VERSION ""

NS_ :

BS_:

BU_: Gateway_25 FCM_A0 FLR SRR_RL External_Tool SRR_FL Steering_E4 VCU_47 CLS_17 ESC_0B EMS_00

BO_ 646 SRR_FL_DETECTION_025_028: 64 SRR_FL
 SG_ DET_RANGE_025 : 24|15@1+ (0.015625,0) [0|500] "m"  SRR_RL
 SG_ DET_RANGE_ERR_025 : 40|7@1+ (0.0075,0) [0|0.9525] "m"  SRR_RL
 SG_ DET_RANGE_VELOCITY_025 : 48|15@1+ (0.0078125,-128) [-128|127.9921875] "m/s"  SRR_RL
 SG_ DET_RANGE_VELOCITY_ERR_025 : 64|8@1+ (0.003,0) [0|0.765] "m/s"  SRR_RL
 SG_ DET_AZIMUTH_025 : 88|13@1+ (0.0004,-1.5708) [-1.5708|1.5708] "rad"  SRR_RL
 SG_ DET_AZIMUTH_ERR_025 : 105|7@1+ (0.00087267,0) [0|0.11082909] "rad"  SRR_RL
 SG_ DET_ELEVATION_025 : 72|8@1+ (0.00275,-0.34925) [-0.34925|0.34925] "rad"  SRR_RL
 SG_ DET_ELEVATION_ERR_025 : 80|6@1+ (0.00174533,0) [0|0.10995579] "rad"  SRR_RL
 SG_ DET_RCS_025 : 128|8@1+ (0.5,-64) [-64|63.5] "dBsm"  SRR_RL
 SG_ DET_BI_STATIC_FLAG_025 : 104|1@1+ (1,0) [0|1] ""  SRR_RL
 SG_ DET_SUPER_RES_TARGET_025 : 87|1@1+ (1,0) [0|1] ""  SRR_RL
 SG_ DET_SNR_025 : 120|8@1+ (0.35156,0) [0|89.6478] "dB"  SRR_RL
 SG_ DET_EXISTENCE_PROB_025 : 112|6@1+ (1.588,0) [0|100] "%"  SRR_RL
 SG_ DET_HVC_FLAG_025 : 86|1@1+ (1,0) [0|1] ""  SRR_RL
 SG_ DET_CONFD_AZIMUTH_025 : 118|2@1+ (1,0) [0|3] ""  SRR_RL
 SG_ DET_CONFD_ELEVATION_025 : 101|2@1+ (1,0) [0|3] ""  SRR_RL
 SG_ DET_PROB_1STAZHYPO_025 : 103|1@1+ (1,0) [0|1] ""  SRR_RL
 SG_ DET_IDM_025 : 63|1@1+ (1,0) [0|1] ""  SRR_RL
 SG_ DET_MTD_025 : 47|1@1+ (1,0) [0|1] ""  SRR_RL
 SG_ DET_BELOW_RAIN_THOLD_025 : 39|1@1+ (1,0) [0|1] ""  SRR_RL
 SG_ DET_RANGE_026 : 136|15@1+ (0.015625,0) [0|500] "m"  SRR_RL
 SG_ DET_RANGE_ERR_026 : 152|7@1+ (0.0075,0) [0|0.9525] "m"  SRR_RL
 SG_ DET_RANGE_VELOCITY_026 : 160|15@1+ (0.0078125,-128) [-128|127.9921875] "m/s"  SRR_RL
 SG_ DET_RANGE_VELOCITY_ERR_026 : 176|8@1+ (0.003,0) [0|0.765] "m/s"  SRR_RL
 SG_ DET_AZIMUTH_026 : 200|13@1+ (0.0004,-1.5708) [-1.5708|1.5708] "rad"  SRR_RL
 SG_ DET_AZIMUTH_ERR_026 : 217|7@1+ (0.00087267,0) [0|0.11082909] "rad"  SRR_RL
 SG_ DET_ELEVATION_026 : 184|8@1+ (0.00275,-0.34925) [-0.34925|0.34925] "rad"  SRR_RL
 SG_ DET_ELEVATION_ERR_026 : 192|6@1+ (0.00174533,0) [0|0.10995579] "rad"  SRR_RL
 SG_ DET_RCS_026 : 240|8@1+ (0.5,-64) [-64|63.5] "dBsm"  SRR_RL
 SG_ DET_BI_STATIC_FLAG_026 : 216|1@1+ (1,0) [0|1] ""  SRR_RL
 SG_ DET_SUPER_RES_TARGET_026 : 199|1@1+ (1,0) [0|1] ""  SRR_RL
 SG_ DET_SNR_026 : 232|8@1+ (0.35156,0) [0|89.6478] "dB"  SRR_RL
 SG_ DET_EXISTENCE_PROB_026 : 224|6@1+ (1.588,0) [0|100] "%"  SRR_RL
 SG_ DET_HVC_FLAG_026 : 198|1@1+ (1,0) [0|1] ""  SRR_RL
 SG_ DET_CONFD_AZIMUTH_026 : 230|2@1+ (1,0) [0|3] ""  SRR_RL
 SG_ DET_CONFD_ELEVATION_026 : 213|2@1+ (1,0) [0|3] ""  SRR_RL
 SG_ DET_PROB_1STAZHYPO_026 : 215|1@1+ (1,0) [0|1] ""  SRR_RL
 SG_ DET_IDM_026 : 175|1@1+ (1,0) [0|1] ""  SRR_RL
 SG_ DET_MTD_026 : 159|1@1+ (1,0) [0|1] ""  SRR_RL
 SG_ DET_BELOW_RAIN_THOLD_026 : 151|1@1+ (1,0) [0|1] ""  SRR_RL
 SG_ DET_RANGE_027 : 248|15@1+ (0.015625,0) [0|500] "m"  SRR_RL
 SG_ DET_RANGE_ERR_027 : 264|7@1+ (0.0075,0) [0|0.9525] "m"  SRR_RL
 SG_ DET_RANGE_VELOCITY_027 : 272|15@1+ (0.0078125,-128) [-128|127.9921875] "m/s"  SRR_RL
 SG_ DET_RANGE_VELOCITY_ERR_027 : 288|8@1+ (0.003,0) [0|0.765] "m/s"  SRR_RL
 SG_ DET_AZIMUTH_027 : 312|13@1+ (0.0004,-1.5708) [-1.5708|1.5708] "rad"  SRR_RL
 SG_ DET_AZIMUTH_ERR_027 : 329|7@1+ (0.00087267,0) [0|0.11082909] "rad"  SRR_RL
 SG_ DET_ELEVATION_027 : 296|8@1+ (0.00275,-0.34925) [-0.34925|0.34925] "rad"  SRR_RL
 SG_ DET_ELEVATION_ERR_027 : 304|6@1+ (0.00174533,0) [0|0.10995579] "rad"  SRR_RL
 SG_ DET_RCS_027 : 352|8@1+ (0.5,-64) [-64|63.5] "dBsm"  SRR_RL
 SG_ DET_BI_STATIC_FLAG_027 : 328|1@1+ (1,0) [0|1] ""  SRR_RL
 SG_ DET_SUPER_RES_TARGET_027 : 311|1@1+ (1,0) [0|1] ""  SRR_RL
 SG_ DET_SNR_027 : 344|8@1+ (0.35156,0) [0|89.6478] "dB"  SRR_RL
 SG_ DET_EXISTENCE_PROB_027 : 336|6@1+ (1.588,0) [0|100] "%"  SRR_RL
 SG_ DET_HVC_FLAG_027 : 310|1@1+ (1,0) [0|1] ""  SRR_RL
 SG_ DET_CONFD_AZIMUTH_027 : 342|2@1+ (1,0) [0|3] ""  SRR_RL
 SG_ DET_CONFD_ELEVATION_027 : 325|2@1+ (1,0) [0|3] ""  SRR_RL
 SG_ DET_PROB_1STAZHYPO_027 : 327|1@1+ (1,0) [0|1] ""  SRR_RL
 SG_ DET_IDM_027 : 287|1@1+ (1,0) [0|1] ""  SRR_RL
 SG_ DET_MTD_027 : 271|1@1+ (1,0) [0|1] ""  SRR_RL
 SG_ DET_BELOW_RAIN_THOLD_027 : 263|1@1+ (1,0) [0|1] ""  SRR_RL
 SG_ DET_RANGE_028 : 360|15@1+ (0.015625,0) [0|500] "m"  SRR_RL
 SG_ DET_RANGE_ERR_028 : 376|7@1+ (0.0075,0) [0|0.9525] "m"  SRR_RL
 SG_ DET_RANGE_VELOCITY_028 : 384|15@1+ (0.0078125,-128) [-128|127.9921875] "m/s"  SRR_RL
 SG_ DET_RANGE_VELOCITY_ERR_028 : 400|8@1+ (0.003,0) [0|0.765] "m/s"  SRR_RL
 SG_ DET_AZIMUTH_028 : 424|13@1+ (0.0004,-1.5708) [-1.5708|1.5708] "rad"  SRR_RL
 SG_ DET_AZIMUTH_ERR_028 : 441|7@1+ (0.00087267,0) [0|0.11082909] "rad"  SRR_RL
 SG_ DET_ELEVATION_028 : 408|8@1+ (0.00275,-0.34925) [-0.34925|0.34925] "rad"  SRR_RL
 SG_ DET_ELEVATION_ERR_028 : 416|6@1+ (0.00174533,0) [0|0.10995579] "rad"  SRR_RL
 SG_ DET_RCS_028 : 464|8@1+ (0.5,-64) [-64|63.5] "dBsm"  SRR_RL
 SG_ DET_BI_STATIC_FLAG_028 : 440|1@1+ (1,0) [0|1] ""  SRR_RL
 SG_ DET_SUPER_RES_TARGET_028 : 423|1@1+ (1,0) [0|1] ""  SRR_RL
 SG_ DET_SNR_028 : 456|8@1+ (0.35156,0) [0|89.6478] "dB"  SRR_RL
 SG_ DET_EXISTENCE_PROB_028 : 448|6@1+ (1.588,0) [0|100] "%"  SRR_RL
 SG_ DET_HVC_FLAG_028 : 422|1@1+ (1,0) [0|1] ""  SRR_RL
 SG_ DET_CONFD_AZIMUTH_028 : 454|2@1+ (1,0) [0|3] ""  SRR_RL
 SG_ DET_CONFD_ELEVATION_028 : 437|2@1+ (1,0) [0|3] ""  SRR_RL
 SG_ DET_MH_SCAN_INDEX_4LSB_025_028 : 476|4@1+ (1,0) [0|15] ""  SRR_RL
 SG_ DET_MH_CYCLE_COUNTER_025_028 : 16|8@1+ (1,0) [0|255] ""  SRR_RL
 SG_ DET_MH_CRC16_025_028 : 0|16@1+ (1,0) [0|65535] ""  SRR_RL
 SG_ DET_PROB_1STAZHYPO_028 : 439|1@1+ (1,0) [0|1] ""  SRR_RL
 SG_ DET_IDM_028 : 399|1@1+ (1,0) [0|1] ""  SRR_RL
 SG_ DET_MTD_028 : 383|1@1+ (1,0) [0|1] ""  SRR_RL
 SG_ DET_BELOW_RAIN_THOLD_028 : 375|1@1+ (1,0) [0|1] ""  SRR_RL

BO_ 647 SRR_FL_DETECTION_029_032: 64 SRR_FL
 SG_ DET_RANGE_029 : 24|15@1+ (0.015625,0) [0|500] "m"  SRR_RL
 SG_ DET_RANGE_ERR_029 : 40|7@1+ (0.0075,0) [0|0.9525] "m"  SRR_RL
 SG_ DET_RANGE_VELOCITY_029 : 48|15@1+ (0.0078125,-128) [-128|127.9921875] "m/s"  SRR_RL
 SG_ DET_RANGE_VELOCITY_ERR_029 : 64|8@1+ (0.003,0) [0|0.765] "m/s"  SRR_RL
 SG_ DET_AZIMUTH_029 : 88|13@1+ (0.0004,-1.5708) [-1.5708|1.5708] "rad"  SRR_RL
 SG_ DET_AZIMUTH_ERR_029 : 105|7@1+ (0.00087267,0) [0|0.11082909] "rad"  SRR_RL
 SG_ DET_ELEVATION_029 : 72|8@1+ (0.00275,-0.34925) [-0.34925|0.34925] "rad"  SRR_RL
 SG_ DET_ELEVATION_ERR_029 : 80|6@1+ (0.00174533,0) [0|0.10995579] "rad"  SRR_RL
 SG_ DET_RCS_029 : 128|8@1+ (0.5,-64) [-64|63.5] "dBsm"  SRR_RL
 SG_ DET_BI_STATIC_FLAG_029 : 104|1@1+ (1,0) [0|1] ""  SRR_RL
 SG_ DET_SUPER_RES_TARGET_029 : 87|1@1+ (1,0) [0|1] ""  SRR_RL
 SG_ DET_SNR_029 : 120|8@1+ (0.35156,0) [0|89.6478] "dB"  SRR_RL
 SG_ DET_EXISTENCE_PROB_029 : 112|6@1+ (1.588,0) [0|100] "%"  SRR_RL
 SG_ DET_HVC_FLAG_029 : 86|1@1+ (1,0) [0|1] ""  SRR_RL
 SG_ DET_CONFD_AZIMUTH_029 : 118|2@1+ (1,0) [0|3] ""  SRR_RL
 SG_ DET_CONFD_ELEVATION_029 : 101|2@1+ (1,0) [0|3] ""  SRR_RL
 SG_ DET_PROB_1STAZHYPO_029 : 103|1@1+ (1,0) [0|1] ""  SRR_RL
 SG_ DET_IDM_029 : 63|1@1+ (1,0) [0|1] ""  SRR_RL
 SG_ DET_MTD_029 : 47|1@1+ (1,0) [0|1] ""  SRR_RL
 SG_ DET_BELOW_RAIN_THOLD_029 : 39|1@1+ (1,0) [0|1] ""  SRR_RL
 SG_ DET_RANGE_030 : 136|15@1+ (0.015625,0) [0|500] "m"  SRR_RL
 SG_ DET_RANGE_ERR_030 : 152|7@1+ (0.0075,0) [0|0.9525] "m"  SRR_RL
 SG_ DET_RANGE_VELOCITY_030 : 160|15@1+ (0.0078125,-128) [-128|127.9921875] "m/s"  SRR_RL
 SG_ DET_RANGE_VELOCITY_ERR_030 : 176|8@1+ (0.003,0) [0|0.765] "m/s"  SRR_RL
 SG_ DET_AZIMUTH_030 : 200|13@1+ (0.0004,-1.5708) [-1.5708|1.5708] "rad"  SRR_RL
 SG_ DET_AZIMUTH_ERR_030 : 217|7@1+ (0.00087267,0) [0|0.11082909] "rad"  SRR_RL
 SG_ DET_ELEVATION_030 : 184|8@1+ (0.00275,-0.34925) [-0.34925|0.34925] "rad"  SRR_RL
 SG_ DET_ELEVATION_ERR_030 : 192|6@1+ (0.00174533,0) [0|0.10995579] "rad"  SRR_RL
 SG_ DET_RCS_030 : 240|8@1+ (0.5,-64) [-64|63.5] "dBsm"  SRR_RL
 SG_ DET_BI_STATIC_FLAG_030 : 216|1@1+ (1,0) [0|1] ""  SRR_RL
 SG_ DET_SUPER_RES_TARGET_030 : 199|1@1+ (1,0) [0|1] ""  SRR_RL
 SG_ DET_SNR_030 : 232|8@1+ (0.35156,0) [0|89.6478] "dB"  SRR_RL
 SG_ DET_EXISTENCE_PROB_030 : 224|6@1+ (1.588,0) [0|100] "%"  SRR_RL
 SG_ DET_HVC_FLAG_030 : 198|1@1+ (1,0) [0|1] ""  SRR_RL
 SG_ DET_CONFD_AZIMUTH_030 : 230|2@1+ (1,0) [0|3] ""  SRR_RL
 SG_ DET_CONFD_ELEVATION_030 : 213|2@1+ (1,0) [0|3] ""  SRR_RL
 SG_ DET_PROB_1STAZHYPO_030 : 215|1@1+ (1,0) [0|1] ""  SRR_RL
 SG_ DET_IDM_030 : 175|1@1+ (1,0) [0|1] ""  SRR_RL
 SG_ DET_MTD_030 : 159|1@1+ (1,0) [0|1] ""  SRR_RL
 SG_ DET_BELOW_RAIN_THOLD_030 : 151|1@1+ (1,0) [0|1] ""  SRR_RL
 SG_ DET_RANGE_031 : 248|15@1+ (0.015625,0) [0|500] "m"  SRR_RL
 SG_ DET_RANGE_ERR_031 : 264|7@1+ (0.0075,0) [0|0.9525] "m"  SRR_RL
 SG_ DET_RANGE_VELOCITY_031 : 272|15@1+ (0.0078125,-128) [-128|127.9921875] "m/s"  SRR_RL
 SG_ DET_RANGE_VELOCITY_ERR_031 : 288|8@1+ (0.003,0) [0|0.765] "m/s"  SRR_RL
 SG_ DET_AZIMUTH_031 : 312|13@1+ (0.0004,-1.5708) [-1.5708|1.5708] "rad"  SRR_RL
 SG_ DET_AZIMUTH_ERR_031 : 329|7@1+ (0.00087267,0) [0|0.11082909] "rad"  SRR_RL
 SG_ DET_ELEVATION_031 : 296|8@1+ (0.00275,-0.34925) [-0.34925|0.34925] "rad"  SRR_RL
 SG_ DET_ELEVATION_ERR_031 : 304|6@1+ (0.00174533,0) [0|0.10995579] "rad"  SRR_RL
 SG_ DET_RCS_031 : 352|8@1+ (0.5,-64) [-64|63.5] "dBsm"  SRR_RL
 SG_ DET_BI_STATIC_FLAG_031 : 328|1@1+ (1,0) [0|1] ""  SRR_RL
 SG_ DET_SUPER_RES_TARGET_031 : 311|1@1+ (1,0) [0|1] ""  SRR_RL
 SG_ DET_SNR_031 : 344|8@1+ (0.35156,0) [0|89.6478] "dB"  SRR_RL
 SG_ DET_EXISTENCE_PROB_031 : 336|6@1+ (1.588,0) [0|100] "%"  SRR_RL
 SG_ DET_HVC_FLAG_031 : 310|1@1+ (1,0) [0|1] ""  SRR_RL
 SG_ DET_CONFD_AZIMUTH_031 : 342|2@1+ (1,0) [0|3] ""  SRR_RL
 SG_ DET_CONFD_ELEVATION_031 : 325|2@1+ (1,0) [0|3] ""  SRR_RL
 SG_ DET_PROB_1STAZHYPO_031 : 327|1@1+ (1,0) [0|1] ""  SRR_RL
 SG_ DET_IDM_031 : 287|1@1+ (1,0) [0|1] ""  SRR_RL
 SG_ DET_MTD_031 : 271|1@1+ (1,0) [0|1] ""  SRR_RL
 SG_ DET_BELOW_RAIN_THOLD_031 : 263|1@1+ (1,0) [0|1] ""  SRR_RL
 SG_ DET_RANGE_032 : 360|15@1+ (0.015625,0) [0|500] "m"  SRR_RL
 SG_ DET_RANGE_ERR_032 : 376|7@1+ (0.0075,0) [0|0.9525] "m"  SRR_RL
 SG_ DET_RANGE_VELOCITY_032 : 384|15@1+ (0.0078125,-128) [-128|127.9921875] "m/s"  SRR_RL
 SG_ DET_RANGE_VELOCITY_ERR_032 : 400|8@1+ (0.003,0) [0|0.765] "m/s"  SRR_RL
 SG_ DET_AZIMUTH_032 : 424|13@1+ (0.0004,-1.5708) [-1.5708|1.5708] "rad"  SRR_RL
 SG_ DET_AZIMUTH_ERR_032 : 441|7@1+ (0.00087267,0) [0|0.11082909] "rad"  SRR_RL
 SG_ DET_ELEVATION_032 : 408|8@1+ (0.00275,-0.34925) [-0.34925|0.34925] "rad"  SRR_RL
 SG_ DET_ELEVATION_ERR_032 : 416|6@1+ (0.00174533,0) [0|0.10995579] "rad"  SRR_RL
 SG_ DET_RCS_032 : 464|8@1+ (0.5,-64) [-64|63.5] "dBsm"  SRR_RL
 SG_ DET_BI_STATIC_FLAG_032 : 440|1@1+ (1,0) [0|1] ""  SRR_RL
 SG_ DET_SUPER_RES_TARGET_032 : 423|1@1+ (1,0) [0|1] ""  SRR_RL
 SG_ DET_SNR_032 : 456|8@1+ (0.35156,0) [0|89.6478] "dB"  SRR_RL
 SG_ DET_EXISTENCE_PROB_032 : 448|6@1+ (1.588,0) [0|100] "%"  SRR_RL
 SG_ DET_HVC_FLAG_032 : 422|1@1+ (1,0) [0|1] ""  SRR_RL
 SG_ DET_CONFD_AZIMUTH_032 : 454|2@1+ (1,0) [0|3] ""  SRR_RL
 SG_ DET_CONFD_ELEVATION_032 : 437|2@1+ (1,0) [0|3] ""  SRR_RL
 SG_ DET_MH_SCAN_INDEX_4LSB_029_032 : 476|4@1+ (1,0) [0|15] ""  SRR_RL
 SG_ DET_MH_CYCLE_COUNTER_029_032 : 16|8@1+ (1,0) [0|255] ""  SRR_RL
 SG_ DET_MH_CRC16_029_032 : 0|16@1+ (1,0) [0|65535] ""  SRR_RL
 SG_ DET_PROB_1STAZHYPO_032 : 439|1@1+ (1,0) [0|1] ""  SRR_RL
 SG_ DET_IDM_032 : 399|1@1+ (1,0) [0|1] ""  SRR_RL
 SG_ DET_MTD_032 : 383|1@1+ (1,0) [0|1] ""  SRR_RL
 SG_ DET_BELOW_RAIN_THOLD_032 : 375|1@1+ (1,0) [0|1] ""  SRR_RL

BO_ 648 SRR_FL_DETECTION_033_036: 64 SRR_FL
 SG_ DET_RANGE_033 : 24|15@1+ (0.015625,0) [0|500] "m"  SRR_RL
 SG_ DET_RANGE_ERR_033 : 40|7@1+ (0.0075,0) [0|0.9525] "m"  SRR_RL
 SG_ DET_RANGE_VELOCITY_033 : 48|15@1+ (0.0078125,-128) [-128|127.9921875] "m/s"  SRR_RL
 SG_ DET_RANGE_VELOCITY_ERR_033 : 64|8@1+ (0.003,0) [0|0.765] "m/s"  SRR_RL
 SG_ DET_AZIMUTH_033 : 88|13@1+ (0.0004,-1.5708) [-1.5708|1.5708] "rad"  SRR_RL
 SG_ DET_AZIMUTH_ERR_033 : 105|7@1+ (0.00087267,0) [0|0.11082909] "rad"  SRR_RL
 SG_ DET_ELEVATION_033 : 72|8@1+ (0.00275,-0.34925) [-0.34925|0.34925] "rad"  SRR_RL
 SG_ DET_ELEVATION_ERR_033 : 80|6@1+ (0.00174533,0) [0|0.10995579] "rad"  SRR_RL
 SG_ DET_RCS_033 : 128|8@1+ (0.5,-64) [-64|63.5] "dBsm"  SRR_RL
 SG_ DET_BI_STATIC_FLAG_033 : 104|1@1+ (1,0) [0|1] ""  SRR_RL
 SG_ DET_SUPER_RES_TARGET_033 : 87|1@1+ (1,0) [0|1] ""  SRR_RL
 SG_ DET_SNR_033 : 120|8@1+ (0.35156,0) [0|89.6478] "dB"  SRR_RL
 SG_ DET_EXISTENCE_PROB_033 : 112|6@1+ (1.588,0) [0|100] "%"  SRR_RL
 SG_ DET_HVC_FLAG_033 : 86|1@1+ (1,0) [0|1] ""  SRR_RL
 SG_ DET_CONFD_AZIMUTH_033 : 118|2@1+ (1,0) [0|3] ""  SRR_RL
 SG_ DET_CONFD_ELEVATION_033 : 101|2@1+ (1,0) [0|3] ""  SRR_RL
 SG_ DET_PROB_1STAZHYPO_033 : 103|1@1+ (1,0) [0|1] ""  SRR_RL
 SG_ DET_IDM_033 : 63|1@1+ (1,0) [0|1] ""  SRR_RL
 SG_ DET_MTD_033 : 47|1@1+ (1,0) [0|1] ""  SRR_RL
 SG_ DET_BELOW_RAIN_THOLD_033 : 39|1@1+ (1,0) [0|1] ""  SRR_RL
 SG_ DET_RANGE_034 : 136|15@1+ (0.015625,0) [0|500] "m"  SRR_RL
 SG_ DET_RANGE_ERR_034 : 152|7@1+ (0.0075,0) [0|0.9525] "m"  SRR_RL
 SG_ DET_RANGE_VELOCITY_034 : 160|15@1+ (0.0078125,-128) [-128|127.9921875] "m/s"  SRR_RL
 SG_ DET_RANGE_VELOCITY_ERR_034 : 176|8@1+ (0.003,0) [0|0.765] "m/s"  SRR_RL
 SG_ DET_AZIMUTH_034 : 200|13@1+ (0.0004,-1.5708) [-1.5708|1.5708] "rad"  SRR_RL
 SG_ DET_AZIMUTH_ERR_034 : 217|7@1+ (0.00087267,0) [0|0.11082909] "rad"  SRR_RL
 SG_ DET_ELEVATION_034 : 184|8@1+ (0.00275,-0.34925) [-0.34925|0.34925] "rad"  SRR_RL
 SG_ DET_ELEVATION_ERR_034 : 192|6@1+ (0.00174533,0) [0|0.10995579] "rad"  SRR_RL
 SG_ DET_RCS_034 : 240|8@1+ (0.5,-64) [-64|63.5] "dBsm"  SRR_RL
 SG_ DET_BI_STATIC_FLAG_034 : 216|1@1+ (1,0) [0|1] ""  SRR_RL
 SG_ DET_SUPER_RES_TARGET_034 : 199|1@1+ (1,0) [0|1] ""  SRR_RL
 SG_ DET_SNR_034 : 232|8@1+ (0.35156,0) [0|89.6478] "dB"  SRR_RL
 SG_ DET_EXISTENCE_PROB_034 : 224|6@1+ (1.588,0) [0|100] "%"  SRR_RL
 SG_ DET_HVC_FLAG_034 : 198|1@1+ (1,0) [0|1] ""  SRR_RL
 SG_ DET_CONFD_AZIMUTH_034 : 230|2@1+ (1,0) [0|3] ""  SRR_RL
 SG_ DET_CONFD_ELEVATION_034 : 213|2@1+ (1,0) [0|3] ""  SRR_RL
 SG_ DET_PROB_1STAZHYPO_034 : 215|1@1+ (1,0) [0|1] ""  SRR_RL
 SG_ DET_IDM_034 : 175|1@1+ (1,0) [0|1] ""  SRR_RL
 SG_ DET_MTD_034 : 159|1@1+ (1,0) [0|1] ""  SRR_RL
 SG_ DET_BELOW_RAIN_THOLD_034 : 151|1@1+ (1,0) [0|1] ""  SRR_RL
 SG_ DET_RANGE_035 : 248|15@1+ (0.015625,0) [0|500] "m"  SRR_RL
 SG_ DET_RANGE_ERR_035 : 264|7@1+ (0.0075,0) [0|0.9525] "m"  SRR_RL
 SG_ DET_RANGE_VELOCITY_035 : 272|15@1+ (0.0078125,-128) [-128|127.9921875] "m/s"  SRR_RL
 SG_ DET_RANGE_VELOCITY_ERR_035 : 288|8@1+ (0.003,0) [0|0.765] "m/s"  SRR_RL
 SG_ DET_AZIMUTH_035 : 312|13@1+ (0.0004,-1.5708) [-1.5708|1.5708] "rad"  SRR_RL
 SG_ DET_AZIMUTH_ERR_035 : 329|7@1+ (0.00087267,0) [0|0.11082909] "rad"  SRR_RL
 SG_ DET_ELEVATION_035 : 296|8@1+ (0.00275,-0.34925) [-0.34925|0.34925] "rad"  SRR_RL
 SG_ DET_ELEVATION_ERR_035 : 304|6@1+ (0.00174533,0) [0|0.10995579] "rad"  SRR_RL
 SG_ DET_RCS_035 : 352|8@1+ (0.5,-64) [-64|63.5] "dBsm"  SRR_RL
 SG_ DET_BI_STATIC_FLAG_035 : 328|1@1+ (1,0) [0|1] ""  SRR_RL
 SG_ DET_SUPER_RES_TARGET_035 : 311|1@1+ (1,0) [0|1] ""  SRR_RL
 SG_ DET_SNR_035 : 344|8@1+ (0.35156,0) [0|89.6478] "dB"  SRR_RL
 SG_ DET_EXISTENCE_PROB_035 : 336|6@1+ (1.588,0) [0|100] "%"  SRR_RL
 SG_ DET_HVC_FLAG_035 : 310|1@1+ (1,0) [0|1] ""  SRR_RL
 SG_ DET_CONFD_AZIMUTH_035 : 342|2@1+ (1,0) [0|3] ""  SRR_RL
 SG_ DET_CONFD_ELEVATION_035 : 325|2@1+ (1,0) [0|3] ""  SRR_RL
 SG_ DET_PROB_1STAZHYPO_035 : 327|1@1+ (1,0) [0|1] ""  SRR_RL
 SG_ DET_IDM_035 : 287|1@1+ (1,0) [0|1] ""  SRR_RL
 SG_ DET_MTD_035 : 271|1@1+ (1,0) [0|1] ""  SRR_RL
 SG_ DET_BELOW_RAIN_THOLD_035 : 263|1@1+ (1,0) [0|1] ""  SRR_RL
 SG_ DET_RANGE_036 : 360|15@1+ (0.015625,0) [0|500] "m"  SRR_RL
 SG_ DET_RANGE_ERR_036 : 376|7@1+ (0.0075,0) [0|0.9525] "m"  SRR_RL
 SG_ DET_RANGE_VELOCITY_036 : 384|15@1+ (0.0078125,-128) [-128|127.9921875] "m/s"  SRR_RL
 SG_ DET_RANGE_VELOCITY_ERR_036 : 400|8@1+ (0.003,0) [0|0.765] "m/s"  SRR_RL
 SG_ DET_AZIMUTH_036 : 424|13@1+ (0.0004,-1.5708) [-1.5708|1.5708] "rad"  SRR_RL
 SG_ DET_AZIMUTH_ERR_036 : 441|7@1+ (0.00087267,0) [0|0.11082909] "rad"  SRR_RL
 SG_ DET_ELEVATION_036 : 408|8@1+ (0.00275,-0.34925) [-0.34925|0.34925] "rad"  SRR_RL
 SG_ DET_ELEVATION_ERR_036 : 416|6@1+ (0.00174533,0) [0|0.10995579] "rad"  SRR_RL
 SG_ DET_RCS_036 : 464|8@1+ (0.5,-64) [-64|63.5] "dBsm"  SRR_RL
 SG_ DET_BI_STATIC_FLAG_036 : 440|1@1+ (1,0) [0|1] ""  SRR_RL
 SG_ DET_SUPER_RES_TARGET_036 : 423|1@1+ (1,0) [0|1] ""  SRR_RL
 SG_ DET_SNR_036 : 456|8@1+ (0.35156,0) [0|89.6478] "dB"  SRR_RL
 SG_ DET_EXISTENCE_PROB_036 : 448|6@1+ (1.588,0) [0|100] "%"  SRR_RL
 SG_ DET_HVC_FLAG_036 : 422|1@1+ (1,0) [0|1] ""  SRR_RL
 SG_ DET_CONFD_AZIMUTH_036 : 454|2@1+ (1,0) [0|3] ""  SRR_RL
 SG_ DET_CONFD_ELEVATION_036 : 437|2@1+ (1,0) [0|3] ""  SRR_RL
 SG_ DET_MH_SCAN_INDEX_4LSB_033_036 : 476|4@1+ (1,0) [0|15] ""  SRR_RL
 SG_ DET_MH_CYCLE_COUNTER_033_036 : 16|8@1+ (1,0) [0|255] ""  SRR_RL
 SG_ DET_MH_CRC16_033_036 : 0|16@1+ (1,0) [0|65535] ""  SRR_RL
 SG_ DET_PROB_1STAZHYPO_036 : 439|1@1+ (1,0) [0|1] ""  SRR_RL
 SG_ DET_IDM_036 : 399|1@1+ (1,0) [0|1] ""  SRR_RL
 SG_ DET_MTD_036 : 383|1@1+ (1,0) [0|1] ""  SRR_RL
 SG_ DET_BELOW_RAIN_THOLD_036 : 375|1@1+ (1,0) [0|1] ""  SRR_RL

BO_ 649 SRR_FL_DETECTION_037_040: 64 SRR_FL
 SG_ DET_RANGE_037 : 24|15@1+ (0.015625,0) [0|500] "m"  SRR_RL
 SG_ DET_RANGE_ERR_037 : 40|7@1+ (0.0075,0) [0|0.9525] "m"  SRR_RL
 SG_ DET_RANGE_VELOCITY_037 : 48|15@1+ (0.0078125,-128) [-128|127.9921875] "m/s"  SRR_RL
 SG_ DET_RANGE_VELOCITY_ERR_037 : 64|8@1+ (0.003,0) [0|0.765] "m/s"  SRR_RL
 SG_ DET_AZIMUTH_037 : 88|13@1+ (0.0004,-1.5708) [-1.5708|1.5708] "rad"  SRR_RL
 SG_ DET_AZIMUTH_ERR_037 : 105|7@1+ (0.00087267,0) [0|0.11082909] "rad"  SRR_RL
 SG_ DET_ELEVATION_037 : 72|8@1+ (0.00275,-0.34925) [-0.34925|0.34925] "rad"  SRR_RL
 SG_ DET_ELEVATION_ERR_037 : 80|6@1+ (0.00174533,0) [0|0.10995579] "rad"  SRR_RL
 SG_ DET_RCS_037 : 128|8@1+ (0.5,-64) [-64|63.5] "dBsm"  SRR_RL
 SG_ DET_BI_STATIC_FLAG_037 : 104|1@1+ (1,0) [0|1] ""  SRR_RL
 SG_ DET_SUPER_RES_TARGET_037 : 87|1@1+ (1,0) [0|1] ""  SRR_RL
 SG_ DET_SNR_037 : 120|8@1+ (0.35156,0) [0|89.6478] "dB"  SRR_RL
 SG_ DET_EXISTENCE_PROB_037 : 112|6@1+ (1.588,0) [0|100] "%"  SRR_RL
 SG_ DET_HVC_FLAG_037 : 86|1@1+ (1,0) [0|1] ""  SRR_RL
 SG_ DET_CONFD_AZIMUTH_037 : 118|2@1+ (1,0) [0|3] ""  SRR_RL
 SG_ DET_CONFD_ELEVATION_037 : 101|2@1+ (1,0) [0|3] ""  SRR_RL
 SG_ DET_PROB_1STAZHYPO_037 : 103|1@1+ (1,0) [0|1] ""  SRR_RL
 SG_ DET_IDM_037 : 63|1@1+ (1,0) [0|1] ""  SRR_RL
 SG_ DET_MTD_037 : 47|1@1+ (1,0) [0|1] ""  SRR_RL
 SG_ DET_BELOW_RAIN_THOLD_037 : 39|1@1+ (1,0) [0|1] ""  SRR_RL
 SG_ DET_RANGE_038 : 136|15@1+ (0.015625,0) [0|500] "m"  SRR_RL
 SG_ DET_RANGE_ERR_038 : 152|7@1+ (0.0075,0) [0|0.9525] "m"  SRR_RL
 SG_ DET_RANGE_VELOCITY_038 : 160|15@1+ (0.0078125,-128) [-128|127.9921875] "m/s"  SRR_RL
 SG_ DET_RANGE_VELOCITY_ERR_038 : 176|8@1+ (0.003,0) [0|0.765] "m/s"  SRR_RL
 SG_ DET_AZIMUTH_038 : 200|13@1+ (0.0004,-1.5708) [-1.5708|1.5708] "rad"  SRR_RL
 SG_ DET_AZIMUTH_ERR_038 : 217|7@1+ (0.00087267,0) [0|0.11082909] "rad"  SRR_RL
 SG_ DET_ELEVATION_038 : 184|8@1+ (0.00275,-0.34925) [-0.34925|0.34925] "rad"  SRR_RL
 SG_ DET_ELEVATION_ERR_038 : 192|6@1+ (0.00174533,0) [0|0.10995579] "rad"  SRR_RL
 SG_ DET_RCS_038 : 240|8@1+ (0.5,-64) [-64|63.5] "dBsm"  SRR_RL
 SG_ DET_BI_STATIC_FLAG_038 : 216|1@1+ (1,0) [0|1] ""  SRR_RL
 SG_ DET_SUPER_RES_TARGET_038 : 199|1@1+ (1,0) [0|1] ""  SRR_RL
 SG_ DET_SNR_038 : 232|8@1+ (0.35156,0) [0|89.6478] "dB"  SRR_RL
 SG_ DET_EXISTENCE_PROB_038 : 224|6@1+ (1.588,0) [0|100] "%"  SRR_RL
 SG_ DET_HVC_FLAG_038 : 198|1@1+ (1,0) [0|1] ""  SRR_RL
 SG_ DET_CONFD_AZIMUTH_038 : 230|2@1+ (1,0) [0|3] ""  SRR_RL
 SG_ DET_CONFD_ELEVATION_038 : 213|2@1+ (1,0) [0|3] ""  SRR_RL
 SG_ DET_PROB_1STAZHYPO_038 : 215|1@1+ (1,0) [0|1] ""  SRR_RL
 SG_ DET_IDM_038 : 175|1@1+ (1,0) [0|1] ""  SRR_RL
 SG_ DET_MTD_038 : 159|1@1+ (1,0) [0|1] ""  SRR_RL
 SG_ DET_BELOW_RAIN_THOLD_038 : 151|1@1+ (1,0) [0|1] ""  SRR_RL
 SG_ DET_RANGE_039 : 248|15@1+ (0.015625,0) [0|500] "m"  SRR_RL
 SG_ DET_RANGE_ERR_039 : 264|7@1+ (0.0075,0) [0|0.9525] "m"  SRR_RL
 SG_ DET_RANGE_VELOCITY_039 : 272|15@1+ (0.0078125,-128) [-128|127.9921875] "m/s"  SRR_RL
 SG_ DET_RANGE_VELOCITY_ERR_039 : 288|8@1+ (0.003,0) [0|0.765] "m/s"  SRR_RL
 SG_ DET_AZIMUTH_039 : 312|13@1+ (0.0004,-1.5708) [-1.5708|1.5708] "rad"  SRR_RL
 SG_ DET_AZIMUTH_ERR_039 : 329|7@1+ (0.00087267,0) [0|0.11082909] "rad"  SRR_RL
 SG_ DET_ELEVATION_039 : 296|8@1+ (0.00275,-0.34925) [-0.34925|0.34925] "rad"  SRR_RL
 SG_ DET_ELEVATION_ERR_039 : 304|6@1+ (0.00174533,0) [0|0.10995579] "rad"  SRR_RL
 SG_ DET_RCS_039 : 352|8@1+ (0.5,-64) [-64|63.5] "dBsm"  SRR_RL
 SG_ DET_BI_STATIC_FLAG_039 : 328|1@1+ (1,0) [0|1] ""  SRR_RL
 SG_ DET_SUPER_RES_TARGET_039 : 311|1@1+ (1,0) [0|1] ""  SRR_RL
 SG_ DET_SNR_039 : 344|8@1+ (0.35156,0) [0|89.6478] "dB"  SRR_RL
 SG_ DET_EXISTENCE_PROB_039 : 336|6@1+ (1.588,0) [0|100] "%"  SRR_RL
 SG_ DET_HVC_FLAG_039 : 310|1@1+ (1,0) [0|1] ""  SRR_RL
 SG_ DET_CONFD_AZIMUTH_039 : 342|2@1+ (1,0) [0|3] ""  SRR_RL
 SG_ DET_CONFD_ELEVATION_039 : 325|2@1+ (1,0) [0|3] ""  SRR_RL
 SG_ DET_PROB_1STAZHYPO_039 : 327|1@1+ (1,0) [0|1] ""  SRR_RL
 SG_ DET_IDM_039 : 287|1@1+ (1,0) [0|1] ""  SRR_RL
 SG_ DET_MTD_039 : 271|1@1+ (1,0) [0|1] ""  SRR_RL
 SG_ DET_BELOW_RAIN_THOLD_039 : 263|1@1+ (1,0) [0|1] ""  SRR_RL
 SG_ DET_RANGE_040 : 360|15@1+ (0.015625,0) [0|500] "m"  SRR_RL
 SG_ DET_RANGE_ERR_040 : 376|7@1+ (0.0075,0) [0|0.9525] "m"  SRR_RL
 SG_ DET_RANGE_VELOCITY_040 : 384|15@1+ (0.0078125,-128) [-128|127.9921875] "m/s"  SRR_RL
 SG_ DET_RANGE_VELOCITY_ERR_040 : 400|8@1+ (0.003,0) [0|0.765] "m/s"  SRR_RL
 SG_ DET_AZIMUTH_040 : 424|13@1+ (0.0004,-1.5708) [-1.5708|1.5708] "rad"  SRR_RL
 SG_ DET_AZIMUTH_ERR_040 : 441|7@1+ (0.00087267,0) [0|0.11082909] "rad"  SRR_RL
 SG_ DET_ELEVATION_040 : 408|8@1+ (0.00275,-0.34925) [-0.34925|0.34925] "rad"  SRR_RL
 SG_ DET_ELEVATION_ERR_040 : 416|6@1+ (0.00174533,0) [0|0.10995579] "rad"  SRR_RL
 SG_ DET_RCS_040 : 464|8@1+ (0.5,-64) [-64|63.5] "dBsm"  SRR_RL
 SG_ DET_BI_STATIC_FLAG_040 : 440|1@1+ (1,0) [0|1] ""  SRR_RL
 SG_ DET_SUPER_RES_TARGET_040 : 423|1@1+ (1,0) [0|1] ""  SRR_RL
 SG_ DET_SNR_040 : 456|8@1+ (0.35156,0) [0|89.6478] "dB"  SRR_RL
 SG_ DET_EXISTENCE_PROB_040 : 448|6@1+ (1.588,0) [0|100] "%"  SRR_RL
 SG_ DET_HVC_FLAG_040 : 422|1@1+ (1,0) [0|1] ""  SRR_RL
 SG_ DET_CONFD_AZIMUTH_040 : 454|2@1+ (1,0) [0|3] ""  SRR_RL
 SG_ DET_CONFD_ELEVATION_040 : 437|2@1+ (1,0) [0|3] ""  SRR_RL
 SG_ DET_MH_SCAN_INDEX_4LSB_037_040 : 476|4@1+ (1,0) [0|15] ""  SRR_RL
 SG_ DET_MH_CYCLE_COUNTER_037_040 : 16|8@1+ (1,0) [0|255] ""  SRR_RL
 SG_ DET_MH_CRC16_037_040 : 0|16@1+ (1,0) [0|65535] ""  SRR_RL
 SG_ DET_PROB_1STAZHYPO_040 : 439|1@1+ (1,0) [0|1] ""  SRR_RL
 SG_ DET_IDM_040 : 399|1@1+ (1,0) [0|1] ""  SRR_RL
 SG_ DET_MTD_040 : 383|1@1+ (1,0) [0|1] ""  SRR_RL
 SG_ DET_BELOW_RAIN_THOLD_040 : 375|1@1+ (1,0) [0|1] ""  SRR_RL

BO_ 650 SRR_FL_DETECTION_041_044: 64 SRR_FL
 SG_ DET_RANGE_041 : 24|15@1+ (0.015625,0) [0|500] "m"  SRR_RL
 SG_ DET_RANGE_ERR_041 : 40|7@1+ (0.0075,0) [0|0.9525] "m"  SRR_RL
 SG_ DET_RANGE_VELOCITY_041 : 48|15@1+ (0.0078125,-128) [-128|127.9921875] "m/s"  SRR_RL
 SG_ DET_RANGE_VELOCITY_ERR_041 : 64|8@1+ (0.003,0) [0|0.765] "m/s"  SRR_RL
 SG_ DET_AZIMUTH_041 : 88|13@1+ (0.0004,-1.5708) [-1.5708|1.5708] "rad"  SRR_RL
 SG_ DET_AZIMUTH_ERR_041 : 105|7@1+ (0.00087267,0) [0|0.11082909] "rad"  SRR_RL
 SG_ DET_ELEVATION_041 : 72|8@1+ (0.00275,-0.34925) [-0.34925|0.34925] "rad"  SRR_RL
 SG_ DET_ELEVATION_ERR_041 : 80|6@1+ (0.00174533,0) [0|0.10995579] "rad"  SRR_RL
 SG_ DET_RCS_041 : 128|8@1+ (0.5,-64) [-64|63.5] "dBsm"  SRR_RL
 SG_ DET_BI_STATIC_FLAG_041 : 104|1@1+ (1,0) [0|1] ""  SRR_RL
 SG_ DET_SUPER_RES_TARGET_041 : 87|1@1+ (1,0) [0|1] ""  SRR_RL
 SG_ DET_SNR_041 : 120|8@1+ (0.35156,0) [0|89.6478] "dB"  SRR_RL
 SG_ DET_EXISTENCE_PROB_041 : 112|6@1+ (1.588,0) [0|100] "%"  SRR_RL
 SG_ DET_HVC_FLAG_041 : 86|1@1+ (1,0) [0|1] ""  SRR_RL
 SG_ DET_CONFD_AZIMUTH_041 : 118|2@1+ (1,0) [0|3] ""  SRR_RL
 SG_ DET_CONFD_ELEVATION_041 : 101|2@1+ (1,0) [0|3] ""  SRR_RL
 SG_ DET_PROB_1STAZHYPO_041 : 103|1@1+ (1,0) [0|1] ""  SRR_RL
 SG_ DET_IDM_041 : 63|1@1+ (1,0) [0|1] ""  SRR_RL
 SG_ DET_MTD_041 : 47|1@1+ (1,0) [0|1] ""  SRR_RL
 SG_ DET_BELOW_RAIN_THOLD_041 : 39|1@1+ (1,0) [0|1] ""  SRR_RL
 SG_ DET_RANGE_042 : 136|15@1+ (0.015625,0) [0|500] "m"  SRR_RL
 SG_ DET_RANGE_ERR_042 : 152|7@1+ (0.0075,0) [0|0.9525] "m"  SRR_RL
 SG_ DET_RANGE_VELOCITY_042 : 160|15@1+ (0.0078125,-128) [-128|127.9921875] "m/s"  SRR_RL
 SG_ DET_RANGE_VELOCITY_ERR_042 : 176|8@1+ (0.003,0) [0|0.765] "m/s"  SRR_RL
 SG_ DET_AZIMUTH_042 : 200|13@1+ (0.0004,-1.5708) [-1.5708|1.5708] "rad"  SRR_RL
 SG_ DET_AZIMUTH_ERR_042 : 217|7@1+ (0.00087267,0) [0|0.11082909] "rad"  SRR_RL
 SG_ DET_ELEVATION_042 : 184|8@1+ (0.00275,-0.34925) [-0.34925|0.34925] "rad"  SRR_RL
 SG_ DET_ELEVATION_ERR_042 : 192|6@1+ (0.00174533,0) [0|0.10995579] "rad"  SRR_RL
 SG_ DET_RCS_042 : 240|8@1+ (0.5,-64) [-64|63.5] "dBsm"  SRR_RL
 SG_ DET_BI_STATIC_FLAG_042 : 216|1@1+ (1,0) [0|1] ""  SRR_RL
 SG_ DET_SUPER_RES_TARGET_042 : 199|1@1+ (1,0) [0|1] ""  SRR_RL
 SG_ DET_SNR_042 : 232|8@1+ (0.35156,0) [0|89.6478] "dB"  SRR_RL
 SG_ DET_EXISTENCE_PROB_042 : 224|6@1+ (1.588,0) [0|100] "%"  SRR_RL
 SG_ DET_HVC_FLAG_042 : 198|1@1+ (1,0) [0|1] ""  SRR_RL
 SG_ DET_CONFD_AZIMUTH_042 : 230|2@1+ (1,0) [0|3] ""  SRR_RL
 SG_ DET_CONFD_ELEVATION_042 : 213|2@1+ (1,0) [0|3] ""  SRR_RL
 SG_ DET_PROB_1STAZHYPO_042 : 215|1@1+ (1,0) [0|1] ""  SRR_RL
 SG_ DET_IDM_042 : 175|1@1+ (1,0) [0|1] ""  SRR_RL
 SG_ DET_MTD_042 : 159|1@1+ (1,0) [0|1] ""  SRR_RL
 SG_ DET_BELOW_RAIN_THOLD_042 : 151|1@1+ (1,0) [0|1] ""  SRR_RL
 SG_ DET_RANGE_043 : 248|15@1+ (0.015625,0) [0|500] "m"  SRR_RL
 SG_ DET_RANGE_ERR_043 : 264|7@1+ (0.0075,0) [0|0.9525] "m"  SRR_RL
 SG_ DET_RANGE_VELOCITY_043 : 272|15@1+ (0.0078125,-128) [-128|127.9921875] "m/s"  SRR_RL
 SG_ DET_RANGE_VELOCITY_ERR_043 : 288|8@1+ (0.003,0) [0|0.765] "m/s"  SRR_RL
 SG_ DET_AZIMUTH_043 : 312|13@1+ (0.0004,-1.5708) [-1.5708|1.5708] "rad"  SRR_RL
 SG_ DET_AZIMUTH_ERR_043 : 329|7@1+ (0.00087267,0) [0|0.11082909] "rad"  SRR_RL
 SG_ DET_ELEVATION_043 : 296|8@1+ (0.00275,-0.34925) [-0.34925|0.34925] "rad"  SRR_RL
 SG_ DET_ELEVATION_ERR_043 : 304|6@1+ (0.00174533,0) [0|0.10995579] "rad"  SRR_RL
 SG_ DET_RCS_043 : 352|8@1+ (0.5,-64) [-64|63.5] "dBsm"  SRR_RL
 SG_ DET_BI_STATIC_FLAG_043 : 328|1@1+ (1,0) [0|1] ""  SRR_RL
 SG_ DET_SUPER_RES_TARGET_043 : 311|1@1+ (1,0) [0|1] ""  SRR_RL
 SG_ DET_SNR_043 : 344|8@1+ (0.35156,0) [0|89.6478] "dB"  SRR_RL
 SG_ DET_EXISTENCE_PROB_043 : 336|6@1+ (1.588,0) [0|100] "%"  SRR_RL
 SG_ DET_HVC_FLAG_043 : 310|1@1+ (1,0) [0|1] ""  SRR_RL
 SG_ DET_CONFD_AZIMUTH_043 : 342|2@1+ (1,0) [0|3] ""  SRR_RL
 SG_ DET_CONFD_ELEVATION_043 : 325|2@1+ (1,0) [0|3] ""  SRR_RL
 SG_ DET_PROB_1STAZHYPO_043 : 327|1@1+ (1,0) [0|1] ""  SRR_RL
 SG_ DET_IDM_043 : 287|1@1+ (1,0) [0|1] ""  SRR_RL
 SG_ DET_MTD_043 : 271|1@1+ (1,0) [0|1] ""  SRR_RL
 SG_ DET_BELOW_RAIN_THOLD_043 : 263|1@1+ (1,0) [0|1] ""  SRR_RL
 SG_ DET_RANGE_044 : 360|15@1+ (0.015625,0) [0|500] "m"  SRR_RL
 SG_ DET_RANGE_ERR_044 : 376|7@1+ (0.0075,0) [0|0.9525] "m"  SRR_RL
 SG_ DET_RANGE_VELOCITY_044 : 384|15@1+ (0.0078125,-128) [-128|127.9921875] "m/s"  SRR_RL
 SG_ DET_RANGE_VELOCITY_ERR_044 : 400|8@1+ (0.003,0) [0|0.765] "m/s"  SRR_RL
 SG_ DET_AZIMUTH_044 : 424|13@1+ (0.0004,-1.5708) [-1.5708|1.5708] "rad"  SRR_RL
 SG_ DET_AZIMUTH_ERR_044 : 441|7@1+ (0.00087267,0) [0|0.11082909] "rad"  SRR_RL
 SG_ DET_ELEVATION_044 : 408|8@1+ (0.00275,-0.34925) [-0.34925|0.34925] "rad"  SRR_RL
 SG_ DET_ELEVATION_ERR_044 : 416|6@1+ (0.00174533,0) [0|0.10995579] "rad"  SRR_RL
 SG_ DET_RCS_044 : 464|8@1+ (0.5,-64) [-64|63.5] "dBsm"  SRR_RL
 SG_ DET_BI_STATIC_FLAG_044 : 440|1@1+ (1,0) [0|1] ""  SRR_RL
 SG_ DET_SUPER_RES_TARGET_044 : 423|1@1+ (1,0) [0|1] ""  SRR_RL
 SG_ DET_SNR_044 : 456|8@1+ (0.35156,0) [0|89.6478] "dB"  SRR_RL
 SG_ DET_EXISTENCE_PROB_044 : 448|6@1+ (1.588,0) [0|100] "%"  SRR_RL
 SG_ DET_HVC_FLAG_044 : 422|1@1+ (1,0) [0|1] ""  SRR_RL
 SG_ DET_CONFD_AZIMUTH_044 : 454|2@1+ (1,0) [0|3] ""  SRR_RL
 SG_ DET_CONFD_ELEVATION_044 : 437|2@1+ (1,0) [0|3] ""  SRR_RL
 SG_ DET_MH_SCAN_INDEX_4LSB_041_044 : 476|4@1+ (1,0) [0|15] ""  SRR_RL
 SG_ DET_MH_CYCLE_COUNTER_041_044 : 16|8@1+ (1,0) [0|255] ""  SRR_RL
 SG_ DET_MH_CRC16_041_044 : 0|16@1+ (1,0) [0|65535] ""  SRR_RL
 SG_ DET_PROB_1STAZHYPO_044 : 439|1@1+ (1,0) [0|1] ""  SRR_RL
 SG_ DET_IDM_044 : 399|1@1+ (1,0) [0|1] ""  SRR_RL
 SG_ DET_MTD_044 : 383|1@1+ (1,0) [0|1] ""  SRR_RL
 SG_ DET_BELOW_RAIN_THOLD_044 : 375|1@1+ (1,0) [0|1] ""  SRR_RL

BO_ 651 SRR_FL_DETECTION_045_048: 64 SRR_FL
 SG_ DET_RANGE_045 : 24|15@1+ (0.015625,0) [0|500] "m"  SRR_RL
 SG_ DET_RANGE_ERR_045 : 40|7@1+ (0.0075,0) [0|0.9525] "m"  SRR_RL
 SG_ DET_RANGE_VELOCITY_045 : 48|15@1+ (0.0078125,-128) [-128|127.9921875] "m/s"  SRR_RL
 SG_ DET_RANGE_VELOCITY_ERR_045 : 64|8@1+ (0.003,0) [0|0.765] "m/s"  SRR_RL
 SG_ DET_AZIMUTH_045 : 88|13@1+ (0.0004,-1.5708) [-1.5708|1.5708] "rad"  SRR_RL
 SG_ DET_AZIMUTH_ERR_045 : 105|7@1+ (0.00087267,0) [0|0.11082909] "rad"  SRR_RL
 SG_ DET_ELEVATION_045 : 72|8@1+ (0.00275,-0.34925) [-0.34925|0.34925] "rad"  SRR_RL
 SG_ DET_ELEVATION_ERR_045 : 80|6@1+ (0.00174533,0) [0|0.10995579] "rad"  SRR_RL
 SG_ DET_RCS_045 : 128|8@1+ (0.5,-64) [-64|63.5] "dBsm"  SRR_RL
 SG_ DET_BI_STATIC_FLAG_045 : 104|1@1+ (1,0) [0|1] ""  SRR_RL
 SG_ DET_SUPER_RES_TARGET_045 : 87|1@1+ (1,0) [0|1] ""  SRR_RL
 SG_ DET_SNR_045 : 120|8@1+ (0.35156,0) [0|89.6478] "dB"  SRR_RL
 SG_ DET_EXISTENCE_PROB_045 : 112|6@1+ (1.588,0) [0|100] "%"  SRR_RL
 SG_ DET_HVC_FLAG_045 : 86|1@1+ (1,0) [0|1] ""  SRR_RL
 SG_ DET_CONFD_AZIMUTH_045 : 118|2@1+ (1,0) [0|3] ""  SRR_RL
 SG_ DET_CONFD_ELEVATION_045 : 101|2@1+ (1,0) [0|3] ""  SRR_RL
 SG_ DET_PROB_1STAZHYPO_045 : 103|1@1+ (1,0) [0|1] ""  SRR_RL
 SG_ DET_IDM_045 : 63|1@1+ (1,0) [0|1] ""  SRR_RL
 SG_ DET_MTD_045 : 47|1@1+ (1,0) [0|1] ""  SRR_RL
 SG_ DET_BELOW_RAIN_THOLD_045 : 39|1@1+ (1,0) [0|1] ""  SRR_RL
 SG_ DET_RANGE_046 : 136|15@1+ (0.015625,0) [0|500] "m"  SRR_RL
 SG_ DET_RANGE_ERR_046 : 152|7@1+ (0.0075,0) [0|0.9525] "m"  SRR_RL
 SG_ DET_RANGE_VELOCITY_046 : 160|15@1+ (0.0078125,-128) [-128|127.9921875] "m/s"  SRR_RL
 SG_ DET_RANGE_VELOCITY_ERR_046 : 176|8@1+ (0.003,0) [0|0.765] "m/s"  SRR_RL
 SG_ DET_AZIMUTH_046 : 200|13@1+ (0.0004,-1.5708) [-1.5708|1.5708] "rad"  SRR_RL
 SG_ DET_AZIMUTH_ERR_046 : 217|7@1+ (0.00087267,0) [0|0.11082909] "rad"  SRR_RL
 SG_ DET_ELEVATION_046 : 184|8@1+ (0.00275,-0.34925) [-0.34925|0.34925] "rad"  SRR_RL
 SG_ DET_ELEVATION_ERR_046 : 192|6@1+ (0.00174533,0) [0|0.10995579] "rad"  SRR_RL
 SG_ DET_RCS_046 : 240|8@1+ (0.5,-64) [-64|63.5] "dBsm"  SRR_RL
 SG_ DET_BI_STATIC_FLAG_046 : 216|1@1+ (1,0) [0|1] ""  SRR_RL
 SG_ DET_SUPER_RES_TARGET_046 : 199|1@1+ (1,0) [0|1] ""  SRR_RL
 SG_ DET_SNR_046 : 232|8@1+ (0.35156,0) [0|89.6478] "dB"  SRR_RL
 SG_ DET_EXISTENCE_PROB_046 : 224|6@1+ (1.588,0) [0|100] "%"  SRR_RL
 SG_ DET_HVC_FLAG_046 : 198|1@1+ (1,0) [0|1] ""  SRR_RL
 SG_ DET_CONFD_AZIMUTH_046 : 230|2@1+ (1,0) [0|3] ""  SRR_RL
 SG_ DET_CONFD_ELEVATION_046 : 213|2@1+ (1,0) [0|3] ""  SRR_RL
 SG_ DET_PROB_1STAZHYPO_046 : 215|1@1+ (1,0) [0|1] ""  SRR_RL
 SG_ DET_IDM_046 : 175|1@1+ (1,0) [0|1] ""  SRR_RL
 SG_ DET_MTD_046 : 159|1@1+ (1,0) [0|1] ""  SRR_RL
 SG_ DET_BELOW_RAIN_THOLD_046 : 151|1@1+ (1,0) [0|1] ""  SRR_RL
 SG_ DET_RANGE_047 : 248|15@1+ (0.015625,0) [0|500] "m"  SRR_RL
 SG_ DET_RANGE_ERR_047 : 264|7@1+ (0.0075,0) [0|0.9525] "m"  SRR_RL
 SG_ DET_RANGE_VELOCITY_047 : 272|15@1+ (0.0078125,-128) [-128|127.9921875] "m/s"  SRR_RL
 SG_ DET_RANGE_VELOCITY_ERR_047 : 288|8@1+ (0.003,0) [0|0.765] "m/s"  SRR_RL
 SG_ DET_AZIMUTH_047 : 312|13@1+ (0.0004,-1.5708) [-1.5708|1.5708] "rad"  SRR_RL
 SG_ DET_AZIMUTH_ERR_047 : 329|7@1+ (0.00087267,0) [0|0.11082909] "rad"  SRR_RL
 SG_ DET_ELEVATION_047 : 296|8@1+ (0.00275,-0.34925) [-0.34925|0.34925] "rad"  SRR_RL
 SG_ DET_ELEVATION_ERR_047 : 304|6@1+ (0.00174533,0) [0|0.10995579] "rad"  SRR_RL
 SG_ DET_RCS_047 : 352|8@1+ (0.5,-64) [-64|63.5] "dBsm"  SRR_RL
 SG_ DET_BI_STATIC_FLAG_047 : 328|1@1+ (1,0) [0|1] ""  SRR_RL
 SG_ DET_SUPER_RES_TARGET_047 : 311|1@1+ (1,0) [0|1] ""  SRR_RL
 SG_ DET_SNR_047 : 344|8@1+ (0.35156,0) [0|89.6478] "dB"  SRR_RL
 SG_ DET_EXISTENCE_PROB_047 : 336|6@1+ (1.588,0) [0|100] "%"  SRR_RL
 SG_ DET_HVC_FLAG_047 : 310|1@1+ (1,0) [0|1] ""  SRR_RL
 SG_ DET_CONFD_AZIMUTH_047 : 342|2@1+ (1,0) [0|3] ""  SRR_RL
 SG_ DET_CONFD_ELEVATION_047 : 325|2@1+ (1,0) [0|3] ""  SRR_RL
 SG_ DET_PROB_1STAZHYPO_047 : 327|1@1+ (1,0) [0|1] ""  SRR_RL
 SG_ DET_IDM_047 : 287|1@1+ (1,0) [0|1] ""  SRR_RL
 SG_ DET_MTD_047 : 271|1@1+ (1,0) [0|1] ""  SRR_RL
 SG_ DET_BELOW_RAIN_THOLD_047 : 263|1@1+ (1,0) [0|1] ""  SRR_RL
 SG_ DET_RANGE_048 : 360|15@1+ (0.015625,0) [0|500] "m"  SRR_RL
 SG_ DET_RANGE_ERR_048 : 376|7@1+ (0.0075,0) [0|0.9525] "m"  SRR_RL
 SG_ DET_RANGE_VELOCITY_048 : 384|15@1+ (0.0078125,-128) [-128|127.9921875] "m/s"  SRR_RL
 SG_ DET_RANGE_VELOCITY_ERR_048 : 400|8@1+ (0.003,0) [0|0.765] "m/s"  SRR_RL
 SG_ DET_AZIMUTH_048 : 424|13@1+ (0.0004,-1.5708) [-1.5708|1.5708] "rad"  SRR_RL
 SG_ DET_AZIMUTH_ERR_048 : 441|7@1+ (0.00087267,0) [0|0.11082909] "rad"  SRR_RL
 SG_ DET_ELEVATION_048 : 408|8@1+ (0.00275,-0.34925) [-0.34925|0.34925] "rad"  SRR_RL
 SG_ DET_ELEVATION_ERR_048 : 416|6@1+ (0.00174533,0) [0|0.10995579] "rad"  SRR_RL
 SG_ DET_RCS_048 : 464|8@1+ (0.5,-64) [-64|63.5] "dBsm"  SRR_RL
 SG_ DET_BI_STATIC_FLAG_048 : 440|1@1+ (1,0) [0|1] ""  SRR_RL
 SG_ DET_SUPER_RES_TARGET_048 : 423|1@1+ (1,0) [0|1] ""  SRR_RL
 SG_ DET_SNR_048 : 456|8@1+ (0.35156,0) [0|89.6478] "dB"  SRR_RL
 SG_ DET_EXISTENCE_PROB_048 : 448|6@1+ (1.588,0) [0|100] "%"  SRR_RL
 SG_ DET_HVC_FLAG_048 : 422|1@1+ (1,0) [0|1] ""  SRR_RL
 SG_ DET_CONFD_AZIMUTH_048 : 454|2@1+ (1,0) [0|3] ""  SRR_RL
 SG_ DET_CONFD_ELEVATION_048 : 437|2@1+ (1,0) [0|3] ""  SRR_RL
 SG_ DET_MH_SCAN_INDEX_4LSB_045_048 : 476|4@1+ (1,0) [0|15] ""  SRR_RL
 SG_ DET_MH_CYCLE_COUNTER_045_048 : 16|8@1+ (1,0) [0|255] ""  SRR_RL
 SG_ DET_MH_CRC16_045_048 : 0|16@1+ (1,0) [0|65535] ""  SRR_RL
 SG_ DET_PROB_1STAZHYPO_048 : 439|1@1+ (1,0) [0|1] ""  SRR_RL
 SG_ DET_IDM_048 : 399|1@1+ (1,0) [0|1] ""  SRR_RL
 SG_ DET_MTD_048 : 383|1@1+ (1,0) [0|1] ""  SRR_RL
 SG_ DET_BELOW_RAIN_THOLD_048 : 375|1@1+ (1,0) [0|1] ""  SRR_RL

BO_ 652 SRR_FL_DETECTION_049_052: 64 SRR_FL
 SG_ DET_RANGE_049 : 24|15@1+ (0.015625,0) [0|500] "m"  SRR_RL
 SG_ DET_RANGE_ERR_049 : 40|7@1+ (0.0075,0) [0|0.9525] "m"  SRR_RL
 SG_ DET_RANGE_VELOCITY_049 : 48|15@1+ (0.0078125,-128) [-128|127.9921875] "m/s"  SRR_RL
 SG_ DET_RANGE_VELOCITY_ERR_049 : 64|8@1+ (0.003,0) [0|0.765] "m/s"  SRR_RL
 SG_ DET_AZIMUTH_049 : 88|13@1+ (0.0004,-1.5708) [-1.5708|1.5708] "rad"  SRR_RL
 SG_ DET_AZIMUTH_ERR_049 : 105|7@1+ (0.00087267,0) [0|0.11082909] "rad"  SRR_RL
 SG_ DET_ELEVATION_049 : 72|8@1+ (0.00275,-0.34925) [-0.34925|0.34925] "rad"  SRR_RL
 SG_ DET_ELEVATION_ERR_049 : 80|6@1+ (0.00174533,0) [0|0.10995579] "rad"  SRR_RL
 SG_ DET_RCS_049 : 128|8@1+ (0.5,-64) [-64|63.5] "dBsm"  SRR_RL
 SG_ DET_BI_STATIC_FLAG_049 : 104|1@1+ (1,0) [0|1] ""  SRR_RL
 SG_ DET_SUPER_RES_TARGET_049 : 87|1@1+ (1,0) [0|1] ""  SRR_RL
 SG_ DET_SNR_049 : 120|8@1+ (0.35156,0) [0|89.6478] "dB"  SRR_RL
 SG_ DET_EXISTENCE_PROB_049 : 112|6@1+ (1.588,0) [0|100] "%"  SRR_RL
 SG_ DET_HVC_FLAG_049 : 86|1@1+ (1,0) [0|1] ""  SRR_RL
 SG_ DET_CONFD_AZIMUTH_049 : 118|2@1+ (1,0) [0|3] ""  SRR_RL
 SG_ DET_CONFD_ELEVATION_049 : 101|2@1+ (1,0) [0|3] ""  SRR_RL
 SG_ DET_PROB_1STAZHYPO_049 : 103|1@1+ (1,0) [0|1] ""  SRR_RL
 SG_ DET_IDM_049 : 63|1@1+ (1,0) [0|1] ""  SRR_RL
 SG_ DET_MTD_049 : 47|1@1+ (1,0) [0|1] ""  SRR_RL
 SG_ DET_BELOW_RAIN_THOLD_049 : 39|1@1+ (1,0) [0|1] ""  SRR_RL
 SG_ DET_RANGE_050 : 136|15@1+ (0.015625,0) [0|500] "m"  SRR_RL
 SG_ DET_RANGE_ERR_050 : 152|7@1+ (0.0075,0) [0|0.9525] "m"  SRR_RL
 SG_ DET_RANGE_VELOCITY_050 : 160|15@1+ (0.0078125,-128) [-128|127.9921875] "m/s"  SRR_RL
 SG_ DET_RANGE_VELOCITY_ERR_050 : 176|8@1+ (0.003,0) [0|0.765] "m/s"  SRR_RL
 SG_ DET_AZIMUTH_050 : 200|13@1+ (0.0004,-1.5708) [-1.5708|1.5708] "rad"  SRR_RL
 SG_ DET_AZIMUTH_ERR_050 : 217|7@1+ (0.00087267,0) [0|0.11082909] "rad"  SRR_RL
 SG_ DET_ELEVATION_050 : 184|8@1+ (0.00275,-0.34925) [-0.34925|0.34925] "rad"  SRR_RL
 SG_ DET_ELEVATION_ERR_050 : 192|6@1+ (0.00174533,0) [0|0.10995579] "rad"  SRR_RL
 SG_ DET_RCS_050 : 240|8@1+ (0.5,-64) [-64|63.5] "dBsm"  SRR_RL
 SG_ DET_BI_STATIC_FLAG_050 : 216|1@1+ (1,0) [0|1] ""  SRR_RL
 SG_ DET_SUPER_RES_TARGET_050 : 199|1@1+ (1,0) [0|1] ""  SRR_RL
 SG_ DET_SNR_050 : 232|8@1+ (0.35156,0) [0|89.6478] "dB"  SRR_RL
 SG_ DET_EXISTENCE_PROB_050 : 224|6@1+ (1.588,0) [0|100] "%"  SRR_RL
 SG_ DET_HVC_FLAG_050 : 198|1@1+ (1,0) [0|1] ""  SRR_RL
 SG_ DET_CONFD_AZIMUTH_050 : 230|2@1+ (1,0) [0|3] ""  SRR_RL
 SG_ DET_CONFD_ELEVATION_050 : 213|2@1+ (1,0) [0|3] ""  SRR_RL
 SG_ DET_PROB_1STAZHYPO_050 : 215|1@1+ (1,0) [0|1] ""  SRR_RL
 SG_ DET_IDM_050 : 175|1@1+ (1,0) [0|1] ""  SRR_RL
 SG_ DET_MTD_050 : 159|1@1+ (1,0) [0|1] ""  SRR_RL
 SG_ DET_BELOW_RAIN_THOLD_050 : 151|1@1+ (1,0) [0|1] ""  SRR_RL
 SG_ DET_RANGE_051 : 248|15@1+ (0.015625,0) [0|500] "m"  SRR_RL
 SG_ DET_RANGE_ERR_051 : 264|7@1+ (0.0075,0) [0|0.9525] "m"  SRR_RL
 SG_ DET_RANGE_VELOCITY_051 : 272|15@1+ (0.0078125,-128) [-128|127.9921875] "m/s"  SRR_RL
 SG_ DET_RANGE_VELOCITY_ERR_051 : 288|8@1+ (0.003,0) [0|0.765] "m/s"  SRR_RL
 SG_ DET_AZIMUTH_051 : 312|13@1+ (0.0004,-1.5708) [-1.5708|1.5708] "rad"  SRR_RL
 SG_ DET_AZIMUTH_ERR_051 : 329|7@1+ (0.00087267,0) [0|0.11082909] "rad"  SRR_RL
 SG_ DET_ELEVATION_051 : 296|8@1+ (0.00275,-0.34925) [-0.34925|0.34925] "rad"  SRR_RL
 SG_ DET_ELEVATION_ERR_051 : 304|6@1+ (0.00174533,0) [0|0.10995579] "rad"  SRR_RL
 SG_ DET_RCS_051 : 352|8@1+ (0.5,-64) [-64|63.5] "dBsm"  SRR_RL
 SG_ DET_BI_STATIC_FLAG_051 : 328|1@1+ (1,0) [0|1] ""  SRR_RL
 SG_ DET_SUPER_RES_TARGET_051 : 311|1@1+ (1,0) [0|1] ""  SRR_RL
 SG_ DET_SNR_051 : 344|8@1+ (0.35156,0) [0|89.6478] "dB"  SRR_RL
 SG_ DET_EXISTENCE_PROB_051 : 336|6@1+ (1.588,0) [0|100] "%"  SRR_RL
 SG_ DET_HVC_FLAG_051 : 310|1@1+ (1,0) [0|1] ""  SRR_RL
 SG_ DET_CONFD_AZIMUTH_051 : 342|2@1+ (1,0) [0|3] ""  SRR_RL
 SG_ DET_CONFD_ELEVATION_051 : 325|2@1+ (1,0) [0|3] ""  SRR_RL
 SG_ DET_PROB_1STAZHYPO_051 : 327|1@1+ (1,0) [0|1] ""  SRR_RL
 SG_ DET_IDM_051 : 287|1@1+ (1,0) [0|1] ""  SRR_RL
 SG_ DET_MTD_051 : 271|1@1+ (1,0) [0|1] ""  SRR_RL
 SG_ DET_BELOW_RAIN_THOLD_051 : 263|1@1+ (1,0) [0|1] ""  SRR_RL
 SG_ DET_RANGE_052 : 360|15@1+ (0.015625,0) [0|500] "m"  SRR_RL
 SG_ DET_RANGE_ERR_052 : 376|7@1+ (0.0075,0) [0|0.9525] "m"  SRR_RL
 SG_ DET_RANGE_VELOCITY_052 : 384|15@1+ (0.0078125,-128) [-128|127.9921875] "m/s"  SRR_RL
 SG_ DET_RANGE_VELOCITY_ERR_052 : 400|8@1+ (0.003,0) [0|0.765] "m/s"  SRR_RL
 SG_ DET_AZIMUTH_052 : 424|13@1+ (0.0004,-1.5708) [-1.5708|1.5708] "rad"  SRR_RL
 SG_ DET_AZIMUTH_ERR_052 : 441|7@1+ (0.00087267,0) [0|0.11082909] "rad"  SRR_RL
 SG_ DET_ELEVATION_052 : 408|8@1+ (0.00275,-0.34925) [-0.34925|0.34925] "rad"  SRR_RL
 SG_ DET_ELEVATION_ERR_052 : 416|6@1+ (0.00174533,0) [0|0.10995579] "rad"  SRR_RL
 SG_ DET_RCS_052 : 464|8@1+ (0.5,-64) [-64|63.5] "dBsm"  SRR_RL
 SG_ DET_BI_STATIC_FLAG_052 : 440|1@1+ (1,0) [0|1] ""  SRR_RL
 SG_ DET_SUPER_RES_TARGET_052 : 423|1@1+ (1,0) [0|1] ""  SRR_RL
 SG_ DET_SNR_052 : 456|8@1+ (0.35156,0) [0|89.6478] "dB"  SRR_RL
 SG_ DET_EXISTENCE_PROB_052 : 448|6@1+ (1.588,0) [0|100] "%"  SRR_RL
 SG_ DET_HVC_FLAG_052 : 422|1@1+ (1,0) [0|1] ""  SRR_RL
 SG_ DET_CONFD_AZIMUTH_052 : 454|2@1+ (1,0) [0|3] ""  SRR_RL
 SG_ DET_CONFD_ELEVATION_052 : 437|2@1+ (1,0) [0|3] ""  SRR_RL
 SG_ DET_MH_SCAN_INDEX_4LSB_049_052 : 476|4@1+ (1,0) [0|15] ""  SRR_RL
 SG_ DET_MH_CYCLE_COUNTER_049_052 : 16|8@1+ (1,0) [0|255] ""  SRR_RL
 SG_ DET_MH_CRC16_049_052 : 0|16@1+ (1,0) [0|65535] ""  SRR_RL
 SG_ DET_PROB_1STAZHYPO_052 : 439|1@1+ (1,0) [0|1] ""  SRR_RL
 SG_ DET_IDM_052 : 399|1@1+ (1,0) [0|1] ""  SRR_RL
 SG_ DET_MTD_052 : 383|1@1+ (1,0) [0|1] ""  SRR_RL
 SG_ DET_BELOW_RAIN_THOLD_052 : 375|1@1+ (1,0) [0|1] ""  SRR_RL

BO_ 653 SRR_FL_DETECTION_053_056: 64 SRR_FL
 SG_ DET_RANGE_053 : 24|15@1+ (0.015625,0) [0|500] "m"  SRR_RL
 SG_ DET_RANGE_ERR_053 : 40|7@1+ (0.0075,0) [0|0.9525] "m"  SRR_RL
 SG_ DET_RANGE_VELOCITY_053 : 48|15@1+ (0.0078125,-128) [-128|127.9921875] "m/s"  SRR_RL
 SG_ DET_RANGE_VELOCITY_ERR_053 : 64|8@1+ (0.003,0) [0|0.765] "m/s"  SRR_RL
 SG_ DET_AZIMUTH_053 : 88|13@1+ (0.0004,-1.5708) [-1.5708|1.5708] "rad"  SRR_RL
 SG_ DET_AZIMUTH_ERR_053 : 105|7@1+ (0.00087267,0) [0|0.11082909] "rad"  SRR_RL
 SG_ DET_ELEVATION_053 : 72|8@1+ (0.00275,-0.34925) [-0.34925|0.34925] "rad"  SRR_RL
 SG_ DET_ELEVATION_ERR_053 : 80|6@1+ (0.00174533,0) [0|0.10995579] "rad"  SRR_RL
 SG_ DET_RCS_053 : 128|8@1+ (0.5,-64) [-64|63.5] "dBsm"  SRR_RL
 SG_ DET_BI_STATIC_FLAG_053 : 104|1@1+ (1,0) [0|1] ""  SRR_RL
 SG_ DET_SUPER_RES_TARGET_053 : 87|1@1+ (1,0) [0|1] ""  SRR_RL
 SG_ DET_SNR_053 : 120|8@1+ (0.35156,0) [0|89.6478] "dB"  SRR_RL
 SG_ DET_EXISTENCE_PROB_053 : 112|6@1+ (1.588,0) [0|100] "%"  SRR_RL
 SG_ DET_HVC_FLAG_053 : 86|1@1+ (1,0) [0|1] ""  SRR_RL
 SG_ DET_CONFD_AZIMUTH_053 : 118|2@1+ (1,0) [0|3] ""  SRR_RL
 SG_ DET_CONFD_ELEVATION_053 : 101|2@1+ (1,0) [0|3] ""  SRR_RL
 SG_ DET_PROB_1STAZHYPO_053 : 103|1@1+ (1,0) [0|1] ""  SRR_RL
 SG_ DET_IDM_053 : 63|1@1+ (1,0) [0|1] ""  SRR_RL
 SG_ DET_MTD_053 : 47|1@1+ (1,0) [0|1] ""  SRR_RL
 SG_ DET_BELOW_RAIN_THOLD_053 : 39|1@1+ (1,0) [0|1] ""  SRR_RL
 SG_ DET_RANGE_054 : 136|15@1+ (0.015625,0) [0|500] "m"  SRR_RL
 SG_ DET_RANGE_ERR_054 : 152|7@1+ (0.0075,0) [0|0.9525] "m"  SRR_RL
 SG_ DET_RANGE_VELOCITY_054 : 160|15@1+ (0.0078125,-128) [-128|127.9921875] "m/s"  SRR_RL
 SG_ DET_RANGE_VELOCITY_ERR_054 : 176|8@1+ (0.003,0) [0|0.765] "m/s"  SRR_RL
 SG_ DET_AZIMUTH_054 : 200|13@1+ (0.0004,-1.5708) [-1.5708|1.5708] "rad"  SRR_RL
 SG_ DET_AZIMUTH_ERR_054 : 217|7@1+ (0.00087267,0) [0|0.11082909] "rad"  SRR_RL
 SG_ DET_ELEVATION_054 : 184|8@1+ (0.00275,-0.34925) [-0.34925|0.34925] "rad"  SRR_RL
 SG_ DET_ELEVATION_ERR_054 : 192|6@1+ (0.00174533,0) [0|0.10995579] "rad"  SRR_RL
 SG_ DET_RCS_054 : 240|8@1+ (0.5,-64) [-64|63.5] "dBsm"  SRR_RL
 SG_ DET_BI_STATIC_FLAG_054 : 216|1@1+ (1,0) [0|1] ""  SRR_RL
 SG_ DET_SUPER_RES_TARGET_054 : 199|1@1+ (1,0) [0|1] ""  SRR_RL
 SG_ DET_SNR_054 : 232|8@1+ (0.35156,0) [0|89.6478] "dB"  SRR_RL
 SG_ DET_EXISTENCE_PROB_054 : 224|6@1+ (1.588,0) [0|100] "%"  SRR_RL
 SG_ DET_HVC_FLAG_054 : 198|1@1+ (1,0) [0|1] ""  SRR_RL
 SG_ DET_CONFD_AZIMUTH_054 : 230|2@1+ (1,0) [0|3] ""  SRR_RL
 SG_ DET_CONFD_ELEVATION_054 : 213|2@1+ (1,0) [0|3] ""  SRR_RL
 SG_ DET_PROB_1STAZHYPO_054 : 215|1@1+ (1,0) [0|1] ""  SRR_RL
 SG_ DET_IDM_054 : 175|1@1+ (1,0) [0|1] ""  SRR_RL
 SG_ DET_MTD_054 : 159|1@1+ (1,0) [0|1] ""  SRR_RL
 SG_ DET_BELOW_RAIN_THOLD_054 : 151|1@1+ (1,0) [0|1] ""  SRR_RL
 SG_ DET_RANGE_055 : 248|15@1+ (0.015625,0) [0|500] "m"  SRR_RL
 SG_ DET_RANGE_ERR_055 : 264|7@1+ (0.0075,0) [0|0.9525] "m"  SRR_RL
 SG_ DET_RANGE_VELOCITY_055 : 272|15@1+ (0.0078125,-128) [-128|127.9921875] "m/s"  SRR_RL
 SG_ DET_RANGE_VELOCITY_ERR_055 : 288|8@1+ (0.003,0) [0|0.765] "m/s"  SRR_RL
 SG_ DET_AZIMUTH_055 : 312|13@1+ (0.0004,-1.5708) [-1.5708|1.5708] "rad"  SRR_RL
 SG_ DET_AZIMUTH_ERR_055 : 329|7@1+ (0.00087267,0) [0|0.11082909] "rad"  SRR_RL
 SG_ DET_ELEVATION_055 : 296|8@1+ (0.00275,-0.34925) [-0.34925|0.34925] "rad"  SRR_RL
 SG_ DET_ELEVATION_ERR_055 : 304|6@1+ (0.00174533,0) [0|0.10995579] "rad"  SRR_RL
 SG_ DET_RCS_055 : 352|8@1+ (0.5,-64) [-64|63.5] "dBsm"  SRR_RL
 SG_ DET_BI_STATIC_FLAG_055 : 328|1@1+ (1,0) [0|1] ""  SRR_RL
 SG_ DET_SUPER_RES_TARGET_055 : 311|1@1+ (1,0) [0|1] ""  SRR_RL
 SG_ DET_SNR_055 : 344|8@1+ (0.35156,0) [0|89.6478] "dB"  SRR_RL
 SG_ DET_EXISTENCE_PROB_055 : 336|6@1+ (1.588,0) [0|100] "%"  SRR_RL
 SG_ DET_HVC_FLAG_055 : 310|1@1+ (1,0) [0|1] ""  SRR_RL
 SG_ DET_CONFD_AZIMUTH_055 : 342|2@1+ (1,0) [0|3] ""  SRR_RL
 SG_ DET_CONFD_ELEVATION_055 : 325|2@1+ (1,0) [0|3] ""  SRR_RL
 SG_ DET_PROB_1STAZHYPO_055 : 327|1@1+ (1,0) [0|1] ""  SRR_RL
 SG_ DET_IDM_055 : 287|1@1+ (1,0) [0|1] ""  SRR_RL
 SG_ DET_MTD_055 : 271|1@1+ (1,0) [0|1] ""  SRR_RL
 SG_ DET_BELOW_RAIN_THOLD_055 : 263|1@1+ (1,0) [0|1] ""  SRR_RL
 SG_ DET_RANGE_056 : 360|15@1+ (0.015625,0) [0|500] "m"  SRR_RL
 SG_ DET_RANGE_ERR_056 : 376|7@1+ (0.0075,0) [0|0.9525] "m"  SRR_RL
 SG_ DET_RANGE_VELOCITY_056 : 384|15@1+ (0.0078125,-128) [-128|127.9921875] "m/s"  SRR_RL
 SG_ DET_RANGE_VELOCITY_ERR_056 : 400|8@1+ (0.003,0) [0|0.765] "m/s"  SRR_RL
 SG_ DET_AZIMUTH_056 : 424|13@1+ (0.0004,-1.5708) [-1.5708|1.5708] "rad"  SRR_RL
 SG_ DET_AZIMUTH_ERR_056 : 441|7@1+ (0.00087267,0) [0|0.11082909] "rad"  SRR_RL
 SG_ DET_ELEVATION_056 : 408|8@1+ (0.00275,-0.34925) [-0.34925|0.34925] "rad"  SRR_RL
 SG_ DET_ELEVATION_ERR_056 : 416|6@1+ (0.00174533,0) [0|0.10995579] "rad"  SRR_RL
 SG_ DET_RCS_056 : 464|8@1+ (0.5,-64) [-64|63.5] "dBsm"  SRR_RL
 SG_ DET_BI_STATIC_FLAG_056 : 440|1@1+ (1,0) [0|1] ""  SRR_RL
 SG_ DET_SUPER_RES_TARGET_056 : 423|1@1+ (1,0) [0|1] ""  SRR_RL
 SG_ DET_SNR_056 : 456|8@1+ (0.35156,0) [0|89.6478] "dB"  SRR_RL
 SG_ DET_EXISTENCE_PROB_056 : 448|6@1+ (1.588,0) [0|100] "%"  SRR_RL
 SG_ DET_HVC_FLAG_056 : 422|1@1+ (1,0) [0|1] ""  SRR_RL
 SG_ DET_CONFD_AZIMUTH_056 : 454|2@1+ (1,0) [0|3] ""  SRR_RL
 SG_ DET_CONFD_ELEVATION_056 : 437|2@1+ (1,0) [0|3] ""  SRR_RL
 SG_ DET_MH_SCAN_INDEX_4LSB_053_056 : 476|4@1+ (1,0) [0|15] ""  SRR_RL
 SG_ DET_MH_CYCLE_COUNTER_053_056 : 16|8@1+ (1,0) [0|255] ""  SRR_RL
 SG_ DET_MH_CRC16_053_056 : 0|16@1+ (1,0) [0|65535] ""  SRR_RL
 SG_ DET_PROB_1STAZHYPO_056 : 439|1@1+ (1,0) [0|1] ""  SRR_RL
 SG_ DET_IDM_056 : 399|1@1+ (1,0) [0|1] ""  SRR_RL
 SG_ DET_MTD_056 : 383|1@1+ (1,0) [0|1] ""  SRR_RL
 SG_ DET_BELOW_RAIN_THOLD_056 : 375|1@1+ (1,0) [0|1] ""  SRR_RL

BO_ 654 SRR_FL_DETECTION_057_060: 64 SRR_FL
 SG_ DET_RANGE_057 : 24|15@1+ (0.015625,0) [0|500] "m"  SRR_RL
 SG_ DET_RANGE_ERR_057 : 40|7@1+ (0.0075,0) [0|0.9525] "m"  SRR_RL
 SG_ DET_RANGE_VELOCITY_057 : 48|15@1+ (0.0078125,-128) [-128|127.9921875] "m/s"  SRR_RL
 SG_ DET_RANGE_VELOCITY_ERR_057 : 64|8@1+ (0.003,0) [0|0.765] "m/s"  SRR_RL
 SG_ DET_AZIMUTH_057 : 88|13@1+ (0.0004,-1.5708) [-1.5708|1.5708] "rad"  SRR_RL
 SG_ DET_AZIMUTH_ERR_057 : 105|7@1+ (0.00087267,0) [0|0.11082909] "rad"  SRR_RL
 SG_ DET_ELEVATION_057 : 72|8@1+ (0.00275,-0.34925) [-0.34925|0.34925] "rad"  SRR_RL
 SG_ DET_ELEVATION_ERR_057 : 80|6@1+ (0.00174533,0) [0|0.10995579] "rad"  SRR_RL
 SG_ DET_RCS_057 : 128|8@1+ (0.5,-64) [-64|63.5] "dBsm"  SRR_RL
 SG_ DET_BI_STATIC_FLAG_057 : 104|1@1+ (1,0) [0|1] ""  SRR_RL
 SG_ DET_SUPER_RES_TARGET_057 : 87|1@1+ (1,0) [0|1] ""  SRR_RL
 SG_ DET_SNR_057 : 120|8@1+ (0.35156,0) [0|89.6478] "dB"  SRR_RL
 SG_ DET_EXISTENCE_PROB_057 : 112|6@1+ (1.588,0) [0|100] "%"  SRR_RL
 SG_ DET_HVC_FLAG_057 : 86|1@1+ (1,0) [0|1] ""  SRR_RL
 SG_ DET_CONFD_AZIMUTH_057 : 118|2@1+ (1,0) [0|3] ""  SRR_RL
 SG_ DET_CONFD_ELEVATION_057 : 101|2@1+ (1,0) [0|3] ""  SRR_RL
 SG_ DET_PROB_1STAZHYPO_057 : 103|1@1+ (1,0) [0|1] ""  SRR_RL
 SG_ DET_IDM_057 : 63|1@1+ (1,0) [0|1] ""  SRR_RL
 SG_ DET_MTD_057 : 47|1@1+ (1,0) [0|1] ""  SRR_RL
 SG_ DET_BELOW_RAIN_THOLD_057 : 39|1@1+ (1,0) [0|1] ""  SRR_RL
 SG_ DET_RANGE_058 : 136|15@1+ (0.015625,0) [0|500] "m"  SRR_RL
 SG_ DET_RANGE_ERR_058 : 152|7@1+ (0.0075,0) [0|0.9525] "m"  SRR_RL
 SG_ DET_RANGE_VELOCITY_058 : 160|15@1+ (0.0078125,-128) [-128|127.9921875] "m/s"  SRR_RL
 SG_ DET_RANGE_VELOCITY_ERR_058 : 176|8@1+ (0.003,0) [0|0.765] "m/s"  SRR_RL
 SG_ DET_AZIMUTH_058 : 200|13@1+ (0.0004,-1.5708) [-1.5708|1.5708] "rad"  SRR_RL
 SG_ DET_AZIMUTH_ERR_058 : 217|7@1+ (0.00087267,0) [0|0.11082909] "rad"  SRR_RL
 SG_ DET_ELEVATION_058 : 184|8@1+ (0.00275,-0.34925) [-0.34925|0.34925] "rad"  SRR_RL
 SG_ DET_ELEVATION_ERR_058 : 192|6@1+ (0.00174533,0) [0|0.10995579] "rad"  SRR_RL
 SG_ DET_RCS_058 : 240|8@1+ (0.5,-64) [-64|63.5] "dBsm"  SRR_RL
 SG_ DET_BI_STATIC_FLAG_058 : 216|1@1+ (1,0) [0|1] ""  SRR_RL
 SG_ DET_SUPER_RES_TARGET_058 : 199|1@1+ (1,0) [0|1] ""  SRR_RL
 SG_ DET_SNR_058 : 232|8@1+ (0.35156,0) [0|89.6478] "dB"  SRR_RL
 SG_ DET_EXISTENCE_PROB_058 : 224|6@1+ (1.588,0) [0|100] "%"  SRR_RL
 SG_ DET_HVC_FLAG_058 : 198|1@1+ (1,0) [0|1] ""  SRR_RL
 SG_ DET_CONFD_AZIMUTH_058 : 230|2@1+ (1,0) [0|3] ""  SRR_RL
 SG_ DET_CONFD_ELEVATION_058 : 213|2@1+ (1,0) [0|3] ""  SRR_RL
 SG_ DET_PROB_1STAZHYPO_058 : 215|1@1+ (1,0) [0|1] ""  SRR_RL
 SG_ DET_IDM_058 : 175|1@1+ (1,0) [0|1] ""  SRR_RL
 SG_ DET_MTD_058 : 159|1@1+ (1,0) [0|1] ""  SRR_RL
 SG_ DET_BELOW_RAIN_THOLD_058 : 151|1@1+ (1,0) [0|1] ""  SRR_RL
 SG_ DET_RANGE_059 : 248|15@1+ (0.015625,0) [0|500] "m"  SRR_RL
 SG_ DET_RANGE_ERR_059 : 264|7@1+ (0.0075,0) [0|0.9525] "m"  SRR_RL
 SG_ DET_RANGE_VELOCITY_059 : 272|15@1+ (0.0078125,-128) [-128|127.9921875] "m/s"  SRR_RL
 SG_ DET_RANGE_VELOCITY_ERR_059 : 288|8@1+ (0.003,0) [0|0.765] "m/s"  SRR_RL
 SG_ DET_AZIMUTH_059 : 312|13@1+ (0.0004,-1.5708) [-1.5708|1.5708] "rad"  SRR_RL
 SG_ DET_AZIMUTH_ERR_059 : 329|7@1+ (0.00087267,0) [0|0.11082909] "rad"  SRR_RL
 SG_ DET_ELEVATION_059 : 296|8@1+ (0.00275,-0.34925) [-0.34925|0.34925] "rad"  SRR_RL
 SG_ DET_ELEVATION_ERR_059 : 304|6@1+ (0.00174533,0) [0|0.10995579] "rad"  SRR_RL
 SG_ DET_RCS_059 : 352|8@1+ (0.5,-64) [-64|63.5] "dBsm"  SRR_RL
 SG_ DET_BI_STATIC_FLAG_059 : 328|1@1+ (1,0) [0|1] ""  SRR_RL
 SG_ DET_SUPER_RES_TARGET_059 : 311|1@1+ (1,0) [0|1] ""  SRR_RL
 SG_ DET_SNR_059 : 344|8@1+ (0.35156,0) [0|89.6478] "dB"  SRR_RL
 SG_ DET_EXISTENCE_PROB_059 : 336|6@1+ (1.588,0) [0|100] "%"  SRR_RL
 SG_ DET_HVC_FLAG_059 : 310|1@1+ (1,0) [0|1] ""  SRR_RL
 SG_ DET_CONFD_AZIMUTH_059 : 342|2@1+ (1,0) [0|3] ""  SRR_RL
 SG_ DET_CONFD_ELEVATION_059 : 325|2@1+ (1,0) [0|3] ""  SRR_RL
 SG_ DET_PROB_1STAZHYPO_059 : 327|1@1+ (1,0) [0|1] ""  SRR_RL
 SG_ DET_IDM_059 : 287|1@1+ (1,0) [0|1] ""  SRR_RL
 SG_ DET_MTD_059 : 271|1@1+ (1,0) [0|1] ""  SRR_RL
 SG_ DET_BELOW_RAIN_THOLD_059 : 263|1@1+ (1,0) [0|1] ""  SRR_RL
 SG_ DET_RANGE_060 : 360|15@1+ (0.015625,0) [0|500] "m"  SRR_RL
 SG_ DET_RANGE_ERR_060 : 376|7@1+ (0.0075,0) [0|0.9525] "m"  SRR_RL
 SG_ DET_RANGE_VELOCITY_060 : 384|15@1+ (0.0078125,-128) [-128|127.9921875] "m/s"  SRR_RL
 SG_ DET_RANGE_VELOCITY_ERR_060 : 400|8@1+ (0.003,0) [0|0.765] "m/s"  SRR_RL
 SG_ DET_AZIMUTH_060 : 424|13@1+ (0.0004,-1.5708) [-1.5708|1.5708] "rad"  SRR_RL
 SG_ DET_AZIMUTH_ERR_060 : 441|7@1+ (0.00087267,0) [0|0.11082909] "rad"  SRR_RL
 SG_ DET_ELEVATION_060 : 408|8@1+ (0.00275,-0.34925) [-0.34925|0.34925] "rad"  SRR_RL
 SG_ DET_ELEVATION_ERR_060 : 416|6@1+ (0.00174533,0) [0|0.10995579] "rad"  SRR_RL
 SG_ DET_RCS_060 : 464|8@1+ (0.5,-64) [-64|63.5] "dBsm"  SRR_RL
 SG_ DET_BI_STATIC_FLAG_060 : 440|1@1+ (1,0) [0|1] ""  SRR_RL
 SG_ DET_SUPER_RES_TARGET_060 : 423|1@1+ (1,0) [0|1] ""  SRR_RL
 SG_ DET_SNR_060 : 456|8@1+ (0.35156,0) [0|89.6478] "dB"  SRR_RL
 SG_ DET_EXISTENCE_PROB_060 : 448|6@1+ (1.588,0) [0|100] "%"  SRR_RL
 SG_ DET_HVC_FLAG_060 : 422|1@1+ (1,0) [0|1] ""  SRR_RL
 SG_ DET_CONFD_AZIMUTH_060 : 454|2@1+ (1,0) [0|3] ""  SRR_RL
 SG_ DET_CONFD_ELEVATION_060 : 437|2@1+ (1,0) [0|3] ""  SRR_RL
 SG_ DET_MH_SCAN_INDEX_4LSB_057_060 : 476|4@1+ (1,0) [0|15] ""  SRR_RL
 SG_ DET_MH_CYCLE_COUNTER_057_060 : 16|8@1+ (1,0) [0|255] ""  SRR_RL
 SG_ DET_MH_CRC16_057_060 : 0|16@1+ (1,0) [0|65535] ""  SRR_RL
 SG_ DET_PROB_1STAZHYPO_060 : 439|1@1+ (1,0) [0|1] ""  SRR_RL
 SG_ DET_IDM_060 : 399|1@1+ (1,0) [0|1] ""  SRR_RL
 SG_ DET_MTD_060 : 383|1@1+ (1,0) [0|1] ""  SRR_RL
 SG_ DET_BELOW_RAIN_THOLD_060 : 375|1@1+ (1,0) [0|1] ""  SRR_RL

BO_ 655 SRR_FL_DETECTION_061_064: 64 SRR_FL
 SG_ DET_RANGE_061 : 24|15@1+ (0.015625,0) [0|500] "m"  SRR_RL
 SG_ DET_RANGE_ERR_061 : 40|7@1+ (0.0075,0) [0|0.9525] "m"  SRR_RL
 SG_ DET_RANGE_VELOCITY_061 : 48|15@1+ (0.0078125,-128) [-128|127.9921875] "m/s"  SRR_RL
 SG_ DET_RANGE_VELOCITY_ERR_061 : 64|8@1+ (0.003,0) [0|0.765] "m/s"  SRR_RL
 SG_ DET_AZIMUTH_061 : 88|13@1+ (0.0004,-1.5708) [-1.5708|1.5708] "rad"  SRR_RL
 SG_ DET_AZIMUTH_ERR_061 : 105|7@1+ (0.00087267,0) [0|0.11082909] "rad"  SRR_RL
 SG_ DET_ELEVATION_061 : 72|8@1+ (0.00275,-0.34925) [-0.34925|0.34925] "rad"  SRR_RL
 SG_ DET_ELEVATION_ERR_061 : 80|6@1+ (0.00174533,0) [0|0.10995579] "rad"  SRR_RL
 SG_ DET_RCS_061 : 128|8@1+ (0.5,-64) [-64|63.5] "dBsm"  SRR_RL
 SG_ DET_BI_STATIC_FLAG_061 : 104|1@1+ (1,0) [0|1] ""  SRR_RL
 SG_ DET_SUPER_RES_TARGET_061 : 87|1@1+ (1,0) [0|1] ""  SRR_RL
 SG_ DET_SNR_061 : 120|8@1+ (0.35156,0) [0|89.6478] "dB"  SRR_RL
 SG_ DET_EXISTENCE_PROB_061 : 112|6@1+ (1.588,0) [0|100] "%"  SRR_RL
 SG_ DET_HVC_FLAG_061 : 86|1@1+ (1,0) [0|1] ""  SRR_RL
 SG_ DET_CONFD_AZIMUTH_061 : 118|2@1+ (1,0) [0|3] ""  SRR_RL
 SG_ DET_CONFD_ELEVATION_061 : 101|2@1+ (1,0) [0|3] ""  SRR_RL
 SG_ DET_PROB_1STAZHYPO_061 : 103|1@1+ (1,0) [0|1] ""  SRR_RL
 SG_ DET_IDM_061 : 63|1@1+ (1,0) [0|1] ""  SRR_RL
 SG_ DET_MTD_061 : 47|1@1+ (1,0) [0|1] ""  SRR_RL
 SG_ DET_BELOW_RAIN_THOLD_061 : 39|1@1+ (1,0) [0|1] ""  SRR_RL
 SG_ DET_RANGE_062 : 136|15@1+ (0.015625,0) [0|500] "m"  SRR_RL
 SG_ DET_RANGE_ERR_062 : 152|7@1+ (0.0075,0) [0|0.9525] "m"  SRR_RL
 SG_ DET_RANGE_VELOCITY_062 : 160|15@1+ (0.0078125,-128) [-128|127.9921875] "m/s"  SRR_RL
 SG_ DET_RANGE_VELOCITY_ERR_062 : 176|8@1+ (0.003,0) [0|0.765] "m/s"  SRR_RL
 SG_ DET_AZIMUTH_062 : 200|13@1+ (0.0004,-1.5708) [-1.5708|1.5708] "rad"  SRR_RL
 SG_ DET_AZIMUTH_ERR_062 : 217|7@1+ (0.00087267,0) [0|0.11082909] "rad"  SRR_RL
 SG_ DET_ELEVATION_062 : 184|8@1+ (0.00275,-0.34925) [-0.34925|0.34925] "rad"  SRR_RL
 SG_ DET_ELEVATION_ERR_062 : 192|6@1+ (0.00174533,0) [0|0.10995579] "rad"  SRR_RL
 SG_ DET_RCS_062 : 240|8@1+ (0.5,-64) [-64|63.5] "dBsm"  SRR_RL
 SG_ DET_BI_STATIC_FLAG_062 : 216|1@1+ (1,0) [0|1] ""  SRR_RL
 SG_ DET_SUPER_RES_TARGET_062 : 199|1@1+ (1,0) [0|1] ""  SRR_RL
 SG_ DET_SNR_062 : 232|8@1+ (0.35156,0) [0|89.6478] "dB"  SRR_RL
 SG_ DET_EXISTENCE_PROB_062 : 224|6@1+ (1.588,0) [0|100] "%"  SRR_RL
 SG_ DET_HVC_FLAG_062 : 198|1@1+ (1,0) [0|1] ""  SRR_RL
 SG_ DET_CONFD_AZIMUTH_062 : 230|2@1+ (1,0) [0|3] ""  SRR_RL
 SG_ DET_CONFD_ELEVATION_062 : 213|2@1+ (1,0) [0|3] ""  SRR_RL
 SG_ DET_PROB_1STAZHYPO_062 : 215|1@1+ (1,0) [0|1] ""  SRR_RL
 SG_ DET_IDM_062 : 175|1@1+ (1,0) [0|1] ""  SRR_RL
 SG_ DET_MTD_062 : 159|1@1+ (1,0) [0|1] ""  SRR_RL
 SG_ DET_BELOW_RAIN_THOLD_062 : 151|1@1+ (1,0) [0|1] ""  SRR_RL
 SG_ DET_RANGE_063 : 248|15@1+ (0.015625,0) [0|500] "m"  SRR_RL
 SG_ DET_RANGE_ERR_063 : 264|7@1+ (0.0075,0) [0|0.9525] "m"  SRR_RL
 SG_ DET_RANGE_VELOCITY_063 : 272|15@1+ (0.0078125,-128) [-128|127.9921875] "m/s"  SRR_RL
 SG_ DET_RANGE_VELOCITY_ERR_063 : 288|8@1+ (0.003,0) [0|0.765] "m/s"  SRR_RL
 SG_ DET_AZIMUTH_063 : 312|13@1+ (0.0004,-1.5708) [-1.5708|1.5708] "rad"  SRR_RL
 SG_ DET_AZIMUTH_ERR_063 : 329|7@1+ (0.00087267,0) [0|0.11082909] "rad"  SRR_RL
 SG_ DET_ELEVATION_063 : 296|8@1+ (0.00275,-0.34925) [-0.34925|0.34925] "rad"  SRR_RL
 SG_ DET_ELEVATION_ERR_063 : 304|6@1+ (0.00174533,0) [0|0.10995579] "rad"  SRR_RL
 SG_ DET_RCS_063 : 352|8@1+ (0.5,-64) [-64|63.5] "dBsm"  SRR_RL
 SG_ DET_BI_STATIC_FLAG_063 : 328|1@1+ (1,0) [0|1] ""  SRR_RL
 SG_ DET_SUPER_RES_TARGET_063 : 311|1@1+ (1,0) [0|1] ""  SRR_RL
 SG_ DET_SNR_063 : 344|8@1+ (0.35156,0) [0|89.6478] "dB"  SRR_RL
 SG_ DET_EXISTENCE_PROB_063 : 336|6@1+ (1.588,0) [0|100] "%"  SRR_RL
 SG_ DET_HVC_FLAG_063 : 310|1@1+ (1,0) [0|1] ""  SRR_RL
 SG_ DET_CONFD_AZIMUTH_063 : 342|2@1+ (1,0) [0|3] ""  SRR_RL
 SG_ DET_CONFD_ELEVATION_063 : 325|2@1+ (1,0) [0|3] ""  SRR_RL
 SG_ DET_PROB_1STAZHYPO_063 : 327|1@1+ (1,0) [0|1] ""  SRR_RL
 SG_ DET_IDM_063 : 287|1@1+ (1,0) [0|1] ""  SRR_RL
 SG_ DET_MTD_063 : 271|1@1+ (1,0) [0|1] ""  SRR_RL
 SG_ DET_BELOW_RAIN_THOLD_063 : 263|1@1+ (1,0) [0|1] ""  SRR_RL
 SG_ DET_RANGE_064 : 360|15@1+ (0.015625,0) [0|500] "m"  SRR_RL
 SG_ DET_RANGE_ERR_064 : 376|7@1+ (0.0075,0) [0|0.9525] "m"  SRR_RL
 SG_ DET_RANGE_VELOCITY_064 : 384|15@1+ (0.0078125,-128) [-128|127.9921875] "m/s"  SRR_RL
 SG_ DET_RANGE_VELOCITY_ERR_064 : 400|8@1+ (0.003,0) [0|0.765] "m/s"  SRR_RL
 SG_ DET_AZIMUTH_064 : 424|13@1+ (0.0004,-1.5708) [-1.5708|1.5708] "rad"  SRR_RL
 SG_ DET_AZIMUTH_ERR_064 : 441|7@1+ (0.00087267,0) [0|0.11082909] "rad"  SRR_RL
 SG_ DET_ELEVATION_064 : 408|8@1+ (0.00275,-0.34925) [-0.34925|0.34925] "rad"  SRR_RL
 SG_ DET_ELEVATION_ERR_064 : 416|6@1+ (0.00174533,0) [0|0.10995579] "rad"  SRR_RL
 SG_ DET_RCS_064 : 464|8@1+ (0.5,-64) [-64|63.5] "dBsm"  SRR_RL
 SG_ DET_BI_STATIC_FLAG_064 : 440|1@1+ (1,0) [0|1] ""  SRR_RL
 SG_ DET_SUPER_RES_TARGET_064 : 423|1@1+ (1,0) [0|1] ""  SRR_RL
 SG_ DET_SNR_064 : 456|8@1+ (0.35156,0) [0|89.6478] "dB"  SRR_RL
 SG_ DET_EXISTENCE_PROB_064 : 448|6@1+ (1.588,0) [0|100] "%"  SRR_RL
 SG_ DET_HVC_FLAG_064 : 422|1@1+ (1,0) [0|1] ""  SRR_RL
 SG_ DET_CONFD_AZIMUTH_064 : 454|2@1+ (1,0) [0|3] ""  SRR_RL
 SG_ DET_CONFD_ELEVATION_064 : 437|2@1+ (1,0) [0|3] ""  SRR_RL
 SG_ DET_MH_SCAN_INDEX_4LSB_061_064 : 476|4@1+ (1,0) [0|15] ""  SRR_RL
 SG_ DET_MH_CYCLE_COUNTER_061_064 : 16|8@1+ (1,0) [0|255] ""  SRR_RL
 SG_ DET_MH_CRC16_061_064 : 0|16@1+ (1,0) [0|65535] ""  SRR_RL
 SG_ DET_PROB_1STAZHYPO_064 : 439|1@1+ (1,0) [0|1] ""  SRR_RL
 SG_ DET_IDM_064 : 399|1@1+ (1,0) [0|1] ""  SRR_RL
 SG_ DET_MTD_064 : 383|1@1+ (1,0) [0|1] ""  SRR_RL
 SG_ DET_BELOW_RAIN_THOLD_064 : 375|1@1+ (1,0) [0|1] ""  SRR_RL

BO_ 656 SRR_FL_DETECTION_065_068: 64 SRR_FL
 SG_ DET_RANGE_065 : 24|15@1+ (0.015625,0) [0|500] "m"  SRR_RL
 SG_ DET_RANGE_ERR_065 : 40|7@1+ (0.0075,0) [0|0.9525] "m"  SRR_RL
 SG_ DET_RANGE_VELOCITY_065 : 48|15@1+ (0.0078125,-128) [-128|127.9921875] "m/s"  SRR_RL
 SG_ DET_RANGE_VELOCITY_ERR_065 : 64|8@1+ (0.003,0) [0|0.765] "m/s"  SRR_RL
 SG_ DET_AZIMUTH_065 : 88|13@1+ (0.0004,-1.5708) [-1.5708|1.5708] "rad"  SRR_RL
 SG_ DET_AZIMUTH_ERR_065 : 105|7@1+ (0.00087267,0) [0|0.11082909] "rad"  SRR_RL
 SG_ DET_ELEVATION_065 : 72|8@1+ (0.00275,-0.34925) [-0.34925|0.34925] "rad"  SRR_RL
 SG_ DET_ELEVATION_ERR_065 : 80|6@1+ (0.00174533,0) [0|0.10995579] "rad"  SRR_RL
 SG_ DET_RCS_065 : 128|8@1+ (0.5,-64) [-64|63.5] "dBsm"  SRR_RL
 SG_ DET_BI_STATIC_FLAG_065 : 104|1@1+ (1,0) [0|1] ""  SRR_RL
 SG_ DET_SUPER_RES_TARGET_065 : 87|1@1+ (1,0) [0|1] ""  SRR_RL
 SG_ DET_SNR_065 : 120|8@1+ (0.35156,0) [0|89.6478] "dB"  SRR_RL
 SG_ DET_EXISTENCE_PROB_065 : 112|6@1+ (1.588,0) [0|100] "%"  SRR_RL
 SG_ DET_HVC_FLAG_065 : 86|1@1+ (1,0) [0|1] ""  SRR_RL
 SG_ DET_CONFD_AZIMUTH_065 : 118|2@1+ (1,0) [0|3] ""  SRR_RL
 SG_ DET_CONFD_ELEVATION_065 : 101|2@1+ (1,0) [0|3] ""  SRR_RL
 SG_ DET_PROB_1STAZHYPO_065 : 103|1@1+ (1,0) [0|1] ""  SRR_RL
 SG_ DET_IDM_065 : 63|1@1+ (1,0) [0|1] ""  SRR_RL
 SG_ DET_MTD_065 : 47|1@1+ (1,0) [0|1] ""  SRR_RL
 SG_ DET_BELOW_RAIN_THOLD_065 : 39|1@1+ (1,0) [0|1] ""  SRR_RL
 SG_ DET_RANGE_066 : 136|15@1+ (0.015625,0) [0|500] "m"  SRR_RL
 SG_ DET_RANGE_ERR_066 : 152|7@1+ (0.0075,0) [0|0.9525] "m"  SRR_RL
 SG_ DET_RANGE_VELOCITY_066 : 160|15@1+ (0.0078125,-128) [-128|127.9921875] "m/s"  SRR_RL
 SG_ DET_RANGE_VELOCITY_ERR_066 : 176|8@1+ (0.003,0) [0|0.765] "m/s"  SRR_RL
 SG_ DET_AZIMUTH_066 : 200|13@1+ (0.0004,-1.5708) [-1.5708|1.5708] "rad"  SRR_RL
 SG_ DET_AZIMUTH_ERR_066 : 217|7@1+ (0.00087267,0) [0|0.11082909] "rad"  SRR_RL
 SG_ DET_ELEVATION_066 : 184|8@1+ (0.00275,-0.34925) [-0.34925|0.34925] "rad"  SRR_RL
 SG_ DET_ELEVATION_ERR_066 : 192|6@1+ (0.00174533,0) [0|0.10995579] "rad"  SRR_RL
 SG_ DET_RCS_066 : 240|8@1+ (0.5,-64) [-64|63.5] "dBsm"  SRR_RL
 SG_ DET_BI_STATIC_FLAG_066 : 216|1@1+ (1,0) [0|1] ""  SRR_RL
 SG_ DET_SUPER_RES_TARGET_066 : 199|1@1+ (1,0) [0|1] ""  SRR_RL
 SG_ DET_SNR_066 : 232|8@1+ (0.35156,0) [0|89.6478] "dB"  SRR_RL
 SG_ DET_EXISTENCE_PROB_066 : 224|6@1+ (1.588,0) [0|100] "%"  SRR_RL
 SG_ DET_HVC_FLAG_066 : 198|1@1+ (1,0) [0|1] ""  SRR_RL
 SG_ DET_CONFD_AZIMUTH_066 : 230|2@1+ (1,0) [0|3] ""  SRR_RL
 SG_ DET_CONFD_ELEVATION_066 : 213|2@1+ (1,0) [0|3] ""  SRR_RL
 SG_ DET_PROB_1STAZHYPO_066 : 215|1@1+ (1,0) [0|1] ""  SRR_RL
 SG_ DET_IDM_066 : 175|1@1+ (1,0) [0|1] ""  SRR_RL
 SG_ DET_MTD_066 : 159|1@1+ (1,0) [0|1] ""  SRR_RL
 SG_ DET_BELOW_RAIN_THOLD_066 : 151|1@1+ (1,0) [0|1] ""  SRR_RL
 SG_ DET_RANGE_067 : 248|15@1+ (0.015625,0) [0|500] "m"  SRR_RL
 SG_ DET_RANGE_ERR_067 : 264|7@1+ (0.0075,0) [0|0.9525] "m"  SRR_RL
 SG_ DET_RANGE_VELOCITY_067 : 272|15@1+ (0.0078125,-128) [-128|127.9921875] "m/s"  SRR_RL
 SG_ DET_RANGE_VELOCITY_ERR_067 : 288|8@1+ (0.003,0) [0|0.765] "m/s"  SRR_RL
 SG_ DET_AZIMUTH_067 : 312|13@1+ (0.0004,-1.5708) [-1.5708|1.5708] "rad"  SRR_RL
 SG_ DET_AZIMUTH_ERR_067 : 329|7@1+ (0.00087267,0) [0|0.11082909] "rad"  SRR_RL
 SG_ DET_ELEVATION_067 : 296|8@1+ (0.00275,-0.34925) [-0.34925|0.34925] "rad"  SRR_RL
 SG_ DET_ELEVATION_ERR_067 : 304|6@1+ (0.00174533,0) [0|0.10995579] "rad"  SRR_RL
 SG_ DET_RCS_067 : 352|8@1+ (0.5,-64) [-64|63.5] "dBsm"  SRR_RL
 SG_ DET_BI_STATIC_FLAG_067 : 328|1@1+ (1,0) [0|1] ""  SRR_RL
 SG_ DET_SUPER_RES_TARGET_067 : 311|1@1+ (1,0) [0|1] ""  SRR_RL
 SG_ DET_SNR_067 : 344|8@1+ (0.35156,0) [0|89.6478] "dB"  SRR_RL
 SG_ DET_EXISTENCE_PROB_067 : 336|6@1+ (1.588,0) [0|100] "%"  SRR_RL
 SG_ DET_HVC_FLAG_067 : 310|1@1+ (1,0) [0|1] ""  SRR_RL
 SG_ DET_CONFD_AZIMUTH_067 : 342|2@1+ (1,0) [0|3] ""  SRR_RL
 SG_ DET_CONFD_ELEVATION_067 : 325|2@1+ (1,0) [0|3] ""  SRR_RL
 SG_ DET_PROB_1STAZHYPO_067 : 327|1@1+ (1,0) [0|1] ""  SRR_RL
 SG_ DET_IDM_067 : 287|1@1+ (1,0) [0|1] ""  SRR_RL
 SG_ DET_MTD_067 : 271|1@1+ (1,0) [0|1] ""  SRR_RL
 SG_ DET_BELOW_RAIN_THOLD_067 : 263|1@1+ (1,0) [0|1] ""  SRR_RL
 SG_ DET_RANGE_068 : 360|15@1+ (0.015625,0) [0|500] "m"  SRR_RL
 SG_ DET_RANGE_ERR_068 : 376|7@1+ (0.0075,0) [0|0.9525] "m"  SRR_RL
 SG_ DET_RANGE_VELOCITY_068 : 384|15@1+ (0.0078125,-128) [-128|127.9921875] "m/s"  SRR_RL
 SG_ DET_RANGE_VELOCITY_ERR_068 : 400|8@1+ (0.003,0) [0|0.765] "m/s"  SRR_RL
 SG_ DET_AZIMUTH_068 : 424|13@1+ (0.0004,-1.5708) [-1.5708|1.5708] "rad"  SRR_RL
 SG_ DET_AZIMUTH_ERR_068 : 441|7@1+ (0.00087267,0) [0|0.11082909] "rad"  SRR_RL
 SG_ DET_ELEVATION_068 : 408|8@1+ (0.00275,-0.34925) [-0.34925|0.34925] "rad"  SRR_RL
 SG_ DET_ELEVATION_ERR_068 : 416|6@1+ (0.00174533,0) [0|0.10995579] "rad"  SRR_RL
 SG_ DET_RCS_068 : 464|8@1+ (0.5,-64) [-64|63.5] "dBsm"  SRR_RL
 SG_ DET_BI_STATIC_FLAG_068 : 440|1@1+ (1,0) [0|1] ""  SRR_RL
 SG_ DET_SUPER_RES_TARGET_068 : 423|1@1+ (1,0) [0|1] ""  SRR_RL
 SG_ DET_SNR_068 : 456|8@1+ (0.35156,0) [0|89.6478] "dB"  SRR_RL
 SG_ DET_EXISTENCE_PROB_068 : 448|6@1+ (1.588,0) [0|100] "%"  SRR_RL
 SG_ DET_HVC_FLAG_068 : 422|1@1+ (1,0) [0|1] ""  SRR_RL
 SG_ DET_CONFD_AZIMUTH_068 : 454|2@1+ (1,0) [0|3] ""  SRR_RL
 SG_ DET_CONFD_ELEVATION_068 : 437|2@1+ (1,0) [0|3] ""  SRR_RL
 SG_ DET_MH_SCAN_INDEX_4LSB_065_068 : 476|4@1+ (1,0) [0|15] ""  SRR_RL
 SG_ DET_MH_CYCLE_COUNTER_065_068 : 16|8@1+ (1,0) [0|255] ""  SRR_RL
 SG_ DET_MH_CRC16_065_068 : 0|16@1+ (1,0) [0|65535] ""  SRR_RL
 SG_ DET_PROB_1STAZHYPO_068 : 439|1@1+ (1,0) [0|1] ""  SRR_RL
 SG_ DET_IDM_068 : 399|1@1+ (1,0) [0|1] ""  SRR_RL
 SG_ DET_MTD_068 : 383|1@1+ (1,0) [0|1] ""  SRR_RL
 SG_ DET_BELOW_RAIN_THOLD_068 : 375|1@1+ (1,0) [0|1] ""  SRR_RL

BO_ 657 SRR_FL_DETECTION_069_072: 64 SRR_FL
 SG_ DET_RANGE_069 : 24|15@1+ (0.015625,0) [0|500] "m"  SRR_RL
 SG_ DET_RANGE_ERR_069 : 40|7@1+ (0.0075,0) [0|0.9525] "m"  SRR_RL
 SG_ DET_RANGE_VELOCITY_069 : 48|15@1+ (0.0078125,-128) [-128|127.9921875] "m/s"  SRR_RL
 SG_ DET_RANGE_VELOCITY_ERR_069 : 64|8@1+ (0.003,0) [0|0.765] "m/s"  SRR_RL
 SG_ DET_AZIMUTH_069 : 88|13@1+ (0.0004,-1.5708) [-1.5708|1.5708] "rad"  SRR_RL
 SG_ DET_AZIMUTH_ERR_069 : 105|7@1+ (0.00087267,0) [0|0.11082909] "rad"  SRR_RL
 SG_ DET_ELEVATION_069 : 72|8@1+ (0.00275,-0.34925) [-0.34925|0.34925] "rad"  SRR_RL
 SG_ DET_ELEVATION_ERR_069 : 80|6@1+ (0.00174533,0) [0|0.10995579] "rad"  SRR_RL
 SG_ DET_RCS_069 : 128|8@1+ (0.5,-64) [-64|63.5] "dBsm"  SRR_RL
 SG_ DET_BI_STATIC_FLAG_069 : 104|1@1+ (1,0) [0|1] ""  SRR_RL
 SG_ DET_SUPER_RES_TARGET_069 : 87|1@1+ (1,0) [0|1] ""  SRR_RL
 SG_ DET_SNR_069 : 120|8@1+ (0.35156,0) [0|89.6478] "dB"  SRR_RL
 SG_ DET_EXISTENCE_PROB_069 : 112|6@1+ (1.588,0) [0|100] "%"  SRR_RL
 SG_ DET_HVC_FLAG_069 : 86|1@1+ (1,0) [0|1] ""  SRR_RL
 SG_ DET_CONFD_AZIMUTH_069 : 118|2@1+ (1,0) [0|3] ""  SRR_RL
 SG_ DET_CONFD_ELEVATION_069 : 101|2@1+ (1,0) [0|3] ""  SRR_RL
 SG_ DET_PROB_1STAZHYPO_069 : 103|1@1+ (1,0) [0|1] ""  SRR_RL
 SG_ DET_IDM_069 : 63|1@1+ (1,0) [0|1] ""  SRR_RL
 SG_ DET_MTD_069 : 47|1@1+ (1,0) [0|1] ""  SRR_RL
 SG_ DET_BELOW_RAIN_THOLD_069 : 39|1@1+ (1,0) [0|1] ""  SRR_RL
 SG_ DET_RANGE_070 : 136|15@1+ (0.015625,0) [0|500] "m"  SRR_RL
 SG_ DET_RANGE_ERR_070 : 152|7@1+ (0.0075,0) [0|0.9525] "m"  SRR_RL
 SG_ DET_RANGE_VELOCITY_070 : 160|15@1+ (0.0078125,-128) [-128|127.9921875] "m/s"  SRR_RL
 SG_ DET_RANGE_VELOCITY_ERR_070 : 176|8@1+ (0.003,0) [0|0.765] "m/s"  SRR_RL
 SG_ DET_AZIMUTH_070 : 200|13@1+ (0.0004,-1.5708) [-1.5708|1.5708] "rad"  SRR_RL
 SG_ DET_AZIMUTH_ERR_070 : 217|7@1+ (0.00087267,0) [0|0.11082909] "rad"  SRR_RL
 SG_ DET_ELEVATION_070 : 184|8@1+ (0.00275,-0.34925) [-0.34925|0.34925] "rad"  SRR_RL
 SG_ DET_ELEVATION_ERR_070 : 192|6@1+ (0.00174533,0) [0|0.10995579] "rad"  SRR_RL
 SG_ DET_RCS_070 : 240|8@1+ (0.5,-64) [-64|63.5] "dBsm"  SRR_RL
 SG_ DET_BI_STATIC_FLAG_070 : 216|1@1+ (1,0) [0|1] ""  SRR_RL
 SG_ DET_SUPER_RES_TARGET_070 : 199|1@1+ (1,0) [0|1] ""  SRR_RL
 SG_ DET_SNR_070 : 232|8@1+ (0.35156,0) [0|89.6478] "dB"  SRR_RL
 SG_ DET_EXISTENCE_PROB_070 : 224|6@1+ (1.588,0) [0|100] "%"  SRR_RL
 SG_ DET_HVC_FLAG_070 : 198|1@1+ (1,0) [0|1] ""  SRR_RL
 SG_ DET_CONFD_AZIMUTH_070 : 230|2@1+ (1,0) [0|3] ""  SRR_RL
 SG_ DET_CONFD_ELEVATION_070 : 213|2@1+ (1,0) [0|3] ""  SRR_RL
 SG_ DET_PROB_1STAZHYPO_070 : 215|1@1+ (1,0) [0|1] ""  SRR_RL
 SG_ DET_IDM_070 : 175|1@1+ (1,0) [0|1] ""  SRR_RL
 SG_ DET_MTD_070 : 159|1@1+ (1,0) [0|1] ""  SRR_RL
 SG_ DET_BELOW_RAIN_THOLD_070 : 151|1@1+ (1,0) [0|1] ""  SRR_RL
 SG_ DET_RANGE_071 : 248|15@1+ (0.015625,0) [0|500] "m"  SRR_RL
 SG_ DET_RANGE_ERR_071 : 264|7@1+ (0.0075,0) [0|0.9525] "m"  SRR_RL
 SG_ DET_RANGE_VELOCITY_071 : 272|15@1+ (0.0078125,-128) [-128|127.9921875] "m/s"  SRR_RL
 SG_ DET_RANGE_VELOCITY_ERR_071 : 288|8@1+ (0.003,0) [0|0.765] "m/s"  SRR_RL
 SG_ DET_AZIMUTH_071 : 312|13@1+ (0.0004,-1.5708) [-1.5708|1.5708] "rad"  SRR_RL
 SG_ DET_AZIMUTH_ERR_071 : 329|7@1+ (0.00087267,0) [0|0.11082909] "rad"  SRR_RL
 SG_ DET_ELEVATION_071 : 296|8@1+ (0.00275,-0.34925) [-0.34925|0.34925] "rad"  SRR_RL
 SG_ DET_ELEVATION_ERR_071 : 304|6@1+ (0.00174533,0) [0|0.10995579] "rad"  SRR_RL
 SG_ DET_RCS_071 : 352|8@1+ (0.5,-64) [-64|63.5] "dBsm"  SRR_RL
 SG_ DET_BI_STATIC_FLAG_071 : 328|1@1+ (1,0) [0|1] ""  SRR_RL
 SG_ DET_SUPER_RES_TARGET_071 : 311|1@1+ (1,0) [0|1] ""  SRR_RL
 SG_ DET_SNR_071 : 344|8@1+ (0.35156,0) [0|89.6478] "dB"  SRR_RL
 SG_ DET_EXISTENCE_PROB_071 : 336|6@1+ (1.588,0) [0|100] "%"  SRR_RL
 SG_ DET_HVC_FLAG_071 : 310|1@1+ (1,0) [0|1] ""  SRR_RL
 SG_ DET_CONFD_AZIMUTH_071 : 342|2@1+ (1,0) [0|3] ""  SRR_RL
 SG_ DET_CONFD_ELEVATION_071 : 325|2@1+ (1,0) [0|3] ""  SRR_RL
 SG_ DET_PROB_1STAZHYPO_071 : 327|1@1+ (1,0) [0|1] ""  SRR_RL
 SG_ DET_IDM_071 : 287|1@1+ (1,0) [0|1] ""  SRR_RL
 SG_ DET_MTD_071 : 271|1@1+ (1,0) [0|1] ""  SRR_RL
 SG_ DET_BELOW_RAIN_THOLD_071 : 263|1@1+ (1,0) [0|1] ""  SRR_RL
 SG_ DET_RANGE_072 : 360|15@1+ (0.015625,0) [0|500] "m"  SRR_RL
 SG_ DET_RANGE_ERR_072 : 376|7@1+ (0.0075,0) [0|0.9525] "m"  SRR_RL
 SG_ DET_RANGE_VELOCITY_072 : 384|15@1+ (0.0078125,-128) [-128|127.9921875] "m/s"  SRR_RL
 SG_ DET_RANGE_VELOCITY_ERR_072 : 400|8@1+ (0.003,0) [0|0.765] "m/s"  SRR_RL
 SG_ DET_AZIMUTH_072 : 424|13@1+ (0.0004,-1.5708) [-1.5708|1.5708] "rad"  SRR_RL
 SG_ DET_AZIMUTH_ERR_072 : 441|7@1+ (0.00087267,0) [0|0.11082909] "rad"  SRR_RL
 SG_ DET_ELEVATION_072 : 408|8@1+ (0.00275,-0.34925) [-0.34925|0.34925] "rad"  SRR_RL
 SG_ DET_ELEVATION_ERR_072 : 416|6@1+ (0.00174533,0) [0|0.10995579] "rad"  SRR_RL
 SG_ DET_RCS_072 : 464|8@1+ (0.5,-64) [-64|63.5] "dBsm"  SRR_RL
 SG_ DET_BI_STATIC_FLAG_072 : 440|1@1+ (1,0) [0|1] ""  SRR_RL
 SG_ DET_SUPER_RES_TARGET_072 : 423|1@1+ (1,0) [0|1] ""  SRR_RL
 SG_ DET_SNR_072 : 456|8@1+ (0.35156,0) [0|89.6478] "dB"  SRR_RL
 SG_ DET_EXISTENCE_PROB_072 : 448|6@1+ (1.588,0) [0|100] "%"  SRR_RL
 SG_ DET_HVC_FLAG_072 : 422|1@1+ (1,0) [0|1] ""  SRR_RL
 SG_ DET_CONFD_AZIMUTH_072 : 454|2@1+ (1,0) [0|3] ""  SRR_RL
 SG_ DET_CONFD_ELEVATION_072 : 437|2@1+ (1,0) [0|3] ""  SRR_RL
 SG_ DET_MH_SCAN_INDEX_4LSB_069_072 : 476|4@1+ (1,0) [0|15] ""  SRR_RL
 SG_ DET_MH_CYCLE_COUNTER_069_072 : 16|8@1+ (1,0) [0|255] ""  SRR_RL
 SG_ DET_MH_CRC16_069_072 : 0|16@1+ (1,0) [0|65535] ""  SRR_RL
 SG_ DET_PROB_1STAZHYPO_072 : 439|1@1+ (1,0) [0|1] ""  SRR_RL
 SG_ DET_IDM_072 : 399|1@1+ (1,0) [0|1] ""  SRR_RL
 SG_ DET_MTD_072 : 383|1@1+ (1,0) [0|1] ""  SRR_RL
 SG_ DET_BELOW_RAIN_THOLD_072 : 375|1@1+ (1,0) [0|1] ""  SRR_RL

BO_ 658 SRR_FL_DETECTION_073_076: 64 SRR_FL
 SG_ DET_RANGE_073 : 24|15@1+ (0.015625,0) [0|500] "m"  SRR_RL
 SG_ DET_RANGE_ERR_073 : 40|7@1+ (0.0075,0) [0|0.9525] "m"  SRR_RL
 SG_ DET_RANGE_VELOCITY_073 : 48|15@1+ (0.0078125,-128) [-128|127.9921875] "m/s"  SRR_RL
 SG_ DET_RANGE_VELOCITY_ERR_073 : 64|8@1+ (0.003,0) [0|0.765] "m/s"  SRR_RL
 SG_ DET_AZIMUTH_073 : 88|13@1+ (0.0004,-1.5708) [-1.5708|1.5708] "rad"  SRR_RL
 SG_ DET_AZIMUTH_ERR_073 : 105|7@1+ (0.00087267,0) [0|0.11082909] "rad"  SRR_RL
 SG_ DET_ELEVATION_073 : 72|8@1+ (0.00275,-0.34925) [-0.34925|0.34925] "rad"  SRR_RL
 SG_ DET_ELEVATION_ERR_073 : 80|6@1+ (0.00174533,0) [0|0.10995579] "rad"  SRR_RL
 SG_ DET_RCS_073 : 128|8@1+ (0.5,-64) [-64|63.5] "dBsm"  SRR_RL
 SG_ DET_BI_STATIC_FLAG_073 : 104|1@1+ (1,0) [0|1] ""  SRR_RL
 SG_ DET_SUPER_RES_TARGET_073 : 87|1@1+ (1,0) [0|1] ""  SRR_RL
 SG_ DET_SNR_073 : 120|8@1+ (0.35156,0) [0|89.6478] "dB"  SRR_RL
 SG_ DET_EXISTENCE_PROB_073 : 112|6@1+ (1.588,0) [0|100] "%"  SRR_RL
 SG_ DET_HVC_FLAG_073 : 86|1@1+ (1,0) [0|1] ""  SRR_RL
 SG_ DET_CONFD_AZIMUTH_073 : 118|2@1+ (1,0) [0|3] ""  SRR_RL
 SG_ DET_CONFD_ELEVATION_073 : 101|2@1+ (1,0) [0|3] ""  SRR_RL
 SG_ DET_PROB_1STAZHYPO_073 : 103|1@1+ (1,0) [0|1] ""  SRR_RL
 SG_ DET_IDM_073 : 63|1@1+ (1,0) [0|1] ""  SRR_RL
 SG_ DET_MTD_073 : 47|1@1+ (1,0) [0|1] ""  SRR_RL
 SG_ DET_BELOW_RAIN_THOLD_073 : 39|1@1+ (1,0) [0|1] ""  SRR_RL
 SG_ DET_RANGE_074 : 136|15@1+ (0.015625,0) [0|500] "m"  SRR_RL
 SG_ DET_RANGE_ERR_074 : 152|7@1+ (0.0075,0) [0|0.9525] "m"  SRR_RL
 SG_ DET_RANGE_VELOCITY_074 : 160|15@1+ (0.0078125,-128) [-128|127.9921875] "m/s"  SRR_RL
 SG_ DET_RANGE_VELOCITY_ERR_074 : 176|8@1+ (0.003,0) [0|0.765] "m/s"  SRR_RL
 SG_ DET_AZIMUTH_074 : 200|13@1+ (0.0004,-1.5708) [-1.5708|1.5708] "rad"  SRR_RL
 SG_ DET_AZIMUTH_ERR_074 : 217|7@1+ (0.00087267,0) [0|0.11082909] "rad"  SRR_RL
 SG_ DET_ELEVATION_074 : 184|8@1+ (0.00275,-0.34925) [-0.34925|0.34925] "rad"  SRR_RL
 SG_ DET_ELEVATION_ERR_074 : 192|6@1+ (0.00174533,0) [0|0.10995579] "rad"  SRR_RL
 SG_ DET_RCS_074 : 240|8@1+ (0.5,-64) [-64|63.5] "dBsm"  SRR_RL
 SG_ DET_BI_STATIC_FLAG_074 : 216|1@1+ (1,0) [0|1] ""  SRR_RL
 SG_ DET_SUPER_RES_TARGET_074 : 199|1@1+ (1,0) [0|1] ""  SRR_RL
 SG_ DET_SNR_074 : 232|8@1+ (0.35156,0) [0|89.6478] "dB"  SRR_RL
 SG_ DET_EXISTENCE_PROB_074 : 224|6@1+ (1.588,0) [0|100] "%"  SRR_RL
 SG_ DET_HVC_FLAG_074 : 198|1@1+ (1,0) [0|1] ""  SRR_RL
 SG_ DET_CONFD_AZIMUTH_074 : 230|2@1+ (1,0) [0|3] ""  SRR_RL
 SG_ DET_CONFD_ELEVATION_074 : 213|2@1+ (1,0) [0|3] ""  SRR_RL
 SG_ DET_PROB_1STAZHYPO_074 : 215|1@1+ (1,0) [0|1] ""  SRR_RL
 SG_ DET_IDM_074 : 175|1@1+ (1,0) [0|1] ""  SRR_RL
 SG_ DET_MTD_074 : 159|1@1+ (1,0) [0|1] ""  SRR_RL
 SG_ DET_BELOW_RAIN_THOLD_074 : 151|1@1+ (1,0) [0|1] ""  SRR_RL
 SG_ DET_RANGE_075 : 248|15@1+ (0.015625,0) [0|500] "m"  SRR_RL
 SG_ DET_RANGE_ERR_075 : 264|7@1+ (0.0075,0) [0|0.9525] "m"  SRR_RL
 SG_ DET_RANGE_VELOCITY_075 : 272|15@1+ (0.0078125,-128) [-128|127.9921875] "m/s"  SRR_RL
 SG_ DET_RANGE_VELOCITY_ERR_075 : 288|8@1+ (0.003,0) [0|0.765] "m/s"  SRR_RL
 SG_ DET_AZIMUTH_075 : 312|13@1+ (0.0004,-1.5708) [-1.5708|1.5708] "rad"  SRR_RL
 SG_ DET_AZIMUTH_ERR_075 : 329|7@1+ (0.00087267,0) [0|0.11082909] "rad"  SRR_RL
 SG_ DET_ELEVATION_075 : 296|8@1+ (0.00275,-0.34925) [-0.34925|0.34925] "rad"  SRR_RL
 SG_ DET_ELEVATION_ERR_075 : 304|6@1+ (0.00174533,0) [0|0.10995579] "rad"  SRR_RL
 SG_ DET_RCS_075 : 352|8@1+ (0.5,-64) [-64|63.5] "dBsm"  SRR_RL
 SG_ DET_BI_STATIC_FLAG_075 : 328|1@1+ (1,0) [0|1] ""  SRR_RL
 SG_ DET_SUPER_RES_TARGET_075 : 311|1@1+ (1,0) [0|1] ""  SRR_RL
 SG_ DET_SNR_075 : 344|8@1+ (0.35156,0) [0|89.6478] "dB"  SRR_RL
 SG_ DET_EXISTENCE_PROB_075 : 336|6@1+ (1.588,0) [0|100] "%"  SRR_RL
 SG_ DET_HVC_FLAG_075 : 310|1@1+ (1,0) [0|1] ""  SRR_RL
 SG_ DET_CONFD_AZIMUTH_075 : 342|2@1+ (1,0) [0|3] ""  SRR_RL
 SG_ DET_CONFD_ELEVATION_075 : 325|2@1+ (1,0) [0|3] ""  SRR_RL
 SG_ DET_PROB_1STAZHYPO_075 : 327|1@1+ (1,0) [0|1] ""  SRR_RL
 SG_ DET_IDM_075 : 287|1@1+ (1,0) [0|1] ""  SRR_RL
 SG_ DET_MTD_075 : 271|1@1+ (1,0) [0|1] ""  SRR_RL
 SG_ DET_BELOW_RAIN_THOLD_075 : 263|1@1+ (1,0) [0|1] ""  SRR_RL
 SG_ DET_RANGE_076 : 360|15@1+ (0.015625,0) [0|500] "m"  SRR_RL
 SG_ DET_RANGE_ERR_076 : 376|7@1+ (0.0075,0) [0|0.9525] "m"  SRR_RL
 SG_ DET_RANGE_VELOCITY_076 : 384|15@1+ (0.0078125,-128) [-128|127.9921875] "m/s"  SRR_RL
 SG_ DET_RANGE_VELOCITY_ERR_076 : 400|8@1+ (0.003,0) [0|0.765] "m/s"  SRR_RL
 SG_ DET_AZIMUTH_076 : 424|13@1+ (0.0004,-1.5708) [-1.5708|1.5708] "rad"  SRR_RL
 SG_ DET_AZIMUTH_ERR_076 : 441|7@1+ (0.00087267,0) [0|0.11082909] "rad"  SRR_RL
 SG_ DET_ELEVATION_076 : 408|8@1+ (0.00275,-0.34925) [-0.34925|0.34925] "rad"  SRR_RL
 SG_ DET_ELEVATION_ERR_076 : 416|6@1+ (0.00174533,0) [0|0.10995579] "rad"  SRR_RL
 SG_ DET_RCS_076 : 464|8@1+ (0.5,-64) [-64|63.5] "dBsm"  SRR_RL
 SG_ DET_BI_STATIC_FLAG_076 : 440|1@1+ (1,0) [0|1] ""  SRR_RL
 SG_ DET_SUPER_RES_TARGET_076 : 423|1@1+ (1,0) [0|1] ""  SRR_RL
 SG_ DET_SNR_076 : 456|8@1+ (0.35156,0) [0|89.6478] "dB"  SRR_RL
 SG_ DET_EXISTENCE_PROB_076 : 448|6@1+ (1.588,0) [0|100] "%"  SRR_RL
 SG_ DET_HVC_FLAG_076 : 422|1@1+ (1,0) [0|1] ""  SRR_RL
 SG_ DET_CONFD_AZIMUTH_076 : 454|2@1+ (1,0) [0|3] ""  SRR_RL
 SG_ DET_CONFD_ELEVATION_076 : 437|2@1+ (1,0) [0|3] ""  SRR_RL
 SG_ DET_MH_SCAN_INDEX_4LSB_073_076 : 476|4@1+ (1,0) [0|15] ""  SRR_RL
 SG_ DET_MH_CYCLE_COUNTER_073_076 : 16|8@1+ (1,0) [0|255] ""  SRR_RL
 SG_ DET_MH_CRC16_073_076 : 0|16@1+ (1,0) [0|65535] ""  SRR_RL
 SG_ DET_PROB_1STAZHYPO_076 : 439|1@1+ (1,0) [0|1] ""  SRR_RL
 SG_ DET_IDM_076 : 399|1@1+ (1,0) [0|1] ""  SRR_RL
 SG_ DET_MTD_076 : 383|1@1+ (1,0) [0|1] ""  SRR_RL
 SG_ DET_BELOW_RAIN_THOLD_076 : 375|1@1+ (1,0) [0|1] ""  SRR_RL

BO_ 659 SRR_FL_DETECTION_077_080: 64 SRR_FL
 SG_ DET_RANGE_077 : 24|15@1+ (0.015625,0) [0|500] "m"  SRR_RL
 SG_ DET_RANGE_ERR_077 : 40|7@1+ (0.0075,0) [0|0.9525] "m"  SRR_RL
 SG_ DET_RANGE_VELOCITY_077 : 48|15@1+ (0.0078125,-128) [-128|127.9921875] "m/s"  SRR_RL
 SG_ DET_RANGE_VELOCITY_ERR_077 : 64|8@1+ (0.003,0) [0|0.765] "m/s"  SRR_RL
 SG_ DET_AZIMUTH_077 : 88|13@1+ (0.0004,-1.5708) [-1.5708|1.5708] "rad"  SRR_RL
 SG_ DET_AZIMUTH_ERR_077 : 105|7@1+ (0.00087267,0) [0|0.11082909] "rad"  SRR_RL
 SG_ DET_ELEVATION_077 : 72|8@1+ (0.00275,-0.34925) [-0.34925|0.34925] "rad"  SRR_RL
 SG_ DET_ELEVATION_ERR_077 : 80|6@1+ (0.00174533,0) [0|0.10995579] "rad"  SRR_RL
 SG_ DET_RCS_077 : 128|8@1+ (0.5,-64) [-64|63.5] "dBsm"  SRR_RL
 SG_ DET_BI_STATIC_FLAG_077 : 104|1@1+ (1,0) [0|1] ""  SRR_RL
 SG_ DET_SUPER_RES_TARGET_077 : 87|1@1+ (1,0) [0|1] ""  SRR_RL
 SG_ DET_SNR_077 : 120|8@1+ (0.35156,0) [0|89.6478] "dB"  SRR_RL
 SG_ DET_EXISTENCE_PROB_077 : 112|6@1+ (1.588,0) [0|100] "%"  SRR_RL
 SG_ DET_HVC_FLAG_077 : 86|1@1+ (1,0) [0|1] ""  SRR_RL
 SG_ DET_CONFD_AZIMUTH_077 : 118|2@1+ (1,0) [0|3] ""  SRR_RL
 SG_ DET_CONFD_ELEVATION_077 : 101|2@1+ (1,0) [0|3] ""  SRR_RL
 SG_ DET_PROB_1STAZHYPO_077 : 103|1@1+ (1,0) [0|1] ""  SRR_RL
 SG_ DET_IDM_077 : 63|1@1+ (1,0) [0|1] ""  SRR_RL
 SG_ DET_MTD_077 : 47|1@1+ (1,0) [0|1] ""  SRR_RL
 SG_ DET_BELOW_RAIN_THOLD_077 : 39|1@1+ (1,0) [0|1] ""  SRR_RL
 SG_ DET_RANGE_078 : 136|15@1+ (0.015625,0) [0|500] "m"  SRR_RL
 SG_ DET_RANGE_ERR_078 : 152|7@1+ (0.0075,0) [0|0.9525] "m"  SRR_RL
 SG_ DET_RANGE_VELOCITY_078 : 160|15@1+ (0.0078125,-128) [-128|127.9921875] "m/s"  SRR_RL
 SG_ DET_RANGE_VELOCITY_ERR_078 : 176|8@1+ (0.003,0) [0|0.765] "m/s"  SRR_RL
 SG_ DET_AZIMUTH_078 : 200|13@1+ (0.0004,-1.5708) [-1.5708|1.5708] "rad"  SRR_RL
 SG_ DET_AZIMUTH_ERR_078 : 217|7@1+ (0.00087267,0) [0|0.11082909] "rad"  SRR_RL
 SG_ DET_ELEVATION_078 : 184|8@1+ (0.00275,-0.34925) [-0.34925|0.34925] "rad"  SRR_RL
 SG_ DET_ELEVATION_ERR_078 : 192|6@1+ (0.00174533,0) [0|0.10995579] "rad"  SRR_RL
 SG_ DET_RCS_078 : 240|8@1+ (0.5,-64) [-64|63.5] "dBsm"  SRR_RL
 SG_ DET_BI_STATIC_FLAG_078 : 216|1@1+ (1,0) [0|1] ""  SRR_RL
 SG_ DET_SUPER_RES_TARGET_078 : 199|1@1+ (1,0) [0|1] ""  SRR_RL
 SG_ DET_SNR_078 : 232|8@1+ (0.35156,0) [0|89.6478] "dB"  SRR_RL
 SG_ DET_EXISTENCE_PROB_078 : 224|6@1+ (1.588,0) [0|100] "%"  SRR_RL
 SG_ DET_HVC_FLAG_078 : 198|1@1+ (1,0) [0|1] ""  SRR_RL
 SG_ DET_CONFD_AZIMUTH_078 : 230|2@1+ (1,0) [0|3] ""  SRR_RL
 SG_ DET_CONFD_ELEVATION_078 : 213|2@1+ (1,0) [0|3] ""  SRR_RL
 SG_ DET_PROB_1STAZHYPO_078 : 215|1@1+ (1,0) [0|1] ""  SRR_RL
 SG_ DET_IDM_078 : 175|1@1+ (1,0) [0|1] ""  SRR_RL
 SG_ DET_MTD_078 : 159|1@1+ (1,0) [0|1] ""  SRR_RL
 SG_ DET_BELOW_RAIN_THOLD_078 : 151|1@1+ (1,0) [0|1] ""  SRR_RL
 SG_ DET_RANGE_079 : 248|15@1+ (0.015625,0) [0|500] "m"  SRR_RL
 SG_ DET_RANGE_ERR_079 : 264|7@1+ (0.0075,0) [0|0.9525] "m"  SRR_RL
 SG_ DET_RANGE_VELOCITY_079 : 272|15@1+ (0.0078125,-128) [-128|127.9921875] "m/s"  SRR_RL
 SG_ DET_RANGE_VELOCITY_ERR_079 : 288|8@1+ (0.003,0) [0|0.765] "m/s"  SRR_RL
 SG_ DET_AZIMUTH_079 : 312|13@1+ (0.0004,-1.5708) [-1.5708|1.5708] "rad"  SRR_RL
 SG_ DET_AZIMUTH_ERR_079 : 329|7@1+ (0.00087267,0) [0|0.11082909] "rad"  SRR_RL
 SG_ DET_ELEVATION_079 : 296|8@1+ (0.00275,-0.34925) [-0.34925|0.34925] "rad"  SRR_RL
 SG_ DET_ELEVATION_ERR_079 : 304|6@1+ (0.00174533,0) [0|0.10995579] "rad"  SRR_RL
 SG_ DET_RCS_079 : 352|8@1+ (0.5,-64) [-64|63.5] "dBsm"  SRR_RL
 SG_ DET_BI_STATIC_FLAG_079 : 328|1@1+ (1,0) [0|1] ""  SRR_RL
 SG_ DET_SUPER_RES_TARGET_079 : 311|1@1+ (1,0) [0|1] ""  SRR_RL
 SG_ DET_SNR_079 : 344|8@1+ (0.35156,0) [0|89.6478] "dB"  SRR_RL
 SG_ DET_EXISTENCE_PROB_079 : 336|6@1+ (1.588,0) [0|100] "%"  SRR_RL
 SG_ DET_HVC_FLAG_079 : 310|1@1+ (1,0) [0|1] ""  SRR_RL
 SG_ DET_CONFD_AZIMUTH_079 : 342|2@1+ (1,0) [0|3] ""  SRR_RL
 SG_ DET_CONFD_ELEVATION_079 : 325|2@1+ (1,0) [0|3] ""  SRR_RL
 SG_ DET_PROB_1STAZHYPO_079 : 327|1@1+ (1,0) [0|1] ""  SRR_RL
 SG_ DET_IDM_079 : 287|1@1+ (1,0) [0|1] ""  SRR_RL
 SG_ DET_MTD_079 : 271|1@1+ (1,0) [0|1] ""  SRR_RL
 SG_ DET_BELOW_RAIN_THOLD_079 : 263|1@1+ (1,0) [0|1] ""  SRR_RL
 SG_ DET_RANGE_080 : 360|15@1+ (0.015625,0) [0|500] "m"  SRR_RL
 SG_ DET_RANGE_ERR_080 : 376|7@1+ (0.0075,0) [0|0.9525] "m"  SRR_RL
 SG_ DET_RANGE_VELOCITY_080 : 384|15@1+ (0.0078125,-128) [-128|127.9921875] "m/s"  SRR_RL
 SG_ DET_RANGE_VELOCITY_ERR_080 : 400|8@1+ (0.003,0) [0|0.765] "m/s"  SRR_RL
 SG_ DET_AZIMUTH_080 : 424|13@1+ (0.0004,-1.5708) [-1.5708|1.5708] "rad"  SRR_RL
 SG_ DET_AZIMUTH_ERR_080 : 441|7@1+ (0.00087267,0) [0|0.11082909] "rad"  SRR_RL
 SG_ DET_ELEVATION_080 : 408|8@1+ (0.00275,-0.34925) [-0.34925|0.34925] "rad"  SRR_RL
 SG_ DET_ELEVATION_ERR_080 : 416|6@1+ (0.00174533,0) [0|0.10995579] "rad"  SRR_RL
 SG_ DET_RCS_080 : 464|8@1+ (0.5,-64) [-64|63.5] "dBsm"  SRR_RL
 SG_ DET_BI_STATIC_FLAG_080 : 440|1@1+ (1,0) [0|1] ""  SRR_RL
 SG_ DET_SUPER_RES_TARGET_080 : 423|1@1+ (1,0) [0|1] ""  SRR_RL
 SG_ DET_SNR_080 : 456|8@1+ (0.35156,0) [0|89.6478] "dB"  SRR_RL
 SG_ DET_EXISTENCE_PROB_080 : 448|6@1+ (1.588,0) [0|100] "%"  SRR_RL
 SG_ DET_HVC_FLAG_080 : 422|1@1+ (1,0) [0|1] ""  SRR_RL
 SG_ DET_CONFD_AZIMUTH_080 : 454|2@1+ (1,0) [0|3] ""  SRR_RL
 SG_ DET_CONFD_ELEVATION_080 : 437|2@1+ (1,0) [0|3] ""  SRR_RL
 SG_ DET_MH_SCAN_INDEX_4LSB_077_080 : 476|4@1+ (1,0) [0|15] ""  SRR_RL
 SG_ DET_MH_CYCLE_COUNTER_077_080 : 16|8@1+ (1,0) [0|255] ""  SRR_RL
 SG_ DET_MH_CRC16_077_080 : 0|16@1+ (1,0) [0|65535] ""  SRR_RL
 SG_ DET_PROB_1STAZHYPO_080 : 439|1@1+ (1,0) [0|1] ""  SRR_RL
 SG_ DET_IDM_080 : 399|1@1+ (1,0) [0|1] ""  SRR_RL
 SG_ DET_MTD_080 : 383|1@1+ (1,0) [0|1] ""  SRR_RL
 SG_ DET_BELOW_RAIN_THOLD_080 : 375|1@1+ (1,0) [0|1] ""  SRR_RL

BO_ 660 SRR_FL_DETECTION_081_084: 64 SRR_FL
 SG_ DET_RANGE_081 : 24|15@1+ (0.015625,0) [0|500] "m"  SRR_RL
 SG_ DET_RANGE_ERR_081 : 40|7@1+ (0.0075,0) [0|0.9525] "m"  SRR_RL
 SG_ DET_RANGE_VELOCITY_081 : 48|15@1+ (0.0078125,-128) [-128|127.9921875] "m/s"  SRR_RL
 SG_ DET_RANGE_VELOCITY_ERR_081 : 64|8@1+ (0.003,0) [0|0.765] "m/s"  SRR_RL
 SG_ DET_AZIMUTH_081 : 88|13@1+ (0.0004,-1.5708) [-1.5708|1.5708] "rad"  SRR_RL
 SG_ DET_AZIMUTH_ERR_081 : 105|7@1+ (0.00087267,0) [0|0.11082909] "rad"  SRR_RL
 SG_ DET_ELEVATION_081 : 72|8@1+ (0.00275,-0.34925) [-0.34925|0.34925] "rad"  SRR_RL
 SG_ DET_ELEVATION_ERR_081 : 80|6@1+ (0.00174533,0) [0|0.10995579] "rad"  SRR_RL
 SG_ DET_RCS_081 : 128|8@1+ (0.5,-64) [-64|63.5] "dBsm"  SRR_RL
 SG_ DET_BI_STATIC_FLAG_081 : 104|1@1+ (1,0) [0|1] ""  SRR_RL
 SG_ DET_SUPER_RES_TARGET_081 : 87|1@1+ (1,0) [0|1] ""  SRR_RL
 SG_ DET_SNR_081 : 120|8@1+ (0.35156,0) [0|89.6478] "dB"  SRR_RL
 SG_ DET_EXISTENCE_PROB_081 : 112|6@1+ (1.588,0) [0|100] "%"  SRR_RL
 SG_ DET_HVC_FLAG_081 : 86|1@1+ (1,0) [0|1] ""  SRR_RL
 SG_ DET_CONFD_AZIMUTH_081 : 118|2@1+ (1,0) [0|3] ""  SRR_RL
 SG_ DET_CONFD_ELEVATION_081 : 101|2@1+ (1,0) [0|3] ""  SRR_RL
 SG_ DET_PROB_1STAZHYPO_081 : 103|1@1+ (1,0) [0|1] ""  SRR_RL
 SG_ DET_IDM_081 : 63|1@1+ (1,0) [0|1] ""  SRR_RL
 SG_ DET_MTD_081 : 47|1@1+ (1,0) [0|1] ""  SRR_RL
 SG_ DET_BELOW_RAIN_THOLD_081 : 39|1@1+ (1,0) [0|1] ""  SRR_RL
 SG_ DET_RANGE_082 : 136|15@1+ (0.015625,0) [0|500] "m"  SRR_RL
 SG_ DET_RANGE_ERR_082 : 152|7@1+ (0.0075,0) [0|0.9525] "m"  SRR_RL
 SG_ DET_RANGE_VELOCITY_082 : 160|15@1+ (0.0078125,-128) [-128|127.9921875] "m/s"  SRR_RL
 SG_ DET_RANGE_VELOCITY_ERR_082 : 176|8@1+ (0.003,0) [0|0.765] "m/s"  SRR_RL
 SG_ DET_AZIMUTH_082 : 200|13@1+ (0.0004,-1.5708) [-1.5708|1.5708] "rad"  SRR_RL
 SG_ DET_AZIMUTH_ERR_082 : 217|7@1+ (0.00087267,0) [0|0.11082909] "rad"  SRR_RL
 SG_ DET_ELEVATION_082 : 184|8@1+ (0.00275,-0.34925) [-0.34925|0.34925] "rad"  SRR_RL
 SG_ DET_ELEVATION_ERR_082 : 192|6@1+ (0.00174533,0) [0|0.10995579] "rad"  SRR_RL
 SG_ DET_RCS_082 : 240|8@1+ (0.5,-64) [-64|63.5] "dBsm"  SRR_RL
 SG_ DET_BI_STATIC_FLAG_082 : 216|1@1+ (1,0) [0|1] ""  SRR_RL
 SG_ DET_SUPER_RES_TARGET_082 : 199|1@1+ (1,0) [0|1] ""  SRR_RL
 SG_ DET_SNR_082 : 232|8@1+ (0.35156,0) [0|89.6478] "dB"  SRR_RL
 SG_ DET_EXISTENCE_PROB_082 : 224|6@1+ (1.588,0) [0|100] "%"  SRR_RL
 SG_ DET_HVC_FLAG_082 : 198|1@1+ (1,0) [0|1] ""  SRR_RL
 SG_ DET_CONFD_AZIMUTH_082 : 230|2@1+ (1,0) [0|3] ""  SRR_RL
 SG_ DET_CONFD_ELEVATION_082 : 213|2@1+ (1,0) [0|3] ""  SRR_RL
 SG_ DET_PROB_1STAZHYPO_082 : 215|1@1+ (1,0) [0|1] ""  SRR_RL
 SG_ DET_IDM_082 : 175|1@1+ (1,0) [0|1] ""  SRR_RL
 SG_ DET_MTD_082 : 159|1@1+ (1,0) [0|1] ""  SRR_RL
 SG_ DET_BELOW_RAIN_THOLD_082 : 151|1@1+ (1,0) [0|1] ""  SRR_RL
 SG_ DET_RANGE_083 : 248|15@1+ (0.015625,0) [0|500] "m"  SRR_RL
 SG_ DET_RANGE_ERR_083 : 264|7@1+ (0.0075,0) [0|0.9525] "m"  SRR_RL
 SG_ DET_RANGE_VELOCITY_083 : 272|15@1+ (0.0078125,-128) [-128|127.9921875] "m/s"  SRR_RL
 SG_ DET_RANGE_VELOCITY_ERR_083 : 288|8@1+ (0.003,0) [0|0.765] "m/s"  SRR_RL
 SG_ DET_AZIMUTH_083 : 312|13@1+ (0.0004,-1.5708) [-1.5708|1.5708] "rad"  SRR_RL
 SG_ DET_AZIMUTH_ERR_083 : 329|7@1+ (0.00087267,0) [0|0.11082909] "rad"  SRR_RL
 SG_ DET_ELEVATION_083 : 296|8@1+ (0.00275,-0.34925) [-0.34925|0.34925] "rad"  SRR_RL
 SG_ DET_ELEVATION_ERR_083 : 304|6@1+ (0.00174533,0) [0|0.10995579] "rad"  SRR_RL
 SG_ DET_RCS_083 : 352|8@1+ (0.5,-64) [-64|63.5] "dBsm"  SRR_RL
 SG_ DET_BI_STATIC_FLAG_083 : 328|1@1+ (1,0) [0|1] ""  SRR_RL
 SG_ DET_SUPER_RES_TARGET_083 : 311|1@1+ (1,0) [0|1] ""  SRR_RL
 SG_ DET_SNR_083 : 344|8@1+ (0.35156,0) [0|89.6478] "dB"  SRR_RL
 SG_ DET_EXISTENCE_PROB_083 : 336|6@1+ (1.588,0) [0|100] "%"  SRR_RL
 SG_ DET_HVC_FLAG_083 : 310|1@1+ (1,0) [0|1] ""  SRR_RL
 SG_ DET_CONFD_AZIMUTH_083 : 342|2@1+ (1,0) [0|3] ""  SRR_RL
 SG_ DET_CONFD_ELEVATION_083 : 325|2@1+ (1,0) [0|3] ""  SRR_RL
 SG_ DET_PROB_1STAZHYPO_083 : 327|1@1+ (1,0) [0|1] ""  SRR_RL
 SG_ DET_IDM_083 : 287|1@1+ (1,0) [0|1] ""  SRR_RL
 SG_ DET_MTD_083 : 271|1@1+ (1,0) [0|1] ""  SRR_RL
 SG_ DET_BELOW_RAIN_THOLD_083 : 263|1@1+ (1,0) [0|1] ""  SRR_RL
 SG_ DET_RANGE_084 : 360|15@1+ (0.015625,0) [0|500] "m"  SRR_RL
 SG_ DET_RANGE_ERR_084 : 376|7@1+ (0.0075,0) [0|0.9525] "m"  SRR_RL
 SG_ DET_RANGE_VELOCITY_084 : 384|15@1+ (0.0078125,-128) [-128|127.9921875] "m/s"  SRR_RL
 SG_ DET_RANGE_VELOCITY_ERR_084 : 400|8@1+ (0.003,0) [0|0.765] "m/s"  SRR_RL
 SG_ DET_AZIMUTH_084 : 424|13@1+ (0.0004,-1.5708) [-1.5708|1.5708] "rad"  SRR_RL
 SG_ DET_AZIMUTH_ERR_084 : 441|7@1+ (0.00087267,0) [0|0.11082909] "rad"  SRR_RL
 SG_ DET_ELEVATION_084 : 408|8@1+ (0.00275,-0.34925) [-0.34925|0.34925] "rad"  SRR_RL
 SG_ DET_ELEVATION_ERR_084 : 416|6@1+ (0.00174533,0) [0|0.10995579] "rad"  SRR_RL
 SG_ DET_RCS_084 : 464|8@1+ (0.5,-64) [-64|63.5] "dBsm"  SRR_RL
 SG_ DET_BI_STATIC_FLAG_084 : 440|1@1+ (1,0) [0|1] ""  SRR_RL
 SG_ DET_SUPER_RES_TARGET_084 : 423|1@1+ (1,0) [0|1] ""  SRR_RL
 SG_ DET_SNR_084 : 456|8@1+ (0.35156,0) [0|89.6478] "dB"  SRR_RL
 SG_ DET_EXISTENCE_PROB_084 : 448|6@1+ (1.588,0) [0|100] "%"  SRR_RL
 SG_ DET_HVC_FLAG_084 : 422|1@1+ (1,0) [0|1] ""  SRR_RL
 SG_ DET_CONFD_AZIMUTH_084 : 454|2@1+ (1,0) [0|3] ""  SRR_RL
 SG_ DET_CONFD_ELEVATION_084 : 437|2@1+ (1,0) [0|3] ""  SRR_RL
 SG_ DET_MH_SCAN_INDEX_4LSB_081_084 : 476|4@1+ (1,0) [0|15] ""  SRR_RL
 SG_ DET_MH_CYCLE_COUNTER_081_084 : 16|8@1+ (1,0) [0|255] ""  SRR_RL
 SG_ DET_MH_CRC16_081_084 : 0|16@1+ (1,0) [0|65535] ""  SRR_RL
 SG_ DET_PROB_1STAZHYPO_084 : 439|1@1+ (1,0) [0|1] ""  SRR_RL
 SG_ DET_IDM_084 : 399|1@1+ (1,0) [0|1] ""  SRR_RL
 SG_ DET_MTD_084 : 383|1@1+ (1,0) [0|1] ""  SRR_RL
 SG_ DET_BELOW_RAIN_THOLD_084 : 375|1@1+ (1,0) [0|1] ""  SRR_RL

BO_ 661 SRR_FL_DETECTION_085_088: 64 SRR_FL
 SG_ DET_RANGE_085 : 24|15@1+ (0.015625,0) [0|500] "m"  SRR_RL
 SG_ DET_RANGE_ERR_085 : 40|7@1+ (0.0075,0) [0|0.9525] "m"  SRR_RL
 SG_ DET_RANGE_VELOCITY_085 : 48|15@1+ (0.0078125,-128) [-128|127.9921875] "m/s"  SRR_RL
 SG_ DET_RANGE_VELOCITY_ERR_085 : 64|8@1+ (0.003,0) [0|0.765] "m/s"  SRR_RL
 SG_ DET_AZIMUTH_085 : 88|13@1+ (0.0004,-1.5708) [-1.5708|1.5708] "rad"  SRR_RL
 SG_ DET_AZIMUTH_ERR_085 : 105|7@1+ (0.00087267,0) [0|0.11082909] "rad"  SRR_RL
 SG_ DET_ELEVATION_085 : 72|8@1+ (0.00275,-0.34925) [-0.34925|0.34925] "rad"  SRR_RL
 SG_ DET_ELEVATION_ERR_085 : 80|6@1+ (0.00174533,0) [0|0.10995579] "rad"  SRR_RL
 SG_ DET_RCS_085 : 128|8@1+ (0.5,-64) [-64|63.5] "dBsm"  SRR_RL
 SG_ DET_BI_STATIC_FLAG_085 : 104|1@1+ (1,0) [0|1] ""  SRR_RL
 SG_ DET_SUPER_RES_TARGET_085 : 87|1@1+ (1,0) [0|1] ""  SRR_RL
 SG_ DET_SNR_085 : 120|8@1+ (0.35156,0) [0|89.6478] "dB"  SRR_RL
 SG_ DET_EXISTENCE_PROB_085 : 112|6@1+ (1.588,0) [0|100] "%"  SRR_RL
 SG_ DET_HVC_FLAG_085 : 86|1@1+ (1,0) [0|1] ""  SRR_RL
 SG_ DET_CONFD_AZIMUTH_085 : 118|2@1+ (1,0) [0|3] ""  SRR_RL
 SG_ DET_CONFD_ELEVATION_085 : 101|2@1+ (1,0) [0|3] ""  SRR_RL
 SG_ DET_PROB_1STAZHYPO_085 : 103|1@1+ (1,0) [0|1] ""  SRR_RL
 SG_ DET_IDM_085 : 63|1@1+ (1,0) [0|1] ""  SRR_RL
 SG_ DET_MTD_085 : 47|1@1+ (1,0) [0|1] ""  SRR_RL
 SG_ DET_BELOW_RAIN_THOLD_085 : 39|1@1+ (1,0) [0|1] ""  SRR_RL
 SG_ DET_RANGE_086 : 136|15@1+ (0.015625,0) [0|500] "m"  SRR_RL
 SG_ DET_RANGE_ERR_086 : 152|7@1+ (0.0075,0) [0|0.9525] "m"  SRR_RL
 SG_ DET_RANGE_VELOCITY_086 : 160|15@1+ (0.0078125,-128) [-128|127.9921875] "m/s"  SRR_RL
 SG_ DET_RANGE_VELOCITY_ERR_086 : 176|8@1+ (0.003,0) [0|0.765] "m/s"  SRR_RL
 SG_ DET_AZIMUTH_086 : 200|13@1+ (0.0004,-1.5708) [-1.5708|1.5708] "rad"  SRR_RL
 SG_ DET_AZIMUTH_ERR_086 : 217|7@1+ (0.00087267,0) [0|0.11082909] "rad"  SRR_RL
 SG_ DET_ELEVATION_086 : 184|8@1+ (0.00275,-0.34925) [-0.34925|0.34925] "rad"  SRR_RL
 SG_ DET_ELEVATION_ERR_086 : 192|6@1+ (0.00174533,0) [0|0.10995579] "rad"  SRR_RL
 SG_ DET_RCS_086 : 240|8@1+ (0.5,-64) [-64|63.5] "dBsm"  SRR_RL
 SG_ DET_BI_STATIC_FLAG_086 : 216|1@1+ (1,0) [0|1] ""  SRR_RL
 SG_ DET_SUPER_RES_TARGET_086 : 199|1@1+ (1,0) [0|1] ""  SRR_RL
 SG_ DET_SNR_086 : 232|8@1+ (0.35156,0) [0|89.6478] "dB"  SRR_RL
 SG_ DET_EXISTENCE_PROB_086 : 224|6@1+ (1.588,0) [0|100] "%"  SRR_RL
 SG_ DET_HVC_FLAG_086 : 198|1@1+ (1,0) [0|1] ""  SRR_RL
 SG_ DET_CONFD_AZIMUTH_086 : 230|2@1+ (1,0) [0|3] ""  SRR_RL
 SG_ DET_CONFD_ELEVATION_086 : 213|2@1+ (1,0) [0|3] ""  SRR_RL
 SG_ DET_PROB_1STAZHYPO_086 : 215|1@1+ (1,0) [0|1] ""  SRR_RL
 SG_ DET_IDM_086 : 175|1@1+ (1,0) [0|1] ""  SRR_RL
 SG_ DET_MTD_086 : 159|1@1+ (1,0) [0|1] ""  SRR_RL
 SG_ DET_BELOW_RAIN_THOLD_086 : 151|1@1+ (1,0) [0|1] ""  SRR_RL
 SG_ DET_RANGE_087 : 248|15@1+ (0.015625,0) [0|500] "m"  SRR_RL
 SG_ DET_RANGE_ERR_087 : 264|7@1+ (0.0075,0) [0|0.9525] "m"  SRR_RL
 SG_ DET_RANGE_VELOCITY_087 : 272|15@1+ (0.0078125,-128) [-128|127.9921875] "m/s"  SRR_RL
 SG_ DET_RANGE_VELOCITY_ERR_087 : 288|8@1+ (0.003,0) [0|0.765] "m/s"  SRR_RL
 SG_ DET_AZIMUTH_087 : 312|13@1+ (0.0004,-1.5708) [-1.5708|1.5708] "rad"  SRR_RL
 SG_ DET_AZIMUTH_ERR_087 : 329|7@1+ (0.00087267,0) [0|0.11082909] "rad"  SRR_RL
 SG_ DET_ELEVATION_087 : 296|8@1+ (0.00275,-0.34925) [-0.34925|0.34925] "rad"  SRR_RL
 SG_ DET_ELEVATION_ERR_087 : 304|6@1+ (0.00174533,0) [0|0.10995579] "rad"  SRR_RL
 SG_ DET_RCS_087 : 352|8@1+ (0.5,-64) [-64|63.5] "dBsm"  SRR_RL
 SG_ DET_BI_STATIC_FLAG_087 : 328|1@1+ (1,0) [0|1] ""  SRR_RL
 SG_ DET_SUPER_RES_TARGET_087 : 311|1@1+ (1,0) [0|1] ""  SRR_RL
 SG_ DET_SNR_087 : 344|8@1+ (0.35156,0) [0|89.6478] "dB"  SRR_RL
 SG_ DET_EXISTENCE_PROB_087 : 336|6@1+ (1.588,0) [0|100] "%"  SRR_RL
 SG_ DET_HVC_FLAG_087 : 310|1@1+ (1,0) [0|1] ""  SRR_RL
 SG_ DET_CONFD_AZIMUTH_087 : 342|2@1+ (1,0) [0|3] ""  SRR_RL
 SG_ DET_CONFD_ELEVATION_087 : 325|2@1+ (1,0) [0|3] ""  SRR_RL
 SG_ DET_PROB_1STAZHYPO_087 : 327|1@1+ (1,0) [0|1] ""  SRR_RL
 SG_ DET_IDM_087 : 287|1@1+ (1,0) [0|1] ""  SRR_RL
 SG_ DET_MTD_087 : 271|1@1+ (1,0) [0|1] ""  SRR_RL
 SG_ DET_BELOW_RAIN_THOLD_087 : 263|1@1+ (1,0) [0|1] ""  SRR_RL
 SG_ DET_RANGE_088 : 360|15@1+ (0.015625,0) [0|500] "m"  SRR_RL
 SG_ DET_RANGE_ERR_088 : 376|7@1+ (0.0075,0) [0|0.9525] "m"  SRR_RL
 SG_ DET_RANGE_VELOCITY_088 : 384|15@1+ (0.0078125,-128) [-128|127.9921875] "m/s"  SRR_RL
 SG_ DET_RANGE_VELOCITY_ERR_088 : 400|8@1+ (0.003,0) [0|0.765] "m/s"  SRR_RL
 SG_ DET_AZIMUTH_088 : 424|13@1+ (0.0004,-1.5708) [-1.5708|1.5708] "rad"  SRR_RL
 SG_ DET_AZIMUTH_ERR_088 : 441|7@1+ (0.00087267,0) [0|0.11082909] "rad"  SRR_RL
 SG_ DET_ELEVATION_088 : 408|8@1+ (0.00275,-0.34925) [-0.34925|0.34925] "rad"  SRR_RL
 SG_ DET_ELEVATION_ERR_088 : 416|6@1+ (0.00174533,0) [0|0.10995579] "rad"  SRR_RL
 SG_ DET_RCS_088 : 464|8@1+ (0.5,-64) [-64|63.5] "dBsm"  SRR_RL
 SG_ DET_BI_STATIC_FLAG_088 : 440|1@1+ (1,0) [0|1] ""  SRR_RL
 SG_ DET_SUPER_RES_TARGET_088 : 423|1@1+ (1,0) [0|1] ""  SRR_RL
 SG_ DET_SNR_088 : 456|8@1+ (0.35156,0) [0|89.6478] "dB"  SRR_RL
 SG_ DET_EXISTENCE_PROB_088 : 448|6@1+ (1.588,0) [0|100] "%"  SRR_RL
 SG_ DET_HVC_FLAG_088 : 422|1@1+ (1,0) [0|1] ""  SRR_RL
 SG_ DET_CONFD_AZIMUTH_088 : 454|2@1+ (1,0) [0|3] ""  SRR_RL
 SG_ DET_CONFD_ELEVATION_088 : 437|2@1+ (1,0) [0|3] ""  SRR_RL
 SG_ DET_MH_SCAN_INDEX_4LSB_085_088 : 476|4@1+ (1,0) [0|15] ""  SRR_RL
 SG_ DET_MH_CYCLE_COUNTER_085_088 : 16|8@1+ (1,0) [0|255] ""  SRR_RL
 SG_ DET_MH_CRC16_085_088 : 0|16@1+ (1,0) [0|65535] ""  SRR_RL
 SG_ DET_PROB_1STAZHYPO_088 : 439|1@1+ (1,0) [0|1] ""  SRR_RL
 SG_ DET_IDM_088 : 399|1@1+ (1,0) [0|1] ""  SRR_RL
 SG_ DET_MTD_088 : 383|1@1+ (1,0) [0|1] ""  SRR_RL
 SG_ DET_BELOW_RAIN_THOLD_088 : 375|1@1+ (1,0) [0|1] ""  SRR_RL

CM_ SG_ 646 DET_RANGE_025 " measured position  of the detection";
CM_ SG_ 646 DET_RANGE_ERR_025 "RMSE or standard deviation of the measured angle  of the detection";
CM_ SG_ 646 DET_RANGE_VELOCITY_025 "Radial velocity of the detection positive in direction to the sensor";
CM_ SG_ 646 DET_RANGE_VELOCITY_ERR_025 "RMSE or standard deviation of the measure radial velocity of the detection";
CM_ SG_ 646 DET_AZIMUTH_025 "Measured angle  of the detection";
CM_ SG_ 646 DET_AZIMUTH_ERR_025 "RMSE or standard deviation of the measured angle  of the detection";
CM_ SG_ 646 DET_ELEVATION_025 "measured elevation of the detection";
CM_ SG_ 646 DET_ELEVATION_ERR_025 "RMSE or standard deviation of the measured elevation  of the detection";
CM_ SG_ 646 DET_RCS_025 "Radar Cross Section or Amplitude, is a measure of how detectable an object is by radar. A larger RCS indicates that an object is more easily detected.";
CM_ SG_ 646 DET_BI_STATIC_FLAG_025 "1 if detection is bi-static 0 otherwise";
CM_ SG_ 646 DET_SUPER_RES_TARGET_025 "flasg is set if the detection is super resolution target";
CM_ SG_ 646 DET_SNR_025 "The signal to noise ratio (SNR) of the radar detection";
CM_ SG_ 646 DET_EXISTENCE_PROB_025 "Existence probability of the detection not based on history. Value does  not depend on any past experience with similar detections.

ote Use as confidence measure where a low value means less confidence
and a high value indicates strong confidence.";
CM_ SG_ 646 DET_HVC_FLAG_025 "Core2 Vehicle clutter flag";
CM_ SG_ 646 DET_CONFD_AZIMUTH_025 "Define the Confidence of Azimuth for Detection ";
CM_ SG_ 646 DET_CONFD_ELEVATION_025 "Define the Confidence of Elevation for the Detection ";
CM_ SG_ 646 DET_BI_STATIC_FLAG_026 "1 if detection is bi-static 0 otherwise";
CM_ SG_ 646 DET_BI_STATIC_FLAG_027 "1 if detection is bi-static 0 otherwise";
CM_ SG_ 646 DET_BI_STATIC_FLAG_028 "1 if detection is bi-static 0 otherwise";
CM_ SG_ 646 DET_MH_SCAN_INDEX_4LSB_025_028 "Scan index of the measured detection";
CM_ SG_ 646 DET_MH_CYCLE_COUNTER_025_028 "Detection Alive Counter";
CM_ SG_ 647 DET_RANGE_029 " measured position  of the detection";
CM_ SG_ 647 DET_RANGE_ERR_029 "RMSE or standard deviation of the measured angle  of the detection";
CM_ SG_ 647 DET_RANGE_VELOCITY_029 "Radial velocity of the detection positive in direction to the sensor";
CM_ SG_ 647 DET_RANGE_VELOCITY_ERR_029 "RMSE or standard deviation of the measure radial velocity of the detection";
CM_ SG_ 647 DET_AZIMUTH_029 "Measured angle  of the detection";
CM_ SG_ 647 DET_AZIMUTH_ERR_029 "RMSE or standard deviation of the measured angle  of the detection";
CM_ SG_ 647 DET_ELEVATION_029 "measured elevation of the detection";
CM_ SG_ 647 DET_ELEVATION_ERR_029 "RMSE or standard deviation of the measured elevation  of the detection";
CM_ SG_ 647 DET_RCS_029 "Radar Cross Section or Amplitude, is a measure of how detectable an object is by radar. A larger RCS indicates that an object is more easily detected.";
CM_ SG_ 647 DET_BI_STATIC_FLAG_029 "1 if detection is bi-static 0 otherwise";
CM_ SG_ 647 DET_SUPER_RES_TARGET_029 "flasg is set if the detection is super resolution target";
CM_ SG_ 647 DET_SNR_029 "The signal to noise ratio (SNR) of the radar detection";
CM_ SG_ 647 DET_EXISTENCE_PROB_029 "Existence probability of the detection not based on history. Value does  not depend on any past experience with similar detections.

ote Use as confidence measure where a low value means less confidence
and a high value indicates strong confidence.";
CM_ SG_ 647 DET_HVC_FLAG_029 "Core2 Vehicle clutter flag";
CM_ SG_ 647 DET_CONFD_AZIMUTH_029 "Define the Confidence of Azimuth for Detection ";
CM_ SG_ 647 DET_CONFD_ELEVATION_029 "Define the Confidence of Elevation for the Detection ";
CM_ SG_ 647 DET_BI_STATIC_FLAG_030 "1 if detection is bi-static 0 otherwise";
CM_ SG_ 647 DET_BI_STATIC_FLAG_031 "1 if detection is bi-static 0 otherwise";
CM_ SG_ 647 DET_BI_STATIC_FLAG_032 "1 if detection is bi-static 0 otherwise";
CM_ SG_ 647 DET_MH_SCAN_INDEX_4LSB_029_032 "Scan index of the measured detection";
CM_ SG_ 647 DET_MH_CYCLE_COUNTER_029_032 "Detection Alive Counter";
CM_ SG_ 648 DET_RANGE_033 " measured position  of the detection";
CM_ SG_ 648 DET_RANGE_ERR_033 "RMSE or standard deviation of the measured angle  of the detection";
CM_ SG_ 648 DET_RANGE_VELOCITY_033 "Radial velocity of the detection positive in direction to the sensor";
CM_ SG_ 648 DET_RANGE_VELOCITY_ERR_033 "RMSE or standard deviation of the measure radial velocity of the detection";
CM_ SG_ 648 DET_AZIMUTH_033 "Measured angle  of the detection";
CM_ SG_ 648 DET_AZIMUTH_ERR_033 "RMSE or standard deviation of the measured angle  of the detection";
CM_ SG_ 648 DET_ELEVATION_033 "measured elevation of the detection";
CM_ SG_ 648 DET_ELEVATION_ERR_033 "RMSE or standard deviation of the measured elevation  of the detection";
CM_ SG_ 648 DET_RCS_033 "Radar Cross Section or Amplitude, is a measure of how detectable an object is by radar. A larger RCS indicates that an object is more easily detected.";
CM_ SG_ 648 DET_BI_STATIC_FLAG_033 "1 if detection is bi-static 0 otherwise";
CM_ SG_ 648 DET_SUPER_RES_TARGET_033 "flasg is set if the detection is super resolution target";
CM_ SG_ 648 DET_SNR_033 "The signal to noise ratio (SNR) of the radar detection";
CM_ SG_ 648 DET_EXISTENCE_PROB_033 "Existence probability of the detection not based on history. Value does  not depend on any past experience with similar detections.

ote Use as confidence measure where a low value means less confidence
and a high value indicates strong confidence.";
CM_ SG_ 648 DET_HVC_FLAG_033 "Core2 Vehicle clutter flag";
CM_ SG_ 648 DET_CONFD_AZIMUTH_033 "Define the Confidence of Azimuth for Detection ";
CM_ SG_ 648 DET_CONFD_ELEVATION_033 "Define the Confidence of Elevation for the Detection ";
CM_ SG_ 648 DET_BI_STATIC_FLAG_034 "1 if detection is bi-static 0 otherwise";
CM_ SG_ 648 DET_BI_STATIC_FLAG_035 "1 if detection is bi-static 0 otherwise";
CM_ SG_ 648 DET_BI_STATIC_FLAG_036 "1 if detection is bi-static 0 otherwise";
CM_ SG_ 648 DET_MH_SCAN_INDEX_4LSB_033_036 "Scan index of the measured detection";
CM_ SG_ 648 DET_MH_CYCLE_COUNTER_033_036 "Detection Alive Counter";
CM_ SG_ 649 DET_RANGE_037 " measured position  of the detection";
CM_ SG_ 649 DET_RANGE_ERR_037 "RMSE or standard deviation of the measured angle  of the detection";
CM_ SG_ 649 DET_RANGE_VELOCITY_037 "Radial velocity of the detection positive in direction to the sensor";
CM_ SG_ 649 DET_RANGE_VELOCITY_ERR_037 "RMSE or standard deviation of the measure radial velocity of the detection";
CM_ SG_ 649 DET_AZIMUTH_037 "Measured angle  of the detection";
CM_ SG_ 649 DET_AZIMUTH_ERR_037 "RMSE or standard deviation of the measured angle  of the detection";
CM_ SG_ 649 DET_ELEVATION_037 "measured elevation of the detection";
CM_ SG_ 649 DET_ELEVATION_ERR_037 "RMSE or standard deviation of the measured elevation  of the detection";
CM_ SG_ 649 DET_RCS_037 "Radar Cross Section or Amplitude, is a measure of how detectable an object is by radar. A larger RCS indicates that an object is more easily detected.";
CM_ SG_ 649 DET_BI_STATIC_FLAG_037 "1 if detection is bi-static 0 otherwise";
CM_ SG_ 649 DET_SUPER_RES_TARGET_037 "flasg is set if the detection is super resolution target";
CM_ SG_ 649 DET_SNR_037 "The signal to noise ratio (SNR) of the radar detection";
CM_ SG_ 649 DET_EXISTENCE_PROB_037 "Existence probability of the detection not based on history. Value does  not depend on any past experience with similar detections.

ote Use as confidence measure where a low value means less confidence
and a high value indicates strong confidence.";
CM_ SG_ 649 DET_HVC_FLAG_037 "Core2 Vehicle clutter flag";
CM_ SG_ 649 DET_CONFD_AZIMUTH_037 "Define the Confidence of Azimuth for Detection ";
CM_ SG_ 649 DET_CONFD_ELEVATION_037 "Define the Confidence of Elevation for the Detection ";
CM_ SG_ 649 DET_BI_STATIC_FLAG_038 "1 if detection is bi-static 0 otherwise";
CM_ SG_ 649 DET_BI_STATIC_FLAG_039 "1 if detection is bi-static 0 otherwise";
CM_ SG_ 649 DET_BI_STATIC_FLAG_040 "1 if detection is bi-static 0 otherwise";
CM_ SG_ 649 DET_MH_SCAN_INDEX_4LSB_037_040 "Scan index of the measured detection";
CM_ SG_ 649 DET_MH_CYCLE_COUNTER_037_040 "Detection Alive Counter";
CM_ SG_ 650 DET_RANGE_041 " measured position  of the detection";
CM_ SG_ 650 DET_RANGE_ERR_041 "RMSE or standard deviation of the measured angle  of the detection";
CM_ SG_ 650 DET_RANGE_VELOCITY_041 "Radial velocity of the detection positive in direction to the sensor";
CM_ SG_ 650 DET_RANGE_VELOCITY_ERR_041 "RMSE or standard deviation of the measure radial velocity of the detection";
CM_ SG_ 650 DET_AZIMUTH_041 "Measured angle  of the detection";
CM_ SG_ 650 DET_AZIMUTH_ERR_041 "RMSE or standard deviation of the measured angle  of the detection";
CM_ SG_ 650 DET_ELEVATION_041 "measured elevation of the detection";
CM_ SG_ 650 DET_ELEVATION_ERR_041 "RMSE or standard deviation of the measured elevation  of the detection";
CM_ SG_ 650 DET_RCS_041 "Radar Cross Section or Amplitude, is a measure of how detectable an object is by radar. A larger RCS indicates that an object is more easily detected.";
CM_ SG_ 650 DET_BI_STATIC_FLAG_041 "1 if detection is bi-static 0 otherwise";
CM_ SG_ 650 DET_SUPER_RES_TARGET_041 "flasg is set if the detection is super resolution target";
CM_ SG_ 650 DET_SNR_041 "The signal to noise ratio (SNR) of the radar detection";
CM_ SG_ 650 DET_EXISTENCE_PROB_041 "Existence probability of the detection not based on history. Value does  not depend on any past experience with similar detections.

ote Use as confidence measure where a low value means less confidence
and a high value indicates strong confidence.";
CM_ SG_ 650 DET_HVC_FLAG_041 "Core2 Vehicle clutter flag";
CM_ SG_ 650 DET_CONFD_AZIMUTH_041 "Define the Confidence of Azimuth for Detection ";
CM_ SG_ 650 DET_CONFD_ELEVATION_041 "Define the Confidence of Elevation for the Detection ";
CM_ SG_ 650 DET_BI_STATIC_FLAG_042 "1 if detection is bi-static 0 otherwise";
CM_ SG_ 650 DET_BI_STATIC_FLAG_043 "1 if detection is bi-static 0 otherwise";
CM_ SG_ 650 DET_BI_STATIC_FLAG_044 "1 if detection is bi-static 0 otherwise";
CM_ SG_ 650 DET_MH_SCAN_INDEX_4LSB_041_044 "Scan index of the measured detection";
CM_ SG_ 650 DET_MH_CYCLE_COUNTER_041_044 "Detection Alive Counter";
CM_ SG_ 651 DET_RANGE_045 " measured position  of the detection";
CM_ SG_ 651 DET_RANGE_ERR_045 "RMSE or standard deviation of the measured angle  of the detection";
CM_ SG_ 651 DET_RANGE_VELOCITY_045 "Radial velocity of the detection positive in direction to the sensor";
CM_ SG_ 651 DET_RANGE_VELOCITY_ERR_045 "RMSE or standard deviation of the measure radial velocity of the detection";
CM_ SG_ 651 DET_AZIMUTH_045 "Measured angle  of the detection";
CM_ SG_ 651 DET_AZIMUTH_ERR_045 "RMSE or standard deviation of the measured angle  of the detection";
CM_ SG_ 651 DET_ELEVATION_045 "measured elevation of the detection";
CM_ SG_ 651 DET_ELEVATION_ERR_045 "RMSE or standard deviation of the measured elevation  of the detection";
CM_ SG_ 651 DET_RCS_045 "Radar Cross Section or Amplitude, is a measure of how detectable an object is by radar. A larger RCS indicates that an object is more easily detected.";
CM_ SG_ 651 DET_BI_STATIC_FLAG_045 "1 if detection is bi-static 0 otherwise";
CM_ SG_ 651 DET_SUPER_RES_TARGET_045 "flasg is set if the detection is super resolution target";
CM_ SG_ 651 DET_SNR_045 "The signal to noise ratio (SNR) of the radar detection";
CM_ SG_ 651 DET_EXISTENCE_PROB_045 "Existence probability of the detection not based on history. Value does  not depend on any past experience with similar detections.

ote Use as confidence measure where a low value means less confidence
and a high value indicates strong confidence.";
CM_ SG_ 651 DET_HVC_FLAG_045 "Core2 Vehicle clutter flag";
CM_ SG_ 651 DET_CONFD_AZIMUTH_045 "Define the Confidence of Azimuth for Detection ";
CM_ SG_ 651 DET_CONFD_ELEVATION_045 "Define the Confidence of Elevation for the Detection ";
CM_ SG_ 651 DET_BI_STATIC_FLAG_046 "1 if detection is bi-static 0 otherwise";
CM_ SG_ 651 DET_BI_STATIC_FLAG_047 "1 if detection is bi-static 0 otherwise";
CM_ SG_ 651 DET_BI_STATIC_FLAG_048 "1 if detection is bi-static 0 otherwise";
CM_ SG_ 651 DET_MH_SCAN_INDEX_4LSB_045_048 "Scan index of the measured detection";
CM_ SG_ 651 DET_MH_CYCLE_COUNTER_045_048 "Detection Alive Counter";
CM_ SG_ 652 DET_RANGE_049 " measured position  of the detection";
CM_ SG_ 652 DET_RANGE_ERR_049 "RMSE or standard deviation of the measured angle  of the detection";
CM_ SG_ 652 DET_RANGE_VELOCITY_049 "Radial velocity of the detection positive in direction to the sensor";
CM_ SG_ 652 DET_RANGE_VELOCITY_ERR_049 "RMSE or standard deviation of the measure radial velocity of the detection";
CM_ SG_ 652 DET_AZIMUTH_049 "Measured angle  of the detection";
CM_ SG_ 652 DET_AZIMUTH_ERR_049 "RMSE or standard deviation of the measured angle  of the detection";
CM_ SG_ 652 DET_ELEVATION_049 "measured elevation of the detection";
CM_ SG_ 652 DET_ELEVATION_ERR_049 "RMSE or standard deviation of the measured elevation  of the detection";
CM_ SG_ 652 DET_RCS_049 "Radar Cross Section or Amplitude, is a measure of how detectable an object is by radar. A larger RCS indicates that an object is more easily detected.";
CM_ SG_ 652 DET_BI_STATIC_FLAG_049 "1 if detection is bi-static 0 otherwise";
CM_ SG_ 652 DET_SUPER_RES_TARGET_049 "flasg is set if the detection is super resolution target";
CM_ SG_ 652 DET_SNR_049 "The signal to noise ratio (SNR) of the radar detection";
CM_ SG_ 652 DET_EXISTENCE_PROB_049 "Existence probability of the detection not based on history. Value does  not depend on any past experience with similar detections.

ote Use as confidence measure where a low value means less confidence
and a high value indicates strong confidence.";
CM_ SG_ 652 DET_HVC_FLAG_049 "Core2 Vehicle clutter flag";
CM_ SG_ 652 DET_CONFD_AZIMUTH_049 "Define the Confidence of Azimuth for Detection ";
CM_ SG_ 652 DET_CONFD_ELEVATION_049 "Define the Confidence of Elevation for the Detection ";
CM_ SG_ 652 DET_BI_STATIC_FLAG_050 "1 if detection is bi-static 0 otherwise";
CM_ SG_ 652 DET_BI_STATIC_FLAG_051 "1 if detection is bi-static 0 otherwise";
CM_ SG_ 652 DET_BI_STATIC_FLAG_052 "1 if detection is bi-static 0 otherwise";
CM_ SG_ 652 DET_MH_SCAN_INDEX_4LSB_049_052 "Scan index of the measured detection";
CM_ SG_ 652 DET_MH_CYCLE_COUNTER_049_052 "Detection Alive Counter";
CM_ SG_ 653 DET_RANGE_053 " measured position  of the detection";
CM_ SG_ 653 DET_RANGE_ERR_053 "RMSE or standard deviation of the measured angle  of the detection";
CM_ SG_ 653 DET_RANGE_VELOCITY_053 "Radial velocity of the detection positive in direction to the sensor";
CM_ SG_ 653 DET_RANGE_VELOCITY_ERR_053 "RMSE or standard deviation of the measure radial velocity of the detection";
CM_ SG_ 653 DET_AZIMUTH_053 "Measured angle  of the detection";
CM_ SG_ 653 DET_AZIMUTH_ERR_053 "RMSE or standard deviation of the measured angle  of the detection";
CM_ SG_ 653 DET_ELEVATION_053 "measured elevation of the detection";
CM_ SG_ 653 DET_ELEVATION_ERR_053 "RMSE or standard deviation of the measured elevation  of the detection";
CM_ SG_ 653 DET_RCS_053 "Radar Cross Section or Amplitude, is a measure of how detectable an object is by radar. A larger RCS indicates that an object is more easily detected.";
CM_ SG_ 653 DET_BI_STATIC_FLAG_053 "1 if detection is bi-static 0 otherwise";
CM_ SG_ 653 DET_SUPER_RES_TARGET_053 "flasg is set if the detection is super resolution target";
CM_ SG_ 653 DET_SNR_053 "The signal to noise ratio (SNR) of the radar detection";
CM_ SG_ 653 DET_EXISTENCE_PROB_053 "Existence probability of the detection not based on history. Value does  not depend on any past experience with similar detections.

ote Use as confidence measure where a low value means less confidence
and a high value indicates strong confidence.";
CM_ SG_ 653 DET_HVC_FLAG_053 "Core2 Vehicle clutter flag";
CM_ SG_ 653 DET_CONFD_AZIMUTH_053 "Define the Confidence of Azimuth for Detection ";
CM_ SG_ 653 DET_CONFD_ELEVATION_053 "Define the Confidence of Elevation for the Detection ";
CM_ SG_ 653 DET_BI_STATIC_FLAG_054 "1 if detection is bi-static 0 otherwise";
CM_ SG_ 653 DET_BI_STATIC_FLAG_055 "1 if detection is bi-static 0 otherwise";
CM_ SG_ 653 DET_BI_STATIC_FLAG_056 "1 if detection is bi-static 0 otherwise";
CM_ SG_ 653 DET_MH_SCAN_INDEX_4LSB_053_056 "Scan index of the measured detection";
CM_ SG_ 653 DET_MH_CYCLE_COUNTER_053_056 "Detection Alive Counter";
CM_ SG_ 654 DET_RANGE_057 " measured position  of the detection";
CM_ SG_ 654 DET_RANGE_ERR_057 "RMSE or standard deviation of the measured angle  of the detection";
CM_ SG_ 654 DET_RANGE_VELOCITY_057 "Radial velocity of the detection positive in direction to the sensor";
CM_ SG_ 654 DET_RANGE_VELOCITY_ERR_057 "RMSE or standard deviation of the measure radial velocity of the detection";
CM_ SG_ 654 DET_AZIMUTH_057 "Measured angle  of the detection";
CM_ SG_ 654 DET_AZIMUTH_ERR_057 "RMSE or standard deviation of the measured angle  of the detection";
CM_ SG_ 654 DET_ELEVATION_057 "measured elevation of the detection";
CM_ SG_ 654 DET_ELEVATION_ERR_057 "RMSE or standard deviation of the measured elevation  of the detection";
CM_ SG_ 654 DET_RCS_057 "Radar Cross Section or Amplitude, is a measure of how detectable an object is by radar. A larger RCS indicates that an object is more easily detected.";
CM_ SG_ 654 DET_BI_STATIC_FLAG_057 "1 if detection is bi-static 0 otherwise";
CM_ SG_ 654 DET_SUPER_RES_TARGET_057 "flasg is set if the detection is super resolution target";
CM_ SG_ 654 DET_SNR_057 "The signal to noise ratio (SNR) of the radar detection";
CM_ SG_ 654 DET_EXISTENCE_PROB_057 "Existence probability of the detection not based on history. Value does  not depend on any past experience with similar detections.

ote Use as confidence measure where a low value means less confidence
and a high value indicates strong confidence.";
CM_ SG_ 654 DET_HVC_FLAG_057 "Core2 Vehicle clutter flag";
CM_ SG_ 654 DET_CONFD_AZIMUTH_057 "Define the Confidence of Azimuth for Detection ";
CM_ SG_ 654 DET_CONFD_ELEVATION_057 "Define the Confidence of Elevation for the Detection ";
CM_ SG_ 654 DET_BI_STATIC_FLAG_058 "1 if detection is bi-static 0 otherwise";
CM_ SG_ 654 DET_BI_STATIC_FLAG_059 "1 if detection is bi-static 0 otherwise";
CM_ SG_ 654 DET_BI_STATIC_FLAG_060 "1 if detection is bi-static 0 otherwise";
CM_ SG_ 654 DET_MH_SCAN_INDEX_4LSB_057_060 "Scan index of the measured detection";
CM_ SG_ 654 DET_MH_CYCLE_COUNTER_057_060 "Detection Alive Counter";
CM_ SG_ 655 DET_RANGE_061 " measured position  of the detection";
CM_ SG_ 655 DET_RANGE_ERR_061 "RMSE or standard deviation of the measured angle  of the detection";
CM_ SG_ 655 DET_RANGE_VELOCITY_061 "Radial velocity of the detection positive in direction to the sensor";
CM_ SG_ 655 DET_RANGE_VELOCITY_ERR_061 "RMSE or standard deviation of the measure radial velocity of the detection";
CM_ SG_ 655 DET_AZIMUTH_061 "Measured angle  of the detection";
CM_ SG_ 655 DET_AZIMUTH_ERR_061 "RMSE or standard deviation of the measured angle  of the detection";
CM_ SG_ 655 DET_ELEVATION_061 "measured elevation of the detection";
CM_ SG_ 655 DET_ELEVATION_ERR_061 "RMSE or standard deviation of the measured elevation  of the detection";
CM_ SG_ 655 DET_RCS_061 "Radar Cross Section or Amplitude, is a measure of how detectable an object is by radar. A larger RCS indicates that an object is more easily detected.";
CM_ SG_ 655 DET_BI_STATIC_FLAG_061 "1 if detection is bi-static 0 otherwise";
CM_ SG_ 655 DET_SUPER_RES_TARGET_061 "flasg is set if the detection is super resolution target";
CM_ SG_ 655 DET_SNR_061 "The signal to noise ratio (SNR) of the radar detection";
CM_ SG_ 655 DET_EXISTENCE_PROB_061 "Existence probability of the detection not based on history. Value does  not depend on any past experience with similar detections.

ote Use as confidence measure where a low value means less confidence
and a high value indicates strong confidence.";
CM_ SG_ 655 DET_HVC_FLAG_061 "Core2 Vehicle clutter flag";
CM_ SG_ 655 DET_CONFD_AZIMUTH_061 "Define the Confidence of Azimuth for Detection ";
CM_ SG_ 655 DET_CONFD_ELEVATION_061 "Define the Confidence of Elevation for the Detection ";
CM_ SG_ 655 DET_BI_STATIC_FLAG_062 "1 if detection is bi-static 0 otherwise";
CM_ SG_ 655 DET_BI_STATIC_FLAG_063 "1 if detection is bi-static 0 otherwise";
CM_ SG_ 655 DET_BI_STATIC_FLAG_064 "1 if detection is bi-static 0 otherwise";
CM_ SG_ 655 DET_MH_SCAN_INDEX_4LSB_061_064 "Scan index of the measured detection";
CM_ SG_ 655 DET_MH_CYCLE_COUNTER_061_064 "Detection Alive Counter";
CM_ SG_ 656 DET_RANGE_065 " measured position  of the detection";
CM_ SG_ 656 DET_RANGE_ERR_065 "RMSE or standard deviation of the measured angle  of the detection";
CM_ SG_ 656 DET_RANGE_VELOCITY_065 "Radial velocity of the detection positive in direction to the sensor";
CM_ SG_ 656 DET_RANGE_VELOCITY_ERR_065 "RMSE or standard deviation of the measure radial velocity of the detection";
CM_ SG_ 656 DET_AZIMUTH_065 "Measured angle  of the detection";
CM_ SG_ 656 DET_AZIMUTH_ERR_065 "RMSE or standard deviation of the measured angle  of the detection";
CM_ SG_ 656 DET_ELEVATION_065 "measured elevation of the detection";
CM_ SG_ 656 DET_ELEVATION_ERR_065 "RMSE or standard deviation of the measured elevation  of the detection";
CM_ SG_ 656 DET_RCS_065 "Radar Cross Section or Amplitude, is a measure of how detectable an object is by radar. A larger RCS indicates that an object is more easily detected.";
CM_ SG_ 656 DET_BI_STATIC_FLAG_065 "1 if detection is bi-static 0 otherwise";
CM_ SG_ 656 DET_SUPER_RES_TARGET_065 "flasg is set if the detection is super resolution target";
CM_ SG_ 656 DET_SNR_065 "The signal to noise ratio (SNR) of the radar detection";
CM_ SG_ 656 DET_EXISTENCE_PROB_065 "Existence probability of the detection not based on history. Value does  not depend on any past experience with similar detections.

ote Use as confidence measure where a low value means less confidence
and a high value indicates strong confidence.";
CM_ SG_ 656 DET_HVC_FLAG_065 "Core2 Vehicle clutter flag";
CM_ SG_ 656 DET_CONFD_AZIMUTH_065 "Define the Confidence of Azimuth for Detection ";
CM_ SG_ 656 DET_CONFD_ELEVATION_065 "Define the Confidence of Elevation for the Detection ";
CM_ SG_ 656 DET_BI_STATIC_FLAG_066 "1 if detection is bi-static 0 otherwise";
CM_ SG_ 656 DET_BI_STATIC_FLAG_067 "1 if detection is bi-static 0 otherwise";
CM_ SG_ 656 DET_BI_STATIC_FLAG_068 "1 if detection is bi-static 0 otherwise";
CM_ SG_ 656 DET_MH_SCAN_INDEX_4LSB_065_068 "Scan index of the measured detection";
CM_ SG_ 656 DET_MH_CYCLE_COUNTER_065_068 "Detection Alive Counter";
CM_ SG_ 657 DET_RANGE_069 " measured position  of the detection";
CM_ SG_ 657 DET_RANGE_ERR_069 "RMSE or standard deviation of the measured angle  of the detection";
CM_ SG_ 657 DET_RANGE_VELOCITY_069 "Radial velocity of the detection positive in direction to the sensor";
CM_ SG_ 657 DET_RANGE_VELOCITY_ERR_069 "RMSE or standard deviation of the measure radial velocity of the detection";
CM_ SG_ 657 DET_AZIMUTH_069 "Measured angle  of the detection";
CM_ SG_ 657 DET_AZIMUTH_ERR_069 "RMSE or standard deviation of the measured angle  of the detection";
CM_ SG_ 657 DET_ELEVATION_069 "measured elevation of the detection";
CM_ SG_ 657 DET_ELEVATION_ERR_069 "RMSE or standard deviation of the measured elevation  of the detection";
CM_ SG_ 657 DET_RCS_069 "Radar Cross Section or Amplitude, is a measure of how detectable an object is by radar. A larger RCS indicates that an object is more easily detected.";
CM_ SG_ 657 DET_BI_STATIC_FLAG_069 "1 if detection is bi-static 0 otherwise";
CM_ SG_ 657 DET_SUPER_RES_TARGET_069 "flasg is set if the detection is super resolution target";
CM_ SG_ 657 DET_SNR_069 "The signal to noise ratio (SNR) of the radar detection";
CM_ SG_ 657 DET_EXISTENCE_PROB_069 "Existence probability of the detection not based on history. Value does  not depend on any past experience with similar detections.

ote Use as confidence measure where a low value means less confidence
and a high value indicates strong confidence.";
CM_ SG_ 657 DET_HVC_FLAG_069 "Core2 Vehicle clutter flag";
CM_ SG_ 657 DET_CONFD_AZIMUTH_069 "Define the Confidence of Azimuth for Detection ";
CM_ SG_ 657 DET_CONFD_ELEVATION_069 "Define the Confidence of Elevation for the Detection ";
CM_ SG_ 657 DET_BI_STATIC_FLAG_070 "1 if detection is bi-static 0 otherwise";
CM_ SG_ 657 DET_BI_STATIC_FLAG_071 "1 if detection is bi-static 0 otherwise";
CM_ SG_ 657 DET_BI_STATIC_FLAG_072 "1 if detection is bi-static 0 otherwise";
CM_ SG_ 657 DET_MH_SCAN_INDEX_4LSB_069_072 "Scan index of the measured detection";
CM_ SG_ 657 DET_MH_CYCLE_COUNTER_069_072 "Detection Alive Counter";
CM_ SG_ 658 DET_RANGE_073 " measured position  of the detection";
CM_ SG_ 658 DET_RANGE_ERR_073 "RMSE or standard deviation of the measured angle  of the detection";
CM_ SG_ 658 DET_RANGE_VELOCITY_073 "Radial velocity of the detection positive in direction to the sensor";
CM_ SG_ 658 DET_RANGE_VELOCITY_ERR_073 "RMSE or standard deviation of the measure radial velocity of the detection";
CM_ SG_ 658 DET_AZIMUTH_073 "Measured angle  of the detection";
CM_ SG_ 658 DET_AZIMUTH_ERR_073 "RMSE or standard deviation of the measured angle  of the detection";
CM_ SG_ 658 DET_ELEVATION_073 "measured elevation of the detection";
CM_ SG_ 658 DET_ELEVATION_ERR_073 "RMSE or standard deviation of the measured elevation  of the detection";
CM_ SG_ 658 DET_RCS_073 "Radar Cross Section or Amplitude, is a measure of how detectable an object is by radar. A larger RCS indicates that an object is more easily detected.";
CM_ SG_ 658 DET_BI_STATIC_FLAG_073 "1 if detection is bi-static 0 otherwise";
CM_ SG_ 658 DET_SUPER_RES_TARGET_073 "flasg is set if the detection is super resolution target";
CM_ SG_ 658 DET_SNR_073 "The signal to noise ratio (SNR) of the radar detection";
CM_ SG_ 658 DET_EXISTENCE_PROB_073 "Existence probability of the detection not based on history. Value does  not depend on any past experience with similar detections.

ote Use as confidence measure where a low value means less confidence
and a high value indicates strong confidence.";
CM_ SG_ 658 DET_HVC_FLAG_073 "Core2 Vehicle clutter flag";
CM_ SG_ 658 DET_CONFD_AZIMUTH_073 "Define the Confidence of Azimuth for Detection ";
CM_ SG_ 658 DET_CONFD_ELEVATION_073 "Define the Confidence of Elevation for the Detection ";
CM_ SG_ 658 DET_BI_STATIC_FLAG_074 "1 if detection is bi-static 0 otherwise";
CM_ SG_ 658 DET_BI_STATIC_FLAG_075 "1 if detection is bi-static 0 otherwise";
CM_ SG_ 658 DET_BI_STATIC_FLAG_076 "1 if detection is bi-static 0 otherwise";
CM_ SG_ 658 DET_MH_SCAN_INDEX_4LSB_073_076 "Scan index of the measured detection";
CM_ SG_ 658 DET_MH_CYCLE_COUNTER_073_076 "Detection Alive Counter";
CM_ SG_ 659 DET_RANGE_077 " measured position  of the detection";
CM_ SG_ 659 DET_RANGE_ERR_077 "RMSE or standard deviation of the measured angle  of the detection";
CM_ SG_ 659 DET_RANGE_VELOCITY_077 "Radial velocity of the detection positive in direction to the sensor";
CM_ SG_ 659 DET_RANGE_VELOCITY_ERR_077 "RMSE or standard deviation of the measure radial velocity of the detection";
CM_ SG_ 659 DET_AZIMUTH_077 "Measured angle  of the detection";
CM_ SG_ 659 DET_AZIMUTH_ERR_077 "RMSE or standard deviation of the measured angle  of the detection";
CM_ SG_ 659 DET_ELEVATION_077 "measured elevation of the detection";
CM_ SG_ 659 DET_ELEVATION_ERR_077 "RMSE or standard deviation of the measured elevation  of the detection";
CM_ SG_ 659 DET_RCS_077 "Radar Cross Section or Amplitude, is a measure of how detectable an object is by radar. A larger RCS indicates that an object is more easily detected.";
CM_ SG_ 659 DET_BI_STATIC_FLAG_077 "1 if detection is bi-static 0 otherwise";
CM_ SG_ 659 DET_SUPER_RES_TARGET_077 "flasg is set if the detection is super resolution target";
CM_ SG_ 659 DET_SNR_077 "The signal to noise ratio (SNR) of the radar detection";
CM_ SG_ 659 DET_EXISTENCE_PROB_077 "Existence probability of the detection not based on history. Value does  not depend on any past experience with similar detections.

ote Use as confidence measure where a low value means less confidence
and a high value indicates strong confidence.";
CM_ SG_ 659 DET_HVC_FLAG_077 "Core2 Vehicle clutter flag";
CM_ SG_ 659 DET_CONFD_AZIMUTH_077 "Define the Confidence of Azimuth for Detection ";
CM_ SG_ 659 DET_CONFD_ELEVATION_077 "Define the Confidence of Elevation for the Detection ";
CM_ SG_ 659 DET_BI_STATIC_FLAG_078 "1 if detection is bi-static 0 otherwise";
CM_ SG_ 659 DET_BI_STATIC_FLAG_079 "1 if detection is bi-static 0 otherwise";
CM_ SG_ 659 DET_BI_STATIC_FLAG_080 "1 if detection is bi-static 0 otherwise";
CM_ SG_ 659 DET_MH_SCAN_INDEX_4LSB_077_080 "Scan index of the measured detection";
CM_ SG_ 659 DET_MH_CYCLE_COUNTER_077_080 "Detection Alive Counter";
CM_ SG_ 660 DET_RANGE_081 " measured position  of the detection";
CM_ SG_ 660 DET_RANGE_ERR_081 "RMSE or standard deviation of the measured angle  of the detection";
CM_ SG_ 660 DET_RANGE_VELOCITY_081 "Radial velocity of the detection positive in direction to the sensor";
CM_ SG_ 660 DET_RANGE_VELOCITY_ERR_081 "RMSE or standard deviation of the measure radial velocity of the detection";
CM_ SG_ 660 DET_AZIMUTH_081 "Measured angle  of the detection";
CM_ SG_ 660 DET_AZIMUTH_ERR_081 "RMSE or standard deviation of the measured angle  of the detection";
CM_ SG_ 660 DET_ELEVATION_081 "measured elevation of the detection";
CM_ SG_ 660 DET_ELEVATION_ERR_081 "RMSE or standard deviation of the measured elevation  of the detection";
CM_ SG_ 660 DET_RCS_081 "Radar Cross Section or Amplitude, is a measure of how detectable an object is by radar. A larger RCS indicates that an object is more easily detected.";
CM_ SG_ 660 DET_BI_STATIC_FLAG_081 "1 if detection is bi-static 0 otherwise";
CM_ SG_ 660 DET_SUPER_RES_TARGET_081 "flasg is set if the detection is super resolution target";
CM_ SG_ 660 DET_SNR_081 "The signal to noise ratio (SNR) of the radar detection";
CM_ SG_ 660 DET_EXISTENCE_PROB_081 "Existence probability of the detection not based on history. Value does  not depend on any past experience with similar detections.

ote Use as confidence measure where a low value means less confidence
and a high value indicates strong confidence.";
CM_ SG_ 660 DET_HVC_FLAG_081 "Core2 Vehicle clutter flag";
CM_ SG_ 660 DET_CONFD_AZIMUTH_081 "Define the Confidence of Azimuth for Detection ";
CM_ SG_ 660 DET_CONFD_ELEVATION_081 "Define the Confidence of Elevation for the Detection ";
CM_ SG_ 660 DET_BI_STATIC_FLAG_082 "1 if detection is bi-static 0 otherwise";
CM_ SG_ 660 DET_BI_STATIC_FLAG_083 "1 if detection is bi-static 0 otherwise";
CM_ SG_ 660 DET_BI_STATIC_FLAG_084 "1 if detection is bi-static 0 otherwise";
CM_ SG_ 660 DET_MH_SCAN_INDEX_4LSB_081_084 "Scan index of the measured detection";
CM_ SG_ 660 DET_MH_CYCLE_COUNTER_081_084 "Detection Alive Counter";
CM_ SG_ 661 DET_RANGE_085 " measured position  of the detection";
CM_ SG_ 661 DET_RANGE_ERR_085 "RMSE or standard deviation of the measured angle  of the detection";
CM_ SG_ 661 DET_RANGE_VELOCITY_085 "Radial velocity of the detection positive in direction to the sensor";
CM_ SG_ 661 DET_RANGE_VELOCITY_ERR_085 "RMSE or standard deviation of the measure radial velocity of the detection";
CM_ SG_ 661 DET_AZIMUTH_085 "Measured angle  of the detection";
CM_ SG_ 661 DET_AZIMUTH_ERR_085 "RMSE or standard deviation of the measured angle  of the detection";
CM_ SG_ 661 DET_ELEVATION_085 "measured elevation of the detection";
CM_ SG_ 661 DET_ELEVATION_ERR_085 "RMSE or standard deviation of the measured elevation  of the detection";
CM_ SG_ 661 DET_RCS_085 "Radar Cross Section or Amplitude, is a measure of how detectable an object is by radar. A larger RCS indicates that an object is more easily detected.";
CM_ SG_ 661 DET_BI_STATIC_FLAG_085 "1 if detection is bi-static 0 otherwise";
CM_ SG_ 661 DET_SUPER_RES_TARGET_085 "flasg is set if the detection is super resolution target";
CM_ SG_ 661 DET_SNR_085 "The signal to noise ratio (SNR) of the radar detection";
CM_ SG_ 661 DET_EXISTENCE_PROB_085 "Existence probability of the detection not based on history. Value does  not depend on any past experience with similar detections.

ote Use as confidence measure where a low value means less confidence
and a high value indicates strong confidence.";
CM_ SG_ 661 DET_HVC_FLAG_085 "Core2 Vehicle clutter flag";
CM_ SG_ 661 DET_CONFD_AZIMUTH_085 "Define the Confidence of Azimuth for Detection ";
CM_ SG_ 661 DET_CONFD_ELEVATION_085 "Define the Confidence of Elevation for the Detection ";
CM_ SG_ 661 DET_BI_STATIC_FLAG_086 "1 if detection is bi-static 0 otherwise";
CM_ SG_ 661 DET_BI_STATIC_FLAG_087 "1 if detection is bi-static 0 otherwise";
CM_ SG_ 661 DET_BI_STATIC_FLAG_088 "1 if detection is bi-static 0 otherwise";
CM_ SG_ 661 DET_MH_SCAN_INDEX_4LSB_085_088 "Scan index of the measured detection";
CM_ SG_ 661 DET_MH_CYCLE_COUNTER_085_088 "Detection Alive Counter";
BA_DEF_ BO_  "CanTpBs" INT 0 255;
BA_DEF_ BO_  "DiagRequest" ENUM  "No","Yes";
BA_DEF_ BO_  "DiagResponse" ENUM  "No","Yes";
BA_DEF_ BO_  "E2EDataId" INT 0 65535;
BA_DEF_ BO_  "E2EDataLength" INT 0 65535;
BA_DEF_ BO_  "E2EProfile" STRING ;
BA_DEF_ BO_  "EventRateOfChange" INT 10 10000;
BA_DEF_ BO_  "GenMsgCycleTime" INT 0 100000;
BA_DEF_ BO_  "GenMsgILSupport" ENUM  "No","Yes";
BA_DEF_ BO_  "GenMsgNrOfRepetition" INT 0 100;
BA_DEF_ BO_  "GenMsgSendType" ENUM  "FixedPeriodic","Event","EnabledPeriodic","NotUsed","NotUsed","EventPeriodic","NotUsed","NotUsed","NoMsgSendType";
BA_DEF_ BO_  "MessageGateway" ENUM  "No","Yes";
BA_DEF_ BO_  "NetworkInitialization" ENUM  "No","Yes";
BA_DEF_ BO_  "SCP_AuthInfoTxLength" INT 0 512;
BA_DEF_ BO_  "SCP_DataId" INT 0 65535;
BA_DEF_ BO_  "SCP_FreshnessValueId" INT 0 65535;
BA_DEF_ BO_  "SCP_FreshnessValueLength" INT 0 512;
BA_DEF_ BO_  "SCP_FreshnessValueTxLength" INT 0 512;
BA_DEF_ BO_  "SC_Message" ENUM  "No","Yes","Yes, split message";
BA_DEF_ BO_  "VFrameFormat" ENUM  "StandardCAN","ExtendedCAN","reserved","reserved","reserved","reserved","reserved","reserved","reserved","reserved","reserved","reserved","reserved","reserved","StandardCAN_FD","ExtendedCAN_FD";
BA_DEF_ SG_  "GenSigCmt" STRING ;
BA_DEF_ SG_  "GenSigCycleTime" INT 0 0;
BA_DEF_ SG_  "GenSigSendType" ENUM  "Cyclic","OnWrite","vector_leerstring","OnChange","vector_leerstring","IfActive","vector_leerstring","NoSigSendType";
BA_DEF_ SG_  "GenSigStartValue" INT 0 1000000000;
BA_DEF_ SG_  "GenSigTimeoutTime" INT 0 0;
BA_DEF_ SG_  "InvalidValue" STRING ;
BA_DEF_DEF_  "CanTpBs" 255;
BA_DEF_DEF_  "DiagRequest" "No";
BA_DEF_DEF_  "DiagResponse" "No";
BA_DEF_DEF_  "E2EDataId" 0;
BA_DEF_DEF_  "E2EDataLength" 0;
BA_DEF_DEF_  "E2EProfile" "";
BA_DEF_DEF_  "EventRateOfChange" 10000;
BA_DEF_DEF_  "GenMsgCycleTime" 0;
BA_DEF_DEF_  "GenMsgILSupport" "Yes";
BA_DEF_DEF_  "GenMsgNrOfRepetition" 0;
BA_DEF_DEF_  "GenMsgSendType" "NoMsgSendType";
BA_DEF_DEF_  "MessageGateway" "No";
BA_DEF_DEF_  "NetworkInitialization" "Yes";
BA_DEF_DEF_  "SCP_AuthInfoTxLength" 28;
BA_DEF_DEF_  "SCP_DataId" 0;
BA_DEF_DEF_  "SCP_FreshnessValueId" 0;
BA_DEF_DEF_  "SCP_FreshnessValueLength" 48;
BA_DEF_DEF_  "SCP_FreshnessValueTxLength" 4;
BA_DEF_DEF_  "SC_Message" "No";
BA_DEF_DEF_  "VFrameFormat" "StandardCAN_FD";
BA_DEF_DEF_  "GenSigCmt" "";
BA_DEF_DEF_  "GenSigCycleTime" 0;
BA_DEF_DEF_  "GenSigSendType" "NoSigSendType";
BA_DEF_DEF_  "GenSigStartValue" 0;
BA_DEF_DEF_  "GenSigTimeoutTime" 0;
BA_DEF_DEF_  "InvalidValue" "";
BA_ "GenMsgSendType" BO_ 646 1;
BA_ "GenMsgSendType" BO_ 647 1;
BA_ "GenMsgSendType" BO_ 648 1;
BA_ "GenMsgSendType" BO_ 649 1;
BA_ "GenMsgSendType" BO_ 650 1;
BA_ "GenMsgSendType" BO_ 651 1;
BA_ "GenMsgSendType" BO_ 652 1;
BA_ "GenMsgSendType" BO_ 653 1;
BA_ "GenMsgSendType" BO_ 654 1;
BA_ "GenMsgSendType" BO_ 655 1;
BA_ "GenMsgSendType" BO_ 656 1;
BA_ "GenMsgSendType" BO_ 657 1;
BA_ "GenMsgSendType" BO_ 658 1;
BA_ "GenMsgSendType" BO_ 659 1;
BA_ "GenMsgSendType" BO_ 660 1;
BA_ "GenMsgSendType" BO_ 661 1;
BA_ "GenSigStartValue" SG_ 646 DET_RANGE_VELOCITY_025 16384;
BA_ "GenSigStartValue" SG_ 646 DET_RCS_025 128;
BA_ "GenSigStartValue" SG_ 646 DET_RANGE_VELOCITY_026 16384;
BA_ "GenSigStartValue" SG_ 646 DET_RCS_026 128;
BA_ "GenSigStartValue" SG_ 646 DET_RANGE_VELOCITY_027 16384;
BA_ "GenSigStartValue" SG_ 646 DET_RCS_027 128;
BA_ "GenSigStartValue" SG_ 646 DET_RANGE_VELOCITY_028 16384;
BA_ "GenSigStartValue" SG_ 646 DET_RCS_028 128;
BA_ "GenSigStartValue" SG_ 647 DET_RANGE_VELOCITY_029 16384;
BA_ "GenSigStartValue" SG_ 647 DET_RCS_029 128;
BA_ "GenSigStartValue" SG_ 647 DET_RANGE_VELOCITY_030 16384;
BA_ "GenSigStartValue" SG_ 647 DET_RCS_030 128;
BA_ "GenSigStartValue" SG_ 647 DET_RANGE_VELOCITY_031 16384;
BA_ "GenSigStartValue" SG_ 647 DET_RCS_031 128;
BA_ "GenSigStartValue" SG_ 647 DET_RANGE_VELOCITY_032 16384;
BA_ "GenSigStartValue" SG_ 647 DET_RCS_032 128;
BA_ "GenSigStartValue" SG_ 648 DET_RANGE_VELOCITY_033 16384;
BA_ "GenSigStartValue" SG_ 648 DET_RCS_033 128;
BA_ "GenSigStartValue" SG_ 648 DET_RANGE_VELOCITY_034 16384;
BA_ "GenSigStartValue" SG_ 648 DET_RCS_034 128;
BA_ "GenSigStartValue" SG_ 648 DET_RANGE_VELOCITY_035 16384;
BA_ "GenSigStartValue" SG_ 648 DET_RCS_035 128;
BA_ "GenSigStartValue" SG_ 648 DET_RANGE_VELOCITY_036 16384;
BA_ "GenSigStartValue" SG_ 648 DET_RCS_036 128;
BA_ "GenSigStartValue" SG_ 649 DET_RANGE_VELOCITY_037 16384;
BA_ "GenSigStartValue" SG_ 649 DET_RCS_037 128;
BA_ "GenSigStartValue" SG_ 649 DET_RANGE_VELOCITY_038 16384;
BA_ "GenSigStartValue" SG_ 649 DET_RCS_038 128;
BA_ "GenSigStartValue" SG_ 649 DET_RANGE_VELOCITY_039 16384;
BA_ "GenSigStartValue" SG_ 649 DET_RCS_039 128;
BA_ "GenSigStartValue" SG_ 649 DET_RANGE_VELOCITY_040 16384;
BA_ "GenSigStartValue" SG_ 649 DET_RCS_040 128;
BA_ "GenSigStartValue" SG_ 650 DET_RANGE_VELOCITY_041 16384;
BA_ "GenSigStartValue" SG_ 650 DET_RCS_041 128;
BA_ "GenSigStartValue" SG_ 650 DET_RANGE_VELOCITY_042 16384;
BA_ "GenSigStartValue" SG_ 650 DET_RCS_042 128;
BA_ "GenSigStartValue" SG_ 650 DET_RANGE_VELOCITY_043 16384;
BA_ "GenSigStartValue" SG_ 650 DET_RCS_043 128;
BA_ "GenSigStartValue" SG_ 650 DET_RANGE_VELOCITY_044 16384;
BA_ "GenSigStartValue" SG_ 650 DET_RCS_044 128;
BA_ "GenSigStartValue" SG_ 651 DET_RANGE_VELOCITY_045 16384;
BA_ "GenSigStartValue" SG_ 651 DET_RCS_045 128;
BA_ "GenSigStartValue" SG_ 651 DET_RANGE_VELOCITY_046 16384;
BA_ "GenSigStartValue" SG_ 651 DET_RCS_046 128;
BA_ "GenSigStartValue" SG_ 651 DET_RANGE_VELOCITY_047 16384;
BA_ "GenSigStartValue" SG_ 651 DET_RCS_047 128;
BA_ "GenSigStartValue" SG_ 651 DET_RANGE_VELOCITY_048 16384;
BA_ "GenSigStartValue" SG_ 651 DET_RCS_048 128;
BA_ "GenSigStartValue" SG_ 652 DET_RANGE_VELOCITY_049 16384;
BA_ "GenSigStartValue" SG_ 652 DET_RCS_049 128;
BA_ "GenSigStartValue" SG_ 652 DET_RANGE_VELOCITY_050 16384;
BA_ "GenSigStartValue" SG_ 652 DET_RCS_050 128;
BA_ "GenSigStartValue" SG_ 652 DET_RANGE_VELOCITY_051 16384;
BA_ "GenSigStartValue" SG_ 652 DET_RCS_051 128;
BA_ "GenSigStartValue" SG_ 652 DET_RANGE_VELOCITY_052 16384;
BA_ "GenSigStartValue" SG_ 652 DET_RCS_052 128;
BA_ "GenSigStartValue" SG_ 653 DET_RANGE_VELOCITY_053 16384;
BA_ "GenSigStartValue" SG_ 653 DET_RCS_053 128;
BA_ "GenSigStartValue" SG_ 653 DET_RANGE_VELOCITY_054 16384;
BA_ "GenSigStartValue" SG_ 653 DET_RCS_054 128;
BA_ "GenSigStartValue" SG_ 653 DET_RANGE_VELOCITY_055 16384;
BA_ "GenSigStartValue" SG_ 653 DET_RCS_055 128;
BA_ "GenSigStartValue" SG_ 653 DET_RANGE_VELOCITY_056 16384;
BA_ "GenSigStartValue" SG_ 653 DET_RCS_056 128;
BA_ "GenSigStartValue" SG_ 654 DET_RANGE_VELOCITY_057 16384;
BA_ "GenSigStartValue" SG_ 654 DET_RCS_057 128;
BA_ "GenSigStartValue" SG_ 654 DET_RANGE_VELOCITY_058 16384;
BA_ "GenSigStartValue" SG_ 654 DET_RCS_058 128;
BA_ "GenSigStartValue" SG_ 654 DET_RANGE_VELOCITY_059 16384;
BA_ "GenSigStartValue" SG_ 654 DET_RCS_059 128;
BA_ "GenSigStartValue" SG_ 654 DET_RANGE_VELOCITY_060 16384;
BA_ "GenSigStartValue" SG_ 654 DET_RCS_060 128;
BA_ "GenSigStartValue" SG_ 655 DET_RANGE_VELOCITY_061 16384;
BA_ "GenSigStartValue" SG_ 655 DET_RCS_061 128;
BA_ "GenSigStartValue" SG_ 655 DET_RANGE_VELOCITY_062 16384;
BA_ "GenSigStartValue" SG_ 655 DET_RCS_062 128;
BA_ "GenSigStartValue" SG_ 655 DET_RANGE_VELOCITY_063 16384;
BA_ "GenSigStartValue" SG_ 655 DET_RCS_063 128;
BA_ "GenSigStartValue" SG_ 655 DET_RANGE_VELOCITY_064 16384;
BA_ "GenSigStartValue" SG_ 655 DET_RCS_064 128;
BA_ "GenSigStartValue" SG_ 656 DET_RANGE_VELOCITY_065 16384;
BA_ "GenSigStartValue" SG_ 656 DET_RCS_065 128;
BA_ "GenSigStartValue" SG_ 656 DET_RANGE_VELOCITY_066 16384;
BA_ "GenSigStartValue" SG_ 656 DET_RCS_066 128;
BA_ "GenSigStartValue" SG_ 656 DET_RANGE_VELOCITY_067 16384;
BA_ "GenSigStartValue" SG_ 656 DET_RCS_067 128;
BA_ "GenSigStartValue" SG_ 656 DET_RANGE_VELOCITY_068 16384;
BA_ "GenSigStartValue" SG_ 656 DET_RCS_068 128;
BA_ "GenSigStartValue" SG_ 657 DET_RANGE_VELOCITY_069 16384;
BA_ "GenSigStartValue" SG_ 657 DET_RCS_069 128;
BA_ "GenSigStartValue" SG_ 657 DET_RANGE_VELOCITY_070 16384;
BA_ "GenSigStartValue" SG_ 657 DET_RCS_070 128;
BA_ "GenSigStartValue" SG_ 657 DET_RANGE_VELOCITY_071 16384;
BA_ "GenSigStartValue" SG_ 657 DET_RCS_071 128;
BA_ "GenSigStartValue" SG_ 657 DET_RANGE_VELOCITY_072 16384;
BA_ "GenSigStartValue" SG_ 657 DET_RCS_072 128;
BA_ "GenSigStartValue" SG_ 658 DET_RANGE_VELOCITY_073 16384;
BA_ "GenSigStartValue" SG_ 658 DET_RCS_073 128;
BA_ "GenSigStartValue" SG_ 658 DET_RANGE_VELOCITY_074 16384;
BA_ "GenSigStartValue" SG_ 658 DET_RCS_074 128;
BA_ "GenSigStartValue" SG_ 658 DET_RANGE_VELOCITY_075 16384;
BA_ "GenSigStartValue" SG_ 658 DET_RCS_075 128;
BA_ "GenSigStartValue" SG_ 658 DET_RANGE_VELOCITY_076 16384;
BA_ "GenSigStartValue" SG_ 658 DET_RCS_076 128;
BA_ "GenSigStartValue" SG_ 659 DET_RANGE_VELOCITY_077 16384;
BA_ "GenSigStartValue" SG_ 659 DET_RCS_077 128;
BA_ "GenSigStartValue" SG_ 659 DET_RANGE_VELOCITY_078 16384;
BA_ "GenSigStartValue" SG_ 659 DET_RCS_078 128;
BA_ "GenSigStartValue" SG_ 659 DET_RANGE_VELOCITY_079 16384;
BA_ "GenSigStartValue" SG_ 659 DET_RCS_079 128;
BA_ "GenSigStartValue" SG_ 659 DET_RANGE_VELOCITY_080 16384;
BA_ "GenSigStartValue" SG_ 659 DET_RCS_080 128;
BA_ "GenSigStartValue" SG_ 660 DET_RANGE_VELOCITY_081 16384;
BA_ "GenSigStartValue" SG_ 660 DET_RCS_081 128;
BA_ "GenSigStartValue" SG_ 660 DET_RANGE_VELOCITY_082 16384;
BA_ "GenSigStartValue" SG_ 660 DET_RCS_082 128;
BA_ "GenSigStartValue" SG_ 660 DET_RANGE_VELOCITY_083 16384;
BA_ "GenSigStartValue" SG_ 660 DET_RCS_083 128;
BA_ "GenSigStartValue" SG_ 660 DET_RANGE_VELOCITY_084 16384;
BA_ "GenSigStartValue" SG_ 660 DET_RCS_084 128;
BA_ "GenSigStartValue" SG_ 661 DET_RANGE_VELOCITY_085 16384;
BA_ "GenSigStartValue" SG_ 661 DET_RCS_085 128;
BA_ "GenSigStartValue" SG_ 661 DET_RANGE_VELOCITY_086 16384;
BA_ "GenSigStartValue" SG_ 661 DET_RCS_086 128;
BA_ "GenSigStartValue" SG_ 661 DET_RANGE_VELOCITY_087 16384;
BA_ "GenSigStartValue" SG_ 661 DET_RCS_087 128;
BA_ "GenSigStartValue" SG_ 661 DET_RANGE_VELOCITY_088 16384;
BA_ "GenSigStartValue" SG_ 661 DET_RCS_088 128;
VAL_ 646 DET_CONFD_AZIMUTH_025 0 "High" 1 "MidHigh" 2 "MidLow" 3 "Low" ;
VAL_ 646 DET_CONFD_ELEVATION_025 0 "High" 1 "MidHigh" 2 "MidLow" 3 "Low" ;
VAL_ 646 DET_IDM_025 0 "Not_IDM_Output" 1 "IDM_Output" ;
VAL_ 646 DET_MTD_025 0 "Not_MTD_Output" 1 "MTD_Output" ;
VAL_ 646 DET_BELOW_RAIN_THOLD_025 0 "DetBelowRainThold" 1 "DetAboveRainThold" ;
VAL_ 646 DET_CONFD_AZIMUTH_026 0 "High" 1 "MidHigh" 2 "MidLow" 3 "Low" ;
VAL_ 646 DET_CONFD_ELEVATION_026 0 "High" 1 "MidHigh" 2 "MidLow" 3 "Low" ;
VAL_ 646 DET_IDM_026 0 "Not_IDM_Output" 1 "IDM_Output" ;
VAL_ 646 DET_MTD_026 0 "Not_MTD_Output" 1 "MTD_Output" ;
VAL_ 646 DET_BELOW_RAIN_THOLD_026 0 "DetBelowRainThold" 1 "DetAboveRainThold" ;
VAL_ 646 DET_CONFD_AZIMUTH_027 0 "High" 1 "MidHigh" 2 "MidLow" 3 "Low" ;
VAL_ 646 DET_CONFD_ELEVATION_027 0 "High" 1 "MidHigh" 2 "MidLow" 3 "Low" ;
VAL_ 646 DET_IDM_027 0 "Not_IDM_Output" 1 "IDM_Output" ;
VAL_ 646 DET_MTD_027 0 "Not_MTD_Output" 1 "MTD_Output" ;
VAL_ 646 DET_BELOW_RAIN_THOLD_027 0 "DetBelowRainThold" 1 "DetAboveRainThold" ;
VAL_ 646 DET_IDM_028 0 "Not_IDM_Output" 1 "IDM_Output" ;
VAL_ 646 DET_MTD_028 0 "Not_MTD_Output" 1 "MTD_Output" ;
VAL_ 646 DET_BELOW_RAIN_THOLD_028 0 "DetBelowRainThold" 1 "DetAboveRainThold" ;
VAL_ 647 DET_CONFD_AZIMUTH_029 0 "High" 1 "MidHigh" 2 "MidLow" 3 "Low" ;
VAL_ 647 DET_CONFD_ELEVATION_029 0 "High" 1 "MidHigh" 2 "MidLow" 3 "Low" ;
VAL_ 647 DET_IDM_029 0 "Not_IDM_Output" 1 "IDM_Output" ;
VAL_ 647 DET_MTD_029 0 "Not_MTD_Output" 1 "MTD_Output" ;
VAL_ 647 DET_BELOW_RAIN_THOLD_029 0 "DetBelowRainThold" 1 "DetAboveRainThold" ;
VAL_ 647 DET_CONFD_AZIMUTH_030 0 "High" 1 "MidHigh" 2 "MidLow" 3 "Low" ;
VAL_ 647 DET_CONFD_ELEVATION_030 0 "High" 1 "MidHigh" 2 "MidLow" 3 "Low" ;
VAL_ 647 DET_IDM_030 0 "Not_IDM_Output" 1 "IDM_Output" ;
VAL_ 647 DET_MTD_030 0 "Not_MTD_Output" 1 "MTD_Output" ;
VAL_ 647 DET_BELOW_RAIN_THOLD_030 0 "DetBelowRainThold" 1 "DetAboveRainThold" ;
VAL_ 647 DET_CONFD_AZIMUTH_031 0 "High" 1 "MidHigh" 2 "MidLow" 3 "Low" ;
VAL_ 647 DET_CONFD_ELEVATION_031 0 "High" 1 "MidHigh" 2 "MidLow" 3 "Low" ;
VAL_ 647 DET_IDM_031 0 "Not_IDM_Output" 1 "IDM_Output" ;
VAL_ 647 DET_MTD_031 0 "Not_MTD_Output" 1 "MTD_Output" ;
VAL_ 647 DET_BELOW_RAIN_THOLD_031 0 "DetBelowRainThold" 1 "DetAboveRainThold" ;
VAL_ 647 DET_IDM_032 0 "Not_IDM_Output" 1 "IDM_Output" ;
VAL_ 647 DET_MTD_032 0 "Not_MTD_Output" 1 "MTD_Output" ;
VAL_ 647 DET_BELOW_RAIN_THOLD_032 0 "DetBelowRainThold" 1 "DetAboveRainThold" ;
VAL_ 648 DET_CONFD_AZIMUTH_033 0 "High" 1 "MidHigh" 2 "MidLow" 3 "Low" ;
VAL_ 648 DET_CONFD_ELEVATION_033 0 "High" 1 "MidHigh" 2 "MidLow" 3 "Low" ;
VAL_ 648 DET_IDM_033 0 "Not_IDM_Output" 1 "IDM_Output" ;
VAL_ 648 DET_MTD_033 0 "Not_MTD_Output" 1 "MTD_Output" ;
VAL_ 648 DET_BELOW_RAIN_THOLD_033 0 "DetBelowRainThold" 1 "DetAboveRainThold" ;
VAL_ 648 DET_CONFD_AZIMUTH_034 0 "High" 1 "MidHigh" 2 "MidLow" 3 "Low" ;
VAL_ 648 DET_CONFD_ELEVATION_034 0 "High" 1 "MidHigh" 2 "MidLow" 3 "Low" ;
VAL_ 648 DET_IDM_034 0 "Not_IDM_Output" 1 "IDM_Output" ;
VAL_ 648 DET_MTD_034 0 "Not_MTD_Output" 1 "MTD_Output" ;
VAL_ 648 DET_BELOW_RAIN_THOLD_034 0 "DetBelowRainThold" 1 "DetAboveRainThold" ;
VAL_ 648 DET_CONFD_AZIMUTH_035 0 "High" 1 "MidHigh" 2 "MidLow" 3 "Low" ;
VAL_ 648 DET_CONFD_ELEVATION_035 0 "High" 1 "MidHigh" 2 "MidLow" 3 "Low" ;
VAL_ 648 DET_IDM_035 0 "Not_IDM_Output" 1 "IDM_Output" ;
VAL_ 648 DET_MTD_035 0 "Not_MTD_Output" 1 "MTD_Output" ;
VAL_ 648 DET_BELOW_RAIN_THOLD_035 0 "DetBelowRainThold" 1 "DetAboveRainThold" ;
VAL_ 648 DET_IDM_036 0 "Not_IDM_Output" 1 "IDM_Output" ;
VAL_ 648 DET_MTD_036 0 "Not_MTD_Output" 1 "MTD_Output" ;
VAL_ 648 DET_BELOW_RAIN_THOLD_036 0 "DetBelowRainThold" 1 "DetAboveRainThold" ;
VAL_ 649 DET_CONFD_AZIMUTH_037 0 "High" 1 "MidHigh" 2 "MidLow" 3 "Low" ;
VAL_ 649 DET_CONFD_ELEVATION_037 0 "High" 1 "MidHigh" 2 "MidLow" 3 "Low" ;
VAL_ 649 DET_IDM_037 0 "Not_IDM_Output" 1 "IDM_Output" ;
VAL_ 649 DET_MTD_037 0 "Not_MTD_Output" 1 "MTD_Output" ;
VAL_ 649 DET_BELOW_RAIN_THOLD_037 0 "DetBelowRainThold" 1 "DetAboveRainThold" ;
VAL_ 649 DET_CONFD_AZIMUTH_038 0 "High" 1 "MidHigh" 2 "MidLow" 3 "Low" ;
VAL_ 649 DET_CONFD_ELEVATION_038 0 "High" 1 "MidHigh" 2 "MidLow" 3 "Low" ;
VAL_ 649 DET_IDM_038 0 "Not_IDM_Output" 1 "IDM_Output" ;
VAL_ 649 DET_MTD_038 0 "Not_MTD_Output" 1 "MTD_Output" ;
VAL_ 649 DET_BELOW_RAIN_THOLD_038 0 "DetBelowRainThold" 1 "DetAboveRainThold" ;
VAL_ 649 DET_CONFD_AZIMUTH_039 0 "High" 1 "MidHigh" 2 "MidLow" 3 "Low" ;
VAL_ 649 DET_CONFD_ELEVATION_039 0 "High" 1 "MidHigh" 2 "MidLow" 3 "Low" ;
VAL_ 649 DET_IDM_039 0 "Not_IDM_Output" 1 "IDM_Output" ;
VAL_ 649 DET_MTD_039 0 "Not_MTD_Output" 1 "MTD_Output" ;
VAL_ 649 DET_BELOW_RAIN_THOLD_039 0 "DetBelowRainThold" 1 "DetAboveRainThold" ;
VAL_ 649 DET_IDM_040 0 "Not_IDM_Output" 1 "IDM_Output" ;
VAL_ 649 DET_MTD_040 0 "Not_MTD_Output" 1 "MTD_Output" ;
VAL_ 649 DET_BELOW_RAIN_THOLD_040 0 "DetBelowRainThold" 1 "DetAboveRainThold" ;
VAL_ 650 DET_CONFD_AZIMUTH_041 0 "High" 1 "MidHigh" 2 "MidLow" 3 "Low" ;
VAL_ 650 DET_CONFD_ELEVATION_041 0 "High" 1 "MidHigh" 2 "MidLow" 3 "Low" ;
VAL_ 650 DET_IDM_041 0 "Not_IDM_Output" 1 "IDM_Output" ;
VAL_ 650 DET_MTD_041 0 "Not_MTD_Output" 1 "MTD_Output" ;
VAL_ 650 DET_BELOW_RAIN_THOLD_041 0 "DetBelowRainThold" 1 "DetAboveRainThold" ;
VAL_ 650 DET_CONFD_AZIMUTH_042 0 "High" 1 "MidHigh" 2 "MidLow" 3 "Low" ;
VAL_ 650 DET_CONFD_ELEVATION_042 0 "High" 1 "MidHigh" 2 "MidLow" 3 "Low" ;
VAL_ 650 DET_IDM_042 0 "Not_IDM_Output" 1 "IDM_Output" ;
VAL_ 650 DET_MTD_042 0 "Not_MTD_Output" 1 "MTD_Output" ;
VAL_ 650 DET_BELOW_RAIN_THOLD_042 0 "DetBelowRainThold" 1 "DetAboveRainThold" ;
VAL_ 650 DET_CONFD_AZIMUTH_043 0 "High" 1 "MidHigh" 2 "MidLow" 3 "Low" ;
VAL_ 650 DET_CONFD_ELEVATION_043 0 "High" 1 "MidHigh" 2 "MidLow" 3 "Low" ;
VAL_ 650 DET_IDM_043 0 "Not_IDM_Output" 1 "IDM_Output" ;
VAL_ 650 DET_MTD_043 0 "Not_MTD_Output" 1 "MTD_Output" ;
VAL_ 650 DET_BELOW_RAIN_THOLD_043 0 "DetBelowRainThold" 1 "DetAboveRainThold" ;
VAL_ 650 DET_IDM_044 0 "Not_IDM_Output" 1 "IDM_Output" ;
VAL_ 650 DET_MTD_044 0 "Not_MTD_Output" 1 "MTD_Output" ;
VAL_ 650 DET_BELOW_RAIN_THOLD_044 0 "DetBelowRainThold" 1 "DetAboveRainThold" ;
VAL_ 651 DET_CONFD_AZIMUTH_045 0 "High" 1 "MidHigh" 2 "MidLow" 3 "Low" ;
VAL_ 651 DET_CONFD_ELEVATION_045 0 "High" 1 "MidHigh" 2 "MidLow" 3 "Low" ;
VAL_ 651 DET_IDM_045 0 "Not_IDM_Output" 1 "IDM_Output" ;
VAL_ 651 DET_MTD_045 0 "Not_MTD_Output" 1 "MTD_Output" ;
VAL_ 651 DET_BELOW_RAIN_THOLD_045 0 "DetBelowRainThold" 1 "DetAboveRainThold" ;
VAL_ 651 DET_CONFD_AZIMUTH_046 0 "High" 1 "MidHigh" 2 "MidLow" 3 "Low" ;
VAL_ 651 DET_CONFD_ELEVATION_046 0 "High" 1 "MidHigh" 2 "MidLow" 3 "Low" ;
VAL_ 651 DET_IDM_046 0 "Not_IDM_Output" 1 "IDM_Output" ;
VAL_ 651 DET_MTD_046 0 "Not_MTD_Output" 1 "MTD_Output" ;
VAL_ 651 DET_BELOW_RAIN_THOLD_046 0 "DetBelowRainThold" 1 "DetAboveRainThold" ;
VAL_ 651 DET_CONFD_AZIMUTH_047 0 "High" 1 "MidHigh" 2 "MidLow" 3 "Low" ;
VAL_ 651 DET_CONFD_ELEVATION_047 0 "High" 1 "MidHigh" 2 "MidLow" 3 "Low" ;
VAL_ 651 DET_IDM_047 0 "Not_IDM_Output" 1 "IDM_Output" ;
VAL_ 651 DET_MTD_047 0 "Not_MTD_Output" 1 "MTD_Output" ;
VAL_ 651 DET_BELOW_RAIN_THOLD_047 0 "DetBelowRainThold" 1 "DetAboveRainThold" ;
VAL_ 651 DET_IDM_048 0 "Not_IDM_Output" 1 "IDM_Output" ;
VAL_ 651 DET_MTD_048 0 "Not_MTD_Output" 1 "MTD_Output" ;
VAL_ 651 DET_BELOW_RAIN_THOLD_048 0 "DetBelowRainThold" 1 "DetAboveRainThold" ;
VAL_ 652 DET_CONFD_AZIMUTH_049 0 "High" 1 "MidHigh" 2 "MidLow" 3 "Low" ;
VAL_ 652 DET_CONFD_ELEVATION_049 0 "High" 1 "MidHigh" 2 "MidLow" 3 "Low" ;
VAL_ 652 DET_IDM_049 0 "Not_IDM_Output" 1 "IDM_Output" ;
VAL_ 652 DET_MTD_049 0 "Not_MTD_Output" 1 "MTD_Output" ;
VAL_ 652 DET_BELOW_RAIN_THOLD_049 0 "DetBelowRainThold" 1 "DetAboveRainThold" ;
VAL_ 652 DET_CONFD_AZIMUTH_050 0 "High" 1 "MidHigh" 2 "MidLow" 3 "Low" ;
VAL_ 652 DET_CONFD_ELEVATION_050 0 "High" 1 "MidHigh" 2 "MidLow" 3 "Low" ;
VAL_ 652 DET_IDM_050 0 "Not_IDM_Output" 1 "IDM_Output" ;
VAL_ 652 DET_MTD_050 0 "Not_MTD_Output" 1 "MTD_Output" ;
VAL_ 652 DET_BELOW_RAIN_THOLD_050 0 "DetBelowRainThold" 1 "DetAboveRainThold" ;
VAL_ 652 DET_CONFD_AZIMUTH_051 0 "High" 1 "MidHigh" 2 "MidLow" 3 "Low" ;
VAL_ 652 DET_CONFD_ELEVATION_051 0 "High" 1 "MidHigh" 2 "MidLow" 3 "Low" ;
VAL_ 652 DET_IDM_051 0 "Not_IDM_Output" 1 "IDM_Output" ;
VAL_ 652 DET_MTD_051 0 "Not_MTD_Output" 1 "MTD_Output" ;
VAL_ 652 DET_BELOW_RAIN_THOLD_051 0 "DetBelowRainThold" 1 "DetAboveRainThold" ;
VAL_ 652 DET_IDM_052 0 "Not_IDM_Output" 1 "IDM_Output" ;
VAL_ 652 DET_MTD_052 0 "Not_MTD_Output" 1 "MTD_Output" ;
VAL_ 652 DET_BELOW_RAIN_THOLD_052 0 "DetBelowRainThold" 1 "DetAboveRainThold" ;
VAL_ 653 DET_CONFD_AZIMUTH_053 0 "High" 1 "MidHigh" 2 "MidLow" 3 "Low" ;
VAL_ 653 DET_CONFD_ELEVATION_053 0 "High" 1 "MidHigh" 2 "MidLow" 3 "Low" ;
VAL_ 653 DET_IDM_053 0 "Not_IDM_Output" 1 "IDM_Output" ;
VAL_ 653 DET_MTD_053 0 "Not_MTD_Output" 1 "MTD_Output" ;
VAL_ 653 DET_BELOW_RAIN_THOLD_053 0 "DetBelowRainThold" 1 "DetAboveRainThold" ;
VAL_ 653 DET_CONFD_AZIMUTH_054 0 "High" 1 "MidHigh" 2 "MidLow" 3 "Low" ;
VAL_ 653 DET_CONFD_ELEVATION_054 0 "High" 1 "MidHigh" 2 "MidLow" 3 "Low" ;
VAL_ 653 DET_IDM_054 0 "Not_IDM_Output" 1 "IDM_Output" ;
VAL_ 653 DET_MTD_054 0 "Not_MTD_Output" 1 "MTD_Output" ;
VAL_ 653 DET_BELOW_RAIN_THOLD_054 0 "DetBelowRainThold" 1 "DetAboveRainThold" ;
VAL_ 653 DET_CONFD_AZIMUTH_055 0 "High" 1 "MidHigh" 2 "MidLow" 3 "Low" ;
VAL_ 653 DET_CONFD_ELEVATION_055 0 "High" 1 "MidHigh" 2 "MidLow" 3 "Low" ;
VAL_ 653 DET_IDM_055 0 "Not_IDM_Output" 1 "IDM_Output" ;
VAL_ 653 DET_MTD_055 0 "Not_MTD_Output" 1 "MTD_Output" ;
VAL_ 653 DET_BELOW_RAIN_THOLD_055 0 "DetBelowRainThold" 1 "DetAboveRainThold" ;
VAL_ 653 DET_IDM_056 0 "Not_IDM_Output" 1 "IDM_Output" ;
VAL_ 653 DET_MTD_056 0 "Not_MTD_Output" 1 "MTD_Output" ;
VAL_ 653 DET_BELOW_RAIN_THOLD_056 0 "DetBelowRainThold" 1 "DetAboveRainThold" ;
VAL_ 654 DET_CONFD_AZIMUTH_057 0 "High" 1 "MidHigh" 2 "MidLow" 3 "Low" ;
VAL_ 654 DET_CONFD_ELEVATION_057 0 "High" 1 "MidHigh" 2 "MidLow" 3 "Low" ;
VAL_ 654 DET_IDM_057 0 "Not_IDM_Output" 1 "IDM_Output" ;
VAL_ 654 DET_MTD_057 0 "Not_MTD_Output" 1 "MTD_Output" ;
VAL_ 654 DET_BELOW_RAIN_THOLD_057 0 "DetBelowRainThold" 1 "DetAboveRainThold" ;
VAL_ 654 DET_CONFD_AZIMUTH_058 0 "High" 1 "MidHigh" 2 "MidLow" 3 "Low" ;
VAL_ 654 DET_CONFD_ELEVATION_058 0 "High" 1 "MidHigh" 2 "MidLow" 3 "Low" ;
VAL_ 654 DET_IDM_058 0 "Not_IDM_Output" 1 "IDM_Output" ;
VAL_ 654 DET_MTD_058 0 "Not_MTD_Output" 1 "MTD_Output" ;
VAL_ 654 DET_BELOW_RAIN_THOLD_058 0 "DetBelowRainThold" 1 "DetAboveRainThold" ;
VAL_ 654 DET_CONFD_AZIMUTH_059 0 "High" 1 "MidHigh" 2 "MidLow" 3 "Low" ;
VAL_ 654 DET_CONFD_ELEVATION_059 0 "High" 1 "MidHigh" 2 "MidLow" 3 "Low" ;
VAL_ 654 DET_IDM_059 0 "Not_IDM_Output" 1 "IDM_Output" ;
VAL_ 654 DET_MTD_059 0 "Not_MTD_Output" 1 "MTD_Output" ;
VAL_ 654 DET_BELOW_RAIN_THOLD_059 0 "DetBelowRainThold" 1 "DetAboveRainThold" ;
VAL_ 654 DET_IDM_060 0 "Not_IDM_Output" 1 "IDM_Output" ;
VAL_ 654 DET_MTD_060 0 "Not_MTD_Output" 1 "MTD_Output" ;
VAL_ 654 DET_BELOW_RAIN_THOLD_060 0 "DetBelowRainThold" 1 "DetAboveRainThold" ;
VAL_ 655 DET_CONFD_AZIMUTH_061 0 "High" 1 "MidHigh" 2 "MidLow" 3 "Low" ;
VAL_ 655 DET_CONFD_ELEVATION_061 0 "High" 1 "MidHigh" 2 "MidLow" 3 "Low" ;
VAL_ 655 DET_IDM_061 0 "Not_IDM_Output" 1 "IDM_Output" ;
VAL_ 655 DET_MTD_061 0 "Not_MTD_Output" 1 "MTD_Output" ;
VAL_ 655 DET_BELOW_RAIN_THOLD_061 0 "DetBelowRainThold" 1 "DetAboveRainThold" ;
VAL_ 655 DET_CONFD_AZIMUTH_062 0 "High" 1 "MidHigh" 2 "MidLow" 3 "Low" ;
VAL_ 655 DET_CONFD_ELEVATION_062 0 "High" 1 "MidHigh" 2 "MidLow" 3 "Low" ;
VAL_ 655 DET_IDM_062 0 "Not_IDM_Output" 1 "IDM_Output" ;
VAL_ 655 DET_MTD_062 0 "Not_MTD_Output" 1 "MTD_Output" ;
VAL_ 655 DET_BELOW_RAIN_THOLD_062 0 "DetBelowRainThold" 1 "DetAboveRainThold" ;
VAL_ 655 DET_CONFD_AZIMUTH_063 0 "High" 1 "MidHigh" 2 "MidLow" 3 "Low" ;
VAL_ 655 DET_CONFD_ELEVATION_063 0 "High" 1 "MidHigh" 2 "MidLow" 3 "Low" ;
VAL_ 655 DET_IDM_063 0 "Not_IDM_Output" 1 "IDM_Output" ;
VAL_ 655 DET_MTD_063 0 "Not_MTD_Output" 1 "MTD_Output" ;
VAL_ 655 DET_BELOW_RAIN_THOLD_063 0 "DetBelowRainThold" 1 "DetAboveRainThold" ;
VAL_ 655 DET_IDM_064 0 "Not_IDM_Output" 1 "IDM_Output" ;
VAL_ 655 DET_MTD_064 0 "Not_MTD_Output" 1 "MTD_Output" ;
VAL_ 655 DET_BELOW_RAIN_THOLD_064 0 "DetBelowRainThold" 1 "DetAboveRainThold" ;
VAL_ 656 DET_CONFD_AZIMUTH_065 0 "High" 1 "MidHigh" 2 "MidLow" 3 "Low" ;
VAL_ 656 DET_CONFD_ELEVATION_065 0 "High" 1 "MidHigh" 2 "MidLow" 3 "Low" ;
VAL_ 656 DET_IDM_065 0 "Not_IDM_Output" 1 "IDM_Output" ;
VAL_ 656 DET_MTD_065 0 "Not_MTD_Output" 1 "MTD_Output" ;
VAL_ 656 DET_BELOW_RAIN_THOLD_065 0 "DetBelowRainThold" 1 "DetAboveRainThold" ;
VAL_ 656 DET_CONFD_AZIMUTH_066 0 "High" 1 "MidHigh" 2 "MidLow" 3 "Low" ;
VAL_ 656 DET_CONFD_ELEVATION_066 0 "High" 1 "MidHigh" 2 "MidLow" 3 "Low" ;
VAL_ 656 DET_IDM_066 0 "Not_IDM_Output" 1 "IDM_Output" ;
VAL_ 656 DET_MTD_066 0 "Not_MTD_Output" 1 "MTD_Output" ;
VAL_ 656 DET_BELOW_RAIN_THOLD_066 0 "DetBelowRainThold" 1 "DetAboveRainThold" ;
VAL_ 656 DET_CONFD_AZIMUTH_067 0 "High" 1 "MidHigh" 2 "MidLow" 3 "Low" ;
VAL_ 656 DET_CONFD_ELEVATION_067 0 "High" 1 "MidHigh" 2 "MidLow" 3 "Low" ;
VAL_ 656 DET_IDM_067 0 "Not_IDM_Output" 1 "IDM_Output" ;
VAL_ 656 DET_MTD_067 0 "Not_MTD_Output" 1 "MTD_Output" ;
VAL_ 656 DET_BELOW_RAIN_THOLD_067 0 "DetBelowRainThold" 1 "DetAboveRainThold" ;
VAL_ 656 DET_IDM_068 0 "Not_IDM_Output" 1 "IDM_Output" ;
VAL_ 656 DET_MTD_068 0 "Not_MTD_Output" 1 "MTD_Output" ;
VAL_ 656 DET_BELOW_RAIN_THOLD_068 0 "DetBelowRainThold" 1 "DetAboveRainThold" ;
VAL_ 657 DET_CONFD_AZIMUTH_069 0 "High" 1 "MidHigh" 2 "MidLow" 3 "Low" ;
VAL_ 657 DET_CONFD_ELEVATION_069 0 "High" 1 "MidHigh" 2 "MidLow" 3 "Low" ;
VAL_ 657 DET_IDM_069 0 "Not_IDM_Output" 1 "IDM_Output" ;
VAL_ 657 DET_MTD_069 0 "Not_MTD_Output" 1 "MTD_Output" ;
VAL_ 657 DET_BELOW_RAIN_THOLD_069 0 "DetBelowRainThold" 1 "DetAboveRainThold" ;
VAL_ 657 DET_CONFD_AZIMUTH_070 0 "High" 1 "MidHigh" 2 "MidLow" 3 "Low" ;
VAL_ 657 DET_CONFD_ELEVATION_070 0 "High" 1 "MidHigh" 2 "MidLow" 3 "Low" ;
VAL_ 657 DET_IDM_070 0 "Not_IDM_Output" 1 "IDM_Output" ;
VAL_ 657 DET_MTD_070 0 "Not_MTD_Output" 1 "MTD_Output" ;
VAL_ 657 DET_BELOW_RAIN_THOLD_070 0 "DetBelowRainThold" 1 "DetAboveRainThold" ;
VAL_ 657 DET_CONFD_AZIMUTH_071 0 "High" 1 "MidHigh" 2 "MidLow" 3 "Low" ;
VAL_ 657 DET_CONFD_ELEVATION_071 0 "High" 1 "MidHigh" 2 "MidLow" 3 "Low" ;
VAL_ 657 DET_IDM_071 0 "Not_IDM_Output" 1 "IDM_Output" ;
VAL_ 657 DET_MTD_071 0 "Not_MTD_Output" 1 "MTD_Output" ;
VAL_ 657 DET_BELOW_RAIN_THOLD_071 0 "DetBelowRainThold" 1 "DetAboveRainThold" ;
VAL_ 657 DET_IDM_072 0 "Not_IDM_Output" 1 "IDM_Output" ;
VAL_ 657 DET_MTD_072 0 "Not_MTD_Output" 1 "MTD_Output" ;
VAL_ 657 DET_BELOW_RAIN_THOLD_072 0 "DetBelowRainThold" 1 "DetAboveRainThold" ;
VAL_ 658 DET_CONFD_AZIMUTH_073 0 "High" 1 "MidHigh" 2 "MidLow" 3 "Low" ;
VAL_ 658 DET_CONFD_ELEVATION_073 0 "High" 1 "MidHigh" 2 "MidLow" 3 "Low" ;
VAL_ 658 DET_IDM_073 0 "Not_IDM_Output" 1 "IDM_Output" ;
VAL_ 658 DET_MTD_073 0 "Not_MTD_Output" 1 "MTD_Output" ;
VAL_ 658 DET_BELOW_RAIN_THOLD_073 0 "DetBelowRainThold" 1 "DetAboveRainThold" ;
VAL_ 658 DET_CONFD_AZIMUTH_074 0 "High" 1 "MidHigh" 2 "MidLow" 3 "Low" ;
VAL_ 658 DET_CONFD_ELEVATION_074 0 "High" 1 "MidHigh" 2 "MidLow" 3 "Low" ;
VAL_ 658 DET_IDM_074 0 "Not_IDM_Output" 1 "IDM_Output" ;
VAL_ 658 DET_MTD_074 0 "Not_MTD_Output" 1 "MTD_Output" ;
VAL_ 658 DET_BELOW_RAIN_THOLD_074 0 "DetBelowRainThold" 1 "DetAboveRainThold" ;
VAL_ 658 DET_CONFD_AZIMUTH_075 0 "High" 1 "MidHigh" 2 "MidLow" 3 "Low" ;
VAL_ 658 DET_CONFD_ELEVATION_075 0 "High" 1 "MidHigh" 2 "MidLow" 3 "Low" ;
VAL_ 658 DET_IDM_075 0 "Not_IDM_Output" 1 "IDM_Output" ;
VAL_ 658 DET_MTD_075 0 "Not_MTD_Output" 1 "MTD_Output" ;
VAL_ 658 DET_BELOW_RAIN_THOLD_075 0 "DetBelowRainThold" 1 "DetAboveRainThold" ;
VAL_ 658 DET_IDM_076 0 "Not_IDM_Output" 1 "IDM_Output" ;
VAL_ 658 DET_MTD_076 0 "Not_MTD_Output" 1 "MTD_Output" ;
VAL_ 658 DET_BELOW_RAIN_THOLD_076 0 "DetBelowRainThold" 1 "DetAboveRainThold" ;
VAL_ 659 DET_CONFD_AZIMUTH_077 0 "High" 1 "MidHigh" 2 "MidLow" 3 "Low" ;
VAL_ 659 DET_CONFD_ELEVATION_077 0 "High" 1 "MidHigh" 2 "MidLow" 3 "Low" ;
VAL_ 659 DET_IDM_077 0 "Not_IDM_Output" 1 "IDM_Output" ;
VAL_ 659 DET_MTD_077 0 "Not_MTD_Output" 1 "MTD_Output" ;
VAL_ 659 DET_BELOW_RAIN_THOLD_077 0 "DetBelowRainThold" 1 "DetAboveRainThold" ;
VAL_ 659 DET_CONFD_AZIMUTH_078 0 "High" 1 "MidHigh" 2 "MidLow" 3 "Low" ;
VAL_ 659 DET_CONFD_ELEVATION_078 0 "High" 1 "MidHigh" 2 "MidLow" 3 "Low" ;
VAL_ 659 DET_IDM_078 0 "Not_IDM_Output" 1 "IDM_Output" ;
VAL_ 659 DET_MTD_078 0 "Not_MTD_Output" 1 "MTD_Output" ;
VAL_ 659 DET_BELOW_RAIN_THOLD_078 0 "DetBelowRainThold" 1 "DetAboveRainThold" ;
VAL_ 659 DET_CONFD_AZIMUTH_079 0 "High" 1 "MidHigh" 2 "MidLow" 3 "Low" ;
VAL_ 659 DET_CONFD_ELEVATION_079 0 "High" 1 "MidHigh" 2 "MidLow" 3 "Low" ;
VAL_ 659 DET_IDM_079 0 "Not_IDM_Output" 1 "IDM_Output" ;
VAL_ 659 DET_MTD_079 0 "Not_MTD_Output" 1 "MTD_Output" ;
VAL_ 659 DET_BELOW_RAIN_THOLD_079 0 "DetBelowRainThold" 1 "DetAboveRainThold" ;
VAL_ 659 DET_IDM_080 0 "Not_IDM_Output" 1 "IDM_Output" ;
VAL_ 659 DET_MTD_080 0 "Not_MTD_Output" 1 "MTD_Output" ;
VAL_ 659 DET_BELOW_RAIN_THOLD_080 0 "DetBelowRainThold" 1 "DetAboveRainThold" ;
VAL_ 660 DET_CONFD_AZIMUTH_081 0 "High" 1 "MidHigh" 2 "MidLow" 3 "Low" ;
VAL_ 660 DET_CONFD_ELEVATION_081 0 "High" 1 "MidHigh" 2 "MidLow" 3 "Low" ;
VAL_ 660 DET_IDM_081 0 "Not_IDM_Output" 1 "IDM_Output" ;
VAL_ 660 DET_MTD_081 0 "Not_MTD_Output" 1 "MTD_Output" ;
VAL_ 660 DET_BELOW_RAIN_THOLD_081 0 "DetBelowRainThold" 1 "DetAboveRainThold" ;
VAL_ 660 DET_CONFD_AZIMUTH_082 0 "High" 1 "MidHigh" 2 "MidLow" 3 "Low" ;
VAL_ 660 DET_CONFD_ELEVATION_082 0 "High" 1 "MidHigh" 2 "MidLow" 3 "Low" ;
VAL_ 660 DET_IDM_082 0 "Not_IDM_Output" 1 "IDM_Output" ;
VAL_ 660 DET_MTD_082 0 "Not_MTD_Output" 1 "MTD_Output" ;
VAL_ 660 DET_BELOW_RAIN_THOLD_082 0 "DetBelowRainThold" 1 "DetAboveRainThold" ;
VAL_ 660 DET_CONFD_AZIMUTH_083 0 "High" 1 "MidHigh" 2 "MidLow" 3 "Low" ;
VAL_ 660 DET_CONFD_ELEVATION_083 0 "High" 1 "MidHigh" 2 "MidLow" 3 "Low" ;
VAL_ 660 DET_IDM_083 0 "Not_IDM_Output" 1 "IDM_Output" ;
VAL_ 660 DET_MTD_083 0 "Not_MTD_Output" 1 "MTD_Output" ;
VAL_ 660 DET_BELOW_RAIN_THOLD_083 0 "DetBelowRainThold" 1 "DetAboveRainThold" ;
VAL_ 660 DET_IDM_084 0 "Not_IDM_Output" 1 "IDM_Output" ;
VAL_ 660 DET_MTD_084 0 "Not_MTD_Output" 1 "MTD_Output" ;
VAL_ 660 DET_BELOW_RAIN_THOLD_084 0 "DetBelowRainThold" 1 "DetAboveRainThold" ;
VAL_ 661 DET_CONFD_AZIMUTH_085 0 "High" 1 "MidHigh" 2 "MidLow" 3 "Low" ;
VAL_ 661 DET_CONFD_ELEVATION_085 0 "High" 1 "MidHigh" 2 "MidLow" 3 "Low" ;
VAL_ 661 DET_IDM_085 0 "Not_IDM_Output" 1 "IDM_Output" ;
VAL_ 661 DET_MTD_085 0 "Not_MTD_Output" 1 "MTD_Output" ;
VAL_ 661 DET_BELOW_RAIN_THOLD_085 0 "DetBelowRainThold" 1 "DetAboveRainThold" ;
VAL_ 661 DET_CONFD_AZIMUTH_086 0 "High" 1 "MidHigh" 2 "MidLow" 3 "Low" ;
VAL_ 661 DET_CONFD_ELEVATION_086 0 "High" 1 "MidHigh" 2 "MidLow" 3 "Low" ;
VAL_ 661 DET_IDM_086 0 "Not_IDM_Output" 1 "IDM_Output" ;
VAL_ 661 DET_MTD_086 0 "Not_MTD_Output" 1 "MTD_Output" ;
VAL_ 661 DET_BELOW_RAIN_THOLD_086 0 "DetBelowRainThold" 1 "DetAboveRainThold" ;
VAL_ 661 DET_CONFD_AZIMUTH_087 0 "High" 1 "MidHigh" 2 "MidLow" 3 "Low" ;
VAL_ 661 DET_CONFD_ELEVATION_087 0 "High" 1 "MidHigh" 2 "MidLow" 3 "Low" ;
VAL_ 661 DET_IDM_087 0 "Not_IDM_Output" 1 "IDM_Output" ;
VAL_ 661 DET_MTD_087 0 "Not_MTD_Output" 1 "MTD_Output" ;
VAL_ 661 DET_BELOW_RAIN_THOLD_087 0 "DetBelowRainThold" 1 "DetAboveRainThold" ;
VAL_ 661 DET_IDM_088 0 "Not_IDM_Output" 1 "IDM_Output" ;
VAL_ 661 DET_MTD_088 0 "Not_MTD_Output" 1 "MTD_Output" ;
VAL_ 661 DET_BELOW_RAIN_THOLD_088 0 "DetBelowRainThold" 1 "DetAboveRainThold" ;
SIG_GROUP_ 646 SRR_FL_Detections_025_028 1 : DET_PROB_1STAZHYPO_025 DET_PROB_1STAZHYPO_026 DET_PROB_1STAZHYPO_027 DET_PROB_1STAZHYPO_028 DET_IDM_025 DET_IDM_026 DET_IDM_027 DET_IDM_028 DET_MTD_028 DET_MTD_027 DET_MTD_026 DET_MTD_025 DET_BELOW_RAIN_THOLD_028 DET_BELOW_RAIN_THOLD_027 DET_BELOW_RAIN_THOLD_026 DET_BELOW_RAIN_THOLD_025 DET_MH_CRC16_025_028 DET_MH_CYCLE_COUNTER_025_028 DET_MH_SCAN_INDEX_4LSB_025_028 DET_CONFD_ELEVATION_025 DET_CONFD_AZIMUTH_025 DET_HVC_FLAG_025 DET_EXISTENCE_PROB_025 DET_SNR_025 DET_SUPER_RES_TARGET_025 DET_BI_STATIC_FLAG_025 DET_RCS_025 DET_ELEVATION_ERR_025 DET_ELEVATION_025 DET_AZIMUTH_ERR_025 DET_AZIMUTH_025 DET_RANGE_VELOCITY_ERR_025 DET_RANGE_VELOCITY_025 DET_RANGE_ERR_025 DET_RANGE_025 DET_CONFD_ELEVATION_026 DET_CONFD_AZIMUTH_026 DET_HVC_FLAG_026 DET_EXISTENCE_PROB_026 DET_SNR_026 DET_SUPER_RES_TARGET_026 DET_BI_STATIC_FLAG_026 DET_RCS_026 DET_ELEVATION_ERR_026 DET_ELEVATION_026 DET_AZIMUTH_ERR_026 DET_AZIMUTH_026 DET_RANGE_VELOCITY_ERR_026 DET_RANGE_VELOCITY_026 DET_RANGE_ERR_026 DET_RANGE_026 DET_CONFD_ELEVATION_027 DET_CONFD_AZIMUTH_027 DET_HVC_FLAG_027 DET_EXISTENCE_PROB_027 DET_SNR_027 DET_SUPER_RES_TARGET_027 DET_BI_STATIC_FLAG_027 DET_RCS_027 DET_ELEVATION_ERR_027 DET_ELEVATION_027 DET_AZIMUTH_ERR_027 DET_AZIMUTH_027 DET_RANGE_VELOCITY_ERR_027 DET_RANGE_VELOCITY_027 DET_RANGE_ERR_027 DET_RANGE_027 DET_CONFD_ELEVATION_028 DET_CONFD_AZIMUTH_028 DET_HVC_FLAG_028 DET_EXISTENCE_PROB_028 DET_SNR_028 DET_SUPER_RES_TARGET_028 DET_BI_STATIC_FLAG_028 DET_RCS_028 DET_ELEVATION_ERR_028 DET_ELEVATION_028 DET_AZIMUTH_ERR_028 DET_AZIMUTH_028 DET_RANGE_VELOCITY_ERR_028 DET_RANGE_VELOCITY_028 DET_RANGE_ERR_028 DET_RANGE_028;
SIG_GROUP_ 647 SRR_FL_Detections_029_032 1 : DET_PROB_1STAZHYPO_029 DET_PROB_1STAZHYPO_030 DET_PROB_1STAZHYPO_031 DET_PROB_1STAZHYPO_032 DET_IDM_029 DET_IDM_030 DET_IDM_031 DET_IDM_032 DET_MTD_032 DET_MTD_031 DET_MTD_030 DET_MTD_029 DET_BELOW_RAIN_THOLD_032 DET_BELOW_RAIN_THOLD_031 DET_BELOW_RAIN_THOLD_030 DET_BELOW_RAIN_THOLD_029 DET_MH_CRC16_029_032 DET_MH_CYCLE_COUNTER_029_032 DET_MH_SCAN_INDEX_4LSB_029_032 DET_CONFD_ELEVATION_029 DET_CONFD_AZIMUTH_029 DET_HVC_FLAG_029 DET_EXISTENCE_PROB_029 DET_SNR_029 DET_SUPER_RES_TARGET_029 DET_BI_STATIC_FLAG_029 DET_RCS_029 DET_ELEVATION_ERR_029 DET_ELEVATION_029 DET_AZIMUTH_ERR_029 DET_AZIMUTH_029 DET_RANGE_VELOCITY_ERR_029 DET_RANGE_VELOCITY_029 DET_RANGE_ERR_029 DET_RANGE_029 DET_CONFD_ELEVATION_030 DET_CONFD_AZIMUTH_030 DET_HVC_FLAG_030 DET_EXISTENCE_PROB_030 DET_SNR_030 DET_SUPER_RES_TARGET_030 DET_BI_STATIC_FLAG_030 DET_RCS_030 DET_ELEVATION_ERR_030 DET_ELEVATION_030 DET_AZIMUTH_ERR_030 DET_AZIMUTH_030 DET_RANGE_VELOCITY_ERR_030 DET_RANGE_VELOCITY_030 DET_RANGE_ERR_030 DET_RANGE_030 DET_CONFD_ELEVATION_031 DET_CONFD_AZIMUTH_031 DET_HVC_FLAG_031 DET_EXISTENCE_PROB_031 DET_SNR_031 DET_SUPER_RES_TARGET_031 DET_BI_STATIC_FLAG_031 DET_RCS_031 DET_ELEVATION_ERR_031 DET_ELEVATION_031 DET_AZIMUTH_ERR_031 DET_AZIMUTH_031 DET_RANGE_VELOCITY_ERR_031 DET_RANGE_VELOCITY_031 DET_RANGE_ERR_031 DET_RANGE_031 DET_CONFD_ELEVATION_032 DET_CONFD_AZIMUTH_032 DET_HVC_FLAG_032 DET_EXISTENCE_PROB_032 DET_SNR_032 DET_SUPER_RES_TARGET_032 DET_BI_STATIC_FLAG_032 DET_RCS_032 DET_ELEVATION_ERR_032 DET_ELEVATION_032 DET_AZIMUTH_ERR_032 DET_AZIMUTH_032 DET_RANGE_VELOCITY_ERR_032 DET_RANGE_VELOCITY_032 DET_RANGE_ERR_032 DET_RANGE_032;
SIG_GROUP_ 648 SRR_FL_Detections_033_036 1 : DET_PROB_1STAZHYPO_033 DET_PROB_1STAZHYPO_034 DET_PROB_1STAZHYPO_035 DET_PROB_1STAZHYPO_036 DET_IDM_033 DET_IDM_034 DET_IDM_035 DET_IDM_036 DET_MTD_036 DET_MTD_035 DET_MTD_034 DET_MTD_033 DET_BELOW_RAIN_THOLD_036 DET_BELOW_RAIN_THOLD_035 DET_BELOW_RAIN_THOLD_034 DET_BELOW_RAIN_THOLD_033 DET_MH_CRC16_033_036 DET_MH_CYCLE_COUNTER_033_036 DET_MH_SCAN_INDEX_4LSB_033_036 DET_CONFD_ELEVATION_033 DET_CONFD_AZIMUTH_033 DET_HVC_FLAG_033 DET_EXISTENCE_PROB_033 DET_SNR_033 DET_SUPER_RES_TARGET_033 DET_BI_STATIC_FLAG_033 DET_RCS_033 DET_ELEVATION_ERR_033 DET_ELEVATION_033 DET_AZIMUTH_ERR_033 DET_AZIMUTH_033 DET_RANGE_VELOCITY_ERR_033 DET_RANGE_VELOCITY_033 DET_RANGE_ERR_033 DET_RANGE_033 DET_CONFD_ELEVATION_034 DET_CONFD_AZIMUTH_034 DET_HVC_FLAG_034 DET_EXISTENCE_PROB_034 DET_SNR_034 DET_SUPER_RES_TARGET_034 DET_BI_STATIC_FLAG_034 DET_RCS_034 DET_ELEVATION_ERR_034 DET_ELEVATION_034 DET_AZIMUTH_ERR_034 DET_AZIMUTH_034 DET_RANGE_VELOCITY_ERR_034 DET_RANGE_VELOCITY_034 DET_RANGE_ERR_034 DET_RANGE_034 DET_CONFD_ELEVATION_035 DET_CONFD_AZIMUTH_035 DET_HVC_FLAG_035 DET_EXISTENCE_PROB_035 DET_SNR_035 DET_SUPER_RES_TARGET_035 DET_BI_STATIC_FLAG_035 DET_RCS_035 DET_ELEVATION_ERR_035 DET_ELEVATION_035 DET_AZIMUTH_ERR_035 DET_AZIMUTH_035 DET_RANGE_VELOCITY_ERR_035 DET_RANGE_VELOCITY_035 DET_RANGE_ERR_035 DET_RANGE_035 DET_CONFD_ELEVATION_036 DET_CONFD_AZIMUTH_036 DET_HVC_FLAG_036 DET_EXISTENCE_PROB_036 DET_SNR_036 DET_SUPER_RES_TARGET_036 DET_BI_STATIC_FLAG_036 DET_RCS_036 DET_ELEVATION_ERR_036 DET_ELEVATION_036 DET_AZIMUTH_ERR_036 DET_AZIMUTH_036 DET_RANGE_VELOCITY_ERR_036 DET_RANGE_VELOCITY_036 DET_RANGE_ERR_036 DET_RANGE_036;
SIG_GROUP_ 649 SRR_FL_Detections_037_040 1 : DET_PROB_1STAZHYPO_037 DET_PROB_1STAZHYPO_038 DET_PROB_1STAZHYPO_039 DET_PROB_1STAZHYPO_040 DET_IDM_037 DET_IDM_038 DET_IDM_039 DET_IDM_040 DET_MTD_040 DET_MTD_039 DET_MTD_038 DET_MTD_037 DET_BELOW_RAIN_THOLD_040 DET_BELOW_RAIN_THOLD_039 DET_BELOW_RAIN_THOLD_038 DET_BELOW_RAIN_THOLD_037 DET_MH_CRC16_037_040 DET_MH_CYCLE_COUNTER_037_040 DET_MH_SCAN_INDEX_4LSB_037_040 DET_CONFD_ELEVATION_037 DET_CONFD_AZIMUTH_037 DET_HVC_FLAG_037 DET_EXISTENCE_PROB_037 DET_SNR_037 DET_SUPER_RES_TARGET_037 DET_BI_STATIC_FLAG_037 DET_RCS_037 DET_ELEVATION_ERR_037 DET_ELEVATION_037 DET_AZIMUTH_ERR_037 DET_AZIMUTH_037 DET_RANGE_VELOCITY_ERR_037 DET_RANGE_VELOCITY_037 DET_RANGE_ERR_037 DET_RANGE_037 DET_CONFD_ELEVATION_038 DET_CONFD_AZIMUTH_038 DET_HVC_FLAG_038 DET_EXISTENCE_PROB_038 DET_SNR_038 DET_SUPER_RES_TARGET_038 DET_BI_STATIC_FLAG_038 DET_RCS_038 DET_ELEVATION_ERR_038 DET_ELEVATION_038 DET_AZIMUTH_ERR_038 DET_AZIMUTH_038 DET_RANGE_VELOCITY_ERR_038 DET_RANGE_VELOCITY_038 DET_RANGE_ERR_038 DET_RANGE_038 DET_CONFD_ELEVATION_039 DET_CONFD_AZIMUTH_039 DET_HVC_FLAG_039 DET_EXISTENCE_PROB_039 DET_SNR_039 DET_SUPER_RES_TARGET_039 DET_BI_STATIC_FLAG_039 DET_RCS_039 DET_ELEVATION_ERR_039 DET_ELEVATION_039 DET_AZIMUTH_ERR_039 DET_AZIMUTH_039 DET_RANGE_VELOCITY_ERR_039 DET_RANGE_VELOCITY_039 DET_RANGE_ERR_039 DET_RANGE_039 DET_CONFD_ELEVATION_040 DET_CONFD_AZIMUTH_040 DET_HVC_FLAG_040 DET_EXISTENCE_PROB_040 DET_SNR_040 DET_SUPER_RES_TARGET_040 DET_BI_STATIC_FLAG_040 DET_RCS_040 DET_ELEVATION_ERR_040 DET_ELEVATION_040 DET_AZIMUTH_ERR_040 DET_AZIMUTH_040 DET_RANGE_VELOCITY_ERR_040 DET_RANGE_VELOCITY_040 DET_RANGE_ERR_040 DET_RANGE_040;
SIG_GROUP_ 650 SRR_FL_Detections_041_044 1 : DET_PROB_1STAZHYPO_041 DET_PROB_1STAZHYPO_042 DET_PROB_1STAZHYPO_043 DET_PROB_1STAZHYPO_044 DET_IDM_041 DET_IDM_042 DET_IDM_043 DET_IDM_044 DET_MTD_044 DET_MTD_043 DET_MTD_042 DET_MTD_041 DET_BELOW_RAIN_THOLD_044 DET_BELOW_RAIN_THOLD_043 DET_BELOW_RAIN_THOLD_042 DET_BELOW_RAIN_THOLD_041 DET_MH_CRC16_041_044 DET_MH_CYCLE_COUNTER_041_044 DET_MH_SCAN_INDEX_4LSB_041_044 DET_CONFD_ELEVATION_041 DET_CONFD_AZIMUTH_041 DET_HVC_FLAG_041 DET_EXISTENCE_PROB_041 DET_SNR_041 DET_SUPER_RES_TARGET_041 DET_BI_STATIC_FLAG_041 DET_RCS_041 DET_ELEVATION_ERR_041 DET_ELEVATION_041 DET_AZIMUTH_ERR_041 DET_AZIMUTH_041 DET_RANGE_VELOCITY_ERR_041 DET_RANGE_VELOCITY_041 DET_RANGE_ERR_041 DET_RANGE_041 DET_CONFD_ELEVATION_042 DET_CONFD_AZIMUTH_042 DET_HVC_FLAG_042 DET_EXISTENCE_PROB_042 DET_SNR_042 DET_SUPER_RES_TARGET_042 DET_BI_STATIC_FLAG_042 DET_RCS_042 DET_ELEVATION_ERR_042 DET_ELEVATION_042 DET_AZIMUTH_ERR_042 DET_AZIMUTH_042 DET_RANGE_VELOCITY_ERR_042 DET_RANGE_VELOCITY_042 DET_RANGE_ERR_042 DET_RANGE_042 DET_CONFD_ELEVATION_043 DET_CONFD_AZIMUTH_043 DET_HVC_FLAG_043 DET_EXISTENCE_PROB_043 DET_SNR_043 DET_SUPER_RES_TARGET_043 DET_BI_STATIC_FLAG_043 DET_RCS_043 DET_ELEVATION_ERR_043 DET_ELEVATION_043 DET_AZIMUTH_ERR_043 DET_AZIMUTH_043 DET_RANGE_VELOCITY_ERR_043 DET_RANGE_VELOCITY_043 DET_RANGE_ERR_043 DET_RANGE_043 DET_CONFD_ELEVATION_044 DET_CONFD_AZIMUTH_044 DET_HVC_FLAG_044 DET_EXISTENCE_PROB_044 DET_SNR_044 DET_SUPER_RES_TARGET_044 DET_BI_STATIC_FLAG_044 DET_RCS_044 DET_ELEVATION_ERR_044 DET_ELEVATION_044 DET_AZIMUTH_ERR_044 DET_AZIMUTH_044 DET_RANGE_VELOCITY_ERR_044 DET_RANGE_VELOCITY_044 DET_RANGE_ERR_044 DET_RANGE_044;
SIG_GROUP_ 651 SRR_FL_Detections_045_048 1 : DET_PROB_1STAZHYPO_045 DET_PROB_1STAZHYPO_046 DET_PROB_1STAZHYPO_047 DET_PROB_1STAZHYPO_048 DET_IDM_045 DET_IDM_046 DET_IDM_047 DET_IDM_048 DET_MTD_048 DET_MTD_047 DET_MTD_046 DET_MTD_045 DET_BELOW_RAIN_THOLD_048 DET_BELOW_RAIN_THOLD_047 DET_BELOW_RAIN_THOLD_046 DET_BELOW_RAIN_THOLD_045 DET_MH_CRC16_045_048 DET_MH_CYCLE_COUNTER_045_048 DET_MH_SCAN_INDEX_4LSB_045_048 DET_CONFD_ELEVATION_045 DET_CONFD_AZIMUTH_045 DET_HVC_FLAG_045 DET_EXISTENCE_PROB_045 DET_SNR_045 DET_SUPER_RES_TARGET_045 DET_BI_STATIC_FLAG_045 DET_RCS_045 DET_ELEVATION_ERR_045 DET_ELEVATION_045 DET_AZIMUTH_ERR_045 DET_AZIMUTH_045 DET_RANGE_VELOCITY_ERR_045 DET_RANGE_VELOCITY_045 DET_RANGE_ERR_045 DET_RANGE_045 DET_CONFD_ELEVATION_046 DET_CONFD_AZIMUTH_046 DET_HVC_FLAG_046 DET_EXISTENCE_PROB_046 DET_SNR_046 DET_SUPER_RES_TARGET_046 DET_BI_STATIC_FLAG_046 DET_RCS_046 DET_ELEVATION_ERR_046 DET_ELEVATION_046 DET_AZIMUTH_ERR_046 DET_AZIMUTH_046 DET_RANGE_VELOCITY_ERR_046 DET_RANGE_VELOCITY_046 DET_RANGE_ERR_046 DET_RANGE_046 DET_CONFD_ELEVATION_047 DET_CONFD_AZIMUTH_047 DET_HVC_FLAG_047 DET_EXISTENCE_PROB_047 DET_SNR_047 DET_SUPER_RES_TARGET_047 DET_BI_STATIC_FLAG_047 DET_RCS_047 DET_ELEVATION_ERR_047 DET_ELEVATION_047 DET_AZIMUTH_ERR_047 DET_AZIMUTH_047 DET_RANGE_VELOCITY_ERR_047 DET_RANGE_VELOCITY_047 DET_RANGE_ERR_047 DET_RANGE_047 DET_CONFD_ELEVATION_048 DET_CONFD_AZIMUTH_048 DET_HVC_FLAG_048 DET_EXISTENCE_PROB_048 DET_SNR_048 DET_SUPER_RES_TARGET_048 DET_BI_STATIC_FLAG_048 DET_RCS_048 DET_ELEVATION_ERR_048 DET_ELEVATION_048 DET_AZIMUTH_ERR_048 DET_AZIMUTH_048 DET_RANGE_VELOCITY_ERR_048 DET_RANGE_VELOCITY_048 DET_RANGE_ERR_048 DET_RANGE_048;
SIG_GROUP_ 652 SRR_FL_Detections_049_052 1 : DET_PROB_1STAZHYPO_049 DET_PROB_1STAZHYPO_050 DET_PROB_1STAZHYPO_051 DET_PROB_1STAZHYPO_052 DET_IDM_049 DET_IDM_050 DET_IDM_051 DET_IDM_052 DET_MTD_052 DET_MTD_051 DET_MTD_050 DET_MTD_049 DET_BELOW_RAIN_THOLD_052 DET_BELOW_RAIN_THOLD_051 DET_BELOW_RAIN_THOLD_050 DET_BELOW_RAIN_THOLD_049 DET_MH_CRC16_049_052 DET_MH_CYCLE_COUNTER_049_052 DET_MH_SCAN_INDEX_4LSB_049_052 DET_CONFD_ELEVATION_049 DET_CONFD_AZIMUTH_049 DET_HVC_FLAG_049 DET_EXISTENCE_PROB_049 DET_SNR_049 DET_SUPER_RES_TARGET_049 DET_BI_STATIC_FLAG_049 DET_RCS_049 DET_ELEVATION_ERR_049 DET_ELEVATION_049 DET_AZIMUTH_ERR_049 DET_AZIMUTH_049 DET_RANGE_VELOCITY_ERR_049 DET_RANGE_VELOCITY_049 DET_RANGE_ERR_049 DET_RANGE_049 DET_CONFD_ELEVATION_050 DET_CONFD_AZIMUTH_050 DET_HVC_FLAG_050 DET_EXISTENCE_PROB_050 DET_SNR_050 DET_SUPER_RES_TARGET_050 DET_BI_STATIC_FLAG_050 DET_RCS_050 DET_ELEVATION_ERR_050 DET_ELEVATION_050 DET_AZIMUTH_ERR_050 DET_AZIMUTH_050 DET_RANGE_VELOCITY_ERR_050 DET_RANGE_VELOCITY_050 DET_RANGE_ERR_050 DET_RANGE_050 DET_CONFD_ELEVATION_051 DET_CONFD_AZIMUTH_051 DET_HVC_FLAG_051 DET_EXISTENCE_PROB_051 DET_SNR_051 DET_SUPER_RES_TARGET_051 DET_BI_STATIC_FLAG_051 DET_RCS_051 DET_ELEVATION_ERR_051 DET_ELEVATION_051 DET_AZIMUTH_ERR_051 DET_AZIMUTH_051 DET_RANGE_VELOCITY_ERR_051 DET_RANGE_VELOCITY_051 DET_RANGE_ERR_051 DET_RANGE_051 DET_CONFD_ELEVATION_052 DET_CONFD_AZIMUTH_052 DET_HVC_FLAG_052 DET_EXISTENCE_PROB_052 DET_SNR_052 DET_SUPER_RES_TARGET_052 DET_BI_STATIC_FLAG_052 DET_RCS_052 DET_ELEVATION_ERR_052 DET_ELEVATION_052 DET_AZIMUTH_ERR_052 DET_AZIMUTH_052 DET_RANGE_VELOCITY_ERR_052 DET_RANGE_VELOCITY_052 DET_RANGE_ERR_052 DET_RANGE_052;
SIG_GROUP_ 653 SRR_FL_Detections_053_056 1 : DET_PROB_1STAZHYPO_053 DET_PROB_1STAZHYPO_054 DET_PROB_1STAZHYPO_055 DET_PROB_1STAZHYPO_056 DET_IDM_053 DET_IDM_054 DET_IDM_055 DET_IDM_056 DET_MTD_056 DET_MTD_055 DET_MTD_054 DET_MTD_053 DET_BELOW_RAIN_THOLD_056 DET_BELOW_RAIN_THOLD_055 DET_BELOW_RAIN_THOLD_054 DET_BELOW_RAIN_THOLD_053 DET_MH_CRC16_053_056 DET_MH_CYCLE_COUNTER_053_056 DET_MH_SCAN_INDEX_4LSB_053_056 DET_CONFD_ELEVATION_053 DET_CONFD_AZIMUTH_053 DET_HVC_FLAG_053 DET_EXISTENCE_PROB_053 DET_SNR_053 DET_SUPER_RES_TARGET_053 DET_BI_STATIC_FLAG_053 DET_RCS_053 DET_ELEVATION_ERR_053 DET_ELEVATION_053 DET_AZIMUTH_ERR_053 DET_AZIMUTH_053 DET_RANGE_VELOCITY_ERR_053 DET_RANGE_VELOCITY_053 DET_RANGE_ERR_053 DET_RANGE_053 DET_CONFD_ELEVATION_054 DET_CONFD_AZIMUTH_054 DET_HVC_FLAG_054 DET_EXISTENCE_PROB_054 DET_SNR_054 DET_SUPER_RES_TARGET_054 DET_BI_STATIC_FLAG_054 DET_RCS_054 DET_ELEVATION_ERR_054 DET_ELEVATION_054 DET_AZIMUTH_ERR_054 DET_AZIMUTH_054 DET_RANGE_VELOCITY_ERR_054 DET_RANGE_VELOCITY_054 DET_RANGE_ERR_054 DET_RANGE_054 DET_CONFD_ELEVATION_055 DET_CONFD_AZIMUTH_055 DET_HVC_FLAG_055 DET_EXISTENCE_PROB_055 DET_SNR_055 DET_SUPER_RES_TARGET_055 DET_BI_STATIC_FLAG_055 DET_RCS_055 DET_ELEVATION_ERR_055 DET_ELEVATION_055 DET_AZIMUTH_ERR_055 DET_AZIMUTH_055 DET_RANGE_VELOCITY_ERR_055 DET_RANGE_VELOCITY_055 DET_RANGE_ERR_055 DET_RANGE_055 DET_CONFD_ELEVATION_056 DET_CONFD_AZIMUTH_056 DET_HVC_FLAG_056 DET_EXISTENCE_PROB_056 DET_SNR_056 DET_SUPER_RES_TARGET_056 DET_BI_STATIC_FLAG_056 DET_RCS_056 DET_ELEVATION_ERR_056 DET_ELEVATION_056 DET_AZIMUTH_ERR_056 DET_AZIMUTH_056 DET_RANGE_VELOCITY_ERR_056 DET_RANGE_VELOCITY_056 DET_RANGE_ERR_056 DET_RANGE_056;
SIG_GROUP_ 654 SRR_FL_Detections_057_060 1 : DET_PROB_1STAZHYPO_057 DET_PROB_1STAZHYPO_058 DET_PROB_1STAZHYPO_059 DET_PROB_1STAZHYPO_060 DET_IDM_057 DET_IDM_058 DET_IDM_059 DET_IDM_060 DET_MTD_060 DET_MTD_059 DET_MTD_058 DET_MTD_057 DET_BELOW_RAIN_THOLD_060 DET_BELOW_RAIN_THOLD_059 DET_BELOW_RAIN_THOLD_058 DET_BELOW_RAIN_THOLD_057 DET_MH_CRC16_057_060 DET_MH_CYCLE_COUNTER_057_060 DET_MH_SCAN_INDEX_4LSB_057_060 DET_CONFD_ELEVATION_057 DET_CONFD_AZIMUTH_057 DET_HVC_FLAG_057 DET_EXISTENCE_PROB_057 DET_SNR_057 DET_SUPER_RES_TARGET_057 DET_BI_STATIC_FLAG_057 DET_RCS_057 DET_ELEVATION_ERR_057 DET_ELEVATION_057 DET_AZIMUTH_ERR_057 DET_AZIMUTH_057 DET_RANGE_VELOCITY_ERR_057 DET_RANGE_VELOCITY_057 DET_RANGE_ERR_057 DET_RANGE_057 DET_CONFD_ELEVATION_058 DET_CONFD_AZIMUTH_058 DET_HVC_FLAG_058 DET_EXISTENCE_PROB_058 DET_SNR_058 DET_SUPER_RES_TARGET_058 DET_BI_STATIC_FLAG_058 DET_RCS_058 DET_ELEVATION_ERR_058 DET_ELEVATION_058 DET_AZIMUTH_ERR_058 DET_AZIMUTH_058 DET_RANGE_VELOCITY_ERR_058 DET_RANGE_VELOCITY_058 DET_RANGE_ERR_058 DET_RANGE_058 DET_CONFD_ELEVATION_059 DET_CONFD_AZIMUTH_059 DET_HVC_FLAG_059 DET_EXISTENCE_PROB_059 DET_SNR_059 DET_SUPER_RES_TARGET_059 DET_BI_STATIC_FLAG_059 DET_RCS_059 DET_ELEVATION_ERR_059 DET_ELEVATION_059 DET_AZIMUTH_ERR_059 DET_AZIMUTH_059 DET_RANGE_VELOCITY_ERR_059 DET_RANGE_VELOCITY_059 DET_RANGE_ERR_059 DET_RANGE_059 DET_CONFD_ELEVATION_060 DET_CONFD_AZIMUTH_060 DET_HVC_FLAG_060 DET_EXISTENCE_PROB_060 DET_SNR_060 DET_SUPER_RES_TARGET_060 DET_BI_STATIC_FLAG_060 DET_RCS_060 DET_ELEVATION_ERR_060 DET_ELEVATION_060 DET_AZIMUTH_ERR_060 DET_AZIMUTH_060 DET_RANGE_VELOCITY_ERR_060 DET_RANGE_VELOCITY_060 DET_RANGE_ERR_060 DET_RANGE_060;
SIG_GROUP_ 655 SRR_FL_Detections_061_064 1 : DET_PROB_1STAZHYPO_061 DET_PROB_1STAZHYPO_062 DET_PROB_1STAZHYPO_063 DET_PROB_1STAZHYPO_064 DET_IDM_061 DET_IDM_062 DET_IDM_063 DET_IDM_064 DET_MTD_064 DET_MTD_063 DET_MTD_062 DET_MTD_061 DET_BELOW_RAIN_THOLD_064 DET_BELOW_RAIN_THOLD_063 DET_BELOW_RAIN_THOLD_062 DET_BELOW_RAIN_THOLD_061 DET_MH_CRC16_061_064 DET_MH_CYCLE_COUNTER_061_064 DET_MH_SCAN_INDEX_4LSB_061_064 DET_CONFD_ELEVATION_061 DET_CONFD_AZIMUTH_061 DET_HVC_FLAG_061 DET_EXISTENCE_PROB_061 DET_SNR_061 DET_SUPER_RES_TARGET_061 DET_BI_STATIC_FLAG_061 DET_RCS_061 DET_ELEVATION_ERR_061 DET_ELEVATION_061 DET_AZIMUTH_ERR_061 DET_AZIMUTH_061 DET_RANGE_VELOCITY_ERR_061 DET_RANGE_VELOCITY_061 DET_RANGE_ERR_061 DET_RANGE_061 DET_CONFD_ELEVATION_062 DET_CONFD_AZIMUTH_062 DET_HVC_FLAG_062 DET_EXISTENCE_PROB_062 DET_SNR_062 DET_SUPER_RES_TARGET_062 DET_BI_STATIC_FLAG_062 DET_RCS_062 DET_ELEVATION_ERR_062 DET_ELEVATION_062 DET_AZIMUTH_ERR_062 DET_AZIMUTH_062 DET_RANGE_VELOCITY_ERR_062 DET_RANGE_VELOCITY_062 DET_RANGE_ERR_062 DET_RANGE_062 DET_CONFD_ELEVATION_063 DET_CONFD_AZIMUTH_063 DET_HVC_FLAG_063 DET_EXISTENCE_PROB_063 DET_SNR_063 DET_SUPER_RES_TARGET_063 DET_BI_STATIC_FLAG_063 DET_RCS_063 DET_ELEVATION_ERR_063 DET_ELEVATION_063 DET_AZIMUTH_ERR_063 DET_AZIMUTH_063 DET_RANGE_VELOCITY_ERR_063 DET_RANGE_VELOCITY_063 DET_RANGE_ERR_063 DET_RANGE_063 DET_CONFD_ELEVATION_064 DET_CONFD_AZIMUTH_064 DET_HVC_FLAG_064 DET_EXISTENCE_PROB_064 DET_SNR_064 DET_SUPER_RES_TARGET_064 DET_BI_STATIC_FLAG_064 DET_RCS_064 DET_ELEVATION_ERR_064 DET_ELEVATION_064 DET_AZIMUTH_ERR_064 DET_AZIMUTH_064 DET_RANGE_VELOCITY_ERR_064 DET_RANGE_VELOCITY_064 DET_RANGE_ERR_064 DET_RANGE_064;
SIG_GROUP_ 656 SRR_FL_Detections_065_068 1 : DET_PROB_1STAZHYPO_065 DET_PROB_1STAZHYPO_066 DET_PROB_1STAZHYPO_067 DET_PROB_1STAZHYPO_068 DET_IDM_065 DET_IDM_066 DET_IDM_067 DET_IDM_068 DET_MTD_068 DET_MTD_067 DET_MTD_066 DET_MTD_065 DET_BELOW_RAIN_THOLD_068 DET_BELOW_RAIN_THOLD_067 DET_BELOW_RAIN_THOLD_066 DET_BELOW_RAIN_THOLD_065 DET_MH_CRC16_065_068 DET_MH_CYCLE_COUNTER_065_068 DET_MH_SCAN_INDEX_4LSB_065_068 DET_CONFD_ELEVATION_065 DET_CONFD_AZIMUTH_065 DET_HVC_FLAG_065 DET_EXISTENCE_PROB_065 DET_SNR_065 DET_SUPER_RES_TARGET_065 DET_BI_STATIC_FLAG_065 DET_RCS_065 DET_ELEVATION_ERR_065 DET_ELEVATION_065 DET_AZIMUTH_ERR_065 DET_AZIMUTH_065 DET_RANGE_VELOCITY_ERR_065 DET_RANGE_VELOCITY_065 DET_RANGE_ERR_065 DET_RANGE_065 DET_CONFD_ELEVATION_066 DET_CONFD_AZIMUTH_066 DET_HVC_FLAG_066 DET_EXISTENCE_PROB_066 DET_SNR_066 DET_SUPER_RES_TARGET_066 DET_BI_STATIC_FLAG_066 DET_RCS_066 DET_ELEVATION_ERR_066 DET_ELEVATION_066 DET_AZIMUTH_ERR_066 DET_AZIMUTH_066 DET_RANGE_VELOCITY_ERR_066 DET_RANGE_VELOCITY_066 DET_RANGE_ERR_066 DET_RANGE_066 DET_CONFD_ELEVATION_067 DET_CONFD_AZIMUTH_067 DET_HVC_FLAG_067 DET_EXISTENCE_PROB_067 DET_SNR_067 DET_SUPER_RES_TARGET_067 DET_BI_STATIC_FLAG_067 DET_RCS_067 DET_ELEVATION_ERR_067 DET_ELEVATION_067 DET_AZIMUTH_ERR_067 DET_AZIMUTH_067 DET_RANGE_VELOCITY_ERR_067 DET_RANGE_VELOCITY_067 DET_RANGE_ERR_067 DET_RANGE_067 DET_CONFD_ELEVATION_068 DET_CONFD_AZIMUTH_068 DET_HVC_FLAG_068 DET_EXISTENCE_PROB_068 DET_SNR_068 DET_SUPER_RES_TARGET_068 DET_BI_STATIC_FLAG_068 DET_RCS_068 DET_ELEVATION_ERR_068 DET_ELEVATION_068 DET_AZIMUTH_ERR_068 DET_AZIMUTH_068 DET_RANGE_VELOCITY_ERR_068 DET_RANGE_VELOCITY_068 DET_RANGE_ERR_068 DET_RANGE_068;
SIG_GROUP_ 657 SRR_FL_Detections_069_072 1 : DET_PROB_1STAZHYPO_069 DET_PROB_1STAZHYPO_070 DET_PROB_1STAZHYPO_071 DET_PROB_1STAZHYPO_072 DET_IDM_069 DET_IDM_070 DET_IDM_071 DET_IDM_072 DET_MTD_072 DET_MTD_071 DET_MTD_070 DET_MTD_069 DET_BELOW_RAIN_THOLD_072 DET_BELOW_RAIN_THOLD_071 DET_BELOW_RAIN_THOLD_070 DET_BELOW_RAIN_THOLD_069 DET_MH_CRC16_069_072 DET_MH_CYCLE_COUNTER_069_072 DET_MH_SCAN_INDEX_4LSB_069_072 DET_CONFD_ELEVATION_069 DET_CONFD_AZIMUTH_069 DET_HVC_FLAG_069 DET_EXISTENCE_PROB_069 DET_SNR_069 DET_SUPER_RES_TARGET_069 DET_BI_STATIC_FLAG_069 DET_RCS_069 DET_ELEVATION_ERR_069 DET_ELEVATION_069 DET_AZIMUTH_ERR_069 DET_AZIMUTH_069 DET_RANGE_VELOCITY_ERR_069 DET_RANGE_VELOCITY_069 DET_RANGE_ERR_069 DET_RANGE_069 DET_CONFD_ELEVATION_070 DET_CONFD_AZIMUTH_070 DET_HVC_FLAG_070 DET_EXISTENCE_PROB_070 DET_SNR_070 DET_SUPER_RES_TARGET_070 DET_BI_STATIC_FLAG_070 DET_RCS_070 DET_ELEVATION_ERR_070 DET_ELEVATION_070 DET_AZIMUTH_ERR_070 DET_AZIMUTH_070 DET_RANGE_VELOCITY_ERR_070 DET_RANGE_VELOCITY_070 DET_RANGE_ERR_070 DET_RANGE_070 DET_CONFD_ELEVATION_071 DET_CONFD_AZIMUTH_071 DET_HVC_FLAG_071 DET_EXISTENCE_PROB_071 DET_SNR_071 DET_SUPER_RES_TARGET_071 DET_BI_STATIC_FLAG_071 DET_RCS_071 DET_ELEVATION_ERR_071 DET_ELEVATION_071 DET_AZIMUTH_ERR_071 DET_AZIMUTH_071 DET_RANGE_VELOCITY_ERR_071 DET_RANGE_VELOCITY_071 DET_RANGE_ERR_071 DET_RANGE_071 DET_CONFD_ELEVATION_072 DET_CONFD_AZIMUTH_072 DET_HVC_FLAG_072 DET_EXISTENCE_PROB_072 DET_SNR_072 DET_SUPER_RES_TARGET_072 DET_BI_STATIC_FLAG_072 DET_RCS_072 DET_ELEVATION_ERR_072 DET_ELEVATION_072 DET_AZIMUTH_ERR_072 DET_AZIMUTH_072 DET_RANGE_VELOCITY_ERR_072 DET_RANGE_VELOCITY_072 DET_RANGE_ERR_072 DET_RANGE_072;
SIG_GROUP_ 658 SRR_FL_Detections_073_076 1 : DET_PROB_1STAZHYPO_073 DET_PROB_1STAZHYPO_074 DET_PROB_1STAZHYPO_075 DET_PROB_1STAZHYPO_076 DET_IDM_073 DET_IDM_074 DET_IDM_075 DET_IDM_076 DET_MTD_076 DET_MTD_075 DET_MTD_074 DET_MTD_073 DET_BELOW_RAIN_THOLD_076 DET_BELOW_RAIN_THOLD_075 DET_BELOW_RAIN_THOLD_074 DET_BELOW_RAIN_THOLD_073 DET_MH_CRC16_073_076 DET_MH_CYCLE_COUNTER_073_076 DET_MH_SCAN_INDEX_4LSB_073_076 DET_CONFD_ELEVATION_073 DET_CONFD_AZIMUTH_073 DET_HVC_FLAG_073 DET_EXISTENCE_PROB_073 DET_SNR_073 DET_SUPER_RES_TARGET_073 DET_BI_STATIC_FLAG_073 DET_RCS_073 DET_ELEVATION_ERR_073 DET_ELEVATION_073 DET_AZIMUTH_ERR_073 DET_AZIMUTH_073 DET_RANGE_VELOCITY_ERR_073 DET_RANGE_VELOCITY_073 DET_RANGE_ERR_073 DET_RANGE_073 DET_CONFD_ELEVATION_074 DET_CONFD_AZIMUTH_074 DET_HVC_FLAG_074 DET_EXISTENCE_PROB_074 DET_SNR_074 DET_SUPER_RES_TARGET_074 DET_BI_STATIC_FLAG_074 DET_RCS_074 DET_ELEVATION_ERR_074 DET_ELEVATION_074 DET_AZIMUTH_ERR_074 DET_AZIMUTH_074 DET_RANGE_VELOCITY_ERR_074 DET_RANGE_VELOCITY_074 DET_RANGE_ERR_074 DET_RANGE_074 DET_CONFD_ELEVATION_075 DET_CONFD_AZIMUTH_075 DET_HVC_FLAG_075 DET_EXISTENCE_PROB_075 DET_SNR_075 DET_SUPER_RES_TARGET_075 DET_BI_STATIC_FLAG_075 DET_RCS_075 DET_ELEVATION_ERR_075 DET_ELEVATION_075 DET_AZIMUTH_ERR_075 DET_AZIMUTH_075 DET_RANGE_VELOCITY_ERR_075 DET_RANGE_VELOCITY_075 DET_RANGE_ERR_075 DET_RANGE_075 DET_CONFD_ELEVATION_076 DET_CONFD_AZIMUTH_076 DET_HVC_FLAG_076 DET_EXISTENCE_PROB_076 DET_SNR_076 DET_SUPER_RES_TARGET_076 DET_BI_STATIC_FLAG_076 DET_RCS_076 DET_ELEVATION_ERR_076 DET_ELEVATION_076 DET_AZIMUTH_ERR_076 DET_AZIMUTH_076 DET_RANGE_VELOCITY_ERR_076 DET_RANGE_VELOCITY_076 DET_RANGE_ERR_076 DET_RANGE_076;
SIG_GROUP_ 659 SRR_FL_Detections_077_080 1 : DET_PROB_1STAZHYPO_077 DET_PROB_1STAZHYPO_078 DET_PROB_1STAZHYPO_079 DET_PROB_1STAZHYPO_080 DET_IDM_077 DET_IDM_078 DET_IDM_079 DET_IDM_080 DET_MTD_080 DET_MTD_079 DET_MTD_078 DET_MTD_077 DET_BELOW_RAIN_THOLD_080 DET_BELOW_RAIN_THOLD_079 DET_BELOW_RAIN_THOLD_078 DET_BELOW_RAIN_THOLD_077 DET_MH_CRC16_077_080 DET_MH_CYCLE_COUNTER_077_080 DET_MH_SCAN_INDEX_4LSB_077_080 DET_CONFD_ELEVATION_077 DET_CONFD_AZIMUTH_077 DET_HVC_FLAG_077 DET_EXISTENCE_PROB_077 DET_SNR_077 DET_SUPER_RES_TARGET_077 DET_BI_STATIC_FLAG_077 DET_RCS_077 DET_ELEVATION_ERR_077 DET_ELEVATION_077 DET_AZIMUTH_ERR_077 DET_AZIMUTH_077 DET_RANGE_VELOCITY_ERR_077 DET_RANGE_VELOCITY_077 DET_RANGE_ERR_077 DET_RANGE_077 DET_CONFD_ELEVATION_078 DET_CONFD_AZIMUTH_078 DET_HVC_FLAG_078 DET_EXISTENCE_PROB_078 DET_SNR_078 DET_SUPER_RES_TARGET_078 DET_BI_STATIC_FLAG_078 DET_RCS_078 DET_ELEVATION_ERR_078 DET_ELEVATION_078 DET_AZIMUTH_ERR_078 DET_AZIMUTH_078 DET_RANGE_VELOCITY_ERR_078 DET_RANGE_VELOCITY_078 DET_RANGE_ERR_078 DET_RANGE_078 DET_CONFD_ELEVATION_079 DET_CONFD_AZIMUTH_079 DET_HVC_FLAG_079 DET_EXISTENCE_PROB_079 DET_SNR_079 DET_SUPER_RES_TARGET_079 DET_BI_STATIC_FLAG_079 DET_RCS_079 DET_ELEVATION_ERR_079 DET_ELEVATION_079 DET_AZIMUTH_ERR_079 DET_AZIMUTH_079 DET_RANGE_VELOCITY_ERR_079 DET_RANGE_VELOCITY_079 DET_RANGE_ERR_079 DET_RANGE_079 DET_CONFD_ELEVATION_080 DET_CONFD_AZIMUTH_080 DET_HVC_FLAG_080 DET_EXISTENCE_PROB_080 DET_SNR_080 DET_SUPER_RES_TARGET_080 DET_BI_STATIC_FLAG_080 DET_RCS_080 DET_ELEVATION_ERR_080 DET_ELEVATION_080 DET_AZIMUTH_ERR_080 DET_AZIMUTH_080 DET_RANGE_VELOCITY_ERR_080 DET_RANGE_VELOCITY_080 DET_RANGE_ERR_080 DET_RANGE_080;
SIG_GROUP_ 660 SRR_FL_Detections_081_084 1 : DET_PROB_1STAZHYPO_081 DET_PROB_1STAZHYPO_082 DET_PROB_1STAZHYPO_083 DET_PROB_1STAZHYPO_084 DET_IDM_081 DET_IDM_082 DET_IDM_083 DET_IDM_084 DET_MTD_084 DET_MTD_083 DET_MTD_082 DET_MTD_081 DET_BELOW_RAIN_THOLD_084 DET_BELOW_RAIN_THOLD_083 DET_BELOW_RAIN_THOLD_082 DET_BELOW_RAIN_THOLD_081 DET_MH_CRC16_081_084 DET_MH_CYCLE_COUNTER_081_084 DET_MH_SCAN_INDEX_4LSB_081_084 DET_CONFD_ELEVATION_081 DET_CONFD_AZIMUTH_081 DET_HVC_FLAG_081 DET_EXISTENCE_PROB_081 DET_SNR_081 DET_SUPER_RES_TARGET_081 DET_BI_STATIC_FLAG_081 DET_RCS_081 DET_ELEVATION_ERR_081 DET_ELEVATION_081 DET_AZIMUTH_ERR_081 DET_AZIMUTH_081 DET_RANGE_VELOCITY_ERR_081 DET_RANGE_VELOCITY_081 DET_RANGE_ERR_081 DET_RANGE_081 DET_CONFD_ELEVATION_082 DET_CONFD_AZIMUTH_082 DET_HVC_FLAG_082 DET_EXISTENCE_PROB_082 DET_SNR_082 DET_SUPER_RES_TARGET_082 DET_BI_STATIC_FLAG_082 DET_RCS_082 DET_ELEVATION_ERR_082 DET_ELEVATION_082 DET_AZIMUTH_ERR_082 DET_AZIMUTH_082 DET_RANGE_VELOCITY_ERR_082 DET_RANGE_VELOCITY_082 DET_RANGE_ERR_082 DET_RANGE_082 DET_CONFD_ELEVATION_083 DET_CONFD_AZIMUTH_083 DET_HVC_FLAG_083 DET_EXISTENCE_PROB_083 DET_SNR_083 DET_SUPER_RES_TARGET_083 DET_BI_STATIC_FLAG_083 DET_RCS_083 DET_ELEVATION_ERR_083 DET_ELEVATION_083 DET_AZIMUTH_ERR_083 DET_AZIMUTH_083 DET_RANGE_VELOCITY_ERR_083 DET_RANGE_VELOCITY_083 DET_RANGE_ERR_083 DET_RANGE_083 DET_CONFD_ELEVATION_084 DET_CONFD_AZIMUTH_084 DET_HVC_FLAG_084 DET_EXISTENCE_PROB_084 DET_SNR_084 DET_SUPER_RES_TARGET_084 DET_BI_STATIC_FLAG_084 DET_RCS_084 DET_ELEVATION_ERR_084 DET_ELEVATION_084 DET_AZIMUTH_ERR_084 DET_AZIMUTH_084 DET_RANGE_VELOCITY_ERR_084 DET_RANGE_VELOCITY_084 DET_RANGE_ERR_084 DET_RANGE_084;
SIG_GROUP_ 661 SRR_FL_Detections_085_088 1 : DET_PROB_1STAZHYPO_085 DET_PROB_1STAZHYPO_086 DET_PROB_1STAZHYPO_087 DET_PROB_1STAZHYPO_088 DET_IDM_085 DET_IDM_086 DET_IDM_087 DET_IDM_088 DET_MTD_088 DET_MTD_087 DET_MTD_086 DET_MTD_085 DET_BELOW_RAIN_THOLD_088 DET_BELOW_RAIN_THOLD_087 DET_BELOW_RAIN_THOLD_086 DET_BELOW_RAIN_THOLD_085 DET_MH_CRC16_085_088 DET_MH_CYCLE_COUNTER_085_088 DET_MH_SCAN_INDEX_4LSB_085_088 DET_CONFD_ELEVATION_085 DET_CONFD_AZIMUTH_085 DET_HVC_FLAG_085 DET_EXISTENCE_PROB_085 DET_SNR_085 DET_SUPER_RES_TARGET_085 DET_BI_STATIC_FLAG_085 DET_RCS_085 DET_ELEVATION_ERR_085 DET_ELEVATION_085 DET_AZIMUTH_ERR_085 DET_AZIMUTH_085 DET_RANGE_VELOCITY_ERR_085 DET_RANGE_VELOCITY_085 DET_RANGE_ERR_085 DET_RANGE_085 DET_CONFD_ELEVATION_086 DET_CONFD_AZIMUTH_086 DET_HVC_FLAG_086 DET_EXISTENCE_PROB_086 DET_SNR_086 DET_SUPER_RES_TARGET_086 DET_BI_STATIC_FLAG_086 DET_RCS_086 DET_ELEVATION_ERR_086 DET_ELEVATION_086 DET_AZIMUTH_ERR_086 DET_AZIMUTH_086 DET_RANGE_VELOCITY_ERR_086 DET_RANGE_VELOCITY_086 DET_RANGE_ERR_086 DET_RANGE_086 DET_CONFD_ELEVATION_087 DET_CONFD_AZIMUTH_087 DET_HVC_FLAG_087 DET_EXISTENCE_PROB_087 DET_SNR_087 DET_SUPER_RES_TARGET_087 DET_BI_STATIC_FLAG_087 DET_RCS_087 DET_ELEVATION_ERR_087 DET_ELEVATION_087 DET_AZIMUTH_ERR_087 DET_AZIMUTH_087 DET_RANGE_VELOCITY_ERR_087 DET_RANGE_VELOCITY_087 DET_RANGE_ERR_087 DET_RANGE_087 DET_CONFD_ELEVATION_088 DET_CONFD_AZIMUTH_088 DET_HVC_FLAG_088 DET_EXISTENCE_PROB_088 DET_SNR_088 DET_SUPER_RES_TARGET_088 DET_BI_STATIC_FLAG_088 DET_RCS_088 DET_ELEVATION_ERR_088 DET_ELEVATION_088 DET_AZIMUTH_ERR_088 DET_AZIMUTH_088 DET_RANGE_VELOCITY_ERR_088 DET_RANGE_VELOCITY_088 DET_RANGE_ERR_088 DET_RANGE_088;
