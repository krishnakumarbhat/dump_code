VERSION ""

NS_ :

BS_:

BU_: Gateway_25 FCM_A0 FLR SRR_RL External_Tool SRR_FL Steering_E4 VCU_47 CLS_17 ESC_0B EMS_00

BO_ 163 FLR_STATUS_001: 64 FLR
 SG_ STS_DIST_FRNT_BMPR_TO_RR_AXL : 248|13@1+ (0.001,0) [0|8.191] "m"  FCM_A0
 SG_ STS_SENSOR_POLARITY : 246|1@1+ (1,0) [0|1] ""  FCM_A0
 SG_ STS_SP_CORE_TIME_PEAK : 472|8@1+ (0.5,0) [0|127.5] "ms"  FCM_A0
 SG_ STS_SP_CORE_TIME_INST : 480|8@1+ (0.5,0) [0|127.5] "ms"  FCM_A0
 SG_ STS_RDD_CORE_TIME_PEAK : 464|8@1+ (0.5,0) [0|127.5] "ms"  FCM_A0
 SG_ STS_RDD_CORE_TIME_INST : 456|8@1+ (0.5,0) [0|127.5] "ms"  FCM_A0
 SG_ STS_MAIN_CORE_TIME_PEAK : 448|8@1+ (0.5,0) [0|127.5] "ms"  FCM_A0
 SG_ STS_MAIN_CORE_TIME_INST : 440|8@1+ (0.5,0) [0|127.5] "ms"  FCM_A0
 SG_ STS_AF_TIME_PEAK : 432|8@1+ (0.5,0) [0|127.5] "ms"  FCM_A0
 SG_ STS_AF_TIME_INST : 424|8@1+ (0.5,0) [0|127.5] "ms"  FCM_A0
 SG_ STS_PCAN_PROTOCOL_VER_MINOR : 128|8@1+ (1,0) [0|255] ""  FCM_A0
 SG_ STS_PCAN_PROTOCOL_VER_MAJOR : 120|8@1+ (1,0) [0|255] ""  FCM_A0
 SG_ STS_PLATFORM_VARIANT : 162|5@1+ (1,0) [0|18] ""  FCM_A0
 SG_ STS_HARDWARE_VERSION : 112|3@1+ (1,0) [0|5] ""  FCM_A0
 SG_ STS_SERIAL_NUMBER_SEQUENCE : 148|14@1+ (1,0) [0|9999] ""  FCM_A0
 SG_ STS_SERIAL_NUM_JULIAN_YEAR : 145|3@1+ (1,2020) [2020|2027] "years"  FCM_A0
 SG_ STS_SERIAL_NUM_JULIAN_DAY : 136|9@1+ (1,0) [0|366] ""  FCM_A0
 SG_ STS_SW_VERSION_FIELD1 : 168|8@1+ (1,0) [0|255] ""  FCM_A0
 SG_ STS_SW_VERSION_FIELD2 : 176|8@1+ (1,0) [0|255] ""  FCM_A0
 SG_ STS_SW_VERSION_FIELD3 : 184|8@1+ (1,0) [0|255] ""  FCM_A0
 SG_ STS_SW_VERSION_FIELD4 : 192|8@1+ (1,0) [0|255] ""  FCM_A0
 SG_ STS_PBL_VERSION_FIELD1 : 200|8@1+ (1,0) [0|255] ""  FCM_A0
 SG_ STS_PBL_VERSION_FIELD2 : 208|8@1+ (1,0) [0|255] ""  FCM_A0
 SG_ STS_PBL_VERSION_FIELD3 : 216|8@1+ (1,0) [0|255] ""  FCM_A0
 SG_ STS_PBL_VERSION_FIELD4 : 224|8@1+ (1,0) [0|255] ""  FCM_A0
 SG_ STS_USC_CAL_VER_MAJOR : 24|16@1+ (1,0) [0|65535] ""  FCM_A0
 SG_ STS_USC_CAL_VER_MINOR : 40|16@1+ (1,0) [0|65535] ""  FCM_A0
 SG_ STS_USC_SECTION_COMPTBLITY : 56|16@1+ (1,0) [0|255] ""  FCM_A0
 SG_ STS_SMC_CAL_VER_MAJOR : 72|16@1+ (1,0) [0|65535] ""  FCM_A0
 SG_ STS_SMC_CAL_VER_MINOR : 88|16@1+ (1,0) [0|65535] ""  FCM_A0
 SG_ STS_SMC_SECTION_COMPTBLITY : 488|16@1+ (1,0) [0|65535] ""  FCM_A0
 SG_ STS_SMC_PLATFROM_VERSION : 104|8@1+ (1,0) [0|14] ""  FCM_A0
 SG_ STS_SENSOR_MOUNT_POS_X : 296|14@1+ (0.001,-8.192) [-8.192|8.191] "m"  FCM_A0
 SG_ STS_SENSOR_MOUNT_POS_Y : 312|16@1+ (0.0001,-3.2768) [-3.2768|3.2767] "m"  FCM_A0
 SG_ STS_SENSOR_MOUNT_POS_Z : 328|16@1+ (0.0001,-3.2768) [-3.2768|3.2767] "m"  FCM_A0
 SG_ STS_SENSOR_MOUNT_ORNT_YAW : 232|14@1- (0.0004,0) [-3.14|3.14] "rad"  FCM_A0
 SG_ STS_SENSOR_MOUNT_ORNT_PITCH : 264|14@1- (0.0004,0) [-3.14|3.14] "rad"  FCM_A0
 SG_ STS_SENSOR_MOUNT_ORNT_ROLL : 280|14@1+ (0.0004,-3.14159) [-3.14159|3.41161] "rad"  FCM_A0
 SG_ STS_SENSOR_HEIGHT : 344|32@1+ (0.01,0) [0|42949672.95] "m"  FCM_A0
 SG_ STS_DET_DBC_BASE_VER_MINOR : 384|8@1+ (1,0) [0|255] ""  FCM_A0
 SG_ STS_DET_DBC_BASE_VER_MAJOR : 376|8@1+ (1,0) [0|255] ""  FCM_A0
 SG_ STS_TIME_SINCE_POWER_ON : 392|32@1+ (1,0) [0|4294967295] "s"  FCM_A0
 SG_ STS_SENSOR_POSITION : 115|3@1+ (1,0) [0|7] ""  FCM_A0
 SG_ STS_MH_001_CRC16 : 0|16@1+ (1,0) [0|65535] ""  FCM_A0
 SG_ STS_MH_001_CYCLE_COUNTER : 16|8@1+ (1,0) [0|255] ""  FCM_A0

BO_ 160 FLR_HEADER_001: 64 FLR
 SG_ HED_Rain_Level : 318|2@1+ (1,0) [0|2] ""  FCM_A0
 SG_ HED_V_WRAPPING : 197|11@1+ (0.01,-40) [-40|-19.53] "mps"  FCM_A0
 SG_ HED_R_WRAPPING : 368|8@1+ (0.01,-0.9) [-0.9|1.65] "m"  FCM_A0
 SG_ HED_Auth_CRC32 : 376|32@1+ (1,0) [0|4294967295] ""  FCM_A0
 SG_ HED_SLOPE_CORR_EXECUTIONFLAG : 172|2@1+ (1,0) [0|3] ""  FCM_A0
 SG_ HED_PROCESSED_RANGE : 160|9@1+ (1,0) [0|500] ""  FCM_A0
 SG_ HED_LOOK_INDEX : 208|16@1+ (1,0) [0|65535] ""  FCM_A0
 SG_ HED_OPERATION_MODE : 315|3@1+ (1,0) [0|5] ""  FCM_A0
 SG_ HED_MAX_NUM_OF_DETECTIONS : 352|9@1+ (1,0) [0|400] ""  FCM_A0
 SG_ HED_NUM_OF_RESTBINS_USED : 24|9@1+ (1,0) [0|511] ""  FCM_A0
 SG_ HED_NUM_OF_VALID_DETECTIONS : 33|9@1+ (1,0) [0|500] ""  FCM_A0
 SG_ HED_LOOK_ID : 42|2@1+ (1,0) [0|3] ""  FCM_A0
 SG_ HED_SCAN_INDEX : 48|16@1+ (1,0) [0|65535] ""  FCM_A0
 SG_ HED_MH_CYCLE_COUNTER : 16|8@1+ (1,0) [0|255] ""  FCM_A0
 SG_ HED_DATA_QUALIFIER : 44|3@1+ (1,0) [0|7] ""  FCM_A0
 SG_ HED_DET_RANGE_MAX : 64|16@1+ (0.01,0) [0|500] "m"  FCM_A0
 SG_ HED_DET_SPEED_RANGE_MAX : 96|16@1+ (0.00390625,-128) [-128|127.99609375] "m/s"  FCM_A0
 SG_ HED_FOV_HOR_MAX : 136|8@1+ (0.0174533,0) [0|3.14159] "rad"  FCM_A0
 SG_ HED_FOV_VER_MAX : 152|8@1+ (0.0174533,0) [0|3.14159] "rad"  FCM_A0
 SG_ HED_DET_RANGE_MIN : 80|16@1+ (0.01,0) [0|500] "m"  FCM_A0
 SG_ HED_DET_SPEED_RANGE_MIN : 112|16@1+ (0.00390625,-128) [-128|127.99609375] "m/s"  FCM_A0
 SG_ HED_FOV_HOR_MIN : 128|8@1+ (0.0174533,-2.2340224) [-2.2340224|2.2165691] "rad"  FCM_A0
 SG_ HED_FOV_VER_MIN : 144|8@1+ (0.0174533,0) [-2.2340224|2.2165691] "rad"  FCM_A0
 SG_ HED_ALIGN_VER_REF : 174|10@1+ (0.0005,-0.1745) [-0.1745|0.337] "rad"  FCM_A0
 SG_ HED_ALIGN_HOR_REF : 184|13@1+ (0.0005,-0.1745) [-0.1745|3.921] "rad"  FCM_A0
 SG_ HED_SENSOR_TIME_STAMP_NS : 224|32@1+ (1,0) [0|4294967295] "ns"  FCM_A0
 SG_ HED_SENSOR_TIME_STAMP_SEC : 256|32@1+ (1,0) [0|4294967295] "s"  FCM_A0
 SG_ HED_TIME_SYNC_SRC_MASTER : 169|1@1+ (1,0) [0|1] ""  FCM_A0
 SG_ HED_TIME_SYNC_VALIDITY_FLAG : 170|2@1+ (1,0) [0|2] ""  FCM_A0
 SG_ HED_MH_CRC16 : 0|16@1+ (1,0) [0|65535] ""  FCM_A0
 SG_ HED_DET_NUM_OF_1PASS : 296|10@1+ (1,0) [0|1023] ""  FCM_A0
 SG_ HED_DET_NUM_OF_2PASS : 306|9@1+ (1,0) [0|511] ""  FCM_A0
 SG_ HED_TRIGGER_TIME : 320|32@1+ (1,0) [0|4294967295] "ns"  FCM_A0
 SG_ HED_DET_BI_STATIC_COUNT : 288|8@1+ (1,0) [0|255] ""  FCM_A0

BO_ 799 FLR_DETECTION_125_128_: 64 FLR
 SG_ DET_RANGE_125 : 24|15@1+ (0.015625,0) [0|500] "m"  FCM_A0
 SG_ DET_RANGE_ERR_125 : 40|7@1+ (0.0075,0) [0|0.9525] "m"  FCM_A0
 SG_ DET_RANGE_VELOCITY_125 : 48|15@1+ (0.0078125,-128) [-128|127.9921875] "m/s"  FCM_A0
 SG_ DET_RANGE_VELOCITY_ERR_125 : 64|8@1+ (0.003,0) [0|0.765] "m/s"  FCM_A0
 SG_ DET_AZIMUTH_125 : 88|13@1+ (0.0004,-1.5708) [-1.5708|1.5708] "rad"  FCM_A0
 SG_ DET_AZIMUTH_ERR_125 : 105|7@1+ (0.00087267,0) [0|0.11082909] "rad"  FCM_A0
 SG_ DET_ELEVATION_125 : 72|8@1+ (0.00275,-0.34925) [-0.34925|0.34925] "rad"  FCM_A0
 SG_ DET_ELEVATION_ERR_125 : 80|6@1+ (0.00174533,0) [0|0.10995579] "rad"  FCM_A0
 SG_ DET_RCS_125 : 128|8@1+ (0.5,-64) [-64|63.5] "dBsm"  FCM_A0
 SG_ DET_BI_STATIC_FLAG_125 : 104|1@1+ (1,0) [0|1] ""  FCM_A0
 SG_ DET_SUPER_RES_TARGET_125 : 87|1@1+ (1,0) [0|1] ""  FCM_A0
 SG_ DET_SNR_125 : 120|8@1+ (0.35156,0) [0|89.6478] "dB"  FCM_A0
 SG_ DET_EXISTENCE_PROB_125 : 112|6@1+ (1.588,0) [0|100] "%"  FCM_A0
 SG_ DET_HVC_FLAG_125 : 86|1@1+ (1,0) [0|1] ""  FCM_A0
 SG_ DET_CONFD_AZIMUTH_125 : 118|2@1+ (1,0) [0|3] ""  FCM_A0
 SG_ DET_CONFD_ELEVATION_125 : 101|2@1+ (1,0) [0|3] ""  FCM_A0
 SG_ DET_PROB_1STAZHYPO_125 : 103|1@1+ (1,0) [0|1] ""  FCM_A0
 SG_ DET_IDM_125 : 63|1@1+ (1,0) [0|1] ""  FCM_A0
 SG_ DET_MTD_125 : 47|1@1+ (1,0) [0|1] ""  FCM_A0
 SG_ DET_BELOW_RAIN_THOLD_125 : 39|1@1+ (1,0) [0|1] ""  FCM_A0
 SG_ DET_RANGE_126 : 136|15@1+ (0.015625,0) [0|500] "m"  FCM_A0
 SG_ DET_RANGE_ERR_126 : 152|7@1+ (0.0075,0) [0|0.9525] "m"  FCM_A0
 SG_ DET_RANGE_VELOCITY_126 : 160|15@1+ (0.0078125,-128) [-128|127.9921875] "m/s"  FCM_A0
 SG_ DET_RANGE_VELOCITY_ERR_126 : 176|8@1+ (0.003,0) [0|0.765] "m/s"  FCM_A0
 SG_ DET_AZIMUTH_126 : 200|13@1+ (0.0004,-1.5708) [-1.5708|1.5708] "rad"  FCM_A0
 SG_ DET_AZIMUTH_ERR_126 : 217|7@1+ (0.00087267,0) [0|0.11082909] "rad"  FCM_A0
 SG_ DET_ELEVATION_126 : 184|8@1+ (0.00275,-0.34925) [-0.34925|0.34925] "rad"  FCM_A0
 SG_ DET_ELEVATION_ERR_126 : 192|6@1+ (0.00174533,0) [0|0.10995579] "rad"  FCM_A0
 SG_ DET_RCS_126 : 240|8@1+ (0.5,-64) [-64|63.5] "dBsm"  FCM_A0
 SG_ DET_BI_STATIC_FLAG_126 : 216|1@1+ (1,0) [0|1] ""  FCM_A0
 SG_ DET_SUPER_RES_TARGET_126 : 199|1@1+ (1,0) [0|1] ""  FCM_A0
 SG_ DET_SNR_126 : 232|8@1+ (0.35156,0) [0|89.6478] "dB"  FCM_A0
 SG_ DET_EXISTENCE_PROB_126 : 224|6@1+ (1.588,0) [0|100] "%"  FCM_A0
 SG_ DET_HVC_FLAG_126 : 198|1@1+ (1,0) [0|1] ""  FCM_A0
 SG_ DET_CONFD_AZIMUTH_126 : 230|2@1+ (1,0) [0|3] ""  FCM_A0
 SG_ DET_CONFD_ELEVATION_126 : 213|2@1+ (1,0) [0|3] ""  FCM_A0
 SG_ DET_PROB_1STAZHYPO_126 : 215|1@1+ (1,0) [0|1] ""  FCM_A0
 SG_ DET_IDM_126 : 175|1@1+ (1,0) [0|1] ""  FCM_A0
 SG_ DET_MTD_126 : 159|1@1+ (1,0) [0|1] ""  FCM_A0
 SG_ DET_BELOW_RAIN_THOLD_126 : 151|1@1+ (1,0) [0|1] ""  FCM_A0
 SG_ DET_RANGE_127 : 248|15@1+ (0.015625,0) [0|500] "m"  FCM_A0
 SG_ DET_RANGE_ERR_127 : 264|7@1+ (0.0075,0) [0|0.9525] "m"  FCM_A0
 SG_ DET_RANGE_VELOCITY_127 : 272|15@1+ (0.0078125,-128) [-128|127.9921875] "m/s"  FCM_A0
 SG_ DET_RANGE_VELOCITY_ERR_127 : 288|8@1+ (0.003,0) [0|0.765] "m/s"  FCM_A0
 SG_ DET_AZIMUTH_127 : 312|13@1+ (0.0004,-1.5708) [-1.5708|1.5708] "rad"  FCM_A0
 SG_ DET_AZIMUTH_ERR_127 : 329|7@1+ (0.00087267,0) [0|0.11082909] "rad"  FCM_A0
 SG_ DET_ELEVATION_127 : 296|8@1+ (0.00275,-0.34925) [-0.34925|0.34925] "rad"  FCM_A0
 SG_ DET_ELEVATION_ERR_127 : 304|6@1+ (0.00174533,0) [0|0.10995579] "rad"  FCM_A0
 SG_ DET_RCS_127 : 352|8@1+ (0.5,-64) [-64|63.5] "dBsm"  FCM_A0
 SG_ DET_BI_STATIC_FLAG_127 : 328|1@1+ (1,0) [0|1] ""  FCM_A0
 SG_ DET_SUPER_RES_TARGET_127 : 311|1@1+ (1,0) [0|1] ""  FCM_A0
 SG_ DET_SNR_127 : 344|8@1+ (0.35156,0) [0|89.6478] "dB"  FCM_A0
 SG_ DET_EXISTENCE_PROB_127 : 336|6@1+ (1.588,0) [0|100] "%"  FCM_A0
 SG_ DET_HVC_FLAG_127 : 310|1@1+ (1,0) [0|1] ""  FCM_A0
 SG_ DET_CONFD_AZIMUTH_127 : 342|2@1+ (1,0) [0|3] ""  FCM_A0
 SG_ DET_CONFD_ELEVATION_127 : 325|2@1+ (1,0) [0|3] ""  FCM_A0
 SG_ DET_PROB_1STAZHYPO_127 : 327|1@1+ (1,0) [0|1] ""  FCM_A0
 SG_ DET_IDM_127 : 287|1@1+ (1,0) [0|1] ""  FCM_A0
 SG_ DET_MTD_127 : 271|1@1+ (1,0) [0|1] ""  FCM_A0
 SG_ DET_BELOW_RAIN_THOLD_127 : 263|1@1+ (1,0) [0|1] ""  FCM_A0
 SG_ DET_RANGE_128 : 360|15@1+ (0.015625,0) [0|500] "m"  FCM_A0
 SG_ DET_RANGE_ERR_128 : 376|7@1+ (0.0075,0) [0|0.9525] "m"  FCM_A0
 SG_ DET_RANGE_VELOCITY_128 : 384|15@1+ (0.0078125,-128) [-128|127.9921875] "m/s"  FCM_A0
 SG_ DET_RANGE_VELOCITY_ERR_128 : 400|8@1+ (0.003,0) [0|0.765] "m/s"  FCM_A0
 SG_ DET_AZIMUTH_128 : 424|13@1+ (0.0004,-1.5708) [-1.5708|1.5708] "rad"  FCM_A0
 SG_ DET_AZIMUTH_ERR_128 : 441|7@1+ (0.00087267,0) [0|0.11082909] "rad"  FCM_A0
 SG_ DET_ELEVATION_128 : 408|8@1+ (0.00275,-0.34925) [-0.34925|0.34925] "rad"  FCM_A0
 SG_ DET_ELEVATION_ERR_128 : 416|6@1+ (0.00174533,0) [0|0.10995579] "rad"  FCM_A0
 SG_ DET_RCS_128 : 464|8@1+ (0.5,-64) [-64|63.5] "dBsm"  FCM_A0
 SG_ DET_BI_STATIC_FLAG_128 : 440|1@1+ (1,0) [0|1] ""  FCM_A0
 SG_ DET_SUPER_RES_TARGET_128 : 423|1@1+ (1,0) [0|1] ""  FCM_A0
 SG_ DET_SNR_128 : 456|8@1+ (0.35156,0) [0|89.6478] "dB"  FCM_A0
 SG_ DET_EXISTENCE_PROB_128 : 448|6@1+ (1.588,0) [0|100] "%"  FCM_A0
 SG_ DET_HVC_FLAG_128 : 422|1@1+ (1,0) [0|1] ""  FCM_A0
 SG_ DET_CONFD_AZIMUTH_128 : 454|2@1+ (1,0) [0|3] ""  FCM_A0
 SG_ DET_CONFD_ELEVATION_128 : 437|2@1+ (1,0) [0|3] ""  FCM_A0
 SG_ DET_MH_SCAN_INDEX_4LSB_125_128 : 476|4@1+ (1,0) [0|15] ""  FCM_A0
 SG_ DET_MH_CYCLE_COUNTER_125_128 : 16|8@1+ (1,0) [0|255] ""  FCM_A0
 SG_ DET_MH_CRC16_125_128 : 0|16@1+ (1,0) [0|65535] ""  FCM_A0
 SG_ DET_PROB_1STAZHYPO_128 : 439|1@1+ (1,0) [0|1] ""  FCM_A0
 SG_ DET_IDM_128 : 399|1@1+ (1,0) [0|1] ""  FCM_A0
 SG_ DET_MTD_128 : 383|1@1+ (1,0) [0|1] ""  FCM_A0
 SG_ DET_BELOW_RAIN_THOLD_128 : 375|1@1+ (1,0) [0|1] ""  FCM_A0

BO_ 798 FLR_DETECTION_121_124: 64 FLR
 SG_ DET_RANGE_121 : 24|15@1+ (0.015625,0) [0|500] "m"  FCM_A0
 SG_ DET_RANGE_ERR_121 : 40|7@1+ (0.0075,0) [0|0.9525] "m"  FCM_A0
 SG_ DET_RANGE_VELOCITY_121 : 48|15@1+ (0.0078125,-128) [-128|127.9921875] "m/s"  FCM_A0
 SG_ DET_RANGE_VELOCITY_ERR_121 : 64|8@1+ (0.003,0) [0|0.765] "m/s"  FCM_A0
 SG_ DET_AZIMUTH_121 : 88|13@1+ (0.0004,-1.5708) [-1.5708|1.5708] "rad"  FCM_A0
 SG_ DET_AZIMUTH_ERR_121 : 105|7@1+ (0.00087267,0) [0|0.11082909] "rad"  FCM_A0
 SG_ DET_ELEVATION_121 : 72|8@1+ (0.00275,-0.34925) [-0.34925|0.34925] "rad"  FCM_A0
 SG_ DET_ELEVATION_ERR_121 : 80|6@1+ (0.00174533,0) [0|0.10995579] "rad"  FCM_A0
 SG_ DET_RCS_121 : 128|8@1+ (0.5,-64) [-64|63.5] "dBsm"  FCM_A0
 SG_ DET_BI_STATIC_FLAG_121 : 104|1@1+ (1,0) [0|1] ""  FCM_A0
 SG_ DET_SUPER_RES_TARGET_121 : 87|1@1+ (1,0) [0|1] ""  FCM_A0
 SG_ DET_SNR_121 : 120|8@1+ (0.35156,0) [0|89.6478] "dB"  FCM_A0
 SG_ DET_EXISTENCE_PROB_121 : 112|6@1+ (1.588,0) [0|100] "%"  FCM_A0
 SG_ DET_HVC_FLAG_121 : 86|1@1+ (1,0) [0|1] ""  FCM_A0
 SG_ DET_CONFD_AZIMUTH_121 : 118|2@1+ (1,0) [0|3] ""  FCM_A0
 SG_ DET_CONFD_ELEVATION_121 : 101|2@1+ (1,0) [0|3] ""  FCM_A0
 SG_ DET_PROB_1STAZHYPO_121 : 103|1@1+ (1,0) [0|1] ""  FCM_A0
 SG_ DET_IDM_121 : 63|1@1+ (1,0) [0|1] ""  FCM_A0
 SG_ DET_MTD_121 : 47|1@1+ (1,0) [0|1] ""  FCM_A0
 SG_ DET_BELOW_RAIN_THOLD_121 : 39|1@1+ (1,0) [0|1] ""  FCM_A0
 SG_ DET_RANGE_122 : 136|15@1+ (0.015625,0) [0|500] "m"  FCM_A0
 SG_ DET_RANGE_ERR_122 : 152|7@1+ (0.0075,0) [0|0.9525] "m"  FCM_A0
 SG_ DET_RANGE_VELOCITY_122 : 160|15@1+ (0.0078125,-128) [-128|127.9921875] "m/s"  FCM_A0
 SG_ DET_RANGE_VELOCITY_ERR_122 : 176|8@1+ (0.003,0) [0|0.765] "m/s"  FCM_A0
 SG_ DET_AZIMUTH_122 : 200|13@1+ (0.0004,-1.5708) [-1.5708|1.5708] "rad"  FCM_A0
 SG_ DET_AZIMUTH_ERR_122 : 217|7@1+ (0.00087267,0) [0|0.11082909] "rad"  FCM_A0
 SG_ DET_ELEVATION_122 : 184|8@1+ (0.00275,-0.34925) [-0.34925|0.34925] "rad"  FCM_A0
 SG_ DET_ELEVATION_ERR_122 : 192|6@1+ (0.00174533,0) [0|0.10995579] "rad"  FCM_A0
 SG_ DET_RCS_122 : 240|8@1+ (0.5,-64) [-64|63.5] "dBsm"  FCM_A0
 SG_ DET_BI_STATIC_FLAG_122 : 216|1@1+ (1,0) [0|1] ""  FCM_A0
 SG_ DET_SUPER_RES_TARGET_122 : 199|1@1+ (1,0) [0|1] ""  FCM_A0
 SG_ DET_SNR_122 : 232|8@1+ (0.35156,0) [0|89.6478] "dB"  FCM_A0
 SG_ DET_EXISTENCE_PROB_122 : 224|6@1+ (1.588,0) [0|100] "%"  FCM_A0
 SG_ DET_HVC_FLAG_122 : 198|1@1+ (1,0) [0|1] ""  FCM_A0
 SG_ DET_CONFD_AZIMUTH_122 : 230|2@1+ (1,0) [0|3] ""  FCM_A0
 SG_ DET_CONFD_ELEVATION_122 : 213|2@1+ (1,0) [0|3] ""  FCM_A0
 SG_ DET_PROB_1STAZHYPO_122 : 215|1@1+ (1,0) [0|1] ""  FCM_A0
 SG_ DET_IDM_122 : 175|1@1+ (1,0) [0|1] ""  FCM_A0
 SG_ DET_MTD_122 : 159|1@1+ (1,0) [0|1] ""  FCM_A0
 SG_ DET_BELOW_RAIN_THOLD_122 : 151|1@1+ (1,0) [0|1] ""  FCM_A0
 SG_ DET_RANGE_123 : 248|15@1+ (0.015625,0) [0|500] "m"  FCM_A0
 SG_ DET_RANGE_ERR_123 : 264|7@1+ (0.0075,0) [0|0.9525] "m"  FCM_A0
 SG_ DET_RANGE_VELOCITY_123 : 272|15@1+ (0.0078125,-128) [-128|127.9921875] "m/s"  FCM_A0
 SG_ DET_RANGE_VELOCITY_ERR_123 : 288|8@1+ (0.003,0) [0|0.765] "m/s"  FCM_A0
 SG_ DET_AZIMUTH_123 : 312|13@1+ (0.0004,-1.5708) [-1.5708|1.5708] "rad"  FCM_A0
 SG_ DET_AZIMUTH_ERR_123 : 329|7@1+ (0.00087267,0) [0|0.11082909] "rad"  FCM_A0
 SG_ DET_ELEVATION_123 : 296|8@1+ (0.00275,-0.34925) [-0.34925|0.34925] "rad"  FCM_A0
 SG_ DET_ELEVATION_ERR_123 : 304|6@1+ (0.00174533,0) [0|0.10995579] "rad"  FCM_A0
 SG_ DET_RCS_123 : 352|8@1+ (0.5,-64) [-64|63.5] "dBsm"  FCM_A0
 SG_ DET_BI_STATIC_FLAG_123 : 328|1@1+ (1,0) [0|1] ""  FCM_A0
 SG_ DET_SUPER_RES_TARGET_123 : 311|1@1+ (1,0) [0|1] ""  FCM_A0
 SG_ DET_SNR_123 : 344|8@1+ (0.35156,0) [0|89.6478] "dB"  FCM_A0
 SG_ DET_EXISTENCE_PROB_123 : 336|6@1+ (1.588,0) [0|100] "%"  FCM_A0
 SG_ DET_HVC_FLAG_123 : 310|1@1+ (1,0) [0|1] ""  FCM_A0
 SG_ DET_CONFD_AZIMUTH_123 : 342|2@1+ (1,0) [0|3] ""  FCM_A0
 SG_ DET_CONFD_ELEVATION_123 : 325|2@1+ (1,0) [0|3] ""  FCM_A0
 SG_ DET_PROB_1STAZHYPO_123 : 327|1@1+ (1,0) [0|1] ""  FCM_A0
 SG_ DET_IDM_123 : 287|1@1+ (1,0) [0|1] ""  FCM_A0
 SG_ DET_MTD_123 : 271|1@1+ (1,0) [0|1] ""  FCM_A0
 SG_ DET_BELOW_RAIN_THOLD_123 : 263|1@1+ (1,0) [0|1] ""  FCM_A0
 SG_ DET_RANGE_124 : 360|15@1+ (0.015625,0) [0|500] "m"  FCM_A0
 SG_ DET_RANGE_ERR_124 : 376|7@1+ (0.0075,0) [0|0.9525] "m"  FCM_A0
 SG_ DET_RANGE_VELOCITY_124 : 384|15@1+ (0.0078125,-128) [-128|127.9921875] "m/s"  FCM_A0
 SG_ DET_RANGE_VELOCITY_ERR_124 : 400|8@1+ (0.003,0) [0|0.765] "m/s"  FCM_A0
 SG_ DET_AZIMUTH_124 : 424|13@1+ (0.0004,-1.5708) [-1.5708|1.5708] "rad"  FCM_A0
 SG_ DET_AZIMUTH_ERR_124 : 441|7@1+ (0.00087267,0) [0|0.11082909] "rad"  FCM_A0
 SG_ DET_ELEVATION_124 : 408|8@1+ (0.00275,-0.34925) [-0.34925|0.34925] "rad"  FCM_A0
 SG_ DET_ELEVATION_ERR_124 : 416|6@1+ (0.00174533,0) [0|0.10995579] "rad"  FCM_A0
 SG_ DET_RCS_124 : 464|8@1+ (0.5,-64) [-64|63.5] "dBsm"  FCM_A0
 SG_ DET_BI_STATIC_FLAG_124 : 440|1@1+ (1,0) [0|1] ""  FCM_A0
 SG_ DET_SUPER_RES_TARGET_124 : 423|1@1+ (1,0) [0|1] ""  FCM_A0
 SG_ DET_SNR_124 : 456|8@1+ (0.35156,0) [0|89.6478] "dB"  FCM_A0
 SG_ DET_EXISTENCE_PROB_124 : 448|6@1+ (1.588,0) [0|100] "%"  FCM_A0
 SG_ DET_HVC_FLAG_124 : 422|1@1+ (1,0) [0|1] ""  FCM_A0
 SG_ DET_CONFD_AZIMUTH_124 : 454|2@1+ (1,0) [0|3] ""  FCM_A0
 SG_ DET_CONFD_ELEVATION_124 : 437|2@1+ (1,0) [0|3] ""  FCM_A0
 SG_ DET_MH_SCAN_INDEX_4LSB_121_124 : 476|4@1+ (1,0) [0|15] ""  FCM_A0
 SG_ DET_MH_CYCLE_COUNTER_121_124 : 16|8@1+ (1,0) [0|255] ""  FCM_A0
 SG_ DET_MH_CRC16_121_124 : 0|16@1+ (1,0) [0|65535] ""  FCM_A0
 SG_ DET_PROB_1STAZHYPO_124 : 439|1@1+ (1,0) [0|1] ""  FCM_A0
 SG_ DET_IDM_124 : 399|1@1+ (1,0) [0|1] ""  FCM_A0
 SG_ DET_MTD_124 : 383|1@1+ (1,0) [0|1] ""  FCM_A0
 SG_ DET_BELOW_RAIN_THOLD_124 : 375|1@1+ (1,0) [0|1] ""  FCM_A0

BO_ 797 FLR_DETECTION_117_120: 64 FLR
 SG_ DET_RANGE_117 : 24|15@1+ (0.015625,0) [0|500] "m"  FCM_A0
 SG_ DET_RANGE_ERR_117 : 40|7@1+ (0.0075,0) [0|0.9525] "m"  FCM_A0
 SG_ DET_RANGE_VELOCITY_117 : 48|15@1+ (0.0078125,-128) [-128|127.9921875] "m/s"  FCM_A0
 SG_ DET_RANGE_VELOCITY_ERR_117 : 64|8@1+ (0.003,0) [0|0.765] "m/s"  FCM_A0
 SG_ DET_AZIMUTH_117 : 88|13@1+ (0.0004,-1.5708) [-1.5708|1.5708] "rad"  FCM_A0
 SG_ DET_AZIMUTH_ERR_117 : 105|7@1+ (0.00087267,0) [0|0.11082909] "rad"  FCM_A0
 SG_ DET_ELEVATION_117 : 72|8@1+ (0.00275,-0.34925) [-0.34925|0.34925] "rad"  FCM_A0
 SG_ DET_ELEVATION_ERR_117 : 80|6@1+ (0.00174533,0) [0|0.10995579] "rad"  FCM_A0
 SG_ DET_RCS_117 : 128|8@1+ (0.5,-64) [-64|63.5] "dBsm"  FCM_A0
 SG_ DET_BI_STATIC_FLAG_117 : 104|1@1+ (1,0) [0|1] ""  FCM_A0
 SG_ DET_SUPER_RES_TARGET_117 : 87|1@1+ (1,0) [0|1] ""  FCM_A0
 SG_ DET_SNR_117 : 120|8@1+ (0.35156,0) [0|89.6478] "dB"  FCM_A0
 SG_ DET_EXISTENCE_PROB_117 : 112|6@1+ (1.588,0) [0|100] "%"  FCM_A0
 SG_ DET_HVC_FLAG_117 : 86|1@1+ (1,0) [0|1] ""  FCM_A0
 SG_ DET_CONFD_AZIMUTH_117 : 118|2@1+ (1,0) [0|3] ""  FCM_A0
 SG_ DET_CONFD_ELEVATION_117 : 101|2@1+ (1,0) [0|3] ""  FCM_A0
 SG_ DET_PROB_1STAZHYPO_117 : 103|1@1+ (1,0) [0|1] ""  FCM_A0
 SG_ DET_IDM_117 : 63|1@1+ (1,0) [0|1] ""  FCM_A0
 SG_ DET_MTD_117 : 47|1@1+ (1,0) [0|1] ""  FCM_A0
 SG_ DET_BELOW_RAIN_THOLD_117 : 39|1@1+ (1,0) [0|1] ""  FCM_A0
 SG_ DET_RANGE_118 : 136|15@1+ (0.015625,0) [0|500] "m"  FCM_A0
 SG_ DET_RANGE_ERR_118 : 152|7@1+ (0.0075,0) [0|0.9525] "m"  FCM_A0
 SG_ DET_RANGE_VELOCITY_118 : 160|15@1+ (0.0078125,-128) [-128|127.9921875] "m/s"  FCM_A0
 SG_ DET_RANGE_VELOCITY_ERR_118 : 176|8@1+ (0.003,0) [0|0.765] "m/s"  FCM_A0
 SG_ DET_AZIMUTH_118 : 200|13@1+ (0.0004,-1.5708) [-1.5708|1.5708] "rad"  FCM_A0
 SG_ DET_AZIMUTH_ERR_118 : 217|7@1+ (0.00087267,0) [0|0.11082909] "rad"  FCM_A0
 SG_ DET_ELEVATION_118 : 184|8@1+ (0.00275,-0.34925) [-0.34925|0.34925] "rad"  FCM_A0
 SG_ DET_ELEVATION_ERR_118 : 192|6@1+ (0.00174533,0) [0|0.10995579] "rad"  FCM_A0
 SG_ DET_RCS_118 : 240|8@1+ (0.5,-64) [-64|63.5] "dBsm"  FCM_A0
 SG_ DET_BI_STATIC_FLAG_118 : 216|1@1+ (1,0) [0|1] ""  FCM_A0
 SG_ DET_SUPER_RES_TARGET_118 : 199|1@1+ (1,0) [0|1] ""  FCM_A0
 SG_ DET_SNR_118 : 232|8@1+ (0.35156,0) [0|89.6478] "dB"  FCM_A0
 SG_ DET_EXISTENCE_PROB_118 : 224|6@1+ (1.588,0) [0|100] "%"  FCM_A0
 SG_ DET_HVC_FLAG_118 : 198|1@1+ (1,0) [0|1] ""  FCM_A0
 SG_ DET_CONFD_AZIMUTH_118 : 230|2@1+ (1,0) [0|3] ""  FCM_A0
 SG_ DET_CONFD_ELEVATION_118 : 213|2@1+ (1,0) [0|3] ""  FCM_A0
 SG_ DET_PROB_1STAZHYPO_118 : 215|1@1+ (1,0) [0|1] ""  FCM_A0
 SG_ DET_IDM_118 : 175|1@1+ (1,0) [0|1] ""  FCM_A0
 SG_ DET_MTD_118 : 159|1@1+ (1,0) [0|1] ""  FCM_A0
 SG_ DET_BELOW_RAIN_THOLD_118 : 151|1@1+ (1,0) [0|1] ""  FCM_A0
 SG_ DET_RANGE_119 : 248|15@1+ (0.015625,0) [0|500] "m"  FCM_A0
 SG_ DET_RANGE_ERR_119 : 264|7@1+ (0.0075,0) [0|0.9525] "m"  FCM_A0
 SG_ DET_RANGE_VELOCITY_119 : 272|15@1+ (0.0078125,-128) [-128|127.9921875] "m/s"  FCM_A0
 SG_ DET_RANGE_VELOCITY_ERR_119 : 288|8@1+ (0.003,0) [0|0.765] "m/s"  FCM_A0
 SG_ DET_AZIMUTH_119 : 312|13@1+ (0.0004,-1.5708) [-1.5708|1.5708] "rad"  FCM_A0
 SG_ DET_AZIMUTH_ERR_119 : 329|7@1+ (0.00087267,0) [0|0.11082909] "rad"  FCM_A0
 SG_ DET_ELEVATION_119 : 296|8@1+ (0.00275,-0.34925) [-0.34925|0.34925] "rad"  FCM_A0
 SG_ DET_ELEVATION_ERR_119 : 304|6@1+ (0.00174533,0) [0|0.10995579] "rad"  FCM_A0
 SG_ DET_RCS_119 : 352|8@1+ (0.5,-64) [-64|63.5] "dBsm"  FCM_A0
 SG_ DET_BI_STATIC_FLAG_119 : 328|1@1+ (1,0) [0|1] ""  FCM_A0
 SG_ DET_SUPER_RES_TARGET_119 : 311|1@1+ (1,0) [0|1] ""  FCM_A0
 SG_ DET_SNR_119 : 344|8@1+ (0.35156,0) [0|89.6478] "dB"  FCM_A0
 SG_ DET_EXISTENCE_PROB_119 : 336|6@1+ (1.588,0) [0|100] "%"  FCM_A0
 SG_ DET_HVC_FLAG_119 : 310|1@1+ (1,0) [0|1] ""  FCM_A0
 SG_ DET_CONFD_AZIMUTH_119 : 342|2@1+ (1,0) [0|3] ""  FCM_A0
 SG_ DET_CONFD_ELEVATION_119 : 325|2@1+ (1,0) [0|3] ""  FCM_A0
 SG_ DET_PROB_1STAZHYPO_119 : 327|1@1+ (1,0) [0|1] ""  FCM_A0
 SG_ DET_IDM_119 : 287|1@1+ (1,0) [0|1] ""  FCM_A0
 SG_ DET_MTD_119 : 271|1@1+ (1,0) [0|1] ""  FCM_A0
 SG_ DET_BELOW_RAIN_THOLD_119 : 263|1@1+ (1,0) [0|1] ""  FCM_A0
 SG_ DET_RANGE_120 : 360|15@1+ (0.015625,0) [0|500] "m"  FCM_A0
 SG_ DET_RANGE_ERR_120 : 376|7@1+ (0.0075,0) [0|0.9525] "m"  FCM_A0
 SG_ DET_RANGE_VELOCITY_120 : 384|15@1+ (0.0078125,-128) [-128|127.9921875] "m/s"  FCM_A0
 SG_ DET_RANGE_VELOCITY_ERR_120 : 400|8@1+ (0.003,0) [0|0.765] "m/s"  FCM_A0
 SG_ DET_AZIMUTH_120 : 424|13@1+ (0.0004,-1.5708) [-1.5708|1.5708] "rad"  FCM_A0
 SG_ DET_AZIMUTH_ERR_120 : 441|7@1+ (0.00087267,0) [0|0.11082909] "rad"  FCM_A0
 SG_ DET_ELEVATION_120 : 408|8@1+ (0.00275,-0.34925) [-0.34925|0.34925] "rad"  FCM_A0
 SG_ DET_ELEVATION_ERR_120 : 416|6@1+ (0.00174533,0) [0|0.10995579] "rad"  FCM_A0
 SG_ DET_RCS_120 : 464|8@1+ (0.5,-64) [-64|63.5] "dBsm"  FCM_A0
 SG_ DET_BI_STATIC_FLAG_120 : 440|1@1+ (1,0) [0|1] ""  FCM_A0
 SG_ DET_SUPER_RES_TARGET_120 : 423|1@1+ (1,0) [0|1] ""  FCM_A0
 SG_ DET_SNR_120 : 456|8@1+ (0.35156,0) [0|89.6478] "dB"  FCM_A0
 SG_ DET_EXISTENCE_PROB_120 : 448|6@1+ (1.588,0) [0|100] "%"  FCM_A0
 SG_ DET_HVC_FLAG_120 : 422|1@1+ (1,0) [0|1] ""  FCM_A0
 SG_ DET_CONFD_AZIMUTH_120 : 454|2@1+ (1,0) [0|3] ""  FCM_A0
 SG_ DET_CONFD_ELEVATION_120 : 437|2@1+ (1,0) [0|3] ""  FCM_A0
 SG_ DET_MH_SCAN_INDEX_4LSB_117_120 : 476|4@1+ (1,0) [0|15] ""  FCM_A0
 SG_ DET_MH_CYCLE_COUNTER_117_120 : 16|8@1+ (1,0) [0|255] ""  FCM_A0
 SG_ DET_MH_CRC16_117_120 : 0|16@1+ (1,0) [0|65535] ""  FCM_A0
 SG_ DET_PROB_1STAZHYPO_120 : 439|1@1+ (1,0) [0|1] ""  FCM_A0
 SG_ DET_IDM_120 : 399|1@1+ (1,0) [0|1] ""  FCM_A0
 SG_ DET_MTD_120 : 383|1@1+ (1,0) [0|1] ""  FCM_A0
 SG_ DET_BELOW_RAIN_THOLD_120 : 375|1@1+ (1,0) [0|1] ""  FCM_A0

BO_ 796 FLR_DETECTION_113_116: 64 FLR
 SG_ DET_RANGE_113 : 24|15@1+ (0.015625,0) [0|500] "m"  FCM_A0
 SG_ DET_RANGE_ERR_113 : 40|7@1+ (0.0075,0) [0|0.9525] "m"  FCM_A0
 SG_ DET_RANGE_VELOCITY_113 : 48|15@1+ (0.0078125,-128) [-128|127.9921875] "m/s"  FCM_A0
 SG_ DET_RANGE_VELOCITY_ERR_113 : 64|8@1+ (0.003,0) [0|0.765] "m/s"  FCM_A0
 SG_ DET_AZIMUTH_113 : 88|13@1+ (0.0004,-1.5708) [-1.5708|1.5708] "rad"  FCM_A0
 SG_ DET_AZIMUTH_ERR_113 : 105|7@1+ (0.00087267,0) [0|0.11082909] "rad"  FCM_A0
 SG_ DET_ELEVATION_113 : 72|8@1+ (0.00275,-0.34925) [-0.34925|0.34925] "rad"  FCM_A0
 SG_ DET_ELEVATION_ERR_113 : 80|6@1+ (0.00174533,0) [0|0.10995579] "rad"  FCM_A0
 SG_ DET_RCS_113 : 128|8@1+ (0.5,-64) [-64|63.5] "dBsm"  FCM_A0
 SG_ DET_BI_STATIC_FLAG_113 : 104|1@1+ (1,0) [0|1] ""  FCM_A0
 SG_ DET_SUPER_RES_TARGET_113 : 87|1@1+ (1,0) [0|1] ""  FCM_A0
 SG_ DET_SNR_113 : 120|8@1+ (0.35156,0) [0|89.6478] "dB"  FCM_A0
 SG_ DET_EXISTENCE_PROB_113 : 112|6@1+ (1.588,0) [0|100] "%"  FCM_A0
 SG_ DET_HVC_FLAG_113 : 86|1@1+ (1,0) [0|1] ""  FCM_A0
 SG_ DET_CONFD_AZIMUTH_113 : 118|2@1+ (1,0) [0|3] ""  FCM_A0
 SG_ DET_CONFD_ELEVATION_113 : 101|2@1+ (1,0) [0|3] ""  FCM_A0
 SG_ DET_PROB_1STAZHYPO_113 : 103|1@1+ (1,0) [0|1] ""  FCM_A0
 SG_ DET_IDM_113 : 63|1@1+ (1,0) [0|1] ""  FCM_A0
 SG_ DET_MTD_113 : 47|1@1+ (1,0) [0|1] ""  FCM_A0
 SG_ DET_BELOW_RAIN_THOLD_113 : 39|1@1+ (1,0) [0|1] ""  FCM_A0
 SG_ DET_RANGE_114 : 136|15@1+ (0.015625,0) [0|500] "m"  FCM_A0
 SG_ DET_RANGE_ERR_114 : 152|7@1+ (0.0075,0) [0|0.9525] "m"  FCM_A0
 SG_ DET_RANGE_VELOCITY_114 : 160|15@1+ (0.0078125,-128) [-128|127.9921875] "m/s"  FCM_A0
 SG_ DET_RANGE_VELOCITY_ERR_114 : 176|8@1+ (0.003,0) [0|0.765] "m/s"  FCM_A0
 SG_ DET_AZIMUTH_114 : 200|13@1+ (0.0004,-1.5708) [-1.5708|1.5708] "rad"  FCM_A0
 SG_ DET_AZIMUTH_ERR_114 : 217|7@1+ (0.00087267,0) [0|0.11082909] "rad"  FCM_A0
 SG_ DET_ELEVATION_114 : 184|8@1+ (0.00275,-0.34925) [-0.34925|0.34925] "rad"  FCM_A0
 SG_ DET_ELEVATION_ERR_114 : 192|6@1+ (0.00174533,0) [0|0.10995579] "rad"  FCM_A0
 SG_ DET_RCS_114 : 240|8@1+ (0.5,-64) [-64|63.5] "dBsm"  FCM_A0
 SG_ DET_BI_STATIC_FLAG_114 : 216|1@1+ (1,0) [0|1] ""  FCM_A0
 SG_ DET_SUPER_RES_TARGET_114 : 199|1@1+ (1,0) [0|1] ""  FCM_A0
 SG_ DET_SNR_114 : 232|8@1+ (0.35156,0) [0|89.6478] "dB"  FCM_A0
 SG_ DET_EXISTENCE_PROB_114 : 224|6@1+ (1.588,0) [0|100] "%"  FCM_A0
 SG_ DET_HVC_FLAG_114 : 198|1@1+ (1,0) [0|1] ""  FCM_A0
 SG_ DET_CONFD_AZIMUTH_114 : 230|2@1+ (1,0) [0|3] ""  FCM_A0
 SG_ DET_CONFD_ELEVATION_114 : 213|2@1+ (1,0) [0|3] ""  FCM_A0
 SG_ DET_PROB_1STAZHYPO_114 : 215|1@1+ (1,0) [0|1] ""  FCM_A0
 SG_ DET_IDM_114 : 175|1@1+ (1,0) [0|1] ""  FCM_A0
 SG_ DET_MTD_114 : 159|1@1+ (1,0) [0|1] ""  FCM_A0
 SG_ DET_BELOW_RAIN_THOLD_114 : 151|1@1+ (1,0) [0|1] ""  FCM_A0
 SG_ DET_RANGE_115 : 248|15@1+ (0.015625,0) [0|500] "m"  FCM_A0
 SG_ DET_RANGE_ERR_115 : 264|7@1+ (0.0075,0) [0|0.9525] "m"  FCM_A0
 SG_ DET_RANGE_VELOCITY_115 : 272|15@1+ (0.0078125,-128) [-128|127.9921875] "m/s"  FCM_A0
 SG_ DET_RANGE_VELOCITY_ERR_115 : 288|8@1+ (0.003,0) [0|0.765] "m/s"  FCM_A0
 SG_ DET_AZIMUTH_115 : 312|13@1+ (0.0004,-1.5708) [-1.5708|1.5708] "rad"  FCM_A0
 SG_ DET_AZIMUTH_ERR_115 : 329|7@1+ (0.00087267,0) [0|0.11082909] "rad"  FCM_A0
 SG_ DET_ELEVATION_115 : 296|8@1+ (0.00275,-0.34925) [-0.34925|0.34925] "rad"  FCM_A0
 SG_ DET_ELEVATION_ERR_115 : 304|6@1+ (0.00174533,0) [0|0.10995579] "rad"  FCM_A0
 SG_ DET_RCS_115 : 352|8@1+ (0.5,-64) [-64|63.5] "dBsm"  FCM_A0
 SG_ DET_BI_STATIC_FLAG_115 : 328|1@1+ (1,0) [0|1] ""  FCM_A0
 SG_ DET_SUPER_RES_TARGET_115 : 311|1@1+ (1,0) [0|1] ""  FCM_A0
 SG_ DET_SNR_115 : 344|8@1+ (0.35156,0) [0|89.6478] "dB"  FCM_A0
 SG_ DET_EXISTENCE_PROB_115 : 336|6@1+ (1.588,0) [0|100] "%"  FCM_A0
 SG_ DET_HVC_FLAG_115 : 310|1@1+ (1,0) [0|1] ""  FCM_A0
 SG_ DET_CONFD_AZIMUTH_115 : 342|2@1+ (1,0) [0|3] ""  FCM_A0
 SG_ DET_CONFD_ELEVATION_115 : 325|2@1+ (1,0) [0|3] ""  FCM_A0
 SG_ DET_PROB_1STAZHYPO_115 : 327|1@1+ (1,0) [0|1] ""  FCM_A0
 SG_ DET_IDM_115 : 287|1@1+ (1,0) [0|1] ""  FCM_A0
 SG_ DET_MTD_115 : 271|1@1+ (1,0) [0|1] ""  FCM_A0
 SG_ DET_BELOW_RAIN_THOLD_115 : 263|1@1+ (1,0) [0|1] ""  FCM_A0
 SG_ DET_RANGE_116 : 360|15@1+ (0.015625,0) [0|500] "m"  FCM_A0
 SG_ DET_RANGE_ERR_116 : 376|7@1+ (0.0075,0) [0|0.9525] "m"  FCM_A0
 SG_ DET_RANGE_VELOCITY_116 : 384|15@1+ (0.0078125,-128) [-128|127.9921875] "m/s"  FCM_A0
 SG_ DET_RANGE_VELOCITY_ERR_116 : 400|8@1+ (0.003,0) [0|0.765] "m/s"  FCM_A0
 SG_ DET_AZIMUTH_116 : 424|13@1+ (0.0004,-1.5708) [-1.5708|1.5708] "rad"  FCM_A0
 SG_ DET_AZIMUTH_ERR_116 : 441|7@1+ (0.00087267,0) [0|0.11082909] "rad"  FCM_A0
 SG_ DET_ELEVATION_116 : 408|8@1+ (0.00275,-0.34925) [-0.34925|0.34925] "rad"  FCM_A0
 SG_ DET_ELEVATION_ERR_116 : 416|6@1+ (0.00174533,0) [0|0.10995579] "rad"  FCM_A0
 SG_ DET_RCS_116 : 464|8@1+ (0.5,-64) [-64|63.5] "dBsm"  FCM_A0
 SG_ DET_BI_STATIC_FLAG_116 : 440|1@1+ (1,0) [0|1] ""  FCM_A0
 SG_ DET_SUPER_RES_TARGET_116 : 423|1@1+ (1,0) [0|1] ""  FCM_A0
 SG_ DET_SNR_116 : 456|8@1+ (0.35156,0) [0|89.6478] "dB"  FCM_A0
 SG_ DET_EXISTENCE_PROB_116 : 448|6@1+ (1.588,0) [0|100] "%"  FCM_A0
 SG_ DET_HVC_FLAG_116 : 422|1@1+ (1,0) [0|1] ""  FCM_A0
 SG_ DET_CONFD_AZIMUTH_116 : 454|2@1+ (1,0) [0|3] ""  FCM_A0
 SG_ DET_CONFD_ELEVATION_116 : 437|2@1+ (1,0) [0|3] ""  FCM_A0
 SG_ DET_MH_SCAN_INDEX_4LSB_113_116 : 476|4@1+ (1,0) [0|15] ""  FCM_A0
 SG_ DET_MH_CYCLE_COUNTER_113_116 : 16|8@1+ (1,0) [0|255] ""  FCM_A0
 SG_ DET_MH_CRC16_113_116 : 0|16@1+ (1,0) [0|65535] ""  FCM_A0
 SG_ DET_PROB_1STAZHYPO_116 : 439|1@1+ (1,0) [0|1] ""  FCM_A0
 SG_ DET_IDM_116 : 399|1@1+ (1,0) [0|1] ""  FCM_A0
 SG_ DET_MTD_116 : 383|1@1+ (1,0) [0|1] ""  FCM_A0
 SG_ DET_BELOW_RAIN_THOLD_116 : 375|1@1+ (1,0) [0|1] ""  FCM_A0

BO_ 795 FLR_DETECTION_109_112: 64 FLR
 SG_ DET_RANGE_109 : 24|15@1+ (0.015625,0) [0|500] "m"  FCM_A0
 SG_ DET_RANGE_ERR_109 : 40|7@1+ (0.0075,0) [0|0.9525] "m"  FCM_A0
 SG_ DET_RANGE_VELOCITY_109 : 48|15@1+ (0.0078125,-128) [-128|127.9921875] "m/s"  FCM_A0
 SG_ DET_RANGE_VELOCITY_ERR_109 : 64|8@1+ (0.003,0) [0|0.765] "m/s"  FCM_A0
 SG_ DET_AZIMUTH_109 : 88|13@1+ (0.0004,-1.5708) [-1.5708|1.5708] "rad"  FCM_A0
 SG_ DET_AZIMUTH_ERR_109 : 105|7@1+ (0.00087267,0) [0|0.11082909] "rad"  FCM_A0
 SG_ DET_ELEVATION_109 : 72|8@1+ (0.00275,-0.34925) [-0.34925|0.34925] "rad"  FCM_A0
 SG_ DET_ELEVATION_ERR_109 : 80|6@1+ (0.00174533,0) [0|0.10995579] "rad"  FCM_A0
 SG_ DET_RCS_109 : 128|8@1+ (0.5,-64) [-64|63.5] "dBsm"  FCM_A0
 SG_ DET_BI_STATIC_FLAG_109 : 104|1@1+ (1,0) [0|1] ""  FCM_A0
 SG_ DET_SUPER_RES_TARGET_109 : 87|1@1+ (1,0) [0|1] ""  FCM_A0
 SG_ DET_SNR_109 : 120|8@1+ (0.35156,0) [0|89.6478] "dB"  FCM_A0
 SG_ DET_EXISTENCE_PROB_109 : 112|6@1+ (1.588,0) [0|100] "%"  FCM_A0
 SG_ DET_HVC_FLAG_109 : 86|1@1+ (1,0) [0|1] ""  FCM_A0
 SG_ DET_CONFD_AZIMUTH_109 : 118|2@1+ (1,0) [0|3] ""  FCM_A0
 SG_ DET_CONFD_ELEVATION_109 : 101|2@1+ (1,0) [0|3] ""  FCM_A0
 SG_ DET_PROB_1STAZHYPO_109 : 103|1@1+ (1,0) [0|1] ""  FCM_A0
 SG_ DET_IDM_109 : 63|1@1+ (1,0) [0|1] ""  FCM_A0
 SG_ DET_MTD_109 : 47|1@1+ (1,0) [0|1] ""  FCM_A0
 SG_ DET_BELOW_RAIN_THOLD_109 : 39|1@1+ (1,0) [0|1] ""  FCM_A0
 SG_ DET_RANGE_110 : 136|15@1+ (0.015625,0) [0|500] "m"  FCM_A0
 SG_ DET_RANGE_ERR_110 : 152|7@1+ (0.0075,0) [0|0.9525] "m"  FCM_A0
 SG_ DET_RANGE_VELOCITY_110 : 160|15@1+ (0.0078125,-128) [-128|127.9921875] "m/s"  FCM_A0
 SG_ DET_RANGE_VELOCITY_ERR_110 : 176|8@1+ (0.003,0) [0|0.765] "m/s"  FCM_A0
 SG_ DET_AZIMUTH_110 : 200|13@1+ (0.0004,-1.5708) [-1.5708|1.5708] "rad"  FCM_A0
 SG_ DET_AZIMUTH_ERR_110 : 217|7@1+ (0.00087267,0) [0|0.11082909] "rad"  FCM_A0
 SG_ DET_ELEVATION_110 : 184|8@1+ (0.00275,-0.34925) [-0.34925|0.34925] "rad"  FCM_A0
 SG_ DET_ELEVATION_ERR_110 : 192|6@1+ (0.00174533,0) [0|0.10995579] "rad"  FCM_A0
 SG_ DET_RCS_110 : 240|8@1+ (0.5,-64) [-64|63.5] "dBsm"  FCM_A0
 SG_ DET_BI_STATIC_FLAG_110 : 216|1@1+ (1,0) [0|1] ""  FCM_A0
 SG_ DET_SUPER_RES_TARGET_110 : 199|1@1+ (1,0) [0|1] ""  FCM_A0
 SG_ DET_SNR_110 : 232|8@1+ (0.35156,0) [0|89.6478] "dB"  FCM_A0
 SG_ DET_EXISTENCE_PROB_110 : 224|6@1+ (1.588,0) [0|100] "%"  FCM_A0
 SG_ DET_HVC_FLAG_110 : 198|1@1+ (1,0) [0|1] ""  FCM_A0
 SG_ DET_CONFD_AZIMUTH_110 : 230|2@1+ (1,0) [0|3] ""  FCM_A0
 SG_ DET_CONFD_ELEVATION_110 : 213|2@1+ (1,0) [0|3] ""  FCM_A0
 SG_ DET_PROB_1STAZHYPO_110 : 215|1@1+ (1,0) [0|1] ""  FCM_A0
 SG_ DET_IDM_110 : 175|1@1+ (1,0) [0|1] ""  FCM_A0
 SG_ DET_MTD_110 : 159|1@1+ (1,0) [0|1] ""  FCM_A0
 SG_ DET_BELOW_RAIN_THOLD_110 : 151|1@1+ (1,0) [0|1] ""  FCM_A0
 SG_ DET_RANGE_111 : 248|15@1+ (0.015625,0) [0|500] "m"  FCM_A0
 SG_ DET_RANGE_ERR_111 : 264|7@1+ (0.0075,0) [0|0.9525] "m"  FCM_A0
 SG_ DET_RANGE_VELOCITY_111 : 272|15@1+ (0.0078125,-128) [-128|127.9921875] "m/s"  FCM_A0
 SG_ DET_RANGE_VELOCITY_ERR_111 : 288|8@1+ (0.003,0) [0|0.765] "m/s"  FCM_A0
 SG_ DET_AZIMUTH_111 : 312|13@1+ (0.0004,-1.5708) [-1.5708|1.5708] "rad"  FCM_A0
 SG_ DET_AZIMUTH_ERR_111 : 329|7@1+ (0.00087267,0) [0|0.11082909] "rad"  FCM_A0
 SG_ DET_ELEVATION_111 : 296|8@1+ (0.00275,-0.34925) [-0.34925|0.34925] "rad"  FCM_A0
 SG_ DET_ELEVATION_ERR_111 : 304|6@1+ (0.00174533,0) [0|0.10995579] "rad"  FCM_A0
 SG_ DET_RCS_111 : 352|8@1+ (0.5,-64) [-64|63.5] "dBsm"  FCM_A0
 SG_ DET_BI_STATIC_FLAG_111 : 328|1@1+ (1,0) [0|1] ""  FCM_A0
 SG_ DET_SUPER_RES_TARGET_111 : 311|1@1+ (1,0) [0|1] ""  FCM_A0
 SG_ DET_SNR_111 : 344|8@1+ (0.35156,0) [0|89.6478] "dB"  FCM_A0
 SG_ DET_EXISTENCE_PROB_111 : 336|6@1+ (1.588,0) [0|100] "%"  FCM_A0
 SG_ DET_HVC_FLAG_111 : 310|1@1+ (1,0) [0|1] ""  FCM_A0
 SG_ DET_CONFD_AZIMUTH_111 : 342|2@1+ (1,0) [0|3] ""  FCM_A0
 SG_ DET_CONFD_ELEVATION_111 : 325|2@1+ (1,0) [0|3] ""  FCM_A0
 SG_ DET_PROB_1STAZHYPO_111 : 327|1@1+ (1,0) [0|1] ""  FCM_A0
 SG_ DET_IDM_111 : 287|1@1+ (1,0) [0|1] ""  FCM_A0
 SG_ DET_MTD_111 : 271|1@1+ (1,0) [0|1] ""  FCM_A0
 SG_ DET_BELOW_RAIN_THOLD_111 : 263|1@1+ (1,0) [0|1] ""  FCM_A0
 SG_ DET_RANGE_112 : 360|15@1+ (0.015625,0) [0|500] "m"  FCM_A0
 SG_ DET_RANGE_ERR_112 : 376|7@1+ (0.0075,0) [0|0.9525] "m"  FCM_A0
 SG_ DET_RANGE_VELOCITY_112 : 384|15@1+ (0.0078125,-128) [-128|127.9921875] "m/s"  FCM_A0
 SG_ DET_RANGE_VELOCITY_ERR_112 : 400|8@1+ (0.003,0) [0|0.765] "m/s"  FCM_A0
 SG_ DET_AZIMUTH_112 : 424|13@1+ (0.0004,-1.5708) [-1.5708|1.5708] "rad"  FCM_A0
 SG_ DET_AZIMUTH_ERR_112 : 441|7@1+ (0.00087267,0) [0|0.11082909] "rad"  FCM_A0
 SG_ DET_ELEVATION_112 : 408|8@1+ (0.00275,-0.34925) [-0.34925|0.34925] "rad"  FCM_A0
 SG_ DET_ELEVATION_ERR_112 : 416|6@1+ (0.00174533,0) [0|0.10995579] "rad"  FCM_A0
 SG_ DET_RCS_112 : 464|8@1+ (0.5,-64) [-64|63.5] "dBsm"  FCM_A0
 SG_ DET_BI_STATIC_FLAG_112 : 440|1@1+ (1,0) [0|1] ""  FCM_A0
 SG_ DET_SUPER_RES_TARGET_112 : 423|1@1+ (1,0) [0|1] ""  FCM_A0
 SG_ DET_SNR_112 : 456|8@1+ (0.35156,0) [0|89.6478] "dB"  FCM_A0
 SG_ DET_EXISTENCE_PROB_112 : 448|6@1+ (1.588,0) [0|100] "%"  FCM_A0
 SG_ DET_HVC_FLAG_112 : 422|1@1+ (1,0) [0|1] ""  FCM_A0
 SG_ DET_CONFD_AZIMUTH_112 : 454|2@1+ (1,0) [0|3] ""  FCM_A0
 SG_ DET_CONFD_ELEVATION_112 : 437|2@1+ (1,0) [0|3] ""  FCM_A0
 SG_ DET_MH_SCAN_INDEX_4LSB_109_112 : 476|4@1+ (1,0) [0|15] ""  FCM_A0
 SG_ DET_MH_CYCLE_COUNTER_109_112 : 16|8@1+ (1,0) [0|255] ""  FCM_A0
 SG_ DET_MH_CRC16_109_112 : 0|16@1+ (1,0) [0|65535] ""  FCM_A0
 SG_ DET_PROB_1STAZHYPO_112 : 439|1@1+ (1,0) [0|1] ""  FCM_A0
 SG_ DET_IDM_112 : 399|1@1+ (1,0) [0|1] ""  FCM_A0
 SG_ DET_MTD_112 : 383|1@1+ (1,0) [0|1] ""  FCM_A0
 SG_ DET_BELOW_RAIN_THOLD_112 : 375|1@1+ (1,0) [0|1] ""  FCM_A0

BO_ 794 FLR_DETECTION_105_108: 64 FLR
 SG_ DET_RANGE_105 : 24|15@1+ (0.015625,0) [0|500] "m"  FCM_A0
 SG_ DET_RANGE_ERR_105 : 40|7@1+ (0.0075,0) [0|0.9525] "m"  FCM_A0
 SG_ DET_RANGE_VELOCITY_105 : 48|15@1+ (0.0078125,-128) [-128|127.9921875] "m/s"  FCM_A0
 SG_ DET_RANGE_VELOCITY_ERR_105 : 64|8@1+ (0.003,0) [0|0.765] "m/s"  FCM_A0
 SG_ DET_AZIMUTH_105 : 88|13@1+ (0.0004,-1.5708) [-1.5708|1.5708] "rad"  FCM_A0
 SG_ DET_AZIMUTH_ERR_105 : 105|7@1+ (0.00087267,0) [0|0.11082909] "rad"  FCM_A0
 SG_ DET_ELEVATION_105 : 72|8@1+ (0.00275,-0.34925) [-0.34925|0.34925] "rad"  FCM_A0
 SG_ DET_ELEVATION_ERR_105 : 80|6@1+ (0.00174533,0) [0|0.10995579] "rad"  FCM_A0
 SG_ DET_RCS_105 : 128|8@1+ (0.5,-64) [-64|63.5] "dBsm"  FCM_A0
 SG_ DET_BI_STATIC_FLAG_105 : 104|1@1+ (1,0) [0|1] ""  FCM_A0
 SG_ DET_SUPER_RES_TARGET_105 : 87|1@1+ (1,0) [0|1] ""  FCM_A0
 SG_ DET_SNR_105 : 120|8@1+ (0.35156,0) [0|89.6478] "dB"  FCM_A0
 SG_ DET_EXISTENCE_PROB_105 : 112|6@1+ (1.588,0) [0|100] "%"  FCM_A0
 SG_ DET_HVC_FLAG_105 : 86|1@1+ (1,0) [0|1] ""  FCM_A0
 SG_ DET_CONFD_AZIMUTH_105 : 118|2@1+ (1,0) [0|3] ""  FCM_A0
 SG_ DET_CONFD_ELEVATION_105 : 101|2@1+ (1,0) [0|3] ""  FCM_A0
 SG_ DET_PROB_1STAZHYPO_105 : 103|1@1+ (1,0) [0|1] ""  FCM_A0
 SG_ DET_IDM_105 : 63|1@1+ (1,0) [0|1] ""  FCM_A0
 SG_ DET_MTD_105 : 47|1@1+ (1,0) [0|1] ""  FCM_A0
 SG_ DET_BELOW_RAIN_THOLD_105 : 39|1@1+ (1,0) [0|1] ""  FCM_A0
 SG_ DET_RANGE_106 : 136|15@1+ (0.015625,0) [0|500] "m"  FCM_A0
 SG_ DET_RANGE_ERR_106 : 152|7@1+ (0.0075,0) [0|0.9525] "m"  FCM_A0
 SG_ DET_RANGE_VELOCITY_106 : 160|15@1+ (0.0078125,-128) [-128|127.9921875] "m/s"  FCM_A0
 SG_ DET_RANGE_VELOCITY_ERR_106 : 176|8@1+ (0.003,0) [0|0.765] "m/s"  FCM_A0
 SG_ DET_AZIMUTH_106 : 200|13@1+ (0.0004,-1.5708) [-1.5708|1.5708] "rad"  FCM_A0
 SG_ DET_AZIMUTH_ERR_106 : 217|7@1+ (0.00087267,0) [0|0.11082909] "rad"  FCM_A0
 SG_ DET_ELEVATION_106 : 184|8@1+ (0.00275,-0.34925) [-0.34925|0.34925] "rad"  FCM_A0
 SG_ DET_ELEVATION_ERR_106 : 192|6@1+ (0.00174533,0) [0|0.10995579] "rad"  FCM_A0
 SG_ DET_RCS_106 : 240|8@1+ (0.5,-64) [-64|63.5] "dBsm"  FCM_A0
 SG_ DET_BI_STATIC_FLAG_106 : 216|1@1+ (1,0) [0|1] ""  FCM_A0
 SG_ DET_SUPER_RES_TARGET_106 : 199|1@1+ (1,0) [0|1] ""  FCM_A0
 SG_ DET_SNR_106 : 232|8@1+ (0.35156,0) [0|89.6478] "dB"  FCM_A0
 SG_ DET_EXISTENCE_PROB_106 : 224|6@1+ (1.588,0) [0|100] "%"  FCM_A0
 SG_ DET_HVC_FLAG_106 : 198|1@1+ (1,0) [0|1] ""  FCM_A0
 SG_ DET_CONFD_AZIMUTH_106 : 230|2@1+ (1,0) [0|3] ""  FCM_A0
 SG_ DET_CONFD_ELEVATION_106 : 213|2@1+ (1,0) [0|3] ""  FCM_A0
 SG_ DET_PROB_1STAZHYPO_106 : 215|1@1+ (1,0) [0|1] ""  FCM_A0
 SG_ DET_IDM_106 : 175|1@1+ (1,0) [0|1] ""  FCM_A0
 SG_ DET_MTD_106 : 159|1@1+ (1,0) [0|1] ""  FCM_A0
 SG_ DET_BELOW_RAIN_THOLD_106 : 151|1@1+ (1,0) [0|1] ""  FCM_A0
 SG_ DET_RANGE_107 : 248|15@1+ (0.015625,0) [0|500] "m"  FCM_A0
 SG_ DET_RANGE_ERR_107 : 264|7@1+ (0.0075,0) [0|0.9525] "m"  FCM_A0
 SG_ DET_RANGE_VELOCITY_107 : 272|15@1+ (0.0078125,-128) [-128|127.9921875] "m/s"  FCM_A0
 SG_ DET_RANGE_VELOCITY_ERR_107 : 288|8@1+ (0.003,0) [0|0.765] "m/s"  FCM_A0
 SG_ DET_AZIMUTH_107 : 312|13@1+ (0.0004,-1.5708) [-1.5708|1.5708] "rad"  FCM_A0
 SG_ DET_AZIMUTH_ERR_107 : 329|7@1+ (0.00087267,0) [0|0.11082909] "rad"  FCM_A0
 SG_ DET_ELEVATION_107 : 296|8@1+ (0.00275,-0.34925) [-0.34925|0.34925] "rad"  FCM_A0
 SG_ DET_ELEVATION_ERR_107 : 304|6@1+ (0.00174533,0) [0|0.10995579] "rad"  FCM_A0
 SG_ DET_RCS_107 : 352|8@1+ (0.5,-64) [-64|63.5] "dBsm"  FCM_A0
 SG_ DET_BI_STATIC_FLAG_107 : 328|1@1+ (1,0) [0|1] ""  FCM_A0
 SG_ DET_SUPER_RES_TARGET_107 : 311|1@1+ (1,0) [0|1] ""  FCM_A0
 SG_ DET_SNR_107 : 344|8@1+ (0.35156,0) [0|89.6478] "dB"  FCM_A0
 SG_ DET_EXISTENCE_PROB_107 : 336|6@1+ (1.588,0) [0|100] "%"  FCM_A0
 SG_ DET_HVC_FLAG_107 : 310|1@1+ (1,0) [0|1] ""  FCM_A0
 SG_ DET_CONFD_AZIMUTH_107 : 342|2@1+ (1,0) [0|3] ""  FCM_A0
 SG_ DET_CONFD_ELEVATION_107 : 325|2@1+ (1,0) [0|3] ""  FCM_A0
 SG_ DET_PROB_1STAZHYPO_107 : 327|1@1+ (1,0) [0|1] ""  FCM_A0
 SG_ DET_IDM_107 : 287|1@1+ (1,0) [0|1] ""  FCM_A0
 SG_ DET_MTD_107 : 271|1@1+ (1,0) [0|1] ""  FCM_A0
 SG_ DET_BELOW_RAIN_THOLD_107 : 263|1@1+ (1,0) [0|1] ""  FCM_A0
 SG_ DET_RANGE_108 : 360|15@1+ (0.015625,0) [0|500] "m"  FCM_A0
 SG_ DET_RANGE_ERR_108 : 376|7@1+ (0.0075,0) [0|0.9525] "m"  FCM_A0
 SG_ DET_RANGE_VELOCITY_108 : 384|15@1+ (0.0078125,-128) [-128|127.9921875] "m/s"  FCM_A0
 SG_ DET_RANGE_VELOCITY_ERR_108 : 400|8@1+ (0.003,0) [0|0.765] "m/s"  FCM_A0
 SG_ DET_AZIMUTH_108 : 424|13@1+ (0.0004,-1.5708) [-1.5708|1.5708] "rad"  FCM_A0
 SG_ DET_AZIMUTH_ERR_108 : 441|7@1+ (0.00087267,0) [0|0.11082909] "rad"  FCM_A0
 SG_ DET_ELEVATION_108 : 408|8@1+ (0.00275,-0.34925) [-0.34925|0.34925] "rad"  FCM_A0
 SG_ DET_ELEVATION_ERR_108 : 416|6@1+ (0.00174533,0) [0|0.10995579] "rad"  FCM_A0
 SG_ DET_RCS_108 : 464|8@1+ (0.5,-64) [-64|63.5] "dBsm"  FCM_A0
 SG_ DET_BI_STATIC_FLAG_108 : 440|1@1+ (1,0) [0|1] ""  FCM_A0
 SG_ DET_SUPER_RES_TARGET_108 : 423|1@1+ (1,0) [0|1] ""  FCM_A0
 SG_ DET_SNR_108 : 456|8@1+ (0.35156,0) [0|89.6478] "dB"  FCM_A0
 SG_ DET_EXISTENCE_PROB_108 : 448|6@1+ (1.588,0) [0|100] "%"  FCM_A0
 SG_ DET_HVC_FLAG_108 : 422|1@1+ (1,0) [0|1] ""  FCM_A0
 SG_ DET_CONFD_AZIMUTH_108 : 454|2@1+ (1,0) [0|3] ""  FCM_A0
 SG_ DET_CONFD_ELEVATION_108 : 437|2@1+ (1,0) [0|3] ""  FCM_A0
 SG_ DET_MH_SCAN_INDEX_4LSB_105_108 : 476|4@1+ (1,0) [0|15] ""  FCM_A0
 SG_ DET_MH_CYCLE_COUNTER_105_108 : 16|8@1+ (1,0) [0|255] ""  FCM_A0
 SG_ DET_MH_CRC16_105_108 : 0|16@1+ (1,0) [0|65535] ""  FCM_A0
 SG_ DET_PROB_1STAZHYPO_108 : 439|1@1+ (1,0) [0|1] ""  FCM_A0
 SG_ DET_IDM_108 : 399|1@1+ (1,0) [0|1] ""  FCM_A0
 SG_ DET_MTD_108 : 383|1@1+ (1,0) [0|1] ""  FCM_A0
 SG_ DET_BELOW_RAIN_THOLD_108 : 375|1@1+ (1,0) [0|1] ""  FCM_A0

BO_ 793 FLR_DETECTION_101_104: 64 FLR
 SG_ DET_RANGE_101 : 24|15@1+ (0.015625,0) [0|500] "m"  FCM_A0
 SG_ DET_RANGE_ERR_101 : 40|7@1+ (0.0075,0) [0|0.9525] "m"  FCM_A0
 SG_ DET_RANGE_VELOCITY_101 : 48|15@1+ (0.0078125,-128) [-128|127.9921875] "m/s"  FCM_A0
 SG_ DET_RANGE_VELOCITY_ERR_101 : 64|8@1+ (0.003,0) [0|0.765] "m/s"  FCM_A0
 SG_ DET_AZIMUTH_101 : 88|13@1+ (0.0004,-1.5708) [-1.5708|1.5708] "rad"  FCM_A0
 SG_ DET_AZIMUTH_ERR_101 : 105|7@1+ (0.00087267,0) [0|0.11082909] "rad"  FCM_A0
 SG_ DET_ELEVATION_101 : 72|8@1+ (0.00275,-0.34925) [-0.34925|0.34925] "rad"  FCM_A0
 SG_ DET_ELEVATION_ERR_101 : 80|6@1+ (0.00174533,0) [0|0.10995579] "rad"  FCM_A0
 SG_ DET_RCS_101 : 128|8@1+ (0.5,-64) [-64|63.5] "dBsm"  FCM_A0
 SG_ DET_BI_STATIC_FLAG_101 : 104|1@1+ (1,0) [0|1] ""  FCM_A0
 SG_ DET_SUPER_RES_TARGET_101 : 87|1@1+ (1,0) [0|1] ""  FCM_A0
 SG_ DET_SNR_101 : 120|8@1+ (0.35156,0) [0|89.6478] "dB"  FCM_A0
 SG_ DET_EXISTENCE_PROB_101 : 112|6@1+ (1.588,0) [0|100] "%"  FCM_A0
 SG_ DET_HVC_FLAG_101 : 86|1@1+ (1,0) [0|1] ""  FCM_A0
 SG_ DET_CONFD_AZIMUTH_101 : 118|2@1+ (1,0) [0|3] ""  FCM_A0
 SG_ DET_CONFD_ELEVATION_101 : 101|2@1+ (1,0) [0|3] ""  FCM_A0
 SG_ DET_PROB_1STAZHYPO_101 : 103|1@1+ (1,0) [0|1] ""  FCM_A0
 SG_ DET_IDM_101 : 63|1@1+ (1,0) [0|1] ""  FCM_A0
 SG_ DET_MTD_101 : 47|1@1+ (1,0) [0|1] ""  FCM_A0
 SG_ DET_BELOW_RAIN_THOLD_101 : 39|1@1+ (1,0) [0|1] ""  FCM_A0
 SG_ DET_RANGE_102 : 136|15@1+ (0.015625,0) [0|500] "m"  FCM_A0
 SG_ DET_RANGE_ERR_102 : 152|7@1+ (0.0075,0) [0|0.9525] "m"  FCM_A0
 SG_ DET_RANGE_VELOCITY_102 : 160|15@1+ (0.0078125,-128) [-128|127.9921875] "m/s"  FCM_A0
 SG_ DET_RANGE_VELOCITY_ERR_102 : 176|8@1+ (0.003,0) [0|0.765] "m/s"  FCM_A0
 SG_ DET_AZIMUTH_102 : 200|13@1+ (0.0004,-1.5708) [-1.5708|1.5708] "rad"  FCM_A0
 SG_ DET_AZIMUTH_ERR_102 : 217|7@1+ (0.00087267,0) [0|0.11082909] "rad"  FCM_A0
 SG_ DET_ELEVATION_102 : 184|8@1+ (0.00275,-0.34925) [-0.34925|0.34925] "rad"  FCM_A0
 SG_ DET_ELEVATION_ERR_102 : 192|6@1+ (0.00174533,0) [0|0.10995579] "rad"  FCM_A0
 SG_ DET_RCS_102 : 240|8@1+ (0.5,-64) [-64|63.5] "dBsm"  FCM_A0
 SG_ DET_BI_STATIC_FLAG_102 : 216|1@1+ (1,0) [0|1] ""  FCM_A0
 SG_ DET_SUPER_RES_TARGET_102 : 199|1@1+ (1,0) [0|1] ""  FCM_A0
 SG_ DET_SNR_102 : 232|8@1+ (0.35156,0) [0|89.6478] "dB"  FCM_A0
 SG_ DET_EXISTENCE_PROB_102 : 224|6@1+ (1.588,0) [0|100] "%"  FCM_A0
 SG_ DET_HVC_FLAG_102 : 198|1@1+ (1,0) [0|1] ""  FCM_A0
 SG_ DET_CONFD_AZIMUTH_102 : 230|2@1+ (1,0) [0|3] ""  FCM_A0
 SG_ DET_CONFD_ELEVATION_102 : 213|2@1+ (1,0) [0|3] ""  FCM_A0
 SG_ DET_PROB_1STAZHYPO_102 : 215|1@1+ (1,0) [0|1] ""  FCM_A0
 SG_ DET_IDM_102 : 175|1@1+ (1,0) [0|1] ""  FCM_A0
 SG_ DET_MTD_102 : 159|1@1+ (1,0) [0|1] ""  FCM_A0
 SG_ DET_BELOW_RAIN_THOLD_102 : 151|1@1+ (1,0) [0|1] ""  FCM_A0
 SG_ DET_RANGE_103 : 248|15@1+ (0.015625,0) [0|500] "m"  FCM_A0
 SG_ DET_RANGE_ERR_103 : 264|7@1+ (0.0075,0) [0|0.9525] "m"  FCM_A0
 SG_ DET_RANGE_VELOCITY_103 : 272|15@1+ (0.0078125,-128) [-128|127.9921875] "m/s"  FCM_A0
 SG_ DET_RANGE_VELOCITY_ERR_103 : 288|8@1+ (0.003,0) [0|0.765] "m/s"  FCM_A0
 SG_ DET_AZIMUTH_103 : 312|13@1+ (0.0004,-1.5708) [-1.5708|1.5708] "rad"  FCM_A0
 SG_ DET_AZIMUTH_ERR_103 : 329|7@1+ (0.00087267,0) [0|0.11082909] "rad"  FCM_A0
 SG_ DET_ELEVATION_103 : 296|8@1+ (0.00275,-0.34925) [-0.34925|0.34925] "rad"  FCM_A0
 SG_ DET_ELEVATION_ERR_103 : 304|6@1+ (0.00174533,0) [0|0.10995579] "rad"  FCM_A0
 SG_ DET_RCS_103 : 352|8@1+ (0.5,-64) [-64|63.5] "dBsm"  FCM_A0
 SG_ DET_BI_STATIC_FLAG_103 : 328|1@1+ (1,0) [0|1] ""  FCM_A0
 SG_ DET_SUPER_RES_TARGET_103 : 311|1@1+ (1,0) [0|1] ""  FCM_A0
 SG_ DET_SNR_103 : 344|8@1+ (0.35156,0) [0|89.6478] "dB"  FCM_A0
 SG_ DET_EXISTENCE_PROB_103 : 336|6@1+ (1.588,0) [0|100] "%"  FCM_A0
 SG_ DET_HVC_FLAG_103 : 310|1@1+ (1,0) [0|1] ""  FCM_A0
 SG_ DET_CONFD_AZIMUTH_103 : 342|2@1+ (1,0) [0|3] ""  FCM_A0
 SG_ DET_CONFD_ELEVATION_103 : 325|2@1+ (1,0) [0|3] ""  FCM_A0
 SG_ DET_PROB_1STAZHYPO_103 : 327|1@1+ (1,0) [0|1] ""  FCM_A0
 SG_ DET_IDM_103 : 287|1@1+ (1,0) [0|1] ""  FCM_A0
 SG_ DET_MTD_103 : 271|1@1+ (1,0) [0|1] ""  FCM_A0
 SG_ DET_BELOW_RAIN_THOLD_103 : 263|1@1+ (1,0) [0|1] ""  FCM_A0
 SG_ DET_RANGE_104 : 360|15@1+ (0.015625,0) [0|500] "m"  FCM_A0
 SG_ DET_RANGE_ERR_104 : 376|7@1+ (0.0075,0) [0|0.9525] "m"  FCM_A0
 SG_ DET_RANGE_VELOCITY_104 : 384|15@1+ (0.0078125,-128) [-128|127.9921875] "m/s"  FCM_A0
 SG_ DET_RANGE_VELOCITY_ERR_104 : 400|8@1+ (0.003,0) [0|0.765] "m/s"  FCM_A0
 SG_ DET_AZIMUTH_104 : 424|13@1+ (0.0004,-1.5708) [-1.5708|1.5708] "rad"  FCM_A0
 SG_ DET_AZIMUTH_ERR_104 : 441|7@1+ (0.00087267,0) [0|0.11082909] "rad"  FCM_A0
 SG_ DET_ELEVATION_104 : 408|8@1+ (0.00275,-0.34925) [-0.34925|0.34925] "rad"  FCM_A0
 SG_ DET_ELEVATION_ERR_104 : 416|6@1+ (0.00174533,0) [0|0.10995579] "rad"  FCM_A0
 SG_ DET_RCS_104 : 464|8@1+ (0.5,-64) [-64|63.5] "dBsm"  FCM_A0
 SG_ DET_BI_STATIC_FLAG_104 : 440|1@1+ (1,0) [0|1] ""  FCM_A0
 SG_ DET_SUPER_RES_TARGET_104 : 423|1@1+ (1,0) [0|1] ""  FCM_A0
 SG_ DET_SNR_104 : 456|8@1+ (0.35156,0) [0|89.6478] "dB"  FCM_A0
 SG_ DET_EXISTENCE_PROB_104 : 448|6@1+ (1.588,0) [0|100] "%"  FCM_A0
 SG_ DET_HVC_FLAG_104 : 422|1@1+ (1,0) [0|1] ""  FCM_A0
 SG_ DET_CONFD_AZIMUTH_104 : 454|2@1+ (1,0) [0|3] ""  FCM_A0
 SG_ DET_CONFD_ELEVATION_104 : 437|2@1+ (1,0) [0|3] ""  FCM_A0
 SG_ DET_MH_SCAN_INDEX_4LSB_101_104 : 476|4@1+ (1,0) [0|15] ""  FCM_A0
 SG_ DET_MH_CYCLE_COUNTER_101_104 : 16|8@1+ (1,0) [0|255] ""  FCM_A0
 SG_ DET_MH_CRC16_101_104 : 0|16@1+ (1,0) [0|65535] ""  FCM_A0
 SG_ DET_PROB_1STAZHYPO_104 : 439|1@1+ (1,0) [0|1] ""  FCM_A0
 SG_ DET_IDM_104 : 399|1@1+ (1,0) [0|1] ""  FCM_A0
 SG_ DET_MTD_104 : 383|1@1+ (1,0) [0|1] ""  FCM_A0
 SG_ DET_BELOW_RAIN_THOLD_104 : 375|1@1+ (1,0) [0|1] ""  FCM_A0

BO_ 792 FLR_DETECTION_097_100: 64 FLR
 SG_ DET_RANGE_097 : 24|15@1+ (0.015625,0) [0|500] "m"  FCM_A0
 SG_ DET_RANGE_ERR_097 : 40|7@1+ (0.0075,0) [0|0.9525] "m"  FCM_A0
 SG_ DET_RANGE_VELOCITY_097 : 48|15@1+ (0.0078125,-128) [-128|127.9921875] "m/s"  FCM_A0
 SG_ DET_RANGE_VELOCITY_ERR_097 : 64|8@1+ (0.003,0) [0|0.765] "m/s"  FCM_A0
 SG_ DET_AZIMUTH_097 : 88|13@1+ (0.0004,-1.5708) [-1.5708|1.5708] "rad"  FCM_A0
 SG_ DET_AZIMUTH_ERR_097 : 105|7@1+ (0.00087267,0) [0|0.11082909] "rad"  FCM_A0
 SG_ DET_ELEVATION_097 : 72|8@1+ (0.00275,-0.34925) [-0.34925|0.34925] "rad"  FCM_A0
 SG_ DET_ELEVATION_ERR_097 : 80|6@1+ (0.00174533,0) [0|0.10995579] "rad"  FCM_A0
 SG_ DET_RCS_097 : 128|8@1+ (0.5,-64) [-64|63.5] "dBsm"  FCM_A0
 SG_ DET_BI_STATIC_FLAG_097 : 104|1@1+ (1,0) [0|1] ""  FCM_A0
 SG_ DET_SUPER_RES_TARGET_097 : 87|1@1+ (1,0) [0|1] ""  FCM_A0
 SG_ DET_SNR_097 : 120|8@1+ (0.35156,0) [0|89.6478] "dB"  FCM_A0
 SG_ DET_EXISTENCE_PROB_097 : 112|6@1+ (1.588,0) [0|100] "%"  FCM_A0
 SG_ DET_HVC_FLAG_097 : 86|1@1+ (1,0) [0|1] ""  FCM_A0
 SG_ DET_CONFD_AZIMUTH_097 : 118|2@1+ (1,0) [0|3] ""  FCM_A0
 SG_ DET_CONFD_ELEVATION_097 : 101|2@1+ (1,0) [0|3] ""  FCM_A0
 SG_ DET_PROB_1STAZHYPO_097 : 103|1@1+ (1,0) [0|1] ""  FCM_A0
 SG_ DET_IDM_097 : 63|1@1+ (1,0) [0|1] ""  FCM_A0
 SG_ DET_MTD_097 : 47|1@1+ (1,0) [0|1] ""  FCM_A0
 SG_ DET_BELOW_RAIN_THOLD_097 : 39|1@1+ (1,0) [0|1] ""  FCM_A0
 SG_ DET_RANGE_098 : 136|15@1+ (0.015625,0) [0|500] "m"  FCM_A0
 SG_ DET_RANGE_ERR_098 : 152|7@1+ (0.0075,0) [0|0.9525] "m"  FCM_A0
 SG_ DET_RANGE_VELOCITY_098 : 160|15@1+ (0.0078125,-128) [-128|127.9921875] "m/s"  FCM_A0
 SG_ DET_RANGE_VELOCITY_ERR_098 : 176|8@1+ (0.003,0) [0|0.765] "m/s"  FCM_A0
 SG_ DET_AZIMUTH_098 : 200|13@1+ (0.0004,-1.5708) [-1.5708|1.5708] "rad"  FCM_A0
 SG_ DET_AZIMUTH_ERR_098 : 217|7@1+ (0.00087267,0) [0|0.11082909] "rad"  FCM_A0
 SG_ DET_ELEVATION_098 : 184|8@1+ (0.00275,-0.34925) [-0.34925|0.34925] "rad"  FCM_A0
 SG_ DET_ELEVATION_ERR_098 : 192|6@1+ (0.00174533,0) [0|0.10995579] "rad"  FCM_A0
 SG_ DET_RCS_098 : 240|8@1+ (0.5,-64) [-64|63.5] "dBsm"  FCM_A0
 SG_ DET_BI_STATIC_FLAG_098 : 216|1@1+ (1,0) [0|1] ""  FCM_A0
 SG_ DET_SUPER_RES_TARGET_098 : 199|1@1+ (1,0) [0|1] ""  FCM_A0
 SG_ DET_SNR_098 : 232|8@1+ (0.35156,0) [0|89.6478] "dB"  FCM_A0
 SG_ DET_EXISTENCE_PROB_098 : 224|6@1+ (1.588,0) [0|100] "%"  FCM_A0
 SG_ DET_HVC_FLAG_098 : 198|1@1+ (1,0) [0|1] ""  FCM_A0
 SG_ DET_CONFD_AZIMUTH_098 : 230|2@1+ (1,0) [0|3] ""  FCM_A0
 SG_ DET_CONFD_ELEVATION_098 : 213|2@1+ (1,0) [0|3] ""  FCM_A0
 SG_ DET_PROB_1STAZHYPO_098 : 215|1@1+ (1,0) [0|1] ""  FCM_A0
 SG_ DET_IDM_098 : 175|1@1+ (1,0) [0|1] ""  FCM_A0
 SG_ DET_MTD_098 : 159|1@1+ (1,0) [0|1] ""  FCM_A0
 SG_ DET_BELOW_RAIN_THOLD_098 : 151|1@1+ (1,0) [0|1] ""  FCM_A0
 SG_ DET_RANGE_099 : 248|15@1+ (0.015625,0) [0|500] "m"  FCM_A0
 SG_ DET_RANGE_ERR_099 : 264|7@1+ (0.0075,0) [0|0.9525] "m"  FCM_A0
 SG_ DET_RANGE_VELOCITY_099 : 272|15@1+ (0.0078125,-128) [-128|127.9921875] "m/s"  FCM_A0
 SG_ DET_RANGE_VELOCITY_ERR_099 : 288|8@1+ (0.003,0) [0|0.765] "m/s"  FCM_A0
 SG_ DET_AZIMUTH_099 : 312|13@1+ (0.0004,-1.5708) [-1.5708|1.5708] "rad"  FCM_A0
 SG_ DET_AZIMUTH_ERR_099 : 329|7@1+ (0.00087267,0) [0|0.11082909] "rad"  FCM_A0
 SG_ DET_ELEVATION_099 : 296|8@1+ (0.00275,-0.34925) [-0.34925|0.34925] "rad"  FCM_A0
 SG_ DET_ELEVATION_ERR_099 : 304|6@1+ (0.00174533,0) [0|0.10995579] "rad"  FCM_A0
 SG_ DET_RCS_099 : 352|8@1+ (0.5,-64) [-64|63.5] "dBsm"  FCM_A0
 SG_ DET_BI_STATIC_FLAG_099 : 328|1@1+ (1,0) [0|1] ""  FCM_A0
 SG_ DET_SUPER_RES_TARGET_099 : 311|1@1+ (1,0) [0|1] ""  FCM_A0
 SG_ DET_SNR_099 : 344|8@1+ (0.35156,0) [0|89.6478] "dB"  FCM_A0
 SG_ DET_EXISTENCE_PROB_099 : 336|6@1+ (1.588,0) [0|100] "%"  FCM_A0
 SG_ DET_HVC_FLAG_099 : 310|1@1+ (1,0) [0|1] ""  FCM_A0
 SG_ DET_CONFD_AZIMUTH_099 : 342|2@1+ (1,0) [0|3] ""  FCM_A0
 SG_ DET_CONFD_ELEVATION_099 : 325|2@1+ (1,0) [0|3] ""  FCM_A0
 SG_ DET_PROB_1STAZHYPO_099 : 327|1@1+ (1,0) [0|1] ""  FCM_A0
 SG_ DET_IDM_099 : 287|1@1+ (1,0) [0|1] ""  FCM_A0
 SG_ DET_MTD_099 : 271|1@1+ (1,0) [0|1] ""  FCM_A0
 SG_ DET_BELOW_RAIN_THOLD_099 : 263|1@1+ (1,0) [0|1] ""  FCM_A0
 SG_ DET_RANGE_100 : 360|15@1+ (0.015625,0) [0|500] "m"  FCM_A0
 SG_ DET_RANGE_ERR_100 : 376|7@1+ (0.0075,0) [0|0.9525] "m"  FCM_A0
 SG_ DET_RANGE_VELOCITY_100 : 384|15@1+ (0.0078125,-128) [-128|127.9921875] "m/s"  FCM_A0
 SG_ DET_RANGE_VELOCITY_ERR_100 : 400|8@1+ (0.003,0) [0|0.765] "m/s"  FCM_A0
 SG_ DET_AZIMUTH_100 : 424|13@1+ (0.0004,-1.5708) [-1.5708|1.5708] "rad"  FCM_A0
 SG_ DET_AZIMUTH_ERR_100 : 441|7@1+ (0.00087267,0) [0|0.11082909] "rad"  FCM_A0
 SG_ DET_ELEVATION_100 : 408|8@1+ (0.00275,-0.34925) [-0.34925|0.34925] "rad"  FCM_A0
 SG_ DET_ELEVATION_ERR_100 : 416|6@1+ (0.00174533,0) [0|0.10995579] "rad"  FCM_A0
 SG_ DET_RCS_100 : 464|8@1+ (0.5,-64) [-64|63.5] "dBsm"  FCM_A0
 SG_ DET_BI_STATIC_FLAG_100 : 440|1@1+ (1,0) [0|1] ""  FCM_A0
 SG_ DET_SUPER_RES_TARGET_100 : 423|1@1+ (1,0) [0|1] ""  FCM_A0
 SG_ DET_SNR_100 : 456|8@1+ (0.35156,0) [0|89.6478] "dB"  FCM_A0
 SG_ DET_EXISTENCE_PROB_100 : 448|6@1+ (1.588,0) [0|100] "%"  FCM_A0
 SG_ DET_HVC_FLAG_100 : 422|1@1+ (1,0) [0|1] ""  FCM_A0
 SG_ DET_CONFD_AZIMUTH_100 : 454|2@1+ (1,0) [0|3] ""  FCM_A0
 SG_ DET_CONFD_ELEVATION_100 : 437|2@1+ (1,0) [0|3] ""  FCM_A0
 SG_ DET_MH_SCAN_INDEX_4LSB_097_100 : 476|4@1+ (1,0) [0|15] ""  FCM_A0
 SG_ DET_MH_CYCLE_COUNTER_097_100 : 16|8@1+ (1,0) [0|255] ""  FCM_A0
 SG_ DET_MH_CRC16_097_100 : 0|16@1+ (1,0) [0|65535] ""  FCM_A0
 SG_ DET_PROB_1STAZHYPO_100 : 439|1@1+ (1,0) [0|1] ""  FCM_A0
 SG_ DET_IDM_100 : 399|1@1+ (1,0) [0|1] ""  FCM_A0
 SG_ DET_MTD_100 : 383|1@1+ (1,0) [0|1] ""  FCM_A0
 SG_ DET_BELOW_RAIN_THOLD_100 : 375|1@1+ (1,0) [0|1] ""  FCM_A0

BO_ 791 FLR_DETECTION_093_096: 64 FLR
 SG_ DET_RANGE_093 : 24|15@1+ (0.015625,0) [0|500] "m"  FCM_A0
 SG_ DET_RANGE_ERR_093 : 40|7@1+ (0.0075,0) [0|0.9525] "m"  FCM_A0
 SG_ DET_RANGE_VELOCITY_093 : 48|15@1+ (0.0078125,-128) [-128|127.9921875] "m/s"  FCM_A0
 SG_ DET_RANGE_VELOCITY_ERR_093 : 64|8@1+ (0.003,0) [0|0.765] "m/s"  FCM_A0
 SG_ DET_AZIMUTH_093 : 88|13@1+ (0.0004,-1.5708) [-1.5708|1.5708] "rad"  FCM_A0
 SG_ DET_AZIMUTH_ERR_093 : 105|7@1+ (0.00087267,0) [0|0.11082909] "rad"  FCM_A0
 SG_ DET_ELEVATION_093 : 72|8@1+ (0.00275,-0.34925) [-0.34925|0.34925] "rad"  FCM_A0
 SG_ DET_ELEVATION_ERR_093 : 80|6@1+ (0.00174533,0) [0|0.10995579] "rad"  FCM_A0
 SG_ DET_RCS_093 : 128|8@1+ (0.5,-64) [-64|63.5] "dBsm"  FCM_A0
 SG_ DET_BI_STATIC_FLAG_093 : 104|1@1+ (1,0) [0|1] ""  FCM_A0
 SG_ DET_SUPER_RES_TARGET_093 : 87|1@1+ (1,0) [0|1] ""  FCM_A0
 SG_ DET_SNR_093 : 120|8@1+ (0.35156,0) [0|89.6478] "dB"  FCM_A0
 SG_ DET_EXISTENCE_PROB_093 : 112|6@1+ (1.588,0) [0|100] "%"  FCM_A0
 SG_ DET_HVC_FLAG_093 : 86|1@1+ (1,0) [0|1] ""  FCM_A0
 SG_ DET_CONFD_AZIMUTH_093 : 118|2@1+ (1,0) [0|3] ""  FCM_A0
 SG_ DET_CONFD_ELEVATION_093 : 101|2@1+ (1,0) [0|3] ""  FCM_A0
 SG_ DET_PROB_1STAZHYPO_093 : 103|1@1+ (1,0) [0|1] ""  FCM_A0
 SG_ DET_IDM_093 : 63|1@1+ (1,0) [0|1] ""  FCM_A0
 SG_ DET_MTD_093 : 47|1@1+ (1,0) [0|1] ""  FCM_A0
 SG_ DET_BELOW_RAIN_THOLD_093 : 39|1@1+ (1,0) [0|1] ""  FCM_A0
 SG_ DET_RANGE_094 : 136|15@1+ (0.015625,0) [0|500] "m"  FCM_A0
 SG_ DET_RANGE_ERR_094 : 152|7@1+ (0.0075,0) [0|0.9525] "m"  FCM_A0
 SG_ DET_RANGE_VELOCITY_094 : 160|15@1+ (0.0078125,-128) [-128|127.9921875] "m/s"  FCM_A0
 SG_ DET_RANGE_VELOCITY_ERR_094 : 176|8@1+ (0.003,0) [0|0.765] "m/s"  FCM_A0
 SG_ DET_AZIMUTH_094 : 200|13@1+ (0.0004,-1.5708) [-1.5708|1.5708] "rad"  FCM_A0
 SG_ DET_AZIMUTH_ERR_094 : 217|7@1+ (0.00087267,0) [0|0.11082909] "rad"  FCM_A0
 SG_ DET_ELEVATION_094 : 184|8@1+ (0.00275,-0.34925) [-0.34925|0.34925] "rad"  FCM_A0
 SG_ DET_ELEVATION_ERR_094 : 192|6@1+ (0.00174533,0) [0|0.10995579] "rad"  FCM_A0
 SG_ DET_RCS_094 : 240|8@1+ (0.5,-64) [-64|63.5] "dBsm"  FCM_A0
 SG_ DET_BI_STATIC_FLAG_094 : 216|1@1+ (1,0) [0|1] ""  FCM_A0
 SG_ DET_SUPER_RES_TARGET_094 : 199|1@1+ (1,0) [0|1] ""  FCM_A0
 SG_ DET_SNR_094 : 232|8@1+ (0.35156,0) [0|89.6478] "dB"  FCM_A0
 SG_ DET_EXISTENCE_PROB_094 : 224|6@1+ (1.588,0) [0|100] "%"  FCM_A0
 SG_ DET_HVC_FLAG_094 : 198|1@1+ (1,0) [0|1] ""  FCM_A0
 SG_ DET_CONFD_AZIMUTH_094 : 230|2@1+ (1,0) [0|3] ""  FCM_A0
 SG_ DET_CONFD_ELEVATION_094 : 213|2@1+ (1,0) [0|3] ""  FCM_A0
 SG_ DET_PROB_1STAZHYPO_094 : 215|1@1+ (1,0) [0|1] ""  FCM_A0
 SG_ DET_IDM_094 : 175|1@1+ (1,0) [0|1] ""  FCM_A0
 SG_ DET_MTD_094 : 159|1@1+ (1,0) [0|1] ""  FCM_A0
 SG_ DET_BELOW_RAIN_THOLD_094 : 151|1@1+ (1,0) [0|1] ""  FCM_A0
 SG_ DET_RANGE_095 : 248|15@1+ (0.015625,0) [0|500] "m"  FCM_A0
 SG_ DET_RANGE_ERR_095 : 264|7@1+ (0.0075,0) [0|0.9525] "m"  FCM_A0
 SG_ DET_RANGE_VELOCITY_095 : 272|15@1+ (0.0078125,-128) [-128|127.9921875] "m/s"  FCM_A0
 SG_ DET_RANGE_VELOCITY_ERR_095 : 288|8@1+ (0.003,0) [0|0.765] "m/s"  FCM_A0
 SG_ DET_AZIMUTH_095 : 312|13@1+ (0.0004,-1.5708) [-1.5708|1.5708] "rad"  FCM_A0
 SG_ DET_AZIMUTH_ERR_095 : 329|7@1+ (0.00087267,0) [0|0.11082909] "rad"  FCM_A0
 SG_ DET_ELEVATION_095 : 296|8@1+ (0.00275,-0.34925) [-0.34925|0.34925] "rad"  FCM_A0
 SG_ DET_ELEVATION_ERR_095 : 304|6@1+ (0.00174533,0) [0|0.10995579] "rad"  FCM_A0
 SG_ DET_RCS_095 : 352|8@1+ (0.5,-64) [-64|63.5] "dBsm"  FCM_A0
 SG_ DET_BI_STATIC_FLAG_095 : 328|1@1+ (1,0) [0|1] ""  FCM_A0
 SG_ DET_SUPER_RES_TARGET_095 : 311|1@1+ (1,0) [0|1] ""  FCM_A0
 SG_ DET_SNR_095 : 344|8@1+ (0.35156,0) [0|89.6478] "dB"  FCM_A0
 SG_ DET_EXISTENCE_PROB_095 : 336|6@1+ (1.588,0) [0|100] "%"  FCM_A0
 SG_ DET_HVC_FLAG_095 : 310|1@1+ (1,0) [0|1] ""  FCM_A0
 SG_ DET_CONFD_AZIMUTH_095 : 342|2@1+ (1,0) [0|3] ""  FCM_A0
 SG_ DET_CONFD_ELEVATION_095 : 325|2@1+ (1,0) [0|3] ""  FCM_A0
 SG_ DET_PROB_1STAZHYPO_095 : 327|1@1+ (1,0) [0|1] ""  FCM_A0
 SG_ DET_IDM_095 : 287|1@1+ (1,0) [0|1] ""  FCM_A0
 SG_ DET_MTD_095 : 271|1@1+ (1,0) [0|1] ""  FCM_A0
 SG_ DET_BELOW_RAIN_THOLD_095 : 263|1@1+ (1,0) [0|1] ""  FCM_A0
 SG_ DET_RANGE_096 : 360|15@1+ (0.015625,0) [0|500] "m"  FCM_A0
 SG_ DET_RANGE_ERR_096 : 376|7@1+ (0.0075,0) [0|0.9525] "m"  FCM_A0
 SG_ DET_RANGE_VELOCITY_096 : 384|15@1+ (0.0078125,-128) [-128|127.9921875] "m/s"  FCM_A0
 SG_ DET_RANGE_VELOCITY_ERR_096 : 400|8@1+ (0.003,0) [0|0.765] "m/s"  FCM_A0
 SG_ DET_AZIMUTH_096 : 424|13@1+ (0.0004,-1.5708) [-1.5708|1.5708] "rad"  FCM_A0
 SG_ DET_AZIMUTH_ERR_096 : 441|7@1+ (0.00087267,0) [0|0.11082909] "rad"  FCM_A0
 SG_ DET_ELEVATION_096 : 408|8@1+ (0.00275,-0.34925) [-0.34925|0.34925] "rad"  FCM_A0
 SG_ DET_ELEVATION_ERR_096 : 416|6@1+ (0.00174533,0) [0|0.10995579] "rad"  FCM_A0
 SG_ DET_RCS_096 : 464|8@1+ (0.5,-64) [-64|63.5] "dBsm"  FCM_A0
 SG_ DET_BI_STATIC_FLAG_096 : 440|1@1+ (1,0) [0|1] ""  FCM_A0
 SG_ DET_SUPER_RES_TARGET_096 : 423|1@1+ (1,0) [0|1] ""  FCM_A0
 SG_ DET_SNR_096 : 456|8@1+ (0.35156,0) [0|89.6478] "dB"  FCM_A0
 SG_ DET_EXISTENCE_PROB_096 : 448|6@1+ (1.588,0) [0|100] "%"  FCM_A0
 SG_ DET_HVC_FLAG_096 : 422|1@1+ (1,0) [0|1] ""  FCM_A0
 SG_ DET_CONFD_AZIMUTH_096 : 454|2@1+ (1,0) [0|3] ""  FCM_A0
 SG_ DET_CONFD_ELEVATION_096 : 437|2@1+ (1,0) [0|3] ""  FCM_A0
 SG_ DET_MH_SCAN_INDEX_4LSB_093_096 : 476|4@1+ (1,0) [0|15] ""  FCM_A0
 SG_ DET_MH_CYCLE_COUNTER_093_096 : 16|8@1+ (1,0) [0|255] ""  FCM_A0
 SG_ DET_MH_CRC16_093_096 : 0|16@1+ (1,0) [0|65535] ""  FCM_A0
 SG_ DET_PROB_1STAZHYPO_096 : 439|1@1+ (1,0) [0|1] ""  FCM_A0
 SG_ DET_IDM_096 : 399|1@1+ (1,0) [0|1] ""  FCM_A0
 SG_ DET_MTD_096 : 383|1@1+ (1,0) [0|1] ""  FCM_A0
 SG_ DET_BELOW_RAIN_THOLD_096 : 375|1@1+ (1,0) [0|1] ""  FCM_A0

BO_ 790 FLR_DETECTION_089_092: 64 FLR
 SG_ DET_RANGE_089 : 24|15@1+ (0.015625,0) [0|500] "m"  FCM_A0
 SG_ DET_RANGE_ERR_089 : 40|7@1+ (0.0075,0) [0|0.9525] "m"  FCM_A0
 SG_ DET_RANGE_VELOCITY_089 : 48|15@1+ (0.0078125,-128) [-128|127.9921875] "m/s"  FCM_A0
 SG_ DET_RANGE_VELOCITY_ERR_089 : 64|8@1+ (0.003,0) [0|0.765] "m/s"  FCM_A0
 SG_ DET_AZIMUTH_089 : 88|13@1+ (0.0004,-1.5708) [-1.5708|1.5708] "rad"  FCM_A0
 SG_ DET_AZIMUTH_ERR_089 : 105|7@1+ (0.00087267,0) [0|0.11082909] "rad"  FCM_A0
 SG_ DET_ELEVATION_089 : 72|8@1+ (0.00275,-0.34925) [-0.34925|0.34925] "rad"  FCM_A0
 SG_ DET_ELEVATION_ERR_089 : 80|6@1+ (0.00174533,0) [0|0.10995579] "rad"  FCM_A0
 SG_ DET_RCS_089 : 128|8@1+ (0.5,-64) [-64|63.5] "dBsm"  FCM_A0
 SG_ DET_BI_STATIC_FLAG_089 : 104|1@1+ (1,0) [0|1] ""  FCM_A0
 SG_ DET_SUPER_RES_TARGET_089 : 87|1@1+ (1,0) [0|1] ""  FCM_A0
 SG_ DET_SNR_089 : 120|8@1+ (0.35156,0) [0|89.6478] "dB"  FCM_A0
 SG_ DET_EXISTENCE_PROB_089 : 112|6@1+ (1.588,0) [0|100] "%"  FCM_A0
 SG_ DET_HVC_FLAG_089 : 86|1@1+ (1,0) [0|1] ""  FCM_A0
 SG_ DET_CONFD_AZIMUTH_089 : 118|2@1+ (1,0) [0|3] ""  FCM_A0
 SG_ DET_CONFD_ELEVATION_089 : 101|2@1+ (1,0) [0|3] ""  FCM_A0
 SG_ DET_PROB_1STAZHYPO_089 : 103|1@1+ (1,0) [0|1] ""  FCM_A0
 SG_ DET_IDM_089 : 63|1@1+ (1,0) [0|1] ""  FCM_A0
 SG_ DET_MTD_089 : 47|1@1+ (1,0) [0|1] ""  FCM_A0
 SG_ DET_BELOW_RAIN_THOLD_089 : 39|1@1+ (1,0) [0|1] ""  FCM_A0
 SG_ DET_RANGE_090 : 136|15@1+ (0.015625,0) [0|500] "m"  FCM_A0
 SG_ DET_RANGE_ERR_090 : 152|7@1+ (0.0075,0) [0|0.9525] "m"  FCM_A0
 SG_ DET_RANGE_VELOCITY_090 : 160|15@1+ (0.0078125,-128) [-128|127.9921875] "m/s"  FCM_A0
 SG_ DET_RANGE_VELOCITY_ERR_090 : 176|8@1+ (0.003,0) [0|0.765] "m/s"  FCM_A0
 SG_ DET_AZIMUTH_090 : 200|13@1+ (0.0004,-1.5708) [-1.5708|1.5708] "rad"  FCM_A0
 SG_ DET_AZIMUTH_ERR_090 : 217|7@1+ (0.00087267,0) [0|0.11082909] "rad"  FCM_A0
 SG_ DET_ELEVATION_090 : 184|8@1+ (0.00275,-0.34925) [-0.34925|0.34925] "rad"  FCM_A0
 SG_ DET_ELEVATION_ERR_090 : 192|6@1+ (0.00174533,0) [0|0.10995579] "rad"  FCM_A0
 SG_ DET_RCS_090 : 240|8@1+ (0.5,-64) [-64|63.5] "dBsm"  FCM_A0
 SG_ DET_BI_STATIC_FLAG_090 : 216|1@1+ (1,0) [0|1] ""  FCM_A0
 SG_ DET_SUPER_RES_TARGET_090 : 199|1@1+ (1,0) [0|1] ""  FCM_A0
 SG_ DET_SNR_090 : 232|8@1+ (0.35156,0) [0|89.6478] "dB"  FCM_A0
 SG_ DET_EXISTENCE_PROB_090 : 224|6@1+ (1.588,0) [0|100] "%"  FCM_A0
 SG_ DET_HVC_FLAG_090 : 198|1@1+ (1,0) [0|1] ""  FCM_A0
 SG_ DET_CONFD_AZIMUTH_090 : 230|2@1+ (1,0) [0|3] ""  FCM_A0
 SG_ DET_CONFD_ELEVATION_090 : 213|2@1+ (1,0) [0|3] ""  FCM_A0
 SG_ DET_PROB_1STAZHYPO_090 : 215|1@1+ (1,0) [0|1] ""  FCM_A0
 SG_ DET_IDM_090 : 175|1@1+ (1,0) [0|1] ""  FCM_A0
 SG_ DET_MTD_090 : 159|1@1+ (1,0) [0|1] ""  FCM_A0
 SG_ DET_BELOW_RAIN_THOLD_090 : 151|1@1+ (1,0) [0|1] ""  FCM_A0
 SG_ DET_RANGE_091 : 248|15@1+ (0.015625,0) [0|500] "m"  FCM_A0
 SG_ DET_RANGE_ERR_091 : 264|7@1+ (0.0075,0) [0|0.9525] "m"  FCM_A0
 SG_ DET_RANGE_VELOCITY_091 : 272|15@1+ (0.0078125,-128) [-128|127.9921875] "m/s"  FCM_A0
 SG_ DET_RANGE_VELOCITY_ERR_091 : 288|8@1+ (0.003,0) [0|0.765] "m/s"  FCM_A0
 SG_ DET_AZIMUTH_091 : 312|13@1+ (0.0004,-1.5708) [-1.5708|1.5708] "rad"  FCM_A0
 SG_ DET_AZIMUTH_ERR_091 : 329|7@1+ (0.00087267,0) [0|0.11082909] "rad"  FCM_A0
 SG_ DET_ELEVATION_091 : 296|8@1+ (0.00275,-0.34925) [-0.34925|0.34925] "rad"  FCM_A0
 SG_ DET_ELEVATION_ERR_091 : 304|6@1+ (0.00174533,0) [0|0.10995579] "rad"  FCM_A0
 SG_ DET_RCS_091 : 352|8@1+ (0.5,-64) [-64|63.5] "dBsm"  FCM_A0
 SG_ DET_BI_STATIC_FLAG_091 : 328|1@1+ (1,0) [0|1] ""  FCM_A0
 SG_ DET_SUPER_RES_TARGET_091 : 311|1@1+ (1,0) [0|1] ""  FCM_A0
 SG_ DET_SNR_091 : 344|8@1+ (0.35156,0) [0|89.6478] "dB"  FCM_A0
 SG_ DET_EXISTENCE_PROB_091 : 336|6@1+ (1.588,0) [0|100] "%"  FCM_A0
 SG_ DET_HVC_FLAG_091 : 310|1@1+ (1,0) [0|1] ""  FCM_A0
 SG_ DET_CONFD_AZIMUTH_091 : 342|2@1+ (1,0) [0|3] ""  FCM_A0
 SG_ DET_CONFD_ELEVATION_091 : 325|2@1+ (1,0) [0|3] ""  FCM_A0
 SG_ DET_PROB_1STAZHYPO_091 : 327|1@1+ (1,0) [0|1] ""  FCM_A0
 SG_ DET_IDM_091 : 287|1@1+ (1,0) [0|1] ""  FCM_A0
 SG_ DET_MTD_091 : 271|1@1+ (1,0) [0|1] ""  FCM_A0
 SG_ DET_BELOW_RAIN_THOLD_091 : 263|1@1+ (1,0) [0|1] ""  FCM_A0
 SG_ DET_RANGE_092 : 360|15@1+ (0.015625,0) [0|500] "m"  FCM_A0
 SG_ DET_RANGE_ERR_092 : 376|7@1+ (0.0075,0) [0|0.9525] "m"  FCM_A0
 SG_ DET_RANGE_VELOCITY_092 : 384|15@1+ (0.0078125,-128) [-128|127.9921875] "m/s"  FCM_A0
 SG_ DET_RANGE_VELOCITY_ERR_092 : 400|8@1+ (0.003,0) [0|0.765] "m/s"  FCM_A0
 SG_ DET_AZIMUTH_092 : 424|13@1+ (0.0004,-1.5708) [-1.5708|1.5708] "rad"  FCM_A0
 SG_ DET_AZIMUTH_ERR_092 : 441|7@1+ (0.00087267,0) [0|0.11082909] "rad"  FCM_A0
 SG_ DET_ELEVATION_092 : 408|8@1+ (0.00275,-0.34925) [-0.34925|0.34925] "rad"  FCM_A0
 SG_ DET_ELEVATION_ERR_092 : 416|6@1+ (0.00174533,0) [0|0.10995579] "rad"  FCM_A0
 SG_ DET_RCS_092 : 464|8@1+ (0.5,-64) [-64|63.5] "dBsm"  FCM_A0
 SG_ DET_BI_STATIC_FLAG_092 : 440|1@1+ (1,0) [0|1] ""  FCM_A0
 SG_ DET_SUPER_RES_TARGET_092 : 423|1@1+ (1,0) [0|1] ""  FCM_A0
 SG_ DET_SNR_092 : 456|8@1+ (0.35156,0) [0|89.6478] "dB"  FCM_A0
 SG_ DET_EXISTENCE_PROB_092 : 448|6@1+ (1.588,0) [0|100] "%"  FCM_A0
 SG_ DET_HVC_FLAG_092 : 422|1@1+ (1,0) [0|1] ""  FCM_A0
 SG_ DET_CONFD_AZIMUTH_092 : 454|2@1+ (1,0) [0|3] ""  FCM_A0
 SG_ DET_CONFD_ELEVATION_092 : 437|2@1+ (1,0) [0|3] ""  FCM_A0
 SG_ DET_MH_SCAN_INDEX_4LSB_089_092 : 476|4@1+ (1,0) [0|15] ""  FCM_A0
 SG_ DET_MH_CYCLE_COUNTER_089_092 : 16|8@1+ (1,0) [0|255] ""  FCM_A0
 SG_ DET_MH_CRC16_089_092 : 0|16@1+ (1,0) [0|65535] ""  FCM_A0
 SG_ DET_PROB_1STAZHYPO_092 : 439|1@1+ (1,0) [0|1] ""  FCM_A0
 SG_ DET_IDM_092 : 399|1@1+ (1,0) [0|1] ""  FCM_A0
 SG_ DET_MTD_092 : 383|1@1+ (1,0) [0|1] ""  FCM_A0
 SG_ DET_BELOW_RAIN_THOLD_092 : 375|1@1+ (1,0) [0|1] ""  FCM_A0

BO_ 789 FLR_DETECTION_085_088: 64 FLR
 SG_ DET_RANGE_085 : 24|15@1+ (0.015625,0) [0|500] "m"  FCM_A0
 SG_ DET_RANGE_ERR_085 : 40|7@1+ (0.0075,0) [0|0.9525] "m"  FCM_A0
 SG_ DET_RANGE_VELOCITY_085 : 48|15@1+ (0.0078125,-128) [-128|127.9921875] "m/s"  FCM_A0
 SG_ DET_RANGE_VELOCITY_ERR_085 : 64|8@1+ (0.003,0) [0|0.765] "m/s"  FCM_A0
 SG_ DET_AZIMUTH_085 : 88|13@1+ (0.0004,-1.5708) [-1.5708|1.5708] "rad"  FCM_A0
 SG_ DET_AZIMUTH_ERR_085 : 105|7@1+ (0.00087267,0) [0|0.11082909] "rad"  FCM_A0
 SG_ DET_ELEVATION_085 : 72|8@1+ (0.00275,-0.34925) [-0.34925|0.34925] "rad"  FCM_A0
 SG_ DET_ELEVATION_ERR_085 : 80|6@1+ (0.00174533,0) [0|0.10995579] "rad"  FCM_A0
 SG_ DET_RCS_085 : 128|8@1+ (0.5,-64) [-64|63.5] "dBsm"  FCM_A0
 SG_ DET_BI_STATIC_FLAG_085 : 104|1@1+ (1,0) [0|1] ""  FCM_A0
 SG_ DET_SUPER_RES_TARGET_085 : 87|1@1+ (1,0) [0|1] ""  FCM_A0
 SG_ DET_SNR_085 : 120|8@1+ (0.35156,0) [0|89.6478] "dB"  FCM_A0
 SG_ DET_EXISTENCE_PROB_085 : 112|6@1+ (1.588,0) [0|100] "%"  FCM_A0
 SG_ DET_HVC_FLAG_085 : 86|1@1+ (1,0) [0|1] ""  FCM_A0
 SG_ DET_CONFD_AZIMUTH_085 : 118|2@1+ (1,0) [0|3] ""  FCM_A0
 SG_ DET_CONFD_ELEVATION_085 : 101|2@1+ (1,0) [0|3] ""  FCM_A0
 SG_ DET_PROB_1STAZHYPO_085 : 103|1@1+ (1,0) [0|1] ""  FCM_A0
 SG_ DET_IDM_085 : 63|1@1+ (1,0) [0|1] ""  FCM_A0
 SG_ DET_MTD_085 : 47|1@1+ (1,0) [0|1] ""  FCM_A0
 SG_ DET_BELOW_RAIN_THOLD_085 : 39|1@1+ (1,0) [0|1] ""  FCM_A0
 SG_ DET_RANGE_086 : 136|15@1+ (0.015625,0) [0|500] "m"  FCM_A0
 SG_ DET_RANGE_ERR_086 : 152|7@1+ (0.0075,0) [0|0.9525] "m"  FCM_A0
 SG_ DET_RANGE_VELOCITY_086 : 160|15@1+ (0.0078125,-128) [-128|127.9921875] "m/s"  FCM_A0
 SG_ DET_RANGE_VELOCITY_ERR_086 : 176|8@1+ (0.003,0) [0|0.765] "m/s"  FCM_A0
 SG_ DET_AZIMUTH_086 : 200|13@1+ (0.0004,-1.5708) [-1.5708|1.5708] "rad"  FCM_A0
 SG_ DET_AZIMUTH_ERR_086 : 217|7@1+ (0.00087267,0) [0|0.11082909] "rad"  FCM_A0
 SG_ DET_ELEVATION_086 : 184|8@1+ (0.00275,-0.34925) [-0.34925|0.34925] "rad"  FCM_A0
 SG_ DET_ELEVATION_ERR_086 : 192|6@1+ (0.00174533,0) [0|0.10995579] "rad"  FCM_A0
 SG_ DET_RCS_086 : 240|8@1+ (0.5,-64) [-64|63.5] "dBsm"  FCM_A0
 SG_ DET_BI_STATIC_FLAG_086 : 216|1@1+ (1,0) [0|1] ""  FCM_A0
 SG_ DET_SUPER_RES_TARGET_086 : 199|1@1+ (1,0) [0|1] ""  FCM_A0
 SG_ DET_SNR_086 : 232|8@1+ (0.35156,0) [0|89.6478] "dB"  FCM_A0
 SG_ DET_EXISTENCE_PROB_086 : 224|6@1+ (1.588,0) [0|100] "%"  FCM_A0
 SG_ DET_HVC_FLAG_086 : 198|1@1+ (1,0) [0|1] ""  FCM_A0
 SG_ DET_CONFD_AZIMUTH_086 : 230|2@1+ (1,0) [0|3] ""  FCM_A0
 SG_ DET_CONFD_ELEVATION_086 : 213|2@1+ (1,0) [0|3] ""  FCM_A0
 SG_ DET_PROB_1STAZHYPO_086 : 215|1@1+ (1,0) [0|1] ""  FCM_A0
 SG_ DET_IDM_086 : 175|1@1+ (1,0) [0|1] ""  FCM_A0
 SG_ DET_MTD_086 : 159|1@1+ (1,0) [0|1] ""  FCM_A0
 SG_ DET_BELOW_RAIN_THOLD_086 : 151|1@1+ (1,0) [0|1] ""  FCM_A0
 SG_ DET_RANGE_087 : 248|15@1+ (0.015625,0) [0|500] "m"  FCM_A0
 SG_ DET_RANGE_ERR_087 : 264|7@1+ (0.0075,0) [0|0.9525] "m"  FCM_A0
 SG_ DET_RANGE_VELOCITY_087 : 272|15@1+ (0.0078125,-128) [-128|127.9921875] "m/s"  FCM_A0
 SG_ DET_RANGE_VELOCITY_ERR_087 : 288|8@1+ (0.003,0) [0|0.765] "m/s"  FCM_A0
 SG_ DET_AZIMUTH_087 : 312|13@1+ (0.0004,-1.5708) [-1.5708|1.5708] "rad"  FCM_A0
 SG_ DET_AZIMUTH_ERR_087 : 329|7@1+ (0.00087267,0) [0|0.11082909] "rad"  FCM_A0
 SG_ DET_ELEVATION_087 : 296|8@1+ (0.00275,-0.34925) [-0.34925|0.34925] "rad"  FCM_A0
 SG_ DET_ELEVATION_ERR_087 : 304|6@1+ (0.00174533,0) [0|0.10995579] "rad"  FCM_A0
 SG_ DET_RCS_087 : 352|8@1+ (0.5,-64) [-64|63.5] "dBsm"  FCM_A0
 SG_ DET_BI_STATIC_FLAG_087 : 328|1@1+ (1,0) [0|1] ""  FCM_A0
 SG_ DET_SUPER_RES_TARGET_087 : 311|1@1+ (1,0) [0|1] ""  FCM_A0
 SG_ DET_SNR_087 : 344|8@1+ (0.35156,0) [0|89.6478] "dB"  FCM_A0
 SG_ DET_EXISTENCE_PROB_087 : 336|6@1+ (1.588,0) [0|100] "%"  FCM_A0
 SG_ DET_HVC_FLAG_087 : 310|1@1+ (1,0) [0|1] ""  FCM_A0
 SG_ DET_CONFD_AZIMUTH_087 : 342|2@1+ (1,0) [0|3] ""  FCM_A0
 SG_ DET_CONFD_ELEVATION_087 : 325|2@1+ (1,0) [0|3] ""  FCM_A0
 SG_ DET_PROB_1STAZHYPO_087 : 327|1@1+ (1,0) [0|1] ""  FCM_A0
 SG_ DET_IDM_087 : 287|1@1+ (1,0) [0|1] ""  FCM_A0
 SG_ DET_MTD_087 : 271|1@1+ (1,0) [0|1] ""  FCM_A0
 SG_ DET_BELOW_RAIN_THOLD_087 : 263|1@1+ (1,0) [0|1] ""  FCM_A0
 SG_ DET_RANGE_088 : 360|15@1+ (0.015625,0) [0|500] "m"  FCM_A0
 SG_ DET_RANGE_ERR_088 : 376|7@1+ (0.0075,0) [0|0.9525] "m"  FCM_A0
 SG_ DET_RANGE_VELOCITY_088 : 384|15@1+ (0.0078125,-128) [-128|127.9921875] "m/s"  FCM_A0
 SG_ DET_RANGE_VELOCITY_ERR_088 : 400|8@1+ (0.003,0) [0|0.765] "m/s"  FCM_A0
 SG_ DET_AZIMUTH_088 : 424|13@1+ (0.0004,-1.5708) [-1.5708|1.5708] "rad"  FCM_A0
 SG_ DET_AZIMUTH_ERR_088 : 441|7@1+ (0.00087267,0) [0|0.11082909] "rad"  FCM_A0
 SG_ DET_ELEVATION_088 : 408|8@1+ (0.00275,-0.34925) [-0.34925|0.34925] "rad"  FCM_A0
 SG_ DET_ELEVATION_ERR_088 : 416|6@1+ (0.00174533,0) [0|0.10995579] "rad"  FCM_A0
 SG_ DET_RCS_088 : 464|8@1+ (0.5,-64) [-64|63.5] "dBsm"  FCM_A0
 SG_ DET_BI_STATIC_FLAG_088 : 440|1@1+ (1,0) [0|1] ""  FCM_A0
 SG_ DET_SUPER_RES_TARGET_088 : 423|1@1+ (1,0) [0|1] ""  FCM_A0
 SG_ DET_SNR_088 : 456|8@1+ (0.35156,0) [0|89.6478] "dB"  FCM_A0
 SG_ DET_EXISTENCE_PROB_088 : 448|6@1+ (1.588,0) [0|100] "%"  FCM_A0
 SG_ DET_HVC_FLAG_088 : 422|1@1+ (1,0) [0|1] ""  FCM_A0
 SG_ DET_CONFD_AZIMUTH_088 : 454|2@1+ (1,0) [0|3] ""  FCM_A0
 SG_ DET_CONFD_ELEVATION_088 : 437|2@1+ (1,0) [0|3] ""  FCM_A0
 SG_ DET_MH_SCAN_INDEX_4LSB_085_088 : 476|4@1+ (1,0) [0|15] ""  FCM_A0
 SG_ DET_MH_CYCLE_COUNTER_085_088 : 16|8@1+ (1,0) [0|255] ""  FCM_A0
 SG_ DET_MH_CRC16_085_088 : 0|16@1+ (1,0) [0|65535] ""  FCM_A0
 SG_ DET_PROB_1STAZHYPO_088 : 439|1@1+ (1,0) [0|1] ""  FCM_A0
 SG_ DET_IDM_088 : 399|1@1+ (1,0) [0|1] ""  FCM_A0
 SG_ DET_MTD_088 : 383|1@1+ (1,0) [0|1] ""  FCM_A0
 SG_ DET_BELOW_RAIN_THOLD_088 : 375|1@1+ (1,0) [0|1] ""  FCM_A0

BO_ 788 FLR_DETECTION_081_084: 64 FLR
 SG_ DET_RANGE_081 : 24|15@1+ (0.015625,0) [0|500] "m"  FCM_A0
 SG_ DET_RANGE_ERR_081 : 40|7@1+ (0.0075,0) [0|0.9525] "m"  FCM_A0
 SG_ DET_RANGE_VELOCITY_081 : 48|15@1+ (0.0078125,-128) [-128|127.9921875] "m/s"  FCM_A0
 SG_ DET_RANGE_VELOCITY_ERR_081 : 64|8@1+ (0.003,0) [0|0.765] "m/s"  FCM_A0
 SG_ DET_AZIMUTH_081 : 88|13@1+ (0.0004,-1.5708) [-1.5708|1.5708] "rad"  FCM_A0
 SG_ DET_AZIMUTH_ERR_081 : 105|7@1+ (0.00087267,0) [0|0.11082909] "rad"  FCM_A0
 SG_ DET_ELEVATION_081 : 72|8@1+ (0.00275,-0.34925) [-0.34925|0.34925] "rad"  FCM_A0
 SG_ DET_ELEVATION_ERR_081 : 80|6@1+ (0.00174533,0) [0|0.10995579] "rad"  FCM_A0
 SG_ DET_RCS_081 : 128|8@1+ (0.5,-64) [-64|63.5] "dBsm"  FCM_A0
 SG_ DET_BI_STATIC_FLAG_081 : 104|1@1+ (1,0) [0|1] ""  FCM_A0
 SG_ DET_SUPER_RES_TARGET_081 : 87|1@1+ (1,0) [0|1] ""  FCM_A0
 SG_ DET_SNR_081 : 120|8@1+ (0.35156,0) [0|89.6478] "dB"  FCM_A0
 SG_ DET_EXISTENCE_PROB_081 : 112|6@1+ (1.588,0) [0|100] "%"  FCM_A0
 SG_ DET_HVC_FLAG_081 : 86|1@1+ (1,0) [0|1] ""  FCM_A0
 SG_ DET_CONFD_AZIMUTH_081 : 118|2@1+ (1,0) [0|3] ""  FCM_A0
 SG_ DET_CONFD_ELEVATION_081 : 101|2@1+ (1,0) [0|3] ""  FCM_A0
 SG_ DET_PROB_1STAZHYPO_081 : 103|1@1+ (1,0) [0|1] ""  FCM_A0
 SG_ DET_IDM_081 : 63|1@1+ (1,0) [0|1] ""  FCM_A0
 SG_ DET_MTD_081 : 47|1@1+ (1,0) [0|1] ""  FCM_A0
 SG_ DET_BELOW_RAIN_THOLD_081 : 39|1@1+ (1,0) [0|1] ""  FCM_A0
 SG_ DET_RANGE_082 : 136|15@1+ (0.015625,0) [0|500] "m"  FCM_A0
 SG_ DET_RANGE_ERR_082 : 152|7@1+ (0.0075,0) [0|0.9525] "m"  FCM_A0
 SG_ DET_RANGE_VELOCITY_082 : 160|15@1+ (0.0078125,-128) [-128|127.9921875] "m/s"  FCM_A0
 SG_ DET_RANGE_VELOCITY_ERR_082 : 176|8@1+ (0.003,0) [0|0.765] "m/s"  FCM_A0
 SG_ DET_AZIMUTH_082 : 200|13@1+ (0.0004,-1.5708) [-1.5708|1.5708] "rad"  FCM_A0
 SG_ DET_AZIMUTH_ERR_082 : 217|7@1+ (0.00087267,0) [0|0.11082909] "rad"  FCM_A0
 SG_ DET_ELEVATION_082 : 184|8@1+ (0.00275,-0.34925) [-0.34925|0.34925] "rad"  FCM_A0
 SG_ DET_ELEVATION_ERR_082 : 192|6@1+ (0.00174533,0) [0|0.10995579] "rad"  FCM_A0
 SG_ DET_RCS_082 : 240|8@1+ (0.5,-64) [-64|63.5] "dBsm"  FCM_A0
 SG_ DET_BI_STATIC_FLAG_082 : 216|1@1+ (1,0) [0|1] ""  FCM_A0
 SG_ DET_SUPER_RES_TARGET_082 : 199|1@1+ (1,0) [0|1] ""  FCM_A0
 SG_ DET_SNR_082 : 232|8@1+ (0.35156,0) [0|89.6478] "dB"  FCM_A0
 SG_ DET_EXISTENCE_PROB_082 : 224|6@1+ (1.588,0) [0|100] "%"  FCM_A0
 SG_ DET_HVC_FLAG_082 : 198|1@1+ (1,0) [0|1] ""  FCM_A0
 SG_ DET_CONFD_AZIMUTH_082 : 230|2@1+ (1,0) [0|3] ""  FCM_A0
 SG_ DET_CONFD_ELEVATION_082 : 213|2@1+ (1,0) [0|3] ""  FCM_A0
 SG_ DET_PROB_1STAZHYPO_082 : 215|1@1+ (1,0) [0|1] ""  FCM_A0
 SG_ DET_IDM_082 : 175|1@1+ (1,0) [0|1] ""  FCM_A0
 SG_ DET_MTD_082 : 159|1@1+ (1,0) [0|1] ""  FCM_A0
 SG_ DET_BELOW_RAIN_THOLD_082 : 151|1@1+ (1,0) [0|1] ""  FCM_A0
 SG_ DET_RANGE_083 : 248|15@1+ (0.015625,0) [0|500] "m"  FCM_A0
 SG_ DET_RANGE_ERR_083 : 264|7@1+ (0.0075,0) [0|0.9525] "m"  FCM_A0
 SG_ DET_RANGE_VELOCITY_083 : 272|15@1+ (0.0078125,-128) [-128|127.9921875] "m/s"  FCM_A0
 SG_ DET_RANGE_VELOCITY_ERR_083 : 288|8@1+ (0.003,0) [0|0.765] "m/s"  FCM_A0
 SG_ DET_AZIMUTH_083 : 312|13@1+ (0.0004,-1.5708) [-1.5708|1.5708] "rad"  FCM_A0
 SG_ DET_AZIMUTH_ERR_083 : 329|7@1+ (0.00087267,0) [0|0.11082909] "rad"  FCM_A0
 SG_ DET_ELEVATION_083 : 296|8@1+ (0.00275,-0.34925) [-0.34925|0.34925] "rad"  FCM_A0
 SG_ DET_ELEVATION_ERR_083 : 304|6@1+ (0.00174533,0) [0|0.10995579] "rad"  FCM_A0
 SG_ DET_RCS_083 : 352|8@1+ (0.5,-64) [-64|63.5] "dBsm"  FCM_A0
 SG_ DET_BI_STATIC_FLAG_083 : 328|1@1+ (1,0) [0|1] ""  FCM_A0
 SG_ DET_SUPER_RES_TARGET_083 : 311|1@1+ (1,0) [0|1] ""  FCM_A0
 SG_ DET_SNR_083 : 344|8@1+ (0.35156,0) [0|89.6478] "dB"  FCM_A0
 SG_ DET_EXISTENCE_PROB_083 : 336|6@1+ (1.588,0) [0|100] "%"  FCM_A0
 SG_ DET_HVC_FLAG_083 : 310|1@1+ (1,0) [0|1] ""  FCM_A0
 SG_ DET_CONFD_AZIMUTH_083 : 342|2@1+ (1,0) [0|3] ""  FCM_A0
 SG_ DET_CONFD_ELEVATION_083 : 325|2@1+ (1,0) [0|3] ""  FCM_A0
 SG_ DET_PROB_1STAZHYPO_083 : 327|1@1+ (1,0) [0|1] ""  FCM_A0
 SG_ DET_IDM_083 : 287|1@1+ (1,0) [0|1] ""  FCM_A0
 SG_ DET_MTD_083 : 271|1@1+ (1,0) [0|1] ""  FCM_A0
 SG_ DET_BELOW_RAIN_THOLD_083 : 263|1@1+ (1,0) [0|1] ""  FCM_A0
 SG_ DET_RANGE_084 : 360|15@1+ (0.015625,0) [0|500] "m"  FCM_A0
 SG_ DET_RANGE_ERR_084 : 376|7@1+ (0.0075,0) [0|0.9525] "m"  FCM_A0
 SG_ DET_RANGE_VELOCITY_084 : 384|15@1+ (0.0078125,-128) [-128|127.9921875] "m/s"  FCM_A0
 SG_ DET_RANGE_VELOCITY_ERR_084 : 400|8@1+ (0.003,0) [0|0.765] "m/s"  FCM_A0
 SG_ DET_AZIMUTH_084 : 424|13@1+ (0.0004,-1.5708) [-1.5708|1.5708] "rad"  FCM_A0
 SG_ DET_AZIMUTH_ERR_084 : 441|7@1+ (0.00087267,0) [0|0.11082909] "rad"  FCM_A0
 SG_ DET_ELEVATION_084 : 408|8@1+ (0.00275,-0.34925) [-0.34925|0.34925] "rad"  FCM_A0
 SG_ DET_ELEVATION_ERR_084 : 416|6@1+ (0.00174533,0) [0|0.10995579] "rad"  FCM_A0
 SG_ DET_RCS_084 : 464|8@1+ (0.5,-64) [-64|63.5] "dBsm"  FCM_A0
 SG_ DET_BI_STATIC_FLAG_084 : 440|1@1+ (1,0) [0|1] ""  FCM_A0
 SG_ DET_SUPER_RES_TARGET_084 : 423|1@1+ (1,0) [0|1] ""  FCM_A0
 SG_ DET_SNR_084 : 456|8@1+ (0.35156,0) [0|89.6478] "dB"  FCM_A0
 SG_ DET_EXISTENCE_PROB_084 : 448|6@1+ (1.588,0) [0|100] "%"  FCM_A0
 SG_ DET_HVC_FLAG_084 : 422|1@1+ (1,0) [0|1] ""  FCM_A0
 SG_ DET_CONFD_AZIMUTH_084 : 454|2@1+ (1,0) [0|3] ""  FCM_A0
 SG_ DET_CONFD_ELEVATION_084 : 437|2@1+ (1,0) [0|3] ""  FCM_A0
 SG_ DET_MH_SCAN_INDEX_4LSB_081_084 : 476|4@1+ (1,0) [0|15] ""  FCM_A0
 SG_ DET_MH_CYCLE_COUNTER_081_084 : 16|8@1+ (1,0) [0|255] ""  FCM_A0
 SG_ DET_MH_CRC16_081_084 : 0|16@1+ (1,0) [0|65535] ""  FCM_A0
 SG_ DET_PROB_1STAZHYPO_084 : 439|1@1+ (1,0) [0|1] ""  FCM_A0
 SG_ DET_IDM_084 : 399|1@1+ (1,0) [0|1] ""  FCM_A0
 SG_ DET_MTD_084 : 383|1@1+ (1,0) [0|1] ""  FCM_A0
 SG_ DET_BELOW_RAIN_THOLD_084 : 375|1@1+ (1,0) [0|1] ""  FCM_A0

BO_ 787 FLR_DETECTION_077_080: 64 FLR
 SG_ DET_RANGE_077 : 24|15@1+ (0.015625,0) [0|500] "m"  FCM_A0
 SG_ DET_RANGE_ERR_077 : 40|7@1+ (0.0075,0) [0|0.9525] "m"  FCM_A0
 SG_ DET_RANGE_VELOCITY_077 : 48|15@1+ (0.0078125,-128) [-128|127.9921875] "m/s"  FCM_A0
 SG_ DET_RANGE_VELOCITY_ERR_077 : 64|8@1+ (0.003,0) [0|0.765] "m/s"  FCM_A0
 SG_ DET_AZIMUTH_077 : 88|13@1+ (0.0004,-1.5708) [-1.5708|1.5708] "rad"  FCM_A0
 SG_ DET_AZIMUTH_ERR_077 : 105|7@1+ (0.00087267,0) [0|0.11082909] "rad"  FCM_A0
 SG_ DET_ELEVATION_077 : 72|8@1+ (0.00275,-0.34925) [-0.34925|0.34925] "rad"  FCM_A0
 SG_ DET_ELEVATION_ERR_077 : 80|6@1+ (0.00174533,0) [0|0.10995579] "rad"  FCM_A0
 SG_ DET_RCS_077 : 128|8@1+ (0.5,-64) [-64|63.5] "dBsm"  FCM_A0
 SG_ DET_BI_STATIC_FLAG_077 : 104|1@1+ (1,0) [0|1] ""  FCM_A0
 SG_ DET_SUPER_RES_TARGET_077 : 87|1@1+ (1,0) [0|1] ""  FCM_A0
 SG_ DET_SNR_077 : 120|8@1+ (0.35156,0) [0|89.6478] "dB"  FCM_A0
 SG_ DET_EXISTENCE_PROB_077 : 112|6@1+ (1.588,0) [0|100] "%"  FCM_A0
 SG_ DET_HVC_FLAG_077 : 86|1@1+ (1,0) [0|1] ""  FCM_A0
 SG_ DET_CONFD_AZIMUTH_077 : 118|2@1+ (1,0) [0|3] ""  FCM_A0
 SG_ DET_CONFD_ELEVATION_077 : 101|2@1+ (1,0) [0|3] ""  FCM_A0
 SG_ DET_PROB_1STAZHYPO_077 : 103|1@1+ (1,0) [0|1] ""  FCM_A0
 SG_ DET_IDM_077 : 63|1@1+ (1,0) [0|1] ""  FCM_A0
 SG_ DET_MTD_077 : 47|1@1+ (1,0) [0|1] ""  FCM_A0
 SG_ DET_BELOW_RAIN_THOLD_077 : 39|1@1+ (1,0) [0|1] ""  FCM_A0
 SG_ DET_RANGE_078 : 136|15@1+ (0.015625,0) [0|500] "m"  FCM_A0
 SG_ DET_RANGE_ERR_078 : 152|7@1+ (0.0075,0) [0|0.9525] "m"  FCM_A0
 SG_ DET_RANGE_VELOCITY_078 : 160|15@1+ (0.0078125,-128) [-128|127.9921875] "m/s"  FCM_A0
 SG_ DET_RANGE_VELOCITY_ERR_078 : 176|8@1+ (0.003,0) [0|0.765] "m/s"  FCM_A0
 SG_ DET_AZIMUTH_078 : 200|13@1+ (0.0004,-1.5708) [-1.5708|1.5708] "rad"  FCM_A0
 SG_ DET_AZIMUTH_ERR_078 : 217|7@1+ (0.00087267,0) [0|0.11082909] "rad"  FCM_A0
 SG_ DET_ELEVATION_078 : 184|8@1+ (0.00275,-0.34925) [-0.34925|0.34925] "rad"  FCM_A0
 SG_ DET_ELEVATION_ERR_078 : 192|6@1+ (0.00174533,0) [0|0.10995579] "rad"  FCM_A0
 SG_ DET_RCS_078 : 240|8@1+ (0.5,-64) [-64|63.5] "dBsm"  FCM_A0
 SG_ DET_BI_STATIC_FLAG_078 : 216|1@1+ (1,0) [0|1] ""  FCM_A0
 SG_ DET_SUPER_RES_TARGET_078 : 199|1@1+ (1,0) [0|1] ""  FCM_A0
 SG_ DET_SNR_078 : 232|8@1+ (0.35156,0) [0|89.6478] "dB"  FCM_A0
 SG_ DET_EXISTENCE_PROB_078 : 224|6@1+ (1.588,0) [0|100] "%"  FCM_A0
 SG_ DET_HVC_FLAG_078 : 198|1@1+ (1,0) [0|1] ""  FCM_A0
 SG_ DET_CONFD_AZIMUTH_078 : 230|2@1+ (1,0) [0|3] ""  FCM_A0
 SG_ DET_CONFD_ELEVATION_078 : 213|2@1+ (1,0) [0|3] ""  FCM_A0
 SG_ DET_PROB_1STAZHYPO_078 : 215|1@1+ (1,0) [0|1] ""  FCM_A0
 SG_ DET_IDM_078 : 175|1@1+ (1,0) [0|1] ""  FCM_A0
 SG_ DET_MTD_078 : 159|1@1+ (1,0) [0|1] ""  FCM_A0
 SG_ DET_BELOW_RAIN_THOLD_078 : 151|1@1+ (1,0) [0|1] ""  FCM_A0
 SG_ DET_RANGE_079 : 248|15@1+ (0.015625,0) [0|500] "m"  FCM_A0
 SG_ DET_RANGE_ERR_079 : 264|7@1+ (0.0075,0) [0|0.9525] "m"  FCM_A0
 SG_ DET_RANGE_VELOCITY_079 : 272|15@1+ (0.0078125,-128) [-128|127.9921875] "m/s"  FCM_A0
 SG_ DET_RANGE_VELOCITY_ERR_079 : 288|8@1+ (0.003,0) [0|0.765] "m/s"  FCM_A0
 SG_ DET_AZIMUTH_079 : 312|13@1+ (0.0004,-1.5708) [-1.5708|1.5708] "rad"  FCM_A0
 SG_ DET_AZIMUTH_ERR_079 : 329|7@1+ (0.00087267,0) [0|0.11082909] "rad"  FCM_A0
 SG_ DET_ELEVATION_079 : 296|8@1+ (0.00275,-0.34925) [-0.34925|0.34925] "rad"  FCM_A0
 SG_ DET_ELEVATION_ERR_079 : 304|6@1+ (0.00174533,0) [0|0.10995579] "rad"  FCM_A0
 SG_ DET_RCS_079 : 352|8@1+ (0.5,-64) [-64|63.5] "dBsm"  FCM_A0
 SG_ DET_BI_STATIC_FLAG_079 : 328|1@1+ (1,0) [0|1] ""  FCM_A0
 SG_ DET_SUPER_RES_TARGET_079 : 311|1@1+ (1,0) [0|1] ""  FCM_A0
 SG_ DET_SNR_079 : 344|8@1+ (0.35156,0) [0|89.6478] "dB"  FCM_A0
 SG_ DET_EXISTENCE_PROB_079 : 336|6@1+ (1.588,0) [0|100] "%"  FCM_A0
 SG_ DET_HVC_FLAG_079 : 310|1@1+ (1,0) [0|1] ""  FCM_A0
 SG_ DET_CONFD_AZIMUTH_079 : 342|2@1+ (1,0) [0|3] ""  FCM_A0
 SG_ DET_CONFD_ELEVATION_079 : 325|2@1+ (1,0) [0|3] ""  FCM_A0
 SG_ DET_PROB_1STAZHYPO_079 : 327|1@1+ (1,0) [0|1] ""  FCM_A0
 SG_ DET_IDM_079 : 287|1@1+ (1,0) [0|1] ""  FCM_A0
 SG_ DET_MTD_079 : 271|1@1+ (1,0) [0|1] ""  FCM_A0
 SG_ DET_BELOW_RAIN_THOLD_079 : 263|1@1+ (1,0) [0|1] ""  FCM_A0
 SG_ DET_RANGE_080 : 360|15@1+ (0.015625,0) [0|500] "m"  FCM_A0
 SG_ DET_RANGE_ERR_080 : 376|7@1+ (0.0075,0) [0|0.9525] "m"  FCM_A0
 SG_ DET_RANGE_VELOCITY_080 : 384|15@1+ (0.0078125,-128) [-128|127.9921875] "m/s"  FCM_A0
 SG_ DET_RANGE_VELOCITY_ERR_080 : 400|8@1+ (0.003,0) [0|0.765] "m/s"  FCM_A0
 SG_ DET_AZIMUTH_080 : 424|13@1+ (0.0004,-1.5708) [-1.5708|1.5708] "rad"  FCM_A0
 SG_ DET_AZIMUTH_ERR_080 : 441|7@1+ (0.00087267,0) [0|0.11082909] "rad"  FCM_A0
 SG_ DET_ELEVATION_080 : 408|8@1+ (0.00275,-0.34925) [-0.34925|0.34925] "rad"  FCM_A0
 SG_ DET_ELEVATION_ERR_080 : 416|6@1+ (0.00174533,0) [0|0.10995579] "rad"  FCM_A0
 SG_ DET_RCS_080 : 464|8@1+ (0.5,-64) [-64|63.5] "dBsm"  FCM_A0
 SG_ DET_BI_STATIC_FLAG_080 : 440|1@1+ (1,0) [0|1] ""  FCM_A0
 SG_ DET_SUPER_RES_TARGET_080 : 423|1@1+ (1,0) [0|1] ""  FCM_A0
 SG_ DET_SNR_080 : 456|8@1+ (0.35156,0) [0|89.6478] "dB"  FCM_A0
 SG_ DET_EXISTENCE_PROB_080 : 448|6@1+ (1.588,0) [0|100] "%"  FCM_A0
 SG_ DET_HVC_FLAG_080 : 422|1@1+ (1,0) [0|1] ""  FCM_A0
 SG_ DET_CONFD_AZIMUTH_080 : 454|2@1+ (1,0) [0|3] ""  FCM_A0
 SG_ DET_CONFD_ELEVATION_080 : 437|2@1+ (1,0) [0|3] ""  FCM_A0
 SG_ DET_MH_SCAN_INDEX_4LSB_077_080 : 476|4@1+ (1,0) [0|15] ""  FCM_A0
 SG_ DET_MH_CYCLE_COUNTER_077_080 : 16|8@1+ (1,0) [0|255] ""  FCM_A0
 SG_ DET_MH_CRC16_077_080 : 0|16@1+ (1,0) [0|65535] ""  FCM_A0
 SG_ DET_PROB_1STAZHYPO_080 : 439|1@1+ (1,0) [0|1] ""  FCM_A0
 SG_ DET_IDM_080 : 399|1@1+ (1,0) [0|1] ""  FCM_A0
 SG_ DET_MTD_080 : 383|1@1+ (1,0) [0|1] ""  FCM_A0
 SG_ DET_BELOW_RAIN_THOLD_080 : 375|1@1+ (1,0) [0|1] ""  FCM_A0

BO_ 786 FLR_DETECTION_073_076: 64 FLR
 SG_ DET_RANGE_073 : 24|15@1+ (0.015625,0) [0|500] "m"  FCM_A0
 SG_ DET_RANGE_ERR_073 : 40|7@1+ (0.0075,0) [0|0.9525] "m"  FCM_A0
 SG_ DET_RANGE_VELOCITY_073 : 48|15@1+ (0.0078125,-128) [-128|127.9921875] "m/s"  FCM_A0
 SG_ DET_RANGE_VELOCITY_ERR_073 : 64|8@1+ (0.003,0) [0|0.765] "m/s"  FCM_A0
 SG_ DET_AZIMUTH_073 : 88|13@1+ (0.0004,-1.5708) [-1.5708|1.5708] "rad"  FCM_A0
 SG_ DET_AZIMUTH_ERR_073 : 105|7@1+ (0.00087267,0) [0|0.11082909] "rad"  FCM_A0
 SG_ DET_ELEVATION_073 : 72|8@1+ (0.00275,-0.34925) [-0.34925|0.34925] "rad"  FCM_A0
 SG_ DET_ELEVATION_ERR_073 : 80|6@1+ (0.00174533,0) [0|0.10995579] "rad"  FCM_A0
 SG_ DET_RCS_073 : 128|8@1+ (0.5,-64) [-64|63.5] "dBsm"  FCM_A0
 SG_ DET_BI_STATIC_FLAG_073 : 104|1@1+ (1,0) [0|1] ""  FCM_A0
 SG_ DET_SUPER_RES_TARGET_073 : 87|1@1+ (1,0) [0|1] ""  FCM_A0
 SG_ DET_SNR_073 : 120|8@1+ (0.35156,0) [0|89.6478] "dB"  FCM_A0
 SG_ DET_EXISTENCE_PROB_073 : 112|6@1+ (1.588,0) [0|100] "%"  FCM_A0
 SG_ DET_HVC_FLAG_073 : 86|1@1+ (1,0) [0|1] ""  FCM_A0
 SG_ DET_CONFD_AZIMUTH_073 : 118|2@1+ (1,0) [0|3] ""  FCM_A0
 SG_ DET_CONFD_ELEVATION_073 : 101|2@1+ (1,0) [0|3] ""  FCM_A0
 SG_ DET_PROB_1STAZHYPO_073 : 103|1@1+ (1,0) [0|1] ""  FCM_A0
 SG_ DET_IDM_073 : 63|1@1+ (1,0) [0|1] ""  FCM_A0
 SG_ DET_MTD_073 : 47|1@1+ (1,0) [0|1] ""  FCM_A0
 SG_ DET_BELOW_RAIN_THOLD_073 : 39|1@1+ (1,0) [0|1] ""  FCM_A0
 SG_ DET_RANGE_074 : 136|15@1+ (0.015625,0) [0|500] "m"  FCM_A0
 SG_ DET_RANGE_ERR_074 : 152|7@1+ (0.0075,0) [0|0.9525] "m"  FCM_A0
 SG_ DET_RANGE_VELOCITY_074 : 160|15@1+ (0.0078125,-128) [-128|127.9921875] "m/s"  FCM_A0
 SG_ DET_RANGE_VELOCITY_ERR_074 : 176|8@1+ (0.003,0) [0|0.765] "m/s"  FCM_A0
 SG_ DET_AZIMUTH_074 : 200|13@1+ (0.0004,-1.5708) [-1.5708|1.5708] "rad"  FCM_A0
 SG_ DET_AZIMUTH_ERR_074 : 217|7@1+ (0.00087267,0) [0|0.11082909] "rad"  FCM_A0
 SG_ DET_ELEVATION_074 : 184|8@1+ (0.00275,-0.34925) [-0.34925|0.34925] "rad"  FCM_A0
 SG_ DET_ELEVATION_ERR_074 : 192|6@1+ (0.00174533,0) [0|0.10995579] "rad"  FCM_A0
 SG_ DET_RCS_074 : 240|8@1+ (0.5,-64) [-64|63.5] "dBsm"  FCM_A0
 SG_ DET_BI_STATIC_FLAG_074 : 216|1@1+ (1,0) [0|1] ""  FCM_A0
 SG_ DET_SUPER_RES_TARGET_074 : 199|1@1+ (1,0) [0|1] ""  FCM_A0
 SG_ DET_SNR_074 : 232|8@1+ (0.35156,0) [0|89.6478] "dB"  FCM_A0
 SG_ DET_EXISTENCE_PROB_074 : 224|6@1+ (1.588,0) [0|100] "%"  FCM_A0
 SG_ DET_HVC_FLAG_074 : 198|1@1+ (1,0) [0|1] ""  FCM_A0
 SG_ DET_CONFD_AZIMUTH_074 : 230|2@1+ (1,0) [0|3] ""  FCM_A0
 SG_ DET_CONFD_ELEVATION_074 : 213|2@1+ (1,0) [0|3] ""  FCM_A0
 SG_ DET_PROB_1STAZHYPO_074 : 215|1@1+ (1,0) [0|1] ""  FCM_A0
 SG_ DET_IDM_074 : 175|1@1+ (1,0) [0|1] ""  FCM_A0
 SG_ DET_MTD_074 : 159|1@1+ (1,0) [0|1] ""  FCM_A0
 SG_ DET_BELOW_RAIN_THOLD_074 : 151|1@1+ (1,0) [0|1] ""  FCM_A0
 SG_ DET_RANGE_075 : 248|15@1+ (0.015625,0) [0|500] "m"  FCM_A0
 SG_ DET_RANGE_ERR_075 : 264|7@1+ (0.0075,0) [0|0.9525] "m"  FCM_A0
 SG_ DET_RANGE_VELOCITY_075 : 272|15@1+ (0.0078125,-128) [-128|127.9921875] "m/s"  FCM_A0
 SG_ DET_RANGE_VELOCITY_ERR_075 : 288|8@1+ (0.003,0) [0|0.765] "m/s"  FCM_A0
 SG_ DET_AZIMUTH_075 : 312|13@1+ (0.0004,-1.5708) [-1.5708|1.5708] "rad"  FCM_A0
 SG_ DET_AZIMUTH_ERR_075 : 329|7@1+ (0.00087267,0) [0|0.11082909] "rad"  FCM_A0
 SG_ DET_ELEVATION_075 : 296|8@1+ (0.00275,-0.34925) [-0.34925|0.34925] "rad"  FCM_A0
 SG_ DET_ELEVATION_ERR_075 : 304|6@1+ (0.00174533,0) [0|0.10995579] "rad"  FCM_A0
 SG_ DET_RCS_075 : 352|8@1+ (0.5,-64) [-64|63.5] "dBsm"  FCM_A0
 SG_ DET_BI_STATIC_FLAG_075 : 328|1@1+ (1,0) [0|1] ""  FCM_A0
 SG_ DET_SUPER_RES_TARGET_075 : 311|1@1+ (1,0) [0|1] ""  FCM_A0
 SG_ DET_SNR_075 : 344|8@1+ (0.35156,0) [0|89.6478] "dB"  FCM_A0
 SG_ DET_EXISTENCE_PROB_075 : 336|6@1+ (1.588,0) [0|100] "%"  FCM_A0
 SG_ DET_HVC_FLAG_075 : 310|1@1+ (1,0) [0|1] ""  FCM_A0
 SG_ DET_CONFD_AZIMUTH_075 : 342|2@1+ (1,0) [0|3] ""  FCM_A0
 SG_ DET_CONFD_ELEVATION_075 : 325|2@1+ (1,0) [0|3] ""  FCM_A0
 SG_ DET_PROB_1STAZHYPO_075 : 327|1@1+ (1,0) [0|1] ""  FCM_A0
 SG_ DET_IDM_075 : 287|1@1+ (1,0) [0|1] ""  FCM_A0
 SG_ DET_MTD_075 : 271|1@1+ (1,0) [0|1] ""  FCM_A0
 SG_ DET_BELOW_RAIN_THOLD_075 : 263|1@1+ (1,0) [0|1] ""  FCM_A0
 SG_ DET_RANGE_076 : 360|15@1+ (0.015625,0) [0|500] "m"  FCM_A0
 SG_ DET_RANGE_ERR_076 : 376|7@1+ (0.0075,0) [0|0.9525] "m"  FCM_A0
 SG_ DET_RANGE_VELOCITY_076 : 384|15@1+ (0.0078125,-128) [-128|127.9921875] "m/s"  FCM_A0
 SG_ DET_RANGE_VELOCITY_ERR_076 : 400|8@1+ (0.003,0) [0|0.765] "m/s"  FCM_A0
 SG_ DET_AZIMUTH_076 : 424|13@1+ (0.0004,-1.5708) [-1.5708|1.5708] "rad"  FCM_A0
 SG_ DET_AZIMUTH_ERR_076 : 441|7@1+ (0.00087267,0) [0|0.11082909] "rad"  FCM_A0
 SG_ DET_ELEVATION_076 : 408|8@1+ (0.00275,-0.34925) [-0.34925|0.34925] "rad"  FCM_A0
 SG_ DET_ELEVATION_ERR_076 : 416|6@1+ (0.00174533,0) [0|0.10995579] "rad"  FCM_A0
 SG_ DET_RCS_076 : 464|8@1+ (0.5,-64) [-64|63.5] "dBsm"  FCM_A0
 SG_ DET_BI_STATIC_FLAG_076 : 440|1@1+ (1,0) [0|1] ""  FCM_A0
 SG_ DET_SUPER_RES_TARGET_076 : 423|1@1+ (1,0) [0|1] ""  FCM_A0
 SG_ DET_SNR_076 : 456|8@1+ (0.35156,0) [0|89.6478] "dB"  FCM_A0
 SG_ DET_EXISTENCE_PROB_076 : 448|6@1+ (1.588,0) [0|100] "%"  FCM_A0
 SG_ DET_HVC_FLAG_076 : 422|1@1+ (1,0) [0|1] ""  FCM_A0
 SG_ DET_CONFD_AZIMUTH_076 : 454|2@1+ (1,0) [0|3] ""  FCM_A0
 SG_ DET_CONFD_ELEVATION_076 : 437|2@1+ (1,0) [0|3] ""  FCM_A0
 SG_ DET_MH_SCAN_INDEX_4LSB_073_076 : 476|4@1+ (1,0) [0|15] ""  FCM_A0
 SG_ DET_MH_CYCLE_COUNTER_073_076 : 16|8@1+ (1,0) [0|255] ""  FCM_A0
 SG_ DET_MH_CRC16_073_076 : 0|16@1+ (1,0) [0|65535] ""  FCM_A0
 SG_ DET_PROB_1STAZHYPO_076 : 439|1@1+ (1,0) [0|1] ""  FCM_A0
 SG_ DET_IDM_076 : 399|1@1+ (1,0) [0|1] ""  FCM_A0
 SG_ DET_MTD_076 : 383|1@1+ (1,0) [0|1] ""  FCM_A0
 SG_ DET_BELOW_RAIN_THOLD_076 : 375|1@1+ (1,0) [0|1] ""  FCM_A0

BO_ 785 FLR_DETECTION_069_072: 64 FLR
 SG_ DET_RANGE_069 : 24|15@1+ (0.015625,0) [0|500] "m"  FCM_A0
 SG_ DET_RANGE_ERR_069 : 40|7@1+ (0.0075,0) [0|0.9525] "m"  FCM_A0
 SG_ DET_RANGE_VELOCITY_069 : 48|15@1+ (0.0078125,-128) [-128|127.9921875] "m/s"  FCM_A0
 SG_ DET_RANGE_VELOCITY_ERR_069 : 64|8@1+ (0.003,0) [0|0.765] "m/s"  FCM_A0
 SG_ DET_AZIMUTH_069 : 88|13@1+ (0.0004,-1.5708) [-1.5708|1.5708] "rad"  FCM_A0
 SG_ DET_AZIMUTH_ERR_069 : 105|7@1+ (0.00087267,0) [0|0.11082909] "rad"  FCM_A0
 SG_ DET_ELEVATION_069 : 72|8@1+ (0.00275,-0.34925) [-0.34925|0.34925] "rad"  FCM_A0
 SG_ DET_ELEVATION_ERR_069 : 80|6@1+ (0.00174533,0) [0|0.10995579] "rad"  FCM_A0
 SG_ DET_RCS_069 : 128|8@1+ (0.5,-64) [-64|63.5] "dBsm"  FCM_A0
 SG_ DET_BI_STATIC_FLAG_069 : 104|1@1+ (1,0) [0|1] ""  FCM_A0
 SG_ DET_SUPER_RES_TARGET_069 : 87|1@1+ (1,0) [0|1] ""  FCM_A0
 SG_ DET_SNR_069 : 120|8@1+ (0.35156,0) [0|89.6478] "dB"  FCM_A0
 SG_ DET_EXISTENCE_PROB_069 : 112|6@1+ (1.588,0) [0|100] "%"  FCM_A0
 SG_ DET_HVC_FLAG_069 : 86|1@1+ (1,0) [0|1] ""  FCM_A0
 SG_ DET_CONFD_AZIMUTH_069 : 118|2@1+ (1,0) [0|3] ""  FCM_A0
 SG_ DET_CONFD_ELEVATION_069 : 101|2@1+ (1,0) [0|3] ""  FCM_A0
 SG_ DET_PROB_1STAZHYPO_069 : 103|1@1+ (1,0) [0|1] ""  FCM_A0
 SG_ DET_IDM_069 : 63|1@1+ (1,0) [0|1] ""  FCM_A0
 SG_ DET_MTD_069 : 47|1@1+ (1,0) [0|1] ""  FCM_A0
 SG_ DET_BELOW_RAIN_THOLD_069 : 39|1@1+ (1,0) [0|1] ""  FCM_A0
 SG_ DET_RANGE_070 : 136|15@1+ (0.015625,0) [0|500] "m"  FCM_A0
 SG_ DET_RANGE_ERR_070 : 152|7@1+ (0.0075,0) [0|0.9525] "m"  FCM_A0
 SG_ DET_RANGE_VELOCITY_070 : 160|15@1+ (0.0078125,-128) [-128|127.9921875] "m/s"  FCM_A0
 SG_ DET_RANGE_VELOCITY_ERR_070 : 176|8@1+ (0.003,0) [0|0.765] "m/s"  FCM_A0
 SG_ DET_AZIMUTH_070 : 200|13@1+ (0.0004,-1.5708) [-1.5708|1.5708] "rad"  FCM_A0
 SG_ DET_AZIMUTH_ERR_070 : 217|7@1+ (0.00087267,0) [0|0.11082909] "rad"  FCM_A0
 SG_ DET_ELEVATION_070 : 184|8@1+ (0.00275,-0.34925) [-0.34925|0.34925] "rad"  FCM_A0
 SG_ DET_ELEVATION_ERR_070 : 192|6@1+ (0.00174533,0) [0|0.10995579] "rad"  FCM_A0
 SG_ DET_RCS_070 : 240|8@1+ (0.5,-64) [-64|63.5] "dBsm"  FCM_A0
 SG_ DET_BI_STATIC_FLAG_070 : 216|1@1+ (1,0) [0|1] ""  FCM_A0
 SG_ DET_SUPER_RES_TARGET_070 : 199|1@1+ (1,0) [0|1] ""  FCM_A0
 SG_ DET_SNR_070 : 232|8@1+ (0.35156,0) [0|89.6478] "dB"  FCM_A0
 SG_ DET_EXISTENCE_PROB_070 : 224|6@1+ (1.588,0) [0|100] "%"  FCM_A0
 SG_ DET_HVC_FLAG_070 : 198|1@1+ (1,0) [0|1] ""  FCM_A0
 SG_ DET_CONFD_AZIMUTH_070 : 230|2@1+ (1,0) [0|3] ""  FCM_A0
 SG_ DET_CONFD_ELEVATION_070 : 213|2@1+ (1,0) [0|3] ""  FCM_A0
 SG_ DET_PROB_1STAZHYPO_070 : 215|1@1+ (1,0) [0|1] ""  FCM_A0
 SG_ DET_IDM_070 : 175|1@1+ (1,0) [0|1] ""  FCM_A0
 SG_ DET_MTD_070 : 159|1@1+ (1,0) [0|1] ""  FCM_A0
 SG_ DET_BELOW_RAIN_THOLD_070 : 151|1@1+ (1,0) [0|1] ""  FCM_A0
 SG_ DET_RANGE_071 : 248|15@1+ (0.015625,0) [0|500] "m"  FCM_A0
 SG_ DET_RANGE_ERR_071 : 264|7@1+ (0.0075,0) [0|0.9525] "m"  FCM_A0
 SG_ DET_RANGE_VELOCITY_071 : 272|15@1+ (0.0078125,-128) [-128|127.9921875] "m/s"  FCM_A0
 SG_ DET_RANGE_VELOCITY_ERR_071 : 288|8@1+ (0.003,0) [0|0.765] "m/s"  FCM_A0
 SG_ DET_AZIMUTH_071 : 312|13@1+ (0.0004,-1.5708) [-1.5708|1.5708] "rad"  FCM_A0
 SG_ DET_AZIMUTH_ERR_071 : 329|7@1+ (0.00087267,0) [0|0.11082909] "rad"  FCM_A0
 SG_ DET_ELEVATION_071 : 296|8@1+ (0.00275,-0.34925) [-0.34925|0.34925] "rad"  FCM_A0
 SG_ DET_ELEVATION_ERR_071 : 304|6@1+ (0.00174533,0) [0|0.10995579] "rad"  FCM_A0
 SG_ DET_RCS_071 : 352|8@1+ (0.5,-64) [-64|63.5] "dBsm"  FCM_A0
 SG_ DET_BI_STATIC_FLAG_071 : 328|1@1+ (1,0) [0|1] ""  FCM_A0
 SG_ DET_SUPER_RES_TARGET_071 : 311|1@1+ (1,0) [0|1] ""  FCM_A0
 SG_ DET_SNR_071 : 344|8@1+ (0.35156,0) [0|89.6478] "dB"  FCM_A0
 SG_ DET_EXISTENCE_PROB_071 : 336|6@1+ (1.588,0) [0|100] "%"  FCM_A0
 SG_ DET_HVC_FLAG_071 : 310|1@1+ (1,0) [0|1] ""  FCM_A0
 SG_ DET_CONFD_AZIMUTH_071 : 342|2@1+ (1,0) [0|3] ""  FCM_A0
 SG_ DET_CONFD_ELEVATION_071 : 325|2@1+ (1,0) [0|3] ""  FCM_A0
 SG_ DET_PROB_1STAZHYPO_071 : 327|1@1+ (1,0) [0|1] ""  FCM_A0
 SG_ DET_IDM_071 : 287|1@1+ (1,0) [0|1] ""  FCM_A0
 SG_ DET_MTD_071 : 271|1@1+ (1,0) [0|1] ""  FCM_A0
 SG_ DET_BELOW_RAIN_THOLD_071 : 263|1@1+ (1,0) [0|1] ""  FCM_A0
 SG_ DET_RANGE_072 : 360|15@1+ (0.015625,0) [0|500] "m"  FCM_A0
 SG_ DET_RANGE_ERR_072 : 376|7@1+ (0.0075,0) [0|0.9525] "m"  FCM_A0
 SG_ DET_RANGE_VELOCITY_072 : 384|15@1+ (0.0078125,-128) [-128|127.9921875] "m/s"  FCM_A0
 SG_ DET_RANGE_VELOCITY_ERR_072 : 400|8@1+ (0.003,0) [0|0.765] "m/s"  FCM_A0
 SG_ DET_AZIMUTH_072 : 424|13@1+ (0.0004,-1.5708) [-1.5708|1.5708] "rad"  FCM_A0
 SG_ DET_AZIMUTH_ERR_072 : 441|7@1+ (0.00087267,0) [0|0.11082909] "rad"  FCM_A0
 SG_ DET_ELEVATION_072 : 408|8@1+ (0.00275,-0.34925) [-0.34925|0.34925] "rad"  FCM_A0
 SG_ DET_ELEVATION_ERR_072 : 416|6@1+ (0.00174533,0) [0|0.10995579] "rad"  FCM_A0
 SG_ DET_RCS_072 : 464|8@1+ (0.5,-64) [-64|63.5] "dBsm"  FCM_A0
 SG_ DET_BI_STATIC_FLAG_072 : 440|1@1+ (1,0) [0|1] ""  FCM_A0
 SG_ DET_SUPER_RES_TARGET_072 : 423|1@1+ (1,0) [0|1] ""  FCM_A0
 SG_ DET_SNR_072 : 456|8@1+ (0.35156,0) [0|89.6478] "dB"  FCM_A0
 SG_ DET_EXISTENCE_PROB_072 : 448|6@1+ (1.588,0) [0|100] "%"  FCM_A0
 SG_ DET_HVC_FLAG_072 : 422|1@1+ (1,0) [0|1] ""  FCM_A0
 SG_ DET_CONFD_AZIMUTH_072 : 454|2@1+ (1,0) [0|3] ""  FCM_A0
 SG_ DET_CONFD_ELEVATION_072 : 437|2@1+ (1,0) [0|3] ""  FCM_A0
 SG_ DET_MH_SCAN_INDEX_4LSB_069_072 : 476|4@1+ (1,0) [0|15] ""  FCM_A0
 SG_ DET_MH_CYCLE_COUNTER_069_072 : 16|8@1+ (1,0) [0|255] ""  FCM_A0
 SG_ DET_MH_CRC16_069_072 : 0|16@1+ (1,0) [0|65535] ""  FCM_A0
 SG_ DET_PROB_1STAZHYPO_072 : 439|1@1+ (1,0) [0|1] ""  FCM_A0
 SG_ DET_IDM_072 : 399|1@1+ (1,0) [0|1] ""  FCM_A0
 SG_ DET_MTD_072 : 383|1@1+ (1,0) [0|1] ""  FCM_A0
 SG_ DET_BELOW_RAIN_THOLD_072 : 375|1@1+ (1,0) [0|1] ""  FCM_A0

CM_ SG_ 163 STS_AF_TIME_PEAK "Angle Finding Latency peak";
CM_ SG_ 163 STS_AF_TIME_INST "Angle Finding Latency instantaneous";
CM_ SG_ 163 STS_SW_VERSION_FIELD1 "Release_Number is incremented for major every release";
CM_ SG_ 163 STS_SW_VERSION_FIELD2 "Promote_Revision, increment with every promote or minor release";
CM_ SG_ 163 STS_SW_VERSION_FIELD3 "Field_Revision  or Variant number";
CM_ SG_ 163 STS_SW_VERSION_FIELD4 "Increment with SW patch release";
CM_ SG_ 163 STS_PBL_VERSION_FIELD1 "Release_Number is incremented for major every release";
CM_ SG_ 163 STS_PBL_VERSION_FIELD2 "Promote_Revision, increment with every promote or minor release";
CM_ SG_ 163 STS_PBL_VERSION_FIELD3 "Field_Revision  or Variant number";
CM_ SG_ 163 STS_PBL_VERSION_FIELD4 "Increment with patch release";
CM_ SG_ 163 STS_SMC_SECTION_COMPTBLITY "Section compatiblity bits as specified in EXEC spec";
CM_ SG_ 163 STS_SMC_PLATFROM_VERSION "Variant ID";
CM_ SG_ 163 STS_SENSOR_MOUNT_POS_X "Correction of the mounting position w.r.t. the optimal position. Correction is determined by calibration";
CM_ SG_ 163 STS_SENSOR_MOUNT_ORNT_PITCH "Correction of the mounting position orientation w.r.t. the optimal orientation";
CM_ SG_ 163 STS_SENSOR_HEIGHT "Radar height from ground to center of radar elevation field-of-view";
CM_ SG_ 163 STS_DET_DBC_BASE_VER_MINOR "Detection base dbc Minor version";
CM_ SG_ 163 STS_DET_DBC_BASE_VER_MAJOR "Detection base dbc Major version";
CM_ SG_ 160 HED_NUM_OF_VALID_DETECTIONS "The current number of valid detections in the detections list";
CM_ SG_ 160 HED_LOOK_ID "Indicates the look type values 1 to 4 base on medium/long look and near/far look. Each radar scan is a look.";
CM_ SG_ 160 HED_SCAN_INDEX "Scan index";
CM_ SG_ 160 HED_MH_CYCLE_COUNTER "ALIVE counter";
CM_ SG_ 160 HED_DATA_QUALIFIER "Data qualifier communicates the overall availability of the interface or expresses to what extent the content of this event can be relied on ";
CM_ SG_ 160 HED_DET_RANGE_MAX "Detection range max is the farthest possible detection with respect to the sensor origin.";
CM_ SG_ 160 HED_DET_SPEED_RANGE_MAX "Describes the relative radial speed range in the sensor coordinate system. Range is defined by
two range values: negative values indicate lower speed than the ego-vehicle, positive values
indicate higher velocity than ego-vehicle";
CM_ SG_ 160 HED_FOV_HOR_MAX "Field of view defined by opening angles in sensor XY-plane.";
CM_ SG_ 160 HED_FOV_VER_MAX "Field of view defined by opening angles in sensor XZ-plane.";
CM_ SG_ 160 HED_DET_RANGE_MIN "Detection range max is the Closest possible detection with respect to the sensor origin.";
CM_ SG_ 160 HED_DET_SPEED_RANGE_MIN "Describes the relative radial speed range in the sensor coordinate system. Range is defined by
two range values: negative values indicate lower speed than the ego-vehicle, positive values
indicate higher velocity than ego-vehicle";
CM_ SG_ 160 HED_FOV_HOR_MIN "Field of view defined by opening angles in sensor XY-plane.";
CM_ SG_ 160 HED_FOV_VER_MIN "Field of view defined by opening angles in sensor XZ-plane.";
CM_ SG_ 160 HED_ALIGN_HOR_REF "Alignment horizontal reference";
CM_ SG_ 160 HED_SENSOR_TIME_STAMP_NS "sensor absolute time when the radar measurement was taken";
CM_ SG_ 160 HED_TIME_SYNC_SRC_MASTER "Indicate if sensor is synch to global master or local master";
CM_ SG_ 160 HED_TIME_SYNC_VALIDITY_FLAG "indicates the validity of Time Sync message data";
CM_ SG_ 160 HED_TRIGGER_TIME "Data Acquisition start time";
CM_ SG_ 799 DET_RANGE_125 " measured position  of the detection";
CM_ SG_ 799 DET_RANGE_ERR_125 "RMSE or standard deviation of the measured angle  of the detection";
CM_ SG_ 799 DET_RANGE_VELOCITY_125 "Radial velocity of the detection positive in direction to the sensor";
CM_ SG_ 799 DET_RANGE_VELOCITY_ERR_125 "RMSE or standard deviation of the measure radial velocity of the detection";
CM_ SG_ 799 DET_AZIMUTH_125 "Measured angle  of the detection";
CM_ SG_ 799 DET_AZIMUTH_ERR_125 "RMSE or standard deviation of the measured angle  of the detection";
CM_ SG_ 799 DET_ELEVATION_125 "measured elevation of the detection";
CM_ SG_ 799 DET_ELEVATION_ERR_125 "RMSE or standard deviation of the measured elevation  of the detection";
CM_ SG_ 799 DET_RCS_125 "Radar Cross Section or Amplitude, is a measure of how detectable an object is by radar. A larger RCS indicates that an object is more easily detected.";
CM_ SG_ 799 DET_BI_STATIC_FLAG_125 "1 if detection is bi-static 0 otherwise";
CM_ SG_ 799 DET_SUPER_RES_TARGET_125 "flasg is set if the detection is super resolution target";
CM_ SG_ 799 DET_SNR_125 "The signal to noise ratio (SNR) of the radar detection";
CM_ SG_ 799 DET_EXISTENCE_PROB_125 "Existence probability of the detection not based on history. Value does  not depend on any past experience with similar detections.

ote Use as confidence measure where a low value means less confidence
and a high value indicates strong confidence.";
CM_ SG_ 799 DET_HVC_FLAG_125 "Core2 Vehicle clutter flag";
CM_ SG_ 799 DET_CONFD_AZIMUTH_125 "Define the Confidence of Azimuth for Detection ";
CM_ SG_ 799 DET_CONFD_ELEVATION_125 "Define the Confidence of Elevation for the Detection ";
CM_ SG_ 799 DET_BI_STATIC_FLAG_126 "1 if detection is bi-static 0 otherwise";
CM_ SG_ 799 DET_BI_STATIC_FLAG_127 "1 if detection is bi-static 0 otherwise";
CM_ SG_ 799 DET_BI_STATIC_FLAG_128 "1 if detection is bi-static 0 otherwise";
CM_ SG_ 799 DET_MH_SCAN_INDEX_4LSB_125_128 "Scan index of the measured detection";
CM_ SG_ 799 DET_MH_CYCLE_COUNTER_125_128 "Detection Alive Counter";
CM_ SG_ 798 DET_RANGE_121 " measured position  of the detection";
CM_ SG_ 798 DET_RANGE_ERR_121 "RMSE or standard deviation of the measured angle  of the detection";
CM_ SG_ 798 DET_RANGE_VELOCITY_121 "Radial velocity of the detection positive in direction to the sensor";
CM_ SG_ 798 DET_RANGE_VELOCITY_ERR_121 "RMSE or standard deviation of the measure radial velocity of the detection";
CM_ SG_ 798 DET_AZIMUTH_121 "Measured angle  of the detection";
CM_ SG_ 798 DET_AZIMUTH_ERR_121 "RMSE or standard deviation of the measured angle  of the detection";
CM_ SG_ 798 DET_ELEVATION_121 "measured elevation of the detection";
CM_ SG_ 798 DET_ELEVATION_ERR_121 "RMSE or standard deviation of the measured elevation  of the detection";
CM_ SG_ 798 DET_RCS_121 "Radar Cross Section or Amplitude, is a measure of how detectable an object is by radar. A larger RCS indicates that an object is more easily detected.";
CM_ SG_ 798 DET_BI_STATIC_FLAG_121 "1 if detection is bi-static 0 otherwise";
CM_ SG_ 798 DET_SUPER_RES_TARGET_121 "flasg is set if the detection is super resolution target";
CM_ SG_ 798 DET_SNR_121 "The signal to noise ratio (SNR) of the radar detection";
CM_ SG_ 798 DET_EXISTENCE_PROB_121 "Existence probability of the detection not based on history. Value does  not depend on any past experience with similar detections.

ote Use as confidence measure where a low value means less confidence
and a high value indicates strong confidence.";
CM_ SG_ 798 DET_HVC_FLAG_121 "Core2 Vehicle clutter flag";
CM_ SG_ 798 DET_CONFD_AZIMUTH_121 "Define the Confidence of Azimuth for Detection ";
CM_ SG_ 798 DET_CONFD_ELEVATION_121 "Define the Confidence of Elevation for the Detection ";
CM_ SG_ 798 DET_BI_STATIC_FLAG_122 "1 if detection is bi-static 0 otherwise";
CM_ SG_ 798 DET_BI_STATIC_FLAG_123 "1 if detection is bi-static 0 otherwise";
CM_ SG_ 798 DET_BI_STATIC_FLAG_124 "1 if detection is bi-static 0 otherwise";
CM_ SG_ 798 DET_MH_SCAN_INDEX_4LSB_121_124 "Scan index of the measured detection";
CM_ SG_ 798 DET_MH_CYCLE_COUNTER_121_124 "Detection Alive Counter";
CM_ SG_ 797 DET_RANGE_117 " measured position  of the detection";
CM_ SG_ 797 DET_RANGE_ERR_117 "RMSE or standard deviation of the measured angle  of the detection";
CM_ SG_ 797 DET_RANGE_VELOCITY_117 "Radial velocity of the detection positive in direction to the sensor";
CM_ SG_ 797 DET_RANGE_VELOCITY_ERR_117 "RMSE or standard deviation of the measure radial velocity of the detection";
CM_ SG_ 797 DET_AZIMUTH_117 "Measured angle  of the detection";
CM_ SG_ 797 DET_AZIMUTH_ERR_117 "RMSE or standard deviation of the measured angle  of the detection";
CM_ SG_ 797 DET_ELEVATION_117 "measured elevation of the detection";
CM_ SG_ 797 DET_ELEVATION_ERR_117 "RMSE or standard deviation of the measured elevation  of the detection";
CM_ SG_ 797 DET_RCS_117 "Radar Cross Section or Amplitude, is a measure of how detectable an object is by radar. A larger RCS indicates that an object is more easily detected.";
CM_ SG_ 797 DET_BI_STATIC_FLAG_117 "1 if detection is bi-static 0 otherwise";
CM_ SG_ 797 DET_SUPER_RES_TARGET_117 "flasg is set if the detection is super resolution target";
CM_ SG_ 797 DET_SNR_117 "The signal to noise ratio (SNR) of the radar detection";
CM_ SG_ 797 DET_EXISTENCE_PROB_117 "Existence probability of the detection not based on history. Value does  not depend on any past experience with similar detections.

ote Use as confidence measure where a low value means less confidence
and a high value indicates strong confidence.";
CM_ SG_ 797 DET_HVC_FLAG_117 "Core2 Vehicle clutter flag";
CM_ SG_ 797 DET_CONFD_AZIMUTH_117 "Define the Confidence of Azimuth for Detection ";
CM_ SG_ 797 DET_CONFD_ELEVATION_117 "Define the Confidence of Elevation for the Detection ";
CM_ SG_ 797 DET_BI_STATIC_FLAG_118 "1 if detection is bi-static 0 otherwise";
CM_ SG_ 797 DET_BI_STATIC_FLAG_119 "1 if detection is bi-static 0 otherwise";
CM_ SG_ 797 DET_BI_STATIC_FLAG_120 "1 if detection is bi-static 0 otherwise";
CM_ SG_ 797 DET_MH_SCAN_INDEX_4LSB_117_120 "Scan index of the measured detection";
CM_ SG_ 797 DET_MH_CYCLE_COUNTER_117_120 "Detection Alive Counter";
CM_ SG_ 796 DET_RANGE_113 " measured position  of the detection";
CM_ SG_ 796 DET_RANGE_ERR_113 "RMSE or standard deviation of the measured angle  of the detection";
CM_ SG_ 796 DET_RANGE_VELOCITY_113 "Radial velocity of the detection positive in direction to the sensor";
CM_ SG_ 796 DET_RANGE_VELOCITY_ERR_113 "RMSE or standard deviation of the measure radial velocity of the detection";
CM_ SG_ 796 DET_AZIMUTH_113 "Measured angle  of the detection";
CM_ SG_ 796 DET_AZIMUTH_ERR_113 "RMSE or standard deviation of the measured angle  of the detection";
CM_ SG_ 796 DET_ELEVATION_113 "measured elevation of the detection";
CM_ SG_ 796 DET_ELEVATION_ERR_113 "RMSE or standard deviation of the measured elevation  of the detection";
CM_ SG_ 796 DET_RCS_113 "Radar Cross Section or Amplitude, is a measure of how detectable an object is by radar. A larger RCS indicates that an object is more easily detected.";
CM_ SG_ 796 DET_BI_STATIC_FLAG_113 "1 if detection is bi-static 0 otherwise";
CM_ SG_ 796 DET_SUPER_RES_TARGET_113 "flasg is set if the detection is super resolution target";
CM_ SG_ 796 DET_SNR_113 "The signal to noise ratio (SNR) of the radar detection";
CM_ SG_ 796 DET_EXISTENCE_PROB_113 "Existence probability of the detection not based on history. Value does  not depend on any past experience with similar detections.

ote Use as confidence measure where a low value means less confidence
and a high value indicates strong confidence.";
CM_ SG_ 796 DET_HVC_FLAG_113 "Core2 Vehicle clutter flag";
CM_ SG_ 796 DET_CONFD_AZIMUTH_113 "Define the Confidence of Azimuth for Detection ";
CM_ SG_ 796 DET_CONFD_ELEVATION_113 "Define the Confidence of Elevation for the Detection ";
CM_ SG_ 796 DET_BI_STATIC_FLAG_114 "1 if detection is bi-static 0 otherwise";
CM_ SG_ 796 DET_BI_STATIC_FLAG_115 "1 if detection is bi-static 0 otherwise";
CM_ SG_ 796 DET_BI_STATIC_FLAG_116 "1 if detection is bi-static 0 otherwise";
CM_ SG_ 796 DET_MH_SCAN_INDEX_4LSB_113_116 "Scan index of the measured detection";
CM_ SG_ 796 DET_MH_CYCLE_COUNTER_113_116 "Detection Alive Counter";
CM_ SG_ 795 DET_RANGE_109 " measured position  of the detection";
CM_ SG_ 795 DET_RANGE_ERR_109 "RMSE or standard deviation of the measured angle  of the detection";
CM_ SG_ 795 DET_RANGE_VELOCITY_109 "Radial velocity of the detection positive in direction to the sensor";
CM_ SG_ 795 DET_RANGE_VELOCITY_ERR_109 "RMSE or standard deviation of the measure radial velocity of the detection";
CM_ SG_ 795 DET_AZIMUTH_109 "Measured angle  of the detection";
CM_ SG_ 795 DET_AZIMUTH_ERR_109 "RMSE or standard deviation of the measured angle  of the detection";
CM_ SG_ 795 DET_ELEVATION_109 "measured elevation of the detection";
CM_ SG_ 795 DET_ELEVATION_ERR_109 "RMSE or standard deviation of the measured elevation  of the detection";
CM_ SG_ 795 DET_RCS_109 "Radar Cross Section or Amplitude, is a measure of how detectable an object is by radar. A larger RCS indicates that an object is more easily detected.";
CM_ SG_ 795 DET_BI_STATIC_FLAG_109 "1 if detection is bi-static 0 otherwise";
CM_ SG_ 795 DET_SUPER_RES_TARGET_109 "flasg is set if the detection is super resolution target";
CM_ SG_ 795 DET_SNR_109 "The signal to noise ratio (SNR) of the radar detection";
CM_ SG_ 795 DET_EXISTENCE_PROB_109 "Existence probability of the detection not based on history. Value does  not depend on any past experience with similar detections.

ote Use as confidence measure where a low value means less confidence
and a high value indicates strong confidence.";
CM_ SG_ 795 DET_HVC_FLAG_109 "Core2 Vehicle clutter flag";
CM_ SG_ 795 DET_CONFD_AZIMUTH_109 "Define the Confidence of Azimuth for Detection ";
CM_ SG_ 795 DET_CONFD_ELEVATION_109 "Define the Confidence of Elevation for the Detection ";
CM_ SG_ 795 DET_BI_STATIC_FLAG_110 "1 if detection is bi-static 0 otherwise";
CM_ SG_ 795 DET_BI_STATIC_FLAG_111 "1 if detection is bi-static 0 otherwise";
CM_ SG_ 795 DET_BI_STATIC_FLAG_112 "1 if detection is bi-static 0 otherwise";
CM_ SG_ 795 DET_MH_SCAN_INDEX_4LSB_109_112 "Scan index of the measured detection";
CM_ SG_ 795 DET_MH_CYCLE_COUNTER_109_112 "Detection Alive Counter";
CM_ SG_ 794 DET_RANGE_105 " measured position  of the detection";
CM_ SG_ 794 DET_RANGE_ERR_105 "RMSE or standard deviation of the measured angle  of the detection";
CM_ SG_ 794 DET_RANGE_VELOCITY_105 "Radial velocity of the detection positive in direction to the sensor";
CM_ SG_ 794 DET_RANGE_VELOCITY_ERR_105 "RMSE or standard deviation of the measure radial velocity of the detection";
CM_ SG_ 794 DET_AZIMUTH_105 "Measured angle  of the detection";
CM_ SG_ 794 DET_AZIMUTH_ERR_105 "RMSE or standard deviation of the measured angle  of the detection";
CM_ SG_ 794 DET_ELEVATION_105 "measured elevation of the detection";
CM_ SG_ 794 DET_ELEVATION_ERR_105 "RMSE or standard deviation of the measured elevation  of the detection";
CM_ SG_ 794 DET_RCS_105 "Radar Cross Section or Amplitude, is a measure of how detectable an object is by radar. A larger RCS indicates that an object is more easily detected.";
CM_ SG_ 794 DET_BI_STATIC_FLAG_105 "1 if detection is bi-static 0 otherwise";
CM_ SG_ 794 DET_SUPER_RES_TARGET_105 "flasg is set if the detection is super resolution target";
CM_ SG_ 794 DET_SNR_105 "The signal to noise ratio (SNR) of the radar detection";
CM_ SG_ 794 DET_EXISTENCE_PROB_105 "Existence probability of the detection not based on history. Value does  not depend on any past experience with similar detections.

ote Use as confidence measure where a low value means less confidence
and a high value indicates strong confidence.";
CM_ SG_ 794 DET_HVC_FLAG_105 "Core2 Vehicle clutter flag";
CM_ SG_ 794 DET_CONFD_AZIMUTH_105 "Define the Confidence of Azimuth for Detection ";
CM_ SG_ 794 DET_CONFD_ELEVATION_105 "Define the Confidence of Elevation for the Detection ";
CM_ SG_ 794 DET_BI_STATIC_FLAG_106 "1 if detection is bi-static 0 otherwise";
CM_ SG_ 794 DET_BI_STATIC_FLAG_107 "1 if detection is bi-static 0 otherwise";
CM_ SG_ 794 DET_BI_STATIC_FLAG_108 "1 if detection is bi-static 0 otherwise";
CM_ SG_ 794 DET_MH_SCAN_INDEX_4LSB_105_108 "Scan index of the measured detection";
CM_ SG_ 794 DET_MH_CYCLE_COUNTER_105_108 "Detection Alive Counter";
CM_ SG_ 793 DET_RANGE_101 " measured position  of the detection";
CM_ SG_ 793 DET_RANGE_ERR_101 "RMSE or standard deviation of the measured angle  of the detection";
CM_ SG_ 793 DET_RANGE_VELOCITY_101 "Radial velocity of the detection positive in direction to the sensor";
CM_ SG_ 793 DET_RANGE_VELOCITY_ERR_101 "RMSE or standard deviation of the measure radial velocity of the detection";
CM_ SG_ 793 DET_AZIMUTH_101 "Measured angle  of the detection";
CM_ SG_ 793 DET_AZIMUTH_ERR_101 "RMSE or standard deviation of the measured angle  of the detection";
CM_ SG_ 793 DET_ELEVATION_101 "measured elevation of the detection";
CM_ SG_ 793 DET_ELEVATION_ERR_101 "RMSE or standard deviation of the measured elevation  of the detection";
CM_ SG_ 793 DET_RCS_101 "Radar Cross Section or Amplitude, is a measure of how detectable an object is by radar. A larger RCS indicates that an object is more easily detected.";
CM_ SG_ 793 DET_BI_STATIC_FLAG_101 "1 if detection is bi-static 0 otherwise";
CM_ SG_ 793 DET_SUPER_RES_TARGET_101 "flasg is set if the detection is super resolution target";
CM_ SG_ 793 DET_SNR_101 "The signal to noise ratio (SNR) of the radar detection";
CM_ SG_ 793 DET_EXISTENCE_PROB_101 "Existence probability of the detection not based on history. Value does  not depend on any past experience with similar detections.

ote Use as confidence measure where a low value means less confidence
and a high value indicates strong confidence.";
CM_ SG_ 793 DET_HVC_FLAG_101 "Core2 Vehicle clutter flag";
CM_ SG_ 793 DET_CONFD_AZIMUTH_101 "Define the Confidence of Azimuth for Detection ";
CM_ SG_ 793 DET_CONFD_ELEVATION_101 "Define the Confidence of Elevation for the Detection ";
CM_ SG_ 793 DET_BI_STATIC_FLAG_102 "1 if detection is bi-static 0 otherwise";
CM_ SG_ 793 DET_BI_STATIC_FLAG_103 "1 if detection is bi-static 0 otherwise";
CM_ SG_ 793 DET_BI_STATIC_FLAG_104 "1 if detection is bi-static 0 otherwise";
CM_ SG_ 793 DET_MH_SCAN_INDEX_4LSB_101_104 "Scan index of the measured detection";
CM_ SG_ 793 DET_MH_CYCLE_COUNTER_101_104 "Detection Alive Counter";
CM_ SG_ 792 DET_RANGE_097 " measured position  of the detection";
CM_ SG_ 792 DET_RANGE_ERR_097 "RMSE or standard deviation of the measured angle  of the detection";
CM_ SG_ 792 DET_RANGE_VELOCITY_097 "Radial velocity of the detection positive in direction to the sensor";
CM_ SG_ 792 DET_RANGE_VELOCITY_ERR_097 "RMSE or standard deviation of the measure radial velocity of the detection";
CM_ SG_ 792 DET_AZIMUTH_097 "Measured angle  of the detection";
CM_ SG_ 792 DET_AZIMUTH_ERR_097 "RMSE or standard deviation of the measured angle  of the detection";
CM_ SG_ 792 DET_ELEVATION_097 "measured elevation of the detection";
CM_ SG_ 792 DET_ELEVATION_ERR_097 "RMSE or standard deviation of the measured elevation  of the detection";
CM_ SG_ 792 DET_RCS_097 "Radar Cross Section or Amplitude, is a measure of how detectable an object is by radar. A larger RCS indicates that an object is more easily detected.";
CM_ SG_ 792 DET_BI_STATIC_FLAG_097 "1 if detection is bi-static 0 otherwise";
CM_ SG_ 792 DET_SUPER_RES_TARGET_097 "flasg is set if the detection is super resolution target";
CM_ SG_ 792 DET_SNR_097 "The signal to noise ratio (SNR) of the radar detection";
CM_ SG_ 792 DET_EXISTENCE_PROB_097 "Existence probability of the detection not based on history. Value does  not depend on any past experience with similar detections.

ote Use as confidence measure where a low value means less confidence
and a high value indicates strong confidence.";
CM_ SG_ 792 DET_HVC_FLAG_097 "Core2 Vehicle clutter flag";
CM_ SG_ 792 DET_CONFD_AZIMUTH_097 "Define the Confidence of Azimuth for Detection ";
CM_ SG_ 792 DET_CONFD_ELEVATION_097 "Define the Confidence of Elevation for the Detection ";
CM_ SG_ 792 DET_BI_STATIC_FLAG_098 "1 if detection is bi-static 0 otherwise";
CM_ SG_ 792 DET_BI_STATIC_FLAG_099 "1 if detection is bi-static 0 otherwise";
CM_ SG_ 792 DET_BI_STATIC_FLAG_100 "1 if detection is bi-static 0 otherwise";
CM_ SG_ 792 DET_MH_SCAN_INDEX_4LSB_097_100 "Scan index of the measured detection";
CM_ SG_ 792 DET_MH_CYCLE_COUNTER_097_100 "Detection Alive Counter";
CM_ SG_ 791 DET_RANGE_093 " measured position  of the detection";
CM_ SG_ 791 DET_RANGE_ERR_093 "RMSE or standard deviation of the measured angle  of the detection";
CM_ SG_ 791 DET_RANGE_VELOCITY_093 "Radial velocity of the detection positive in direction to the sensor";
CM_ SG_ 791 DET_RANGE_VELOCITY_ERR_093 "RMSE or standard deviation of the measure radial velocity of the detection";
CM_ SG_ 791 DET_AZIMUTH_093 "Measured angle  of the detection";
CM_ SG_ 791 DET_AZIMUTH_ERR_093 "RMSE or standard deviation of the measured angle  of the detection";
CM_ SG_ 791 DET_ELEVATION_093 "measured elevation of the detection";
CM_ SG_ 791 DET_ELEVATION_ERR_093 "RMSE or standard deviation of the measured elevation  of the detection";
CM_ SG_ 791 DET_RCS_093 "Radar Cross Section or Amplitude, is a measure of how detectable an object is by radar. A larger RCS indicates that an object is more easily detected.";
CM_ SG_ 791 DET_BI_STATIC_FLAG_093 "1 if detection is bi-static 0 otherwise";
CM_ SG_ 791 DET_SUPER_RES_TARGET_093 "flasg is set if the detection is super resolution target";
CM_ SG_ 791 DET_SNR_093 "The signal to noise ratio (SNR) of the radar detection";
CM_ SG_ 791 DET_EXISTENCE_PROB_093 "Existence probability of the detection not based on history. Value does  not depend on any past experience with similar detections.

ote Use as confidence measure where a low value means less confidence
and a high value indicates strong confidence.";
CM_ SG_ 791 DET_HVC_FLAG_093 "Core2 Vehicle clutter flag";
CM_ SG_ 791 DET_CONFD_AZIMUTH_093 "Define the Confidence of Azimuth for Detection ";
CM_ SG_ 791 DET_CONFD_ELEVATION_093 "Define the Confidence of Elevation for the Detection ";
CM_ SG_ 791 DET_BI_STATIC_FLAG_094 "1 if detection is bi-static 0 otherwise";
CM_ SG_ 791 DET_BI_STATIC_FLAG_095 "1 if detection is bi-static 0 otherwise";
CM_ SG_ 791 DET_BI_STATIC_FLAG_096 "1 if detection is bi-static 0 otherwise";
CM_ SG_ 791 DET_MH_SCAN_INDEX_4LSB_093_096 "Scan index of the measured detection";
CM_ SG_ 791 DET_MH_CYCLE_COUNTER_093_096 "Detection Alive Counter";
CM_ SG_ 790 DET_RANGE_089 " measured position  of the detection";
CM_ SG_ 790 DET_RANGE_ERR_089 "RMSE or standard deviation of the measured angle  of the detection";
CM_ SG_ 790 DET_RANGE_VELOCITY_089 "Radial velocity of the detection positive in direction to the sensor";
CM_ SG_ 790 DET_RANGE_VELOCITY_ERR_089 "RMSE or standard deviation of the measure radial velocity of the detection";
CM_ SG_ 790 DET_AZIMUTH_089 "Measured angle  of the detection";
CM_ SG_ 790 DET_AZIMUTH_ERR_089 "RMSE or standard deviation of the measured angle  of the detection";
CM_ SG_ 790 DET_ELEVATION_089 "measured elevation of the detection";
CM_ SG_ 790 DET_ELEVATION_ERR_089 "RMSE or standard deviation of the measured elevation  of the detection";
CM_ SG_ 790 DET_RCS_089 "Radar Cross Section or Amplitude, is a measure of how detectable an object is by radar. A larger RCS indicates that an object is more easily detected.";
CM_ SG_ 790 DET_BI_STATIC_FLAG_089 "1 if detection is bi-static 0 otherwise";
CM_ SG_ 790 DET_SUPER_RES_TARGET_089 "flasg is set if the detection is super resolution target";
CM_ SG_ 790 DET_SNR_089 "The signal to noise ratio (SNR) of the radar detection";
CM_ SG_ 790 DET_EXISTENCE_PROB_089 "Existence probability of the detection not based on history. Value does  not depend on any past experience with similar detections.

ote Use as confidence measure where a low value means less confidence
and a high value indicates strong confidence.";
CM_ SG_ 790 DET_HVC_FLAG_089 "Core2 Vehicle clutter flag";
CM_ SG_ 790 DET_CONFD_AZIMUTH_089 "Define the Confidence of Azimuth for Detection ";
CM_ SG_ 790 DET_CONFD_ELEVATION_089 "Define the Confidence of Elevation for the Detection ";
CM_ SG_ 790 DET_BI_STATIC_FLAG_090 "1 if detection is bi-static 0 otherwise";
CM_ SG_ 790 DET_BI_STATIC_FLAG_091 "1 if detection is bi-static 0 otherwise";
CM_ SG_ 790 DET_BI_STATIC_FLAG_092 "1 if detection is bi-static 0 otherwise";
CM_ SG_ 790 DET_MH_SCAN_INDEX_4LSB_089_092 "Scan index of the measured detection";
CM_ SG_ 790 DET_MH_CYCLE_COUNTER_089_092 "Detection Alive Counter";
CM_ SG_ 789 DET_RANGE_085 " measured position  of the detection";
CM_ SG_ 789 DET_RANGE_ERR_085 "RMSE or standard deviation of the measured angle  of the detection";
CM_ SG_ 789 DET_RANGE_VELOCITY_085 "Radial velocity of the detection positive in direction to the sensor";
CM_ SG_ 789 DET_RANGE_VELOCITY_ERR_085 "RMSE or standard deviation of the measure radial velocity of the detection";
CM_ SG_ 789 DET_AZIMUTH_085 "Measured angle  of the detection";
CM_ SG_ 789 DET_AZIMUTH_ERR_085 "RMSE or standard deviation of the measured angle  of the detection";
CM_ SG_ 789 DET_ELEVATION_085 "measured elevation of the detection";
CM_ SG_ 789 DET_ELEVATION_ERR_085 "RMSE or standard deviation of the measured elevation  of the detection";
CM_ SG_ 789 DET_RCS_085 "Radar Cross Section or Amplitude, is a measure of how detectable an object is by radar. A larger RCS indicates that an object is more easily detected.";
CM_ SG_ 789 DET_BI_STATIC_FLAG_085 "1 if detection is bi-static 0 otherwise";
CM_ SG_ 789 DET_SUPER_RES_TARGET_085 "flasg is set if the detection is super resolution target";
CM_ SG_ 789 DET_SNR_085 "The signal to noise ratio (SNR) of the radar detection";
CM_ SG_ 789 DET_EXISTENCE_PROB_085 "Existence probability of the detection not based on history. Value does  not depend on any past experience with similar detections.

ote Use as confidence measure where a low value means less confidence
and a high value indicates strong confidence.";
CM_ SG_ 789 DET_HVC_FLAG_085 "Core2 Vehicle clutter flag";
CM_ SG_ 789 DET_CONFD_AZIMUTH_085 "Define the Confidence of Azimuth for Detection ";
CM_ SG_ 789 DET_CONFD_ELEVATION_085 "Define the Confidence of Elevation for the Detection ";
CM_ SG_ 789 DET_BI_STATIC_FLAG_086 "1 if detection is bi-static 0 otherwise";
CM_ SG_ 789 DET_BI_STATIC_FLAG_087 "1 if detection is bi-static 0 otherwise";
CM_ SG_ 789 DET_BI_STATIC_FLAG_088 "1 if detection is bi-static 0 otherwise";
CM_ SG_ 789 DET_MH_SCAN_INDEX_4LSB_085_088 "Scan index of the measured detection";
CM_ SG_ 789 DET_MH_CYCLE_COUNTER_085_088 "Detection Alive Counter";
CM_ SG_ 788 DET_RANGE_081 " measured position  of the detection";
CM_ SG_ 788 DET_RANGE_ERR_081 "RMSE or standard deviation of the measured angle  of the detection";
CM_ SG_ 788 DET_RANGE_VELOCITY_081 "Radial velocity of the detection positive in direction to the sensor";
CM_ SG_ 788 DET_RANGE_VELOCITY_ERR_081 "RMSE or standard deviation of the measure radial velocity of the detection";
CM_ SG_ 788 DET_AZIMUTH_081 "Measured angle  of the detection";
CM_ SG_ 788 DET_AZIMUTH_ERR_081 "RMSE or standard deviation of the measured angle  of the detection";
CM_ SG_ 788 DET_ELEVATION_081 "measured elevation of the detection";
CM_ SG_ 788 DET_ELEVATION_ERR_081 "RMSE or standard deviation of the measured elevation  of the detection";
CM_ SG_ 788 DET_RCS_081 "Radar Cross Section or Amplitude, is a measure of how detectable an object is by radar. A larger RCS indicates that an object is more easily detected.";
CM_ SG_ 788 DET_BI_STATIC_FLAG_081 "1 if detection is bi-static 0 otherwise";
CM_ SG_ 788 DET_SUPER_RES_TARGET_081 "flasg is set if the detection is super resolution target";
CM_ SG_ 788 DET_SNR_081 "The signal to noise ratio (SNR) of the radar detection";
CM_ SG_ 788 DET_EXISTENCE_PROB_081 "Existence probability of the detection not based on history. Value does  not depend on any past experience with similar detections.

ote Use as confidence measure where a low value means less confidence
and a high value indicates strong confidence.";
CM_ SG_ 788 DET_HVC_FLAG_081 "Core2 Vehicle clutter flag";
CM_ SG_ 788 DET_CONFD_AZIMUTH_081 "Define the Confidence of Azimuth for Detection ";
CM_ SG_ 788 DET_CONFD_ELEVATION_081 "Define the Confidence of Elevation for the Detection ";
CM_ SG_ 788 DET_BI_STATIC_FLAG_082 "1 if detection is bi-static 0 otherwise";
CM_ SG_ 788 DET_BI_STATIC_FLAG_083 "1 if detection is bi-static 0 otherwise";
CM_ SG_ 788 DET_BI_STATIC_FLAG_084 "1 if detection is bi-static 0 otherwise";
CM_ SG_ 788 DET_MH_SCAN_INDEX_4LSB_081_084 "Scan index of the measured detection";
CM_ SG_ 788 DET_MH_CYCLE_COUNTER_081_084 "Detection Alive Counter";
CM_ SG_ 787 DET_RANGE_077 " measured position  of the detection";
CM_ SG_ 787 DET_RANGE_ERR_077 "RMSE or standard deviation of the measured angle  of the detection";
CM_ SG_ 787 DET_RANGE_VELOCITY_077 "Radial velocity of the detection positive in direction to the sensor";
CM_ SG_ 787 DET_RANGE_VELOCITY_ERR_077 "RMSE or standard deviation of the measure radial velocity of the detection";
CM_ SG_ 787 DET_AZIMUTH_077 "Measured angle  of the detection";
CM_ SG_ 787 DET_AZIMUTH_ERR_077 "RMSE or standard deviation of the measured angle  of the detection";
CM_ SG_ 787 DET_ELEVATION_077 "measured elevation of the detection";
CM_ SG_ 787 DET_ELEVATION_ERR_077 "RMSE or standard deviation of the measured elevation  of the detection";
CM_ SG_ 787 DET_RCS_077 "Radar Cross Section or Amplitude, is a measure of how detectable an object is by radar. A larger RCS indicates that an object is more easily detected.";
CM_ SG_ 787 DET_BI_STATIC_FLAG_077 "1 if detection is bi-static 0 otherwise";
CM_ SG_ 787 DET_SUPER_RES_TARGET_077 "flasg is set if the detection is super resolution target";
CM_ SG_ 787 DET_SNR_077 "The signal to noise ratio (SNR) of the radar detection";
CM_ SG_ 787 DET_EXISTENCE_PROB_077 "Existence probability of the detection not based on history. Value does  not depend on any past experience with similar detections.

ote Use as confidence measure where a low value means less confidence
and a high value indicates strong confidence.";
CM_ SG_ 787 DET_HVC_FLAG_077 "Core2 Vehicle clutter flag";
CM_ SG_ 787 DET_CONFD_AZIMUTH_077 "Define the Confidence of Azimuth for Detection ";
CM_ SG_ 787 DET_CONFD_ELEVATION_077 "Define the Confidence of Elevation for the Detection ";
CM_ SG_ 787 DET_BI_STATIC_FLAG_078 "1 if detection is bi-static 0 otherwise";
CM_ SG_ 787 DET_BI_STATIC_FLAG_079 "1 if detection is bi-static 0 otherwise";
CM_ SG_ 787 DET_BI_STATIC_FLAG_080 "1 if detection is bi-static 0 otherwise";
CM_ SG_ 787 DET_MH_SCAN_INDEX_4LSB_077_080 "Scan index of the measured detection";
CM_ SG_ 787 DET_MH_CYCLE_COUNTER_077_080 "Detection Alive Counter";
CM_ SG_ 786 DET_RANGE_073 " measured position  of the detection";
CM_ SG_ 786 DET_RANGE_ERR_073 "RMSE or standard deviation of the measured angle  of the detection";
CM_ SG_ 786 DET_RANGE_VELOCITY_073 "Radial velocity of the detection positive in direction to the sensor";
CM_ SG_ 786 DET_RANGE_VELOCITY_ERR_073 "RMSE or standard deviation of the measure radial velocity of the detection";
CM_ SG_ 786 DET_AZIMUTH_073 "Measured angle  of the detection";
CM_ SG_ 786 DET_AZIMUTH_ERR_073 "RMSE or standard deviation of the measured angle  of the detection";
CM_ SG_ 786 DET_ELEVATION_073 "measured elevation of the detection";
CM_ SG_ 786 DET_ELEVATION_ERR_073 "RMSE or standard deviation of the measured elevation  of the detection";
CM_ SG_ 786 DET_RCS_073 "Radar Cross Section or Amplitude, is a measure of how detectable an object is by radar. A larger RCS indicates that an object is more easily detected.";
CM_ SG_ 786 DET_BI_STATIC_FLAG_073 "1 if detection is bi-static 0 otherwise";
CM_ SG_ 786 DET_SUPER_RES_TARGET_073 "flasg is set if the detection is super resolution target";
CM_ SG_ 786 DET_SNR_073 "The signal to noise ratio (SNR) of the radar detection";
CM_ SG_ 786 DET_EXISTENCE_PROB_073 "Existence probability of the detection not based on history. Value does  not depend on any past experience with similar detections.

ote Use as confidence measure where a low value means less confidence
and a high value indicates strong confidence.";
CM_ SG_ 786 DET_HVC_FLAG_073 "Core2 Vehicle clutter flag";
CM_ SG_ 786 DET_CONFD_AZIMUTH_073 "Define the Confidence of Azimuth for Detection ";
CM_ SG_ 786 DET_CONFD_ELEVATION_073 "Define the Confidence of Elevation for the Detection ";
CM_ SG_ 786 DET_BI_STATIC_FLAG_074 "1 if detection is bi-static 0 otherwise";
CM_ SG_ 786 DET_BI_STATIC_FLAG_075 "1 if detection is bi-static 0 otherwise";
CM_ SG_ 786 DET_BI_STATIC_FLAG_076 "1 if detection is bi-static 0 otherwise";
CM_ SG_ 786 DET_MH_SCAN_INDEX_4LSB_073_076 "Scan index of the measured detection";
CM_ SG_ 786 DET_MH_CYCLE_COUNTER_073_076 "Detection Alive Counter";
CM_ SG_ 785 DET_RANGE_069 " measured position  of the detection";
CM_ SG_ 785 DET_RANGE_ERR_069 "RMSE or standard deviation of the measured angle  of the detection";
CM_ SG_ 785 DET_RANGE_VELOCITY_069 "Radial velocity of the detection positive in direction to the sensor";
CM_ SG_ 785 DET_RANGE_VELOCITY_ERR_069 "RMSE or standard deviation of the measure radial velocity of the detection";
CM_ SG_ 785 DET_AZIMUTH_069 "Measured angle  of the detection";
CM_ SG_ 785 DET_AZIMUTH_ERR_069 "RMSE or standard deviation of the measured angle  of the detection";
CM_ SG_ 785 DET_ELEVATION_069 "measured elevation of the detection";
CM_ SG_ 785 DET_ELEVATION_ERR_069 "RMSE or standard deviation of the measured elevation  of the detection";
CM_ SG_ 785 DET_RCS_069 "Radar Cross Section or Amplitude, is a measure of how detectable an object is by radar. A larger RCS indicates that an object is more easily detected.";
CM_ SG_ 785 DET_BI_STATIC_FLAG_069 "1 if detection is bi-static 0 otherwise";
CM_ SG_ 785 DET_SUPER_RES_TARGET_069 "flasg is set if the detection is super resolution target";
CM_ SG_ 785 DET_SNR_069 "The signal to noise ratio (SNR) of the radar detection";
CM_ SG_ 785 DET_EXISTENCE_PROB_069 "Existence probability of the detection not based on history. Value does  not depend on any past experience with similar detections.

ote Use as confidence measure where a low value means less confidence
and a high value indicates strong confidence.";
CM_ SG_ 785 DET_HVC_FLAG_069 "Core2 Vehicle clutter flag";
CM_ SG_ 785 DET_CONFD_AZIMUTH_069 "Define the Confidence of Azimuth for Detection ";
CM_ SG_ 785 DET_CONFD_ELEVATION_069 "Define the Confidence of Elevation for the Detection ";
CM_ SG_ 785 DET_BI_STATIC_FLAG_070 "1 if detection is bi-static 0 otherwise";
CM_ SG_ 785 DET_BI_STATIC_FLAG_071 "1 if detection is bi-static 0 otherwise";
CM_ SG_ 785 DET_BI_STATIC_FLAG_072 "1 if detection is bi-static 0 otherwise";
CM_ SG_ 785 DET_MH_SCAN_INDEX_4LSB_069_072 "Scan index of the measured detection";
CM_ SG_ 785 DET_MH_CYCLE_COUNTER_069_072 "Detection Alive Counter";
BA_DEF_ BO_  "CanTpBs" INT 0 255;
BA_DEF_ BO_  "DiagRequest" ENUM  "No","Yes";
BA_DEF_ BO_  "DiagResponse" ENUM  "No","Yes";
BA_DEF_ BO_  "E2EDataId" INT 0 65535;
BA_DEF_ BO_  "E2EDataLength" INT 0 65535;
BA_DEF_ BO_  "E2EProfile" STRING ;
BA_DEF_ BO_  "EventRateOfChange" INT 10 10000;
BA_DEF_ BO_  "GenMsgCycleTime" INT 0 100000;
BA_DEF_ BO_  "GenMsgILSupport" ENUM  "No","Yes";
BA_DEF_ BO_  "GenMsgNrOfRepetition" INT 0 100;
BA_DEF_ BO_  "GenMsgSendType" ENUM  "FixedPeriodic","Event","EnabledPeriodic","NotUsed","NotUsed","EventPeriodic","NotUsed","NotUsed","NoMsgSendType";
BA_DEF_ BO_  "MessageGateway" ENUM  "No","Yes";
BA_DEF_ BO_  "NetworkInitialization" ENUM  "No","Yes";
BA_DEF_ BO_  "SCP_AuthInfoTxLength" INT 0 512;
BA_DEF_ BO_  "SCP_DataId" INT 0 65535;
BA_DEF_ BO_  "SCP_FreshnessValueId" INT 0 65535;
BA_DEF_ BO_  "SCP_FreshnessValueLength" INT 0 512;
BA_DEF_ BO_  "SCP_FreshnessValueTxLength" INT 0 512;
BA_DEF_ BO_  "SC_Message" ENUM  "No","Yes","Yes, split message";
BA_DEF_ BO_  "VFrameFormat" ENUM  "StandardCAN","ExtendedCAN","reserved","reserved","reserved","reserved","reserved","reserved","reserved","reserved","reserved","reserved","reserved","reserved","StandardCAN_FD","ExtendedCAN_FD";
BA_DEF_ SG_  "GenSigCmt" STRING ;
BA_DEF_ SG_  "GenSigCycleTime" INT 0 0;
BA_DEF_ SG_  "GenSigSendType" ENUM  "Cyclic","OnWrite","vector_leerstring","OnChange","vector_leerstring","IfActive","vector_leerstring","NoSigSendType";
BA_DEF_ SG_  "GenSigStartValue" INT 0 1000000000;
BA_DEF_ SG_  "GenSigTimeoutTime" INT 0 0;
BA_DEF_ SG_  "InvalidValue" STRING ;
BA_DEF_DEF_  "CanTpBs" 255;
BA_DEF_DEF_  "DiagRequest" "No";
BA_DEF_DEF_  "DiagResponse" "No";
BA_DEF_DEF_  "E2EDataId" 0;
BA_DEF_DEF_  "E2EDataLength" 0;
BA_DEF_DEF_  "E2EProfile" "";
BA_DEF_DEF_  "EventRateOfChange" 10000;
BA_DEF_DEF_  "GenMsgCycleTime" 0;
BA_DEF_DEF_  "GenMsgILSupport" "Yes";
BA_DEF_DEF_  "GenMsgNrOfRepetition" 0;
BA_DEF_DEF_  "GenMsgSendType" "NoMsgSendType";
BA_DEF_DEF_  "MessageGateway" "No";
BA_DEF_DEF_  "NetworkInitialization" "Yes";
BA_DEF_DEF_  "SCP_AuthInfoTxLength" 28;
BA_DEF_DEF_  "SCP_DataId" 0;
BA_DEF_DEF_  "SCP_FreshnessValueId" 0;
BA_DEF_DEF_  "SCP_FreshnessValueLength" 48;
BA_DEF_DEF_  "SCP_FreshnessValueTxLength" 4;
BA_DEF_DEF_  "SC_Message" "No";
BA_DEF_DEF_  "VFrameFormat" "StandardCAN_FD";
BA_DEF_DEF_  "GenSigCmt" "";
BA_DEF_DEF_  "GenSigCycleTime" 0;
BA_DEF_DEF_  "GenSigSendType" "NoSigSendType";
BA_DEF_DEF_  "GenSigStartValue" 0;
BA_DEF_DEF_  "GenSigTimeoutTime" 0;
BA_DEF_DEF_  "InvalidValue" "";
BA_ "E2EProfile" BO_ 163 "P05";
BA_ "E2EDataLength" BO_ 163 504;
BA_ "E2EDataId" BO_ 163 1443;
BA_ "GenMsgCycleTime" BO_ 163 1000;
BA_ "GenMsgSendType" BO_ 163 0;
BA_ "E2EDataLength" BO_ 160 408;
BA_ "E2EDataId" BO_ 160 1440;
BA_ "E2EProfile" BO_ 160 "P05";
BA_ "GenMsgSendType" BO_ 160 1;
BA_ "GenMsgSendType" BO_ 799 1;
BA_ "GenMsgSendType" BO_ 798 1;
BA_ "GenMsgSendType" BO_ 797 1;
BA_ "GenMsgSendType" BO_ 796 1;
BA_ "GenMsgSendType" BO_ 795 1;
BA_ "GenMsgSendType" BO_ 794 1;
BA_ "GenMsgSendType" BO_ 793 1;
BA_ "GenMsgSendType" BO_ 792 1;
BA_ "GenMsgSendType" BO_ 791 1;
BA_ "GenMsgSendType" BO_ 790 1;
BA_ "GenMsgSendType" BO_ 789 1;
BA_ "GenMsgSendType" BO_ 788 1;
BA_ "GenMsgSendType" BO_ 787 1;
BA_ "GenMsgSendType" BO_ 786 1;
BA_ "GenMsgSendType" BO_ 785 1;
BA_ "GenSigCycleTime" SG_ 163 STS_PCAN_PROTOCOL_VER_MINOR 50;
BA_ "GenSigSendType" SG_ 163 STS_PCAN_PROTOCOL_VER_MINOR 0;
BA_ "GenSigTimeoutTime" SG_ 163 STS_PCAN_PROTOCOL_VER_MINOR 150;
BA_ "GenSigCycleTime" SG_ 163 STS_PCAN_PROTOCOL_VER_MAJOR 50;
BA_ "GenSigSendType" SG_ 163 STS_PCAN_PROTOCOL_VER_MAJOR 0;
BA_ "GenSigTimeoutTime" SG_ 163 STS_PCAN_PROTOCOL_VER_MAJOR 150;
BA_ "GenSigCycleTime" SG_ 163 STS_SERIAL_NUMBER_SEQUENCE 50;
BA_ "GenSigSendType" SG_ 163 STS_SERIAL_NUMBER_SEQUENCE 0;
BA_ "GenSigStartValue" SG_ 163 STS_SERIAL_NUMBER_SEQUENCE 1234;
BA_ "GenSigTimeoutTime" SG_ 163 STS_SERIAL_NUMBER_SEQUENCE 150;
BA_ "GenSigCycleTime" SG_ 163 STS_SERIAL_NUM_JULIAN_YEAR 50;
BA_ "GenSigSendType" SG_ 163 STS_SERIAL_NUM_JULIAN_YEAR 0;
BA_ "GenSigTimeoutTime" SG_ 163 STS_SERIAL_NUM_JULIAN_YEAR 150;
BA_ "GenSigCycleTime" SG_ 163 STS_SERIAL_NUM_JULIAN_DAY 50;
BA_ "GenSigSendType" SG_ 163 STS_SERIAL_NUM_JULIAN_DAY 0;
BA_ "GenSigStartValue" SG_ 163 STS_SERIAL_NUM_JULIAN_DAY 365;
BA_ "GenSigTimeoutTime" SG_ 163 STS_SERIAL_NUM_JULIAN_DAY 150;
BA_ "GenSigStartValue" SG_ 163 STS_SENSOR_MOUNT_POS_X 8192;
BA_ "GenSigStartValue" SG_ 163 STS_SENSOR_MOUNT_POS_Y 32768;
BA_ "GenSigStartValue" SG_ 163 STS_SENSOR_MOUNT_POS_Z 32768;
BA_ "GenSigStartValue" SG_ 163 STS_SENSOR_MOUNT_ORNT_ROLL 7853.975;
BA_ "GenSigStartValue" SG_ 160 HED_R_WRAPPING 90;
BA_ "GenSigCmt" SG_ 160 HED_NUM_OF_VALID_DETECTIONS "Number of detections sent";
BA_ "GenSigCmt" SG_ 160 HED_LOOK_ID "Indicates the look type values 1 to 4 base on medium/long look and near/far look";
BA_ "GenSigCmt" SG_ 160 HED_SCAN_INDEX "Scan index for SODFL";
BA_ "GenSigStartValue" SG_ 160 HED_DATA_QUALIFIER 1;
BA_ "GenSigCmt" SG_ 160 HED_DET_RANGE_MAX "CAN range coverage";
BA_ "GenSigCmt" SG_ 160 HED_DET_SPEED_RANGE_MAX "CAN range coverage";
BA_ "GenSigStartValue" SG_ 160 HED_DET_SPEED_RANGE_MAX 32768;
BA_ "GenSigCmt" SG_ 160 HED_FOV_HOR_MAX "CAN range coverage";
BA_ "GenSigCmt" SG_ 160 HED_FOV_VER_MAX "CAN range coverage";
BA_ "GenSigStartValue" SG_ 160 HED_DET_SPEED_RANGE_MIN 32768;
BA_ "GenSigStartValue" SG_ 799 DET_RANGE_VELOCITY_125 16384;
BA_ "GenSigStartValue" SG_ 799 DET_RCS_125 128;
BA_ "GenSigStartValue" SG_ 799 DET_RANGE_VELOCITY_126 16384;
BA_ "GenSigStartValue" SG_ 799 DET_RCS_126 128;
BA_ "GenSigStartValue" SG_ 799 DET_RANGE_VELOCITY_127 16384;
BA_ "GenSigStartValue" SG_ 799 DET_RCS_127 128;
BA_ "GenSigStartValue" SG_ 799 DET_RANGE_VELOCITY_128 16384;
BA_ "GenSigStartValue" SG_ 799 DET_RCS_128 128;
BA_ "GenSigStartValue" SG_ 798 DET_RANGE_VELOCITY_121 16384;
BA_ "GenSigStartValue" SG_ 798 DET_RCS_121 128;
BA_ "GenSigStartValue" SG_ 798 DET_RANGE_VELOCITY_122 16384;
BA_ "GenSigStartValue" SG_ 798 DET_RCS_122 128;
BA_ "GenSigStartValue" SG_ 798 DET_RANGE_VELOCITY_123 16384;
BA_ "GenSigStartValue" SG_ 798 DET_RCS_123 128;
BA_ "GenSigStartValue" SG_ 798 DET_RANGE_VELOCITY_124 16384;
BA_ "GenSigStartValue" SG_ 798 DET_RCS_124 128;
BA_ "GenSigStartValue" SG_ 797 DET_RANGE_VELOCITY_117 16384;
BA_ "GenSigStartValue" SG_ 797 DET_RCS_117 128;
BA_ "GenSigStartValue" SG_ 797 DET_RANGE_VELOCITY_118 16384;
BA_ "GenSigStartValue" SG_ 797 DET_RCS_118 128;
BA_ "GenSigStartValue" SG_ 797 DET_RANGE_VELOCITY_119 16384;
BA_ "GenSigStartValue" SG_ 797 DET_RCS_119 128;
BA_ "GenSigStartValue" SG_ 797 DET_RANGE_VELOCITY_120 16384;
BA_ "GenSigStartValue" SG_ 797 DET_RCS_120 128;
BA_ "GenSigStartValue" SG_ 796 DET_RANGE_VELOCITY_113 16384;
BA_ "GenSigStartValue" SG_ 796 DET_RCS_113 128;
BA_ "GenSigStartValue" SG_ 796 DET_RANGE_VELOCITY_114 16384;
BA_ "GenSigStartValue" SG_ 796 DET_RCS_114 128;
BA_ "GenSigStartValue" SG_ 796 DET_RANGE_VELOCITY_115 16384;
BA_ "GenSigStartValue" SG_ 796 DET_RCS_115 128;
BA_ "GenSigStartValue" SG_ 796 DET_RANGE_VELOCITY_116 16384;
BA_ "GenSigStartValue" SG_ 796 DET_RCS_116 128;
BA_ "GenSigStartValue" SG_ 795 DET_RANGE_VELOCITY_109 16384;
BA_ "GenSigStartValue" SG_ 795 DET_RCS_109 128;
BA_ "GenSigStartValue" SG_ 795 DET_RANGE_VELOCITY_110 16384;
BA_ "GenSigStartValue" SG_ 795 DET_RCS_110 128;
BA_ "GenSigStartValue" SG_ 795 DET_RANGE_VELOCITY_111 16384;
BA_ "GenSigStartValue" SG_ 795 DET_RCS_111 128;
BA_ "GenSigStartValue" SG_ 795 DET_RANGE_VELOCITY_112 16384;
BA_ "GenSigStartValue" SG_ 795 DET_RCS_112 128;
BA_ "GenSigStartValue" SG_ 794 DET_RANGE_VELOCITY_105 16384;
BA_ "GenSigStartValue" SG_ 794 DET_RCS_105 128;
BA_ "GenSigStartValue" SG_ 794 DET_RANGE_VELOCITY_106 16384;
BA_ "GenSigStartValue" SG_ 794 DET_RCS_106 128;
BA_ "GenSigStartValue" SG_ 794 DET_RANGE_VELOCITY_107 16384;
BA_ "GenSigStartValue" SG_ 794 DET_RCS_107 128;
BA_ "GenSigStartValue" SG_ 794 DET_RANGE_VELOCITY_108 16384;
BA_ "GenSigStartValue" SG_ 794 DET_RCS_108 128;
BA_ "GenSigStartValue" SG_ 793 DET_RANGE_VELOCITY_101 16384;
BA_ "GenSigStartValue" SG_ 793 DET_RCS_101 128;
BA_ "GenSigStartValue" SG_ 793 DET_RANGE_VELOCITY_102 16384;
BA_ "GenSigStartValue" SG_ 793 DET_RCS_102 128;
BA_ "GenSigStartValue" SG_ 793 DET_RANGE_VELOCITY_103 16384;
BA_ "GenSigStartValue" SG_ 793 DET_RCS_103 128;
BA_ "GenSigStartValue" SG_ 793 DET_RANGE_VELOCITY_104 16384;
BA_ "GenSigStartValue" SG_ 793 DET_RCS_104 128;
BA_ "GenSigStartValue" SG_ 792 DET_RANGE_VELOCITY_097 16384;
BA_ "GenSigStartValue" SG_ 792 DET_RCS_097 128;
BA_ "GenSigStartValue" SG_ 792 DET_RANGE_VELOCITY_098 16384;
BA_ "GenSigStartValue" SG_ 792 DET_RCS_098 128;
BA_ "GenSigStartValue" SG_ 792 DET_RANGE_VELOCITY_099 16384;
BA_ "GenSigStartValue" SG_ 792 DET_RCS_099 128;
BA_ "GenSigStartValue" SG_ 792 DET_RANGE_VELOCITY_100 16384;
BA_ "GenSigStartValue" SG_ 792 DET_RCS_100 128;
BA_ "GenSigStartValue" SG_ 791 DET_RANGE_VELOCITY_093 16384;
BA_ "GenSigStartValue" SG_ 791 DET_RCS_093 128;
BA_ "GenSigStartValue" SG_ 791 DET_RANGE_VELOCITY_094 16384;
BA_ "GenSigStartValue" SG_ 791 DET_RCS_094 128;
BA_ "GenSigStartValue" SG_ 791 DET_RANGE_VELOCITY_095 16384;
BA_ "GenSigStartValue" SG_ 791 DET_RCS_095 128;
BA_ "GenSigStartValue" SG_ 791 DET_RANGE_VELOCITY_096 16384;
BA_ "GenSigStartValue" SG_ 791 DET_RCS_096 128;
BA_ "GenSigStartValue" SG_ 790 DET_RANGE_VELOCITY_089 16384;
BA_ "GenSigStartValue" SG_ 790 DET_RCS_089 128;
BA_ "GenSigStartValue" SG_ 790 DET_RANGE_VELOCITY_090 16384;
BA_ "GenSigStartValue" SG_ 790 DET_RCS_090 128;
BA_ "GenSigStartValue" SG_ 790 DET_RANGE_VELOCITY_091 16384;
BA_ "GenSigStartValue" SG_ 790 DET_RCS_091 128;
BA_ "GenSigStartValue" SG_ 790 DET_RANGE_VELOCITY_092 16384;
BA_ "GenSigStartValue" SG_ 790 DET_RCS_092 128;
BA_ "GenSigStartValue" SG_ 789 DET_RANGE_VELOCITY_085 16384;
BA_ "GenSigStartValue" SG_ 789 DET_RCS_085 128;
BA_ "GenSigStartValue" SG_ 789 DET_RANGE_VELOCITY_086 16384;
BA_ "GenSigStartValue" SG_ 789 DET_RCS_086 128;
BA_ "GenSigStartValue" SG_ 789 DET_RANGE_VELOCITY_087 16384;
BA_ "GenSigStartValue" SG_ 789 DET_RCS_087 128;
BA_ "GenSigStartValue" SG_ 789 DET_RANGE_VELOCITY_088 16384;
BA_ "GenSigStartValue" SG_ 789 DET_RCS_088 128;
BA_ "GenSigStartValue" SG_ 788 DET_RANGE_VELOCITY_081 16384;
BA_ "GenSigStartValue" SG_ 788 DET_RCS_081 128;
BA_ "GenSigStartValue" SG_ 788 DET_RANGE_VELOCITY_082 16384;
BA_ "GenSigStartValue" SG_ 788 DET_RCS_082 128;
BA_ "GenSigStartValue" SG_ 788 DET_RANGE_VELOCITY_083 16384;
BA_ "GenSigStartValue" SG_ 788 DET_RCS_083 128;
BA_ "GenSigStartValue" SG_ 788 DET_RANGE_VELOCITY_084 16384;
BA_ "GenSigStartValue" SG_ 788 DET_RCS_084 128;
BA_ "GenSigStartValue" SG_ 787 DET_RANGE_VELOCITY_077 16384;
BA_ "GenSigStartValue" SG_ 787 DET_RCS_077 128;
BA_ "GenSigStartValue" SG_ 787 DET_RANGE_VELOCITY_078 16384;
BA_ "GenSigStartValue" SG_ 787 DET_RCS_078 128;
BA_ "GenSigStartValue" SG_ 787 DET_RANGE_VELOCITY_079 16384;
BA_ "GenSigStartValue" SG_ 787 DET_RCS_079 128;
BA_ "GenSigStartValue" SG_ 787 DET_RANGE_VELOCITY_080 16384;
BA_ "GenSigStartValue" SG_ 787 DET_RCS_080 128;
BA_ "GenSigStartValue" SG_ 786 DET_RANGE_VELOCITY_073 16384;
BA_ "GenSigStartValue" SG_ 786 DET_RCS_073 128;
BA_ "GenSigStartValue" SG_ 786 DET_RANGE_VELOCITY_074 16384;
BA_ "GenSigStartValue" SG_ 786 DET_RCS_074 128;
BA_ "GenSigStartValue" SG_ 786 DET_RANGE_VELOCITY_075 16384;
BA_ "GenSigStartValue" SG_ 786 DET_RCS_075 128;
BA_ "GenSigStartValue" SG_ 786 DET_RANGE_VELOCITY_076 16384;
BA_ "GenSigStartValue" SG_ 786 DET_RCS_076 128;
BA_ "GenSigStartValue" SG_ 785 DET_RANGE_VELOCITY_069 16384;
BA_ "GenSigStartValue" SG_ 785 DET_RCS_069 128;
BA_ "GenSigStartValue" SG_ 785 DET_RANGE_VELOCITY_070 16384;
BA_ "GenSigStartValue" SG_ 785 DET_RCS_070 128;
BA_ "GenSigStartValue" SG_ 785 DET_RANGE_VELOCITY_071 16384;
BA_ "GenSigStartValue" SG_ 785 DET_RCS_071 128;
BA_ "GenSigStartValue" SG_ 785 DET_RANGE_VELOCITY_072 16384;
BA_ "GenSigStartValue" SG_ 785 DET_RCS_072 128;
VAL_ 163 STS_PLATFORM_VARIANT 18 "VARIANT_FLR8" 17 " VARIANT_SRR8" 0 "VARIANT_INVALID" 1 "VARIANT_MRR3" 2 "VARIANT_SRR5" 3 "VARIANT_RACAM" 4 "VARIANT_MRR360" 5 "VARIANT_MRR3LLP" 6 "VARIANT_MRR3LLP_STD" 7 "VARIANT_MRR3LLP_AMOD" 8 "VARIANT_SRRAD" 9 "VARIANT_FLR4" 10 "VARIANT_FLR4PLUS" 11 "VARIANT_SRR6" 12 "VARIANT_SRR6PLUS" 13 "VARIANT_SRR_V2" 14 "VARIANT_FLR_V2" 15 "VARIANT_SRR_V1" 16 "VARIANT_FLR_V1" ;
VAL_ 163 STS_HARDWARE_VERSION 0 "EDU" 1 "A1" 2 "B1_USCAR" 3 "CEER" 4 "UNDEFINED" 5 "RESERVED" ;
VAL_ 163 STS_SMC_PLATFROM_VERSION 0 "INVALID" 1 "MRR3" 2 "SRR5" 3 "RACAM" 4 "MRR360" 5 "MRR3LLP" 6 "MRRLLP_STD" 7 "MRRLLP_AMOD" 8 "SRRAD" 9 "FLR4" 10 "FLR4PLUS" 11 "SRR6" 12 "SRR6PLUS" ;
VAL_ 163 STS_SENSOR_POSITION 0 "Reserved_0" 1 "Rear_Left" 2 "Rear_Right" 3 "Front_Right" 4 "Front_Left" 5 "Front_Center" 6 "Reserved_6" 7 "Reserved_7" ;
VAL_ 160 HED_Rain_Level 0 "No_Rain" 1 "Low_Medium" 2 "Medium_High" ;
VAL_ 160 HED_SLOPE_CORR_EXECUTIONFLAG 0 "AzimuthElevationNotCompensated" 1 "AzimuthCompensated" 2 "ElevationCompensated" 3 "AzimuthElevationCompensated" ;
VAL_ 160 HED_OPERATION_MODE 0 "Init_MCU" 1 "Radar_Not_Configured" 2 "Operational" 3 "OpMode_Faulty" 4 "Shutdown_Initiated" 5 "Shutdown_Completed" ;
VAL_ 160 HED_LOOK_ID 0 "LOOK_A" 1 "LOOK_B" 2 "LOOK_C" 3 "LOOK_D" ;
VAL_ 160 HED_DATA_QUALIFIER 0 "DataQual_Invalid" 1 "Not_Available" 2 "Reduced_In_Performance" 3 "Test_Mode" 4 "DataQual_Normal" 5 "Reduced_In_Coverage" 6 "Reduced_In_Perf_And_Cov" 7 "DataQual_Unknown" ;
VAL_ 160 HED_TIME_SYNC_SRC_MASTER 0 "LOCAL" 1 "GLOBAL" ;
VAL_ 160 HED_TIME_SYNC_VALIDITY_FLAG 0 "OUT_OF_SYNC" 1 "SYNCED_AT_LEAST_ONCE" 2 "SYNC_MSG_TIMEOUT_OR_CRC_ERR" ;
VAL_ 799 DET_CONFD_AZIMUTH_125 0 "High" 1 "MidHigh" 2 "MidLow" 3 "Low" ;
VAL_ 799 DET_CONFD_ELEVATION_125 0 "High" 1 "MidHigh" 2 "MidLow" 3 "Low" ;
VAL_ 799 DET_IDM_125 0 "Not_IDM_Output" 1 "IDM_Output" ;
VAL_ 799 DET_MTD_125 0 "Not_MTD_Output" 1 "MTD_Output" ;
VAL_ 799 DET_BELOW_RAIN_THOLD_125 0 "DetBelowRainThold" 1 "DetAboveRainThold" ;
VAL_ 799 DET_CONFD_AZIMUTH_126 0 "High" 1 "MidHigh" 2 "MidLow" 3 "Low" ;
VAL_ 799 DET_CONFD_ELEVATION_126 0 "High" 1 "MidHigh" 2 "MidLow" 3 "Low" ;
VAL_ 799 DET_IDM_126 0 "Not_IDM_Output" 1 "IDM_Output" ;
VAL_ 799 DET_MTD_126 0 "Not_MTD_Output" 1 "MTD_Output" ;
VAL_ 799 DET_BELOW_RAIN_THOLD_126 0 "DetBelowRainThold" 1 "DetAboveRainThold" ;
VAL_ 799 DET_CONFD_AZIMUTH_127 0 "High" 1 "MidHigh" 2 "MidLow" 3 "Low" ;
VAL_ 799 DET_CONFD_ELEVATION_127 0 "High" 1 "MidHigh" 2 "MidLow" 3 "Low" ;
VAL_ 799 DET_IDM_127 0 "Not_IDM_Output" 1 "IDM_Output" ;
VAL_ 799 DET_MTD_127 0 "Not_MTD_Output" 1 "MTD_Output" ;
VAL_ 799 DET_BELOW_RAIN_THOLD_127 0 "DetBelowRainThold" 1 "DetAboveRainThold" ;
VAL_ 799 DET_IDM_128 0 "Not_IDM_Output" 1 "IDM_Output" ;
VAL_ 799 DET_MTD_128 0 "Not_MTD_Output" 1 "MTD_Output" ;
VAL_ 799 DET_BELOW_RAIN_THOLD_128 0 "DetBelowRainThold" 1 "DetAboveRainThold" ;
VAL_ 798 DET_CONFD_AZIMUTH_121 0 "High" 1 "MidHigh" 2 "MidLow" 3 "Low" ;
VAL_ 798 DET_CONFD_ELEVATION_121 0 "High" 1 "MidHigh" 2 "MidLow" 3 "Low" ;
VAL_ 798 DET_IDM_121 0 "Not_IDM_Output" 1 "IDM_Output" ;
VAL_ 798 DET_MTD_121 0 "Not_MTD_Output" 1 "MTD_Output" ;
VAL_ 798 DET_BELOW_RAIN_THOLD_121 0 "DetBelowRainThold" 1 "DetAboveRainThold" ;
VAL_ 798 DET_CONFD_AZIMUTH_122 0 "High" 1 "MidHigh" 2 "MidLow" 3 "Low" ;
VAL_ 798 DET_CONFD_ELEVATION_122 0 "High" 1 "MidHigh" 2 "MidLow" 3 "Low" ;
VAL_ 798 DET_IDM_122 0 "Not_IDM_Output" 1 "IDM_Output" ;
VAL_ 798 DET_MTD_122 0 "Not_MTD_Output" 1 "MTD_Output" ;
VAL_ 798 DET_BELOW_RAIN_THOLD_122 0 "DetBelowRainThold" 1 "DetAboveRainThold" ;
VAL_ 798 DET_CONFD_AZIMUTH_123 0 "High" 1 "MidHigh" 2 "MidLow" 3 "Low" ;
VAL_ 798 DET_CONFD_ELEVATION_123 0 "High" 1 "MidHigh" 2 "MidLow" 3 "Low" ;
VAL_ 798 DET_IDM_123 0 "Not_IDM_Output" 1 "IDM_Output" ;
VAL_ 798 DET_MTD_123 0 "Not_MTD_Output" 1 "MTD_Output" ;
VAL_ 798 DET_BELOW_RAIN_THOLD_123 0 "DetBelowRainThold" 1 "DetAboveRainThold" ;
VAL_ 798 DET_IDM_124 0 "Not_IDM_Output" 1 "IDM_Output" ;
VAL_ 798 DET_MTD_124 0 "Not_MTD_Output" 1 "MTD_Output" ;
VAL_ 798 DET_BELOW_RAIN_THOLD_124 0 "DetBelowRainThold" 1 "DetAboveRainThold" ;
VAL_ 797 DET_CONFD_AZIMUTH_117 0 "High" 1 "MidHigh" 2 "MidLow" 3 "Low" ;
VAL_ 797 DET_CONFD_ELEVATION_117 0 "High" 1 "MidHigh" 2 "MidLow" 3 "Low" ;
VAL_ 797 DET_IDM_117 0 "Not_IDM_Output" 1 "IDM_Output" ;
VAL_ 797 DET_MTD_117 0 "Not_MTD_Output" 1 "MTD_Output" ;
VAL_ 797 DET_BELOW_RAIN_THOLD_117 0 "DetBelowRainThold" 1 "DetAboveRainThold" ;
VAL_ 797 DET_CONFD_AZIMUTH_118 0 "High" 1 "MidHigh" 2 "MidLow" 3 "Low" ;
VAL_ 797 DET_CONFD_ELEVATION_118 0 "High" 1 "MidHigh" 2 "MidLow" 3 "Low" ;
VAL_ 797 DET_IDM_118 0 "Not_IDM_Output" 1 "IDM_Output" ;
VAL_ 797 DET_MTD_118 0 "Not_MTD_Output" 1 "MTD_Output" ;
VAL_ 797 DET_BELOW_RAIN_THOLD_118 0 "DetBelowRainThold" 1 "DetAboveRainThold" ;
VAL_ 797 DET_CONFD_AZIMUTH_119 0 "High" 1 "MidHigh" 2 "MidLow" 3 "Low" ;
VAL_ 797 DET_CONFD_ELEVATION_119 0 "High" 1 "MidHigh" 2 "MidLow" 3 "Low" ;
VAL_ 797 DET_IDM_119 0 "Not_IDM_Output" 1 "IDM_Output" ;
VAL_ 797 DET_MTD_119 0 "Not_MTD_Output" 1 "MTD_Output" ;
VAL_ 797 DET_BELOW_RAIN_THOLD_119 0 "DetBelowRainThold" 1 "DetAboveRainThold" ;
VAL_ 797 DET_IDM_120 0 "Not_IDM_Output" 1 "IDM_Output" ;
VAL_ 797 DET_MTD_120 0 "Not_MTD_Output" 1 "MTD_Output" ;
VAL_ 797 DET_BELOW_RAIN_THOLD_120 0 "DetBelowRainThold" 1 "DetAboveRainThold" ;
VAL_ 796 DET_CONFD_AZIMUTH_113 0 "High" 1 "MidHigh" 2 "MidLow" 3 "Low" ;
VAL_ 796 DET_CONFD_ELEVATION_113 0 "High" 1 "MidHigh" 2 "MidLow" 3 "Low" ;
VAL_ 796 DET_IDM_113 0 "Not_IDM_Output" 1 "IDM_Output" ;
VAL_ 796 DET_MTD_113 0 "Not_MTD_Output" 1 "MTD_Output" ;
VAL_ 796 DET_BELOW_RAIN_THOLD_113 0 "DetBelowRainThold" 1 "DetAboveRainThold" ;
VAL_ 796 DET_CONFD_AZIMUTH_114 0 "High" 1 "MidHigh" 2 "MidLow" 3 "Low" ;
VAL_ 796 DET_CONFD_ELEVATION_114 0 "High" 1 "MidHigh" 2 "MidLow" 3 "Low" ;
VAL_ 796 DET_IDM_114 0 "Not_IDM_Output" 1 "IDM_Output" ;
VAL_ 796 DET_MTD_114 0 "Not_MTD_Output" 1 "MTD_Output" ;
VAL_ 796 DET_BELOW_RAIN_THOLD_114 0 "DetBelowRainThold" 1 "DetAboveRainThold" ;
VAL_ 796 DET_CONFD_AZIMUTH_115 0 "High" 1 "MidHigh" 2 "MidLow" 3 "Low" ;
VAL_ 796 DET_CONFD_ELEVATION_115 0 "High" 1 "MidHigh" 2 "MidLow" 3 "Low" ;
VAL_ 796 DET_IDM_115 0 "Not_IDM_Output" 1 "IDM_Output" ;
VAL_ 796 DET_MTD_115 0 "Not_MTD_Output" 1 "MTD_Output" ;
VAL_ 796 DET_BELOW_RAIN_THOLD_115 0 "DetBelowRainThold" 1 "DetAboveRainThold" ;
VAL_ 796 DET_IDM_116 0 "Not_IDM_Output" 1 "IDM_Output" ;
VAL_ 796 DET_MTD_116 0 "Not_MTD_Output" 1 "MTD_Output" ;
VAL_ 796 DET_BELOW_RAIN_THOLD_116 0 "DetBelowRainThold" 1 "DetAboveRainThold" ;
VAL_ 795 DET_CONFD_AZIMUTH_109 0 "High" 1 "MidHigh" 2 "MidLow" 3 "Low" ;
VAL_ 795 DET_CONFD_ELEVATION_109 0 "High" 1 "MidHigh" 2 "MidLow" 3 "Low" ;
VAL_ 795 DET_IDM_109 0 "Not_IDM_Output" 1 "IDM_Output" ;
VAL_ 795 DET_MTD_109 0 "Not_MTD_Output" 1 "MTD_Output" ;
VAL_ 795 DET_BELOW_RAIN_THOLD_109 0 "DetBelowRainThold" 1 "DetAboveRainThold" ;
VAL_ 795 DET_CONFD_AZIMUTH_110 0 "High" 1 "MidHigh" 2 "MidLow" 3 "Low" ;
VAL_ 795 DET_CONFD_ELEVATION_110 0 "High" 1 "MidHigh" 2 "MidLow" 3 "Low" ;
VAL_ 795 DET_IDM_110 0 "Not_IDM_Output" 1 "IDM_Output" ;
VAL_ 795 DET_MTD_110 0 "Not_MTD_Output" 1 "MTD_Output" ;
VAL_ 795 DET_BELOW_RAIN_THOLD_110 0 "DetBelowRainThold" 1 "DetAboveRainThold" ;
VAL_ 795 DET_CONFD_AZIMUTH_111 0 "High" 1 "MidHigh" 2 "MidLow" 3 "Low" ;
VAL_ 795 DET_CONFD_ELEVATION_111 0 "High" 1 "MidHigh" 2 "MidLow" 3 "Low" ;
VAL_ 795 DET_IDM_111 0 "Not_IDM_Output" 1 "IDM_Output" ;
VAL_ 795 DET_MTD_111 0 "Not_MTD_Output" 1 "MTD_Output" ;
VAL_ 795 DET_BELOW_RAIN_THOLD_111 0 "DetBelowRainThold" 1 "DetAboveRainThold" ;
VAL_ 795 DET_IDM_112 0 "Not_IDM_Output" 1 "IDM_Output" ;
VAL_ 795 DET_MTD_112 0 "Not_MTD_Output" 1 "MTD_Output" ;
VAL_ 795 DET_BELOW_RAIN_THOLD_112 0 "DetBelowRainThold" 1 "DetAboveRainThold" ;
VAL_ 794 DET_CONFD_AZIMUTH_105 0 "High" 1 "MidHigh" 2 "MidLow" 3 "Low" ;
VAL_ 794 DET_CONFD_ELEVATION_105 0 "High" 1 "MidHigh" 2 "MidLow" 3 "Low" ;
VAL_ 794 DET_IDM_105 0 "Not_IDM_Output" 1 "IDM_Output" ;
VAL_ 794 DET_MTD_105 0 "Not_MTD_Output" 1 "MTD_Output" ;
VAL_ 794 DET_BELOW_RAIN_THOLD_105 0 "DetBelowRainThold" 1 "DetAboveRainThold" ;
VAL_ 794 DET_CONFD_AZIMUTH_106 0 "High" 1 "MidHigh" 2 "MidLow" 3 "Low" ;
VAL_ 794 DET_CONFD_ELEVATION_106 0 "High" 1 "MidHigh" 2 "MidLow" 3 "Low" ;
VAL_ 794 DET_IDM_106 0 "Not_IDM_Output" 1 "IDM_Output" ;
VAL_ 794 DET_MTD_106 0 "Not_MTD_Output" 1 "MTD_Output" ;
VAL_ 794 DET_BELOW_RAIN_THOLD_106 0 "DetBelowRainThold" 1 "DetAboveRainThold" ;
VAL_ 794 DET_CONFD_AZIMUTH_107 0 "High" 1 "MidHigh" 2 "MidLow" 3 "Low" ;
VAL_ 794 DET_CONFD_ELEVATION_107 0 "High" 1 "MidHigh" 2 "MidLow" 3 "Low" ;
VAL_ 794 DET_IDM_107 0 "Not_IDM_Output" 1 "IDM_Output" ;
VAL_ 794 DET_MTD_107 0 "Not_MTD_Output" 1 "MTD_Output" ;
VAL_ 794 DET_BELOW_RAIN_THOLD_107 0 "DetBelowRainThold" 1 "DetAboveRainThold" ;
VAL_ 794 DET_IDM_108 0 "Not_IDM_Output" 1 "IDM_Output" ;
VAL_ 794 DET_MTD_108 0 "Not_MTD_Output" 1 "MTD_Output" ;
VAL_ 794 DET_BELOW_RAIN_THOLD_108 0 "DetBelowRainThold" 1 "DetAboveRainThold" ;
VAL_ 793 DET_CONFD_AZIMUTH_101 0 "High" 1 "MidHigh" 2 "MidLow" 3 "Low" ;
VAL_ 793 DET_CONFD_ELEVATION_101 0 "High" 1 "MidHigh" 2 "MidLow" 3 "Low" ;
VAL_ 793 DET_IDM_101 0 "Not_IDM_Output" 1 "IDM_Output" ;
VAL_ 793 DET_MTD_101 0 "Not_MTD_Output" 1 "MTD_Output" ;
VAL_ 793 DET_BELOW_RAIN_THOLD_101 0 "DetBelowRainThold" 1 "DetAboveRainThold" ;
VAL_ 793 DET_CONFD_AZIMUTH_102 0 "High" 1 "MidHigh" 2 "MidLow" 3 "Low" ;
VAL_ 793 DET_CONFD_ELEVATION_102 0 "High" 1 "MidHigh" 2 "MidLow" 3 "Low" ;
VAL_ 793 DET_IDM_102 0 "Not_IDM_Output" 1 "IDM_Output" ;
VAL_ 793 DET_MTD_102 0 "Not_MTD_Output" 1 "MTD_Output" ;
VAL_ 793 DET_BELOW_RAIN_THOLD_102 0 "DetBelowRainThold" 1 "DetAboveRainThold" ;
VAL_ 793 DET_CONFD_AZIMUTH_103 0 "High" 1 "MidHigh" 2 "MidLow" 3 "Low" ;
VAL_ 793 DET_CONFD_ELEVATION_103 0 "High" 1 "MidHigh" 2 "MidLow" 3 "Low" ;
VAL_ 793 DET_IDM_103 0 "Not_IDM_Output" 1 "IDM_Output" ;
VAL_ 793 DET_MTD_103 0 "Not_MTD_Output" 1 "MTD_Output" ;
VAL_ 793 DET_BELOW_RAIN_THOLD_103 0 "DetBelowRainThold" 1 "DetAboveRainThold" ;
VAL_ 793 DET_IDM_104 0 "Not_IDM_Output" 1 "IDM_Output" ;
VAL_ 793 DET_MTD_104 0 "Not_MTD_Output" 1 "MTD_Output" ;
VAL_ 793 DET_BELOW_RAIN_THOLD_104 0 "DetBelowRainThold" 1 "DetAboveRainThold" ;
VAL_ 792 DET_CONFD_AZIMUTH_097 0 "High" 1 "MidHigh" 2 "MidLow" 3 "Low" ;
VAL_ 792 DET_CONFD_ELEVATION_097 0 "High" 1 "MidHigh" 2 "MidLow" 3 "Low" ;
VAL_ 792 DET_IDM_097 0 "Not_IDM_Output" 1 "IDM_Output" ;
VAL_ 792 DET_MTD_097 0 "Not_MTD_Output" 1 "MTD_Output" ;
VAL_ 792 DET_BELOW_RAIN_THOLD_097 0 "DetBelowRainThold" 1 "DetAboveRainThold" ;
VAL_ 792 DET_CONFD_AZIMUTH_098 0 "High" 1 "MidHigh" 2 "MidLow" 3 "Low" ;
VAL_ 792 DET_CONFD_ELEVATION_098 0 "High" 1 "MidHigh" 2 "MidLow" 3 "Low" ;
VAL_ 792 DET_IDM_098 0 "Not_IDM_Output" 1 "IDM_Output" ;
VAL_ 792 DET_MTD_098 0 "Not_MTD_Output" 1 "MTD_Output" ;
VAL_ 792 DET_BELOW_RAIN_THOLD_098 0 "DetBelowRainThold" 1 "DetAboveRainThold" ;
VAL_ 792 DET_CONFD_AZIMUTH_099 0 "High" 1 "MidHigh" 2 "MidLow" 3 "Low" ;
VAL_ 792 DET_CONFD_ELEVATION_099 0 "High" 1 "MidHigh" 2 "MidLow" 3 "Low" ;
VAL_ 792 DET_IDM_099 0 "Not_IDM_Output" 1 "IDM_Output" ;
VAL_ 792 DET_MTD_099 0 "Not_MTD_Output" 1 "MTD_Output" ;
VAL_ 792 DET_BELOW_RAIN_THOLD_099 0 "DetBelowRainThold" 1 "DetAboveRainThold" ;
VAL_ 792 DET_IDM_100 0 "Not_IDM_Output" 1 "IDM_Output" ;
VAL_ 792 DET_MTD_100 0 "Not_MTD_Output" 1 "MTD_Output" ;
VAL_ 792 DET_BELOW_RAIN_THOLD_100 0 "DetBelowRainThold" 1 "DetAboveRainThold" ;
VAL_ 791 DET_CONFD_AZIMUTH_093 0 "High" 1 "MidHigh" 2 "MidLow" 3 "Low" ;
VAL_ 791 DET_CONFD_ELEVATION_093 0 "High" 1 "MidHigh" 2 "MidLow" 3 "Low" ;
VAL_ 791 DET_IDM_093 0 "Not_IDM_Output" 1 "IDM_Output" ;
VAL_ 791 DET_MTD_093 0 "Not_MTD_Output" 1 "MTD_Output" ;
VAL_ 791 DET_BELOW_RAIN_THOLD_093 0 "DetBelowRainThold" 1 "DetAboveRainThold" ;
VAL_ 791 DET_CONFD_AZIMUTH_094 0 "High" 1 "MidHigh" 2 "MidLow" 3 "Low" ;
VAL_ 791 DET_CONFD_ELEVATION_094 0 "High" 1 "MidHigh" 2 "MidLow" 3 "Low" ;
VAL_ 791 DET_IDM_094 0 "Not_IDM_Output" 1 "IDM_Output" ;
VAL_ 791 DET_MTD_094 0 "Not_MTD_Output" 1 "MTD_Output" ;
VAL_ 791 DET_BELOW_RAIN_THOLD_094 0 "DetBelowRainThold" 1 "DetAboveRainThold" ;
VAL_ 791 DET_CONFD_AZIMUTH_095 0 "High" 1 "MidHigh" 2 "MidLow" 3 "Low" ;
VAL_ 791 DET_CONFD_ELEVATION_095 0 "High" 1 "MidHigh" 2 "MidLow" 3 "Low" ;
VAL_ 791 DET_IDM_095 0 "Not_IDM_Output" 1 "IDM_Output" ;
VAL_ 791 DET_MTD_095 0 "Not_MTD_Output" 1 "MTD_Output" ;
VAL_ 791 DET_BELOW_RAIN_THOLD_095 0 "DetBelowRainThold" 1 "DetAboveRainThold" ;
VAL_ 791 DET_IDM_096 0 "Not_IDM_Output" 1 "IDM_Output" ;
VAL_ 791 DET_MTD_096 0 "Not_MTD_Output" 1 "MTD_Output" ;
VAL_ 791 DET_BELOW_RAIN_THOLD_096 0 "DetBelowRainThold" 1 "DetAboveRainThold" ;
VAL_ 790 DET_CONFD_AZIMUTH_089 0 "High" 1 "MidHigh" 2 "MidLow" 3 "Low" ;
VAL_ 790 DET_CONFD_ELEVATION_089 0 "High" 1 "MidHigh" 2 "MidLow" 3 "Low" ;
VAL_ 790 DET_IDM_089 0 "Not_IDM_Output" 1 "IDM_Output" ;
VAL_ 790 DET_MTD_089 0 "Not_MTD_Output" 1 "MTD_Output" ;
VAL_ 790 DET_BELOW_RAIN_THOLD_089 0 "DetBelowRainThold" 1 "DetAboveRainThold" ;
VAL_ 790 DET_CONFD_AZIMUTH_090 0 "High" 1 "MidHigh" 2 "MidLow" 3 "Low" ;
VAL_ 790 DET_CONFD_ELEVATION_090 0 "High" 1 "MidHigh" 2 "MidLow" 3 "Low" ;
VAL_ 790 DET_IDM_090 0 "Not_IDM_Output" 1 "IDM_Output" ;
VAL_ 790 DET_MTD_090 0 "Not_MTD_Output" 1 "MTD_Output" ;
VAL_ 790 DET_BELOW_RAIN_THOLD_090 0 "DetBelowRainThold" 1 "DetAboveRainThold" ;
VAL_ 790 DET_CONFD_AZIMUTH_091 0 "High" 1 "MidHigh" 2 "MidLow" 3 "Low" ;
VAL_ 790 DET_CONFD_ELEVATION_091 0 "High" 1 "MidHigh" 2 "MidLow" 3 "Low" ;
VAL_ 790 DET_IDM_091 0 "Not_IDM_Output" 1 "IDM_Output" ;
VAL_ 790 DET_MTD_091 0 "Not_MTD_Output" 1 "MTD_Output" ;
VAL_ 790 DET_BELOW_RAIN_THOLD_091 0 "DetBelowRainThold" 1 "DetAboveRainThold" ;
VAL_ 790 DET_IDM_092 0 "Not_IDM_Output" 1 "IDM_Output" ;
VAL_ 790 DET_MTD_092 0 "Not_MTD_Output" 1 "MTD_Output" ;
VAL_ 790 DET_BELOW_RAIN_THOLD_092 0 "DetBelowRainThold" 1 "DetAboveRainThold" ;
VAL_ 789 DET_CONFD_AZIMUTH_085 0 "High" 1 "MidHigh" 2 "MidLow" 3 "Low" ;
VAL_ 789 DET_CONFD_ELEVATION_085 0 "High" 1 "MidHigh" 2 "MidLow" 3 "Low" ;
VAL_ 789 DET_IDM_085 0 "Not_IDM_Output" 1 "IDM_Output" ;
VAL_ 789 DET_MTD_085 0 "Not_MTD_Output" 1 "MTD_Output" ;
VAL_ 789 DET_BELOW_RAIN_THOLD_085 0 "DetBelowRainThold" 1 "DetAboveRainThold" ;
VAL_ 789 DET_CONFD_AZIMUTH_086 0 "High" 1 "MidHigh" 2 "MidLow" 3 "Low" ;
VAL_ 789 DET_CONFD_ELEVATION_086 0 "High" 1 "MidHigh" 2 "MidLow" 3 "Low" ;
VAL_ 789 DET_IDM_086 0 "Not_IDM_Output" 1 "IDM_Output" ;
VAL_ 789 DET_MTD_086 0 "Not_MTD_Output" 1 "MTD_Output" ;
VAL_ 789 DET_BELOW_RAIN_THOLD_086 0 "DetBelowRainThold" 1 "DetAboveRainThold" ;
VAL_ 789 DET_CONFD_AZIMUTH_087 0 "High" 1 "MidHigh" 2 "MidLow" 3 "Low" ;
VAL_ 789 DET_CONFD_ELEVATION_087 0 "High" 1 "MidHigh" 2 "MidLow" 3 "Low" ;
VAL_ 789 DET_IDM_087 0 "Not_IDM_Output" 1 "IDM_Output" ;
VAL_ 789 DET_MTD_087 0 "Not_MTD_Output" 1 "MTD_Output" ;
VAL_ 789 DET_BELOW_RAIN_THOLD_087 0 "DetBelowRainThold" 1 "DetAboveRainThold" ;
VAL_ 789 DET_IDM_088 0 "Not_IDM_Output" 1 "IDM_Output" ;
VAL_ 789 DET_MTD_088 0 "Not_MTD_Output" 1 "MTD_Output" ;
VAL_ 789 DET_BELOW_RAIN_THOLD_088 0 "DetBelowRainThold" 1 "DetAboveRainThold" ;
VAL_ 788 DET_CONFD_AZIMUTH_081 0 "High" 1 "MidHigh" 2 "MidLow" 3 "Low" ;
VAL_ 788 DET_CONFD_ELEVATION_081 0 "High" 1 "MidHigh" 2 "MidLow" 3 "Low" ;
VAL_ 788 DET_IDM_081 0 "Not_IDM_Output" 1 "IDM_Output" ;
VAL_ 788 DET_MTD_081 0 "Not_MTD_Output" 1 "MTD_Output" ;
VAL_ 788 DET_BELOW_RAIN_THOLD_081 0 "DetBelowRainThold" 1 "DetAboveRainThold" ;
VAL_ 788 DET_CONFD_AZIMUTH_082 0 "High" 1 "MidHigh" 2 "MidLow" 3 "Low" ;
VAL_ 788 DET_CONFD_ELEVATION_082 0 "High" 1 "MidHigh" 2 "MidLow" 3 "Low" ;
VAL_ 788 DET_IDM_082 0 "Not_IDM_Output" 1 "IDM_Output" ;
VAL_ 788 DET_MTD_082 0 "Not_MTD_Output" 1 "MTD_Output" ;
VAL_ 788 DET_BELOW_RAIN_THOLD_082 0 "DetBelowRainThold" 1 "DetAboveRainThold" ;
VAL_ 788 DET_CONFD_AZIMUTH_083 0 "High" 1 "MidHigh" 2 "MidLow" 3 "Low" ;
VAL_ 788 DET_CONFD_ELEVATION_083 0 "High" 1 "MidHigh" 2 "MidLow" 3 "Low" ;
VAL_ 788 DET_IDM_083 0 "Not_IDM_Output" 1 "IDM_Output" ;
VAL_ 788 DET_MTD_083 0 "Not_MTD_Output" 1 "MTD_Output" ;
VAL_ 788 DET_BELOW_RAIN_THOLD_083 0 "DetBelowRainThold" 1 "DetAboveRainThold" ;
VAL_ 788 DET_IDM_084 0 "Not_IDM_Output" 1 "IDM_Output" ;
VAL_ 788 DET_MTD_084 0 "Not_MTD_Output" 1 "MTD_Output" ;
VAL_ 788 DET_BELOW_RAIN_THOLD_084 0 "DetBelowRainThold" 1 "DetAboveRainThold" ;
VAL_ 787 DET_CONFD_AZIMUTH_077 0 "High" 1 "MidHigh" 2 "MidLow" 3 "Low" ;
VAL_ 787 DET_CONFD_ELEVATION_077 0 "High" 1 "MidHigh" 2 "MidLow" 3 "Low" ;
VAL_ 787 DET_IDM_077 0 "Not_IDM_Output" 1 "IDM_Output" ;
VAL_ 787 DET_MTD_077 0 "Not_MTD_Output" 1 "MTD_Output" ;
VAL_ 787 DET_BELOW_RAIN_THOLD_077 0 "DetBelowRainThold" 1 "DetAboveRainThold" ;
VAL_ 787 DET_CONFD_AZIMUTH_078 0 "High" 1 "MidHigh" 2 "MidLow" 3 "Low" ;
VAL_ 787 DET_CONFD_ELEVATION_078 0 "High" 1 "MidHigh" 2 "MidLow" 3 "Low" ;
VAL_ 787 DET_IDM_078 0 "Not_IDM_Output" 1 "IDM_Output" ;
VAL_ 787 DET_MTD_078 0 "Not_MTD_Output" 1 "MTD_Output" ;
VAL_ 787 DET_BELOW_RAIN_THOLD_078 0 "DetBelowRainThold" 1 "DetAboveRainThold" ;
VAL_ 787 DET_CONFD_AZIMUTH_079 0 "High" 1 "MidHigh" 2 "MidLow" 3 "Low" ;
VAL_ 787 DET_CONFD_ELEVATION_079 0 "High" 1 "MidHigh" 2 "MidLow" 3 "Low" ;
VAL_ 787 DET_IDM_079 0 "Not_IDM_Output" 1 "IDM_Output" ;
VAL_ 787 DET_MTD_079 0 "Not_MTD_Output" 1 "MTD_Output" ;
VAL_ 787 DET_BELOW_RAIN_THOLD_079 0 "DetBelowRainThold" 1 "DetAboveRainThold" ;
VAL_ 787 DET_IDM_080 0 "Not_IDM_Output" 1 "IDM_Output" ;
VAL_ 787 DET_MTD_080 0 "Not_MTD_Output" 1 "MTD_Output" ;
VAL_ 787 DET_BELOW_RAIN_THOLD_080 0 "DetBelowRainThold" 1 "DetAboveRainThold" ;
VAL_ 786 DET_CONFD_AZIMUTH_073 0 "High" 1 "MidHigh" 2 "MidLow" 3 "Low" ;
VAL_ 786 DET_CONFD_ELEVATION_073 0 "High" 1 "MidHigh" 2 "MidLow" 3 "Low" ;
VAL_ 786 DET_IDM_073 0 "Not_IDM_Output" 1 "IDM_Output" ;
VAL_ 786 DET_MTD_073 0 "Not_MTD_Output" 1 "MTD_Output" ;
VAL_ 786 DET_BELOW_RAIN_THOLD_073 0 "DetBelowRainThold" 1 "DetAboveRainThold" ;
VAL_ 786 DET_CONFD_AZIMUTH_074 0 "High" 1 "MidHigh" 2 "MidLow" 3 "Low" ;
VAL_ 786 DET_CONFD_ELEVATION_074 0 "High" 1 "MidHigh" 2 "MidLow" 3 "Low" ;
VAL_ 786 DET_IDM_074 0 "Not_IDM_Output" 1 "IDM_Output" ;
VAL_ 786 DET_MTD_074 0 "Not_MTD_Output" 1 "MTD_Output" ;
VAL_ 786 DET_BELOW_RAIN_THOLD_074 0 "DetBelowRainThold" 1 "DetAboveRainThold" ;
VAL_ 786 DET_CONFD_AZIMUTH_075 0 "High" 1 "MidHigh" 2 "MidLow" 3 "Low" ;
VAL_ 786 DET_CONFD_ELEVATION_075 0 "High" 1 "MidHigh" 2 "MidLow" 3 "Low" ;
VAL_ 786 DET_IDM_075 0 "Not_IDM_Output" 1 "IDM_Output" ;
VAL_ 786 DET_MTD_075 0 "Not_MTD_Output" 1 "MTD_Output" ;
VAL_ 786 DET_BELOW_RAIN_THOLD_075 0 "DetBelowRainThold" 1 "DetAboveRainThold" ;
VAL_ 786 DET_IDM_076 0 "Not_IDM_Output" 1 "IDM_Output" ;
VAL_ 786 DET_MTD_076 0 "Not_MTD_Output" 1 "MTD_Output" ;
VAL_ 786 DET_BELOW_RAIN_THOLD_076 0 "DetBelowRainThold" 1 "DetAboveRainThold" ;
VAL_ 785 DET_CONFD_AZIMUTH_069 0 "High" 1 "MidHigh" 2 "MidLow" 3 "Low" ;
VAL_ 785 DET_CONFD_ELEVATION_069 0 "High" 1 "MidHigh" 2 "MidLow" 3 "Low" ;
VAL_ 785 DET_IDM_069 0 "Not_IDM_Output" 1 "IDM_Output" ;
VAL_ 785 DET_MTD_069 0 "Not_MTD_Output" 1 "MTD_Output" ;
VAL_ 785 DET_BELOW_RAIN_THOLD_069 0 "DetBelowRainThold" 1 "DetAboveRainThold" ;
VAL_ 785 DET_CONFD_AZIMUTH_070 0 "High" 1 "MidHigh" 2 "MidLow" 3 "Low" ;
VAL_ 785 DET_CONFD_ELEVATION_070 0 "High" 1 "MidHigh" 2 "MidLow" 3 "Low" ;
VAL_ 785 DET_IDM_070 0 "Not_IDM_Output" 1 "IDM_Output" ;
VAL_ 785 DET_MTD_070 0 "Not_MTD_Output" 1 "MTD_Output" ;
VAL_ 785 DET_BELOW_RAIN_THOLD_070 0 "DetBelowRainThold" 1 "DetAboveRainThold" ;
VAL_ 785 DET_CONFD_AZIMUTH_071 0 "High" 1 "MidHigh" 2 "MidLow" 3 "Low" ;
VAL_ 785 DET_CONFD_ELEVATION_071 0 "High" 1 "MidHigh" 2 "MidLow" 3 "Low" ;
VAL_ 785 DET_IDM_071 0 "Not_IDM_Output" 1 "IDM_Output" ;
VAL_ 785 DET_MTD_071 0 "Not_MTD_Output" 1 "MTD_Output" ;
VAL_ 785 DET_BELOW_RAIN_THOLD_071 0 "DetBelowRainThold" 1 "DetAboveRainThold" ;
VAL_ 785 DET_IDM_072 0 "Not_IDM_Output" 1 "IDM_Output" ;
VAL_ 785 DET_MTD_072 0 "Not_MTD_Output" 1 "MTD_Output" ;
VAL_ 785 DET_BELOW_RAIN_THOLD_072 0 "DetBelowRainThold" 1 "DetAboveRainThold" ;
SIG_GROUP_ 163 FLR_RadarStatus1 1 : STS_DIST_FRNT_BMPR_TO_RR_AXL STS_MH_001_CYCLE_COUNTER STS_MH_001_CRC16 STS_SMC_PLATFROM_VERSION STS_SMC_SECTION_COMPTBLITY STS_SMC_CAL_VER_MINOR STS_SMC_CAL_VER_MAJOR STS_USC_SECTION_COMPTBLITY STS_USC_CAL_VER_MINOR STS_USC_CAL_VER_MAJOR STS_SENSOR_POSITION STS_SENSOR_HEIGHT STS_SENSOR_MOUNT_ORNT_ROLL STS_SENSOR_MOUNT_ORNT_PITCH STS_SENSOR_MOUNT_ORNT_YAW STS_SENSOR_MOUNT_POS_Z STS_SENSOR_MOUNT_POS_Y STS_SENSOR_MOUNT_POS_X STS_SENSOR_POLARITY STS_PBL_VERSION_FIELD4 STS_PBL_VERSION_FIELD3 STS_PBL_VERSION_FIELD2 STS_PBL_VERSION_FIELD1 STS_SW_VERSION_FIELD4 STS_SW_VERSION_FIELD3 STS_SW_VERSION_FIELD2 STS_SW_VERSION_FIELD1 STS_DET_DBC_BASE_VER_MAJOR STS_DET_DBC_BASE_VER_MINOR STS_SERIAL_NUM_JULIAN_DAY STS_SERIAL_NUM_JULIAN_YEAR STS_SERIAL_NUMBER_SEQUENCE STS_HARDWARE_VERSION STS_PCAN_PROTOCOL_VER_MAJOR STS_PLATFORM_VARIANT STS_PCAN_PROTOCOL_VER_MINOR STS_TIME_SINCE_POWER_ON STS_AF_TIME_INST STS_AF_TIME_PEAK STS_MAIN_CORE_TIME_INST STS_MAIN_CORE_TIME_PEAK STS_RDD_CORE_TIME_INST STS_RDD_CORE_TIME_PEAK STS_SP_CORE_TIME_INST STS_SP_CORE_TIME_PEAK;
SIG_GROUP_ 160 FLR_RadarHeader 1 : HED_Rain_Level HED_MH_CRC16 HED_MH_CYCLE_COUNTER HED_Auth_CRC32 HED_FOV_VER_MIN HED_FOV_HOR_MIN HED_DET_SPEED_RANGE_MIN HED_DET_RANGE_MIN HED_FOV_VER_MAX HED_FOV_HOR_MAX HED_DET_SPEED_RANGE_MAX HED_DET_RANGE_MAX HED_R_WRAPPING HED_V_WRAPPING HED_DATA_QUALIFIER HED_SCAN_INDEX HED_LOOK_ID HED_NUM_OF_VALID_DETECTIONS HED_ALIGN_HOR_REF HED_LOOK_INDEX HED_ALIGN_VER_REF HED_TRIGGER_TIME HED_TIME_SYNC_VALIDITY_FLAG HED_TIME_SYNC_SRC_MASTER HED_SENSOR_TIME_STAMP_NS HED_SENSOR_TIME_STAMP_SEC HED_DET_BI_STATIC_COUNT HED_DET_NUM_OF_2PASS HED_DET_NUM_OF_1PASS HED_NUM_OF_RESTBINS_USED HED_MAX_NUM_OF_DETECTIONS HED_OPERATION_MODE HED_PROCESSED_RANGE HED_SLOPE_CORR_EXECUTIONFLAG;
SIG_GROUP_ 799 FLR_Detections_125_128 1 : DET_PROB_1STAZHYPO_125 DET_PROB_1STAZHYPO_126 DET_PROB_1STAZHYPO_127 DET_PROB_1STAZHYPO_128 DET_IDM_125 DET_IDM_126 DET_IDM_127 DET_IDM_128 DET_MTD_128 DET_MTD_127 DET_MTD_126 DET_MTD_125 DET_BELOW_RAIN_THOLD_128 DET_BELOW_RAIN_THOLD_127 DET_BELOW_RAIN_THOLD_126 DET_BELOW_RAIN_THOLD_125 DET_MH_CRC16_125_128 DET_MH_CYCLE_COUNTER_125_128 DET_MH_SCAN_INDEX_4LSB_125_128 DET_CONFD_ELEVATION_125 DET_CONFD_AZIMUTH_125 DET_HVC_FLAG_125 DET_EXISTENCE_PROB_125 DET_SNR_125 DET_SUPER_RES_TARGET_125 DET_BI_STATIC_FLAG_125 DET_RCS_125 DET_ELEVATION_ERR_125 DET_ELEVATION_125 DET_AZIMUTH_ERR_125 DET_AZIMUTH_125 DET_RANGE_VELOCITY_ERR_125 DET_RANGE_VELOCITY_125 DET_RANGE_ERR_125 DET_RANGE_125 DET_CONFD_ELEVATION_126 DET_CONFD_AZIMUTH_126 DET_HVC_FLAG_126 DET_EXISTENCE_PROB_126 DET_SNR_126 DET_SUPER_RES_TARGET_126 DET_BI_STATIC_FLAG_126 DET_RCS_126 DET_ELEVATION_ERR_126 DET_ELEVATION_126 DET_AZIMUTH_ERR_126 DET_AZIMUTH_126 DET_RANGE_VELOCITY_ERR_126 DET_RANGE_VELOCITY_126 DET_RANGE_ERR_126 DET_RANGE_126 DET_CONFD_ELEVATION_127 DET_CONFD_AZIMUTH_127 DET_HVC_FLAG_127 DET_EXISTENCE_PROB_127 DET_SNR_127 DET_SUPER_RES_TARGET_127 DET_BI_STATIC_FLAG_127 DET_RCS_127 DET_ELEVATION_ERR_127 DET_ELEVATION_127 DET_AZIMUTH_ERR_127 DET_AZIMUTH_127 DET_RANGE_VELOCITY_ERR_127 DET_RANGE_VELOCITY_127 DET_RANGE_ERR_127 DET_RANGE_127 DET_CONFD_ELEVATION_128 DET_CONFD_AZIMUTH_128 DET_HVC_FLAG_128 DET_EXISTENCE_PROB_128 DET_SNR_128 DET_SUPER_RES_TARGET_128 DET_BI_STATIC_FLAG_128 DET_RCS_128 DET_ELEVATION_ERR_128 DET_ELEVATION_128 DET_AZIMUTH_ERR_128 DET_AZIMUTH_128 DET_RANGE_VELOCITY_ERR_128 DET_RANGE_VELOCITY_128 DET_RANGE_ERR_128 DET_RANGE_128;
SIG_GROUP_ 798 FLR_Detections_121_124 1 : DET_PROB_1STAZHYPO_121 DET_PROB_1STAZHYPO_122 DET_PROB_1STAZHYPO_123 DET_PROB_1STAZHYPO_124 DET_IDM_121 DET_IDM_122 DET_IDM_123 DET_IDM_124 DET_MTD_124 DET_MTD_123 DET_MTD_122 DET_MTD_121 DET_BELOW_RAIN_THOLD_124 DET_BELOW_RAIN_THOLD_123 DET_BELOW_RAIN_THOLD_122 DET_BELOW_RAIN_THOLD_121 DET_MH_CRC16_121_124 DET_MH_CYCLE_COUNTER_121_124 DET_MH_SCAN_INDEX_4LSB_121_124 DET_CONFD_ELEVATION_121 DET_CONFD_AZIMUTH_121 DET_HVC_FLAG_121 DET_EXISTENCE_PROB_121 DET_SNR_121 DET_SUPER_RES_TARGET_121 DET_BI_STATIC_FLAG_121 DET_RCS_121 DET_ELEVATION_ERR_121 DET_ELEVATION_121 DET_AZIMUTH_ERR_121 DET_AZIMUTH_121 DET_RANGE_VELOCITY_ERR_121 DET_RANGE_VELOCITY_121 DET_RANGE_ERR_121 DET_RANGE_121 DET_CONFD_ELEVATION_122 DET_CONFD_AZIMUTH_122 DET_HVC_FLAG_122 DET_EXISTENCE_PROB_122 DET_SNR_122 DET_SUPER_RES_TARGET_122 DET_BI_STATIC_FLAG_122 DET_RCS_122 DET_ELEVATION_ERR_122 DET_ELEVATION_122 DET_AZIMUTH_ERR_122 DET_AZIMUTH_122 DET_RANGE_VELOCITY_ERR_122 DET_RANGE_VELOCITY_122 DET_RANGE_ERR_122 DET_RANGE_122 DET_CONFD_ELEVATION_123 DET_CONFD_AZIMUTH_123 DET_HVC_FLAG_123 DET_EXISTENCE_PROB_123 DET_SNR_123 DET_SUPER_RES_TARGET_123 DET_BI_STATIC_FLAG_123 DET_RCS_123 DET_ELEVATION_ERR_123 DET_ELEVATION_123 DET_AZIMUTH_ERR_123 DET_AZIMUTH_123 DET_RANGE_VELOCITY_ERR_123 DET_RANGE_VELOCITY_123 DET_RANGE_ERR_123 DET_RANGE_123 DET_CONFD_ELEVATION_124 DET_CONFD_AZIMUTH_124 DET_HVC_FLAG_124 DET_EXISTENCE_PROB_124 DET_SNR_124 DET_SUPER_RES_TARGET_124 DET_BI_STATIC_FLAG_124 DET_RCS_124 DET_ELEVATION_ERR_124 DET_ELEVATION_124 DET_AZIMUTH_ERR_124 DET_AZIMUTH_124 DET_RANGE_VELOCITY_ERR_124 DET_RANGE_VELOCITY_124 DET_RANGE_ERR_124 DET_RANGE_124;
SIG_GROUP_ 797 FLR_Detections_117_120 1 : DET_PROB_1STAZHYPO_117 DET_PROB_1STAZHYPO_118 DET_PROB_1STAZHYPO_119 DET_PROB_1STAZHYPO_120 DET_IDM_117 DET_IDM_118 DET_IDM_119 DET_IDM_120 DET_MTD_120 DET_MTD_119 DET_MTD_118 DET_MTD_117 DET_BELOW_RAIN_THOLD_120 DET_BELOW_RAIN_THOLD_119 DET_BELOW_RAIN_THOLD_118 DET_BELOW_RAIN_THOLD_117 DET_MH_CRC16_117_120 DET_MH_CYCLE_COUNTER_117_120 DET_MH_SCAN_INDEX_4LSB_117_120 DET_CONFD_ELEVATION_117 DET_CONFD_AZIMUTH_117 DET_HVC_FLAG_117 DET_EXISTENCE_PROB_117 DET_SNR_117 DET_SUPER_RES_TARGET_117 DET_BI_STATIC_FLAG_117 DET_RCS_117 DET_ELEVATION_ERR_117 DET_ELEVATION_117 DET_AZIMUTH_ERR_117 DET_AZIMUTH_117 DET_RANGE_VELOCITY_ERR_117 DET_RANGE_VELOCITY_117 DET_RANGE_ERR_117 DET_RANGE_117 DET_CONFD_ELEVATION_118 DET_CONFD_AZIMUTH_118 DET_HVC_FLAG_118 DET_EXISTENCE_PROB_118 DET_SNR_118 DET_SUPER_RES_TARGET_118 DET_BI_STATIC_FLAG_118 DET_RCS_118 DET_ELEVATION_ERR_118 DET_ELEVATION_118 DET_AZIMUTH_ERR_118 DET_AZIMUTH_118 DET_RANGE_VELOCITY_ERR_118 DET_RANGE_VELOCITY_118 DET_RANGE_ERR_118 DET_RANGE_118 DET_CONFD_ELEVATION_119 DET_CONFD_AZIMUTH_119 DET_HVC_FLAG_119 DET_EXISTENCE_PROB_119 DET_SNR_119 DET_SUPER_RES_TARGET_119 DET_BI_STATIC_FLAG_119 DET_RCS_119 DET_ELEVATION_ERR_119 DET_ELEVATION_119 DET_AZIMUTH_ERR_119 DET_AZIMUTH_119 DET_RANGE_VELOCITY_ERR_119 DET_RANGE_VELOCITY_119 DET_RANGE_ERR_119 DET_RANGE_119 DET_CONFD_ELEVATION_120 DET_CONFD_AZIMUTH_120 DET_HVC_FLAG_120 DET_EXISTENCE_PROB_120 DET_SNR_120 DET_SUPER_RES_TARGET_120 DET_BI_STATIC_FLAG_120 DET_RCS_120 DET_ELEVATION_ERR_120 DET_ELEVATION_120 DET_AZIMUTH_ERR_120 DET_AZIMUTH_120 DET_RANGE_VELOCITY_ERR_120 DET_RANGE_VELOCITY_120 DET_RANGE_ERR_120 DET_RANGE_120;
SIG_GROUP_ 796 FLR_Detections_113_116 1 : DET_PROB_1STAZHYPO_113 DET_PROB_1STAZHYPO_114 DET_PROB_1STAZHYPO_115 DET_PROB_1STAZHYPO_116 DET_IDM_113 DET_IDM_114 DET_IDM_115 DET_IDM_116 DET_MTD_116 DET_MTD_115 DET_MTD_114 DET_MTD_113 DET_BELOW_RAIN_THOLD_116 DET_BELOW_RAIN_THOLD_115 DET_BELOW_RAIN_THOLD_114 DET_BELOW_RAIN_THOLD_113 DET_MH_CRC16_113_116 DET_MH_CYCLE_COUNTER_113_116 DET_MH_SCAN_INDEX_4LSB_113_116 DET_CONFD_ELEVATION_113 DET_CONFD_AZIMUTH_113 DET_HVC_FLAG_113 DET_EXISTENCE_PROB_113 DET_SNR_113 DET_SUPER_RES_TARGET_113 DET_BI_STATIC_FLAG_113 DET_RCS_113 DET_ELEVATION_ERR_113 DET_ELEVATION_113 DET_AZIMUTH_ERR_113 DET_AZIMUTH_113 DET_RANGE_VELOCITY_ERR_113 DET_RANGE_VELOCITY_113 DET_RANGE_ERR_113 DET_RANGE_113 DET_CONFD_ELEVATION_114 DET_CONFD_AZIMUTH_114 DET_HVC_FLAG_114 DET_EXISTENCE_PROB_114 DET_SNR_114 DET_SUPER_RES_TARGET_114 DET_BI_STATIC_FLAG_114 DET_RCS_114 DET_ELEVATION_ERR_114 DET_ELEVATION_114 DET_AZIMUTH_ERR_114 DET_AZIMUTH_114 DET_RANGE_VELOCITY_ERR_114 DET_RANGE_VELOCITY_114 DET_RANGE_ERR_114 DET_RANGE_114 DET_CONFD_ELEVATION_115 DET_CONFD_AZIMUTH_115 DET_HVC_FLAG_115 DET_EXISTENCE_PROB_115 DET_SNR_115 DET_SUPER_RES_TARGET_115 DET_BI_STATIC_FLAG_115 DET_RCS_115 DET_ELEVATION_ERR_115 DET_ELEVATION_115 DET_AZIMUTH_ERR_115 DET_AZIMUTH_115 DET_RANGE_VELOCITY_ERR_115 DET_RANGE_VELOCITY_115 DET_RANGE_ERR_115 DET_RANGE_115 DET_CONFD_ELEVATION_116 DET_CONFD_AZIMUTH_116 DET_HVC_FLAG_116 DET_EXISTENCE_PROB_116 DET_SNR_116 DET_SUPER_RES_TARGET_116 DET_BI_STATIC_FLAG_116 DET_RCS_116 DET_ELEVATION_ERR_116 DET_ELEVATION_116 DET_AZIMUTH_ERR_116 DET_AZIMUTH_116 DET_RANGE_VELOCITY_ERR_116 DET_RANGE_VELOCITY_116 DET_RANGE_ERR_116 DET_RANGE_116;
SIG_GROUP_ 795 FLR_Detections_109_112 1 : DET_PROB_1STAZHYPO_109 DET_PROB_1STAZHYPO_110 DET_PROB_1STAZHYPO_111 DET_PROB_1STAZHYPO_112 DET_IDM_109 DET_IDM_110 DET_IDM_111 DET_IDM_112 DET_MTD_112 DET_MTD_111 DET_MTD_110 DET_MTD_109 DET_BELOW_RAIN_THOLD_112 DET_BELOW_RAIN_THOLD_111 DET_BELOW_RAIN_THOLD_110 DET_BELOW_RAIN_THOLD_109 DET_MH_CRC16_109_112 DET_MH_CYCLE_COUNTER_109_112 DET_MH_SCAN_INDEX_4LSB_109_112 DET_CONFD_ELEVATION_109 DET_CONFD_AZIMUTH_109 DET_HVC_FLAG_109 DET_EXISTENCE_PROB_109 DET_SNR_109 DET_SUPER_RES_TARGET_109 DET_BI_STATIC_FLAG_109 DET_RCS_109 DET_ELEVATION_ERR_109 DET_ELEVATION_109 DET_AZIMUTH_ERR_109 DET_AZIMUTH_109 DET_RANGE_VELOCITY_ERR_109 DET_RANGE_VELOCITY_109 DET_RANGE_ERR_109 DET_RANGE_109 DET_CONFD_ELEVATION_110 DET_CONFD_AZIMUTH_110 DET_HVC_FLAG_110 DET_EXISTENCE_PROB_110 DET_SNR_110 DET_SUPER_RES_TARGET_110 DET_BI_STATIC_FLAG_110 DET_RCS_110 DET_ELEVATION_ERR_110 DET_ELEVATION_110 DET_AZIMUTH_ERR_110 DET_AZIMUTH_110 DET_RANGE_VELOCITY_ERR_110 DET_RANGE_VELOCITY_110 DET_RANGE_ERR_110 DET_RANGE_110 DET_CONFD_ELEVATION_111 DET_CONFD_AZIMUTH_111 DET_HVC_FLAG_111 DET_EXISTENCE_PROB_111 DET_SNR_111 DET_SUPER_RES_TARGET_111 DET_BI_STATIC_FLAG_111 DET_RCS_111 DET_ELEVATION_ERR_111 DET_ELEVATION_111 DET_AZIMUTH_ERR_111 DET_AZIMUTH_111 DET_RANGE_VELOCITY_ERR_111 DET_RANGE_VELOCITY_111 DET_RANGE_ERR_111 DET_RANGE_111 DET_CONFD_ELEVATION_112 DET_CONFD_AZIMUTH_112 DET_HVC_FLAG_112 DET_EXISTENCE_PROB_112 DET_SNR_112 DET_SUPER_RES_TARGET_112 DET_BI_STATIC_FLAG_112 DET_RCS_112 DET_ELEVATION_ERR_112 DET_ELEVATION_112 DET_AZIMUTH_ERR_112 DET_AZIMUTH_112 DET_RANGE_VELOCITY_ERR_112 DET_RANGE_VELOCITY_112 DET_RANGE_ERR_112 DET_RANGE_112;
SIG_GROUP_ 794 FLR_Detections_105_108 1 : DET_PROB_1STAZHYPO_105 DET_PROB_1STAZHYPO_106 DET_PROB_1STAZHYPO_107 DET_PROB_1STAZHYPO_108 DET_IDM_105 DET_IDM_106 DET_IDM_107 DET_IDM_108 DET_MTD_108 DET_MTD_107 DET_MTD_106 DET_MTD_105 DET_BELOW_RAIN_THOLD_108 DET_BELOW_RAIN_THOLD_107 DET_BELOW_RAIN_THOLD_106 DET_BELOW_RAIN_THOLD_105 DET_MH_CRC16_105_108 DET_MH_CYCLE_COUNTER_105_108 DET_MH_SCAN_INDEX_4LSB_105_108 DET_CONFD_ELEVATION_105 DET_CONFD_AZIMUTH_105 DET_HVC_FLAG_105 DET_EXISTENCE_PROB_105 DET_SNR_105 DET_SUPER_RES_TARGET_105 DET_BI_STATIC_FLAG_105 DET_RCS_105 DET_ELEVATION_ERR_105 DET_ELEVATION_105 DET_AZIMUTH_ERR_105 DET_AZIMUTH_105 DET_RANGE_VELOCITY_ERR_105 DET_RANGE_VELOCITY_105 DET_RANGE_ERR_105 DET_RANGE_105 DET_CONFD_ELEVATION_106 DET_CONFD_AZIMUTH_106 DET_HVC_FLAG_106 DET_EXISTENCE_PROB_106 DET_SNR_106 DET_SUPER_RES_TARGET_106 DET_BI_STATIC_FLAG_106 DET_RCS_106 DET_ELEVATION_ERR_106 DET_ELEVATION_106 DET_AZIMUTH_ERR_106 DET_AZIMUTH_106 DET_RANGE_VELOCITY_ERR_106 DET_RANGE_VELOCITY_106 DET_RANGE_ERR_106 DET_RANGE_106 DET_CONFD_ELEVATION_107 DET_CONFD_AZIMUTH_107 DET_HVC_FLAG_107 DET_EXISTENCE_PROB_107 DET_SNR_107 DET_SUPER_RES_TARGET_107 DET_BI_STATIC_FLAG_107 DET_RCS_107 DET_ELEVATION_ERR_107 DET_ELEVATION_107 DET_AZIMUTH_ERR_107 DET_AZIMUTH_107 DET_RANGE_VELOCITY_ERR_107 DET_RANGE_VELOCITY_107 DET_RANGE_ERR_107 DET_RANGE_107 DET_CONFD_ELEVATION_108 DET_CONFD_AZIMUTH_108 DET_HVC_FLAG_108 DET_EXISTENCE_PROB_108 DET_SNR_108 DET_SUPER_RES_TARGET_108 DET_BI_STATIC_FLAG_108 DET_RCS_108 DET_ELEVATION_ERR_108 DET_ELEVATION_108 DET_AZIMUTH_ERR_108 DET_AZIMUTH_108 DET_RANGE_VELOCITY_ERR_108 DET_RANGE_VELOCITY_108 DET_RANGE_ERR_108 DET_RANGE_108;
SIG_GROUP_ 793 FLR_Detections_101_104 1 : DET_PROB_1STAZHYPO_101 DET_PROB_1STAZHYPO_102 DET_PROB_1STAZHYPO_103 DET_PROB_1STAZHYPO_104 DET_IDM_101 DET_IDM_102 DET_IDM_103 DET_IDM_104 DET_MTD_104 DET_MTD_103 DET_MTD_102 DET_MTD_101 DET_BELOW_RAIN_THOLD_104 DET_BELOW_RAIN_THOLD_103 DET_BELOW_RAIN_THOLD_102 DET_BELOW_RAIN_THOLD_101 DET_MH_CRC16_101_104 DET_MH_CYCLE_COUNTER_101_104 DET_MH_SCAN_INDEX_4LSB_101_104 DET_CONFD_ELEVATION_101 DET_CONFD_AZIMUTH_101 DET_HVC_FLAG_101 DET_EXISTENCE_PROB_101 DET_SNR_101 DET_SUPER_RES_TARGET_101 DET_BI_STATIC_FLAG_101 DET_RCS_101 DET_ELEVATION_ERR_101 DET_ELEVATION_101 DET_AZIMUTH_ERR_101 DET_AZIMUTH_101 DET_RANGE_VELOCITY_ERR_101 DET_RANGE_VELOCITY_101 DET_RANGE_ERR_101 DET_RANGE_101 DET_CONFD_ELEVATION_102 DET_CONFD_AZIMUTH_102 DET_HVC_FLAG_102 DET_EXISTENCE_PROB_102 DET_SNR_102 DET_SUPER_RES_TARGET_102 DET_BI_STATIC_FLAG_102 DET_RCS_102 DET_ELEVATION_ERR_102 DET_ELEVATION_102 DET_AZIMUTH_ERR_102 DET_AZIMUTH_102 DET_RANGE_VELOCITY_ERR_102 DET_RANGE_VELOCITY_102 DET_RANGE_ERR_102 DET_RANGE_102 DET_CONFD_ELEVATION_103 DET_CONFD_AZIMUTH_103 DET_HVC_FLAG_103 DET_EXISTENCE_PROB_103 DET_SNR_103 DET_SUPER_RES_TARGET_103 DET_BI_STATIC_FLAG_103 DET_RCS_103 DET_ELEVATION_ERR_103 DET_ELEVATION_103 DET_AZIMUTH_ERR_103 DET_AZIMUTH_103 DET_RANGE_VELOCITY_ERR_103 DET_RANGE_VELOCITY_103 DET_RANGE_ERR_103 DET_RANGE_103 DET_CONFD_ELEVATION_104 DET_CONFD_AZIMUTH_104 DET_HVC_FLAG_104 DET_EXISTENCE_PROB_104 DET_SNR_104 DET_SUPER_RES_TARGET_104 DET_BI_STATIC_FLAG_104 DET_RCS_104 DET_ELEVATION_ERR_104 DET_ELEVATION_104 DET_AZIMUTH_ERR_104 DET_AZIMUTH_104 DET_RANGE_VELOCITY_ERR_104 DET_RANGE_VELOCITY_104 DET_RANGE_ERR_104 DET_RANGE_104;
SIG_GROUP_ 792 FLR_Detections_097_100 1 : DET_PROB_1STAZHYPO_097 DET_PROB_1STAZHYPO_098 DET_PROB_1STAZHYPO_099 DET_PROB_1STAZHYPO_100 DET_IDM_097 DET_IDM_098 DET_IDM_099 DET_IDM_100 DET_MTD_100 DET_MTD_099 DET_MTD_098 DET_MTD_097 DET_BELOW_RAIN_THOLD_100 DET_BELOW_RAIN_THOLD_099 DET_BELOW_RAIN_THOLD_098 DET_BELOW_RAIN_THOLD_097 DET_MH_CRC16_097_100 DET_MH_CYCLE_COUNTER_097_100 DET_MH_SCAN_INDEX_4LSB_097_100 DET_CONFD_ELEVATION_097 DET_CONFD_AZIMUTH_097 DET_HVC_FLAG_097 DET_EXISTENCE_PROB_097 DET_SNR_097 DET_SUPER_RES_TARGET_097 DET_BI_STATIC_FLAG_097 DET_RCS_097 DET_ELEVATION_ERR_097 DET_ELEVATION_097 DET_AZIMUTH_ERR_097 DET_AZIMUTH_097 DET_RANGE_VELOCITY_ERR_097 DET_RANGE_VELOCITY_097 DET_RANGE_ERR_097 DET_RANGE_097 DET_CONFD_ELEVATION_098 DET_CONFD_AZIMUTH_098 DET_HVC_FLAG_098 DET_EXISTENCE_PROB_098 DET_SNR_098 DET_SUPER_RES_TARGET_098 DET_BI_STATIC_FLAG_098 DET_RCS_098 DET_ELEVATION_ERR_098 DET_ELEVATION_098 DET_AZIMUTH_ERR_098 DET_AZIMUTH_098 DET_RANGE_VELOCITY_ERR_098 DET_RANGE_VELOCITY_098 DET_RANGE_ERR_098 DET_RANGE_098 DET_CONFD_ELEVATION_099 DET_CONFD_AZIMUTH_099 DET_HVC_FLAG_099 DET_EXISTENCE_PROB_099 DET_SNR_099 DET_SUPER_RES_TARGET_099 DET_BI_STATIC_FLAG_099 DET_RCS_099 DET_ELEVATION_ERR_099 DET_ELEVATION_099 DET_AZIMUTH_ERR_099 DET_AZIMUTH_099 DET_RANGE_VELOCITY_ERR_099 DET_RANGE_VELOCITY_099 DET_RANGE_ERR_099 DET_RANGE_099 DET_CONFD_ELEVATION_100 DET_CONFD_AZIMUTH_100 DET_HVC_FLAG_100 DET_EXISTENCE_PROB_100 DET_SNR_100 DET_SUPER_RES_TARGET_100 DET_BI_STATIC_FLAG_100 DET_RCS_100 DET_ELEVATION_ERR_100 DET_ELEVATION_100 DET_AZIMUTH_ERR_100 DET_AZIMUTH_100 DET_RANGE_VELOCITY_ERR_100 DET_RANGE_VELOCITY_100 DET_RANGE_ERR_100 DET_RANGE_100;
SIG_GROUP_ 791 FLR_Detections_093_096 1 : DET_PROB_1STAZHYPO_093 DET_PROB_1STAZHYPO_094 DET_PROB_1STAZHYPO_095 DET_PROB_1STAZHYPO_096 DET_IDM_093 DET_IDM_094 DET_IDM_095 DET_IDM_096 DET_MTD_096 DET_MTD_095 DET_MTD_094 DET_MTD_093 DET_BELOW_RAIN_THOLD_096 DET_BELOW_RAIN_THOLD_095 DET_BELOW_RAIN_THOLD_094 DET_BELOW_RAIN_THOLD_093 DET_MH_CRC16_093_096 DET_MH_CYCLE_COUNTER_093_096 DET_MH_SCAN_INDEX_4LSB_093_096 DET_CONFD_ELEVATION_093 DET_CONFD_AZIMUTH_093 DET_HVC_FLAG_093 DET_EXISTENCE_PROB_093 DET_SNR_093 DET_SUPER_RES_TARGET_093 DET_BI_STATIC_FLAG_093 DET_RCS_093 DET_ELEVATION_ERR_093 DET_ELEVATION_093 DET_AZIMUTH_ERR_093 DET_AZIMUTH_093 DET_RANGE_VELOCITY_ERR_093 DET_RANGE_VELOCITY_093 DET_RANGE_ERR_093 DET_RANGE_093 DET_CONFD_ELEVATION_094 DET_CONFD_AZIMUTH_094 DET_HVC_FLAG_094 DET_EXISTENCE_PROB_094 DET_SNR_094 DET_SUPER_RES_TARGET_094 DET_BI_STATIC_FLAG_094 DET_RCS_094 DET_ELEVATION_ERR_094 DET_ELEVATION_094 DET_AZIMUTH_ERR_094 DET_AZIMUTH_094 DET_RANGE_VELOCITY_ERR_094 DET_RANGE_VELOCITY_094 DET_RANGE_ERR_094 DET_RANGE_094 DET_CONFD_ELEVATION_095 DET_CONFD_AZIMUTH_095 DET_HVC_FLAG_095 DET_EXISTENCE_PROB_095 DET_SNR_095 DET_SUPER_RES_TARGET_095 DET_BI_STATIC_FLAG_095 DET_RCS_095 DET_ELEVATION_ERR_095 DET_ELEVATION_095 DET_AZIMUTH_ERR_095 DET_AZIMUTH_095 DET_RANGE_VELOCITY_ERR_095 DET_RANGE_VELOCITY_095 DET_RANGE_ERR_095 DET_RANGE_095 DET_CONFD_ELEVATION_096 DET_CONFD_AZIMUTH_096 DET_HVC_FLAG_096 DET_EXISTENCE_PROB_096 DET_SNR_096 DET_SUPER_RES_TARGET_096 DET_BI_STATIC_FLAG_096 DET_RCS_096 DET_ELEVATION_ERR_096 DET_ELEVATION_096 DET_AZIMUTH_ERR_096 DET_AZIMUTH_096 DET_RANGE_VELOCITY_ERR_096 DET_RANGE_VELOCITY_096 DET_RANGE_ERR_096 DET_RANGE_096;
SIG_GROUP_ 790 FLR_Detections_089_092 1 : DET_PROB_1STAZHYPO_089 DET_PROB_1STAZHYPO_090 DET_PROB_1STAZHYPO_091 DET_PROB_1STAZHYPO_092 DET_IDM_089 DET_IDM_090 DET_IDM_091 DET_IDM_092 DET_MTD_092 DET_MTD_091 DET_MTD_090 DET_MTD_089 DET_BELOW_RAIN_THOLD_092 DET_BELOW_RAIN_THOLD_091 DET_BELOW_RAIN_THOLD_090 DET_BELOW_RAIN_THOLD_089 DET_MH_CRC16_089_092 DET_MH_CYCLE_COUNTER_089_092 DET_MH_SCAN_INDEX_4LSB_089_092 DET_CONFD_ELEVATION_089 DET_CONFD_AZIMUTH_089 DET_HVC_FLAG_089 DET_EXISTENCE_PROB_089 DET_SNR_089 DET_SUPER_RES_TARGET_089 DET_BI_STATIC_FLAG_089 DET_RCS_089 DET_ELEVATION_ERR_089 DET_ELEVATION_089 DET_AZIMUTH_ERR_089 DET_AZIMUTH_089 DET_RANGE_VELOCITY_ERR_089 DET_RANGE_VELOCITY_089 DET_RANGE_ERR_089 DET_RANGE_089 DET_CONFD_ELEVATION_090 DET_CONFD_AZIMUTH_090 DET_HVC_FLAG_090 DET_EXISTENCE_PROB_090 DET_SNR_090 DET_SUPER_RES_TARGET_090 DET_BI_STATIC_FLAG_090 DET_RCS_090 DET_ELEVATION_ERR_090 DET_ELEVATION_090 DET_AZIMUTH_ERR_090 DET_AZIMUTH_090 DET_RANGE_VELOCITY_ERR_090 DET_RANGE_VELOCITY_090 DET_RANGE_ERR_090 DET_RANGE_090 DET_CONFD_ELEVATION_091 DET_CONFD_AZIMUTH_091 DET_HVC_FLAG_091 DET_EXISTENCE_PROB_091 DET_SNR_091 DET_SUPER_RES_TARGET_091 DET_BI_STATIC_FLAG_091 DET_RCS_091 DET_ELEVATION_ERR_091 DET_ELEVATION_091 DET_AZIMUTH_ERR_091 DET_AZIMUTH_091 DET_RANGE_VELOCITY_ERR_091 DET_RANGE_VELOCITY_091 DET_RANGE_ERR_091 DET_RANGE_091 DET_CONFD_ELEVATION_092 DET_CONFD_AZIMUTH_092 DET_HVC_FLAG_092 DET_EXISTENCE_PROB_092 DET_SNR_092 DET_SUPER_RES_TARGET_092 DET_BI_STATIC_FLAG_092 DET_RCS_092 DET_ELEVATION_ERR_092 DET_ELEVATION_092 DET_AZIMUTH_ERR_092 DET_AZIMUTH_092 DET_RANGE_VELOCITY_ERR_092 DET_RANGE_VELOCITY_092 DET_RANGE_ERR_092 DET_RANGE_092;
SIG_GROUP_ 789 FLR_Detections_085_088 1 : DET_PROB_1STAZHYPO_085 DET_PROB_1STAZHYPO_086 DET_PROB_1STAZHYPO_087 DET_PROB_1STAZHYPO_088 DET_IDM_085 DET_IDM_086 DET_IDM_087 DET_IDM_088 DET_MTD_088 DET_MTD_087 DET_MTD_086 DET_MTD_085 DET_BELOW_RAIN_THOLD_088 DET_BELOW_RAIN_THOLD_087 DET_BELOW_RAIN_THOLD_086 DET_BELOW_RAIN_THOLD_085 DET_MH_CRC16_085_088 DET_MH_CYCLE_COUNTER_085_088 DET_MH_SCAN_INDEX_4LSB_085_088 DET_CONFD_ELEVATION_085 DET_CONFD_AZIMUTH_085 DET_HVC_FLAG_085 DET_EXISTENCE_PROB_085 DET_SNR_085 DET_SUPER_RES_TARGET_085 DET_BI_STATIC_FLAG_085 DET_RCS_085 DET_ELEVATION_ERR_085 DET_ELEVATION_085 DET_AZIMUTH_ERR_085 DET_AZIMUTH_085 DET_RANGE_VELOCITY_ERR_085 DET_RANGE_VELOCITY_085 DET_RANGE_ERR_085 DET_RANGE_085 DET_CONFD_ELEVATION_086 DET_CONFD_AZIMUTH_086 DET_HVC_FLAG_086 DET_EXISTENCE_PROB_086 DET_SNR_086 DET_SUPER_RES_TARGET_086 DET_BI_STATIC_FLAG_086 DET_RCS_086 DET_ELEVATION_ERR_086 DET_ELEVATION_086 DET_AZIMUTH_ERR_086 DET_AZIMUTH_086 DET_RANGE_VELOCITY_ERR_086 DET_RANGE_VELOCITY_086 DET_RANGE_ERR_086 DET_RANGE_086 DET_CONFD_ELEVATION_087 DET_CONFD_AZIMUTH_087 DET_HVC_FLAG_087 DET_EXISTENCE_PROB_087 DET_SNR_087 DET_SUPER_RES_TARGET_087 DET_BI_STATIC_FLAG_087 DET_RCS_087 DET_ELEVATION_ERR_087 DET_ELEVATION_087 DET_AZIMUTH_ERR_087 DET_AZIMUTH_087 DET_RANGE_VELOCITY_ERR_087 DET_RANGE_VELOCITY_087 DET_RANGE_ERR_087 DET_RANGE_087 DET_CONFD_ELEVATION_088 DET_CONFD_AZIMUTH_088 DET_HVC_FLAG_088 DET_EXISTENCE_PROB_088 DET_SNR_088 DET_SUPER_RES_TARGET_088 DET_BI_STATIC_FLAG_088 DET_RCS_088 DET_ELEVATION_ERR_088 DET_ELEVATION_088 DET_AZIMUTH_ERR_088 DET_AZIMUTH_088 DET_RANGE_VELOCITY_ERR_088 DET_RANGE_VELOCITY_088 DET_RANGE_ERR_088 DET_RANGE_088;
SIG_GROUP_ 788 FLR_Detections_081_084 1 : DET_PROB_1STAZHYPO_081 DET_PROB_1STAZHYPO_082 DET_PROB_1STAZHYPO_083 DET_PROB_1STAZHYPO_084 DET_IDM_081 DET_IDM_082 DET_IDM_083 DET_IDM_084 DET_MTD_084 DET_MTD_083 DET_MTD_082 DET_MTD_081 DET_BELOW_RAIN_THOLD_084 DET_BELOW_RAIN_THOLD_083 DET_BELOW_RAIN_THOLD_082 DET_BELOW_RAIN_THOLD_081 DET_MH_CRC16_081_084 DET_MH_CYCLE_COUNTER_081_084 DET_MH_SCAN_INDEX_4LSB_081_084 DET_CONFD_ELEVATION_081 DET_CONFD_AZIMUTH_081 DET_HVC_FLAG_081 DET_EXISTENCE_PROB_081 DET_SNR_081 DET_SUPER_RES_TARGET_081 DET_BI_STATIC_FLAG_081 DET_RCS_081 DET_ELEVATION_ERR_081 DET_ELEVATION_081 DET_AZIMUTH_ERR_081 DET_AZIMUTH_081 DET_RANGE_VELOCITY_ERR_081 DET_RANGE_VELOCITY_081 DET_RANGE_ERR_081 DET_RANGE_081 DET_CONFD_ELEVATION_082 DET_CONFD_AZIMUTH_082 DET_HVC_FLAG_082 DET_EXISTENCE_PROB_082 DET_SNR_082 DET_SUPER_RES_TARGET_082 DET_BI_STATIC_FLAG_082 DET_RCS_082 DET_ELEVATION_ERR_082 DET_ELEVATION_082 DET_AZIMUTH_ERR_082 DET_AZIMUTH_082 DET_RANGE_VELOCITY_ERR_082 DET_RANGE_VELOCITY_082 DET_RANGE_ERR_082 DET_RANGE_082 DET_CONFD_ELEVATION_083 DET_CONFD_AZIMUTH_083 DET_HVC_FLAG_083 DET_EXISTENCE_PROB_083 DET_SNR_083 DET_SUPER_RES_TARGET_083 DET_BI_STATIC_FLAG_083 DET_RCS_083 DET_ELEVATION_ERR_083 DET_ELEVATION_083 DET_AZIMUTH_ERR_083 DET_AZIMUTH_083 DET_RANGE_VELOCITY_ERR_083 DET_RANGE_VELOCITY_083 DET_RANGE_ERR_083 DET_RANGE_083 DET_CONFD_ELEVATION_084 DET_CONFD_AZIMUTH_084 DET_HVC_FLAG_084 DET_EXISTENCE_PROB_084 DET_SNR_084 DET_SUPER_RES_TARGET_084 DET_BI_STATIC_FLAG_084 DET_RCS_084 DET_ELEVATION_ERR_084 DET_ELEVATION_084 DET_AZIMUTH_ERR_084 DET_AZIMUTH_084 DET_RANGE_VELOCITY_ERR_084 DET_RANGE_VELOCITY_084 DET_RANGE_ERR_084 DET_RANGE_084;
SIG_GROUP_ 787 FLR_Detections_077_080 1 : DET_PROB_1STAZHYPO_077 DET_PROB_1STAZHYPO_078 DET_PROB_1STAZHYPO_079 DET_PROB_1STAZHYPO_080 DET_IDM_077 DET_IDM_078 DET_IDM_079 DET_IDM_080 DET_MTD_080 DET_MTD_079 DET_MTD_078 DET_MTD_077 DET_BELOW_RAIN_THOLD_080 DET_BELOW_RAIN_THOLD_079 DET_BELOW_RAIN_THOLD_078 DET_BELOW_RAIN_THOLD_077 DET_MH_CRC16_077_080 DET_MH_CYCLE_COUNTER_077_080 DET_MH_SCAN_INDEX_4LSB_077_080 DET_CONFD_ELEVATION_077 DET_CONFD_AZIMUTH_077 DET_HVC_FLAG_077 DET_EXISTENCE_PROB_077 DET_SNR_077 DET_SUPER_RES_TARGET_077 DET_BI_STATIC_FLAG_077 DET_RCS_077 DET_ELEVATION_ERR_077 DET_ELEVATION_077 DET_AZIMUTH_ERR_077 DET_AZIMUTH_077 DET_RANGE_VELOCITY_ERR_077 DET_RANGE_VELOCITY_077 DET_RANGE_ERR_077 DET_RANGE_077 DET_CONFD_ELEVATION_078 DET_CONFD_AZIMUTH_078 DET_HVC_FLAG_078 DET_EXISTENCE_PROB_078 DET_SNR_078 DET_SUPER_RES_TARGET_078 DET_BI_STATIC_FLAG_078 DET_RCS_078 DET_ELEVATION_ERR_078 DET_ELEVATION_078 DET_AZIMUTH_ERR_078 DET_AZIMUTH_078 DET_RANGE_VELOCITY_ERR_078 DET_RANGE_VELOCITY_078 DET_RANGE_ERR_078 DET_RANGE_078 DET_CONFD_ELEVATION_079 DET_CONFD_AZIMUTH_079 DET_HVC_FLAG_079 DET_EXISTENCE_PROB_079 DET_SNR_079 DET_SUPER_RES_TARGET_079 DET_BI_STATIC_FLAG_079 DET_RCS_079 DET_ELEVATION_ERR_079 DET_ELEVATION_079 DET_AZIMUTH_ERR_079 DET_AZIMUTH_079 DET_RANGE_VELOCITY_ERR_079 DET_RANGE_VELOCITY_079 DET_RANGE_ERR_079 DET_RANGE_079 DET_CONFD_ELEVATION_080 DET_CONFD_AZIMUTH_080 DET_HVC_FLAG_080 DET_EXISTENCE_PROB_080 DET_SNR_080 DET_SUPER_RES_TARGET_080 DET_BI_STATIC_FLAG_080 DET_RCS_080 DET_ELEVATION_ERR_080 DET_ELEVATION_080 DET_AZIMUTH_ERR_080 DET_AZIMUTH_080 DET_RANGE_VELOCITY_ERR_080 DET_RANGE_VELOCITY_080 DET_RANGE_ERR_080 DET_RANGE_080;
SIG_GROUP_ 786 FLR_Detections_073_076 1 : DET_PROB_1STAZHYPO_073 DET_PROB_1STAZHYPO_074 DET_PROB_1STAZHYPO_075 DET_PROB_1STAZHYPO_076 DET_IDM_073 DET_IDM_074 DET_IDM_075 DET_IDM_076 DET_MTD_076 DET_MTD_075 DET_MTD_074 DET_MTD_073 DET_BELOW_RAIN_THOLD_076 DET_BELOW_RAIN_THOLD_075 DET_BELOW_RAIN_THOLD_074 DET_BELOW_RAIN_THOLD_073 DET_MH_CRC16_073_076 DET_MH_CYCLE_COUNTER_073_076 DET_MH_SCAN_INDEX_4LSB_073_076 DET_CONFD_ELEVATION_073 DET_CONFD_AZIMUTH_073 DET_HVC_FLAG_073 DET_EXISTENCE_PROB_073 DET_SNR_073 DET_SUPER_RES_TARGET_073 DET_BI_STATIC_FLAG_073 DET_RCS_073 DET_ELEVATION_ERR_073 DET_ELEVATION_073 DET_AZIMUTH_ERR_073 DET_AZIMUTH_073 DET_RANGE_VELOCITY_ERR_073 DET_RANGE_VELOCITY_073 DET_RANGE_ERR_073 DET_RANGE_073 DET_CONFD_ELEVATION_074 DET_CONFD_AZIMUTH_074 DET_HVC_FLAG_074 DET_EXISTENCE_PROB_074 DET_SNR_074 DET_SUPER_RES_TARGET_074 DET_BI_STATIC_FLAG_074 DET_RCS_074 DET_ELEVATION_ERR_074 DET_ELEVATION_074 DET_AZIMUTH_ERR_074 DET_AZIMUTH_074 DET_RANGE_VELOCITY_ERR_074 DET_RANGE_VELOCITY_074 DET_RANGE_ERR_074 DET_RANGE_074 DET_CONFD_ELEVATION_075 DET_CONFD_AZIMUTH_075 DET_HVC_FLAG_075 DET_EXISTENCE_PROB_075 DET_SNR_075 DET_SUPER_RES_TARGET_075 DET_BI_STATIC_FLAG_075 DET_RCS_075 DET_ELEVATION_ERR_075 DET_ELEVATION_075 DET_AZIMUTH_ERR_075 DET_AZIMUTH_075 DET_RANGE_VELOCITY_ERR_075 DET_RANGE_VELOCITY_075 DET_RANGE_ERR_075 DET_RANGE_075 DET_CONFD_ELEVATION_076 DET_CONFD_AZIMUTH_076 DET_HVC_FLAG_076 DET_EXISTENCE_PROB_076 DET_SNR_076 DET_SUPER_RES_TARGET_076 DET_BI_STATIC_FLAG_076 DET_RCS_076 DET_ELEVATION_ERR_076 DET_ELEVATION_076 DET_AZIMUTH_ERR_076 DET_AZIMUTH_076 DET_RANGE_VELOCITY_ERR_076 DET_RANGE_VELOCITY_076 DET_RANGE_ERR_076 DET_RANGE_076;
SIG_GROUP_ 785 FLR_Detections_069_072 1 : DET_PROB_1STAZHYPO_069 DET_PROB_1STAZHYPO_070 DET_PROB_1STAZHYPO_071 DET_PROB_1STAZHYPO_072 DET_IDM_069 DET_IDM_070 DET_IDM_071 DET_IDM_072 DET_MTD_072 DET_MTD_071 DET_MTD_070 DET_MTD_069 DET_BELOW_RAIN_THOLD_072 DET_BELOW_RAIN_THOLD_071 DET_BELOW_RAIN_THOLD_070 DET_BELOW_RAIN_THOLD_069 DET_MH_CRC16_069_072 DET_MH_CYCLE_COUNTER_069_072 DET_MH_SCAN_INDEX_4LSB_069_072 DET_CONFD_ELEVATION_069 DET_CONFD_AZIMUTH_069 DET_HVC_FLAG_069 DET_EXISTENCE_PROB_069 DET_SNR_069 DET_SUPER_RES_TARGET_069 DET_BI_STATIC_FLAG_069 DET_RCS_069 DET_ELEVATION_ERR_069 DET_ELEVATION_069 DET_AZIMUTH_ERR_069 DET_AZIMUTH_069 DET_RANGE_VELOCITY_ERR_069 DET_RANGE_VELOCITY_069 DET_RANGE_ERR_069 DET_RANGE_069 DET_CONFD_ELEVATION_070 DET_CONFD_AZIMUTH_070 DET_HVC_FLAG_070 DET_EXISTENCE_PROB_070 DET_SNR_070 DET_SUPER_RES_TARGET_070 DET_BI_STATIC_FLAG_070 DET_RCS_070 DET_ELEVATION_ERR_070 DET_ELEVATION_070 DET_AZIMUTH_ERR_070 DET_AZIMUTH_070 DET_RANGE_VELOCITY_ERR_070 DET_RANGE_VELOCITY_070 DET_RANGE_ERR_070 DET_RANGE_070 DET_CONFD_ELEVATION_071 DET_CONFD_AZIMUTH_071 DET_HVC_FLAG_071 DET_EXISTENCE_PROB_071 DET_SNR_071 DET_SUPER_RES_TARGET_071 DET_BI_STATIC_FLAG_071 DET_RCS_071 DET_ELEVATION_ERR_071 DET_ELEVATION_071 DET_AZIMUTH_ERR_071 DET_AZIMUTH_071 DET_RANGE_VELOCITY_ERR_071 DET_RANGE_VELOCITY_071 DET_RANGE_ERR_071 DET_RANGE_071 DET_CONFD_ELEVATION_072 DET_CONFD_AZIMUTH_072 DET_HVC_FLAG_072 DET_EXISTENCE_PROB_072 DET_SNR_072 DET_SUPER_RES_TARGET_072 DET_BI_STATIC_FLAG_072 DET_RCS_072 DET_ELEVATION_ERR_072 DET_ELEVATION_072 DET_AZIMUTH_ERR_072 DET_AZIMUTH_072 DET_RANGE_VELOCITY_ERR_072 DET_RANGE_VELOCITY_072 DET_RANGE_ERR_072 DET_RANGE_072;
