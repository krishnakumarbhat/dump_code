VERSION "created by canmatrix"

NS_ :

BS_:

BU_: External_Tool ADAS RDR07 RDR_Fusion_Partner RDR_Gateway

BO_ 1048 RDR_DETECTION_097_100: 64 RDR07
 SG_ DET_RANGE_097 : 24|15@1+ (0.015625,0) [0|500] "m"  ADAS
 SG_ DET_RANGE_ERR_097 : 40|7@1+ (0.0075,0) [0|0.9525] "m"  ADAS
 SG_ DET_RANGE_VELOCITY_097 : 48|15@1+ (0.0078125,-128) [-128|127.9921875] "m/s"  ADAS
 SG_ DET_RANGE_VELOCITY_ERR_097 : 64|8@1+ (0.003,0) [0|0.765] "m/s"  ADAS
 SG_ DET_AZIMUTH_097 : 88|13@1+ (0.0004,-1.5708) [-1.5708|1.5708] "rad"  ADAS
 SG_ DET_AZIMUTH_ERR_097 : 105|7@1+ (0.00087267,0) [0|0.11082909] "rad"  ADAS
 SG_ DET_ELEVATION_097 : 72|8@1+ (0.00275,-0.34925) [-0.34925|0.34925] "rad"  ADAS
 SG_ DET_ELEVATION_ERR_097 : 80|6@1+ (0.00174533,0) [0|0.10995579] "rad"  ADAS
 SG_ DET_RCS_097 : 128|8@1+ (0.5,-64) [-64|63.5] "dBsm"  ADAS
 SG_ DET_BI_STATIC_FLAG_097 : 104|1@1+ (1,0) [0|1] ""  ADAS
 SG_ DET_SUPER_RES_TARGET_097 : 87|1@1+ (1,0) [0|1] ""  ADAS
 SG_ DET_SNR_097 : 120|8@1+ (0.35156,0) [0|89.6478] "dB"  ADAS
 SG_ DET_EXISTENCE_PROB_097 : 112|6@1+ (1.588,0) [0|100] "%"  ADAS
 SG_ DET_HVC_FLAG_097 : 86|1@1+ (1,0) [0|1] ""  ADAS
 SG_ DET_CONFD_AZIMUTH_097 : 118|2@1+ (1,0) [0|3] ""  ADAS
 SG_ DET_CONFD_ELEVATION_097 : 101|2@1+ (1,0) [0|3] ""  ADAS
 SG_ DET_PROB_1STAZHYPO_097 : 103|1@1+ (1,0) [0|1] ""  ADAS
 SG_ DET_IDM_097 : 63|1@1+ (1,0) [0|1] ""  ADAS
 SG_ DET_MTD_097 : 47|1@1+ (1,0) [0|1] ""  ADAS
 SG_ DET_BELOW_RAIN_THOLD_097 : 39|1@1+ (1,0) [0|1] ""  ADAS
 SG_ DET_RANGE_098 : 136|15@1+ (0.015625,0) [0|500] "m"  ADAS
 SG_ DET_RANGE_ERR_098 : 152|7@1+ (0.0075,0) [0|0.9525] "m"  ADAS
 SG_ DET_RANGE_VELOCITY_098 : 160|15@1+ (0.0078125,-128) [-128|127.9921875] "m/s"  ADAS
 SG_ DET_RANGE_VELOCITY_ERR_098 : 176|8@1+ (0.003,0) [0|0.765] "m/s"  ADAS
 SG_ DET_AZIMUTH_098 : 200|13@1+ (0.0004,-1.5708) [-1.5708|1.5708] "rad"  ADAS
 SG_ DET_AZIMUTH_ERR_098 : 217|7@1+ (0.00087267,0) [0|0.11082909] "rad"  ADAS
 SG_ DET_ELEVATION_098 : 184|8@1+ (0.00275,-0.34925) [-0.34925|0.34925] "rad"  ADAS
 SG_ DET_ELEVATION_ERR_098 : 192|6@1+ (0.00174533,0) [0|0.10995579] "rad"  ADAS
 SG_ DET_RCS_098 : 240|8@1+ (0.5,-64) [-64|63.5] "dBsm"  ADAS
 SG_ DET_BI_STATIC_FLAG_098 : 216|1@1+ (1,0) [0|1] ""  ADAS
 SG_ DET_SUPER_RES_TARGET_098 : 199|1@1+ (1,0) [0|1] ""  ADAS
 SG_ DET_SNR_098 : 232|8@1+ (0.35156,0) [0|89.6478] "dB"  ADAS
 SG_ DET_EXISTENCE_PROB_098 : 224|6@1+ (1.588,0) [0|100] "%"  ADAS
 SG_ DET_HVC_FLAG_098 : 198|1@1+ (1,0) [0|1] ""  ADAS
 SG_ DET_CONFD_AZIMUTH_098 : 230|2@1+ (1,0) [0|3] ""  ADAS
 SG_ DET_CONFD_ELEVATION_098 : 213|2@1+ (1,0) [0|3] ""  ADAS
 SG_ DET_PROB_1STAZHYPO_098 : 215|1@1+ (1,0) [0|1] ""  ADAS
 SG_ DET_IDM_098 : 175|1@1+ (1,0) [0|1] ""  ADAS
 SG_ DET_MTD_098 : 159|1@1+ (1,0) [0|1] ""  ADAS
 SG_ DET_BELOW_RAIN_THOLD_098 : 151|1@1+ (1,0) [0|1] ""  ADAS
 SG_ DET_RANGE_099 : 248|15@1+ (0.015625,0) [0|500] "m"  ADAS
 SG_ DET_RANGE_ERR_099 : 264|7@1+ (0.0075,0) [0|0.9525] "m"  ADAS
 SG_ DET_RANGE_VELOCITY_099 : 272|15@1+ (0.0078125,-128) [-128|127.9921875] "m/s"  ADAS
 SG_ DET_RANGE_VELOCITY_ERR_099 : 288|8@1+ (0.003,0) [0|0.765] "m/s"  ADAS
 SG_ DET_AZIMUTH_099 : 312|13@1+ (0.0004,-1.5708) [-1.5708|1.5708] "rad"  ADAS
 SG_ DET_AZIMUTH_ERR_099 : 329|7@1+ (0.00087267,0) [0|0.11082909] "rad"  ADAS
 SG_ DET_ELEVATION_099 : 296|8@1+ (0.00275,-0.34925) [-0.34925|0.34925] "rad"  ADAS
 SG_ DET_ELEVATION_ERR_099 : 304|6@1+ (0.00174533,0) [0|0.10995579] "rad"  ADAS
 SG_ DET_RCS_099 : 352|8@1+ (0.5,-64) [-64|63.5] "dBsm"  ADAS
 SG_ DET_BI_STATIC_FLAG_099 : 328|1@1+ (1,0) [0|1] ""  ADAS
 SG_ DET_SUPER_RES_TARGET_099 : 311|1@1+ (1,0) [0|1] ""  ADAS
 SG_ DET_SNR_099 : 344|8@1+ (0.35156,0) [0|89.6478] "dB"  ADAS
 SG_ DET_EXISTENCE_PROB_099 : 336|6@1+ (1.588,0) [0|100] "%"  ADAS
 SG_ DET_HVC_FLAG_099 : 310|1@1+ (1,0) [0|1] ""  ADAS
 SG_ DET_CONFD_AZIMUTH_099 : 342|2@1+ (1,0) [0|3] ""  ADAS
 SG_ DET_CONFD_ELEVATION_099 : 325|2@1+ (1,0) [0|3] ""  ADAS
 SG_ DET_PROB_1STAZHYPO_099 : 327|1@1+ (1,0) [0|1] ""  ADAS
 SG_ DET_IDM_099 : 287|1@1+ (1,0) [0|1] ""  ADAS
 SG_ DET_MTD_099 : 271|1@1+ (1,0) [0|1] ""  ADAS
 SG_ DET_BELOW_RAIN_THOLD_099 : 263|1@1+ (1,0) [0|1] ""  ADAS
 SG_ DET_RANGE_100 : 360|15@1+ (0.015625,0) [0|500] "m"  ADAS
 SG_ DET_RANGE_ERR_100 : 376|7@1+ (0.0075,0) [0|0.9525] "m"  ADAS
 SG_ DET_RANGE_VELOCITY_100 : 384|15@1+ (0.0078125,-128) [-128|127.9921875] "m/s"  ADAS
 SG_ DET_RANGE_VELOCITY_ERR_100 : 400|8@1+ (0.003,0) [0|0.765] "m/s"  ADAS
 SG_ DET_AZIMUTH_100 : 424|13@1+ (0.0004,-1.5708) [-1.5708|1.5708] "rad"  ADAS
 SG_ DET_AZIMUTH_ERR_100 : 441|7@1+ (0.00087267,0) [0|0.11082909] "rad"  ADAS
 SG_ DET_ELEVATION_100 : 408|8@1+ (0.00275,-0.34925) [-0.34925|0.34925] "rad"  ADAS
 SG_ DET_ELEVATION_ERR_100 : 416|6@1+ (0.00174533,0) [0|0.10995579] "rad"  ADAS
 SG_ DET_RCS_100 : 464|8@1+ (0.5,-64) [-64|63.5] "dBsm"  ADAS
 SG_ DET_BI_STATIC_FLAG_100 : 440|1@1+ (1,0) [0|1] ""  ADAS
 SG_ DET_SUPER_RES_TARGET_100 : 423|1@1+ (1,0) [0|1] ""  ADAS
 SG_ DET_SNR_100 : 456|8@1+ (0.35156,0) [0|89.6478] "dB"  ADAS
 SG_ DET_EXISTENCE_PROB_100 : 448|6@1+ (1.588,0) [0|100] "%"  ADAS
 SG_ DET_HVC_FLAG_100 : 422|1@1+ (1,0) [0|1] ""  ADAS
 SG_ DET_CONFD_AZIMUTH_100 : 454|2@1+ (1,0) [0|3] ""  ADAS
 SG_ DET_CONFD_ELEVATION_100 : 437|2@1+ (1,0) [0|3] ""  ADAS
 SG_ DET_MH_SCAN_INDEX_4LSB_097_100 : 476|4@1+ (1,0) [0|15] ""  ADAS
 SG_ DET_MH_CYCLE_COUNTER_097_100 : 16|8@1+ (1,0) [0|255] ""  ADAS
 SG_ DET_MH_CRC16_097_100 : 0|16@1+ (1,0) [0|65535] ""  ADAS
 SG_ DET_PROB_1STAZHYPO_100 : 439|1@1+ (1,0) [0|1] ""  ADAS
 SG_ DET_IDM_100 : 399|1@1+ (1,0) [0|1] ""  ADAS
 SG_ DET_MTD_100 : 383|1@1+ (1,0) [0|1] ""  ADAS
 SG_ DET_BELOW_RAIN_THOLD_100 : 375|1@1+ (1,0) [0|1] ""  ADAS

BO_ 1049 RDR_DETECTION_101_104: 64 RDR07
 SG_ DET_RANGE_101 : 24|15@1+ (0.015625,0) [0|500] "m"  ADAS
 SG_ DET_RANGE_ERR_101 : 40|7@1+ (0.0075,0) [0|0.9525] "m"  ADAS
 SG_ DET_RANGE_VELOCITY_101 : 48|15@1+ (0.0078125,-128) [-128|127.9921875] "m/s"  ADAS
 SG_ DET_RANGE_VELOCITY_ERR_101 : 64|8@1+ (0.003,0) [0|0.765] "m/s"  ADAS
 SG_ DET_AZIMUTH_101 : 88|13@1+ (0.0004,-1.5708) [-1.5708|1.5708] "rad"  ADAS
 SG_ DET_AZIMUTH_ERR_101 : 105|7@1+ (0.00087267,0) [0|0.11082909] "rad"  ADAS
 SG_ DET_ELEVATION_101 : 72|8@1+ (0.00275,-0.34925) [-0.34925|0.34925] "rad"  ADAS
 SG_ DET_ELEVATION_ERR_101 : 80|6@1+ (0.00174533,0) [0|0.10995579] "rad"  ADAS
 SG_ DET_RCS_101 : 128|8@1+ (0.5,-64) [-64|63.5] "dBsm"  ADAS
 SG_ DET_BI_STATIC_FLAG_101 : 104|1@1+ (1,0) [0|1] ""  ADAS
 SG_ DET_SUPER_RES_TARGET_101 : 87|1@1+ (1,0) [0|1] ""  ADAS
 SG_ DET_SNR_101 : 120|8@1+ (0.35156,0) [0|89.6478] "dB"  ADAS
 SG_ DET_EXISTENCE_PROB_101 : 112|6@1+ (1.588,0) [0|100] "%"  ADAS
 SG_ DET_HVC_FLAG_101 : 86|1@1+ (1,0) [0|1] ""  ADAS
 SG_ DET_CONFD_AZIMUTH_101 : 118|2@1+ (1,0) [0|3] ""  ADAS
 SG_ DET_CONFD_ELEVATION_101 : 101|2@1+ (1,0) [0|3] ""  ADAS
 SG_ DET_PROB_1STAZHYPO_101 : 103|1@1+ (1,0) [0|1] ""  ADAS
 SG_ DET_IDM_101 : 63|1@1+ (1,0) [0|1] ""  ADAS
 SG_ DET_MTD_101 : 47|1@1+ (1,0) [0|1] ""  ADAS
 SG_ DET_BELOW_RAIN_THOLD_101 : 39|1@1+ (1,0) [0|1] ""  ADAS
 SG_ DET_RANGE_102 : 136|15@1+ (0.015625,0) [0|500] "m"  ADAS
 SG_ DET_RANGE_ERR_102 : 152|7@1+ (0.0075,0) [0|0.9525] "m"  ADAS
 SG_ DET_RANGE_VELOCITY_102 : 160|15@1+ (0.0078125,-128) [-128|127.9921875] "m/s"  ADAS
 SG_ DET_RANGE_VELOCITY_ERR_102 : 176|8@1+ (0.003,0) [0|0.765] "m/s"  ADAS
 SG_ DET_AZIMUTH_102 : 200|13@1+ (0.0004,-1.5708) [-1.5708|1.5708] "rad"  ADAS
 SG_ DET_AZIMUTH_ERR_102 : 217|7@1+ (0.00087267,0) [0|0.11082909] "rad"  ADAS
 SG_ DET_ELEVATION_102 : 184|8@1+ (0.00275,-0.34925) [-0.34925|0.34925] "rad"  ADAS
 SG_ DET_ELEVATION_ERR_102 : 192|6@1+ (0.00174533,0) [0|0.10995579] "rad"  ADAS
 SG_ DET_RCS_102 : 240|8@1+ (0.5,-64) [-64|63.5] "dBsm"  ADAS
 SG_ DET_BI_STATIC_FLAG_102 : 216|1@1+ (1,0) [0|1] ""  ADAS
 SG_ DET_SUPER_RES_TARGET_102 : 199|1@1+ (1,0) [0|1] ""  ADAS
 SG_ DET_SNR_102 : 232|8@1+ (0.35156,0) [0|89.6478] "dB"  ADAS
 SG_ DET_EXISTENCE_PROB_102 : 224|6@1+ (1.588,0) [0|100] "%"  ADAS
 SG_ DET_HVC_FLAG_102 : 198|1@1+ (1,0) [0|1] ""  ADAS
 SG_ DET_CONFD_AZIMUTH_102 : 230|2@1+ (1,0) [0|3] ""  ADAS
 SG_ DET_CONFD_ELEVATION_102 : 213|2@1+ (1,0) [0|3] ""  ADAS
 SG_ DET_PROB_1STAZHYPO_102 : 215|1@1+ (1,0) [0|1] ""  ADAS
 SG_ DET_IDM_102 : 175|1@1+ (1,0) [0|1] ""  ADAS
 SG_ DET_MTD_102 : 159|1@1+ (1,0) [0|1] ""  ADAS
 SG_ DET_BELOW_RAIN_THOLD_102 : 151|1@1+ (1,0) [0|1] ""  ADAS
 SG_ DET_RANGE_103 : 248|15@1+ (0.015625,0) [0|500] "m"  ADAS
 SG_ DET_RANGE_ERR_103 : 264|7@1+ (0.0075,0) [0|0.9525] "m"  ADAS
 SG_ DET_RANGE_VELOCITY_103 : 272|15@1+ (0.0078125,-128) [-128|127.9921875] "m/s"  ADAS
 SG_ DET_RANGE_VELOCITY_ERR_103 : 288|8@1+ (0.003,0) [0|0.765] "m/s"  ADAS
 SG_ DET_AZIMUTH_103 : 312|13@1+ (0.0004,-1.5708) [-1.5708|1.5708] "rad"  ADAS
 SG_ DET_AZIMUTH_ERR_103 : 329|7@1+ (0.00087267,0) [0|0.11082909] "rad"  ADAS
 SG_ DET_ELEVATION_103 : 296|8@1+ (0.00275,-0.34925) [-0.34925|0.34925] "rad"  ADAS
 SG_ DET_ELEVATION_ERR_103 : 304|6@1+ (0.00174533,0) [0|0.10995579] "rad"  ADAS
 SG_ DET_RCS_103 : 352|8@1+ (0.5,-64) [-64|63.5] "dBsm"  ADAS
 SG_ DET_BI_STATIC_FLAG_103 : 328|1@1+ (1,0) [0|1] ""  ADAS
 SG_ DET_SUPER_RES_TARGET_103 : 311|1@1+ (1,0) [0|1] ""  ADAS
 SG_ DET_SNR_103 : 344|8@1+ (0.35156,0) [0|89.6478] "dB"  ADAS
 SG_ DET_EXISTENCE_PROB_103 : 336|6@1+ (1.588,0) [0|100] "%"  ADAS
 SG_ DET_HVC_FLAG_103 : 310|1@1+ (1,0) [0|1] ""  ADAS
 SG_ DET_CONFD_AZIMUTH_103 : 342|2@1+ (1,0) [0|3] ""  ADAS
 SG_ DET_CONFD_ELEVATION_103 : 325|2@1+ (1,0) [0|3] ""  ADAS
 SG_ DET_PROB_1STAZHYPO_103 : 327|1@1+ (1,0) [0|1] ""  ADAS
 SG_ DET_IDM_103 : 287|1@1+ (1,0) [0|1] ""  ADAS
 SG_ DET_MTD_103 : 271|1@1+ (1,0) [0|1] ""  ADAS
 SG_ DET_BELOW_RAIN_THOLD_103 : 263|1@1+ (1,0) [0|1] ""  ADAS
 SG_ DET_RANGE_104 : 360|15@1+ (0.015625,0) [0|500] "m"  ADAS
 SG_ DET_RANGE_ERR_104 : 376|7@1+ (0.0075,0) [0|0.9525] "m"  ADAS
 SG_ DET_RANGE_VELOCITY_104 : 384|15@1+ (0.0078125,-128) [-128|127.9921875] "m/s"  ADAS
 SG_ DET_RANGE_VELOCITY_ERR_104 : 400|8@1+ (0.003,0) [0|0.765] "m/s"  ADAS
 SG_ DET_AZIMUTH_104 : 424|13@1+ (0.0004,-1.5708) [-1.5708|1.5708] "rad"  ADAS
 SG_ DET_AZIMUTH_ERR_104 : 441|7@1+ (0.00087267,0) [0|0.11082909] "rad"  ADAS
 SG_ DET_ELEVATION_104 : 408|8@1+ (0.00275,-0.34925) [-0.34925|0.34925] "rad"  ADAS
 SG_ DET_ELEVATION_ERR_104 : 416|6@1+ (0.00174533,0) [0|0.10995579] "rad"  ADAS
 SG_ DET_RCS_104 : 464|8@1+ (0.5,-64) [-64|63.5] "dBsm"  ADAS
 SG_ DET_BI_STATIC_FLAG_104 : 440|1@1+ (1,0) [0|1] ""  ADAS
 SG_ DET_SUPER_RES_TARGET_104 : 423|1@1+ (1,0) [0|1] ""  ADAS
 SG_ DET_SNR_104 : 456|8@1+ (0.35156,0) [0|89.6478] "dB"  ADAS
 SG_ DET_EXISTENCE_PROB_104 : 448|6@1+ (1.588,0) [0|100] "%"  ADAS
 SG_ DET_HVC_FLAG_104 : 422|1@1+ (1,0) [0|1] ""  ADAS
 SG_ DET_CONFD_AZIMUTH_104 : 454|2@1+ (1,0) [0|3] ""  ADAS
 SG_ DET_CONFD_ELEVATION_104 : 437|2@1+ (1,0) [0|3] ""  ADAS
 SG_ DET_MH_SCAN_INDEX_4LSB_101_104 : 476|4@1+ (1,0) [0|15] ""  ADAS
 SG_ DET_MH_CYCLE_COUNTER_101_104 : 16|8@1+ (1,0) [0|255] ""  ADAS
 SG_ DET_MH_CRC16_101_104 : 0|16@1+ (1,0) [0|65535] ""  ADAS
 SG_ DET_PROB_1STAZHYPO_104 : 439|1@1+ (1,0) [0|1] ""  ADAS
 SG_ DET_IDM_104 : 399|1@1+ (1,0) [0|1] ""  ADAS
 SG_ DET_MTD_104 : 383|1@1+ (1,0) [0|1] ""  ADAS
 SG_ DET_BELOW_RAIN_THOLD_104 : 375|1@1+ (1,0) [0|1] ""  ADAS

BO_ 1050 RDR_DETECTION_105_108: 64 RDR07
 SG_ DET_RANGE_105 : 24|15@1+ (0.015625,0) [0|500] "m"  ADAS
 SG_ DET_RANGE_ERR_105 : 40|7@1+ (0.0075,0) [0|0.9525] "m"  ADAS
 SG_ DET_RANGE_VELOCITY_105 : 48|15@1+ (0.0078125,-128) [-128|127.9921875] "m/s"  ADAS
 SG_ DET_RANGE_VELOCITY_ERR_105 : 64|8@1+ (0.003,0) [0|0.765] "m/s"  ADAS
 SG_ DET_AZIMUTH_105 : 88|13@1+ (0.0004,-1.5708) [-1.5708|1.5708] "rad"  ADAS
 SG_ DET_AZIMUTH_ERR_105 : 105|7@1+ (0.00087267,0) [0|0.11082909] "rad"  ADAS
 SG_ DET_ELEVATION_105 : 72|8@1+ (0.00275,-0.34925) [-0.34925|0.34925] "rad"  ADAS
 SG_ DET_ELEVATION_ERR_105 : 80|6@1+ (0.00174533,0) [0|0.10995579] "rad"  ADAS
 SG_ DET_RCS_105 : 128|8@1+ (0.5,-64) [-64|63.5] "dBsm"  ADAS
 SG_ DET_BI_STATIC_FLAG_105 : 104|1@1+ (1,0) [0|1] ""  ADAS
 SG_ DET_SUPER_RES_TARGET_105 : 87|1@1+ (1,0) [0|1] ""  ADAS
 SG_ DET_SNR_105 : 120|8@1+ (0.35156,0) [0|89.6478] "dB"  ADAS
 SG_ DET_EXISTENCE_PROB_105 : 112|6@1+ (1.588,0) [0|100] "%"  ADAS
 SG_ DET_HVC_FLAG_105 : 86|1@1+ (1,0) [0|1] ""  ADAS
 SG_ DET_CONFD_AZIMUTH_105 : 118|2@1+ (1,0) [0|3] ""  ADAS
 SG_ DET_CONFD_ELEVATION_105 : 101|2@1+ (1,0) [0|3] ""  ADAS
 SG_ DET_PROB_1STAZHYPO_105 : 103|1@1+ (1,0) [0|1] ""  ADAS
 SG_ DET_IDM_105 : 63|1@1+ (1,0) [0|1] ""  ADAS
 SG_ DET_MTD_105 : 47|1@1+ (1,0) [0|1] ""  ADAS
 SG_ DET_BELOW_RAIN_THOLD_105 : 39|1@1+ (1,0) [0|1] ""  ADAS
 SG_ DET_RANGE_106 : 136|15@1+ (0.015625,0) [0|500] "m"  ADAS
 SG_ DET_RANGE_ERR_106 : 152|7@1+ (0.0075,0) [0|0.9525] "m"  ADAS
 SG_ DET_RANGE_VELOCITY_106 : 160|15@1+ (0.0078125,-128) [-128|127.9921875] "m/s"  ADAS
 SG_ DET_RANGE_VELOCITY_ERR_106 : 176|8@1+ (0.003,0) [0|0.765] "m/s"  ADAS
 SG_ DET_AZIMUTH_106 : 200|13@1+ (0.0004,-1.5708) [-1.5708|1.5708] "rad"  ADAS
 SG_ DET_AZIMUTH_ERR_106 : 217|7@1+ (0.00087267,0) [0|0.11082909] "rad"  ADAS
 SG_ DET_ELEVATION_106 : 184|8@1+ (0.00275,-0.34925) [-0.34925|0.34925] "rad"  ADAS
 SG_ DET_ELEVATION_ERR_106 : 192|6@1+ (0.00174533,0) [0|0.10995579] "rad"  ADAS
 SG_ DET_RCS_106 : 240|8@1+ (0.5,-64) [-64|63.5] "dBsm"  ADAS
 SG_ DET_BI_STATIC_FLAG_106 : 216|1@1+ (1,0) [0|1] ""  ADAS
 SG_ DET_SUPER_RES_TARGET_106 : 199|1@1+ (1,0) [0|1] ""  ADAS
 SG_ DET_SNR_106 : 232|8@1+ (0.35156,0) [0|89.6478] "dB"  ADAS
 SG_ DET_EXISTENCE_PROB_106 : 224|6@1+ (1.588,0) [0|100] "%"  ADAS
 SG_ DET_HVC_FLAG_106 : 198|1@1+ (1,0) [0|1] ""  ADAS
 SG_ DET_CONFD_AZIMUTH_106 : 230|2@1+ (1,0) [0|3] ""  ADAS
 SG_ DET_CONFD_ELEVATION_106 : 213|2@1+ (1,0) [0|3] ""  ADAS
 SG_ DET_PROB_1STAZHYPO_106 : 215|1@1+ (1,0) [0|1] ""  ADAS
 SG_ DET_IDM_106 : 175|1@1+ (1,0) [0|1] ""  ADAS
 SG_ DET_MTD_106 : 159|1@1+ (1,0) [0|1] ""  ADAS
 SG_ DET_BELOW_RAIN_THOLD_106 : 151|1@1+ (1,0) [0|1] ""  ADAS
 SG_ DET_RANGE_107 : 248|15@1+ (0.015625,0) [0|500] "m"  ADAS
 SG_ DET_RANGE_ERR_107 : 264|7@1+ (0.0075,0) [0|0.9525] "m"  ADAS
 SG_ DET_RANGE_VELOCITY_107 : 272|15@1+ (0.0078125,-128) [-128|127.9921875] "m/s"  ADAS
 SG_ DET_RANGE_VELOCITY_ERR_107 : 288|8@1+ (0.003,0) [0|0.765] "m/s"  ADAS
 SG_ DET_AZIMUTH_107 : 312|13@1+ (0.0004,-1.5708) [-1.5708|1.5708] "rad"  ADAS
 SG_ DET_AZIMUTH_ERR_107 : 329|7@1+ (0.00087267,0) [0|0.11082909] "rad"  ADAS
 SG_ DET_ELEVATION_107 : 296|8@1+ (0.00275,-0.34925) [-0.34925|0.34925] "rad"  ADAS
 SG_ DET_ELEVATION_ERR_107 : 304|6@1+ (0.00174533,0) [0|0.10995579] "rad"  ADAS
 SG_ DET_RCS_107 : 352|8@1+ (0.5,-64) [-64|63.5] "dBsm"  ADAS
 SG_ DET_BI_STATIC_FLAG_107 : 328|1@1+ (1,0) [0|1] ""  ADAS
 SG_ DET_SUPER_RES_TARGET_107 : 311|1@1+ (1,0) [0|1] ""  ADAS
 SG_ DET_SNR_107 : 344|8@1+ (0.35156,0) [0|89.6478] "dB"  ADAS
 SG_ DET_EXISTENCE_PROB_107 : 336|6@1+ (1.588,0) [0|100] "%"  ADAS
 SG_ DET_HVC_FLAG_107 : 310|1@1+ (1,0) [0|1] ""  ADAS
 SG_ DET_CONFD_AZIMUTH_107 : 342|2@1+ (1,0) [0|3] ""  ADAS
 SG_ DET_CONFD_ELEVATION_107 : 325|2@1+ (1,0) [0|3] ""  ADAS
 SG_ DET_PROB_1STAZHYPO_107 : 327|1@1+ (1,0) [0|1] ""  ADAS
 SG_ DET_IDM_107 : 287|1@1+ (1,0) [0|1] ""  ADAS
 SG_ DET_MTD_107 : 271|1@1+ (1,0) [0|1] ""  ADAS
 SG_ DET_BELOW_RAIN_THOLD_107 : 263|1@1+ (1,0) [0|1] ""  ADAS
 SG_ DET_RANGE_108 : 360|15@1+ (0.015625,0) [0|500] "m"  ADAS
 SG_ DET_RANGE_ERR_108 : 376|7@1+ (0.0075,0) [0|0.9525] "m"  ADAS
 SG_ DET_RANGE_VELOCITY_108 : 384|15@1+ (0.0078125,-128) [-128|127.9921875] "m/s"  ADAS
 SG_ DET_RANGE_VELOCITY_ERR_108 : 400|8@1+ (0.003,0) [0|0.765] "m/s"  ADAS
 SG_ DET_AZIMUTH_108 : 424|13@1+ (0.0004,-1.5708) [-1.5708|1.5708] "rad"  ADAS
 SG_ DET_AZIMUTH_ERR_108 : 441|7@1+ (0.00087267,0) [0|0.11082909] "rad"  ADAS
 SG_ DET_ELEVATION_108 : 408|8@1+ (0.00275,-0.34925) [-0.34925|0.34925] "rad"  ADAS
 SG_ DET_ELEVATION_ERR_108 : 416|6@1+ (0.00174533,0) [0|0.10995579] "rad"  ADAS
 SG_ DET_RCS_108 : 464|8@1+ (0.5,-64) [-64|63.5] "dBsm"  ADAS
 SG_ DET_BI_STATIC_FLAG_108 : 440|1@1+ (1,0) [0|1] ""  ADAS
 SG_ DET_SUPER_RES_TARGET_108 : 423|1@1+ (1,0) [0|1] ""  ADAS
 SG_ DET_SNR_108 : 456|8@1+ (0.35156,0) [0|89.6478] "dB"  ADAS
 SG_ DET_EXISTENCE_PROB_108 : 448|6@1+ (1.588,0) [0|100] "%"  ADAS
 SG_ DET_HVC_FLAG_108 : 422|1@1+ (1,0) [0|1] ""  ADAS
 SG_ DET_CONFD_AZIMUTH_108 : 454|2@1+ (1,0) [0|3] ""  ADAS
 SG_ DET_CONFD_ELEVATION_108 : 437|2@1+ (1,0) [0|3] ""  ADAS
 SG_ DET_MH_SCAN_INDEX_4LSB_105_108 : 476|4@1+ (1,0) [0|15] ""  ADAS
 SG_ DET_MH_CYCLE_COUNTER_105_108 : 16|8@1+ (1,0) [0|255] ""  ADAS
 SG_ DET_MH_CRC16_105_108 : 0|16@1+ (1,0) [0|65535] ""  ADAS
 SG_ DET_PROB_1STAZHYPO_108 : 439|1@1+ (1,0) [0|1] ""  ADAS
 SG_ DET_IDM_108 : 399|1@1+ (1,0) [0|1] ""  ADAS
 SG_ DET_MTD_108 : 383|1@1+ (1,0) [0|1] ""  ADAS
 SG_ DET_BELOW_RAIN_THOLD_108 : 375|1@1+ (1,0) [0|1] ""  ADAS

BO_ 1051 RDR_DETECTION_109_112: 64 RDR07
 SG_ DET_RANGE_109 : 24|15@1+ (0.015625,0) [0|500] "m"  ADAS
 SG_ DET_RANGE_ERR_109 : 40|7@1+ (0.0075,0) [0|0.9525] "m"  ADAS
 SG_ DET_RANGE_VELOCITY_109 : 48|15@1+ (0.0078125,-128) [-128|127.9921875] "m/s"  ADAS
 SG_ DET_RANGE_VELOCITY_ERR_109 : 64|8@1+ (0.003,0) [0|0.765] "m/s"  ADAS
 SG_ DET_AZIMUTH_109 : 88|13@1+ (0.0004,-1.5708) [-1.5708|1.5708] "rad"  ADAS
 SG_ DET_AZIMUTH_ERR_109 : 105|7@1+ (0.00087267,0) [0|0.11082909] "rad"  ADAS
 SG_ DET_ELEVATION_109 : 72|8@1+ (0.00275,-0.34925) [-0.34925|0.34925] "rad"  ADAS
 SG_ DET_ELEVATION_ERR_109 : 80|6@1+ (0.00174533,0) [0|0.10995579] "rad"  ADAS
 SG_ DET_RCS_109 : 128|8@1+ (0.5,-64) [-64|63.5] "dBsm"  ADAS
 SG_ DET_BI_STATIC_FLAG_109 : 104|1@1+ (1,0) [0|1] ""  ADAS
 SG_ DET_SUPER_RES_TARGET_109 : 87|1@1+ (1,0) [0|1] ""  ADAS
 SG_ DET_SNR_109 : 120|8@1+ (0.35156,0) [0|89.6478] "dB"  ADAS
 SG_ DET_EXISTENCE_PROB_109 : 112|6@1+ (1.588,0) [0|100] "%"  ADAS
 SG_ DET_HVC_FLAG_109 : 86|1@1+ (1,0) [0|1] ""  ADAS
 SG_ DET_CONFD_AZIMUTH_109 : 118|2@1+ (1,0) [0|3] ""  ADAS
 SG_ DET_CONFD_ELEVATION_109 : 101|2@1+ (1,0) [0|3] ""  ADAS
 SG_ DET_PROB_1STAZHYPO_109 : 103|1@1+ (1,0) [0|1] ""  ADAS
 SG_ DET_IDM_109 : 63|1@1+ (1,0) [0|1] ""  ADAS
 SG_ DET_MTD_109 : 47|1@1+ (1,0) [0|1] ""  ADAS
 SG_ DET_BELOW_RAIN_THOLD_109 : 39|1@1+ (1,0) [0|1] ""  ADAS
 SG_ DET_RANGE_110 : 136|15@1+ (0.015625,0) [0|500] "m"  ADAS
 SG_ DET_RANGE_ERR_110 : 152|7@1+ (0.0075,0) [0|0.9525] "m"  ADAS
 SG_ DET_RANGE_VELOCITY_110 : 160|15@1+ (0.0078125,-128) [-128|127.9921875] "m/s"  ADAS
 SG_ DET_RANGE_VELOCITY_ERR_110 : 176|8@1+ (0.003,0) [0|0.765] "m/s"  ADAS
 SG_ DET_AZIMUTH_110 : 200|13@1+ (0.0004,-1.5708) [-1.5708|1.5708] "rad"  ADAS
 SG_ DET_AZIMUTH_ERR_110 : 217|7@1+ (0.00087267,0) [0|0.11082909] "rad"  ADAS
 SG_ DET_ELEVATION_110 : 184|8@1+ (0.00275,-0.34925) [-0.34925|0.34925] "rad"  ADAS
 SG_ DET_ELEVATION_ERR_110 : 192|6@1+ (0.00174533,0) [0|0.10995579] "rad"  ADAS
 SG_ DET_RCS_110 : 240|8@1+ (0.5,-64) [-64|63.5] "dBsm"  ADAS
 SG_ DET_BI_STATIC_FLAG_110 : 216|1@1+ (1,0) [0|1] ""  ADAS
 SG_ DET_SUPER_RES_TARGET_110 : 199|1@1+ (1,0) [0|1] ""  ADAS
 SG_ DET_SNR_110 : 232|8@1+ (0.35156,0) [0|89.6478] "dB"  ADAS
 SG_ DET_EXISTENCE_PROB_110 : 224|6@1+ (1.588,0) [0|100] "%"  ADAS
 SG_ DET_HVC_FLAG_110 : 198|1@1+ (1,0) [0|1] ""  ADAS
 SG_ DET_CONFD_AZIMUTH_110 : 230|2@1+ (1,0) [0|3] ""  ADAS
 SG_ DET_CONFD_ELEVATION_110 : 213|2@1+ (1,0) [0|3] ""  ADAS
 SG_ DET_PROB_1STAZHYPO_110 : 215|1@1+ (1,0) [0|1] ""  ADAS
 SG_ DET_IDM_110 : 175|1@1+ (1,0) [0|1] ""  ADAS
 SG_ DET_MTD_110 : 159|1@1+ (1,0) [0|1] ""  ADAS
 SG_ DET_BELOW_RAIN_THOLD_110 : 151|1@1+ (1,0) [0|1] ""  ADAS
 SG_ DET_RANGE_111 : 248|15@1+ (0.015625,0) [0|500] "m"  ADAS
 SG_ DET_RANGE_ERR_111 : 264|7@1+ (0.0075,0) [0|0.9525] "m"  ADAS
 SG_ DET_RANGE_VELOCITY_111 : 272|15@1+ (0.0078125,-128) [-128|127.9921875] "m/s"  ADAS
 SG_ DET_RANGE_VELOCITY_ERR_111 : 288|8@1+ (0.003,0) [0|0.765] "m/s"  ADAS
 SG_ DET_AZIMUTH_111 : 312|13@1+ (0.0004,-1.5708) [-1.5708|1.5708] "rad"  ADAS
 SG_ DET_AZIMUTH_ERR_111 : 329|7@1+ (0.00087267,0) [0|0.11082909] "rad"  ADAS
 SG_ DET_ELEVATION_111 : 296|8@1+ (0.00275,-0.34925) [-0.34925|0.34925] "rad"  ADAS
 SG_ DET_ELEVATION_ERR_111 : 304|6@1+ (0.00174533,0) [0|0.10995579] "rad"  ADAS
 SG_ DET_RCS_111 : 352|8@1+ (0.5,-64) [-64|63.5] "dBsm"  ADAS
 SG_ DET_BI_STATIC_FLAG_111 : 328|1@1+ (1,0) [0|1] ""  ADAS
 SG_ DET_SUPER_RES_TARGET_111 : 311|1@1+ (1,0) [0|1] ""  ADAS
 SG_ DET_SNR_111 : 344|8@1+ (0.35156,0) [0|89.6478] "dB"  ADAS
 SG_ DET_EXISTENCE_PROB_111 : 336|6@1+ (1.588,0) [0|100] "%"  ADAS
 SG_ DET_HVC_FLAG_111 : 310|1@1+ (1,0) [0|1] ""  ADAS
 SG_ DET_CONFD_AZIMUTH_111 : 342|2@1+ (1,0) [0|3] ""  ADAS
 SG_ DET_CONFD_ELEVATION_111 : 325|2@1+ (1,0) [0|3] ""  ADAS
 SG_ DET_PROB_1STAZHYPO_111 : 327|1@1+ (1,0) [0|1] ""  ADAS
 SG_ DET_IDM_111 : 287|1@1+ (1,0) [0|1] ""  ADAS
 SG_ DET_MTD_111 : 271|1@1+ (1,0) [0|1] ""  ADAS
 SG_ DET_BELOW_RAIN_THOLD_111 : 263|1@1+ (1,0) [0|1] ""  ADAS
 SG_ DET_RANGE_112 : 360|15@1+ (0.015625,0) [0|500] "m"  ADAS
 SG_ DET_RANGE_ERR_112 : 376|7@1+ (0.0075,0) [0|0.9525] "m"  ADAS
 SG_ DET_RANGE_VELOCITY_112 : 384|15@1+ (0.0078125,-128) [-128|127.9921875] "m/s"  ADAS
 SG_ DET_RANGE_VELOCITY_ERR_112 : 400|8@1+ (0.003,0) [0|0.765] "m/s"  ADAS
 SG_ DET_AZIMUTH_112 : 424|13@1+ (0.0004,-1.5708) [-1.5708|1.5708] "rad"  ADAS
 SG_ DET_AZIMUTH_ERR_112 : 441|7@1+ (0.00087267,0) [0|0.11082909] "rad"  ADAS
 SG_ DET_ELEVATION_112 : 408|8@1+ (0.00275,-0.34925) [-0.34925|0.34925] "rad"  ADAS
 SG_ DET_ELEVATION_ERR_112 : 416|6@1+ (0.00174533,0) [0|0.10995579] "rad"  ADAS
 SG_ DET_RCS_112 : 464|8@1+ (0.5,-64) [-64|63.5] "dBsm"  ADAS
 SG_ DET_BI_STATIC_FLAG_112 : 440|1@1+ (1,0) [0|1] ""  ADAS
 SG_ DET_SUPER_RES_TARGET_112 : 423|1@1+ (1,0) [0|1] ""  ADAS
 SG_ DET_SNR_112 : 456|8@1+ (0.35156,0) [0|89.6478] "dB"  ADAS
 SG_ DET_EXISTENCE_PROB_112 : 448|6@1+ (1.588,0) [0|100] "%"  ADAS
 SG_ DET_HVC_FLAG_112 : 422|1@1+ (1,0) [0|1] ""  ADAS
 SG_ DET_CONFD_AZIMUTH_112 : 454|2@1+ (1,0) [0|3] ""  ADAS
 SG_ DET_CONFD_ELEVATION_112 : 437|2@1+ (1,0) [0|3] ""  ADAS
 SG_ DET_MH_SCAN_INDEX_4LSB_109_112 : 476|4@1+ (1,0) [0|15] ""  ADAS
 SG_ DET_MH_CYCLE_COUNTER_109_112 : 16|8@1+ (1,0) [0|255] ""  ADAS
 SG_ DET_MH_CRC16_109_112 : 0|16@1+ (1,0) [0|65535] ""  ADAS
 SG_ DET_PROB_1STAZHYPO_112 : 439|1@1+ (1,0) [0|1] ""  ADAS
 SG_ DET_IDM_112 : 399|1@1+ (1,0) [0|1] ""  ADAS
 SG_ DET_MTD_112 : 383|1@1+ (1,0) [0|1] ""  ADAS
 SG_ DET_BELOW_RAIN_THOLD_112 : 375|1@1+ (1,0) [0|1] ""  ADAS

BO_ 1052 RDR_DETECTION_113_116: 64 RDR07
 SG_ DET_RANGE_113 : 24|15@1+ (0.015625,0) [0|500] "m"  ADAS
 SG_ DET_RANGE_ERR_113 : 40|7@1+ (0.0075,0) [0|0.9525] "m"  ADAS
 SG_ DET_RANGE_VELOCITY_113 : 48|15@1+ (0.0078125,-128) [-128|127.9921875] "m/s"  ADAS
 SG_ DET_RANGE_VELOCITY_ERR_113 : 64|8@1+ (0.003,0) [0|0.765] "m/s"  ADAS
 SG_ DET_AZIMUTH_113 : 88|13@1+ (0.0004,-1.5708) [-1.5708|1.5708] "rad"  ADAS
 SG_ DET_AZIMUTH_ERR_113 : 105|7@1+ (0.00087267,0) [0|0.11082909] "rad"  ADAS
 SG_ DET_ELEVATION_113 : 72|8@1+ (0.00275,-0.34925) [-0.34925|0.34925] "rad"  ADAS
 SG_ DET_ELEVATION_ERR_113 : 80|6@1+ (0.00174533,0) [0|0.10995579] "rad"  ADAS
 SG_ DET_RCS_113 : 128|8@1+ (0.5,-64) [-64|63.5] "dBsm"  ADAS
 SG_ DET_BI_STATIC_FLAG_113 : 104|1@1+ (1,0) [0|1] ""  ADAS
 SG_ DET_SUPER_RES_TARGET_113 : 87|1@1+ (1,0) [0|1] ""  ADAS
 SG_ DET_SNR_113 : 120|8@1+ (0.35156,0) [0|89.6478] "dB"  ADAS
 SG_ DET_EXISTENCE_PROB_113 : 112|6@1+ (1.588,0) [0|100] "%"  ADAS
 SG_ DET_HVC_FLAG_113 : 86|1@1+ (1,0) [0|1] ""  ADAS
 SG_ DET_CONFD_AZIMUTH_113 : 118|2@1+ (1,0) [0|3] ""  ADAS
 SG_ DET_CONFD_ELEVATION_113 : 101|2@1+ (1,0) [0|3] ""  ADAS
 SG_ DET_PROB_1STAZHYPO_113 : 103|1@1+ (1,0) [0|1] ""  ADAS
 SG_ DET_IDM_113 : 63|1@1+ (1,0) [0|1] ""  ADAS
 SG_ DET_MTD_113 : 47|1@1+ (1,0) [0|1] ""  ADAS
 SG_ DET_BELOW_RAIN_THOLD_113 : 39|1@1+ (1,0) [0|1] ""  ADAS
 SG_ DET_RANGE_114 : 136|15@1+ (0.015625,0) [0|500] "m"  ADAS
 SG_ DET_RANGE_ERR_114 : 152|7@1+ (0.0075,0) [0|0.9525] "m"  ADAS
 SG_ DET_RANGE_VELOCITY_114 : 160|15@1+ (0.0078125,-128) [-128|127.9921875] "m/s"  ADAS
 SG_ DET_RANGE_VELOCITY_ERR_114 : 176|8@1+ (0.003,0) [0|0.765] "m/s"  ADAS
 SG_ DET_AZIMUTH_114 : 200|13@1+ (0.0004,-1.5708) [-1.5708|1.5708] "rad"  ADAS
 SG_ DET_AZIMUTH_ERR_114 : 217|7@1+ (0.00087267,0) [0|0.11082909] "rad"  ADAS
 SG_ DET_ELEVATION_114 : 184|8@1+ (0.00275,-0.34925) [-0.34925|0.34925] "rad"  ADAS
 SG_ DET_ELEVATION_ERR_114 : 192|6@1+ (0.00174533,0) [0|0.10995579] "rad"  ADAS
 SG_ DET_RCS_114 : 240|8@1+ (0.5,-64) [-64|63.5] "dBsm"  ADAS
 SG_ DET_BI_STATIC_FLAG_114 : 216|1@1+ (1,0) [0|1] ""  ADAS
 SG_ DET_SUPER_RES_TARGET_114 : 199|1@1+ (1,0) [0|1] ""  ADAS
 SG_ DET_SNR_114 : 232|8@1+ (0.35156,0) [0|89.6478] "dB"  ADAS
 SG_ DET_EXISTENCE_PROB_114 : 224|6@1+ (1.588,0) [0|100] "%"  ADAS
 SG_ DET_HVC_FLAG_114 : 198|1@1+ (1,0) [0|1] ""  ADAS
 SG_ DET_CONFD_AZIMUTH_114 : 230|2@1+ (1,0) [0|3] ""  ADAS
 SG_ DET_CONFD_ELEVATION_114 : 213|2@1+ (1,0) [0|3] ""  ADAS
 SG_ DET_PROB_1STAZHYPO_114 : 215|1@1+ (1,0) [0|1] ""  ADAS
 SG_ DET_IDM_114 : 175|1@1+ (1,0) [0|1] ""  ADAS
 SG_ DET_MTD_114 : 159|1@1+ (1,0) [0|1] ""  ADAS
 SG_ DET_BELOW_RAIN_THOLD_114 : 151|1@1+ (1,0) [0|1] ""  ADAS
 SG_ DET_RANGE_115 : 248|15@1+ (0.015625,0) [0|500] "m"  ADAS
 SG_ DET_RANGE_ERR_115 : 264|7@1+ (0.0075,0) [0|0.9525] "m"  ADAS
 SG_ DET_RANGE_VELOCITY_115 : 272|15@1+ (0.0078125,-128) [-128|127.9921875] "m/s"  ADAS
 SG_ DET_RANGE_VELOCITY_ERR_115 : 288|8@1+ (0.003,0) [0|0.765] "m/s"  ADAS
 SG_ DET_AZIMUTH_115 : 312|13@1+ (0.0004,-1.5708) [-1.5708|1.5708] "rad"  ADAS
 SG_ DET_AZIMUTH_ERR_115 : 329|7@1+ (0.00087267,0) [0|0.11082909] "rad"  ADAS
 SG_ DET_ELEVATION_115 : 296|8@1+ (0.00275,-0.34925) [-0.34925|0.34925] "rad"  ADAS
 SG_ DET_ELEVATION_ERR_115 : 304|6@1+ (0.00174533,0) [0|0.10995579] "rad"  ADAS
 SG_ DET_RCS_115 : 352|8@1+ (0.5,-64) [-64|63.5] "dBsm"  ADAS
 SG_ DET_BI_STATIC_FLAG_115 : 328|1@1+ (1,0) [0|1] ""  ADAS
 SG_ DET_SUPER_RES_TARGET_115 : 311|1@1+ (1,0) [0|1] ""  ADAS
 SG_ DET_SNR_115 : 344|8@1+ (0.35156,0) [0|89.6478] "dB"  ADAS
 SG_ DET_EXISTENCE_PROB_115 : 336|6@1+ (1.588,0) [0|100] "%"  ADAS
 SG_ DET_HVC_FLAG_115 : 310|1@1+ (1,0) [0|1] ""  ADAS
 SG_ DET_CONFD_AZIMUTH_115 : 342|2@1+ (1,0) [0|3] ""  ADAS
 SG_ DET_CONFD_ELEVATION_115 : 325|2@1+ (1,0) [0|3] ""  ADAS
 SG_ DET_PROB_1STAZHYPO_115 : 327|1@1+ (1,0) [0|1] ""  ADAS
 SG_ DET_IDM_115 : 287|1@1+ (1,0) [0|1] ""  ADAS
 SG_ DET_MTD_115 : 271|1@1+ (1,0) [0|1] ""  ADAS
 SG_ DET_BELOW_RAIN_THOLD_115 : 263|1@1+ (1,0) [0|1] ""  ADAS
 SG_ DET_RANGE_116 : 360|15@1+ (0.015625,0) [0|500] "m"  ADAS
 SG_ DET_RANGE_ERR_116 : 376|7@1+ (0.0075,0) [0|0.9525] "m"  ADAS
 SG_ DET_RANGE_VELOCITY_116 : 384|15@1+ (0.0078125,-128) [-128|127.9921875] "m/s"  ADAS
 SG_ DET_RANGE_VELOCITY_ERR_116 : 400|8@1+ (0.003,0) [0|0.765] "m/s"  ADAS
 SG_ DET_AZIMUTH_116 : 424|13@1+ (0.0004,-1.5708) [-1.5708|1.5708] "rad"  ADAS
 SG_ DET_AZIMUTH_ERR_116 : 441|7@1+ (0.00087267,0) [0|0.11082909] "rad"  ADAS
 SG_ DET_ELEVATION_116 : 408|8@1+ (0.00275,-0.34925) [-0.34925|0.34925] "rad"  ADAS
 SG_ DET_ELEVATION_ERR_116 : 416|6@1+ (0.00174533,0) [0|0.10995579] "rad"  ADAS
 SG_ DET_RCS_116 : 464|8@1+ (0.5,-64) [-64|63.5] "dBsm"  ADAS
 SG_ DET_BI_STATIC_FLAG_116 : 440|1@1+ (1,0) [0|1] ""  ADAS
 SG_ DET_SUPER_RES_TARGET_116 : 423|1@1+ (1,0) [0|1] ""  ADAS
 SG_ DET_SNR_116 : 456|8@1+ (0.35156,0) [0|89.6478] "dB"  ADAS
 SG_ DET_EXISTENCE_PROB_116 : 448|6@1+ (1.588,0) [0|100] "%"  ADAS
 SG_ DET_HVC_FLAG_116 : 422|1@1+ (1,0) [0|1] ""  ADAS
 SG_ DET_CONFD_AZIMUTH_116 : 454|2@1+ (1,0) [0|3] ""  ADAS
 SG_ DET_CONFD_ELEVATION_116 : 437|2@1+ (1,0) [0|3] ""  ADAS
 SG_ DET_MH_SCAN_INDEX_4LSB_113_116 : 476|4@1+ (1,0) [0|15] ""  ADAS
 SG_ DET_MH_CYCLE_COUNTER_113_116 : 16|8@1+ (1,0) [0|255] ""  ADAS
 SG_ DET_MH_CRC16_113_116 : 0|16@1+ (1,0) [0|65535] ""  ADAS
 SG_ DET_PROB_1STAZHYPO_116 : 439|1@1+ (1,0) [0|1] ""  ADAS
 SG_ DET_IDM_116 : 399|1@1+ (1,0) [0|1] ""  ADAS
 SG_ DET_MTD_116 : 383|1@1+ (1,0) [0|1] ""  ADAS
 SG_ DET_BELOW_RAIN_THOLD_116 : 375|1@1+ (1,0) [0|1] ""  ADAS

BO_ 1053 RDR_DETECTION_117_120: 64 RDR07
 SG_ DET_RANGE_117 : 24|15@1+ (0.015625,0) [0|500] "m"  ADAS
 SG_ DET_RANGE_ERR_117 : 40|7@1+ (0.0075,0) [0|0.9525] "m"  ADAS
 SG_ DET_RANGE_VELOCITY_117 : 48|15@1+ (0.0078125,-128) [-128|127.9921875] "m/s"  ADAS
 SG_ DET_RANGE_VELOCITY_ERR_117 : 64|8@1+ (0.003,0) [0|0.765] "m/s"  ADAS
 SG_ DET_AZIMUTH_117 : 88|13@1+ (0.0004,-1.5708) [-1.5708|1.5708] "rad"  ADAS
 SG_ DET_AZIMUTH_ERR_117 : 105|7@1+ (0.00087267,0) [0|0.11082909] "rad"  ADAS
 SG_ DET_ELEVATION_117 : 72|8@1+ (0.00275,-0.34925) [-0.34925|0.34925] "rad"  ADAS
 SG_ DET_ELEVATION_ERR_117 : 80|6@1+ (0.00174533,0) [0|0.10995579] "rad"  ADAS
 SG_ DET_RCS_117 : 128|8@1+ (0.5,-64) [-64|63.5] "dBsm"  ADAS
 SG_ DET_BI_STATIC_FLAG_117 : 104|1@1+ (1,0) [0|1] ""  ADAS
 SG_ DET_SUPER_RES_TARGET_117 : 87|1@1+ (1,0) [0|1] ""  ADAS
 SG_ DET_SNR_117 : 120|8@1+ (0.35156,0) [0|89.6478] "dB"  ADAS
 SG_ DET_EXISTENCE_PROB_117 : 112|6@1+ (1.588,0) [0|100] "%"  ADAS
 SG_ DET_HVC_FLAG_117 : 86|1@1+ (1,0) [0|1] ""  ADAS
 SG_ DET_CONFD_AZIMUTH_117 : 118|2@1+ (1,0) [0|3] ""  ADAS
 SG_ DET_CONFD_ELEVATION_117 : 101|2@1+ (1,0) [0|3] ""  ADAS
 SG_ DET_PROB_1STAZHYPO_117 : 103|1@1+ (1,0) [0|1] ""  ADAS
 SG_ DET_IDM_117 : 63|1@1+ (1,0) [0|1] ""  ADAS
 SG_ DET_MTD_117 : 47|1@1+ (1,0) [0|1] ""  ADAS
 SG_ DET_BELOW_RAIN_THOLD_117 : 39|1@1+ (1,0) [0|1] ""  ADAS
 SG_ DET_RANGE_118 : 136|15@1+ (0.015625,0) [0|500] "m"  ADAS
 SG_ DET_RANGE_ERR_118 : 152|7@1+ (0.0075,0) [0|0.9525] "m"  ADAS
 SG_ DET_RANGE_VELOCITY_118 : 160|15@1+ (0.0078125,-128) [-128|127.9921875] "m/s"  ADAS
 SG_ DET_RANGE_VELOCITY_ERR_118 : 176|8@1+ (0.003,0) [0|0.765] "m/s"  ADAS
 SG_ DET_AZIMUTH_118 : 200|13@1+ (0.0004,-1.5708) [-1.5708|1.5708] "rad"  ADAS
 SG_ DET_AZIMUTH_ERR_118 : 217|7@1+ (0.00087267,0) [0|0.11082909] "rad"  ADAS
 SG_ DET_ELEVATION_118 : 184|8@1+ (0.00275,-0.34925) [-0.34925|0.34925] "rad"  ADAS
 SG_ DET_ELEVATION_ERR_118 : 192|6@1+ (0.00174533,0) [0|0.10995579] "rad"  ADAS
 SG_ DET_RCS_118 : 240|8@1+ (0.5,-64) [-64|63.5] "dBsm"  ADAS
 SG_ DET_BI_STATIC_FLAG_118 : 216|1@1+ (1,0) [0|1] ""  ADAS
 SG_ DET_SUPER_RES_TARGET_118 : 199|1@1+ (1,0) [0|1] ""  ADAS
 SG_ DET_SNR_118 : 232|8@1+ (0.35156,0) [0|89.6478] "dB"  ADAS
 SG_ DET_EXISTENCE_PROB_118 : 224|6@1+ (1.588,0) [0|100] "%"  ADAS
 SG_ DET_HVC_FLAG_118 : 198|1@1+ (1,0) [0|1] ""  ADAS
 SG_ DET_CONFD_AZIMUTH_118 : 230|2@1+ (1,0) [0|3] ""  ADAS
 SG_ DET_CONFD_ELEVATION_118 : 213|2@1+ (1,0) [0|3] ""  ADAS
 SG_ DET_PROB_1STAZHYPO_118 : 215|1@1+ (1,0) [0|1] ""  ADAS
 SG_ DET_IDM_118 : 175|1@1+ (1,0) [0|1] ""  ADAS
 SG_ DET_MTD_118 : 159|1@1+ (1,0) [0|1] ""  ADAS
 SG_ DET_BELOW_RAIN_THOLD_118 : 151|1@1+ (1,0) [0|1] ""  ADAS
 SG_ DET_RANGE_119 : 248|15@1+ (0.015625,0) [0|500] "m"  ADAS
 SG_ DET_RANGE_ERR_119 : 264|7@1+ (0.0075,0) [0|0.9525] "m"  ADAS
 SG_ DET_RANGE_VELOCITY_119 : 272|15@1+ (0.0078125,-128) [-128|127.9921875] "m/s"  ADAS
 SG_ DET_RANGE_VELOCITY_ERR_119 : 288|8@1+ (0.003,0) [0|0.765] "m/s"  ADAS
 SG_ DET_AZIMUTH_119 : 312|13@1+ (0.0004,-1.5708) [-1.5708|1.5708] "rad"  ADAS
 SG_ DET_AZIMUTH_ERR_119 : 329|7@1+ (0.00087267,0) [0|0.11082909] "rad"  ADAS
 SG_ DET_ELEVATION_119 : 296|8@1+ (0.00275,-0.34925) [-0.34925|0.34925] "rad"  ADAS
 SG_ DET_ELEVATION_ERR_119 : 304|6@1+ (0.00174533,0) [0|0.10995579] "rad"  ADAS
 SG_ DET_RCS_119 : 352|8@1+ (0.5,-64) [-64|63.5] "dBsm"  ADAS
 SG_ DET_BI_STATIC_FLAG_119 : 328|1@1+ (1,0) [0|1] ""  ADAS
 SG_ DET_SUPER_RES_TARGET_119 : 311|1@1+ (1,0) [0|1] ""  ADAS
 SG_ DET_SNR_119 : 344|8@1+ (0.35156,0) [0|89.6478] "dB"  ADAS
 SG_ DET_EXISTENCE_PROB_119 : 336|6@1+ (1.588,0) [0|100] "%"  ADAS
 SG_ DET_HVC_FLAG_119 : 310|1@1+ (1,0) [0|1] ""  ADAS
 SG_ DET_CONFD_AZIMUTH_119 : 342|2@1+ (1,0) [0|3] ""  ADAS
 SG_ DET_CONFD_ELEVATION_119 : 325|2@1+ (1,0) [0|3] ""  ADAS
 SG_ DET_PROB_1STAZHYPO_119 : 327|1@1+ (1,0) [0|1] ""  ADAS
 SG_ DET_IDM_119 : 287|1@1+ (1,0) [0|1] ""  ADAS
 SG_ DET_MTD_119 : 271|1@1+ (1,0) [0|1] ""  ADAS
 SG_ DET_BELOW_RAIN_THOLD_119 : 263|1@1+ (1,0) [0|1] ""  ADAS
 SG_ DET_RANGE_120 : 360|15@1+ (0.015625,0) [0|500] "m"  ADAS
 SG_ DET_RANGE_ERR_120 : 376|7@1+ (0.0075,0) [0|0.9525] "m"  ADAS
 SG_ DET_RANGE_VELOCITY_120 : 384|15@1+ (0.0078125,-128) [-128|127.9921875] "m/s"  ADAS
 SG_ DET_RANGE_VELOCITY_ERR_120 : 400|8@1+ (0.003,0) [0|0.765] "m/s"  ADAS
 SG_ DET_AZIMUTH_120 : 424|13@1+ (0.0004,-1.5708) [-1.5708|1.5708] "rad"  ADAS
 SG_ DET_AZIMUTH_ERR_120 : 441|7@1+ (0.00087267,0) [0|0.11082909] "rad"  ADAS
 SG_ DET_ELEVATION_120 : 408|8@1+ (0.00275,-0.34925) [-0.34925|0.34925] "rad"  ADAS
 SG_ DET_ELEVATION_ERR_120 : 416|6@1+ (0.00174533,0) [0|0.10995579] "rad"  ADAS
 SG_ DET_RCS_120 : 464|8@1+ (0.5,-64) [-64|63.5] "dBsm"  ADAS
 SG_ DET_BI_STATIC_FLAG_120 : 440|1@1+ (1,0) [0|1] ""  ADAS
 SG_ DET_SUPER_RES_TARGET_120 : 423|1@1+ (1,0) [0|1] ""  ADAS
 SG_ DET_SNR_120 : 456|8@1+ (0.35156,0) [0|89.6478] "dB"  ADAS
 SG_ DET_EXISTENCE_PROB_120 : 448|6@1+ (1.588,0) [0|100] "%"  ADAS
 SG_ DET_HVC_FLAG_120 : 422|1@1+ (1,0) [0|1] ""  ADAS
 SG_ DET_CONFD_AZIMUTH_120 : 454|2@1+ (1,0) [0|3] ""  ADAS
 SG_ DET_CONFD_ELEVATION_120 : 437|2@1+ (1,0) [0|3] ""  ADAS
 SG_ DET_MH_SCAN_INDEX_4LSB_117_120 : 476|4@1+ (1,0) [0|15] ""  ADAS
 SG_ DET_MH_CYCLE_COUNTER_117_120 : 16|8@1+ (1,0) [0|255] ""  ADAS
 SG_ DET_MH_CRC16_117_120 : 0|16@1+ (1,0) [0|65535] ""  ADAS
 SG_ DET_PROB_1STAZHYPO_120 : 439|1@1+ (1,0) [0|1] ""  ADAS
 SG_ DET_IDM_120 : 399|1@1+ (1,0) [0|1] ""  ADAS
 SG_ DET_MTD_120 : 383|1@1+ (1,0) [0|1] ""  ADAS
 SG_ DET_BELOW_RAIN_THOLD_120 : 375|1@1+ (1,0) [0|1] ""  ADAS

BO_ 1054 RDR_DETECTION_121_124: 64 RDR07
 SG_ DET_RANGE_121 : 24|15@1+ (0.015625,0) [0|500] "m"  ADAS
 SG_ DET_RANGE_ERR_121 : 40|7@1+ (0.0075,0) [0|0.9525] "m"  ADAS
 SG_ DET_RANGE_VELOCITY_121 : 48|15@1+ (0.0078125,-128) [-128|127.9921875] "m/s"  ADAS
 SG_ DET_RANGE_VELOCITY_ERR_121 : 64|8@1+ (0.003,0) [0|0.765] "m/s"  ADAS
 SG_ DET_AZIMUTH_121 : 88|13@1+ (0.0004,-1.5708) [-1.5708|1.5708] "rad"  ADAS
 SG_ DET_AZIMUTH_ERR_121 : 105|7@1+ (0.00087267,0) [0|0.11082909] "rad"  ADAS
 SG_ DET_ELEVATION_121 : 72|8@1+ (0.00275,-0.34925) [-0.34925|0.34925] "rad"  ADAS
 SG_ DET_ELEVATION_ERR_121 : 80|6@1+ (0.00174533,0) [0|0.10995579] "rad"  ADAS
 SG_ DET_RCS_121 : 128|8@1+ (0.5,-64) [-64|63.5] "dBsm"  ADAS
 SG_ DET_BI_STATIC_FLAG_121 : 104|1@1+ (1,0) [0|1] ""  ADAS
 SG_ DET_SUPER_RES_TARGET_121 : 87|1@1+ (1,0) [0|1] ""  ADAS
 SG_ DET_SNR_121 : 120|8@1+ (0.35156,0) [0|89.6478] "dB"  ADAS
 SG_ DET_EXISTENCE_PROB_121 : 112|6@1+ (1.588,0) [0|100] "%"  ADAS
 SG_ DET_HVC_FLAG_121 : 86|1@1+ (1,0) [0|1] ""  ADAS
 SG_ DET_CONFD_AZIMUTH_121 : 118|2@1+ (1,0) [0|3] ""  ADAS
 SG_ DET_CONFD_ELEVATION_121 : 101|2@1+ (1,0) [0|3] ""  ADAS
 SG_ DET_PROB_1STAZHYPO_121 : 103|1@1+ (1,0) [0|1] ""  ADAS
 SG_ DET_IDM_121 : 63|1@1+ (1,0) [0|1] ""  ADAS
 SG_ DET_MTD_121 : 47|1@1+ (1,0) [0|1] ""  ADAS
 SG_ DET_BELOW_RAIN_THOLD_121 : 39|1@1+ (1,0) [0|1] ""  ADAS
 SG_ DET_RANGE_122 : 136|15@1+ (0.015625,0) [0|500] "m"  ADAS
 SG_ DET_RANGE_ERR_122 : 152|7@1+ (0.0075,0) [0|0.9525] "m"  ADAS
 SG_ DET_RANGE_VELOCITY_122 : 160|15@1+ (0.0078125,-128) [-128|127.9921875] "m/s"  ADAS
 SG_ DET_RANGE_VELOCITY_ERR_122 : 176|8@1+ (0.003,0) [0|0.765] "m/s"  ADAS
 SG_ DET_AZIMUTH_122 : 200|13@1+ (0.0004,-1.5708) [-1.5708|1.5708] "rad"  ADAS
 SG_ DET_AZIMUTH_ERR_122 : 217|7@1+ (0.00087267,0) [0|0.11082909] "rad"  ADAS
 SG_ DET_ELEVATION_122 : 184|8@1+ (0.00275,-0.34925) [-0.34925|0.34925] "rad"  ADAS
 SG_ DET_ELEVATION_ERR_122 : 192|6@1+ (0.00174533,0) [0|0.10995579] "rad"  ADAS
 SG_ DET_RCS_122 : 240|8@1+ (0.5,-64) [-64|63.5] "dBsm"  ADAS
 SG_ DET_BI_STATIC_FLAG_122 : 216|1@1+ (1,0) [0|1] ""  ADAS
 SG_ DET_SUPER_RES_TARGET_122 : 199|1@1+ (1,0) [0|1] ""  ADAS
 SG_ DET_SNR_122 : 232|8@1+ (0.35156,0) [0|89.6478] "dB"  ADAS
 SG_ DET_EXISTENCE_PROB_122 : 224|6@1+ (1.588,0) [0|100] "%"  ADAS
 SG_ DET_HVC_FLAG_122 : 198|1@1+ (1,0) [0|1] ""  ADAS
 SG_ DET_CONFD_AZIMUTH_122 : 230|2@1+ (1,0) [0|3] ""  ADAS
 SG_ DET_CONFD_ELEVATION_122 : 213|2@1+ (1,0) [0|3] ""  ADAS
 SG_ DET_PROB_1STAZHYPO_122 : 215|1@1+ (1,0) [0|1] ""  ADAS
 SG_ DET_IDM_122 : 175|1@1+ (1,0) [0|1] ""  ADAS
 SG_ DET_MTD_122 : 159|1@1+ (1,0) [0|1] ""  ADAS
 SG_ DET_BELOW_RAIN_THOLD_122 : 151|1@1+ (1,0) [0|1] ""  ADAS
 SG_ DET_RANGE_123 : 248|15@1+ (0.015625,0) [0|500] "m"  ADAS
 SG_ DET_RANGE_ERR_123 : 264|7@1+ (0.0075,0) [0|0.9525] "m"  ADAS
 SG_ DET_RANGE_VELOCITY_123 : 272|15@1+ (0.0078125,-128) [-128|127.9921875] "m/s"  ADAS
 SG_ DET_RANGE_VELOCITY_ERR_123 : 288|8@1+ (0.003,0) [0|0.765] "m/s"  ADAS
 SG_ DET_AZIMUTH_123 : 312|13@1+ (0.0004,-1.5708) [-1.5708|1.5708] "rad"  ADAS
 SG_ DET_AZIMUTH_ERR_123 : 329|7@1+ (0.00087267,0) [0|0.11082909] "rad"  ADAS
 SG_ DET_ELEVATION_123 : 296|8@1+ (0.00275,-0.34925) [-0.34925|0.34925] "rad"  ADAS
 SG_ DET_ELEVATION_ERR_123 : 304|6@1+ (0.00174533,0) [0|0.10995579] "rad"  ADAS
 SG_ DET_RCS_123 : 352|8@1+ (0.5,-64) [-64|63.5] "dBsm"  ADAS
 SG_ DET_BI_STATIC_FLAG_123 : 328|1@1+ (1,0) [0|1] ""  ADAS
 SG_ DET_SUPER_RES_TARGET_123 : 311|1@1+ (1,0) [0|1] ""  ADAS
 SG_ DET_SNR_123 : 344|8@1+ (0.35156,0) [0|89.6478] "dB"  ADAS
 SG_ DET_EXISTENCE_PROB_123 : 336|6@1+ (1.588,0) [0|100] "%"  ADAS
 SG_ DET_HVC_FLAG_123 : 310|1@1+ (1,0) [0|1] ""  ADAS
 SG_ DET_CONFD_AZIMUTH_123 : 342|2@1+ (1,0) [0|3] ""  ADAS
 SG_ DET_CONFD_ELEVATION_123 : 325|2@1+ (1,0) [0|3] ""  ADAS
 SG_ DET_PROB_1STAZHYPO_123 : 327|1@1+ (1,0) [0|1] ""  ADAS
 SG_ DET_IDM_123 : 287|1@1+ (1,0) [0|1] ""  ADAS
 SG_ DET_MTD_123 : 271|1@1+ (1,0) [0|1] ""  ADAS
 SG_ DET_BELOW_RAIN_THOLD_123 : 263|1@1+ (1,0) [0|1] ""  ADAS
 SG_ DET_RANGE_124 : 360|15@1+ (0.015625,0) [0|500] "m"  ADAS
 SG_ DET_RANGE_ERR_124 : 376|7@1+ (0.0075,0) [0|0.9525] "m"  ADAS
 SG_ DET_RANGE_VELOCITY_124 : 384|15@1+ (0.0078125,-128) [-128|127.9921875] "m/s"  ADAS
 SG_ DET_RANGE_VELOCITY_ERR_124 : 400|8@1+ (0.003,0) [0|0.765] "m/s"  ADAS
 SG_ DET_AZIMUTH_124 : 424|13@1+ (0.0004,-1.5708) [-1.5708|1.5708] "rad"  ADAS
 SG_ DET_AZIMUTH_ERR_124 : 441|7@1+ (0.00087267,0) [0|0.11082909] "rad"  ADAS
 SG_ DET_ELEVATION_124 : 408|8@1+ (0.00275,-0.34925) [-0.34925|0.34925] "rad"  ADAS
 SG_ DET_ELEVATION_ERR_124 : 416|6@1+ (0.00174533,0) [0|0.10995579] "rad"  ADAS
 SG_ DET_RCS_124 : 464|8@1+ (0.5,-64) [-64|63.5] "dBsm"  ADAS
 SG_ DET_BI_STATIC_FLAG_124 : 440|1@1+ (1,0) [0|1] ""  ADAS
 SG_ DET_SUPER_RES_TARGET_124 : 423|1@1+ (1,0) [0|1] ""  ADAS
 SG_ DET_SNR_124 : 456|8@1+ (0.35156,0) [0|89.6478] "dB"  ADAS
 SG_ DET_EXISTENCE_PROB_124 : 448|6@1+ (1.588,0) [0|100] "%"  ADAS
 SG_ DET_HVC_FLAG_124 : 422|1@1+ (1,0) [0|1] ""  ADAS
 SG_ DET_CONFD_AZIMUTH_124 : 454|2@1+ (1,0) [0|3] ""  ADAS
 SG_ DET_CONFD_ELEVATION_124 : 437|2@1+ (1,0) [0|3] ""  ADAS
 SG_ DET_MH_SCAN_INDEX_4LSB_121_124 : 476|4@1+ (1,0) [0|15] ""  ADAS
 SG_ DET_MH_CYCLE_COUNTER_121_124 : 16|8@1+ (1,0) [0|255] ""  ADAS
 SG_ DET_MH_CRC16_121_124 : 0|16@1+ (1,0) [0|65535] ""  ADAS
 SG_ DET_PROB_1STAZHYPO_124 : 439|1@1+ (1,0) [0|1] ""  ADAS
 SG_ DET_IDM_124 : 399|1@1+ (1,0) [0|1] ""  ADAS
 SG_ DET_MTD_124 : 383|1@1+ (1,0) [0|1] ""  ADAS
 SG_ DET_BELOW_RAIN_THOLD_124 : 375|1@1+ (1,0) [0|1] ""  ADAS

BO_ 1055 RDR_DETECTION_125_128: 64 RDR07
 SG_ DET_RANGE_125 : 24|15@1+ (0.015625,0) [0|500] "m"  ADAS
 SG_ DET_RANGE_ERR_125 : 40|7@1+ (0.0075,0) [0|0.9525] "m"  ADAS
 SG_ DET_RANGE_VELOCITY_125 : 48|15@1+ (0.0078125,-128) [-128|127.9921875] "m/s"  ADAS
 SG_ DET_RANGE_VELOCITY_ERR_125 : 64|8@1+ (0.003,0) [0|0.765] "m/s"  ADAS
 SG_ DET_AZIMUTH_125 : 88|13@1+ (0.0004,-1.5708) [-1.5708|1.5708] "rad"  ADAS
 SG_ DET_AZIMUTH_ERR_125 : 105|7@1+ (0.00087267,0) [0|0.11082909] "rad"  ADAS
 SG_ DET_ELEVATION_125 : 72|8@1+ (0.00275,-0.34925) [-0.34925|0.34925] "rad"  ADAS
 SG_ DET_ELEVATION_ERR_125 : 80|6@1+ (0.00174533,0) [0|0.10995579] "rad"  ADAS
 SG_ DET_RCS_125 : 128|8@1+ (0.5,-64) [-64|63.5] "dBsm"  ADAS
 SG_ DET_BI_STATIC_FLAG_125 : 104|1@1+ (1,0) [0|1] ""  ADAS
 SG_ DET_SUPER_RES_TARGET_125 : 87|1@1+ (1,0) [0|1] ""  ADAS
 SG_ DET_SNR_125 : 120|8@1+ (0.35156,0) [0|89.6478] "dB"  ADAS
 SG_ DET_EXISTENCE_PROB_125 : 112|6@1+ (1.588,0) [0|100] "%"  ADAS
 SG_ DET_HVC_FLAG_125 : 86|1@1+ (1,0) [0|1] ""  ADAS
 SG_ DET_CONFD_AZIMUTH_125 : 118|2@1+ (1,0) [0|3] ""  ADAS
 SG_ DET_CONFD_ELEVATION_125 : 101|2@1+ (1,0) [0|3] ""  ADAS
 SG_ DET_PROB_1STAZHYPO_125 : 103|1@1+ (1,0) [0|1] ""  ADAS
 SG_ DET_IDM_125 : 63|1@1+ (1,0) [0|1] ""  ADAS
 SG_ DET_MTD_125 : 47|1@1+ (1,0) [0|1] ""  ADAS
 SG_ DET_BELOW_RAIN_THOLD_125 : 39|1@1+ (1,0) [0|1] ""  ADAS
 SG_ DET_RANGE_126 : 136|15@1+ (0.015625,0) [0|500] "m"  ADAS
 SG_ DET_RANGE_ERR_126 : 152|7@1+ (0.0075,0) [0|0.9525] "m"  ADAS
 SG_ DET_RANGE_VELOCITY_126 : 160|15@1+ (0.0078125,-128) [-128|127.9921875] "m/s"  ADAS
 SG_ DET_RANGE_VELOCITY_ERR_126 : 176|8@1+ (0.003,0) [0|0.765] "m/s"  ADAS
 SG_ DET_AZIMUTH_126 : 200|13@1+ (0.0004,-1.5708) [-1.5708|1.5708] "rad"  ADAS
 SG_ DET_AZIMUTH_ERR_126 : 217|7@1+ (0.00087267,0) [0|0.11082909] "rad"  ADAS
 SG_ DET_ELEVATION_126 : 184|8@1+ (0.00275,-0.34925) [-0.34925|0.34925] "rad"  ADAS
 SG_ DET_ELEVATION_ERR_126 : 192|6@1+ (0.00174533,0) [0|0.10995579] "rad"  ADAS
 SG_ DET_RCS_126 : 240|8@1+ (0.5,-64) [-64|63.5] "dBsm"  ADAS
 SG_ DET_BI_STATIC_FLAG_126 : 216|1@1+ (1,0) [0|1] ""  ADAS
 SG_ DET_SUPER_RES_TARGET_126 : 199|1@1+ (1,0) [0|1] ""  ADAS
 SG_ DET_SNR_126 : 232|8@1+ (0.35156,0) [0|89.6478] "dB"  ADAS
 SG_ DET_EXISTENCE_PROB_126 : 224|6@1+ (1.588,0) [0|100] "%"  ADAS
 SG_ DET_HVC_FLAG_126 : 198|1@1+ (1,0) [0|1] ""  ADAS
 SG_ DET_CONFD_AZIMUTH_126 : 230|2@1+ (1,0) [0|3] ""  ADAS
 SG_ DET_CONFD_ELEVATION_126 : 213|2@1+ (1,0) [0|3] ""  ADAS
 SG_ DET_PROB_1STAZHYPO_126 : 215|1@1+ (1,0) [0|1] ""  ADAS
 SG_ DET_IDM_126 : 175|1@1+ (1,0) [0|1] ""  ADAS
 SG_ DET_MTD_126 : 159|1@1+ (1,0) [0|1] ""  ADAS
 SG_ DET_BELOW_RAIN_THOLD_126 : 151|1@1+ (1,0) [0|1] ""  ADAS
 SG_ DET_RANGE_127 : 248|15@1+ (0.015625,0) [0|500] "m"  ADAS
 SG_ DET_RANGE_ERR_127 : 264|7@1+ (0.0075,0) [0|0.9525] "m"  ADAS
 SG_ DET_RANGE_VELOCITY_127 : 272|15@1+ (0.0078125,-128) [-128|127.9921875] "m/s"  ADAS
 SG_ DET_RANGE_VELOCITY_ERR_127 : 288|8@1+ (0.003,0) [0|0.765] "m/s"  ADAS
 SG_ DET_AZIMUTH_127 : 312|13@1+ (0.0004,-1.5708) [-1.5708|1.5708] "rad"  ADAS
 SG_ DET_AZIMUTH_ERR_127 : 329|7@1+ (0.00087267,0) [0|0.11082909] "rad"  ADAS
 SG_ DET_ELEVATION_127 : 296|8@1+ (0.00275,-0.34925) [-0.34925|0.34925] "rad"  ADAS
 SG_ DET_ELEVATION_ERR_127 : 304|6@1+ (0.00174533,0) [0|0.10995579] "rad"  ADAS
 SG_ DET_RCS_127 : 352|8@1+ (0.5,-64) [-64|63.5] "dBsm"  ADAS
 SG_ DET_BI_STATIC_FLAG_127 : 328|1@1+ (1,0) [0|1] ""  ADAS
 SG_ DET_SUPER_RES_TARGET_127 : 311|1@1+ (1,0) [0|1] ""  ADAS
 SG_ DET_SNR_127 : 344|8@1+ (0.35156,0) [0|89.6478] "dB"  ADAS
 SG_ DET_EXISTENCE_PROB_127 : 336|6@1+ (1.588,0) [0|100] "%"  ADAS
 SG_ DET_HVC_FLAG_127 : 310|1@1+ (1,0) [0|1] ""  ADAS
 SG_ DET_CONFD_AZIMUTH_127 : 342|2@1+ (1,0) [0|3] ""  ADAS
 SG_ DET_CONFD_ELEVATION_127 : 325|2@1+ (1,0) [0|3] ""  ADAS
 SG_ DET_PROB_1STAZHYPO_127 : 327|1@1+ (1,0) [0|1] ""  ADAS
 SG_ DET_IDM_127 : 287|1@1+ (1,0) [0|1] ""  ADAS
 SG_ DET_MTD_127 : 271|1@1+ (1,0) [0|1] ""  ADAS
 SG_ DET_BELOW_RAIN_THOLD_127 : 263|1@1+ (1,0) [0|1] ""  ADAS
 SG_ DET_RANGE_128 : 360|15@1+ (0.015625,0) [0|500] "m"  ADAS
 SG_ DET_RANGE_ERR_128 : 376|7@1+ (0.0075,0) [0|0.9525] "m"  ADAS
 SG_ DET_RANGE_VELOCITY_128 : 384|15@1+ (0.0078125,-128) [-128|127.9921875] "m/s"  ADAS
 SG_ DET_RANGE_VELOCITY_ERR_128 : 400|8@1+ (0.003,0) [0|0.765] "m/s"  ADAS
 SG_ DET_AZIMUTH_128 : 424|13@1+ (0.0004,-1.5708) [-1.5708|1.5708] "rad"  ADAS
 SG_ DET_AZIMUTH_ERR_128 : 441|7@1+ (0.00087267,0) [0|0.11082909] "rad"  ADAS
 SG_ DET_ELEVATION_128 : 408|8@1+ (0.00275,-0.34925) [-0.34925|0.34925] "rad"  ADAS
 SG_ DET_ELEVATION_ERR_128 : 416|6@1+ (0.00174533,0) [0|0.10995579] "rad"  ADAS
 SG_ DET_RCS_128 : 464|8@1+ (0.5,-64) [-64|63.5] "dBsm"  ADAS
 SG_ DET_BI_STATIC_FLAG_128 : 440|1@1+ (1,0) [0|1] ""  ADAS
 SG_ DET_SUPER_RES_TARGET_128 : 423|1@1+ (1,0) [0|1] ""  ADAS
 SG_ DET_SNR_128 : 456|8@1+ (0.35156,0) [0|89.6478] "dB"  ADAS
 SG_ DET_EXISTENCE_PROB_128 : 448|6@1+ (1.588,0) [0|100] "%"  ADAS
 SG_ DET_HVC_FLAG_128 : 422|1@1+ (1,0) [0|1] ""  ADAS
 SG_ DET_CONFD_AZIMUTH_128 : 454|2@1+ (1,0) [0|3] ""  ADAS
 SG_ DET_CONFD_ELEVATION_128 : 437|2@1+ (1,0) [0|3] ""  ADAS
 SG_ DET_MH_SCAN_INDEX_4LSB_125_128 : 476|4@1+ (1,0) [0|15] ""  ADAS
 SG_ DET_MH_CYCLE_COUNTER_125_128 : 16|8@1+ (1,0) [0|255] ""  ADAS
 SG_ DET_MH_CRC16_125_128 : 0|16@1+ (1,0) [0|65535] ""  ADAS
 SG_ DET_PROB_1STAZHYPO_128 : 439|1@1+ (1,0) [0|1] ""  ADAS
 SG_ DET_IDM_128 : 399|1@1+ (1,0) [0|1] ""  ADAS
 SG_ DET_MTD_128 : 383|1@1+ (1,0) [0|1] ""  ADAS
 SG_ DET_BELOW_RAIN_THOLD_128 : 375|1@1+ (1,0) [0|1] ""  ADAS

BO_ 1056 RDR_DETECTION_129_132: 64 RDR07
 SG_ DET_RANGE_129 : 24|15@1+ (0.015625,0) [0|500] "m"  ADAS
 SG_ DET_RANGE_ERR_129 : 40|7@1+ (0.0075,0) [0|0.9525] "m"  ADAS
 SG_ DET_RANGE_VELOCITY_129 : 48|15@1+ (0.0078125,-128) [-128|127.9921875] "m/s"  ADAS
 SG_ DET_RANGE_VELOCITY_ERR_129 : 64|8@1+ (0.003,0) [0|0.765] "m/s"  ADAS
 SG_ DET_AZIMUTH_129 : 88|13@1+ (0.0004,-1.5708) [-1.5708|1.5708] "rad"  ADAS
 SG_ DET_AZIMUTH_ERR_129 : 105|7@1+ (0.00087267,0) [0|0.11082909] "rad"  ADAS
 SG_ DET_ELEVATION_129 : 72|8@1+ (0.00275,-0.34925) [-0.34925|0.34925] "rad"  ADAS
 SG_ DET_ELEVATION_ERR_129 : 80|6@1+ (0.00174533,0) [0|0.10995579] "rad"  ADAS
 SG_ DET_RCS_129 : 128|8@1+ (0.5,-64) [-64|63.5] "dBsm"  ADAS
 SG_ DET_BI_STATIC_FLAG_129 : 104|1@1+ (1,0) [0|1] ""  ADAS
 SG_ DET_SUPER_RES_TARGET_129 : 87|1@1+ (1,0) [0|1] ""  ADAS
 SG_ DET_SNR_129 : 120|8@1+ (0.35156,0) [0|89.6478] "dB"  ADAS
 SG_ DET_EXISTENCE_PROB_129 : 112|6@1+ (1.588,0) [0|100] "%"  ADAS
 SG_ DET_HVC_FLAG_129 : 86|1@1+ (1,0) [0|1] ""  ADAS
 SG_ DET_CONFD_AZIMUTH_129 : 118|2@1+ (1,0) [0|3] ""  ADAS
 SG_ DET_CONFD_ELEVATION_129 : 101|2@1+ (1,0) [0|3] ""  ADAS
 SG_ DET_PROB_1STAZHYPO_129 : 103|1@1+ (1,0) [0|1] ""  ADAS
 SG_ DET_IDM_129 : 63|1@1+ (1,0) [0|1] ""  ADAS
 SG_ DET_MTD_129 : 47|1@1+ (1,0) [0|1] ""  ADAS
 SG_ DET_BELOW_RAIN_THOLD_129 : 39|1@1+ (1,0) [0|1] ""  ADAS
 SG_ DET_RANGE_130 : 136|15@1+ (0.015625,0) [0|500] "m"  ADAS
 SG_ DET_RANGE_ERR_130 : 152|7@1+ (0.0075,0) [0|0.9525] "m"  ADAS
 SG_ DET_RANGE_VELOCITY_130 : 160|15@1+ (0.0078125,-128) [-128|127.9921875] "m/s"  ADAS
 SG_ DET_RANGE_VELOCITY_ERR_130 : 176|8@1+ (0.003,0) [0|0.765] "m/s"  ADAS
 SG_ DET_AZIMUTH_130 : 200|13@1+ (0.0004,-1.5708) [-1.5708|1.5708] "rad"  ADAS
 SG_ DET_AZIMUTH_ERR_130 : 217|7@1+ (0.00087267,0) [0|0.11082909] "rad"  ADAS
 SG_ DET_ELEVATION_130 : 184|8@1+ (0.00275,-0.34925) [-0.34925|0.34925] "rad"  ADAS
 SG_ DET_ELEVATION_ERR_130 : 192|6@1+ (0.00174533,0) [0|0.10995579] "rad"  ADAS
 SG_ DET_RCS_130 : 240|8@1+ (0.5,-64) [-64|63.5] "dBsm"  ADAS
 SG_ DET_BI_STATIC_FLAG_130 : 216|1@1+ (1,0) [0|1] ""  ADAS
 SG_ DET_SUPER_RES_TARGET_130 : 199|1@1+ (1,0) [0|1] ""  ADAS
 SG_ DET_SNR_130 : 232|8@1+ (0.35156,0) [0|89.6478] "dB"  ADAS
 SG_ DET_EXISTENCE_PROB_130 : 224|6@1+ (1.588,0) [0|100] "%"  ADAS
 SG_ DET_HVC_FLAG_130 : 198|1@1+ (1,0) [0|1] ""  ADAS
 SG_ DET_CONFD_AZIMUTH_130 : 230|2@1+ (1,0) [0|3] ""  ADAS
 SG_ DET_CONFD_ELEVATION_130 : 213|2@1+ (1,0) [0|3] ""  ADAS
 SG_ DET_PROB_1STAZHYPO_130 : 215|1@1+ (1,0) [0|1] ""  ADAS
 SG_ DET_IDM_130 : 175|1@1+ (1,0) [0|1] ""  ADAS
 SG_ DET_MTD_130 : 159|1@1+ (1,0) [0|1] ""  ADAS
 SG_ DET_BELOW_RAIN_THOLD_130 : 151|1@1+ (1,0) [0|1] ""  ADAS
 SG_ DET_RANGE_131 : 248|15@1+ (0.015625,0) [0|500] "m"  ADAS
 SG_ DET_RANGE_ERR_131 : 264|7@1+ (0.0075,0) [0|0.9525] "m"  ADAS
 SG_ DET_RANGE_VELOCITY_131 : 272|15@1+ (0.0078125,-128) [-128|127.9921875] "m/s"  ADAS
 SG_ DET_RANGE_VELOCITY_ERR_131 : 288|8@1+ (0.003,0) [0|0.765] "m/s"  ADAS
 SG_ DET_AZIMUTH_131 : 312|13@1+ (0.0004,-1.5708) [-1.5708|1.5708] "rad"  ADAS
 SG_ DET_AZIMUTH_ERR_131 : 329|7@1+ (0.00087267,0) [0|0.11082909] "rad"  ADAS
 SG_ DET_ELEVATION_131 : 296|8@1+ (0.00275,-0.34925) [-0.34925|0.34925] "rad"  ADAS
 SG_ DET_ELEVATION_ERR_131 : 304|6@1+ (0.00174533,0) [0|0.10995579] "rad"  ADAS
 SG_ DET_RCS_131 : 352|8@1+ (0.5,-64) [-64|63.5] "dBsm"  ADAS
 SG_ DET_BI_STATIC_FLAG_131 : 328|1@1+ (1,0) [0|1] ""  ADAS
 SG_ DET_SUPER_RES_TARGET_131 : 311|1@1+ (1,0) [0|1] ""  ADAS
 SG_ DET_SNR_131 : 344|8@1+ (0.35156,0) [0|89.6478] "dB"  ADAS
 SG_ DET_EXISTENCE_PROB_131 : 336|6@1+ (1.588,0) [0|100] "%"  ADAS
 SG_ DET_HVC_FLAG_131 : 310|1@1+ (1,0) [0|1] ""  ADAS
 SG_ DET_CONFD_AZIMUTH_131 : 342|2@1+ (1,0) [0|3] ""  ADAS
 SG_ DET_CONFD_ELEVATION_131 : 325|2@1+ (1,0) [0|3] ""  ADAS
 SG_ DET_PROB_1STAZHYPO_131 : 327|1@1+ (1,0) [0|1] ""  ADAS
 SG_ DET_IDM_131 : 287|1@1+ (1,0) [0|1] ""  ADAS
 SG_ DET_MTD_131 : 271|1@1+ (1,0) [0|1] ""  ADAS
 SG_ DET_BELOW_RAIN_THOLD_131 : 263|1@1+ (1,0) [0|1] ""  ADAS
 SG_ DET_RANGE_132 : 360|15@1+ (0.015625,0) [0|500] "m"  ADAS
 SG_ DET_RANGE_ERR_132 : 376|7@1+ (0.0075,0) [0|0.9525] "m"  ADAS
 SG_ DET_RANGE_VELOCITY_132 : 384|15@1+ (0.0078125,-128) [-128|127.9921875] "m/s"  ADAS
 SG_ DET_RANGE_VELOCITY_ERR_132 : 400|8@1+ (0.003,0) [0|0.765] "m/s"  ADAS
 SG_ DET_AZIMUTH_132 : 424|13@1+ (0.0004,-1.5708) [-1.5708|1.5708] "rad"  ADAS
 SG_ DET_AZIMUTH_ERR_132 : 441|7@1+ (0.00087267,0) [0|0.11082909] "rad"  ADAS
 SG_ DET_ELEVATION_132 : 408|8@1+ (0.00275,-0.34925) [-0.34925|0.34925] "rad"  ADAS
 SG_ DET_ELEVATION_ERR_132 : 416|6@1+ (0.00174533,0) [0|0.10995579] "rad"  ADAS
 SG_ DET_RCS_132 : 464|8@1+ (0.5,-64) [-64|63.5] "dBsm"  ADAS
 SG_ DET_BI_STATIC_FLAG_132 : 440|1@1+ (1,0) [0|1] ""  ADAS
 SG_ DET_SUPER_RES_TARGET_132 : 423|1@1+ (1,0) [0|1] ""  ADAS
 SG_ DET_SNR_132 : 456|8@1+ (0.35156,0) [0|89.6478] "dB"  ADAS
 SG_ DET_EXISTENCE_PROB_132 : 448|6@1+ (1.588,0) [0|100] "%"  ADAS
 SG_ DET_HVC_FLAG_132 : 422|1@1+ (1,0) [0|1] ""  ADAS
 SG_ DET_CONFD_AZIMUTH_132 : 454|2@1+ (1,0) [0|3] ""  ADAS
 SG_ DET_CONFD_ELEVATION_132 : 437|2@1+ (1,0) [0|3] ""  ADAS
 SG_ DET_MH_SCAN_INDEX_4LSB_129_132 : 476|4@1+ (1,0) [0|15] ""  ADAS
 SG_ DET_MH_CYCLE_COUNTER_129_132 : 16|8@1+ (1,0) [0|255] ""  ADAS
 SG_ DET_MH_CRC16_129_132 : 0|16@1+ (1,0) [0|65535] ""  ADAS
 SG_ DET_PROB_1STAZHYPO_132 : 439|1@1+ (1,0) [0|1] ""  ADAS
 SG_ DET_IDM_132 : 399|1@1+ (1,0) [0|1] ""  ADAS
 SG_ DET_MTD_132 : 383|1@1+ (1,0) [0|1] ""  ADAS
 SG_ DET_BELOW_RAIN_THOLD_132 : 375|1@1+ (1,0) [0|1] ""  ADAS

BO_ 1057 RDR_DETECTION_133_136: 64 RDR07
 SG_ DET_RANGE_133 : 24|15@1+ (0.015625,0) [0|500] "m"  ADAS
 SG_ DET_RANGE_ERR_133 : 40|7@1+ (0.0075,0) [0|0.9525] "m"  ADAS
 SG_ DET_RANGE_VELOCITY_133 : 48|15@1+ (0.0078125,-128) [-128|127.9921875] "m/s"  ADAS
 SG_ DET_RANGE_VELOCITY_ERR_133 : 64|8@1+ (0.003,0) [0|0.765] "m/s"  ADAS
 SG_ DET_AZIMUTH_133 : 88|13@1+ (0.0004,-1.5708) [-1.5708|1.5708] "rad"  ADAS
 SG_ DET_AZIMUTH_ERR_133 : 105|7@1+ (0.00087267,0) [0|0.11082909] "rad"  ADAS
 SG_ DET_ELEVATION_133 : 72|8@1+ (0.00275,-0.34925) [-0.34925|0.34925] "rad"  ADAS
 SG_ DET_ELEVATION_ERR_133 : 80|6@1+ (0.00174533,0) [0|0.10995579] "rad"  ADAS
 SG_ DET_RCS_133 : 128|8@1+ (0.5,-64) [-64|63.5] "dBsm"  ADAS
 SG_ DET_BI_STATIC_FLAG_133 : 104|1@1+ (1,0) [0|1] ""  ADAS
 SG_ DET_SUPER_RES_TARGET_133 : 87|1@1+ (1,0) [0|1] ""  ADAS
 SG_ DET_SNR_133 : 120|8@1+ (0.35156,0) [0|89.6478] "dB"  ADAS
 SG_ DET_EXISTENCE_PROB_133 : 112|6@1+ (1.588,0) [0|100] "%"  ADAS
 SG_ DET_HVC_FLAG_133 : 86|1@1+ (1,0) [0|1] ""  ADAS
 SG_ DET_CONFD_AZIMUTH_133 : 118|2@1+ (1,0) [0|3] ""  ADAS
 SG_ DET_CONFD_ELEVATION_133 : 101|2@1+ (1,0) [0|3] ""  ADAS
 SG_ DET_PROB_1STAZHYPO_133 : 103|1@1+ (1,0) [0|1] ""  ADAS
 SG_ DET_IDM_133 : 63|1@1+ (1,0) [0|1] ""  ADAS
 SG_ DET_MTD_133 : 47|1@1+ (1,0) [0|1] ""  ADAS
 SG_ DET_BELOW_RAIN_THOLD_133 : 39|1@1+ (1,0) [0|1] ""  ADAS
 SG_ DET_RANGE_134 : 136|15@1+ (0.015625,0) [0|500] "m"  ADAS
 SG_ DET_RANGE_ERR_134 : 152|7@1+ (0.0075,0) [0|0.9525] "m"  ADAS
 SG_ DET_RANGE_VELOCITY_134 : 160|15@1+ (0.0078125,-128) [-128|127.9921875] "m/s"  ADAS
 SG_ DET_RANGE_VELOCITY_ERR_134 : 176|8@1+ (0.003,0) [0|0.765] "m/s"  ADAS
 SG_ DET_AZIMUTH_134 : 200|13@1+ (0.0004,-1.5708) [-1.5708|1.5708] "rad"  ADAS
 SG_ DET_AZIMUTH_ERR_134 : 217|7@1+ (0.00087267,0) [0|0.11082909] "rad"  ADAS
 SG_ DET_ELEVATION_134 : 184|8@1+ (0.00275,-0.34925) [-0.34925|0.34925] "rad"  ADAS
 SG_ DET_ELEVATION_ERR_134 : 192|6@1+ (0.00174533,0) [0|0.10995579] "rad"  ADAS
 SG_ DET_RCS_134 : 240|8@1+ (0.5,-64) [-64|63.5] "dBsm"  ADAS
 SG_ DET_BI_STATIC_FLAG_134 : 216|1@1+ (1,0) [0|1] ""  ADAS
 SG_ DET_SUPER_RES_TARGET_134 : 199|1@1+ (1,0) [0|1] ""  ADAS
 SG_ DET_SNR_134 : 232|8@1+ (0.35156,0) [0|89.6478] "dB"  ADAS
 SG_ DET_EXISTENCE_PROB_134 : 224|6@1+ (1.588,0) [0|100] "%"  ADAS
 SG_ DET_HVC_FLAG_134 : 198|1@1+ (1,0) [0|1] ""  ADAS
 SG_ DET_CONFD_AZIMUTH_134 : 230|2@1+ (1,0) [0|3] ""  ADAS
 SG_ DET_CONFD_ELEVATION_134 : 213|2@1+ (1,0) [0|3] ""  ADAS
 SG_ DET_PROB_1STAZHYPO_134 : 215|1@1+ (1,0) [0|1] ""  ADAS
 SG_ DET_IDM_134 : 175|1@1+ (1,0) [0|1] ""  ADAS
 SG_ DET_MTD_134 : 159|1@1+ (1,0) [0|1] ""  ADAS
 SG_ DET_BELOW_RAIN_THOLD_134 : 151|1@1+ (1,0) [0|1] ""  ADAS
 SG_ DET_RANGE_135 : 248|15@1+ (0.015625,0) [0|500] "m"  ADAS
 SG_ DET_RANGE_ERR_135 : 264|7@1+ (0.0075,0) [0|0.9525] "m"  ADAS
 SG_ DET_RANGE_VELOCITY_135 : 272|15@1+ (0.0078125,-128) [-128|127.9921875] "m/s"  ADAS
 SG_ DET_RANGE_VELOCITY_ERR_135 : 288|8@1+ (0.003,0) [0|0.765] "m/s"  ADAS
 SG_ DET_AZIMUTH_135 : 312|13@1+ (0.0004,-1.5708) [-1.5708|1.5708] "rad"  ADAS
 SG_ DET_AZIMUTH_ERR_135 : 329|7@1+ (0.00087267,0) [0|0.11082909] "rad"  ADAS
 SG_ DET_ELEVATION_135 : 296|8@1+ (0.00275,-0.34925) [-0.34925|0.34925] "rad"  ADAS
 SG_ DET_ELEVATION_ERR_135 : 304|6@1+ (0.00174533,0) [0|0.10995579] "rad"  ADAS
 SG_ DET_RCS_135 : 352|8@1+ (0.5,-64) [-64|63.5] "dBsm"  ADAS
 SG_ DET_BI_STATIC_FLAG_135 : 328|1@1+ (1,0) [0|1] ""  ADAS
 SG_ DET_SUPER_RES_TARGET_135 : 311|1@1+ (1,0) [0|1] ""  ADAS
 SG_ DET_SNR_135 : 344|8@1+ (0.35156,0) [0|89.6478] "dB"  ADAS
 SG_ DET_EXISTENCE_PROB_135 : 336|6@1+ (1.588,0) [0|100] "%"  ADAS
 SG_ DET_HVC_FLAG_135 : 310|1@1+ (1,0) [0|1] ""  ADAS
 SG_ DET_CONFD_AZIMUTH_135 : 342|2@1+ (1,0) [0|3] ""  ADAS
 SG_ DET_CONFD_ELEVATION_135 : 325|2@1+ (1,0) [0|3] ""  ADAS
 SG_ DET_PROB_1STAZHYPO_135 : 327|1@1+ (1,0) [0|1] ""  ADAS
 SG_ DET_IDM_135 : 287|1@1+ (1,0) [0|1] ""  ADAS
 SG_ DET_MTD_135 : 271|1@1+ (1,0) [0|1] ""  ADAS
 SG_ DET_BELOW_RAIN_THOLD_135 : 263|1@1+ (1,0) [0|1] ""  ADAS
 SG_ DET_RANGE_136 : 360|15@1+ (0.015625,0) [0|500] "m"  ADAS
 SG_ DET_RANGE_ERR_136 : 376|7@1+ (0.0075,0) [0|0.9525] "m"  ADAS
 SG_ DET_RANGE_VELOCITY_136 : 384|15@1+ (0.0078125,-128) [-128|127.9921875] "m/s"  ADAS
 SG_ DET_RANGE_VELOCITY_ERR_136 : 400|8@1+ (0.003,0) [0|0.765] "m/s"  ADAS
 SG_ DET_AZIMUTH_136 : 424|13@1+ (0.0004,-1.5708) [-1.5708|1.5708] "rad"  ADAS
 SG_ DET_AZIMUTH_ERR_136 : 441|7@1+ (0.00087267,0) [0|0.11082909] "rad"  ADAS
 SG_ DET_ELEVATION_136 : 408|8@1+ (0.00275,-0.34925) [-0.34925|0.34925] "rad"  ADAS
 SG_ DET_ELEVATION_ERR_136 : 416|6@1+ (0.00174533,0) [0|0.10995579] "rad"  ADAS
 SG_ DET_RCS_136 : 464|8@1+ (0.5,-64) [-64|63.5] "dBsm"  ADAS
 SG_ DET_BI_STATIC_FLAG_136 : 440|1@1+ (1,0) [0|1] ""  ADAS
 SG_ DET_SUPER_RES_TARGET_136 : 423|1@1+ (1,0) [0|1] ""  ADAS
 SG_ DET_SNR_136 : 456|8@1+ (0.35156,0) [0|89.6478] "dB"  ADAS
 SG_ DET_EXISTENCE_PROB_136 : 448|6@1+ (1.588,0) [0|100] "%"  ADAS
 SG_ DET_HVC_FLAG_136 : 422|1@1+ (1,0) [0|1] ""  ADAS
 SG_ DET_CONFD_AZIMUTH_136 : 454|2@1+ (1,0) [0|3] ""  ADAS
 SG_ DET_CONFD_ELEVATION_136 : 437|2@1+ (1,0) [0|3] ""  ADAS
 SG_ DET_MH_SCAN_INDEX_4LSB_133_136 : 476|4@1+ (1,0) [0|15] ""  ADAS
 SG_ DET_MH_CYCLE_COUNTER_133_136 : 16|8@1+ (1,0) [0|255] ""  ADAS
 SG_ DET_MH_CRC16_133_136 : 0|16@1+ (1,0) [0|65535] ""  ADAS
 SG_ DET_PROB_1STAZHYPO_136 : 439|1@1+ (1,0) [0|1] ""  ADAS
 SG_ DET_IDM_136 : 399|1@1+ (1,0) [0|1] ""  ADAS
 SG_ DET_MTD_136 : 383|1@1+ (1,0) [0|1] ""  ADAS
 SG_ DET_BELOW_RAIN_THOLD_136 : 375|1@1+ (1,0) [0|1] ""  ADAS

BO_ 1058 RDR_DETECTION_137_140: 64 RDR07
 SG_ DET_RANGE_137 : 24|15@1+ (0.015625,0) [0|500] "m"  ADAS
 SG_ DET_RANGE_ERR_137 : 40|7@1+ (0.0075,0) [0|0.9525] "m"  ADAS
 SG_ DET_RANGE_VELOCITY_137 : 48|15@1+ (0.0078125,-128) [-128|127.9921875] "m/s"  ADAS
 SG_ DET_RANGE_VELOCITY_ERR_137 : 64|8@1+ (0.003,0) [0|0.765] "m/s"  ADAS
 SG_ DET_AZIMUTH_137 : 88|13@1+ (0.0004,-1.5708) [-1.5708|1.5708] "rad"  ADAS
 SG_ DET_AZIMUTH_ERR_137 : 105|7@1+ (0.00087267,0) [0|0.11082909] "rad"  ADAS
 SG_ DET_ELEVATION_137 : 72|8@1+ (0.00275,-0.34925) [-0.34925|0.34925] "rad"  ADAS
 SG_ DET_ELEVATION_ERR_137 : 80|6@1+ (0.00174533,0) [0|0.10995579] "rad"  ADAS
 SG_ DET_RCS_137 : 128|8@1+ (0.5,-64) [-64|63.5] "dBsm"  ADAS
 SG_ DET_BI_STATIC_FLAG_137 : 104|1@1+ (1,0) [0|1] ""  ADAS
 SG_ DET_SUPER_RES_TARGET_137 : 87|1@1+ (1,0) [0|1] ""  ADAS
 SG_ DET_SNR_137 : 120|8@1+ (0.35156,0) [0|89.6478] "dB"  ADAS
 SG_ DET_EXISTENCE_PROB_137 : 112|6@1+ (1.588,0) [0|100] "%"  ADAS
 SG_ DET_HVC_FLAG_137 : 86|1@1+ (1,0) [0|1] ""  ADAS
 SG_ DET_CONFD_AZIMUTH_137 : 118|2@1+ (1,0) [0|3] ""  ADAS
 SG_ DET_CONFD_ELEVATION_137 : 101|2@1+ (1,0) [0|3] ""  ADAS
 SG_ DET_PROB_1STAZHYPO_137 : 103|1@1+ (1,0) [0|1] ""  ADAS
 SG_ DET_IDM_137 : 63|1@1+ (1,0) [0|1] ""  ADAS
 SG_ DET_MTD_137 : 47|1@1+ (1,0) [0|1] ""  ADAS
 SG_ DET_BELOW_RAIN_THOLD_137 : 39|1@1+ (1,0) [0|1] ""  ADAS
 SG_ DET_RANGE_138 : 136|15@1+ (0.015625,0) [0|500] "m"  ADAS
 SG_ DET_RANGE_ERR_138 : 152|7@1+ (0.0075,0) [0|0.9525] "m"  ADAS
 SG_ DET_RANGE_VELOCITY_138 : 160|15@1+ (0.0078125,-128) [-128|127.9921875] "m/s"  ADAS
 SG_ DET_RANGE_VELOCITY_ERR_138 : 176|8@1+ (0.003,0) [0|0.765] "m/s"  ADAS
 SG_ DET_AZIMUTH_138 : 200|13@1+ (0.0004,-1.5708) [-1.5708|1.5708] "rad"  ADAS
 SG_ DET_AZIMUTH_ERR_138 : 217|7@1+ (0.00087267,0) [0|0.11082909] "rad"  ADAS
 SG_ DET_ELEVATION_138 : 184|8@1+ (0.00275,-0.34925) [-0.34925|0.34925] "rad"  ADAS
 SG_ DET_ELEVATION_ERR_138 : 192|6@1+ (0.00174533,0) [0|0.10995579] "rad"  ADAS
 SG_ DET_RCS_138 : 240|8@1+ (0.5,-64) [-64|63.5] "dBsm"  ADAS
 SG_ DET_BI_STATIC_FLAG_138 : 216|1@1+ (1,0) [0|1] ""  ADAS
 SG_ DET_SUPER_RES_TARGET_138 : 199|1@1+ (1,0) [0|1] ""  ADAS
 SG_ DET_SNR_138 : 232|8@1+ (0.35156,0) [0|89.6478] "dB"  ADAS
 SG_ DET_EXISTENCE_PROB_138 : 224|6@1+ (1.588,0) [0|100] "%"  ADAS
 SG_ DET_HVC_FLAG_138 : 198|1@1+ (1,0) [0|1] ""  ADAS
 SG_ DET_CONFD_AZIMUTH_138 : 230|2@1+ (1,0) [0|3] ""  ADAS
 SG_ DET_CONFD_ELEVATION_138 : 213|2@1+ (1,0) [0|3] ""  ADAS
 SG_ DET_PROB_1STAZHYPO_138 : 215|1@1+ (1,0) [0|1] ""  ADAS
 SG_ DET_IDM_138 : 175|1@1+ (1,0) [0|1] ""  ADAS
 SG_ DET_MTD_138 : 159|1@1+ (1,0) [0|1] ""  ADAS
 SG_ DET_BELOW_RAIN_THOLD_138 : 151|1@1+ (1,0) [0|1] ""  ADAS
 SG_ DET_RANGE_139 : 248|15@1+ (0.015625,0) [0|500] "m"  ADAS
 SG_ DET_RANGE_ERR_139 : 264|7@1+ (0.0075,0) [0|0.9525] "m"  ADAS
 SG_ DET_RANGE_VELOCITY_139 : 272|15@1+ (0.0078125,-128) [-128|127.9921875] "m/s"  ADAS
 SG_ DET_RANGE_VELOCITY_ERR_139 : 288|8@1+ (0.003,0) [0|0.765] "m/s"  ADAS
 SG_ DET_AZIMUTH_139 : 312|13@1+ (0.0004,-1.5708) [-1.5708|1.5708] "rad"  ADAS
 SG_ DET_AZIMUTH_ERR_139 : 329|7@1+ (0.00087267,0) [0|0.11082909] "rad"  ADAS
 SG_ DET_ELEVATION_139 : 296|8@1+ (0.00275,-0.34925) [-0.34925|0.34925] "rad"  ADAS
 SG_ DET_ELEVATION_ERR_139 : 304|6@1+ (0.00174533,0) [0|0.10995579] "rad"  ADAS
 SG_ DET_RCS_139 : 352|8@1+ (0.5,-64) [-64|63.5] "dBsm"  ADAS
 SG_ DET_BI_STATIC_FLAG_139 : 328|1@1+ (1,0) [0|1] ""  ADAS
 SG_ DET_SUPER_RES_TARGET_139 : 311|1@1+ (1,0) [0|1] ""  ADAS
 SG_ DET_SNR_139 : 344|8@1+ (0.35156,0) [0|89.6478] "dB"  ADAS
 SG_ DET_EXISTENCE_PROB_139 : 336|6@1+ (1.588,0) [0|100] "%"  ADAS
 SG_ DET_HVC_FLAG_139 : 310|1@1+ (1,0) [0|1] ""  ADAS
 SG_ DET_CONFD_AZIMUTH_139 : 342|2@1+ (1,0) [0|3] ""  ADAS
 SG_ DET_CONFD_ELEVATION_139 : 325|2@1+ (1,0) [0|3] ""  ADAS
 SG_ DET_PROB_1STAZHYPO_139 : 327|1@1+ (1,0) [0|1] ""  ADAS
 SG_ DET_IDM_139 : 287|1@1+ (1,0) [0|1] ""  ADAS
 SG_ DET_MTD_139 : 271|1@1+ (1,0) [0|1] ""  ADAS
 SG_ DET_BELOW_RAIN_THOLD_139 : 263|1@1+ (1,0) [0|1] ""  ADAS
 SG_ DET_RANGE_140 : 360|15@1+ (0.015625,0) [0|500] "m"  ADAS
 SG_ DET_RANGE_ERR_140 : 376|7@1+ (0.0075,0) [0|0.9525] "m"  ADAS
 SG_ DET_RANGE_VELOCITY_140 : 384|15@1+ (0.0078125,-128) [-128|127.9921875] "m/s"  ADAS
 SG_ DET_RANGE_VELOCITY_ERR_140 : 400|8@1+ (0.003,0) [0|0.765] "m/s"  ADAS
 SG_ DET_AZIMUTH_140 : 424|13@1+ (0.0004,-1.5708) [-1.5708|1.5708] "rad"  ADAS
 SG_ DET_AZIMUTH_ERR_140 : 441|7@1+ (0.00087267,0) [0|0.11082909] "rad"  ADAS
 SG_ DET_ELEVATION_140 : 408|8@1+ (0.00275,-0.34925) [-0.34925|0.34925] "rad"  ADAS
 SG_ DET_ELEVATION_ERR_140 : 416|6@1+ (0.00174533,0) [0|0.10995579] "rad"  ADAS
 SG_ DET_RCS_140 : 464|8@1+ (0.5,-64) [-64|63.5] "dBsm"  ADAS
 SG_ DET_BI_STATIC_FLAG_140 : 440|1@1+ (1,0) [0|1] ""  ADAS
 SG_ DET_SUPER_RES_TARGET_140 : 423|1@1+ (1,0) [0|1] ""  ADAS
 SG_ DET_SNR_140 : 456|8@1+ (0.35156,0) [0|89.6478] "dB"  ADAS
 SG_ DET_EXISTENCE_PROB_140 : 448|6@1+ (1.588,0) [0|100] "%"  ADAS
 SG_ DET_HVC_FLAG_140 : 422|1@1+ (1,0) [0|1] ""  ADAS
 SG_ DET_CONFD_AZIMUTH_140 : 454|2@1+ (1,0) [0|3] ""  ADAS
 SG_ DET_CONFD_ELEVATION_140 : 437|2@1+ (1,0) [0|3] ""  ADAS
 SG_ DET_MH_SCAN_INDEX_4LSB_137_140 : 476|4@1+ (1,0) [0|15] ""  ADAS
 SG_ DET_MH_CYCLE_COUNTER_137_140 : 16|8@1+ (1,0) [0|255] ""  ADAS
 SG_ DET_MH_CRC16_137_140 : 0|16@1+ (1,0) [0|65535] ""  ADAS
 SG_ DET_PROB_1STAZHYPO_140 : 439|1@1+ (1,0) [0|1] ""  ADAS
 SG_ DET_IDM_140 : 399|1@1+ (1,0) [0|1] ""  ADAS
 SG_ DET_MTD_140 : 383|1@1+ (1,0) [0|1] ""  ADAS
 SG_ DET_BELOW_RAIN_THOLD_140 : 375|1@1+ (1,0) [0|1] ""  ADAS

BO_ 1059 RDR_DETECTION_141_144: 64 RDR07
 SG_ DET_RANGE_141 : 24|15@1+ (0.015625,0) [0|500] "m"  ADAS
 SG_ DET_RANGE_ERR_141 : 40|7@1+ (0.0075,0) [0|0.9525] "m"  ADAS
 SG_ DET_RANGE_VELOCITY_141 : 48|15@1+ (0.0078125,-128) [-128|127.9921875] "m/s"  ADAS
 SG_ DET_RANGE_VELOCITY_ERR_141 : 64|8@1+ (0.003,0) [0|0.765] "m/s"  ADAS
 SG_ DET_AZIMUTH_141 : 88|13@1+ (0.0004,-1.5708) [-1.5708|1.5708] "rad"  ADAS
 SG_ DET_AZIMUTH_ERR_141 : 105|7@1+ (0.00087267,0) [0|0.11082909] "rad"  ADAS
 SG_ DET_ELEVATION_141 : 72|8@1+ (0.00275,-0.34925) [-0.34925|0.34925] "rad"  ADAS
 SG_ DET_ELEVATION_ERR_141 : 80|6@1+ (0.00174533,0) [0|0.10995579] "rad"  ADAS
 SG_ DET_RCS_141 : 128|8@1+ (0.5,-64) [-64|63.5] "dBsm"  ADAS
 SG_ DET_BI_STATIC_FLAG_141 : 104|1@1+ (1,0) [0|1] ""  ADAS
 SG_ DET_SUPER_RES_TARGET_141 : 87|1@1+ (1,0) [0|1] ""  ADAS
 SG_ DET_SNR_141 : 120|8@1+ (0.35156,0) [0|89.6478] "dB"  ADAS
 SG_ DET_EXISTENCE_PROB_141 : 112|6@1+ (1.588,0) [0|100] "%"  ADAS
 SG_ DET_HVC_FLAG_141 : 86|1@1+ (1,0) [0|1] ""  ADAS
 SG_ DET_CONFD_AZIMUTH_141 : 118|2@1+ (1,0) [0|3] ""  ADAS
 SG_ DET_CONFD_ELEVATION_141 : 101|2@1+ (1,0) [0|3] ""  ADAS
 SG_ DET_PROB_1STAZHYPO_141 : 103|1@1+ (1,0) [0|1] ""  ADAS
 SG_ DET_IDM_141 : 63|1@1+ (1,0) [0|1] ""  ADAS
 SG_ DET_MTD_141 : 47|1@1+ (1,0) [0|1] ""  ADAS
 SG_ DET_BELOW_RAIN_THOLD_141 : 39|1@1+ (1,0) [0|1] ""  ADAS
 SG_ DET_RANGE_142 : 136|15@1+ (0.015625,0) [0|500] "m"  ADAS
 SG_ DET_RANGE_ERR_142 : 152|7@1+ (0.0075,0) [0|0.9525] "m"  ADAS
 SG_ DET_RANGE_VELOCITY_142 : 160|15@1+ (0.0078125,-128) [-128|127.9921875] "m/s"  ADAS
 SG_ DET_RANGE_VELOCITY_ERR_142 : 176|8@1+ (0.003,0) [0|0.765] "m/s"  ADAS
 SG_ DET_AZIMUTH_142 : 200|13@1+ (0.0004,-1.5708) [-1.5708|1.5708] "rad"  ADAS
 SG_ DET_AZIMUTH_ERR_142 : 217|7@1+ (0.00087267,0) [0|0.11082909] "rad"  ADAS
 SG_ DET_ELEVATION_142 : 184|8@1+ (0.00275,-0.34925) [-0.34925|0.34925] "rad"  ADAS
 SG_ DET_ELEVATION_ERR_142 : 192|6@1+ (0.00174533,0) [0|0.10995579] "rad"  ADAS
 SG_ DET_RCS_142 : 240|8@1+ (0.5,-64) [-64|63.5] "dBsm"  ADAS
 SG_ DET_BI_STATIC_FLAG_142 : 216|1@1+ (1,0) [0|1] ""  ADAS
 SG_ DET_SUPER_RES_TARGET_142 : 199|1@1+ (1,0) [0|1] ""  ADAS
 SG_ DET_SNR_142 : 232|8@1+ (0.35156,0) [0|89.6478] "dB"  ADAS
 SG_ DET_EXISTENCE_PROB_142 : 224|6@1+ (1.588,0) [0|100] "%"  ADAS
 SG_ DET_HVC_FLAG_142 : 198|1@1+ (1,0) [0|1] ""  ADAS
 SG_ DET_CONFD_AZIMUTH_142 : 230|2@1+ (1,0) [0|3] ""  ADAS
 SG_ DET_CONFD_ELEVATION_142 : 213|2@1+ (1,0) [0|3] ""  ADAS
 SG_ DET_PROB_1STAZHYPO_142 : 215|1@1+ (1,0) [0|1] ""  ADAS
 SG_ DET_IDM_142 : 175|1@1+ (1,0) [0|1] ""  ADAS
 SG_ DET_MTD_142 : 159|1@1+ (1,0) [0|1] ""  ADAS
 SG_ DET_BELOW_RAIN_THOLD_142 : 151|1@1+ (1,0) [0|1] ""  ADAS
 SG_ DET_RANGE_143 : 248|15@1+ (0.015625,0) [0|500] "m"  ADAS
 SG_ DET_RANGE_ERR_143 : 264|7@1+ (0.0075,0) [0|0.9525] "m"  ADAS
 SG_ DET_RANGE_VELOCITY_143 : 272|15@1+ (0.0078125,-128) [-128|127.9921875] "m/s"  ADAS
 SG_ DET_RANGE_VELOCITY_ERR_143 : 288|8@1+ (0.003,0) [0|0.765] "m/s"  ADAS
 SG_ DET_AZIMUTH_143 : 312|13@1+ (0.0004,-1.5708) [-1.5708|1.5708] "rad"  ADAS
 SG_ DET_AZIMUTH_ERR_143 : 329|7@1+ (0.00087267,0) [0|0.11082909] "rad"  ADAS
 SG_ DET_ELEVATION_143 : 296|8@1+ (0.00275,-0.34925) [-0.34925|0.34925] "rad"  ADAS
 SG_ DET_ELEVATION_ERR_143 : 304|6@1+ (0.00174533,0) [0|0.10995579] "rad"  ADAS
 SG_ DET_RCS_143 : 352|8@1+ (0.5,-64) [-64|63.5] "dBsm"  ADAS
 SG_ DET_BI_STATIC_FLAG_143 : 328|1@1+ (1,0) [0|1] ""  ADAS
 SG_ DET_SUPER_RES_TARGET_143 : 311|1@1+ (1,0) [0|1] ""  ADAS
 SG_ DET_SNR_143 : 344|8@1+ (0.35156,0) [0|89.6478] "dB"  ADAS
 SG_ DET_EXISTENCE_PROB_143 : 336|6@1+ (1.588,0) [0|100] "%"  ADAS
 SG_ DET_HVC_FLAG_143 : 310|1@1+ (1,0) [0|1] ""  ADAS
 SG_ DET_CONFD_AZIMUTH_143 : 342|2@1+ (1,0) [0|3] ""  ADAS
 SG_ DET_CONFD_ELEVATION_143 : 325|2@1+ (1,0) [0|3] ""  ADAS
 SG_ DET_PROB_1STAZHYPO_143 : 327|1@1+ (1,0) [0|1] ""  ADAS
 SG_ DET_IDM_143 : 287|1@1+ (1,0) [0|1] ""  ADAS
 SG_ DET_MTD_143 : 271|1@1+ (1,0) [0|1] ""  ADAS
 SG_ DET_BELOW_RAIN_THOLD_143 : 263|1@1+ (1,0) [0|1] ""  ADAS
 SG_ DET_RANGE_144 : 360|15@1+ (0.015625,0) [0|500] "m"  ADAS
 SG_ DET_RANGE_ERR_144 : 376|7@1+ (0.0075,0) [0|0.9525] "m"  ADAS
 SG_ DET_RANGE_VELOCITY_144 : 384|15@1+ (0.0078125,-128) [-128|127.9921875] "m/s"  ADAS
 SG_ DET_RANGE_VELOCITY_ERR_144 : 400|8@1+ (0.003,0) [0|0.765] "m/s"  ADAS
 SG_ DET_AZIMUTH_144 : 424|13@1+ (0.0004,-1.5708) [-1.5708|1.5708] "rad"  ADAS
 SG_ DET_AZIMUTH_ERR_144 : 441|7@1+ (0.00087267,0) [0|0.11082909] "rad"  ADAS
 SG_ DET_ELEVATION_144 : 408|8@1+ (0.00275,-0.34925) [-0.34925|0.34925] "rad"  ADAS
 SG_ DET_ELEVATION_ERR_144 : 416|6@1+ (0.00174533,0) [0|0.10995579] "rad"  ADAS
 SG_ DET_RCS_144 : 464|8@1+ (0.5,-64) [-64|63.5] "dBsm"  ADAS
 SG_ DET_BI_STATIC_FLAG_144 : 440|1@1+ (1,0) [0|1] ""  ADAS
 SG_ DET_SUPER_RES_TARGET_144 : 423|1@1+ (1,0) [0|1] ""  ADAS
 SG_ DET_SNR_144 : 456|8@1+ (0.35156,0) [0|89.6478] "dB"  ADAS
 SG_ DET_EXISTENCE_PROB_144 : 448|6@1+ (1.588,0) [0|100] "%"  ADAS
 SG_ DET_HVC_FLAG_144 : 422|1@1+ (1,0) [0|1] ""  ADAS
 SG_ DET_CONFD_AZIMUTH_144 : 454|2@1+ (1,0) [0|3] ""  ADAS
 SG_ DET_CONFD_ELEVATION_144 : 437|2@1+ (1,0) [0|3] ""  ADAS
 SG_ DET_MH_SCAN_INDEX_4LSB_141_144 : 476|4@1+ (1,0) [0|15] ""  ADAS
 SG_ DET_MH_CYCLE_COUNTER_141_144 : 16|8@1+ (1,0) [0|255] ""  ADAS
 SG_ DET_MH_CRC16_141_144 : 0|16@1+ (1,0) [0|65535] ""  ADAS
 SG_ DET_PROB_1STAZHYPO_144 : 439|1@1+ (1,0) [0|1] ""  ADAS
 SG_ DET_IDM_144 : 399|1@1+ (1,0) [0|1] ""  ADAS
 SG_ DET_MTD_144 : 383|1@1+ (1,0) [0|1] ""  ADAS
 SG_ DET_BELOW_RAIN_THOLD_144 : 375|1@1+ (1,0) [0|1] ""  ADAS

BO_ 1060 RDR_DETECTION_145_148: 64 RDR07
 SG_ DET_RANGE_145 : 24|15@1+ (0.015625,0) [0|500] "m"  ADAS
 SG_ DET_RANGE_ERR_145 : 40|7@1+ (0.0075,0) [0|0.9525] "m"  ADAS
 SG_ DET_RANGE_VELOCITY_145 : 48|15@1+ (0.0078125,-128) [-128|127.9921875] "m/s"  ADAS
 SG_ DET_RANGE_VELOCITY_ERR_145 : 64|8@1+ (0.003,0) [0|0.765] "m/s"  ADAS
 SG_ DET_AZIMUTH_145 : 88|13@1+ (0.0004,-1.5708) [-1.5708|1.5708] "rad"  ADAS
 SG_ DET_AZIMUTH_ERR_145 : 105|7@1+ (0.00087267,0) [0|0.11082909] "rad"  ADAS
 SG_ DET_ELEVATION_145 : 72|8@1+ (0.00275,-0.34925) [-0.34925|0.34925] "rad"  ADAS
 SG_ DET_ELEVATION_ERR_145 : 80|6@1+ (0.00174533,0) [0|0.10995579] "rad"  ADAS
 SG_ DET_RCS_145 : 128|8@1+ (0.5,-64) [-64|63.5] "dBsm"  ADAS
 SG_ DET_BI_STATIC_FLAG_145 : 104|1@1+ (1,0) [0|1] ""  ADAS
 SG_ DET_SUPER_RES_TARGET_145 : 87|1@1+ (1,0) [0|1] ""  ADAS
 SG_ DET_SNR_145 : 120|8@1+ (0.35156,0) [0|89.6478] "dB"  ADAS
 SG_ DET_EXISTENCE_PROB_145 : 112|6@1+ (1.588,0) [0|100] "%"  ADAS
 SG_ DET_HVC_FLAG_145 : 86|1@1+ (1,0) [0|1] ""  ADAS
 SG_ DET_CONFD_AZIMUTH_145 : 118|2@1+ (1,0) [0|3] ""  ADAS
 SG_ DET_CONFD_ELEVATION_145 : 101|2@1+ (1,0) [0|3] ""  ADAS
 SG_ DET_PROB_1STAZHYPO_145 : 103|1@1+ (1,0) [0|1] ""  ADAS
 SG_ DET_IDM_145 : 63|1@1+ (1,0) [0|1] ""  ADAS
 SG_ DET_MTD_145 : 47|1@1+ (1,0) [0|1] ""  ADAS
 SG_ DET_BELOW_RAIN_THOLD_145 : 39|1@1+ (1,0) [0|1] ""  ADAS
 SG_ DET_RANGE_146 : 136|15@1+ (0.015625,0) [0|500] "m"  ADAS
 SG_ DET_RANGE_ERR_146 : 152|7@1+ (0.0075,0) [0|0.9525] "m"  ADAS
 SG_ DET_RANGE_VELOCITY_146 : 160|15@1+ (0.0078125,-128) [-128|127.9921875] "m/s"  ADAS
 SG_ DET_RANGE_VELOCITY_ERR_146 : 176|8@1+ (0.003,0) [0|0.765] "m/s"  ADAS
 SG_ DET_AZIMUTH_146 : 200|13@1+ (0.0004,-1.5708) [-1.5708|1.5708] "rad"  ADAS
 SG_ DET_AZIMUTH_ERR_146 : 217|7@1+ (0.00087267,0) [0|0.11082909] "rad"  ADAS
 SG_ DET_ELEVATION_146 : 184|8@1+ (0.00275,-0.34925) [-0.34925|0.34925] "rad"  ADAS
 SG_ DET_ELEVATION_ERR_146 : 192|6@1+ (0.00174533,0) [0|0.10995579] "rad"  ADAS
 SG_ DET_RCS_146 : 240|8@1+ (0.5,-64) [-64|63.5] "dBsm"  ADAS
 SG_ DET_BI_STATIC_FLAG_146 : 216|1@1+ (1,0) [0|1] ""  ADAS
 SG_ DET_SUPER_RES_TARGET_146 : 199|1@1+ (1,0) [0|1] ""  ADAS
 SG_ DET_SNR_146 : 232|8@1+ (0.35156,0) [0|89.6478] "dB"  ADAS
 SG_ DET_EXISTENCE_PROB_146 : 224|6@1+ (1.588,0) [0|100] "%"  ADAS
 SG_ DET_HVC_FLAG_146 : 198|1@1+ (1,0) [0|1] ""  ADAS
 SG_ DET_CONFD_AZIMUTH_146 : 230|2@1+ (1,0) [0|3] ""  ADAS
 SG_ DET_CONFD_ELEVATION_146 : 213|2@1+ (1,0) [0|3] ""  ADAS
 SG_ DET_PROB_1STAZHYPO_146 : 215|1@1+ (1,0) [0|1] ""  ADAS
 SG_ DET_IDM_146 : 175|1@1+ (1,0) [0|1] ""  ADAS
 SG_ DET_MTD_146 : 159|1@1+ (1,0) [0|1] ""  ADAS
 SG_ DET_BELOW_RAIN_THOLD_146 : 151|1@1+ (1,0) [0|1] ""  ADAS
 SG_ DET_RANGE_147 : 248|15@1+ (0.015625,0) [0|500] "m"  ADAS
 SG_ DET_RANGE_ERR_147 : 264|7@1+ (0.0075,0) [0|0.9525] "m"  ADAS
 SG_ DET_RANGE_VELOCITY_147 : 272|15@1+ (0.0078125,-128) [-128|127.9921875] "m/s"  ADAS
 SG_ DET_RANGE_VELOCITY_ERR_147 : 288|8@1+ (0.003,0) [0|0.765] "m/s"  ADAS
 SG_ DET_AZIMUTH_147 : 312|13@1+ (0.0004,-1.5708) [-1.5708|1.5708] "rad"  ADAS
 SG_ DET_AZIMUTH_ERR_147 : 329|7@1+ (0.00087267,0) [0|0.11082909] "rad"  ADAS
 SG_ DET_ELEVATION_147 : 296|8@1+ (0.00275,-0.34925) [-0.34925|0.34925] "rad"  ADAS
 SG_ DET_ELEVATION_ERR_147 : 304|6@1+ (0.00174533,0) [0|0.10995579] "rad"  ADAS
 SG_ DET_RCS_147 : 352|8@1+ (0.5,-64) [-64|63.5] "dBsm"  ADAS
 SG_ DET_BI_STATIC_FLAG_147 : 328|1@1+ (1,0) [0|1] ""  ADAS
 SG_ DET_SUPER_RES_TARGET_147 : 311|1@1+ (1,0) [0|1] ""  ADAS
 SG_ DET_SNR_147 : 344|8@1+ (0.35156,0) [0|89.6478] "dB"  ADAS
 SG_ DET_EXISTENCE_PROB_147 : 336|6@1+ (1.588,0) [0|100] "%"  ADAS
 SG_ DET_HVC_FLAG_147 : 310|1@1+ (1,0) [0|1] ""  ADAS
 SG_ DET_CONFD_AZIMUTH_147 : 342|2@1+ (1,0) [0|3] ""  ADAS
 SG_ DET_CONFD_ELEVATION_147 : 325|2@1+ (1,0) [0|3] ""  ADAS
 SG_ DET_PROB_1STAZHYPO_147 : 327|1@1+ (1,0) [0|1] ""  ADAS
 SG_ DET_IDM_147 : 287|1@1+ (1,0) [0|1] ""  ADAS
 SG_ DET_MTD_147 : 271|1@1+ (1,0) [0|1] ""  ADAS
 SG_ DET_BELOW_RAIN_THOLD_147 : 263|1@1+ (1,0) [0|1] ""  ADAS
 SG_ DET_RANGE_148 : 360|15@1+ (0.015625,0) [0|500] "m"  ADAS
 SG_ DET_RANGE_ERR_148 : 376|7@1+ (0.0075,0) [0|0.9525] "m"  ADAS
 SG_ DET_RANGE_VELOCITY_148 : 384|15@1+ (0.0078125,-128) [-128|127.9921875] "m/s"  ADAS
 SG_ DET_RANGE_VELOCITY_ERR_148 : 400|8@1+ (0.003,0) [0|0.765] "m/s"  ADAS
 SG_ DET_AZIMUTH_148 : 424|13@1+ (0.0004,-1.5708) [-1.5708|1.5708] "rad"  ADAS
 SG_ DET_AZIMUTH_ERR_148 : 441|7@1+ (0.00087267,0) [0|0.11082909] "rad"  ADAS
 SG_ DET_ELEVATION_148 : 408|8@1+ (0.00275,-0.34925) [-0.34925|0.34925] "rad"  ADAS
 SG_ DET_ELEVATION_ERR_148 : 416|6@1+ (0.00174533,0) [0|0.10995579] "rad"  ADAS
 SG_ DET_RCS_148 : 464|8@1+ (0.5,-64) [-64|63.5] "dBsm"  ADAS
 SG_ DET_BI_STATIC_FLAG_148 : 440|1@1+ (1,0) [0|1] ""  ADAS
 SG_ DET_SUPER_RES_TARGET_148 : 423|1@1+ (1,0) [0|1] ""  ADAS
 SG_ DET_SNR_148 : 456|8@1+ (0.35156,0) [0|89.6478] "dB"  ADAS
 SG_ DET_EXISTENCE_PROB_148 : 448|6@1+ (1.588,0) [0|100] "%"  ADAS
 SG_ DET_HVC_FLAG_148 : 422|1@1+ (1,0) [0|1] ""  ADAS
 SG_ DET_CONFD_AZIMUTH_148 : 454|2@1+ (1,0) [0|3] ""  ADAS
 SG_ DET_CONFD_ELEVATION_148 : 437|2@1+ (1,0) [0|3] ""  ADAS
 SG_ DET_MH_SCAN_INDEX_4LSB_145_148 : 476|4@1+ (1,0) [0|15] ""  ADAS
 SG_ DET_MH_CYCLE_COUNTER_145_148 : 16|8@1+ (1,0) [0|255] ""  ADAS
 SG_ DET_MH_CRC16_145_148 : 0|16@1+ (1,0) [0|65535] ""  ADAS
 SG_ DET_PROB_1STAZHYPO_148 : 439|1@1+ (1,0) [0|1] ""  ADAS
 SG_ DET_IDM_148 : 399|1@1+ (1,0) [0|1] ""  ADAS
 SG_ DET_MTD_148 : 383|1@1+ (1,0) [0|1] ""  ADAS
 SG_ DET_BELOW_RAIN_THOLD_148 : 375|1@1+ (1,0) [0|1] ""  ADAS

BO_ 1061 RDR_DETECTION_149_152: 64 RDR07
 SG_ DET_RANGE_149 : 24|15@1+ (0.015625,0) [0|500] "m"  ADAS
 SG_ DET_RANGE_ERR_149 : 40|7@1+ (0.0075,0) [0|0.9525] "m"  ADAS
 SG_ DET_RANGE_VELOCITY_149 : 48|15@1+ (0.0078125,-128) [-128|127.9921875] "m/s"  ADAS
 SG_ DET_RANGE_VELOCITY_ERR_149 : 64|8@1+ (0.003,0) [0|0.765] "m/s"  ADAS
 SG_ DET_AZIMUTH_149 : 88|13@1+ (0.0004,-1.5708) [-1.5708|1.5708] "rad"  ADAS
 SG_ DET_AZIMUTH_ERR_149 : 105|7@1+ (0.00087267,0) [0|0.11082909] "rad"  ADAS
 SG_ DET_ELEVATION_149 : 72|8@1+ (0.00275,-0.34925) [-0.34925|0.34925] "rad"  ADAS
 SG_ DET_ELEVATION_ERR_149 : 80|6@1+ (0.00174533,0) [0|0.10995579] "rad"  ADAS
 SG_ DET_RCS_149 : 128|8@1+ (0.5,-64) [-64|63.5] "dBsm"  ADAS
 SG_ DET_BI_STATIC_FLAG_149 : 104|1@1+ (1,0) [0|1] ""  ADAS
 SG_ DET_SUPER_RES_TARGET_149 : 87|1@1+ (1,0) [0|1] ""  ADAS
 SG_ DET_SNR_149 : 120|8@1+ (0.35156,0) [0|89.6478] "dB"  ADAS
 SG_ DET_EXISTENCE_PROB_149 : 112|6@1+ (1.588,0) [0|100] "%"  ADAS
 SG_ DET_HVC_FLAG_149 : 86|1@1+ (1,0) [0|1] ""  ADAS
 SG_ DET_CONFD_AZIMUTH_149 : 118|2@1+ (1,0) [0|3] ""  ADAS
 SG_ DET_CONFD_ELEVATION_149 : 101|2@1+ (1,0) [0|3] ""  ADAS
 SG_ DET_PROB_1STAZHYPO_149 : 103|1@1+ (1,0) [0|1] ""  ADAS
 SG_ DET_IDM_149 : 63|1@1+ (1,0) [0|1] ""  ADAS
 SG_ DET_MTD_149 : 47|1@1+ (1,0) [0|1] ""  ADAS
 SG_ DET_BELOW_RAIN_THOLD_149 : 39|1@1+ (1,0) [0|1] ""  ADAS
 SG_ DET_RANGE_150 : 136|15@1+ (0.015625,0) [0|500] "m"  ADAS
 SG_ DET_RANGE_ERR_150 : 152|7@1+ (0.0075,0) [0|0.9525] "m"  ADAS
 SG_ DET_RANGE_VELOCITY_150 : 160|15@1+ (0.0078125,-128) [-128|127.9921875] "m/s"  ADAS
 SG_ DET_RANGE_VELOCITY_ERR_150 : 176|8@1+ (0.003,0) [0|0.765] "m/s"  ADAS
 SG_ DET_AZIMUTH_150 : 200|13@1+ (0.0004,-1.5708) [-1.5708|1.5708] "rad"  ADAS
 SG_ DET_AZIMUTH_ERR_150 : 217|7@1+ (0.00087267,0) [0|0.11082909] "rad"  ADAS
 SG_ DET_ELEVATION_150 : 184|8@1+ (0.00275,-0.34925) [-0.34925|0.34925] "rad"  ADAS
 SG_ DET_ELEVATION_ERR_150 : 192|6@1+ (0.00174533,0) [0|0.10995579] "rad"  ADAS
 SG_ DET_RCS_150 : 240|8@1+ (0.5,-64) [-64|63.5] "dBsm"  ADAS
 SG_ DET_BI_STATIC_FLAG_150 : 216|1@1+ (1,0) [0|1] ""  ADAS
 SG_ DET_SUPER_RES_TARGET_150 : 199|1@1+ (1,0) [0|1] ""  ADAS
 SG_ DET_SNR_150 : 232|8@1+ (0.35156,0) [0|89.6478] "dB"  ADAS
 SG_ DET_EXISTENCE_PROB_150 : 224|6@1+ (1.588,0) [0|100] "%"  ADAS
 SG_ DET_HVC_FLAG_150 : 198|1@1+ (1,0) [0|1] ""  ADAS
 SG_ DET_CONFD_AZIMUTH_150 : 230|2@1+ (1,0) [0|3] ""  ADAS
 SG_ DET_CONFD_ELEVATION_150 : 213|2@1+ (1,0) [0|3] ""  ADAS
 SG_ DET_PROB_1STAZHYPO_150 : 215|1@1+ (1,0) [0|1] ""  ADAS
 SG_ DET_IDM_150 : 175|1@1+ (1,0) [0|1] ""  ADAS
 SG_ DET_MTD_150 : 159|1@1+ (1,0) [0|1] ""  ADAS
 SG_ DET_BELOW_RAIN_THOLD_150 : 151|1@1+ (1,0) [0|1] ""  ADAS
 SG_ DET_RANGE_151 : 248|15@1+ (0.015625,0) [0|500] "m"  ADAS
 SG_ DET_RANGE_ERR_151 : 264|7@1+ (0.0075,0) [0|0.9525] "m"  ADAS
 SG_ DET_RANGE_VELOCITY_151 : 272|15@1+ (0.0078125,-128) [-128|127.9921875] "m/s"  ADAS
 SG_ DET_RANGE_VELOCITY_ERR_151 : 288|8@1+ (0.003,0) [0|0.765] "m/s"  ADAS
 SG_ DET_AZIMUTH_151 : 312|13@1+ (0.0004,-1.5708) [-1.5708|1.5708] "rad"  ADAS
 SG_ DET_AZIMUTH_ERR_151 : 329|7@1+ (0.00087267,0) [0|0.11082909] "rad"  ADAS
 SG_ DET_ELEVATION_151 : 296|8@1+ (0.00275,-0.34925) [-0.34925|0.34925] "rad"  ADAS
 SG_ DET_ELEVATION_ERR_151 : 304|6@1+ (0.00174533,0) [0|0.10995579] "rad"  ADAS
 SG_ DET_RCS_151 : 352|8@1+ (0.5,-64) [-64|63.5] "dBsm"  ADAS
 SG_ DET_BI_STATIC_FLAG_151 : 328|1@1+ (1,0) [0|1] ""  ADAS
 SG_ DET_SUPER_RES_TARGET_151 : 311|1@1+ (1,0) [0|1] ""  ADAS
 SG_ DET_SNR_151 : 344|8@1+ (0.35156,0) [0|89.6478] "dB"  ADAS
 SG_ DET_EXISTENCE_PROB_151 : 336|6@1+ (1.588,0) [0|100] "%"  ADAS
 SG_ DET_HVC_FLAG_151 : 310|1@1+ (1,0) [0|1] ""  ADAS
 SG_ DET_CONFD_AZIMUTH_151 : 342|2@1+ (1,0) [0|3] ""  ADAS
 SG_ DET_CONFD_ELEVATION_151 : 325|2@1+ (1,0) [0|3] ""  ADAS
 SG_ DET_PROB_1STAZHYPO_151 : 327|1@1+ (1,0) [0|1] ""  ADAS
 SG_ DET_IDM_151 : 287|1@1+ (1,0) [0|1] ""  ADAS
 SG_ DET_MTD_151 : 271|1@1+ (1,0) [0|1] ""  ADAS
 SG_ DET_BELOW_RAIN_THOLD_151 : 263|1@1+ (1,0) [0|1] ""  ADAS
 SG_ DET_RANGE_152 : 360|15@1+ (0.015625,0) [0|500] "m"  ADAS
 SG_ DET_RANGE_ERR_152 : 376|7@1+ (0.0075,0) [0|0.9525] "m"  ADAS
 SG_ DET_RANGE_VELOCITY_152 : 384|15@1+ (0.0078125,-128) [-128|127.9921875] "m/s"  ADAS
 SG_ DET_RANGE_VELOCITY_ERR_152 : 400|8@1+ (0.003,0) [0|0.765] "m/s"  ADAS
 SG_ DET_AZIMUTH_152 : 424|13@1+ (0.0004,-1.5708) [-1.5708|1.5708] "rad"  ADAS
 SG_ DET_AZIMUTH_ERR_152 : 441|7@1+ (0.00087267,0) [0|0.11082909] "rad"  ADAS
 SG_ DET_ELEVATION_152 : 408|8@1+ (0.00275,-0.34925) [-0.34925|0.34925] "rad"  ADAS
 SG_ DET_ELEVATION_ERR_152 : 416|6@1+ (0.00174533,0) [0|0.10995579] "rad"  ADAS
 SG_ DET_RCS_152 : 464|8@1+ (0.5,-64) [-64|63.5] "dBsm"  ADAS
 SG_ DET_BI_STATIC_FLAG_152 : 440|1@1+ (1,0) [0|1] ""  ADAS
 SG_ DET_SUPER_RES_TARGET_152 : 423|1@1+ (1,0) [0|1] ""  ADAS
 SG_ DET_SNR_152 : 456|8@1+ (0.35156,0) [0|89.6478] "dB"  ADAS
 SG_ DET_EXISTENCE_PROB_152 : 448|6@1+ (1.588,0) [0|100] "%"  ADAS
 SG_ DET_HVC_FLAG_152 : 422|1@1+ (1,0) [0|1] ""  ADAS
 SG_ DET_CONFD_AZIMUTH_152 : 454|2@1+ (1,0) [0|3] ""  ADAS
 SG_ DET_CONFD_ELEVATION_152 : 437|2@1+ (1,0) [0|3] ""  ADAS
 SG_ DET_MH_SCAN_INDEX_4LSB_149_152 : 476|4@1+ (1,0) [0|15] ""  ADAS
 SG_ DET_MH_CYCLE_COUNTER_149_152 : 16|8@1+ (1,0) [0|255] ""  ADAS
 SG_ DET_MH_CRC16_149_152 : 0|16@1+ (1,0) [0|65535] ""  ADAS
 SG_ DET_PROB_1STAZHYPO_152 : 439|1@1+ (1,0) [0|1] ""  ADAS
 SG_ DET_IDM_152 : 399|1@1+ (1,0) [0|1] ""  ADAS
 SG_ DET_MTD_152 : 383|1@1+ (1,0) [0|1] ""  ADAS
 SG_ DET_BELOW_RAIN_THOLD_152 : 375|1@1+ (1,0) [0|1] ""  ADAS

BO_ 1062 RDR_DETECTION_153_156: 64 RDR07
 SG_ DET_RANGE_153 : 24|15@1+ (0.015625,0) [0|500] "m"  ADAS
 SG_ DET_RANGE_ERR_153 : 40|7@1+ (0.0075,0) [0|0.9525] "m"  ADAS
 SG_ DET_RANGE_VELOCITY_153 : 48|15@1+ (0.0078125,-128) [-128|127.9921875] "m/s"  ADAS
 SG_ DET_RANGE_VELOCITY_ERR_153 : 64|8@1+ (0.003,0) [0|0.765] "m/s"  ADAS
 SG_ DET_AZIMUTH_153 : 88|13@1+ (0.0004,-1.5708) [-1.5708|1.5708] "rad"  ADAS
 SG_ DET_AZIMUTH_ERR_153 : 105|7@1+ (0.00087267,0) [0|0.11082909] "rad"  ADAS
 SG_ DET_ELEVATION_153 : 72|8@1+ (0.00275,-0.34925) [-0.34925|0.34925] "rad"  ADAS
 SG_ DET_ELEVATION_ERR_153 : 80|6@1+ (0.00174533,0) [0|0.10995579] "rad"  ADAS
 SG_ DET_RCS_153 : 128|8@1+ (0.5,-64) [-64|63.5] "dBsm"  ADAS
 SG_ DET_BI_STATIC_FLAG_153 : 104|1@1+ (1,0) [0|1] ""  ADAS
 SG_ DET_SUPER_RES_TARGET_153 : 87|1@1+ (1,0) [0|1] ""  ADAS
 SG_ DET_SNR_153 : 120|8@1+ (0.35156,0) [0|89.6478] "dB"  ADAS
 SG_ DET_EXISTENCE_PROB_153 : 112|6@1+ (1.588,0) [0|100] "%"  ADAS
 SG_ DET_HVC_FLAG_153 : 86|1@1+ (1,0) [0|1] ""  ADAS
 SG_ DET_CONFD_AZIMUTH_153 : 118|2@1+ (1,0) [0|3] ""  ADAS
 SG_ DET_CONFD_ELEVATION_153 : 101|2@1+ (1,0) [0|3] ""  ADAS
 SG_ DET_PROB_1STAZHYPO_153 : 103|1@1+ (1,0) [0|1] ""  ADAS
 SG_ DET_IDM_153 : 63|1@1+ (1,0) [0|1] ""  ADAS
 SG_ DET_MTD_153 : 47|1@1+ (1,0) [0|1] ""  ADAS
 SG_ DET_BELOW_RAIN_THOLD_153 : 39|1@1+ (1,0) [0|1] ""  ADAS
 SG_ DET_RANGE_154 : 136|15@1+ (0.015625,0) [0|500] "m"  ADAS
 SG_ DET_RANGE_ERR_154 : 152|7@1+ (0.0075,0) [0|0.9525] "m"  ADAS
 SG_ DET_RANGE_VELOCITY_154 : 160|15@1+ (0.0078125,-128) [-128|127.9921875] "m/s"  ADAS
 SG_ DET_RANGE_VELOCITY_ERR_154 : 176|8@1+ (0.003,0) [0|0.765] "m/s"  ADAS
 SG_ DET_AZIMUTH_154 : 200|13@1+ (0.0004,-1.5708) [-1.5708|1.5708] "rad"  ADAS
 SG_ DET_AZIMUTH_ERR_154 : 217|7@1+ (0.00087267,0) [0|0.11082909] "rad"  ADAS
 SG_ DET_ELEVATION_154 : 184|8@1+ (0.00275,-0.34925) [-0.34925|0.34925] "rad"  ADAS
 SG_ DET_ELEVATION_ERR_154 : 192|6@1+ (0.00174533,0) [0|0.10995579] "rad"  ADAS
 SG_ DET_RCS_154 : 240|8@1+ (0.5,-64) [-64|63.5] "dBsm"  ADAS
 SG_ DET_BI_STATIC_FLAG_154 : 216|1@1+ (1,0) [0|1] ""  ADAS
 SG_ DET_SUPER_RES_TARGET_154 : 199|1@1+ (1,0) [0|1] ""  ADAS
 SG_ DET_SNR_154 : 232|8@1+ (0.35156,0) [0|89.6478] "dB"  ADAS
 SG_ DET_EXISTENCE_PROB_154 : 224|6@1+ (1.588,0) [0|100] "%"  ADAS
 SG_ DET_HVC_FLAG_154 : 198|1@1+ (1,0) [0|1] ""  ADAS
 SG_ DET_CONFD_AZIMUTH_154 : 230|2@1+ (1,0) [0|3] ""  ADAS
 SG_ DET_CONFD_ELEVATION_154 : 213|2@1+ (1,0) [0|3] ""  ADAS
 SG_ DET_PROB_1STAZHYPO_154 : 215|1@1+ (1,0) [0|1] ""  ADAS
 SG_ DET_IDM_154 : 175|1@1+ (1,0) [0|1] ""  ADAS
 SG_ DET_MTD_154 : 159|1@1+ (1,0) [0|1] ""  ADAS
 SG_ DET_BELOW_RAIN_THOLD_154 : 151|1@1+ (1,0) [0|1] ""  ADAS
 SG_ DET_RANGE_155 : 248|15@1+ (0.015625,0) [0|500] "m"  ADAS
 SG_ DET_RANGE_ERR_155 : 264|7@1+ (0.0075,0) [0|0.9525] "m"  ADAS
 SG_ DET_RANGE_VELOCITY_155 : 272|15@1+ (0.0078125,-128) [-128|127.9921875] "m/s"  ADAS
 SG_ DET_RANGE_VELOCITY_ERR_155 : 288|8@1+ (0.003,0) [0|0.765] "m/s"  ADAS
 SG_ DET_AZIMUTH_155 : 312|13@1+ (0.0004,-1.5708) [-1.5708|1.5708] "rad"  ADAS
 SG_ DET_AZIMUTH_ERR_155 : 329|7@1+ (0.00087267,0) [0|0.11082909] "rad"  ADAS
 SG_ DET_ELEVATION_155 : 296|8@1+ (0.00275,-0.34925) [-0.34925|0.34925] "rad"  ADAS
 SG_ DET_ELEVATION_ERR_155 : 304|6@1+ (0.00174533,0) [0|0.10995579] "rad"  ADAS
 SG_ DET_RCS_155 : 352|8@1+ (0.5,-64) [-64|63.5] "dBsm"  ADAS
 SG_ DET_BI_STATIC_FLAG_155 : 328|1@1+ (1,0) [0|1] ""  ADAS
 SG_ DET_SUPER_RES_TARGET_155 : 311|1@1+ (1,0) [0|1] ""  ADAS
 SG_ DET_SNR_155 : 344|8@1+ (0.35156,0) [0|89.6478] "dB"  ADAS
 SG_ DET_EXISTENCE_PROB_155 : 336|6@1+ (1.588,0) [0|100] "%"  ADAS
 SG_ DET_HVC_FLAG_155 : 310|1@1+ (1,0) [0|1] ""  ADAS
 SG_ DET_CONFD_AZIMUTH_155 : 342|2@1+ (1,0) [0|3] ""  ADAS
 SG_ DET_CONFD_ELEVATION_155 : 325|2@1+ (1,0) [0|3] ""  ADAS
 SG_ DET_PROB_1STAZHYPO_155 : 327|1@1+ (1,0) [0|1] ""  ADAS
 SG_ DET_IDM_155 : 287|1@1+ (1,0) [0|1] ""  ADAS
 SG_ DET_MTD_155 : 271|1@1+ (1,0) [0|1] ""  ADAS
 SG_ DET_BELOW_RAIN_THOLD_155 : 263|1@1+ (1,0) [0|1] ""  ADAS
 SG_ DET_RANGE_156 : 360|15@1+ (0.015625,0) [0|500] "m"  ADAS
 SG_ DET_RANGE_ERR_156 : 376|7@1+ (0.0075,0) [0|0.9525] "m"  ADAS
 SG_ DET_RANGE_VELOCITY_156 : 384|15@1+ (0.0078125,-128) [-128|127.9921875] "m/s"  ADAS
 SG_ DET_RANGE_VELOCITY_ERR_156 : 400|8@1+ (0.003,0) [0|0.765] "m/s"  ADAS
 SG_ DET_AZIMUTH_156 : 424|13@1+ (0.0004,-1.5708) [-1.5708|1.5708] "rad"  ADAS
 SG_ DET_AZIMUTH_ERR_156 : 441|7@1+ (0.00087267,0) [0|0.11082909] "rad"  ADAS
 SG_ DET_ELEVATION_156 : 408|8@1+ (0.00275,-0.34925) [-0.34925|0.34925] "rad"  ADAS
 SG_ DET_ELEVATION_ERR_156 : 416|6@1+ (0.00174533,0) [0|0.10995579] "rad"  ADAS
 SG_ DET_RCS_156 : 464|8@1+ (0.5,-64) [-64|63.5] "dBsm"  ADAS
 SG_ DET_BI_STATIC_FLAG_156 : 440|1@1+ (1,0) [0|1] ""  ADAS
 SG_ DET_SUPER_RES_TARGET_156 : 423|1@1+ (1,0) [0|1] ""  ADAS
 SG_ DET_SNR_156 : 456|8@1+ (0.35156,0) [0|89.6478] "dB"  ADAS
 SG_ DET_EXISTENCE_PROB_156 : 448|6@1+ (1.588,0) [0|100] "%"  ADAS
 SG_ DET_HVC_FLAG_156 : 422|1@1+ (1,0) [0|1] ""  ADAS
 SG_ DET_CONFD_AZIMUTH_156 : 454|2@1+ (1,0) [0|3] ""  ADAS
 SG_ DET_CONFD_ELEVATION_156 : 437|2@1+ (1,0) [0|3] ""  ADAS
 SG_ DET_MH_SCAN_INDEX_4LSB_153_156 : 476|4@1+ (1,0) [0|15] ""  ADAS
 SG_ DET_MH_CYCLE_COUNTER_153_156 : 16|8@1+ (1,0) [0|255] ""  ADAS
 SG_ DET_MH_CRC16_153_156 : 0|16@1+ (1,0) [0|65535] ""  ADAS
 SG_ DET_PROB_1STAZHYPO_156 : 439|1@1+ (1,0) [0|1] ""  ADAS
 SG_ DET_IDM_156 : 399|1@1+ (1,0) [0|1] ""  ADAS
 SG_ DET_MTD_156 : 383|1@1+ (1,0) [0|1] ""  ADAS
 SG_ DET_BELOW_RAIN_THOLD_156 : 375|1@1+ (1,0) [0|1] ""  ADAS

BO_ 1063 RDR_DETECTION_157_160: 64 RDR07
 SG_ DET_RANGE_157 : 24|15@1+ (0.015625,0) [0|500] "m"  ADAS
 SG_ DET_RANGE_ERR_157 : 40|7@1+ (0.0075,0) [0|0.9525] "m"  ADAS
 SG_ DET_RANGE_VELOCITY_157 : 48|15@1+ (0.0078125,-128) [-128|127.9921875] "m/s"  ADAS
 SG_ DET_RANGE_VELOCITY_ERR_157 : 64|8@1+ (0.003,0) [0|0.765] "m/s"  ADAS
 SG_ DET_AZIMUTH_157 : 88|13@1+ (0.0004,-1.5708) [-1.5708|1.5708] "rad"  ADAS
 SG_ DET_AZIMUTH_ERR_157 : 105|7@1+ (0.00087267,0) [0|0.11082909] "rad"  ADAS
 SG_ DET_ELEVATION_157 : 72|8@1+ (0.00275,-0.34925) [-0.34925|0.34925] "rad"  ADAS
 SG_ DET_ELEVATION_ERR_157 : 80|6@1+ (0.00174533,0) [0|0.10995579] "rad"  ADAS
 SG_ DET_RCS_157 : 128|8@1+ (0.5,-64) [-64|63.5] "dBsm"  ADAS
 SG_ DET_BI_STATIC_FLAG_157 : 104|1@1+ (1,0) [0|1] ""  ADAS
 SG_ DET_SUPER_RES_TARGET_157 : 87|1@1+ (1,0) [0|1] ""  ADAS
 SG_ DET_SNR_157 : 120|8@1+ (0.35156,0) [0|89.6478] "dB"  ADAS
 SG_ DET_EXISTENCE_PROB_157 : 112|6@1+ (1.588,0) [0|100] "%"  ADAS
 SG_ DET_HVC_FLAG_157 : 86|1@1+ (1,0) [0|1] ""  ADAS
 SG_ DET_CONFD_AZIMUTH_157 : 118|2@1+ (1,0) [0|3] ""  ADAS
 SG_ DET_CONFD_ELEVATION_157 : 101|2@1+ (1,0) [0|3] ""  ADAS
 SG_ DET_PROB_1STAZHYPO_157 : 103|1@1+ (1,0) [0|1] ""  ADAS
 SG_ DET_IDM_157 : 63|1@1+ (1,0) [0|1] ""  ADAS
 SG_ DET_MTD_157 : 47|1@1+ (1,0) [0|1] ""  ADAS
 SG_ DET_BELOW_RAIN_THOLD_157 : 39|1@1+ (1,0) [0|1] ""  ADAS
 SG_ DET_RANGE_158 : 136|15@1+ (0.015625,0) [0|500] "m"  ADAS
 SG_ DET_RANGE_ERR_158 : 152|7@1+ (0.0075,0) [0|0.9525] "m"  ADAS
 SG_ DET_RANGE_VELOCITY_158 : 160|15@1+ (0.0078125,-128) [-128|127.9921875] "m/s"  ADAS
 SG_ DET_RANGE_VELOCITY_ERR_158 : 176|8@1+ (0.003,0) [0|0.765] "m/s"  ADAS
 SG_ DET_AZIMUTH_158 : 200|13@1+ (0.0004,-1.5708) [-1.5708|1.5708] "rad"  ADAS
 SG_ DET_AZIMUTH_ERR_158 : 217|7@1+ (0.00087267,0) [0|0.11082909] "rad"  ADAS
 SG_ DET_ELEVATION_158 : 184|8@1+ (0.00275,-0.34925) [-0.34925|0.34925] "rad"  ADAS
 SG_ DET_ELEVATION_ERR_158 : 192|6@1+ (0.00174533,0) [0|0.10995579] "rad"  ADAS
 SG_ DET_RCS_158 : 240|8@1+ (0.5,-64) [-64|63.5] "dBsm"  ADAS
 SG_ DET_BI_STATIC_FLAG_158 : 216|1@1+ (1,0) [0|1] ""  ADAS
 SG_ DET_SUPER_RES_TARGET_158 : 199|1@1+ (1,0) [0|1] ""  ADAS
 SG_ DET_SNR_158 : 232|8@1+ (0.35156,0) [0|89.6478] "dB"  ADAS
 SG_ DET_EXISTENCE_PROB_158 : 224|6@1+ (1.588,0) [0|100] "%"  ADAS
 SG_ DET_HVC_FLAG_158 : 198|1@1+ (1,0) [0|1] ""  ADAS
 SG_ DET_CONFD_AZIMUTH_158 : 230|2@1+ (1,0) [0|3] ""  ADAS
 SG_ DET_CONFD_ELEVATION_158 : 213|2@1+ (1,0) [0|3] ""  ADAS
 SG_ DET_PROB_1STAZHYPO_158 : 215|1@1+ (1,0) [0|1] ""  ADAS
 SG_ DET_IDM_158 : 175|1@1+ (1,0) [0|1] ""  ADAS
 SG_ DET_MTD_158 : 159|1@1+ (1,0) [0|1] ""  ADAS
 SG_ DET_BELOW_RAIN_THOLD_158 : 151|1@1+ (1,0) [0|1] ""  ADAS
 SG_ DET_RANGE_159 : 248|15@1+ (0.015625,0) [0|500] "m"  ADAS
 SG_ DET_RANGE_ERR_159 : 264|7@1+ (0.0075,0) [0|0.9525] "m"  ADAS
 SG_ DET_RANGE_VELOCITY_159 : 272|15@1+ (0.0078125,-128) [-128|127.9921875] "m/s"  ADAS
 SG_ DET_RANGE_VELOCITY_ERR_159 : 288|8@1+ (0.003,0) [0|0.765] "m/s"  ADAS
 SG_ DET_AZIMUTH_159 : 312|13@1+ (0.0004,-1.5708) [-1.5708|1.5708] "rad"  ADAS
 SG_ DET_AZIMUTH_ERR_159 : 329|7@1+ (0.00087267,0) [0|0.11082909] "rad"  ADAS
 SG_ DET_ELEVATION_159 : 296|8@1+ (0.00275,-0.34925) [-0.34925|0.34925] "rad"  ADAS
 SG_ DET_ELEVATION_ERR_159 : 304|6@1+ (0.00174533,0) [0|0.10995579] "rad"  ADAS
 SG_ DET_RCS_159 : 352|8@1+ (0.5,-64) [-64|63.5] "dBsm"  ADAS
 SG_ DET_BI_STATIC_FLAG_159 : 328|1@1+ (1,0) [0|1] ""  ADAS
 SG_ DET_SUPER_RES_TARGET_159 : 311|1@1+ (1,0) [0|1] ""  ADAS
 SG_ DET_SNR_159 : 344|8@1+ (0.35156,0) [0|89.6478] "dB"  ADAS
 SG_ DET_EXISTENCE_PROB_159 : 336|6@1+ (1.588,0) [0|100] "%"  ADAS
 SG_ DET_HVC_FLAG_159 : 310|1@1+ (1,0) [0|1] ""  ADAS
 SG_ DET_CONFD_AZIMUTH_159 : 342|2@1+ (1,0) [0|3] ""  ADAS
 SG_ DET_CONFD_ELEVATION_159 : 325|2@1+ (1,0) [0|3] ""  ADAS
 SG_ DET_PROB_1STAZHYPO_159 : 327|1@1+ (1,0) [0|1] ""  ADAS
 SG_ DET_IDM_159 : 287|1@1+ (1,0) [0|1] ""  ADAS
 SG_ DET_MTD_159 : 271|1@1+ (1,0) [0|1] ""  ADAS
 SG_ DET_BELOW_RAIN_THOLD_159 : 263|1@1+ (1,0) [0|1] ""  ADAS
 SG_ DET_RANGE_160 : 360|15@1+ (0.015625,0) [0|500] "m"  ADAS
 SG_ DET_RANGE_ERR_160 : 376|7@1+ (0.0075,0) [0|0.9525] "m"  ADAS
 SG_ DET_RANGE_VELOCITY_160 : 384|15@1+ (0.0078125,-128) [-128|127.9921875] "m/s"  ADAS
 SG_ DET_RANGE_VELOCITY_ERR_160 : 400|8@1+ (0.003,0) [0|0.765] "m/s"  ADAS
 SG_ DET_AZIMUTH_160 : 424|13@1+ (0.0004,-1.5708) [-1.5708|1.5708] "rad"  ADAS
 SG_ DET_AZIMUTH_ERR_160 : 441|7@1+ (0.00087267,0) [0|0.11082909] "rad"  ADAS
 SG_ DET_ELEVATION_160 : 408|8@1+ (0.00275,-0.34925) [-0.34925|0.34925] "rad"  ADAS
 SG_ DET_ELEVATION_ERR_160 : 416|6@1+ (0.00174533,0) [0|0.10995579] "rad"  ADAS
 SG_ DET_RCS_160 : 464|8@1+ (0.5,-64) [-64|63.5] "dBsm"  ADAS
 SG_ DET_BI_STATIC_FLAG_160 : 440|1@1+ (1,0) [0|1] ""  ADAS
 SG_ DET_SUPER_RES_TARGET_160 : 423|1@1+ (1,0) [0|1] ""  ADAS
 SG_ DET_SNR_160 : 456|8@1+ (0.35156,0) [0|89.6478] "dB"  ADAS
 SG_ DET_EXISTENCE_PROB_160 : 448|6@1+ (1.588,0) [0|100] "%"  ADAS
 SG_ DET_HVC_FLAG_160 : 422|1@1+ (1,0) [0|1] ""  ADAS
 SG_ DET_CONFD_AZIMUTH_160 : 454|2@1+ (1,0) [0|3] ""  ADAS
 SG_ DET_CONFD_ELEVATION_160 : 437|2@1+ (1,0) [0|3] ""  ADAS
 SG_ DET_MH_SCAN_INDEX_4LSB_157_160 : 476|4@1+ (1,0) [0|15] ""  ADAS
 SG_ DET_MH_CYCLE_COUNTER_157_160 : 16|8@1+ (1,0) [0|255] ""  ADAS
 SG_ DET_MH_CRC16_157_160 : 0|16@1+ (1,0) [0|65535] ""  ADAS
 SG_ DET_PROB_1STAZHYPO_160 : 439|1@1+ (1,0) [0|1] ""  ADAS
 SG_ DET_IDM_160 : 399|1@1+ (1,0) [0|1] ""  ADAS
 SG_ DET_MTD_160 : 383|1@1+ (1,0) [0|1] ""  ADAS
 SG_ DET_BELOW_RAIN_THOLD_160 : 375|1@1+ (1,0) [0|1] ""  ADAS

CM_ SG_ 1048 DET_RANGE_097 " measured position  of the detection";
CM_ SG_ 1048 DET_RANGE_ERR_097 "RMSE or standard deviation of the measured angle  of the detection";
CM_ SG_ 1048 DET_RANGE_VELOCITY_097 "Radial velocity of the detection positive in direction to the sensor";
CM_ SG_ 1048 DET_RANGE_VELOCITY_ERR_097 "RMSE or standard deviation of the measure radial velocity of the detection";
CM_ SG_ 1048 DET_AZIMUTH_097 "Measured angle  of the detection";
CM_ SG_ 1048 DET_AZIMUTH_ERR_097 "RMSE or standard deviation of the measured angle  of the detection";
CM_ SG_ 1048 DET_ELEVATION_097 "measured elevation of the detection";
CM_ SG_ 1048 DET_ELEVATION_ERR_097 "RMSE or standard deviation of the measured elevation  of the detection";
CM_ SG_ 1048 DET_RCS_097 "Radar Cross Section or Amplitude, is a measure of how detectable an object is by radar. A larger RCS indicates that an object is more easily detected.";
CM_ SG_ 1048 DET_BI_STATIC_FLAG_097 "1 if detection is bi-static 0 otherwise";
CM_ SG_ 1048 DET_SUPER_RES_TARGET_097 "flasg is set if the detection is super resolution target";
CM_ SG_ 1048 DET_SNR_097 "The signal to noise ratio (SNR) of the radar detection";
CM_ SG_ 1048 DET_EXISTENCE_PROB_097 "Existence probability of the detection not based on history. Value does  not depend on any past experience with similar detections.
\note Use as confidence measure where a low value means less confidence
and a high value indicates strong confidence.";
CM_ SG_ 1048 DET_HVC_FLAG_097 "Core2 Vehicle clutter flag";
CM_ SG_ 1048 DET_CONFD_AZIMUTH_097 "Define the Confidence of Azimuth for Detection ";
CM_ SG_ 1048 DET_CONFD_ELEVATION_097 "Define the Confidence of Elevation for the Detection ";
CM_ SG_ 1048 DET_BI_STATIC_FLAG_098 "1 if detection is bi-static 0 otherwise";
CM_ SG_ 1048 DET_BI_STATIC_FLAG_099 "1 if detection is bi-static 0 otherwise";
CM_ SG_ 1048 DET_BI_STATIC_FLAG_100 "1 if detection is bi-static 0 otherwise";
CM_ SG_ 1048 DET_MH_SCAN_INDEX_4LSB_097_100 "Scan index of the measured detection";
CM_ SG_ 1048 DET_MH_CYCLE_COUNTER_097_100 "Detection Alive Counter";
CM_ SG_ 1049 DET_RANGE_101 " measured position  of the detection";
CM_ SG_ 1049 DET_RANGE_ERR_101 "RMSE or standard deviation of the measured angle  of the detection";
CM_ SG_ 1049 DET_RANGE_VELOCITY_101 "Radial velocity of the detection positive in direction to the sensor";
CM_ SG_ 1049 DET_RANGE_VELOCITY_ERR_101 "RMSE or standard deviation of the measure radial velocity of the detection";
CM_ SG_ 1049 DET_AZIMUTH_101 "Measured angle  of the detection";
CM_ SG_ 1049 DET_AZIMUTH_ERR_101 "RMSE or standard deviation of the measured angle  of the detection";
CM_ SG_ 1049 DET_ELEVATION_101 "measured elevation of the detection";
CM_ SG_ 1049 DET_ELEVATION_ERR_101 "RMSE or standard deviation of the measured elevation  of the detection";
CM_ SG_ 1049 DET_RCS_101 "Radar Cross Section or Amplitude, is a measure of how detectable an object is by radar. A larger RCS indicates that an object is more easily detected.";
CM_ SG_ 1049 DET_BI_STATIC_FLAG_101 "1 if detection is bi-static 0 otherwise";
CM_ SG_ 1049 DET_SUPER_RES_TARGET_101 "flasg is set if the detection is super resolution target";
CM_ SG_ 1049 DET_SNR_101 "The signal to noise ratio (SNR) of the radar detection";
CM_ SG_ 1049 DET_EXISTENCE_PROB_101 "Existence probability of the detection not based on history. Value does  not depend on any past experience with similar detections.
\note Use as confidence measure where a low value means less confidence
and a high value indicates strong confidence.";
CM_ SG_ 1049 DET_HVC_FLAG_101 "Core2 Vehicle clutter flag";
CM_ SG_ 1049 DET_CONFD_AZIMUTH_101 "Define the Confidence of Azimuth for Detection ";
CM_ SG_ 1049 DET_CONFD_ELEVATION_101 "Define the Confidence of Elevation for the Detection ";
CM_ SG_ 1049 DET_BI_STATIC_FLAG_102 "1 if detection is bi-static 0 otherwise";
CM_ SG_ 1049 DET_BI_STATIC_FLAG_103 "1 if detection is bi-static 0 otherwise";
CM_ SG_ 1049 DET_BI_STATIC_FLAG_104 "1 if detection is bi-static 0 otherwise";
CM_ SG_ 1049 DET_MH_SCAN_INDEX_4LSB_101_104 "Scan index of the measured detection";
CM_ SG_ 1049 DET_MH_CYCLE_COUNTER_101_104 "Detection Alive Counter";
CM_ SG_ 1050 DET_RANGE_105 " measured position  of the detection";
CM_ SG_ 1050 DET_RANGE_ERR_105 "RMSE or standard deviation of the measured angle  of the detection";
CM_ SG_ 1050 DET_RANGE_VELOCITY_105 "Radial velocity of the detection positive in direction to the sensor";
CM_ SG_ 1050 DET_RANGE_VELOCITY_ERR_105 "RMSE or standard deviation of the measure radial velocity of the detection";
CM_ SG_ 1050 DET_AZIMUTH_105 "Measured angle  of the detection";
CM_ SG_ 1050 DET_AZIMUTH_ERR_105 "RMSE or standard deviation of the measured angle  of the detection";
CM_ SG_ 1050 DET_ELEVATION_105 "measured elevation of the detection";
CM_ SG_ 1050 DET_ELEVATION_ERR_105 "RMSE or standard deviation of the measured elevation  of the detection";
CM_ SG_ 1050 DET_RCS_105 "Radar Cross Section or Amplitude, is a measure of how detectable an object is by radar. A larger RCS indicates that an object is more easily detected.";
CM_ SG_ 1050 DET_BI_STATIC_FLAG_105 "1 if detection is bi-static 0 otherwise";
CM_ SG_ 1050 DET_SUPER_RES_TARGET_105 "flasg is set if the detection is super resolution target";
CM_ SG_ 1050 DET_SNR_105 "The signal to noise ratio (SNR) of the radar detection";
CM_ SG_ 1050 DET_EXISTENCE_PROB_105 "Existence probability of the detection not based on history. Value does  not depend on any past experience with similar detections.
\note Use as confidence measure where a low value means less confidence
and a high value indicates strong confidence.";
CM_ SG_ 1050 DET_HVC_FLAG_105 "Core2 Vehicle clutter flag";
CM_ SG_ 1050 DET_CONFD_AZIMUTH_105 "Define the Confidence of Azimuth for Detection ";
CM_ SG_ 1050 DET_CONFD_ELEVATION_105 "Define the Confidence of Elevation for the Detection ";
CM_ SG_ 1050 DET_BI_STATIC_FLAG_106 "1 if detection is bi-static 0 otherwise";
CM_ SG_ 1050 DET_BI_STATIC_FLAG_107 "1 if detection is bi-static 0 otherwise";
CM_ SG_ 1050 DET_BI_STATIC_FLAG_108 "1 if detection is bi-static 0 otherwise";
CM_ SG_ 1050 DET_MH_SCAN_INDEX_4LSB_105_108 "Scan index of the measured detection";
CM_ SG_ 1050 DET_MH_CYCLE_COUNTER_105_108 "Detection Alive Counter";
CM_ SG_ 1051 DET_RANGE_109 " measured position  of the detection";
CM_ SG_ 1051 DET_RANGE_ERR_109 "RMSE or standard deviation of the measured angle  of the detection";
CM_ SG_ 1051 DET_RANGE_VELOCITY_109 "Radial velocity of the detection positive in direction to the sensor";
CM_ SG_ 1051 DET_RANGE_VELOCITY_ERR_109 "RMSE or standard deviation of the measure radial velocity of the detection";
CM_ SG_ 1051 DET_AZIMUTH_109 "Measured angle  of the detection";
CM_ SG_ 1051 DET_AZIMUTH_ERR_109 "RMSE or standard deviation of the measured angle  of the detection";
CM_ SG_ 1051 DET_ELEVATION_109 "measured elevation of the detection";
CM_ SG_ 1051 DET_ELEVATION_ERR_109 "RMSE or standard deviation of the measured elevation  of the detection";
CM_ SG_ 1051 DET_RCS_109 "Radar Cross Section or Amplitude, is a measure of how detectable an object is by radar. A larger RCS indicates that an object is more easily detected.";
CM_ SG_ 1051 DET_BI_STATIC_FLAG_109 "1 if detection is bi-static 0 otherwise";
CM_ SG_ 1051 DET_SUPER_RES_TARGET_109 "flasg is set if the detection is super resolution target";
CM_ SG_ 1051 DET_SNR_109 "The signal to noise ratio (SNR) of the radar detection";
CM_ SG_ 1051 DET_EXISTENCE_PROB_109 "Existence probability of the detection not based on history. Value does  not depend on any past experience with similar detections.
\note Use as confidence measure where a low value means less confidence
and a high value indicates strong confidence.";
CM_ SG_ 1051 DET_HVC_FLAG_109 "Core2 Vehicle clutter flag";
CM_ SG_ 1051 DET_CONFD_AZIMUTH_109 "Define the Confidence of Azimuth for Detection ";
CM_ SG_ 1051 DET_CONFD_ELEVATION_109 "Define the Confidence of Elevation for the Detection ";
CM_ SG_ 1051 DET_BI_STATIC_FLAG_110 "1 if detection is bi-static 0 otherwise";
CM_ SG_ 1051 DET_BI_STATIC_FLAG_111 "1 if detection is bi-static 0 otherwise";
CM_ SG_ 1051 DET_BI_STATIC_FLAG_112 "1 if detection is bi-static 0 otherwise";
CM_ SG_ 1051 DET_MH_SCAN_INDEX_4LSB_109_112 "Scan index of the measured detection";
CM_ SG_ 1051 DET_MH_CYCLE_COUNTER_109_112 "Detection Alive Counter";
CM_ SG_ 1052 DET_RANGE_113 " measured position  of the detection";
CM_ SG_ 1052 DET_RANGE_ERR_113 "RMSE or standard deviation of the measured angle  of the detection";
CM_ SG_ 1052 DET_RANGE_VELOCITY_113 "Radial velocity of the detection positive in direction to the sensor";
CM_ SG_ 1052 DET_RANGE_VELOCITY_ERR_113 "RMSE or standard deviation of the measure radial velocity of the detection";
CM_ SG_ 1052 DET_AZIMUTH_113 "Measured angle  of the detection";
CM_ SG_ 1052 DET_AZIMUTH_ERR_113 "RMSE or standard deviation of the measured angle  of the detection";
CM_ SG_ 1052 DET_ELEVATION_113 "measured elevation of the detection";
CM_ SG_ 1052 DET_ELEVATION_ERR_113 "RMSE or standard deviation of the measured elevation  of the detection";
CM_ SG_ 1052 DET_RCS_113 "Radar Cross Section or Amplitude, is a measure of how detectable an object is by radar. A larger RCS indicates that an object is more easily detected.";
CM_ SG_ 1052 DET_BI_STATIC_FLAG_113 "1 if detection is bi-static 0 otherwise";
CM_ SG_ 1052 DET_SUPER_RES_TARGET_113 "flasg is set if the detection is super resolution target";
CM_ SG_ 1052 DET_SNR_113 "The signal to noise ratio (SNR) of the radar detection";
CM_ SG_ 1052 DET_EXISTENCE_PROB_113 "Existence probability of the detection not based on history. Value does  not depend on any past experience with similar detections.
\note Use as confidence measure where a low value means less confidence
and a high value indicates strong confidence.";
CM_ SG_ 1052 DET_HVC_FLAG_113 "Core2 Vehicle clutter flag";
CM_ SG_ 1052 DET_CONFD_AZIMUTH_113 "Define the Confidence of Azimuth for Detection ";
CM_ SG_ 1052 DET_CONFD_ELEVATION_113 "Define the Confidence of Elevation for the Detection ";
CM_ SG_ 1052 DET_BI_STATIC_FLAG_114 "1 if detection is bi-static 0 otherwise";
CM_ SG_ 1052 DET_BI_STATIC_FLAG_115 "1 if detection is bi-static 0 otherwise";
CM_ SG_ 1052 DET_BI_STATIC_FLAG_116 "1 if detection is bi-static 0 otherwise";
CM_ SG_ 1052 DET_MH_SCAN_INDEX_4LSB_113_116 "Scan index of the measured detection";
CM_ SG_ 1052 DET_MH_CYCLE_COUNTER_113_116 "Detection Alive Counter";
CM_ SG_ 1053 DET_RANGE_117 " measured position  of the detection";
CM_ SG_ 1053 DET_RANGE_ERR_117 "RMSE or standard deviation of the measured angle  of the detection";
CM_ SG_ 1053 DET_RANGE_VELOCITY_117 "Radial velocity of the detection positive in direction to the sensor";
CM_ SG_ 1053 DET_RANGE_VELOCITY_ERR_117 "RMSE or standard deviation of the measure radial velocity of the detection";
CM_ SG_ 1053 DET_AZIMUTH_117 "Measured angle  of the detection";
CM_ SG_ 1053 DET_AZIMUTH_ERR_117 "RMSE or standard deviation of the measured angle  of the detection";
CM_ SG_ 1053 DET_ELEVATION_117 "measured elevation of the detection";
CM_ SG_ 1053 DET_ELEVATION_ERR_117 "RMSE or standard deviation of the measured elevation  of the detection";
CM_ SG_ 1053 DET_RCS_117 "Radar Cross Section or Amplitude, is a measure of how detectable an object is by radar. A larger RCS indicates that an object is more easily detected.";
CM_ SG_ 1053 DET_BI_STATIC_FLAG_117 "1 if detection is bi-static 0 otherwise";
CM_ SG_ 1053 DET_SUPER_RES_TARGET_117 "flasg is set if the detection is super resolution target";
CM_ SG_ 1053 DET_SNR_117 "The signal to noise ratio (SNR) of the radar detection";
CM_ SG_ 1053 DET_EXISTENCE_PROB_117 "Existence probability of the detection not based on history. Value does  not depend on any past experience with similar detections.
\note Use as confidence measure where a low value means less confidence
and a high value indicates strong confidence.";
CM_ SG_ 1053 DET_HVC_FLAG_117 "Core2 Vehicle clutter flag";
CM_ SG_ 1053 DET_CONFD_AZIMUTH_117 "Define the Confidence of Azimuth for Detection ";
CM_ SG_ 1053 DET_CONFD_ELEVATION_117 "Define the Confidence of Elevation for the Detection ";
CM_ SG_ 1053 DET_BI_STATIC_FLAG_118 "1 if detection is bi-static 0 otherwise";
CM_ SG_ 1053 DET_BI_STATIC_FLAG_119 "1 if detection is bi-static 0 otherwise";
CM_ SG_ 1053 DET_BI_STATIC_FLAG_120 "1 if detection is bi-static 0 otherwise";
CM_ SG_ 1053 DET_MH_SCAN_INDEX_4LSB_117_120 "Scan index of the measured detection";
CM_ SG_ 1053 DET_MH_CYCLE_COUNTER_117_120 "Detection Alive Counter";
CM_ SG_ 1054 DET_RANGE_121 " measured position  of the detection";
CM_ SG_ 1054 DET_RANGE_ERR_121 "RMSE or standard deviation of the measured angle  of the detection";
CM_ SG_ 1054 DET_RANGE_VELOCITY_121 "Radial velocity of the detection positive in direction to the sensor";
CM_ SG_ 1054 DET_RANGE_VELOCITY_ERR_121 "RMSE or standard deviation of the measure radial velocity of the detection";
CM_ SG_ 1054 DET_AZIMUTH_121 "Measured angle  of the detection";
CM_ SG_ 1054 DET_AZIMUTH_ERR_121 "RMSE or standard deviation of the measured angle  of the detection";
CM_ SG_ 1054 DET_ELEVATION_121 "measured elevation of the detection";
CM_ SG_ 1054 DET_ELEVATION_ERR_121 "RMSE or standard deviation of the measured elevation  of the detection";
CM_ SG_ 1054 DET_RCS_121 "Radar Cross Section or Amplitude, is a measure of how detectable an object is by radar. A larger RCS indicates that an object is more easily detected.";
CM_ SG_ 1054 DET_BI_STATIC_FLAG_121 "1 if detection is bi-static 0 otherwise";
CM_ SG_ 1054 DET_SUPER_RES_TARGET_121 "flasg is set if the detection is super resolution target";
CM_ SG_ 1054 DET_SNR_121 "The signal to noise ratio (SNR) of the radar detection";
CM_ SG_ 1054 DET_EXISTENCE_PROB_121 "Existence probability of the detection not based on history. Value does  not depend on any past experience with similar detections.
\note Use as confidence measure where a low value means less confidence
and a high value indicates strong confidence.";
CM_ SG_ 1054 DET_HVC_FLAG_121 "Core2 Vehicle clutter flag";
CM_ SG_ 1054 DET_CONFD_AZIMUTH_121 "Define the Confidence of Azimuth for Detection ";
CM_ SG_ 1054 DET_CONFD_ELEVATION_121 "Define the Confidence of Elevation for the Detection ";
CM_ SG_ 1054 DET_BI_STATIC_FLAG_122 "1 if detection is bi-static 0 otherwise";
CM_ SG_ 1054 DET_BI_STATIC_FLAG_123 "1 if detection is bi-static 0 otherwise";
CM_ SG_ 1054 DET_BI_STATIC_FLAG_124 "1 if detection is bi-static 0 otherwise";
CM_ SG_ 1054 DET_MH_SCAN_INDEX_4LSB_121_124 "Scan index of the measured detection";
CM_ SG_ 1054 DET_MH_CYCLE_COUNTER_121_124 "Detection Alive Counter";
CM_ SG_ 1055 DET_RANGE_125 " measured position  of the detection";
CM_ SG_ 1055 DET_RANGE_ERR_125 "RMSE or standard deviation of the measured angle  of the detection";
CM_ SG_ 1055 DET_RANGE_VELOCITY_125 "Radial velocity of the detection positive in direction to the sensor";
CM_ SG_ 1055 DET_RANGE_VELOCITY_ERR_125 "RMSE or standard deviation of the measure radial velocity of the detection";
CM_ SG_ 1055 DET_AZIMUTH_125 "Measured angle  of the detection";
CM_ SG_ 1055 DET_AZIMUTH_ERR_125 "RMSE or standard deviation of the measured angle  of the detection";
CM_ SG_ 1055 DET_ELEVATION_125 "measured elevation of the detection";
CM_ SG_ 1055 DET_ELEVATION_ERR_125 "RMSE or standard deviation of the measured elevation  of the detection";
CM_ SG_ 1055 DET_RCS_125 "Radar Cross Section or Amplitude, is a measure of how detectable an object is by radar. A larger RCS indicates that an object is more easily detected.";
CM_ SG_ 1055 DET_BI_STATIC_FLAG_125 "1 if detection is bi-static 0 otherwise";
CM_ SG_ 1055 DET_SUPER_RES_TARGET_125 "flasg is set if the detection is super resolution target";
CM_ SG_ 1055 DET_SNR_125 "The signal to noise ratio (SNR) of the radar detection";
CM_ SG_ 1055 DET_EXISTENCE_PROB_125 "Existence probability of the detection not based on history. Value does  not depend on any past experience with similar detections.
\note Use as confidence measure where a low value means less confidence
and a high value indicates strong confidence.";
CM_ SG_ 1055 DET_HVC_FLAG_125 "Core2 Vehicle clutter flag";
CM_ SG_ 1055 DET_CONFD_AZIMUTH_125 "Define the Confidence of Azimuth for Detection ";
CM_ SG_ 1055 DET_CONFD_ELEVATION_125 "Define the Confidence of Elevation for the Detection ";
CM_ SG_ 1055 DET_BI_STATIC_FLAG_126 "1 if detection is bi-static 0 otherwise";
CM_ SG_ 1055 DET_BI_STATIC_FLAG_127 "1 if detection is bi-static 0 otherwise";
CM_ SG_ 1055 DET_BI_STATIC_FLAG_128 "1 if detection is bi-static 0 otherwise";
CM_ SG_ 1055 DET_MH_SCAN_INDEX_4LSB_125_128 "Scan index of the measured detection";
CM_ SG_ 1055 DET_MH_CYCLE_COUNTER_125_128 "Detection Alive Counter";
CM_ SG_ 1056 DET_RANGE_129 " measured position  of the detection";
CM_ SG_ 1056 DET_RANGE_ERR_129 "RMSE or standard deviation of the measured angle  of the detection";
CM_ SG_ 1056 DET_RANGE_VELOCITY_129 "Radial velocity of the detection positive in direction to the sensor";
CM_ SG_ 1056 DET_RANGE_VELOCITY_ERR_129 "RMSE or standard deviation of the measure radial velocity of the detection";
CM_ SG_ 1056 DET_AZIMUTH_129 "Measured angle  of the detection";
CM_ SG_ 1056 DET_AZIMUTH_ERR_129 "RMSE or standard deviation of the measured angle  of the detection";
CM_ SG_ 1056 DET_ELEVATION_129 "measured elevation of the detection";
CM_ SG_ 1056 DET_ELEVATION_ERR_129 "RMSE or standard deviation of the measured elevation  of the detection";
CM_ SG_ 1056 DET_RCS_129 "Radar Cross Section or Amplitude, is a measure of how detectable an object is by radar. A larger RCS indicates that an object is more easily detected.";
CM_ SG_ 1056 DET_BI_STATIC_FLAG_129 "1 if detection is bi-static 0 otherwise";
CM_ SG_ 1056 DET_SUPER_RES_TARGET_129 "flasg is set if the detection is super resolution target";
CM_ SG_ 1056 DET_SNR_129 "The signal to noise ratio (SNR) of the radar detection";
CM_ SG_ 1056 DET_EXISTENCE_PROB_129 "Existence probability of the detection not based on history. Value does  not depend on any past experience with similar detections.
\note Use as confidence measure where a low value means less confidence
and a high value indicates strong confidence.";
CM_ SG_ 1056 DET_HVC_FLAG_129 "Core2 Vehicle clutter flag";
CM_ SG_ 1056 DET_CONFD_AZIMUTH_129 "Define the Confidence of Azimuth for Detection ";
CM_ SG_ 1056 DET_CONFD_ELEVATION_129 "Define the Confidence of Elevation for the Detection ";
CM_ SG_ 1056 DET_BI_STATIC_FLAG_130 "1 if detection is bi-static 0 otherwise";
CM_ SG_ 1056 DET_BI_STATIC_FLAG_131 "1 if detection is bi-static 0 otherwise";
CM_ SG_ 1056 DET_BI_STATIC_FLAG_132 "1 if detection is bi-static 0 otherwise";
CM_ SG_ 1056 DET_MH_SCAN_INDEX_4LSB_129_132 "Scan index of the measured detection";
CM_ SG_ 1056 DET_MH_CYCLE_COUNTER_129_132 "Detection Alive Counter";
CM_ SG_ 1057 DET_RANGE_133 " measured position  of the detection";
CM_ SG_ 1057 DET_RANGE_ERR_133 "RMSE or standard deviation of the measured angle  of the detection";
CM_ SG_ 1057 DET_RANGE_VELOCITY_133 "Radial velocity of the detection positive in direction to the sensor";
CM_ SG_ 1057 DET_RANGE_VELOCITY_ERR_133 "RMSE or standard deviation of the measure radial velocity of the detection";
CM_ SG_ 1057 DET_AZIMUTH_133 "Measured angle  of the detection";
CM_ SG_ 1057 DET_AZIMUTH_ERR_133 "RMSE or standard deviation of the measured angle  of the detection";
CM_ SG_ 1057 DET_ELEVATION_133 "measured elevation of the detection";
CM_ SG_ 1057 DET_ELEVATION_ERR_133 "RMSE or standard deviation of the measured elevation  of the detection";
CM_ SG_ 1057 DET_RCS_133 "Radar Cross Section or Amplitude, is a measure of how detectable an object is by radar. A larger RCS indicates that an object is more easily detected.";
CM_ SG_ 1057 DET_BI_STATIC_FLAG_133 "1 if detection is bi-static 0 otherwise";
CM_ SG_ 1057 DET_SUPER_RES_TARGET_133 "flasg is set if the detection is super resolution target";
CM_ SG_ 1057 DET_SNR_133 "The signal to noise ratio (SNR) of the radar detection";
CM_ SG_ 1057 DET_EXISTENCE_PROB_133 "Existence probability of the detection not based on history. Value does  not depend on any past experience with similar detections.
\note Use as confidence measure where a low value means less confidence
and a high value indicates strong confidence.";
CM_ SG_ 1057 DET_HVC_FLAG_133 "Core2 Vehicle clutter flag";
CM_ SG_ 1057 DET_CONFD_AZIMUTH_133 "Define the Confidence of Azimuth for Detection ";
CM_ SG_ 1057 DET_CONFD_ELEVATION_133 "Define the Confidence of Elevation for the Detection ";
CM_ SG_ 1057 DET_BI_STATIC_FLAG_134 "1 if detection is bi-static 0 otherwise";
CM_ SG_ 1057 DET_BI_STATIC_FLAG_135 "1 if detection is bi-static 0 otherwise";
CM_ SG_ 1057 DET_BI_STATIC_FLAG_136 "1 if detection is bi-static 0 otherwise";
CM_ SG_ 1057 DET_MH_SCAN_INDEX_4LSB_133_136 "Scan index of the measured detection";
CM_ SG_ 1057 DET_MH_CYCLE_COUNTER_133_136 "Detection Alive Counter";
CM_ SG_ 1058 DET_RANGE_137 " measured position  of the detection";
CM_ SG_ 1058 DET_RANGE_ERR_137 "RMSE or standard deviation of the measured angle  of the detection";
CM_ SG_ 1058 DET_RANGE_VELOCITY_137 "Radial velocity of the detection positive in direction to the sensor";
CM_ SG_ 1058 DET_RANGE_VELOCITY_ERR_137 "RMSE or standard deviation of the measure radial velocity of the detection";
CM_ SG_ 1058 DET_AZIMUTH_137 "Measured angle  of the detection";
CM_ SG_ 1058 DET_AZIMUTH_ERR_137 "RMSE or standard deviation of the measured angle  of the detection";
CM_ SG_ 1058 DET_ELEVATION_137 "measured elevation of the detection";
CM_ SG_ 1058 DET_ELEVATION_ERR_137 "RMSE or standard deviation of the measured elevation  of the detection";
CM_ SG_ 1058 DET_RCS_137 "Radar Cross Section or Amplitude, is a measure of how detectable an object is by radar. A larger RCS indicates that an object is more easily detected.";
CM_ SG_ 1058 DET_BI_STATIC_FLAG_137 "1 if detection is bi-static 0 otherwise";
CM_ SG_ 1058 DET_SUPER_RES_TARGET_137 "flasg is set if the detection is super resolution target";
CM_ SG_ 1058 DET_SNR_137 "The signal to noise ratio (SNR) of the radar detection";
CM_ SG_ 1058 DET_EXISTENCE_PROB_137 "Existence probability of the detection not based on history. Value does  not depend on any past experience with similar detections.
\note Use as confidence measure where a low value means less confidence
and a high value indicates strong confidence.";
CM_ SG_ 1058 DET_HVC_FLAG_137 "Core2 Vehicle clutter flag";
CM_ SG_ 1058 DET_CONFD_AZIMUTH_137 "Define the Confidence of Azimuth for Detection ";
CM_ SG_ 1058 DET_CONFD_ELEVATION_137 "Define the Confidence of Elevation for the Detection ";
CM_ SG_ 1058 DET_BI_STATIC_FLAG_138 "1 if detection is bi-static 0 otherwise";
CM_ SG_ 1058 DET_BI_STATIC_FLAG_139 "1 if detection is bi-static 0 otherwise";
CM_ SG_ 1058 DET_BI_STATIC_FLAG_140 "1 if detection is bi-static 0 otherwise";
CM_ SG_ 1058 DET_MH_SCAN_INDEX_4LSB_137_140 "Scan index of the measured detection";
CM_ SG_ 1058 DET_MH_CYCLE_COUNTER_137_140 "Detection Alive Counter";
CM_ SG_ 1059 DET_RANGE_141 " measured position  of the detection";
CM_ SG_ 1059 DET_RANGE_ERR_141 "RMSE or standard deviation of the measured angle  of the detection";
CM_ SG_ 1059 DET_RANGE_VELOCITY_141 "Radial velocity of the detection positive in direction to the sensor";
CM_ SG_ 1059 DET_RANGE_VELOCITY_ERR_141 "RMSE or standard deviation of the measure radial velocity of the detection";
CM_ SG_ 1059 DET_AZIMUTH_141 "Measured angle  of the detection";
CM_ SG_ 1059 DET_AZIMUTH_ERR_141 "RMSE or standard deviation of the measured angle  of the detection";
CM_ SG_ 1059 DET_ELEVATION_141 "measured elevation of the detection";
CM_ SG_ 1059 DET_ELEVATION_ERR_141 "RMSE or standard deviation of the measured elevation  of the detection";
CM_ SG_ 1059 DET_RCS_141 "Radar Cross Section or Amplitude, is a measure of how detectable an object is by radar. A larger RCS indicates that an object is more easily detected.";
CM_ SG_ 1059 DET_BI_STATIC_FLAG_141 "1 if detection is bi-static 0 otherwise";
CM_ SG_ 1059 DET_SUPER_RES_TARGET_141 "flasg is set if the detection is super resolution target";
CM_ SG_ 1059 DET_SNR_141 "The signal to noise ratio (SNR) of the radar detection";
CM_ SG_ 1059 DET_EXISTENCE_PROB_141 "Existence probability of the detection not based on history. Value does  not depend on any past experience with similar detections.
\note Use as confidence measure where a low value means less confidence
and a high value indicates strong confidence.";
CM_ SG_ 1059 DET_HVC_FLAG_141 "Core2 Vehicle clutter flag";
CM_ SG_ 1059 DET_CONFD_AZIMUTH_141 "Define the Confidence of Azimuth for Detection ";
CM_ SG_ 1059 DET_CONFD_ELEVATION_141 "Define the Confidence of Elevation for the Detection ";
CM_ SG_ 1059 DET_BI_STATIC_FLAG_142 "1 if detection is bi-static 0 otherwise";
CM_ SG_ 1059 DET_BI_STATIC_FLAG_143 "1 if detection is bi-static 0 otherwise";
CM_ SG_ 1059 DET_BI_STATIC_FLAG_144 "1 if detection is bi-static 0 otherwise";
CM_ SG_ 1059 DET_MH_SCAN_INDEX_4LSB_141_144 "Scan index of the measured detection";
CM_ SG_ 1059 DET_MH_CYCLE_COUNTER_141_144 "Detection Alive Counter";
CM_ SG_ 1060 DET_RANGE_145 " measured position  of the detection";
CM_ SG_ 1060 DET_RANGE_ERR_145 "RMSE or standard deviation of the measured angle  of the detection";
CM_ SG_ 1060 DET_RANGE_VELOCITY_145 "Radial velocity of the detection positive in direction to the sensor";
CM_ SG_ 1060 DET_RANGE_VELOCITY_ERR_145 "RMSE or standard deviation of the measure radial velocity of the detection";
CM_ SG_ 1060 DET_AZIMUTH_145 "Measured angle  of the detection";
CM_ SG_ 1060 DET_AZIMUTH_ERR_145 "RMSE or standard deviation of the measured angle  of the detection";
CM_ SG_ 1060 DET_ELEVATION_145 "measured elevation of the detection";
CM_ SG_ 1060 DET_ELEVATION_ERR_145 "RMSE or standard deviation of the measured elevation  of the detection";
CM_ SG_ 1060 DET_RCS_145 "Radar Cross Section or Amplitude, is a measure of how detectable an object is by radar. A larger RCS indicates that an object is more easily detected.";
CM_ SG_ 1060 DET_BI_STATIC_FLAG_145 "1 if detection is bi-static 0 otherwise";
CM_ SG_ 1060 DET_SUPER_RES_TARGET_145 "flasg is set if the detection is super resolution target";
CM_ SG_ 1060 DET_SNR_145 "The signal to noise ratio (SNR) of the radar detection";
CM_ SG_ 1060 DET_EXISTENCE_PROB_145 "Existence probability of the detection not based on history. Value does  not depend on any past experience with similar detections.
\note Use as confidence measure where a low value means less confidence
and a high value indicates strong confidence.";
CM_ SG_ 1060 DET_HVC_FLAG_145 "Core2 Vehicle clutter flag";
CM_ SG_ 1060 DET_CONFD_AZIMUTH_145 "Define the Confidence of Azimuth for Detection ";
CM_ SG_ 1060 DET_CONFD_ELEVATION_145 "Define the Confidence of Elevation for the Detection ";
CM_ SG_ 1060 DET_BI_STATIC_FLAG_146 "1 if detection is bi-static 0 otherwise";
CM_ SG_ 1060 DET_BI_STATIC_FLAG_147 "1 if detection is bi-static 0 otherwise";
CM_ SG_ 1060 DET_BI_STATIC_FLAG_148 "1 if detection is bi-static 0 otherwise";
CM_ SG_ 1060 DET_MH_SCAN_INDEX_4LSB_145_148 "Scan index of the measured detection";
CM_ SG_ 1060 DET_MH_CYCLE_COUNTER_145_148 "Detection Alive Counter";
CM_ SG_ 1061 DET_RANGE_149 " measured position  of the detection";
CM_ SG_ 1061 DET_RANGE_ERR_149 "RMSE or standard deviation of the measured angle  of the detection";
CM_ SG_ 1061 DET_RANGE_VELOCITY_149 "Radial velocity of the detection positive in direction to the sensor";
CM_ SG_ 1061 DET_RANGE_VELOCITY_ERR_149 "RMSE or standard deviation of the measure radial velocity of the detection";
CM_ SG_ 1061 DET_AZIMUTH_149 "Measured angle  of the detection";
CM_ SG_ 1061 DET_AZIMUTH_ERR_149 "RMSE or standard deviation of the measured angle  of the detection";
CM_ SG_ 1061 DET_ELEVATION_149 "measured elevation of the detection";
CM_ SG_ 1061 DET_ELEVATION_ERR_149 "RMSE or standard deviation of the measured elevation  of the detection";
CM_ SG_ 1061 DET_RCS_149 "Radar Cross Section or Amplitude, is a measure of how detectable an object is by radar. A larger RCS indicates that an object is more easily detected.";
CM_ SG_ 1061 DET_BI_STATIC_FLAG_149 "1 if detection is bi-static 0 otherwise";
CM_ SG_ 1061 DET_SUPER_RES_TARGET_149 "flasg is set if the detection is super resolution target";
CM_ SG_ 1061 DET_SNR_149 "The signal to noise ratio (SNR) of the radar detection";
CM_ SG_ 1061 DET_EXISTENCE_PROB_149 "Existence probability of the detection not based on history. Value does  not depend on any past experience with similar detections.
\note Use as confidence measure where a low value means less confidence
and a high value indicates strong confidence.";
CM_ SG_ 1061 DET_HVC_FLAG_149 "Core2 Vehicle clutter flag";
CM_ SG_ 1061 DET_CONFD_AZIMUTH_149 "Define the Confidence of Azimuth for Detection ";
CM_ SG_ 1061 DET_CONFD_ELEVATION_149 "Define the Confidence of Elevation for the Detection ";
CM_ SG_ 1061 DET_BI_STATIC_FLAG_150 "1 if detection is bi-static 0 otherwise";
CM_ SG_ 1061 DET_BI_STATIC_FLAG_151 "1 if detection is bi-static 0 otherwise";
CM_ SG_ 1061 DET_BI_STATIC_FLAG_152 "1 if detection is bi-static 0 otherwise";
CM_ SG_ 1061 DET_MH_SCAN_INDEX_4LSB_149_152 "Scan index of the measured detection";
CM_ SG_ 1061 DET_MH_CYCLE_COUNTER_149_152 "Detection Alive Counter";
CM_ SG_ 1062 DET_RANGE_153 " measured position  of the detection";
CM_ SG_ 1062 DET_RANGE_ERR_153 "RMSE or standard deviation of the measured angle  of the detection";
CM_ SG_ 1062 DET_RANGE_VELOCITY_153 "Radial velocity of the detection positive in direction to the sensor";
CM_ SG_ 1062 DET_RANGE_VELOCITY_ERR_153 "RMSE or standard deviation of the measure radial velocity of the detection";
CM_ SG_ 1062 DET_AZIMUTH_153 "Measured angle  of the detection";
CM_ SG_ 1062 DET_AZIMUTH_ERR_153 "RMSE or standard deviation of the measured angle  of the detection";
CM_ SG_ 1062 DET_ELEVATION_153 "measured elevation of the detection";
CM_ SG_ 1062 DET_ELEVATION_ERR_153 "RMSE or standard deviation of the measured elevation  of the detection";
CM_ SG_ 1062 DET_RCS_153 "Radar Cross Section or Amplitude, is a measure of how detectable an object is by radar. A larger RCS indicates that an object is more easily detected.";
CM_ SG_ 1062 DET_BI_STATIC_FLAG_153 "1 if detection is bi-static 0 otherwise";
CM_ SG_ 1062 DET_SUPER_RES_TARGET_153 "flasg is set if the detection is super resolution target";
CM_ SG_ 1062 DET_SNR_153 "The signal to noise ratio (SNR) of the radar detection";
CM_ SG_ 1062 DET_EXISTENCE_PROB_153 "Existence probability of the detection not based on history. Value does  not depend on any past experience with similar detections.
\note Use as confidence measure where a low value means less confidence
and a high value indicates strong confidence.";
CM_ SG_ 1062 DET_HVC_FLAG_153 "Core2 Vehicle clutter flag";
CM_ SG_ 1062 DET_CONFD_AZIMUTH_153 "Define the Confidence of Azimuth for Detection ";
CM_ SG_ 1062 DET_CONFD_ELEVATION_153 "Define the Confidence of Elevation for the Detection ";
CM_ SG_ 1062 DET_BI_STATIC_FLAG_154 "1 if detection is bi-static 0 otherwise";
CM_ SG_ 1062 DET_BI_STATIC_FLAG_155 "1 if detection is bi-static 0 otherwise";
CM_ SG_ 1062 DET_BI_STATIC_FLAG_156 "1 if detection is bi-static 0 otherwise";
CM_ SG_ 1062 DET_MH_SCAN_INDEX_4LSB_153_156 "Scan index of the measured detection";
CM_ SG_ 1062 DET_MH_CYCLE_COUNTER_153_156 "Detection Alive Counter";
CM_ SG_ 1063 DET_RANGE_157 " measured position  of the detection";
CM_ SG_ 1063 DET_RANGE_ERR_157 "RMSE or standard deviation of the measured angle  of the detection";
CM_ SG_ 1063 DET_RANGE_VELOCITY_157 "Radial velocity of the detection positive in direction to the sensor";
CM_ SG_ 1063 DET_RANGE_VELOCITY_ERR_157 "RMSE or standard deviation of the measure radial velocity of the detection";
CM_ SG_ 1063 DET_AZIMUTH_157 "Measured angle  of the detection";
CM_ SG_ 1063 DET_AZIMUTH_ERR_157 "RMSE or standard deviation of the measured angle  of the detection";
CM_ SG_ 1063 DET_ELEVATION_157 "measured elevation of the detection";
CM_ SG_ 1063 DET_ELEVATION_ERR_157 "RMSE or standard deviation of the measured elevation  of the detection";
CM_ SG_ 1063 DET_RCS_157 "Radar Cross Section or Amplitude, is a measure of how detectable an object is by radar. A larger RCS indicates that an object is more easily detected.";
CM_ SG_ 1063 DET_BI_STATIC_FLAG_157 "1 if detection is bi-static 0 otherwise";
CM_ SG_ 1063 DET_SUPER_RES_TARGET_157 "flasg is set if the detection is super resolution target";
CM_ SG_ 1063 DET_SNR_157 "The signal to noise ratio (SNR) of the radar detection";
CM_ SG_ 1063 DET_EXISTENCE_PROB_157 "Existence probability of the detection not based on history. Value does  not depend on any past experience with similar detections.
\note Use as confidence measure where a low value means less confidence
and a high value indicates strong confidence.";
CM_ SG_ 1063 DET_HVC_FLAG_157 "Core2 Vehicle clutter flag";
CM_ SG_ 1063 DET_CONFD_AZIMUTH_157 "Define the Confidence of Azimuth for Detection ";
CM_ SG_ 1063 DET_CONFD_ELEVATION_157 "Define the Confidence of Elevation for the Detection ";
CM_ SG_ 1063 DET_BI_STATIC_FLAG_158 "1 if detection is bi-static 0 otherwise";
CM_ SG_ 1063 DET_BI_STATIC_FLAG_159 "1 if detection is bi-static 0 otherwise";
CM_ SG_ 1063 DET_BI_STATIC_FLAG_160 "1 if detection is bi-static 0 otherwise";
CM_ SG_ 1063 DET_MH_SCAN_INDEX_4LSB_157_160 "Scan index of the measured detection";
CM_ SG_ 1063 DET_MH_CYCLE_COUNTER_157_160 "Detection Alive Counter";
BA_DEF_ BO_  "VFrameFormat" ENUM  "StandardCAN","ExtendedCAN","reserved","reserved","reserved","reserved","reserved","reserved","reserved","reserved","reserved","reserved","reserved","reserved","StandardCAN_FD","ExtendedCAN_FD";
BA_DEF_ BO_  "CanTpBs" INT 0 255;
BA_DEF_ BO_  "DiagConnection" INT 0 65535;
BA_DEF_ BO_  "DiagRequest" ENUM  "No","Yes";
BA_DEF_ BO_  "DiagResponse" ENUM  "No","Yes";
BA_DEF_ BO_  "DiagState" ENUM  "No","Yes";
BA_DEF_ BO_  "E2EDataId" INT 0 65535;
BA_DEF_ BO_  "E2EDataLength" INT 0 65535;
BA_DEF_ BO_  "E2EProfile" STRING ;
BA_DEF_ BO_  "EventRateOfChange" INT 10 10000;
BA_DEF_ BO_  "GenMsgCycleTime" INT 0 100000;
BA_DEF_ BO_  "GenMsgILSupport" ENUM  "No","Yes";
BA_DEF_ BO_  "GenMsgNrOfRepetition" INT 0 100;
BA_DEF_ BO_  "GenMsgSendType" ENUM  "FixedPeriodic","Event","EnabledPeriodic","NotUsed","NotUsed","EventPeriodic","NotUsed","NotUsed","NoMsgSendType";
BA_DEF_ BO_  "NetworkInitialization" ENUM  "No","Yes";
BA_DEF_ BO_  "NmAsrMessage" ENUM  "No","Yes";
BA_DEF_ BO_  "NmMessage" ENUM  "No","Yes";
BA_DEF_ BO_  "SCP_AuthInfoTxLength" INT 0 512;
BA_DEF_ BO_  "SCP_FreshnessValueLength" INT 0 512;
BA_DEF_ BO_  "SCP_FreshnessValueTxLength" INT 0 512;
BA_DEF_ BO_  "TpTxIndex" INT 0 255;
BA_DEF_ SG_  "GenSigCmt" STRING ;
BA_DEF_ SG_  "GenSigCycleTime" INT 0 0;
BA_DEF_ SG_  "GenSigSendType" ENUM  "Cyclic","OnWrite","vector_leerstring","OnChange","vector_leerstring","IfActive","vector_leerstring","NoSigSendType";
BA_DEF_ SG_  "GenSigStartValue" INT 0 1000000000;
BA_DEF_ SG_  "GenSigTimeoutTime" INT 0 0;
BA_DEF_ SG_  "GenSigVtEn" STRING ;
BA_DEF_ SG_  "GenSigVtName" STRING ;
BA_DEF_ SG_  "InvalidValue" STRING ;
BA_DEF_ SG_  "SystemSignalLongSymbol" STRING ;
BA_DEF_REL_ BU_SG_REL_  "SC_Verification" ENUM  "No","Yes";
BA_DEF_DEF_  "VFrameFormat" "StandardCAN_FD";
BA_DEF_DEF_  "CanTpBs" 255;
BA_DEF_DEF_  "DiagConnection" 0;
BA_DEF_DEF_  "DiagRequest" "No";
BA_DEF_DEF_  "DiagResponse" "No";
BA_DEF_DEF_  "DiagState" "No";
BA_DEF_DEF_  "E2EDataId" 0;
BA_DEF_DEF_  "E2EDataLength" 0;
BA_DEF_DEF_  "E2EProfile" "";
BA_DEF_DEF_  "EventRateOfChange" 10000;
BA_DEF_DEF_  "GenMsgCycleTime" 0;
BA_DEF_DEF_  "GenMsgILSupport" "Yes";
BA_DEF_DEF_  "GenMsgNrOfRepetition" 0;
BA_DEF_DEF_  "GenMsgSendType" "NoMsgSendType";
BA_DEF_DEF_  "NetworkInitialization" "Yes";
BA_DEF_DEF_  "NmAsrMessage" "No";
BA_DEF_DEF_  "NmMessage" "No";
BA_DEF_DEF_  "SCP_AuthInfoTxLength" 28;
BA_DEF_DEF_  "SCP_FreshnessValueLength" 48;
BA_DEF_DEF_  "SCP_FreshnessValueTxLength" 4;
BA_DEF_DEF_  "TpTxIndex" 0;
BA_DEF_DEF_  "GenSigCmt" "";
BA_DEF_DEF_  "GenSigCycleTime" 0;
BA_DEF_DEF_  "GenSigSendType" "NoSigSendType";
BA_DEF_DEF_  "GenSigStartValue" 0;
BA_DEF_DEF_  "GenSigTimeoutTime" 0;
BA_DEF_DEF_  "GenSigVtEn" "";
BA_DEF_DEF_  "GenSigVtName" "";
BA_DEF_DEF_  "InvalidValue" "";
BA_DEF_DEF_REL_ "SC_Verification" "No";
BA_DEF_DEF_  "SystemSignalLongSymbol" "";
BA_ "GenMsgSendType" BO_ 1048 1;
BA_ "GenMsgSendType" BO_ 1049 1;
BA_ "GenMsgSendType" BO_ 1050 1;
BA_ "GenMsgSendType" BO_ 1051 1;
BA_ "GenMsgSendType" BO_ 1052 1;
BA_ "GenMsgSendType" BO_ 1053 1;
BA_ "GenMsgSendType" BO_ 1054 1;
BA_ "GenMsgSendType" BO_ 1055 1;
BA_ "GenMsgSendType" BO_ 1056 1;
BA_ "GenMsgSendType" BO_ 1057 1;
BA_ "GenMsgSendType" BO_ 1058 1;
BA_ "GenMsgSendType" BO_ 1059 1;
BA_ "GenMsgSendType" BO_ 1060 1;
BA_ "GenMsgSendType" BO_ 1061 1;
BA_ "GenMsgSendType" BO_ 1062 1;
BA_ "GenMsgSendType" BO_ 1063 1;
BA_ "GenSigStartValue" SG_ 1048 DET_RANGE_VELOCITY_097 16384;
BA_ "GenSigStartValue" SG_ 1048 DET_RCS_097 128;
BA_ "GenSigStartValue" SG_ 1048 DET_RANGE_VELOCITY_098 16384;
BA_ "GenSigStartValue" SG_ 1048 DET_RCS_098 128;
BA_ "GenSigStartValue" SG_ 1048 DET_RANGE_VELOCITY_099 16384;
BA_ "GenSigStartValue" SG_ 1048 DET_RCS_099 128;
BA_ "GenSigStartValue" SG_ 1048 DET_RANGE_VELOCITY_100 16384;
BA_ "GenSigStartValue" SG_ 1048 DET_RCS_100 128;
BA_ "GenSigStartValue" SG_ 1049 DET_RANGE_VELOCITY_101 16384;
BA_ "GenSigStartValue" SG_ 1049 DET_RCS_101 128;
BA_ "GenSigStartValue" SG_ 1049 DET_RANGE_VELOCITY_102 16384;
BA_ "GenSigStartValue" SG_ 1049 DET_RCS_102 128;
BA_ "GenSigStartValue" SG_ 1049 DET_RANGE_VELOCITY_103 16384;
BA_ "GenSigStartValue" SG_ 1049 DET_RCS_103 128;
BA_ "GenSigStartValue" SG_ 1049 DET_RANGE_VELOCITY_104 16384;
BA_ "GenSigStartValue" SG_ 1049 DET_RCS_104 128;
BA_ "GenSigStartValue" SG_ 1050 DET_RANGE_VELOCITY_105 16384;
BA_ "GenSigStartValue" SG_ 1050 DET_RCS_105 128;
BA_ "GenSigStartValue" SG_ 1050 DET_RANGE_VELOCITY_106 16384;
BA_ "GenSigStartValue" SG_ 1050 DET_RCS_106 128;
BA_ "GenSigStartValue" SG_ 1050 DET_RANGE_VELOCITY_107 16384;
BA_ "GenSigStartValue" SG_ 1050 DET_RCS_107 128;
BA_ "GenSigStartValue" SG_ 1050 DET_RANGE_VELOCITY_108 16384;
BA_ "GenSigStartValue" SG_ 1050 DET_RCS_108 128;
BA_ "GenSigStartValue" SG_ 1051 DET_RANGE_VELOCITY_109 16384;
BA_ "GenSigStartValue" SG_ 1051 DET_RCS_109 128;
BA_ "GenSigStartValue" SG_ 1051 DET_RANGE_VELOCITY_110 16384;
BA_ "GenSigStartValue" SG_ 1051 DET_RCS_110 128;
BA_ "GenSigStartValue" SG_ 1051 DET_RANGE_VELOCITY_111 16384;
BA_ "GenSigStartValue" SG_ 1051 DET_RCS_111 128;
BA_ "GenSigStartValue" SG_ 1051 DET_RANGE_VELOCITY_112 16384;
BA_ "GenSigStartValue" SG_ 1051 DET_RCS_112 128;
BA_ "GenSigStartValue" SG_ 1052 DET_RANGE_VELOCITY_113 16384;
BA_ "GenSigStartValue" SG_ 1052 DET_RCS_113 128;
BA_ "GenSigStartValue" SG_ 1052 DET_RANGE_VELOCITY_114 16384;
BA_ "GenSigStartValue" SG_ 1052 DET_RCS_114 128;
BA_ "GenSigStartValue" SG_ 1052 DET_RANGE_VELOCITY_115 16384;
BA_ "GenSigStartValue" SG_ 1052 DET_RCS_115 128;
BA_ "GenSigStartValue" SG_ 1052 DET_RANGE_VELOCITY_116 16384;
BA_ "GenSigStartValue" SG_ 1052 DET_RCS_116 128;
BA_ "GenSigStartValue" SG_ 1053 DET_RANGE_VELOCITY_117 16384;
BA_ "GenSigStartValue" SG_ 1053 DET_RCS_117 128;
BA_ "GenSigStartValue" SG_ 1053 DET_RANGE_VELOCITY_118 16384;
BA_ "GenSigStartValue" SG_ 1053 DET_RCS_118 128;
BA_ "GenSigStartValue" SG_ 1053 DET_RANGE_VELOCITY_119 16384;
BA_ "GenSigStartValue" SG_ 1053 DET_RCS_119 128;
BA_ "GenSigStartValue" SG_ 1053 DET_RANGE_VELOCITY_120 16384;
BA_ "GenSigStartValue" SG_ 1053 DET_RCS_120 128;
BA_ "GenSigStartValue" SG_ 1054 DET_RANGE_VELOCITY_121 16384;
BA_ "GenSigStartValue" SG_ 1054 DET_RCS_121 128;
BA_ "GenSigStartValue" SG_ 1054 DET_RANGE_VELOCITY_122 16384;
BA_ "GenSigStartValue" SG_ 1054 DET_RCS_122 128;
BA_ "GenSigStartValue" SG_ 1054 DET_RANGE_VELOCITY_123 16384;
BA_ "GenSigStartValue" SG_ 1054 DET_RCS_123 128;
BA_ "GenSigStartValue" SG_ 1054 DET_RANGE_VELOCITY_124 16384;
BA_ "GenSigStartValue" SG_ 1054 DET_RCS_124 128;
BA_ "GenSigStartValue" SG_ 1055 DET_RANGE_VELOCITY_125 16384;
BA_ "GenSigStartValue" SG_ 1055 DET_RCS_125 128;
BA_ "GenSigStartValue" SG_ 1055 DET_RANGE_VELOCITY_126 16384;
BA_ "GenSigStartValue" SG_ 1055 DET_RCS_126 128;
BA_ "GenSigStartValue" SG_ 1055 DET_RANGE_VELOCITY_127 16384;
BA_ "GenSigStartValue" SG_ 1055 DET_RCS_127 128;
BA_ "GenSigStartValue" SG_ 1055 DET_RANGE_VELOCITY_128 16384;
BA_ "GenSigStartValue" SG_ 1055 DET_RCS_128 128;
BA_ "GenSigStartValue" SG_ 1056 DET_RANGE_VELOCITY_129 16384;
BA_ "GenSigStartValue" SG_ 1056 DET_RCS_129 128;
BA_ "GenSigStartValue" SG_ 1056 DET_RANGE_VELOCITY_130 16384;
BA_ "GenSigStartValue" SG_ 1056 DET_RCS_130 128;
BA_ "GenSigStartValue" SG_ 1056 DET_RANGE_VELOCITY_131 16384;
BA_ "GenSigStartValue" SG_ 1056 DET_RCS_131 128;
BA_ "GenSigStartValue" SG_ 1056 DET_RANGE_VELOCITY_132 16384;
BA_ "GenSigStartValue" SG_ 1056 DET_RCS_132 128;
BA_ "GenSigStartValue" SG_ 1057 DET_RANGE_VELOCITY_133 16384;
BA_ "GenSigStartValue" SG_ 1057 DET_RCS_133 128;
BA_ "GenSigStartValue" SG_ 1057 DET_RANGE_VELOCITY_134 16384;
BA_ "GenSigStartValue" SG_ 1057 DET_RCS_134 128;
BA_ "GenSigStartValue" SG_ 1057 DET_RANGE_VELOCITY_135 16384;
BA_ "GenSigStartValue" SG_ 1057 DET_RCS_135 128;
BA_ "GenSigStartValue" SG_ 1057 DET_RANGE_VELOCITY_136 16384;
BA_ "GenSigStartValue" SG_ 1057 DET_RCS_136 128;
BA_ "GenSigStartValue" SG_ 1058 DET_RANGE_VELOCITY_137 16384;
BA_ "GenSigStartValue" SG_ 1058 DET_RCS_137 128;
BA_ "GenSigStartValue" SG_ 1058 DET_RANGE_VELOCITY_138 16384;
BA_ "GenSigStartValue" SG_ 1058 DET_RCS_138 128;
BA_ "GenSigStartValue" SG_ 1058 DET_RANGE_VELOCITY_139 16384;
BA_ "GenSigStartValue" SG_ 1058 DET_RCS_139 128;
BA_ "GenSigStartValue" SG_ 1058 DET_RANGE_VELOCITY_140 16384;
BA_ "GenSigStartValue" SG_ 1058 DET_RCS_140 128;
BA_ "GenSigStartValue" SG_ 1059 DET_RANGE_VELOCITY_141 16384;
BA_ "GenSigStartValue" SG_ 1059 DET_RCS_141 128;
BA_ "GenSigStartValue" SG_ 1059 DET_RANGE_VELOCITY_142 16384;
BA_ "GenSigStartValue" SG_ 1059 DET_RCS_142 128;
BA_ "GenSigStartValue" SG_ 1059 DET_RANGE_VELOCITY_143 16384;
BA_ "GenSigStartValue" SG_ 1059 DET_RCS_143 128;
BA_ "GenSigStartValue" SG_ 1059 DET_RANGE_VELOCITY_144 16384;
BA_ "GenSigStartValue" SG_ 1059 DET_RCS_144 128;
BA_ "GenSigStartValue" SG_ 1060 DET_RANGE_VELOCITY_145 16384;
BA_ "GenSigStartValue" SG_ 1060 DET_RCS_145 128;
BA_ "GenSigStartValue" SG_ 1060 DET_RANGE_VELOCITY_146 16384;
BA_ "GenSigStartValue" SG_ 1060 DET_RCS_146 128;
BA_ "GenSigStartValue" SG_ 1060 DET_RANGE_VELOCITY_147 16384;
BA_ "GenSigStartValue" SG_ 1060 DET_RCS_147 128;
BA_ "GenSigStartValue" SG_ 1060 DET_RANGE_VELOCITY_148 16384;
BA_ "GenSigStartValue" SG_ 1060 DET_RCS_148 128;
BA_ "GenSigStartValue" SG_ 1061 DET_RANGE_VELOCITY_149 16384;
BA_ "GenSigStartValue" SG_ 1061 DET_RCS_149 128;
BA_ "GenSigStartValue" SG_ 1061 DET_RANGE_VELOCITY_150 16384;
BA_ "GenSigStartValue" SG_ 1061 DET_RCS_150 128;
BA_ "GenSigStartValue" SG_ 1061 DET_RANGE_VELOCITY_151 16384;
BA_ "GenSigStartValue" SG_ 1061 DET_RCS_151 128;
BA_ "GenSigStartValue" SG_ 1061 DET_RANGE_VELOCITY_152 16384;
BA_ "GenSigStartValue" SG_ 1061 DET_RCS_152 128;
BA_ "GenSigStartValue" SG_ 1062 DET_RANGE_VELOCITY_153 16384;
BA_ "GenSigStartValue" SG_ 1062 DET_RCS_153 128;
BA_ "GenSigStartValue" SG_ 1062 DET_RANGE_VELOCITY_154 16384;
BA_ "GenSigStartValue" SG_ 1062 DET_RCS_154 128;
BA_ "GenSigStartValue" SG_ 1062 DET_RANGE_VELOCITY_155 16384;
BA_ "GenSigStartValue" SG_ 1062 DET_RCS_155 128;
BA_ "GenSigStartValue" SG_ 1062 DET_RANGE_VELOCITY_156 16384;
BA_ "GenSigStartValue" SG_ 1062 DET_RCS_156 128;
BA_ "GenSigStartValue" SG_ 1063 DET_RANGE_VELOCITY_157 16384;
BA_ "GenSigStartValue" SG_ 1063 DET_RCS_157 128;
BA_ "GenSigStartValue" SG_ 1063 DET_RANGE_VELOCITY_158 16384;
BA_ "GenSigStartValue" SG_ 1063 DET_RCS_158 128;
BA_ "GenSigStartValue" SG_ 1063 DET_RANGE_VELOCITY_159 16384;
BA_ "GenSigStartValue" SG_ 1063 DET_RCS_159 128;
BA_ "GenSigStartValue" SG_ 1063 DET_RANGE_VELOCITY_160 16384;
BA_ "GenSigStartValue" SG_ 1063 DET_RCS_160 128;
VAL_ 1048 DET_CONFD_AZIMUTH_097 0 "High" 1 "MidHigh" 2 "MidLow" 3 "Low" ;
VAL_ 1048 DET_CONFD_ELEVATION_097 0 "High" 1 "MidHigh" 2 "MidLow" 3 "Low" ;
VAL_ 1048 DET_IDM_097 0 "Not_IDM_Output" 1 "IDM_Output" ;
VAL_ 1048 DET_MTD_097 0 "Not_MTD_Output" 1 "MTD_Output" ;
VAL_ 1048 DET_BELOW_RAIN_THOLD_097 0 "DetBelowRainThold" 1 "DetAboveRainThold" ;
VAL_ 1048 DET_CONFD_AZIMUTH_098 0 "High" 1 "MidHigh" 2 "MidLow" 3 "Low" ;
VAL_ 1048 DET_CONFD_ELEVATION_098 0 "High" 1 "MidHigh" 2 "MidLow" 3 "Low" ;
VAL_ 1048 DET_IDM_098 0 "Not_IDM_Output" 1 "IDM_Output" ;
VAL_ 1048 DET_MTD_098 0 "Not_MTD_Output" 1 "MTD_Output" ;
VAL_ 1048 DET_BELOW_RAIN_THOLD_098 0 "DetBelowRainThold" 1 "DetAboveRainThold" ;
VAL_ 1048 DET_CONFD_AZIMUTH_099 0 "High" 1 "MidHigh" 2 "MidLow" 3 "Low" ;
VAL_ 1048 DET_CONFD_ELEVATION_099 0 "High" 1 "MidHigh" 2 "MidLow" 3 "Low" ;
VAL_ 1048 DET_IDM_099 0 "Not_IDM_Output" 1 "IDM_Output" ;
VAL_ 1048 DET_MTD_099 0 "Not_MTD_Output" 1 "MTD_Output" ;
VAL_ 1048 DET_BELOW_RAIN_THOLD_099 0 "DetBelowRainThold" 1 "DetAboveRainThold" ;
VAL_ 1048 DET_IDM_100 0 "Not_IDM_Output" 1 "IDM_Output" ;
VAL_ 1048 DET_MTD_100 0 "Not_MTD_Output" 1 "MTD_Output" ;
VAL_ 1048 DET_BELOW_RAIN_THOLD_100 0 "DetBelowRainThold" 1 "DetAboveRainThold" ;
VAL_ 1049 DET_CONFD_AZIMUTH_101 0 "High" 1 "MidHigh" 2 "MidLow" 3 "Low" ;
VAL_ 1049 DET_CONFD_ELEVATION_101 0 "High" 1 "MidHigh" 2 "MidLow" 3 "Low" ;
VAL_ 1049 DET_IDM_101 0 "Not_IDM_Output" 1 "IDM_Output" ;
VAL_ 1049 DET_MTD_101 0 "Not_MTD_Output" 1 "MTD_Output" ;
VAL_ 1049 DET_BELOW_RAIN_THOLD_101 0 "DetBelowRainThold" 1 "DetAboveRainThold" ;
VAL_ 1049 DET_CONFD_AZIMUTH_102 0 "High" 1 "MidHigh" 2 "MidLow" 3 "Low" ;
VAL_ 1049 DET_CONFD_ELEVATION_102 0 "High" 1 "MidHigh" 2 "MidLow" 3 "Low" ;
VAL_ 1049 DET_IDM_102 0 "Not_IDM_Output" 1 "IDM_Output" ;
VAL_ 1049 DET_MTD_102 0 "Not_MTD_Output" 1 "MTD_Output" ;
VAL_ 1049 DET_BELOW_RAIN_THOLD_102 0 "DetBelowRainThold" 1 "DetAboveRainThold" ;
VAL_ 1049 DET_CONFD_AZIMUTH_103 0 "High" 1 "MidHigh" 2 "MidLow" 3 "Low" ;
VAL_ 1049 DET_CONFD_ELEVATION_103 0 "High" 1 "MidHigh" 2 "MidLow" 3 "Low" ;
VAL_ 1049 DET_IDM_103 0 "Not_IDM_Output" 1 "IDM_Output" ;
VAL_ 1049 DET_MTD_103 0 "Not_MTD_Output" 1 "MTD_Output" ;
VAL_ 1049 DET_BELOW_RAIN_THOLD_103 0 "DetBelowRainThold" 1 "DetAboveRainThold" ;
VAL_ 1049 DET_IDM_104 0 "Not_IDM_Output" 1 "IDM_Output" ;
VAL_ 1049 DET_MTD_104 0 "Not_MTD_Output" 1 "MTD_Output" ;
VAL_ 1049 DET_BELOW_RAIN_THOLD_104 0 "DetBelowRainThold" 1 "DetAboveRainThold" ;
VAL_ 1050 DET_CONFD_AZIMUTH_105 0 "High" 1 "MidHigh" 2 "MidLow" 3 "Low" ;
VAL_ 1050 DET_CONFD_ELEVATION_105 0 "High" 1 "MidHigh" 2 "MidLow" 3 "Low" ;
VAL_ 1050 DET_IDM_105 0 "Not_IDM_Output" 1 "IDM_Output" ;
VAL_ 1050 DET_MTD_105 0 "Not_MTD_Output" 1 "MTD_Output" ;
VAL_ 1050 DET_BELOW_RAIN_THOLD_105 0 "DetBelowRainThold" 1 "DetAboveRainThold" ;
VAL_ 1050 DET_CONFD_AZIMUTH_106 0 "High" 1 "MidHigh" 2 "MidLow" 3 "Low" ;
VAL_ 1050 DET_CONFD_ELEVATION_106 0 "High" 1 "MidHigh" 2 "MidLow" 3 "Low" ;
VAL_ 1050 DET_IDM_106 0 "Not_IDM_Output" 1 "IDM_Output" ;
VAL_ 1050 DET_MTD_106 0 "Not_MTD_Output" 1 "MTD_Output" ;
VAL_ 1050 DET_BELOW_RAIN_THOLD_106 0 "DetBelowRainThold" 1 "DetAboveRainThold" ;
VAL_ 1050 DET_CONFD_AZIMUTH_107 0 "High" 1 "MidHigh" 2 "MidLow" 3 "Low" ;
VAL_ 1050 DET_CONFD_ELEVATION_107 0 "High" 1 "MidHigh" 2 "MidLow" 3 "Low" ;
VAL_ 1050 DET_IDM_107 0 "Not_IDM_Output" 1 "IDM_Output" ;
VAL_ 1050 DET_MTD_107 0 "Not_MTD_Output" 1 "MTD_Output" ;
VAL_ 1050 DET_BELOW_RAIN_THOLD_107 0 "DetBelowRainThold" 1 "DetAboveRainThold" ;
VAL_ 1050 DET_IDM_108 0 "Not_IDM_Output" 1 "IDM_Output" ;
VAL_ 1050 DET_MTD_108 0 "Not_MTD_Output" 1 "MTD_Output" ;
VAL_ 1050 DET_BELOW_RAIN_THOLD_108 0 "DetBelowRainThold" 1 "DetAboveRainThold" ;
VAL_ 1051 DET_CONFD_AZIMUTH_109 0 "High" 1 "MidHigh" 2 "MidLow" 3 "Low" ;
VAL_ 1051 DET_CONFD_ELEVATION_109 0 "High" 1 "MidHigh" 2 "MidLow" 3 "Low" ;
VAL_ 1051 DET_IDM_109 0 "Not_IDM_Output" 1 "IDM_Output" ;
VAL_ 1051 DET_MTD_109 0 "Not_MTD_Output" 1 "MTD_Output" ;
VAL_ 1051 DET_BELOW_RAIN_THOLD_109 0 "DetBelowRainThold" 1 "DetAboveRainThold" ;
VAL_ 1051 DET_CONFD_AZIMUTH_110 0 "High" 1 "MidHigh" 2 "MidLow" 3 "Low" ;
VAL_ 1051 DET_CONFD_ELEVATION_110 0 "High" 1 "MidHigh" 2 "MidLow" 3 "Low" ;
VAL_ 1051 DET_IDM_110 0 "Not_IDM_Output" 1 "IDM_Output" ;
VAL_ 1051 DET_MTD_110 0 "Not_MTD_Output" 1 "MTD_Output" ;
VAL_ 1051 DET_BELOW_RAIN_THOLD_110 0 "DetBelowRainThold" 1 "DetAboveRainThold" ;
VAL_ 1051 DET_CONFD_AZIMUTH_111 0 "High" 1 "MidHigh" 2 "MidLow" 3 "Low" ;
VAL_ 1051 DET_CONFD_ELEVATION_111 0 "High" 1 "MidHigh" 2 "MidLow" 3 "Low" ;
VAL_ 1051 DET_IDM_111 0 "Not_IDM_Output" 1 "IDM_Output" ;
VAL_ 1051 DET_MTD_111 0 "Not_MTD_Output" 1 "MTD_Output" ;
VAL_ 1051 DET_BELOW_RAIN_THOLD_111 0 "DetBelowRainThold" 1 "DetAboveRainThold" ;
VAL_ 1051 DET_IDM_112 0 "Not_IDM_Output" 1 "IDM_Output" ;
VAL_ 1051 DET_MTD_112 0 "Not_MTD_Output" 1 "MTD_Output" ;
VAL_ 1051 DET_BELOW_RAIN_THOLD_112 0 "DetBelowRainThold" 1 "DetAboveRainThold" ;
VAL_ 1052 DET_CONFD_AZIMUTH_113 0 "High" 1 "MidHigh" 2 "MidLow" 3 "Low" ;
VAL_ 1052 DET_CONFD_ELEVATION_113 0 "High" 1 "MidHigh" 2 "MidLow" 3 "Low" ;
VAL_ 1052 DET_IDM_113 0 "Not_IDM_Output" 1 "IDM_Output" ;
VAL_ 1052 DET_MTD_113 0 "Not_MTD_Output" 1 "MTD_Output" ;
VAL_ 1052 DET_BELOW_RAIN_THOLD_113 0 "DetBelowRainThold" 1 "DetAboveRainThold" ;
VAL_ 1052 DET_CONFD_AZIMUTH_114 0 "High" 1 "MidHigh" 2 "MidLow" 3 "Low" ;
VAL_ 1052 DET_CONFD_ELEVATION_114 0 "High" 1 "MidHigh" 2 "MidLow" 3 "Low" ;
VAL_ 1052 DET_IDM_114 0 "Not_IDM_Output" 1 "IDM_Output" ;
VAL_ 1052 DET_MTD_114 0 "Not_MTD_Output" 1 "MTD_Output" ;
VAL_ 1052 DET_BELOW_RAIN_THOLD_114 0 "DetBelowRainThold" 1 "DetAboveRainThold" ;
VAL_ 1052 DET_CONFD_AZIMUTH_115 0 "High" 1 "MidHigh" 2 "MidLow" 3 "Low" ;
VAL_ 1052 DET_CONFD_ELEVATION_115 0 "High" 1 "MidHigh" 2 "MidLow" 3 "Low" ;
VAL_ 1052 DET_IDM_115 0 "Not_IDM_Output" 1 "IDM_Output" ;
VAL_ 1052 DET_MTD_115 0 "Not_MTD_Output" 1 "MTD_Output" ;
VAL_ 1052 DET_BELOW_RAIN_THOLD_115 0 "DetBelowRainThold" 1 "DetAboveRainThold" ;
VAL_ 1052 DET_IDM_116 0 "Not_IDM_Output" 1 "IDM_Output" ;
VAL_ 1052 DET_MTD_116 0 "Not_MTD_Output" 1 "MTD_Output" ;
VAL_ 1052 DET_BELOW_RAIN_THOLD_116 0 "DetBelowRainThold" 1 "DetAboveRainThold" ;
VAL_ 1053 DET_CONFD_AZIMUTH_117 0 "High" 1 "MidHigh" 2 "MidLow" 3 "Low" ;
VAL_ 1053 DET_CONFD_ELEVATION_117 0 "High" 1 "MidHigh" 2 "MidLow" 3 "Low" ;
VAL_ 1053 DET_IDM_117 0 "Not_IDM_Output" 1 "IDM_Output" ;
VAL_ 1053 DET_MTD_117 0 "Not_MTD_Output" 1 "MTD_Output" ;
VAL_ 1053 DET_BELOW_RAIN_THOLD_117 0 "DetBelowRainThold" 1 "DetAboveRainThold" ;
VAL_ 1053 DET_CONFD_AZIMUTH_118 0 "High" 1 "MidHigh" 2 "MidLow" 3 "Low" ;
VAL_ 1053 DET_CONFD_ELEVATION_118 0 "High" 1 "MidHigh" 2 "MidLow" 3 "Low" ;
VAL_ 1053 DET_IDM_118 0 "Not_IDM_Output" 1 "IDM_Output" ;
VAL_ 1053 DET_MTD_118 0 "Not_MTD_Output" 1 "MTD_Output" ;
VAL_ 1053 DET_BELOW_RAIN_THOLD_118 0 "DetBelowRainThold" 1 "DetAboveRainThold" ;
VAL_ 1053 DET_CONFD_AZIMUTH_119 0 "High" 1 "MidHigh" 2 "MidLow" 3 "Low" ;
VAL_ 1053 DET_CONFD_ELEVATION_119 0 "High" 1 "MidHigh" 2 "MidLow" 3 "Low" ;
VAL_ 1053 DET_IDM_119 0 "Not_IDM_Output" 1 "IDM_Output" ;
VAL_ 1053 DET_MTD_119 0 "Not_MTD_Output" 1 "MTD_Output" ;
VAL_ 1053 DET_BELOW_RAIN_THOLD_119 0 "DetBelowRainThold" 1 "DetAboveRainThold" ;
VAL_ 1053 DET_IDM_120 0 "Not_IDM_Output" 1 "IDM_Output" ;
VAL_ 1053 DET_MTD_120 0 "Not_MTD_Output" 1 "MTD_Output" ;
VAL_ 1053 DET_BELOW_RAIN_THOLD_120 0 "DetBelowRainThold" 1 "DetAboveRainThold" ;
VAL_ 1054 DET_CONFD_AZIMUTH_121 0 "High" 1 "MidHigh" 2 "MidLow" 3 "Low" ;
VAL_ 1054 DET_CONFD_ELEVATION_121 0 "High" 1 "MidHigh" 2 "MidLow" 3 "Low" ;
VAL_ 1054 DET_IDM_121 0 "Not_IDM_Output" 1 "IDM_Output" ;
VAL_ 1054 DET_MTD_121 0 "Not_MTD_Output" 1 "MTD_Output" ;
VAL_ 1054 DET_BELOW_RAIN_THOLD_121 0 "DetBelowRainThold" 1 "DetAboveRainThold" ;
VAL_ 1054 DET_CONFD_AZIMUTH_122 0 "High" 1 "MidHigh" 2 "MidLow" 3 "Low" ;
VAL_ 1054 DET_CONFD_ELEVATION_122 0 "High" 1 "MidHigh" 2 "MidLow" 3 "Low" ;
VAL_ 1054 DET_IDM_122 0 "Not_IDM_Output" 1 "IDM_Output" ;
VAL_ 1054 DET_MTD_122 0 "Not_MTD_Output" 1 "MTD_Output" ;
VAL_ 1054 DET_BELOW_RAIN_THOLD_122 0 "DetBelowRainThold" 1 "DetAboveRainThold" ;
VAL_ 1054 DET_CONFD_AZIMUTH_123 0 "High" 1 "MidHigh" 2 "MidLow" 3 "Low" ;
VAL_ 1054 DET_CONFD_ELEVATION_123 0 "High" 1 "MidHigh" 2 "MidLow" 3 "Low" ;
VAL_ 1054 DET_IDM_123 0 "Not_IDM_Output" 1 "IDM_Output" ;
VAL_ 1054 DET_MTD_123 0 "Not_MTD_Output" 1 "MTD_Output" ;
VAL_ 1054 DET_BELOW_RAIN_THOLD_123 0 "DetBelowRainThold" 1 "DetAboveRainThold" ;
VAL_ 1054 DET_IDM_124 0 "Not_IDM_Output" 1 "IDM_Output" ;
VAL_ 1054 DET_MTD_124 0 "Not_MTD_Output" 1 "MTD_Output" ;
VAL_ 1054 DET_BELOW_RAIN_THOLD_124 0 "DetBelowRainThold" 1 "DetAboveRainThold" ;
VAL_ 1055 DET_CONFD_AZIMUTH_125 0 "High" 1 "MidHigh" 2 "MidLow" 3 "Low" ;
VAL_ 1055 DET_CONFD_ELEVATION_125 0 "High" 1 "MidHigh" 2 "MidLow" 3 "Low" ;
VAL_ 1055 DET_IDM_125 0 "Not_IDM_Output" 1 "IDM_Output" ;
VAL_ 1055 DET_MTD_125 0 "Not_MTD_Output" 1 "MTD_Output" ;
VAL_ 1055 DET_BELOW_RAIN_THOLD_125 0 "DetBelowRainThold" 1 "DetAboveRainThold" ;
VAL_ 1055 DET_CONFD_AZIMUTH_126 0 "High" 1 "MidHigh" 2 "MidLow" 3 "Low" ;
VAL_ 1055 DET_CONFD_ELEVATION_126 0 "High" 1 "MidHigh" 2 "MidLow" 3 "Low" ;
VAL_ 1055 DET_IDM_126 0 "Not_IDM_Output" 1 "IDM_Output" ;
VAL_ 1055 DET_MTD_126 0 "Not_MTD_Output" 1 "MTD_Output" ;
VAL_ 1055 DET_BELOW_RAIN_THOLD_126 0 "DetBelowRainThold" 1 "DetAboveRainThold" ;
VAL_ 1055 DET_CONFD_AZIMUTH_127 0 "High" 1 "MidHigh" 2 "MidLow" 3 "Low" ;
VAL_ 1055 DET_CONFD_ELEVATION_127 0 "High" 1 "MidHigh" 2 "MidLow" 3 "Low" ;
VAL_ 1055 DET_IDM_127 0 "Not_IDM_Output" 1 "IDM_Output" ;
VAL_ 1055 DET_MTD_127 0 "Not_MTD_Output" 1 "MTD_Output" ;
VAL_ 1055 DET_BELOW_RAIN_THOLD_127 0 "DetBelowRainThold" 1 "DetAboveRainThold" ;
VAL_ 1055 DET_IDM_128 0 "Not_IDM_Output" 1 "IDM_Output" ;
VAL_ 1055 DET_MTD_128 0 "Not_MTD_Output" 1 "MTD_Output" ;
VAL_ 1055 DET_BELOW_RAIN_THOLD_128 0 "DetBelowRainThold" 1 "DetAboveRainThold" ;
VAL_ 1056 DET_CONFD_AZIMUTH_129 0 "High" 1 "MidHigh" 2 "MidLow" 3 "Low" ;
VAL_ 1056 DET_CONFD_ELEVATION_129 0 "High" 1 "MidHigh" 2 "MidLow" 3 "Low" ;
VAL_ 1056 DET_IDM_129 0 "Not_IDM_Output" 1 "IDM_Output" ;
VAL_ 1056 DET_MTD_129 0 "Not_MTD_Output" 1 "MTD_Output" ;
VAL_ 1056 DET_BELOW_RAIN_THOLD_129 0 "DetBelowRainThold" 1 "DetAboveRainThold" ;
VAL_ 1056 DET_CONFD_AZIMUTH_130 0 "High" 1 "MidHigh" 2 "MidLow" 3 "Low" ;
VAL_ 1056 DET_CONFD_ELEVATION_130 0 "High" 1 "MidHigh" 2 "MidLow" 3 "Low" ;
VAL_ 1056 DET_IDM_130 0 "Not_IDM_Output" 1 "IDM_Output" ;
VAL_ 1056 DET_MTD_130 0 "Not_MTD_Output" 1 "MTD_Output" ;
VAL_ 1056 DET_BELOW_RAIN_THOLD_130 0 "DetBelowRainThold" 1 "DetAboveRainThold" ;
VAL_ 1056 DET_CONFD_AZIMUTH_131 0 "High" 1 "MidHigh" 2 "MidLow" 3 "Low" ;
VAL_ 1056 DET_CONFD_ELEVATION_131 0 "High" 1 "MidHigh" 2 "MidLow" 3 "Low" ;
VAL_ 1056 DET_IDM_131 0 "Not_IDM_Output" 1 "IDM_Output" ;
VAL_ 1056 DET_MTD_131 0 "Not_MTD_Output" 1 "MTD_Output" ;
VAL_ 1056 DET_BELOW_RAIN_THOLD_131 0 "DetBelowRainThold" 1 "DetAboveRainThold" ;
VAL_ 1056 DET_IDM_132 0 "Not_IDM_Output" 1 "IDM_Output" ;
VAL_ 1056 DET_MTD_132 0 "Not_MTD_Output" 1 "MTD_Output" ;
VAL_ 1056 DET_BELOW_RAIN_THOLD_132 0 "DetBelowRainThold" 1 "DetAboveRainThold" ;
VAL_ 1057 DET_CONFD_AZIMUTH_133 0 "High" 1 "MidHigh" 2 "MidLow" 3 "Low" ;
VAL_ 1057 DET_CONFD_ELEVATION_133 0 "High" 1 "MidHigh" 2 "MidLow" 3 "Low" ;
VAL_ 1057 DET_IDM_133 0 "Not_IDM_Output" 1 "IDM_Output" ;
VAL_ 1057 DET_MTD_133 0 "Not_MTD_Output" 1 "MTD_Output" ;
VAL_ 1057 DET_BELOW_RAIN_THOLD_133 0 "DetBelowRainThold" 1 "DetAboveRainThold" ;
VAL_ 1057 DET_CONFD_AZIMUTH_134 0 "High" 1 "MidHigh" 2 "MidLow" 3 "Low" ;
VAL_ 1057 DET_CONFD_ELEVATION_134 0 "High" 1 "MidHigh" 2 "MidLow" 3 "Low" ;
VAL_ 1057 DET_IDM_134 0 "Not_IDM_Output" 1 "IDM_Output" ;
VAL_ 1057 DET_MTD_134 0 "Not_MTD_Output" 1 "MTD_Output" ;
VAL_ 1057 DET_BELOW_RAIN_THOLD_134 0 "DetBelowRainThold" 1 "DetAboveRainThold" ;
VAL_ 1057 DET_CONFD_AZIMUTH_135 0 "High" 1 "MidHigh" 2 "MidLow" 3 "Low" ;
VAL_ 1057 DET_CONFD_ELEVATION_135 0 "High" 1 "MidHigh" 2 "MidLow" 3 "Low" ;
VAL_ 1057 DET_IDM_135 0 "Not_IDM_Output" 1 "IDM_Output" ;
VAL_ 1057 DET_MTD_135 0 "Not_MTD_Output" 1 "MTD_Output" ;
VAL_ 1057 DET_BELOW_RAIN_THOLD_135 0 "DetBelowRainThold" 1 "DetAboveRainThold" ;
VAL_ 1057 DET_IDM_136 0 "Not_IDM_Output" 1 "IDM_Output" ;
VAL_ 1057 DET_MTD_136 0 "Not_MTD_Output" 1 "MTD_Output" ;
VAL_ 1057 DET_BELOW_RAIN_THOLD_136 0 "DetBelowRainThold" 1 "DetAboveRainThold" ;
VAL_ 1058 DET_CONFD_AZIMUTH_137 0 "High" 1 "MidHigh" 2 "MidLow" 3 "Low" ;
VAL_ 1058 DET_CONFD_ELEVATION_137 0 "High" 1 "MidHigh" 2 "MidLow" 3 "Low" ;
VAL_ 1058 DET_IDM_137 0 "Not_IDM_Output" 1 "IDM_Output" ;
VAL_ 1058 DET_MTD_137 0 "Not_MTD_Output" 1 "MTD_Output" ;
VAL_ 1058 DET_BELOW_RAIN_THOLD_137 0 "DetBelowRainThold" 1 "DetAboveRainThold" ;
VAL_ 1058 DET_CONFD_AZIMUTH_138 0 "High" 1 "MidHigh" 2 "MidLow" 3 "Low" ;
VAL_ 1058 DET_CONFD_ELEVATION_138 0 "High" 1 "MidHigh" 2 "MidLow" 3 "Low" ;
VAL_ 1058 DET_IDM_138 0 "Not_IDM_Output" 1 "IDM_Output" ;
VAL_ 1058 DET_MTD_138 0 "Not_MTD_Output" 1 "MTD_Output" ;
VAL_ 1058 DET_BELOW_RAIN_THOLD_138 0 "DetBelowRainThold" 1 "DetAboveRainThold" ;
VAL_ 1058 DET_CONFD_AZIMUTH_139 0 "High" 1 "MidHigh" 2 "MidLow" 3 "Low" ;
VAL_ 1058 DET_CONFD_ELEVATION_139 0 "High" 1 "MidHigh" 2 "MidLow" 3 "Low" ;
VAL_ 1058 DET_IDM_139 0 "Not_IDM_Output" 1 "IDM_Output" ;
VAL_ 1058 DET_MTD_139 0 "Not_MTD_Output" 1 "MTD_Output" ;
VAL_ 1058 DET_BELOW_RAIN_THOLD_139 0 "DetBelowRainThold" 1 "DetAboveRainThold" ;
VAL_ 1058 DET_IDM_140 0 "Not_IDM_Output" 1 "IDM_Output" ;
VAL_ 1058 DET_MTD_140 0 "Not_MTD_Output" 1 "MTD_Output" ;
VAL_ 1058 DET_BELOW_RAIN_THOLD_140 0 "DetBelowRainThold" 1 "DetAboveRainThold" ;
VAL_ 1059 DET_CONFD_AZIMUTH_141 0 "High" 1 "MidHigh" 2 "MidLow" 3 "Low" ;
VAL_ 1059 DET_CONFD_ELEVATION_141 0 "High" 1 "MidHigh" 2 "MidLow" 3 "Low" ;
VAL_ 1059 DET_IDM_141 0 "Not_IDM_Output" 1 "IDM_Output" ;
VAL_ 1059 DET_MTD_141 0 "Not_MTD_Output" 1 "MTD_Output" ;
VAL_ 1059 DET_BELOW_RAIN_THOLD_141 0 "DetBelowRainThold" 1 "DetAboveRainThold" ;
VAL_ 1059 DET_CONFD_AZIMUTH_142 0 "High" 1 "MidHigh" 2 "MidLow" 3 "Low" ;
VAL_ 1059 DET_CONFD_ELEVATION_142 0 "High" 1 "MidHigh" 2 "MidLow" 3 "Low" ;
VAL_ 1059 DET_IDM_142 0 "Not_IDM_Output" 1 "IDM_Output" ;
VAL_ 1059 DET_MTD_142 0 "Not_MTD_Output" 1 "MTD_Output" ;
VAL_ 1059 DET_BELOW_RAIN_THOLD_142 0 "DetBelowRainThold" 1 "DetAboveRainThold" ;
VAL_ 1059 DET_CONFD_AZIMUTH_143 0 "High" 1 "MidHigh" 2 "MidLow" 3 "Low" ;
VAL_ 1059 DET_CONFD_ELEVATION_143 0 "High" 1 "MidHigh" 2 "MidLow" 3 "Low" ;
VAL_ 1059 DET_IDM_143 0 "Not_IDM_Output" 1 "IDM_Output" ;
VAL_ 1059 DET_MTD_143 0 "Not_MTD_Output" 1 "MTD_Output" ;
VAL_ 1059 DET_BELOW_RAIN_THOLD_143 0 "DetBelowRainThold" 1 "DetAboveRainThold" ;
VAL_ 1059 DET_IDM_144 0 "Not_IDM_Output" 1 "IDM_Output" ;
VAL_ 1059 DET_MTD_144 0 "Not_MTD_Output" 1 "MTD_Output" ;
VAL_ 1059 DET_BELOW_RAIN_THOLD_144 0 "DetBelowRainThold" 1 "DetAboveRainThold" ;
VAL_ 1060 DET_CONFD_AZIMUTH_145 0 "High" 1 "MidHigh" 2 "MidLow" 3 "Low" ;
VAL_ 1060 DET_CONFD_ELEVATION_145 0 "High" 1 "MidHigh" 2 "MidLow" 3 "Low" ;
VAL_ 1060 DET_IDM_145 0 "Not_IDM_Output" 1 "IDM_Output" ;
VAL_ 1060 DET_MTD_145 0 "Not_MTD_Output" 1 "MTD_Output" ;
VAL_ 1060 DET_BELOW_RAIN_THOLD_145 0 "DetBelowRainThold" 1 "DetAboveRainThold" ;
VAL_ 1060 DET_CONFD_AZIMUTH_146 0 "High" 1 "MidHigh" 2 "MidLow" 3 "Low" ;
VAL_ 1060 DET_CONFD_ELEVATION_146 0 "High" 1 "MidHigh" 2 "MidLow" 3 "Low" ;
VAL_ 1060 DET_IDM_146 0 "Not_IDM_Output" 1 "IDM_Output" ;
VAL_ 1060 DET_MTD_146 0 "Not_MTD_Output" 1 "MTD_Output" ;
VAL_ 1060 DET_BELOW_RAIN_THOLD_146 0 "DetBelowRainThold" 1 "DetAboveRainThold" ;
VAL_ 1060 DET_CONFD_AZIMUTH_147 0 "High" 1 "MidHigh" 2 "MidLow" 3 "Low" ;
VAL_ 1060 DET_CONFD_ELEVATION_147 0 "High" 1 "MidHigh" 2 "MidLow" 3 "Low" ;
VAL_ 1060 DET_IDM_147 0 "Not_IDM_Output" 1 "IDM_Output" ;
VAL_ 1060 DET_MTD_147 0 "Not_MTD_Output" 1 "MTD_Output" ;
VAL_ 1060 DET_BELOW_RAIN_THOLD_147 0 "DetBelowRainThold" 1 "DetAboveRainThold" ;
VAL_ 1060 DET_IDM_148 0 "Not_IDM_Output" 1 "IDM_Output" ;
VAL_ 1060 DET_MTD_148 0 "Not_MTD_Output" 1 "MTD_Output" ;
VAL_ 1060 DET_BELOW_RAIN_THOLD_148 0 "DetBelowRainThold" 1 "DetAboveRainThold" ;
VAL_ 1061 DET_CONFD_AZIMUTH_149 0 "High" 1 "MidHigh" 2 "MidLow" 3 "Low" ;
VAL_ 1061 DET_CONFD_ELEVATION_149 0 "High" 1 "MidHigh" 2 "MidLow" 3 "Low" ;
VAL_ 1061 DET_IDM_149 0 "Not_IDM_Output" 1 "IDM_Output" ;
VAL_ 1061 DET_MTD_149 0 "Not_MTD_Output" 1 "MTD_Output" ;
VAL_ 1061 DET_BELOW_RAIN_THOLD_149 0 "DetBelowRainThold" 1 "DetAboveRainThold" ;
VAL_ 1061 DET_CONFD_AZIMUTH_150 0 "High" 1 "MidHigh" 2 "MidLow" 3 "Low" ;
VAL_ 1061 DET_CONFD_ELEVATION_150 0 "High" 1 "MidHigh" 2 "MidLow" 3 "Low" ;
VAL_ 1061 DET_IDM_150 0 "Not_IDM_Output" 1 "IDM_Output" ;
VAL_ 1061 DET_MTD_150 0 "Not_MTD_Output" 1 "MTD_Output" ;
VAL_ 1061 DET_BELOW_RAIN_THOLD_150 0 "DetBelowRainThold" 1 "DetAboveRainThold" ;
VAL_ 1061 DET_CONFD_AZIMUTH_151 0 "High" 1 "MidHigh" 2 "MidLow" 3 "Low" ;
VAL_ 1061 DET_CONFD_ELEVATION_151 0 "High" 1 "MidHigh" 2 "MidLow" 3 "Low" ;
VAL_ 1061 DET_IDM_151 0 "Not_IDM_Output" 1 "IDM_Output" ;
VAL_ 1061 DET_MTD_151 0 "Not_MTD_Output" 1 "MTD_Output" ;
VAL_ 1061 DET_BELOW_RAIN_THOLD_151 0 "DetBelowRainThold" 1 "DetAboveRainThold" ;
VAL_ 1061 DET_IDM_152 0 "Not_IDM_Output" 1 "IDM_Output" ;
VAL_ 1061 DET_MTD_152 0 "Not_MTD_Output" 1 "MTD_Output" ;
VAL_ 1061 DET_BELOW_RAIN_THOLD_152 0 "DetBelowRainThold" 1 "DetAboveRainThold" ;
VAL_ 1062 DET_CONFD_AZIMUTH_153 0 "High" 1 "MidHigh" 2 "MidLow" 3 "Low" ;
VAL_ 1062 DET_CONFD_ELEVATION_153 0 "High" 1 "MidHigh" 2 "MidLow" 3 "Low" ;
VAL_ 1062 DET_IDM_153 0 "Not_IDM_Output" 1 "IDM_Output" ;
VAL_ 1062 DET_MTD_153 0 "Not_MTD_Output" 1 "MTD_Output" ;
VAL_ 1062 DET_BELOW_RAIN_THOLD_153 0 "DetBelowRainThold" 1 "DetAboveRainThold" ;
VAL_ 1062 DET_CONFD_AZIMUTH_154 0 "High" 1 "MidHigh" 2 "MidLow" 3 "Low" ;
VAL_ 1062 DET_CONFD_ELEVATION_154 0 "High" 1 "MidHigh" 2 "MidLow" 3 "Low" ;
VAL_ 1062 DET_IDM_154 0 "Not_IDM_Output" 1 "IDM_Output" ;
VAL_ 1062 DET_MTD_154 0 "Not_MTD_Output" 1 "MTD_Output" ;
VAL_ 1062 DET_BELOW_RAIN_THOLD_154 0 "DetBelowRainThold" 1 "DetAboveRainThold" ;
VAL_ 1062 DET_CONFD_AZIMUTH_155 0 "High" 1 "MidHigh" 2 "MidLow" 3 "Low" ;
VAL_ 1062 DET_CONFD_ELEVATION_155 0 "High" 1 "MidHigh" 2 "MidLow" 3 "Low" ;
VAL_ 1062 DET_IDM_155 0 "Not_IDM_Output" 1 "IDM_Output" ;
VAL_ 1062 DET_MTD_155 0 "Not_MTD_Output" 1 "MTD_Output" ;
VAL_ 1062 DET_BELOW_RAIN_THOLD_155 0 "DetBelowRainThold" 1 "DetAboveRainThold" ;
VAL_ 1062 DET_IDM_156 0 "Not_IDM_Output" 1 "IDM_Output" ;
VAL_ 1062 DET_MTD_156 0 "Not_MTD_Output" 1 "MTD_Output" ;
VAL_ 1062 DET_BELOW_RAIN_THOLD_156 0 "DetBelowRainThold" 1 "DetAboveRainThold" ;
VAL_ 1063 DET_CONFD_AZIMUTH_157 0 "High" 1 "MidHigh" 2 "MidLow" 3 "Low" ;
VAL_ 1063 DET_CONFD_ELEVATION_157 0 "High" 1 "MidHigh" 2 "MidLow" 3 "Low" ;
VAL_ 1063 DET_IDM_157 0 "Not_IDM_Output" 1 "IDM_Output" ;
VAL_ 1063 DET_MTD_157 0 "Not_MTD_Output" 1 "MTD_Output" ;
VAL_ 1063 DET_BELOW_RAIN_THOLD_157 0 "DetBelowRainThold" 1 "DetAboveRainThold" ;
VAL_ 1063 DET_CONFD_AZIMUTH_158 0 "High" 1 "MidHigh" 2 "MidLow" 3 "Low" ;
VAL_ 1063 DET_CONFD_ELEVATION_158 0 "High" 1 "MidHigh" 2 "MidLow" 3 "Low" ;
VAL_ 1063 DET_IDM_158 0 "Not_IDM_Output" 1 "IDM_Output" ;
VAL_ 1063 DET_MTD_158 0 "Not_MTD_Output" 1 "MTD_Output" ;
VAL_ 1063 DET_BELOW_RAIN_THOLD_158 0 "DetBelowRainThold" 1 "DetAboveRainThold" ;
VAL_ 1063 DET_CONFD_AZIMUTH_159 0 "High" 1 "MidHigh" 2 "MidLow" 3 "Low" ;
VAL_ 1063 DET_CONFD_ELEVATION_159 0 "High" 1 "MidHigh" 2 "MidLow" 3 "Low" ;
VAL_ 1063 DET_IDM_159 0 "Not_IDM_Output" 1 "IDM_Output" ;
VAL_ 1063 DET_MTD_159 0 "Not_MTD_Output" 1 "MTD_Output" ;
VAL_ 1063 DET_BELOW_RAIN_THOLD_159 0 "DetBelowRainThold" 1 "DetAboveRainThold" ;
VAL_ 1063 DET_IDM_160 0 "Not_IDM_Output" 1 "IDM_Output" ;
VAL_ 1063 DET_MTD_160 0 "Not_MTD_Output" 1 "MTD_Output" ;
VAL_ 1063 DET_BELOW_RAIN_THOLD_160 0 "DetBelowRainThold" 1 "DetAboveRainThold" ;
SIG_GROUP_ 1048 Detections_097_100 1 : DET_PROB_1STAZHYPO_097 DET_PROB_1STAZHYPO_098 DET_PROB_1STAZHYPO_099 DET_PROB_1STAZHYPO_100 DET_IDM_097 DET_IDM_098 DET_IDM_099 DET_IDM_100 DET_MTD_100 DET_MTD_099 DET_MTD_098 DET_MTD_097 DET_BELOW_RAIN_THOLD_100 DET_BELOW_RAIN_THOLD_099 DET_BELOW_RAIN_THOLD_098 DET_BELOW_RAIN_THOLD_097 DET_MH_CRC16_097_100 DET_MH_CYCLE_COUNTER_097_100 DET_MH_SCAN_INDEX_4LSB_097_100 DET_CONFD_ELEVATION_097 DET_CONFD_AZIMUTH_097 DET_HVC_FLAG_097 DET_EXISTENCE_PROB_097 DET_SNR_097 DET_SUPER_RES_TARGET_097 DET_BI_STATIC_FLAG_097 DET_RCS_097 DET_ELEVATION_ERR_097 DET_ELEVATION_097 DET_AZIMUTH_ERR_097 DET_AZIMUTH_097 DET_RANGE_VELOCITY_ERR_097 DET_RANGE_VELOCITY_097 DET_RANGE_ERR_097 DET_RANGE_097 DET_CONFD_ELEVATION_098 DET_CONFD_AZIMUTH_098 DET_HVC_FLAG_098 DET_EXISTENCE_PROB_098 DET_SNR_098 DET_SUPER_RES_TARGET_098 DET_BI_STATIC_FLAG_098 DET_RCS_098 DET_ELEVATION_ERR_098 DET_ELEVATION_098 DET_AZIMUTH_ERR_098 DET_AZIMUTH_098 DET_RANGE_VELOCITY_ERR_098 DET_RANGE_VELOCITY_098 DET_RANGE_ERR_098 DET_RANGE_098 DET_CONFD_ELEVATION_099 DET_CONFD_AZIMUTH_099 DET_HVC_FLAG_099 DET_EXISTENCE_PROB_099 DET_SNR_099 DET_SUPER_RES_TARGET_099 DET_BI_STATIC_FLAG_099 DET_RCS_099 DET_ELEVATION_ERR_099 DET_ELEVATION_099 DET_AZIMUTH_ERR_099 DET_AZIMUTH_099 DET_RANGE_VELOCITY_ERR_099 DET_RANGE_VELOCITY_099 DET_RANGE_ERR_099 DET_RANGE_099 DET_CONFD_ELEVATION_100 DET_CONFD_AZIMUTH_100 DET_HVC_FLAG_100 DET_EXISTENCE_PROB_100 DET_SNR_100 DET_SUPER_RES_TARGET_100 DET_BI_STATIC_FLAG_100 DET_RCS_100 DET_ELEVATION_ERR_100 DET_ELEVATION_100 DET_AZIMUTH_ERR_100 DET_AZIMUTH_100 DET_RANGE_VELOCITY_ERR_100 DET_RANGE_VELOCITY_100 DET_RANGE_ERR_100 DET_RANGE_100;
SIG_GROUP_ 1049 Detections_101_104 1 : DET_PROB_1STAZHYPO_101 DET_PROB_1STAZHYPO_102 DET_PROB_1STAZHYPO_103 DET_PROB_1STAZHYPO_104 DET_IDM_101 DET_IDM_102 DET_IDM_103 DET_IDM_104 DET_MTD_104 DET_MTD_103 DET_MTD_102 DET_MTD_101 DET_BELOW_RAIN_THOLD_104 DET_BELOW_RAIN_THOLD_103 DET_BELOW_RAIN_THOLD_102 DET_BELOW_RAIN_THOLD_101 DET_MH_CRC16_101_104 DET_MH_CYCLE_COUNTER_101_104 DET_MH_SCAN_INDEX_4LSB_101_104 DET_CONFD_ELEVATION_101 DET_CONFD_AZIMUTH_101 DET_HVC_FLAG_101 DET_EXISTENCE_PROB_101 DET_SNR_101 DET_SUPER_RES_TARGET_101 DET_BI_STATIC_FLAG_101 DET_RCS_101 DET_ELEVATION_ERR_101 DET_ELEVATION_101 DET_AZIMUTH_ERR_101 DET_AZIMUTH_101 DET_RANGE_VELOCITY_ERR_101 DET_RANGE_VELOCITY_101 DET_RANGE_ERR_101 DET_RANGE_101 DET_CONFD_ELEVATION_102 DET_CONFD_AZIMUTH_102 DET_HVC_FLAG_102 DET_EXISTENCE_PROB_102 DET_SNR_102 DET_SUPER_RES_TARGET_102 DET_BI_STATIC_FLAG_102 DET_RCS_102 DET_ELEVATION_ERR_102 DET_ELEVATION_102 DET_AZIMUTH_ERR_102 DET_AZIMUTH_102 DET_RANGE_VELOCITY_ERR_102 DET_RANGE_VELOCITY_102 DET_RANGE_ERR_102 DET_RANGE_102 DET_CONFD_ELEVATION_103 DET_CONFD_AZIMUTH_103 DET_HVC_FLAG_103 DET_EXISTENCE_PROB_103 DET_SNR_103 DET_SUPER_RES_TARGET_103 DET_BI_STATIC_FLAG_103 DET_RCS_103 DET_ELEVATION_ERR_103 DET_ELEVATION_103 DET_AZIMUTH_ERR_103 DET_AZIMUTH_103 DET_RANGE_VELOCITY_ERR_103 DET_RANGE_VELOCITY_103 DET_RANGE_ERR_103 DET_RANGE_103 DET_CONFD_ELEVATION_104 DET_CONFD_AZIMUTH_104 DET_HVC_FLAG_104 DET_EXISTENCE_PROB_104 DET_SNR_104 DET_SUPER_RES_TARGET_104 DET_BI_STATIC_FLAG_104 DET_RCS_104 DET_ELEVATION_ERR_104 DET_ELEVATION_104 DET_AZIMUTH_ERR_104 DET_AZIMUTH_104 DET_RANGE_VELOCITY_ERR_104 DET_RANGE_VELOCITY_104 DET_RANGE_ERR_104 DET_RANGE_104;
SIG_GROUP_ 1050 Detections_105_108 1 : DET_PROB_1STAZHYPO_105 DET_PROB_1STAZHYPO_106 DET_PROB_1STAZHYPO_107 DET_PROB_1STAZHYPO_108 DET_IDM_105 DET_IDM_106 DET_IDM_107 DET_IDM_108 DET_MTD_108 DET_MTD_107 DET_MTD_106 DET_MTD_105 DET_BELOW_RAIN_THOLD_108 DET_BELOW_RAIN_THOLD_107 DET_BELOW_RAIN_THOLD_106 DET_BELOW_RAIN_THOLD_105 DET_MH_CRC16_105_108 DET_MH_CYCLE_COUNTER_105_108 DET_MH_SCAN_INDEX_4LSB_105_108 DET_CONFD_ELEVATION_105 DET_CONFD_AZIMUTH_105 DET_HVC_FLAG_105 DET_EXISTENCE_PROB_105 DET_SNR_105 DET_SUPER_RES_TARGET_105 DET_BI_STATIC_FLAG_105 DET_RCS_105 DET_ELEVATION_ERR_105 DET_ELEVATION_105 DET_AZIMUTH_ERR_105 DET_AZIMUTH_105 DET_RANGE_VELOCITY_ERR_105 DET_RANGE_VELOCITY_105 DET_RANGE_ERR_105 DET_RANGE_105 DET_CONFD_ELEVATION_106 DET_CONFD_AZIMUTH_106 DET_HVC_FLAG_106 DET_EXISTENCE_PROB_106 DET_SNR_106 DET_SUPER_RES_TARGET_106 DET_BI_STATIC_FLAG_106 DET_RCS_106 DET_ELEVATION_ERR_106 DET_ELEVATION_106 DET_AZIMUTH_ERR_106 DET_AZIMUTH_106 DET_RANGE_VELOCITY_ERR_106 DET_RANGE_VELOCITY_106 DET_RANGE_ERR_106 DET_RANGE_106 DET_CONFD_ELEVATION_107 DET_CONFD_AZIMUTH_107 DET_HVC_FLAG_107 DET_EXISTENCE_PROB_107 DET_SNR_107 DET_SUPER_RES_TARGET_107 DET_BI_STATIC_FLAG_107 DET_RCS_107 DET_ELEVATION_ERR_107 DET_ELEVATION_107 DET_AZIMUTH_ERR_107 DET_AZIMUTH_107 DET_RANGE_VELOCITY_ERR_107 DET_RANGE_VELOCITY_107 DET_RANGE_ERR_107 DET_RANGE_107 DET_CONFD_ELEVATION_108 DET_CONFD_AZIMUTH_108 DET_HVC_FLAG_108 DET_EXISTENCE_PROB_108 DET_SNR_108 DET_SUPER_RES_TARGET_108 DET_BI_STATIC_FLAG_108 DET_RCS_108 DET_ELEVATION_ERR_108 DET_ELEVATION_108 DET_AZIMUTH_ERR_108 DET_AZIMUTH_108 DET_RANGE_VELOCITY_ERR_108 DET_RANGE_VELOCITY_108 DET_RANGE_ERR_108 DET_RANGE_108;
SIG_GROUP_ 1051 Detections_109_112 1 : DET_PROB_1STAZHYPO_109 DET_PROB_1STAZHYPO_110 DET_PROB_1STAZHYPO_111 DET_PROB_1STAZHYPO_112 DET_IDM_109 DET_IDM_110 DET_IDM_111 DET_IDM_112 DET_MTD_112 DET_MTD_111 DET_MTD_110 DET_MTD_109 DET_BELOW_RAIN_THOLD_112 DET_BELOW_RAIN_THOLD_111 DET_BELOW_RAIN_THOLD_110 DET_BELOW_RAIN_THOLD_109 DET_MH_CRC16_109_112 DET_MH_CYCLE_COUNTER_109_112 DET_MH_SCAN_INDEX_4LSB_109_112 DET_CONFD_ELEVATION_109 DET_CONFD_AZIMUTH_109 DET_HVC_FLAG_109 DET_EXISTENCE_PROB_109 DET_SNR_109 DET_SUPER_RES_TARGET_109 DET_BI_STATIC_FLAG_109 DET_RCS_109 DET_ELEVATION_ERR_109 DET_ELEVATION_109 DET_AZIMUTH_ERR_109 DET_AZIMUTH_109 DET_RANGE_VELOCITY_ERR_109 DET_RANGE_VELOCITY_109 DET_RANGE_ERR_109 DET_RANGE_109 DET_CONFD_ELEVATION_110 DET_CONFD_AZIMUTH_110 DET_HVC_FLAG_110 DET_EXISTENCE_PROB_110 DET_SNR_110 DET_SUPER_RES_TARGET_110 DET_BI_STATIC_FLAG_110 DET_RCS_110 DET_ELEVATION_ERR_110 DET_ELEVATION_110 DET_AZIMUTH_ERR_110 DET_AZIMUTH_110 DET_RANGE_VELOCITY_ERR_110 DET_RANGE_VELOCITY_110 DET_RANGE_ERR_110 DET_RANGE_110 DET_CONFD_ELEVATION_111 DET_CONFD_AZIMUTH_111 DET_HVC_FLAG_111 DET_EXISTENCE_PROB_111 DET_SNR_111 DET_SUPER_RES_TARGET_111 DET_BI_STATIC_FLAG_111 DET_RCS_111 DET_ELEVATION_ERR_111 DET_ELEVATION_111 DET_AZIMUTH_ERR_111 DET_AZIMUTH_111 DET_RANGE_VELOCITY_ERR_111 DET_RANGE_VELOCITY_111 DET_RANGE_ERR_111 DET_RANGE_111 DET_CONFD_ELEVATION_112 DET_CONFD_AZIMUTH_112 DET_HVC_FLAG_112 DET_EXISTENCE_PROB_112 DET_SNR_112 DET_SUPER_RES_TARGET_112 DET_BI_STATIC_FLAG_112 DET_RCS_112 DET_ELEVATION_ERR_112 DET_ELEVATION_112 DET_AZIMUTH_ERR_112 DET_AZIMUTH_112 DET_RANGE_VELOCITY_ERR_112 DET_RANGE_VELOCITY_112 DET_RANGE_ERR_112 DET_RANGE_112;
SIG_GROUP_ 1052 Detections_113_116 1 : DET_PROB_1STAZHYPO_113 DET_PROB_1STAZHYPO_114 DET_PROB_1STAZHYPO_115 DET_PROB_1STAZHYPO_116 DET_IDM_113 DET_IDM_114 DET_IDM_115 DET_IDM_116 DET_MTD_116 DET_MTD_115 DET_MTD_114 DET_MTD_113 DET_BELOW_RAIN_THOLD_116 DET_BELOW_RAIN_THOLD_115 DET_BELOW_RAIN_THOLD_114 DET_BELOW_RAIN_THOLD_113 DET_MH_CRC16_113_116 DET_MH_CYCLE_COUNTER_113_116 DET_MH_SCAN_INDEX_4LSB_113_116 DET_CONFD_ELEVATION_113 DET_CONFD_AZIMUTH_113 DET_HVC_FLAG_113 DET_EXISTENCE_PROB_113 DET_SNR_113 DET_SUPER_RES_TARGET_113 DET_BI_STATIC_FLAG_113 DET_RCS_113 DET_ELEVATION_ERR_113 DET_ELEVATION_113 DET_AZIMUTH_ERR_113 DET_AZIMUTH_113 DET_RANGE_VELOCITY_ERR_113 DET_RANGE_VELOCITY_113 DET_RANGE_ERR_113 DET_RANGE_113 DET_CONFD_ELEVATION_114 DET_CONFD_AZIMUTH_114 DET_HVC_FLAG_114 DET_EXISTENCE_PROB_114 DET_SNR_114 DET_SUPER_RES_TARGET_114 DET_BI_STATIC_FLAG_114 DET_RCS_114 DET_ELEVATION_ERR_114 DET_ELEVATION_114 DET_AZIMUTH_ERR_114 DET_AZIMUTH_114 DET_RANGE_VELOCITY_ERR_114 DET_RANGE_VELOCITY_114 DET_RANGE_ERR_114 DET_RANGE_114 DET_CONFD_ELEVATION_115 DET_CONFD_AZIMUTH_115 DET_HVC_FLAG_115 DET_EXISTENCE_PROB_115 DET_SNR_115 DET_SUPER_RES_TARGET_115 DET_BI_STATIC_FLAG_115 DET_RCS_115 DET_ELEVATION_ERR_115 DET_ELEVATION_115 DET_AZIMUTH_ERR_115 DET_AZIMUTH_115 DET_RANGE_VELOCITY_ERR_115 DET_RANGE_VELOCITY_115 DET_RANGE_ERR_115 DET_RANGE_115 DET_CONFD_ELEVATION_116 DET_CONFD_AZIMUTH_116 DET_HVC_FLAG_116 DET_EXISTENCE_PROB_116 DET_SNR_116 DET_SUPER_RES_TARGET_116 DET_BI_STATIC_FLAG_116 DET_RCS_116 DET_ELEVATION_ERR_116 DET_ELEVATION_116 DET_AZIMUTH_ERR_116 DET_AZIMUTH_116 DET_RANGE_VELOCITY_ERR_116 DET_RANGE_VELOCITY_116 DET_RANGE_ERR_116 DET_RANGE_116;
SIG_GROUP_ 1053 Detections_117_120 1 : DET_PROB_1STAZHYPO_117 DET_PROB_1STAZHYPO_118 DET_PROB_1STAZHYPO_119 DET_PROB_1STAZHYPO_120 DET_IDM_117 DET_IDM_118 DET_IDM_119 DET_IDM_120 DET_MTD_120 DET_MTD_119 DET_MTD_118 DET_MTD_117 DET_BELOW_RAIN_THOLD_120 DET_BELOW_RAIN_THOLD_119 DET_BELOW_RAIN_THOLD_118 DET_BELOW_RAIN_THOLD_117 DET_MH_CRC16_117_120 DET_MH_CYCLE_COUNTER_117_120 DET_MH_SCAN_INDEX_4LSB_117_120 DET_CONFD_ELEVATION_117 DET_CONFD_AZIMUTH_117 DET_HVC_FLAG_117 DET_EXISTENCE_PROB_117 DET_SNR_117 DET_SUPER_RES_TARGET_117 DET_BI_STATIC_FLAG_117 DET_RCS_117 DET_ELEVATION_ERR_117 DET_ELEVATION_117 DET_AZIMUTH_ERR_117 DET_AZIMUTH_117 DET_RANGE_VELOCITY_ERR_117 DET_RANGE_VELOCITY_117 DET_RANGE_ERR_117 DET_RANGE_117 DET_CONFD_ELEVATION_118 DET_CONFD_AZIMUTH_118 DET_HVC_FLAG_118 DET_EXISTENCE_PROB_118 DET_SNR_118 DET_SUPER_RES_TARGET_118 DET_BI_STATIC_FLAG_118 DET_RCS_118 DET_ELEVATION_ERR_118 DET_ELEVATION_118 DET_AZIMUTH_ERR_118 DET_AZIMUTH_118 DET_RANGE_VELOCITY_ERR_118 DET_RANGE_VELOCITY_118 DET_RANGE_ERR_118 DET_RANGE_118 DET_CONFD_ELEVATION_119 DET_CONFD_AZIMUTH_119 DET_HVC_FLAG_119 DET_EXISTENCE_PROB_119 DET_SNR_119 DET_SUPER_RES_TARGET_119 DET_BI_STATIC_FLAG_119 DET_RCS_119 DET_ELEVATION_ERR_119 DET_ELEVATION_119 DET_AZIMUTH_ERR_119 DET_AZIMUTH_119 DET_RANGE_VELOCITY_ERR_119 DET_RANGE_VELOCITY_119 DET_RANGE_ERR_119 DET_RANGE_119 DET_CONFD_ELEVATION_120 DET_CONFD_AZIMUTH_120 DET_HVC_FLAG_120 DET_EXISTENCE_PROB_120 DET_SNR_120 DET_SUPER_RES_TARGET_120 DET_BI_STATIC_FLAG_120 DET_RCS_120 DET_ELEVATION_ERR_120 DET_ELEVATION_120 DET_AZIMUTH_ERR_120 DET_AZIMUTH_120 DET_RANGE_VELOCITY_ERR_120 DET_RANGE_VELOCITY_120 DET_RANGE_ERR_120 DET_RANGE_120;
SIG_GROUP_ 1054 Detections_121_124 1 : DET_PROB_1STAZHYPO_121 DET_PROB_1STAZHYPO_122 DET_PROB_1STAZHYPO_123 DET_PROB_1STAZHYPO_124 DET_IDM_121 DET_IDM_122 DET_IDM_123 DET_IDM_124 DET_MTD_124 DET_MTD_123 DET_MTD_122 DET_MTD_121 DET_BELOW_RAIN_THOLD_124 DET_BELOW_RAIN_THOLD_123 DET_BELOW_RAIN_THOLD_122 DET_BELOW_RAIN_THOLD_121 DET_MH_CRC16_121_124 DET_MH_CYCLE_COUNTER_121_124 DET_MH_SCAN_INDEX_4LSB_121_124 DET_CONFD_ELEVATION_121 DET_CONFD_AZIMUTH_121 DET_HVC_FLAG_121 DET_EXISTENCE_PROB_121 DET_SNR_121 DET_SUPER_RES_TARGET_121 DET_BI_STATIC_FLAG_121 DET_RCS_121 DET_ELEVATION_ERR_121 DET_ELEVATION_121 DET_AZIMUTH_ERR_121 DET_AZIMUTH_121 DET_RANGE_VELOCITY_ERR_121 DET_RANGE_VELOCITY_121 DET_RANGE_ERR_121 DET_RANGE_121 DET_CONFD_ELEVATION_122 DET_CONFD_AZIMUTH_122 DET_HVC_FLAG_122 DET_EXISTENCE_PROB_122 DET_SNR_122 DET_SUPER_RES_TARGET_122 DET_BI_STATIC_FLAG_122 DET_RCS_122 DET_ELEVATION_ERR_122 DET_ELEVATION_122 DET_AZIMUTH_ERR_122 DET_AZIMUTH_122 DET_RANGE_VELOCITY_ERR_122 DET_RANGE_VELOCITY_122 DET_RANGE_ERR_122 DET_RANGE_122 DET_CONFD_ELEVATION_123 DET_CONFD_AZIMUTH_123 DET_HVC_FLAG_123 DET_EXISTENCE_PROB_123 DET_SNR_123 DET_SUPER_RES_TARGET_123 DET_BI_STATIC_FLAG_123 DET_RCS_123 DET_ELEVATION_ERR_123 DET_ELEVATION_123 DET_AZIMUTH_ERR_123 DET_AZIMUTH_123 DET_RANGE_VELOCITY_ERR_123 DET_RANGE_VELOCITY_123 DET_RANGE_ERR_123 DET_RANGE_123 DET_CONFD_ELEVATION_124 DET_CONFD_AZIMUTH_124 DET_HVC_FLAG_124 DET_EXISTENCE_PROB_124 DET_SNR_124 DET_SUPER_RES_TARGET_124 DET_BI_STATIC_FLAG_124 DET_RCS_124 DET_ELEVATION_ERR_124 DET_ELEVATION_124 DET_AZIMUTH_ERR_124 DET_AZIMUTH_124 DET_RANGE_VELOCITY_ERR_124 DET_RANGE_VELOCITY_124 DET_RANGE_ERR_124 DET_RANGE_124;
SIG_GROUP_ 1055 Detections_125_128 1 : DET_PROB_1STAZHYPO_125 DET_PROB_1STAZHYPO_126 DET_PROB_1STAZHYPO_127 DET_PROB_1STAZHYPO_128 DET_IDM_125 DET_IDM_126 DET_IDM_127 DET_IDM_128 DET_MTD_128 DET_MTD_127 DET_MTD_126 DET_MTD_125 DET_BELOW_RAIN_THOLD_128 DET_BELOW_RAIN_THOLD_127 DET_BELOW_RAIN_THOLD_126 DET_BELOW_RAIN_THOLD_125 DET_MH_CRC16_125_128 DET_MH_CYCLE_COUNTER_125_128 DET_MH_SCAN_INDEX_4LSB_125_128 DET_CONFD_ELEVATION_125 DET_CONFD_AZIMUTH_125 DET_HVC_FLAG_125 DET_EXISTENCE_PROB_125 DET_SNR_125 DET_SUPER_RES_TARGET_125 DET_BI_STATIC_FLAG_125 DET_RCS_125 DET_ELEVATION_ERR_125 DET_ELEVATION_125 DET_AZIMUTH_ERR_125 DET_AZIMUTH_125 DET_RANGE_VELOCITY_ERR_125 DET_RANGE_VELOCITY_125 DET_RANGE_ERR_125 DET_RANGE_125 DET_CONFD_ELEVATION_126 DET_CONFD_AZIMUTH_126 DET_HVC_FLAG_126 DET_EXISTENCE_PROB_126 DET_SNR_126 DET_SUPER_RES_TARGET_126 DET_BI_STATIC_FLAG_126 DET_RCS_126 DET_ELEVATION_ERR_126 DET_ELEVATION_126 DET_AZIMUTH_ERR_126 DET_AZIMUTH_126 DET_RANGE_VELOCITY_ERR_126 DET_RANGE_VELOCITY_126 DET_RANGE_ERR_126 DET_RANGE_126 DET_CONFD_ELEVATION_127 DET_CONFD_AZIMUTH_127 DET_HVC_FLAG_127 DET_EXISTENCE_PROB_127 DET_SNR_127 DET_SUPER_RES_TARGET_127 DET_BI_STATIC_FLAG_127 DET_RCS_127 DET_ELEVATION_ERR_127 DET_ELEVATION_127 DET_AZIMUTH_ERR_127 DET_AZIMUTH_127 DET_RANGE_VELOCITY_ERR_127 DET_RANGE_VELOCITY_127 DET_RANGE_ERR_127 DET_RANGE_127 DET_CONFD_ELEVATION_128 DET_CONFD_AZIMUTH_128 DET_HVC_FLAG_128 DET_EXISTENCE_PROB_128 DET_SNR_128 DET_SUPER_RES_TARGET_128 DET_BI_STATIC_FLAG_128 DET_RCS_128 DET_ELEVATION_ERR_128 DET_ELEVATION_128 DET_AZIMUTH_ERR_128 DET_AZIMUTH_128 DET_RANGE_VELOCITY_ERR_128 DET_RANGE_VELOCITY_128 DET_RANGE_ERR_128 DET_RANGE_128;
SIG_GROUP_ 1056 Detections_129_132 1 : DET_PROB_1STAZHYPO_129 DET_PROB_1STAZHYPO_130 DET_PROB_1STAZHYPO_131 DET_PROB_1STAZHYPO_132 DET_IDM_129 DET_IDM_130 DET_IDM_131 DET_IDM_132 DET_MTD_132 DET_MTD_131 DET_MTD_130 DET_MTD_129 DET_BELOW_RAIN_THOLD_132 DET_BELOW_RAIN_THOLD_131 DET_BELOW_RAIN_THOLD_130 DET_BELOW_RAIN_THOLD_129 DET_MH_CRC16_129_132 DET_MH_CYCLE_COUNTER_129_132 DET_MH_SCAN_INDEX_4LSB_129_132 DET_CONFD_ELEVATION_129 DET_CONFD_AZIMUTH_129 DET_HVC_FLAG_129 DET_EXISTENCE_PROB_129 DET_SNR_129 DET_SUPER_RES_TARGET_129 DET_BI_STATIC_FLAG_129 DET_RCS_129 DET_ELEVATION_ERR_129 DET_ELEVATION_129 DET_AZIMUTH_ERR_129 DET_AZIMUTH_129 DET_RANGE_VELOCITY_ERR_129 DET_RANGE_VELOCITY_129 DET_RANGE_ERR_129 DET_RANGE_129 DET_CONFD_ELEVATION_130 DET_CONFD_AZIMUTH_130 DET_HVC_FLAG_130 DET_EXISTENCE_PROB_130 DET_SNR_130 DET_SUPER_RES_TARGET_130 DET_BI_STATIC_FLAG_130 DET_RCS_130 DET_ELEVATION_ERR_130 DET_ELEVATION_130 DET_AZIMUTH_ERR_130 DET_AZIMUTH_130 DET_RANGE_VELOCITY_ERR_130 DET_RANGE_VELOCITY_130 DET_RANGE_ERR_130 DET_RANGE_130 DET_CONFD_ELEVATION_131 DET_CONFD_AZIMUTH_131 DET_HVC_FLAG_131 DET_EXISTENCE_PROB_131 DET_SNR_131 DET_SUPER_RES_TARGET_131 DET_BI_STATIC_FLAG_131 DET_RCS_131 DET_ELEVATION_ERR_131 DET_ELEVATION_131 DET_AZIMUTH_ERR_131 DET_AZIMUTH_131 DET_RANGE_VELOCITY_ERR_131 DET_RANGE_VELOCITY_131 DET_RANGE_ERR_131 DET_RANGE_131 DET_CONFD_ELEVATION_132 DET_CONFD_AZIMUTH_132 DET_HVC_FLAG_132 DET_EXISTENCE_PROB_132 DET_SNR_132 DET_SUPER_RES_TARGET_132 DET_BI_STATIC_FLAG_132 DET_RCS_132 DET_ELEVATION_ERR_132 DET_ELEVATION_132 DET_AZIMUTH_ERR_132 DET_AZIMUTH_132 DET_RANGE_VELOCITY_ERR_132 DET_RANGE_VELOCITY_132 DET_RANGE_ERR_132 DET_RANGE_132;
SIG_GROUP_ 1057 Detections_133_136 1 : DET_PROB_1STAZHYPO_133 DET_PROB_1STAZHYPO_134 DET_PROB_1STAZHYPO_135 DET_PROB_1STAZHYPO_136 DET_IDM_133 DET_IDM_134 DET_IDM_135 DET_IDM_136 DET_MTD_136 DET_MTD_135 DET_MTD_134 DET_MTD_133 DET_BELOW_RAIN_THOLD_136 DET_BELOW_RAIN_THOLD_135 DET_BELOW_RAIN_THOLD_134 DET_BELOW_RAIN_THOLD_133 DET_MH_CRC16_133_136 DET_MH_CYCLE_COUNTER_133_136 DET_MH_SCAN_INDEX_4LSB_133_136 DET_CONFD_ELEVATION_133 DET_CONFD_AZIMUTH_133 DET_HVC_FLAG_133 DET_EXISTENCE_PROB_133 DET_SNR_133 DET_SUPER_RES_TARGET_133 DET_BI_STATIC_FLAG_133 DET_RCS_133 DET_ELEVATION_ERR_133 DET_ELEVATION_133 DET_AZIMUTH_ERR_133 DET_AZIMUTH_133 DET_RANGE_VELOCITY_ERR_133 DET_RANGE_VELOCITY_133 DET_RANGE_ERR_133 DET_RANGE_133 DET_CONFD_ELEVATION_134 DET_CONFD_AZIMUTH_134 DET_HVC_FLAG_134 DET_EXISTENCE_PROB_134 DET_SNR_134 DET_SUPER_RES_TARGET_134 DET_BI_STATIC_FLAG_134 DET_RCS_134 DET_ELEVATION_ERR_134 DET_ELEVATION_134 DET_AZIMUTH_ERR_134 DET_AZIMUTH_134 DET_RANGE_VELOCITY_ERR_134 DET_RANGE_VELOCITY_134 DET_RANGE_ERR_134 DET_RANGE_134 DET_CONFD_ELEVATION_135 DET_CONFD_AZIMUTH_135 DET_HVC_FLAG_135 DET_EXISTENCE_PROB_135 DET_SNR_135 DET_SUPER_RES_TARGET_135 DET_BI_STATIC_FLAG_135 DET_RCS_135 DET_ELEVATION_ERR_135 DET_ELEVATION_135 DET_AZIMUTH_ERR_135 DET_AZIMUTH_135 DET_RANGE_VELOCITY_ERR_135 DET_RANGE_VELOCITY_135 DET_RANGE_ERR_135 DET_RANGE_135 DET_CONFD_ELEVATION_136 DET_CONFD_AZIMUTH_136 DET_HVC_FLAG_136 DET_EXISTENCE_PROB_136 DET_SNR_136 DET_SUPER_RES_TARGET_136 DET_BI_STATIC_FLAG_136 DET_RCS_136 DET_ELEVATION_ERR_136 DET_ELEVATION_136 DET_AZIMUTH_ERR_136 DET_AZIMUTH_136 DET_RANGE_VELOCITY_ERR_136 DET_RANGE_VELOCITY_136 DET_RANGE_ERR_136 DET_RANGE_136;
SIG_GROUP_ 1058 Detections_137_140 1 : DET_PROB_1STAZHYPO_137 DET_PROB_1STAZHYPO_138 DET_PROB_1STAZHYPO_139 DET_PROB_1STAZHYPO_140 DET_IDM_137 DET_IDM_138 DET_IDM_139 DET_IDM_140 DET_MTD_140 DET_MTD_139 DET_MTD_138 DET_MTD_137 DET_BELOW_RAIN_THOLD_140 DET_BELOW_RAIN_THOLD_139 DET_BELOW_RAIN_THOLD_138 DET_BELOW_RAIN_THOLD_137 DET_MH_CRC16_137_140 DET_MH_CYCLE_COUNTER_137_140 DET_MH_SCAN_INDEX_4LSB_137_140 DET_CONFD_ELEVATION_137 DET_CONFD_AZIMUTH_137 DET_HVC_FLAG_137 DET_EXISTENCE_PROB_137 DET_SNR_137 DET_SUPER_RES_TARGET_137 DET_BI_STATIC_FLAG_137 DET_RCS_137 DET_ELEVATION_ERR_137 DET_ELEVATION_137 DET_AZIMUTH_ERR_137 DET_AZIMUTH_137 DET_RANGE_VELOCITY_ERR_137 DET_RANGE_VELOCITY_137 DET_RANGE_ERR_137 DET_RANGE_137 DET_CONFD_ELEVATION_138 DET_CONFD_AZIMUTH_138 DET_HVC_FLAG_138 DET_EXISTENCE_PROB_138 DET_SNR_138 DET_SUPER_RES_TARGET_138 DET_BI_STATIC_FLAG_138 DET_RCS_138 DET_ELEVATION_ERR_138 DET_ELEVATION_138 DET_AZIMUTH_ERR_138 DET_AZIMUTH_138 DET_RANGE_VELOCITY_ERR_138 DET_RANGE_VELOCITY_138 DET_RANGE_ERR_138 DET_RANGE_138 DET_CONFD_ELEVATION_139 DET_CONFD_AZIMUTH_139 DET_HVC_FLAG_139 DET_EXISTENCE_PROB_139 DET_SNR_139 DET_SUPER_RES_TARGET_139 DET_BI_STATIC_FLAG_139 DET_RCS_139 DET_ELEVATION_ERR_139 DET_ELEVATION_139 DET_AZIMUTH_ERR_139 DET_AZIMUTH_139 DET_RANGE_VELOCITY_ERR_139 DET_RANGE_VELOCITY_139 DET_RANGE_ERR_139 DET_RANGE_139 DET_CONFD_ELEVATION_140 DET_CONFD_AZIMUTH_140 DET_HVC_FLAG_140 DET_EXISTENCE_PROB_140 DET_SNR_140 DET_SUPER_RES_TARGET_140 DET_BI_STATIC_FLAG_140 DET_RCS_140 DET_ELEVATION_ERR_140 DET_ELEVATION_140 DET_AZIMUTH_ERR_140 DET_AZIMUTH_140 DET_RANGE_VELOCITY_ERR_140 DET_RANGE_VELOCITY_140 DET_RANGE_ERR_140 DET_RANGE_140;
SIG_GROUP_ 1059 Detections_141_144 1 : DET_PROB_1STAZHYPO_141 DET_PROB_1STAZHYPO_142 DET_PROB_1STAZHYPO_143 DET_PROB_1STAZHYPO_144 DET_IDM_141 DET_IDM_142 DET_IDM_143 DET_IDM_144 DET_MTD_144 DET_MTD_143 DET_MTD_142 DET_MTD_141 DET_BELOW_RAIN_THOLD_144 DET_BELOW_RAIN_THOLD_143 DET_BELOW_RAIN_THOLD_142 DET_BELOW_RAIN_THOLD_141 DET_MH_CRC16_141_144 DET_MH_CYCLE_COUNTER_141_144 DET_MH_SCAN_INDEX_4LSB_141_144 DET_CONFD_ELEVATION_141 DET_CONFD_AZIMUTH_141 DET_HVC_FLAG_141 DET_EXISTENCE_PROB_141 DET_SNR_141 DET_SUPER_RES_TARGET_141 DET_BI_STATIC_FLAG_141 DET_RCS_141 DET_ELEVATION_ERR_141 DET_ELEVATION_141 DET_AZIMUTH_ERR_141 DET_AZIMUTH_141 DET_RANGE_VELOCITY_ERR_141 DET_RANGE_VELOCITY_141 DET_RANGE_ERR_141 DET_RANGE_141 DET_CONFD_ELEVATION_142 DET_CONFD_AZIMUTH_142 DET_HVC_FLAG_142 DET_EXISTENCE_PROB_142 DET_SNR_142 DET_SUPER_RES_TARGET_142 DET_BI_STATIC_FLAG_142 DET_RCS_142 DET_ELEVATION_ERR_142 DET_ELEVATION_142 DET_AZIMUTH_ERR_142 DET_AZIMUTH_142 DET_RANGE_VELOCITY_ERR_142 DET_RANGE_VELOCITY_142 DET_RANGE_ERR_142 DET_RANGE_142 DET_CONFD_ELEVATION_143 DET_CONFD_AZIMUTH_143 DET_HVC_FLAG_143 DET_EXISTENCE_PROB_143 DET_SNR_143 DET_SUPER_RES_TARGET_143 DET_BI_STATIC_FLAG_143 DET_RCS_143 DET_ELEVATION_ERR_143 DET_ELEVATION_143 DET_AZIMUTH_ERR_143 DET_AZIMUTH_143 DET_RANGE_VELOCITY_ERR_143 DET_RANGE_VELOCITY_143 DET_RANGE_ERR_143 DET_RANGE_143 DET_CONFD_ELEVATION_144 DET_CONFD_AZIMUTH_144 DET_HVC_FLAG_144 DET_EXISTENCE_PROB_144 DET_SNR_144 DET_SUPER_RES_TARGET_144 DET_BI_STATIC_FLAG_144 DET_RCS_144 DET_ELEVATION_ERR_144 DET_ELEVATION_144 DET_AZIMUTH_ERR_144 DET_AZIMUTH_144 DET_RANGE_VELOCITY_ERR_144 DET_RANGE_VELOCITY_144 DET_RANGE_ERR_144 DET_RANGE_144;
SIG_GROUP_ 1060 Detections_145_148 1 : DET_PROB_1STAZHYPO_145 DET_PROB_1STAZHYPO_146 DET_PROB_1STAZHYPO_147 DET_PROB_1STAZHYPO_148 DET_IDM_145 DET_IDM_146 DET_IDM_147 DET_IDM_148 DET_MTD_148 DET_MTD_147 DET_MTD_146 DET_MTD_145 DET_BELOW_RAIN_THOLD_148 DET_BELOW_RAIN_THOLD_147 DET_BELOW_RAIN_THOLD_146 DET_BELOW_RAIN_THOLD_145 DET_MH_CRC16_145_148 DET_MH_CYCLE_COUNTER_145_148 DET_MH_SCAN_INDEX_4LSB_145_148 DET_CONFD_ELEVATION_145 DET_CONFD_AZIMUTH_145 DET_HVC_FLAG_145 DET_EXISTENCE_PROB_145 DET_SNR_145 DET_SUPER_RES_TARGET_145 DET_BI_STATIC_FLAG_145 DET_RCS_145 DET_ELEVATION_ERR_145 DET_ELEVATION_145 DET_AZIMUTH_ERR_145 DET_AZIMUTH_145 DET_RANGE_VELOCITY_ERR_145 DET_RANGE_VELOCITY_145 DET_RANGE_ERR_145 DET_RANGE_145 DET_CONFD_ELEVATION_146 DET_CONFD_AZIMUTH_146 DET_HVC_FLAG_146 DET_EXISTENCE_PROB_146 DET_SNR_146 DET_SUPER_RES_TARGET_146 DET_BI_STATIC_FLAG_146 DET_RCS_146 DET_ELEVATION_ERR_146 DET_ELEVATION_146 DET_AZIMUTH_ERR_146 DET_AZIMUTH_146 DET_RANGE_VELOCITY_ERR_146 DET_RANGE_VELOCITY_146 DET_RANGE_ERR_146 DET_RANGE_146 DET_CONFD_ELEVATION_147 DET_CONFD_AZIMUTH_147 DET_HVC_FLAG_147 DET_EXISTENCE_PROB_147 DET_SNR_147 DET_SUPER_RES_TARGET_147 DET_BI_STATIC_FLAG_147 DET_RCS_147 DET_ELEVATION_ERR_147 DET_ELEVATION_147 DET_AZIMUTH_ERR_147 DET_AZIMUTH_147 DET_RANGE_VELOCITY_ERR_147 DET_RANGE_VELOCITY_147 DET_RANGE_ERR_147 DET_RANGE_147 DET_CONFD_ELEVATION_148 DET_CONFD_AZIMUTH_148 DET_HVC_FLAG_148 DET_EXISTENCE_PROB_148 DET_SNR_148 DET_SUPER_RES_TARGET_148 DET_BI_STATIC_FLAG_148 DET_RCS_148 DET_ELEVATION_ERR_148 DET_ELEVATION_148 DET_AZIMUTH_ERR_148 DET_AZIMUTH_148 DET_RANGE_VELOCITY_ERR_148 DET_RANGE_VELOCITY_148 DET_RANGE_ERR_148 DET_RANGE_148;
SIG_GROUP_ 1061 Detections_149_152 1 : DET_PROB_1STAZHYPO_149 DET_PROB_1STAZHYPO_150 DET_PROB_1STAZHYPO_151 DET_PROB_1STAZHYPO_152 DET_IDM_149 DET_IDM_150 DET_IDM_151 DET_IDM_152 DET_MTD_152 DET_MTD_151 DET_MTD_150 DET_MTD_149 DET_BELOW_RAIN_THOLD_152 DET_BELOW_RAIN_THOLD_151 DET_BELOW_RAIN_THOLD_150 DET_BELOW_RAIN_THOLD_149 DET_MH_CRC16_149_152 DET_MH_CYCLE_COUNTER_149_152 DET_MH_SCAN_INDEX_4LSB_149_152 DET_CONFD_ELEVATION_149 DET_CONFD_AZIMUTH_149 DET_HVC_FLAG_149 DET_EXISTENCE_PROB_149 DET_SNR_149 DET_SUPER_RES_TARGET_149 DET_BI_STATIC_FLAG_149 DET_RCS_149 DET_ELEVATION_ERR_149 DET_ELEVATION_149 DET_AZIMUTH_ERR_149 DET_AZIMUTH_149 DET_RANGE_VELOCITY_ERR_149 DET_RANGE_VELOCITY_149 DET_RANGE_ERR_149 DET_RANGE_149 DET_CONFD_ELEVATION_150 DET_CONFD_AZIMUTH_150 DET_HVC_FLAG_150 DET_EXISTENCE_PROB_150 DET_SNR_150 DET_SUPER_RES_TARGET_150 DET_BI_STATIC_FLAG_150 DET_RCS_150 DET_ELEVATION_ERR_150 DET_ELEVATION_150 DET_AZIMUTH_ERR_150 DET_AZIMUTH_150 DET_RANGE_VELOCITY_ERR_150 DET_RANGE_VELOCITY_150 DET_RANGE_ERR_150 DET_RANGE_150 DET_CONFD_ELEVATION_151 DET_CONFD_AZIMUTH_151 DET_HVC_FLAG_151 DET_EXISTENCE_PROB_151 DET_SNR_151 DET_SUPER_RES_TARGET_151 DET_BI_STATIC_FLAG_151 DET_RCS_151 DET_ELEVATION_ERR_151 DET_ELEVATION_151 DET_AZIMUTH_ERR_151 DET_AZIMUTH_151 DET_RANGE_VELOCITY_ERR_151 DET_RANGE_VELOCITY_151 DET_RANGE_ERR_151 DET_RANGE_151 DET_CONFD_ELEVATION_152 DET_CONFD_AZIMUTH_152 DET_HVC_FLAG_152 DET_EXISTENCE_PROB_152 DET_SNR_152 DET_SUPER_RES_TARGET_152 DET_BI_STATIC_FLAG_152 DET_RCS_152 DET_ELEVATION_ERR_152 DET_ELEVATION_152 DET_AZIMUTH_ERR_152 DET_AZIMUTH_152 DET_RANGE_VELOCITY_ERR_152 DET_RANGE_VELOCITY_152 DET_RANGE_ERR_152 DET_RANGE_152;
SIG_GROUP_ 1062 Detections_153_156 1 : DET_PROB_1STAZHYPO_153 DET_PROB_1STAZHYPO_154 DET_PROB_1STAZHYPO_155 DET_PROB_1STAZHYPO_156 DET_IDM_153 DET_IDM_154 DET_IDM_155 DET_IDM_156 DET_MTD_156 DET_MTD_155 DET_MTD_154 DET_MTD_153 DET_BELOW_RAIN_THOLD_156 DET_BELOW_RAIN_THOLD_155 DET_BELOW_RAIN_THOLD_154 DET_BELOW_RAIN_THOLD_153 DET_MH_CRC16_153_156 DET_MH_CYCLE_COUNTER_153_156 DET_MH_SCAN_INDEX_4LSB_153_156 DET_CONFD_ELEVATION_153 DET_CONFD_AZIMUTH_153 DET_HVC_FLAG_153 DET_EXISTENCE_PROB_153 DET_SNR_153 DET_SUPER_RES_TARGET_153 DET_BI_STATIC_FLAG_153 DET_RCS_153 DET_ELEVATION_ERR_153 DET_ELEVATION_153 DET_AZIMUTH_ERR_153 DET_AZIMUTH_153 DET_RANGE_VELOCITY_ERR_153 DET_RANGE_VELOCITY_153 DET_RANGE_ERR_153 DET_RANGE_153 DET_CONFD_ELEVATION_154 DET_CONFD_AZIMUTH_154 DET_HVC_FLAG_154 DET_EXISTENCE_PROB_154 DET_SNR_154 DET_SUPER_RES_TARGET_154 DET_BI_STATIC_FLAG_154 DET_RCS_154 DET_ELEVATION_ERR_154 DET_ELEVATION_154 DET_AZIMUTH_ERR_154 DET_AZIMUTH_154 DET_RANGE_VELOCITY_ERR_154 DET_RANGE_VELOCITY_154 DET_RANGE_ERR_154 DET_RANGE_154 DET_CONFD_ELEVATION_155 DET_CONFD_AZIMUTH_155 DET_HVC_FLAG_155 DET_EXISTENCE_PROB_155 DET_SNR_155 DET_SUPER_RES_TARGET_155 DET_BI_STATIC_FLAG_155 DET_RCS_155 DET_ELEVATION_ERR_155 DET_ELEVATION_155 DET_AZIMUTH_ERR_155 DET_AZIMUTH_155 DET_RANGE_VELOCITY_ERR_155 DET_RANGE_VELOCITY_155 DET_RANGE_ERR_155 DET_RANGE_155 DET_CONFD_ELEVATION_156 DET_CONFD_AZIMUTH_156 DET_HVC_FLAG_156 DET_EXISTENCE_PROB_156 DET_SNR_156 DET_SUPER_RES_TARGET_156 DET_BI_STATIC_FLAG_156 DET_RCS_156 DET_ELEVATION_ERR_156 DET_ELEVATION_156 DET_AZIMUTH_ERR_156 DET_AZIMUTH_156 DET_RANGE_VELOCITY_ERR_156 DET_RANGE_VELOCITY_156 DET_RANGE_ERR_156 DET_RANGE_156;
SIG_GROUP_ 1063 Detections_157_160 1 : DET_PROB_1STAZHYPO_157 DET_PROB_1STAZHYPO_158 DET_PROB_1STAZHYPO_159 DET_PROB_1STAZHYPO_160 DET_IDM_157 DET_IDM_158 DET_IDM_159 DET_IDM_160 DET_MTD_160 DET_MTD_159 DET_MTD_158 DET_MTD_157 DET_BELOW_RAIN_THOLD_160 DET_BELOW_RAIN_THOLD_159 DET_BELOW_RAIN_THOLD_158 DET_BELOW_RAIN_THOLD_157 DET_MH_CRC16_157_160 DET_MH_CYCLE_COUNTER_157_160 DET_MH_SCAN_INDEX_4LSB_157_160 DET_CONFD_ELEVATION_157 DET_CONFD_AZIMUTH_157 DET_HVC_FLAG_157 DET_EXISTENCE_PROB_157 DET_SNR_157 DET_SUPER_RES_TARGET_157 DET_BI_STATIC_FLAG_157 DET_RCS_157 DET_ELEVATION_ERR_157 DET_ELEVATION_157 DET_AZIMUTH_ERR_157 DET_AZIMUTH_157 DET_RANGE_VELOCITY_ERR_157 DET_RANGE_VELOCITY_157 DET_RANGE_ERR_157 DET_RANGE_157 DET_CONFD_ELEVATION_158 DET_CONFD_AZIMUTH_158 DET_HVC_FLAG_158 DET_EXISTENCE_PROB_158 DET_SNR_158 DET_SUPER_RES_TARGET_158 DET_BI_STATIC_FLAG_158 DET_RCS_158 DET_ELEVATION_ERR_158 DET_ELEVATION_158 DET_AZIMUTH_ERR_158 DET_AZIMUTH_158 DET_RANGE_VELOCITY_ERR_158 DET_RANGE_VELOCITY_158 DET_RANGE_ERR_158 DET_RANGE_158 DET_CONFD_ELEVATION_159 DET_CONFD_AZIMUTH_159 DET_HVC_FLAG_159 DET_EXISTENCE_PROB_159 DET_SNR_159 DET_SUPER_RES_TARGET_159 DET_BI_STATIC_FLAG_159 DET_RCS_159 DET_ELEVATION_ERR_159 DET_ELEVATION_159 DET_AZIMUTH_ERR_159 DET_AZIMUTH_159 DET_RANGE_VELOCITY_ERR_159 DET_RANGE_VELOCITY_159 DET_RANGE_ERR_159 DET_RANGE_159 DET_CONFD_ELEVATION_160 DET_CONFD_AZIMUTH_160 DET_HVC_FLAG_160 DET_EXISTENCE_PROB_160 DET_SNR_160 DET_SUPER_RES_TARGET_160 DET_BI_STATIC_FLAG_160 DET_RCS_160 DET_ELEVATION_ERR_160 DET_ELEVATION_160 DET_AZIMUTH_ERR_160 DET_AZIMUTH_160 DET_RANGE_VELOCITY_ERR_160 DET_RANGE_VELOCITY_160 DET_RANGE_ERR_160 DET_RANGE_160;
