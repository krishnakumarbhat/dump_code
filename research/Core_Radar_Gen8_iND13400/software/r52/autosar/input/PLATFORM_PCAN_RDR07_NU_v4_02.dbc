VERSION "created by canmatrix"

NS_ :

BS_:

BU_: External_Tool ADAS RDR07 RDR_Fusion_Partner RDR_Gateway

BO_ 1096 RDR_DETECTION_289_292: 64 RDR07
 SG_ DET_RANGE_289 : 24|15@1+ (0.015625,0) [0|500] "m"  ADAS
 SG_ DET_RANGE_ERR_289 : 40|7@1+ (0.0075,0) [0|0.9525] "m"  ADAS
 SG_ DET_RANGE_VELOCITY_289 : 48|15@1+ (0.0078125,-128) [-128|127.9921875] "m/s"  ADAS
 SG_ DET_RANGE_VELOCITY_ERR_289 : 64|8@1+ (0.003,0) [0|0.765] "m/s"  ADAS
 SG_ DET_AZIMUTH_289 : 88|13@1+ (0.0004,-1.5708) [-1.5708|1.5708] "rad"  ADAS
 SG_ DET_AZIMUTH_ERR_289 : 105|7@1+ (0.00087267,0) [0|0.11082909] "rad"  ADAS
 SG_ DET_ELEVATION_289 : 72|8@1+ (0.00275,-0.34925) [-0.34925|0.34925] "rad"  ADAS
 SG_ DET_ELEVATION_ERR_289 : 80|6@1+ (0.00174533,0) [0|0.10995579] "rad"  ADAS
 SG_ DET_RCS_289 : 128|8@1+ (0.5,-64) [-64|63.5] "dBsm"  ADAS
 SG_ DET_BI_STATIC_FLAG_289 : 104|1@1+ (1,0) [0|1] ""  ADAS
 SG_ DET_SUPER_RES_TARGET_289 : 87|1@1+ (1,0) [0|1] ""  ADAS
 SG_ DET_SNR_289 : 120|8@1+ (0.35156,0) [0|89.6478] "dB"  ADAS
 SG_ DET_EXISTENCE_PROB_289 : 112|6@1+ (1.588,0) [0|100] "%"  ADAS
 SG_ DET_HVC_FLAG_289 : 86|1@1+ (1,0) [0|1] ""  ADAS
 SG_ DET_CONFD_AZIMUTH_289 : 118|2@1+ (1,0) [0|3] ""  ADAS
 SG_ DET_CONFD_ELEVATION_289 : 101|2@1+ (1,0) [0|3] ""  ADAS
 SG_ DET_PROB_1STAZHYPO_289 : 103|1@1+ (1,0) [0|1] ""  ADAS
 SG_ DET_IDM_289 : 63|1@1+ (1,0) [0|1] ""  ADAS
 SG_ DET_MTD_289 : 47|1@1+ (1,0) [0|1] ""  ADAS
 SG_ DET_BELOW_RAIN_THOLD_289 : 39|1@1+ (1,0) [0|1] ""  ADAS
 SG_ DET_RANGE_290 : 136|15@1+ (0.015625,0) [0|500] "m"  ADAS
 SG_ DET_RANGE_ERR_290 : 152|7@1+ (0.0075,0) [0|0.9525] "m"  ADAS
 SG_ DET_RANGE_VELOCITY_290 : 160|15@1+ (0.0078125,-128) [-128|127.9921875] "m/s"  ADAS
 SG_ DET_RANGE_VELOCITY_ERR_290 : 176|8@1+ (0.003,0) [0|0.765] "m/s"  ADAS
 SG_ DET_AZIMUTH_290 : 200|13@1+ (0.0004,-1.5708) [-1.5708|1.5708] "rad"  ADAS
 SG_ DET_AZIMUTH_ERR_290 : 217|7@1+ (0.00087267,0) [0|0.11082909] "rad"  ADAS
 SG_ DET_ELEVATION_290 : 184|8@1+ (0.00275,-0.34925) [-0.34925|0.34925] "rad"  ADAS
 SG_ DET_ELEVATION_ERR_290 : 192|6@1+ (0.00174533,0) [0|0.10995579] "rad"  ADAS
 SG_ DET_RCS_290 : 240|8@1+ (0.5,-64) [-64|63.5] "dBsm"  ADAS
 SG_ DET_BI_STATIC_FLAG_290 : 216|1@1+ (1,0) [0|1] ""  ADAS
 SG_ DET_SUPER_RES_TARGET_290 : 199|1@1+ (1,0) [0|1] ""  ADAS
 SG_ DET_SNR_290 : 232|8@1+ (0.35156,0) [0|89.6478] "dB"  ADAS
 SG_ DET_EXISTENCE_PROB_290 : 224|6@1+ (1.588,0) [0|100] "%"  ADAS
 SG_ DET_HVC_FLAG_290 : 198|1@1+ (1,0) [0|1] ""  ADAS
 SG_ DET_CONFD_AZIMUTH_290 : 230|2@1+ (1,0) [0|3] ""  ADAS
 SG_ DET_CONFD_ELEVATION_290 : 213|2@1+ (1,0) [0|3] ""  ADAS
 SG_ DET_PROB_1STAZHYPO_290 : 215|1@1+ (1,0) [0|1] ""  ADAS
 SG_ DET_IDM_290 : 175|1@1+ (1,0) [0|1] ""  ADAS
 SG_ DET_MTD_290 : 159|1@1+ (1,0) [0|1] ""  ADAS
 SG_ DET_BELOW_RAIN_THOLD_290 : 151|1@1+ (1,0) [0|1] ""  ADAS
 SG_ DET_RANGE_291 : 248|15@1+ (0.015625,0) [0|500] "m"  ADAS
 SG_ DET_RANGE_ERR_291 : 264|7@1+ (0.0075,0) [0|0.9525] "m"  ADAS
 SG_ DET_RANGE_VELOCITY_291 : 272|15@1+ (0.0078125,-128) [-128|127.9921875] "m/s"  ADAS
 SG_ DET_RANGE_VELOCITY_ERR_291 : 288|8@1+ (0.003,0) [0|0.765] "m/s"  ADAS
 SG_ DET_AZIMUTH_291 : 312|13@1+ (0.0004,-1.5708) [-1.5708|1.5708] "rad"  ADAS
 SG_ DET_AZIMUTH_ERR_291 : 329|7@1+ (0.00087267,0) [0|0.11082909] "rad"  ADAS
 SG_ DET_ELEVATION_291 : 296|8@1+ (0.00275,-0.34925) [-0.34925|0.34925] "rad"  ADAS
 SG_ DET_ELEVATION_ERR_291 : 304|6@1+ (0.00174533,0) [0|0.10995579] "rad"  ADAS
 SG_ DET_RCS_291 : 352|8@1+ (0.5,-64) [-64|63.5] "dBsm"  ADAS
 SG_ DET_BI_STATIC_FLAG_291 : 328|1@1+ (1,0) [0|1] ""  ADAS
 SG_ DET_SUPER_RES_TARGET_291 : 311|1@1+ (1,0) [0|1] ""  ADAS
 SG_ DET_SNR_291 : 344|8@1+ (0.35156,0) [0|89.6478] "dB"  ADAS
 SG_ DET_EXISTENCE_PROB_291 : 336|6@1+ (1.588,0) [0|100] "%"  ADAS
 SG_ DET_HVC_FLAG_291 : 310|1@1+ (1,0) [0|1] ""  ADAS
 SG_ DET_CONFD_AZIMUTH_291 : 342|2@1+ (1,0) [0|3] ""  ADAS
 SG_ DET_CONFD_ELEVATION_291 : 325|2@1+ (1,0) [0|3] ""  ADAS
 SG_ DET_PROB_1STAZHYPO_291 : 327|1@1+ (1,0) [0|1] ""  ADAS
 SG_ DET_IDM_291 : 287|1@1+ (1,0) [0|1] ""  ADAS
 SG_ DET_MTD_291 : 271|1@1+ (1,0) [0|1] ""  ADAS
 SG_ DET_BELOW_RAIN_THOLD_291 : 263|1@1+ (1,0) [0|1] ""  ADAS
 SG_ DET_RANGE_292 : 360|15@1+ (0.015625,0) [0|500] "m"  ADAS
 SG_ DET_RANGE_ERR_292 : 376|7@1+ (0.0075,0) [0|0.9525] "m"  ADAS
 SG_ DET_RANGE_VELOCITY_292 : 384|15@1+ (0.0078125,-128) [-128|127.9921875] "m/s"  ADAS
 SG_ DET_RANGE_VELOCITY_ERR_292 : 400|8@1+ (0.003,0) [0|0.765] "m/s"  ADAS
 SG_ DET_AZIMUTH_292 : 424|13@1+ (0.0004,-1.5708) [-1.5708|1.5708] "rad"  ADAS
 SG_ DET_AZIMUTH_ERR_292 : 441|7@1+ (0.00087267,0) [0|0.11082909] "rad"  ADAS
 SG_ DET_ELEVATION_292 : 408|8@1+ (0.00275,-0.34925) [-0.34925|0.34925] "rad"  ADAS
 SG_ DET_ELEVATION_ERR_292 : 416|6@1+ (0.00174533,0) [0|0.10995579] "rad"  ADAS
 SG_ DET_RCS_292 : 464|8@1+ (0.5,-64) [-64|63.5] "dBsm"  ADAS
 SG_ DET_BI_STATIC_FLAG_292 : 440|1@1+ (1,0) [0|1] ""  ADAS
 SG_ DET_SUPER_RES_TARGET_292 : 423|1@1+ (1,0) [0|1] ""  ADAS
 SG_ DET_SNR_292 : 456|8@1+ (0.35156,0) [0|89.6478] "dB"  ADAS
 SG_ DET_EXISTENCE_PROB_292 : 448|6@1+ (1.588,0) [0|100] "%"  ADAS
 SG_ DET_HVC_FLAG_292 : 422|1@1+ (1,0) [0|1] ""  ADAS
 SG_ DET_CONFD_AZIMUTH_292 : 454|2@1+ (1,0) [0|3] ""  ADAS
 SG_ DET_CONFD_ELEVATION_292 : 437|2@1+ (1,0) [0|3] ""  ADAS
 SG_ DET_MH_SCAN_INDEX_4LSB_289_292 : 476|4@1+ (1,0) [0|15] ""  ADAS
 SG_ DET_MH_CYCLE_COUNTER_289_292 : 16|8@1+ (1,0) [0|255] ""  ADAS
 SG_ DET_MH_CRC16_289_292 : 0|16@1+ (1,0) [0|65535] ""  ADAS
 SG_ DET_PROB_1STAZHYPO_292 : 439|1@1+ (1,0) [0|1] ""  ADAS
 SG_ DET_IDM_292 : 399|1@1+ (1,0) [0|1] ""  ADAS
 SG_ DET_MTD_292 : 383|1@1+ (1,0) [0|1] ""  ADAS
 SG_ DET_BELOW_RAIN_THOLD_292 : 375|1@1+ (1,0) [0|1] ""  ADAS

BO_ 1097 RDR_DETECTION_293_296: 64 RDR07
 SG_ DET_RANGE_293 : 24|15@1+ (0.015625,0) [0|500] "m"  ADAS
 SG_ DET_RANGE_ERR_293 : 40|7@1+ (0.0075,0) [0|0.9525] "m"  ADAS
 SG_ DET_RANGE_VELOCITY_293 : 48|15@1+ (0.0078125,-128) [-128|127.9921875] "m/s"  ADAS
 SG_ DET_RANGE_VELOCITY_ERR_293 : 64|8@1+ (0.003,0) [0|0.765] "m/s"  ADAS
 SG_ DET_AZIMUTH_293 : 88|13@1+ (0.0004,-1.5708) [-1.5708|1.5708] "rad"  ADAS
 SG_ DET_AZIMUTH_ERR_293 : 105|7@1+ (0.00087267,0) [0|0.11082909] "rad"  ADAS
 SG_ DET_ELEVATION_293 : 72|8@1+ (0.00275,-0.34925) [-0.34925|0.34925] "rad"  ADAS
 SG_ DET_ELEVATION_ERR_293 : 80|6@1+ (0.00174533,0) [0|0.10995579] "rad"  ADAS
 SG_ DET_RCS_293 : 128|8@1+ (0.5,-64) [-64|63.5] "dBsm"  ADAS
 SG_ DET_BI_STATIC_FLAG_293 : 104|1@1+ (1,0) [0|1] ""  ADAS
 SG_ DET_SUPER_RES_TARGET_293 : 87|1@1+ (1,0) [0|1] ""  ADAS
 SG_ DET_SNR_293 : 120|8@1+ (0.35156,0) [0|89.6478] "dB"  ADAS
 SG_ DET_EXISTENCE_PROB_293 : 112|6@1+ (1.588,0) [0|100] "%"  ADAS
 SG_ DET_HVC_FLAG_293 : 86|1@1+ (1,0) [0|1] ""  ADAS
 SG_ DET_CONFD_AZIMUTH_293 : 118|2@1+ (1,0) [0|3] ""  ADAS
 SG_ DET_CONFD_ELEVATION_293 : 101|2@1+ (1,0) [0|3] ""  ADAS
 SG_ DET_PROB_1STAZHYPO_293 : 103|1@1+ (1,0) [0|1] ""  ADAS
 SG_ DET_IDM_293 : 63|1@1+ (1,0) [0|1] ""  ADAS
 SG_ DET_MTD_293 : 47|1@1+ (1,0) [0|1] ""  ADAS
 SG_ DET_BELOW_RAIN_THOLD_293 : 39|1@1+ (1,0) [0|1] ""  ADAS
 SG_ DET_RANGE_294 : 136|15@1+ (0.015625,0) [0|500] "m"  ADAS
 SG_ DET_RANGE_ERR_294 : 152|7@1+ (0.0075,0) [0|0.9525] "m"  ADAS
 SG_ DET_RANGE_VELOCITY_294 : 160|15@1+ (0.0078125,-128) [-128|127.9921875] "m/s"  ADAS
 SG_ DET_RANGE_VELOCITY_ERR_294 : 176|8@1+ (0.003,0) [0|0.765] "m/s"  ADAS
 SG_ DET_AZIMUTH_294 : 200|13@1+ (0.0004,-1.5708) [-1.5708|1.5708] "rad"  ADAS
 SG_ DET_AZIMUTH_ERR_294 : 217|7@1+ (0.00087267,0) [0|0.11082909] "rad"  ADAS
 SG_ DET_ELEVATION_294 : 184|8@1+ (0.00275,-0.34925) [-0.34925|0.34925] "rad"  ADAS
 SG_ DET_ELEVATION_ERR_294 : 192|6@1+ (0.00174533,0) [0|0.10995579] "rad"  ADAS
 SG_ DET_RCS_294 : 240|8@1+ (0.5,-64) [-64|63.5] "dBsm"  ADAS
 SG_ DET_BI_STATIC_FLAG_294 : 216|1@1+ (1,0) [0|1] ""  ADAS
 SG_ DET_SUPER_RES_TARGET_294 : 199|1@1+ (1,0) [0|1] ""  ADAS
 SG_ DET_SNR_294 : 232|8@1+ (0.35156,0) [0|89.6478] "dB"  ADAS
 SG_ DET_EXISTENCE_PROB_294 : 224|6@1+ (1.588,0) [0|100] "%"  ADAS
 SG_ DET_HVC_FLAG_294 : 198|1@1+ (1,0) [0|1] ""  ADAS
 SG_ DET_CONFD_AZIMUTH_294 : 230|2@1+ (1,0) [0|3] ""  ADAS
 SG_ DET_CONFD_ELEVATION_294 : 213|2@1+ (1,0) [0|3] ""  ADAS
 SG_ DET_PROB_1STAZHYPO_294 : 215|1@1+ (1,0) [0|1] ""  ADAS
 SG_ DET_IDM_294 : 175|1@1+ (1,0) [0|1] ""  ADAS
 SG_ DET_MTD_294 : 159|1@1+ (1,0) [0|1] ""  ADAS
 SG_ DET_BELOW_RAIN_THOLD_294 : 151|1@1+ (1,0) [0|1] ""  ADAS
 SG_ DET_RANGE_295 : 248|15@1+ (0.015625,0) [0|500] "m"  ADAS
 SG_ DET_RANGE_ERR_295 : 264|7@1+ (0.0075,0) [0|0.9525] "m"  ADAS
 SG_ DET_RANGE_VELOCITY_295 : 272|15@1+ (0.0078125,-128) [-128|127.9921875] "m/s"  ADAS
 SG_ DET_RANGE_VELOCITY_ERR_295 : 288|8@1+ (0.003,0) [0|0.765] "m/s"  ADAS
 SG_ DET_AZIMUTH_295 : 312|13@1+ (0.0004,-1.5708) [-1.5708|1.5708] "rad"  ADAS
 SG_ DET_AZIMUTH_ERR_295 : 329|7@1+ (0.00087267,0) [0|0.11082909] "rad"  ADAS
 SG_ DET_ELEVATION_295 : 296|8@1+ (0.00275,-0.34925) [-0.34925|0.34925] "rad"  ADAS
 SG_ DET_ELEVATION_ERR_295 : 304|6@1+ (0.00174533,0) [0|0.10995579] "rad"  ADAS
 SG_ DET_RCS_295 : 352|8@1+ (0.5,-64) [-64|63.5] "dBsm"  ADAS
 SG_ DET_BI_STATIC_FLAG_295 : 328|1@1+ (1,0) [0|1] ""  ADAS
 SG_ DET_SUPER_RES_TARGET_295 : 311|1@1+ (1,0) [0|1] ""  ADAS
 SG_ DET_SNR_295 : 344|8@1+ (0.35156,0) [0|89.6478] "dB"  ADAS
 SG_ DET_EXISTENCE_PROB_295 : 336|6@1+ (1.588,0) [0|100] "%"  ADAS
 SG_ DET_HVC_FLAG_295 : 310|1@1+ (1,0) [0|1] ""  ADAS
 SG_ DET_CONFD_AZIMUTH_295 : 342|2@1+ (1,0) [0|3] ""  ADAS
 SG_ DET_CONFD_ELEVATION_295 : 325|2@1+ (1,0) [0|3] ""  ADAS
 SG_ DET_PROB_1STAZHYPO_295 : 327|1@1+ (1,0) [0|1] ""  ADAS
 SG_ DET_IDM_295 : 287|1@1+ (1,0) [0|1] ""  ADAS
 SG_ DET_MTD_295 : 271|1@1+ (1,0) [0|1] ""  ADAS
 SG_ DET_BELOW_RAIN_THOLD_295 : 263|1@1+ (1,0) [0|1] ""  ADAS
 SG_ DET_RANGE_296 : 360|15@1+ (0.015625,0) [0|500] "m"  ADAS
 SG_ DET_RANGE_ERR_296 : 376|7@1+ (0.0075,0) [0|0.9525] "m"  ADAS
 SG_ DET_RANGE_VELOCITY_296 : 384|15@1+ (0.0078125,-128) [-128|127.9921875] "m/s"  ADAS
 SG_ DET_RANGE_VELOCITY_ERR_296 : 400|8@1+ (0.003,0) [0|0.765] "m/s"  ADAS
 SG_ DET_AZIMUTH_296 : 424|13@1+ (0.0004,-1.5708) [-1.5708|1.5708] "rad"  ADAS
 SG_ DET_AZIMUTH_ERR_296 : 441|7@1+ (0.00087267,0) [0|0.11082909] "rad"  ADAS
 SG_ DET_ELEVATION_296 : 408|8@1+ (0.00275,-0.34925) [-0.34925|0.34925] "rad"  ADAS
 SG_ DET_ELEVATION_ERR_296 : 416|6@1+ (0.00174533,0) [0|0.10995579] "rad"  ADAS
 SG_ DET_RCS_296 : 464|8@1+ (0.5,-64) [-64|63.5] "dBsm"  ADAS
 SG_ DET_BI_STATIC_FLAG_296 : 440|1@1+ (1,0) [0|1] ""  ADAS
 SG_ DET_SUPER_RES_TARGET_296 : 423|1@1+ (1,0) [0|1] ""  ADAS
 SG_ DET_SNR_296 : 456|8@1+ (0.35156,0) [0|89.6478] "dB"  ADAS
 SG_ DET_EXISTENCE_PROB_296 : 448|6@1+ (1.588,0) [0|100] "%"  ADAS
 SG_ DET_HVC_FLAG_296 : 422|1@1+ (1,0) [0|1] ""  ADAS
 SG_ DET_CONFD_AZIMUTH_296 : 454|2@1+ (1,0) [0|3] ""  ADAS
 SG_ DET_CONFD_ELEVATION_296 : 437|2@1+ (1,0) [0|3] ""  ADAS
 SG_ DET_MH_SCAN_INDEX_4LSB_293_296 : 476|4@1+ (1,0) [0|15] ""  ADAS
 SG_ DET_MH_CYCLE_COUNTER_293_296 : 16|8@1+ (1,0) [0|255] ""  ADAS
 SG_ DET_MH_CRC16_293_296 : 0|16@1+ (1,0) [0|65535] ""  ADAS
 SG_ DET_PROB_1STAZHYPO_296 : 439|1@1+ (1,0) [0|1] ""  ADAS
 SG_ DET_IDM_296 : 399|1@1+ (1,0) [0|1] ""  ADAS
 SG_ DET_MTD_296 : 383|1@1+ (1,0) [0|1] ""  ADAS
 SG_ DET_BELOW_RAIN_THOLD_296 : 375|1@1+ (1,0) [0|1] ""  ADAS

BO_ 1098 RDR_DETECTION_297_300: 64 RDR07
 SG_ DET_RANGE_297 : 24|15@1+ (0.015625,0) [0|500] "m"  ADAS
 SG_ DET_RANGE_ERR_297 : 40|7@1+ (0.0075,0) [0|0.9525] "m"  ADAS
 SG_ DET_RANGE_VELOCITY_297 : 48|15@1+ (0.0078125,-128) [-128|127.9921875] "m/s"  ADAS
 SG_ DET_RANGE_VELOCITY_ERR_297 : 64|8@1+ (0.003,0) [0|0.765] "m/s"  ADAS
 SG_ DET_AZIMUTH_297 : 88|13@1+ (0.0004,-1.5708) [-1.5708|1.5708] "rad"  ADAS
 SG_ DET_AZIMUTH_ERR_297 : 105|7@1+ (0.00087267,0) [0|0.11082909] "rad"  ADAS
 SG_ DET_ELEVATION_297 : 72|8@1+ (0.00275,-0.34925) [-0.34925|0.34925] "rad"  ADAS
 SG_ DET_ELEVATION_ERR_297 : 80|6@1+ (0.00174533,0) [0|0.10995579] "rad"  ADAS
 SG_ DET_RCS_297 : 128|8@1+ (0.5,-64) [-64|63.5] "dBsm"  ADAS
 SG_ DET_BI_STATIC_FLAG_297 : 104|1@1+ (1,0) [0|1] ""  ADAS
 SG_ DET_SUPER_RES_TARGET_297 : 87|1@1+ (1,0) [0|1] ""  ADAS
 SG_ DET_SNR_297 : 120|8@1+ (0.35156,0) [0|89.6478] "dB"  ADAS
 SG_ DET_EXISTENCE_PROB_297 : 112|6@1+ (1.588,0) [0|100] "%"  ADAS
 SG_ DET_HVC_FLAG_297 : 86|1@1+ (1,0) [0|1] ""  ADAS
 SG_ DET_CONFD_AZIMUTH_297 : 118|2@1+ (1,0) [0|3] ""  ADAS
 SG_ DET_CONFD_ELEVATION_297 : 101|2@1+ (1,0) [0|3] ""  ADAS
 SG_ DET_PROB_1STAZHYPO_297 : 103|1@1+ (1,0) [0|1] ""  ADAS
 SG_ DET_IDM_297 : 63|1@1+ (1,0) [0|1] ""  ADAS
 SG_ DET_MTD_297 : 47|1@1+ (1,0) [0|1] ""  ADAS
 SG_ DET_BELOW_RAIN_THOLD_297 : 39|1@1+ (1,0) [0|1] ""  ADAS
 SG_ DET_RANGE_298 : 136|15@1+ (0.015625,0) [0|500] "m"  ADAS
 SG_ DET_RANGE_ERR_298 : 152|7@1+ (0.0075,0) [0|0.9525] "m"  ADAS
 SG_ DET_RANGE_VELOCITY_298 : 160|15@1+ (0.0078125,-128) [-128|127.9921875] "m/s"  ADAS
 SG_ DET_RANGE_VELOCITY_ERR_298 : 176|8@1+ (0.003,0) [0|0.765] "m/s"  ADAS
 SG_ DET_AZIMUTH_298 : 200|13@1+ (0.0004,-1.5708) [-1.5708|1.5708] "rad"  ADAS
 SG_ DET_AZIMUTH_ERR_298 : 217|7@1+ (0.00087267,0) [0|0.11082909] "rad"  ADAS
 SG_ DET_ELEVATION_298 : 184|8@1+ (0.00275,-0.34925) [-0.34925|0.34925] "rad"  ADAS
 SG_ DET_ELEVATION_ERR_298 : 192|6@1+ (0.00174533,0) [0|0.10995579] "rad"  ADAS
 SG_ DET_RCS_298 : 240|8@1+ (0.5,-64) [-64|63.5] "dBsm"  ADAS
 SG_ DET_BI_STATIC_FLAG_298 : 216|1@1+ (1,0) [0|1] ""  ADAS
 SG_ DET_SUPER_RES_TARGET_298 : 199|1@1+ (1,0) [0|1] ""  ADAS
 SG_ DET_SNR_298 : 232|8@1+ (0.35156,0) [0|89.6478] "dB"  ADAS
 SG_ DET_EXISTENCE_PROB_298 : 224|6@1+ (1.588,0) [0|100] "%"  ADAS
 SG_ DET_HVC_FLAG_298 : 198|1@1+ (1,0) [0|1] ""  ADAS
 SG_ DET_CONFD_AZIMUTH_298 : 230|2@1+ (1,0) [0|3] ""  ADAS
 SG_ DET_CONFD_ELEVATION_298 : 213|2@1+ (1,0) [0|3] ""  ADAS
 SG_ DET_PROB_1STAZHYPO_298 : 215|1@1+ (1,0) [0|1] ""  ADAS
 SG_ DET_IDM_298 : 175|1@1+ (1,0) [0|1] ""  ADAS
 SG_ DET_MTD_298 : 159|1@1+ (1,0) [0|1] ""  ADAS
 SG_ DET_BELOW_RAIN_THOLD_298 : 151|1@1+ (1,0) [0|1] ""  ADAS
 SG_ DET_RANGE_299 : 248|15@1+ (0.015625,0) [0|500] "m"  ADAS
 SG_ DET_RANGE_ERR_299 : 264|7@1+ (0.0075,0) [0|0.9525] "m"  ADAS
 SG_ DET_RANGE_VELOCITY_299 : 272|15@1+ (0.0078125,-128) [-128|127.9921875] "m/s"  ADAS
 SG_ DET_RANGE_VELOCITY_ERR_299 : 288|8@1+ (0.003,0) [0|0.765] "m/s"  ADAS
 SG_ DET_AZIMUTH_299 : 312|13@1+ (0.0004,-1.5708) [-1.5708|1.5708] "rad"  ADAS
 SG_ DET_AZIMUTH_ERR_299 : 329|7@1+ (0.00087267,0) [0|0.11082909] "rad"  ADAS
 SG_ DET_ELEVATION_299 : 296|8@1+ (0.00275,-0.34925) [-0.34925|0.34925] "rad"  ADAS
 SG_ DET_ELEVATION_ERR_299 : 304|6@1+ (0.00174533,0) [0|0.10995579] "rad"  ADAS
 SG_ DET_RCS_299 : 352|8@1+ (0.5,-64) [-64|63.5] "dBsm"  ADAS
 SG_ DET_BI_STATIC_FLAG_299 : 328|1@1+ (1,0) [0|1] ""  ADAS
 SG_ DET_SUPER_RES_TARGET_299 : 311|1@1+ (1,0) [0|1] ""  ADAS
 SG_ DET_SNR_299 : 344|8@1+ (0.35156,0) [0|89.6478] "dB"  ADAS
 SG_ DET_EXISTENCE_PROB_299 : 336|6@1+ (1.588,0) [0|100] "%"  ADAS
 SG_ DET_HVC_FLAG_299 : 310|1@1+ (1,0) [0|1] ""  ADAS
 SG_ DET_CONFD_AZIMUTH_299 : 342|2@1+ (1,0) [0|3] ""  ADAS
 SG_ DET_CONFD_ELEVATION_299 : 325|2@1+ (1,0) [0|3] ""  ADAS
 SG_ DET_PROB_1STAZHYPO_299 : 327|1@1+ (1,0) [0|1] ""  ADAS
 SG_ DET_IDM_299 : 287|1@1+ (1,0) [0|1] ""  ADAS
 SG_ DET_MTD_299 : 271|1@1+ (1,0) [0|1] ""  ADAS
 SG_ DET_BELOW_RAIN_THOLD_299 : 263|1@1+ (1,0) [0|1] ""  ADAS
 SG_ DET_RANGE_300 : 360|15@1+ (0.015625,0) [0|500] "m"  ADAS
 SG_ DET_RANGE_ERR_300 : 376|7@1+ (0.0075,0) [0|0.9525] "m"  ADAS
 SG_ DET_RANGE_VELOCITY_300 : 384|15@1+ (0.0078125,-128) [-128|127.9921875] "m/s"  ADAS
 SG_ DET_RANGE_VELOCITY_ERR_300 : 400|8@1+ (0.003,0) [0|0.765] "m/s"  ADAS
 SG_ DET_AZIMUTH_300 : 424|13@1+ (0.0004,-1.5708) [-1.5708|1.5708] "rad"  ADAS
 SG_ DET_AZIMUTH_ERR_300 : 441|7@1+ (0.00087267,0) [0|0.11082909] "rad"  ADAS
 SG_ DET_ELEVATION_300 : 408|8@1+ (0.00275,-0.34925) [-0.34925|0.34925] "rad"  ADAS
 SG_ DET_ELEVATION_ERR_300 : 416|6@1+ (0.00174533,0) [0|0.10995579] "rad"  ADAS
 SG_ DET_RCS_300 : 464|8@1+ (0.5,-64) [-64|63.5] "dBsm"  ADAS
 SG_ DET_BI_STATIC_FLAG_300 : 440|1@1+ (1,0) [0|1] ""  ADAS
 SG_ DET_SUPER_RES_TARGET_300 : 423|1@1+ (1,0) [0|1] ""  ADAS
 SG_ DET_SNR_300 : 456|8@1+ (0.35156,0) [0|89.6478] "dB"  ADAS
 SG_ DET_EXISTENCE_PROB_300 : 448|6@1+ (1.588,0) [0|100] "%"  ADAS
 SG_ DET_HVC_FLAG_300 : 422|1@1+ (1,0) [0|1] ""  ADAS
 SG_ DET_CONFD_AZIMUTH_300 : 454|2@1+ (1,0) [0|3] ""  ADAS
 SG_ DET_CONFD_ELEVATION_300 : 437|2@1+ (1,0) [0|3] ""  ADAS
 SG_ DET_MH_SCAN_INDEX_4LSB_297_300 : 476|4@1+ (1,0) [0|15] ""  ADAS
 SG_ DET_MH_CYCLE_COUNTER_297_300 : 16|8@1+ (1,0) [0|255] ""  ADAS
 SG_ DET_MH_CRC16_297_300 : 0|16@1+ (1,0) [0|65535] ""  ADAS
 SG_ DET_PROB_1STAZHYPO_300 : 439|1@1+ (1,0) [0|1] ""  ADAS
 SG_ DET_IDM_300 : 399|1@1+ (1,0) [0|1] ""  ADAS
 SG_ DET_MTD_300 : 383|1@1+ (1,0) [0|1] ""  ADAS
 SG_ DET_BELOW_RAIN_THOLD_300 : 375|1@1+ (1,0) [0|1] ""  ADAS

BO_ 1099 RDR_DETECTION_301_304: 64 RDR07
 SG_ DET_RANGE_301 : 24|15@1+ (0.015625,0) [0|500] "m"  ADAS
 SG_ DET_RANGE_ERR_301 : 40|7@1+ (0.0075,0) [0|0.9525] "m"  ADAS
 SG_ DET_RANGE_VELOCITY_301 : 48|15@1+ (0.0078125,-128) [-128|127.9921875] "m/s"  ADAS
 SG_ DET_RANGE_VELOCITY_ERR_301 : 64|8@1+ (0.003,0) [0|0.765] "m/s"  ADAS
 SG_ DET_AZIMUTH_301 : 88|13@1+ (0.0004,-1.5708) [-1.5708|1.5708] "rad"  ADAS
 SG_ DET_AZIMUTH_ERR_301 : 105|7@1+ (0.00087267,0) [0|0.11082909] "rad"  ADAS
 SG_ DET_ELEVATION_301 : 72|8@1+ (0.00275,-0.34925) [-0.34925|0.34925] "rad"  ADAS
 SG_ DET_ELEVATION_ERR_301 : 80|6@1+ (0.00174533,0) [0|0.10995579] "rad"  ADAS
 SG_ DET_RCS_301 : 128|8@1+ (0.5,-64) [-64|63.5] "dBsm"  ADAS
 SG_ DET_BI_STATIC_FLAG_301 : 104|1@1+ (1,0) [0|1] ""  ADAS
 SG_ DET_SUPER_RES_TARGET_301 : 87|1@1+ (1,0) [0|1] ""  ADAS
 SG_ DET_SNR_301 : 120|8@1+ (0.35156,0) [0|89.6478] "dB"  ADAS
 SG_ DET_EXISTENCE_PROB_301 : 112|6@1+ (1.588,0) [0|100] "%"  ADAS
 SG_ DET_HVC_FLAG_301 : 86|1@1+ (1,0) [0|1] ""  ADAS
 SG_ DET_CONFD_AZIMUTH_301 : 118|2@1+ (1,0) [0|3] ""  ADAS
 SG_ DET_CONFD_ELEVATION_301 : 101|2@1+ (1,0) [0|3] ""  ADAS
 SG_ DET_PROB_1STAZHYPO_301 : 103|1@1+ (1,0) [0|1] ""  ADAS
 SG_ DET_IDM_301 : 63|1@1+ (1,0) [0|1] ""  ADAS
 SG_ DET_MTD_301 : 47|1@1+ (1,0) [0|1] ""  ADAS
 SG_ DET_BELOW_RAIN_THOLD_301 : 39|1@1+ (1,0) [0|1] ""  ADAS
 SG_ DET_RANGE_302 : 136|15@1+ (0.015625,0) [0|500] "m"  ADAS
 SG_ DET_RANGE_ERR_302 : 152|7@1+ (0.0075,0) [0|0.9525] "m"  ADAS
 SG_ DET_RANGE_VELOCITY_302 : 160|15@1+ (0.0078125,-128) [-128|127.9921875] "m/s"  ADAS
 SG_ DET_RANGE_VELOCITY_ERR_302 : 176|8@1+ (0.003,0) [0|0.765] "m/s"  ADAS
 SG_ DET_AZIMUTH_302 : 200|13@1+ (0.0004,-1.5708) [-1.5708|1.5708] "rad"  ADAS
 SG_ DET_AZIMUTH_ERR_302 : 217|7@1+ (0.00087267,0) [0|0.11082909] "rad"  ADAS
 SG_ DET_ELEVATION_302 : 184|8@1+ (0.00275,-0.34925) [-0.34925|0.34925] "rad"  ADAS
 SG_ DET_ELEVATION_ERR_302 : 192|6@1+ (0.00174533,0) [0|0.10995579] "rad"  ADAS
 SG_ DET_RCS_302 : 240|8@1+ (0.5,-64) [-64|63.5] "dBsm"  ADAS
 SG_ DET_BI_STATIC_FLAG_302 : 216|1@1+ (1,0) [0|1] ""  ADAS
 SG_ DET_SUPER_RES_TARGET_302 : 199|1@1+ (1,0) [0|1] ""  ADAS
 SG_ DET_SNR_302 : 232|8@1+ (0.35156,0) [0|89.6478] "dB"  ADAS
 SG_ DET_EXISTENCE_PROB_302 : 224|6@1+ (1.588,0) [0|100] "%"  ADAS
 SG_ DET_HVC_FLAG_302 : 198|1@1+ (1,0) [0|1] ""  ADAS
 SG_ DET_CONFD_AZIMUTH_302 : 230|2@1+ (1,0) [0|3] ""  ADAS
 SG_ DET_CONFD_ELEVATION_302 : 213|2@1+ (1,0) [0|3] ""  ADAS
 SG_ DET_PROB_1STAZHYPO_302 : 215|1@1+ (1,0) [0|1] ""  ADAS
 SG_ DET_IDM_302 : 175|1@1+ (1,0) [0|1] ""  ADAS
 SG_ DET_MTD_302 : 159|1@1+ (1,0) [0|1] ""  ADAS
 SG_ DET_BELOW_RAIN_THOLD_302 : 151|1@1+ (1,0) [0|1] ""  ADAS
 SG_ DET_RANGE_303 : 248|15@1+ (0.015625,0) [0|500] "m"  ADAS
 SG_ DET_RANGE_ERR_303 : 264|7@1+ (0.0075,0) [0|0.9525] "m"  ADAS
 SG_ DET_RANGE_VELOCITY_303 : 272|15@1+ (0.0078125,-128) [-128|127.9921875] "m/s"  ADAS
 SG_ DET_RANGE_VELOCITY_ERR_303 : 288|8@1+ (0.003,0) [0|0.765] "m/s"  ADAS
 SG_ DET_AZIMUTH_303 : 312|13@1+ (0.0004,-1.5708) [-1.5708|1.5708] "rad"  ADAS
 SG_ DET_AZIMUTH_ERR_303 : 329|7@1+ (0.00087267,0) [0|0.11082909] "rad"  ADAS
 SG_ DET_ELEVATION_303 : 296|8@1+ (0.00275,-0.34925) [-0.34925|0.34925] "rad"  ADAS
 SG_ DET_ELEVATION_ERR_303 : 304|6@1+ (0.00174533,0) [0|0.10995579] "rad"  ADAS
 SG_ DET_RCS_303 : 352|8@1+ (0.5,-64) [-64|63.5] "dBsm"  ADAS
 SG_ DET_BI_STATIC_FLAG_303 : 328|1@1+ (1,0) [0|1] ""  ADAS
 SG_ DET_SUPER_RES_TARGET_303 : 311|1@1+ (1,0) [0|1] ""  ADAS
 SG_ DET_SNR_303 : 344|8@1+ (0.35156,0) [0|89.6478] "dB"  ADAS
 SG_ DET_EXISTENCE_PROB_303 : 336|6@1+ (1.588,0) [0|100] "%"  ADAS
 SG_ DET_HVC_FLAG_303 : 310|1@1+ (1,0) [0|1] ""  ADAS
 SG_ DET_CONFD_AZIMUTH_303 : 342|2@1+ (1,0) [0|3] ""  ADAS
 SG_ DET_CONFD_ELEVATION_303 : 325|2@1+ (1,0) [0|3] ""  ADAS
 SG_ DET_PROB_1STAZHYPO_303 : 327|1@1+ (1,0) [0|1] ""  ADAS
 SG_ DET_IDM_303 : 287|1@1+ (1,0) [0|1] ""  ADAS
 SG_ DET_MTD_303 : 271|1@1+ (1,0) [0|1] ""  ADAS
 SG_ DET_BELOW_RAIN_THOLD_303 : 263|1@1+ (1,0) [0|1] ""  ADAS
 SG_ DET_RANGE_304 : 360|15@1+ (0.015625,0) [0|500] "m"  ADAS
 SG_ DET_RANGE_ERR_304 : 376|7@1+ (0.0075,0) [0|0.9525] "m"  ADAS
 SG_ DET_RANGE_VELOCITY_304 : 384|15@1+ (0.0078125,-128) [-128|127.9921875] "m/s"  ADAS
 SG_ DET_RANGE_VELOCITY_ERR_304 : 400|8@1+ (0.003,0) [0|0.765] "m/s"  ADAS
 SG_ DET_AZIMUTH_304 : 424|13@1+ (0.0004,-1.5708) [-1.5708|1.5708] "rad"  ADAS
 SG_ DET_AZIMUTH_ERR_304 : 441|7@1+ (0.00087267,0) [0|0.11082909] "rad"  ADAS
 SG_ DET_ELEVATION_304 : 408|8@1+ (0.00275,-0.34925) [-0.34925|0.34925] "rad"  ADAS
 SG_ DET_ELEVATION_ERR_304 : 416|6@1+ (0.00174533,0) [0|0.10995579] "rad"  ADAS
 SG_ DET_RCS_304 : 464|8@1+ (0.5,-64) [-64|63.5] "dBsm"  ADAS
 SG_ DET_BI_STATIC_FLAG_304 : 440|1@1+ (1,0) [0|1] ""  ADAS
 SG_ DET_SUPER_RES_TARGET_304 : 423|1@1+ (1,0) [0|1] ""  ADAS
 SG_ DET_SNR_304 : 456|8@1+ (0.35156,0) [0|89.6478] "dB"  ADAS
 SG_ DET_EXISTENCE_PROB_304 : 448|6@1+ (1.588,0) [0|100] "%"  ADAS
 SG_ DET_HVC_FLAG_304 : 422|1@1+ (1,0) [0|1] ""  ADAS
 SG_ DET_CONFD_AZIMUTH_304 : 454|2@1+ (1,0) [0|3] ""  ADAS
 SG_ DET_CONFD_ELEVATION_304 : 437|2@1+ (1,0) [0|3] ""  ADAS
 SG_ DET_MH_SCAN_INDEX_4LSB_301_304 : 476|4@1+ (1,0) [0|15] ""  ADAS
 SG_ DET_MH_CYCLE_COUNTER_301_304 : 16|8@1+ (1,0) [0|255] ""  ADAS
 SG_ DET_MH_CRC16_301_304 : 0|16@1+ (1,0) [0|65535] ""  ADAS
 SG_ DET_PROB_1STAZHYPO_304 : 439|1@1+ (1,0) [0|1] ""  ADAS
 SG_ DET_IDM_304 : 399|1@1+ (1,0) [0|1] ""  ADAS
 SG_ DET_MTD_304 : 383|1@1+ (1,0) [0|1] ""  ADAS
 SG_ DET_BELOW_RAIN_THOLD_304 : 375|1@1+ (1,0) [0|1] ""  ADAS

BO_ 1100 RDR_DETECTION_305_308: 64 RDR07
 SG_ DET_RANGE_305 : 24|15@1+ (0.015625,0) [0|500] "m"  ADAS
 SG_ DET_RANGE_ERR_305 : 40|7@1+ (0.0075,0) [0|0.9525] "m"  ADAS
 SG_ DET_RANGE_VELOCITY_305 : 48|15@1+ (0.0078125,-128) [-128|127.9921875] "m/s"  ADAS
 SG_ DET_RANGE_VELOCITY_ERR_305 : 64|8@1+ (0.003,0) [0|0.765] "m/s"  ADAS
 SG_ DET_AZIMUTH_305 : 88|13@1+ (0.0004,-1.5708) [-1.5708|1.5708] "rad"  ADAS
 SG_ DET_AZIMUTH_ERR_305 : 105|7@1+ (0.00087267,0) [0|0.11082909] "rad"  ADAS
 SG_ DET_ELEVATION_305 : 72|8@1+ (0.00275,-0.34925) [-0.34925|0.34925] "rad"  ADAS
 SG_ DET_ELEVATION_ERR_305 : 80|6@1+ (0.00174533,0) [0|0.10995579] "rad"  ADAS
 SG_ DET_RCS_305 : 128|8@1+ (0.5,-64) [-64|63.5] "dBsm"  ADAS
 SG_ DET_BI_STATIC_FLAG_305 : 104|1@1+ (1,0) [0|1] ""  ADAS
 SG_ DET_SUPER_RES_TARGET_305 : 87|1@1+ (1,0) [0|1] ""  ADAS
 SG_ DET_SNR_305 : 120|8@1+ (0.35156,0) [0|89.6478] "dB"  ADAS
 SG_ DET_EXISTENCE_PROB_305 : 112|6@1+ (1.588,0) [0|100] "%"  ADAS
 SG_ DET_HVC_FLAG_305 : 86|1@1+ (1,0) [0|1] ""  ADAS
 SG_ DET_CONFD_AZIMUTH_305 : 118|2@1+ (1,0) [0|3] ""  ADAS
 SG_ DET_CONFD_ELEVATION_305 : 101|2@1+ (1,0) [0|3] ""  ADAS
 SG_ DET_PROB_1STAZHYPO_305 : 103|1@1+ (1,0) [0|1] ""  ADAS
 SG_ DET_IDM_305 : 63|1@1+ (1,0) [0|1] ""  ADAS
 SG_ DET_MTD_305 : 47|1@1+ (1,0) [0|1] ""  ADAS
 SG_ DET_BELOW_RAIN_THOLD_305 : 39|1@1+ (1,0) [0|1] ""  ADAS
 SG_ DET_RANGE_306 : 136|15@1+ (0.015625,0) [0|500] "m"  ADAS
 SG_ DET_RANGE_ERR_306 : 152|7@1+ (0.0075,0) [0|0.9525] "m"  ADAS
 SG_ DET_RANGE_VELOCITY_306 : 160|15@1+ (0.0078125,-128) [-128|127.9921875] "m/s"  ADAS
 SG_ DET_RANGE_VELOCITY_ERR_306 : 176|8@1+ (0.003,0) [0|0.765] "m/s"  ADAS
 SG_ DET_AZIMUTH_306 : 200|13@1+ (0.0004,-1.5708) [-1.5708|1.5708] "rad"  ADAS
 SG_ DET_AZIMUTH_ERR_306 : 217|7@1+ (0.00087267,0) [0|0.11082909] "rad"  ADAS
 SG_ DET_ELEVATION_306 : 184|8@1+ (0.00275,-0.34925) [-0.34925|0.34925] "rad"  ADAS
 SG_ DET_ELEVATION_ERR_306 : 192|6@1+ (0.00174533,0) [0|0.10995579] "rad"  ADAS
 SG_ DET_RCS_306 : 240|8@1+ (0.5,-64) [-64|63.5] "dBsm"  ADAS
 SG_ DET_BI_STATIC_FLAG_306 : 216|1@1+ (1,0) [0|1] ""  ADAS
 SG_ DET_SUPER_RES_TARGET_306 : 199|1@1+ (1,0) [0|1] ""  ADAS
 SG_ DET_SNR_306 : 232|8@1+ (0.35156,0) [0|89.6478] "dB"  ADAS
 SG_ DET_EXISTENCE_PROB_306 : 224|6@1+ (1.588,0) [0|100] "%"  ADAS
 SG_ DET_HVC_FLAG_306 : 198|1@1+ (1,0) [0|1] ""  ADAS
 SG_ DET_CONFD_AZIMUTH_306 : 230|2@1+ (1,0) [0|3] ""  ADAS
 SG_ DET_CONFD_ELEVATION_306 : 213|2@1+ (1,0) [0|3] ""  ADAS
 SG_ DET_PROB_1STAZHYPO_306 : 215|1@1+ (1,0) [0|1] ""  ADAS
 SG_ DET_IDM_306 : 175|1@1+ (1,0) [0|1] ""  ADAS
 SG_ DET_MTD_306 : 159|1@1+ (1,0) [0|1] ""  ADAS
 SG_ DET_BELOW_RAIN_THOLD_306 : 151|1@1+ (1,0) [0|1] ""  ADAS
 SG_ DET_RANGE_307 : 248|15@1+ (0.015625,0) [0|500] "m"  ADAS
 SG_ DET_RANGE_ERR_307 : 264|7@1+ (0.0075,0) [0|0.9525] "m"  ADAS
 SG_ DET_RANGE_VELOCITY_307 : 272|15@1+ (0.0078125,-128) [-128|127.9921875] "m/s"  ADAS
 SG_ DET_RANGE_VELOCITY_ERR_307 : 288|8@1+ (0.003,0) [0|0.765] "m/s"  ADAS
 SG_ DET_AZIMUTH_307 : 312|13@1+ (0.0004,-1.5708) [-1.5708|1.5708] "rad"  ADAS
 SG_ DET_AZIMUTH_ERR_307 : 329|7@1+ (0.00087267,0) [0|0.11082909] "rad"  ADAS
 SG_ DET_ELEVATION_307 : 296|8@1+ (0.00275,-0.34925) [-0.34925|0.34925] "rad"  ADAS
 SG_ DET_ELEVATION_ERR_307 : 304|6@1+ (0.00174533,0) [0|0.10995579] "rad"  ADAS
 SG_ DET_RCS_307 : 352|8@1+ (0.5,-64) [-64|63.5] "dBsm"  ADAS
 SG_ DET_BI_STATIC_FLAG_307 : 328|1@1+ (1,0) [0|1] ""  ADAS
 SG_ DET_SUPER_RES_TARGET_307 : 311|1@1+ (1,0) [0|1] ""  ADAS
 SG_ DET_SNR_307 : 344|8@1+ (0.35156,0) [0|89.6478] "dB"  ADAS
 SG_ DET_EXISTENCE_PROB_307 : 336|6@1+ (1.588,0) [0|100] "%"  ADAS
 SG_ DET_HVC_FLAG_307 : 310|1@1+ (1,0) [0|1] ""  ADAS
 SG_ DET_CONFD_AZIMUTH_307 : 342|2@1+ (1,0) [0|3] ""  ADAS
 SG_ DET_CONFD_ELEVATION_307 : 325|2@1+ (1,0) [0|3] ""  ADAS
 SG_ DET_PROB_1STAZHYPO_307 : 327|1@1+ (1,0) [0|1] ""  ADAS
 SG_ DET_IDM_307 : 287|1@1+ (1,0) [0|1] ""  ADAS
 SG_ DET_MTD_307 : 271|1@1+ (1,0) [0|1] ""  ADAS
 SG_ DET_BELOW_RAIN_THOLD_307 : 263|1@1+ (1,0) [0|1] ""  ADAS
 SG_ DET_RANGE_308 : 360|15@1+ (0.015625,0) [0|500] "m"  ADAS
 SG_ DET_RANGE_ERR_308 : 376|7@1+ (0.0075,0) [0|0.9525] "m"  ADAS
 SG_ DET_RANGE_VELOCITY_308 : 384|15@1+ (0.0078125,-128) [-128|127.9921875] "m/s"  ADAS
 SG_ DET_RANGE_VELOCITY_ERR_308 : 400|8@1+ (0.003,0) [0|0.765] "m/s"  ADAS
 SG_ DET_AZIMUTH_308 : 424|13@1+ (0.0004,-1.5708) [-1.5708|1.5708] "rad"  ADAS
 SG_ DET_AZIMUTH_ERR_308 : 441|7@1+ (0.00087267,0) [0|0.11082909] "rad"  ADAS
 SG_ DET_ELEVATION_308 : 408|8@1+ (0.00275,-0.34925) [-0.34925|0.34925] "rad"  ADAS
 SG_ DET_ELEVATION_ERR_308 : 416|6@1+ (0.00174533,0) [0|0.10995579] "rad"  ADAS
 SG_ DET_RCS_308 : 464|8@1+ (0.5,-64) [-64|63.5] "dBsm"  ADAS
 SG_ DET_BI_STATIC_FLAG_308 : 440|1@1+ (1,0) [0|1] ""  ADAS
 SG_ DET_SUPER_RES_TARGET_308 : 423|1@1+ (1,0) [0|1] ""  ADAS
 SG_ DET_SNR_308 : 456|8@1+ (0.35156,0) [0|89.6478] "dB"  ADAS
 SG_ DET_EXISTENCE_PROB_308 : 448|6@1+ (1.588,0) [0|100] "%"  ADAS
 SG_ DET_HVC_FLAG_308 : 422|1@1+ (1,0) [0|1] ""  ADAS
 SG_ DET_CONFD_AZIMUTH_308 : 454|2@1+ (1,0) [0|3] ""  ADAS
 SG_ DET_CONFD_ELEVATION_308 : 437|2@1+ (1,0) [0|3] ""  ADAS
 SG_ DET_MH_SCAN_INDEX_4LSB_305_308 : 476|4@1+ (1,0) [0|15] ""  ADAS
 SG_ DET_MH_CYCLE_COUNTER_305_308 : 16|8@1+ (1,0) [0|255] ""  ADAS
 SG_ DET_MH_CRC16_305_308 : 0|16@1+ (1,0) [0|65535] ""  ADAS
 SG_ DET_PROB_1STAZHYPO_308 : 439|1@1+ (1,0) [0|1] ""  ADAS
 SG_ DET_IDM_308 : 399|1@1+ (1,0) [0|1] ""  ADAS
 SG_ DET_MTD_308 : 383|1@1+ (1,0) [0|1] ""  ADAS
 SG_ DET_BELOW_RAIN_THOLD_308 : 375|1@1+ (1,0) [0|1] ""  ADAS

BO_ 1101 RDR_DETECTION_309_312: 64 RDR07
 SG_ DET_RANGE_309 : 24|15@1+ (0.015625,0) [0|500] "m"  ADAS
 SG_ DET_RANGE_ERR_309 : 40|7@1+ (0.0075,0) [0|0.9525] "m"  ADAS
 SG_ DET_RANGE_VELOCITY_309 : 48|15@1+ (0.0078125,-128) [-128|127.9921875] "m/s"  ADAS
 SG_ DET_RANGE_VELOCITY_ERR_309 : 64|8@1+ (0.003,0) [0|0.765] "m/s"  ADAS
 SG_ DET_AZIMUTH_309 : 88|13@1+ (0.0004,-1.5708) [-1.5708|1.5708] "rad"  ADAS
 SG_ DET_AZIMUTH_ERR_309 : 105|7@1+ (0.00087267,0) [0|0.11082909] "rad"  ADAS
 SG_ DET_ELEVATION_309 : 72|8@1+ (0.00275,-0.34925) [-0.34925|0.34925] "rad"  ADAS
 SG_ DET_ELEVATION_ERR_309 : 80|6@1+ (0.00174533,0) [0|0.10995579] "rad"  ADAS
 SG_ DET_RCS_309 : 128|8@1+ (0.5,-64) [-64|63.5] "dBsm"  ADAS
 SG_ DET_BI_STATIC_FLAG_309 : 104|1@1+ (1,0) [0|1] ""  ADAS
 SG_ DET_SUPER_RES_TARGET_309 : 87|1@1+ (1,0) [0|1] ""  ADAS
 SG_ DET_SNR_309 : 120|8@1+ (0.35156,0) [0|89.6478] "dB"  ADAS
 SG_ DET_EXISTENCE_PROB_309 : 112|6@1+ (1.588,0) [0|100] "%"  ADAS
 SG_ DET_HVC_FLAG_309 : 86|1@1+ (1,0) [0|1] ""  ADAS
 SG_ DET_CONFD_AZIMUTH_309 : 118|2@1+ (1,0) [0|3] ""  ADAS
 SG_ DET_CONFD_ELEVATION_309 : 101|2@1+ (1,0) [0|3] ""  ADAS
 SG_ DET_PROB_1STAZHYPO_309 : 103|1@1+ (1,0) [0|1] ""  ADAS
 SG_ DET_IDM_309 : 63|1@1+ (1,0) [0|1] ""  ADAS
 SG_ DET_MTD_309 : 47|1@1+ (1,0) [0|1] ""  ADAS
 SG_ DET_BELOW_RAIN_THOLD_309 : 39|1@1+ (1,0) [0|1] ""  ADAS
 SG_ DET_RANGE_310 : 136|15@1+ (0.015625,0) [0|500] "m"  ADAS
 SG_ DET_RANGE_ERR_310 : 152|7@1+ (0.0075,0) [0|0.9525] "m"  ADAS
 SG_ DET_RANGE_VELOCITY_310 : 160|15@1+ (0.0078125,-128) [-128|127.9921875] "m/s"  ADAS
 SG_ DET_RANGE_VELOCITY_ERR_310 : 176|8@1+ (0.003,0) [0|0.765] "m/s"  ADAS
 SG_ DET_AZIMUTH_310 : 200|13@1+ (0.0004,-1.5708) [-1.5708|1.5708] "rad"  ADAS
 SG_ DET_AZIMUTH_ERR_310 : 217|7@1+ (0.00087267,0) [0|0.11082909] "rad"  ADAS
 SG_ DET_ELEVATION_310 : 184|8@1+ (0.00275,-0.34925) [-0.34925|0.34925] "rad"  ADAS
 SG_ DET_ELEVATION_ERR_310 : 192|6@1+ (0.00174533,0) [0|0.10995579] "rad"  ADAS
 SG_ DET_RCS_310 : 240|8@1+ (0.5,-64) [-64|63.5] "dBsm"  ADAS
 SG_ DET_BI_STATIC_FLAG_310 : 216|1@1+ (1,0) [0|1] ""  ADAS
 SG_ DET_SUPER_RES_TARGET_310 : 199|1@1+ (1,0) [0|1] ""  ADAS
 SG_ DET_SNR_310 : 232|8@1+ (0.35156,0) [0|89.6478] "dB"  ADAS
 SG_ DET_EXISTENCE_PROB_310 : 224|6@1+ (1.588,0) [0|100] "%"  ADAS
 SG_ DET_HVC_FLAG_310 : 198|1@1+ (1,0) [0|1] ""  ADAS
 SG_ DET_CONFD_AZIMUTH_310 : 230|2@1+ (1,0) [0|3] ""  ADAS
 SG_ DET_CONFD_ELEVATION_310 : 213|2@1+ (1,0) [0|3] ""  ADAS
 SG_ DET_PROB_1STAZHYPO_310 : 215|1@1+ (1,0) [0|1] ""  ADAS
 SG_ DET_IDM_310 : 175|1@1+ (1,0) [0|1] ""  ADAS
 SG_ DET_MTD_310 : 159|1@1+ (1,0) [0|1] ""  ADAS
 SG_ DET_BELOW_RAIN_THOLD_310 : 151|1@1+ (1,0) [0|1] ""  ADAS
 SG_ DET_RANGE_311 : 248|15@1+ (0.015625,0) [0|500] "m"  ADAS
 SG_ DET_RANGE_ERR_311 : 264|7@1+ (0.0075,0) [0|0.9525] "m"  ADAS
 SG_ DET_RANGE_VELOCITY_311 : 272|15@1+ (0.0078125,-128) [-128|127.9921875] "m/s"  ADAS
 SG_ DET_RANGE_VELOCITY_ERR_311 : 288|8@1+ (0.003,0) [0|0.765] "m/s"  ADAS
 SG_ DET_AZIMUTH_311 : 312|13@1+ (0.0004,-1.5708) [-1.5708|1.5708] "rad"  ADAS
 SG_ DET_AZIMUTH_ERR_311 : 329|7@1+ (0.00087267,0) [0|0.11082909] "rad"  ADAS
 SG_ DET_ELEVATION_311 : 296|8@1+ (0.00275,-0.34925) [-0.34925|0.34925] "rad"  ADAS
 SG_ DET_ELEVATION_ERR_311 : 304|6@1+ (0.00174533,0) [0|0.10995579] "rad"  ADAS
 SG_ DET_RCS_311 : 352|8@1+ (0.5,-64) [-64|63.5] "dBsm"  ADAS
 SG_ DET_BI_STATIC_FLAG_311 : 328|1@1+ (1,0) [0|1] ""  ADAS
 SG_ DET_SUPER_RES_TARGET_311 : 311|1@1+ (1,0) [0|1] ""  ADAS
 SG_ DET_SNR_311 : 344|8@1+ (0.35156,0) [0|89.6478] "dB"  ADAS
 SG_ DET_EXISTENCE_PROB_311 : 336|6@1+ (1.588,0) [0|100] "%"  ADAS
 SG_ DET_HVC_FLAG_311 : 310|1@1+ (1,0) [0|1] ""  ADAS
 SG_ DET_CONFD_AZIMUTH_311 : 342|2@1+ (1,0) [0|3] ""  ADAS
 SG_ DET_CONFD_ELEVATION_311 : 325|2@1+ (1,0) [0|3] ""  ADAS
 SG_ DET_PROB_1STAZHYPO_311 : 327|1@1+ (1,0) [0|1] ""  ADAS
 SG_ DET_IDM_311 : 287|1@1+ (1,0) [0|1] ""  ADAS
 SG_ DET_MTD_311 : 271|1@1+ (1,0) [0|1] ""  ADAS
 SG_ DET_BELOW_RAIN_THOLD_311 : 263|1@1+ (1,0) [0|1] ""  ADAS
 SG_ DET_RANGE_312 : 360|15@1+ (0.015625,0) [0|500] "m"  ADAS
 SG_ DET_RANGE_ERR_312 : 376|7@1+ (0.0075,0) [0|0.9525] "m"  ADAS
 SG_ DET_RANGE_VELOCITY_312 : 384|15@1+ (0.0078125,-128) [-128|127.9921875] "m/s"  ADAS
 SG_ DET_RANGE_VELOCITY_ERR_312 : 400|8@1+ (0.003,0) [0|0.765] "m/s"  ADAS
 SG_ DET_AZIMUTH_312 : 424|13@1+ (0.0004,-1.5708) [-1.5708|1.5708] "rad"  ADAS
 SG_ DET_AZIMUTH_ERR_312 : 441|7@1+ (0.00087267,0) [0|0.11082909] "rad"  ADAS
 SG_ DET_ELEVATION_312 : 408|8@1+ (0.00275,-0.34925) [-0.34925|0.34925] "rad"  ADAS
 SG_ DET_ELEVATION_ERR_312 : 416|6@1+ (0.00174533,0) [0|0.10995579] "rad"  ADAS
 SG_ DET_RCS_312 : 464|8@1+ (0.5,-64) [-64|63.5] "dBsm"  ADAS
 SG_ DET_BI_STATIC_FLAG_312 : 440|1@1+ (1,0) [0|1] ""  ADAS
 SG_ DET_SUPER_RES_TARGET_312 : 423|1@1+ (1,0) [0|1] ""  ADAS
 SG_ DET_SNR_312 : 456|8@1+ (0.35156,0) [0|89.6478] "dB"  ADAS
 SG_ DET_EXISTENCE_PROB_312 : 448|6@1+ (1.588,0) [0|100] "%"  ADAS
 SG_ DET_HVC_FLAG_312 : 422|1@1+ (1,0) [0|1] ""  ADAS
 SG_ DET_CONFD_AZIMUTH_312 : 454|2@1+ (1,0) [0|3] ""  ADAS
 SG_ DET_CONFD_ELEVATION_312 : 437|2@1+ (1,0) [0|3] ""  ADAS
 SG_ DET_MH_SCAN_INDEX_4LSB_309_312 : 476|4@1+ (1,0) [0|15] ""  ADAS
 SG_ DET_MH_CYCLE_COUNTER_309_312 : 16|8@1+ (1,0) [0|255] ""  ADAS
 SG_ DET_MH_CRC16_309_312 : 0|16@1+ (1,0) [0|65535] ""  ADAS
 SG_ DET_PROB_1STAZHYPO_312 : 439|1@1+ (1,0) [0|1] ""  ADAS
 SG_ DET_IDM_312 : 399|1@1+ (1,0) [0|1] ""  ADAS
 SG_ DET_MTD_312 : 383|1@1+ (1,0) [0|1] ""  ADAS
 SG_ DET_BELOW_RAIN_THOLD_312 : 375|1@1+ (1,0) [0|1] ""  ADAS

BO_ 1102 RDR_DETECTION_313_316: 64 RDR07
 SG_ DET_RANGE_313 : 24|15@1+ (0.015625,0) [0|500] "m"  ADAS
 SG_ DET_RANGE_ERR_313 : 40|7@1+ (0.0075,0) [0|0.9525] "m"  ADAS
 SG_ DET_RANGE_VELOCITY_313 : 48|15@1+ (0.0078125,-128) [-128|127.9921875] "m/s"  ADAS
 SG_ DET_RANGE_VELOCITY_ERR_313 : 64|8@1+ (0.003,0) [0|0.765] "m/s"  ADAS
 SG_ DET_AZIMUTH_313 : 88|13@1+ (0.0004,-1.5708) [-1.5708|1.5708] "rad"  ADAS
 SG_ DET_AZIMUTH_ERR_313 : 105|7@1+ (0.00087267,0) [0|0.11082909] "rad"  ADAS
 SG_ DET_ELEVATION_313 : 72|8@1+ (0.00275,-0.34925) [-0.34925|0.34925] "rad"  ADAS
 SG_ DET_ELEVATION_ERR_313 : 80|6@1+ (0.00174533,0) [0|0.10995579] "rad"  ADAS
 SG_ DET_RCS_313 : 128|8@1+ (0.5,-64) [-64|63.5] "dBsm"  ADAS
 SG_ DET_BI_STATIC_FLAG_313 : 104|1@1+ (1,0) [0|1] ""  ADAS
 SG_ DET_SUPER_RES_TARGET_313 : 87|1@1+ (1,0) [0|1] ""  ADAS
 SG_ DET_SNR_313 : 120|8@1+ (0.35156,0) [0|89.6478] "dB"  ADAS
 SG_ DET_EXISTENCE_PROB_313 : 112|6@1+ (1.588,0) [0|100] "%"  ADAS
 SG_ DET_HVC_FLAG_313 : 86|1@1+ (1,0) [0|1] ""  ADAS
 SG_ DET_CONFD_AZIMUTH_313 : 118|2@1+ (1,0) [0|3] ""  ADAS
 SG_ DET_CONFD_ELEVATION_313 : 101|2@1+ (1,0) [0|3] ""  ADAS
 SG_ DET_PROB_1STAZHYPO_313 : 103|1@1+ (1,0) [0|1] ""  ADAS
 SG_ DET_IDM_313 : 63|1@1+ (1,0) [0|1] ""  ADAS
 SG_ DET_MTD_313 : 47|1@1+ (1,0) [0|1] ""  ADAS
 SG_ DET_BELOW_RAIN_THOLD_313 : 39|1@1+ (1,0) [0|1] ""  ADAS
 SG_ DET_RANGE_314 : 136|15@1+ (0.015625,0) [0|500] "m"  ADAS
 SG_ DET_RANGE_ERR_314 : 152|7@1+ (0.0075,0) [0|0.9525] "m"  ADAS
 SG_ DET_RANGE_VELOCITY_314 : 160|15@1+ (0.0078125,-128) [-128|127.9921875] "m/s"  ADAS
 SG_ DET_RANGE_VELOCITY_ERR_314 : 176|8@1+ (0.003,0) [0|0.765] "m/s"  ADAS
 SG_ DET_AZIMUTH_314 : 200|13@1+ (0.0004,-1.5708) [-1.5708|1.5708] "rad"  ADAS
 SG_ DET_AZIMUTH_ERR_314 : 217|7@1+ (0.00087267,0) [0|0.11082909] "rad"  ADAS
 SG_ DET_ELEVATION_314 : 184|8@1+ (0.00275,-0.34925) [-0.34925|0.34925] "rad"  ADAS
 SG_ DET_ELEVATION_ERR_314 : 192|6@1+ (0.00174533,0) [0|0.10995579] "rad"  ADAS
 SG_ DET_RCS_314 : 240|8@1+ (0.5,-64) [-64|63.5] "dBsm"  ADAS
 SG_ DET_BI_STATIC_FLAG_314 : 216|1@1+ (1,0) [0|1] ""  ADAS
 SG_ DET_SUPER_RES_TARGET_314 : 199|1@1+ (1,0) [0|1] ""  ADAS
 SG_ DET_SNR_314 : 232|8@1+ (0.35156,0) [0|89.6478] "dB"  ADAS
 SG_ DET_EXISTENCE_PROB_314 : 224|6@1+ (1.588,0) [0|100] "%"  ADAS
 SG_ DET_HVC_FLAG_314 : 198|1@1+ (1,0) [0|1] ""  ADAS
 SG_ DET_CONFD_AZIMUTH_314 : 230|2@1+ (1,0) [0|3] ""  ADAS
 SG_ DET_CONFD_ELEVATION_314 : 213|2@1+ (1,0) [0|3] ""  ADAS
 SG_ DET_PROB_1STAZHYPO_314 : 215|1@1+ (1,0) [0|1] ""  ADAS
 SG_ DET_IDM_314 : 175|1@1+ (1,0) [0|1] ""  ADAS
 SG_ DET_MTD_314 : 159|1@1+ (1,0) [0|1] ""  ADAS
 SG_ DET_BELOW_RAIN_THOLD_314 : 151|1@1+ (1,0) [0|1] ""  ADAS
 SG_ DET_RANGE_315 : 248|15@1+ (0.015625,0) [0|500] "m"  ADAS
 SG_ DET_RANGE_ERR_315 : 264|7@1+ (0.0075,0) [0|0.9525] "m"  ADAS
 SG_ DET_RANGE_VELOCITY_315 : 272|15@1+ (0.0078125,-128) [-128|127.9921875] "m/s"  ADAS
 SG_ DET_RANGE_VELOCITY_ERR_315 : 288|8@1+ (0.003,0) [0|0.765] "m/s"  ADAS
 SG_ DET_AZIMUTH_315 : 312|13@1+ (0.0004,-1.5708) [-1.5708|1.5708] "rad"  ADAS
 SG_ DET_AZIMUTH_ERR_315 : 329|7@1+ (0.00087267,0) [0|0.11082909] "rad"  ADAS
 SG_ DET_ELEVATION_315 : 296|8@1+ (0.00275,-0.34925) [-0.34925|0.34925] "rad"  ADAS
 SG_ DET_ELEVATION_ERR_315 : 304|6@1+ (0.00174533,0) [0|0.10995579] "rad"  ADAS
 SG_ DET_RCS_315 : 352|8@1+ (0.5,-64) [-64|63.5] "dBsm"  ADAS
 SG_ DET_BI_STATIC_FLAG_315 : 328|1@1+ (1,0) [0|1] ""  ADAS
 SG_ DET_SUPER_RES_TARGET_315 : 311|1@1+ (1,0) [0|1] ""  ADAS
 SG_ DET_SNR_315 : 344|8@1+ (0.35156,0) [0|89.6478] "dB"  ADAS
 SG_ DET_EXISTENCE_PROB_315 : 336|6@1+ (1.588,0) [0|100] "%"  ADAS
 SG_ DET_HVC_FLAG_315 : 310|1@1+ (1,0) [0|1] ""  ADAS
 SG_ DET_CONFD_AZIMUTH_315 : 342|2@1+ (1,0) [0|3] ""  ADAS
 SG_ DET_CONFD_ELEVATION_315 : 325|2@1+ (1,0) [0|3] ""  ADAS
 SG_ DET_PROB_1STAZHYPO_315 : 327|1@1+ (1,0) [0|1] ""  ADAS
 SG_ DET_IDM_315 : 287|1@1+ (1,0) [0|1] ""  ADAS
 SG_ DET_MTD_315 : 271|1@1+ (1,0) [0|1] ""  ADAS
 SG_ DET_BELOW_RAIN_THOLD_315 : 263|1@1+ (1,0) [0|1] ""  ADAS
 SG_ DET_RANGE_316 : 360|15@1+ (0.015625,0) [0|500] "m"  ADAS
 SG_ DET_RANGE_ERR_316 : 376|7@1+ (0.0075,0) [0|0.9525] "m"  ADAS
 SG_ DET_RANGE_VELOCITY_316 : 384|15@1+ (0.0078125,-128) [-128|127.9921875] "m/s"  ADAS
 SG_ DET_RANGE_VELOCITY_ERR_316 : 400|8@1+ (0.003,0) [0|0.765] "m/s"  ADAS
 SG_ DET_AZIMUTH_316 : 424|13@1+ (0.0004,-1.5708) [-1.5708|1.5708] "rad"  ADAS
 SG_ DET_AZIMUTH_ERR_316 : 441|7@1+ (0.00087267,0) [0|0.11082909] "rad"  ADAS
 SG_ DET_ELEVATION_316 : 408|8@1+ (0.00275,-0.34925) [-0.34925|0.34925] "rad"  ADAS
 SG_ DET_ELEVATION_ERR_316 : 416|6@1+ (0.00174533,0) [0|0.10995579] "rad"  ADAS
 SG_ DET_RCS_316 : 464|8@1+ (0.5,-64) [-64|63.5] "dBsm"  ADAS
 SG_ DET_BI_STATIC_FLAG_316 : 440|1@1+ (1,0) [0|1] ""  ADAS
 SG_ DET_SUPER_RES_TARGET_316 : 423|1@1+ (1,0) [0|1] ""  ADAS
 SG_ DET_SNR_316 : 456|8@1+ (0.35156,0) [0|89.6478] "dB"  ADAS
 SG_ DET_EXISTENCE_PROB_316 : 448|6@1+ (1.588,0) [0|100] "%"  ADAS
 SG_ DET_HVC_FLAG_316 : 422|1@1+ (1,0) [0|1] ""  ADAS
 SG_ DET_CONFD_AZIMUTH_316 : 454|2@1+ (1,0) [0|3] ""  ADAS
 SG_ DET_CONFD_ELEVATION_316 : 437|2@1+ (1,0) [0|3] ""  ADAS
 SG_ DET_MH_SCAN_INDEX_4LSB_313_316 : 476|4@1+ (1,0) [0|15] ""  ADAS
 SG_ DET_MH_CYCLE_COUNTER_313_316 : 16|8@1+ (1,0) [0|255] ""  ADAS
 SG_ DET_MH_CRC16_313_316 : 0|16@1+ (1,0) [0|65535] ""  ADAS
 SG_ DET_PROB_1STAZHYPO_316 : 439|1@1+ (1,0) [0|1] ""  ADAS
 SG_ DET_IDM_316 : 399|1@1+ (1,0) [0|1] ""  ADAS
 SG_ DET_MTD_316 : 383|1@1+ (1,0) [0|1] ""  ADAS
 SG_ DET_BELOW_RAIN_THOLD_316 : 375|1@1+ (1,0) [0|1] ""  ADAS

BO_ 1103 RDR_DETECTION_317_320: 64 RDR07
 SG_ DET_RANGE_317 : 24|15@1+ (0.015625,0) [0|500] "m"  ADAS
 SG_ DET_RANGE_ERR_317 : 40|7@1+ (0.0075,0) [0|0.9525] "m"  ADAS
 SG_ DET_RANGE_VELOCITY_317 : 48|15@1+ (0.0078125,-128) [-128|127.9921875] "m/s"  ADAS
 SG_ DET_RANGE_VELOCITY_ERR_317 : 64|8@1+ (0.003,0) [0|0.765] "m/s"  ADAS
 SG_ DET_AZIMUTH_317 : 88|13@1+ (0.0004,-1.5708) [-1.5708|1.5708] "rad"  ADAS
 SG_ DET_AZIMUTH_ERR_317 : 105|7@1+ (0.00087267,0) [0|0.11082909] "rad"  ADAS
 SG_ DET_ELEVATION_317 : 72|8@1+ (0.00275,-0.34925) [-0.34925|0.34925] "rad"  ADAS
 SG_ DET_ELEVATION_ERR_317 : 80|6@1+ (0.00174533,0) [0|0.10995579] "rad"  ADAS
 SG_ DET_RCS_317 : 128|8@1+ (0.5,-64) [-64|63.5] "dBsm"  ADAS
 SG_ DET_BI_STATIC_FLAG_317 : 104|1@1+ (1,0) [0|1] ""  ADAS
 SG_ DET_SUPER_RES_TARGET_317 : 87|1@1+ (1,0) [0|1] ""  ADAS
 SG_ DET_SNR_317 : 120|8@1+ (0.35156,0) [0|89.6478] "dB"  ADAS
 SG_ DET_EXISTENCE_PROB_317 : 112|6@1+ (1.588,0) [0|100] "%"  ADAS
 SG_ DET_HVC_FLAG_317 : 86|1@1+ (1,0) [0|1] ""  ADAS
 SG_ DET_CONFD_AZIMUTH_317 : 118|2@1+ (1,0) [0|3] ""  ADAS
 SG_ DET_CONFD_ELEVATION_317 : 101|2@1+ (1,0) [0|3] ""  ADAS
 SG_ DET_PROB_1STAZHYPO_317 : 103|1@1+ (1,0) [0|1] ""  ADAS
 SG_ DET_IDM_317 : 63|1@1+ (1,0) [0|1] ""  ADAS
 SG_ DET_MTD_317 : 47|1@1+ (1,0) [0|1] ""  ADAS
 SG_ DET_BELOW_RAIN_THOLD_317 : 39|1@1+ (1,0) [0|1] ""  ADAS
 SG_ DET_RANGE_318 : 136|15@1+ (0.015625,0) [0|500] "m"  ADAS
 SG_ DET_RANGE_ERR_318 : 152|7@1+ (0.0075,0) [0|0.9525] "m"  ADAS
 SG_ DET_RANGE_VELOCITY_318 : 160|15@1+ (0.0078125,-128) [-128|127.9921875] "m/s"  ADAS
 SG_ DET_RANGE_VELOCITY_ERR_318 : 176|8@1+ (0.003,0) [0|0.765] "m/s"  ADAS
 SG_ DET_AZIMUTH_318 : 200|13@1+ (0.0004,-1.5708) [-1.5708|1.5708] "rad"  ADAS
 SG_ DET_AZIMUTH_ERR_318 : 217|7@1+ (0.00087267,0) [0|0.11082909] "rad"  ADAS
 SG_ DET_ELEVATION_318 : 184|8@1+ (0.00275,-0.34925) [-0.34925|0.34925] "rad"  ADAS
 SG_ DET_ELEVATION_ERR_318 : 192|6@1+ (0.00174533,0) [0|0.10995579] "rad"  ADAS
 SG_ DET_RCS_318 : 240|8@1+ (0.5,-64) [-64|63.5] "dBsm"  ADAS
 SG_ DET_BI_STATIC_FLAG_318 : 216|1@1+ (1,0) [0|1] ""  ADAS
 SG_ DET_SUPER_RES_TARGET_318 : 199|1@1+ (1,0) [0|1] ""  ADAS
 SG_ DET_SNR_318 : 232|8@1+ (0.35156,0) [0|89.6478] "dB"  ADAS
 SG_ DET_EXISTENCE_PROB_318 : 224|6@1+ (1.588,0) [0|100] "%"  ADAS
 SG_ DET_HVC_FLAG_318 : 198|1@1+ (1,0) [0|1] ""  ADAS
 SG_ DET_CONFD_AZIMUTH_318 : 230|2@1+ (1,0) [0|3] ""  ADAS
 SG_ DET_CONFD_ELEVATION_318 : 213|2@1+ (1,0) [0|3] ""  ADAS
 SG_ DET_PROB_1STAZHYPO_318 : 215|1@1+ (1,0) [0|1] ""  ADAS
 SG_ DET_IDM_318 : 175|1@1+ (1,0) [0|1] ""  ADAS
 SG_ DET_MTD_318 : 159|1@1+ (1,0) [0|1] ""  ADAS
 SG_ DET_BELOW_RAIN_THOLD_318 : 151|1@1+ (1,0) [0|1] ""  ADAS
 SG_ DET_RANGE_319 : 248|15@1+ (0.015625,0) [0|500] "m"  ADAS
 SG_ DET_RANGE_ERR_319 : 264|7@1+ (0.0075,0) [0|0.9525] "m"  ADAS
 SG_ DET_RANGE_VELOCITY_319 : 272|15@1+ (0.0078125,-128) [-128|127.9921875] "m/s"  ADAS
 SG_ DET_RANGE_VELOCITY_ERR_319 : 288|8@1+ (0.003,0) [0|0.765] "m/s"  ADAS
 SG_ DET_AZIMUTH_319 : 312|13@1+ (0.0004,-1.5708) [-1.5708|1.5708] "rad"  ADAS
 SG_ DET_AZIMUTH_ERR_319 : 329|7@1+ (0.00087267,0) [0|0.11082909] "rad"  ADAS
 SG_ DET_ELEVATION_319 : 296|8@1+ (0.00275,-0.34925) [-0.34925|0.34925] "rad"  ADAS
 SG_ DET_ELEVATION_ERR_319 : 304|6@1+ (0.00174533,0) [0|0.10995579] "rad"  ADAS
 SG_ DET_RCS_319 : 352|8@1+ (0.5,-64) [-64|63.5] "dBsm"  ADAS
 SG_ DET_BI_STATIC_FLAG_319 : 328|1@1+ (1,0) [0|1] ""  ADAS
 SG_ DET_SUPER_RES_TARGET_319 : 311|1@1+ (1,0) [0|1] ""  ADAS
 SG_ DET_SNR_319 : 344|8@1+ (0.35156,0) [0|89.6478] "dB"  ADAS
 SG_ DET_EXISTENCE_PROB_319 : 336|6@1+ (1.588,0) [0|100] "%"  ADAS
 SG_ DET_HVC_FLAG_319 : 310|1@1+ (1,0) [0|1] ""  ADAS
 SG_ DET_CONFD_AZIMUTH_319 : 342|2@1+ (1,0) [0|3] ""  ADAS
 SG_ DET_CONFD_ELEVATION_319 : 325|2@1+ (1,0) [0|3] ""  ADAS
 SG_ DET_PROB_1STAZHYPO_319 : 327|1@1+ (1,0) [0|1] ""  ADAS
 SG_ DET_IDM_319 : 287|1@1+ (1,0) [0|1] ""  ADAS
 SG_ DET_MTD_319 : 271|1@1+ (1,0) [0|1] ""  ADAS
 SG_ DET_BELOW_RAIN_THOLD_319 : 263|1@1+ (1,0) [0|1] ""  ADAS
 SG_ DET_RANGE_320 : 360|15@1+ (0.015625,0) [0|500] "m"  ADAS
 SG_ DET_RANGE_ERR_320 : 376|7@1+ (0.0075,0) [0|0.9525] "m"  ADAS
 SG_ DET_RANGE_VELOCITY_320 : 384|15@1+ (0.0078125,-128) [-128|127.9921875] "m/s"  ADAS
 SG_ DET_RANGE_VELOCITY_ERR_320 : 400|8@1+ (0.003,0) [0|0.765] "m/s"  ADAS
 SG_ DET_AZIMUTH_320 : 424|13@1+ (0.0004,-1.5708) [-1.5708|1.5708] "rad"  ADAS
 SG_ DET_AZIMUTH_ERR_320 : 441|7@1+ (0.00087267,0) [0|0.11082909] "rad"  ADAS
 SG_ DET_ELEVATION_320 : 408|8@1+ (0.00275,-0.34925) [-0.34925|0.34925] "rad"  ADAS
 SG_ DET_ELEVATION_ERR_320 : 416|6@1+ (0.00174533,0) [0|0.10995579] "rad"  ADAS
 SG_ DET_RCS_320 : 464|8@1+ (0.5,-64) [-64|63.5] "dBsm"  ADAS
 SG_ DET_BI_STATIC_FLAG_320 : 440|1@1+ (1,0) [0|1] ""  ADAS
 SG_ DET_SUPER_RES_TARGET_320 : 423|1@1+ (1,0) [0|1] ""  ADAS
 SG_ DET_SNR_320 : 456|8@1+ (0.35156,0) [0|89.6478] "dB"  ADAS
 SG_ DET_EXISTENCE_PROB_320 : 448|6@1+ (1.588,0) [0|100] "%"  ADAS
 SG_ DET_HVC_FLAG_320 : 422|1@1+ (1,0) [0|1] ""  ADAS
 SG_ DET_CONFD_AZIMUTH_320 : 454|2@1+ (1,0) [0|3] ""  ADAS
 SG_ DET_CONFD_ELEVATION_320 : 437|2@1+ (1,0) [0|3] ""  ADAS
 SG_ DET_MH_SCAN_INDEX_4LSB_317_320 : 476|4@1+ (1,0) [0|15] ""  ADAS
 SG_ DET_MH_CYCLE_COUNTER_317_320 : 16|8@1+ (1,0) [0|255] ""  ADAS
 SG_ DET_MH_CRC16_317_320 : 0|16@1+ (1,0) [0|65535] ""  ADAS
 SG_ DET_PROB_1STAZHYPO_320 : 439|1@1+ (1,0) [0|1] ""  ADAS
 SG_ DET_IDM_320 : 399|1@1+ (1,0) [0|1] ""  ADAS
 SG_ DET_MTD_320 : 383|1@1+ (1,0) [0|1] ""  ADAS
 SG_ DET_BELOW_RAIN_THOLD_320 : 375|1@1+ (1,0) [0|1] ""  ADAS

BO_ 1104 RDR_DETECTION_321_324: 64 RDR07
 SG_ DET_RANGE_321 : 24|15@1+ (0.015625,0) [0|500] "m"  ADAS
 SG_ DET_RANGE_ERR_321 : 40|7@1+ (0.0075,0) [0|0.9525] "m"  ADAS
 SG_ DET_RANGE_VELOCITY_321 : 48|15@1+ (0.0078125,-128) [-128|127.9921875] "m/s"  ADAS
 SG_ DET_RANGE_VELOCITY_ERR_321 : 64|8@1+ (0.003,0) [0|0.765] "m/s"  ADAS
 SG_ DET_AZIMUTH_321 : 88|13@1+ (0.0004,-1.5708) [-1.5708|1.5708] "rad"  ADAS
 SG_ DET_AZIMUTH_ERR_321 : 105|7@1+ (0.00087267,0) [0|0.11082909] "rad"  ADAS
 SG_ DET_ELEVATION_321 : 72|8@1+ (0.00275,-0.34925) [-0.34925|0.34925] "rad"  ADAS
 SG_ DET_ELEVATION_ERR_321 : 80|6@1+ (0.00174533,0) [0|0.10995579] "rad"  ADAS
 SG_ DET_RCS_321 : 128|8@1+ (0.5,-64) [-64|63.5] "dBsm"  ADAS
 SG_ DET_BI_STATIC_FLAG_321 : 104|1@1+ (1,0) [0|1] ""  ADAS
 SG_ DET_SUPER_RES_TARGET_321 : 87|1@1+ (1,0) [0|1] ""  ADAS
 SG_ DET_SNR_321 : 120|8@1+ (0.35156,0) [0|89.6478] "dB"  ADAS
 SG_ DET_EXISTENCE_PROB_321 : 112|6@1+ (1.588,0) [0|100] "%"  ADAS
 SG_ DET_HVC_FLAG_321 : 86|1@1+ (1,0) [0|1] ""  ADAS
 SG_ DET_CONFD_AZIMUTH_321 : 118|2@1+ (1,0) [0|3] ""  ADAS
 SG_ DET_CONFD_ELEVATION_321 : 101|2@1+ (1,0) [0|3] ""  ADAS
 SG_ DET_PROB_1STAZHYPO_321 : 103|1@1+ (1,0) [0|1] ""  ADAS
 SG_ DET_IDM_321 : 63|1@1+ (1,0) [0|1] ""  ADAS
 SG_ DET_MTD_321 : 47|1@1+ (1,0) [0|1] ""  ADAS
 SG_ DET_BELOW_RAIN_THOLD_321 : 39|1@1+ (1,0) [0|1] ""  ADAS
 SG_ DET_RANGE_322 : 136|15@1+ (0.015625,0) [0|500] "m"  ADAS
 SG_ DET_RANGE_ERR_322 : 152|7@1+ (0.0075,0) [0|0.9525] "m"  ADAS
 SG_ DET_RANGE_VELOCITY_322 : 160|15@1+ (0.0078125,-128) [-128|127.9921875] "m/s"  ADAS
 SG_ DET_RANGE_VELOCITY_ERR_322 : 176|8@1+ (0.003,0) [0|0.765] "m/s"  ADAS
 SG_ DET_AZIMUTH_322 : 200|13@1+ (0.0004,-1.5708) [-1.5708|1.5708] "rad"  ADAS
 SG_ DET_AZIMUTH_ERR_322 : 217|7@1+ (0.00087267,0) [0|0.11082909] "rad"  ADAS
 SG_ DET_ELEVATION_322 : 184|8@1+ (0.00275,-0.34925) [-0.34925|0.34925] "rad"  ADAS
 SG_ DET_ELEVATION_ERR_322 : 192|6@1+ (0.00174533,0) [0|0.10995579] "rad"  ADAS
 SG_ DET_RCS_322 : 240|8@1+ (0.5,-64) [-64|63.5] "dBsm"  ADAS
 SG_ DET_BI_STATIC_FLAG_322 : 216|1@1+ (1,0) [0|1] ""  ADAS
 SG_ DET_SUPER_RES_TARGET_322 : 199|1@1+ (1,0) [0|1] ""  ADAS
 SG_ DET_SNR_322 : 232|8@1+ (0.35156,0) [0|89.6478] "dB"  ADAS
 SG_ DET_EXISTENCE_PROB_322 : 224|6@1+ (1.588,0) [0|100] "%"  ADAS
 SG_ DET_HVC_FLAG_322 : 198|1@1+ (1,0) [0|1] ""  ADAS
 SG_ DET_CONFD_AZIMUTH_322 : 230|2@1+ (1,0) [0|3] ""  ADAS
 SG_ DET_CONFD_ELEVATION_322 : 213|2@1+ (1,0) [0|3] ""  ADAS
 SG_ DET_PROB_1STAZHYPO_322 : 215|1@1+ (1,0) [0|1] ""  ADAS
 SG_ DET_IDM_322 : 175|1@1+ (1,0) [0|1] ""  ADAS
 SG_ DET_MTD_322 : 159|1@1+ (1,0) [0|1] ""  ADAS
 SG_ DET_BELOW_RAIN_THOLD_322 : 151|1@1+ (1,0) [0|1] ""  ADAS
 SG_ DET_RANGE_323 : 248|15@1+ (0.015625,0) [0|500] "m"  ADAS
 SG_ DET_RANGE_ERR_323 : 264|7@1+ (0.0075,0) [0|0.9525] "m"  ADAS
 SG_ DET_RANGE_VELOCITY_323 : 272|15@1+ (0.0078125,-128) [-128|127.9921875] "m/s"  ADAS
 SG_ DET_RANGE_VELOCITY_ERR_323 : 288|8@1+ (0.003,0) [0|0.765] "m/s"  ADAS
 SG_ DET_AZIMUTH_323 : 312|13@1+ (0.0004,-1.5708) [-1.5708|1.5708] "rad"  ADAS
 SG_ DET_AZIMUTH_ERR_323 : 329|7@1+ (0.00087267,0) [0|0.11082909] "rad"  ADAS
 SG_ DET_ELEVATION_323 : 296|8@1+ (0.00275,-0.34925) [-0.34925|0.34925] "rad"  ADAS
 SG_ DET_ELEVATION_ERR_323 : 304|6@1+ (0.00174533,0) [0|0.10995579] "rad"  ADAS
 SG_ DET_RCS_323 : 352|8@1+ (0.5,-64) [-64|63.5] "dBsm"  ADAS
 SG_ DET_BI_STATIC_FLAG_323 : 328|1@1+ (1,0) [0|1] ""  ADAS
 SG_ DET_SUPER_RES_TARGET_323 : 311|1@1+ (1,0) [0|1] ""  ADAS
 SG_ DET_SNR_323 : 344|8@1+ (0.35156,0) [0|89.6478] "dB"  ADAS
 SG_ DET_EXISTENCE_PROB_323 : 336|6@1+ (1.588,0) [0|100] "%"  ADAS
 SG_ DET_HVC_FLAG_323 : 310|1@1+ (1,0) [0|1] ""  ADAS
 SG_ DET_CONFD_AZIMUTH_323 : 342|2@1+ (1,0) [0|3] ""  ADAS
 SG_ DET_CONFD_ELEVATION_323 : 325|2@1+ (1,0) [0|3] ""  ADAS
 SG_ DET_PROB_1STAZHYPO_323 : 327|1@1+ (1,0) [0|1] ""  ADAS
 SG_ DET_IDM_323 : 287|1@1+ (1,0) [0|1] ""  ADAS
 SG_ DET_MTD_323 : 271|1@1+ (1,0) [0|1] ""  ADAS
 SG_ DET_BELOW_RAIN_THOLD_323 : 263|1@1+ (1,0) [0|1] ""  ADAS
 SG_ DET_RANGE_324 : 360|15@1+ (0.015625,0) [0|500] "m"  ADAS
 SG_ DET_RANGE_ERR_324 : 376|7@1+ (0.0075,0) [0|0.9525] "m"  ADAS
 SG_ DET_RANGE_VELOCITY_324 : 384|15@1+ (0.0078125,-128) [-128|127.9921875] "m/s"  ADAS
 SG_ DET_RANGE_VELOCITY_ERR_324 : 400|8@1+ (0.003,0) [0|0.765] "m/s"  ADAS
 SG_ DET_AZIMUTH_324 : 424|13@1+ (0.0004,-1.5708) [-1.5708|1.5708] "rad"  ADAS
 SG_ DET_AZIMUTH_ERR_324 : 441|7@1+ (0.00087267,0) [0|0.11082909] "rad"  ADAS
 SG_ DET_ELEVATION_324 : 408|8@1+ (0.00275,-0.34925) [-0.34925|0.34925] "rad"  ADAS
 SG_ DET_ELEVATION_ERR_324 : 416|6@1+ (0.00174533,0) [0|0.10995579] "rad"  ADAS
 SG_ DET_RCS_324 : 464|8@1+ (0.5,-64) [-64|63.5] "dBsm"  ADAS
 SG_ DET_BI_STATIC_FLAG_324 : 440|1@1+ (1,0) [0|1] ""  ADAS
 SG_ DET_SUPER_RES_TARGET_324 : 423|1@1+ (1,0) [0|1] ""  ADAS
 SG_ DET_SNR_324 : 456|8@1+ (0.35156,0) [0|89.6478] "dB"  ADAS
 SG_ DET_EXISTENCE_PROB_324 : 448|6@1+ (1.588,0) [0|100] "%"  ADAS
 SG_ DET_HVC_FLAG_324 : 422|1@1+ (1,0) [0|1] ""  ADAS
 SG_ DET_CONFD_AZIMUTH_324 : 454|2@1+ (1,0) [0|3] ""  ADAS
 SG_ DET_CONFD_ELEVATION_324 : 437|2@1+ (1,0) [0|3] ""  ADAS
 SG_ DET_MH_SCAN_INDEX_4LSB_321_324 : 476|4@1+ (1,0) [0|15] ""  ADAS
 SG_ DET_MH_CYCLE_COUNTER_321_324 : 16|8@1+ (1,0) [0|255] ""  ADAS
 SG_ DET_MH_CRC16_321_324 : 0|16@1+ (1,0) [0|65535] ""  ADAS
 SG_ DET_PROB_1STAZHYPO_324 : 439|1@1+ (1,0) [0|1] ""  ADAS
 SG_ DET_IDM_324 : 399|1@1+ (1,0) [0|1] ""  ADAS
 SG_ DET_MTD_324 : 383|1@1+ (1,0) [0|1] ""  ADAS
 SG_ DET_BELOW_RAIN_THOLD_324 : 375|1@1+ (1,0) [0|1] ""  ADAS

BO_ 1105 RDR_DETECTION_325_328: 64 RDR07
 SG_ DET_RANGE_325 : 24|15@1+ (0.015625,0) [0|500] "m"  ADAS
 SG_ DET_RANGE_ERR_325 : 40|7@1+ (0.0075,0) [0|0.9525] "m"  ADAS
 SG_ DET_RANGE_VELOCITY_325 : 48|15@1+ (0.0078125,-128) [-128|127.9921875] "m/s"  ADAS
 SG_ DET_RANGE_VELOCITY_ERR_325 : 64|8@1+ (0.003,0) [0|0.765] "m/s"  ADAS
 SG_ DET_AZIMUTH_325 : 88|13@1+ (0.0004,-1.5708) [-1.5708|1.5708] "rad"  ADAS
 SG_ DET_AZIMUTH_ERR_325 : 105|7@1+ (0.00087267,0) [0|0.11082909] "rad"  ADAS
 SG_ DET_ELEVATION_325 : 72|8@1+ (0.00275,-0.34925) [-0.34925|0.34925] "rad"  ADAS
 SG_ DET_ELEVATION_ERR_325 : 80|6@1+ (0.00174533,0) [0|0.10995579] "rad"  ADAS
 SG_ DET_RCS_325 : 128|8@1+ (0.5,-64) [-64|63.5] "dBsm"  ADAS
 SG_ DET_BI_STATIC_FLAG_325 : 104|1@1+ (1,0) [0|1] ""  ADAS
 SG_ DET_SUPER_RES_TARGET_325 : 87|1@1+ (1,0) [0|1] ""  ADAS
 SG_ DET_SNR_325 : 120|8@1+ (0.35156,0) [0|89.6478] "dB"  ADAS
 SG_ DET_EXISTENCE_PROB_325 : 112|6@1+ (1.588,0) [0|100] "%"  ADAS
 SG_ DET_HVC_FLAG_325 : 86|1@1+ (1,0) [0|1] ""  ADAS
 SG_ DET_CONFD_AZIMUTH_325 : 118|2@1+ (1,0) [0|3] ""  ADAS
 SG_ DET_CONFD_ELEVATION_325 : 101|2@1+ (1,0) [0|3] ""  ADAS
 SG_ DET_PROB_1STAZHYPO_325 : 103|1@1+ (1,0) [0|1] ""  ADAS
 SG_ DET_IDM_325 : 63|1@1+ (1,0) [0|1] ""  ADAS
 SG_ DET_MTD_325 : 47|1@1+ (1,0) [0|1] ""  ADAS
 SG_ DET_BELOW_RAIN_THOLD_325 : 39|1@1+ (1,0) [0|1] ""  ADAS
 SG_ DET_RANGE_326 : 136|15@1+ (0.015625,0) [0|500] "m"  ADAS
 SG_ DET_RANGE_ERR_326 : 152|7@1+ (0.0075,0) [0|0.9525] "m"  ADAS
 SG_ DET_RANGE_VELOCITY_326 : 160|15@1+ (0.0078125,-128) [-128|127.9921875] "m/s"  ADAS
 SG_ DET_RANGE_VELOCITY_ERR_326 : 176|8@1+ (0.003,0) [0|0.765] "m/s"  ADAS
 SG_ DET_AZIMUTH_326 : 200|13@1+ (0.0004,-1.5708) [-1.5708|1.5708] "rad"  ADAS
 SG_ DET_AZIMUTH_ERR_326 : 217|7@1+ (0.00087267,0) [0|0.11082909] "rad"  ADAS
 SG_ DET_ELEVATION_326 : 184|8@1+ (0.00275,-0.34925) [-0.34925|0.34925] "rad"  ADAS
 SG_ DET_ELEVATION_ERR_326 : 192|6@1+ (0.00174533,0) [0|0.10995579] "rad"  ADAS
 SG_ DET_RCS_326 : 240|8@1+ (0.5,-64) [-64|63.5] "dBsm"  ADAS
 SG_ DET_BI_STATIC_FLAG_326 : 216|1@1+ (1,0) [0|1] ""  ADAS
 SG_ DET_SUPER_RES_TARGET_326 : 199|1@1+ (1,0) [0|1] ""  ADAS
 SG_ DET_SNR_326 : 232|8@1+ (0.35156,0) [0|89.6478] "dB"  ADAS
 SG_ DET_EXISTENCE_PROB_326 : 224|6@1+ (1.588,0) [0|100] "%"  ADAS
 SG_ DET_HVC_FLAG_326 : 198|1@1+ (1,0) [0|1] ""  ADAS
 SG_ DET_CONFD_AZIMUTH_326 : 230|2@1+ (1,0) [0|3] ""  ADAS
 SG_ DET_CONFD_ELEVATION_326 : 213|2@1+ (1,0) [0|3] ""  ADAS
 SG_ DET_PROB_1STAZHYPO_326 : 215|1@1+ (1,0) [0|1] ""  ADAS
 SG_ DET_IDM_326 : 175|1@1+ (1,0) [0|1] ""  ADAS
 SG_ DET_MTD_326 : 159|1@1+ (1,0) [0|1] ""  ADAS
 SG_ DET_BELOW_RAIN_THOLD_326 : 151|1@1+ (1,0) [0|1] ""  ADAS
 SG_ DET_RANGE_327 : 248|15@1+ (0.015625,0) [0|500] "m"  ADAS
 SG_ DET_RANGE_ERR_327 : 264|7@1+ (0.0075,0) [0|0.9525] "m"  ADAS
 SG_ DET_RANGE_VELOCITY_327 : 272|15@1+ (0.0078125,-128) [-128|127.9921875] "m/s"  ADAS
 SG_ DET_RANGE_VELOCITY_ERR_327 : 288|8@1+ (0.003,0) [0|0.765] "m/s"  ADAS
 SG_ DET_AZIMUTH_327 : 312|13@1+ (0.0004,-1.5708) [-1.5708|1.5708] "rad"  ADAS
 SG_ DET_AZIMUTH_ERR_327 : 329|7@1+ (0.00087267,0) [0|0.11082909] "rad"  ADAS
 SG_ DET_ELEVATION_327 : 296|8@1+ (0.00275,-0.34925) [-0.34925|0.34925] "rad"  ADAS
 SG_ DET_ELEVATION_ERR_327 : 304|6@1+ (0.00174533,0) [0|0.10995579] "rad"  ADAS
 SG_ DET_RCS_327 : 352|8@1+ (0.5,-64) [-64|63.5] "dBsm"  ADAS
 SG_ DET_BI_STATIC_FLAG_327 : 328|1@1+ (1,0) [0|1] ""  ADAS
 SG_ DET_SUPER_RES_TARGET_327 : 311|1@1+ (1,0) [0|1] ""  ADAS
 SG_ DET_SNR_327 : 344|8@1+ (0.35156,0) [0|89.6478] "dB"  ADAS
 SG_ DET_EXISTENCE_PROB_327 : 336|6@1+ (1.588,0) [0|100] "%"  ADAS
 SG_ DET_HVC_FLAG_327 : 310|1@1+ (1,0) [0|1] ""  ADAS
 SG_ DET_CONFD_AZIMUTH_327 : 342|2@1+ (1,0) [0|3] ""  ADAS
 SG_ DET_CONFD_ELEVATION_327 : 325|2@1+ (1,0) [0|3] ""  ADAS
 SG_ DET_PROB_1STAZHYPO_327 : 327|1@1+ (1,0) [0|1] ""  ADAS
 SG_ DET_IDM_327 : 287|1@1+ (1,0) [0|1] ""  ADAS
 SG_ DET_MTD_327 : 271|1@1+ (1,0) [0|1] ""  ADAS
 SG_ DET_BELOW_RAIN_THOLD_327 : 263|1@1+ (1,0) [0|1] ""  ADAS
 SG_ DET_RANGE_328 : 360|15@1+ (0.015625,0) [0|500] "m"  ADAS
 SG_ DET_RANGE_ERR_328 : 376|7@1+ (0.0075,0) [0|0.9525] "m"  ADAS
 SG_ DET_RANGE_VELOCITY_328 : 384|15@1+ (0.0078125,-128) [-128|127.9921875] "m/s"  ADAS
 SG_ DET_RANGE_VELOCITY_ERR_328 : 400|8@1+ (0.003,0) [0|0.765] "m/s"  ADAS
 SG_ DET_AZIMUTH_328 : 424|13@1+ (0.0004,-1.5708) [-1.5708|1.5708] "rad"  ADAS
 SG_ DET_AZIMUTH_ERR_328 : 441|7@1+ (0.00087267,0) [0|0.11082909] "rad"  ADAS
 SG_ DET_ELEVATION_328 : 408|8@1+ (0.00275,-0.34925) [-0.34925|0.34925] "rad"  ADAS
 SG_ DET_ELEVATION_ERR_328 : 416|6@1+ (0.00174533,0) [0|0.10995579] "rad"  ADAS
 SG_ DET_RCS_328 : 464|8@1+ (0.5,-64) [-64|63.5] "dBsm"  ADAS
 SG_ DET_BI_STATIC_FLAG_328 : 440|1@1+ (1,0) [0|1] ""  ADAS
 SG_ DET_SUPER_RES_TARGET_328 : 423|1@1+ (1,0) [0|1] ""  ADAS
 SG_ DET_SNR_328 : 456|8@1+ (0.35156,0) [0|89.6478] "dB"  ADAS
 SG_ DET_EXISTENCE_PROB_328 : 448|6@1+ (1.588,0) [0|100] "%"  ADAS
 SG_ DET_HVC_FLAG_328 : 422|1@1+ (1,0) [0|1] ""  ADAS
 SG_ DET_CONFD_AZIMUTH_328 : 454|2@1+ (1,0) [0|3] ""  ADAS
 SG_ DET_CONFD_ELEVATION_328 : 437|2@1+ (1,0) [0|3] ""  ADAS
 SG_ DET_MH_SCAN_INDEX_4LSB_325_328 : 476|4@1+ (1,0) [0|15] ""  ADAS
 SG_ DET_MH_CYCLE_COUNTER_325_328 : 16|8@1+ (1,0) [0|255] ""  ADAS
 SG_ DET_MH_CRC16_325_328 : 0|16@1+ (1,0) [0|65535] ""  ADAS
 SG_ DET_PROB_1STAZHYPO_328 : 439|1@1+ (1,0) [0|1] ""  ADAS
 SG_ DET_IDM_328 : 399|1@1+ (1,0) [0|1] ""  ADAS
 SG_ DET_MTD_328 : 383|1@1+ (1,0) [0|1] ""  ADAS
 SG_ DET_BELOW_RAIN_THOLD_328 : 375|1@1+ (1,0) [0|1] ""  ADAS

BO_ 1106 RDR_DETECTION_329_332: 64 RDR07
 SG_ DET_RANGE_329 : 24|15@1+ (0.015625,0) [0|500] "m"  ADAS
 SG_ DET_RANGE_ERR_329 : 40|7@1+ (0.0075,0) [0|0.9525] "m"  ADAS
 SG_ DET_RANGE_VELOCITY_329 : 48|15@1+ (0.0078125,-128) [-128|127.9921875] "m/s"  ADAS
 SG_ DET_RANGE_VELOCITY_ERR_329 : 64|8@1+ (0.003,0) [0|0.765] "m/s"  ADAS
 SG_ DET_AZIMUTH_329 : 88|13@1+ (0.0004,-1.5708) [-1.5708|1.5708] "rad"  ADAS
 SG_ DET_AZIMUTH_ERR_329 : 105|7@1+ (0.00087267,0) [0|0.11082909] "rad"  ADAS
 SG_ DET_ELEVATION_329 : 72|8@1+ (0.00275,-0.34925) [-0.34925|0.34925] "rad"  ADAS
 SG_ DET_ELEVATION_ERR_329 : 80|6@1+ (0.00174533,0) [0|0.10995579] "rad"  ADAS
 SG_ DET_RCS_329 : 128|8@1+ (0.5,-64) [-64|63.5] "dBsm"  ADAS
 SG_ DET_BI_STATIC_FLAG_329 : 104|1@1+ (1,0) [0|1] ""  ADAS
 SG_ DET_SUPER_RES_TARGET_329 : 87|1@1+ (1,0) [0|1] ""  ADAS
 SG_ DET_SNR_329 : 120|8@1+ (0.35156,0) [0|89.6478] "dB"  ADAS
 SG_ DET_EXISTENCE_PROB_329 : 112|6@1+ (1.588,0) [0|100] "%"  ADAS
 SG_ DET_HVC_FLAG_329 : 86|1@1+ (1,0) [0|1] ""  ADAS
 SG_ DET_CONFD_AZIMUTH_329 : 118|2@1+ (1,0) [0|3] ""  ADAS
 SG_ DET_CONFD_ELEVATION_329 : 101|2@1+ (1,0) [0|3] ""  ADAS
 SG_ DET_PROB_1STAZHYPO_329 : 103|1@1+ (1,0) [0|1] ""  ADAS
 SG_ DET_IDM_329 : 63|1@1+ (1,0) [0|1] ""  ADAS
 SG_ DET_MTD_329 : 47|1@1+ (1,0) [0|1] ""  ADAS
 SG_ DET_BELOW_RAIN_THOLD_329 : 39|1@1+ (1,0) [0|1] ""  ADAS
 SG_ DET_RANGE_330 : 136|15@1+ (0.015625,0) [0|500] "m"  ADAS
 SG_ DET_RANGE_ERR_330 : 152|7@1+ (0.0075,0) [0|0.9525] "m"  ADAS
 SG_ DET_RANGE_VELOCITY_330 : 160|15@1+ (0.0078125,-128) [-128|127.9921875] "m/s"  ADAS
 SG_ DET_RANGE_VELOCITY_ERR_330 : 176|8@1+ (0.003,0) [0|0.765] "m/s"  ADAS
 SG_ DET_AZIMUTH_330 : 200|13@1+ (0.0004,-1.5708) [-1.5708|1.5708] "rad"  ADAS
 SG_ DET_AZIMUTH_ERR_330 : 217|7@1+ (0.00087267,0) [0|0.11082909] "rad"  ADAS
 SG_ DET_ELEVATION_330 : 184|8@1+ (0.00275,-0.34925) [-0.34925|0.34925] "rad"  ADAS
 SG_ DET_ELEVATION_ERR_330 : 192|6@1+ (0.00174533,0) [0|0.10995579] "rad"  ADAS
 SG_ DET_RCS_330 : 240|8@1+ (0.5,-64) [-64|63.5] "dBsm"  ADAS
 SG_ DET_BI_STATIC_FLAG_330 : 216|1@1+ (1,0) [0|1] ""  ADAS
 SG_ DET_SUPER_RES_TARGET_330 : 199|1@1+ (1,0) [0|1] ""  ADAS
 SG_ DET_SNR_330 : 232|8@1+ (0.35156,0) [0|89.6478] "dB"  ADAS
 SG_ DET_EXISTENCE_PROB_330 : 224|6@1+ (1.588,0) [0|100] "%"  ADAS
 SG_ DET_HVC_FLAG_330 : 198|1@1+ (1,0) [0|1] ""  ADAS
 SG_ DET_CONFD_AZIMUTH_330 : 230|2@1+ (1,0) [0|3] ""  ADAS
 SG_ DET_CONFD_ELEVATION_330 : 213|2@1+ (1,0) [0|3] ""  ADAS
 SG_ DET_PROB_1STAZHYPO_330 : 215|1@1+ (1,0) [0|1] ""  ADAS
 SG_ DET_IDM_330 : 175|1@1+ (1,0) [0|1] ""  ADAS
 SG_ DET_MTD_330 : 159|1@1+ (1,0) [0|1] ""  ADAS
 SG_ DET_BELOW_RAIN_THOLD_330 : 151|1@1+ (1,0) [0|1] ""  ADAS
 SG_ DET_RANGE_331 : 248|15@1+ (0.015625,0) [0|500] "m"  ADAS
 SG_ DET_RANGE_ERR_331 : 264|7@1+ (0.0075,0) [0|0.9525] "m"  ADAS
 SG_ DET_RANGE_VELOCITY_331 : 272|15@1+ (0.0078125,-128) [-128|127.9921875] "m/s"  ADAS
 SG_ DET_RANGE_VELOCITY_ERR_331 : 288|8@1+ (0.003,0) [0|0.765] "m/s"  ADAS
 SG_ DET_AZIMUTH_331 : 312|13@1+ (0.0004,-1.5708) [-1.5708|1.5708] "rad"  ADAS
 SG_ DET_AZIMUTH_ERR_331 : 329|7@1+ (0.00087267,0) [0|0.11082909] "rad"  ADAS
 SG_ DET_ELEVATION_331 : 296|8@1+ (0.00275,-0.34925) [-0.34925|0.34925] "rad"  ADAS
 SG_ DET_ELEVATION_ERR_331 : 304|6@1+ (0.00174533,0) [0|0.10995579] "rad"  ADAS
 SG_ DET_RCS_331 : 352|8@1+ (0.5,-64) [-64|63.5] "dBsm"  ADAS
 SG_ DET_BI_STATIC_FLAG_331 : 328|1@1+ (1,0) [0|1] ""  ADAS
 SG_ DET_SUPER_RES_TARGET_331 : 311|1@1+ (1,0) [0|1] ""  ADAS
 SG_ DET_SNR_331 : 344|8@1+ (0.35156,0) [0|89.6478] "dB"  ADAS
 SG_ DET_EXISTENCE_PROB_331 : 336|6@1+ (1.588,0) [0|100] "%"  ADAS
 SG_ DET_HVC_FLAG_331 : 310|1@1+ (1,0) [0|1] ""  ADAS
 SG_ DET_CONFD_AZIMUTH_331 : 342|2@1+ (1,0) [0|3] ""  ADAS
 SG_ DET_CONFD_ELEVATION_331 : 325|2@1+ (1,0) [0|3] ""  ADAS
 SG_ DET_PROB_1STAZHYPO_331 : 327|1@1+ (1,0) [0|1] ""  ADAS
 SG_ DET_IDM_331 : 287|1@1+ (1,0) [0|1] ""  ADAS
 SG_ DET_MTD_331 : 271|1@1+ (1,0) [0|1] ""  ADAS
 SG_ DET_BELOW_RAIN_THOLD_331 : 263|1@1+ (1,0) [0|1] ""  ADAS
 SG_ DET_RANGE_332 : 360|15@1+ (0.015625,0) [0|500] "m"  ADAS
 SG_ DET_RANGE_ERR_332 : 376|7@1+ (0.0075,0) [0|0.9525] "m"  ADAS
 SG_ DET_RANGE_VELOCITY_332 : 384|15@1+ (0.0078125,-128) [-128|127.9921875] "m/s"  ADAS
 SG_ DET_RANGE_VELOCITY_ERR_332 : 400|8@1+ (0.003,0) [0|0.765] "m/s"  ADAS
 SG_ DET_AZIMUTH_332 : 424|13@1+ (0.0004,-1.5708) [-1.5708|1.5708] "rad"  ADAS
 SG_ DET_AZIMUTH_ERR_332 : 441|7@1+ (0.00087267,0) [0|0.11082909] "rad"  ADAS
 SG_ DET_ELEVATION_332 : 408|8@1+ (0.00275,-0.34925) [-0.34925|0.34925] "rad"  ADAS
 SG_ DET_ELEVATION_ERR_332 : 416|6@1+ (0.00174533,0) [0|0.10995579] "rad"  ADAS
 SG_ DET_RCS_332 : 464|8@1+ (0.5,-64) [-64|63.5] "dBsm"  ADAS
 SG_ DET_BI_STATIC_FLAG_332 : 440|1@1+ (1,0) [0|1] ""  ADAS
 SG_ DET_SUPER_RES_TARGET_332 : 423|1@1+ (1,0) [0|1] ""  ADAS
 SG_ DET_SNR_332 : 456|8@1+ (0.35156,0) [0|89.6478] "dB"  ADAS
 SG_ DET_EXISTENCE_PROB_332 : 448|6@1+ (1.588,0) [0|100] "%"  ADAS
 SG_ DET_HVC_FLAG_332 : 422|1@1+ (1,0) [0|1] ""  ADAS
 SG_ DET_CONFD_AZIMUTH_332 : 454|2@1+ (1,0) [0|3] ""  ADAS
 SG_ DET_CONFD_ELEVATION_332 : 437|2@1+ (1,0) [0|3] ""  ADAS
 SG_ DET_MH_SCAN_INDEX_4LSB_329_332 : 476|4@1+ (1,0) [0|15] ""  ADAS
 SG_ DET_MH_CYCLE_COUNTER_329_332 : 16|8@1+ (1,0) [0|255] ""  ADAS
 SG_ DET_MH_CRC16_329_332 : 0|16@1+ (1,0) [0|65535] ""  ADAS
 SG_ DET_PROB_1STAZHYPO_332 : 439|1@1+ (1,0) [0|1] ""  ADAS
 SG_ DET_IDM_332 : 399|1@1+ (1,0) [0|1] ""  ADAS
 SG_ DET_MTD_332 : 383|1@1+ (1,0) [0|1] ""  ADAS
 SG_ DET_BELOW_RAIN_THOLD_332 : 375|1@1+ (1,0) [0|1] ""  ADAS

BO_ 1107 RDR_DETECTION_333_336: 64 RDR07
 SG_ DET_RANGE_333 : 24|15@1+ (0.015625,0) [0|500] "m"  ADAS
 SG_ DET_RANGE_ERR_333 : 40|7@1+ (0.0075,0) [0|0.9525] "m"  ADAS
 SG_ DET_RANGE_VELOCITY_333 : 48|15@1+ (0.0078125,-128) [-128|127.9921875] "m/s"  ADAS
 SG_ DET_RANGE_VELOCITY_ERR_333 : 64|8@1+ (0.003,0) [0|0.765] "m/s"  ADAS
 SG_ DET_AZIMUTH_333 : 88|13@1+ (0.0004,-1.5708) [-1.5708|1.5708] "rad"  ADAS
 SG_ DET_AZIMUTH_ERR_333 : 105|7@1+ (0.00087267,0) [0|0.11082909] "rad"  ADAS
 SG_ DET_ELEVATION_333 : 72|8@1+ (0.00275,-0.34925) [-0.34925|0.34925] "rad"  ADAS
 SG_ DET_ELEVATION_ERR_333 : 80|6@1+ (0.00174533,0) [0|0.10995579] "rad"  ADAS
 SG_ DET_RCS_333 : 128|8@1+ (0.5,-64) [-64|63.5] "dBsm"  ADAS
 SG_ DET_BI_STATIC_FLAG_333 : 104|1@1+ (1,0) [0|1] ""  ADAS
 SG_ DET_SUPER_RES_TARGET_333 : 87|1@1+ (1,0) [0|1] ""  ADAS
 SG_ DET_SNR_333 : 120|8@1+ (0.35156,0) [0|89.6478] "dB"  ADAS
 SG_ DET_EXISTENCE_PROB_333 : 112|6@1+ (1.588,0) [0|100] "%"  ADAS
 SG_ DET_HVC_FLAG_333 : 86|1@1+ (1,0) [0|1] ""  ADAS
 SG_ DET_CONFD_AZIMUTH_333 : 118|2@1+ (1,0) [0|3] ""  ADAS
 SG_ DET_CONFD_ELEVATION_333 : 101|2@1+ (1,0) [0|3] ""  ADAS
 SG_ DET_PROB_1STAZHYPO_333 : 103|1@1+ (1,0) [0|1] ""  ADAS
 SG_ DET_IDM_333 : 63|1@1+ (1,0) [0|1] ""  ADAS
 SG_ DET_MTD_333 : 47|1@1+ (1,0) [0|1] ""  ADAS
 SG_ DET_BELOW_RAIN_THOLD_333 : 39|1@1+ (1,0) [0|1] ""  ADAS
 SG_ DET_RANGE_334 : 136|15@1+ (0.015625,0) [0|500] "m"  ADAS
 SG_ DET_RANGE_ERR_334 : 152|7@1+ (0.0075,0) [0|0.9525] "m"  ADAS
 SG_ DET_RANGE_VELOCITY_334 : 160|15@1+ (0.0078125,-128) [-128|127.9921875] "m/s"  ADAS
 SG_ DET_RANGE_VELOCITY_ERR_334 : 176|8@1+ (0.003,0) [0|0.765] "m/s"  ADAS
 SG_ DET_AZIMUTH_334 : 200|13@1+ (0.0004,-1.5708) [-1.5708|1.5708] "rad"  ADAS
 SG_ DET_AZIMUTH_ERR_334 : 217|7@1+ (0.00087267,0) [0|0.11082909] "rad"  ADAS
 SG_ DET_ELEVATION_334 : 184|8@1+ (0.00275,-0.34925) [-0.34925|0.34925] "rad"  ADAS
 SG_ DET_ELEVATION_ERR_334 : 192|6@1+ (0.00174533,0) [0|0.10995579] "rad"  ADAS
 SG_ DET_RCS_334 : 240|8@1+ (0.5,-64) [-64|63.5] "dBsm"  ADAS
 SG_ DET_BI_STATIC_FLAG_334 : 216|1@1+ (1,0) [0|1] ""  ADAS
 SG_ DET_SUPER_RES_TARGET_334 : 199|1@1+ (1,0) [0|1] ""  ADAS
 SG_ DET_SNR_334 : 232|8@1+ (0.35156,0) [0|89.6478] "dB"  ADAS
 SG_ DET_EXISTENCE_PROB_334 : 224|6@1+ (1.588,0) [0|100] "%"  ADAS
 SG_ DET_HVC_FLAG_334 : 198|1@1+ (1,0) [0|1] ""  ADAS
 SG_ DET_CONFD_AZIMUTH_334 : 230|2@1+ (1,0) [0|3] ""  ADAS
 SG_ DET_CONFD_ELEVATION_334 : 213|2@1+ (1,0) [0|3] ""  ADAS
 SG_ DET_PROB_1STAZHYPO_334 : 215|1@1+ (1,0) [0|1] ""  ADAS
 SG_ DET_IDM_334 : 175|1@1+ (1,0) [0|1] ""  ADAS
 SG_ DET_MTD_334 : 159|1@1+ (1,0) [0|1] ""  ADAS
 SG_ DET_BELOW_RAIN_THOLD_334 : 151|1@1+ (1,0) [0|1] ""  ADAS
 SG_ DET_RANGE_335 : 248|15@1+ (0.015625,0) [0|500] "m"  ADAS
 SG_ DET_RANGE_ERR_335 : 264|7@1+ (0.0075,0) [0|0.9525] "m"  ADAS
 SG_ DET_RANGE_VELOCITY_335 : 272|15@1+ (0.0078125,-128) [-128|127.9921875] "m/s"  ADAS
 SG_ DET_RANGE_VELOCITY_ERR_335 : 288|8@1+ (0.003,0) [0|0.765] "m/s"  ADAS
 SG_ DET_AZIMUTH_335 : 312|13@1+ (0.0004,-1.5708) [-1.5708|1.5708] "rad"  ADAS
 SG_ DET_AZIMUTH_ERR_335 : 329|7@1+ (0.00087267,0) [0|0.11082909] "rad"  ADAS
 SG_ DET_ELEVATION_335 : 296|8@1+ (0.00275,-0.34925) [-0.34925|0.34925] "rad"  ADAS
 SG_ DET_ELEVATION_ERR_335 : 304|6@1+ (0.00174533,0) [0|0.10995579] "rad"  ADAS
 SG_ DET_RCS_335 : 352|8@1+ (0.5,-64) [-64|63.5] "dBsm"  ADAS
 SG_ DET_BI_STATIC_FLAG_335 : 328|1@1+ (1,0) [0|1] ""  ADAS
 SG_ DET_SUPER_RES_TARGET_335 : 311|1@1+ (1,0) [0|1] ""  ADAS
 SG_ DET_SNR_335 : 344|8@1+ (0.35156,0) [0|89.6478] "dB"  ADAS
 SG_ DET_EXISTENCE_PROB_335 : 336|6@1+ (1.588,0) [0|100] "%"  ADAS
 SG_ DET_HVC_FLAG_335 : 310|1@1+ (1,0) [0|1] ""  ADAS
 SG_ DET_CONFD_AZIMUTH_335 : 342|2@1+ (1,0) [0|3] ""  ADAS
 SG_ DET_CONFD_ELEVATION_335 : 325|2@1+ (1,0) [0|3] ""  ADAS
 SG_ DET_PROB_1STAZHYPO_335 : 327|1@1+ (1,0) [0|1] ""  ADAS
 SG_ DET_IDM_335 : 287|1@1+ (1,0) [0|1] ""  ADAS
 SG_ DET_MTD_335 : 271|1@1+ (1,0) [0|1] ""  ADAS
 SG_ DET_BELOW_RAIN_THOLD_335 : 263|1@1+ (1,0) [0|1] ""  ADAS
 SG_ DET_RANGE_336 : 360|15@1+ (0.015625,0) [0|500] "m"  ADAS
 SG_ DET_RANGE_ERR_336 : 376|7@1+ (0.0075,0) [0|0.9525] "m"  ADAS
 SG_ DET_RANGE_VELOCITY_336 : 384|15@1+ (0.0078125,-128) [-128|127.9921875] "m/s"  ADAS
 SG_ DET_RANGE_VELOCITY_ERR_336 : 400|8@1+ (0.003,0) [0|0.765] "m/s"  ADAS
 SG_ DET_AZIMUTH_336 : 424|13@1+ (0.0004,-1.5708) [-1.5708|1.5708] "rad"  ADAS
 SG_ DET_AZIMUTH_ERR_336 : 441|7@1+ (0.00087267,0) [0|0.11082909] "rad"  ADAS
 SG_ DET_ELEVATION_336 : 408|8@1+ (0.00275,-0.34925) [-0.34925|0.34925] "rad"  ADAS
 SG_ DET_ELEVATION_ERR_336 : 416|6@1+ (0.00174533,0) [0|0.10995579] "rad"  ADAS
 SG_ DET_RCS_336 : 464|8@1+ (0.5,-64) [-64|63.5] "dBsm"  ADAS
 SG_ DET_BI_STATIC_FLAG_336 : 440|1@1+ (1,0) [0|1] ""  ADAS
 SG_ DET_SUPER_RES_TARGET_336 : 423|1@1+ (1,0) [0|1] ""  ADAS
 SG_ DET_SNR_336 : 456|8@1+ (0.35156,0) [0|89.6478] "dB"  ADAS
 SG_ DET_EXISTENCE_PROB_336 : 448|6@1+ (1.588,0) [0|100] "%"  ADAS
 SG_ DET_HVC_FLAG_336 : 422|1@1+ (1,0) [0|1] ""  ADAS
 SG_ DET_CONFD_AZIMUTH_336 : 454|2@1+ (1,0) [0|3] ""  ADAS
 SG_ DET_CONFD_ELEVATION_336 : 437|2@1+ (1,0) [0|3] ""  ADAS
 SG_ DET_MH_SCAN_INDEX_4LSB_333_336 : 476|4@1+ (1,0) [0|15] ""  ADAS
 SG_ DET_MH_CYCLE_COUNTER_333_336 : 16|8@1+ (1,0) [0|255] ""  ADAS
 SG_ DET_MH_CRC16_333_336 : 0|16@1+ (1,0) [0|65535] ""  ADAS
 SG_ DET_PROB_1STAZHYPO_336 : 439|1@1+ (1,0) [0|1] ""  ADAS
 SG_ DET_IDM_336 : 399|1@1+ (1,0) [0|1] ""  ADAS
 SG_ DET_MTD_336 : 383|1@1+ (1,0) [0|1] ""  ADAS
 SG_ DET_BELOW_RAIN_THOLD_336 : 375|1@1+ (1,0) [0|1] ""  ADAS

BO_ 1108 RDR_DETECTION_337_340: 64 RDR07
 SG_ DET_RANGE_337 : 24|15@1+ (0.015625,0) [0|500] "m"  ADAS
 SG_ DET_RANGE_ERR_337 : 40|7@1+ (0.0075,0) [0|0.9525] "m"  ADAS
 SG_ DET_RANGE_VELOCITY_337 : 48|15@1+ (0.0078125,-128) [-128|127.9921875] "m/s"  ADAS
 SG_ DET_RANGE_VELOCITY_ERR_337 : 64|8@1+ (0.003,0) [0|0.765] "m/s"  ADAS
 SG_ DET_AZIMUTH_337 : 88|13@1+ (0.0004,-1.5708) [-1.5708|1.5708] "rad"  ADAS
 SG_ DET_AZIMUTH_ERR_337 : 105|7@1+ (0.00087267,0) [0|0.11082909] "rad"  ADAS
 SG_ DET_ELEVATION_337 : 72|8@1+ (0.00275,-0.34925) [-0.34925|0.34925] "rad"  ADAS
 SG_ DET_ELEVATION_ERR_337 : 80|6@1+ (0.00174533,0) [0|0.10995579] "rad"  ADAS
 SG_ DET_RCS_337 : 128|8@1+ (0.5,-64) [-64|63.5] "dBsm"  ADAS
 SG_ DET_BI_STATIC_FLAG_337 : 104|1@1+ (1,0) [0|1] ""  ADAS
 SG_ DET_SUPER_RES_TARGET_337 : 87|1@1+ (1,0) [0|1] ""  ADAS
 SG_ DET_SNR_337 : 120|8@1+ (0.35156,0) [0|89.6478] "dB"  ADAS
 SG_ DET_EXISTENCE_PROB_337 : 112|6@1+ (1.588,0) [0|100] "%"  ADAS
 SG_ DET_HVC_FLAG_337 : 86|1@1+ (1,0) [0|1] ""  ADAS
 SG_ DET_CONFD_AZIMUTH_337 : 118|2@1+ (1,0) [0|3] ""  ADAS
 SG_ DET_CONFD_ELEVATION_337 : 101|2@1+ (1,0) [0|3] ""  ADAS
 SG_ DET_PROB_1STAZHYPO_337 : 103|1@1+ (1,0) [0|1] ""  ADAS
 SG_ DET_IDM_337 : 63|1@1+ (1,0) [0|1] ""  ADAS
 SG_ DET_MTD_337 : 47|1@1+ (1,0) [0|1] ""  ADAS
 SG_ DET_BELOW_RAIN_THOLD_337 : 39|1@1+ (1,0) [0|1] ""  ADAS
 SG_ DET_RANGE_338 : 136|15@1+ (0.015625,0) [0|500] "m"  ADAS
 SG_ DET_RANGE_ERR_338 : 152|7@1+ (0.0075,0) [0|0.9525] "m"  ADAS
 SG_ DET_RANGE_VELOCITY_338 : 160|15@1+ (0.0078125,-128) [-128|127.9921875] "m/s"  ADAS
 SG_ DET_RANGE_VELOCITY_ERR_338 : 176|8@1+ (0.003,0) [0|0.765] "m/s"  ADAS
 SG_ DET_AZIMUTH_338 : 200|13@1+ (0.0004,-1.5708) [-1.5708|1.5708] "rad"  ADAS
 SG_ DET_AZIMUTH_ERR_338 : 217|7@1+ (0.00087267,0) [0|0.11082909] "rad"  ADAS
 SG_ DET_ELEVATION_338 : 184|8@1+ (0.00275,-0.34925) [-0.34925|0.34925] "rad"  ADAS
 SG_ DET_ELEVATION_ERR_338 : 192|6@1+ (0.00174533,0) [0|0.10995579] "rad"  ADAS
 SG_ DET_RCS_338 : 240|8@1+ (0.5,-64) [-64|63.5] "dBsm"  ADAS
 SG_ DET_BI_STATIC_FLAG_338 : 216|1@1+ (1,0) [0|1] ""  ADAS
 SG_ DET_SUPER_RES_TARGET_338 : 199|1@1+ (1,0) [0|1] ""  ADAS
 SG_ DET_SNR_338 : 232|8@1+ (0.35156,0) [0|89.6478] "dB"  ADAS
 SG_ DET_EXISTENCE_PROB_338 : 224|6@1+ (1.588,0) [0|100] "%"  ADAS
 SG_ DET_HVC_FLAG_338 : 198|1@1+ (1,0) [0|1] ""  ADAS
 SG_ DET_CONFD_AZIMUTH_338 : 230|2@1+ (1,0) [0|3] ""  ADAS
 SG_ DET_CONFD_ELEVATION_338 : 213|2@1+ (1,0) [0|3] ""  ADAS
 SG_ DET_PROB_1STAZHYPO_338 : 215|1@1+ (1,0) [0|1] ""  ADAS
 SG_ DET_IDM_338 : 175|1@1+ (1,0) [0|1] ""  ADAS
 SG_ DET_MTD_338 : 159|1@1+ (1,0) [0|1] ""  ADAS
 SG_ DET_BELOW_RAIN_THOLD_338 : 151|1@1+ (1,0) [0|1] ""  ADAS
 SG_ DET_RANGE_339 : 248|15@1+ (0.015625,0) [0|500] "m"  ADAS
 SG_ DET_RANGE_ERR_339 : 264|7@1+ (0.0075,0) [0|0.9525] "m"  ADAS
 SG_ DET_RANGE_VELOCITY_339 : 272|15@1+ (0.0078125,-128) [-128|127.9921875] "m/s"  ADAS
 SG_ DET_RANGE_VELOCITY_ERR_339 : 288|8@1+ (0.003,0) [0|0.765] "m/s"  ADAS
 SG_ DET_AZIMUTH_339 : 312|13@1+ (0.0004,-1.5708) [-1.5708|1.5708] "rad"  ADAS
 SG_ DET_AZIMUTH_ERR_339 : 329|7@1+ (0.00087267,0) [0|0.11082909] "rad"  ADAS
 SG_ DET_ELEVATION_339 : 296|8@1+ (0.00275,-0.34925) [-0.34925|0.34925] "rad"  ADAS
 SG_ DET_ELEVATION_ERR_339 : 304|6@1+ (0.00174533,0) [0|0.10995579] "rad"  ADAS
 SG_ DET_RCS_339 : 352|8@1+ (0.5,-64) [-64|63.5] "dBsm"  ADAS
 SG_ DET_BI_STATIC_FLAG_339 : 328|1@1+ (1,0) [0|1] ""  ADAS
 SG_ DET_SUPER_RES_TARGET_339 : 311|1@1+ (1,0) [0|1] ""  ADAS
 SG_ DET_SNR_339 : 344|8@1+ (0.35156,0) [0|89.6478] "dB"  ADAS
 SG_ DET_EXISTENCE_PROB_339 : 336|6@1+ (1.588,0) [0|100] "%"  ADAS
 SG_ DET_HVC_FLAG_339 : 310|1@1+ (1,0) [0|1] ""  ADAS
 SG_ DET_CONFD_AZIMUTH_339 : 342|2@1+ (1,0) [0|3] ""  ADAS
 SG_ DET_CONFD_ELEVATION_339 : 325|2@1+ (1,0) [0|3] ""  ADAS
 SG_ DET_PROB_1STAZHYPO_339 : 327|1@1+ (1,0) [0|1] ""  ADAS
 SG_ DET_IDM_339 : 287|1@1+ (1,0) [0|1] ""  ADAS
 SG_ DET_MTD_339 : 271|1@1+ (1,0) [0|1] ""  ADAS
 SG_ DET_BELOW_RAIN_THOLD_339 : 263|1@1+ (1,0) [0|1] ""  ADAS
 SG_ DET_RANGE_340 : 360|15@1+ (0.015625,0) [0|500] "m"  ADAS
 SG_ DET_RANGE_ERR_340 : 376|7@1+ (0.0075,0) [0|0.9525] "m"  ADAS
 SG_ DET_RANGE_VELOCITY_340 : 384|15@1+ (0.0078125,-128) [-128|127.9921875] "m/s"  ADAS
 SG_ DET_RANGE_VELOCITY_ERR_340 : 400|8@1+ (0.003,0) [0|0.765] "m/s"  ADAS
 SG_ DET_AZIMUTH_340 : 424|13@1+ (0.0004,-1.5708) [-1.5708|1.5708] "rad"  ADAS
 SG_ DET_AZIMUTH_ERR_340 : 441|7@1+ (0.00087267,0) [0|0.11082909] "rad"  ADAS
 SG_ DET_ELEVATION_340 : 408|8@1+ (0.00275,-0.34925) [-0.34925|0.34925] "rad"  ADAS
 SG_ DET_ELEVATION_ERR_340 : 416|6@1+ (0.00174533,0) [0|0.10995579] "rad"  ADAS
 SG_ DET_RCS_340 : 464|8@1+ (0.5,-64) [-64|63.5] "dBsm"  ADAS
 SG_ DET_BI_STATIC_FLAG_340 : 440|1@1+ (1,0) [0|1] ""  ADAS
 SG_ DET_SUPER_RES_TARGET_340 : 423|1@1+ (1,0) [0|1] ""  ADAS
 SG_ DET_SNR_340 : 456|8@1+ (0.35156,0) [0|89.6478] "dB"  ADAS
 SG_ DET_EXISTENCE_PROB_340 : 448|6@1+ (1.588,0) [0|100] "%"  ADAS
 SG_ DET_HVC_FLAG_340 : 422|1@1+ (1,0) [0|1] ""  ADAS
 SG_ DET_CONFD_AZIMUTH_340 : 454|2@1+ (1,0) [0|3] ""  ADAS
 SG_ DET_CONFD_ELEVATION_340 : 437|2@1+ (1,0) [0|3] ""  ADAS
 SG_ DET_MH_SCAN_INDEX_4LSB_337_340 : 476|4@1+ (1,0) [0|15] ""  ADAS
 SG_ DET_MH_CYCLE_COUNTER_337_340 : 16|8@1+ (1,0) [0|255] ""  ADAS
 SG_ DET_MH_CRC16_337_340 : 0|16@1+ (1,0) [0|65535] ""  ADAS
 SG_ DET_PROB_1STAZHYPO_340 : 439|1@1+ (1,0) [0|1] ""  ADAS
 SG_ DET_IDM_340 : 399|1@1+ (1,0) [0|1] ""  ADAS
 SG_ DET_MTD_340 : 383|1@1+ (1,0) [0|1] ""  ADAS
 SG_ DET_BELOW_RAIN_THOLD_340 : 375|1@1+ (1,0) [0|1] ""  ADAS

BO_ 1109 RDR_DETECTION_341_344: 64 RDR07
 SG_ DET_RANGE_341 : 24|15@1+ (0.015625,0) [0|500] "m"  ADAS
 SG_ DET_RANGE_ERR_341 : 40|7@1+ (0.0075,0) [0|0.9525] "m"  ADAS
 SG_ DET_RANGE_VELOCITY_341 : 48|15@1+ (0.0078125,-128) [-128|127.9921875] "m/s"  ADAS
 SG_ DET_RANGE_VELOCITY_ERR_341 : 64|8@1+ (0.003,0) [0|0.765] "m/s"  ADAS
 SG_ DET_AZIMUTH_341 : 88|13@1+ (0.0004,-1.5708) [-1.5708|1.5708] "rad"  ADAS
 SG_ DET_AZIMUTH_ERR_341 : 105|7@1+ (0.00087267,0) [0|0.11082909] "rad"  ADAS
 SG_ DET_ELEVATION_341 : 72|8@1+ (0.00275,-0.34925) [-0.34925|0.34925] "rad"  ADAS
 SG_ DET_ELEVATION_ERR_341 : 80|6@1+ (0.00174533,0) [0|0.10995579] "rad"  ADAS
 SG_ DET_RCS_341 : 128|8@1+ (0.5,-64) [-64|63.5] "dBsm"  ADAS
 SG_ DET_BI_STATIC_FLAG_341 : 104|1@1+ (1,0) [0|1] ""  ADAS
 SG_ DET_SUPER_RES_TARGET_341 : 87|1@1+ (1,0) [0|1] ""  ADAS
 SG_ DET_SNR_341 : 120|8@1+ (0.35156,0) [0|89.6478] "dB"  ADAS
 SG_ DET_EXISTENCE_PROB_341 : 112|6@1+ (1.588,0) [0|100] "%"  ADAS
 SG_ DET_HVC_FLAG_341 : 86|1@1+ (1,0) [0|1] ""  ADAS
 SG_ DET_CONFD_AZIMUTH_341 : 118|2@1+ (1,0) [0|3] ""  ADAS
 SG_ DET_CONFD_ELEVATION_341 : 101|2@1+ (1,0) [0|3] ""  ADAS
 SG_ DET_PROB_1STAZHYPO_341 : 103|1@1+ (1,0) [0|1] ""  ADAS
 SG_ DET_IDM_341 : 63|1@1+ (1,0) [0|1] ""  ADAS
 SG_ DET_MTD_341 : 47|1@1+ (1,0) [0|1] ""  ADAS
 SG_ DET_BELOW_RAIN_THOLD_341 : 39|1@1+ (1,0) [0|1] ""  ADAS
 SG_ DET_RANGE_342 : 136|15@1+ (0.015625,0) [0|500] "m"  ADAS
 SG_ DET_RANGE_ERR_342 : 152|7@1+ (0.0075,0) [0|0.9525] "m"  ADAS
 SG_ DET_RANGE_VELOCITY_342 : 160|15@1+ (0.0078125,-128) [-128|127.9921875] "m/s"  ADAS
 SG_ DET_RANGE_VELOCITY_ERR_342 : 176|8@1+ (0.003,0) [0|0.765] "m/s"  ADAS
 SG_ DET_AZIMUTH_342 : 200|13@1+ (0.0004,-1.5708) [-1.5708|1.5708] "rad"  ADAS
 SG_ DET_AZIMUTH_ERR_342 : 217|7@1+ (0.00087267,0) [0|0.11082909] "rad"  ADAS
 SG_ DET_ELEVATION_342 : 184|8@1+ (0.00275,-0.34925) [-0.34925|0.34925] "rad"  ADAS
 SG_ DET_ELEVATION_ERR_342 : 192|6@1+ (0.00174533,0) [0|0.10995579] "rad"  ADAS
 SG_ DET_RCS_342 : 240|8@1+ (0.5,-64) [-64|63.5] "dBsm"  ADAS
 SG_ DET_BI_STATIC_FLAG_342 : 216|1@1+ (1,0) [0|1] ""  ADAS
 SG_ DET_SUPER_RES_TARGET_342 : 199|1@1+ (1,0) [0|1] ""  ADAS
 SG_ DET_SNR_342 : 232|8@1+ (0.35156,0) [0|89.6478] "dB"  ADAS
 SG_ DET_EXISTENCE_PROB_342 : 224|6@1+ (1.588,0) [0|100] "%"  ADAS
 SG_ DET_HVC_FLAG_342 : 198|1@1+ (1,0) [0|1] ""  ADAS
 SG_ DET_CONFD_AZIMUTH_342 : 230|2@1+ (1,0) [0|3] ""  ADAS
 SG_ DET_CONFD_ELEVATION_342 : 213|2@1+ (1,0) [0|3] ""  ADAS
 SG_ DET_PROB_1STAZHYPO_342 : 215|1@1+ (1,0) [0|1] ""  ADAS
 SG_ DET_IDM_342 : 175|1@1+ (1,0) [0|1] ""  ADAS
 SG_ DET_MTD_342 : 159|1@1+ (1,0) [0|1] ""  ADAS
 SG_ DET_BELOW_RAIN_THOLD_342 : 151|1@1+ (1,0) [0|1] ""  ADAS
 SG_ DET_RANGE_343 : 248|15@1+ (0.015625,0) [0|500] "m"  ADAS
 SG_ DET_RANGE_ERR_343 : 264|7@1+ (0.0075,0) [0|0.9525] "m"  ADAS
 SG_ DET_RANGE_VELOCITY_343 : 272|15@1+ (0.0078125,-128) [-128|127.9921875] "m/s"  ADAS
 SG_ DET_RANGE_VELOCITY_ERR_343 : 288|8@1+ (0.003,0) [0|0.765] "m/s"  ADAS
 SG_ DET_AZIMUTH_343 : 312|13@1+ (0.0004,-1.5708) [-1.5708|1.5708] "rad"  ADAS
 SG_ DET_AZIMUTH_ERR_343 : 329|7@1+ (0.00087267,0) [0|0.11082909] "rad"  ADAS
 SG_ DET_ELEVATION_343 : 296|8@1+ (0.00275,-0.34925) [-0.34925|0.34925] "rad"  ADAS
 SG_ DET_ELEVATION_ERR_343 : 304|6@1+ (0.00174533,0) [0|0.10995579] "rad"  ADAS
 SG_ DET_RCS_343 : 352|8@1+ (0.5,-64) [-64|63.5] "dBsm"  ADAS
 SG_ DET_BI_STATIC_FLAG_343 : 328|1@1+ (1,0) [0|1] ""  ADAS
 SG_ DET_SUPER_RES_TARGET_343 : 311|1@1+ (1,0) [0|1] ""  ADAS
 SG_ DET_SNR_343 : 344|8@1+ (0.35156,0) [0|89.6478] "dB"  ADAS
 SG_ DET_EXISTENCE_PROB_343 : 336|6@1+ (1.588,0) [0|100] "%"  ADAS
 SG_ DET_HVC_FLAG_343 : 310|1@1+ (1,0) [0|1] ""  ADAS
 SG_ DET_CONFD_AZIMUTH_343 : 342|2@1+ (1,0) [0|3] ""  ADAS
 SG_ DET_CONFD_ELEVATION_343 : 325|2@1+ (1,0) [0|3] ""  ADAS
 SG_ DET_PROB_1STAZHYPO_343 : 327|1@1+ (1,0) [0|1] ""  ADAS
 SG_ DET_IDM_343 : 287|1@1+ (1,0) [0|1] ""  ADAS
 SG_ DET_MTD_343 : 271|1@1+ (1,0) [0|1] ""  ADAS
 SG_ DET_BELOW_RAIN_THOLD_343 : 263|1@1+ (1,0) [0|1] ""  ADAS
 SG_ DET_RANGE_344 : 360|15@1+ (0.015625,0) [0|500] "m"  ADAS
 SG_ DET_RANGE_ERR_344 : 376|7@1+ (0.0075,0) [0|0.9525] "m"  ADAS
 SG_ DET_RANGE_VELOCITY_344 : 384|15@1+ (0.0078125,-128) [-128|127.9921875] "m/s"  ADAS
 SG_ DET_RANGE_VELOCITY_ERR_344 : 400|8@1+ (0.003,0) [0|0.765] "m/s"  ADAS
 SG_ DET_AZIMUTH_344 : 424|13@1+ (0.0004,-1.5708) [-1.5708|1.5708] "rad"  ADAS
 SG_ DET_AZIMUTH_ERR_344 : 441|7@1+ (0.00087267,0) [0|0.11082909] "rad"  ADAS
 SG_ DET_ELEVATION_344 : 408|8@1+ (0.00275,-0.34925) [-0.34925|0.34925] "rad"  ADAS
 SG_ DET_ELEVATION_ERR_344 : 416|6@1+ (0.00174533,0) [0|0.10995579] "rad"  ADAS
 SG_ DET_RCS_344 : 464|8@1+ (0.5,-64) [-64|63.5] "dBsm"  ADAS
 SG_ DET_BI_STATIC_FLAG_344 : 440|1@1+ (1,0) [0|1] ""  ADAS
 SG_ DET_SUPER_RES_TARGET_344 : 423|1@1+ (1,0) [0|1] ""  ADAS
 SG_ DET_SNR_344 : 456|8@1+ (0.35156,0) [0|89.6478] "dB"  ADAS
 SG_ DET_EXISTENCE_PROB_344 : 448|6@1+ (1.588,0) [0|100] "%"  ADAS
 SG_ DET_HVC_FLAG_344 : 422|1@1+ (1,0) [0|1] ""  ADAS
 SG_ DET_CONFD_AZIMUTH_344 : 454|2@1+ (1,0) [0|3] ""  ADAS
 SG_ DET_CONFD_ELEVATION_344 : 437|2@1+ (1,0) [0|3] ""  ADAS
 SG_ DET_MH_SCAN_INDEX_4LSB_341_344 : 476|4@1+ (1,0) [0|15] ""  ADAS
 SG_ DET_MH_CYCLE_COUNTER_341_344 : 16|8@1+ (1,0) [0|255] ""  ADAS
 SG_ DET_MH_CRC16_341_344 : 0|16@1+ (1,0) [0|65535] ""  ADAS
 SG_ DET_PROB_1STAZHYPO_344 : 439|1@1+ (1,0) [0|1] ""  ADAS
 SG_ DET_IDM_344 : 399|1@1+ (1,0) [0|1] ""  ADAS
 SG_ DET_MTD_344 : 383|1@1+ (1,0) [0|1] ""  ADAS
 SG_ DET_BELOW_RAIN_THOLD_344 : 375|1@1+ (1,0) [0|1] ""  ADAS

BO_ 1110 RDR_DETECTION_345_348: 64 RDR07
 SG_ DET_RANGE_345 : 24|15@1+ (0.015625,0) [0|500] "m"  ADAS
 SG_ DET_RANGE_ERR_345 : 40|7@1+ (0.0075,0) [0|0.9525] "m"  ADAS
 SG_ DET_RANGE_VELOCITY_345 : 48|15@1+ (0.0078125,-128) [-128|127.9921875] "m/s"  ADAS
 SG_ DET_RANGE_VELOCITY_ERR_345 : 64|8@1+ (0.003,0) [0|0.765] "m/s"  ADAS
 SG_ DET_AZIMUTH_345 : 88|13@1+ (0.0004,-1.5708) [-1.5708|1.5708] "rad"  ADAS
 SG_ DET_AZIMUTH_ERR_345 : 105|7@1+ (0.00087267,0) [0|0.11082909] "rad"  ADAS
 SG_ DET_ELEVATION_345 : 72|8@1+ (0.00275,-0.34925) [-0.34925|0.34925] "rad"  ADAS
 SG_ DET_ELEVATION_ERR_345 : 80|6@1+ (0.00174533,0) [0|0.10995579] "rad"  ADAS
 SG_ DET_RCS_345 : 128|8@1+ (0.5,-64) [-64|63.5] "dBsm"  ADAS
 SG_ DET_BI_STATIC_FLAG_345 : 104|1@1+ (1,0) [0|1] ""  ADAS
 SG_ DET_SUPER_RES_TARGET_345 : 87|1@1+ (1,0) [0|1] ""  ADAS
 SG_ DET_SNR_345 : 120|8@1+ (0.35156,0) [0|89.6478] "dB"  ADAS
 SG_ DET_EXISTENCE_PROB_345 : 112|6@1+ (1.588,0) [0|100] "%"  ADAS
 SG_ DET_HVC_FLAG_345 : 86|1@1+ (1,0) [0|1] ""  ADAS
 SG_ DET_CONFD_AZIMUTH_345 : 118|2@1+ (1,0) [0|3] ""  ADAS
 SG_ DET_CONFD_ELEVATION_345 : 101|2@1+ (1,0) [0|3] ""  ADAS
 SG_ DET_PROB_1STAZHYPO_345 : 103|1@1+ (1,0) [0|1] ""  ADAS
 SG_ DET_IDM_345 : 63|1@1+ (1,0) [0|1] ""  ADAS
 SG_ DET_MTD_345 : 47|1@1+ (1,0) [0|1] ""  ADAS
 SG_ DET_BELOW_RAIN_THOLD_345 : 39|1@1+ (1,0) [0|1] ""  ADAS
 SG_ DET_RANGE_346 : 136|15@1+ (0.015625,0) [0|500] "m"  ADAS
 SG_ DET_RANGE_ERR_346 : 152|7@1+ (0.0075,0) [0|0.9525] "m"  ADAS
 SG_ DET_RANGE_VELOCITY_346 : 160|15@1+ (0.0078125,-128) [-128|127.9921875] "m/s"  ADAS
 SG_ DET_RANGE_VELOCITY_ERR_346 : 176|8@1+ (0.003,0) [0|0.765] "m/s"  ADAS
 SG_ DET_AZIMUTH_346 : 200|13@1+ (0.0004,-1.5708) [-1.5708|1.5708] "rad"  ADAS
 SG_ DET_AZIMUTH_ERR_346 : 217|7@1+ (0.00087267,0) [0|0.11082909] "rad"  ADAS
 SG_ DET_ELEVATION_346 : 184|8@1+ (0.00275,-0.34925) [-0.34925|0.34925] "rad"  ADAS
 SG_ DET_ELEVATION_ERR_346 : 192|6@1+ (0.00174533,0) [0|0.10995579] "rad"  ADAS
 SG_ DET_RCS_346 : 240|8@1+ (0.5,-64) [-64|63.5] "dBsm"  ADAS
 SG_ DET_BI_STATIC_FLAG_346 : 216|1@1+ (1,0) [0|1] ""  ADAS
 SG_ DET_SUPER_RES_TARGET_346 : 199|1@1+ (1,0) [0|1] ""  ADAS
 SG_ DET_SNR_346 : 232|8@1+ (0.35156,0) [0|89.6478] "dB"  ADAS
 SG_ DET_EXISTENCE_PROB_346 : 224|6@1+ (1.588,0) [0|100] "%"  ADAS
 SG_ DET_HVC_FLAG_346 : 198|1@1+ (1,0) [0|1] ""  ADAS
 SG_ DET_CONFD_AZIMUTH_346 : 230|2@1+ (1,0) [0|3] ""  ADAS
 SG_ DET_CONFD_ELEVATION_346 : 213|2@1+ (1,0) [0|3] ""  ADAS
 SG_ DET_PROB_1STAZHYPO_346 : 215|1@1+ (1,0) [0|1] ""  ADAS
 SG_ DET_IDM_346 : 175|1@1+ (1,0) [0|1] ""  ADAS
 SG_ DET_MTD_346 : 159|1@1+ (1,0) [0|1] ""  ADAS
 SG_ DET_BELOW_RAIN_THOLD_346 : 151|1@1+ (1,0) [0|1] ""  ADAS
 SG_ DET_RANGE_347 : 248|15@1+ (0.015625,0) [0|500] "m"  ADAS
 SG_ DET_RANGE_ERR_347 : 264|7@1+ (0.0075,0) [0|0.9525] "m"  ADAS
 SG_ DET_RANGE_VELOCITY_347 : 272|15@1+ (0.0078125,-128) [-128|127.9921875] "m/s"  ADAS
 SG_ DET_RANGE_VELOCITY_ERR_347 : 288|8@1+ (0.003,0) [0|0.765] "m/s"  ADAS
 SG_ DET_AZIMUTH_347 : 312|13@1+ (0.0004,-1.5708) [-1.5708|1.5708] "rad"  ADAS
 SG_ DET_AZIMUTH_ERR_347 : 329|7@1+ (0.00087267,0) [0|0.11082909] "rad"  ADAS
 SG_ DET_ELEVATION_347 : 296|8@1+ (0.00275,-0.34925) [-0.34925|0.34925] "rad"  ADAS
 SG_ DET_ELEVATION_ERR_347 : 304|6@1+ (0.00174533,0) [0|0.10995579] "rad"  ADAS
 SG_ DET_RCS_347 : 352|8@1+ (0.5,-64) [-64|63.5] "dBsm"  ADAS
 SG_ DET_BI_STATIC_FLAG_347 : 328|1@1+ (1,0) [0|1] ""  ADAS
 SG_ DET_SUPER_RES_TARGET_347 : 311|1@1+ (1,0) [0|1] ""  ADAS
 SG_ DET_SNR_347 : 344|8@1+ (0.35156,0) [0|89.6478] "dB"  ADAS
 SG_ DET_EXISTENCE_PROB_347 : 336|6@1+ (1.588,0) [0|100] "%"  ADAS
 SG_ DET_HVC_FLAG_347 : 310|1@1+ (1,0) [0|1] ""  ADAS
 SG_ DET_CONFD_AZIMUTH_347 : 342|2@1+ (1,0) [0|3] ""  ADAS
 SG_ DET_CONFD_ELEVATION_347 : 325|2@1+ (1,0) [0|3] ""  ADAS
 SG_ DET_PROB_1STAZHYPO_347 : 327|1@1+ (1,0) [0|1] ""  ADAS
 SG_ DET_IDM_347 : 287|1@1+ (1,0) [0|1] ""  ADAS
 SG_ DET_MTD_347 : 271|1@1+ (1,0) [0|1] ""  ADAS
 SG_ DET_BELOW_RAIN_THOLD_347 : 263|1@1+ (1,0) [0|1] ""  ADAS
 SG_ DET_RANGE_348 : 360|15@1+ (0.015625,0) [0|500] "m"  ADAS
 SG_ DET_RANGE_ERR_348 : 376|7@1+ (0.0075,0) [0|0.9525] "m"  ADAS
 SG_ DET_RANGE_VELOCITY_348 : 384|15@1+ (0.0078125,-128) [-128|127.9921875] "m/s"  ADAS
 SG_ DET_RANGE_VELOCITY_ERR_348 : 400|8@1+ (0.003,0) [0|0.765] "m/s"  ADAS
 SG_ DET_AZIMUTH_348 : 424|13@1+ (0.0004,-1.5708) [-1.5708|1.5708] "rad"  ADAS
 SG_ DET_AZIMUTH_ERR_348 : 441|7@1+ (0.00087267,0) [0|0.11082909] "rad"  ADAS
 SG_ DET_ELEVATION_348 : 408|8@1+ (0.00275,-0.34925) [-0.34925|0.34925] "rad"  ADAS
 SG_ DET_ELEVATION_ERR_348 : 416|6@1+ (0.00174533,0) [0|0.10995579] "rad"  ADAS
 SG_ DET_RCS_348 : 464|8@1+ (0.5,-64) [-64|63.5] "dBsm"  ADAS
 SG_ DET_BI_STATIC_FLAG_348 : 440|1@1+ (1,0) [0|1] ""  ADAS
 SG_ DET_SUPER_RES_TARGET_348 : 423|1@1+ (1,0) [0|1] ""  ADAS
 SG_ DET_SNR_348 : 456|8@1+ (0.35156,0) [0|89.6478] "dB"  ADAS
 SG_ DET_EXISTENCE_PROB_348 : 448|6@1+ (1.588,0) [0|100] "%"  ADAS
 SG_ DET_HVC_FLAG_348 : 422|1@1+ (1,0) [0|1] ""  ADAS
 SG_ DET_CONFD_AZIMUTH_348 : 454|2@1+ (1,0) [0|3] ""  ADAS
 SG_ DET_CONFD_ELEVATION_348 : 437|2@1+ (1,0) [0|3] ""  ADAS
 SG_ DET_MH_SCAN_INDEX_4LSB_345_348 : 476|4@1+ (1,0) [0|15] ""  ADAS
 SG_ DET_MH_CYCLE_COUNTER_345_348 : 16|8@1+ (1,0) [0|255] ""  ADAS
 SG_ DET_MH_CRC16_345_348 : 0|16@1+ (1,0) [0|65535] ""  ADAS
 SG_ DET_PROB_1STAZHYPO_348 : 439|1@1+ (1,0) [0|1] ""  ADAS
 SG_ DET_IDM_348 : 399|1@1+ (1,0) [0|1] ""  ADAS
 SG_ DET_MTD_348 : 383|1@1+ (1,0) [0|1] ""  ADAS
 SG_ DET_BELOW_RAIN_THOLD_348 : 375|1@1+ (1,0) [0|1] ""  ADAS

BO_ 1111 RDR_DETECTION_349_352: 64 RDR07
 SG_ DET_RANGE_349 : 24|15@1+ (0.015625,0) [0|500] "m"  ADAS
 SG_ DET_RANGE_ERR_349 : 40|7@1+ (0.0075,0) [0|0.9525] "m"  ADAS
 SG_ DET_RANGE_VELOCITY_349 : 48|15@1+ (0.0078125,-128) [-128|127.9921875] "m/s"  ADAS
 SG_ DET_RANGE_VELOCITY_ERR_349 : 64|8@1+ (0.003,0) [0|0.765] "m/s"  ADAS
 SG_ DET_AZIMUTH_349 : 88|13@1+ (0.0004,-1.5708) [-1.5708|1.5708] "rad"  ADAS
 SG_ DET_AZIMUTH_ERR_349 : 105|7@1+ (0.00087267,0) [0|0.11082909] "rad"  ADAS
 SG_ DET_ELEVATION_349 : 72|8@1+ (0.00275,-0.34925) [-0.34925|0.34925] "rad"  ADAS
 SG_ DET_ELEVATION_ERR_349 : 80|6@1+ (0.00174533,0) [0|0.10995579] "rad"  ADAS
 SG_ DET_RCS_349 : 128|8@1+ (0.5,-64) [-64|63.5] "dBsm"  ADAS
 SG_ DET_BI_STATIC_FLAG_349 : 104|1@1+ (1,0) [0|1] ""  ADAS
 SG_ DET_SUPER_RES_TARGET_349 : 87|1@1+ (1,0) [0|1] ""  ADAS
 SG_ DET_SNR_349 : 120|8@1+ (0.35156,0) [0|89.6478] "dB"  ADAS
 SG_ DET_EXISTENCE_PROB_349 : 112|6@1+ (1.588,0) [0|100] "%"  ADAS
 SG_ DET_HVC_FLAG_349 : 86|1@1+ (1,0) [0|1] ""  ADAS
 SG_ DET_CONFD_AZIMUTH_349 : 118|2@1+ (1,0) [0|3] ""  ADAS
 SG_ DET_CONFD_ELEVATION_349 : 101|2@1+ (1,0) [0|3] ""  ADAS
 SG_ DET_PROB_1STAZHYPO_349 : 103|1@1+ (1,0) [0|1] ""  ADAS
 SG_ DET_IDM_349 : 63|1@1+ (1,0) [0|1] ""  ADAS
 SG_ DET_MTD_349 : 47|1@1+ (1,0) [0|1] ""  ADAS
 SG_ DET_BELOW_RAIN_THOLD_349 : 39|1@1+ (1,0) [0|1] ""  ADAS
 SG_ DET_RANGE_350 : 136|15@1+ (0.015625,0) [0|500] "m"  ADAS
 SG_ DET_RANGE_ERR_350 : 152|7@1+ (0.0075,0) [0|0.9525] "m"  ADAS
 SG_ DET_RANGE_VELOCITY_350 : 160|15@1+ (0.0078125,-128) [-128|127.9921875] "m/s"  ADAS
 SG_ DET_RANGE_VELOCITY_ERR_350 : 176|8@1+ (0.003,0) [0|0.765] "m/s"  ADAS
 SG_ DET_AZIMUTH_350 : 200|13@1+ (0.0004,-1.5708) [-1.5708|1.5708] "rad"  ADAS
 SG_ DET_AZIMUTH_ERR_350 : 217|7@1+ (0.00087267,0) [0|0.11082909] "rad"  ADAS
 SG_ DET_ELEVATION_350 : 184|8@1+ (0.00275,-0.34925) [-0.34925|0.34925] "rad"  ADAS
 SG_ DET_ELEVATION_ERR_350 : 192|6@1+ (0.00174533,0) [0|0.10995579] "rad"  ADAS
 SG_ DET_RCS_350 : 240|8@1+ (0.5,-64) [-64|63.5] "dBsm"  ADAS
 SG_ DET_BI_STATIC_FLAG_350 : 216|1@1+ (1,0) [0|1] ""  ADAS
 SG_ DET_SUPER_RES_TARGET_350 : 199|1@1+ (1,0) [0|1] ""  ADAS
 SG_ DET_SNR_350 : 232|8@1+ (0.35156,0) [0|89.6478] "dB"  ADAS
 SG_ DET_EXISTENCE_PROB_350 : 224|6@1+ (1.588,0) [0|100] "%"  ADAS
 SG_ DET_HVC_FLAG_350 : 198|1@1+ (1,0) [0|1] ""  ADAS
 SG_ DET_CONFD_AZIMUTH_350 : 230|2@1+ (1,0) [0|3] ""  ADAS
 SG_ DET_CONFD_ELEVATION_350 : 213|2@1+ (1,0) [0|3] ""  ADAS
 SG_ DET_PROB_1STAZHYPO_350 : 215|1@1+ (1,0) [0|1] ""  ADAS
 SG_ DET_IDM_350 : 175|1@1+ (1,0) [0|1] ""  ADAS
 SG_ DET_MTD_350 : 159|1@1+ (1,0) [0|1] ""  ADAS
 SG_ DET_BELOW_RAIN_THOLD_350 : 151|1@1+ (1,0) [0|1] ""  ADAS
 SG_ DET_RANGE_351 : 248|15@1+ (0.015625,0) [0|500] "m"  ADAS
 SG_ DET_RANGE_ERR_351 : 264|7@1+ (0.0075,0) [0|0.9525] "m"  ADAS
 SG_ DET_RANGE_VELOCITY_351 : 272|15@1+ (0.0078125,-128) [-128|127.9921875] "m/s"  ADAS
 SG_ DET_RANGE_VELOCITY_ERR_351 : 288|8@1+ (0.003,0) [0|0.765] "m/s"  ADAS
 SG_ DET_AZIMUTH_351 : 312|13@1+ (0.0004,-1.5708) [-1.5708|1.5708] "rad"  ADAS
 SG_ DET_AZIMUTH_ERR_351 : 329|7@1+ (0.00087267,0) [0|0.11082909] "rad"  ADAS
 SG_ DET_ELEVATION_351 : 296|8@1+ (0.00275,-0.34925) [-0.34925|0.34925] "rad"  ADAS
 SG_ DET_ELEVATION_ERR_351 : 304|6@1+ (0.00174533,0) [0|0.10995579] "rad"  ADAS
 SG_ DET_RCS_351 : 352|8@1+ (0.5,-64) [-64|63.5] "dBsm"  ADAS
 SG_ DET_BI_STATIC_FLAG_351 : 328|1@1+ (1,0) [0|1] ""  ADAS
 SG_ DET_SUPER_RES_TARGET_351 : 311|1@1+ (1,0) [0|1] ""  ADAS
 SG_ DET_SNR_351 : 344|8@1+ (0.35156,0) [0|89.6478] "dB"  ADAS
 SG_ DET_EXISTENCE_PROB_351 : 336|6@1+ (1.588,0) [0|100] "%"  ADAS
 SG_ DET_HVC_FLAG_351 : 310|1@1+ (1,0) [0|1] ""  ADAS
 SG_ DET_CONFD_AZIMUTH_351 : 342|2@1+ (1,0) [0|3] ""  ADAS
 SG_ DET_CONFD_ELEVATION_351 : 325|2@1+ (1,0) [0|3] ""  ADAS
 SG_ DET_PROB_1STAZHYPO_351 : 327|1@1+ (1,0) [0|1] ""  ADAS
 SG_ DET_IDM_351 : 287|1@1+ (1,0) [0|1] ""  ADAS
 SG_ DET_MTD_351 : 271|1@1+ (1,0) [0|1] ""  ADAS
 SG_ DET_BELOW_RAIN_THOLD_351 : 263|1@1+ (1,0) [0|1] ""  ADAS
 SG_ DET_RANGE_352 : 360|15@1+ (0.015625,0) [0|500] "m"  ADAS
 SG_ DET_RANGE_ERR_352 : 376|7@1+ (0.0075,0) [0|0.9525] "m"  ADAS
 SG_ DET_RANGE_VELOCITY_352 : 384|15@1+ (0.0078125,-128) [-128|127.9921875] "m/s"  ADAS
 SG_ DET_RANGE_VELOCITY_ERR_352 : 400|8@1+ (0.003,0) [0|0.765] "m/s"  ADAS
 SG_ DET_AZIMUTH_352 : 424|13@1+ (0.0004,-1.5708) [-1.5708|1.5708] "rad"  ADAS
 SG_ DET_AZIMUTH_ERR_352 : 441|7@1+ (0.00087267,0) [0|0.11082909] "rad"  ADAS
 SG_ DET_ELEVATION_352 : 408|8@1+ (0.00275,-0.34925) [-0.34925|0.34925] "rad"  ADAS
 SG_ DET_ELEVATION_ERR_352 : 416|6@1+ (0.00174533,0) [0|0.10995579] "rad"  ADAS
 SG_ DET_RCS_352 : 464|8@1+ (0.5,-64) [-64|63.5] "dBsm"  ADAS
 SG_ DET_BI_STATIC_FLAG_352 : 440|1@1+ (1,0) [0|1] ""  ADAS
 SG_ DET_SUPER_RES_TARGET_352 : 423|1@1+ (1,0) [0|1] ""  ADAS
 SG_ DET_SNR_352 : 456|8@1+ (0.35156,0) [0|89.6478] "dB"  ADAS
 SG_ DET_EXISTENCE_PROB_352 : 448|6@1+ (1.588,0) [0|100] "%"  ADAS
 SG_ DET_HVC_FLAG_352 : 422|1@1+ (1,0) [0|1] ""  ADAS
 SG_ DET_CONFD_AZIMUTH_352 : 454|2@1+ (1,0) [0|3] ""  ADAS
 SG_ DET_CONFD_ELEVATION_352 : 437|2@1+ (1,0) [0|3] ""  ADAS
 SG_ DET_MH_SCAN_INDEX_4LSB_349_352 : 476|4@1+ (1,0) [0|15] ""  ADAS
 SG_ DET_MH_CYCLE_COUNTER_349_352 : 16|8@1+ (1,0) [0|255] ""  ADAS
 SG_ DET_MH_CRC16_349_352 : 0|16@1+ (1,0) [0|65535] ""  ADAS
 SG_ DET_PROB_1STAZHYPO_352 : 439|1@1+ (1,0) [0|1] ""  ADAS
 SG_ DET_IDM_352 : 399|1@1+ (1,0) [0|1] ""  ADAS
 SG_ DET_MTD_352 : 383|1@1+ (1,0) [0|1] ""  ADAS
 SG_ DET_BELOW_RAIN_THOLD_352 : 375|1@1+ (1,0) [0|1] ""  ADAS

CM_ SG_ 1096 DET_RANGE_289 " measured position  of the detection";
CM_ SG_ 1096 DET_RANGE_ERR_289 "RMSE or standard deviation of the measured angle  of the detection";
CM_ SG_ 1096 DET_RANGE_VELOCITY_289 "Radial velocity of the detection positive in direction to the sensor";
CM_ SG_ 1096 DET_RANGE_VELOCITY_ERR_289 "RMSE or standard deviation of the measure radial velocity of the detection";
CM_ SG_ 1096 DET_AZIMUTH_289 "Measured angle  of the detection";
CM_ SG_ 1096 DET_AZIMUTH_ERR_289 "RMSE or standard deviation of the measured angle  of the detection";
CM_ SG_ 1096 DET_ELEVATION_289 "measured elevation of the detection";
CM_ SG_ 1096 DET_ELEVATION_ERR_289 "RMSE or standard deviation of the measured elevation  of the detection";
CM_ SG_ 1096 DET_RCS_289 "Radar Cross Section or Amplitude, is a measure of how detectable an object is by radar. A larger RCS indicates that an object is more easily detected.";
CM_ SG_ 1096 DET_BI_STATIC_FLAG_289 "1 if detection is bi-static 0 otherwise";
CM_ SG_ 1096 DET_SUPER_RES_TARGET_289 "flasg is set if the detection is super resolution target";
CM_ SG_ 1096 DET_SNR_289 "The signal to noise ratio (SNR) of the radar detection";
CM_ SG_ 1096 DET_EXISTENCE_PROB_289 "Existence probability of the detection not based on history. Value does  not depend on any past experience with similar detections.
\note Use as confidence measure where a low value means less confidence
and a high value indicates strong confidence.";
CM_ SG_ 1096 DET_HVC_FLAG_289 "Core2 Vehicle clutter flag";
CM_ SG_ 1096 DET_CONFD_AZIMUTH_289 "Define the Confidence of Azimuth for Detection ";
CM_ SG_ 1096 DET_CONFD_ELEVATION_289 "Define the Confidence of Elevation for the Detection ";
CM_ SG_ 1096 DET_BI_STATIC_FLAG_290 "1 if detection is bi-static 0 otherwise";
CM_ SG_ 1096 DET_BI_STATIC_FLAG_291 "1 if detection is bi-static 0 otherwise";
CM_ SG_ 1096 DET_BI_STATIC_FLAG_292 "1 if detection is bi-static 0 otherwise";
CM_ SG_ 1096 DET_MH_SCAN_INDEX_4LSB_289_292 "Scan index of the measured detection";
CM_ SG_ 1096 DET_MH_CYCLE_COUNTER_289_292 "Detection Alive Counter";
CM_ SG_ 1097 DET_RANGE_293 " measured position  of the detection";
CM_ SG_ 1097 DET_RANGE_ERR_293 "RMSE or standard deviation of the measured angle  of the detection";
CM_ SG_ 1097 DET_RANGE_VELOCITY_293 "Radial velocity of the detection positive in direction to the sensor";
CM_ SG_ 1097 DET_RANGE_VELOCITY_ERR_293 "RMSE or standard deviation of the measure radial velocity of the detection";
CM_ SG_ 1097 DET_AZIMUTH_293 "Measured angle  of the detection";
CM_ SG_ 1097 DET_AZIMUTH_ERR_293 "RMSE or standard deviation of the measured angle  of the detection";
CM_ SG_ 1097 DET_ELEVATION_293 "measured elevation of the detection";
CM_ SG_ 1097 DET_ELEVATION_ERR_293 "RMSE or standard deviation of the measured elevation  of the detection";
CM_ SG_ 1097 DET_RCS_293 "Radar Cross Section or Amplitude, is a measure of how detectable an object is by radar. A larger RCS indicates that an object is more easily detected.";
CM_ SG_ 1097 DET_BI_STATIC_FLAG_293 "1 if detection is bi-static 0 otherwise";
CM_ SG_ 1097 DET_SUPER_RES_TARGET_293 "flasg is set if the detection is super resolution target";
CM_ SG_ 1097 DET_SNR_293 "The signal to noise ratio (SNR) of the radar detection";
CM_ SG_ 1097 DET_EXISTENCE_PROB_293 "Existence probability of the detection not based on history. Value does  not depend on any past experience with similar detections.
\note Use as confidence measure where a low value means less confidence
and a high value indicates strong confidence.";
CM_ SG_ 1097 DET_HVC_FLAG_293 "Core2 Vehicle clutter flag";
CM_ SG_ 1097 DET_CONFD_AZIMUTH_293 "Define the Confidence of Azimuth for Detection ";
CM_ SG_ 1097 DET_CONFD_ELEVATION_293 "Define the Confidence of Elevation for the Detection ";
CM_ SG_ 1097 DET_BI_STATIC_FLAG_294 "1 if detection is bi-static 0 otherwise";
CM_ SG_ 1097 DET_BI_STATIC_FLAG_295 "1 if detection is bi-static 0 otherwise";
CM_ SG_ 1097 DET_BI_STATIC_FLAG_296 "1 if detection is bi-static 0 otherwise";
CM_ SG_ 1097 DET_MH_SCAN_INDEX_4LSB_293_296 "Scan index of the measured detection";
CM_ SG_ 1097 DET_MH_CYCLE_COUNTER_293_296 "Detection Alive Counter";
CM_ SG_ 1098 DET_RANGE_297 " measured position  of the detection";
CM_ SG_ 1098 DET_RANGE_ERR_297 "RMSE or standard deviation of the measured angle  of the detection";
CM_ SG_ 1098 DET_RANGE_VELOCITY_297 "Radial velocity of the detection positive in direction to the sensor";
CM_ SG_ 1098 DET_RANGE_VELOCITY_ERR_297 "RMSE or standard deviation of the measure radial velocity of the detection";
CM_ SG_ 1098 DET_AZIMUTH_297 "Measured angle  of the detection";
CM_ SG_ 1098 DET_AZIMUTH_ERR_297 "RMSE or standard deviation of the measured angle  of the detection";
CM_ SG_ 1098 DET_ELEVATION_297 "measured elevation of the detection";
CM_ SG_ 1098 DET_ELEVATION_ERR_297 "RMSE or standard deviation of the measured elevation  of the detection";
CM_ SG_ 1098 DET_RCS_297 "Radar Cross Section or Amplitude, is a measure of how detectable an object is by radar. A larger RCS indicates that an object is more easily detected.";
CM_ SG_ 1098 DET_BI_STATIC_FLAG_297 "1 if detection is bi-static 0 otherwise";
CM_ SG_ 1098 DET_SUPER_RES_TARGET_297 "flasg is set if the detection is super resolution target";
CM_ SG_ 1098 DET_SNR_297 "The signal to noise ratio (SNR) of the radar detection";
CM_ SG_ 1098 DET_EXISTENCE_PROB_297 "Existence probability of the detection not based on history. Value does  not depend on any past experience with similar detections.
\note Use as confidence measure where a low value means less confidence
and a high value indicates strong confidence.";
CM_ SG_ 1098 DET_HVC_FLAG_297 "Core2 Vehicle clutter flag";
CM_ SG_ 1098 DET_CONFD_AZIMUTH_297 "Define the Confidence of Azimuth for Detection ";
CM_ SG_ 1098 DET_CONFD_ELEVATION_297 "Define the Confidence of Elevation for the Detection ";
CM_ SG_ 1098 DET_BI_STATIC_FLAG_298 "1 if detection is bi-static 0 otherwise";
CM_ SG_ 1098 DET_BI_STATIC_FLAG_299 "1 if detection is bi-static 0 otherwise";
CM_ SG_ 1098 DET_BI_STATIC_FLAG_300 "1 if detection is bi-static 0 otherwise";
CM_ SG_ 1098 DET_MH_SCAN_INDEX_4LSB_297_300 "Scan index of the measured detection";
CM_ SG_ 1098 DET_MH_CYCLE_COUNTER_297_300 "Detection Alive Counter";
CM_ SG_ 1099 DET_RANGE_301 " measured position  of the detection";
CM_ SG_ 1099 DET_RANGE_ERR_301 "RMSE or standard deviation of the measured angle  of the detection";
CM_ SG_ 1099 DET_RANGE_VELOCITY_301 "Radial velocity of the detection positive in direction to the sensor";
CM_ SG_ 1099 DET_RANGE_VELOCITY_ERR_301 "RMSE or standard deviation of the measure radial velocity of the detection";
CM_ SG_ 1099 DET_AZIMUTH_301 "Measured angle  of the detection";
CM_ SG_ 1099 DET_AZIMUTH_ERR_301 "RMSE or standard deviation of the measured angle  of the detection";
CM_ SG_ 1099 DET_ELEVATION_301 "measured elevation of the detection";
CM_ SG_ 1099 DET_ELEVATION_ERR_301 "RMSE or standard deviation of the measured elevation  of the detection";
CM_ SG_ 1099 DET_RCS_301 "Radar Cross Section or Amplitude, is a measure of how detectable an object is by radar. A larger RCS indicates that an object is more easily detected.";
CM_ SG_ 1099 DET_BI_STATIC_FLAG_301 "1 if detection is bi-static 0 otherwise";
CM_ SG_ 1099 DET_SUPER_RES_TARGET_301 "flasg is set if the detection is super resolution target";
CM_ SG_ 1099 DET_SNR_301 "The signal to noise ratio (SNR) of the radar detection";
CM_ SG_ 1099 DET_EXISTENCE_PROB_301 "Existence probability of the detection not based on history. Value does  not depend on any past experience with similar detections.
\note Use as confidence measure where a low value means less confidence
and a high value indicates strong confidence.";
CM_ SG_ 1099 DET_HVC_FLAG_301 "Core2 Vehicle clutter flag";
CM_ SG_ 1099 DET_CONFD_AZIMUTH_301 "Define the Confidence of Azimuth for Detection ";
CM_ SG_ 1099 DET_CONFD_ELEVATION_301 "Define the Confidence of Elevation for the Detection ";
CM_ SG_ 1099 DET_BI_STATIC_FLAG_302 "1 if detection is bi-static 0 otherwise";
CM_ SG_ 1099 DET_BI_STATIC_FLAG_303 "1 if detection is bi-static 0 otherwise";
CM_ SG_ 1099 DET_BI_STATIC_FLAG_304 "1 if detection is bi-static 0 otherwise";
CM_ SG_ 1099 DET_MH_SCAN_INDEX_4LSB_301_304 "Scan index of the measured detection";
CM_ SG_ 1099 DET_MH_CYCLE_COUNTER_301_304 "Detection Alive Counter";
CM_ SG_ 1100 DET_RANGE_305 " measured position  of the detection";
CM_ SG_ 1100 DET_RANGE_ERR_305 "RMSE or standard deviation of the measured angle  of the detection";
CM_ SG_ 1100 DET_RANGE_VELOCITY_305 "Radial velocity of the detection positive in direction to the sensor";
CM_ SG_ 1100 DET_RANGE_VELOCITY_ERR_305 "RMSE or standard deviation of the measure radial velocity of the detection";
CM_ SG_ 1100 DET_AZIMUTH_305 "Measured angle  of the detection";
CM_ SG_ 1100 DET_AZIMUTH_ERR_305 "RMSE or standard deviation of the measured angle  of the detection";
CM_ SG_ 1100 DET_ELEVATION_305 "measured elevation of the detection";
CM_ SG_ 1100 DET_ELEVATION_ERR_305 "RMSE or standard deviation of the measured elevation  of the detection";
CM_ SG_ 1100 DET_RCS_305 "Radar Cross Section or Amplitude, is a measure of how detectable an object is by radar. A larger RCS indicates that an object is more easily detected.";
CM_ SG_ 1100 DET_BI_STATIC_FLAG_305 "1 if detection is bi-static 0 otherwise";
CM_ SG_ 1100 DET_SUPER_RES_TARGET_305 "flasg is set if the detection is super resolution target";
CM_ SG_ 1100 DET_SNR_305 "The signal to noise ratio (SNR) of the radar detection";
CM_ SG_ 1100 DET_EXISTENCE_PROB_305 "Existence probability of the detection not based on history. Value does  not depend on any past experience with similar detections.
\note Use as confidence measure where a low value means less confidence
and a high value indicates strong confidence.";
CM_ SG_ 1100 DET_HVC_FLAG_305 "Core2 Vehicle clutter flag";
CM_ SG_ 1100 DET_CONFD_AZIMUTH_305 "Define the Confidence of Azimuth for Detection ";
CM_ SG_ 1100 DET_CONFD_ELEVATION_305 "Define the Confidence of Elevation for the Detection ";
CM_ SG_ 1100 DET_BI_STATIC_FLAG_306 "1 if detection is bi-static 0 otherwise";
CM_ SG_ 1100 DET_BI_STATIC_FLAG_307 "1 if detection is bi-static 0 otherwise";
CM_ SG_ 1100 DET_BI_STATIC_FLAG_308 "1 if detection is bi-static 0 otherwise";
CM_ SG_ 1100 DET_MH_SCAN_INDEX_4LSB_305_308 "Scan index of the measured detection";
CM_ SG_ 1100 DET_MH_CYCLE_COUNTER_305_308 "Detection Alive Counter";
CM_ SG_ 1101 DET_RANGE_309 " measured position  of the detection";
CM_ SG_ 1101 DET_RANGE_ERR_309 "RMSE or standard deviation of the measured angle  of the detection";
CM_ SG_ 1101 DET_RANGE_VELOCITY_309 "Radial velocity of the detection positive in direction to the sensor";
CM_ SG_ 1101 DET_RANGE_VELOCITY_ERR_309 "RMSE or standard deviation of the measure radial velocity of the detection";
CM_ SG_ 1101 DET_AZIMUTH_309 "Measured angle  of the detection";
CM_ SG_ 1101 DET_AZIMUTH_ERR_309 "RMSE or standard deviation of the measured angle  of the detection";
CM_ SG_ 1101 DET_ELEVATION_309 "measured elevation of the detection";
CM_ SG_ 1101 DET_ELEVATION_ERR_309 "RMSE or standard deviation of the measured elevation  of the detection";
CM_ SG_ 1101 DET_RCS_309 "Radar Cross Section or Amplitude, is a measure of how detectable an object is by radar. A larger RCS indicates that an object is more easily detected.";
CM_ SG_ 1101 DET_BI_STATIC_FLAG_309 "1 if detection is bi-static 0 otherwise";
CM_ SG_ 1101 DET_SUPER_RES_TARGET_309 "flasg is set if the detection is super resolution target";
CM_ SG_ 1101 DET_SNR_309 "The signal to noise ratio (SNR) of the radar detection";
CM_ SG_ 1101 DET_EXISTENCE_PROB_309 "Existence probability of the detection not based on history. Value does  not depend on any past experience with similar detections.
\note Use as confidence measure where a low value means less confidence
and a high value indicates strong confidence.";
CM_ SG_ 1101 DET_HVC_FLAG_309 "Core2 Vehicle clutter flag";
CM_ SG_ 1101 DET_CONFD_AZIMUTH_309 "Define the Confidence of Azimuth for Detection ";
CM_ SG_ 1101 DET_CONFD_ELEVATION_309 "Define the Confidence of Elevation for the Detection ";
CM_ SG_ 1101 DET_BI_STATIC_FLAG_310 "1 if detection is bi-static 0 otherwise";
CM_ SG_ 1101 DET_BI_STATIC_FLAG_311 "1 if detection is bi-static 0 otherwise";
CM_ SG_ 1101 DET_BI_STATIC_FLAG_312 "1 if detection is bi-static 0 otherwise";
CM_ SG_ 1101 DET_MH_SCAN_INDEX_4LSB_309_312 "Scan index of the measured detection";
CM_ SG_ 1101 DET_MH_CYCLE_COUNTER_309_312 "Detection Alive Counter";
CM_ SG_ 1102 DET_RANGE_313 " measured position  of the detection";
CM_ SG_ 1102 DET_RANGE_ERR_313 "RMSE or standard deviation of the measured angle  of the detection";
CM_ SG_ 1102 DET_RANGE_VELOCITY_313 "Radial velocity of the detection positive in direction to the sensor";
CM_ SG_ 1102 DET_RANGE_VELOCITY_ERR_313 "RMSE or standard deviation of the measure radial velocity of the detection";
CM_ SG_ 1102 DET_AZIMUTH_313 "Measured angle  of the detection";
CM_ SG_ 1102 DET_AZIMUTH_ERR_313 "RMSE or standard deviation of the measured angle  of the detection";
CM_ SG_ 1102 DET_ELEVATION_313 "measured elevation of the detection";
CM_ SG_ 1102 DET_ELEVATION_ERR_313 "RMSE or standard deviation of the measured elevation  of the detection";
CM_ SG_ 1102 DET_RCS_313 "Radar Cross Section or Amplitude, is a measure of how detectable an object is by radar. A larger RCS indicates that an object is more easily detected.";
CM_ SG_ 1102 DET_BI_STATIC_FLAG_313 "1 if detection is bi-static 0 otherwise";
CM_ SG_ 1102 DET_SUPER_RES_TARGET_313 "flasg is set if the detection is super resolution target";
CM_ SG_ 1102 DET_SNR_313 "The signal to noise ratio (SNR) of the radar detection";
CM_ SG_ 1102 DET_EXISTENCE_PROB_313 "Existence probability of the detection not based on history. Value does  not depend on any past experience with similar detections.
\note Use as confidence measure where a low value means less confidence
and a high value indicates strong confidence.";
CM_ SG_ 1102 DET_HVC_FLAG_313 "Core2 Vehicle clutter flag";
CM_ SG_ 1102 DET_CONFD_AZIMUTH_313 "Define the Confidence of Azimuth for Detection ";
CM_ SG_ 1102 DET_CONFD_ELEVATION_313 "Define the Confidence of Elevation for the Detection ";
CM_ SG_ 1102 DET_BI_STATIC_FLAG_314 "1 if detection is bi-static 0 otherwise";
CM_ SG_ 1102 DET_BI_STATIC_FLAG_315 "1 if detection is bi-static 0 otherwise";
CM_ SG_ 1102 DET_BI_STATIC_FLAG_316 "1 if detection is bi-static 0 otherwise";
CM_ SG_ 1102 DET_MH_SCAN_INDEX_4LSB_313_316 "Scan index of the measured detection";
CM_ SG_ 1102 DET_MH_CYCLE_COUNTER_313_316 "Detection Alive Counter";
CM_ SG_ 1103 DET_RANGE_317 " measured position  of the detection";
CM_ SG_ 1103 DET_RANGE_ERR_317 "RMSE or standard deviation of the measured angle  of the detection";
CM_ SG_ 1103 DET_RANGE_VELOCITY_317 "Radial velocity of the detection positive in direction to the sensor";
CM_ SG_ 1103 DET_RANGE_VELOCITY_ERR_317 "RMSE or standard deviation of the measure radial velocity of the detection";
CM_ SG_ 1103 DET_AZIMUTH_317 "Measured angle  of the detection";
CM_ SG_ 1103 DET_AZIMUTH_ERR_317 "RMSE or standard deviation of the measured angle  of the detection";
CM_ SG_ 1103 DET_ELEVATION_317 "measured elevation of the detection";
CM_ SG_ 1103 DET_ELEVATION_ERR_317 "RMSE or standard deviation of the measured elevation  of the detection";
CM_ SG_ 1103 DET_RCS_317 "Radar Cross Section or Amplitude, is a measure of how detectable an object is by radar. A larger RCS indicates that an object is more easily detected.";
CM_ SG_ 1103 DET_BI_STATIC_FLAG_317 "1 if detection is bi-static 0 otherwise";
CM_ SG_ 1103 DET_SUPER_RES_TARGET_317 "flasg is set if the detection is super resolution target";
CM_ SG_ 1103 DET_SNR_317 "The signal to noise ratio (SNR) of the radar detection";
CM_ SG_ 1103 DET_EXISTENCE_PROB_317 "Existence probability of the detection not based on history. Value does  not depend on any past experience with similar detections.
\note Use as confidence measure where a low value means less confidence
and a high value indicates strong confidence.";
CM_ SG_ 1103 DET_HVC_FLAG_317 "Core2 Vehicle clutter flag";
CM_ SG_ 1103 DET_CONFD_AZIMUTH_317 "Define the Confidence of Azimuth for Detection ";
CM_ SG_ 1103 DET_CONFD_ELEVATION_317 "Define the Confidence of Elevation for the Detection ";
CM_ SG_ 1103 DET_BI_STATIC_FLAG_318 "1 if detection is bi-static 0 otherwise";
CM_ SG_ 1103 DET_BI_STATIC_FLAG_319 "1 if detection is bi-static 0 otherwise";
CM_ SG_ 1103 DET_BI_STATIC_FLAG_320 "1 if detection is bi-static 0 otherwise";
CM_ SG_ 1103 DET_MH_SCAN_INDEX_4LSB_317_320 "Scan index of the measured detection";
CM_ SG_ 1103 DET_MH_CYCLE_COUNTER_317_320 "Detection Alive Counter";
CM_ SG_ 1104 DET_RANGE_321 " measured position  of the detection";
CM_ SG_ 1104 DET_RANGE_ERR_321 "RMSE or standard deviation of the measured angle  of the detection";
CM_ SG_ 1104 DET_RANGE_VELOCITY_321 "Radial velocity of the detection positive in direction to the sensor";
CM_ SG_ 1104 DET_RANGE_VELOCITY_ERR_321 "RMSE or standard deviation of the measure radial velocity of the detection";
CM_ SG_ 1104 DET_AZIMUTH_321 "Measured angle  of the detection";
CM_ SG_ 1104 DET_AZIMUTH_ERR_321 "RMSE or standard deviation of the measured angle  of the detection";
CM_ SG_ 1104 DET_ELEVATION_321 "measured elevation of the detection";
CM_ SG_ 1104 DET_ELEVATION_ERR_321 "RMSE or standard deviation of the measured elevation  of the detection";
CM_ SG_ 1104 DET_RCS_321 "Radar Cross Section or Amplitude, is a measure of how detectable an object is by radar. A larger RCS indicates that an object is more easily detected.";
CM_ SG_ 1104 DET_BI_STATIC_FLAG_321 "1 if detection is bi-static 0 otherwise";
CM_ SG_ 1104 DET_SUPER_RES_TARGET_321 "flasg is set if the detection is super resolution target";
CM_ SG_ 1104 DET_SNR_321 "The signal to noise ratio (SNR) of the radar detection";
CM_ SG_ 1104 DET_EXISTENCE_PROB_321 "Existence probability of the detection not based on history. Value does  not depend on any past experience with similar detections.
\note Use as confidence measure where a low value means less confidence
and a high value indicates strong confidence.";
CM_ SG_ 1104 DET_HVC_FLAG_321 "Core2 Vehicle clutter flag";
CM_ SG_ 1104 DET_CONFD_AZIMUTH_321 "Define the Confidence of Azimuth for Detection ";
CM_ SG_ 1104 DET_CONFD_ELEVATION_321 "Define the Confidence of Elevation for the Detection ";
CM_ SG_ 1104 DET_BI_STATIC_FLAG_322 "1 if detection is bi-static 0 otherwise";
CM_ SG_ 1104 DET_BI_STATIC_FLAG_323 "1 if detection is bi-static 0 otherwise";
CM_ SG_ 1104 DET_BI_STATIC_FLAG_324 "1 if detection is bi-static 0 otherwise";
CM_ SG_ 1104 DET_MH_SCAN_INDEX_4LSB_321_324 "Scan index of the measured detection";
CM_ SG_ 1104 DET_MH_CYCLE_COUNTER_321_324 "Detection Alive Counter";
CM_ SG_ 1105 DET_RANGE_325 " measured position  of the detection";
CM_ SG_ 1105 DET_RANGE_ERR_325 "RMSE or standard deviation of the measured angle  of the detection";
CM_ SG_ 1105 DET_RANGE_VELOCITY_325 "Radial velocity of the detection positive in direction to the sensor";
CM_ SG_ 1105 DET_RANGE_VELOCITY_ERR_325 "RMSE or standard deviation of the measure radial velocity of the detection";
CM_ SG_ 1105 DET_AZIMUTH_325 "Measured angle  of the detection";
CM_ SG_ 1105 DET_AZIMUTH_ERR_325 "RMSE or standard deviation of the measured angle  of the detection";
CM_ SG_ 1105 DET_ELEVATION_325 "measured elevation of the detection";
CM_ SG_ 1105 DET_ELEVATION_ERR_325 "RMSE or standard deviation of the measured elevation  of the detection";
CM_ SG_ 1105 DET_RCS_325 "Radar Cross Section or Amplitude, is a measure of how detectable an object is by radar. A larger RCS indicates that an object is more easily detected.";
CM_ SG_ 1105 DET_BI_STATIC_FLAG_325 "1 if detection is bi-static 0 otherwise";
CM_ SG_ 1105 DET_SUPER_RES_TARGET_325 "flasg is set if the detection is super resolution target";
CM_ SG_ 1105 DET_SNR_325 "The signal to noise ratio (SNR) of the radar detection";
CM_ SG_ 1105 DET_EXISTENCE_PROB_325 "Existence probability of the detection not based on history. Value does  not depend on any past experience with similar detections.
\note Use as confidence measure where a low value means less confidence
and a high value indicates strong confidence.";
CM_ SG_ 1105 DET_HVC_FLAG_325 "Core2 Vehicle clutter flag";
CM_ SG_ 1105 DET_CONFD_AZIMUTH_325 "Define the Confidence of Azimuth for Detection ";
CM_ SG_ 1105 DET_CONFD_ELEVATION_325 "Define the Confidence of Elevation for the Detection ";
CM_ SG_ 1105 DET_BI_STATIC_FLAG_326 "1 if detection is bi-static 0 otherwise";
CM_ SG_ 1105 DET_BI_STATIC_FLAG_327 "1 if detection is bi-static 0 otherwise";
CM_ SG_ 1105 DET_BI_STATIC_FLAG_328 "1 if detection is bi-static 0 otherwise";
CM_ SG_ 1105 DET_MH_SCAN_INDEX_4LSB_325_328 "Scan index of the measured detection";
CM_ SG_ 1105 DET_MH_CYCLE_COUNTER_325_328 "Detection Alive Counter";
CM_ SG_ 1106 DET_RANGE_329 " measured position  of the detection";
CM_ SG_ 1106 DET_RANGE_ERR_329 "RMSE or standard deviation of the measured angle  of the detection";
CM_ SG_ 1106 DET_RANGE_VELOCITY_329 "Radial velocity of the detection positive in direction to the sensor";
CM_ SG_ 1106 DET_RANGE_VELOCITY_ERR_329 "RMSE or standard deviation of the measure radial velocity of the detection";
CM_ SG_ 1106 DET_AZIMUTH_329 "Measured angle  of the detection";
CM_ SG_ 1106 DET_AZIMUTH_ERR_329 "RMSE or standard deviation of the measured angle  of the detection";
CM_ SG_ 1106 DET_ELEVATION_329 "measured elevation of the detection";
CM_ SG_ 1106 DET_ELEVATION_ERR_329 "RMSE or standard deviation of the measured elevation  of the detection";
CM_ SG_ 1106 DET_RCS_329 "Radar Cross Section or Amplitude, is a measure of how detectable an object is by radar. A larger RCS indicates that an object is more easily detected.";
CM_ SG_ 1106 DET_BI_STATIC_FLAG_329 "1 if detection is bi-static 0 otherwise";
CM_ SG_ 1106 DET_SUPER_RES_TARGET_329 "flasg is set if the detection is super resolution target";
CM_ SG_ 1106 DET_SNR_329 "The signal to noise ratio (SNR) of the radar detection";
CM_ SG_ 1106 DET_EXISTENCE_PROB_329 "Existence probability of the detection not based on history. Value does  not depend on any past experience with similar detections.
\note Use as confidence measure where a low value means less confidence
and a high value indicates strong confidence.";
CM_ SG_ 1106 DET_HVC_FLAG_329 "Core2 Vehicle clutter flag";
CM_ SG_ 1106 DET_CONFD_AZIMUTH_329 "Define the Confidence of Azimuth for Detection ";
CM_ SG_ 1106 DET_CONFD_ELEVATION_329 "Define the Confidence of Elevation for the Detection ";
CM_ SG_ 1106 DET_BI_STATIC_FLAG_330 "1 if detection is bi-static 0 otherwise";
CM_ SG_ 1106 DET_BI_STATIC_FLAG_331 "1 if detection is bi-static 0 otherwise";
CM_ SG_ 1106 DET_BI_STATIC_FLAG_332 "1 if detection is bi-static 0 otherwise";
CM_ SG_ 1106 DET_MH_SCAN_INDEX_4LSB_329_332 "Scan index of the measured detection";
CM_ SG_ 1106 DET_MH_CYCLE_COUNTER_329_332 "Detection Alive Counter";
CM_ SG_ 1107 DET_RANGE_333 " measured position  of the detection";
CM_ SG_ 1107 DET_RANGE_ERR_333 "RMSE or standard deviation of the measured angle  of the detection";
CM_ SG_ 1107 DET_RANGE_VELOCITY_333 "Radial velocity of the detection positive in direction to the sensor";
CM_ SG_ 1107 DET_RANGE_VELOCITY_ERR_333 "RMSE or standard deviation of the measure radial velocity of the detection";
CM_ SG_ 1107 DET_AZIMUTH_333 "Measured angle  of the detection";
CM_ SG_ 1107 DET_AZIMUTH_ERR_333 "RMSE or standard deviation of the measured angle  of the detection";
CM_ SG_ 1107 DET_ELEVATION_333 "measured elevation of the detection";
CM_ SG_ 1107 DET_ELEVATION_ERR_333 "RMSE or standard deviation of the measured elevation  of the detection";
CM_ SG_ 1107 DET_RCS_333 "Radar Cross Section or Amplitude, is a measure of how detectable an object is by radar. A larger RCS indicates that an object is more easily detected.";
CM_ SG_ 1107 DET_BI_STATIC_FLAG_333 "1 if detection is bi-static 0 otherwise";
CM_ SG_ 1107 DET_SUPER_RES_TARGET_333 "flasg is set if the detection is super resolution target";
CM_ SG_ 1107 DET_SNR_333 "The signal to noise ratio (SNR) of the radar detection";
CM_ SG_ 1107 DET_EXISTENCE_PROB_333 "Existence probability of the detection not based on history. Value does  not depend on any past experience with similar detections.
\note Use as confidence measure where a low value means less confidence
and a high value indicates strong confidence.";
CM_ SG_ 1107 DET_HVC_FLAG_333 "Core2 Vehicle clutter flag";
CM_ SG_ 1107 DET_CONFD_AZIMUTH_333 "Define the Confidence of Azimuth for Detection ";
CM_ SG_ 1107 DET_CONFD_ELEVATION_333 "Define the Confidence of Elevation for the Detection ";
CM_ SG_ 1107 DET_BI_STATIC_FLAG_334 "1 if detection is bi-static 0 otherwise";
CM_ SG_ 1107 DET_BI_STATIC_FLAG_335 "1 if detection is bi-static 0 otherwise";
CM_ SG_ 1107 DET_BI_STATIC_FLAG_336 "1 if detection is bi-static 0 otherwise";
CM_ SG_ 1107 DET_MH_SCAN_INDEX_4LSB_333_336 "Scan index of the measured detection";
CM_ SG_ 1107 DET_MH_CYCLE_COUNTER_333_336 "Detection Alive Counter";
CM_ SG_ 1108 DET_RANGE_337 " measured position  of the detection";
CM_ SG_ 1108 DET_RANGE_ERR_337 "RMSE or standard deviation of the measured angle  of the detection";
CM_ SG_ 1108 DET_RANGE_VELOCITY_337 "Radial velocity of the detection positive in direction to the sensor";
CM_ SG_ 1108 DET_RANGE_VELOCITY_ERR_337 "RMSE or standard deviation of the measure radial velocity of the detection";
CM_ SG_ 1108 DET_AZIMUTH_337 "Measured angle  of the detection";
CM_ SG_ 1108 DET_AZIMUTH_ERR_337 "RMSE or standard deviation of the measured angle  of the detection";
CM_ SG_ 1108 DET_ELEVATION_337 "measured elevation of the detection";
CM_ SG_ 1108 DET_ELEVATION_ERR_337 "RMSE or standard deviation of the measured elevation  of the detection";
CM_ SG_ 1108 DET_RCS_337 "Radar Cross Section or Amplitude, is a measure of how detectable an object is by radar. A larger RCS indicates that an object is more easily detected.";
CM_ SG_ 1108 DET_BI_STATIC_FLAG_337 "1 if detection is bi-static 0 otherwise";
CM_ SG_ 1108 DET_SUPER_RES_TARGET_337 "flasg is set if the detection is super resolution target";
CM_ SG_ 1108 DET_SNR_337 "The signal to noise ratio (SNR) of the radar detection";
CM_ SG_ 1108 DET_EXISTENCE_PROB_337 "Existence probability of the detection not based on history. Value does  not depend on any past experience with similar detections.
\note Use as confidence measure where a low value means less confidence
and a high value indicates strong confidence.";
CM_ SG_ 1108 DET_HVC_FLAG_337 "Core2 Vehicle clutter flag";
CM_ SG_ 1108 DET_CONFD_AZIMUTH_337 "Define the Confidence of Azimuth for Detection ";
CM_ SG_ 1108 DET_CONFD_ELEVATION_337 "Define the Confidence of Elevation for the Detection ";
CM_ SG_ 1108 DET_BI_STATIC_FLAG_338 "1 if detection is bi-static 0 otherwise";
CM_ SG_ 1108 DET_BI_STATIC_FLAG_339 "1 if detection is bi-static 0 otherwise";
CM_ SG_ 1108 DET_BI_STATIC_FLAG_340 "1 if detection is bi-static 0 otherwise";
CM_ SG_ 1108 DET_MH_SCAN_INDEX_4LSB_337_340 "Scan index of the measured detection";
CM_ SG_ 1108 DET_MH_CYCLE_COUNTER_337_340 "Detection Alive Counter";
CM_ SG_ 1109 DET_RANGE_341 " measured position  of the detection";
CM_ SG_ 1109 DET_RANGE_ERR_341 "RMSE or standard deviation of the measured angle  of the detection";
CM_ SG_ 1109 DET_RANGE_VELOCITY_341 "Radial velocity of the detection positive in direction to the sensor";
CM_ SG_ 1109 DET_RANGE_VELOCITY_ERR_341 "RMSE or standard deviation of the measure radial velocity of the detection";
CM_ SG_ 1109 DET_AZIMUTH_341 "Measured angle  of the detection";
CM_ SG_ 1109 DET_AZIMUTH_ERR_341 "RMSE or standard deviation of the measured angle  of the detection";
CM_ SG_ 1109 DET_ELEVATION_341 "measured elevation of the detection";
CM_ SG_ 1109 DET_ELEVATION_ERR_341 "RMSE or standard deviation of the measured elevation  of the detection";
CM_ SG_ 1109 DET_RCS_341 "Radar Cross Section or Amplitude, is a measure of how detectable an object is by radar. A larger RCS indicates that an object is more easily detected.";
CM_ SG_ 1109 DET_BI_STATIC_FLAG_341 "1 if detection is bi-static 0 otherwise";
CM_ SG_ 1109 DET_SUPER_RES_TARGET_341 "flasg is set if the detection is super resolution target";
CM_ SG_ 1109 DET_SNR_341 "The signal to noise ratio (SNR) of the radar detection";
CM_ SG_ 1109 DET_EXISTENCE_PROB_341 "Existence probability of the detection not based on history. Value does  not depend on any past experience with similar detections.
\note Use as confidence measure where a low value means less confidence
and a high value indicates strong confidence.";
CM_ SG_ 1109 DET_HVC_FLAG_341 "Core2 Vehicle clutter flag";
CM_ SG_ 1109 DET_CONFD_AZIMUTH_341 "Define the Confidence of Azimuth for Detection ";
CM_ SG_ 1109 DET_CONFD_ELEVATION_341 "Define the Confidence of Elevation for the Detection ";
CM_ SG_ 1109 DET_BI_STATIC_FLAG_342 "1 if detection is bi-static 0 otherwise";
CM_ SG_ 1109 DET_BI_STATIC_FLAG_343 "1 if detection is bi-static 0 otherwise";
CM_ SG_ 1109 DET_BI_STATIC_FLAG_344 "1 if detection is bi-static 0 otherwise";
CM_ SG_ 1109 DET_MH_SCAN_INDEX_4LSB_341_344 "Scan index of the measured detection";
CM_ SG_ 1109 DET_MH_CYCLE_COUNTER_341_344 "Detection Alive Counter";
CM_ SG_ 1110 DET_RANGE_345 " measured position  of the detection";
CM_ SG_ 1110 DET_RANGE_ERR_345 "RMSE or standard deviation of the measured angle  of the detection";
CM_ SG_ 1110 DET_RANGE_VELOCITY_345 "Radial velocity of the detection positive in direction to the sensor";
CM_ SG_ 1110 DET_RANGE_VELOCITY_ERR_345 "RMSE or standard deviation of the measure radial velocity of the detection";
CM_ SG_ 1110 DET_AZIMUTH_345 "Measured angle  of the detection";
CM_ SG_ 1110 DET_AZIMUTH_ERR_345 "RMSE or standard deviation of the measured angle  of the detection";
CM_ SG_ 1110 DET_ELEVATION_345 "measured elevation of the detection";
CM_ SG_ 1110 DET_ELEVATION_ERR_345 "RMSE or standard deviation of the measured elevation  of the detection";
CM_ SG_ 1110 DET_RCS_345 "Radar Cross Section or Amplitude, is a measure of how detectable an object is by radar. A larger RCS indicates that an object is more easily detected.";
CM_ SG_ 1110 DET_BI_STATIC_FLAG_345 "1 if detection is bi-static 0 otherwise";
CM_ SG_ 1110 DET_SUPER_RES_TARGET_345 "flasg is set if the detection is super resolution target";
CM_ SG_ 1110 DET_SNR_345 "The signal to noise ratio (SNR) of the radar detection";
CM_ SG_ 1110 DET_EXISTENCE_PROB_345 "Existence probability of the detection not based on history. Value does  not depend on any past experience with similar detections.
\note Use as confidence measure where a low value means less confidence
and a high value indicates strong confidence.";
CM_ SG_ 1110 DET_HVC_FLAG_345 "Core2 Vehicle clutter flag";
CM_ SG_ 1110 DET_CONFD_AZIMUTH_345 "Define the Confidence of Azimuth for Detection ";
CM_ SG_ 1110 DET_CONFD_ELEVATION_345 "Define the Confidence of Elevation for the Detection ";
CM_ SG_ 1110 DET_BI_STATIC_FLAG_346 "1 if detection is bi-static 0 otherwise";
CM_ SG_ 1110 DET_BI_STATIC_FLAG_347 "1 if detection is bi-static 0 otherwise";
CM_ SG_ 1110 DET_BI_STATIC_FLAG_348 "1 if detection is bi-static 0 otherwise";
CM_ SG_ 1110 DET_MH_SCAN_INDEX_4LSB_345_348 "Scan index of the measured detection";
CM_ SG_ 1110 DET_MH_CYCLE_COUNTER_345_348 "Detection Alive Counter";
CM_ SG_ 1111 DET_RANGE_349 " measured position  of the detection";
CM_ SG_ 1111 DET_RANGE_ERR_349 "RMSE or standard deviation of the measured angle  of the detection";
CM_ SG_ 1111 DET_RANGE_VELOCITY_349 "Radial velocity of the detection positive in direction to the sensor";
CM_ SG_ 1111 DET_RANGE_VELOCITY_ERR_349 "RMSE or standard deviation of the measure radial velocity of the detection";
CM_ SG_ 1111 DET_AZIMUTH_349 "Measured angle  of the detection";
CM_ SG_ 1111 DET_AZIMUTH_ERR_349 "RMSE or standard deviation of the measured angle  of the detection";
CM_ SG_ 1111 DET_ELEVATION_349 "measured elevation of the detection";
CM_ SG_ 1111 DET_ELEVATION_ERR_349 "RMSE or standard deviation of the measured elevation  of the detection";
CM_ SG_ 1111 DET_RCS_349 "Radar Cross Section or Amplitude, is a measure of how detectable an object is by radar. A larger RCS indicates that an object is more easily detected.";
CM_ SG_ 1111 DET_BI_STATIC_FLAG_349 "1 if detection is bi-static 0 otherwise";
CM_ SG_ 1111 DET_SUPER_RES_TARGET_349 "flasg is set if the detection is super resolution target";
CM_ SG_ 1111 DET_SNR_349 "The signal to noise ratio (SNR) of the radar detection";
CM_ SG_ 1111 DET_EXISTENCE_PROB_349 "Existence probability of the detection not based on history. Value does  not depend on any past experience with similar detections.
\note Use as confidence measure where a low value means less confidence
and a high value indicates strong confidence.";
CM_ SG_ 1111 DET_HVC_FLAG_349 "Core2 Vehicle clutter flag";
CM_ SG_ 1111 DET_CONFD_AZIMUTH_349 "Define the Confidence of Azimuth for Detection ";
CM_ SG_ 1111 DET_CONFD_ELEVATION_349 "Define the Confidence of Elevation for the Detection ";
CM_ SG_ 1111 DET_BI_STATIC_FLAG_350 "1 if detection is bi-static 0 otherwise";
CM_ SG_ 1111 DET_BI_STATIC_FLAG_351 "1 if detection is bi-static 0 otherwise";
CM_ SG_ 1111 DET_BI_STATIC_FLAG_352 "1 if detection is bi-static 0 otherwise";
CM_ SG_ 1111 DET_MH_SCAN_INDEX_4LSB_349_352 "Scan index of the measured detection";
CM_ SG_ 1111 DET_MH_CYCLE_COUNTER_349_352 "Detection Alive Counter";
BA_DEF_ BO_  "VFrameFormat" ENUM  "StandardCAN","ExtendedCAN","reserved","reserved","reserved","reserved","reserved","reserved","reserved","reserved","reserved","reserved","reserved","reserved","StandardCAN_FD","ExtendedCAN_FD";
BA_DEF_ BO_  "CanTpBs" INT 0 255;
BA_DEF_ BO_  "DiagConnection" INT 0 65535;
BA_DEF_ BO_  "DiagRequest" ENUM  "No","Yes";
BA_DEF_ BO_  "DiagResponse" ENUM  "No","Yes";
BA_DEF_ BO_  "DiagState" ENUM  "No","Yes";
BA_DEF_ BO_  "E2EDataId" INT 0 65535;
BA_DEF_ BO_  "E2EDataLength" INT 0 65535;
BA_DEF_ BO_  "E2EProfile" STRING ;
BA_DEF_ BO_  "EventRateOfChange" INT 10 10000;
BA_DEF_ BO_  "GenMsgCycleTime" INT 0 100000;
BA_DEF_ BO_  "GenMsgILSupport" ENUM  "No","Yes";
BA_DEF_ BO_  "GenMsgNrOfRepetition" INT 0 100;
BA_DEF_ BO_  "GenMsgSendType" ENUM  "FixedPeriodic","Event","EnabledPeriodic","NotUsed","NotUsed","EventPeriodic","NotUsed","NotUsed","NoMsgSendType";
BA_DEF_ BO_  "NetworkInitialization" ENUM  "No","Yes";
BA_DEF_ BO_  "NmAsrMessage" ENUM  "No","Yes";
BA_DEF_ BO_  "NmMessage" ENUM  "No","Yes";
BA_DEF_ BO_  "SCP_AuthInfoTxLength" INT 0 512;
BA_DEF_ BO_  "SCP_FreshnessValueLength" INT 0 512;
BA_DEF_ BO_  "SCP_FreshnessValueTxLength" INT 0 512;
BA_DEF_ BO_  "TpTxIndex" INT 0 255;
BA_DEF_ SG_  "GenSigCmt" STRING ;
BA_DEF_ SG_  "GenSigCycleTime" INT 0 0;
BA_DEF_ SG_  "GenSigSendType" ENUM  "Cyclic","OnWrite","vector_leerstring","OnChange","vector_leerstring","IfActive","vector_leerstring","NoSigSendType";
BA_DEF_ SG_  "GenSigStartValue" INT 0 1000000000;
BA_DEF_ SG_  "GenSigTimeoutTime" INT 0 0;
BA_DEF_ SG_  "GenSigVtEn" STRING ;
BA_DEF_ SG_  "GenSigVtName" STRING ;
BA_DEF_ SG_  "InvalidValue" STRING ;
BA_DEF_ SG_  "SystemSignalLongSymbol" STRING ;
BA_DEF_REL_ BU_SG_REL_  "SC_Verification" ENUM  "No","Yes";
BA_DEF_DEF_  "VFrameFormat" "StandardCAN_FD";
BA_DEF_DEF_  "CanTpBs" 255;
BA_DEF_DEF_  "DiagConnection" 0;
BA_DEF_DEF_  "DiagRequest" "No";
BA_DEF_DEF_  "DiagResponse" "No";
BA_DEF_DEF_  "DiagState" "No";
BA_DEF_DEF_  "E2EDataId" 0;
BA_DEF_DEF_  "E2EDataLength" 0;
BA_DEF_DEF_  "E2EProfile" "";
BA_DEF_DEF_  "EventRateOfChange" 10000;
BA_DEF_DEF_  "GenMsgCycleTime" 0;
BA_DEF_DEF_  "GenMsgILSupport" "Yes";
BA_DEF_DEF_  "GenMsgNrOfRepetition" 0;
BA_DEF_DEF_  "GenMsgSendType" "NoMsgSendType";
BA_DEF_DEF_  "NetworkInitialization" "Yes";
BA_DEF_DEF_  "NmAsrMessage" "No";
BA_DEF_DEF_  "NmMessage" "No";
BA_DEF_DEF_  "SCP_AuthInfoTxLength" 28;
BA_DEF_DEF_  "SCP_FreshnessValueLength" 48;
BA_DEF_DEF_  "SCP_FreshnessValueTxLength" 4;
BA_DEF_DEF_  "TpTxIndex" 0;
BA_DEF_DEF_  "GenSigCmt" "";
BA_DEF_DEF_  "GenSigCycleTime" 0;
BA_DEF_DEF_  "GenSigSendType" "NoSigSendType";
BA_DEF_DEF_  "GenSigStartValue" 0;
BA_DEF_DEF_  "GenSigTimeoutTime" 0;
BA_DEF_DEF_  "GenSigVtEn" "";
BA_DEF_DEF_  "GenSigVtName" "";
BA_DEF_DEF_  "InvalidValue" "";
BA_DEF_DEF_REL_ "SC_Verification" "No";
BA_DEF_DEF_  "SystemSignalLongSymbol" "";
BA_ "GenMsgSendType" BO_ 1096 1;
BA_ "GenMsgSendType" BO_ 1097 1;
BA_ "GenMsgSendType" BO_ 1098 1;
BA_ "GenMsgSendType" BO_ 1099 1;
BA_ "GenMsgSendType" BO_ 1100 1;
BA_ "GenMsgSendType" BO_ 1101 1;
BA_ "GenMsgSendType" BO_ 1102 1;
BA_ "GenMsgSendType" BO_ 1103 1;
BA_ "GenMsgSendType" BO_ 1104 1;
BA_ "GenMsgSendType" BO_ 1105 1;
BA_ "GenMsgSendType" BO_ 1106 1;
BA_ "GenMsgSendType" BO_ 1107 1;
BA_ "GenMsgSendType" BO_ 1108 1;
BA_ "GenMsgSendType" BO_ 1109 1;
BA_ "GenMsgSendType" BO_ 1110 1;
BA_ "GenMsgSendType" BO_ 1111 1;
BA_ "GenSigStartValue" SG_ 1096 DET_RANGE_VELOCITY_289 16384;
BA_ "GenSigStartValue" SG_ 1096 DET_RCS_289 128;
BA_ "GenSigStartValue" SG_ 1096 DET_RANGE_VELOCITY_290 16384;
BA_ "GenSigStartValue" SG_ 1096 DET_RCS_290 128;
BA_ "GenSigStartValue" SG_ 1096 DET_RANGE_VELOCITY_291 16384;
BA_ "GenSigStartValue" SG_ 1096 DET_RCS_291 128;
BA_ "GenSigStartValue" SG_ 1096 DET_RANGE_VELOCITY_292 16384;
BA_ "GenSigStartValue" SG_ 1096 DET_RCS_292 128;
BA_ "GenSigStartValue" SG_ 1097 DET_RANGE_VELOCITY_293 16384;
BA_ "GenSigStartValue" SG_ 1097 DET_RCS_293 128;
BA_ "GenSigStartValue" SG_ 1097 DET_RANGE_VELOCITY_294 16384;
BA_ "GenSigStartValue" SG_ 1097 DET_RCS_294 128;
BA_ "GenSigStartValue" SG_ 1097 DET_RANGE_VELOCITY_295 16384;
BA_ "GenSigStartValue" SG_ 1097 DET_RCS_295 128;
BA_ "GenSigStartValue" SG_ 1097 DET_RANGE_VELOCITY_296 16384;
BA_ "GenSigStartValue" SG_ 1097 DET_RCS_296 128;
BA_ "GenSigStartValue" SG_ 1098 DET_RANGE_VELOCITY_297 16384;
BA_ "GenSigStartValue" SG_ 1098 DET_RCS_297 128;
BA_ "GenSigStartValue" SG_ 1098 DET_RANGE_VELOCITY_298 16384;
BA_ "GenSigStartValue" SG_ 1098 DET_RCS_298 128;
BA_ "GenSigStartValue" SG_ 1098 DET_RANGE_VELOCITY_299 16384;
BA_ "GenSigStartValue" SG_ 1098 DET_RCS_299 128;
BA_ "GenSigStartValue" SG_ 1098 DET_RANGE_VELOCITY_300 16384;
BA_ "GenSigStartValue" SG_ 1098 DET_RCS_300 128;
BA_ "GenSigStartValue" SG_ 1099 DET_RANGE_VELOCITY_301 16384;
BA_ "GenSigStartValue" SG_ 1099 DET_RCS_301 128;
BA_ "GenSigStartValue" SG_ 1099 DET_RANGE_VELOCITY_302 16384;
BA_ "GenSigStartValue" SG_ 1099 DET_RCS_302 128;
BA_ "GenSigStartValue" SG_ 1099 DET_RANGE_VELOCITY_303 16384;
BA_ "GenSigStartValue" SG_ 1099 DET_RCS_303 128;
BA_ "GenSigStartValue" SG_ 1099 DET_RANGE_VELOCITY_304 16384;
BA_ "GenSigStartValue" SG_ 1099 DET_RCS_304 128;
BA_ "GenSigStartValue" SG_ 1100 DET_RANGE_VELOCITY_305 16384;
BA_ "GenSigStartValue" SG_ 1100 DET_RCS_305 128;
BA_ "GenSigStartValue" SG_ 1100 DET_RANGE_VELOCITY_306 16384;
BA_ "GenSigStartValue" SG_ 1100 DET_RCS_306 128;
BA_ "GenSigStartValue" SG_ 1100 DET_RANGE_VELOCITY_307 16384;
BA_ "GenSigStartValue" SG_ 1100 DET_RCS_307 128;
BA_ "GenSigStartValue" SG_ 1100 DET_RANGE_VELOCITY_308 16384;
BA_ "GenSigStartValue" SG_ 1100 DET_RCS_308 128;
BA_ "GenSigStartValue" SG_ 1101 DET_RANGE_VELOCITY_309 16384;
BA_ "GenSigStartValue" SG_ 1101 DET_RCS_309 128;
BA_ "GenSigStartValue" SG_ 1101 DET_RANGE_VELOCITY_310 16384;
BA_ "GenSigStartValue" SG_ 1101 DET_RCS_310 128;
BA_ "GenSigStartValue" SG_ 1101 DET_RANGE_VELOCITY_311 16384;
BA_ "GenSigStartValue" SG_ 1101 DET_RCS_311 128;
BA_ "GenSigStartValue" SG_ 1101 DET_RANGE_VELOCITY_312 16384;
BA_ "GenSigStartValue" SG_ 1101 DET_RCS_312 128;
BA_ "GenSigStartValue" SG_ 1102 DET_RANGE_VELOCITY_313 16384;
BA_ "GenSigStartValue" SG_ 1102 DET_RCS_313 128;
BA_ "GenSigStartValue" SG_ 1102 DET_RANGE_VELOCITY_314 16384;
BA_ "GenSigStartValue" SG_ 1102 DET_RCS_314 128;
BA_ "GenSigStartValue" SG_ 1102 DET_RANGE_VELOCITY_315 16384;
BA_ "GenSigStartValue" SG_ 1102 DET_RCS_315 128;
BA_ "GenSigStartValue" SG_ 1102 DET_RANGE_VELOCITY_316 16384;
BA_ "GenSigStartValue" SG_ 1102 DET_RCS_316 128;
BA_ "GenSigStartValue" SG_ 1103 DET_RANGE_VELOCITY_317 16384;
BA_ "GenSigStartValue" SG_ 1103 DET_RCS_317 128;
BA_ "GenSigStartValue" SG_ 1103 DET_RANGE_VELOCITY_318 16384;
BA_ "GenSigStartValue" SG_ 1103 DET_RCS_318 128;
BA_ "GenSigStartValue" SG_ 1103 DET_RANGE_VELOCITY_319 16384;
BA_ "GenSigStartValue" SG_ 1103 DET_RCS_319 128;
BA_ "GenSigStartValue" SG_ 1103 DET_RANGE_VELOCITY_320 16384;
BA_ "GenSigStartValue" SG_ 1103 DET_RCS_320 128;
BA_ "GenSigStartValue" SG_ 1104 DET_RANGE_VELOCITY_321 16384;
BA_ "GenSigStartValue" SG_ 1104 DET_RCS_321 128;
BA_ "GenSigStartValue" SG_ 1104 DET_RANGE_VELOCITY_322 16384;
BA_ "GenSigStartValue" SG_ 1104 DET_RCS_322 128;
BA_ "GenSigStartValue" SG_ 1104 DET_RANGE_VELOCITY_323 16384;
BA_ "GenSigStartValue" SG_ 1104 DET_RCS_323 128;
BA_ "GenSigStartValue" SG_ 1104 DET_RANGE_VELOCITY_324 16384;
BA_ "GenSigStartValue" SG_ 1104 DET_RCS_324 128;
BA_ "GenSigStartValue" SG_ 1105 DET_RANGE_VELOCITY_325 16384;
BA_ "GenSigStartValue" SG_ 1105 DET_RCS_325 128;
BA_ "GenSigStartValue" SG_ 1105 DET_RANGE_VELOCITY_326 16384;
BA_ "GenSigStartValue" SG_ 1105 DET_RCS_326 128;
BA_ "GenSigStartValue" SG_ 1105 DET_RANGE_VELOCITY_327 16384;
BA_ "GenSigStartValue" SG_ 1105 DET_RCS_327 128;
BA_ "GenSigStartValue" SG_ 1105 DET_RANGE_VELOCITY_328 16384;
BA_ "GenSigStartValue" SG_ 1105 DET_RCS_328 128;
BA_ "GenSigStartValue" SG_ 1106 DET_RANGE_VELOCITY_329 16384;
BA_ "GenSigStartValue" SG_ 1106 DET_RCS_329 128;
BA_ "GenSigStartValue" SG_ 1106 DET_RANGE_VELOCITY_330 16384;
BA_ "GenSigStartValue" SG_ 1106 DET_RCS_330 128;
BA_ "GenSigStartValue" SG_ 1106 DET_RANGE_VELOCITY_331 16384;
BA_ "GenSigStartValue" SG_ 1106 DET_RCS_331 128;
BA_ "GenSigStartValue" SG_ 1106 DET_RANGE_VELOCITY_332 16384;
BA_ "GenSigStartValue" SG_ 1106 DET_RCS_332 128;
BA_ "GenSigStartValue" SG_ 1107 DET_RANGE_VELOCITY_333 16384;
BA_ "GenSigStartValue" SG_ 1107 DET_RCS_333 128;
BA_ "GenSigStartValue" SG_ 1107 DET_RANGE_VELOCITY_334 16384;
BA_ "GenSigStartValue" SG_ 1107 DET_RCS_334 128;
BA_ "GenSigStartValue" SG_ 1107 DET_RANGE_VELOCITY_335 16384;
BA_ "GenSigStartValue" SG_ 1107 DET_RCS_335 128;
BA_ "GenSigStartValue" SG_ 1107 DET_RANGE_VELOCITY_336 16384;
BA_ "GenSigStartValue" SG_ 1107 DET_RCS_336 128;
BA_ "GenSigStartValue" SG_ 1108 DET_RANGE_VELOCITY_337 16384;
BA_ "GenSigStartValue" SG_ 1108 DET_RCS_337 128;
BA_ "GenSigStartValue" SG_ 1108 DET_RANGE_VELOCITY_338 16384;
BA_ "GenSigStartValue" SG_ 1108 DET_RCS_338 128;
BA_ "GenSigStartValue" SG_ 1108 DET_RANGE_VELOCITY_339 16384;
BA_ "GenSigStartValue" SG_ 1108 DET_RCS_339 128;
BA_ "GenSigStartValue" SG_ 1108 DET_RANGE_VELOCITY_340 16384;
BA_ "GenSigStartValue" SG_ 1108 DET_RCS_340 128;
BA_ "GenSigStartValue" SG_ 1109 DET_RANGE_VELOCITY_341 16384;
BA_ "GenSigStartValue" SG_ 1109 DET_RCS_341 128;
BA_ "GenSigStartValue" SG_ 1109 DET_RANGE_VELOCITY_342 16384;
BA_ "GenSigStartValue" SG_ 1109 DET_RCS_342 128;
BA_ "GenSigStartValue" SG_ 1109 DET_RANGE_VELOCITY_343 16384;
BA_ "GenSigStartValue" SG_ 1109 DET_RCS_343 128;
BA_ "GenSigStartValue" SG_ 1109 DET_RANGE_VELOCITY_344 16384;
BA_ "GenSigStartValue" SG_ 1109 DET_RCS_344 128;
BA_ "GenSigStartValue" SG_ 1110 DET_RANGE_VELOCITY_345 16384;
BA_ "GenSigStartValue" SG_ 1110 DET_RCS_345 128;
BA_ "GenSigStartValue" SG_ 1110 DET_RANGE_VELOCITY_346 16384;
BA_ "GenSigStartValue" SG_ 1110 DET_RCS_346 128;
BA_ "GenSigStartValue" SG_ 1110 DET_RANGE_VELOCITY_347 16384;
BA_ "GenSigStartValue" SG_ 1110 DET_RCS_347 128;
BA_ "GenSigStartValue" SG_ 1110 DET_RANGE_VELOCITY_348 16384;
BA_ "GenSigStartValue" SG_ 1110 DET_RCS_348 128;
BA_ "GenSigStartValue" SG_ 1111 DET_RANGE_VELOCITY_349 16384;
BA_ "GenSigStartValue" SG_ 1111 DET_RCS_349 128;
BA_ "GenSigStartValue" SG_ 1111 DET_RANGE_VELOCITY_350 16384;
BA_ "GenSigStartValue" SG_ 1111 DET_RCS_350 128;
BA_ "GenSigStartValue" SG_ 1111 DET_RANGE_VELOCITY_351 16384;
BA_ "GenSigStartValue" SG_ 1111 DET_RCS_351 128;
BA_ "GenSigStartValue" SG_ 1111 DET_RANGE_VELOCITY_352 16384;
BA_ "GenSigStartValue" SG_ 1111 DET_RCS_352 128;
VAL_ 1096 DET_CONFD_AZIMUTH_289 0 "High" 1 "MidHigh" 2 "MidLow" 3 "Low" ;
VAL_ 1096 DET_CONFD_ELEVATION_289 0 "High" 1 "MidHigh" 2 "MidLow" 3 "Low" ;
VAL_ 1096 DET_IDM_289 0 "Not_IDM_Output" 1 "IDM_Output" ;
VAL_ 1096 DET_MTD_289 0 "Not_MTD_Output" 1 "MTD_Output" ;
VAL_ 1096 DET_BELOW_RAIN_THOLD_289 0 "DetBelowRainThold" 1 "DetAboveRainThold" ;
VAL_ 1096 DET_CONFD_AZIMUTH_290 0 "High" 1 "MidHigh" 2 "MidLow" 3 "Low" ;
VAL_ 1096 DET_CONFD_ELEVATION_290 0 "High" 1 "MidHigh" 2 "MidLow" 3 "Low" ;
VAL_ 1096 DET_IDM_290 0 "Not_IDM_Output" 1 "IDM_Output" ;
VAL_ 1096 DET_MTD_290 0 "Not_MTD_Output" 1 "MTD_Output" ;
VAL_ 1096 DET_BELOW_RAIN_THOLD_290 0 "DetBelowRainThold" 1 "DetAboveRainThold" ;
VAL_ 1096 DET_CONFD_AZIMUTH_291 0 "High" 1 "MidHigh" 2 "MidLow" 3 "Low" ;
VAL_ 1096 DET_CONFD_ELEVATION_291 0 "High" 1 "MidHigh" 2 "MidLow" 3 "Low" ;
VAL_ 1096 DET_IDM_291 0 "Not_IDM_Output" 1 "IDM_Output" ;
VAL_ 1096 DET_MTD_291 0 "Not_MTD_Output" 1 "MTD_Output" ;
VAL_ 1096 DET_BELOW_RAIN_THOLD_291 0 "DetBelowRainThold" 1 "DetAboveRainThold" ;
VAL_ 1096 DET_IDM_292 0 "Not_IDM_Output" 1 "IDM_Output" ;
VAL_ 1096 DET_MTD_292 0 "Not_MTD_Output" 1 "MTD_Output" ;
VAL_ 1096 DET_BELOW_RAIN_THOLD_292 0 "DetBelowRainThold" 1 "DetAboveRainThold" ;
VAL_ 1097 DET_CONFD_AZIMUTH_293 0 "High" 1 "MidHigh" 2 "MidLow" 3 "Low" ;
VAL_ 1097 DET_CONFD_ELEVATION_293 0 "High" 1 "MidHigh" 2 "MidLow" 3 "Low" ;
VAL_ 1097 DET_IDM_293 0 "Not_IDM_Output" 1 "IDM_Output" ;
VAL_ 1097 DET_MTD_293 0 "Not_MTD_Output" 1 "MTD_Output" ;
VAL_ 1097 DET_BELOW_RAIN_THOLD_293 0 "DetBelowRainThold" 1 "DetAboveRainThold" ;
VAL_ 1097 DET_CONFD_AZIMUTH_294 0 "High" 1 "MidHigh" 2 "MidLow" 3 "Low" ;
VAL_ 1097 DET_CONFD_ELEVATION_294 0 "High" 1 "MidHigh" 2 "MidLow" 3 "Low" ;
VAL_ 1097 DET_IDM_294 0 "Not_IDM_Output" 1 "IDM_Output" ;
VAL_ 1097 DET_MTD_294 0 "Not_MTD_Output" 1 "MTD_Output" ;
VAL_ 1097 DET_BELOW_RAIN_THOLD_294 0 "DetBelowRainThold" 1 "DetAboveRainThold" ;
VAL_ 1097 DET_CONFD_AZIMUTH_295 0 "High" 1 "MidHigh" 2 "MidLow" 3 "Low" ;
VAL_ 1097 DET_CONFD_ELEVATION_295 0 "High" 1 "MidHigh" 2 "MidLow" 3 "Low" ;
VAL_ 1097 DET_IDM_295 0 "Not_IDM_Output" 1 "IDM_Output" ;
VAL_ 1097 DET_MTD_295 0 "Not_MTD_Output" 1 "MTD_Output" ;
VAL_ 1097 DET_BELOW_RAIN_THOLD_295 0 "DetBelowRainThold" 1 "DetAboveRainThold" ;
VAL_ 1097 DET_IDM_296 0 "Not_IDM_Output" 1 "IDM_Output" ;
VAL_ 1097 DET_MTD_296 0 "Not_MTD_Output" 1 "MTD_Output" ;
VAL_ 1097 DET_BELOW_RAIN_THOLD_296 0 "DetBelowRainThold" 1 "DetAboveRainThold" ;
VAL_ 1098 DET_CONFD_AZIMUTH_297 0 "High" 1 "MidHigh" 2 "MidLow" 3 "Low" ;
VAL_ 1098 DET_CONFD_ELEVATION_297 0 "High" 1 "MidHigh" 2 "MidLow" 3 "Low" ;
VAL_ 1098 DET_IDM_297 0 "Not_IDM_Output" 1 "IDM_Output" ;
VAL_ 1098 DET_MTD_297 0 "Not_MTD_Output" 1 "MTD_Output" ;
VAL_ 1098 DET_BELOW_RAIN_THOLD_297 0 "DetBelowRainThold" 1 "DetAboveRainThold" ;
VAL_ 1098 DET_CONFD_AZIMUTH_298 0 "High" 1 "MidHigh" 2 "MidLow" 3 "Low" ;
VAL_ 1098 DET_CONFD_ELEVATION_298 0 "High" 1 "MidHigh" 2 "MidLow" 3 "Low" ;
VAL_ 1098 DET_IDM_298 0 "Not_IDM_Output" 1 "IDM_Output" ;
VAL_ 1098 DET_MTD_298 0 "Not_MTD_Output" 1 "MTD_Output" ;
VAL_ 1098 DET_BELOW_RAIN_THOLD_298 0 "DetBelowRainThold" 1 "DetAboveRainThold" ;
VAL_ 1098 DET_CONFD_AZIMUTH_299 0 "High" 1 "MidHigh" 2 "MidLow" 3 "Low" ;
VAL_ 1098 DET_CONFD_ELEVATION_299 0 "High" 1 "MidHigh" 2 "MidLow" 3 "Low" ;
VAL_ 1098 DET_IDM_299 0 "Not_IDM_Output" 1 "IDM_Output" ;
VAL_ 1098 DET_MTD_299 0 "Not_MTD_Output" 1 "MTD_Output" ;
VAL_ 1098 DET_BELOW_RAIN_THOLD_299 0 "DetBelowRainThold" 1 "DetAboveRainThold" ;
VAL_ 1098 DET_IDM_300 0 "Not_IDM_Output" 1 "IDM_Output" ;
VAL_ 1098 DET_MTD_300 0 "Not_MTD_Output" 1 "MTD_Output" ;
VAL_ 1098 DET_BELOW_RAIN_THOLD_300 0 "DetBelowRainThold" 1 "DetAboveRainThold" ;
VAL_ 1099 DET_CONFD_AZIMUTH_301 0 "High" 1 "MidHigh" 2 "MidLow" 3 "Low" ;
VAL_ 1099 DET_CONFD_ELEVATION_301 0 "High" 1 "MidHigh" 2 "MidLow" 3 "Low" ;
VAL_ 1099 DET_IDM_301 0 "Not_IDM_Output" 1 "IDM_Output" ;
VAL_ 1099 DET_MTD_301 0 "Not_MTD_Output" 1 "MTD_Output" ;
VAL_ 1099 DET_BELOW_RAIN_THOLD_301 0 "DetBelowRainThold" 1 "DetAboveRainThold" ;
VAL_ 1099 DET_CONFD_AZIMUTH_302 0 "High" 1 "MidHigh" 2 "MidLow" 3 "Low" ;
VAL_ 1099 DET_CONFD_ELEVATION_302 0 "High" 1 "MidHigh" 2 "MidLow" 3 "Low" ;
VAL_ 1099 DET_IDM_302 0 "Not_IDM_Output" 1 "IDM_Output" ;
VAL_ 1099 DET_MTD_302 0 "Not_MTD_Output" 1 "MTD_Output" ;
VAL_ 1099 DET_BELOW_RAIN_THOLD_302 0 "DetBelowRainThold" 1 "DetAboveRainThold" ;
VAL_ 1099 DET_CONFD_AZIMUTH_303 0 "High" 1 "MidHigh" 2 "MidLow" 3 "Low" ;
VAL_ 1099 DET_CONFD_ELEVATION_303 0 "High" 1 "MidHigh" 2 "MidLow" 3 "Low" ;
VAL_ 1099 DET_IDM_303 0 "Not_IDM_Output" 1 "IDM_Output" ;
VAL_ 1099 DET_MTD_303 0 "Not_MTD_Output" 1 "MTD_Output" ;
VAL_ 1099 DET_BELOW_RAIN_THOLD_303 0 "DetBelowRainThold" 1 "DetAboveRainThold" ;
VAL_ 1099 DET_IDM_304 0 "Not_IDM_Output" 1 "IDM_Output" ;
VAL_ 1099 DET_MTD_304 0 "Not_MTD_Output" 1 "MTD_Output" ;
VAL_ 1099 DET_BELOW_RAIN_THOLD_304 0 "DetBelowRainThold" 1 "DetAboveRainThold" ;
VAL_ 1100 DET_CONFD_AZIMUTH_305 0 "High" 1 "MidHigh" 2 "MidLow" 3 "Low" ;
VAL_ 1100 DET_CONFD_ELEVATION_305 0 "High" 1 "MidHigh" 2 "MidLow" 3 "Low" ;
VAL_ 1100 DET_IDM_305 0 "Not_IDM_Output" 1 "IDM_Output" ;
VAL_ 1100 DET_MTD_305 0 "Not_MTD_Output" 1 "MTD_Output" ;
VAL_ 1100 DET_BELOW_RAIN_THOLD_305 0 "DetBelowRainThold" 1 "DetAboveRainThold" ;
VAL_ 1100 DET_CONFD_AZIMUTH_306 0 "High" 1 "MidHigh" 2 "MidLow" 3 "Low" ;
VAL_ 1100 DET_CONFD_ELEVATION_306 0 "High" 1 "MidHigh" 2 "MidLow" 3 "Low" ;
VAL_ 1100 DET_IDM_306 0 "Not_IDM_Output" 1 "IDM_Output" ;
VAL_ 1100 DET_MTD_306 0 "Not_MTD_Output" 1 "MTD_Output" ;
VAL_ 1100 DET_BELOW_RAIN_THOLD_306 0 "DetBelowRainThold" 1 "DetAboveRainThold" ;
VAL_ 1100 DET_CONFD_AZIMUTH_307 0 "High" 1 "MidHigh" 2 "MidLow" 3 "Low" ;
VAL_ 1100 DET_CONFD_ELEVATION_307 0 "High" 1 "MidHigh" 2 "MidLow" 3 "Low" ;
VAL_ 1100 DET_IDM_307 0 "Not_IDM_Output" 1 "IDM_Output" ;
VAL_ 1100 DET_MTD_307 0 "Not_MTD_Output" 1 "MTD_Output" ;
VAL_ 1100 DET_BELOW_RAIN_THOLD_307 0 "DetBelowRainThold" 1 "DetAboveRainThold" ;
VAL_ 1100 DET_IDM_308 0 "Not_IDM_Output" 1 "IDM_Output" ;
VAL_ 1100 DET_MTD_308 0 "Not_MTD_Output" 1 "MTD_Output" ;
VAL_ 1100 DET_BELOW_RAIN_THOLD_308 0 "DetBelowRainThold" 1 "DetAboveRainThold" ;
VAL_ 1101 DET_CONFD_AZIMUTH_309 0 "High" 1 "MidHigh" 2 "MidLow" 3 "Low" ;
VAL_ 1101 DET_CONFD_ELEVATION_309 0 "High" 1 "MidHigh" 2 "MidLow" 3 "Low" ;
VAL_ 1101 DET_IDM_309 0 "Not_IDM_Output" 1 "IDM_Output" ;
VAL_ 1101 DET_MTD_309 0 "Not_MTD_Output" 1 "MTD_Output" ;
VAL_ 1101 DET_BELOW_RAIN_THOLD_309 0 "DetBelowRainThold" 1 "DetAboveRainThold" ;
VAL_ 1101 DET_CONFD_AZIMUTH_310 0 "High" 1 "MidHigh" 2 "MidLow" 3 "Low" ;
VAL_ 1101 DET_CONFD_ELEVATION_310 0 "High" 1 "MidHigh" 2 "MidLow" 3 "Low" ;
VAL_ 1101 DET_IDM_310 0 "Not_IDM_Output" 1 "IDM_Output" ;
VAL_ 1101 DET_MTD_310 0 "Not_MTD_Output" 1 "MTD_Output" ;
VAL_ 1101 DET_BELOW_RAIN_THOLD_310 0 "DetBelowRainThold" 1 "DetAboveRainThold" ;
VAL_ 1101 DET_CONFD_AZIMUTH_311 0 "High" 1 "MidHigh" 2 "MidLow" 3 "Low" ;
VAL_ 1101 DET_CONFD_ELEVATION_311 0 "High" 1 "MidHigh" 2 "MidLow" 3 "Low" ;
VAL_ 1101 DET_IDM_311 0 "Not_IDM_Output" 1 "IDM_Output" ;
VAL_ 1101 DET_MTD_311 0 "Not_MTD_Output" 1 "MTD_Output" ;
VAL_ 1101 DET_BELOW_RAIN_THOLD_311 0 "DetBelowRainThold" 1 "DetAboveRainThold" ;
VAL_ 1101 DET_IDM_312 0 "Not_IDM_Output" 1 "IDM_Output" ;
VAL_ 1101 DET_MTD_312 0 "Not_MTD_Output" 1 "MTD_Output" ;
VAL_ 1101 DET_BELOW_RAIN_THOLD_312 0 "DetBelowRainThold" 1 "DetAboveRainThold" ;
VAL_ 1102 DET_CONFD_AZIMUTH_313 0 "High" 1 "MidHigh" 2 "MidLow" 3 "Low" ;
VAL_ 1102 DET_CONFD_ELEVATION_313 0 "High" 1 "MidHigh" 2 "MidLow" 3 "Low" ;
VAL_ 1102 DET_IDM_313 0 "Not_IDM_Output" 1 "IDM_Output" ;
VAL_ 1102 DET_MTD_313 0 "Not_MTD_Output" 1 "MTD_Output" ;
VAL_ 1102 DET_BELOW_RAIN_THOLD_313 0 "DetBelowRainThold" 1 "DetAboveRainThold" ;
VAL_ 1102 DET_CONFD_AZIMUTH_314 0 "High" 1 "MidHigh" 2 "MidLow" 3 "Low" ;
VAL_ 1102 DET_CONFD_ELEVATION_314 0 "High" 1 "MidHigh" 2 "MidLow" 3 "Low" ;
VAL_ 1102 DET_IDM_314 0 "Not_IDM_Output" 1 "IDM_Output" ;
VAL_ 1102 DET_MTD_314 0 "Not_MTD_Output" 1 "MTD_Output" ;
VAL_ 1102 DET_BELOW_RAIN_THOLD_314 0 "DetBelowRainThold" 1 "DetAboveRainThold" ;
VAL_ 1102 DET_CONFD_AZIMUTH_315 0 "High" 1 "MidHigh" 2 "MidLow" 3 "Low" ;
VAL_ 1102 DET_CONFD_ELEVATION_315 0 "High" 1 "MidHigh" 2 "MidLow" 3 "Low" ;
VAL_ 1102 DET_IDM_315 0 "Not_IDM_Output" 1 "IDM_Output" ;
VAL_ 1102 DET_MTD_315 0 "Not_MTD_Output" 1 "MTD_Output" ;
VAL_ 1102 DET_BELOW_RAIN_THOLD_315 0 "DetBelowRainThold" 1 "DetAboveRainThold" ;
VAL_ 1102 DET_IDM_316 0 "Not_IDM_Output" 1 "IDM_Output" ;
VAL_ 1102 DET_MTD_316 0 "Not_MTD_Output" 1 "MTD_Output" ;
VAL_ 1102 DET_BELOW_RAIN_THOLD_316 0 "DetBelowRainThold" 1 "DetAboveRainThold" ;
VAL_ 1103 DET_CONFD_AZIMUTH_317 0 "High" 1 "MidHigh" 2 "MidLow" 3 "Low" ;
VAL_ 1103 DET_CONFD_ELEVATION_317 0 "High" 1 "MidHigh" 2 "MidLow" 3 "Low" ;
VAL_ 1103 DET_IDM_317 0 "Not_IDM_Output" 1 "IDM_Output" ;
VAL_ 1103 DET_MTD_317 0 "Not_MTD_Output" 1 "MTD_Output" ;
VAL_ 1103 DET_BELOW_RAIN_THOLD_317 0 "DetBelowRainThold" 1 "DetAboveRainThold" ;
VAL_ 1103 DET_CONFD_AZIMUTH_318 0 "High" 1 "MidHigh" 2 "MidLow" 3 "Low" ;
VAL_ 1103 DET_CONFD_ELEVATION_318 0 "High" 1 "MidHigh" 2 "MidLow" 3 "Low" ;
VAL_ 1103 DET_IDM_318 0 "Not_IDM_Output" 1 "IDM_Output" ;
VAL_ 1103 DET_MTD_318 0 "Not_MTD_Output" 1 "MTD_Output" ;
VAL_ 1103 DET_BELOW_RAIN_THOLD_318 0 "DetBelowRainThold" 1 "DetAboveRainThold" ;
VAL_ 1103 DET_CONFD_AZIMUTH_319 0 "High" 1 "MidHigh" 2 "MidLow" 3 "Low" ;
VAL_ 1103 DET_CONFD_ELEVATION_319 0 "High" 1 "MidHigh" 2 "MidLow" 3 "Low" ;
VAL_ 1103 DET_IDM_319 0 "Not_IDM_Output" 1 "IDM_Output" ;
VAL_ 1103 DET_MTD_319 0 "Not_MTD_Output" 1 "MTD_Output" ;
VAL_ 1103 DET_BELOW_RAIN_THOLD_319 0 "DetBelowRainThold" 1 "DetAboveRainThold" ;
VAL_ 1103 DET_IDM_320 0 "Not_IDM_Output" 1 "IDM_Output" ;
VAL_ 1103 DET_MTD_320 0 "Not_MTD_Output" 1 "MTD_Output" ;
VAL_ 1103 DET_BELOW_RAIN_THOLD_320 0 "DetBelowRainThold" 1 "DetAboveRainThold" ;
VAL_ 1104 DET_CONFD_AZIMUTH_321 0 "High" 1 "MidHigh" 2 "MidLow" 3 "Low" ;
VAL_ 1104 DET_CONFD_ELEVATION_321 0 "High" 1 "MidHigh" 2 "MidLow" 3 "Low" ;
VAL_ 1104 DET_IDM_321 0 "Not_IDM_Output" 1 "IDM_Output" ;
VAL_ 1104 DET_MTD_321 0 "Not_MTD_Output" 1 "MTD_Output" ;
VAL_ 1104 DET_BELOW_RAIN_THOLD_321 0 "DetBelowRainThold" 1 "DetAboveRainThold" ;
VAL_ 1104 DET_CONFD_AZIMUTH_322 0 "High" 1 "MidHigh" 2 "MidLow" 3 "Low" ;
VAL_ 1104 DET_CONFD_ELEVATION_322 0 "High" 1 "MidHigh" 2 "MidLow" 3 "Low" ;
VAL_ 1104 DET_IDM_322 0 "Not_IDM_Output" 1 "IDM_Output" ;
VAL_ 1104 DET_MTD_322 0 "Not_MTD_Output" 1 "MTD_Output" ;
VAL_ 1104 DET_BELOW_RAIN_THOLD_322 0 "DetBelowRainThold" 1 "DetAboveRainThold" ;
VAL_ 1104 DET_CONFD_AZIMUTH_323 0 "High" 1 "MidHigh" 2 "MidLow" 3 "Low" ;
VAL_ 1104 DET_CONFD_ELEVATION_323 0 "High" 1 "MidHigh" 2 "MidLow" 3 "Low" ;
VAL_ 1104 DET_IDM_323 0 "Not_IDM_Output" 1 "IDM_Output" ;
VAL_ 1104 DET_MTD_323 0 "Not_MTD_Output" 1 "MTD_Output" ;
VAL_ 1104 DET_BELOW_RAIN_THOLD_323 0 "DetBelowRainThold" 1 "DetAboveRainThold" ;
VAL_ 1104 DET_IDM_324 0 "Not_IDM_Output" 1 "IDM_Output" ;
VAL_ 1104 DET_MTD_324 0 "Not_MTD_Output" 1 "MTD_Output" ;
VAL_ 1104 DET_BELOW_RAIN_THOLD_324 0 "DetBelowRainThold" 1 "DetAboveRainThold" ;
VAL_ 1105 DET_CONFD_AZIMUTH_325 0 "High" 1 "MidHigh" 2 "MidLow" 3 "Low" ;
VAL_ 1105 DET_CONFD_ELEVATION_325 0 "High" 1 "MidHigh" 2 "MidLow" 3 "Low" ;
VAL_ 1105 DET_IDM_325 0 "Not_IDM_Output" 1 "IDM_Output" ;
VAL_ 1105 DET_MTD_325 0 "Not_MTD_Output" 1 "MTD_Output" ;
VAL_ 1105 DET_BELOW_RAIN_THOLD_325 0 "DetBelowRainThold" 1 "DetAboveRainThold" ;
VAL_ 1105 DET_CONFD_AZIMUTH_326 0 "High" 1 "MidHigh" 2 "MidLow" 3 "Low" ;
VAL_ 1105 DET_CONFD_ELEVATION_326 0 "High" 1 "MidHigh" 2 "MidLow" 3 "Low" ;
VAL_ 1105 DET_IDM_326 0 "Not_IDM_Output" 1 "IDM_Output" ;
VAL_ 1105 DET_MTD_326 0 "Not_MTD_Output" 1 "MTD_Output" ;
VAL_ 1105 DET_BELOW_RAIN_THOLD_326 0 "DetBelowRainThold" 1 "DetAboveRainThold" ;
VAL_ 1105 DET_CONFD_AZIMUTH_327 0 "High" 1 "MidHigh" 2 "MidLow" 3 "Low" ;
VAL_ 1105 DET_CONFD_ELEVATION_327 0 "High" 1 "MidHigh" 2 "MidLow" 3 "Low" ;
VAL_ 1105 DET_IDM_327 0 "Not_IDM_Output" 1 "IDM_Output" ;
VAL_ 1105 DET_MTD_327 0 "Not_MTD_Output" 1 "MTD_Output" ;
VAL_ 1105 DET_BELOW_RAIN_THOLD_327 0 "DetBelowRainThold" 1 "DetAboveRainThold" ;
VAL_ 1105 DET_IDM_328 0 "Not_IDM_Output" 1 "IDM_Output" ;
VAL_ 1105 DET_MTD_328 0 "Not_MTD_Output" 1 "MTD_Output" ;
VAL_ 1105 DET_BELOW_RAIN_THOLD_328 0 "DetBelowRainThold" 1 "DetAboveRainThold" ;
VAL_ 1106 DET_CONFD_AZIMUTH_329 0 "High" 1 "MidHigh" 2 "MidLow" 3 "Low" ;
VAL_ 1106 DET_CONFD_ELEVATION_329 0 "High" 1 "MidHigh" 2 "MidLow" 3 "Low" ;
VAL_ 1106 DET_IDM_329 0 "Not_IDM_Output" 1 "IDM_Output" ;
VAL_ 1106 DET_MTD_329 0 "Not_MTD_Output" 1 "MTD_Output" ;
VAL_ 1106 DET_BELOW_RAIN_THOLD_329 0 "DetBelowRainThold" 1 "DetAboveRainThold" ;
VAL_ 1106 DET_CONFD_AZIMUTH_330 0 "High" 1 "MidHigh" 2 "MidLow" 3 "Low" ;
VAL_ 1106 DET_CONFD_ELEVATION_330 0 "High" 1 "MidHigh" 2 "MidLow" 3 "Low" ;
VAL_ 1106 DET_IDM_330 0 "Not_IDM_Output" 1 "IDM_Output" ;
VAL_ 1106 DET_MTD_330 0 "Not_MTD_Output" 1 "MTD_Output" ;
VAL_ 1106 DET_BELOW_RAIN_THOLD_330 0 "DetBelowRainThold" 1 "DetAboveRainThold" ;
VAL_ 1106 DET_CONFD_AZIMUTH_331 0 "High" 1 "MidHigh" 2 "MidLow" 3 "Low" ;
VAL_ 1106 DET_CONFD_ELEVATION_331 0 "High" 1 "MidHigh" 2 "MidLow" 3 "Low" ;
VAL_ 1106 DET_IDM_331 0 "Not_IDM_Output" 1 "IDM_Output" ;
VAL_ 1106 DET_MTD_331 0 "Not_MTD_Output" 1 "MTD_Output" ;
VAL_ 1106 DET_BELOW_RAIN_THOLD_331 0 "DetBelowRainThold" 1 "DetAboveRainThold" ;
VAL_ 1106 DET_IDM_332 0 "Not_IDM_Output" 1 "IDM_Output" ;
VAL_ 1106 DET_MTD_332 0 "Not_MTD_Output" 1 "MTD_Output" ;
VAL_ 1106 DET_BELOW_RAIN_THOLD_332 0 "DetBelowRainThold" 1 "DetAboveRainThold" ;
VAL_ 1107 DET_CONFD_AZIMUTH_333 0 "High" 1 "MidHigh" 2 "MidLow" 3 "Low" ;
VAL_ 1107 DET_CONFD_ELEVATION_333 0 "High" 1 "MidHigh" 2 "MidLow" 3 "Low" ;
VAL_ 1107 DET_IDM_333 0 "Not_IDM_Output" 1 "IDM_Output" ;
VAL_ 1107 DET_MTD_333 0 "Not_MTD_Output" 1 "MTD_Output" ;
VAL_ 1107 DET_BELOW_RAIN_THOLD_333 0 "DetBelowRainThold" 1 "DetAboveRainThold" ;
VAL_ 1107 DET_CONFD_AZIMUTH_334 0 "High" 1 "MidHigh" 2 "MidLow" 3 "Low" ;
VAL_ 1107 DET_CONFD_ELEVATION_334 0 "High" 1 "MidHigh" 2 "MidLow" 3 "Low" ;
VAL_ 1107 DET_IDM_334 0 "Not_IDM_Output" 1 "IDM_Output" ;
VAL_ 1107 DET_MTD_334 0 "Not_MTD_Output" 1 "MTD_Output" ;
VAL_ 1107 DET_BELOW_RAIN_THOLD_334 0 "DetBelowRainThold" 1 "DetAboveRainThold" ;
VAL_ 1107 DET_CONFD_AZIMUTH_335 0 "High" 1 "MidHigh" 2 "MidLow" 3 "Low" ;
VAL_ 1107 DET_CONFD_ELEVATION_335 0 "High" 1 "MidHigh" 2 "MidLow" 3 "Low" ;
VAL_ 1107 DET_IDM_335 0 "Not_IDM_Output" 1 "IDM_Output" ;
VAL_ 1107 DET_MTD_335 0 "Not_MTD_Output" 1 "MTD_Output" ;
VAL_ 1107 DET_BELOW_RAIN_THOLD_335 0 "DetBelowRainThold" 1 "DetAboveRainThold" ;
VAL_ 1107 DET_IDM_336 0 "Not_IDM_Output" 1 "IDM_Output" ;
VAL_ 1107 DET_MTD_336 0 "Not_MTD_Output" 1 "MTD_Output" ;
VAL_ 1107 DET_BELOW_RAIN_THOLD_336 0 "DetBelowRainThold" 1 "DetAboveRainThold" ;
VAL_ 1108 DET_CONFD_AZIMUTH_337 0 "High" 1 "MidHigh" 2 "MidLow" 3 "Low" ;
VAL_ 1108 DET_CONFD_ELEVATION_337 0 "High" 1 "MidHigh" 2 "MidLow" 3 "Low" ;
VAL_ 1108 DET_IDM_337 0 "Not_IDM_Output" 1 "IDM_Output" ;
VAL_ 1108 DET_MTD_337 0 "Not_MTD_Output" 1 "MTD_Output" ;
VAL_ 1108 DET_BELOW_RAIN_THOLD_337 0 "DetBelowRainThold" 1 "DetAboveRainThold" ;
VAL_ 1108 DET_CONFD_AZIMUTH_338 0 "High" 1 "MidHigh" 2 "MidLow" 3 "Low" ;
VAL_ 1108 DET_CONFD_ELEVATION_338 0 "High" 1 "MidHigh" 2 "MidLow" 3 "Low" ;
VAL_ 1108 DET_IDM_338 0 "Not_IDM_Output" 1 "IDM_Output" ;
VAL_ 1108 DET_MTD_338 0 "Not_MTD_Output" 1 "MTD_Output" ;
VAL_ 1108 DET_BELOW_RAIN_THOLD_338 0 "DetBelowRainThold" 1 "DetAboveRainThold" ;
VAL_ 1108 DET_CONFD_AZIMUTH_339 0 "High" 1 "MidHigh" 2 "MidLow" 3 "Low" ;
VAL_ 1108 DET_CONFD_ELEVATION_339 0 "High" 1 "MidHigh" 2 "MidLow" 3 "Low" ;
VAL_ 1108 DET_IDM_339 0 "Not_IDM_Output" 1 "IDM_Output" ;
VAL_ 1108 DET_MTD_339 0 "Not_MTD_Output" 1 "MTD_Output" ;
VAL_ 1108 DET_BELOW_RAIN_THOLD_339 0 "DetBelowRainThold" 1 "DetAboveRainThold" ;
VAL_ 1108 DET_IDM_340 0 "Not_IDM_Output" 1 "IDM_Output" ;
VAL_ 1108 DET_MTD_340 0 "Not_MTD_Output" 1 "MTD_Output" ;
VAL_ 1108 DET_BELOW_RAIN_THOLD_340 0 "DetBelowRainThold" 1 "DetAboveRainThold" ;
VAL_ 1109 DET_CONFD_AZIMUTH_341 0 "High" 1 "MidHigh" 2 "MidLow" 3 "Low" ;
VAL_ 1109 DET_CONFD_ELEVATION_341 0 "High" 1 "MidHigh" 2 "MidLow" 3 "Low" ;
VAL_ 1109 DET_IDM_341 0 "Not_IDM_Output" 1 "IDM_Output" ;
VAL_ 1109 DET_MTD_341 0 "Not_MTD_Output" 1 "MTD_Output" ;
VAL_ 1109 DET_BELOW_RAIN_THOLD_341 0 "DetBelowRainThold" 1 "DetAboveRainThold" ;
VAL_ 1109 DET_CONFD_AZIMUTH_342 0 "High" 1 "MidHigh" 2 "MidLow" 3 "Low" ;
VAL_ 1109 DET_CONFD_ELEVATION_342 0 "High" 1 "MidHigh" 2 "MidLow" 3 "Low" ;
VAL_ 1109 DET_IDM_342 0 "Not_IDM_Output" 1 "IDM_Output" ;
VAL_ 1109 DET_MTD_342 0 "Not_MTD_Output" 1 "MTD_Output" ;
VAL_ 1109 DET_BELOW_RAIN_THOLD_342 0 "DetBelowRainThold" 1 "DetAboveRainThold" ;
VAL_ 1109 DET_CONFD_AZIMUTH_343 0 "High" 1 "MidHigh" 2 "MidLow" 3 "Low" ;
VAL_ 1109 DET_CONFD_ELEVATION_343 0 "High" 1 "MidHigh" 2 "MidLow" 3 "Low" ;
VAL_ 1109 DET_IDM_343 0 "Not_IDM_Output" 1 "IDM_Output" ;
VAL_ 1109 DET_MTD_343 0 "Not_MTD_Output" 1 "MTD_Output" ;
VAL_ 1109 DET_BELOW_RAIN_THOLD_343 0 "DetBelowRainThold" 1 "DetAboveRainThold" ;
VAL_ 1109 DET_IDM_344 0 "Not_IDM_Output" 1 "IDM_Output" ;
VAL_ 1109 DET_MTD_344 0 "Not_MTD_Output" 1 "MTD_Output" ;
VAL_ 1109 DET_BELOW_RAIN_THOLD_344 0 "DetBelowRainThold" 1 "DetAboveRainThold" ;
VAL_ 1110 DET_CONFD_AZIMUTH_345 0 "High" 1 "MidHigh" 2 "MidLow" 3 "Low" ;
VAL_ 1110 DET_CONFD_ELEVATION_345 0 "High" 1 "MidHigh" 2 "MidLow" 3 "Low" ;
VAL_ 1110 DET_IDM_345 0 "Not_IDM_Output" 1 "IDM_Output" ;
VAL_ 1110 DET_MTD_345 0 "Not_MTD_Output" 1 "MTD_Output" ;
VAL_ 1110 DET_BELOW_RAIN_THOLD_345 0 "DetBelowRainThold" 1 "DetAboveRainThold" ;
VAL_ 1110 DET_CONFD_AZIMUTH_346 0 "High" 1 "MidHigh" 2 "MidLow" 3 "Low" ;
VAL_ 1110 DET_CONFD_ELEVATION_346 0 "High" 1 "MidHigh" 2 "MidLow" 3 "Low" ;
VAL_ 1110 DET_IDM_346 0 "Not_IDM_Output" 1 "IDM_Output" ;
VAL_ 1110 DET_MTD_346 0 "Not_MTD_Output" 1 "MTD_Output" ;
VAL_ 1110 DET_BELOW_RAIN_THOLD_346 0 "DetBelowRainThold" 1 "DetAboveRainThold" ;
VAL_ 1110 DET_CONFD_AZIMUTH_347 0 "High" 1 "MidHigh" 2 "MidLow" 3 "Low" ;
VAL_ 1110 DET_CONFD_ELEVATION_347 0 "High" 1 "MidHigh" 2 "MidLow" 3 "Low" ;
VAL_ 1110 DET_IDM_347 0 "Not_IDM_Output" 1 "IDM_Output" ;
VAL_ 1110 DET_MTD_347 0 "Not_MTD_Output" 1 "MTD_Output" ;
VAL_ 1110 DET_BELOW_RAIN_THOLD_347 0 "DetBelowRainThold" 1 "DetAboveRainThold" ;
VAL_ 1110 DET_IDM_348 0 "Not_IDM_Output" 1 "IDM_Output" ;
VAL_ 1110 DET_MTD_348 0 "Not_MTD_Output" 1 "MTD_Output" ;
VAL_ 1110 DET_BELOW_RAIN_THOLD_348 0 "DetBelowRainThold" 1 "DetAboveRainThold" ;
VAL_ 1111 DET_CONFD_AZIMUTH_349 0 "High" 1 "MidHigh" 2 "MidLow" 3 "Low" ;
VAL_ 1111 DET_CONFD_ELEVATION_349 0 "High" 1 "MidHigh" 2 "MidLow" 3 "Low" ;
VAL_ 1111 DET_IDM_349 0 "Not_IDM_Output" 1 "IDM_Output" ;
VAL_ 1111 DET_MTD_349 0 "Not_MTD_Output" 1 "MTD_Output" ;
VAL_ 1111 DET_BELOW_RAIN_THOLD_349 0 "DetBelowRainThold" 1 "DetAboveRainThold" ;
VAL_ 1111 DET_CONFD_AZIMUTH_350 0 "High" 1 "MidHigh" 2 "MidLow" 3 "Low" ;
VAL_ 1111 DET_CONFD_ELEVATION_350 0 "High" 1 "MidHigh" 2 "MidLow" 3 "Low" ;
VAL_ 1111 DET_IDM_350 0 "Not_IDM_Output" 1 "IDM_Output" ;
VAL_ 1111 DET_MTD_350 0 "Not_MTD_Output" 1 "MTD_Output" ;
VAL_ 1111 DET_BELOW_RAIN_THOLD_350 0 "DetBelowRainThold" 1 "DetAboveRainThold" ;
VAL_ 1111 DET_CONFD_AZIMUTH_351 0 "High" 1 "MidHigh" 2 "MidLow" 3 "Low" ;
VAL_ 1111 DET_CONFD_ELEVATION_351 0 "High" 1 "MidHigh" 2 "MidLow" 3 "Low" ;
VAL_ 1111 DET_IDM_351 0 "Not_IDM_Output" 1 "IDM_Output" ;
VAL_ 1111 DET_MTD_351 0 "Not_MTD_Output" 1 "MTD_Output" ;
VAL_ 1111 DET_BELOW_RAIN_THOLD_351 0 "DetBelowRainThold" 1 "DetAboveRainThold" ;
VAL_ 1111 DET_IDM_352 0 "Not_IDM_Output" 1 "IDM_Output" ;
VAL_ 1111 DET_MTD_352 0 "Not_MTD_Output" 1 "MTD_Output" ;
VAL_ 1111 DET_BELOW_RAIN_THOLD_352 0 "DetBelowRainThold" 1 "DetAboveRainThold" ;
SIG_GROUP_ 1096 Detections_289_292 1 : DET_PROB_1STAZHYPO_289 DET_PROB_1STAZHYPO_290 DET_PROB_1STAZHYPO_291 DET_PROB_1STAZHYPO_292 DET_IDM_289 DET_IDM_290 DET_IDM_291 DET_IDM_292 DET_MTD_292 DET_MTD_291 DET_MTD_290 DET_MTD_289 DET_BELOW_RAIN_THOLD_292 DET_BELOW_RAIN_THOLD_291 DET_BELOW_RAIN_THOLD_290 DET_BELOW_RAIN_THOLD_289 DET_MH_CRC16_289_292 DET_MH_CYCLE_COUNTER_289_292 DET_MH_SCAN_INDEX_4LSB_289_292 DET_CONFD_ELEVATION_289 DET_CONFD_AZIMUTH_289 DET_HVC_FLAG_289 DET_EXISTENCE_PROB_289 DET_SNR_289 DET_SUPER_RES_TARGET_289 DET_BI_STATIC_FLAG_289 DET_RCS_289 DET_ELEVATION_ERR_289 DET_ELEVATION_289 DET_AZIMUTH_ERR_289 DET_AZIMUTH_289 DET_RANGE_VELOCITY_ERR_289 DET_RANGE_VELOCITY_289 DET_RANGE_ERR_289 DET_RANGE_289 DET_CONFD_ELEVATION_290 DET_CONFD_AZIMUTH_290 DET_HVC_FLAG_290 DET_EXISTENCE_PROB_290 DET_SNR_290 DET_SUPER_RES_TARGET_290 DET_BI_STATIC_FLAG_290 DET_RCS_290 DET_ELEVATION_ERR_290 DET_ELEVATION_290 DET_AZIMUTH_ERR_290 DET_AZIMUTH_290 DET_RANGE_VELOCITY_ERR_290 DET_RANGE_VELOCITY_290 DET_RANGE_ERR_290 DET_RANGE_290 DET_CONFD_ELEVATION_291 DET_CONFD_AZIMUTH_291 DET_HVC_FLAG_291 DET_EXISTENCE_PROB_291 DET_SNR_291 DET_SUPER_RES_TARGET_291 DET_BI_STATIC_FLAG_291 DET_RCS_291 DET_ELEVATION_ERR_291 DET_ELEVATION_291 DET_AZIMUTH_ERR_291 DET_AZIMUTH_291 DET_RANGE_VELOCITY_ERR_291 DET_RANGE_VELOCITY_291 DET_RANGE_ERR_291 DET_RANGE_291 DET_CONFD_ELEVATION_292 DET_CONFD_AZIMUTH_292 DET_HVC_FLAG_292 DET_EXISTENCE_PROB_292 DET_SNR_292 DET_SUPER_RES_TARGET_292 DET_BI_STATIC_FLAG_292 DET_RCS_292 DET_ELEVATION_ERR_292 DET_ELEVATION_292 DET_AZIMUTH_ERR_292 DET_AZIMUTH_292 DET_RANGE_VELOCITY_ERR_292 DET_RANGE_VELOCITY_292 DET_RANGE_ERR_292 DET_RANGE_292;
SIG_GROUP_ 1097 Detections_293_296 1 : DET_PROB_1STAZHYPO_293 DET_PROB_1STAZHYPO_294 DET_PROB_1STAZHYPO_295 DET_PROB_1STAZHYPO_296 DET_IDM_293 DET_IDM_294 DET_IDM_295 DET_IDM_296 DET_MTD_296 DET_MTD_295 DET_MTD_294 DET_MTD_293 DET_BELOW_RAIN_THOLD_296 DET_BELOW_RAIN_THOLD_295 DET_BELOW_RAIN_THOLD_294 DET_BELOW_RAIN_THOLD_293 DET_MH_CRC16_293_296 DET_MH_CYCLE_COUNTER_293_296 DET_MH_SCAN_INDEX_4LSB_293_296 DET_CONFD_ELEVATION_293 DET_CONFD_AZIMUTH_293 DET_HVC_FLAG_293 DET_EXISTENCE_PROB_293 DET_SNR_293 DET_SUPER_RES_TARGET_293 DET_BI_STATIC_FLAG_293 DET_RCS_293 DET_ELEVATION_ERR_293 DET_ELEVATION_293 DET_AZIMUTH_ERR_293 DET_AZIMUTH_293 DET_RANGE_VELOCITY_ERR_293 DET_RANGE_VELOCITY_293 DET_RANGE_ERR_293 DET_RANGE_293 DET_CONFD_ELEVATION_294 DET_CONFD_AZIMUTH_294 DET_HVC_FLAG_294 DET_EXISTENCE_PROB_294 DET_SNR_294 DET_SUPER_RES_TARGET_294 DET_BI_STATIC_FLAG_294 DET_RCS_294 DET_ELEVATION_ERR_294 DET_ELEVATION_294 DET_AZIMUTH_ERR_294 DET_AZIMUTH_294 DET_RANGE_VELOCITY_ERR_294 DET_RANGE_VELOCITY_294 DET_RANGE_ERR_294 DET_RANGE_294 DET_CONFD_ELEVATION_295 DET_CONFD_AZIMUTH_295 DET_HVC_FLAG_295 DET_EXISTENCE_PROB_295 DET_SNR_295 DET_SUPER_RES_TARGET_295 DET_BI_STATIC_FLAG_295 DET_RCS_295 DET_ELEVATION_ERR_295 DET_ELEVATION_295 DET_AZIMUTH_ERR_295 DET_AZIMUTH_295 DET_RANGE_VELOCITY_ERR_295 DET_RANGE_VELOCITY_295 DET_RANGE_ERR_295 DET_RANGE_295 DET_CONFD_ELEVATION_296 DET_CONFD_AZIMUTH_296 DET_HVC_FLAG_296 DET_EXISTENCE_PROB_296 DET_SNR_296 DET_SUPER_RES_TARGET_296 DET_BI_STATIC_FLAG_296 DET_RCS_296 DET_ELEVATION_ERR_296 DET_ELEVATION_296 DET_AZIMUTH_ERR_296 DET_AZIMUTH_296 DET_RANGE_VELOCITY_ERR_296 DET_RANGE_VELOCITY_296 DET_RANGE_ERR_296 DET_RANGE_296;
SIG_GROUP_ 1098 Detections_297_300 1 : DET_PROB_1STAZHYPO_297 DET_PROB_1STAZHYPO_298 DET_PROB_1STAZHYPO_299 DET_PROB_1STAZHYPO_300 DET_IDM_297 DET_IDM_298 DET_IDM_299 DET_IDM_300 DET_MTD_300 DET_MTD_299 DET_MTD_298 DET_MTD_297 DET_BELOW_RAIN_THOLD_300 DET_BELOW_RAIN_THOLD_299 DET_BELOW_RAIN_THOLD_298 DET_BELOW_RAIN_THOLD_297 DET_MH_CRC16_297_300 DET_MH_CYCLE_COUNTER_297_300 DET_MH_SCAN_INDEX_4LSB_297_300 DET_CONFD_ELEVATION_297 DET_CONFD_AZIMUTH_297 DET_HVC_FLAG_297 DET_EXISTENCE_PROB_297 DET_SNR_297 DET_SUPER_RES_TARGET_297 DET_BI_STATIC_FLAG_297 DET_RCS_297 DET_ELEVATION_ERR_297 DET_ELEVATION_297 DET_AZIMUTH_ERR_297 DET_AZIMUTH_297 DET_RANGE_VELOCITY_ERR_297 DET_RANGE_VELOCITY_297 DET_RANGE_ERR_297 DET_RANGE_297 DET_CONFD_ELEVATION_298 DET_CONFD_AZIMUTH_298 DET_HVC_FLAG_298 DET_EXISTENCE_PROB_298 DET_SNR_298 DET_SUPER_RES_TARGET_298 DET_BI_STATIC_FLAG_298 DET_RCS_298 DET_ELEVATION_ERR_298 DET_ELEVATION_298 DET_AZIMUTH_ERR_298 DET_AZIMUTH_298 DET_RANGE_VELOCITY_ERR_298 DET_RANGE_VELOCITY_298 DET_RANGE_ERR_298 DET_RANGE_298 DET_CONFD_ELEVATION_299 DET_CONFD_AZIMUTH_299 DET_HVC_FLAG_299 DET_EXISTENCE_PROB_299 DET_SNR_299 DET_SUPER_RES_TARGET_299 DET_BI_STATIC_FLAG_299 DET_RCS_299 DET_ELEVATION_ERR_299 DET_ELEVATION_299 DET_AZIMUTH_ERR_299 DET_AZIMUTH_299 DET_RANGE_VELOCITY_ERR_299 DET_RANGE_VELOCITY_299 DET_RANGE_ERR_299 DET_RANGE_299 DET_CONFD_ELEVATION_300 DET_CONFD_AZIMUTH_300 DET_HVC_FLAG_300 DET_EXISTENCE_PROB_300 DET_SNR_300 DET_SUPER_RES_TARGET_300 DET_BI_STATIC_FLAG_300 DET_RCS_300 DET_ELEVATION_ERR_300 DET_ELEVATION_300 DET_AZIMUTH_ERR_300 DET_AZIMUTH_300 DET_RANGE_VELOCITY_ERR_300 DET_RANGE_VELOCITY_300 DET_RANGE_ERR_300 DET_RANGE_300;
SIG_GROUP_ 1099 Detections_301_304 1 : DET_PROB_1STAZHYPO_301 DET_PROB_1STAZHYPO_302 DET_PROB_1STAZHYPO_303 DET_PROB_1STAZHYPO_304 DET_IDM_301 DET_IDM_302 DET_IDM_303 DET_IDM_304 DET_MTD_304 DET_MTD_303 DET_MTD_302 DET_MTD_301 DET_BELOW_RAIN_THOLD_304 DET_BELOW_RAIN_THOLD_303 DET_BELOW_RAIN_THOLD_302 DET_BELOW_RAIN_THOLD_301 DET_MH_CRC16_301_304 DET_MH_CYCLE_COUNTER_301_304 DET_MH_SCAN_INDEX_4LSB_301_304 DET_CONFD_ELEVATION_301 DET_CONFD_AZIMUTH_301 DET_HVC_FLAG_301 DET_EXISTENCE_PROB_301 DET_SNR_301 DET_SUPER_RES_TARGET_301 DET_BI_STATIC_FLAG_301 DET_RCS_301 DET_ELEVATION_ERR_301 DET_ELEVATION_301 DET_AZIMUTH_ERR_301 DET_AZIMUTH_301 DET_RANGE_VELOCITY_ERR_301 DET_RANGE_VELOCITY_301 DET_RANGE_ERR_301 DET_RANGE_301 DET_CONFD_ELEVATION_302 DET_CONFD_AZIMUTH_302 DET_HVC_FLAG_302 DET_EXISTENCE_PROB_302 DET_SNR_302 DET_SUPER_RES_TARGET_302 DET_BI_STATIC_FLAG_302 DET_RCS_302 DET_ELEVATION_ERR_302 DET_ELEVATION_302 DET_AZIMUTH_ERR_302 DET_AZIMUTH_302 DET_RANGE_VELOCITY_ERR_302 DET_RANGE_VELOCITY_302 DET_RANGE_ERR_302 DET_RANGE_302 DET_CONFD_ELEVATION_303 DET_CONFD_AZIMUTH_303 DET_HVC_FLAG_303 DET_EXISTENCE_PROB_303 DET_SNR_303 DET_SUPER_RES_TARGET_303 DET_BI_STATIC_FLAG_303 DET_RCS_303 DET_ELEVATION_ERR_303 DET_ELEVATION_303 DET_AZIMUTH_ERR_303 DET_AZIMUTH_303 DET_RANGE_VELOCITY_ERR_303 DET_RANGE_VELOCITY_303 DET_RANGE_ERR_303 DET_RANGE_303 DET_CONFD_ELEVATION_304 DET_CONFD_AZIMUTH_304 DET_HVC_FLAG_304 DET_EXISTENCE_PROB_304 DET_SNR_304 DET_SUPER_RES_TARGET_304 DET_BI_STATIC_FLAG_304 DET_RCS_304 DET_ELEVATION_ERR_304 DET_ELEVATION_304 DET_AZIMUTH_ERR_304 DET_AZIMUTH_304 DET_RANGE_VELOCITY_ERR_304 DET_RANGE_VELOCITY_304 DET_RANGE_ERR_304 DET_RANGE_304;
SIG_GROUP_ 1100 Detections_305_308 1 : DET_PROB_1STAZHYPO_305 DET_PROB_1STAZHYPO_306 DET_PROB_1STAZHYPO_307 DET_PROB_1STAZHYPO_308 DET_IDM_305 DET_IDM_306 DET_IDM_307 DET_IDM_308 DET_MTD_308 DET_MTD_307 DET_MTD_306 DET_MTD_305 DET_BELOW_RAIN_THOLD_308 DET_BELOW_RAIN_THOLD_307 DET_BELOW_RAIN_THOLD_306 DET_BELOW_RAIN_THOLD_305 DET_MH_CRC16_305_308 DET_MH_CYCLE_COUNTER_305_308 DET_MH_SCAN_INDEX_4LSB_305_308 DET_CONFD_ELEVATION_305 DET_CONFD_AZIMUTH_305 DET_HVC_FLAG_305 DET_EXISTENCE_PROB_305 DET_SNR_305 DET_SUPER_RES_TARGET_305 DET_BI_STATIC_FLAG_305 DET_RCS_305 DET_ELEVATION_ERR_305 DET_ELEVATION_305 DET_AZIMUTH_ERR_305 DET_AZIMUTH_305 DET_RANGE_VELOCITY_ERR_305 DET_RANGE_VELOCITY_305 DET_RANGE_ERR_305 DET_RANGE_305 DET_CONFD_ELEVATION_306 DET_CONFD_AZIMUTH_306 DET_HVC_FLAG_306 DET_EXISTENCE_PROB_306 DET_SNR_306 DET_SUPER_RES_TARGET_306 DET_BI_STATIC_FLAG_306 DET_RCS_306 DET_ELEVATION_ERR_306 DET_ELEVATION_306 DET_AZIMUTH_ERR_306 DET_AZIMUTH_306 DET_RANGE_VELOCITY_ERR_306 DET_RANGE_VELOCITY_306 DET_RANGE_ERR_306 DET_RANGE_306 DET_CONFD_ELEVATION_307 DET_CONFD_AZIMUTH_307 DET_HVC_FLAG_307 DET_EXISTENCE_PROB_307 DET_SNR_307 DET_SUPER_RES_TARGET_307 DET_BI_STATIC_FLAG_307 DET_RCS_307 DET_ELEVATION_ERR_307 DET_ELEVATION_307 DET_AZIMUTH_ERR_307 DET_AZIMUTH_307 DET_RANGE_VELOCITY_ERR_307 DET_RANGE_VELOCITY_307 DET_RANGE_ERR_307 DET_RANGE_307 DET_CONFD_ELEVATION_308 DET_CONFD_AZIMUTH_308 DET_HVC_FLAG_308 DET_EXISTENCE_PROB_308 DET_SNR_308 DET_SUPER_RES_TARGET_308 DET_BI_STATIC_FLAG_308 DET_RCS_308 DET_ELEVATION_ERR_308 DET_ELEVATION_308 DET_AZIMUTH_ERR_308 DET_AZIMUTH_308 DET_RANGE_VELOCITY_ERR_308 DET_RANGE_VELOCITY_308 DET_RANGE_ERR_308 DET_RANGE_308;
SIG_GROUP_ 1101 Detections_309_312 1 : DET_PROB_1STAZHYPO_309 DET_PROB_1STAZHYPO_310 DET_PROB_1STAZHYPO_311 DET_PROB_1STAZHYPO_312 DET_IDM_309 DET_IDM_310 DET_IDM_311 DET_IDM_312 DET_MTD_312 DET_MTD_311 DET_MTD_310 DET_MTD_309 DET_BELOW_RAIN_THOLD_312 DET_BELOW_RAIN_THOLD_311 DET_BELOW_RAIN_THOLD_310 DET_BELOW_RAIN_THOLD_309 DET_MH_CRC16_309_312 DET_MH_CYCLE_COUNTER_309_312 DET_MH_SCAN_INDEX_4LSB_309_312 DET_CONFD_ELEVATION_309 DET_CONFD_AZIMUTH_309 DET_HVC_FLAG_309 DET_EXISTENCE_PROB_309 DET_SNR_309 DET_SUPER_RES_TARGET_309 DET_BI_STATIC_FLAG_309 DET_RCS_309 DET_ELEVATION_ERR_309 DET_ELEVATION_309 DET_AZIMUTH_ERR_309 DET_AZIMUTH_309 DET_RANGE_VELOCITY_ERR_309 DET_RANGE_VELOCITY_309 DET_RANGE_ERR_309 DET_RANGE_309 DET_CONFD_ELEVATION_310 DET_CONFD_AZIMUTH_310 DET_HVC_FLAG_310 DET_EXISTENCE_PROB_310 DET_SNR_310 DET_SUPER_RES_TARGET_310 DET_BI_STATIC_FLAG_310 DET_RCS_310 DET_ELEVATION_ERR_310 DET_ELEVATION_310 DET_AZIMUTH_ERR_310 DET_AZIMUTH_310 DET_RANGE_VELOCITY_ERR_310 DET_RANGE_VELOCITY_310 DET_RANGE_ERR_310 DET_RANGE_310 DET_CONFD_ELEVATION_311 DET_CONFD_AZIMUTH_311 DET_HVC_FLAG_311 DET_EXISTENCE_PROB_311 DET_SNR_311 DET_SUPER_RES_TARGET_311 DET_BI_STATIC_FLAG_311 DET_RCS_311 DET_ELEVATION_ERR_311 DET_ELEVATION_311 DET_AZIMUTH_ERR_311 DET_AZIMUTH_311 DET_RANGE_VELOCITY_ERR_311 DET_RANGE_VELOCITY_311 DET_RANGE_ERR_311 DET_RANGE_311 DET_CONFD_ELEVATION_312 DET_CONFD_AZIMUTH_312 DET_HVC_FLAG_312 DET_EXISTENCE_PROB_312 DET_SNR_312 DET_SUPER_RES_TARGET_312 DET_BI_STATIC_FLAG_312 DET_RCS_312 DET_ELEVATION_ERR_312 DET_ELEVATION_312 DET_AZIMUTH_ERR_312 DET_AZIMUTH_312 DET_RANGE_VELOCITY_ERR_312 DET_RANGE_VELOCITY_312 DET_RANGE_ERR_312 DET_RANGE_312;
SIG_GROUP_ 1102 Detections_313_316 1 : DET_PROB_1STAZHYPO_313 DET_PROB_1STAZHYPO_314 DET_PROB_1STAZHYPO_315 DET_PROB_1STAZHYPO_316 DET_IDM_313 DET_IDM_314 DET_IDM_315 DET_IDM_316 DET_MTD_316 DET_MTD_315 DET_MTD_314 DET_MTD_313 DET_BELOW_RAIN_THOLD_316 DET_BELOW_RAIN_THOLD_315 DET_BELOW_RAIN_THOLD_314 DET_BELOW_RAIN_THOLD_313 DET_MH_CRC16_313_316 DET_MH_CYCLE_COUNTER_313_316 DET_MH_SCAN_INDEX_4LSB_313_316 DET_CONFD_ELEVATION_313 DET_CONFD_AZIMUTH_313 DET_HVC_FLAG_313 DET_EXISTENCE_PROB_313 DET_SNR_313 DET_SUPER_RES_TARGET_313 DET_BI_STATIC_FLAG_313 DET_RCS_313 DET_ELEVATION_ERR_313 DET_ELEVATION_313 DET_AZIMUTH_ERR_313 DET_AZIMUTH_313 DET_RANGE_VELOCITY_ERR_313 DET_RANGE_VELOCITY_313 DET_RANGE_ERR_313 DET_RANGE_313 DET_CONFD_ELEVATION_314 DET_CONFD_AZIMUTH_314 DET_HVC_FLAG_314 DET_EXISTENCE_PROB_314 DET_SNR_314 DET_SUPER_RES_TARGET_314 DET_BI_STATIC_FLAG_314 DET_RCS_314 DET_ELEVATION_ERR_314 DET_ELEVATION_314 DET_AZIMUTH_ERR_314 DET_AZIMUTH_314 DET_RANGE_VELOCITY_ERR_314 DET_RANGE_VELOCITY_314 DET_RANGE_ERR_314 DET_RANGE_314 DET_CONFD_ELEVATION_315 DET_CONFD_AZIMUTH_315 DET_HVC_FLAG_315 DET_EXISTENCE_PROB_315 DET_SNR_315 DET_SUPER_RES_TARGET_315 DET_BI_STATIC_FLAG_315 DET_RCS_315 DET_ELEVATION_ERR_315 DET_ELEVATION_315 DET_AZIMUTH_ERR_315 DET_AZIMUTH_315 DET_RANGE_VELOCITY_ERR_315 DET_RANGE_VELOCITY_315 DET_RANGE_ERR_315 DET_RANGE_315 DET_CONFD_ELEVATION_316 DET_CONFD_AZIMUTH_316 DET_HVC_FLAG_316 DET_EXISTENCE_PROB_316 DET_SNR_316 DET_SUPER_RES_TARGET_316 DET_BI_STATIC_FLAG_316 DET_RCS_316 DET_ELEVATION_ERR_316 DET_ELEVATION_316 DET_AZIMUTH_ERR_316 DET_AZIMUTH_316 DET_RANGE_VELOCITY_ERR_316 DET_RANGE_VELOCITY_316 DET_RANGE_ERR_316 DET_RANGE_316;
SIG_GROUP_ 1103 Detections_317_320 1 : DET_PROB_1STAZHYPO_317 DET_PROB_1STAZHYPO_318 DET_PROB_1STAZHYPO_319 DET_PROB_1STAZHYPO_320 DET_IDM_317 DET_IDM_318 DET_IDM_319 DET_IDM_320 DET_MTD_320 DET_MTD_319 DET_MTD_318 DET_MTD_317 DET_BELOW_RAIN_THOLD_320 DET_BELOW_RAIN_THOLD_319 DET_BELOW_RAIN_THOLD_318 DET_BELOW_RAIN_THOLD_317 DET_MH_CRC16_317_320 DET_MH_CYCLE_COUNTER_317_320 DET_MH_SCAN_INDEX_4LSB_317_320 DET_CONFD_ELEVATION_317 DET_CONFD_AZIMUTH_317 DET_HVC_FLAG_317 DET_EXISTENCE_PROB_317 DET_SNR_317 DET_SUPER_RES_TARGET_317 DET_BI_STATIC_FLAG_317 DET_RCS_317 DET_ELEVATION_ERR_317 DET_ELEVATION_317 DET_AZIMUTH_ERR_317 DET_AZIMUTH_317 DET_RANGE_VELOCITY_ERR_317 DET_RANGE_VELOCITY_317 DET_RANGE_ERR_317 DET_RANGE_317 DET_CONFD_ELEVATION_318 DET_CONFD_AZIMUTH_318 DET_HVC_FLAG_318 DET_EXISTENCE_PROB_318 DET_SNR_318 DET_SUPER_RES_TARGET_318 DET_BI_STATIC_FLAG_318 DET_RCS_318 DET_ELEVATION_ERR_318 DET_ELEVATION_318 DET_AZIMUTH_ERR_318 DET_AZIMUTH_318 DET_RANGE_VELOCITY_ERR_318 DET_RANGE_VELOCITY_318 DET_RANGE_ERR_318 DET_RANGE_318 DET_CONFD_ELEVATION_319 DET_CONFD_AZIMUTH_319 DET_HVC_FLAG_319 DET_EXISTENCE_PROB_319 DET_SNR_319 DET_SUPER_RES_TARGET_319 DET_BI_STATIC_FLAG_319 DET_RCS_319 DET_ELEVATION_ERR_319 DET_ELEVATION_319 DET_AZIMUTH_ERR_319 DET_AZIMUTH_319 DET_RANGE_VELOCITY_ERR_319 DET_RANGE_VELOCITY_319 DET_RANGE_ERR_319 DET_RANGE_319 DET_CONFD_ELEVATION_320 DET_CONFD_AZIMUTH_320 DET_HVC_FLAG_320 DET_EXISTENCE_PROB_320 DET_SNR_320 DET_SUPER_RES_TARGET_320 DET_BI_STATIC_FLAG_320 DET_RCS_320 DET_ELEVATION_ERR_320 DET_ELEVATION_320 DET_AZIMUTH_ERR_320 DET_AZIMUTH_320 DET_RANGE_VELOCITY_ERR_320 DET_RANGE_VELOCITY_320 DET_RANGE_ERR_320 DET_RANGE_320;
SIG_GROUP_ 1104 Detections_321_324 1 : DET_PROB_1STAZHYPO_321 DET_PROB_1STAZHYPO_322 DET_PROB_1STAZHYPO_323 DET_PROB_1STAZHYPO_324 DET_IDM_321 DET_IDM_322 DET_IDM_323 DET_IDM_324 DET_MTD_324 DET_MTD_323 DET_MTD_322 DET_MTD_321 DET_BELOW_RAIN_THOLD_324 DET_BELOW_RAIN_THOLD_323 DET_BELOW_RAIN_THOLD_322 DET_BELOW_RAIN_THOLD_321 DET_MH_CRC16_321_324 DET_MH_CYCLE_COUNTER_321_324 DET_MH_SCAN_INDEX_4LSB_321_324 DET_CONFD_ELEVATION_321 DET_CONFD_AZIMUTH_321 DET_HVC_FLAG_321 DET_EXISTENCE_PROB_321 DET_SNR_321 DET_SUPER_RES_TARGET_321 DET_BI_STATIC_FLAG_321 DET_RCS_321 DET_ELEVATION_ERR_321 DET_ELEVATION_321 DET_AZIMUTH_ERR_321 DET_AZIMUTH_321 DET_RANGE_VELOCITY_ERR_321 DET_RANGE_VELOCITY_321 DET_RANGE_ERR_321 DET_RANGE_321 DET_CONFD_ELEVATION_322 DET_CONFD_AZIMUTH_322 DET_HVC_FLAG_322 DET_EXISTENCE_PROB_322 DET_SNR_322 DET_SUPER_RES_TARGET_322 DET_BI_STATIC_FLAG_322 DET_RCS_322 DET_ELEVATION_ERR_322 DET_ELEVATION_322 DET_AZIMUTH_ERR_322 DET_AZIMUTH_322 DET_RANGE_VELOCITY_ERR_322 DET_RANGE_VELOCITY_322 DET_RANGE_ERR_322 DET_RANGE_322 DET_CONFD_ELEVATION_323 DET_CONFD_AZIMUTH_323 DET_HVC_FLAG_323 DET_EXISTENCE_PROB_323 DET_SNR_323 DET_SUPER_RES_TARGET_323 DET_BI_STATIC_FLAG_323 DET_RCS_323 DET_ELEVATION_ERR_323 DET_ELEVATION_323 DET_AZIMUTH_ERR_323 DET_AZIMUTH_323 DET_RANGE_VELOCITY_ERR_323 DET_RANGE_VELOCITY_323 DET_RANGE_ERR_323 DET_RANGE_323 DET_CONFD_ELEVATION_324 DET_CONFD_AZIMUTH_324 DET_HVC_FLAG_324 DET_EXISTENCE_PROB_324 DET_SNR_324 DET_SUPER_RES_TARGET_324 DET_BI_STATIC_FLAG_324 DET_RCS_324 DET_ELEVATION_ERR_324 DET_ELEVATION_324 DET_AZIMUTH_ERR_324 DET_AZIMUTH_324 DET_RANGE_VELOCITY_ERR_324 DET_RANGE_VELOCITY_324 DET_RANGE_ERR_324 DET_RANGE_324;
SIG_GROUP_ 1105 Detections_325_328 1 : DET_PROB_1STAZHYPO_325 DET_PROB_1STAZHYPO_326 DET_PROB_1STAZHYPO_327 DET_PROB_1STAZHYPO_328 DET_IDM_325 DET_IDM_326 DET_IDM_327 DET_IDM_328 DET_MTD_328 DET_MTD_327 DET_MTD_326 DET_MTD_325 DET_BELOW_RAIN_THOLD_328 DET_BELOW_RAIN_THOLD_327 DET_BELOW_RAIN_THOLD_326 DET_BELOW_RAIN_THOLD_325 DET_MH_CRC16_325_328 DET_MH_CYCLE_COUNTER_325_328 DET_MH_SCAN_INDEX_4LSB_325_328 DET_CONFD_ELEVATION_325 DET_CONFD_AZIMUTH_325 DET_HVC_FLAG_325 DET_EXISTENCE_PROB_325 DET_SNR_325 DET_SUPER_RES_TARGET_325 DET_BI_STATIC_FLAG_325 DET_RCS_325 DET_ELEVATION_ERR_325 DET_ELEVATION_325 DET_AZIMUTH_ERR_325 DET_AZIMUTH_325 DET_RANGE_VELOCITY_ERR_325 DET_RANGE_VELOCITY_325 DET_RANGE_ERR_325 DET_RANGE_325 DET_CONFD_ELEVATION_326 DET_CONFD_AZIMUTH_326 DET_HVC_FLAG_326 DET_EXISTENCE_PROB_326 DET_SNR_326 DET_SUPER_RES_TARGET_326 DET_BI_STATIC_FLAG_326 DET_RCS_326 DET_ELEVATION_ERR_326 DET_ELEVATION_326 DET_AZIMUTH_ERR_326 DET_AZIMUTH_326 DET_RANGE_VELOCITY_ERR_326 DET_RANGE_VELOCITY_326 DET_RANGE_ERR_326 DET_RANGE_326 DET_CONFD_ELEVATION_327 DET_CONFD_AZIMUTH_327 DET_HVC_FLAG_327 DET_EXISTENCE_PROB_327 DET_SNR_327 DET_SUPER_RES_TARGET_327 DET_BI_STATIC_FLAG_327 DET_RCS_327 DET_ELEVATION_ERR_327 DET_ELEVATION_327 DET_AZIMUTH_ERR_327 DET_AZIMUTH_327 DET_RANGE_VELOCITY_ERR_327 DET_RANGE_VELOCITY_327 DET_RANGE_ERR_327 DET_RANGE_327 DET_CONFD_ELEVATION_328 DET_CONFD_AZIMUTH_328 DET_HVC_FLAG_328 DET_EXISTENCE_PROB_328 DET_SNR_328 DET_SUPER_RES_TARGET_328 DET_BI_STATIC_FLAG_328 DET_RCS_328 DET_ELEVATION_ERR_328 DET_ELEVATION_328 DET_AZIMUTH_ERR_328 DET_AZIMUTH_328 DET_RANGE_VELOCITY_ERR_328 DET_RANGE_VELOCITY_328 DET_RANGE_ERR_328 DET_RANGE_328;
SIG_GROUP_ 1106 Detections_329_332 1 : DET_PROB_1STAZHYPO_329 DET_PROB_1STAZHYPO_330 DET_PROB_1STAZHYPO_331 DET_PROB_1STAZHYPO_332 DET_IDM_329 DET_IDM_330 DET_IDM_331 DET_IDM_332 DET_MTD_332 DET_MTD_331 DET_MTD_330 DET_MTD_329 DET_BELOW_RAIN_THOLD_332 DET_BELOW_RAIN_THOLD_331 DET_BELOW_RAIN_THOLD_330 DET_BELOW_RAIN_THOLD_329 DET_MH_CRC16_329_332 DET_MH_CYCLE_COUNTER_329_332 DET_MH_SCAN_INDEX_4LSB_329_332 DET_CONFD_ELEVATION_329 DET_CONFD_AZIMUTH_329 DET_HVC_FLAG_329 DET_EXISTENCE_PROB_329 DET_SNR_329 DET_SUPER_RES_TARGET_329 DET_BI_STATIC_FLAG_329 DET_RCS_329 DET_ELEVATION_ERR_329 DET_ELEVATION_329 DET_AZIMUTH_ERR_329 DET_AZIMUTH_329 DET_RANGE_VELOCITY_ERR_329 DET_RANGE_VELOCITY_329 DET_RANGE_ERR_329 DET_RANGE_329 DET_CONFD_ELEVATION_330 DET_CONFD_AZIMUTH_330 DET_HVC_FLAG_330 DET_EXISTENCE_PROB_330 DET_SNR_330 DET_SUPER_RES_TARGET_330 DET_BI_STATIC_FLAG_330 DET_RCS_330 DET_ELEVATION_ERR_330 DET_ELEVATION_330 DET_AZIMUTH_ERR_330 DET_AZIMUTH_330 DET_RANGE_VELOCITY_ERR_330 DET_RANGE_VELOCITY_330 DET_RANGE_ERR_330 DET_RANGE_330 DET_CONFD_ELEVATION_331 DET_CONFD_AZIMUTH_331 DET_HVC_FLAG_331 DET_EXISTENCE_PROB_331 DET_SNR_331 DET_SUPER_RES_TARGET_331 DET_BI_STATIC_FLAG_331 DET_RCS_331 DET_ELEVATION_ERR_331 DET_ELEVATION_331 DET_AZIMUTH_ERR_331 DET_AZIMUTH_331 DET_RANGE_VELOCITY_ERR_331 DET_RANGE_VELOCITY_331 DET_RANGE_ERR_331 DET_RANGE_331 DET_CONFD_ELEVATION_332 DET_CONFD_AZIMUTH_332 DET_HVC_FLAG_332 DET_EXISTENCE_PROB_332 DET_SNR_332 DET_SUPER_RES_TARGET_332 DET_BI_STATIC_FLAG_332 DET_RCS_332 DET_ELEVATION_ERR_332 DET_ELEVATION_332 DET_AZIMUTH_ERR_332 DET_AZIMUTH_332 DET_RANGE_VELOCITY_ERR_332 DET_RANGE_VELOCITY_332 DET_RANGE_ERR_332 DET_RANGE_332;
SIG_GROUP_ 1107 Detections_333_336 1 : DET_PROB_1STAZHYPO_333 DET_PROB_1STAZHYPO_334 DET_PROB_1STAZHYPO_335 DET_PROB_1STAZHYPO_336 DET_IDM_333 DET_IDM_334 DET_IDM_335 DET_IDM_336 DET_MTD_336 DET_MTD_335 DET_MTD_334 DET_MTD_333 DET_BELOW_RAIN_THOLD_336 DET_BELOW_RAIN_THOLD_335 DET_BELOW_RAIN_THOLD_334 DET_BELOW_RAIN_THOLD_333 DET_MH_CRC16_333_336 DET_MH_CYCLE_COUNTER_333_336 DET_MH_SCAN_INDEX_4LSB_333_336 DET_CONFD_ELEVATION_333 DET_CONFD_AZIMUTH_333 DET_HVC_FLAG_333 DET_EXISTENCE_PROB_333 DET_SNR_333 DET_SUPER_RES_TARGET_333 DET_BI_STATIC_FLAG_333 DET_RCS_333 DET_ELEVATION_ERR_333 DET_ELEVATION_333 DET_AZIMUTH_ERR_333 DET_AZIMUTH_333 DET_RANGE_VELOCITY_ERR_333 DET_RANGE_VELOCITY_333 DET_RANGE_ERR_333 DET_RANGE_333 DET_CONFD_ELEVATION_334 DET_CONFD_AZIMUTH_334 DET_HVC_FLAG_334 DET_EXISTENCE_PROB_334 DET_SNR_334 DET_SUPER_RES_TARGET_334 DET_BI_STATIC_FLAG_334 DET_RCS_334 DET_ELEVATION_ERR_334 DET_ELEVATION_334 DET_AZIMUTH_ERR_334 DET_AZIMUTH_334 DET_RANGE_VELOCITY_ERR_334 DET_RANGE_VELOCITY_334 DET_RANGE_ERR_334 DET_RANGE_334 DET_CONFD_ELEVATION_335 DET_CONFD_AZIMUTH_335 DET_HVC_FLAG_335 DET_EXISTENCE_PROB_335 DET_SNR_335 DET_SUPER_RES_TARGET_335 DET_BI_STATIC_FLAG_335 DET_RCS_335 DET_ELEVATION_ERR_335 DET_ELEVATION_335 DET_AZIMUTH_ERR_335 DET_AZIMUTH_335 DET_RANGE_VELOCITY_ERR_335 DET_RANGE_VELOCITY_335 DET_RANGE_ERR_335 DET_RANGE_335 DET_CONFD_ELEVATION_336 DET_CONFD_AZIMUTH_336 DET_HVC_FLAG_336 DET_EXISTENCE_PROB_336 DET_SNR_336 DET_SUPER_RES_TARGET_336 DET_BI_STATIC_FLAG_336 DET_RCS_336 DET_ELEVATION_ERR_336 DET_ELEVATION_336 DET_AZIMUTH_ERR_336 DET_AZIMUTH_336 DET_RANGE_VELOCITY_ERR_336 DET_RANGE_VELOCITY_336 DET_RANGE_ERR_336 DET_RANGE_336;
SIG_GROUP_ 1108 Detections_337_340 1 : DET_PROB_1STAZHYPO_337 DET_PROB_1STAZHYPO_338 DET_PROB_1STAZHYPO_339 DET_PROB_1STAZHYPO_340 DET_IDM_337 DET_IDM_338 DET_IDM_339 DET_IDM_340 DET_MTD_340 DET_MTD_339 DET_MTD_338 DET_MTD_337 DET_BELOW_RAIN_THOLD_340 DET_BELOW_RAIN_THOLD_339 DET_BELOW_RAIN_THOLD_338 DET_BELOW_RAIN_THOLD_337 DET_MH_CRC16_337_340 DET_MH_CYCLE_COUNTER_337_340 DET_MH_SCAN_INDEX_4LSB_337_340 DET_CONFD_ELEVATION_337 DET_CONFD_AZIMUTH_337 DET_HVC_FLAG_337 DET_EXISTENCE_PROB_337 DET_SNR_337 DET_SUPER_RES_TARGET_337 DET_BI_STATIC_FLAG_337 DET_RCS_337 DET_ELEVATION_ERR_337 DET_ELEVATION_337 DET_AZIMUTH_ERR_337 DET_AZIMUTH_337 DET_RANGE_VELOCITY_ERR_337 DET_RANGE_VELOCITY_337 DET_RANGE_ERR_337 DET_RANGE_337 DET_CONFD_ELEVATION_338 DET_CONFD_AZIMUTH_338 DET_HVC_FLAG_338 DET_EXISTENCE_PROB_338 DET_SNR_338 DET_SUPER_RES_TARGET_338 DET_BI_STATIC_FLAG_338 DET_RCS_338 DET_ELEVATION_ERR_338 DET_ELEVATION_338 DET_AZIMUTH_ERR_338 DET_AZIMUTH_338 DET_RANGE_VELOCITY_ERR_338 DET_RANGE_VELOCITY_338 DET_RANGE_ERR_338 DET_RANGE_338 DET_CONFD_ELEVATION_339 DET_CONFD_AZIMUTH_339 DET_HVC_FLAG_339 DET_EXISTENCE_PROB_339 DET_SNR_339 DET_SUPER_RES_TARGET_339 DET_BI_STATIC_FLAG_339 DET_RCS_339 DET_ELEVATION_ERR_339 DET_ELEVATION_339 DET_AZIMUTH_ERR_339 DET_AZIMUTH_339 DET_RANGE_VELOCITY_ERR_339 DET_RANGE_VELOCITY_339 DET_RANGE_ERR_339 DET_RANGE_339 DET_CONFD_ELEVATION_340 DET_CONFD_AZIMUTH_340 DET_HVC_FLAG_340 DET_EXISTENCE_PROB_340 DET_SNR_340 DET_SUPER_RES_TARGET_340 DET_BI_STATIC_FLAG_340 DET_RCS_340 DET_ELEVATION_ERR_340 DET_ELEVATION_340 DET_AZIMUTH_ERR_340 DET_AZIMUTH_340 DET_RANGE_VELOCITY_ERR_340 DET_RANGE_VELOCITY_340 DET_RANGE_ERR_340 DET_RANGE_340;
SIG_GROUP_ 1109 Detections_341_344 1 : DET_PROB_1STAZHYPO_341 DET_PROB_1STAZHYPO_342 DET_PROB_1STAZHYPO_343 DET_PROB_1STAZHYPO_344 DET_IDM_341 DET_IDM_342 DET_IDM_343 DET_IDM_344 DET_MTD_344 DET_MTD_343 DET_MTD_342 DET_MTD_341 DET_BELOW_RAIN_THOLD_344 DET_BELOW_RAIN_THOLD_343 DET_BELOW_RAIN_THOLD_342 DET_BELOW_RAIN_THOLD_341 DET_MH_CRC16_341_344 DET_MH_CYCLE_COUNTER_341_344 DET_MH_SCAN_INDEX_4LSB_341_344 DET_CONFD_ELEVATION_341 DET_CONFD_AZIMUTH_341 DET_HVC_FLAG_341 DET_EXISTENCE_PROB_341 DET_SNR_341 DET_SUPER_RES_TARGET_341 DET_BI_STATIC_FLAG_341 DET_RCS_341 DET_ELEVATION_ERR_341 DET_ELEVATION_341 DET_AZIMUTH_ERR_341 DET_AZIMUTH_341 DET_RANGE_VELOCITY_ERR_341 DET_RANGE_VELOCITY_341 DET_RANGE_ERR_341 DET_RANGE_341 DET_CONFD_ELEVATION_342 DET_CONFD_AZIMUTH_342 DET_HVC_FLAG_342 DET_EXISTENCE_PROB_342 DET_SNR_342 DET_SUPER_RES_TARGET_342 DET_BI_STATIC_FLAG_342 DET_RCS_342 DET_ELEVATION_ERR_342 DET_ELEVATION_342 DET_AZIMUTH_ERR_342 DET_AZIMUTH_342 DET_RANGE_VELOCITY_ERR_342 DET_RANGE_VELOCITY_342 DET_RANGE_ERR_342 DET_RANGE_342 DET_CONFD_ELEVATION_343 DET_CONFD_AZIMUTH_343 DET_HVC_FLAG_343 DET_EXISTENCE_PROB_343 DET_SNR_343 DET_SUPER_RES_TARGET_343 DET_BI_STATIC_FLAG_343 DET_RCS_343 DET_ELEVATION_ERR_343 DET_ELEVATION_343 DET_AZIMUTH_ERR_343 DET_AZIMUTH_343 DET_RANGE_VELOCITY_ERR_343 DET_RANGE_VELOCITY_343 DET_RANGE_ERR_343 DET_RANGE_343 DET_CONFD_ELEVATION_344 DET_CONFD_AZIMUTH_344 DET_HVC_FLAG_344 DET_EXISTENCE_PROB_344 DET_SNR_344 DET_SUPER_RES_TARGET_344 DET_BI_STATIC_FLAG_344 DET_RCS_344 DET_ELEVATION_ERR_344 DET_ELEVATION_344 DET_AZIMUTH_ERR_344 DET_AZIMUTH_344 DET_RANGE_VELOCITY_ERR_344 DET_RANGE_VELOCITY_344 DET_RANGE_ERR_344 DET_RANGE_344;
SIG_GROUP_ 1110 Detections_345_348 1 : DET_PROB_1STAZHYPO_345 DET_PROB_1STAZHYPO_346 DET_PROB_1STAZHYPO_347 DET_PROB_1STAZHYPO_348 DET_IDM_345 DET_IDM_346 DET_IDM_347 DET_IDM_348 DET_MTD_348 DET_MTD_347 DET_MTD_346 DET_MTD_345 DET_BELOW_RAIN_THOLD_348 DET_BELOW_RAIN_THOLD_347 DET_BELOW_RAIN_THOLD_346 DET_BELOW_RAIN_THOLD_345 DET_MH_CRC16_345_348 DET_MH_CYCLE_COUNTER_345_348 DET_MH_SCAN_INDEX_4LSB_345_348 DET_CONFD_ELEVATION_345 DET_CONFD_AZIMUTH_345 DET_HVC_FLAG_345 DET_EXISTENCE_PROB_345 DET_SNR_345 DET_SUPER_RES_TARGET_345 DET_BI_STATIC_FLAG_345 DET_RCS_345 DET_ELEVATION_ERR_345 DET_ELEVATION_345 DET_AZIMUTH_ERR_345 DET_AZIMUTH_345 DET_RANGE_VELOCITY_ERR_345 DET_RANGE_VELOCITY_345 DET_RANGE_ERR_345 DET_RANGE_345 DET_CONFD_ELEVATION_346 DET_CONFD_AZIMUTH_346 DET_HVC_FLAG_346 DET_EXISTENCE_PROB_346 DET_SNR_346 DET_SUPER_RES_TARGET_346 DET_BI_STATIC_FLAG_346 DET_RCS_346 DET_ELEVATION_ERR_346 DET_ELEVATION_346 DET_AZIMUTH_ERR_346 DET_AZIMUTH_346 DET_RANGE_VELOCITY_ERR_346 DET_RANGE_VELOCITY_346 DET_RANGE_ERR_346 DET_RANGE_346 DET_CONFD_ELEVATION_347 DET_CONFD_AZIMUTH_347 DET_HVC_FLAG_347 DET_EXISTENCE_PROB_347 DET_SNR_347 DET_SUPER_RES_TARGET_347 DET_BI_STATIC_FLAG_347 DET_RCS_347 DET_ELEVATION_ERR_347 DET_ELEVATION_347 DET_AZIMUTH_ERR_347 DET_AZIMUTH_347 DET_RANGE_VELOCITY_ERR_347 DET_RANGE_VELOCITY_347 DET_RANGE_ERR_347 DET_RANGE_347 DET_CONFD_ELEVATION_348 DET_CONFD_AZIMUTH_348 DET_HVC_FLAG_348 DET_EXISTENCE_PROB_348 DET_SNR_348 DET_SUPER_RES_TARGET_348 DET_BI_STATIC_FLAG_348 DET_RCS_348 DET_ELEVATION_ERR_348 DET_ELEVATION_348 DET_AZIMUTH_ERR_348 DET_AZIMUTH_348 DET_RANGE_VELOCITY_ERR_348 DET_RANGE_VELOCITY_348 DET_RANGE_ERR_348 DET_RANGE_348;
SIG_GROUP_ 1111 Detections_349_352 1 : DET_PROB_1STAZHYPO_349 DET_PROB_1STAZHYPO_350 DET_PROB_1STAZHYPO_351 DET_PROB_1STAZHYPO_352 DET_IDM_349 DET_IDM_350 DET_IDM_351 DET_IDM_352 DET_MTD_352 DET_MTD_351 DET_MTD_350 DET_MTD_349 DET_BELOW_RAIN_THOLD_352 DET_BELOW_RAIN_THOLD_351 DET_BELOW_RAIN_THOLD_350 DET_BELOW_RAIN_THOLD_349 DET_MH_CRC16_349_352 DET_MH_CYCLE_COUNTER_349_352 DET_MH_SCAN_INDEX_4LSB_349_352 DET_CONFD_ELEVATION_349 DET_CONFD_AZIMUTH_349 DET_HVC_FLAG_349 DET_EXISTENCE_PROB_349 DET_SNR_349 DET_SUPER_RES_TARGET_349 DET_BI_STATIC_FLAG_349 DET_RCS_349 DET_ELEVATION_ERR_349 DET_ELEVATION_349 DET_AZIMUTH_ERR_349 DET_AZIMUTH_349 DET_RANGE_VELOCITY_ERR_349 DET_RANGE_VELOCITY_349 DET_RANGE_ERR_349 DET_RANGE_349 DET_CONFD_ELEVATION_350 DET_CONFD_AZIMUTH_350 DET_HVC_FLAG_350 DET_EXISTENCE_PROB_350 DET_SNR_350 DET_SUPER_RES_TARGET_350 DET_BI_STATIC_FLAG_350 DET_RCS_350 DET_ELEVATION_ERR_350 DET_ELEVATION_350 DET_AZIMUTH_ERR_350 DET_AZIMUTH_350 DET_RANGE_VELOCITY_ERR_350 DET_RANGE_VELOCITY_350 DET_RANGE_ERR_350 DET_RANGE_350 DET_CONFD_ELEVATION_351 DET_CONFD_AZIMUTH_351 DET_HVC_FLAG_351 DET_EXISTENCE_PROB_351 DET_SNR_351 DET_SUPER_RES_TARGET_351 DET_BI_STATIC_FLAG_351 DET_RCS_351 DET_ELEVATION_ERR_351 DET_ELEVATION_351 DET_AZIMUTH_ERR_351 DET_AZIMUTH_351 DET_RANGE_VELOCITY_ERR_351 DET_RANGE_VELOCITY_351 DET_RANGE_ERR_351 DET_RANGE_351 DET_CONFD_ELEVATION_352 DET_CONFD_AZIMUTH_352 DET_HVC_FLAG_352 DET_EXISTENCE_PROB_352 DET_SNR_352 DET_SUPER_RES_TARGET_352 DET_BI_STATIC_FLAG_352 DET_RCS_352 DET_ELEVATION_ERR_352 DET_ELEVATION_352 DET_AZIMUTH_ERR_352 DET_AZIMUTH_352 DET_RANGE_VELOCITY_ERR_352 DET_RANGE_VELOCITY_352 DET_RANGE_ERR_352 DET_RANGE_352;
