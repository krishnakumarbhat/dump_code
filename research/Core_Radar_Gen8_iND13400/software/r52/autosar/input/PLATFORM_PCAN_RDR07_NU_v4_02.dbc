VERSION "created by canmatrix"

NS_ :

BS_:

BU_: External_Tool ADAS RDR07 RDR_Fusion_Partner RDR_Gateway

BO_ 1112 RDR_DETECTION_353_356: 64 RDR07
 SG_ DET_RANGE_353 : 24|15@1+ (0.015625,0) [0|500] "m"  ADAS
 SG_ DET_RANGE_ERR_353 : 40|7@1+ (0.0075,0) [0|0.9525] "m"  ADAS
 SG_ DET_RANGE_VELOCITY_353 : 48|15@1+ (0.0078125,-128) [-128|127.9921875] "m/s"  ADAS
 SG_ DET_RANGE_VELOCITY_ERR_353 : 64|8@1+ (0.003,0) [0|0.765] "m/s"  ADAS
 SG_ DET_AZIMUTH_353 : 88|13@1+ (0.0004,-1.5708) [-1.5708|1.5708] "rad"  ADAS
 SG_ DET_AZIMUTH_ERR_353 : 105|7@1+ (0.00087267,0) [0|0.11082909] "rad"  ADAS
 SG_ DET_ELEVATION_353 : 72|8@1+ (0.00275,-0.34925) [-0.34925|0.34925] "rad"  ADAS
 SG_ DET_ELEVATION_ERR_353 : 80|6@1+ (0.00174533,0) [0|0.10995579] "rad"  ADAS
 SG_ DET_RCS_353 : 128|8@1+ (0.5,-64) [-64|63.5] "dBsm"  ADAS
 SG_ DET_BI_STATIC_FLAG_353 : 104|1@1+ (1,0) [0|1] ""  ADAS
 SG_ DET_SUPER_RES_TARGET_353 : 87|1@1+ (1,0) [0|1] ""  ADAS
 SG_ DET_SNR_353 : 120|8@1+ (0.35156,0) [0|89.6478] "dB"  ADAS
 SG_ DET_EXISTENCE_PROB_353 : 112|6@1+ (1.588,0) [0|100] "%"  ADAS
 SG_ DET_HVC_FLAG_353 : 86|1@1+ (1,0) [0|1] ""  ADAS
 SG_ DET_CONFD_AZIMUTH_353 : 118|2@1+ (1,0) [0|3] ""  ADAS
 SG_ DET_CONFD_ELEVATION_353 : 101|2@1+ (1,0) [0|3] ""  ADAS
 SG_ DET_PROB_1STAZHYPO_353 : 103|1@1+ (1,0) [0|1] ""  ADAS
 SG_ DET_IDM_353 : 63|1@1+ (1,0) [0|1] ""  ADAS
 SG_ DET_MTD_353 : 47|1@1+ (1,0) [0|1] ""  ADAS
 SG_ DET_BELOW_RAIN_THOLD_353 : 39|1@1+ (1,0) [0|1] ""  ADAS
 SG_ DET_RANGE_354 : 136|15@1+ (0.015625,0) [0|500] "m"  ADAS
 SG_ DET_RANGE_ERR_354 : 152|7@1+ (0.0075,0) [0|0.9525] "m"  ADAS
 SG_ DET_RANGE_VELOCITY_354 : 160|15@1+ (0.0078125,-128) [-128|127.9921875] "m/s"  ADAS
 SG_ DET_RANGE_VELOCITY_ERR_354 : 176|8@1+ (0.003,0) [0|0.765] "m/s"  ADAS
 SG_ DET_AZIMUTH_354 : 200|13@1+ (0.0004,-1.5708) [-1.5708|1.5708] "rad"  ADAS
 SG_ DET_AZIMUTH_ERR_354 : 217|7@1+ (0.00087267,0) [0|0.11082909] "rad"  ADAS
 SG_ DET_ELEVATION_354 : 184|8@1+ (0.00275,-0.34925) [-0.34925|0.34925] "rad"  ADAS
 SG_ DET_ELEVATION_ERR_354 : 192|6@1+ (0.00174533,0) [0|0.10995579] "rad"  ADAS
 SG_ DET_RCS_354 : 240|8@1+ (0.5,-64) [-64|63.5] "dBsm"  ADAS
 SG_ DET_BI_STATIC_FLAG_354 : 216|1@1+ (1,0) [0|1] ""  ADAS
 SG_ DET_SUPER_RES_TARGET_354 : 199|1@1+ (1,0) [0|1] ""  ADAS
 SG_ DET_SNR_354 : 232|8@1+ (0.35156,0) [0|89.6478] "dB"  ADAS
 SG_ DET_EXISTENCE_PROB_354 : 224|6@1+ (1.588,0) [0|100] "%"  ADAS
 SG_ DET_HVC_FLAG_354 : 198|1@1+ (1,0) [0|1] ""  ADAS
 SG_ DET_CONFD_AZIMUTH_354 : 230|2@1+ (1,0) [0|3] ""  ADAS
 SG_ DET_CONFD_ELEVATION_354 : 213|2@1+ (1,0) [0|3] ""  ADAS
 SG_ DET_PROB_1STAZHYPO_354 : 215|1@1+ (1,0) [0|1] ""  ADAS
 SG_ DET_IDM_354 : 175|1@1+ (1,0) [0|1] ""  ADAS
 SG_ DET_MTD_354 : 159|1@1+ (1,0) [0|1] ""  ADAS
 SG_ DET_BELOW_RAIN_THOLD_354 : 151|1@1+ (1,0) [0|1] ""  ADAS
 SG_ DET_RANGE_355 : 248|15@1+ (0.015625,0) [0|500] "m"  ADAS
 SG_ DET_RANGE_ERR_355 : 264|7@1+ (0.0075,0) [0|0.9525] "m"  ADAS
 SG_ DET_RANGE_VELOCITY_355 : 272|15@1+ (0.0078125,-128) [-128|127.9921875] "m/s"  ADAS
 SG_ DET_RANGE_VELOCITY_ERR_355 : 288|8@1+ (0.003,0) [0|0.765] "m/s"  ADAS
 SG_ DET_AZIMUTH_355 : 312|13@1+ (0.0004,-1.5708) [-1.5708|1.5708] "rad"  ADAS
 SG_ DET_AZIMUTH_ERR_355 : 329|7@1+ (0.00087267,0) [0|0.11082909] "rad"  ADAS
 SG_ DET_ELEVATION_355 : 296|8@1+ (0.00275,-0.34925) [-0.34925|0.34925] "rad"  ADAS
 SG_ DET_ELEVATION_ERR_355 : 304|6@1+ (0.00174533,0) [0|0.10995579] "rad"  ADAS
 SG_ DET_RCS_355 : 352|8@1+ (0.5,-64) [-64|63.5] "dBsm"  ADAS
 SG_ DET_BI_STATIC_FLAG_355 : 328|1@1+ (1,0) [0|1] ""  ADAS
 SG_ DET_SUPER_RES_TARGET_355 : 311|1@1+ (1,0) [0|1] ""  ADAS
 SG_ DET_SNR_355 : 344|8@1+ (0.35156,0) [0|89.6478] "dB"  ADAS
 SG_ DET_EXISTENCE_PROB_355 : 336|6@1+ (1.588,0) [0|100] "%"  ADAS
 SG_ DET_HVC_FLAG_355 : 310|1@1+ (1,0) [0|1] ""  ADAS
 SG_ DET_CONFD_AZIMUTH_355 : 342|2@1+ (1,0) [0|3] ""  ADAS
 SG_ DET_CONFD_ELEVATION_355 : 325|2@1+ (1,0) [0|3] ""  ADAS
 SG_ DET_PROB_1STAZHYPO_355 : 327|1@1+ (1,0) [0|1] ""  ADAS
 SG_ DET_IDM_355 : 287|1@1+ (1,0) [0|1] ""  ADAS
 SG_ DET_MTD_355 : 271|1@1+ (1,0) [0|1] ""  ADAS
 SG_ DET_BELOW_RAIN_THOLD_355 : 263|1@1+ (1,0) [0|1] ""  ADAS
 SG_ DET_RANGE_356 : 360|15@1+ (0.015625,0) [0|500] "m"  ADAS
 SG_ DET_RANGE_ERR_356 : 376|7@1+ (0.0075,0) [0|0.9525] "m"  ADAS
 SG_ DET_RANGE_VELOCITY_356 : 384|15@1+ (0.0078125,-128) [-128|127.9921875] "m/s"  ADAS
 SG_ DET_RANGE_VELOCITY_ERR_356 : 400|8@1+ (0.003,0) [0|0.765] "m/s"  ADAS
 SG_ DET_AZIMUTH_356 : 424|13@1+ (0.0004,-1.5708) [-1.5708|1.5708] "rad"  ADAS
 SG_ DET_AZIMUTH_ERR_356 : 441|7@1+ (0.00087267,0) [0|0.11082909] "rad"  ADAS
 SG_ DET_ELEVATION_356 : 408|8@1+ (0.00275,-0.34925) [-0.34925|0.34925] "rad"  ADAS
 SG_ DET_ELEVATION_ERR_356 : 416|6@1+ (0.00174533,0) [0|0.10995579] "rad"  ADAS
 SG_ DET_RCS_356 : 464|8@1+ (0.5,-64) [-64|63.5] "dBsm"  ADAS
 SG_ DET_BI_STATIC_FLAG_356 : 440|1@1+ (1,0) [0|1] ""  ADAS
 SG_ DET_SUPER_RES_TARGET_356 : 423|1@1+ (1,0) [0|1] ""  ADAS
 SG_ DET_SNR_356 : 456|8@1+ (0.35156,0) [0|89.6478] "dB"  ADAS
 SG_ DET_EXISTENCE_PROB_356 : 448|6@1+ (1.588,0) [0|100] "%"  ADAS
 SG_ DET_HVC_FLAG_356 : 422|1@1+ (1,0) [0|1] ""  ADAS
 SG_ DET_CONFD_AZIMUTH_356 : 454|2@1+ (1,0) [0|3] ""  ADAS
 SG_ DET_CONFD_ELEVATION_356 : 437|2@1+ (1,0) [0|3] ""  ADAS
 SG_ DET_MH_SCAN_INDEX_4LSB_353_356 : 476|4@1+ (1,0) [0|15] ""  ADAS
 SG_ DET_MH_CYCLE_COUNTER_353_356 : 16|8@1+ (1,0) [0|255] ""  ADAS
 SG_ DET_MH_CRC16_353_356 : 0|16@1+ (1,0) [0|65535] ""  ADAS
 SG_ DET_PROB_1STAZHYPO_356 : 439|1@1+ (1,0) [0|1] ""  ADAS
 SG_ DET_IDM_356 : 399|1@1+ (1,0) [0|1] ""  ADAS
 SG_ DET_MTD_356 : 383|1@1+ (1,0) [0|1] ""  ADAS
 SG_ DET_BELOW_RAIN_THOLD_356 : 375|1@1+ (1,0) [0|1] ""  ADAS

BO_ 1113 RDR_DETECTION_357_360: 64 RDR07
 SG_ DET_RANGE_357 : 24|15@1+ (0.015625,0) [0|500] "m"  ADAS
 SG_ DET_RANGE_ERR_357 : 40|7@1+ (0.0075,0) [0|0.9525] "m"  ADAS
 SG_ DET_RANGE_VELOCITY_357 : 48|15@1+ (0.0078125,-128) [-128|127.9921875] "m/s"  ADAS
 SG_ DET_RANGE_VELOCITY_ERR_357 : 64|8@1+ (0.003,0) [0|0.765] "m/s"  ADAS
 SG_ DET_AZIMUTH_357 : 88|13@1+ (0.0004,-1.5708) [-1.5708|1.5708] "rad"  ADAS
 SG_ DET_AZIMUTH_ERR_357 : 105|7@1+ (0.00087267,0) [0|0.11082909] "rad"  ADAS
 SG_ DET_ELEVATION_357 : 72|8@1+ (0.00275,-0.34925) [-0.34925|0.34925] "rad"  ADAS
 SG_ DET_ELEVATION_ERR_357 : 80|6@1+ (0.00174533,0) [0|0.10995579] "rad"  ADAS
 SG_ DET_RCS_357 : 128|8@1+ (0.5,-64) [-64|63.5] "dBsm"  ADAS
 SG_ DET_BI_STATIC_FLAG_357 : 104|1@1+ (1,0) [0|1] ""  ADAS
 SG_ DET_SUPER_RES_TARGET_357 : 87|1@1+ (1,0) [0|1] ""  ADAS
 SG_ DET_SNR_357 : 120|8@1+ (0.35156,0) [0|89.6478] "dB"  ADAS
 SG_ DET_EXISTENCE_PROB_357 : 112|6@1+ (1.588,0) [0|100] "%"  ADAS
 SG_ DET_HVC_FLAG_357 : 86|1@1+ (1,0) [0|1] ""  ADAS
 SG_ DET_CONFD_AZIMUTH_357 : 118|2@1+ (1,0) [0|3] ""  ADAS
 SG_ DET_CONFD_ELEVATION_357 : 101|2@1+ (1,0) [0|3] ""  ADAS
 SG_ DET_PROB_1STAZHYPO_357 : 103|1@1+ (1,0) [0|1] ""  ADAS
 SG_ DET_IDM_357 : 63|1@1+ (1,0) [0|1] ""  ADAS
 SG_ DET_MTD_357 : 47|1@1+ (1,0) [0|1] ""  ADAS
 SG_ DET_BELOW_RAIN_THOLD_357 : 39|1@1+ (1,0) [0|1] ""  ADAS
 SG_ DET_RANGE_358 : 136|15@1+ (0.015625,0) [0|500] "m"  ADAS
 SG_ DET_RANGE_ERR_358 : 152|7@1+ (0.0075,0) [0|0.9525] "m"  ADAS
 SG_ DET_RANGE_VELOCITY_358 : 160|15@1+ (0.0078125,-128) [-128|127.9921875] "m/s"  ADAS
 SG_ DET_RANGE_VELOCITY_ERR_358 : 176|8@1+ (0.003,0) [0|0.765] "m/s"  ADAS
 SG_ DET_AZIMUTH_358 : 200|13@1+ (0.0004,-1.5708) [-1.5708|1.5708] "rad"  ADAS
 SG_ DET_AZIMUTH_ERR_358 : 217|7@1+ (0.00087267,0) [0|0.11082909] "rad"  ADAS
 SG_ DET_ELEVATION_358 : 184|8@1+ (0.00275,-0.34925) [-0.34925|0.34925] "rad"  ADAS
 SG_ DET_ELEVATION_ERR_358 : 192|6@1+ (0.00174533,0) [0|0.10995579] "rad"  ADAS
 SG_ DET_RCS_358 : 240|8@1+ (0.5,-64) [-64|63.5] "dBsm"  ADAS
 SG_ DET_BI_STATIC_FLAG_358 : 216|1@1+ (1,0) [0|1] ""  ADAS
 SG_ DET_SUPER_RES_TARGET_358 : 199|1@1+ (1,0) [0|1] ""  ADAS
 SG_ DET_SNR_358 : 232|8@1+ (0.35156,0) [0|89.6478] "dB"  ADAS
 SG_ DET_EXISTENCE_PROB_358 : 224|6@1+ (1.588,0) [0|100] "%"  ADAS
 SG_ DET_HVC_FLAG_358 : 198|1@1+ (1,0) [0|1] ""  ADAS
 SG_ DET_CONFD_AZIMUTH_358 : 230|2@1+ (1,0) [0|3] ""  ADAS
 SG_ DET_CONFD_ELEVATION_358 : 213|2@1+ (1,0) [0|3] ""  ADAS
 SG_ DET_PROB_1STAZHYPO_358 : 215|1@1+ (1,0) [0|1] ""  ADAS
 SG_ DET_IDM_358 : 175|1@1+ (1,0) [0|1] ""  ADAS
 SG_ DET_MTD_358 : 159|1@1+ (1,0) [0|1] ""  ADAS
 SG_ DET_BELOW_RAIN_THOLD_358 : 151|1@1+ (1,0) [0|1] ""  ADAS
 SG_ DET_RANGE_359 : 248|15@1+ (0.015625,0) [0|500] "m"  ADAS
 SG_ DET_RANGE_ERR_359 : 264|7@1+ (0.0075,0) [0|0.9525] "m"  ADAS
 SG_ DET_RANGE_VELOCITY_359 : 272|15@1+ (0.0078125,-128) [-128|127.9921875] "m/s"  ADAS
 SG_ DET_RANGE_VELOCITY_ERR_359 : 288|8@1+ (0.003,0) [0|0.765] "m/s"  ADAS
 SG_ DET_AZIMUTH_359 : 312|13@1+ (0.0004,-1.5708) [-1.5708|1.5708] "rad"  ADAS
 SG_ DET_AZIMUTH_ERR_359 : 329|7@1+ (0.00087267,0) [0|0.11082909] "rad"  ADAS
 SG_ DET_ELEVATION_359 : 296|8@1+ (0.00275,-0.34925) [-0.34925|0.34925] "rad"  ADAS
 SG_ DET_ELEVATION_ERR_359 : 304|6@1+ (0.00174533,0) [0|0.10995579] "rad"  ADAS
 SG_ DET_RCS_359 : 352|8@1+ (0.5,-64) [-64|63.5] "dBsm"  ADAS
 SG_ DET_BI_STATIC_FLAG_359 : 328|1@1+ (1,0) [0|1] ""  ADAS
 SG_ DET_SUPER_RES_TARGET_359 : 311|1@1+ (1,0) [0|1] ""  ADAS
 SG_ DET_SNR_359 : 344|8@1+ (0.35156,0) [0|89.6478] "dB"  ADAS
 SG_ DET_EXISTENCE_PROB_359 : 336|6@1+ (1.588,0) [0|100] "%"  ADAS
 SG_ DET_HVC_FLAG_359 : 310|1@1+ (1,0) [0|1] ""  ADAS
 SG_ DET_CONFD_AZIMUTH_359 : 342|2@1+ (1,0) [0|3] ""  ADAS
 SG_ DET_CONFD_ELEVATION_359 : 325|2@1+ (1,0) [0|3] ""  ADAS
 SG_ DET_PROB_1STAZHYPO_359 : 327|1@1+ (1,0) [0|1] ""  ADAS
 SG_ DET_IDM_359 : 287|1@1+ (1,0) [0|1] ""  ADAS
 SG_ DET_MTD_359 : 271|1@1+ (1,0) [0|1] ""  ADAS
 SG_ DET_BELOW_RAIN_THOLD_359 : 263|1@1+ (1,0) [0|1] ""  ADAS
 SG_ DET_RANGE_360 : 360|15@1+ (0.015625,0) [0|500] "m"  ADAS
 SG_ DET_RANGE_ERR_360 : 376|7@1+ (0.0075,0) [0|0.9525] "m"  ADAS
 SG_ DET_RANGE_VELOCITY_360 : 384|15@1+ (0.0078125,-128) [-128|127.9921875] "m/s"  ADAS
 SG_ DET_RANGE_VELOCITY_ERR_360 : 400|8@1+ (0.003,0) [0|0.765] "m/s"  ADAS
 SG_ DET_AZIMUTH_360 : 424|13@1+ (0.0004,-1.5708) [-1.5708|1.5708] "rad"  ADAS
 SG_ DET_AZIMUTH_ERR_360 : 441|7@1+ (0.00087267,0) [0|0.11082909] "rad"  ADAS
 SG_ DET_ELEVATION_360 : 408|8@1+ (0.00275,-0.34925) [-0.34925|0.34925] "rad"  ADAS
 SG_ DET_ELEVATION_ERR_360 : 416|6@1+ (0.00174533,0) [0|0.10995579] "rad"  ADAS
 SG_ DET_RCS_360 : 464|8@1+ (0.5,-64) [-64|63.5] "dBsm"  ADAS
 SG_ DET_BI_STATIC_FLAG_360 : 440|1@1+ (1,0) [0|1] ""  ADAS
 SG_ DET_SUPER_RES_TARGET_360 : 423|1@1+ (1,0) [0|1] ""  ADAS
 SG_ DET_SNR_360 : 456|8@1+ (0.35156,0) [0|89.6478] "dB"  ADAS
 SG_ DET_EXISTENCE_PROB_360 : 448|6@1+ (1.588,0) [0|100] "%"  ADAS
 SG_ DET_HVC_FLAG_360 : 422|1@1+ (1,0) [0|1] ""  ADAS
 SG_ DET_CONFD_AZIMUTH_360 : 454|2@1+ (1,0) [0|3] ""  ADAS
 SG_ DET_CONFD_ELEVATION_360 : 437|2@1+ (1,0) [0|3] ""  ADAS
 SG_ DET_MH_SCAN_INDEX_4LSB_357_360 : 476|4@1+ (1,0) [0|15] ""  ADAS
 SG_ DET_MH_CYCLE_COUNTER_357_360 : 16|8@1+ (1,0) [0|255] ""  ADAS
 SG_ DET_MH_CRC16_357_360 : 0|16@1+ (1,0) [0|65535] ""  ADAS
 SG_ DET_PROB_1STAZHYPO_360 : 439|1@1+ (1,0) [0|1] ""  ADAS
 SG_ DET_IDM_360 : 399|1@1+ (1,0) [0|1] ""  ADAS
 SG_ DET_MTD_360 : 383|1@1+ (1,0) [0|1] ""  ADAS
 SG_ DET_BELOW_RAIN_THOLD_360 : 375|1@1+ (1,0) [0|1] ""  ADAS

BO_ 1114 RDR_DETECTION_361_364: 64 RDR07
 SG_ DET_RANGE_361 : 24|15@1+ (0.015625,0) [0|500] "m"  ADAS
 SG_ DET_RANGE_ERR_361 : 40|7@1+ (0.0075,0) [0|0.9525] "m"  ADAS
 SG_ DET_RANGE_VELOCITY_361 : 48|15@1+ (0.0078125,-128) [-128|127.9921875] "m/s"  ADAS
 SG_ DET_RANGE_VELOCITY_ERR_361 : 64|8@1+ (0.003,0) [0|0.765] "m/s"  ADAS
 SG_ DET_AZIMUTH_361 : 88|13@1+ (0.0004,-1.5708) [-1.5708|1.5708] "rad"  ADAS
 SG_ DET_AZIMUTH_ERR_361 : 105|7@1+ (0.00087267,0) [0|0.11082909] "rad"  ADAS
 SG_ DET_ELEVATION_361 : 72|8@1+ (0.00275,-0.34925) [-0.34925|0.34925] "rad"  ADAS
 SG_ DET_ELEVATION_ERR_361 : 80|6@1+ (0.00174533,0) [0|0.10995579] "rad"  ADAS
 SG_ DET_RCS_361 : 128|8@1+ (0.5,-64) [-64|63.5] "dBsm"  ADAS
 SG_ DET_BI_STATIC_FLAG_361 : 104|1@1+ (1,0) [0|1] ""  ADAS
 SG_ DET_SUPER_RES_TARGET_361 : 87|1@1+ (1,0) [0|1] ""  ADAS
 SG_ DET_SNR_361 : 120|8@1+ (0.35156,0) [0|89.6478] "dB"  ADAS
 SG_ DET_EXISTENCE_PROB_361 : 112|6@1+ (1.588,0) [0|100] "%"  ADAS
 SG_ DET_HVC_FLAG_361 : 86|1@1+ (1,0) [0|1] ""  ADAS
 SG_ DET_CONFD_AZIMUTH_361 : 118|2@1+ (1,0) [0|3] ""  ADAS
 SG_ DET_CONFD_ELEVATION_361 : 101|2@1+ (1,0) [0|3] ""  ADAS
 SG_ DET_PROB_1STAZHYPO_361 : 103|1@1+ (1,0) [0|1] ""  ADAS
 SG_ DET_IDM_361 : 63|1@1+ (1,0) [0|1] ""  ADAS
 SG_ DET_MTD_361 : 47|1@1+ (1,0) [0|1] ""  ADAS
 SG_ DET_BELOW_RAIN_THOLD_361 : 39|1@1+ (1,0) [0|1] ""  ADAS
 SG_ DET_RANGE_362 : 136|15@1+ (0.015625,0) [0|500] "m"  ADAS
 SG_ DET_RANGE_ERR_362 : 152|7@1+ (0.0075,0) [0|0.9525] "m"  ADAS
 SG_ DET_RANGE_VELOCITY_362 : 160|15@1+ (0.0078125,-128) [-128|127.9921875] "m/s"  ADAS
 SG_ DET_RANGE_VELOCITY_ERR_362 : 176|8@1+ (0.003,0) [0|0.765] "m/s"  ADAS
 SG_ DET_AZIMUTH_362 : 200|13@1+ (0.0004,-1.5708) [-1.5708|1.5708] "rad"  ADAS
 SG_ DET_AZIMUTH_ERR_362 : 217|7@1+ (0.00087267,0) [0|0.11082909] "rad"  ADAS
 SG_ DET_ELEVATION_362 : 184|8@1+ (0.00275,-0.34925) [-0.34925|0.34925] "rad"  ADAS
 SG_ DET_ELEVATION_ERR_362 : 192|6@1+ (0.00174533,0) [0|0.10995579] "rad"  ADAS
 SG_ DET_RCS_362 : 240|8@1+ (0.5,-64) [-64|63.5] "dBsm"  ADAS
 SG_ DET_BI_STATIC_FLAG_362 : 216|1@1+ (1,0) [0|1] ""  ADAS
 SG_ DET_SUPER_RES_TARGET_362 : 199|1@1+ (1,0) [0|1] ""  ADAS
 SG_ DET_SNR_362 : 232|8@1+ (0.35156,0) [0|89.6478] "dB"  ADAS
 SG_ DET_EXISTENCE_PROB_362 : 224|6@1+ (1.588,0) [0|100] "%"  ADAS
 SG_ DET_HVC_FLAG_362 : 198|1@1+ (1,0) [0|1] ""  ADAS
 SG_ DET_CONFD_AZIMUTH_362 : 230|2@1+ (1,0) [0|3] ""  ADAS
 SG_ DET_CONFD_ELEVATION_362 : 213|2@1+ (1,0) [0|3] ""  ADAS
 SG_ DET_PROB_1STAZHYPO_362 : 215|1@1+ (1,0) [0|1] ""  ADAS
 SG_ DET_IDM_362 : 175|1@1+ (1,0) [0|1] ""  ADAS
 SG_ DET_MTD_362 : 159|1@1+ (1,0) [0|1] ""  ADAS
 SG_ DET_BELOW_RAIN_THOLD_362 : 151|1@1+ (1,0) [0|1] ""  ADAS
 SG_ DET_RANGE_363 : 248|15@1+ (0.015625,0) [0|500] "m"  ADAS
 SG_ DET_RANGE_ERR_363 : 264|7@1+ (0.0075,0) [0|0.9525] "m"  ADAS
 SG_ DET_RANGE_VELOCITY_363 : 272|15@1+ (0.0078125,-128) [-128|127.9921875] "m/s"  ADAS
 SG_ DET_RANGE_VELOCITY_ERR_363 : 288|8@1+ (0.003,0) [0|0.765] "m/s"  ADAS
 SG_ DET_AZIMUTH_363 : 312|13@1+ (0.0004,-1.5708) [-1.5708|1.5708] "rad"  ADAS
 SG_ DET_AZIMUTH_ERR_363 : 329|7@1+ (0.00087267,0) [0|0.11082909] "rad"  ADAS
 SG_ DET_ELEVATION_363 : 296|8@1+ (0.00275,-0.34925) [-0.34925|0.34925] "rad"  ADAS
 SG_ DET_ELEVATION_ERR_363 : 304|6@1+ (0.00174533,0) [0|0.10995579] "rad"  ADAS
 SG_ DET_RCS_363 : 352|8@1+ (0.5,-64) [-64|63.5] "dBsm"  ADAS
 SG_ DET_BI_STATIC_FLAG_363 : 328|1@1+ (1,0) [0|1] ""  ADAS
 SG_ DET_SUPER_RES_TARGET_363 : 311|1@1+ (1,0) [0|1] ""  ADAS
 SG_ DET_SNR_363 : 344|8@1+ (0.35156,0) [0|89.6478] "dB"  ADAS
 SG_ DET_EXISTENCE_PROB_363 : 336|6@1+ (1.588,0) [0|100] "%"  ADAS
 SG_ DET_HVC_FLAG_363 : 310|1@1+ (1,0) [0|1] ""  ADAS
 SG_ DET_CONFD_AZIMUTH_363 : 342|2@1+ (1,0) [0|3] ""  ADAS
 SG_ DET_CONFD_ELEVATION_363 : 325|2@1+ (1,0) [0|3] ""  ADAS
 SG_ DET_PROB_1STAZHYPO_363 : 327|1@1+ (1,0) [0|1] ""  ADAS
 SG_ DET_IDM_363 : 287|1@1+ (1,0) [0|1] ""  ADAS
 SG_ DET_MTD_363 : 271|1@1+ (1,0) [0|1] ""  ADAS
 SG_ DET_BELOW_RAIN_THOLD_363 : 263|1@1+ (1,0) [0|1] ""  ADAS
 SG_ DET_RANGE_364 : 360|15@1+ (0.015625,0) [0|500] "m"  ADAS
 SG_ DET_RANGE_ERR_364 : 376|7@1+ (0.0075,0) [0|0.9525] "m"  ADAS
 SG_ DET_RANGE_VELOCITY_364 : 384|15@1+ (0.0078125,-128) [-128|127.9921875] "m/s"  ADAS
 SG_ DET_RANGE_VELOCITY_ERR_364 : 400|8@1+ (0.003,0) [0|0.765] "m/s"  ADAS
 SG_ DET_AZIMUTH_364 : 424|13@1+ (0.0004,-1.5708) [-1.5708|1.5708] "rad"  ADAS
 SG_ DET_AZIMUTH_ERR_364 : 441|7@1+ (0.00087267,0) [0|0.11082909] "rad"  ADAS
 SG_ DET_ELEVATION_364 : 408|8@1+ (0.00275,-0.34925) [-0.34925|0.34925] "rad"  ADAS
 SG_ DET_ELEVATION_ERR_364 : 416|6@1+ (0.00174533,0) [0|0.10995579] "rad"  ADAS
 SG_ DET_RCS_364 : 464|8@1+ (0.5,-64) [-64|63.5] "dBsm"  ADAS
 SG_ DET_BI_STATIC_FLAG_364 : 440|1@1+ (1,0) [0|1] ""  ADAS
 SG_ DET_SUPER_RES_TARGET_364 : 423|1@1+ (1,0) [0|1] ""  ADAS
 SG_ DET_SNR_364 : 456|8@1+ (0.35156,0) [0|89.6478] "dB"  ADAS
 SG_ DET_EXISTENCE_PROB_364 : 448|6@1+ (1.588,0) [0|100] "%"  ADAS
 SG_ DET_HVC_FLAG_364 : 422|1@1+ (1,0) [0|1] ""  ADAS
 SG_ DET_CONFD_AZIMUTH_364 : 454|2@1+ (1,0) [0|3] ""  ADAS
 SG_ DET_CONFD_ELEVATION_364 : 437|2@1+ (1,0) [0|3] ""  ADAS
 SG_ DET_MH_SCAN_INDEX_4LSB_361_364 : 476|4@1+ (1,0) [0|15] ""  ADAS
 SG_ DET_MH_CYCLE_COUNTER_361_364 : 16|8@1+ (1,0) [0|255] ""  ADAS
 SG_ DET_MH_CRC16_361_364 : 0|16@1+ (1,0) [0|65535] ""  ADAS
 SG_ DET_PROB_1STAZHYPO_364 : 439|1@1+ (1,0) [0|1] ""  ADAS
 SG_ DET_IDM_364 : 399|1@1+ (1,0) [0|1] ""  ADAS
 SG_ DET_MTD_364 : 383|1@1+ (1,0) [0|1] ""  ADAS
 SG_ DET_BELOW_RAIN_THOLD_364 : 375|1@1+ (1,0) [0|1] ""  ADAS

BO_ 1115 RDR_DETECTION_365_368: 64 RDR07
 SG_ DET_RANGE_365 : 24|15@1+ (0.015625,0) [0|500] "m"  ADAS
 SG_ DET_RANGE_ERR_365 : 40|7@1+ (0.0075,0) [0|0.9525] "m"  ADAS
 SG_ DET_RANGE_VELOCITY_365 : 48|15@1+ (0.0078125,-128) [-128|127.9921875] "m/s"  ADAS
 SG_ DET_RANGE_VELOCITY_ERR_365 : 64|8@1+ (0.003,0) [0|0.765] "m/s"  ADAS
 SG_ DET_AZIMUTH_365 : 88|13@1+ (0.0004,-1.5708) [-1.5708|1.5708] "rad"  ADAS
 SG_ DET_AZIMUTH_ERR_365 : 105|7@1+ (0.00087267,0) [0|0.11082909] "rad"  ADAS
 SG_ DET_ELEVATION_365 : 72|8@1+ (0.00275,-0.34925) [-0.34925|0.34925] "rad"  ADAS
 SG_ DET_ELEVATION_ERR_365 : 80|6@1+ (0.00174533,0) [0|0.10995579] "rad"  ADAS
 SG_ DET_RCS_365 : 128|8@1+ (0.5,-64) [-64|63.5] "dBsm"  ADAS
 SG_ DET_BI_STATIC_FLAG_365 : 104|1@1+ (1,0) [0|1] ""  ADAS
 SG_ DET_SUPER_RES_TARGET_365 : 87|1@1+ (1,0) [0|1] ""  ADAS
 SG_ DET_SNR_365 : 120|8@1+ (0.35156,0) [0|89.6478] "dB"  ADAS
 SG_ DET_EXISTENCE_PROB_365 : 112|6@1+ (1.588,0) [0|100] "%"  ADAS
 SG_ DET_HVC_FLAG_365 : 86|1@1+ (1,0) [0|1] ""  ADAS
 SG_ DET_CONFD_AZIMUTH_365 : 118|2@1+ (1,0) [0|3] ""  ADAS
 SG_ DET_CONFD_ELEVATION_365 : 101|2@1+ (1,0) [0|3] ""  ADAS
 SG_ DET_PROB_1STAZHYPO_365 : 103|1@1+ (1,0) [0|1] ""  ADAS
 SG_ DET_IDM_365 : 63|1@1+ (1,0) [0|1] ""  ADAS
 SG_ DET_MTD_365 : 47|1@1+ (1,0) [0|1] ""  ADAS
 SG_ DET_BELOW_RAIN_THOLD_365 : 39|1@1+ (1,0) [0|1] ""  ADAS
 SG_ DET_RANGE_366 : 136|15@1+ (0.015625,0) [0|500] "m"  ADAS
 SG_ DET_RANGE_ERR_366 : 152|7@1+ (0.0075,0) [0|0.9525] "m"  ADAS
 SG_ DET_RANGE_VELOCITY_366 : 160|15@1+ (0.0078125,-128) [-128|127.9921875] "m/s"  ADAS
 SG_ DET_RANGE_VELOCITY_ERR_366 : 176|8@1+ (0.003,0) [0|0.765] "m/s"  ADAS
 SG_ DET_AZIMUTH_366 : 200|13@1+ (0.0004,-1.5708) [-1.5708|1.5708] "rad"  ADAS
 SG_ DET_AZIMUTH_ERR_366 : 217|7@1+ (0.00087267,0) [0|0.11082909] "rad"  ADAS
 SG_ DET_ELEVATION_366 : 184|8@1+ (0.00275,-0.34925) [-0.34925|0.34925] "rad"  ADAS
 SG_ DET_ELEVATION_ERR_366 : 192|6@1+ (0.00174533,0) [0|0.10995579] "rad"  ADAS
 SG_ DET_RCS_366 : 240|8@1+ (0.5,-64) [-64|63.5] "dBsm"  ADAS
 SG_ DET_BI_STATIC_FLAG_366 : 216|1@1+ (1,0) [0|1] ""  ADAS
 SG_ DET_SUPER_RES_TARGET_366 : 199|1@1+ (1,0) [0|1] ""  ADAS
 SG_ DET_SNR_366 : 232|8@1+ (0.35156,0) [0|89.6478] "dB"  ADAS
 SG_ DET_EXISTENCE_PROB_366 : 224|6@1+ (1.588,0) [0|100] "%"  ADAS
 SG_ DET_HVC_FLAG_366 : 198|1@1+ (1,0) [0|1] ""  ADAS
 SG_ DET_CONFD_AZIMUTH_366 : 230|2@1+ (1,0) [0|3] ""  ADAS
 SG_ DET_CONFD_ELEVATION_366 : 213|2@1+ (1,0) [0|3] ""  ADAS
 SG_ DET_PROB_1STAZHYPO_366 : 215|1@1+ (1,0) [0|1] ""  ADAS
 SG_ DET_IDM_366 : 175|1@1+ (1,0) [0|1] ""  ADAS
 SG_ DET_MTD_366 : 159|1@1+ (1,0) [0|1] ""  ADAS
 SG_ DET_BELOW_RAIN_THOLD_366 : 151|1@1+ (1,0) [0|1] ""  ADAS
 SG_ DET_RANGE_367 : 248|15@1+ (0.015625,0) [0|500] "m"  ADAS
 SG_ DET_RANGE_ERR_367 : 264|7@1+ (0.0075,0) [0|0.9525] "m"  ADAS
 SG_ DET_RANGE_VELOCITY_367 : 272|15@1+ (0.0078125,-128) [-128|127.9921875] "m/s"  ADAS
 SG_ DET_RANGE_VELOCITY_ERR_367 : 288|8@1+ (0.003,0) [0|0.765] "m/s"  ADAS
 SG_ DET_AZIMUTH_367 : 312|13@1+ (0.0004,-1.5708) [-1.5708|1.5708] "rad"  ADAS
 SG_ DET_AZIMUTH_ERR_367 : 329|7@1+ (0.00087267,0) [0|0.11082909] "rad"  ADAS
 SG_ DET_ELEVATION_367 : 296|8@1+ (0.00275,-0.34925) [-0.34925|0.34925] "rad"  ADAS
 SG_ DET_ELEVATION_ERR_367 : 304|6@1+ (0.00174533,0) [0|0.10995579] "rad"  ADAS
 SG_ DET_RCS_367 : 352|8@1+ (0.5,-64) [-64|63.5] "dBsm"  ADAS
 SG_ DET_BI_STATIC_FLAG_367 : 328|1@1+ (1,0) [0|1] ""  ADAS
 SG_ DET_SUPER_RES_TARGET_367 : 311|1@1+ (1,0) [0|1] ""  ADAS
 SG_ DET_SNR_367 : 344|8@1+ (0.35156,0) [0|89.6478] "dB"  ADAS
 SG_ DET_EXISTENCE_PROB_367 : 336|6@1+ (1.588,0) [0|100] "%"  ADAS
 SG_ DET_HVC_FLAG_367 : 310|1@1+ (1,0) [0|1] ""  ADAS
 SG_ DET_CONFD_AZIMUTH_367 : 342|2@1+ (1,0) [0|3] ""  ADAS
 SG_ DET_CONFD_ELEVATION_367 : 325|2@1+ (1,0) [0|3] ""  ADAS
 SG_ DET_PROB_1STAZHYPO_367 : 327|1@1+ (1,0) [0|1] ""  ADAS
 SG_ DET_IDM_367 : 287|1@1+ (1,0) [0|1] ""  ADAS
 SG_ DET_MTD_367 : 271|1@1+ (1,0) [0|1] ""  ADAS
 SG_ DET_BELOW_RAIN_THOLD_367 : 263|1@1+ (1,0) [0|1] ""  ADAS
 SG_ DET_RANGE_368 : 360|15@1+ (0.015625,0) [0|500] "m"  ADAS
 SG_ DET_RANGE_ERR_368 : 376|7@1+ (0.0075,0) [0|0.9525] "m"  ADAS
 SG_ DET_RANGE_VELOCITY_368 : 384|15@1+ (0.0078125,-128) [-128|127.9921875] "m/s"  ADAS
 SG_ DET_RANGE_VELOCITY_ERR_368 : 400|8@1+ (0.003,0) [0|0.765] "m/s"  ADAS
 SG_ DET_AZIMUTH_368 : 424|13@1+ (0.0004,-1.5708) [-1.5708|1.5708] "rad"  ADAS
 SG_ DET_AZIMUTH_ERR_368 : 441|7@1+ (0.00087267,0) [0|0.11082909] "rad"  ADAS
 SG_ DET_ELEVATION_368 : 408|8@1+ (0.00275,-0.34925) [-0.34925|0.34925] "rad"  ADAS
 SG_ DET_ELEVATION_ERR_368 : 416|6@1+ (0.00174533,0) [0|0.10995579] "rad"  ADAS
 SG_ DET_RCS_368 : 464|8@1+ (0.5,-64) [-64|63.5] "dBsm"  ADAS
 SG_ DET_BI_STATIC_FLAG_368 : 440|1@1+ (1,0) [0|1] ""  ADAS
 SG_ DET_SUPER_RES_TARGET_368 : 423|1@1+ (1,0) [0|1] ""  ADAS
 SG_ DET_SNR_368 : 456|8@1+ (0.35156,0) [0|89.6478] "dB"  ADAS
 SG_ DET_EXISTENCE_PROB_368 : 448|6@1+ (1.588,0) [0|100] "%"  ADAS
 SG_ DET_HVC_FLAG_368 : 422|1@1+ (1,0) [0|1] ""  ADAS
 SG_ DET_CONFD_AZIMUTH_368 : 454|2@1+ (1,0) [0|3] ""  ADAS
 SG_ DET_CONFD_ELEVATION_368 : 437|2@1+ (1,0) [0|3] ""  ADAS
 SG_ DET_MH_SCAN_INDEX_4LSB_365_368 : 476|4@1+ (1,0) [0|15] ""  ADAS
 SG_ DET_MH_CYCLE_COUNTER_365_368 : 16|8@1+ (1,0) [0|255] ""  ADAS
 SG_ DET_MH_CRC16_365_368 : 0|16@1+ (1,0) [0|65535] ""  ADAS
 SG_ DET_PROB_1STAZHYPO_368 : 439|1@1+ (1,0) [0|1] ""  ADAS
 SG_ DET_IDM_368 : 399|1@1+ (1,0) [0|1] ""  ADAS
 SG_ DET_MTD_368 : 383|1@1+ (1,0) [0|1] ""  ADAS
 SG_ DET_BELOW_RAIN_THOLD_368 : 375|1@1+ (1,0) [0|1] ""  ADAS

BO_ 1116 RDR_DETECTION_369_372: 64 RDR07
 SG_ DET_RANGE_369 : 24|15@1+ (0.015625,0) [0|500] "m"  ADAS
 SG_ DET_RANGE_ERR_369 : 40|7@1+ (0.0075,0) [0|0.9525] "m"  ADAS
 SG_ DET_RANGE_VELOCITY_369 : 48|15@1+ (0.0078125,-128) [-128|127.9921875] "m/s"  ADAS
 SG_ DET_RANGE_VELOCITY_ERR_369 : 64|8@1+ (0.003,0) [0|0.765] "m/s"  ADAS
 SG_ DET_AZIMUTH_369 : 88|13@1+ (0.0004,-1.5708) [-1.5708|1.5708] "rad"  ADAS
 SG_ DET_AZIMUTH_ERR_369 : 105|7@1+ (0.00087267,0) [0|0.11082909] "rad"  ADAS
 SG_ DET_ELEVATION_369 : 72|8@1+ (0.00275,-0.34925) [-0.34925|0.34925] "rad"  ADAS
 SG_ DET_ELEVATION_ERR_369 : 80|6@1+ (0.00174533,0) [0|0.10995579] "rad"  ADAS
 SG_ DET_RCS_369 : 128|8@1+ (0.5,-64) [-64|63.5] "dBsm"  ADAS
 SG_ DET_BI_STATIC_FLAG_369 : 104|1@1+ (1,0) [0|1] ""  ADAS
 SG_ DET_SUPER_RES_TARGET_369 : 87|1@1+ (1,0) [0|1] ""  ADAS
 SG_ DET_SNR_369 : 120|8@1+ (0.35156,0) [0|89.6478] "dB"  ADAS
 SG_ DET_EXISTENCE_PROB_369 : 112|6@1+ (1.588,0) [0|100] "%"  ADAS
 SG_ DET_HVC_FLAG_369 : 86|1@1+ (1,0) [0|1] ""  ADAS
 SG_ DET_CONFD_AZIMUTH_369 : 118|2@1+ (1,0) [0|3] ""  ADAS
 SG_ DET_CONFD_ELEVATION_369 : 101|2@1+ (1,0) [0|3] ""  ADAS
 SG_ DET_PROB_1STAZHYPO_369 : 103|1@1+ (1,0) [0|1] ""  ADAS
 SG_ DET_IDM_369 : 63|1@1+ (1,0) [0|1] ""  ADAS
 SG_ DET_MTD_369 : 47|1@1+ (1,0) [0|1] ""  ADAS
 SG_ DET_BELOW_RAIN_THOLD_369 : 39|1@1+ (1,0) [0|1] ""  ADAS
 SG_ DET_RANGE_370 : 136|15@1+ (0.015625,0) [0|500] "m"  ADAS
 SG_ DET_RANGE_ERR_370 : 152|7@1+ (0.0075,0) [0|0.9525] "m"  ADAS
 SG_ DET_RANGE_VELOCITY_370 : 160|15@1+ (0.0078125,-128) [-128|127.9921875] "m/s"  ADAS
 SG_ DET_RANGE_VELOCITY_ERR_370 : 176|8@1+ (0.003,0) [0|0.765] "m/s"  ADAS
 SG_ DET_AZIMUTH_370 : 200|13@1+ (0.0004,-1.5708) [-1.5708|1.5708] "rad"  ADAS
 SG_ DET_AZIMUTH_ERR_370 : 217|7@1+ (0.00087267,0) [0|0.11082909] "rad"  ADAS
 SG_ DET_ELEVATION_370 : 184|8@1+ (0.00275,-0.34925) [-0.34925|0.34925] "rad"  ADAS
 SG_ DET_ELEVATION_ERR_370 : 192|6@1+ (0.00174533,0) [0|0.10995579] "rad"  ADAS
 SG_ DET_RCS_370 : 240|8@1+ (0.5,-64) [-64|63.5] "dBsm"  ADAS
 SG_ DET_BI_STATIC_FLAG_370 : 216|1@1+ (1,0) [0|1] ""  ADAS
 SG_ DET_SUPER_RES_TARGET_370 : 199|1@1+ (1,0) [0|1] ""  ADAS
 SG_ DET_SNR_370 : 232|8@1+ (0.35156,0) [0|89.6478] "dB"  ADAS
 SG_ DET_EXISTENCE_PROB_370 : 224|6@1+ (1.588,0) [0|100] "%"  ADAS
 SG_ DET_HVC_FLAG_370 : 198|1@1+ (1,0) [0|1] ""  ADAS
 SG_ DET_CONFD_AZIMUTH_370 : 230|2@1+ (1,0) [0|3] ""  ADAS
 SG_ DET_CONFD_ELEVATION_370 : 213|2@1+ (1,0) [0|3] ""  ADAS
 SG_ DET_PROB_1STAZHYPO_370 : 215|1@1+ (1,0) [0|1] ""  ADAS
 SG_ DET_IDM_370 : 175|1@1+ (1,0) [0|1] ""  ADAS
 SG_ DET_MTD_370 : 159|1@1+ (1,0) [0|1] ""  ADAS
 SG_ DET_BELOW_RAIN_THOLD_370 : 151|1@1+ (1,0) [0|1] ""  ADAS
 SG_ DET_RANGE_371 : 248|15@1+ (0.015625,0) [0|500] "m"  ADAS
 SG_ DET_RANGE_ERR_371 : 264|7@1+ (0.0075,0) [0|0.9525] "m"  ADAS
 SG_ DET_RANGE_VELOCITY_371 : 272|15@1+ (0.0078125,-128) [-128|127.9921875] "m/s"  ADAS
 SG_ DET_RANGE_VELOCITY_ERR_371 : 288|8@1+ (0.003,0) [0|0.765] "m/s"  ADAS
 SG_ DET_AZIMUTH_371 : 312|13@1+ (0.0004,-1.5708) [-1.5708|1.5708] "rad"  ADAS
 SG_ DET_AZIMUTH_ERR_371 : 329|7@1+ (0.00087267,0) [0|0.11082909] "rad"  ADAS
 SG_ DET_ELEVATION_371 : 296|8@1+ (0.00275,-0.34925) [-0.34925|0.34925] "rad"  ADAS
 SG_ DET_ELEVATION_ERR_371 : 304|6@1+ (0.00174533,0) [0|0.10995579] "rad"  ADAS
 SG_ DET_RCS_371 : 352|8@1+ (0.5,-64) [-64|63.5] "dBsm"  ADAS
 SG_ DET_BI_STATIC_FLAG_371 : 328|1@1+ (1,0) [0|1] ""  ADAS
 SG_ DET_SUPER_RES_TARGET_371 : 311|1@1+ (1,0) [0|1] ""  ADAS
 SG_ DET_SNR_371 : 344|8@1+ (0.35156,0) [0|89.6478] "dB"  ADAS
 SG_ DET_EXISTENCE_PROB_371 : 336|6@1+ (1.588,0) [0|100] "%"  ADAS
 SG_ DET_HVC_FLAG_371 : 310|1@1+ (1,0) [0|1] ""  ADAS
 SG_ DET_CONFD_AZIMUTH_371 : 342|2@1+ (1,0) [0|3] ""  ADAS
 SG_ DET_CONFD_ELEVATION_371 : 325|2@1+ (1,0) [0|3] ""  ADAS
 SG_ DET_PROB_1STAZHYPO_371 : 327|1@1+ (1,0) [0|1] ""  ADAS
 SG_ DET_IDM_371 : 287|1@1+ (1,0) [0|1] ""  ADAS
 SG_ DET_MTD_371 : 271|1@1+ (1,0) [0|1] ""  ADAS
 SG_ DET_BELOW_RAIN_THOLD_371 : 263|1@1+ (1,0) [0|1] ""  ADAS
 SG_ DET_RANGE_372 : 360|15@1+ (0.015625,0) [0|500] "m"  ADAS
 SG_ DET_RANGE_ERR_372 : 376|7@1+ (0.0075,0) [0|0.9525] "m"  ADAS
 SG_ DET_RANGE_VELOCITY_372 : 384|15@1+ (0.0078125,-128) [-128|127.9921875] "m/s"  ADAS
 SG_ DET_RANGE_VELOCITY_ERR_372 : 400|8@1+ (0.003,0) [0|0.765] "m/s"  ADAS
 SG_ DET_AZIMUTH_372 : 424|13@1+ (0.0004,-1.5708) [-1.5708|1.5708] "rad"  ADAS
 SG_ DET_AZIMUTH_ERR_372 : 441|7@1+ (0.00087267,0) [0|0.11082909] "rad"  ADAS
 SG_ DET_ELEVATION_372 : 408|8@1+ (0.00275,-0.34925) [-0.34925|0.34925] "rad"  ADAS
 SG_ DET_ELEVATION_ERR_372 : 416|6@1+ (0.00174533,0) [0|0.10995579] "rad"  ADAS
 SG_ DET_RCS_372 : 464|8@1+ (0.5,-64) [-64|63.5] "dBsm"  ADAS
 SG_ DET_BI_STATIC_FLAG_372 : 440|1@1+ (1,0) [0|1] ""  ADAS
 SG_ DET_SUPER_RES_TARGET_372 : 423|1@1+ (1,0) [0|1] ""  ADAS
 SG_ DET_SNR_372 : 456|8@1+ (0.35156,0) [0|89.6478] "dB"  ADAS
 SG_ DET_EXISTENCE_PROB_372 : 448|6@1+ (1.588,0) [0|100] "%"  ADAS
 SG_ DET_HVC_FLAG_372 : 422|1@1+ (1,0) [0|1] ""  ADAS
 SG_ DET_CONFD_AZIMUTH_372 : 454|2@1+ (1,0) [0|3] ""  ADAS
 SG_ DET_CONFD_ELEVATION_372 : 437|2@1+ (1,0) [0|3] ""  ADAS
 SG_ DET_MH_SCAN_INDEX_4LSB_369_372 : 476|4@1+ (1,0) [0|15] ""  ADAS
 SG_ DET_MH_CYCLE_COUNTER_369_372 : 16|8@1+ (1,0) [0|255] ""  ADAS
 SG_ DET_MH_CRC16_369_372 : 0|16@1+ (1,0) [0|65535] ""  ADAS
 SG_ DET_PROB_1STAZHYPO_372 : 439|1@1+ (1,0) [0|1] ""  ADAS
 SG_ DET_IDM_372 : 399|1@1+ (1,0) [0|1] ""  ADAS
 SG_ DET_MTD_372 : 383|1@1+ (1,0) [0|1] ""  ADAS
 SG_ DET_BELOW_RAIN_THOLD_372 : 375|1@1+ (1,0) [0|1] ""  ADAS

BO_ 1117 RDR_DETECTION_373_376: 64 RDR07
 SG_ DET_RANGE_373 : 24|15@1+ (0.015625,0) [0|500] "m"  ADAS
 SG_ DET_RANGE_ERR_373 : 40|7@1+ (0.0075,0) [0|0.9525] "m"  ADAS
 SG_ DET_RANGE_VELOCITY_373 : 48|15@1+ (0.0078125,-128) [-128|127.9921875] "m/s"  ADAS
 SG_ DET_RANGE_VELOCITY_ERR_373 : 64|8@1+ (0.003,0) [0|0.765] "m/s"  ADAS
 SG_ DET_AZIMUTH_373 : 88|13@1+ (0.0004,-1.5708) [-1.5708|1.5708] "rad"  ADAS
 SG_ DET_AZIMUTH_ERR_373 : 105|7@1+ (0.00087267,0) [0|0.11082909] "rad"  ADAS
 SG_ DET_ELEVATION_373 : 72|8@1+ (0.00275,-0.34925) [-0.34925|0.34925] "rad"  ADAS
 SG_ DET_ELEVATION_ERR_373 : 80|6@1+ (0.00174533,0) [0|0.10995579] "rad"  ADAS
 SG_ DET_RCS_373 : 128|8@1+ (0.5,-64) [-64|63.5] "dBsm"  ADAS
 SG_ DET_BI_STATIC_FLAG_373 : 104|1@1+ (1,0) [0|1] ""  ADAS
 SG_ DET_SUPER_RES_TARGET_373 : 87|1@1+ (1,0) [0|1] ""  ADAS
 SG_ DET_SNR_373 : 120|8@1+ (0.35156,0) [0|89.6478] "dB"  ADAS
 SG_ DET_EXISTENCE_PROB_373 : 112|6@1+ (1.588,0) [0|100] "%"  ADAS
 SG_ DET_HVC_FLAG_373 : 86|1@1+ (1,0) [0|1] ""  ADAS
 SG_ DET_CONFD_AZIMUTH_373 : 118|2@1+ (1,0) [0|3] ""  ADAS
 SG_ DET_CONFD_ELEVATION_373 : 101|2@1+ (1,0) [0|3] ""  ADAS
 SG_ DET_PROB_1STAZHYPO_373 : 103|1@1+ (1,0) [0|1] ""  ADAS
 SG_ DET_IDM_373 : 63|1@1+ (1,0) [0|1] ""  ADAS
 SG_ DET_MTD_373 : 47|1@1+ (1,0) [0|1] ""  ADAS
 SG_ DET_BELOW_RAIN_THOLD_373 : 39|1@1+ (1,0) [0|1] ""  ADAS
 SG_ DET_RANGE_374 : 136|15@1+ (0.015625,0) [0|500] "m"  ADAS
 SG_ DET_RANGE_ERR_374 : 152|7@1+ (0.0075,0) [0|0.9525] "m"  ADAS
 SG_ DET_RANGE_VELOCITY_374 : 160|15@1+ (0.0078125,-128) [-128|127.9921875] "m/s"  ADAS
 SG_ DET_RANGE_VELOCITY_ERR_374 : 176|8@1+ (0.003,0) [0|0.765] "m/s"  ADAS
 SG_ DET_AZIMUTH_374 : 200|13@1+ (0.0004,-1.5708) [-1.5708|1.5708] "rad"  ADAS
 SG_ DET_AZIMUTH_ERR_374 : 217|7@1+ (0.00087267,0) [0|0.11082909] "rad"  ADAS
 SG_ DET_ELEVATION_374 : 184|8@1+ (0.00275,-0.34925) [-0.34925|0.34925] "rad"  ADAS
 SG_ DET_ELEVATION_ERR_374 : 192|6@1+ (0.00174533,0) [0|0.10995579] "rad"  ADAS
 SG_ DET_RCS_374 : 240|8@1+ (0.5,-64) [-64|63.5] "dBsm"  ADAS
 SG_ DET_BI_STATIC_FLAG_374 : 216|1@1+ (1,0) [0|1] ""  ADAS
 SG_ DET_SUPER_RES_TARGET_374 : 199|1@1+ (1,0) [0|1] ""  ADAS
 SG_ DET_SNR_374 : 232|8@1+ (0.35156,0) [0|89.6478] "dB"  ADAS
 SG_ DET_EXISTENCE_PROB_374 : 224|6@1+ (1.588,0) [0|100] "%"  ADAS
 SG_ DET_HVC_FLAG_374 : 198|1@1+ (1,0) [0|1] ""  ADAS
 SG_ DET_CONFD_AZIMUTH_374 : 230|2@1+ (1,0) [0|3] ""  ADAS
 SG_ DET_CONFD_ELEVATION_374 : 213|2@1+ (1,0) [0|3] ""  ADAS
 SG_ DET_PROB_1STAZHYPO_374 : 215|1@1+ (1,0) [0|1] ""  ADAS
 SG_ DET_IDM_374 : 175|1@1+ (1,0) [0|1] ""  ADAS
 SG_ DET_MTD_374 : 159|1@1+ (1,0) [0|1] ""  ADAS
 SG_ DET_BELOW_RAIN_THOLD_374 : 151|1@1+ (1,0) [0|1] ""  ADAS
 SG_ DET_RANGE_375 : 248|15@1+ (0.015625,0) [0|500] "m"  ADAS
 SG_ DET_RANGE_ERR_375 : 264|7@1+ (0.0075,0) [0|0.9525] "m"  ADAS
 SG_ DET_RANGE_VELOCITY_375 : 272|15@1+ (0.0078125,-128) [-128|127.9921875] "m/s"  ADAS
 SG_ DET_RANGE_VELOCITY_ERR_375 : 288|8@1+ (0.003,0) [0|0.765] "m/s"  ADAS
 SG_ DET_AZIMUTH_375 : 312|13@1+ (0.0004,-1.5708) [-1.5708|1.5708] "rad"  ADAS
 SG_ DET_AZIMUTH_ERR_375 : 329|7@1+ (0.00087267,0) [0|0.11082909] "rad"  ADAS
 SG_ DET_ELEVATION_375 : 296|8@1+ (0.00275,-0.34925) [-0.34925|0.34925] "rad"  ADAS
 SG_ DET_ELEVATION_ERR_375 : 304|6@1+ (0.00174533,0) [0|0.10995579] "rad"  ADAS
 SG_ DET_RCS_375 : 352|8@1+ (0.5,-64) [-64|63.5] "dBsm"  ADAS
 SG_ DET_BI_STATIC_FLAG_375 : 328|1@1+ (1,0) [0|1] ""  ADAS
 SG_ DET_SUPER_RES_TARGET_375 : 311|1@1+ (1,0) [0|1] ""  ADAS
 SG_ DET_SNR_375 : 344|8@1+ (0.35156,0) [0|89.6478] "dB"  ADAS
 SG_ DET_EXISTENCE_PROB_375 : 336|6@1+ (1.588,0) [0|100] "%"  ADAS
 SG_ DET_HVC_FLAG_375 : 310|1@1+ (1,0) [0|1] ""  ADAS
 SG_ DET_CONFD_AZIMUTH_375 : 342|2@1+ (1,0) [0|3] ""  ADAS
 SG_ DET_CONFD_ELEVATION_375 : 325|2@1+ (1,0) [0|3] ""  ADAS
 SG_ DET_PROB_1STAZHYPO_375 : 327|1@1+ (1,0) [0|1] ""  ADAS
 SG_ DET_IDM_375 : 287|1@1+ (1,0) [0|1] ""  ADAS
 SG_ DET_MTD_375 : 271|1@1+ (1,0) [0|1] ""  ADAS
 SG_ DET_BELOW_RAIN_THOLD_375 : 263|1@1+ (1,0) [0|1] ""  ADAS
 SG_ DET_RANGE_376 : 360|15@1+ (0.015625,0) [0|500] "m"  ADAS
 SG_ DET_RANGE_ERR_376 : 376|7@1+ (0.0075,0) [0|0.9525] "m"  ADAS
 SG_ DET_RANGE_VELOCITY_376 : 384|15@1+ (0.0078125,-128) [-128|127.9921875] "m/s"  ADAS
 SG_ DET_RANGE_VELOCITY_ERR_376 : 400|8@1+ (0.003,0) [0|0.765] "m/s"  ADAS
 SG_ DET_AZIMUTH_376 : 424|13@1+ (0.0004,-1.5708) [-1.5708|1.5708] "rad"  ADAS
 SG_ DET_AZIMUTH_ERR_376 : 441|7@1+ (0.00087267,0) [0|0.11082909] "rad"  ADAS
 SG_ DET_ELEVATION_376 : 408|8@1+ (0.00275,-0.34925) [-0.34925|0.34925] "rad"  ADAS
 SG_ DET_ELEVATION_ERR_376 : 416|6@1+ (0.00174533,0) [0|0.10995579] "rad"  ADAS
 SG_ DET_RCS_376 : 464|8@1+ (0.5,-64) [-64|63.5] "dBsm"  ADAS
 SG_ DET_BI_STATIC_FLAG_376 : 440|1@1+ (1,0) [0|1] ""  ADAS
 SG_ DET_SUPER_RES_TARGET_376 : 423|1@1+ (1,0) [0|1] ""  ADAS
 SG_ DET_SNR_376 : 456|8@1+ (0.35156,0) [0|89.6478] "dB"  ADAS
 SG_ DET_EXISTENCE_PROB_376 : 448|6@1+ (1.588,0) [0|100] "%"  ADAS
 SG_ DET_HVC_FLAG_376 : 422|1@1+ (1,0) [0|1] ""  ADAS
 SG_ DET_CONFD_AZIMUTH_376 : 454|2@1+ (1,0) [0|3] ""  ADAS
 SG_ DET_CONFD_ELEVATION_376 : 437|2@1+ (1,0) [0|3] ""  ADAS
 SG_ DET_MH_SCAN_INDEX_4LSB_373_376 : 476|4@1+ (1,0) [0|15] ""  ADAS
 SG_ DET_MH_CYCLE_COUNTER_373_376 : 16|8@1+ (1,0) [0|255] ""  ADAS
 SG_ DET_MH_CRC16_373_376 : 0|16@1+ (1,0) [0|65535] ""  ADAS
 SG_ DET_PROB_1STAZHYPO_376 : 439|1@1+ (1,0) [0|1] ""  ADAS
 SG_ DET_IDM_376 : 399|1@1+ (1,0) [0|1] ""  ADAS
 SG_ DET_MTD_376 : 383|1@1+ (1,0) [0|1] ""  ADAS
 SG_ DET_BELOW_RAIN_THOLD_376 : 375|1@1+ (1,0) [0|1] ""  ADAS

BO_ 1118 RDR_DETECTION_377_380: 64 RDR07
 SG_ DET_RANGE_377 : 24|15@1+ (0.015625,0) [0|500] "m"  ADAS
 SG_ DET_RANGE_ERR_377 : 40|7@1+ (0.0075,0) [0|0.9525] "m"  ADAS
 SG_ DET_RANGE_VELOCITY_377 : 48|15@1+ (0.0078125,-128) [-128|127.9921875] "m/s"  ADAS
 SG_ DET_RANGE_VELOCITY_ERR_377 : 64|8@1+ (0.003,0) [0|0.765] "m/s"  ADAS
 SG_ DET_AZIMUTH_377 : 88|13@1+ (0.0004,-1.5708) [-1.5708|1.5708] "rad"  ADAS
 SG_ DET_AZIMUTH_ERR_377 : 105|7@1+ (0.00087267,0) [0|0.11082909] "rad"  ADAS
 SG_ DET_ELEVATION_377 : 72|8@1+ (0.00275,-0.34925) [-0.34925|0.34925] "rad"  ADAS
 SG_ DET_ELEVATION_ERR_377 : 80|6@1+ (0.00174533,0) [0|0.10995579] "rad"  ADAS
 SG_ DET_RCS_377 : 128|8@1+ (0.5,-64) [-64|63.5] "dBsm"  ADAS
 SG_ DET_BI_STATIC_FLAG_377 : 104|1@1+ (1,0) [0|1] ""  ADAS
 SG_ DET_SUPER_RES_TARGET_377 : 87|1@1+ (1,0) [0|1] ""  ADAS
 SG_ DET_SNR_377 : 120|8@1+ (0.35156,0) [0|89.6478] "dB"  ADAS
 SG_ DET_EXISTENCE_PROB_377 : 112|6@1+ (1.588,0) [0|100] "%"  ADAS
 SG_ DET_HVC_FLAG_377 : 86|1@1+ (1,0) [0|1] ""  ADAS
 SG_ DET_CONFD_AZIMUTH_377 : 118|2@1+ (1,0) [0|3] ""  ADAS
 SG_ DET_CONFD_ELEVATION_377 : 101|2@1+ (1,0) [0|3] ""  ADAS
 SG_ DET_PROB_1STAZHYPO_377 : 103|1@1+ (1,0) [0|1] ""  ADAS
 SG_ DET_IDM_377 : 63|1@1+ (1,0) [0|1] ""  ADAS
 SG_ DET_MTD_377 : 47|1@1+ (1,0) [0|1] ""  ADAS
 SG_ DET_BELOW_RAIN_THOLD_377 : 39|1@1+ (1,0) [0|1] ""  ADAS
 SG_ DET_RANGE_378 : 136|15@1+ (0.015625,0) [0|500] "m"  ADAS
 SG_ DET_RANGE_ERR_378 : 152|7@1+ (0.0075,0) [0|0.9525] "m"  ADAS
 SG_ DET_RANGE_VELOCITY_378 : 160|15@1+ (0.0078125,-128) [-128|127.9921875] "m/s"  ADAS
 SG_ DET_RANGE_VELOCITY_ERR_378 : 176|8@1+ (0.003,0) [0|0.765] "m/s"  ADAS
 SG_ DET_AZIMUTH_378 : 200|13@1+ (0.0004,-1.5708) [-1.5708|1.5708] "rad"  ADAS
 SG_ DET_AZIMUTH_ERR_378 : 217|7@1+ (0.00087267,0) [0|0.11082909] "rad"  ADAS
 SG_ DET_ELEVATION_378 : 184|8@1+ (0.00275,-0.34925) [-0.34925|0.34925] "rad"  ADAS
 SG_ DET_ELEVATION_ERR_378 : 192|6@1+ (0.00174533,0) [0|0.10995579] "rad"  ADAS
 SG_ DET_RCS_378 : 240|8@1+ (0.5,-64) [-64|63.5] "dBsm"  ADAS
 SG_ DET_BI_STATIC_FLAG_378 : 216|1@1+ (1,0) [0|1] ""  ADAS
 SG_ DET_SUPER_RES_TARGET_378 : 199|1@1+ (1,0) [0|1] ""  ADAS
 SG_ DET_SNR_378 : 232|8@1+ (0.35156,0) [0|89.6478] "dB"  ADAS
 SG_ DET_EXISTENCE_PROB_378 : 224|6@1+ (1.588,0) [0|100] "%"  ADAS
 SG_ DET_HVC_FLAG_378 : 198|1@1+ (1,0) [0|1] ""  ADAS
 SG_ DET_CONFD_AZIMUTH_378 : 230|2@1+ (1,0) [0|3] ""  ADAS
 SG_ DET_CONFD_ELEVATION_378 : 213|2@1+ (1,0) [0|3] ""  ADAS
 SG_ DET_PROB_1STAZHYPO_378 : 215|1@1+ (1,0) [0|1] ""  ADAS
 SG_ DET_IDM_378 : 175|1@1+ (1,0) [0|1] ""  ADAS
 SG_ DET_MTD_378 : 159|1@1+ (1,0) [0|1] ""  ADAS
 SG_ DET_BELOW_RAIN_THOLD_378 : 151|1@1+ (1,0) [0|1] ""  ADAS
 SG_ DET_RANGE_379 : 248|15@1+ (0.015625,0) [0|500] "m"  ADAS
 SG_ DET_RANGE_ERR_379 : 264|7@1+ (0.0075,0) [0|0.9525] "m"  ADAS
 SG_ DET_RANGE_VELOCITY_379 : 272|15@1+ (0.0078125,-128) [-128|127.9921875] "m/s"  ADAS
 SG_ DET_RANGE_VELOCITY_ERR_379 : 288|8@1+ (0.003,0) [0|0.765] "m/s"  ADAS
 SG_ DET_AZIMUTH_379 : 312|13@1+ (0.0004,-1.5708) [-1.5708|1.5708] "rad"  ADAS
 SG_ DET_AZIMUTH_ERR_379 : 329|7@1+ (0.00087267,0) [0|0.11082909] "rad"  ADAS
 SG_ DET_ELEVATION_379 : 296|8@1+ (0.00275,-0.34925) [-0.34925|0.34925] "rad"  ADAS
 SG_ DET_ELEVATION_ERR_379 : 304|6@1+ (0.00174533,0) [0|0.10995579] "rad"  ADAS
 SG_ DET_RCS_379 : 352|8@1+ (0.5,-64) [-64|63.5] "dBsm"  ADAS
 SG_ DET_BI_STATIC_FLAG_379 : 328|1@1+ (1,0) [0|1] ""  ADAS
 SG_ DET_SUPER_RES_TARGET_379 : 311|1@1+ (1,0) [0|1] ""  ADAS
 SG_ DET_SNR_379 : 344|8@1+ (0.35156,0) [0|89.6478] "dB"  ADAS
 SG_ DET_EXISTENCE_PROB_379 : 336|6@1+ (1.588,0) [0|100] "%"  ADAS
 SG_ DET_HVC_FLAG_379 : 310|1@1+ (1,0) [0|1] ""  ADAS
 SG_ DET_CONFD_AZIMUTH_379 : 342|2@1+ (1,0) [0|3] ""  ADAS
 SG_ DET_CONFD_ELEVATION_379 : 325|2@1+ (1,0) [0|3] ""  ADAS
 SG_ DET_PROB_1STAZHYPO_379 : 327|1@1+ (1,0) [0|1] ""  ADAS
 SG_ DET_IDM_379 : 287|1@1+ (1,0) [0|1] ""  ADAS
 SG_ DET_MTD_379 : 271|1@1+ (1,0) [0|1] ""  ADAS
 SG_ DET_BELOW_RAIN_THOLD_379 : 263|1@1+ (1,0) [0|1] ""  ADAS
 SG_ DET_RANGE_380 : 360|15@1+ (0.015625,0) [0|500] "m"  ADAS
 SG_ DET_RANGE_ERR_380 : 376|7@1+ (0.0075,0) [0|0.9525] "m"  ADAS
 SG_ DET_RANGE_VELOCITY_380 : 384|15@1+ (0.0078125,-128) [-128|127.9921875] "m/s"  ADAS
 SG_ DET_RANGE_VELOCITY_ERR_380 : 400|8@1+ (0.003,0) [0|0.765] "m/s"  ADAS
 SG_ DET_AZIMUTH_380 : 424|13@1+ (0.0004,-1.5708) [-1.5708|1.5708] "rad"  ADAS
 SG_ DET_AZIMUTH_ERR_380 : 441|7@1+ (0.00087267,0) [0|0.11082909] "rad"  ADAS
 SG_ DET_ELEVATION_380 : 408|8@1+ (0.00275,-0.34925) [-0.34925|0.34925] "rad"  ADAS
 SG_ DET_ELEVATION_ERR_380 : 416|6@1+ (0.00174533,0) [0|0.10995579] "rad"  ADAS
 SG_ DET_RCS_380 : 464|8@1+ (0.5,-64) [-64|63.5] "dBsm"  ADAS
 SG_ DET_BI_STATIC_FLAG_380 : 440|1@1+ (1,0) [0|1] ""  ADAS
 SG_ DET_SUPER_RES_TARGET_380 : 423|1@1+ (1,0) [0|1] ""  ADAS
 SG_ DET_SNR_380 : 456|8@1+ (0.35156,0) [0|89.6478] "dB"  ADAS
 SG_ DET_EXISTENCE_PROB_380 : 448|6@1+ (1.588,0) [0|100] "%"  ADAS
 SG_ DET_HVC_FLAG_380 : 422|1@1+ (1,0) [0|1] ""  ADAS
 SG_ DET_CONFD_AZIMUTH_380 : 454|2@1+ (1,0) [0|3] ""  ADAS
 SG_ DET_CONFD_ELEVATION_380 : 437|2@1+ (1,0) [0|3] ""  ADAS
 SG_ DET_MH_SCAN_INDEX_4LSB_377_380 : 476|4@1+ (1,0) [0|15] ""  ADAS
 SG_ DET_MH_CYCLE_COUNTER_377_380 : 16|8@1+ (1,0) [0|255] ""  ADAS
 SG_ DET_MH_CRC16_377_380 : 0|16@1+ (1,0) [0|65535] ""  ADAS
 SG_ DET_PROB_1STAZHYPO_380 : 439|1@1+ (1,0) [0|1] ""  ADAS
 SG_ DET_IDM_380 : 399|1@1+ (1,0) [0|1] ""  ADAS
 SG_ DET_MTD_380 : 383|1@1+ (1,0) [0|1] ""  ADAS
 SG_ DET_BELOW_RAIN_THOLD_380 : 375|1@1+ (1,0) [0|1] ""  ADAS

BO_ 1119 RDR_DETECTION_381_384: 64 RDR07
 SG_ DET_RANGE_381 : 24|15@1+ (0.015625,0) [0|500] "m"  ADAS
 SG_ DET_RANGE_ERR_381 : 40|7@1+ (0.0075,0) [0|0.9525] "m"  ADAS
 SG_ DET_RANGE_VELOCITY_381 : 48|15@1+ (0.0078125,-128) [-128|127.9921875] "m/s"  ADAS
 SG_ DET_RANGE_VELOCITY_ERR_381 : 64|8@1+ (0.003,0) [0|0.765] "m/s"  ADAS
 SG_ DET_AZIMUTH_381 : 88|13@1+ (0.0004,-1.5708) [-1.5708|1.5708] "rad"  ADAS
 SG_ DET_AZIMUTH_ERR_381 : 105|7@1+ (0.00087267,0) [0|0.11082909] "rad"  ADAS
 SG_ DET_ELEVATION_381 : 72|8@1+ (0.00275,-0.34925) [-0.34925|0.34925] "rad"  ADAS
 SG_ DET_ELEVATION_ERR_381 : 80|6@1+ (0.00174533,0) [0|0.10995579] "rad"  ADAS
 SG_ DET_RCS_381 : 128|8@1+ (0.5,-64) [-64|63.5] "dBsm"  ADAS
 SG_ DET_BI_STATIC_FLAG_381 : 104|1@1+ (1,0) [0|1] ""  ADAS
 SG_ DET_SUPER_RES_TARGET_381 : 87|1@1+ (1,0) [0|1] ""  ADAS
 SG_ DET_SNR_381 : 120|8@1+ (0.35156,0) [0|89.6478] "dB"  ADAS
 SG_ DET_EXISTENCE_PROB_381 : 112|6@1+ (1.588,0) [0|100] "%"  ADAS
 SG_ DET_HVC_FLAG_381 : 86|1@1+ (1,0) [0|1] ""  ADAS
 SG_ DET_CONFD_AZIMUTH_381 : 118|2@1+ (1,0) [0|3] ""  ADAS
 SG_ DET_CONFD_ELEVATION_381 : 101|2@1+ (1,0) [0|3] ""  ADAS
 SG_ DET_PROB_1STAZHYPO_381 : 103|1@1+ (1,0) [0|1] ""  ADAS
 SG_ DET_IDM_381 : 63|1@1+ (1,0) [0|1] ""  ADAS
 SG_ DET_MTD_381 : 47|1@1+ (1,0) [0|1] ""  ADAS
 SG_ DET_BELOW_RAIN_THOLD_381 : 39|1@1+ (1,0) [0|1] ""  ADAS
 SG_ DET_RANGE_382 : 136|15@1+ (0.015625,0) [0|500] "m"  ADAS
 SG_ DET_RANGE_ERR_382 : 152|7@1+ (0.0075,0) [0|0.9525] "m"  ADAS
 SG_ DET_RANGE_VELOCITY_382 : 160|15@1+ (0.0078125,-128) [-128|127.9921875] "m/s"  ADAS
 SG_ DET_RANGE_VELOCITY_ERR_382 : 176|8@1+ (0.003,0) [0|0.765] "m/s"  ADAS
 SG_ DET_AZIMUTH_382 : 200|13@1+ (0.0004,-1.5708) [-1.5708|1.5708] "rad"  ADAS
 SG_ DET_AZIMUTH_ERR_382 : 217|7@1+ (0.00087267,0) [0|0.11082909] "rad"  ADAS
 SG_ DET_ELEVATION_382 : 184|8@1+ (0.00275,-0.34925) [-0.34925|0.34925] "rad"  ADAS
 SG_ DET_ELEVATION_ERR_382 : 192|6@1+ (0.00174533,0) [0|0.10995579] "rad"  ADAS
 SG_ DET_RCS_382 : 240|8@1+ (0.5,-64) [-64|63.5] "dBsm"  ADAS
 SG_ DET_BI_STATIC_FLAG_382 : 216|1@1+ (1,0) [0|1] ""  ADAS
 SG_ DET_SUPER_RES_TARGET_382 : 199|1@1+ (1,0) [0|1] ""  ADAS
 SG_ DET_SNR_382 : 232|8@1+ (0.35156,0) [0|89.6478] "dB"  ADAS
 SG_ DET_EXISTENCE_PROB_382 : 224|6@1+ (1.588,0) [0|100] "%"  ADAS
 SG_ DET_HVC_FLAG_382 : 198|1@1+ (1,0) [0|1] ""  ADAS
 SG_ DET_CONFD_AZIMUTH_382 : 230|2@1+ (1,0) [0|3] ""  ADAS
 SG_ DET_CONFD_ELEVATION_382 : 213|2@1+ (1,0) [0|3] ""  ADAS
 SG_ DET_PROB_1STAZHYPO_382 : 215|1@1+ (1,0) [0|1] ""  ADAS
 SG_ DET_IDM_382 : 175|1@1+ (1,0) [0|1] ""  ADAS
 SG_ DET_MTD_382 : 159|1@1+ (1,0) [0|1] ""  ADAS
 SG_ DET_BELOW_RAIN_THOLD_382 : 151|1@1+ (1,0) [0|1] ""  ADAS
 SG_ DET_RANGE_383 : 248|15@1+ (0.015625,0) [0|500] "m"  ADAS
 SG_ DET_RANGE_ERR_383 : 264|7@1+ (0.0075,0) [0|0.9525] "m"  ADAS
 SG_ DET_RANGE_VELOCITY_383 : 272|15@1+ (0.0078125,-128) [-128|127.9921875] "m/s"  ADAS
 SG_ DET_RANGE_VELOCITY_ERR_383 : 288|8@1+ (0.003,0) [0|0.765] "m/s"  ADAS
 SG_ DET_AZIMUTH_383 : 312|13@1+ (0.0004,-1.5708) [-1.5708|1.5708] "rad"  ADAS
 SG_ DET_AZIMUTH_ERR_383 : 329|7@1+ (0.00087267,0) [0|0.11082909] "rad"  ADAS
 SG_ DET_ELEVATION_383 : 296|8@1+ (0.00275,-0.34925) [-0.34925|0.34925] "rad"  ADAS
 SG_ DET_ELEVATION_ERR_383 : 304|6@1+ (0.00174533,0) [0|0.10995579] "rad"  ADAS
 SG_ DET_RCS_383 : 352|8@1+ (0.5,-64) [-64|63.5] "dBsm"  ADAS
 SG_ DET_BI_STATIC_FLAG_383 : 328|1@1+ (1,0) [0|1] ""  ADAS
 SG_ DET_SUPER_RES_TARGET_383 : 311|1@1+ (1,0) [0|1] ""  ADAS
 SG_ DET_SNR_383 : 344|8@1+ (0.35156,0) [0|89.6478] "dB"  ADAS
 SG_ DET_EXISTENCE_PROB_383 : 336|6@1+ (1.588,0) [0|100] "%"  ADAS
 SG_ DET_HVC_FLAG_383 : 310|1@1+ (1,0) [0|1] ""  ADAS
 SG_ DET_CONFD_AZIMUTH_383 : 342|2@1+ (1,0) [0|3] ""  ADAS
 SG_ DET_CONFD_ELEVATION_383 : 325|2@1+ (1,0) [0|3] ""  ADAS
 SG_ DET_PROB_1STAZHYPO_383 : 327|1@1+ (1,0) [0|1] ""  ADAS
 SG_ DET_IDM_383 : 287|1@1+ (1,0) [0|1] ""  ADAS
 SG_ DET_MTD_383 : 271|1@1+ (1,0) [0|1] ""  ADAS
 SG_ DET_BELOW_RAIN_THOLD_383 : 263|1@1+ (1,0) [0|1] ""  ADAS
 SG_ DET_RANGE_384 : 360|15@1+ (0.015625,0) [0|500] "m"  ADAS
 SG_ DET_RANGE_ERR_384 : 376|7@1+ (0.0075,0) [0|0.9525] "m"  ADAS
 SG_ DET_RANGE_VELOCITY_384 : 384|15@1+ (0.0078125,-128) [-128|127.9921875] "m/s"  ADAS
 SG_ DET_RANGE_VELOCITY_ERR_384 : 400|8@1+ (0.003,0) [0|0.765] "m/s"  ADAS
 SG_ DET_AZIMUTH_384 : 424|13@1+ (0.0004,-1.5708) [-1.5708|1.5708] "rad"  ADAS
 SG_ DET_AZIMUTH_ERR_384 : 441|7@1+ (0.00087267,0) [0|0.11082909] "rad"  ADAS
 SG_ DET_ELEVATION_384 : 408|8@1+ (0.00275,-0.34925) [-0.34925|0.34925] "rad"  ADAS
 SG_ DET_ELEVATION_ERR_384 : 416|6@1+ (0.00174533,0) [0|0.10995579] "rad"  ADAS
 SG_ DET_RCS_384 : 464|8@1+ (0.5,-64) [-64|63.5] "dBsm"  ADAS
 SG_ DET_BI_STATIC_FLAG_384 : 440|1@1+ (1,0) [0|1] ""  ADAS
 SG_ DET_SUPER_RES_TARGET_384 : 423|1@1+ (1,0) [0|1] ""  ADAS
 SG_ DET_SNR_384 : 456|8@1+ (0.35156,0) [0|89.6478] "dB"  ADAS
 SG_ DET_EXISTENCE_PROB_384 : 448|6@1+ (1.588,0) [0|100] "%"  ADAS
 SG_ DET_HVC_FLAG_384 : 422|1@1+ (1,0) [0|1] ""  ADAS
 SG_ DET_CONFD_AZIMUTH_384 : 454|2@1+ (1,0) [0|3] ""  ADAS
 SG_ DET_CONFD_ELEVATION_384 : 437|2@1+ (1,0) [0|3] ""  ADAS
 SG_ DET_MH_SCAN_INDEX_4LSB_381_384 : 476|4@1+ (1,0) [0|15] ""  ADAS
 SG_ DET_MH_CYCLE_COUNTER_381_384 : 16|8@1+ (1,0) [0|255] ""  ADAS
 SG_ DET_MH_CRC16_381_384 : 0|16@1+ (1,0) [0|65535] ""  ADAS
 SG_ DET_PROB_1STAZHYPO_384 : 439|1@1+ (1,0) [0|1] ""  ADAS
 SG_ DET_IDM_384 : 399|1@1+ (1,0) [0|1] ""  ADAS
 SG_ DET_MTD_384 : 383|1@1+ (1,0) [0|1] ""  ADAS
 SG_ DET_BELOW_RAIN_THOLD_384 : 375|1@1+ (1,0) [0|1] ""  ADAS

BO_ 1120 RDR_DETECTION_385_388: 64 RDR07
 SG_ DET_RANGE_385 : 24|15@1+ (0.015625,0) [0|500] "m"  ADAS
 SG_ DET_RANGE_ERR_385 : 40|7@1+ (0.0075,0) [0|0.9525] "m"  ADAS
 SG_ DET_RANGE_VELOCITY_385 : 48|15@1+ (0.0078125,-128) [-128|127.9921875] "m/s"  ADAS
 SG_ DET_RANGE_VELOCITY_ERR_385 : 64|8@1+ (0.003,0) [0|0.765] "m/s"  ADAS
 SG_ DET_AZIMUTH_385 : 88|13@1+ (0.0004,-1.5708) [-1.5708|1.5708] "rad"  ADAS
 SG_ DET_AZIMUTH_ERR_385 : 105|7@1+ (0.00087267,0) [0|0.11082909] "rad"  ADAS
 SG_ DET_ELEVATION_385 : 72|8@1+ (0.00275,-0.34925) [-0.34925|0.34925] "rad"  ADAS
 SG_ DET_ELEVATION_ERR_385 : 80|6@1+ (0.00174533,0) [0|0.10995579] "rad"  ADAS
 SG_ DET_RCS_385 : 128|8@1+ (0.5,-64) [-64|63.5] "dBsm"  ADAS
 SG_ DET_BI_STATIC_FLAG_385 : 104|1@1+ (1,0) [0|1] ""  ADAS
 SG_ DET_SUPER_RES_TARGET_385 : 87|1@1+ (1,0) [0|1] ""  ADAS
 SG_ DET_SNR_385 : 120|8@1+ (0.35156,0) [0|89.6478] "dB"  ADAS
 SG_ DET_EXISTENCE_PROB_385 : 112|6@1+ (1.588,0) [0|100] "%"  ADAS
 SG_ DET_HVC_FLAG_385 : 86|1@1+ (1,0) [0|1] ""  ADAS
 SG_ DET_CONFD_AZIMUTH_385 : 118|2@1+ (1,0) [0|3] ""  ADAS
 SG_ DET_CONFD_ELEVATION_385 : 101|2@1+ (1,0) [0|3] ""  ADAS
 SG_ DET_PROB_1STAZHYPO_385 : 103|1@1+ (1,0) [0|1] ""  ADAS
 SG_ DET_IDM_385 : 63|1@1+ (1,0) [0|1] ""  ADAS
 SG_ DET_MTD_385 : 47|1@1+ (1,0) [0|1] ""  ADAS
 SG_ DET_BELOW_RAIN_THOLD_385 : 39|1@1+ (1,0) [0|1] ""  ADAS
 SG_ DET_RANGE_386 : 136|15@1+ (0.015625,0) [0|500] "m"  ADAS
 SG_ DET_RANGE_ERR_386 : 152|7@1+ (0.0075,0) [0|0.9525] "m"  ADAS
 SG_ DET_RANGE_VELOCITY_386 : 160|15@1+ (0.0078125,-128) [-128|127.9921875] "m/s"  ADAS
 SG_ DET_RANGE_VELOCITY_ERR_386 : 176|8@1+ (0.003,0) [0|0.765] "m/s"  ADAS
 SG_ DET_AZIMUTH_386 : 200|13@1+ (0.0004,-1.5708) [-1.5708|1.5708] "rad"  ADAS
 SG_ DET_AZIMUTH_ERR_386 : 217|7@1+ (0.00087267,0) [0|0.11082909] "rad"  ADAS
 SG_ DET_ELEVATION_386 : 184|8@1+ (0.00275,-0.34925) [-0.34925|0.34925] "rad"  ADAS
 SG_ DET_ELEVATION_ERR_386 : 192|6@1+ (0.00174533,0) [0|0.10995579] "rad"  ADAS
 SG_ DET_RCS_386 : 240|8@1+ (0.5,-64) [-64|63.5] "dBsm"  ADAS
 SG_ DET_BI_STATIC_FLAG_386 : 216|1@1+ (1,0) [0|1] ""  ADAS
 SG_ DET_SUPER_RES_TARGET_386 : 199|1@1+ (1,0) [0|1] ""  ADAS
 SG_ DET_SNR_386 : 232|8@1+ (0.35156,0) [0|89.6478] "dB"  ADAS
 SG_ DET_EXISTENCE_PROB_386 : 224|6@1+ (1.588,0) [0|100] "%"  ADAS
 SG_ DET_HVC_FLAG_386 : 198|1@1+ (1,0) [0|1] ""  ADAS
 SG_ DET_CONFD_AZIMUTH_386 : 230|2@1+ (1,0) [0|3] ""  ADAS
 SG_ DET_CONFD_ELEVATION_386 : 213|2@1+ (1,0) [0|3] ""  ADAS
 SG_ DET_PROB_1STAZHYPO_386 : 215|1@1+ (1,0) [0|1] ""  ADAS
 SG_ DET_IDM_386 : 175|1@1+ (1,0) [0|1] ""  ADAS
 SG_ DET_MTD_386 : 159|1@1+ (1,0) [0|1] ""  ADAS
 SG_ DET_BELOW_RAIN_THOLD_386 : 151|1@1+ (1,0) [0|1] ""  ADAS
 SG_ DET_RANGE_387 : 248|15@1+ (0.015625,0) [0|500] "m"  ADAS
 SG_ DET_RANGE_ERR_387 : 264|7@1+ (0.0075,0) [0|0.9525] "m"  ADAS
 SG_ DET_RANGE_VELOCITY_387 : 272|15@1+ (0.0078125,-128) [-128|127.9921875] "m/s"  ADAS
 SG_ DET_RANGE_VELOCITY_ERR_387 : 288|8@1+ (0.003,0) [0|0.765] "m/s"  ADAS
 SG_ DET_AZIMUTH_387 : 312|13@1+ (0.0004,-1.5708) [-1.5708|1.5708] "rad"  ADAS
 SG_ DET_AZIMUTH_ERR_387 : 329|7@1+ (0.00087267,0) [0|0.11082909] "rad"  ADAS
 SG_ DET_ELEVATION_387 : 296|8@1+ (0.00275,-0.34925) [-0.34925|0.34925] "rad"  ADAS
 SG_ DET_ELEVATION_ERR_387 : 304|6@1+ (0.00174533,0) [0|0.10995579] "rad"  ADAS
 SG_ DET_RCS_387 : 352|8@1+ (0.5,-64) [-64|63.5] "dBsm"  ADAS
 SG_ DET_BI_STATIC_FLAG_387 : 328|1@1+ (1,0) [0|1] ""  ADAS
 SG_ DET_SUPER_RES_TARGET_387 : 311|1@1+ (1,0) [0|1] ""  ADAS
 SG_ DET_SNR_387 : 344|8@1+ (0.35156,0) [0|89.6478] "dB"  ADAS
 SG_ DET_EXISTENCE_PROB_387 : 336|6@1+ (1.588,0) [0|100] "%"  ADAS
 SG_ DET_HVC_FLAG_387 : 310|1@1+ (1,0) [0|1] ""  ADAS
 SG_ DET_CONFD_AZIMUTH_387 : 342|2@1+ (1,0) [0|3] ""  ADAS
 SG_ DET_CONFD_ELEVATION_387 : 325|2@1+ (1,0) [0|3] ""  ADAS
 SG_ DET_PROB_1STAZHYPO_387 : 327|1@1+ (1,0) [0|1] ""  ADAS
 SG_ DET_IDM_387 : 287|1@1+ (1,0) [0|1] ""  ADAS
 SG_ DET_MTD_387 : 271|1@1+ (1,0) [0|1] ""  ADAS
 SG_ DET_BELOW_RAIN_THOLD_387 : 263|1@1+ (1,0) [0|1] ""  ADAS
 SG_ DET_RANGE_388 : 360|15@1+ (0.015625,0) [0|500] "m"  ADAS
 SG_ DET_RANGE_ERR_388 : 376|7@1+ (0.0075,0) [0|0.9525] "m"  ADAS
 SG_ DET_RANGE_VELOCITY_388 : 384|15@1+ (0.0078125,-128) [-128|127.9921875] "m/s"  ADAS
 SG_ DET_RANGE_VELOCITY_ERR_388 : 400|8@1+ (0.003,0) [0|0.765] "m/s"  ADAS
 SG_ DET_AZIMUTH_388 : 424|13@1+ (0.0004,-1.5708) [-1.5708|1.5708] "rad"  ADAS
 SG_ DET_AZIMUTH_ERR_388 : 441|7@1+ (0.00087267,0) [0|0.11082909] "rad"  ADAS
 SG_ DET_ELEVATION_388 : 408|8@1+ (0.00275,-0.34925) [-0.34925|0.34925] "rad"  ADAS
 SG_ DET_ELEVATION_ERR_388 : 416|6@1+ (0.00174533,0) [0|0.10995579] "rad"  ADAS
 SG_ DET_RCS_388 : 464|8@1+ (0.5,-64) [-64|63.5] "dBsm"  ADAS
 SG_ DET_BI_STATIC_FLAG_388 : 440|1@1+ (1,0) [0|1] ""  ADAS
 SG_ DET_SUPER_RES_TARGET_388 : 423|1@1+ (1,0) [0|1] ""  ADAS
 SG_ DET_SNR_388 : 456|8@1+ (0.35156,0) [0|89.6478] "dB"  ADAS
 SG_ DET_EXISTENCE_PROB_388 : 448|6@1+ (1.588,0) [0|100] "%"  ADAS
 SG_ DET_HVC_FLAG_388 : 422|1@1+ (1,0) [0|1] ""  ADAS
 SG_ DET_CONFD_AZIMUTH_388 : 454|2@1+ (1,0) [0|3] ""  ADAS
 SG_ DET_CONFD_ELEVATION_388 : 437|2@1+ (1,0) [0|3] ""  ADAS
 SG_ DET_MH_SCAN_INDEX_4LSB_385_388 : 476|4@1+ (1,0) [0|15] ""  ADAS
 SG_ DET_MH_CYCLE_COUNTER_385_388 : 16|8@1+ (1,0) [0|255] ""  ADAS
 SG_ DET_MH_CRC16_385_388 : 0|16@1+ (1,0) [0|65535] ""  ADAS
 SG_ DET_PROB_1STAZHYPO_388 : 439|1@1+ (1,0) [0|1] ""  ADAS
 SG_ DET_IDM_388 : 399|1@1+ (1,0) [0|1] ""  ADAS
 SG_ DET_MTD_388 : 383|1@1+ (1,0) [0|1] ""  ADAS
 SG_ DET_BELOW_RAIN_THOLD_388 : 375|1@1+ (1,0) [0|1] ""  ADAS

BO_ 1121 RDR_DETECTION_389_392: 64 RDR07
 SG_ DET_RANGE_389 : 24|15@1+ (0.015625,0) [0|500] "m"  ADAS
 SG_ DET_RANGE_ERR_389 : 40|7@1+ (0.0075,0) [0|0.9525] "m"  ADAS
 SG_ DET_RANGE_VELOCITY_389 : 48|15@1+ (0.0078125,-128) [-128|127.9921875] "m/s"  ADAS
 SG_ DET_RANGE_VELOCITY_ERR_389 : 64|8@1+ (0.003,0) [0|0.765] "m/s"  ADAS
 SG_ DET_AZIMUTH_389 : 88|13@1+ (0.0004,-1.5708) [-1.5708|1.5708] "rad"  ADAS
 SG_ DET_AZIMUTH_ERR_389 : 105|7@1+ (0.00087267,0) [0|0.11082909] "rad"  ADAS
 SG_ DET_ELEVATION_389 : 72|8@1+ (0.00275,-0.34925) [-0.34925|0.34925] "rad"  ADAS
 SG_ DET_ELEVATION_ERR_389 : 80|6@1+ (0.00174533,0) [0|0.10995579] "rad"  ADAS
 SG_ DET_RCS_389 : 128|8@1+ (0.5,-64) [-64|63.5] "dBsm"  ADAS
 SG_ DET_BI_STATIC_FLAG_389 : 104|1@1+ (1,0) [0|1] ""  ADAS
 SG_ DET_SUPER_RES_TARGET_389 : 87|1@1+ (1,0) [0|1] ""  ADAS
 SG_ DET_SNR_389 : 120|8@1+ (0.35156,0) [0|89.6478] "dB"  ADAS
 SG_ DET_EXISTENCE_PROB_389 : 112|6@1+ (1.588,0) [0|100] "%"  ADAS
 SG_ DET_HVC_FLAG_389 : 86|1@1+ (1,0) [0|1] ""  ADAS
 SG_ DET_CONFD_AZIMUTH_389 : 118|2@1+ (1,0) [0|3] ""  ADAS
 SG_ DET_CONFD_ELEVATION_389 : 101|2@1+ (1,0) [0|3] ""  ADAS
 SG_ DET_PROB_1STAZHYPO_389 : 103|1@1+ (1,0) [0|1] ""  ADAS
 SG_ DET_IDM_389 : 63|1@1+ (1,0) [0|1] ""  ADAS
 SG_ DET_MTD_389 : 47|1@1+ (1,0) [0|1] ""  ADAS
 SG_ DET_BELOW_RAIN_THOLD_389 : 39|1@1+ (1,0) [0|1] ""  ADAS
 SG_ DET_RANGE_390 : 136|15@1+ (0.015625,0) [0|500] "m"  ADAS
 SG_ DET_RANGE_ERR_390 : 152|7@1+ (0.0075,0) [0|0.9525] "m"  ADAS
 SG_ DET_RANGE_VELOCITY_390 : 160|15@1+ (0.0078125,-128) [-128|127.9921875] "m/s"  ADAS
 SG_ DET_RANGE_VELOCITY_ERR_390 : 176|8@1+ (0.003,0) [0|0.765] "m/s"  ADAS
 SG_ DET_AZIMUTH_390 : 200|13@1+ (0.0004,-1.5708) [-1.5708|1.5708] "rad"  ADAS
 SG_ DET_AZIMUTH_ERR_390 : 217|7@1+ (0.00087267,0) [0|0.11082909] "rad"  ADAS
 SG_ DET_ELEVATION_390 : 184|8@1+ (0.00275,-0.34925) [-0.34925|0.34925] "rad"  ADAS
 SG_ DET_ELEVATION_ERR_390 : 192|6@1+ (0.00174533,0) [0|0.10995579] "rad"  ADAS
 SG_ DET_RCS_390 : 240|8@1+ (0.5,-64) [-64|63.5] "dBsm"  ADAS
 SG_ DET_BI_STATIC_FLAG_390 : 216|1@1+ (1,0) [0|1] ""  ADAS
 SG_ DET_SUPER_RES_TARGET_390 : 199|1@1+ (1,0) [0|1] ""  ADAS
 SG_ DET_SNR_390 : 232|8@1+ (0.35156,0) [0|89.6478] "dB"  ADAS
 SG_ DET_EXISTENCE_PROB_390 : 224|6@1+ (1.588,0) [0|100] "%"  ADAS
 SG_ DET_HVC_FLAG_390 : 198|1@1+ (1,0) [0|1] ""  ADAS
 SG_ DET_CONFD_AZIMUTH_390 : 230|2@1+ (1,0) [0|3] ""  ADAS
 SG_ DET_CONFD_ELEVATION_390 : 213|2@1+ (1,0) [0|3] ""  ADAS
 SG_ DET_PROB_1STAZHYPO_390 : 215|1@1+ (1,0) [0|1] ""  ADAS
 SG_ DET_IDM_390 : 175|1@1+ (1,0) [0|1] ""  ADAS
 SG_ DET_MTD_390 : 159|1@1+ (1,0) [0|1] ""  ADAS
 SG_ DET_BELOW_RAIN_THOLD_390 : 151|1@1+ (1,0) [0|1] ""  ADAS
 SG_ DET_RANGE_391 : 248|15@1+ (0.015625,0) [0|500] "m"  ADAS
 SG_ DET_RANGE_ERR_391 : 264|7@1+ (0.0075,0) [0|0.9525] "m"  ADAS
 SG_ DET_RANGE_VELOCITY_391 : 272|15@1+ (0.0078125,-128) [-128|127.9921875] "m/s"  ADAS
 SG_ DET_RANGE_VELOCITY_ERR_391 : 288|8@1+ (0.003,0) [0|0.765] "m/s"  ADAS
 SG_ DET_AZIMUTH_391 : 312|13@1+ (0.0004,-1.5708) [-1.5708|1.5708] "rad"  ADAS
 SG_ DET_AZIMUTH_ERR_391 : 329|7@1+ (0.00087267,0) [0|0.11082909] "rad"  ADAS
 SG_ DET_ELEVATION_391 : 296|8@1+ (0.00275,-0.34925) [-0.34925|0.34925] "rad"  ADAS
 SG_ DET_ELEVATION_ERR_391 : 304|6@1+ (0.00174533,0) [0|0.10995579] "rad"  ADAS
 SG_ DET_RCS_391 : 352|8@1+ (0.5,-64) [-64|63.5] "dBsm"  ADAS
 SG_ DET_BI_STATIC_FLAG_391 : 328|1@1+ (1,0) [0|1] ""  ADAS
 SG_ DET_SUPER_RES_TARGET_391 : 311|1@1+ (1,0) [0|1] ""  ADAS
 SG_ DET_SNR_391 : 344|8@1+ (0.35156,0) [0|89.6478] "dB"  ADAS
 SG_ DET_EXISTENCE_PROB_391 : 336|6@1+ (1.588,0) [0|100] "%"  ADAS
 SG_ DET_HVC_FLAG_391 : 310|1@1+ (1,0) [0|1] ""  ADAS
 SG_ DET_CONFD_AZIMUTH_391 : 342|2@1+ (1,0) [0|3] ""  ADAS
 SG_ DET_CONFD_ELEVATION_391 : 325|2@1+ (1,0) [0|3] ""  ADAS
 SG_ DET_PROB_1STAZHYPO_391 : 327|1@1+ (1,0) [0|1] ""  ADAS
 SG_ DET_IDM_391 : 287|1@1+ (1,0) [0|1] ""  ADAS
 SG_ DET_MTD_391 : 271|1@1+ (1,0) [0|1] ""  ADAS
 SG_ DET_BELOW_RAIN_THOLD_391 : 263|1@1+ (1,0) [0|1] ""  ADAS
 SG_ DET_RANGE_392 : 360|15@1+ (0.015625,0) [0|500] "m"  ADAS
 SG_ DET_RANGE_ERR_392 : 376|7@1+ (0.0075,0) [0|0.9525] "m"  ADAS
 SG_ DET_RANGE_VELOCITY_392 : 384|15@1+ (0.0078125,-128) [-128|127.9921875] "m/s"  ADAS
 SG_ DET_RANGE_VELOCITY_ERR_392 : 400|8@1+ (0.003,0) [0|0.765] "m/s"  ADAS
 SG_ DET_AZIMUTH_392 : 424|13@1+ (0.0004,-1.5708) [-1.5708|1.5708] "rad"  ADAS
 SG_ DET_AZIMUTH_ERR_392 : 441|7@1+ (0.00087267,0) [0|0.11082909] "rad"  ADAS
 SG_ DET_ELEVATION_392 : 408|8@1+ (0.00275,-0.34925) [-0.34925|0.34925] "rad"  ADAS
 SG_ DET_ELEVATION_ERR_392 : 416|6@1+ (0.00174533,0) [0|0.10995579] "rad"  ADAS
 SG_ DET_RCS_392 : 464|8@1+ (0.5,-64) [-64|63.5] "dBsm"  ADAS
 SG_ DET_BI_STATIC_FLAG_392 : 440|1@1+ (1,0) [0|1] ""  ADAS
 SG_ DET_SUPER_RES_TARGET_392 : 423|1@1+ (1,0) [0|1] ""  ADAS
 SG_ DET_SNR_392 : 456|8@1+ (0.35156,0) [0|89.6478] "dB"  ADAS
 SG_ DET_EXISTENCE_PROB_392 : 448|6@1+ (1.588,0) [0|100] "%"  ADAS
 SG_ DET_HVC_FLAG_392 : 422|1@1+ (1,0) [0|1] ""  ADAS
 SG_ DET_CONFD_AZIMUTH_392 : 454|2@1+ (1,0) [0|3] ""  ADAS
 SG_ DET_CONFD_ELEVATION_392 : 437|2@1+ (1,0) [0|3] ""  ADAS
 SG_ DET_MH_SCAN_INDEX_4LSB_389_392 : 476|4@1+ (1,0) [0|15] ""  ADAS
 SG_ DET_MH_CYCLE_COUNTER_389_392 : 16|8@1+ (1,0) [0|255] ""  ADAS
 SG_ DET_MH_CRC16_389_392 : 0|16@1+ (1,0) [0|65535] ""  ADAS
 SG_ DET_PROB_1STAZHYPO_392 : 439|1@1+ (1,0) [0|1] ""  ADAS
 SG_ DET_IDM_392 : 399|1@1+ (1,0) [0|1] ""  ADAS
 SG_ DET_MTD_392 : 383|1@1+ (1,0) [0|1] ""  ADAS
 SG_ DET_BELOW_RAIN_THOLD_392 : 375|1@1+ (1,0) [0|1] ""  ADAS

BO_ 1122 RDR_DETECTION_393_396: 64 RDR07
 SG_ DET_RANGE_393 : 24|15@1+ (0.015625,0) [0|500] "m"  ADAS
 SG_ DET_RANGE_ERR_393 : 40|7@1+ (0.0075,0) [0|0.9525] "m"  ADAS
 SG_ DET_RANGE_VELOCITY_393 : 48|15@1+ (0.0078125,-128) [-128|127.9921875] "m/s"  ADAS
 SG_ DET_RANGE_VELOCITY_ERR_393 : 64|8@1+ (0.003,0) [0|0.765] "m/s"  ADAS
 SG_ DET_AZIMUTH_393 : 88|13@1+ (0.0004,-1.5708) [-1.5708|1.5708] "rad"  ADAS
 SG_ DET_AZIMUTH_ERR_393 : 105|7@1+ (0.00087267,0) [0|0.11082909] "rad"  ADAS
 SG_ DET_ELEVATION_393 : 72|8@1+ (0.00275,-0.34925) [-0.34925|0.34925] "rad"  ADAS
 SG_ DET_ELEVATION_ERR_393 : 80|6@1+ (0.00174533,0) [0|0.10995579] "rad"  ADAS
 SG_ DET_RCS_393 : 128|8@1+ (0.5,-64) [-64|63.5] "dBsm"  ADAS
 SG_ DET_BI_STATIC_FLAG_393 : 104|1@1+ (1,0) [0|1] ""  ADAS
 SG_ DET_SUPER_RES_TARGET_393 : 87|1@1+ (1,0) [0|1] ""  ADAS
 SG_ DET_SNR_393 : 120|8@1+ (0.35156,0) [0|89.6478] "dB"  ADAS
 SG_ DET_EXISTENCE_PROB_393 : 112|6@1+ (1.588,0) [0|100] "%"  ADAS
 SG_ DET_HVC_FLAG_393 : 86|1@1+ (1,0) [0|1] ""  ADAS
 SG_ DET_CONFD_AZIMUTH_393 : 118|2@1+ (1,0) [0|3] ""  ADAS
 SG_ DET_CONFD_ELEVATION_393 : 101|2@1+ (1,0) [0|3] ""  ADAS
 SG_ DET_PROB_1STAZHYPO_393 : 103|1@1+ (1,0) [0|1] ""  ADAS
 SG_ DET_IDM_393 : 63|1@1+ (1,0) [0|1] ""  ADAS
 SG_ DET_MTD_393 : 47|1@1+ (1,0) [0|1] ""  ADAS
 SG_ DET_BELOW_RAIN_THOLD_393 : 39|1@1+ (1,0) [0|1] ""  ADAS
 SG_ DET_RANGE_394 : 136|15@1+ (0.015625,0) [0|500] "m"  ADAS
 SG_ DET_RANGE_ERR_394 : 152|7@1+ (0.0075,0) [0|0.9525] "m"  ADAS
 SG_ DET_RANGE_VELOCITY_394 : 160|15@1+ (0.0078125,-128) [-128|127.9921875] "m/s"  ADAS
 SG_ DET_RANGE_VELOCITY_ERR_394 : 176|8@1+ (0.003,0) [0|0.765] "m/s"  ADAS
 SG_ DET_AZIMUTH_394 : 200|13@1+ (0.0004,-1.5708) [-1.5708|1.5708] "rad"  ADAS
 SG_ DET_AZIMUTH_ERR_394 : 217|7@1+ (0.00087267,0) [0|0.11082909] "rad"  ADAS
 SG_ DET_ELEVATION_394 : 184|8@1+ (0.00275,-0.34925) [-0.34925|0.34925] "rad"  ADAS
 SG_ DET_ELEVATION_ERR_394 : 192|6@1+ (0.00174533,0) [0|0.10995579] "rad"  ADAS
 SG_ DET_RCS_394 : 240|8@1+ (0.5,-64) [-64|63.5] "dBsm"  ADAS
 SG_ DET_BI_STATIC_FLAG_394 : 216|1@1+ (1,0) [0|1] ""  ADAS
 SG_ DET_SUPER_RES_TARGET_394 : 199|1@1+ (1,0) [0|1] ""  ADAS
 SG_ DET_SNR_394 : 232|8@1+ (0.35156,0) [0|89.6478] "dB"  ADAS
 SG_ DET_EXISTENCE_PROB_394 : 224|6@1+ (1.588,0) [0|100] "%"  ADAS
 SG_ DET_HVC_FLAG_394 : 198|1@1+ (1,0) [0|1] ""  ADAS
 SG_ DET_CONFD_AZIMUTH_394 : 230|2@1+ (1,0) [0|3] ""  ADAS
 SG_ DET_CONFD_ELEVATION_394 : 213|2@1+ (1,0) [0|3] ""  ADAS
 SG_ DET_PROB_1STAZHYPO_394 : 215|1@1+ (1,0) [0|1] ""  ADAS
 SG_ DET_IDM_394 : 175|1@1+ (1,0) [0|1] ""  ADAS
 SG_ DET_MTD_394 : 159|1@1+ (1,0) [0|1] ""  ADAS
 SG_ DET_BELOW_RAIN_THOLD_394 : 151|1@1+ (1,0) [0|1] ""  ADAS
 SG_ DET_RANGE_395 : 248|15@1+ (0.015625,0) [0|500] "m"  ADAS
 SG_ DET_RANGE_ERR_395 : 264|7@1+ (0.0075,0) [0|0.9525] "m"  ADAS
 SG_ DET_RANGE_VELOCITY_395 : 272|15@1+ (0.0078125,-128) [-128|127.9921875] "m/s"  ADAS
 SG_ DET_RANGE_VELOCITY_ERR_395 : 288|8@1+ (0.003,0) [0|0.765] "m/s"  ADAS
 SG_ DET_AZIMUTH_395 : 312|13@1+ (0.0004,-1.5708) [-1.5708|1.5708] "rad"  ADAS
 SG_ DET_AZIMUTH_ERR_395 : 329|7@1+ (0.00087267,0) [0|0.11082909] "rad"  ADAS
 SG_ DET_ELEVATION_395 : 296|8@1+ (0.00275,-0.34925) [-0.34925|0.34925] "rad"  ADAS
 SG_ DET_ELEVATION_ERR_395 : 304|6@1+ (0.00174533,0) [0|0.10995579] "rad"  ADAS
 SG_ DET_RCS_395 : 352|8@1+ (0.5,-64) [-64|63.5] "dBsm"  ADAS
 SG_ DET_BI_STATIC_FLAG_395 : 328|1@1+ (1,0) [0|1] ""  ADAS
 SG_ DET_SUPER_RES_TARGET_395 : 311|1@1+ (1,0) [0|1] ""  ADAS
 SG_ DET_SNR_395 : 344|8@1+ (0.35156,0) [0|89.6478] "dB"  ADAS
 SG_ DET_EXISTENCE_PROB_395 : 336|6@1+ (1.588,0) [0|100] "%"  ADAS
 SG_ DET_HVC_FLAG_395 : 310|1@1+ (1,0) [0|1] ""  ADAS
 SG_ DET_CONFD_AZIMUTH_395 : 342|2@1+ (1,0) [0|3] ""  ADAS
 SG_ DET_CONFD_ELEVATION_395 : 325|2@1+ (1,0) [0|3] ""  ADAS
 SG_ DET_PROB_1STAZHYPO_395 : 327|1@1+ (1,0) [0|1] ""  ADAS
 SG_ DET_IDM_395 : 287|1@1+ (1,0) [0|1] ""  ADAS
 SG_ DET_MTD_395 : 271|1@1+ (1,0) [0|1] ""  ADAS
 SG_ DET_BELOW_RAIN_THOLD_395 : 263|1@1+ (1,0) [0|1] ""  ADAS
 SG_ DET_RANGE_396 : 360|15@1+ (0.015625,0) [0|500] "m"  ADAS
 SG_ DET_RANGE_ERR_396 : 376|7@1+ (0.0075,0) [0|0.9525] "m"  ADAS
 SG_ DET_RANGE_VELOCITY_396 : 384|15@1+ (0.0078125,-128) [-128|127.9921875] "m/s"  ADAS
 SG_ DET_RANGE_VELOCITY_ERR_396 : 400|8@1+ (0.003,0) [0|0.765] "m/s"  ADAS
 SG_ DET_AZIMUTH_396 : 424|13@1+ (0.0004,-1.5708) [-1.5708|1.5708] "rad"  ADAS
 SG_ DET_AZIMUTH_ERR_396 : 441|7@1+ (0.00087267,0) [0|0.11082909] "rad"  ADAS
 SG_ DET_ELEVATION_396 : 408|8@1+ (0.00275,-0.34925) [-0.34925|0.34925] "rad"  ADAS
 SG_ DET_ELEVATION_ERR_396 : 416|6@1+ (0.00174533,0) [0|0.10995579] "rad"  ADAS
 SG_ DET_RCS_396 : 464|8@1+ (0.5,-64) [-64|63.5] "dBsm"  ADAS
 SG_ DET_BI_STATIC_FLAG_396 : 440|1@1+ (1,0) [0|1] ""  ADAS
 SG_ DET_SUPER_RES_TARGET_396 : 423|1@1+ (1,0) [0|1] ""  ADAS
 SG_ DET_SNR_396 : 456|8@1+ (0.35156,0) [0|89.6478] "dB"  ADAS
 SG_ DET_EXISTENCE_PROB_396 : 448|6@1+ (1.588,0) [0|100] "%"  ADAS
 SG_ DET_HVC_FLAG_396 : 422|1@1+ (1,0) [0|1] ""  ADAS
 SG_ DET_CONFD_AZIMUTH_396 : 454|2@1+ (1,0) [0|3] ""  ADAS
 SG_ DET_CONFD_ELEVATION_396 : 437|2@1+ (1,0) [0|3] ""  ADAS
 SG_ DET_MH_SCAN_INDEX_4LSB_393_396 : 476|4@1+ (1,0) [0|15] ""  ADAS
 SG_ DET_MH_CYCLE_COUNTER_393_396 : 16|8@1+ (1,0) [0|255] ""  ADAS
 SG_ DET_MH_CRC16_393_396 : 0|16@1+ (1,0) [0|65535] ""  ADAS
 SG_ DET_PROB_1STAZHYPO_396 : 439|1@1+ (1,0) [0|1] ""  ADAS
 SG_ DET_IDM_396 : 399|1@1+ (1,0) [0|1] ""  ADAS
 SG_ DET_MTD_396 : 383|1@1+ (1,0) [0|1] ""  ADAS
 SG_ DET_BELOW_RAIN_THOLD_396 : 375|1@1+ (1,0) [0|1] ""  ADAS

BO_ 1123 RDR_DETECTION_397_400: 64 RDR07
 SG_ DET_RANGE_397 : 24|15@1+ (0.015625,0) [0|500] "m"  ADAS
 SG_ DET_RANGE_ERR_397 : 40|7@1+ (0.0075,0) [0|0.9525] "m"  ADAS
 SG_ DET_RANGE_VELOCITY_397 : 48|15@1+ (0.0078125,-128) [-128|127.9921875] "m/s"  ADAS
 SG_ DET_RANGE_VELOCITY_ERR_397 : 64|8@1+ (0.003,0) [0|0.765] "m/s"  ADAS
 SG_ DET_AZIMUTH_397 : 88|13@1+ (0.0004,-1.5708) [-1.5708|1.5708] "rad"  ADAS
 SG_ DET_AZIMUTH_ERR_397 : 105|7@1+ (0.00087267,0) [0|0.11082909] "rad"  ADAS
 SG_ DET_ELEVATION_397 : 72|8@1+ (0.00275,-0.34925) [-0.34925|0.34925] "rad"  ADAS
 SG_ DET_ELEVATION_ERR_397 : 80|6@1+ (0.00174533,0) [0|0.10995579] "rad"  ADAS
 SG_ DET_RCS_397 : 128|8@1+ (0.5,-64) [-64|63.5] "dBsm"  ADAS
 SG_ DET_BI_STATIC_FLAG_397 : 104|1@1+ (1,0) [0|1] ""  ADAS
 SG_ DET_SUPER_RES_TARGET_397 : 87|1@1+ (1,0) [0|1] ""  ADAS
 SG_ DET_SNR_397 : 120|8@1+ (0.35156,0) [0|89.6478] "dB"  ADAS
 SG_ DET_EXISTENCE_PROB_397 : 112|6@1+ (1.588,0) [0|100] "%"  ADAS
 SG_ DET_HVC_FLAG_397 : 86|1@1+ (1,0) [0|1] ""  ADAS
 SG_ DET_CONFD_AZIMUTH_397 : 118|2@1+ (1,0) [0|3] ""  ADAS
 SG_ DET_CONFD_ELEVATION_397 : 101|2@1+ (1,0) [0|3] ""  ADAS
 SG_ DET_PROB_1STAZHYPO_397 : 103|1@1+ (1,0) [0|1] ""  ADAS
 SG_ DET_IDM_397 : 63|1@1+ (1,0) [0|1] ""  ADAS
 SG_ DET_MTD_397 : 47|1@1+ (1,0) [0|1] ""  ADAS
 SG_ DET_BELOW_RAIN_THOLD_397 : 39|1@1+ (1,0) [0|1] ""  ADAS
 SG_ DET_RANGE_398 : 136|15@1+ (0.015625,0) [0|500] "m"  ADAS
 SG_ DET_RANGE_ERR_398 : 152|7@1+ (0.0075,0) [0|0.9525] "m"  ADAS
 SG_ DET_RANGE_VELOCITY_398 : 160|15@1+ (0.0078125,-128) [-128|127.9921875] "m/s"  ADAS
 SG_ DET_RANGE_VELOCITY_ERR_398 : 176|8@1+ (0.003,0) [0|0.765] "m/s"  ADAS
 SG_ DET_AZIMUTH_398 : 200|13@1+ (0.0004,-1.5708) [-1.5708|1.5708] "rad"  ADAS
 SG_ DET_AZIMUTH_ERR_398 : 217|7@1+ (0.00087267,0) [0|0.11082909] "rad"  ADAS
 SG_ DET_ELEVATION_398 : 184|8@1+ (0.00275,-0.34925) [-0.34925|0.34925] "rad"  ADAS
 SG_ DET_ELEVATION_ERR_398 : 192|6@1+ (0.00174533,0) [0|0.10995579] "rad"  ADAS
 SG_ DET_RCS_398 : 240|8@1+ (0.5,-64) [-64|63.5] "dBsm"  ADAS
 SG_ DET_BI_STATIC_FLAG_398 : 216|1@1+ (1,0) [0|1] ""  ADAS
 SG_ DET_SUPER_RES_TARGET_398 : 199|1@1+ (1,0) [0|1] ""  ADAS
 SG_ DET_SNR_398 : 232|8@1+ (0.35156,0) [0|89.6478] "dB"  ADAS
 SG_ DET_EXISTENCE_PROB_398 : 224|6@1+ (1.588,0) [0|100] "%"  ADAS
 SG_ DET_HVC_FLAG_398 : 198|1@1+ (1,0) [0|1] ""  ADAS
 SG_ DET_CONFD_AZIMUTH_398 : 230|2@1+ (1,0) [0|3] ""  ADAS
 SG_ DET_CONFD_ELEVATION_398 : 213|2@1+ (1,0) [0|3] ""  ADAS
 SG_ DET_PROB_1STAZHYPO_398 : 215|1@1+ (1,0) [0|1] ""  ADAS
 SG_ DET_IDM_398 : 175|1@1+ (1,0) [0|1] ""  ADAS
 SG_ DET_MTD_398 : 159|1@1+ (1,0) [0|1] ""  ADAS
 SG_ DET_BELOW_RAIN_THOLD_398 : 151|1@1+ (1,0) [0|1] ""  ADAS
 SG_ DET_RANGE_399 : 248|15@1+ (0.015625,0) [0|500] "m"  ADAS
 SG_ DET_RANGE_ERR_399 : 264|7@1+ (0.0075,0) [0|0.9525] "m"  ADAS
 SG_ DET_RANGE_VELOCITY_399 : 272|15@1+ (0.0078125,-128) [-128|127.9921875] "m/s"  ADAS
 SG_ DET_RANGE_VELOCITY_ERR_399 : 288|8@1+ (0.003,0) [0|0.765] "m/s"  ADAS
 SG_ DET_AZIMUTH_399 : 312|13@1+ (0.0004,-1.5708) [-1.5708|1.5708] "rad"  ADAS
 SG_ DET_AZIMUTH_ERR_399 : 329|7@1+ (0.00087267,0) [0|0.11082909] "rad"  ADAS
 SG_ DET_ELEVATION_399 : 296|8@1+ (0.00275,-0.34925) [-0.34925|0.34925] "rad"  ADAS
 SG_ DET_ELEVATION_ERR_399 : 304|6@1+ (0.00174533,0) [0|0.10995579] "rad"  ADAS
 SG_ DET_RCS_399 : 352|8@1+ (0.5,-64) [-64|63.5] "dBsm"  ADAS
 SG_ DET_BI_STATIC_FLAG_399 : 328|1@1+ (1,0) [0|1] ""  ADAS
 SG_ DET_SUPER_RES_TARGET_399 : 311|1@1+ (1,0) [0|1] ""  ADAS
 SG_ DET_SNR_399 : 344|8@1+ (0.35156,0) [0|89.6478] "dB"  ADAS
 SG_ DET_EXISTENCE_PROB_399 : 336|6@1+ (1.588,0) [0|100] "%"  ADAS
 SG_ DET_HVC_FLAG_399 : 310|1@1+ (1,0) [0|1] ""  ADAS
 SG_ DET_CONFD_AZIMUTH_399 : 342|2@1+ (1,0) [0|3] ""  ADAS
 SG_ DET_CONFD_ELEVATION_399 : 325|2@1+ (1,0) [0|3] ""  ADAS
 SG_ DET_PROB_1STAZHYPO_399 : 327|1@1+ (1,0) [0|1] ""  ADAS
 SG_ DET_IDM_399 : 287|1@1+ (1,0) [0|1] ""  ADAS
 SG_ DET_MTD_399 : 271|1@1+ (1,0) [0|1] ""  ADAS
 SG_ DET_BELOW_RAIN_THOLD_399 : 263|1@1+ (1,0) [0|1] ""  ADAS
 SG_ DET_RANGE_400 : 360|15@1+ (0.015625,0) [0|500] "m"  ADAS
 SG_ DET_RANGE_ERR_400 : 376|7@1+ (0.0075,0) [0|0.9525] "m"  ADAS
 SG_ DET_RANGE_VELOCITY_400 : 384|15@1+ (0.0078125,-128) [-128|127.9921875] "m/s"  ADAS
 SG_ DET_RANGE_VELOCITY_ERR_400 : 400|8@1+ (0.003,0) [0|0.765] "m/s"  ADAS
 SG_ DET_AZIMUTH_400 : 424|13@1+ (0.0004,-1.5708) [-1.5708|1.5708] "rad"  ADAS
 SG_ DET_AZIMUTH_ERR_400 : 441|7@1+ (0.00087267,0) [0|0.11082909] "rad"  ADAS
 SG_ DET_ELEVATION_400 : 408|8@1+ (0.00275,-0.34925) [-0.34925|0.34925] "rad"  ADAS
 SG_ DET_ELEVATION_ERR_400 : 416|6@1+ (0.00174533,0) [0|0.10995579] "rad"  ADAS
 SG_ DET_RCS_400 : 464|8@1+ (0.5,-64) [-64|63.5] "dBsm"  ADAS
 SG_ DET_BI_STATIC_FLAG_400 : 440|1@1+ (1,0) [0|1] ""  ADAS
 SG_ DET_SUPER_RES_TARGET_400 : 423|1@1+ (1,0) [0|1] ""  ADAS
 SG_ DET_SNR_400 : 456|8@1+ (0.35156,0) [0|89.6478] "dB"  ADAS
 SG_ DET_EXISTENCE_PROB_400 : 448|6@1+ (1.588,0) [0|100] "%"  ADAS
 SG_ DET_HVC_FLAG_400 : 422|1@1+ (1,0) [0|1] ""  ADAS
 SG_ DET_CONFD_AZIMUTH_400 : 454|2@1+ (1,0) [0|3] ""  ADAS
 SG_ DET_CONFD_ELEVATION_400 : 437|2@1+ (1,0) [0|3] ""  ADAS
 SG_ DET_MH_SCAN_INDEX_4LSB_397_400 : 476|4@1+ (1,0) [0|15] ""  ADAS
 SG_ DET_MH_CYCLE_COUNTER_397_400 : 16|8@1+ (1,0) [0|255] ""  ADAS
 SG_ DET_MH_CRC16_397_400 : 0|16@1+ (1,0) [0|65535] ""  ADAS
 SG_ DET_PROB_1STAZHYPO_400 : 439|1@1+ (1,0) [0|1] ""  ADAS
 SG_ DET_IDM_400 : 399|1@1+ (1,0) [0|1] ""  ADAS
 SG_ DET_MTD_400 : 383|1@1+ (1,0) [0|1] ""  ADAS
 SG_ DET_BELOW_RAIN_THOLD_400 : 375|1@1+ (1,0) [0|1] ""  ADAS

BO_ 1680 RDR_TRACKER_OBJ_001: 64 RDR07
 SG_ OBJ_ALIVE_TIME_001 : 255|16@0+ (1,0) [0|65535] "ms"  ADAS
 SG_ OBJ_ACCELERATION_LONG_ERR_001 : 215|8@0+ (0.025,0) [0|6.375] "m/s^2"  ADAS
 SG_ OBJ_ACCELERATION_LAT_ERR_001 : 223|8@0+ (0.025,0) [0|6.375] "m/s^2"  ADAS
 SG_ OBJ_VELOCITY_LONG_ERR_001 : 143|8@0+ (0.05,0) [0|12.75] "m/s"  ADAS
 SG_ OBJ_VELOCITY_LAT_ERR_001 : 151|8@0+ (0.05,0) [0|12.75] "m/s"  ADAS
 SG_ OBJ_POS_LONG_ERR_001 : 95|8@0+ (0.025,0) [0|6.375] "m"  ADAS
 SG_ OBJ_POS_LAT_ERR_001 : 103|8@0+ (0.025,0) [0|6.375] "m"  ADAS
 SG_ OBJ_TRACK_MOTION_MODEL_001 : 9|2@0+ (1,0) [0|3] "NA"  ADAS
 SG_ OBJ_DIMENSION_WIDTH_001 : 17|10@0+ (0.01,0) [0|10.23] "m"  ADAS
 SG_ OBJ_DIMENSION_LENGTH_001 : 37|12@0+ (0.01,0) [0|40.95] "m"  ADAS
 SG_ OBJ_EXISTENCE_PROB_001 : 229|14@0+ (0.0001,0) [0|1] "NA"  ADAS
 SG_ OBJ_YAW_ANGLE_001 : 155|12@0+ (0.005,-10) [-10|10.475] "rad"  ADAS
 SG_ OBJ_YAW_ANGLE_ERR_001 : 175|7@0+ (0.01,0) [0|1.27] "rad"  ADAS
 SG_ OBJ_ID_001 : 7|8@0+ (1,0) [0|255] "NA"  ADAS
 SG_ OBJ_MOVEMENT_STATUS_001 : 196|3@0+ (1,0) [0|3] "NA"  ADAS
 SG_ OBJ_MEASUREMENT_STATUS_001 : 14|3@0+ (1,0) [0|7] "NA"  ADAS
 SG_ OBJ_POS_LONG_001 : 63|16@0+ (0.01,-327) [-327|327] "m"  ADAS
 SG_ OBJ_POS_LAT_001 : 79|16@0+ (0.01,-327) [-327|327] "m"  ADAS
 SG_ OBJ_VELOCITY_LONG_001 : 110|15@0+ (0.01,-163) [-163|163] "m/s"  ADAS
 SG_ OBJ_VELOCITY_LAT_001 : 126|15@0+ (0.01,-163) [-163|163] "m/s"  ADAS
 SG_ OBJ_ACCELERATION_LONG_001 : 193|10@0+ (0.05,-20) [-20|20] "m/s^2"  ADAS
 SG_ OBJ_ACCELERATION_LAT_001 : 177|10@0+ (0.05,-20) [-20|20] "m/s^2"  ADAS
 SG_ OBJ_VEH_TRACK_FLAG_001 : 10|1@0+ (1,0) [0|1] "NA"  ADAS
 SG_ OBJ_MH_CYCLE_COUNTER_001 : 487|8@0+ (1,0) [0|255] "NA"  ADAS
 SG_ OBJ_MH_CRC16_001 : 495|16@0+ (1,0) [0|65535] "NA"  ADAS
 SG_ OBJ_TIMESTAMP_OFFSET_001 : 247|8@0+ (1,-127) [-127|128] "ms"  ADAS
 SG_ OBJ_DIMENSION_WIDTH_ERR_001 : 23|6@0+ (0.01,0) [0|0.63] "m"  ADAS
 SG_ OBJ_DIMENSION_LENGTH_ERR_001 : 41|10@0+ (0.01,0) [0|10.23] "m"  ADAS
 SG_ OBJ_CLS_TYPE1_001 : 271|4@0+ (1,0) [0|15] "NA"  ADAS
 SG_ OBJ_CLS_TYPE1_PROB_001 : 303|8@0+ (0.004,0) [0|1] "NA"  ADAS
 SG_ OBJ_CLS_TYPE2_001 : 267|4@0+ (1,0) [0|15] "NA"  ADAS
 SG_ OBJ_CLS_TYPE2_PROB_001 : 311|8@0+ (0.004,0) [0|1] "NA"  ADAS
 SG_ OBJ_CLS_TYPE3_001 : 279|4@0+ (1,0) [0|15] "NA"  ADAS
 SG_ OBJ_CLS_TYPE3_PROB_001 : 319|8@0+ (0.004,0) [0|1] "NA"  ADAS
 SG_ OBJ_CLS_TYPE4_001 : 275|4@0+ (1,0) [0|15] "NA"  ADAS
 SG_ OBJ_CLS_TYPE4_PROB_001 : 327|8@0+ (0.004,0) [0|1] "NA"  ADAS
 SG_ OBJ_CLS_TYPE5_001 : 287|4@0+ (1,0) [0|15] "NA"  ADAS
 SG_ OBJ_CLS_TYPE5_PROB_001 : 335|8@0+ (0.004,0) [0|1] "NA"  ADAS
 SG_ OBJ_CLS_TYPE6_001 : 282|4@0+ (1,0) [0|15] "NA"  ADAS
 SG_ OBJ_CLS_TYPE6_PROB_001 : 343|8@0+ (0.004,0) [0|1] "NA"  ADAS
 SG_ OBJ_RCS_001 : 351|7@0+ (1,-64) [-64|63] "dBsm"  ADAS
 SG_ OBJ_REF_PT_LONG_OFFSET_001 : 357|14@0+ (0.0001,0) [0|1] "NA"  ADAS
 SG_ OBJ_REF_PT_LAT_OFFSET_001 : 370|14@0+ (0.0001,0) [0|1] "NA"  ADAS
 SG_ OBJ_YAW_RATE_001 : 399|10@0+ (0.005,-2.24) [-2.24|2.24] "rad/s"  ADAS
 SG_ OBJ_YAW_RATE_ERR_001 : 388|5@0+ (0.025,0) [0|0.775] "rad/s"  ADAS
 SG_ OBJ_GROUP_ID_001 : 405|6@0+ (1,0) [0|63] "NA"  ADAS
 SG_ OBJ_POS_ERR_CRR_COEF_001 : 415|8@0+ (0.01,-1.2) [-1.2|1] "NA"  ADAS
 SG_ OBJ_VELOCITY_ERR_CRR_COEF_001 : 423|8@0+ (0.01,-1.2) [-1.2|1] "NA"  ADAS
 SG_ OBJ_ACCEL_ERR_CRR_COEF_001 : 431|8@0+ (0.01,-1.2) [-1.2|1] "NA"  ADAS

BO_ 1681 RDR_TRACKER_OBJ_002: 64 RDR07
 SG_ OBJ_ALIVE_TIME_002 : 255|16@0+ (1,0) [0|65535] "ms"  ADAS
 SG_ OBJ_ACCELERATION_LONG_ERR_002 : 215|8@0+ (0.025,0) [0|6.375] "m/s^2"  ADAS
 SG_ OBJ_ACCELERATION_LAT_ERR_002 : 223|8@0+ (0.025,0) [0|6.375] "m/s^2"  ADAS
 SG_ OBJ_VELOCITY_LONG_ERR_002 : 143|8@0+ (0.05,0) [0|12.75] "m/s"  ADAS
 SG_ OBJ_VELOCITY_LAT_ERR_002 : 151|8@0+ (0.05,0) [0|12.75] "m/s"  ADAS
 SG_ OBJ_POS_LONG_ERR_002 : 95|8@0+ (0.025,0) [0|6.375] "m"  ADAS
 SG_ OBJ_POS_LAT_ERR_002 : 103|8@0+ (0.025,0) [0|6.375] "m"  ADAS
 SG_ OBJ_TRACK_MOTION_MODEL_002 : 9|2@0+ (1,0) [0|3] "NA"  ADAS
 SG_ OBJ_DIMENSION_WIDTH_002 : 17|10@0+ (0.01,0) [0|10.23] "m"  ADAS
 SG_ OBJ_DIMENSION_LENGTH_002 : 37|12@0+ (0.01,0) [0|40.95] "m"  ADAS
 SG_ OBJ_EXISTENCE_PROB_002 : 229|14@0+ (0.0001,0) [0|1] "NA"  ADAS
 SG_ OBJ_YAW_ANGLE_002 : 155|12@0+ (0.005,-10) [-10|10.475] "rad"  ADAS
 SG_ OBJ_YAW_ANGLE_ERR_002 : 175|7@0+ (0.01,0) [0|1.27] "rad"  ADAS
 SG_ OBJ_ID_002 : 7|8@0+ (1,0) [0|255] "NA"  ADAS
 SG_ OBJ_MOVEMENT_STATUS_002 : 196|3@0+ (1,0) [0|3] "NA"  ADAS
 SG_ OBJ_MEASUREMENT_STATUS_002 : 14|3@0+ (1,0) [0|7] "NA"  ADAS
 SG_ OBJ_POS_LONG_002 : 63|16@0+ (0.01,-327) [-327|327] "m"  ADAS
 SG_ OBJ_POS_LAT_002 : 79|16@0+ (0.01,-327) [-327|327] "m"  ADAS
 SG_ OBJ_VELOCITY_LONG_002 : 110|15@0+ (0.01,-163) [-163|163] "m/s"  ADAS
 SG_ OBJ_VELOCITY_LAT_002 : 126|15@0+ (0.01,-163) [-163|163] "m/s"  ADAS
 SG_ OBJ_ACCELERATION_LONG_002 : 193|10@0+ (0.05,-20) [-20|20] "m/s^2"  ADAS
 SG_ OBJ_ACCELERATION_LAT_002 : 177|10@0+ (0.05,-20) [-20|20] "m/s^2"  ADAS
 SG_ OBJ_VEH_TRACK_FLAG_002 : 10|1@0+ (1,0) [0|1] "NA"  ADAS
 SG_ OBJ_MH_CYCLE_COUNTER_002 : 487|8@0+ (1,0) [0|255] "NA"  ADAS
 SG_ OBJ_MH_CRC16_002 : 495|16@0+ (1,0) [0|65535] "NA"  ADAS
 SG_ OBJ_TIMESTAMP_OFFSET_002 : 247|8@0+ (1,-127) [-127|128] "ms"  ADAS
 SG_ OBJ_DIMENSION_WIDTH_ERR_002 : 23|6@0+ (0.01,0) [0|0.63] "m"  ADAS
 SG_ OBJ_DIMENSION_LENGTH_ERR_002 : 41|10@0+ (0.01,0) [0|10.23] "m"  ADAS
 SG_ OBJ_CLS_TYPE1_002 : 271|4@0+ (1,0) [0|15] "NA"  ADAS
 SG_ OBJ_CLS_TYPE1_PROB_002 : 303|8@0+ (0.004,0) [0|1] "NA"  ADAS
 SG_ OBJ_CLS_TYPE2_002 : 267|4@0+ (1,0) [0|15] "NA"  ADAS
 SG_ OBJ_CLS_TYPE2_PROB_002 : 311|8@0+ (0.004,0) [0|1] "NA"  ADAS
 SG_ OBJ_CLS_TYPE3_002 : 279|4@0+ (1,0) [0|15] "NA"  ADAS
 SG_ OBJ_CLS_TYPE3_PROB_002 : 319|8@0+ (0.004,0) [0|1] "NA"  ADAS
 SG_ OBJ_CLS_TYPE4_002 : 275|4@0+ (1,0) [0|15] "NA"  ADAS
 SG_ OBJ_CLS_TYPE4_PROB_002 : 327|8@0+ (0.004,0) [0|1] "NA"  ADAS
 SG_ OBJ_CLS_TYPE5_002 : 287|4@0+ (1,0) [0|15] "NA"  ADAS
 SG_ OBJ_CLS_TYPE5_PROB_002 : 335|8@0+ (0.004,0) [0|1] "NA"  ADAS
 SG_ OBJ_CLS_TYPE6_002 : 282|4@0+ (1,0) [0|15] "NA"  ADAS
 SG_ OBJ_CLS_TYPE6_PROB_002 : 343|8@0+ (0.004,0) [0|1] "NA"  ADAS
 SG_ OBJ_RCS_002 : 351|7@0+ (1,-64) [-64|63] "dBsm"  ADAS
 SG_ OBJ_REF_PT_LONG_OFFSET_002 : 357|14@0+ (0.0001,0) [0|1] "NA"  ADAS
 SG_ OBJ_REF_PT_LAT_OFFSET_002 : 370|14@0+ (0.0001,0) [0|1] "NA"  ADAS
 SG_ OBJ_YAW_RATE_002 : 399|10@0+ (0.005,-2.24) [-2.24|2.24] "rad/s"  ADAS
 SG_ OBJ_YAW_RATE_ERR_002 : 388|5@0+ (0.025,0) [0|0.775] "rad/s"  ADAS
 SG_ OBJ_GROUP_ID_002 : 405|6@0+ (1,0) [0|63] "NA"  ADAS
 SG_ OBJ_POS_ERR_CRR_COEF_002 : 415|8@0+ (0.01,-1.2) [-1.2|1] "NA"  ADAS
 SG_ OBJ_VELOCITY_ERR_CRR_COEF_002 : 423|8@0+ (0.01,-1.2) [-1.2|1] "NA"  ADAS
 SG_ OBJ_ACCEL_ERR_CRR_COEF_002 : 431|8@0+ (0.01,-1.2) [-1.2|1] "NA"  ADAS

BO_ 1682 RDR_TRACKER_OBJ_003: 64 RDR07
 SG_ OBJ_ALIVE_TIME_003 : 255|16@0+ (1,0) [0|65535] "ms"  ADAS
 SG_ OBJ_ACCELERATION_LONG_ERR_003 : 215|8@0+ (0.025,0) [0|6.375] "m/s^2"  ADAS
 SG_ OBJ_ACCELERATION_LAT_ERR_003 : 223|8@0+ (0.025,0) [0|6.375] "m/s^2"  ADAS
 SG_ OBJ_VELOCITY_LONG_ERR_003 : 143|8@0+ (0.05,0) [0|12.75] "m/s"  ADAS
 SG_ OBJ_VELOCITY_LAT_ERR_003 : 151|8@0+ (0.05,0) [0|12.75] "m/s"  ADAS
 SG_ OBJ_POS_LONG_ERR_003 : 95|8@0+ (0.025,0) [0|6.375] "m"  ADAS
 SG_ OBJ_POS_LAT_ERR_003 : 103|8@0+ (0.025,0) [0|6.375] "m"  ADAS
 SG_ OBJ_TRACK_MOTION_MODEL_003 : 9|2@0+ (1,0) [0|3] "NA"  ADAS
 SG_ OBJ_DIMENSION_WIDTH_003 : 17|10@0+ (0.01,0) [0|10.23] "m"  ADAS
 SG_ OBJ_DIMENSION_LENGTH_003 : 37|12@0+ (0.01,0) [0|40.95] "m"  ADAS
 SG_ OBJ_EXISTENCE_PROB_003 : 229|14@0+ (0.0001,0) [0|1] "NA"  ADAS
 SG_ OBJ_YAW_ANGLE_003 : 155|12@0+ (0.005,-10) [-10|10.475] "rad"  ADAS
 SG_ OBJ_YAW_ANGLE_ERR_003 : 175|7@0+ (0.01,0) [0|1.27] "rad"  ADAS
 SG_ OBJ_ID_003 : 7|8@0+ (1,0) [0|255] "NA"  ADAS
 SG_ OBJ_MOVEMENT_STATUS_003 : 196|3@0+ (1,0) [0|3] "NA"  ADAS
 SG_ OBJ_MEASUREMENT_STATUS_003 : 14|3@0+ (1,0) [0|7] "NA"  ADAS
 SG_ OBJ_POS_LONG_003 : 63|16@0+ (0.01,-327) [-327|327] "m"  ADAS
 SG_ OBJ_POS_LAT_003 : 79|16@0+ (0.01,-327) [-327|327] "m"  ADAS
 SG_ OBJ_VELOCITY_LONG_003 : 110|15@0+ (0.01,-163) [-163|163] "m/s"  ADAS
 SG_ OBJ_VELOCITY_LAT_003 : 126|15@0+ (0.01,-163) [-163|163] "m/s"  ADAS
 SG_ OBJ_ACCELERATION_LONG_003 : 193|10@0+ (0.05,-20) [-20|20] "m/s^2"  ADAS
 SG_ OBJ_ACCELERATION_LAT_003 : 177|10@0+ (0.05,-20) [-20|20] "m/s^2"  ADAS
 SG_ OBJ_VEH_TRACK_FLAG_003 : 10|1@0+ (1,0) [0|1] "NA"  ADAS
 SG_ OBJ_MH_CYCLE_COUNTER_003 : 487|8@0+ (1,0) [0|255] "NA"  ADAS
 SG_ OBJ_MH_CRC16_003 : 495|16@0+ (1,0) [0|65535] "NA"  ADAS
 SG_ OBJ_TIMESTAMP_OFFSET_003 : 247|8@0+ (1,-127) [-127|128] "ms"  ADAS
 SG_ OBJ_DIMENSION_WIDTH_ERR_003 : 23|6@0+ (0.01,0) [0|0.63] "m"  ADAS
 SG_ OBJ_DIMENSION_LENGTH_ERR_003 : 41|10@0+ (0.01,0) [0|10.23] "m"  ADAS
 SG_ OBJ_CLS_TYPE1_003 : 271|4@0+ (1,0) [0|15] "NA"  ADAS
 SG_ OBJ_CLS_TYPE1_PROB_003 : 303|8@0+ (0.004,0) [0|1] "NA"  ADAS
 SG_ OBJ_CLS_TYPE2_003 : 267|4@0+ (1,0) [0|15] "NA"  ADAS
 SG_ OBJ_CLS_TYPE2_PROB_003 : 311|8@0+ (0.004,0) [0|1] "NA"  ADAS
 SG_ OBJ_CLS_TYPE3_003 : 279|4@0+ (1,0) [0|15] "NA"  ADAS
 SG_ OBJ_CLS_TYPE3_PROB_003 : 319|8@0+ (0.004,0) [0|1] "NA"  ADAS
 SG_ OBJ_CLS_TYPE4_003 : 275|4@0+ (1,0) [0|15] "NA"  ADAS
 SG_ OBJ_CLS_TYPE4_PROB_003 : 327|8@0+ (0.004,0) [0|1] "NA"  ADAS
 SG_ OBJ_CLS_TYPE5_003 : 287|4@0+ (1,0) [0|15] "NA"  ADAS
 SG_ OBJ_CLS_TYPE5_PROB_003 : 335|8@0+ (0.004,0) [0|1] "NA"  ADAS
 SG_ OBJ_CLS_TYPE6_003 : 282|4@0+ (1,0) [0|15] "NA"  ADAS
 SG_ OBJ_CLS_TYPE6_PROB_003 : 343|8@0+ (0.004,0) [0|1] "NA"  ADAS
 SG_ OBJ_RCS_003 : 351|7@0+ (1,-64) [-64|63] "dBsm"  ADAS
 SG_ OBJ_REF_PT_LONG_OFFSET_003 : 357|14@0+ (0.0001,0) [0|1] "NA"  ADAS
 SG_ OBJ_REF_PT_LAT_OFFSET_003 : 370|14@0+ (0.0001,0) [0|1] "NA"  ADAS
 SG_ OBJ_YAW_RATE_003 : 399|10@0+ (0.005,-2.24) [-2.24|2.24] "rad/s"  ADAS
 SG_ OBJ_YAW_RATE_ERR_003 : 388|5@0+ (0.025,0) [0|0.775] "rad/s"  ADAS
 SG_ OBJ_GROUP_ID_003 : 405|6@0+ (1,0) [0|63] "NA"  ADAS
 SG_ OBJ_POS_ERR_CRR_COEF_003 : 415|8@0+ (0.01,-1.2) [-1.2|1] "NA"  ADAS
 SG_ OBJ_VELOCITY_ERR_CRR_COEF_003 : 423|8@0+ (0.01,-1.2) [-1.2|1] "NA"  ADAS
 SG_ OBJ_ACCEL_ERR_CRR_COEF_003 : 431|8@0+ (0.01,-1.2) [-1.2|1] "NA"  ADAS

BO_ 1683 RDR_TRACKER_OBJ_004: 64 RDR07
 SG_ OBJ_ALIVE_TIME_004 : 255|16@0+ (1,0) [0|65535] "ms"  ADAS
 SG_ OBJ_ACCELERATION_LONG_ERR_004 : 215|8@0+ (0.025,0) [0|6.375] "m/s^2"  ADAS
 SG_ OBJ_ACCELERATION_LAT_ERR_004 : 223|8@0+ (0.025,0) [0|6.375] "m/s^2"  ADAS
 SG_ OBJ_VELOCITY_LONG_ERR_004 : 143|8@0+ (0.05,0) [0|12.75] "m/s"  ADAS
 SG_ OBJ_VELOCITY_LAT_ERR_004 : 151|8@0+ (0.05,0) [0|12.75] "m/s"  ADAS
 SG_ OBJ_POS_LONG_ERR_004 : 95|8@0+ (0.025,0) [0|6.375] "m"  ADAS
 SG_ OBJ_POS_LAT_ERR_004 : 103|8@0+ (0.025,0) [0|6.375] "m"  ADAS
 SG_ OBJ_TRACK_MOTION_MODEL_004 : 9|2@0+ (1,0) [0|3] "NA"  ADAS
 SG_ OBJ_DIMENSION_WIDTH_004 : 17|10@0+ (0.01,0) [0|10.23] "m"  ADAS
 SG_ OBJ_DIMENSION_LENGTH_004 : 37|12@0+ (0.01,0) [0|40.95] "m"  ADAS
 SG_ OBJ_EXISTENCE_PROB_004 : 229|14@0+ (0.0001,0) [0|1] "NA"  ADAS
 SG_ OBJ_YAW_ANGLE_004 : 155|12@0+ (0.005,-10) [-10|10.475] "rad"  ADAS
 SG_ OBJ_YAW_ANGLE_ERR_004 : 175|7@0+ (0.01,0) [0|1.27] "rad"  ADAS
 SG_ OBJ_ID_004 : 7|8@0+ (1,0) [0|255] "NA"  ADAS
 SG_ OBJ_MOVEMENT_STATUS_004 : 196|3@0+ (1,0) [0|3] "NA"  ADAS
 SG_ OBJ_MEASUREMENT_STATUS_004 : 14|3@0+ (1,0) [0|7] "NA"  ADAS
 SG_ OBJ_POS_LONG_004 : 63|16@0+ (0.01,-327) [-327|327] "m"  ADAS
 SG_ OBJ_POS_LAT_004 : 79|16@0+ (0.01,-327) [-327|327] "m"  ADAS
 SG_ OBJ_VELOCITY_LONG_004 : 110|15@0+ (0.01,-163) [-163|163] "m/s"  ADAS
 SG_ OBJ_VELOCITY_LAT_004 : 126|15@0+ (0.01,-163) [-163|163] "m/s"  ADAS
 SG_ OBJ_ACCELERATION_LONG_004 : 193|10@0+ (0.05,-20) [-20|20] "m/s^2"  ADAS
 SG_ OBJ_ACCELERATION_LAT_004 : 177|10@0+ (0.05,-20) [-20|20] "m/s^2"  ADAS
 SG_ OBJ_VEH_TRACK_FLAG_004 : 10|1@0+ (1,0) [0|1] "NA"  ADAS
 SG_ OBJ_MH_CYCLE_COUNTER_004 : 487|8@0+ (1,0) [0|255] "NA"  ADAS
 SG_ OBJ_MH_CRC16_004 : 495|16@0+ (1,0) [0|65535] "NA"  ADAS
 SG_ OBJ_TIMESTAMP_OFFSET_004 : 247|8@0+ (1,-127) [-127|128] "ms"  ADAS
 SG_ OBJ_DIMENSION_WIDTH_ERR_004 : 23|6@0+ (0.01,0) [0|0.63] "m"  ADAS
 SG_ OBJ_DIMENSION_LENGTH_ERR_004 : 41|10@0+ (0.01,0) [0|10.23] "m"  ADAS
 SG_ OBJ_CLS_TYPE1_004 : 271|4@0+ (1,0) [0|15] "NA"  ADAS
 SG_ OBJ_CLS_TYPE1_PROB_004 : 303|8@0+ (0.004,0) [0|1] "NA"  ADAS
 SG_ OBJ_CLS_TYPE2_004 : 267|4@0+ (1,0) [0|15] "NA"  ADAS
 SG_ OBJ_CLS_TYPE2_PROB_004 : 311|8@0+ (0.004,0) [0|1] "NA"  ADAS
 SG_ OBJ_CLS_TYPE3_004 : 279|4@0+ (1,0) [0|15] "NA"  ADAS
 SG_ OBJ_CLS_TYPE3_PROB_004 : 319|8@0+ (0.004,0) [0|1] "NA"  ADAS
 SG_ OBJ_CLS_TYPE4_004 : 275|4@0+ (1,0) [0|15] "NA"  ADAS
 SG_ OBJ_CLS_TYPE4_PROB_004 : 327|8@0+ (0.004,0) [0|1] "NA"  ADAS
 SG_ OBJ_CLS_TYPE5_004 : 287|4@0+ (1,0) [0|15] "NA"  ADAS
 SG_ OBJ_CLS_TYPE5_PROB_004 : 335|8@0+ (0.004,0) [0|1] "NA"  ADAS
 SG_ OBJ_CLS_TYPE6_004 : 282|4@0+ (1,0) [0|15] "NA"  ADAS
 SG_ OBJ_CLS_TYPE6_PROB_004 : 343|8@0+ (0.004,0) [0|1] "NA"  ADAS
 SG_ OBJ_RCS_004 : 351|7@0+ (1,-64) [-64|63] "dBsm"  ADAS
 SG_ OBJ_REF_PT_LONG_OFFSET_004 : 357|14@0+ (0.0001,0) [0|1] "NA"  ADAS
 SG_ OBJ_REF_PT_LAT_OFFSET_004 : 370|14@0+ (0.0001,0) [0|1] "NA"  ADAS
 SG_ OBJ_YAW_RATE_004 : 399|10@0+ (0.005,-2.24) [-2.24|2.24] "rad/s"  ADAS
 SG_ OBJ_YAW_RATE_ERR_004 : 388|5@0+ (0.025,0) [0|0.775] "rad/s"  ADAS
 SG_ OBJ_GROUP_ID_004 : 405|6@0+ (1,0) [0|63] "NA"  ADAS
 SG_ OBJ_POS_ERR_CRR_COEF_004 : 415|8@0+ (0.01,-1.2) [-1.2|1] "NA"  ADAS
 SG_ OBJ_VELOCITY_ERR_CRR_COEF_004 : 423|8@0+ (0.01,-1.2) [-1.2|1] "NA"  ADAS
 SG_ OBJ_ACCEL_ERR_CRR_COEF_004 : 431|8@0+ (0.01,-1.2) [-1.2|1] "NA"  ADAS

BO_ 1684 RDR_TRACKER_OBJ_005: 64 RDR07
 SG_ OBJ_ALIVE_TIME_005 : 255|16@0+ (1,0) [0|65535] "ms"  ADAS
 SG_ OBJ_ACCELERATION_LONG_ERR_005 : 215|8@0+ (0.025,0) [0|6.375] "m/s^2"  ADAS
 SG_ OBJ_ACCELERATION_LAT_ERR_005 : 223|8@0+ (0.025,0) [0|6.375] "m/s^2"  ADAS
 SG_ OBJ_VELOCITY_LONG_ERR_005 : 143|8@0+ (0.05,0) [0|12.75] "m/s"  ADAS
 SG_ OBJ_VELOCITY_LAT_ERR_005 : 151|8@0+ (0.05,0) [0|12.75] "m/s"  ADAS
 SG_ OBJ_POS_LONG_ERR_005 : 95|8@0+ (0.025,0) [0|6.375] "m"  ADAS
 SG_ OBJ_POS_LAT_ERR_005 : 103|8@0+ (0.025,0) [0|6.375] "m"  ADAS
 SG_ OBJ_TRACK_MOTION_MODEL_005 : 9|2@0+ (1,0) [0|3] "NA"  ADAS
 SG_ OBJ_DIMENSION_WIDTH_005 : 17|10@0+ (0.01,0) [0|10.23] "m"  ADAS
 SG_ OBJ_DIMENSION_LENGTH_005 : 37|12@0+ (0.01,0) [0|40.95] "m"  ADAS
 SG_ OBJ_EXISTENCE_PROB_005 : 229|14@0+ (0.0001,0) [0|1] "NA"  ADAS
 SG_ OBJ_YAW_ANGLE_005 : 155|12@0+ (0.005,-10) [-10|10.475] "rad"  ADAS
 SG_ OBJ_YAW_ANGLE_ERR_005 : 175|7@0+ (0.01,0) [0|1.27] "rad"  ADAS
 SG_ OBJ_ID_005 : 7|8@0+ (1,0) [0|255] "NA"  ADAS
 SG_ OBJ_MOVEMENT_STATUS_005 : 196|3@0+ (1,0) [0|3] "NA"  ADAS
 SG_ OBJ_MEASUREMENT_STATUS_005 : 14|3@0+ (1,0) [0|7] "NA"  ADAS
 SG_ OBJ_POS_LONG_005 : 63|16@0+ (0.01,-327) [-327|327] "m"  ADAS
 SG_ OBJ_POS_LAT_005 : 79|16@0+ (0.01,-327) [-327|327] "m"  ADAS
 SG_ OBJ_VELOCITY_LONG_005 : 110|15@0+ (0.01,-163) [-163|163] "m/s"  ADAS
 SG_ OBJ_VELOCITY_LAT_005 : 126|15@0+ (0.01,-163) [-163|163] "m/s"  ADAS
 SG_ OBJ_ACCELERATION_LONG_005 : 193|10@0+ (0.05,-20) [-20|20] "m/s^2"  ADAS
 SG_ OBJ_ACCELERATION_LAT_005 : 177|10@0+ (0.05,-20) [-20|20] "m/s^2"  ADAS
 SG_ OBJ_VEH_TRACK_FLAG_005 : 10|1@0+ (1,0) [0|1] "NA"  ADAS
 SG_ OBJ_MH_CYCLE_COUNTER_005 : 487|8@0+ (1,0) [0|255] "NA"  ADAS
 SG_ OBJ_MH_CRC16_005 : 495|16@0+ (1,0) [0|65535] "NA"  ADAS
 SG_ OBJ_TIMESTAMP_OFFSET_005 : 247|8@0+ (1,-127) [-127|128] "ms"  ADAS
 SG_ OBJ_DIMENSION_WIDTH_ERR_005 : 23|6@0+ (0.01,0) [0|0.63] "m"  ADAS
 SG_ OBJ_DIMENSION_LENGTH_ERR_005 : 41|10@0+ (0.01,0) [0|10.23] "m"  ADAS
 SG_ OBJ_CLS_TYPE1_005 : 271|4@0+ (1,0) [0|15] "NA"  ADAS
 SG_ OBJ_CLS_TYPE1_PROB_005 : 303|8@0+ (0.004,0) [0|1] "NA"  ADAS
 SG_ OBJ_CLS_TYPE2_005 : 267|4@0+ (1,0) [0|15] "NA"  ADAS
 SG_ OBJ_CLS_TYPE2_PROB_005 : 311|8@0+ (0.004,0) [0|1] "NA"  ADAS
 SG_ OBJ_CLS_TYPE3_005 : 279|4@0+ (1,0) [0|15] "NA"  ADAS
 SG_ OBJ_CLS_TYPE3_PROB_005 : 319|8@0+ (0.004,0) [0|1] "NA"  ADAS
 SG_ OBJ_CLS_TYPE4_005 : 275|4@0+ (1,0) [0|15] "NA"  ADAS
 SG_ OBJ_CLS_TYPE4_PROB_005 : 327|8@0+ (0.004,0) [0|1] "NA"  ADAS
 SG_ OBJ_CLS_TYPE5_005 : 287|4@0+ (1,0) [0|15] "NA"  ADAS
 SG_ OBJ_CLS_TYPE5_PROB_005 : 335|8@0+ (0.004,0) [0|1] "NA"  ADAS
 SG_ OBJ_CLS_TYPE6_005 : 282|4@0+ (1,0) [0|15] "NA"  ADAS
 SG_ OBJ_CLS_TYPE6_PROB_005 : 343|8@0+ (0.004,0) [0|1] "NA"  ADAS
 SG_ OBJ_RCS_005 : 351|7@0+ (1,-64) [-64|63] "dBsm"  ADAS
 SG_ OBJ_REF_PT_LONG_OFFSET_005 : 357|14@0+ (0.0001,0) [0|1] "NA"  ADAS
 SG_ OBJ_REF_PT_LAT_OFFSET_005 : 370|14@0+ (0.0001,0) [0|1] "NA"  ADAS
 SG_ OBJ_YAW_RATE_005 : 399|10@0+ (0.005,-2.24) [-2.24|2.24] "rad/s"  ADAS
 SG_ OBJ_YAW_RATE_ERR_005 : 388|5@0+ (0.025,0) [0|0.775] "rad/s"  ADAS
 SG_ OBJ_GROUP_ID_005 : 405|6@0+ (1,0) [0|63] "NA"  ADAS
 SG_ OBJ_POS_ERR_CRR_COEF_005 : 415|8@0+ (0.01,-1.2) [-1.2|1] "NA"  ADAS
 SG_ OBJ_VELOCITY_ERR_CRR_COEF_005 : 423|8@0+ (0.01,-1.2) [-1.2|1] "NA"  ADAS
 SG_ OBJ_ACCEL_ERR_CRR_COEF_005 : 431|8@0+ (0.01,-1.2) [-1.2|1] "NA"  ADAS

BO_ 1685 RDR_TRACKER_OBJ_006: 64 RDR07
 SG_ OBJ_ALIVE_TIME_006 : 255|16@0+ (1,0) [0|65535] "ms"  ADAS
 SG_ OBJ_ACCELERATION_LONG_ERR_006 : 215|8@0+ (0.025,0) [0|6.375] "m/s^2"  ADAS
 SG_ OBJ_ACCELERATION_LAT_ERR_006 : 223|8@0+ (0.025,0) [0|6.375] "m/s^2"  ADAS
 SG_ OBJ_VELOCITY_LONG_ERR_006 : 143|8@0+ (0.05,0) [0|12.75] "m/s"  ADAS
 SG_ OBJ_VELOCITY_LAT_ERR_006 : 151|8@0+ (0.05,0) [0|12.75] "m/s"  ADAS
 SG_ OBJ_POS_LONG_ERR_006 : 95|8@0+ (0.025,0) [0|6.375] "m"  ADAS
 SG_ OBJ_POS_LAT_ERR_006 : 103|8@0+ (0.025,0) [0|6.375] "m"  ADAS
 SG_ OBJ_TRACK_MOTION_MODEL_006 : 9|2@0+ (1,0) [0|3] "NA"  ADAS
 SG_ OBJ_DIMENSION_WIDTH_006 : 17|10@0+ (0.01,0) [0|10.23] "m"  ADAS
 SG_ OBJ_DIMENSION_LENGTH_006 : 37|12@0+ (0.01,0) [0|40.95] "m"  ADAS
 SG_ OBJ_EXISTENCE_PROB_006 : 229|14@0+ (0.0001,0) [0|1] "NA"  ADAS
 SG_ OBJ_YAW_ANGLE_006 : 155|12@0+ (0.005,-10) [-10|10.475] "rad"  ADAS
 SG_ OBJ_YAW_ANGLE_ERR_006 : 175|7@0+ (0.01,0) [0|1.27] "rad"  ADAS
 SG_ OBJ_ID_006 : 7|8@0+ (1,0) [0|255] "NA"  ADAS
 SG_ OBJ_MOVEMENT_STATUS_006 : 196|3@0+ (1,0) [0|3] "NA"  ADAS
 SG_ OBJ_MEASUREMENT_STATUS_006 : 14|3@0+ (1,0) [0|7] "NA"  ADAS
 SG_ OBJ_POS_LONG_006 : 63|16@0+ (0.01,-327) [-327|327] "m"  ADAS
 SG_ OBJ_POS_LAT_006 : 79|16@0+ (0.01,-327) [-327|327] "m"  ADAS
 SG_ OBJ_VELOCITY_LONG_006 : 110|15@0+ (0.01,-163) [-163|163] "m/s"  ADAS
 SG_ OBJ_VELOCITY_LAT_006 : 126|15@0+ (0.01,-163) [-163|163] "m/s"  ADAS
 SG_ OBJ_ACCELERATION_LONG_006 : 193|10@0+ (0.05,-20) [-20|20] "m/s^2"  ADAS
 SG_ OBJ_ACCELERATION_LAT_006 : 177|10@0+ (0.05,-20) [-20|20] "m/s^2"  ADAS
 SG_ OBJ_VEH_TRACK_FLAG_006 : 10|1@0+ (1,0) [0|1] "NA"  ADAS
 SG_ OBJ_MH_CYCLE_COUNTER_006 : 487|8@0+ (1,0) [0|255] "NA"  ADAS
 SG_ OBJ_MH_CRC16_006 : 495|16@0+ (1,0) [0|65535] "NA"  ADAS
 SG_ OBJ_TIMESTAMP_OFFSET_006 : 247|8@0+ (1,-127) [-127|128] "ms"  ADAS
 SG_ OBJ_DIMENSION_WIDTH_ERR_006 : 23|6@0+ (0.01,0) [0|0.63] "m"  ADAS
 SG_ OBJ_DIMENSION_LENGTH_ERR_006 : 41|10@0+ (0.01,0) [0|10.23] "m"  ADAS
 SG_ OBJ_CLS_TYPE1_006 : 271|4@0+ (1,0) [0|15] "NA"  ADAS
 SG_ OBJ_CLS_TYPE1_PROB_006 : 303|8@0+ (0.004,0) [0|1] "NA"  ADAS
 SG_ OBJ_CLS_TYPE2_006 : 267|4@0+ (1,0) [0|15] "NA"  ADAS
 SG_ OBJ_CLS_TYPE2_PROB_006 : 311|8@0+ (0.004,0) [0|1] "NA"  ADAS
 SG_ OBJ_CLS_TYPE3_006 : 279|4@0+ (1,0) [0|15] "NA"  ADAS
 SG_ OBJ_CLS_TYPE3_PROB_006 : 319|8@0+ (0.004,0) [0|1] "NA"  ADAS
 SG_ OBJ_CLS_TYPE4_006 : 275|4@0+ (1,0) [0|15] "NA"  ADAS
 SG_ OBJ_CLS_TYPE4_PROB_006 : 327|8@0+ (0.004,0) [0|1] "NA"  ADAS
 SG_ OBJ_CLS_TYPE5_006 : 287|4@0+ (1,0) [0|15] "NA"  ADAS
 SG_ OBJ_CLS_TYPE5_PROB_006 : 335|8@0+ (0.004,0) [0|1] "NA"  ADAS
 SG_ OBJ_CLS_TYPE6_006 : 282|4@0+ (1,0) [0|15] "NA"  ADAS
 SG_ OBJ_CLS_TYPE6_PROB_006 : 343|8@0+ (0.004,0) [0|1] "NA"  ADAS
 SG_ OBJ_RCS_006 : 351|7@0+ (1,-64) [-64|63] "dBsm"  ADAS
 SG_ OBJ_REF_PT_LONG_OFFSET_006 : 357|14@0+ (0.0001,0) [0|1] "NA"  ADAS
 SG_ OBJ_REF_PT_LAT_OFFSET_006 : 370|14@0+ (0.0001,0) [0|1] "NA"  ADAS
 SG_ OBJ_YAW_RATE_006 : 399|10@0+ (0.005,-2.24) [-2.24|2.24] "rad/s"  ADAS
 SG_ OBJ_YAW_RATE_ERR_006 : 388|5@0+ (0.025,0) [0|0.775] "rad/s"  ADAS
 SG_ OBJ_GROUP_ID_006 : 405|6@0+ (1,0) [0|63] "NA"  ADAS
 SG_ OBJ_POS_ERR_CRR_COEF_006 : 415|8@0+ (0.01,-1.2) [-1.2|1] "NA"  ADAS
 SG_ OBJ_VELOCITY_ERR_CRR_COEF_006 : 423|8@0+ (0.01,-1.2) [-1.2|1] "NA"  ADAS
 SG_ OBJ_ACCEL_ERR_CRR_COEF_006 : 431|8@0+ (0.01,-1.2) [-1.2|1] "NA"  ADAS

BO_ 1686 RDR_TRACKER_OBJ_007: 64 RDR07
 SG_ OBJ_ALIVE_TIME_007 : 255|16@0+ (1,0) [0|65535] "ms"  ADAS
 SG_ OBJ_ACCELERATION_LONG_ERR_007 : 215|8@0+ (0.025,0) [0|6.375] "m/s^2"  ADAS
 SG_ OBJ_ACCELERATION_LAT_ERR_007 : 223|8@0+ (0.025,0) [0|6.375] "m/s^2"  ADAS
 SG_ OBJ_VELOCITY_LONG_ERR_007 : 143|8@0+ (0.05,0) [0|12.75] "m/s"  ADAS
 SG_ OBJ_VELOCITY_LAT_ERR_007 : 151|8@0+ (0.05,0) [0|12.75] "m/s"  ADAS
 SG_ OBJ_POS_LONG_ERR_007 : 95|8@0+ (0.025,0) [0|6.375] "m"  ADAS
 SG_ OBJ_POS_LAT_ERR_007 : 103|8@0+ (0.025,0) [0|6.375] "m"  ADAS
 SG_ OBJ_TRACK_MOTION_MODEL_007 : 9|2@0+ (1,0) [0|3] "NA"  ADAS
 SG_ OBJ_DIMENSION_WIDTH_007 : 17|10@0+ (0.01,0) [0|10.23] "m"  ADAS
 SG_ OBJ_DIMENSION_LENGTH_007 : 37|12@0+ (0.01,0) [0|40.95] "m"  ADAS
 SG_ OBJ_EXISTENCE_PROB_007 : 229|14@0+ (0.0001,0) [0|1] "NA"  ADAS
 SG_ OBJ_YAW_ANGLE_007 : 155|12@0+ (0.005,-10) [-10|10.475] "rad"  ADAS
 SG_ OBJ_YAW_ANGLE_ERR_007 : 175|7@0+ (0.01,0) [0|1.27] "rad"  ADAS
 SG_ OBJ_ID_007 : 7|8@0+ (1,0) [0|255] "NA"  ADAS
 SG_ OBJ_MOVEMENT_STATUS_007 : 196|3@0+ (1,0) [0|3] "NA"  ADAS
 SG_ OBJ_MEASUREMENT_STATUS_007 : 14|3@0+ (1,0) [0|7] "NA"  ADAS
 SG_ OBJ_POS_LONG_007 : 63|16@0+ (0.01,-327) [-327|327] "m"  ADAS
 SG_ OBJ_POS_LAT_007 : 79|16@0+ (0.01,-327) [-327|327] "m"  ADAS
 SG_ OBJ_VELOCITY_LONG_007 : 110|15@0+ (0.01,-163) [-163|163] "m/s"  ADAS
 SG_ OBJ_VELOCITY_LAT_007 : 126|15@0+ (0.01,-163) [-163|163] "m/s"  ADAS
 SG_ OBJ_ACCELERATION_LONG_007 : 193|10@0+ (0.05,-20) [-20|20] "m/s^2"  ADAS
 SG_ OBJ_ACCELERATION_LAT_007 : 177|10@0+ (0.05,-20) [-20|20] "m/s^2"  ADAS
 SG_ OBJ_VEH_TRACK_FLAG_007 : 10|1@0+ (1,0) [0|1] "NA"  ADAS
 SG_ OBJ_MH_CYCLE_COUNTER_007 : 487|8@0+ (1,0) [0|255] "NA"  ADAS
 SG_ OBJ_MH_CRC16_007 : 495|16@0+ (1,0) [0|65535] "NA"  ADAS
 SG_ OBJ_TIMESTAMP_OFFSET_007 : 247|8@0+ (1,-127) [-127|128] "ms"  ADAS
 SG_ OBJ_DIMENSION_WIDTH_ERR_007 : 23|6@0+ (0.01,0) [0|0.63] "m"  ADAS
 SG_ OBJ_DIMENSION_LENGTH_ERR_007 : 41|10@0+ (0.01,0) [0|10.23] "m"  ADAS
 SG_ OBJ_CLS_TYPE1_007 : 271|4@0+ (1,0) [0|15] "NA"  ADAS
 SG_ OBJ_CLS_TYPE1_PROB_007 : 303|8@0+ (0.004,0) [0|1] "NA"  ADAS
 SG_ OBJ_CLS_TYPE2_007 : 267|4@0+ (1,0) [0|15] "NA"  ADAS
 SG_ OBJ_CLS_TYPE2_PROB_007 : 311|8@0+ (0.004,0) [0|1] "NA"  ADAS
 SG_ OBJ_CLS_TYPE3_007 : 279|4@0+ (1,0) [0|15] "NA"  ADAS
 SG_ OBJ_CLS_TYPE3_PROB_007 : 319|8@0+ (0.004,0) [0|1] "NA"  ADAS
 SG_ OBJ_CLS_TYPE4_007 : 275|4@0+ (1,0) [0|15] "NA"  ADAS
 SG_ OBJ_CLS_TYPE4_PROB_007 : 327|8@0+ (0.004,0) [0|1] "NA"  ADAS
 SG_ OBJ_CLS_TYPE5_007 : 287|4@0+ (1,0) [0|15] "NA"  ADAS
 SG_ OBJ_CLS_TYPE5_PROB_007 : 335|8@0+ (0.004,0) [0|1] "NA"  ADAS
 SG_ OBJ_CLS_TYPE6_007 : 282|4@0+ (1,0) [0|15] "NA"  ADAS
 SG_ OBJ_CLS_TYPE6_PROB_007 : 343|8@0+ (0.004,0) [0|1] "NA"  ADAS
 SG_ OBJ_RCS_007 : 351|7@0+ (1,-64) [-64|63] "dBsm"  ADAS
 SG_ OBJ_REF_PT_LONG_OFFSET_007 : 357|14@0+ (0.0001,0) [0|1] "NA"  ADAS
 SG_ OBJ_REF_PT_LAT_OFFSET_007 : 370|14@0+ (0.0001,0) [0|1] "NA"  ADAS
 SG_ OBJ_YAW_RATE_007 : 399|10@0+ (0.005,-2.24) [-2.24|2.24] "rad/s"  ADAS
 SG_ OBJ_YAW_RATE_ERR_007 : 388|5@0+ (0.025,0) [0|0.775] "rad/s"  ADAS
 SG_ OBJ_GROUP_ID_007 : 405|6@0+ (1,0) [0|63] "NA"  ADAS
 SG_ OBJ_POS_ERR_CRR_COEF_007 : 415|8@0+ (0.01,-1.2) [-1.2|1] "NA"  ADAS
 SG_ OBJ_VELOCITY_ERR_CRR_COEF_007 : 423|8@0+ (0.01,-1.2) [-1.2|1] "NA"  ADAS
 SG_ OBJ_ACCEL_ERR_CRR_COEF_007 : 431|8@0+ (0.01,-1.2) [-1.2|1] "NA"  ADAS

BO_ 1687 RDR_TRACKER_OBJ_008: 64 RDR07
 SG_ OBJ_ALIVE_TIME_008 : 255|16@0+ (1,0) [0|65535] "ms"  ADAS
 SG_ OBJ_ACCELERATION_LONG_ERR_008 : 215|8@0+ (0.025,0) [0|6.375] "m/s^2"  ADAS
 SG_ OBJ_ACCELERATION_LAT_ERR_008 : 223|8@0+ (0.025,0) [0|6.375] "m/s^2"  ADAS
 SG_ OBJ_VELOCITY_LONG_ERR_008 : 143|8@0+ (0.05,0) [0|12.75] "m/s"  ADAS
 SG_ OBJ_VELOCITY_LAT_ERR_008 : 151|8@0+ (0.05,0) [0|12.75] "m/s"  ADAS
 SG_ OBJ_POS_LONG_ERR_008 : 95|8@0+ (0.025,0) [0|6.375] "m"  ADAS
 SG_ OBJ_POS_LAT_ERR_008 : 103|8@0+ (0.025,0) [0|6.375] "m"  ADAS
 SG_ OBJ_TRACK_MOTION_MODEL_008 : 9|2@0+ (1,0) [0|3] "NA"  ADAS
 SG_ OBJ_DIMENSION_WIDTH_008 : 17|10@0+ (0.01,0) [0|10.23] "m"  ADAS
 SG_ OBJ_DIMENSION_LENGTH_008 : 37|12@0+ (0.01,0) [0|40.95] "m"  ADAS
 SG_ OBJ_EXISTENCE_PROB_008 : 229|14@0+ (0.0001,0) [0|1] "NA"  ADAS
 SG_ OBJ_YAW_ANGLE_008 : 155|12@0+ (0.005,-10) [-10|10.475] "rad"  ADAS
 SG_ OBJ_YAW_ANGLE_ERR_008 : 175|7@0+ (0.01,0) [0|1.27] "rad"  ADAS
 SG_ OBJ_ID_008 : 7|8@0+ (1,0) [0|255] "NA"  ADAS
 SG_ OBJ_MOVEMENT_STATUS_008 : 196|3@0+ (1,0) [0|3] "NA"  ADAS
 SG_ OBJ_MEASUREMENT_STATUS_008 : 14|3@0+ (1,0) [0|7] "NA"  ADAS
 SG_ OBJ_POS_LONG_008 : 63|16@0+ (0.01,-327) [-327|327] "m"  ADAS
 SG_ OBJ_POS_LAT_008 : 79|16@0+ (0.01,-327) [-327|327] "m"  ADAS
 SG_ OBJ_VELOCITY_LONG_008 : 110|15@0+ (0.01,-163) [-163|163] "m/s"  ADAS
 SG_ OBJ_VELOCITY_LAT_008 : 126|15@0+ (0.01,-163) [-163|163] "m/s"  ADAS
 SG_ OBJ_ACCELERATION_LONG_008 : 193|10@0+ (0.05,-20) [-20|20] "m/s^2"  ADAS
 SG_ OBJ_ACCELERATION_LAT_008 : 177|10@0+ (0.05,-20) [-20|20] "m/s^2"  ADAS
 SG_ OBJ_VEH_TRACK_FLAG_008 : 10|1@0+ (1,0) [0|1] "NA"  ADAS
 SG_ OBJ_MH_CYCLE_COUNTER_008 : 487|8@0+ (1,0) [0|255] "NA"  ADAS
 SG_ OBJ_MH_CRC16_008 : 495|16@0+ (1,0) [0|65535] "NA"  ADAS
 SG_ OBJ_TIMESTAMP_OFFSET_008 : 247|8@0+ (1,-127) [-127|128] "ms"  ADAS
 SG_ OBJ_DIMENSION_WIDTH_ERR_008 : 23|6@0+ (0.01,0) [0|0.63] "m"  ADAS
 SG_ OBJ_DIMENSION_LENGTH_ERR_008 : 41|10@0+ (0.01,0) [0|10.23] "m"  ADAS
 SG_ OBJ_CLS_TYPE1_008 : 271|4@0+ (1,0) [0|15] "NA"  ADAS
 SG_ OBJ_CLS_TYPE1_PROB_008 : 303|8@0+ (0.004,0) [0|1] "NA"  ADAS
 SG_ OBJ_CLS_TYPE2_008 : 267|4@0+ (1,0) [0|15] "NA"  ADAS
 SG_ OBJ_CLS_TYPE2_PROB_008 : 311|8@0+ (0.004,0) [0|1] "NA"  ADAS
 SG_ OBJ_CLS_TYPE3_008 : 279|4@0+ (1,0) [0|15] "NA"  ADAS
 SG_ OBJ_CLS_TYPE3_PROB_008 : 319|8@0+ (0.004,0) [0|1] "NA"  ADAS
 SG_ OBJ_CLS_TYPE4_008 : 275|4@0+ (1,0) [0|15] "NA"  ADAS
 SG_ OBJ_CLS_TYPE4_PROB_008 : 327|8@0+ (0.004,0) [0|1] "NA"  ADAS
 SG_ OBJ_CLS_TYPE5_008 : 287|4@0+ (1,0) [0|15] "NA"  ADAS
 SG_ OBJ_CLS_TYPE5_PROB_008 : 335|8@0+ (0.004,0) [0|1] "NA"  ADAS
 SG_ OBJ_CLS_TYPE6_008 : 282|4@0+ (1,0) [0|15] "NA"  ADAS
 SG_ OBJ_CLS_TYPE6_PROB_008 : 343|8@0+ (0.004,0) [0|1] "NA"  ADAS
 SG_ OBJ_RCS_008 : 351|7@0+ (1,-64) [-64|63] "dBsm"  ADAS
 SG_ OBJ_REF_PT_LONG_OFFSET_008 : 357|14@0+ (0.0001,0) [0|1] "NA"  ADAS
 SG_ OBJ_REF_PT_LAT_OFFSET_008 : 370|14@0+ (0.0001,0) [0|1] "NA"  ADAS
 SG_ OBJ_YAW_RATE_008 : 399|10@0+ (0.005,-2.24) [-2.24|2.24] "rad/s"  ADAS
 SG_ OBJ_YAW_RATE_ERR_008 : 388|5@0+ (0.025,0) [0|0.775] "rad/s"  ADAS
 SG_ OBJ_GROUP_ID_008 : 405|6@0+ (1,0) [0|63] "NA"  ADAS
 SG_ OBJ_POS_ERR_CRR_COEF_008 : 415|8@0+ (0.01,-1.2) [-1.2|1] "NA"  ADAS
 SG_ OBJ_VELOCITY_ERR_CRR_COEF_008 : 423|8@0+ (0.01,-1.2) [-1.2|1] "NA"  ADAS
 SG_ OBJ_ACCEL_ERR_CRR_COEF_008 : 431|8@0+ (0.01,-1.2) [-1.2|1] "NA"  ADAS

BO_ 1688 RDR_TRACKER_OBJ_009: 64 RDR07
 SG_ OBJ_ALIVE_TIME_009 : 255|16@0+ (1,0) [0|65535] "ms"  ADAS
 SG_ OBJ_ACCELERATION_LONG_ERR_009 : 215|8@0+ (0.025,0) [0|6.375] "m/s^2"  ADAS
 SG_ OBJ_ACCELERATION_LAT_ERR_009 : 223|8@0+ (0.025,0) [0|6.375] "m/s^2"  ADAS
 SG_ OBJ_VELOCITY_LONG_ERR_009 : 143|8@0+ (0.05,0) [0|12.75] "m/s"  ADAS
 SG_ OBJ_VELOCITY_LAT_ERR_009 : 151|8@0+ (0.05,0) [0|12.75] "m/s"  ADAS
 SG_ OBJ_POS_LONG_ERR_009 : 95|8@0+ (0.025,0) [0|6.375] "m"  ADAS
 SG_ OBJ_POS_LAT_ERR_009 : 103|8@0+ (0.025,0) [0|6.375] "m"  ADAS
 SG_ OBJ_TRACK_MOTION_MODEL_009 : 9|2@0+ (1,0) [0|3] "NA"  ADAS
 SG_ OBJ_DIMENSION_WIDTH_009 : 17|10@0+ (0.01,0) [0|10.23] "m"  ADAS
 SG_ OBJ_DIMENSION_LENGTH_009 : 37|12@0+ (0.01,0) [0|40.95] "m"  ADAS
 SG_ OBJ_EXISTENCE_PROB_009 : 229|14@0+ (0.0001,0) [0|1] "NA"  ADAS
 SG_ OBJ_YAW_ANGLE_009 : 155|12@0+ (0.005,-10) [-10|10.475] "rad"  ADAS
 SG_ OBJ_YAW_ANGLE_ERR_009 : 175|7@0+ (0.01,0) [0|1.27] "rad"  ADAS
 SG_ OBJ_ID_009 : 7|8@0+ (1,0) [0|255] "NA"  ADAS
 SG_ OBJ_MOVEMENT_STATUS_009 : 196|3@0+ (1,0) [0|3] "NA"  ADAS
 SG_ OBJ_MEASUREMENT_STATUS_009 : 14|3@0+ (1,0) [0|7] "NA"  ADAS
 SG_ OBJ_POS_LONG_009 : 63|16@0+ (0.01,-327) [-327|327] "m"  ADAS
 SG_ OBJ_POS_LAT_009 : 79|16@0+ (0.01,-327) [-327|327] "m"  ADAS
 SG_ OBJ_VELOCITY_LONG_009 : 110|15@0+ (0.01,-163) [-163|163] "m/s"  ADAS
 SG_ OBJ_VELOCITY_LAT_009 : 126|15@0+ (0.01,-163) [-163|163] "m/s"  ADAS
 SG_ OBJ_ACCELERATION_LONG_009 : 193|10@0+ (0.05,-20) [-20|20] "m/s^2"  ADAS
 SG_ OBJ_ACCELERATION_LAT_009 : 177|10@0+ (0.05,-20) [-20|20] "m/s^2"  ADAS
 SG_ OBJ_VEH_TRACK_FLAG_009 : 10|1@0+ (1,0) [0|1] "NA"  ADAS
 SG_ OBJ_MH_CYCLE_COUNTER_009 : 487|8@0+ (1,0) [0|255] "NA"  ADAS
 SG_ OBJ_MH_CRC16_009 : 495|16@0+ (1,0) [0|65535] "NA"  ADAS
 SG_ OBJ_TIMESTAMP_OFFSET_009 : 247|8@0+ (1,-127) [-127|128] "ms"  ADAS
 SG_ OBJ_DIMENSION_WIDTH_ERR_009 : 23|6@0+ (0.01,0) [0|0.63] "m"  ADAS
 SG_ OBJ_DIMENSION_LENGTH_ERR_009 : 41|10@0+ (0.01,0) [0|10.23] "m"  ADAS
 SG_ OBJ_CLS_TYPE1_009 : 271|4@0+ (1,0) [0|15] "NA"  ADAS
 SG_ OBJ_CLS_TYPE1_PROB_009 : 303|8@0+ (0.004,0) [0|1] "NA"  ADAS
 SG_ OBJ_CLS_TYPE2_009 : 267|4@0+ (1,0) [0|15] "NA"  ADAS
 SG_ OBJ_CLS_TYPE2_PROB_009 : 311|8@0+ (0.004,0) [0|1] "NA"  ADAS
 SG_ OBJ_CLS_TYPE3_009 : 279|4@0+ (1,0) [0|15] "NA"  ADAS
 SG_ OBJ_CLS_TYPE3_PROB_009 : 319|8@0+ (0.004,0) [0|1] "NA"  ADAS
 SG_ OBJ_CLS_TYPE4_009 : 275|4@0+ (1,0) [0|15] "NA"  ADAS
 SG_ OBJ_CLS_TYPE4_PROB_009 : 327|8@0+ (0.004,0) [0|1] "NA"  ADAS
 SG_ OBJ_CLS_TYPE5_009 : 287|4@0+ (1,0) [0|15] "NA"  ADAS
 SG_ OBJ_CLS_TYPE5_PROB_009 : 335|8@0+ (0.004,0) [0|1] "NA"  ADAS
 SG_ OBJ_CLS_TYPE6_009 : 282|4@0+ (1,0) [0|15] "NA"  ADAS
 SG_ OBJ_CLS_TYPE6_PROB_009 : 343|8@0+ (0.004,0) [0|1] "NA"  ADAS
 SG_ OBJ_RCS_009 : 351|7@0+ (1,-64) [-64|63] "dBsm"  ADAS
 SG_ OBJ_REF_PT_LONG_OFFSET_009 : 357|14@0+ (0.0001,0) [0|1] "NA"  ADAS
 SG_ OBJ_REF_PT_LAT_OFFSET_009 : 370|14@0+ (0.0001,0) [0|1] "NA"  ADAS
 SG_ OBJ_YAW_RATE_009 : 399|10@0+ (0.005,-2.24) [-2.24|2.24] "rad/s"  ADAS
 SG_ OBJ_YAW_RATE_ERR_009 : 388|5@0+ (0.025,0) [0|0.775] "rad/s"  ADAS
 SG_ OBJ_GROUP_ID_009 : 405|6@0+ (1,0) [0|63] "NA"  ADAS
 SG_ OBJ_POS_ERR_CRR_COEF_009 : 415|8@0+ (0.01,-1.2) [-1.2|1] "NA"  ADAS
 SG_ OBJ_VELOCITY_ERR_CRR_COEF_009 : 423|8@0+ (0.01,-1.2) [-1.2|1] "NA"  ADAS
 SG_ OBJ_ACCEL_ERR_CRR_COEF_009 : 431|8@0+ (0.01,-1.2) [-1.2|1] "NA"  ADAS

BO_ 1689 RDR_TRACKER_OBJ_010: 64 RDR07
 SG_ OBJ_ALIVE_TIME_010 : 255|16@0+ (1,0) [0|65535] "ms"  ADAS
 SG_ OBJ_ACCELERATION_LONG_ERR_010 : 215|8@0+ (0.025,0) [0|6.375] "m/s^2"  ADAS
 SG_ OBJ_ACCELERATION_LAT_ERR_010 : 223|8@0+ (0.025,0) [0|6.375] "m/s^2"  ADAS
 SG_ OBJ_VELOCITY_LONG_ERR_010 : 143|8@0+ (0.05,0) [0|12.75] "m/s"  ADAS
 SG_ OBJ_VELOCITY_LAT_ERR_010 : 151|8@0+ (0.05,0) [0|12.75] "m/s"  ADAS
 SG_ OBJ_POS_LONG_ERR_010 : 95|8@0+ (0.025,0) [0|6.375] "m"  ADAS
 SG_ OBJ_POS_LAT_ERR_010 : 103|8@0+ (0.025,0) [0|6.375] "m"  ADAS
 SG_ OBJ_TRACK_MOTION_MODEL_010 : 9|2@0+ (1,0) [0|3] "NA"  ADAS
 SG_ OBJ_DIMENSION_WIDTH_010 : 17|10@0+ (0.01,0) [0|10.23] "m"  ADAS
 SG_ OBJ_DIMENSION_LENGTH_010 : 37|12@0+ (0.01,0) [0|40.95] "m"  ADAS
 SG_ OBJ_EXISTENCE_PROB_010 : 229|14@0+ (0.0001,0) [0|1] "NA"  ADAS
 SG_ OBJ_YAW_ANGLE_010 : 155|12@0+ (0.005,-10) [-10|10.475] "rad"  ADAS
 SG_ OBJ_YAW_ANGLE_ERR_010 : 175|7@0+ (0.01,0) [0|1.27] "rad"  ADAS
 SG_ OBJ_ID_010 : 7|8@0+ (1,0) [0|255] "NA"  ADAS
 SG_ OBJ_MOVEMENT_STATUS_010 : 196|3@0+ (1,0) [0|3] "NA"  ADAS
 SG_ OBJ_MEASUREMENT_STATUS_010 : 14|3@0+ (1,0) [0|7] "NA"  ADAS
 SG_ OBJ_POS_LONG_010 : 63|16@0+ (0.01,-327) [-327|327] "m"  ADAS
 SG_ OBJ_POS_LAT_010 : 79|16@0+ (0.01,-327) [-327|327] "m"  ADAS
 SG_ OBJ_VELOCITY_LONG_010 : 110|15@0+ (0.01,-163) [-163|163] "m/s"  ADAS
 SG_ OBJ_VELOCITY_LAT_010 : 126|15@0+ (0.01,-163) [-163|163] "m/s"  ADAS
 SG_ OBJ_ACCELERATION_LONG_010 : 193|10@0+ (0.05,-20) [-20|20] "m/s^2"  ADAS
 SG_ OBJ_ACCELERATION_LAT_010 : 177|10@0+ (0.05,-20) [-20|20] "m/s^2"  ADAS
 SG_ OBJ_VEH_TRACK_FLAG_010 : 10|1@0+ (1,0) [0|1] "NA"  ADAS
 SG_ OBJ_MH_CYCLE_COUNTER_010 : 487|8@0+ (1,0) [0|255] "NA"  ADAS
 SG_ OBJ_MH_CRC16_010 : 495|16@0+ (1,0) [0|65535] "NA"  ADAS
 SG_ OBJ_TIMESTAMP_OFFSET_010 : 247|8@0+ (1,-127) [-127|128] "ms"  ADAS
 SG_ OBJ_DIMENSION_WIDTH_ERR_010 : 23|6@0+ (0.01,0) [0|0.63] "m"  ADAS
 SG_ OBJ_DIMENSION_LENGTH_ERR_010 : 41|10@0+ (0.01,0) [0|10.23] "m"  ADAS
 SG_ OBJ_CLS_TYPE1_010 : 271|4@0+ (1,0) [0|15] "NA"  ADAS
 SG_ OBJ_CLS_TYPE1_PROB_010 : 303|8@0+ (0.004,0) [0|1] "NA"  ADAS
 SG_ OBJ_CLS_TYPE2_010 : 267|4@0+ (1,0) [0|15] "NA"  ADAS
 SG_ OBJ_CLS_TYPE2_PROB_010 : 311|8@0+ (0.004,0) [0|1] "NA"  ADAS
 SG_ OBJ_CLS_TYPE3_010 : 279|4@0+ (1,0) [0|15] "NA"  ADAS
 SG_ OBJ_CLS_TYPE3_PROB_010 : 319|8@0+ (0.004,0) [0|1] "NA"  ADAS
 SG_ OBJ_CLS_TYPE4_010 : 275|4@0+ (1,0) [0|15] "NA"  ADAS
 SG_ OBJ_CLS_TYPE4_PROB_010 : 327|8@0+ (0.004,0) [0|1] "NA"  ADAS
 SG_ OBJ_CLS_TYPE5_010 : 287|4@0+ (1,0) [0|15] "NA"  ADAS
 SG_ OBJ_CLS_TYPE5_PROB_010 : 335|8@0+ (0.004,0) [0|1] "NA"  ADAS
 SG_ OBJ_CLS_TYPE6_010 : 282|4@0+ (1,0) [0|15] "NA"  ADAS
 SG_ OBJ_CLS_TYPE6_PROB_010 : 343|8@0+ (0.004,0) [0|1] "NA"  ADAS
 SG_ OBJ_RCS_010 : 351|7@0+ (1,-64) [-64|63] "dBsm"  ADAS
 SG_ OBJ_REF_PT_LONG_OFFSET_010 : 357|14@0+ (0.0001,0) [0|1] "NA"  ADAS
 SG_ OBJ_REF_PT_LAT_OFFSET_010 : 370|14@0+ (0.0001,0) [0|1] "NA"  ADAS
 SG_ OBJ_YAW_RATE_010 : 399|10@0+ (0.005,-2.24) [-2.24|2.24] "rad/s"  ADAS
 SG_ OBJ_YAW_RATE_ERR_010 : 388|5@0+ (0.025,0) [0|0.775] "rad/s"  ADAS
 SG_ OBJ_GROUP_ID_010 : 405|6@0+ (1,0) [0|63] "NA"  ADAS
 SG_ OBJ_POS_ERR_CRR_COEF_010 : 415|8@0+ (0.01,-1.2) [-1.2|1] "NA"  ADAS
 SG_ OBJ_VELOCITY_ERR_CRR_COEF_010 : 423|8@0+ (0.01,-1.2) [-1.2|1] "NA"  ADAS
 SG_ OBJ_ACCEL_ERR_CRR_COEF_010 : 431|8@0+ (0.01,-1.2) [-1.2|1] "NA"  ADAS

BO_ 1690 RDR_TRACKER_OBJ_011: 64 RDR07
 SG_ OBJ_ALIVE_TIME_011 : 255|16@0+ (1,0) [0|65535] "ms"  ADAS
 SG_ OBJ_ACCELERATION_LONG_ERR_011 : 215|8@0+ (0.025,0) [0|6.375] "m/s^2"  ADAS
 SG_ OBJ_ACCELERATION_LAT_ERR_011 : 223|8@0+ (0.025,0) [0|6.375] "m/s^2"  ADAS
 SG_ OBJ_VELOCITY_LONG_ERR_011 : 143|8@0+ (0.05,0) [0|12.75] "m/s"  ADAS
 SG_ OBJ_VELOCITY_LAT_ERR_011 : 151|8@0+ (0.05,0) [0|12.75] "m/s"  ADAS
 SG_ OBJ_POS_LONG_ERR_011 : 95|8@0+ (0.025,0) [0|6.375] "m"  ADAS
 SG_ OBJ_POS_LAT_ERR_011 : 103|8@0+ (0.025,0) [0|6.375] "m"  ADAS
 SG_ OBJ_TRACK_MOTION_MODEL_011 : 9|2@0+ (1,0) [0|3] "NA"  ADAS
 SG_ OBJ_DIMENSION_WIDTH_011 : 17|10@0+ (0.01,0) [0|10.23] "m"  ADAS
 SG_ OBJ_DIMENSION_LENGTH_011 : 37|12@0+ (0.01,0) [0|40.95] "m"  ADAS
 SG_ OBJ_EXISTENCE_PROB_011 : 229|14@0+ (0.0001,0) [0|1] "NA"  ADAS
 SG_ OBJ_YAW_ANGLE_011 : 155|12@0+ (0.005,-10) [-10|10.475] "rad"  ADAS
 SG_ OBJ_YAW_ANGLE_ERR_011 : 175|7@0+ (0.01,0) [0|1.27] "rad"  ADAS
 SG_ OBJ_ID_011 : 7|8@0+ (1,0) [0|255] "NA"  ADAS
 SG_ OBJ_MOVEMENT_STATUS_011 : 196|3@0+ (1,0) [0|3] "NA"  ADAS
 SG_ OBJ_MEASUREMENT_STATUS_011 : 14|3@0+ (1,0) [0|7] "NA"  ADAS
 SG_ OBJ_POS_LONG_011 : 63|16@0+ (0.01,-327) [-327|327] "m"  ADAS
 SG_ OBJ_POS_LAT_011 : 79|16@0+ (0.01,-327) [-327|327] "m"  ADAS
 SG_ OBJ_VELOCITY_LONG_011 : 110|15@0+ (0.01,-163) [-163|163] "m/s"  ADAS
 SG_ OBJ_VELOCITY_LAT_011 : 126|15@0+ (0.01,-163) [-163|163] "m/s"  ADAS
 SG_ OBJ_ACCELERATION_LONG_011 : 193|10@0+ (0.05,-20) [-20|20] "m/s^2"  ADAS
 SG_ OBJ_ACCELERATION_LAT_011 : 177|10@0+ (0.05,-20) [-20|20] "m/s^2"  ADAS
 SG_ OBJ_VEH_TRACK_FLAG_011 : 10|1@0+ (1,0) [0|1] "NA"  ADAS
 SG_ OBJ_MH_CYCLE_COUNTER_011 : 487|8@0+ (1,0) [0|255] "NA"  ADAS
 SG_ OBJ_MH_CRC16_011 : 495|16@0+ (1,0) [0|65535] "NA"  ADAS
 SG_ OBJ_TIMESTAMP_OFFSET_011 : 247|8@0+ (1,-127) [-127|128] "ms"  ADAS
 SG_ OBJ_DIMENSION_WIDTH_ERR_011 : 23|6@0+ (0.01,0) [0|0.63] "m"  ADAS
 SG_ OBJ_DIMENSION_LENGTH_ERR_011 : 41|10@0+ (0.01,0) [0|10.23] "m"  ADAS
 SG_ OBJ_CLS_TYPE1_011 : 271|4@0+ (1,0) [0|15] "NA"  ADAS
 SG_ OBJ_CLS_TYPE1_PROB_011 : 303|8@0+ (0.004,0) [0|1] "NA"  ADAS
 SG_ OBJ_CLS_TYPE2_011 : 267|4@0+ (1,0) [0|15] "NA"  ADAS
 SG_ OBJ_CLS_TYPE2_PROB_011 : 311|8@0+ (0.004,0) [0|1] "NA"  ADAS
 SG_ OBJ_CLS_TYPE3_011 : 279|4@0+ (1,0) [0|15] "NA"  ADAS
 SG_ OBJ_CLS_TYPE3_PROB_011 : 319|8@0+ (0.004,0) [0|1] "NA"  ADAS
 SG_ OBJ_CLS_TYPE4_011 : 275|4@0+ (1,0) [0|15] "NA"  ADAS
 SG_ OBJ_CLS_TYPE4_PROB_011 : 327|8@0+ (0.004,0) [0|1] "NA"  ADAS
 SG_ OBJ_CLS_TYPE5_011 : 287|4@0+ (1,0) [0|15] "NA"  ADAS
 SG_ OBJ_CLS_TYPE5_PROB_011 : 335|8@0+ (0.004,0) [0|1] "NA"  ADAS
 SG_ OBJ_CLS_TYPE6_011 : 282|4@0+ (1,0) [0|15] "NA"  ADAS
 SG_ OBJ_CLS_TYPE6_PROB_011 : 343|8@0+ (0.004,0) [0|1] "NA"  ADAS
 SG_ OBJ_RCS_011 : 351|7@0+ (1,-64) [-64|63] "dBsm"  ADAS
 SG_ OBJ_REF_PT_LONG_OFFSET_011 : 357|14@0+ (0.0001,0) [0|1] "NA"  ADAS
 SG_ OBJ_REF_PT_LAT_OFFSET_011 : 370|14@0+ (0.0001,0) [0|1] "NA"  ADAS
 SG_ OBJ_YAW_RATE_011 : 399|10@0+ (0.005,-2.24) [-2.24|2.24] "rad/s"  ADAS
 SG_ OBJ_YAW_RATE_ERR_011 : 388|5@0+ (0.025,0) [0|0.775] "rad/s"  ADAS
 SG_ OBJ_GROUP_ID_011 : 405|6@0+ (1,0) [0|63] "NA"  ADAS
 SG_ OBJ_POS_ERR_CRR_COEF_011 : 415|8@0+ (0.01,-1.2) [-1.2|1] "NA"  ADAS
 SG_ OBJ_VELOCITY_ERR_CRR_COEF_011 : 423|8@0+ (0.01,-1.2) [-1.2|1] "NA"  ADAS
 SG_ OBJ_ACCEL_ERR_CRR_COEF_011 : 431|8@0+ (0.01,-1.2) [-1.2|1] "NA"  ADAS

CM_ SG_ 1112 DET_RANGE_353 " measured position  of the detection";
CM_ SG_ 1112 DET_RANGE_ERR_353 "RMSE or standard deviation of the measured angle  of the detection";
CM_ SG_ 1112 DET_RANGE_VELOCITY_353 "Radial velocity of the detection positive in direction to the sensor";
CM_ SG_ 1112 DET_RANGE_VELOCITY_ERR_353 "RMSE or standard deviation of the measure radial velocity of the detection";
CM_ SG_ 1112 DET_AZIMUTH_353 "Measured angle  of the detection";
CM_ SG_ 1112 DET_AZIMUTH_ERR_353 "RMSE or standard deviation of the measured angle  of the detection";
CM_ SG_ 1112 DET_ELEVATION_353 "measured elevation of the detection";
CM_ SG_ 1112 DET_ELEVATION_ERR_353 "RMSE or standard deviation of the measured elevation  of the detection";
CM_ SG_ 1112 DET_RCS_353 "Radar Cross Section or Amplitude, is a measure of how detectable an object is by radar. A larger RCS indicates that an object is more easily detected.";
CM_ SG_ 1112 DET_BI_STATIC_FLAG_353 "1 if detection is bi-static 0 otherwise";
CM_ SG_ 1112 DET_SUPER_RES_TARGET_353 "flasg is set if the detection is super resolution target";
CM_ SG_ 1112 DET_SNR_353 "The signal to noise ratio (SNR) of the radar detection";
CM_ SG_ 1112 DET_EXISTENCE_PROB_353 "Existence probability of the detection not based on history. Value does  not depend on any past experience with similar detections.
\note Use as confidence measure where a low value means less confidence
and a high value indicates strong confidence.";
CM_ SG_ 1112 DET_HVC_FLAG_353 "Core2 Vehicle clutter flag";
CM_ SG_ 1112 DET_CONFD_AZIMUTH_353 "Define the Confidence of Azimuth for Detection ";
CM_ SG_ 1112 DET_CONFD_ELEVATION_353 "Define the Confidence of Elevation for the Detection ";
CM_ SG_ 1112 DET_BI_STATIC_FLAG_354 "1 if detection is bi-static 0 otherwise";
CM_ SG_ 1112 DET_BI_STATIC_FLAG_355 "1 if detection is bi-static 0 otherwise";
CM_ SG_ 1112 DET_BI_STATIC_FLAG_356 "1 if detection is bi-static 0 otherwise";
CM_ SG_ 1112 DET_MH_SCAN_INDEX_4LSB_353_356 "Scan index of the measured detection";
CM_ SG_ 1112 DET_MH_CYCLE_COUNTER_353_356 "Detection Alive Counter";
CM_ SG_ 1113 DET_RANGE_357 " measured position  of the detection";
CM_ SG_ 1113 DET_RANGE_ERR_357 "RMSE or standard deviation of the measured angle  of the detection";
CM_ SG_ 1113 DET_RANGE_VELOCITY_357 "Radial velocity of the detection positive in direction to the sensor";
CM_ SG_ 1113 DET_RANGE_VELOCITY_ERR_357 "RMSE or standard deviation of the measure radial velocity of the detection";
CM_ SG_ 1113 DET_AZIMUTH_357 "Measured angle  of the detection";
CM_ SG_ 1113 DET_AZIMUTH_ERR_357 "RMSE or standard deviation of the measured angle  of the detection";
CM_ SG_ 1113 DET_ELEVATION_357 "measured elevation of the detection";
CM_ SG_ 1113 DET_ELEVATION_ERR_357 "RMSE or standard deviation of the measured elevation  of the detection";
CM_ SG_ 1113 DET_RCS_357 "Radar Cross Section or Amplitude, is a measure of how detectable an object is by radar. A larger RCS indicates that an object is more easily detected.";
CM_ SG_ 1113 DET_BI_STATIC_FLAG_357 "1 if detection is bi-static 0 otherwise";
CM_ SG_ 1113 DET_SUPER_RES_TARGET_357 "flasg is set if the detection is super resolution target";
CM_ SG_ 1113 DET_SNR_357 "The signal to noise ratio (SNR) of the radar detection";
CM_ SG_ 1113 DET_EXISTENCE_PROB_357 "Existence probability of the detection not based on history. Value does  not depend on any past experience with similar detections.
\note Use as confidence measure where a low value means less confidence
and a high value indicates strong confidence.";
CM_ SG_ 1113 DET_HVC_FLAG_357 "Core2 Vehicle clutter flag";
CM_ SG_ 1113 DET_CONFD_AZIMUTH_357 "Define the Confidence of Azimuth for Detection ";
CM_ SG_ 1113 DET_CONFD_ELEVATION_357 "Define the Confidence of Elevation for the Detection ";
CM_ SG_ 1113 DET_BI_STATIC_FLAG_358 "1 if detection is bi-static 0 otherwise";
CM_ SG_ 1113 DET_BI_STATIC_FLAG_359 "1 if detection is bi-static 0 otherwise";
CM_ SG_ 1113 DET_BI_STATIC_FLAG_360 "1 if detection is bi-static 0 otherwise";
CM_ SG_ 1113 DET_MH_SCAN_INDEX_4LSB_357_360 "Scan index of the measured detection";
CM_ SG_ 1113 DET_MH_CYCLE_COUNTER_357_360 "Detection Alive Counter";
CM_ SG_ 1114 DET_RANGE_361 " measured position  of the detection";
CM_ SG_ 1114 DET_RANGE_ERR_361 "RMSE or standard deviation of the measured angle  of the detection";
CM_ SG_ 1114 DET_RANGE_VELOCITY_361 "Radial velocity of the detection positive in direction to the sensor";
CM_ SG_ 1114 DET_RANGE_VELOCITY_ERR_361 "RMSE or standard deviation of the measure radial velocity of the detection";
CM_ SG_ 1114 DET_AZIMUTH_361 "Measured angle  of the detection";
CM_ SG_ 1114 DET_AZIMUTH_ERR_361 "RMSE or standard deviation of the measured angle  of the detection";
CM_ SG_ 1114 DET_ELEVATION_361 "measured elevation of the detection";
CM_ SG_ 1114 DET_ELEVATION_ERR_361 "RMSE or standard deviation of the measured elevation  of the detection";
CM_ SG_ 1114 DET_RCS_361 "Radar Cross Section or Amplitude, is a measure of how detectable an object is by radar. A larger RCS indicates that an object is more easily detected.";
CM_ SG_ 1114 DET_BI_STATIC_FLAG_361 "1 if detection is bi-static 0 otherwise";
CM_ SG_ 1114 DET_SUPER_RES_TARGET_361 "flasg is set if the detection is super resolution target";
CM_ SG_ 1114 DET_SNR_361 "The signal to noise ratio (SNR) of the radar detection";
CM_ SG_ 1114 DET_EXISTENCE_PROB_361 "Existence probability of the detection not based on history. Value does  not depend on any past experience with similar detections.
\note Use as confidence measure where a low value means less confidence
and a high value indicates strong confidence.";
CM_ SG_ 1114 DET_HVC_FLAG_361 "Core2 Vehicle clutter flag";
CM_ SG_ 1114 DET_CONFD_AZIMUTH_361 "Define the Confidence of Azimuth for Detection ";
CM_ SG_ 1114 DET_CONFD_ELEVATION_361 "Define the Confidence of Elevation for the Detection ";
CM_ SG_ 1114 DET_BI_STATIC_FLAG_362 "1 if detection is bi-static 0 otherwise";
CM_ SG_ 1114 DET_BI_STATIC_FLAG_363 "1 if detection is bi-static 0 otherwise";
CM_ SG_ 1114 DET_BI_STATIC_FLAG_364 "1 if detection is bi-static 0 otherwise";
CM_ SG_ 1114 DET_MH_SCAN_INDEX_4LSB_361_364 "Scan index of the measured detection";
CM_ SG_ 1114 DET_MH_CYCLE_COUNTER_361_364 "Detection Alive Counter";
CM_ SG_ 1115 DET_RANGE_365 " measured position  of the detection";
CM_ SG_ 1115 DET_RANGE_ERR_365 "RMSE or standard deviation of the measured angle  of the detection";
CM_ SG_ 1115 DET_RANGE_VELOCITY_365 "Radial velocity of the detection positive in direction to the sensor";
CM_ SG_ 1115 DET_RANGE_VELOCITY_ERR_365 "RMSE or standard deviation of the measure radial velocity of the detection";
CM_ SG_ 1115 DET_AZIMUTH_365 "Measured angle  of the detection";
CM_ SG_ 1115 DET_AZIMUTH_ERR_365 "RMSE or standard deviation of the measured angle  of the detection";
CM_ SG_ 1115 DET_ELEVATION_365 "measured elevation of the detection";
CM_ SG_ 1115 DET_ELEVATION_ERR_365 "RMSE or standard deviation of the measured elevation  of the detection";
CM_ SG_ 1115 DET_RCS_365 "Radar Cross Section or Amplitude, is a measure of how detectable an object is by radar. A larger RCS indicates that an object is more easily detected.";
CM_ SG_ 1115 DET_BI_STATIC_FLAG_365 "1 if detection is bi-static 0 otherwise";
CM_ SG_ 1115 DET_SUPER_RES_TARGET_365 "flasg is set if the detection is super resolution target";
CM_ SG_ 1115 DET_SNR_365 "The signal to noise ratio (SNR) of the radar detection";
CM_ SG_ 1115 DET_EXISTENCE_PROB_365 "Existence probability of the detection not based on history. Value does  not depend on any past experience with similar detections.
\note Use as confidence measure where a low value means less confidence
and a high value indicates strong confidence.";
CM_ SG_ 1115 DET_HVC_FLAG_365 "Core2 Vehicle clutter flag";
CM_ SG_ 1115 DET_CONFD_AZIMUTH_365 "Define the Confidence of Azimuth for Detection ";
CM_ SG_ 1115 DET_CONFD_ELEVATION_365 "Define the Confidence of Elevation for the Detection ";
CM_ SG_ 1115 DET_BI_STATIC_FLAG_366 "1 if detection is bi-static 0 otherwise";
CM_ SG_ 1115 DET_BI_STATIC_FLAG_367 "1 if detection is bi-static 0 otherwise";
CM_ SG_ 1115 DET_BI_STATIC_FLAG_368 "1 if detection is bi-static 0 otherwise";
CM_ SG_ 1115 DET_MH_SCAN_INDEX_4LSB_365_368 "Scan index of the measured detection";
CM_ SG_ 1115 DET_MH_CYCLE_COUNTER_365_368 "Detection Alive Counter";
CM_ SG_ 1116 DET_RANGE_369 " measured position  of the detection";
CM_ SG_ 1116 DET_RANGE_ERR_369 "RMSE or standard deviation of the measured angle  of the detection";
CM_ SG_ 1116 DET_RANGE_VELOCITY_369 "Radial velocity of the detection positive in direction to the sensor";
CM_ SG_ 1116 DET_RANGE_VELOCITY_ERR_369 "RMSE or standard deviation of the measure radial velocity of the detection";
CM_ SG_ 1116 DET_AZIMUTH_369 "Measured angle  of the detection";
CM_ SG_ 1116 DET_AZIMUTH_ERR_369 "RMSE or standard deviation of the measured angle  of the detection";
CM_ SG_ 1116 DET_ELEVATION_369 "measured elevation of the detection";
CM_ SG_ 1116 DET_ELEVATION_ERR_369 "RMSE or standard deviation of the measured elevation  of the detection";
CM_ SG_ 1116 DET_RCS_369 "Radar Cross Section or Amplitude, is a measure of how detectable an object is by radar. A larger RCS indicates that an object is more easily detected.";
CM_ SG_ 1116 DET_BI_STATIC_FLAG_369 "1 if detection is bi-static 0 otherwise";
CM_ SG_ 1116 DET_SUPER_RES_TARGET_369 "flasg is set if the detection is super resolution target";
CM_ SG_ 1116 DET_SNR_369 "The signal to noise ratio (SNR) of the radar detection";
CM_ SG_ 1116 DET_EXISTENCE_PROB_369 "Existence probability of the detection not based on history. Value does  not depend on any past experience with similar detections.
\note Use as confidence measure where a low value means less confidence
and a high value indicates strong confidence.";
CM_ SG_ 1116 DET_HVC_FLAG_369 "Core2 Vehicle clutter flag";
CM_ SG_ 1116 DET_CONFD_AZIMUTH_369 "Define the Confidence of Azimuth for Detection ";
CM_ SG_ 1116 DET_CONFD_ELEVATION_369 "Define the Confidence of Elevation for the Detection ";
CM_ SG_ 1116 DET_BI_STATIC_FLAG_370 "1 if detection is bi-static 0 otherwise";
CM_ SG_ 1116 DET_BI_STATIC_FLAG_371 "1 if detection is bi-static 0 otherwise";
CM_ SG_ 1116 DET_BI_STATIC_FLAG_372 "1 if detection is bi-static 0 otherwise";
CM_ SG_ 1116 DET_MH_SCAN_INDEX_4LSB_369_372 "Scan index of the measured detection";
CM_ SG_ 1116 DET_MH_CYCLE_COUNTER_369_372 "Detection Alive Counter";
CM_ SG_ 1117 DET_RANGE_373 " measured position  of the detection";
CM_ SG_ 1117 DET_RANGE_ERR_373 "RMSE or standard deviation of the measured angle  of the detection";
CM_ SG_ 1117 DET_RANGE_VELOCITY_373 "Radial velocity of the detection positive in direction to the sensor";
CM_ SG_ 1117 DET_RANGE_VELOCITY_ERR_373 "RMSE or standard deviation of the measure radial velocity of the detection";
CM_ SG_ 1117 DET_AZIMUTH_373 "Measured angle  of the detection";
CM_ SG_ 1117 DET_AZIMUTH_ERR_373 "RMSE or standard deviation of the measured angle  of the detection";
CM_ SG_ 1117 DET_ELEVATION_373 "measured elevation of the detection";
CM_ SG_ 1117 DET_ELEVATION_ERR_373 "RMSE or standard deviation of the measured elevation  of the detection";
CM_ SG_ 1117 DET_RCS_373 "Radar Cross Section or Amplitude, is a measure of how detectable an object is by radar. A larger RCS indicates that an object is more easily detected.";
CM_ SG_ 1117 DET_BI_STATIC_FLAG_373 "1 if detection is bi-static 0 otherwise";
CM_ SG_ 1117 DET_SUPER_RES_TARGET_373 "flasg is set if the detection is super resolution target";
CM_ SG_ 1117 DET_SNR_373 "The signal to noise ratio (SNR) of the radar detection";
CM_ SG_ 1117 DET_EXISTENCE_PROB_373 "Existence probability of the detection not based on history. Value does  not depend on any past experience with similar detections.
\note Use as confidence measure where a low value means less confidence
and a high value indicates strong confidence.";
CM_ SG_ 1117 DET_HVC_FLAG_373 "Core2 Vehicle clutter flag";
CM_ SG_ 1117 DET_CONFD_AZIMUTH_373 "Define the Confidence of Azimuth for Detection ";
CM_ SG_ 1117 DET_CONFD_ELEVATION_373 "Define the Confidence of Elevation for the Detection ";
CM_ SG_ 1117 DET_BI_STATIC_FLAG_374 "1 if detection is bi-static 0 otherwise";
CM_ SG_ 1117 DET_BI_STATIC_FLAG_375 "1 if detection is bi-static 0 otherwise";
CM_ SG_ 1117 DET_BI_STATIC_FLAG_376 "1 if detection is bi-static 0 otherwise";
CM_ SG_ 1117 DET_MH_SCAN_INDEX_4LSB_373_376 "Scan index of the measured detection";
CM_ SG_ 1117 DET_MH_CYCLE_COUNTER_373_376 "Detection Alive Counter";
CM_ SG_ 1118 DET_RANGE_377 " measured position  of the detection";
CM_ SG_ 1118 DET_RANGE_ERR_377 "RMSE or standard deviation of the measured angle  of the detection";
CM_ SG_ 1118 DET_RANGE_VELOCITY_377 "Radial velocity of the detection positive in direction to the sensor";
CM_ SG_ 1118 DET_RANGE_VELOCITY_ERR_377 "RMSE or standard deviation of the measure radial velocity of the detection";
CM_ SG_ 1118 DET_AZIMUTH_377 "Measured angle  of the detection";
CM_ SG_ 1118 DET_AZIMUTH_ERR_377 "RMSE or standard deviation of the measured angle  of the detection";
CM_ SG_ 1118 DET_ELEVATION_377 "measured elevation of the detection";
CM_ SG_ 1118 DET_ELEVATION_ERR_377 "RMSE or standard deviation of the measured elevation  of the detection";
CM_ SG_ 1118 DET_RCS_377 "Radar Cross Section or Amplitude, is a measure of how detectable an object is by radar. A larger RCS indicates that an object is more easily detected.";
CM_ SG_ 1118 DET_BI_STATIC_FLAG_377 "1 if detection is bi-static 0 otherwise";
CM_ SG_ 1118 DET_SUPER_RES_TARGET_377 "flasg is set if the detection is super resolution target";
CM_ SG_ 1118 DET_SNR_377 "The signal to noise ratio (SNR) of the radar detection";
CM_ SG_ 1118 DET_EXISTENCE_PROB_377 "Existence probability of the detection not based on history. Value does  not depend on any past experience with similar detections.
\note Use as confidence measure where a low value means less confidence
and a high value indicates strong confidence.";
CM_ SG_ 1118 DET_HVC_FLAG_377 "Core2 Vehicle clutter flag";
CM_ SG_ 1118 DET_CONFD_AZIMUTH_377 "Define the Confidence of Azimuth for Detection ";
CM_ SG_ 1118 DET_CONFD_ELEVATION_377 "Define the Confidence of Elevation for the Detection ";
CM_ SG_ 1118 DET_BI_STATIC_FLAG_378 "1 if detection is bi-static 0 otherwise";
CM_ SG_ 1118 DET_BI_STATIC_FLAG_379 "1 if detection is bi-static 0 otherwise";
CM_ SG_ 1118 DET_BI_STATIC_FLAG_380 "1 if detection is bi-static 0 otherwise";
CM_ SG_ 1118 DET_MH_SCAN_INDEX_4LSB_377_380 "Scan index of the measured detection";
CM_ SG_ 1118 DET_MH_CYCLE_COUNTER_377_380 "Detection Alive Counter";
CM_ SG_ 1119 DET_RANGE_381 " measured position  of the detection";
CM_ SG_ 1119 DET_RANGE_ERR_381 "RMSE or standard deviation of the measured angle  of the detection";
CM_ SG_ 1119 DET_RANGE_VELOCITY_381 "Radial velocity of the detection positive in direction to the sensor";
CM_ SG_ 1119 DET_RANGE_VELOCITY_ERR_381 "RMSE or standard deviation of the measure radial velocity of the detection";
CM_ SG_ 1119 DET_AZIMUTH_381 "Measured angle  of the detection";
CM_ SG_ 1119 DET_AZIMUTH_ERR_381 "RMSE or standard deviation of the measured angle  of the detection";
CM_ SG_ 1119 DET_ELEVATION_381 "measured elevation of the detection";
CM_ SG_ 1119 DET_ELEVATION_ERR_381 "RMSE or standard deviation of the measured elevation  of the detection";
CM_ SG_ 1119 DET_RCS_381 "Radar Cross Section or Amplitude, is a measure of how detectable an object is by radar. A larger RCS indicates that an object is more easily detected.";
CM_ SG_ 1119 DET_BI_STATIC_FLAG_381 "1 if detection is bi-static 0 otherwise";
CM_ SG_ 1119 DET_SUPER_RES_TARGET_381 "flasg is set if the detection is super resolution target";
CM_ SG_ 1119 DET_SNR_381 "The signal to noise ratio (SNR) of the radar detection";
CM_ SG_ 1119 DET_EXISTENCE_PROB_381 "Existence probability of the detection not based on history. Value does  not depend on any past experience with similar detections.
\note Use as confidence measure where a low value means less confidence
and a high value indicates strong confidence.";
CM_ SG_ 1119 DET_HVC_FLAG_381 "Core2 Vehicle clutter flag";
CM_ SG_ 1119 DET_CONFD_AZIMUTH_381 "Define the Confidence of Azimuth for Detection ";
CM_ SG_ 1119 DET_CONFD_ELEVATION_381 "Define the Confidence of Elevation for the Detection ";
CM_ SG_ 1119 DET_BI_STATIC_FLAG_382 "1 if detection is bi-static 0 otherwise";
CM_ SG_ 1119 DET_BI_STATIC_FLAG_383 "1 if detection is bi-static 0 otherwise";
CM_ SG_ 1119 DET_BI_STATIC_FLAG_384 "1 if detection is bi-static 0 otherwise";
CM_ SG_ 1119 DET_MH_SCAN_INDEX_4LSB_381_384 "Scan index of the measured detection";
CM_ SG_ 1119 DET_MH_CYCLE_COUNTER_381_384 "Detection Alive Counter";
CM_ SG_ 1120 DET_RANGE_385 " measured position  of the detection";
CM_ SG_ 1120 DET_RANGE_ERR_385 "RMSE or standard deviation of the measured angle  of the detection";
CM_ SG_ 1120 DET_RANGE_VELOCITY_385 "Radial velocity of the detection positive in direction to the sensor";
CM_ SG_ 1120 DET_RANGE_VELOCITY_ERR_385 "RMSE or standard deviation of the measure radial velocity of the detection";
CM_ SG_ 1120 DET_AZIMUTH_385 "Measured angle  of the detection";
CM_ SG_ 1120 DET_AZIMUTH_ERR_385 "RMSE or standard deviation of the measured angle  of the detection";
CM_ SG_ 1120 DET_ELEVATION_385 "measured elevation of the detection";
CM_ SG_ 1120 DET_ELEVATION_ERR_385 "RMSE or standard deviation of the measured elevation  of the detection";
CM_ SG_ 1120 DET_RCS_385 "Radar Cross Section or Amplitude, is a measure of how detectable an object is by radar. A larger RCS indicates that an object is more easily detected.";
CM_ SG_ 1120 DET_BI_STATIC_FLAG_385 "1 if detection is bi-static 0 otherwise";
CM_ SG_ 1120 DET_SUPER_RES_TARGET_385 "flasg is set if the detection is super resolution target";
CM_ SG_ 1120 DET_SNR_385 "The signal to noise ratio (SNR) of the radar detection";
CM_ SG_ 1120 DET_EXISTENCE_PROB_385 "Existence probability of the detection not based on history. Value does  not depend on any past experience with similar detections.
\note Use as confidence measure where a low value means less confidence
and a high value indicates strong confidence.";
CM_ SG_ 1120 DET_HVC_FLAG_385 "Core2 Vehicle clutter flag";
CM_ SG_ 1120 DET_CONFD_AZIMUTH_385 "Define the Confidence of Azimuth for Detection ";
CM_ SG_ 1120 DET_CONFD_ELEVATION_385 "Define the Confidence of Elevation for the Detection ";
CM_ SG_ 1120 DET_BI_STATIC_FLAG_386 "1 if detection is bi-static 0 otherwise";
CM_ SG_ 1120 DET_BI_STATIC_FLAG_387 "1 if detection is bi-static 0 otherwise";
CM_ SG_ 1120 DET_BI_STATIC_FLAG_388 "1 if detection is bi-static 0 otherwise";
CM_ SG_ 1120 DET_MH_SCAN_INDEX_4LSB_385_388 "Scan index of the measured detection";
CM_ SG_ 1120 DET_MH_CYCLE_COUNTER_385_388 "Detection Alive Counter";
CM_ SG_ 1121 DET_RANGE_389 " measured position  of the detection";
CM_ SG_ 1121 DET_RANGE_ERR_389 "RMSE or standard deviation of the measured angle  of the detection";
CM_ SG_ 1121 DET_RANGE_VELOCITY_389 "Radial velocity of the detection positive in direction to the sensor";
CM_ SG_ 1121 DET_RANGE_VELOCITY_ERR_389 "RMSE or standard deviation of the measure radial velocity of the detection";
CM_ SG_ 1121 DET_AZIMUTH_389 "Measured angle  of the detection";
CM_ SG_ 1121 DET_AZIMUTH_ERR_389 "RMSE or standard deviation of the measured angle  of the detection";
CM_ SG_ 1121 DET_ELEVATION_389 "measured elevation of the detection";
CM_ SG_ 1121 DET_ELEVATION_ERR_389 "RMSE or standard deviation of the measured elevation  of the detection";
CM_ SG_ 1121 DET_RCS_389 "Radar Cross Section or Amplitude, is a measure of how detectable an object is by radar. A larger RCS indicates that an object is more easily detected.";
CM_ SG_ 1121 DET_BI_STATIC_FLAG_389 "1 if detection is bi-static 0 otherwise";
CM_ SG_ 1121 DET_SUPER_RES_TARGET_389 "flasg is set if the detection is super resolution target";
CM_ SG_ 1121 DET_SNR_389 "The signal to noise ratio (SNR) of the radar detection";
CM_ SG_ 1121 DET_EXISTENCE_PROB_389 "Existence probability of the detection not based on history. Value does  not depend on any past experience with similar detections.
\note Use as confidence measure where a low value means less confidence
and a high value indicates strong confidence.";
CM_ SG_ 1121 DET_HVC_FLAG_389 "Core2 Vehicle clutter flag";
CM_ SG_ 1121 DET_CONFD_AZIMUTH_389 "Define the Confidence of Azimuth for Detection ";
CM_ SG_ 1121 DET_CONFD_ELEVATION_389 "Define the Confidence of Elevation for the Detection ";
CM_ SG_ 1121 DET_BI_STATIC_FLAG_390 "1 if detection is bi-static 0 otherwise";
CM_ SG_ 1121 DET_BI_STATIC_FLAG_391 "1 if detection is bi-static 0 otherwise";
CM_ SG_ 1121 DET_BI_STATIC_FLAG_392 "1 if detection is bi-static 0 otherwise";
CM_ SG_ 1121 DET_MH_SCAN_INDEX_4LSB_389_392 "Scan index of the measured detection";
CM_ SG_ 1121 DET_MH_CYCLE_COUNTER_389_392 "Detection Alive Counter";
CM_ SG_ 1122 DET_RANGE_393 " measured position  of the detection";
CM_ SG_ 1122 DET_RANGE_ERR_393 "RMSE or standard deviation of the measured angle  of the detection";
CM_ SG_ 1122 DET_RANGE_VELOCITY_393 "Radial velocity of the detection positive in direction to the sensor";
CM_ SG_ 1122 DET_RANGE_VELOCITY_ERR_393 "RMSE or standard deviation of the measure radial velocity of the detection";
CM_ SG_ 1122 DET_AZIMUTH_393 "Measured angle  of the detection";
CM_ SG_ 1122 DET_AZIMUTH_ERR_393 "RMSE or standard deviation of the measured angle  of the detection";
CM_ SG_ 1122 DET_ELEVATION_393 "measured elevation of the detection";
CM_ SG_ 1122 DET_ELEVATION_ERR_393 "RMSE or standard deviation of the measured elevation  of the detection";
CM_ SG_ 1122 DET_RCS_393 "Radar Cross Section or Amplitude, is a measure of how detectable an object is by radar. A larger RCS indicates that an object is more easily detected.";
CM_ SG_ 1122 DET_BI_STATIC_FLAG_393 "1 if detection is bi-static 0 otherwise";
CM_ SG_ 1122 DET_SUPER_RES_TARGET_393 "flasg is set if the detection is super resolution target";
CM_ SG_ 1122 DET_SNR_393 "The signal to noise ratio (SNR) of the radar detection";
CM_ SG_ 1122 DET_EXISTENCE_PROB_393 "Existence probability of the detection not based on history. Value does  not depend on any past experience with similar detections.
\note Use as confidence measure where a low value means less confidence
and a high value indicates strong confidence.";
CM_ SG_ 1122 DET_HVC_FLAG_393 "Core2 Vehicle clutter flag";
CM_ SG_ 1122 DET_CONFD_AZIMUTH_393 "Define the Confidence of Azimuth for Detection ";
CM_ SG_ 1122 DET_CONFD_ELEVATION_393 "Define the Confidence of Elevation for the Detection ";
CM_ SG_ 1122 DET_BI_STATIC_FLAG_394 "1 if detection is bi-static 0 otherwise";
CM_ SG_ 1122 DET_BI_STATIC_FLAG_395 "1 if detection is bi-static 0 otherwise";
CM_ SG_ 1122 DET_BI_STATIC_FLAG_396 "1 if detection is bi-static 0 otherwise";
CM_ SG_ 1122 DET_MH_SCAN_INDEX_4LSB_393_396 "Scan index of the measured detection";
CM_ SG_ 1122 DET_MH_CYCLE_COUNTER_393_396 "Detection Alive Counter";
CM_ SG_ 1123 DET_RANGE_397 " measured position  of the detection";
CM_ SG_ 1123 DET_RANGE_ERR_397 "RMSE or standard deviation of the measured angle  of the detection";
CM_ SG_ 1123 DET_RANGE_VELOCITY_397 "Radial velocity of the detection positive in direction to the sensor";
CM_ SG_ 1123 DET_RANGE_VELOCITY_ERR_397 "RMSE or standard deviation of the measure radial velocity of the detection";
CM_ SG_ 1123 DET_AZIMUTH_397 "Measured angle  of the detection";
CM_ SG_ 1123 DET_AZIMUTH_ERR_397 "RMSE or standard deviation of the measured angle  of the detection";
CM_ SG_ 1123 DET_ELEVATION_397 "measured elevation of the detection";
CM_ SG_ 1123 DET_ELEVATION_ERR_397 "RMSE or standard deviation of the measured elevation  of the detection";
CM_ SG_ 1123 DET_RCS_397 "Radar Cross Section or Amplitude, is a measure of how detectable an object is by radar. A larger RCS indicates that an object is more easily detected.";
CM_ SG_ 1123 DET_BI_STATIC_FLAG_397 "1 if detection is bi-static 0 otherwise";
CM_ SG_ 1123 DET_SUPER_RES_TARGET_397 "flasg is set if the detection is super resolution target";
CM_ SG_ 1123 DET_SNR_397 "The signal to noise ratio (SNR) of the radar detection";
CM_ SG_ 1123 DET_EXISTENCE_PROB_397 "Existence probability of the detection not based on history. Value does  not depend on any past experience with similar detections.
\note Use as confidence measure where a low value means less confidence
and a high value indicates strong confidence.";
CM_ SG_ 1123 DET_HVC_FLAG_397 "Core2 Vehicle clutter flag";
CM_ SG_ 1123 DET_CONFD_AZIMUTH_397 "Define the Confidence of Azimuth for Detection ";
CM_ SG_ 1123 DET_CONFD_ELEVATION_397 "Define the Confidence of Elevation for the Detection ";
CM_ SG_ 1123 DET_BI_STATIC_FLAG_398 "1 if detection is bi-static 0 otherwise";
CM_ SG_ 1123 DET_BI_STATIC_FLAG_399 "1 if detection is bi-static 0 otherwise";
CM_ SG_ 1123 DET_BI_STATIC_FLAG_400 "1 if detection is bi-static 0 otherwise";
CM_ SG_ 1123 DET_MH_SCAN_INDEX_4LSB_397_400 "Scan index of the measured detection";
CM_ SG_ 1123 DET_MH_CYCLE_COUNTER_397_400 "Detection Alive Counter";
BA_DEF_ BO_  "VFrameFormat" ENUM  "StandardCAN","ExtendedCAN","reserved","reserved","reserved","reserved","reserved","reserved","reserved","reserved","reserved","reserved","reserved","reserved","StandardCAN_FD","ExtendedCAN_FD";
BA_DEF_ BO_  "CanTpBs" INT 0 255;
BA_DEF_ BO_  "DiagConnection" INT 0 65535;
BA_DEF_ BO_  "DiagRequest" ENUM  "No","Yes";
BA_DEF_ BO_  "DiagResponse" ENUM  "No","Yes";
BA_DEF_ BO_  "DiagState" ENUM  "No","Yes";
BA_DEF_ BO_  "E2EDataId" INT 0 65535;
BA_DEF_ BO_  "E2EDataLength" INT 0 65535;
BA_DEF_ BO_  "E2EProfile" STRING ;
BA_DEF_ BO_  "EventRateOfChange" INT 10 10000;
BA_DEF_ BO_  "GenMsgCycleTime" INT 0 100000;
BA_DEF_ BO_  "GenMsgILSupport" ENUM  "No","Yes";
BA_DEF_ BO_  "GenMsgNrOfRepetition" INT 0 100;
BA_DEF_ BO_  "GenMsgSendType" ENUM  "FixedPeriodic","Event","EnabledPeriodic","NotUsed","NotUsed","EventPeriodic","NotUsed","NotUsed","NoMsgSendType";
BA_DEF_ BO_  "NetworkInitialization" ENUM  "No","Yes";
BA_DEF_ BO_  "NmAsrMessage" ENUM  "No","Yes";
BA_DEF_ BO_  "NmMessage" ENUM  "No","Yes";
BA_DEF_ BO_  "SCP_AuthInfoTxLength" INT 0 512;
BA_DEF_ BO_  "SCP_FreshnessValueLength" INT 0 512;
BA_DEF_ BO_  "SCP_FreshnessValueTxLength" INT 0 512;
BA_DEF_ BO_  "TpTxIndex" INT 0 255;
BA_DEF_ SG_  "GenSigCmt" STRING ;
BA_DEF_ SG_  "GenSigCycleTime" INT 0 0;
BA_DEF_ SG_  "GenSigSendType" ENUM  "Cyclic","OnWrite","vector_leerstring","OnChange","vector_leerstring","IfActive","vector_leerstring","NoSigSendType";
BA_DEF_ SG_  "GenSigStartValue" INT 0 1000000000;
BA_DEF_ SG_  "GenSigTimeoutTime" INT 0 0;
BA_DEF_ SG_  "GenSigVtEn" STRING ;
BA_DEF_ SG_  "GenSigVtName" STRING ;
BA_DEF_ SG_  "InvalidValue" STRING ;
BA_DEF_ SG_  "SystemSignalLongSymbol" STRING ;
BA_DEF_REL_ BU_SG_REL_  "SC_Verification" ENUM  "No","Yes";
BA_DEF_DEF_  "VFrameFormat" "StandardCAN_FD";
BA_DEF_DEF_  "CanTpBs" 255;
BA_DEF_DEF_  "DiagConnection" 0;
BA_DEF_DEF_  "DiagRequest" "No";
BA_DEF_DEF_  "DiagResponse" "No";
BA_DEF_DEF_  "DiagState" "No";
BA_DEF_DEF_  "E2EDataId" 0;
BA_DEF_DEF_  "E2EDataLength" 0;
BA_DEF_DEF_  "E2EProfile" "";
BA_DEF_DEF_  "EventRateOfChange" 10000;
BA_DEF_DEF_  "GenMsgCycleTime" 0;
BA_DEF_DEF_  "GenMsgILSupport" "Yes";
BA_DEF_DEF_  "GenMsgNrOfRepetition" 0;
BA_DEF_DEF_  "GenMsgSendType" "NoMsgSendType";
BA_DEF_DEF_  "NetworkInitialization" "Yes";
BA_DEF_DEF_  "NmAsrMessage" "No";
BA_DEF_DEF_  "NmMessage" "No";
BA_DEF_DEF_  "SCP_AuthInfoTxLength" 28;
BA_DEF_DEF_  "SCP_FreshnessValueLength" 48;
BA_DEF_DEF_  "SCP_FreshnessValueTxLength" 4;
BA_DEF_DEF_  "TpTxIndex" 0;
BA_DEF_DEF_  "GenSigCmt" "";
BA_DEF_DEF_  "GenSigCycleTime" 0;
BA_DEF_DEF_  "GenSigSendType" "NoSigSendType";
BA_DEF_DEF_  "GenSigStartValue" 0;
BA_DEF_DEF_  "GenSigTimeoutTime" 0;
BA_DEF_DEF_  "GenSigVtEn" "";
BA_DEF_DEF_  "GenSigVtName" "";
BA_DEF_DEF_  "InvalidValue" "";
BA_DEF_DEF_REL_ "SC_Verification" "No";
BA_DEF_DEF_  "SystemSignalLongSymbol" "";
BA_ "GenMsgSendType" BO_ 1112 1;
BA_ "GenMsgSendType" BO_ 1113 1;
BA_ "GenMsgSendType" BO_ 1114 1;
BA_ "GenMsgSendType" BO_ 1115 1;
BA_ "GenMsgSendType" BO_ 1116 1;
BA_ "GenMsgSendType" BO_ 1117 1;
BA_ "GenMsgSendType" BO_ 1118 1;
BA_ "GenMsgSendType" BO_ 1119 1;
BA_ "GenMsgSendType" BO_ 1120 1;
BA_ "GenMsgSendType" BO_ 1121 1;
BA_ "GenMsgSendType" BO_ 1122 1;
BA_ "GenMsgSendType" BO_ 1123 1;
BA_ "GenSigStartValue" SG_ 1112 DET_RANGE_VELOCITY_353 16384;
BA_ "GenSigStartValue" SG_ 1112 DET_RCS_353 128;
BA_ "GenSigStartValue" SG_ 1112 DET_RANGE_VELOCITY_354 16384;
BA_ "GenSigStartValue" SG_ 1112 DET_RCS_354 128;
BA_ "GenSigStartValue" SG_ 1112 DET_RANGE_VELOCITY_355 16384;
BA_ "GenSigStartValue" SG_ 1112 DET_RCS_355 128;
BA_ "GenSigStartValue" SG_ 1112 DET_RANGE_VELOCITY_356 16384;
BA_ "GenSigStartValue" SG_ 1112 DET_RCS_356 128;
BA_ "GenSigStartValue" SG_ 1113 DET_RANGE_VELOCITY_357 16384;
BA_ "GenSigStartValue" SG_ 1113 DET_RCS_357 128;
BA_ "GenSigStartValue" SG_ 1113 DET_RANGE_VELOCITY_358 16384;
BA_ "GenSigStartValue" SG_ 1113 DET_RCS_358 128;
BA_ "GenSigStartValue" SG_ 1113 DET_RANGE_VELOCITY_359 16384;
BA_ "GenSigStartValue" SG_ 1113 DET_RCS_359 128;
BA_ "GenSigStartValue" SG_ 1113 DET_RANGE_VELOCITY_360 16384;
BA_ "GenSigStartValue" SG_ 1113 DET_RCS_360 128;
BA_ "GenSigStartValue" SG_ 1114 DET_RANGE_VELOCITY_361 16384;
BA_ "GenSigStartValue" SG_ 1114 DET_RCS_361 128;
BA_ "GenSigStartValue" SG_ 1114 DET_RANGE_VELOCITY_362 16384;
BA_ "GenSigStartValue" SG_ 1114 DET_RCS_362 128;
BA_ "GenSigStartValue" SG_ 1114 DET_RANGE_VELOCITY_363 16384;
BA_ "GenSigStartValue" SG_ 1114 DET_RCS_363 128;
BA_ "GenSigStartValue" SG_ 1114 DET_RANGE_VELOCITY_364 16384;
BA_ "GenSigStartValue" SG_ 1114 DET_RCS_364 128;
BA_ "GenSigStartValue" SG_ 1115 DET_RANGE_VELOCITY_365 16384;
BA_ "GenSigStartValue" SG_ 1115 DET_RCS_365 128;
BA_ "GenSigStartValue" SG_ 1115 DET_RANGE_VELOCITY_366 16384;
BA_ "GenSigStartValue" SG_ 1115 DET_RCS_366 128;
BA_ "GenSigStartValue" SG_ 1115 DET_RANGE_VELOCITY_367 16384;
BA_ "GenSigStartValue" SG_ 1115 DET_RCS_367 128;
BA_ "GenSigStartValue" SG_ 1115 DET_RANGE_VELOCITY_368 16384;
BA_ "GenSigStartValue" SG_ 1115 DET_RCS_368 128;
BA_ "GenSigStartValue" SG_ 1116 DET_RANGE_VELOCITY_369 16384;
BA_ "GenSigStartValue" SG_ 1116 DET_RCS_369 128;
BA_ "GenSigStartValue" SG_ 1116 DET_RANGE_VELOCITY_370 16384;
BA_ "GenSigStartValue" SG_ 1116 DET_RCS_370 128;
BA_ "GenSigStartValue" SG_ 1116 DET_RANGE_VELOCITY_371 16384;
BA_ "GenSigStartValue" SG_ 1116 DET_RCS_371 128;
BA_ "GenSigStartValue" SG_ 1116 DET_RANGE_VELOCITY_372 16384;
BA_ "GenSigStartValue" SG_ 1116 DET_RCS_372 128;
BA_ "GenSigStartValue" SG_ 1117 DET_RANGE_VELOCITY_373 16384;
BA_ "GenSigStartValue" SG_ 1117 DET_RCS_373 128;
BA_ "GenSigStartValue" SG_ 1117 DET_RANGE_VELOCITY_374 16384;
BA_ "GenSigStartValue" SG_ 1117 DET_RCS_374 128;
BA_ "GenSigStartValue" SG_ 1117 DET_RANGE_VELOCITY_375 16384;
BA_ "GenSigStartValue" SG_ 1117 DET_RCS_375 128;
BA_ "GenSigStartValue" SG_ 1117 DET_RANGE_VELOCITY_376 16384;
BA_ "GenSigStartValue" SG_ 1117 DET_RCS_376 128;
BA_ "GenSigStartValue" SG_ 1118 DET_RANGE_VELOCITY_377 16384;
BA_ "GenSigStartValue" SG_ 1118 DET_RCS_377 128;
BA_ "GenSigStartValue" SG_ 1118 DET_RANGE_VELOCITY_378 16384;
BA_ "GenSigStartValue" SG_ 1118 DET_RCS_378 128;
BA_ "GenSigStartValue" SG_ 1118 DET_RANGE_VELOCITY_379 16384;
BA_ "GenSigStartValue" SG_ 1118 DET_RCS_379 128;
BA_ "GenSigStartValue" SG_ 1118 DET_RANGE_VELOCITY_380 16384;
BA_ "GenSigStartValue" SG_ 1118 DET_RCS_380 128;
BA_ "GenSigStartValue" SG_ 1119 DET_RANGE_VELOCITY_381 16384;
BA_ "GenSigStartValue" SG_ 1119 DET_RCS_381 128;
BA_ "GenSigStartValue" SG_ 1119 DET_RANGE_VELOCITY_382 16384;
BA_ "GenSigStartValue" SG_ 1119 DET_RCS_382 128;
BA_ "GenSigStartValue" SG_ 1119 DET_RANGE_VELOCITY_383 16384;
BA_ "GenSigStartValue" SG_ 1119 DET_RCS_383 128;
BA_ "GenSigStartValue" SG_ 1119 DET_RANGE_VELOCITY_384 16384;
BA_ "GenSigStartValue" SG_ 1119 DET_RCS_384 128;
BA_ "GenSigStartValue" SG_ 1120 DET_RANGE_VELOCITY_385 16384;
BA_ "GenSigStartValue" SG_ 1120 DET_RCS_385 128;
BA_ "GenSigStartValue" SG_ 1120 DET_RANGE_VELOCITY_386 16384;
BA_ "GenSigStartValue" SG_ 1120 DET_RCS_386 128;
BA_ "GenSigStartValue" SG_ 1120 DET_RANGE_VELOCITY_387 16384;
BA_ "GenSigStartValue" SG_ 1120 DET_RCS_387 128;
BA_ "GenSigStartValue" SG_ 1120 DET_RANGE_VELOCITY_388 16384;
BA_ "GenSigStartValue" SG_ 1120 DET_RCS_388 128;
BA_ "GenSigStartValue" SG_ 1121 DET_RANGE_VELOCITY_389 16384;
BA_ "GenSigStartValue" SG_ 1121 DET_RCS_389 128;
BA_ "GenSigStartValue" SG_ 1121 DET_RANGE_VELOCITY_390 16384;
BA_ "GenSigStartValue" SG_ 1121 DET_RCS_390 128;
BA_ "GenSigStartValue" SG_ 1121 DET_RANGE_VELOCITY_391 16384;
BA_ "GenSigStartValue" SG_ 1121 DET_RCS_391 128;
BA_ "GenSigStartValue" SG_ 1121 DET_RANGE_VELOCITY_392 16384;
BA_ "GenSigStartValue" SG_ 1121 DET_RCS_392 128;
BA_ "GenSigStartValue" SG_ 1122 DET_RANGE_VELOCITY_393 16384;
BA_ "GenSigStartValue" SG_ 1122 DET_RCS_393 128;
BA_ "GenSigStartValue" SG_ 1122 DET_RANGE_VELOCITY_394 16384;
BA_ "GenSigStartValue" SG_ 1122 DET_RCS_394 128;
BA_ "GenSigStartValue" SG_ 1122 DET_RANGE_VELOCITY_395 16384;
BA_ "GenSigStartValue" SG_ 1122 DET_RCS_395 128;
BA_ "GenSigStartValue" SG_ 1122 DET_RANGE_VELOCITY_396 16384;
BA_ "GenSigStartValue" SG_ 1122 DET_RCS_396 128;
BA_ "GenSigStartValue" SG_ 1123 DET_RANGE_VELOCITY_397 16384;
BA_ "GenSigStartValue" SG_ 1123 DET_RCS_397 128;
BA_ "GenSigStartValue" SG_ 1123 DET_RANGE_VELOCITY_398 16384;
BA_ "GenSigStartValue" SG_ 1123 DET_RCS_398 128;
BA_ "GenSigStartValue" SG_ 1123 DET_RANGE_VELOCITY_399 16384;
BA_ "GenSigStartValue" SG_ 1123 DET_RCS_399 128;
BA_ "GenSigStartValue" SG_ 1123 DET_RANGE_VELOCITY_400 16384;
BA_ "GenSigStartValue" SG_ 1123 DET_RCS_400 128;
VAL_ 1112 DET_CONFD_AZIMUTH_353 0 "High" 1 "MidHigh" 2 "MidLow" 3 "Low" ;
VAL_ 1112 DET_CONFD_ELEVATION_353 0 "High" 1 "MidHigh" 2 "MidLow" 3 "Low" ;
VAL_ 1112 DET_IDM_353 0 "Not_IDM_Output" 1 "IDM_Output" ;
VAL_ 1112 DET_MTD_353 0 "Not_MTD_Output" 1 "MTD_Output" ;
VAL_ 1112 DET_BELOW_RAIN_THOLD_353 0 "DetBelowRainThold" 1 "DetAboveRainThold" ;
VAL_ 1112 DET_CONFD_AZIMUTH_354 0 "High" 1 "MidHigh" 2 "MidLow" 3 "Low" ;
VAL_ 1112 DET_CONFD_ELEVATION_354 0 "High" 1 "MidHigh" 2 "MidLow" 3 "Low" ;
VAL_ 1112 DET_IDM_354 0 "Not_IDM_Output" 1 "IDM_Output" ;
VAL_ 1112 DET_MTD_354 0 "Not_MTD_Output" 1 "MTD_Output" ;
VAL_ 1112 DET_BELOW_RAIN_THOLD_354 0 "DetBelowRainThold" 1 "DetAboveRainThold" ;
VAL_ 1112 DET_CONFD_AZIMUTH_355 0 "High" 1 "MidHigh" 2 "MidLow" 3 "Low" ;
VAL_ 1112 DET_CONFD_ELEVATION_355 0 "High" 1 "MidHigh" 2 "MidLow" 3 "Low" ;
VAL_ 1112 DET_IDM_355 0 "Not_IDM_Output" 1 "IDM_Output" ;
VAL_ 1112 DET_MTD_355 0 "Not_MTD_Output" 1 "MTD_Output" ;
VAL_ 1112 DET_BELOW_RAIN_THOLD_355 0 "DetBelowRainThold" 1 "DetAboveRainThold" ;
VAL_ 1112 DET_IDM_356 0 "Not_IDM_Output" 1 "IDM_Output" ;
VAL_ 1112 DET_MTD_356 0 "Not_MTD_Output" 1 "MTD_Output" ;
VAL_ 1112 DET_BELOW_RAIN_THOLD_356 0 "DetBelowRainThold" 1 "DetAboveRainThold" ;
VAL_ 1113 DET_CONFD_AZIMUTH_357 0 "High" 1 "MidHigh" 2 "MidLow" 3 "Low" ;
VAL_ 1113 DET_CONFD_ELEVATION_357 0 "High" 1 "MidHigh" 2 "MidLow" 3 "Low" ;
VAL_ 1113 DET_IDM_357 0 "Not_IDM_Output" 1 "IDM_Output" ;
VAL_ 1113 DET_MTD_357 0 "Not_MTD_Output" 1 "MTD_Output" ;
VAL_ 1113 DET_BELOW_RAIN_THOLD_357 0 "DetBelowRainThold" 1 "DetAboveRainThold" ;
VAL_ 1113 DET_CONFD_AZIMUTH_358 0 "High" 1 "MidHigh" 2 "MidLow" 3 "Low" ;
VAL_ 1113 DET_CONFD_ELEVATION_358 0 "High" 1 "MidHigh" 2 "MidLow" 3 "Low" ;
VAL_ 1113 DET_IDM_358 0 "Not_IDM_Output" 1 "IDM_Output" ;
VAL_ 1113 DET_MTD_358 0 "Not_MTD_Output" 1 "MTD_Output" ;
VAL_ 1113 DET_BELOW_RAIN_THOLD_358 0 "DetBelowRainThold" 1 "DetAboveRainThold" ;
VAL_ 1113 DET_CONFD_AZIMUTH_359 0 "High" 1 "MidHigh" 2 "MidLow" 3 "Low" ;
VAL_ 1113 DET_CONFD_ELEVATION_359 0 "High" 1 "MidHigh" 2 "MidLow" 3 "Low" ;
VAL_ 1113 DET_IDM_359 0 "Not_IDM_Output" 1 "IDM_Output" ;
VAL_ 1113 DET_MTD_359 0 "Not_MTD_Output" 1 "MTD_Output" ;
VAL_ 1113 DET_BELOW_RAIN_THOLD_359 0 "DetBelowRainThold" 1 "DetAboveRainThold" ;
VAL_ 1113 DET_IDM_360 0 "Not_IDM_Output" 1 "IDM_Output" ;
VAL_ 1113 DET_MTD_360 0 "Not_MTD_Output" 1 "MTD_Output" ;
VAL_ 1113 DET_BELOW_RAIN_THOLD_360 0 "DetBelowRainThold" 1 "DetAboveRainThold" ;
VAL_ 1114 DET_CONFD_AZIMUTH_361 0 "High" 1 "MidHigh" 2 "MidLow" 3 "Low" ;
VAL_ 1114 DET_CONFD_ELEVATION_361 0 "High" 1 "MidHigh" 2 "MidLow" 3 "Low" ;
VAL_ 1114 DET_IDM_361 0 "Not_IDM_Output" 1 "IDM_Output" ;
VAL_ 1114 DET_MTD_361 0 "Not_MTD_Output" 1 "MTD_Output" ;
VAL_ 1114 DET_BELOW_RAIN_THOLD_361 0 "DetBelowRainThold" 1 "DetAboveRainThold" ;
VAL_ 1114 DET_CONFD_AZIMUTH_362 0 "High" 1 "MidHigh" 2 "MidLow" 3 "Low" ;
VAL_ 1114 DET_CONFD_ELEVATION_362 0 "High" 1 "MidHigh" 2 "MidLow" 3 "Low" ;
VAL_ 1114 DET_IDM_362 0 "Not_IDM_Output" 1 "IDM_Output" ;
VAL_ 1114 DET_MTD_362 0 "Not_MTD_Output" 1 "MTD_Output" ;
VAL_ 1114 DET_BELOW_RAIN_THOLD_362 0 "DetBelowRainThold" 1 "DetAboveRainThold" ;
VAL_ 1114 DET_CONFD_AZIMUTH_363 0 "High" 1 "MidHigh" 2 "MidLow" 3 "Low" ;
VAL_ 1114 DET_CONFD_ELEVATION_363 0 "High" 1 "MidHigh" 2 "MidLow" 3 "Low" ;
VAL_ 1114 DET_IDM_363 0 "Not_IDM_Output" 1 "IDM_Output" ;
VAL_ 1114 DET_MTD_363 0 "Not_MTD_Output" 1 "MTD_Output" ;
VAL_ 1114 DET_BELOW_RAIN_THOLD_363 0 "DetBelowRainThold" 1 "DetAboveRainThold" ;
VAL_ 1114 DET_IDM_364 0 "Not_IDM_Output" 1 "IDM_Output" ;
VAL_ 1114 DET_MTD_364 0 "Not_MTD_Output" 1 "MTD_Output" ;
VAL_ 1114 DET_BELOW_RAIN_THOLD_364 0 "DetBelowRainThold" 1 "DetAboveRainThold" ;
VAL_ 1115 DET_CONFD_AZIMUTH_365 0 "High" 1 "MidHigh" 2 "MidLow" 3 "Low" ;
VAL_ 1115 DET_CONFD_ELEVATION_365 0 "High" 1 "MidHigh" 2 "MidLow" 3 "Low" ;
VAL_ 1115 DET_IDM_365 0 "Not_IDM_Output" 1 "IDM_Output" ;
VAL_ 1115 DET_MTD_365 0 "Not_MTD_Output" 1 "MTD_Output" ;
VAL_ 1115 DET_BELOW_RAIN_THOLD_365 0 "DetBelowRainThold" 1 "DetAboveRainThold" ;
VAL_ 1115 DET_CONFD_AZIMUTH_366 0 "High" 1 "MidHigh" 2 "MidLow" 3 "Low" ;
VAL_ 1115 DET_CONFD_ELEVATION_366 0 "High" 1 "MidHigh" 2 "MidLow" 3 "Low" ;
VAL_ 1115 DET_IDM_366 0 "Not_IDM_Output" 1 "IDM_Output" ;
VAL_ 1115 DET_MTD_366 0 "Not_MTD_Output" 1 "MTD_Output" ;
VAL_ 1115 DET_BELOW_RAIN_THOLD_366 0 "DetBelowRainThold" 1 "DetAboveRainThold" ;
VAL_ 1115 DET_CONFD_AZIMUTH_367 0 "High" 1 "MidHigh" 2 "MidLow" 3 "Low" ;
VAL_ 1115 DET_CONFD_ELEVATION_367 0 "High" 1 "MidHigh" 2 "MidLow" 3 "Low" ;
VAL_ 1115 DET_IDM_367 0 "Not_IDM_Output" 1 "IDM_Output" ;
VAL_ 1115 DET_MTD_367 0 "Not_MTD_Output" 1 "MTD_Output" ;
VAL_ 1115 DET_BELOW_RAIN_THOLD_367 0 "DetBelowRainThold" 1 "DetAboveRainThold" ;
VAL_ 1115 DET_IDM_368 0 "Not_IDM_Output" 1 "IDM_Output" ;
VAL_ 1115 DET_MTD_368 0 "Not_MTD_Output" 1 "MTD_Output" ;
VAL_ 1115 DET_BELOW_RAIN_THOLD_368 0 "DetBelowRainThold" 1 "DetAboveRainThold" ;
VAL_ 1116 DET_CONFD_AZIMUTH_369 0 "High" 1 "MidHigh" 2 "MidLow" 3 "Low" ;
VAL_ 1116 DET_CONFD_ELEVATION_369 0 "High" 1 "MidHigh" 2 "MidLow" 3 "Low" ;
VAL_ 1116 DET_IDM_369 0 "Not_IDM_Output" 1 "IDM_Output" ;
VAL_ 1116 DET_MTD_369 0 "Not_MTD_Output" 1 "MTD_Output" ;
VAL_ 1116 DET_BELOW_RAIN_THOLD_369 0 "DetBelowRainThold" 1 "DetAboveRainThold" ;
VAL_ 1116 DET_CONFD_AZIMUTH_370 0 "High" 1 "MidHigh" 2 "MidLow" 3 "Low" ;
VAL_ 1116 DET_CONFD_ELEVATION_370 0 "High" 1 "MidHigh" 2 "MidLow" 3 "Low" ;
VAL_ 1116 DET_IDM_370 0 "Not_IDM_Output" 1 "IDM_Output" ;
VAL_ 1116 DET_MTD_370 0 "Not_MTD_Output" 1 "MTD_Output" ;
VAL_ 1116 DET_BELOW_RAIN_THOLD_370 0 "DetBelowRainThold" 1 "DetAboveRainThold" ;
VAL_ 1116 DET_CONFD_AZIMUTH_371 0 "High" 1 "MidHigh" 2 "MidLow" 3 "Low" ;
VAL_ 1116 DET_CONFD_ELEVATION_371 0 "High" 1 "MidHigh" 2 "MidLow" 3 "Low" ;
VAL_ 1116 DET_IDM_371 0 "Not_IDM_Output" 1 "IDM_Output" ;
VAL_ 1116 DET_MTD_371 0 "Not_MTD_Output" 1 "MTD_Output" ;
VAL_ 1116 DET_BELOW_RAIN_THOLD_371 0 "DetBelowRainThold" 1 "DetAboveRainThold" ;
VAL_ 1116 DET_IDM_372 0 "Not_IDM_Output" 1 "IDM_Output" ;
VAL_ 1116 DET_MTD_372 0 "Not_MTD_Output" 1 "MTD_Output" ;
VAL_ 1116 DET_BELOW_RAIN_THOLD_372 0 "DetBelowRainThold" 1 "DetAboveRainThold" ;
VAL_ 1117 DET_CONFD_AZIMUTH_373 0 "High" 1 "MidHigh" 2 "MidLow" 3 "Low" ;
VAL_ 1117 DET_CONFD_ELEVATION_373 0 "High" 1 "MidHigh" 2 "MidLow" 3 "Low" ;
VAL_ 1117 DET_IDM_373 0 "Not_IDM_Output" 1 "IDM_Output" ;
VAL_ 1117 DET_MTD_373 0 "Not_MTD_Output" 1 "MTD_Output" ;
VAL_ 1117 DET_BELOW_RAIN_THOLD_373 0 "DetBelowRainThold" 1 "DetAboveRainThold" ;
VAL_ 1117 DET_CONFD_AZIMUTH_374 0 "High" 1 "MidHigh" 2 "MidLow" 3 "Low" ;
VAL_ 1117 DET_CONFD_ELEVATION_374 0 "High" 1 "MidHigh" 2 "MidLow" 3 "Low" ;
VAL_ 1117 DET_IDM_374 0 "Not_IDM_Output" 1 "IDM_Output" ;
VAL_ 1117 DET_MTD_374 0 "Not_MTD_Output" 1 "MTD_Output" ;
VAL_ 1117 DET_BELOW_RAIN_THOLD_374 0 "DetBelowRainThold" 1 "DetAboveRainThold" ;
VAL_ 1117 DET_CONFD_AZIMUTH_375 0 "High" 1 "MidHigh" 2 "MidLow" 3 "Low" ;
VAL_ 1117 DET_CONFD_ELEVATION_375 0 "High" 1 "MidHigh" 2 "MidLow" 3 "Low" ;
VAL_ 1117 DET_IDM_375 0 "Not_IDM_Output" 1 "IDM_Output" ;
VAL_ 1117 DET_MTD_375 0 "Not_MTD_Output" 1 "MTD_Output" ;
VAL_ 1117 DET_BELOW_RAIN_THOLD_375 0 "DetBelowRainThold" 1 "DetAboveRainThold" ;
VAL_ 1117 DET_IDM_376 0 "Not_IDM_Output" 1 "IDM_Output" ;
VAL_ 1117 DET_MTD_376 0 "Not_MTD_Output" 1 "MTD_Output" ;
VAL_ 1117 DET_BELOW_RAIN_THOLD_376 0 "DetBelowRainThold" 1 "DetAboveRainThold" ;
VAL_ 1118 DET_CONFD_AZIMUTH_377 0 "High" 1 "MidHigh" 2 "MidLow" 3 "Low" ;
VAL_ 1118 DET_CONFD_ELEVATION_377 0 "High" 1 "MidHigh" 2 "MidLow" 3 "Low" ;
VAL_ 1118 DET_IDM_377 0 "Not_IDM_Output" 1 "IDM_Output" ;
VAL_ 1118 DET_MTD_377 0 "Not_MTD_Output" 1 "MTD_Output" ;
VAL_ 1118 DET_BELOW_RAIN_THOLD_377 0 "DetBelowRainThold" 1 "DetAboveRainThold" ;
VAL_ 1118 DET_CONFD_AZIMUTH_378 0 "High" 1 "MidHigh" 2 "MidLow" 3 "Low" ;
VAL_ 1118 DET_CONFD_ELEVATION_378 0 "High" 1 "MidHigh" 2 "MidLow" 3 "Low" ;
VAL_ 1118 DET_IDM_378 0 "Not_IDM_Output" 1 "IDM_Output" ;
VAL_ 1118 DET_MTD_378 0 "Not_MTD_Output" 1 "MTD_Output" ;
VAL_ 1118 DET_BELOW_RAIN_THOLD_378 0 "DetBelowRainThold" 1 "DetAboveRainThold" ;
VAL_ 1118 DET_CONFD_AZIMUTH_379 0 "High" 1 "MidHigh" 2 "MidLow" 3 "Low" ;
VAL_ 1118 DET_CONFD_ELEVATION_379 0 "High" 1 "MidHigh" 2 "MidLow" 3 "Low" ;
VAL_ 1118 DET_IDM_379 0 "Not_IDM_Output" 1 "IDM_Output" ;
VAL_ 1118 DET_MTD_379 0 "Not_MTD_Output" 1 "MTD_Output" ;
VAL_ 1118 DET_BELOW_RAIN_THOLD_379 0 "DetBelowRainThold" 1 "DetAboveRainThold" ;
VAL_ 1118 DET_IDM_380 0 "Not_IDM_Output" 1 "IDM_Output" ;
VAL_ 1118 DET_MTD_380 0 "Not_MTD_Output" 1 "MTD_Output" ;
VAL_ 1118 DET_BELOW_RAIN_THOLD_380 0 "DetBelowRainThold" 1 "DetAboveRainThold" ;
VAL_ 1119 DET_CONFD_AZIMUTH_381 0 "High" 1 "MidHigh" 2 "MidLow" 3 "Low" ;
VAL_ 1119 DET_CONFD_ELEVATION_381 0 "High" 1 "MidHigh" 2 "MidLow" 3 "Low" ;
VAL_ 1119 DET_IDM_381 0 "Not_IDM_Output" 1 "IDM_Output" ;
VAL_ 1119 DET_MTD_381 0 "Not_MTD_Output" 1 "MTD_Output" ;
VAL_ 1119 DET_BELOW_RAIN_THOLD_381 0 "DetBelowRainThold" 1 "DetAboveRainThold" ;
VAL_ 1119 DET_CONFD_AZIMUTH_382 0 "High" 1 "MidHigh" 2 "MidLow" 3 "Low" ;
VAL_ 1119 DET_CONFD_ELEVATION_382 0 "High" 1 "MidHigh" 2 "MidLow" 3 "Low" ;
VAL_ 1119 DET_IDM_382 0 "Not_IDM_Output" 1 "IDM_Output" ;
VAL_ 1119 DET_MTD_382 0 "Not_MTD_Output" 1 "MTD_Output" ;
VAL_ 1119 DET_BELOW_RAIN_THOLD_382 0 "DetBelowRainThold" 1 "DetAboveRainThold" ;
VAL_ 1119 DET_CONFD_AZIMUTH_383 0 "High" 1 "MidHigh" 2 "MidLow" 3 "Low" ;
VAL_ 1119 DET_CONFD_ELEVATION_383 0 "High" 1 "MidHigh" 2 "MidLow" 3 "Low" ;
VAL_ 1119 DET_IDM_383 0 "Not_IDM_Output" 1 "IDM_Output" ;
VAL_ 1119 DET_MTD_383 0 "Not_MTD_Output" 1 "MTD_Output" ;
VAL_ 1119 DET_BELOW_RAIN_THOLD_383 0 "DetBelowRainThold" 1 "DetAboveRainThold" ;
VAL_ 1119 DET_IDM_384 0 "Not_IDM_Output" 1 "IDM_Output" ;
VAL_ 1119 DET_MTD_384 0 "Not_MTD_Output" 1 "MTD_Output" ;
VAL_ 1119 DET_BELOW_RAIN_THOLD_384 0 "DetBelowRainThold" 1 "DetAboveRainThold" ;
VAL_ 1120 DET_CONFD_AZIMUTH_385 0 "High" 1 "MidHigh" 2 "MidLow" 3 "Low" ;
VAL_ 1120 DET_CONFD_ELEVATION_385 0 "High" 1 "MidHigh" 2 "MidLow" 3 "Low" ;
VAL_ 1120 DET_IDM_385 0 "Not_IDM_Output" 1 "IDM_Output" ;
VAL_ 1120 DET_MTD_385 0 "Not_MTD_Output" 1 "MTD_Output" ;
VAL_ 1120 DET_BELOW_RAIN_THOLD_385 0 "DetBelowRainThold" 1 "DetAboveRainThold" ;
VAL_ 1120 DET_CONFD_AZIMUTH_386 0 "High" 1 "MidHigh" 2 "MidLow" 3 "Low" ;
VAL_ 1120 DET_CONFD_ELEVATION_386 0 "High" 1 "MidHigh" 2 "MidLow" 3 "Low" ;
VAL_ 1120 DET_IDM_386 0 "Not_IDM_Output" 1 "IDM_Output" ;
VAL_ 1120 DET_MTD_386 0 "Not_MTD_Output" 1 "MTD_Output" ;
VAL_ 1120 DET_BELOW_RAIN_THOLD_386 0 "DetBelowRainThold" 1 "DetAboveRainThold" ;
VAL_ 1120 DET_CONFD_AZIMUTH_387 0 "High" 1 "MidHigh" 2 "MidLow" 3 "Low" ;
VAL_ 1120 DET_CONFD_ELEVATION_387 0 "High" 1 "MidHigh" 2 "MidLow" 3 "Low" ;
VAL_ 1120 DET_IDM_387 0 "Not_IDM_Output" 1 "IDM_Output" ;
VAL_ 1120 DET_MTD_387 0 "Not_MTD_Output" 1 "MTD_Output" ;
VAL_ 1120 DET_BELOW_RAIN_THOLD_387 0 "DetBelowRainThold" 1 "DetAboveRainThold" ;
VAL_ 1120 DET_IDM_388 0 "Not_IDM_Output" 1 "IDM_Output" ;
VAL_ 1120 DET_MTD_388 0 "Not_MTD_Output" 1 "MTD_Output" ;
VAL_ 1120 DET_BELOW_RAIN_THOLD_388 0 "DetBelowRainThold" 1 "DetAboveRainThold" ;
VAL_ 1121 DET_CONFD_AZIMUTH_389 0 "High" 1 "MidHigh" 2 "MidLow" 3 "Low" ;
VAL_ 1121 DET_CONFD_ELEVATION_389 0 "High" 1 "MidHigh" 2 "MidLow" 3 "Low" ;
VAL_ 1121 DET_IDM_389 0 "Not_IDM_Output" 1 "IDM_Output" ;
VAL_ 1121 DET_MTD_389 0 "Not_MTD_Output" 1 "MTD_Output" ;
VAL_ 1121 DET_BELOW_RAIN_THOLD_389 0 "DetBelowRainThold" 1 "DetAboveRainThold" ;
VAL_ 1121 DET_CONFD_AZIMUTH_390 0 "High" 1 "MidHigh" 2 "MidLow" 3 "Low" ;
VAL_ 1121 DET_CONFD_ELEVATION_390 0 "High" 1 "MidHigh" 2 "MidLow" 3 "Low" ;
VAL_ 1121 DET_IDM_390 0 "Not_IDM_Output" 1 "IDM_Output" ;
VAL_ 1121 DET_MTD_390 0 "Not_MTD_Output" 1 "MTD_Output" ;
VAL_ 1121 DET_BELOW_RAIN_THOLD_390 0 "DetBelowRainThold" 1 "DetAboveRainThold" ;
VAL_ 1121 DET_CONFD_AZIMUTH_391 0 "High" 1 "MidHigh" 2 "MidLow" 3 "Low" ;
VAL_ 1121 DET_CONFD_ELEVATION_391 0 "High" 1 "MidHigh" 2 "MidLow" 3 "Low" ;
VAL_ 1121 DET_IDM_391 0 "Not_IDM_Output" 1 "IDM_Output" ;
VAL_ 1121 DET_MTD_391 0 "Not_MTD_Output" 1 "MTD_Output" ;
VAL_ 1121 DET_BELOW_RAIN_THOLD_391 0 "DetBelowRainThold" 1 "DetAboveRainThold" ;
VAL_ 1121 DET_IDM_392 0 "Not_IDM_Output" 1 "IDM_Output" ;
VAL_ 1121 DET_MTD_392 0 "Not_MTD_Output" 1 "MTD_Output" ;
VAL_ 1121 DET_BELOW_RAIN_THOLD_392 0 "DetBelowRainThold" 1 "DetAboveRainThold" ;
VAL_ 1122 DET_CONFD_AZIMUTH_393 0 "High" 1 "MidHigh" 2 "MidLow" 3 "Low" ;
VAL_ 1122 DET_CONFD_ELEVATION_393 0 "High" 1 "MidHigh" 2 "MidLow" 3 "Low" ;
VAL_ 1122 DET_IDM_393 0 "Not_IDM_Output" 1 "IDM_Output" ;
VAL_ 1122 DET_MTD_393 0 "Not_MTD_Output" 1 "MTD_Output" ;
VAL_ 1122 DET_BELOW_RAIN_THOLD_393 0 "DetBelowRainThold" 1 "DetAboveRainThold" ;
VAL_ 1122 DET_CONFD_AZIMUTH_394 0 "High" 1 "MidHigh" 2 "MidLow" 3 "Low" ;
VAL_ 1122 DET_CONFD_ELEVATION_394 0 "High" 1 "MidHigh" 2 "MidLow" 3 "Low" ;
VAL_ 1122 DET_IDM_394 0 "Not_IDM_Output" 1 "IDM_Output" ;
VAL_ 1122 DET_MTD_394 0 "Not_MTD_Output" 1 "MTD_Output" ;
VAL_ 1122 DET_BELOW_RAIN_THOLD_394 0 "DetBelowRainThold" 1 "DetAboveRainThold" ;
VAL_ 1122 DET_CONFD_AZIMUTH_395 0 "High" 1 "MidHigh" 2 "MidLow" 3 "Low" ;
VAL_ 1122 DET_CONFD_ELEVATION_395 0 "High" 1 "MidHigh" 2 "MidLow" 3 "Low" ;
VAL_ 1122 DET_IDM_395 0 "Not_IDM_Output" 1 "IDM_Output" ;
VAL_ 1122 DET_MTD_395 0 "Not_MTD_Output" 1 "MTD_Output" ;
VAL_ 1122 DET_BELOW_RAIN_THOLD_395 0 "DetBelowRainThold" 1 "DetAboveRainThold" ;
VAL_ 1122 DET_IDM_396 0 "Not_IDM_Output" 1 "IDM_Output" ;
VAL_ 1122 DET_MTD_396 0 "Not_MTD_Output" 1 "MTD_Output" ;
VAL_ 1122 DET_BELOW_RAIN_THOLD_396 0 "DetBelowRainThold" 1 "DetAboveRainThold" ;
VAL_ 1123 DET_CONFD_AZIMUTH_397 0 "High" 1 "MidHigh" 2 "MidLow" 3 "Low" ;
VAL_ 1123 DET_CONFD_ELEVATION_397 0 "High" 1 "MidHigh" 2 "MidLow" 3 "Low" ;
VAL_ 1123 DET_IDM_397 0 "Not_IDM_Output" 1 "IDM_Output" ;
VAL_ 1123 DET_MTD_397 0 "Not_MTD_Output" 1 "MTD_Output" ;
VAL_ 1123 DET_BELOW_RAIN_THOLD_397 0 "DetBelowRainThold" 1 "DetAboveRainThold" ;
VAL_ 1123 DET_CONFD_AZIMUTH_398 0 "High" 1 "MidHigh" 2 "MidLow" 3 "Low" ;
VAL_ 1123 DET_CONFD_ELEVATION_398 0 "High" 1 "MidHigh" 2 "MidLow" 3 "Low" ;
VAL_ 1123 DET_IDM_398 0 "Not_IDM_Output" 1 "IDM_Output" ;
VAL_ 1123 DET_MTD_398 0 "Not_MTD_Output" 1 "MTD_Output" ;
VAL_ 1123 DET_BELOW_RAIN_THOLD_398 0 "DetBelowRainThold" 1 "DetAboveRainThold" ;
VAL_ 1123 DET_CONFD_AZIMUTH_399 0 "High" 1 "MidHigh" 2 "MidLow" 3 "Low" ;
VAL_ 1123 DET_CONFD_ELEVATION_399 0 "High" 1 "MidHigh" 2 "MidLow" 3 "Low" ;
VAL_ 1123 DET_IDM_399 0 "Not_IDM_Output" 1 "IDM_Output" ;
VAL_ 1123 DET_MTD_399 0 "Not_MTD_Output" 1 "MTD_Output" ;
VAL_ 1123 DET_BELOW_RAIN_THOLD_399 0 "DetBelowRainThold" 1 "DetAboveRainThold" ;
VAL_ 1123 DET_IDM_400 0 "Not_IDM_Output" 1 "IDM_Output" ;
VAL_ 1123 DET_MTD_400 0 "Not_MTD_Output" 1 "MTD_Output" ;
VAL_ 1123 DET_BELOW_RAIN_THOLD_400 0 "DetBelowRainThold" 1 "DetAboveRainThold" ;
SIG_GROUP_ 1112 Detections_353_356 1 : DET_PROB_1STAZHYPO_353 DET_PROB_1STAZHYPO_354 DET_PROB_1STAZHYPO_355 DET_PROB_1STAZHYPO_356 DET_IDM_353 DET_IDM_354 DET_IDM_355 DET_IDM_356 DET_MTD_356 DET_MTD_355 DET_MTD_354 DET_MTD_353 DET_BELOW_RAIN_THOLD_356 DET_BELOW_RAIN_THOLD_355 DET_BELOW_RAIN_THOLD_354 DET_BELOW_RAIN_THOLD_353 DET_MH_CRC16_353_356 DET_MH_CYCLE_COUNTER_353_356 DET_MH_SCAN_INDEX_4LSB_353_356 DET_CONFD_ELEVATION_353 DET_CONFD_AZIMUTH_353 DET_HVC_FLAG_353 DET_EXISTENCE_PROB_353 DET_SNR_353 DET_SUPER_RES_TARGET_353 DET_BI_STATIC_FLAG_353 DET_RCS_353 DET_ELEVATION_ERR_353 DET_ELEVATION_353 DET_AZIMUTH_ERR_353 DET_AZIMUTH_353 DET_RANGE_VELOCITY_ERR_353 DET_RANGE_VELOCITY_353 DET_RANGE_ERR_353 DET_RANGE_353 DET_CONFD_ELEVATION_354 DET_CONFD_AZIMUTH_354 DET_HVC_FLAG_354 DET_EXISTENCE_PROB_354 DET_SNR_354 DET_SUPER_RES_TARGET_354 DET_BI_STATIC_FLAG_354 DET_RCS_354 DET_ELEVATION_ERR_354 DET_ELEVATION_354 DET_AZIMUTH_ERR_354 DET_AZIMUTH_354 DET_RANGE_VELOCITY_ERR_354 DET_RANGE_VELOCITY_354 DET_RANGE_ERR_354 DET_RANGE_354 DET_CONFD_ELEVATION_355 DET_CONFD_AZIMUTH_355 DET_HVC_FLAG_355 DET_EXISTENCE_PROB_355 DET_SNR_355 DET_SUPER_RES_TARGET_355 DET_BI_STATIC_FLAG_355 DET_RCS_355 DET_ELEVATION_ERR_355 DET_ELEVATION_355 DET_AZIMUTH_ERR_355 DET_AZIMUTH_355 DET_RANGE_VELOCITY_ERR_355 DET_RANGE_VELOCITY_355 DET_RANGE_ERR_355 DET_RANGE_355 DET_CONFD_ELEVATION_356 DET_CONFD_AZIMUTH_356 DET_HVC_FLAG_356 DET_EXISTENCE_PROB_356 DET_SNR_356 DET_SUPER_RES_TARGET_356 DET_BI_STATIC_FLAG_356 DET_RCS_356 DET_ELEVATION_ERR_356 DET_ELEVATION_356 DET_AZIMUTH_ERR_356 DET_AZIMUTH_356 DET_RANGE_VELOCITY_ERR_356 DET_RANGE_VELOCITY_356 DET_RANGE_ERR_356 DET_RANGE_356;
SIG_GROUP_ 1113 Detections_357_360 1 : DET_PROB_1STAZHYPO_357 DET_PROB_1STAZHYPO_358 DET_PROB_1STAZHYPO_359 DET_PROB_1STAZHYPO_360 DET_IDM_357 DET_IDM_358 DET_IDM_359 DET_IDM_360 DET_MTD_360 DET_MTD_359 DET_MTD_358 DET_MTD_357 DET_BELOW_RAIN_THOLD_360 DET_BELOW_RAIN_THOLD_359 DET_BELOW_RAIN_THOLD_358 DET_BELOW_RAIN_THOLD_357 DET_MH_CRC16_357_360 DET_MH_CYCLE_COUNTER_357_360 DET_MH_SCAN_INDEX_4LSB_357_360 DET_CONFD_ELEVATION_357 DET_CONFD_AZIMUTH_357 DET_HVC_FLAG_357 DET_EXISTENCE_PROB_357 DET_SNR_357 DET_SUPER_RES_TARGET_357 DET_BI_STATIC_FLAG_357 DET_RCS_357 DET_ELEVATION_ERR_357 DET_ELEVATION_357 DET_AZIMUTH_ERR_357 DET_AZIMUTH_357 DET_RANGE_VELOCITY_ERR_357 DET_RANGE_VELOCITY_357 DET_RANGE_ERR_357 DET_RANGE_357 DET_CONFD_ELEVATION_358 DET_CONFD_AZIMUTH_358 DET_HVC_FLAG_358 DET_EXISTENCE_PROB_358 DET_SNR_358 DET_SUPER_RES_TARGET_358 DET_BI_STATIC_FLAG_358 DET_RCS_358 DET_ELEVATION_ERR_358 DET_ELEVATION_358 DET_AZIMUTH_ERR_358 DET_AZIMUTH_358 DET_RANGE_VELOCITY_ERR_358 DET_RANGE_VELOCITY_358 DET_RANGE_ERR_358 DET_RANGE_358 DET_CONFD_ELEVATION_359 DET_CONFD_AZIMUTH_359 DET_HVC_FLAG_359 DET_EXISTENCE_PROB_359 DET_SNR_359 DET_SUPER_RES_TARGET_359 DET_BI_STATIC_FLAG_359 DET_RCS_359 DET_ELEVATION_ERR_359 DET_ELEVATION_359 DET_AZIMUTH_ERR_359 DET_AZIMUTH_359 DET_RANGE_VELOCITY_ERR_359 DET_RANGE_VELOCITY_359 DET_RANGE_ERR_359 DET_RANGE_359 DET_CONFD_ELEVATION_360 DET_CONFD_AZIMUTH_360 DET_HVC_FLAG_360 DET_EXISTENCE_PROB_360 DET_SNR_360 DET_SUPER_RES_TARGET_360 DET_BI_STATIC_FLAG_360 DET_RCS_360 DET_ELEVATION_ERR_360 DET_ELEVATION_360 DET_AZIMUTH_ERR_360 DET_AZIMUTH_360 DET_RANGE_VELOCITY_ERR_360 DET_RANGE_VELOCITY_360 DET_RANGE_ERR_360 DET_RANGE_360;
SIG_GROUP_ 1114 Detections_361_364 1 : DET_PROB_1STAZHYPO_361 DET_PROB_1STAZHYPO_362 DET_PROB_1STAZHYPO_363 DET_PROB_1STAZHYPO_364 DET_IDM_361 DET_IDM_362 DET_IDM_363 DET_IDM_364 DET_MTD_364 DET_MTD_363 DET_MTD_362 DET_MTD_361 DET_BELOW_RAIN_THOLD_364 DET_BELOW_RAIN_THOLD_363 DET_BELOW_RAIN_THOLD_362 DET_BELOW_RAIN_THOLD_361 DET_MH_CRC16_361_364 DET_MH_CYCLE_COUNTER_361_364 DET_MH_SCAN_INDEX_4LSB_361_364 DET_CONFD_ELEVATION_361 DET_CONFD_AZIMUTH_361 DET_HVC_FLAG_361 DET_EXISTENCE_PROB_361 DET_SNR_361 DET_SUPER_RES_TARGET_361 DET_BI_STATIC_FLAG_361 DET_RCS_361 DET_ELEVATION_ERR_361 DET_ELEVATION_361 DET_AZIMUTH_ERR_361 DET_AZIMUTH_361 DET_RANGE_VELOCITY_ERR_361 DET_RANGE_VELOCITY_361 DET_RANGE_ERR_361 DET_RANGE_361 DET_CONFD_ELEVATION_362 DET_CONFD_AZIMUTH_362 DET_HVC_FLAG_362 DET_EXISTENCE_PROB_362 DET_SNR_362 DET_SUPER_RES_TARGET_362 DET_BI_STATIC_FLAG_362 DET_RCS_362 DET_ELEVATION_ERR_362 DET_ELEVATION_362 DET_AZIMUTH_ERR_362 DET_AZIMUTH_362 DET_RANGE_VELOCITY_ERR_362 DET_RANGE_VELOCITY_362 DET_RANGE_ERR_362 DET_RANGE_362 DET_CONFD_ELEVATION_363 DET_CONFD_AZIMUTH_363 DET_HVC_FLAG_363 DET_EXISTENCE_PROB_363 DET_SNR_363 DET_SUPER_RES_TARGET_363 DET_BI_STATIC_FLAG_363 DET_RCS_363 DET_ELEVATION_ERR_363 DET_ELEVATION_363 DET_AZIMUTH_ERR_363 DET_AZIMUTH_363 DET_RANGE_VELOCITY_ERR_363 DET_RANGE_VELOCITY_363 DET_RANGE_ERR_363 DET_RANGE_363 DET_CONFD_ELEVATION_364 DET_CONFD_AZIMUTH_364 DET_HVC_FLAG_364 DET_EXISTENCE_PROB_364 DET_SNR_364 DET_SUPER_RES_TARGET_364 DET_BI_STATIC_FLAG_364 DET_RCS_364 DET_ELEVATION_ERR_364 DET_ELEVATION_364 DET_AZIMUTH_ERR_364 DET_AZIMUTH_364 DET_RANGE_VELOCITY_ERR_364 DET_RANGE_VELOCITY_364 DET_RANGE_ERR_364 DET_RANGE_364;
SIG_GROUP_ 1115 Detections_365_368 1 : DET_PROB_1STAZHYPO_365 DET_PROB_1STAZHYPO_366 DET_PROB_1STAZHYPO_367 DET_PROB_1STAZHYPO_368 DET_IDM_365 DET_IDM_366 DET_IDM_367 DET_IDM_368 DET_MTD_368 DET_MTD_367 DET_MTD_366 DET_MTD_365 DET_BELOW_RAIN_THOLD_368 DET_BELOW_RAIN_THOLD_367 DET_BELOW_RAIN_THOLD_366 DET_BELOW_RAIN_THOLD_365 DET_MH_CRC16_365_368 DET_MH_CYCLE_COUNTER_365_368 DET_MH_SCAN_INDEX_4LSB_365_368 DET_CONFD_ELEVATION_365 DET_CONFD_AZIMUTH_365 DET_HVC_FLAG_365 DET_EXISTENCE_PROB_365 DET_SNR_365 DET_SUPER_RES_TARGET_365 DET_BI_STATIC_FLAG_365 DET_RCS_365 DET_ELEVATION_ERR_365 DET_ELEVATION_365 DET_AZIMUTH_ERR_365 DET_AZIMUTH_365 DET_RANGE_VELOCITY_ERR_365 DET_RANGE_VELOCITY_365 DET_RANGE_ERR_365 DET_RANGE_365 DET_CONFD_ELEVATION_366 DET_CONFD_AZIMUTH_366 DET_HVC_FLAG_366 DET_EXISTENCE_PROB_366 DET_SNR_366 DET_SUPER_RES_TARGET_366 DET_BI_STATIC_FLAG_366 DET_RCS_366 DET_ELEVATION_ERR_366 DET_ELEVATION_366 DET_AZIMUTH_ERR_366 DET_AZIMUTH_366 DET_RANGE_VELOCITY_ERR_366 DET_RANGE_VELOCITY_366 DET_RANGE_ERR_366 DET_RANGE_366 DET_CONFD_ELEVATION_367 DET_CONFD_AZIMUTH_367 DET_HVC_FLAG_367 DET_EXISTENCE_PROB_367 DET_SNR_367 DET_SUPER_RES_TARGET_367 DET_BI_STATIC_FLAG_367 DET_RCS_367 DET_ELEVATION_ERR_367 DET_ELEVATION_367 DET_AZIMUTH_ERR_367 DET_AZIMUTH_367 DET_RANGE_VELOCITY_ERR_367 DET_RANGE_VELOCITY_367 DET_RANGE_ERR_367 DET_RANGE_367 DET_CONFD_ELEVATION_368 DET_CONFD_AZIMUTH_368 DET_HVC_FLAG_368 DET_EXISTENCE_PROB_368 DET_SNR_368 DET_SUPER_RES_TARGET_368 DET_BI_STATIC_FLAG_368 DET_RCS_368 DET_ELEVATION_ERR_368 DET_ELEVATION_368 DET_AZIMUTH_ERR_368 DET_AZIMUTH_368 DET_RANGE_VELOCITY_ERR_368 DET_RANGE_VELOCITY_368 DET_RANGE_ERR_368 DET_RANGE_368;
SIG_GROUP_ 1116 Detections_369_372 1 : DET_PROB_1STAZHYPO_369 DET_PROB_1STAZHYPO_370 DET_PROB_1STAZHYPO_371 DET_PROB_1STAZHYPO_372 DET_IDM_369 DET_IDM_370 DET_IDM_371 DET_IDM_372 DET_MTD_372 DET_MTD_371 DET_MTD_370 DET_MTD_369 DET_BELOW_RAIN_THOLD_372 DET_BELOW_RAIN_THOLD_371 DET_BELOW_RAIN_THOLD_370 DET_BELOW_RAIN_THOLD_369 DET_MH_CRC16_369_372 DET_MH_CYCLE_COUNTER_369_372 DET_MH_SCAN_INDEX_4LSB_369_372 DET_CONFD_ELEVATION_369 DET_CONFD_AZIMUTH_369 DET_HVC_FLAG_369 DET_EXISTENCE_PROB_369 DET_SNR_369 DET_SUPER_RES_TARGET_369 DET_BI_STATIC_FLAG_369 DET_RCS_369 DET_ELEVATION_ERR_369 DET_ELEVATION_369 DET_AZIMUTH_ERR_369 DET_AZIMUTH_369 DET_RANGE_VELOCITY_ERR_369 DET_RANGE_VELOCITY_369 DET_RANGE_ERR_369 DET_RANGE_369 DET_CONFD_ELEVATION_370 DET_CONFD_AZIMUTH_370 DET_HVC_FLAG_370 DET_EXISTENCE_PROB_370 DET_SNR_370 DET_SUPER_RES_TARGET_370 DET_BI_STATIC_FLAG_370 DET_RCS_370 DET_ELEVATION_ERR_370 DET_ELEVATION_370 DET_AZIMUTH_ERR_370 DET_AZIMUTH_370 DET_RANGE_VELOCITY_ERR_370 DET_RANGE_VELOCITY_370 DET_RANGE_ERR_370 DET_RANGE_370 DET_CONFD_ELEVATION_371 DET_CONFD_AZIMUTH_371 DET_HVC_FLAG_371 DET_EXISTENCE_PROB_371 DET_SNR_371 DET_SUPER_RES_TARGET_371 DET_BI_STATIC_FLAG_371 DET_RCS_371 DET_ELEVATION_ERR_371 DET_ELEVATION_371 DET_AZIMUTH_ERR_371 DET_AZIMUTH_371 DET_RANGE_VELOCITY_ERR_371 DET_RANGE_VELOCITY_371 DET_RANGE_ERR_371 DET_RANGE_371 DET_CONFD_ELEVATION_372 DET_CONFD_AZIMUTH_372 DET_HVC_FLAG_372 DET_EXISTENCE_PROB_372 DET_SNR_372 DET_SUPER_RES_TARGET_372 DET_BI_STATIC_FLAG_372 DET_RCS_372 DET_ELEVATION_ERR_372 DET_ELEVATION_372 DET_AZIMUTH_ERR_372 DET_AZIMUTH_372 DET_RANGE_VELOCITY_ERR_372 DET_RANGE_VELOCITY_372 DET_RANGE_ERR_372 DET_RANGE_372;
SIG_GROUP_ 1117 Detections_373_376 1 : DET_PROB_1STAZHYPO_373 DET_PROB_1STAZHYPO_374 DET_PROB_1STAZHYPO_375 DET_PROB_1STAZHYPO_376 DET_IDM_373 DET_IDM_374 DET_IDM_375 DET_IDM_376 DET_MTD_376 DET_MTD_375 DET_MTD_374 DET_MTD_373 DET_BELOW_RAIN_THOLD_376 DET_BELOW_RAIN_THOLD_375 DET_BELOW_RAIN_THOLD_374 DET_BELOW_RAIN_THOLD_373 DET_MH_CRC16_373_376 DET_MH_CYCLE_COUNTER_373_376 DET_MH_SCAN_INDEX_4LSB_373_376 DET_CONFD_ELEVATION_373 DET_CONFD_AZIMUTH_373 DET_HVC_FLAG_373 DET_EXISTENCE_PROB_373 DET_SNR_373 DET_SUPER_RES_TARGET_373 DET_BI_STATIC_FLAG_373 DET_RCS_373 DET_ELEVATION_ERR_373 DET_ELEVATION_373 DET_AZIMUTH_ERR_373 DET_AZIMUTH_373 DET_RANGE_VELOCITY_ERR_373 DET_RANGE_VELOCITY_373 DET_RANGE_ERR_373 DET_RANGE_373 DET_CONFD_ELEVATION_374 DET_CONFD_AZIMUTH_374 DET_HVC_FLAG_374 DET_EXISTENCE_PROB_374 DET_SNR_374 DET_SUPER_RES_TARGET_374 DET_BI_STATIC_FLAG_374 DET_RCS_374 DET_ELEVATION_ERR_374 DET_ELEVATION_374 DET_AZIMUTH_ERR_374 DET_AZIMUTH_374 DET_RANGE_VELOCITY_ERR_374 DET_RANGE_VELOCITY_374 DET_RANGE_ERR_374 DET_RANGE_374 DET_CONFD_ELEVATION_375 DET_CONFD_AZIMUTH_375 DET_HVC_FLAG_375 DET_EXISTENCE_PROB_375 DET_SNR_375 DET_SUPER_RES_TARGET_375 DET_BI_STATIC_FLAG_375 DET_RCS_375 DET_ELEVATION_ERR_375 DET_ELEVATION_375 DET_AZIMUTH_ERR_375 DET_AZIMUTH_375 DET_RANGE_VELOCITY_ERR_375 DET_RANGE_VELOCITY_375 DET_RANGE_ERR_375 DET_RANGE_375 DET_CONFD_ELEVATION_376 DET_CONFD_AZIMUTH_376 DET_HVC_FLAG_376 DET_EXISTENCE_PROB_376 DET_SNR_376 DET_SUPER_RES_TARGET_376 DET_BI_STATIC_FLAG_376 DET_RCS_376 DET_ELEVATION_ERR_376 DET_ELEVATION_376 DET_AZIMUTH_ERR_376 DET_AZIMUTH_376 DET_RANGE_VELOCITY_ERR_376 DET_RANGE_VELOCITY_376 DET_RANGE_ERR_376 DET_RANGE_376;
SIG_GROUP_ 1118 Detections_377_380 1 : DET_PROB_1STAZHYPO_377 DET_PROB_1STAZHYPO_378 DET_PROB_1STAZHYPO_379 DET_PROB_1STAZHYPO_380 DET_IDM_377 DET_IDM_378 DET_IDM_379 DET_IDM_380 DET_MTD_380 DET_MTD_379 DET_MTD_378 DET_MTD_377 DET_BELOW_RAIN_THOLD_380 DET_BELOW_RAIN_THOLD_379 DET_BELOW_RAIN_THOLD_378 DET_BELOW_RAIN_THOLD_377 DET_MH_CRC16_377_380 DET_MH_CYCLE_COUNTER_377_380 DET_MH_SCAN_INDEX_4LSB_377_380 DET_CONFD_ELEVATION_377 DET_CONFD_AZIMUTH_377 DET_HVC_FLAG_377 DET_EXISTENCE_PROB_377 DET_SNR_377 DET_SUPER_RES_TARGET_377 DET_BI_STATIC_FLAG_377 DET_RCS_377 DET_ELEVATION_ERR_377 DET_ELEVATION_377 DET_AZIMUTH_ERR_377 DET_AZIMUTH_377 DET_RANGE_VELOCITY_ERR_377 DET_RANGE_VELOCITY_377 DET_RANGE_ERR_377 DET_RANGE_377 DET_CONFD_ELEVATION_378 DET_CONFD_AZIMUTH_378 DET_HVC_FLAG_378 DET_EXISTENCE_PROB_378 DET_SNR_378 DET_SUPER_RES_TARGET_378 DET_BI_STATIC_FLAG_378 DET_RCS_378 DET_ELEVATION_ERR_378 DET_ELEVATION_378 DET_AZIMUTH_ERR_378 DET_AZIMUTH_378 DET_RANGE_VELOCITY_ERR_378 DET_RANGE_VELOCITY_378 DET_RANGE_ERR_378 DET_RANGE_378 DET_CONFD_ELEVATION_379 DET_CONFD_AZIMUTH_379 DET_HVC_FLAG_379 DET_EXISTENCE_PROB_379 DET_SNR_379 DET_SUPER_RES_TARGET_379 DET_BI_STATIC_FLAG_379 DET_RCS_379 DET_ELEVATION_ERR_379 DET_ELEVATION_379 DET_AZIMUTH_ERR_379 DET_AZIMUTH_379 DET_RANGE_VELOCITY_ERR_379 DET_RANGE_VELOCITY_379 DET_RANGE_ERR_379 DET_RANGE_379 DET_CONFD_ELEVATION_380 DET_CONFD_AZIMUTH_380 DET_HVC_FLAG_380 DET_EXISTENCE_PROB_380 DET_SNR_380 DET_SUPER_RES_TARGET_380 DET_BI_STATIC_FLAG_380 DET_RCS_380 DET_ELEVATION_ERR_380 DET_ELEVATION_380 DET_AZIMUTH_ERR_380 DET_AZIMUTH_380 DET_RANGE_VELOCITY_ERR_380 DET_RANGE_VELOCITY_380 DET_RANGE_ERR_380 DET_RANGE_380;
SIG_GROUP_ 1119 Detections_381_384 1 : DET_PROB_1STAZHYPO_381 DET_PROB_1STAZHYPO_382 DET_PROB_1STAZHYPO_383 DET_PROB_1STAZHYPO_384 DET_IDM_381 DET_IDM_382 DET_IDM_383 DET_IDM_384 DET_MTD_384 DET_MTD_383 DET_MTD_382 DET_MTD_381 DET_BELOW_RAIN_THOLD_384 DET_BELOW_RAIN_THOLD_383 DET_BELOW_RAIN_THOLD_382 DET_BELOW_RAIN_THOLD_381 DET_MH_CRC16_381_384 DET_MH_CYCLE_COUNTER_381_384 DET_MH_SCAN_INDEX_4LSB_381_384 DET_CONFD_ELEVATION_381 DET_CONFD_AZIMUTH_381 DET_HVC_FLAG_381 DET_EXISTENCE_PROB_381 DET_SNR_381 DET_SUPER_RES_TARGET_381 DET_BI_STATIC_FLAG_381 DET_RCS_381 DET_ELEVATION_ERR_381 DET_ELEVATION_381 DET_AZIMUTH_ERR_381 DET_AZIMUTH_381 DET_RANGE_VELOCITY_ERR_381 DET_RANGE_VELOCITY_381 DET_RANGE_ERR_381 DET_RANGE_381 DET_CONFD_ELEVATION_382 DET_CONFD_AZIMUTH_382 DET_HVC_FLAG_382 DET_EXISTENCE_PROB_382 DET_SNR_382 DET_SUPER_RES_TARGET_382 DET_BI_STATIC_FLAG_382 DET_RCS_382 DET_ELEVATION_ERR_382 DET_ELEVATION_382 DET_AZIMUTH_ERR_382 DET_AZIMUTH_382 DET_RANGE_VELOCITY_ERR_382 DET_RANGE_VELOCITY_382 DET_RANGE_ERR_382 DET_RANGE_382 DET_CONFD_ELEVATION_383 DET_CONFD_AZIMUTH_383 DET_HVC_FLAG_383 DET_EXISTENCE_PROB_383 DET_SNR_383 DET_SUPER_RES_TARGET_383 DET_BI_STATIC_FLAG_383 DET_RCS_383 DET_ELEVATION_ERR_383 DET_ELEVATION_383 DET_AZIMUTH_ERR_383 DET_AZIMUTH_383 DET_RANGE_VELOCITY_ERR_383 DET_RANGE_VELOCITY_383 DET_RANGE_ERR_383 DET_RANGE_383 DET_CONFD_ELEVATION_384 DET_CONFD_AZIMUTH_384 DET_HVC_FLAG_384 DET_EXISTENCE_PROB_384 DET_SNR_384 DET_SUPER_RES_TARGET_384 DET_BI_STATIC_FLAG_384 DET_RCS_384 DET_ELEVATION_ERR_384 DET_ELEVATION_384 DET_AZIMUTH_ERR_384 DET_AZIMUTH_384 DET_RANGE_VELOCITY_ERR_384 DET_RANGE_VELOCITY_384 DET_RANGE_ERR_384 DET_RANGE_384;
SIG_GROUP_ 1120 Detections_385_388 1 : DET_PROB_1STAZHYPO_385 DET_PROB_1STAZHYPO_386 DET_PROB_1STAZHYPO_387 DET_PROB_1STAZHYPO_388 DET_IDM_385 DET_IDM_386 DET_IDM_387 DET_IDM_388 DET_MTD_388 DET_MTD_387 DET_MTD_386 DET_MTD_385 DET_BELOW_RAIN_THOLD_388 DET_BELOW_RAIN_THOLD_387 DET_BELOW_RAIN_THOLD_386 DET_BELOW_RAIN_THOLD_385 DET_MH_CRC16_385_388 DET_MH_CYCLE_COUNTER_385_388 DET_MH_SCAN_INDEX_4LSB_385_388 DET_CONFD_ELEVATION_385 DET_CONFD_AZIMUTH_385 DET_HVC_FLAG_385 DET_EXISTENCE_PROB_385 DET_SNR_385 DET_SUPER_RES_TARGET_385 DET_BI_STATIC_FLAG_385 DET_RCS_385 DET_ELEVATION_ERR_385 DET_ELEVATION_385 DET_AZIMUTH_ERR_385 DET_AZIMUTH_385 DET_RANGE_VELOCITY_ERR_385 DET_RANGE_VELOCITY_385 DET_RANGE_ERR_385 DET_RANGE_385 DET_CONFD_ELEVATION_386 DET_CONFD_AZIMUTH_386 DET_HVC_FLAG_386 DET_EXISTENCE_PROB_386 DET_SNR_386 DET_SUPER_RES_TARGET_386 DET_BI_STATIC_FLAG_386 DET_RCS_386 DET_ELEVATION_ERR_386 DET_ELEVATION_386 DET_AZIMUTH_ERR_386 DET_AZIMUTH_386 DET_RANGE_VELOCITY_ERR_386 DET_RANGE_VELOCITY_386 DET_RANGE_ERR_386 DET_RANGE_386 DET_CONFD_ELEVATION_387 DET_CONFD_AZIMUTH_387 DET_HVC_FLAG_387 DET_EXISTENCE_PROB_387 DET_SNR_387 DET_SUPER_RES_TARGET_387 DET_BI_STATIC_FLAG_387 DET_RCS_387 DET_ELEVATION_ERR_387 DET_ELEVATION_387 DET_AZIMUTH_ERR_387 DET_AZIMUTH_387 DET_RANGE_VELOCITY_ERR_387 DET_RANGE_VELOCITY_387 DET_RANGE_ERR_387 DET_RANGE_387 DET_CONFD_ELEVATION_388 DET_CONFD_AZIMUTH_388 DET_HVC_FLAG_388 DET_EXISTENCE_PROB_388 DET_SNR_388 DET_SUPER_RES_TARGET_388 DET_BI_STATIC_FLAG_388 DET_RCS_388 DET_ELEVATION_ERR_388 DET_ELEVATION_388 DET_AZIMUTH_ERR_388 DET_AZIMUTH_388 DET_RANGE_VELOCITY_ERR_388 DET_RANGE_VELOCITY_388 DET_RANGE_ERR_388 DET_RANGE_388;
SIG_GROUP_ 1121 Detections_389_392 1 : DET_PROB_1STAZHYPO_389 DET_PROB_1STAZHYPO_390 DET_PROB_1STAZHYPO_391 DET_PROB_1STAZHYPO_392 DET_IDM_389 DET_IDM_390 DET_IDM_391 DET_IDM_392 DET_MTD_392 DET_MTD_391 DET_MTD_390 DET_MTD_389 DET_BELOW_RAIN_THOLD_392 DET_BELOW_RAIN_THOLD_391 DET_BELOW_RAIN_THOLD_390 DET_BELOW_RAIN_THOLD_389 DET_MH_CRC16_389_392 DET_MH_CYCLE_COUNTER_389_392 DET_MH_SCAN_INDEX_4LSB_389_392 DET_CONFD_ELEVATION_389 DET_CONFD_AZIMUTH_389 DET_HVC_FLAG_389 DET_EXISTENCE_PROB_389 DET_SNR_389 DET_SUPER_RES_TARGET_389 DET_BI_STATIC_FLAG_389 DET_RCS_389 DET_ELEVATION_ERR_389 DET_ELEVATION_389 DET_AZIMUTH_ERR_389 DET_AZIMUTH_389 DET_RANGE_VELOCITY_ERR_389 DET_RANGE_VELOCITY_389 DET_RANGE_ERR_389 DET_RANGE_389 DET_CONFD_ELEVATION_390 DET_CONFD_AZIMUTH_390 DET_HVC_FLAG_390 DET_EXISTENCE_PROB_390 DET_SNR_390 DET_SUPER_RES_TARGET_390 DET_BI_STATIC_FLAG_390 DET_RCS_390 DET_ELEVATION_ERR_390 DET_ELEVATION_390 DET_AZIMUTH_ERR_390 DET_AZIMUTH_390 DET_RANGE_VELOCITY_ERR_390 DET_RANGE_VELOCITY_390 DET_RANGE_ERR_390 DET_RANGE_390 DET_CONFD_ELEVATION_391 DET_CONFD_AZIMUTH_391 DET_HVC_FLAG_391 DET_EXISTENCE_PROB_391 DET_SNR_391 DET_SUPER_RES_TARGET_391 DET_BI_STATIC_FLAG_391 DET_RCS_391 DET_ELEVATION_ERR_391 DET_ELEVATION_391 DET_AZIMUTH_ERR_391 DET_AZIMUTH_391 DET_RANGE_VELOCITY_ERR_391 DET_RANGE_VELOCITY_391 DET_RANGE_ERR_391 DET_RANGE_391 DET_CONFD_ELEVATION_392 DET_CONFD_AZIMUTH_392 DET_HVC_FLAG_392 DET_EXISTENCE_PROB_392 DET_SNR_392 DET_SUPER_RES_TARGET_392 DET_BI_STATIC_FLAG_392 DET_RCS_392 DET_ELEVATION_ERR_392 DET_ELEVATION_392 DET_AZIMUTH_ERR_392 DET_AZIMUTH_392 DET_RANGE_VELOCITY_ERR_392 DET_RANGE_VELOCITY_392 DET_RANGE_ERR_392 DET_RANGE_392;
SIG_GROUP_ 1122 Detections_393_396 1 : DET_PROB_1STAZHYPO_393 DET_PROB_1STAZHYPO_394 DET_PROB_1STAZHYPO_395 DET_PROB_1STAZHYPO_396 DET_IDM_393 DET_IDM_394 DET_IDM_395 DET_IDM_396 DET_MTD_396 DET_MTD_395 DET_MTD_394 DET_MTD_393 DET_BELOW_RAIN_THOLD_396 DET_BELOW_RAIN_THOLD_395 DET_BELOW_RAIN_THOLD_394 DET_BELOW_RAIN_THOLD_393 DET_MH_CRC16_393_396 DET_MH_CYCLE_COUNTER_393_396 DET_MH_SCAN_INDEX_4LSB_393_396 DET_CONFD_ELEVATION_393 DET_CONFD_AZIMUTH_393 DET_HVC_FLAG_393 DET_EXISTENCE_PROB_393 DET_SNR_393 DET_SUPER_RES_TARGET_393 DET_BI_STATIC_FLAG_393 DET_RCS_393 DET_ELEVATION_ERR_393 DET_ELEVATION_393 DET_AZIMUTH_ERR_393 DET_AZIMUTH_393 DET_RANGE_VELOCITY_ERR_393 DET_RANGE_VELOCITY_393 DET_RANGE_ERR_393 DET_RANGE_393 DET_CONFD_ELEVATION_394 DET_CONFD_AZIMUTH_394 DET_HVC_FLAG_394 DET_EXISTENCE_PROB_394 DET_SNR_394 DET_SUPER_RES_TARGET_394 DET_BI_STATIC_FLAG_394 DET_RCS_394 DET_ELEVATION_ERR_394 DET_ELEVATION_394 DET_AZIMUTH_ERR_394 DET_AZIMUTH_394 DET_RANGE_VELOCITY_ERR_394 DET_RANGE_VELOCITY_394 DET_RANGE_ERR_394 DET_RANGE_394 DET_CONFD_ELEVATION_395 DET_CONFD_AZIMUTH_395 DET_HVC_FLAG_395 DET_EXISTENCE_PROB_395 DET_SNR_395 DET_SUPER_RES_TARGET_395 DET_BI_STATIC_FLAG_395 DET_RCS_395 DET_ELEVATION_ERR_395 DET_ELEVATION_395 DET_AZIMUTH_ERR_395 DET_AZIMUTH_395 DET_RANGE_VELOCITY_ERR_395 DET_RANGE_VELOCITY_395 DET_RANGE_ERR_395 DET_RANGE_395 DET_CONFD_ELEVATION_396 DET_CONFD_AZIMUTH_396 DET_HVC_FLAG_396 DET_EXISTENCE_PROB_396 DET_SNR_396 DET_SUPER_RES_TARGET_396 DET_BI_STATIC_FLAG_396 DET_RCS_396 DET_ELEVATION_ERR_396 DET_ELEVATION_396 DET_AZIMUTH_ERR_396 DET_AZIMUTH_396 DET_RANGE_VELOCITY_ERR_396 DET_RANGE_VELOCITY_396 DET_RANGE_ERR_396 DET_RANGE_396;
SIG_GROUP_ 1123 Detections_397_400 1 : DET_PROB_1STAZHYPO_397 DET_PROB_1STAZHYPO_398 DET_PROB_1STAZHYPO_399 DET_PROB_1STAZHYPO_400 DET_IDM_397 DET_IDM_398 DET_IDM_399 DET_IDM_400 DET_MTD_400 DET_MTD_399 DET_MTD_398 DET_MTD_397 DET_BELOW_RAIN_THOLD_400 DET_BELOW_RAIN_THOLD_399 DET_BELOW_RAIN_THOLD_398 DET_BELOW_RAIN_THOLD_397 DET_MH_CRC16_397_400 DET_MH_CYCLE_COUNTER_397_400 DET_MH_SCAN_INDEX_4LSB_397_400 DET_CONFD_ELEVATION_397 DET_CONFD_AZIMUTH_397 DET_HVC_FLAG_397 DET_EXISTENCE_PROB_397 DET_SNR_397 DET_SUPER_RES_TARGET_397 DET_BI_STATIC_FLAG_397 DET_RCS_397 DET_ELEVATION_ERR_397 DET_ELEVATION_397 DET_AZIMUTH_ERR_397 DET_AZIMUTH_397 DET_RANGE_VELOCITY_ERR_397 DET_RANGE_VELOCITY_397 DET_RANGE_ERR_397 DET_RANGE_397 DET_CONFD_ELEVATION_398 DET_CONFD_AZIMUTH_398 DET_HVC_FLAG_398 DET_EXISTENCE_PROB_398 DET_SNR_398 DET_SUPER_RES_TARGET_398 DET_BI_STATIC_FLAG_398 DET_RCS_398 DET_ELEVATION_ERR_398 DET_ELEVATION_398 DET_AZIMUTH_ERR_398 DET_AZIMUTH_398 DET_RANGE_VELOCITY_ERR_398 DET_RANGE_VELOCITY_398 DET_RANGE_ERR_398 DET_RANGE_398 DET_CONFD_ELEVATION_399 DET_CONFD_AZIMUTH_399 DET_HVC_FLAG_399 DET_EXISTENCE_PROB_399 DET_SNR_399 DET_SUPER_RES_TARGET_399 DET_BI_STATIC_FLAG_399 DET_RCS_399 DET_ELEVATION_ERR_399 DET_ELEVATION_399 DET_AZIMUTH_ERR_399 DET_AZIMUTH_399 DET_RANGE_VELOCITY_ERR_399 DET_RANGE_VELOCITY_399 DET_RANGE_ERR_399 DET_RANGE_399 DET_CONFD_ELEVATION_400 DET_CONFD_AZIMUTH_400 DET_HVC_FLAG_400 DET_EXISTENCE_PROB_400 DET_SNR_400 DET_SUPER_RES_TARGET_400 DET_BI_STATIC_FLAG_400 DET_RCS_400 DET_ELEVATION_ERR_400 DET_ELEVATION_400 DET_AZIMUTH_ERR_400 DET_AZIMUTH_400 DET_RANGE_VELOCITY_ERR_400 DET_RANGE_VELOCITY_400 DET_RANGE_ERR_400 DET_RANGE_400;
SIG_GROUP_ 1680 TrackerObject001 1 : OBJ_ALIVE_TIME_001 OBJ_ACCELERATION_LONG_ERR_001 OBJ_ACCELERATION_LAT_ERR_001 OBJ_VELOCITY_LONG_ERR_001 OBJ_VELOCITY_LAT_ERR_001 OBJ_POS_LONG_ERR_001 OBJ_POS_LAT_ERR_001 OBJ_TRACK_MOTION_MODEL_001 OBJ_DIMENSION_WIDTH_001 OBJ_DIMENSION_LENGTH_001 OBJ_EXISTENCE_PROB_001 OBJ_YAW_ANGLE_001 OBJ_YAW_ANGLE_ERR_001 OBJ_ID_001 OBJ_MOVEMENT_STATUS_001 OBJ_MEASUREMENT_STATUS_001 OBJ_POS_LONG_001 OBJ_POS_LAT_001 OBJ_VELOCITY_LONG_001 OBJ_VELOCITY_LAT_001 OBJ_ACCELERATION_LONG_001 OBJ_ACCELERATION_LAT_001 OBJ_VEH_TRACK_FLAG_001 OBJ_MH_CYCLE_COUNTER_001 OBJ_MH_CRC16_001 OBJ_TIMESTAMP_OFFSET_001 OBJ_DIMENSION_WIDTH_ERR_001 OBJ_DIMENSION_LENGTH_ERR_001 OBJ_CLS_TYPE1_001 OBJ_CLS_TYPE1_PROB_001 OBJ_CLS_TYPE2_001 OBJ_CLS_TYPE2_PROB_001 OBJ_CLS_TYPE3_001 OBJ_CLS_TYPE3_PROB_001 OBJ_CLS_TYPE4_001 OBJ_CLS_TYPE4_PROB_001 OBJ_CLS_TYPE5_001 OBJ_CLS_TYPE5_PROB_001 OBJ_CLS_TYPE6_001 OBJ_CLS_TYPE6_PROB_001 OBJ_RCS_001 OBJ_REF_PT_LONG_OFFSET_001 OBJ_REF_PT_LAT_OFFSET_001 OBJ_YAW_RATE_001 OBJ_YAW_RATE_ERR_001 OBJ_GROUP_ID_001 OBJ_POS_ERR_CRR_COEF_001 OBJ_VELOCITY_ERR_CRR_COEF_001 OBJ_ACCEL_ERR_CRR_COEF_001;
SIG_GROUP_ 1681 TrackerObject002 1 : OBJ_ALIVE_TIME_002 OBJ_ACCELERATION_LONG_ERR_002 OBJ_ACCELERATION_LAT_ERR_002 OBJ_VELOCITY_LONG_ERR_002 OBJ_VELOCITY_LAT_ERR_002 OBJ_POS_LONG_ERR_002 OBJ_POS_LAT_ERR_002 OBJ_TRACK_MOTION_MODEL_002 OBJ_DIMENSION_WIDTH_002 OBJ_DIMENSION_LENGTH_002 OBJ_EXISTENCE_PROB_002 OBJ_YAW_ANGLE_002 OBJ_YAW_ANGLE_ERR_002 OBJ_ID_002 OBJ_MOVEMENT_STATUS_002 OBJ_MEASUREMENT_STATUS_002 OBJ_POS_LONG_002 OBJ_POS_LAT_002 OBJ_VELOCITY_LONG_002 OBJ_VELOCITY_LAT_002 OBJ_ACCELERATION_LONG_002 OBJ_ACCELERATION_LAT_002 OBJ_VEH_TRACK_FLAG_002 OBJ_MH_CYCLE_COUNTER_002 OBJ_MH_CRC16_002 OBJ_TIMESTAMP_OFFSET_002 OBJ_DIMENSION_WIDTH_ERR_002 OBJ_DIMENSION_LENGTH_ERR_002 OBJ_CLS_TYPE1_002 OBJ_CLS_TYPE1_PROB_002 OBJ_CLS_TYPE2_002 OBJ_CLS_TYPE2_PROB_002 OBJ_CLS_TYPE3_002 OBJ_CLS_TYPE3_PROB_002 OBJ_CLS_TYPE4_002 OBJ_CLS_TYPE4_PROB_002 OBJ_CLS_TYPE5_002 OBJ_CLS_TYPE5_PROB_002 OBJ_CLS_TYPE6_002 OBJ_CLS_TYPE6_PROB_002 OBJ_RCS_002 OBJ_REF_PT_LONG_OFFSET_002 OBJ_REF_PT_LAT_OFFSET_002 OBJ_YAW_RATE_002 OBJ_YAW_RATE_ERR_002 OBJ_GROUP_ID_002 OBJ_POS_ERR_CRR_COEF_002 OBJ_VELOCITY_ERR_CRR_COEF_002 OBJ_ACCEL_ERR_CRR_COEF_002;
SIG_GROUP_ 1682 TrackerObject003 1 : OBJ_ALIVE_TIME_003 OBJ_ACCELERATION_LONG_ERR_003 OBJ_ACCELERATION_LAT_ERR_003 OBJ_VELOCITY_LONG_ERR_003 OBJ_VELOCITY_LAT_ERR_003 OBJ_POS_LONG_ERR_003 OBJ_POS_LAT_ERR_003 OBJ_TRACK_MOTION_MODEL_003 OBJ_DIMENSION_WIDTH_003 OBJ_DIMENSION_LENGTH_003 OBJ_EXISTENCE_PROB_003 OBJ_YAW_ANGLE_003 OBJ_YAW_ANGLE_ERR_003 OBJ_ID_003 OBJ_MOVEMENT_STATUS_003 OBJ_MEASUREMENT_STATUS_003 OBJ_POS_LONG_003 OBJ_POS_LAT_003 OBJ_VELOCITY_LONG_003 OBJ_VELOCITY_LAT_003 OBJ_ACCELERATION_LONG_003 OBJ_ACCELERATION_LAT_003 OBJ_VEH_TRACK_FLAG_003 OBJ_MH_CYCLE_COUNTER_003 OBJ_MH_CRC16_003 OBJ_TIMESTAMP_OFFSET_003 OBJ_DIMENSION_WIDTH_ERR_003 OBJ_DIMENSION_LENGTH_ERR_003 OBJ_CLS_TYPE1_003 OBJ_CLS_TYPE1_PROB_003 OBJ_CLS_TYPE2_003 OBJ_CLS_TYPE2_PROB_003 OBJ_CLS_TYPE3_003 OBJ_CLS_TYPE3_PROB_003 OBJ_CLS_TYPE4_003 OBJ_CLS_TYPE4_PROB_003 OBJ_CLS_TYPE5_003 OBJ_CLS_TYPE5_PROB_003 OBJ_CLS_TYPE6_003 OBJ_CLS_TYPE6_PROB_003 OBJ_RCS_003 OBJ_REF_PT_LONG_OFFSET_003 OBJ_REF_PT_LAT_OFFSET_003 OBJ_YAW_RATE_003 OBJ_YAW_RATE_ERR_003 OBJ_GROUP_ID_003 OBJ_POS_ERR_CRR_COEF_003 OBJ_VELOCITY_ERR_CRR_COEF_003 OBJ_ACCEL_ERR_CRR_COEF_003;
SIG_GROUP_ 1683 TrackerObject004 1 : OBJ_ALIVE_TIME_004 OBJ_ACCELERATION_LONG_ERR_004 OBJ_ACCELERATION_LAT_ERR_004 OBJ_VELOCITY_LONG_ERR_004 OBJ_VELOCITY_LAT_ERR_004 OBJ_POS_LONG_ERR_004 OBJ_POS_LAT_ERR_004 OBJ_TRACK_MOTION_MODEL_004 OBJ_DIMENSION_WIDTH_004 OBJ_DIMENSION_LENGTH_004 OBJ_EXISTENCE_PROB_004 OBJ_YAW_ANGLE_004 OBJ_YAW_ANGLE_ERR_004 OBJ_ID_004 OBJ_MOVEMENT_STATUS_004 OBJ_MEASUREMENT_STATUS_004 OBJ_POS_LONG_004 OBJ_POS_LAT_004 OBJ_VELOCITY_LONG_004 OBJ_VELOCITY_LAT_004 OBJ_ACCELERATION_LONG_004 OBJ_ACCELERATION_LAT_004 OBJ_VEH_TRACK_FLAG_004 OBJ_MH_CYCLE_COUNTER_004 OBJ_MH_CRC16_004 OBJ_TIMESTAMP_OFFSET_004 OBJ_DIMENSION_WIDTH_ERR_004 OBJ_DIMENSION_LENGTH_ERR_004 OBJ_CLS_TYPE1_004 OBJ_CLS_TYPE1_PROB_004 OBJ_CLS_TYPE2_004 OBJ_CLS_TYPE2_PROB_004 OBJ_CLS_TYPE3_004 OBJ_CLS_TYPE3_PROB_004 OBJ_CLS_TYPE4_004 OBJ_CLS_TYPE4_PROB_004 OBJ_CLS_TYPE5_004 OBJ_CLS_TYPE5_PROB_004 OBJ_CLS_TYPE6_004 OBJ_CLS_TYPE6_PROB_004 OBJ_RCS_004 OBJ_REF_PT_LONG_OFFSET_004 OBJ_REF_PT_LAT_OFFSET_004 OBJ_YAW_RATE_004 OBJ_YAW_RATE_ERR_004 OBJ_GROUP_ID_004 OBJ_POS_ERR_CRR_COEF_004 OBJ_VELOCITY_ERR_CRR_COEF_004 OBJ_ACCEL_ERR_CRR_COEF_004;
SIG_GROUP_ 1684 TrackerObject005 1 : OBJ_ALIVE_TIME_005 OBJ_ACCELERATION_LONG_ERR_005 OBJ_ACCELERATION_LAT_ERR_005 OBJ_VELOCITY_LONG_ERR_005 OBJ_VELOCITY_LAT_ERR_005 OBJ_POS_LONG_ERR_005 OBJ_POS_LAT_ERR_005 OBJ_TRACK_MOTION_MODEL_005 OBJ_DIMENSION_WIDTH_005 OBJ_DIMENSION_LENGTH_005 OBJ_EXISTENCE_PROB_005 OBJ_YAW_ANGLE_005 OBJ_YAW_ANGLE_ERR_005 OBJ_ID_005 OBJ_MOVEMENT_STATUS_005 OBJ_MEASUREMENT_STATUS_005 OBJ_POS_LONG_005 OBJ_POS_LAT_005 OBJ_VELOCITY_LONG_005 OBJ_VELOCITY_LAT_005 OBJ_ACCELERATION_LONG_005 OBJ_ACCELERATION_LAT_005 OBJ_VEH_TRACK_FLAG_005 OBJ_MH_CYCLE_COUNTER_005 OBJ_MH_CRC16_005 OBJ_TIMESTAMP_OFFSET_005 OBJ_DIMENSION_WIDTH_ERR_005 OBJ_DIMENSION_LENGTH_ERR_005 OBJ_CLS_TYPE1_005 OBJ_CLS_TYPE1_PROB_005 OBJ_CLS_TYPE2_005 OBJ_CLS_TYPE2_PROB_005 OBJ_CLS_TYPE3_005 OBJ_CLS_TYPE3_PROB_005 OBJ_CLS_TYPE4_005 OBJ_CLS_TYPE4_PROB_005 OBJ_CLS_TYPE5_005 OBJ_CLS_TYPE5_PROB_005 OBJ_CLS_TYPE6_005 OBJ_CLS_TYPE6_PROB_005 OBJ_RCS_005 OBJ_REF_PT_LONG_OFFSET_005 OBJ_REF_PT_LAT_OFFSET_005 OBJ_YAW_RATE_005 OBJ_YAW_RATE_ERR_005 OBJ_GROUP_ID_005 OBJ_POS_ERR_CRR_COEF_005 OBJ_VELOCITY_ERR_CRR_COEF_005 OBJ_ACCEL_ERR_CRR_COEF_005;
SIG_GROUP_ 1685 TrackerObject006 1 : OBJ_ALIVE_TIME_006 OBJ_ACCELERATION_LONG_ERR_006 OBJ_ACCELERATION_LAT_ERR_006 OBJ_VELOCITY_LONG_ERR_006 OBJ_VELOCITY_LAT_ERR_006 OBJ_POS_LONG_ERR_006 OBJ_POS_LAT_ERR_006 OBJ_TRACK_MOTION_MODEL_006 OBJ_DIMENSION_WIDTH_006 OBJ_DIMENSION_LENGTH_006 OBJ_EXISTENCE_PROB_006 OBJ_YAW_ANGLE_006 OBJ_YAW_ANGLE_ERR_006 OBJ_ID_006 OBJ_MOVEMENT_STATUS_006 OBJ_MEASUREMENT_STATUS_006 OBJ_POS_LONG_006 OBJ_POS_LAT_006 OBJ_VELOCITY_LONG_006 OBJ_VELOCITY_LAT_006 OBJ_ACCELERATION_LONG_006 OBJ_ACCELERATION_LAT_006 OBJ_VEH_TRACK_FLAG_006 OBJ_MH_CYCLE_COUNTER_006 OBJ_MH_CRC16_006 OBJ_TIMESTAMP_OFFSET_006 OBJ_DIMENSION_WIDTH_ERR_006 OBJ_DIMENSION_LENGTH_ERR_006 OBJ_CLS_TYPE1_006 OBJ_CLS_TYPE1_PROB_006 OBJ_CLS_TYPE2_006 OBJ_CLS_TYPE2_PROB_006 OBJ_CLS_TYPE3_006 OBJ_CLS_TYPE3_PROB_006 OBJ_CLS_TYPE4_006 OBJ_CLS_TYPE4_PROB_006 OBJ_CLS_TYPE5_006 OBJ_CLS_TYPE5_PROB_006 OBJ_CLS_TYPE6_006 OBJ_CLS_TYPE6_PROB_006 OBJ_RCS_006 OBJ_REF_PT_LONG_OFFSET_006 OBJ_REF_PT_LAT_OFFSET_006 OBJ_YAW_RATE_006 OBJ_YAW_RATE_ERR_006 OBJ_GROUP_ID_006 OBJ_POS_ERR_CRR_COEF_006 OBJ_VELOCITY_ERR_CRR_COEF_006 OBJ_ACCEL_ERR_CRR_COEF_006;
SIG_GROUP_ 1686 TrackerObject007 1 : OBJ_ALIVE_TIME_007 OBJ_ACCELERATION_LONG_ERR_007 OBJ_ACCELERATION_LAT_ERR_007 OBJ_VELOCITY_LONG_ERR_007 OBJ_VELOCITY_LAT_ERR_007 OBJ_POS_LONG_ERR_007 OBJ_POS_LAT_ERR_007 OBJ_TRACK_MOTION_MODEL_007 OBJ_DIMENSION_WIDTH_007 OBJ_DIMENSION_LENGTH_007 OBJ_EXISTENCE_PROB_007 OBJ_YAW_ANGLE_007 OBJ_YAW_ANGLE_ERR_007 OBJ_ID_007 OBJ_MOVEMENT_STATUS_007 OBJ_MEASUREMENT_STATUS_007 OBJ_POS_LONG_007 OBJ_POS_LAT_007 OBJ_VELOCITY_LONG_007 OBJ_VELOCITY_LAT_007 OBJ_ACCELERATION_LONG_007 OBJ_ACCELERATION_LAT_007 OBJ_VEH_TRACK_FLAG_007 OBJ_MH_CYCLE_COUNTER_007 OBJ_MH_CRC16_007 OBJ_TIMESTAMP_OFFSET_007 OBJ_DIMENSION_WIDTH_ERR_007 OBJ_DIMENSION_LENGTH_ERR_007 OBJ_CLS_TYPE1_007 OBJ_CLS_TYPE1_PROB_007 OBJ_CLS_TYPE2_007 OBJ_CLS_TYPE2_PROB_007 OBJ_CLS_TYPE3_007 OBJ_CLS_TYPE3_PROB_007 OBJ_CLS_TYPE4_007 OBJ_CLS_TYPE4_PROB_007 OBJ_CLS_TYPE5_007 OBJ_CLS_TYPE5_PROB_007 OBJ_CLS_TYPE6_007 OBJ_CLS_TYPE6_PROB_007 OBJ_RCS_007 OBJ_REF_PT_LONG_OFFSET_007 OBJ_REF_PT_LAT_OFFSET_007 OBJ_YAW_RATE_007 OBJ_YAW_RATE_ERR_007 OBJ_GROUP_ID_007 OBJ_POS_ERR_CRR_COEF_007 OBJ_VELOCITY_ERR_CRR_COEF_007 OBJ_ACCEL_ERR_CRR_COEF_007;
SIG_GROUP_ 1687 TrackerObject008 1 : OBJ_ALIVE_TIME_008 OBJ_ACCELERATION_LONG_ERR_008 OBJ_ACCELERATION_LAT_ERR_008 OBJ_VELOCITY_LONG_ERR_008 OBJ_VELOCITY_LAT_ERR_008 OBJ_POS_LONG_ERR_008 OBJ_POS_LAT_ERR_008 OBJ_TRACK_MOTION_MODEL_008 OBJ_DIMENSION_WIDTH_008 OBJ_DIMENSION_LENGTH_008 OBJ_EXISTENCE_PROB_008 OBJ_YAW_ANGLE_008 OBJ_YAW_ANGLE_ERR_008 OBJ_ID_008 OBJ_MOVEMENT_STATUS_008 OBJ_MEASUREMENT_STATUS_008 OBJ_POS_LONG_008 OBJ_POS_LAT_008 OBJ_VELOCITY_LONG_008 OBJ_VELOCITY_LAT_008 OBJ_ACCELERATION_LONG_008 OBJ_ACCELERATION_LAT_008 OBJ_VEH_TRACK_FLAG_008 OBJ_MH_CYCLE_COUNTER_008 OBJ_MH_CRC16_008 OBJ_TIMESTAMP_OFFSET_008 OBJ_DIMENSION_WIDTH_ERR_008 OBJ_DIMENSION_LENGTH_ERR_008 OBJ_CLS_TYPE1_008 OBJ_CLS_TYPE1_PROB_008 OBJ_CLS_TYPE2_008 OBJ_CLS_TYPE2_PROB_008 OBJ_CLS_TYPE3_008 OBJ_CLS_TYPE3_PROB_008 OBJ_CLS_TYPE4_008 OBJ_CLS_TYPE4_PROB_008 OBJ_CLS_TYPE5_008 OBJ_CLS_TYPE5_PROB_008 OBJ_CLS_TYPE6_008 OBJ_CLS_TYPE6_PROB_008 OBJ_RCS_008 OBJ_REF_PT_LONG_OFFSET_008 OBJ_REF_PT_LAT_OFFSET_008 OBJ_YAW_RATE_008 OBJ_YAW_RATE_ERR_008 OBJ_GROUP_ID_008 OBJ_POS_ERR_CRR_COEF_008 OBJ_VELOCITY_ERR_CRR_COEF_008 OBJ_ACCEL_ERR_CRR_COEF_008;
SIG_GROUP_ 1688 TrackerObject009 1 : OBJ_ALIVE_TIME_009 OBJ_ACCELERATION_LONG_ERR_009 OBJ_ACCELERATION_LAT_ERR_009 OBJ_VELOCITY_LONG_ERR_009 OBJ_VELOCITY_LAT_ERR_009 OBJ_POS_LONG_ERR_009 OBJ_POS_LAT_ERR_009 OBJ_TRACK_MOTION_MODEL_009 OBJ_DIMENSION_WIDTH_009 OBJ_DIMENSION_LENGTH_009 OBJ_EXISTENCE_PROB_009 OBJ_YAW_ANGLE_009 OBJ_YAW_ANGLE_ERR_009 OBJ_ID_009 OBJ_MOVEMENT_STATUS_009 OBJ_MEASUREMENT_STATUS_009 OBJ_POS_LONG_009 OBJ_POS_LAT_009 OBJ_VELOCITY_LONG_009 OBJ_VELOCITY_LAT_009 OBJ_ACCELERATION_LONG_009 OBJ_ACCELERATION_LAT_009 OBJ_VEH_TRACK_FLAG_009 OBJ_MH_CYCLE_COUNTER_009 OBJ_MH_CRC16_009 OBJ_TIMESTAMP_OFFSET_009 OBJ_DIMENSION_WIDTH_ERR_009 OBJ_DIMENSION_LENGTH_ERR_009 OBJ_CLS_TYPE1_009 OBJ_CLS_TYPE1_PROB_009 OBJ_CLS_TYPE2_009 OBJ_CLS_TYPE2_PROB_009 OBJ_CLS_TYPE3_009 OBJ_CLS_TYPE3_PROB_009 OBJ_CLS_TYPE4_009 OBJ_CLS_TYPE4_PROB_009 OBJ_CLS_TYPE5_009 OBJ_CLS_TYPE5_PROB_009 OBJ_CLS_TYPE6_009 OBJ_CLS_TYPE6_PROB_009 OBJ_RCS_009 OBJ_REF_PT_LONG_OFFSET_009 OBJ_REF_PT_LAT_OFFSET_009 OBJ_YAW_RATE_009 OBJ_YAW_RATE_ERR_009 OBJ_GROUP_ID_009 OBJ_POS_ERR_CRR_COEF_009 OBJ_VELOCITY_ERR_CRR_COEF_009 OBJ_ACCEL_ERR_CRR_COEF_009;
SIG_GROUP_ 1689 TrackerObject010 1 : OBJ_ALIVE_TIME_010 OBJ_ACCELERATION_LONG_ERR_010 OBJ_ACCELERATION_LAT_ERR_010 OBJ_VELOCITY_LONG_ERR_010 OBJ_VELOCITY_LAT_ERR_010 OBJ_POS_LONG_ERR_010 OBJ_POS_LAT_ERR_010 OBJ_TRACK_MOTION_MODEL_010 OBJ_DIMENSION_WIDTH_010 OBJ_DIMENSION_LENGTH_010 OBJ_EXISTENCE_PROB_010 OBJ_YAW_ANGLE_010 OBJ_YAW_ANGLE_ERR_010 OBJ_ID_010 OBJ_MOVEMENT_STATUS_010 OBJ_MEASUREMENT_STATUS_010 OBJ_POS_LONG_010 OBJ_POS_LAT_010 OBJ_VELOCITY_LONG_010 OBJ_VELOCITY_LAT_010 OBJ_ACCELERATION_LONG_010 OBJ_ACCELERATION_LAT_010 OBJ_VEH_TRACK_FLAG_010 OBJ_MH_CYCLE_COUNTER_010 OBJ_MH_CRC16_010 OBJ_TIMESTAMP_OFFSET_010 OBJ_DIMENSION_WIDTH_ERR_010 OBJ_DIMENSION_LENGTH_ERR_010 OBJ_CLS_TYPE1_010 OBJ_CLS_TYPE1_PROB_010 OBJ_CLS_TYPE2_010 OBJ_CLS_TYPE2_PROB_010 OBJ_CLS_TYPE3_010 OBJ_CLS_TYPE3_PROB_010 OBJ_CLS_TYPE4_010 OBJ_CLS_TYPE4_PROB_010 OBJ_CLS_TYPE5_010 OBJ_CLS_TYPE5_PROB_010 OBJ_CLS_TYPE6_010 OBJ_CLS_TYPE6_PROB_010 OBJ_RCS_010 OBJ_REF_PT_LONG_OFFSET_010 OBJ_REF_PT_LAT_OFFSET_010 OBJ_YAW_RATE_010 OBJ_YAW_RATE_ERR_010 OBJ_GROUP_ID_010 OBJ_POS_ERR_CRR_COEF_010 OBJ_VELOCITY_ERR_CRR_COEF_010 OBJ_ACCEL_ERR_CRR_COEF_010;
SIG_GROUP_ 1690 TrackerObject011 1 : OBJ_ALIVE_TIME_011 OBJ_ACCELERATION_LONG_ERR_011 OBJ_ACCELERATION_LAT_ERR_011 OBJ_VELOCITY_LONG_ERR_011 OBJ_VELOCITY_LAT_ERR_011 OBJ_POS_LONG_ERR_011 OBJ_POS_LAT_ERR_011 OBJ_TRACK_MOTION_MODEL_011 OBJ_DIMENSION_WIDTH_011 OBJ_DIMENSION_LENGTH_011 OBJ_EXISTENCE_PROB_011 OBJ_YAW_ANGLE_011 OBJ_YAW_ANGLE_ERR_011 OBJ_ID_011 OBJ_MOVEMENT_STATUS_011 OBJ_MEASUREMENT_STATUS_011 OBJ_POS_LONG_011 OBJ_POS_LAT_011 OBJ_VELOCITY_LONG_011 OBJ_VELOCITY_LAT_011 OBJ_ACCELERATION_LONG_011 OBJ_ACCELERATION_LAT_011 OBJ_VEH_TRACK_FLAG_011 OBJ_MH_CYCLE_COUNTER_011 OBJ_MH_CRC16_011 OBJ_TIMESTAMP_OFFSET_011 OBJ_DIMENSION_WIDTH_ERR_011 OBJ_DIMENSION_LENGTH_ERR_011 OBJ_CLS_TYPE1_011 OBJ_CLS_TYPE1_PROB_011 OBJ_CLS_TYPE2_011 OBJ_CLS_TYPE2_PROB_011 OBJ_CLS_TYPE3_011 OBJ_CLS_TYPE3_PROB_011 OBJ_CLS_TYPE4_011 OBJ_CLS_TYPE4_PROB_011 OBJ_CLS_TYPE5_011 OBJ_CLS_TYPE5_PROB_011 OBJ_CLS_TYPE6_011 OBJ_CLS_TYPE6_PROB_011 OBJ_RCS_011 OBJ_REF_PT_LONG_OFFSET_011 OBJ_REF_PT_LAT_OFFSET_011 OBJ_YAW_RATE_011 OBJ_YAW_RATE_ERR_011 OBJ_GROUP_ID_011 OBJ_POS_ERR_CRR_COEF_011 OBJ_VELOCITY_ERR_CRR_COEF_011 OBJ_ACCEL_ERR_CRR_COEF_011;
