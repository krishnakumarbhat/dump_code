VERSION "created by canmatrix"

NS_ :

BS_:

BU_: External_Tool ADAS RDR02 RDR_Fusion_Partner RDR_Gateway

BO_ 1371 RDR_TRACKER_OBJ_012: 64 RDR02
 SG_ OBJ_ALIVE_TIME_012 : 255|16@0+ (1,0) [0|65535] "ms"  ADAS
 SG_ OBJ_ACCELERATION_LONG_ERR_012 : 215|8@0+ (0.025,0) [0|6.375] "m/s^2"  ADAS
 SG_ OBJ_ACCELERATION_LAT_ERR_012 : 223|8@0+ (0.025,0) [0|6.375] "m/s^2"  ADAS
 SG_ OBJ_VELOCITY_LONG_ERR_012 : 143|8@0+ (0.05,0) [0|12.75] "m/s"  ADAS
 SG_ OBJ_VELOCITY_LAT_ERR_012 : 151|8@0+ (0.05,0) [0|12.75] "m/s"  ADAS
 SG_ OBJ_POS_LONG_ERR_012 : 95|8@0+ (0.025,0) [0|6.375] "m"  ADAS
 SG_ OBJ_POS_LAT_ERR_012 : 103|8@0+ (0.025,0) [0|6.375] "m"  ADAS
 SG_ OBJ_TRACK_MOTION_MODEL_012 : 9|2@0+ (1,0) [0|3] "NA"  ADAS
 SG_ OBJ_DIMENSION_WIDTH_012 : 17|10@0+ (0.01,0) [0|10.23] "m"  ADAS
 SG_ OBJ_DIMENSION_LENGTH_012 : 37|12@0+ (0.01,0) [0|40.95] "m"  ADAS
 SG_ OBJ_EXISTENCE_PROB_012 : 229|14@0+ (0.0001,0) [0|1] "NA"  ADAS
 SG_ OBJ_YAW_ANGLE_012 : 155|12@0+ (0.005,-10) [-10|10.475] "rad"  ADAS
 SG_ OBJ_YAW_ANGLE_ERR_012 : 175|7@0+ (0.01,0) [0|1.27] "rad"  ADAS
 SG_ OBJ_ID_012 : 7|8@0+ (1,0) [0|255] "NA"  ADAS
 SG_ OBJ_MOVEMENT_STATUS_012 : 196|3@0+ (1,0) [0|3] "NA"  ADAS
 SG_ OBJ_MEASUREMENT_STATUS_012 : 14|3@0+ (1,0) [0|7] "NA"  ADAS
 SG_ OBJ_POS_LONG_012 : 63|16@0+ (0.01,-327) [-327|327] "m"  ADAS
 SG_ OBJ_POS_LAT_012 : 79|16@0+ (0.01,-327) [-327|327] "m"  ADAS
 SG_ OBJ_VELOCITY_LONG_012 : 110|15@0+ (0.01,-163) [-163|163] "m/s"  ADAS
 SG_ OBJ_VELOCITY_LAT_012 : 126|15@0+ (0.01,-163) [-163|163] "m/s"  ADAS
 SG_ OBJ_ACCELERATION_LONG_012 : 193|10@0+ (0.05,-20) [-20|20] "m/s^2"  ADAS
 SG_ OBJ_ACCELERATION_LAT_012 : 177|10@0+ (0.05,-20) [-20|20] "m/s^2"  ADAS
 SG_ OBJ_VEH_TRACK_FLAG_012 : 10|1@0+ (1,0) [0|1] "NA"  ADAS
 SG_ OBJ_MH_CYCLE_COUNTER_012 : 487|8@0+ (1,0) [0|255] "NA"  ADAS
 SG_ OBJ_MH_CRC16_012 : 495|16@0+ (1,0) [0|65535] "NA"  ADAS
 SG_ OBJ_TIMESTAMP_OFFSET_012 : 247|8@0+ (1,-127) [-127|128] "ms"  ADAS
 SG_ OBJ_DIMENSION_WIDTH_ERR_012 : 23|6@0+ (0.01,0) [0|0.63] "m"  ADAS
 SG_ OBJ_DIMENSION_LENGTH_ERR_012 : 41|10@0+ (0.01,0) [0|10.23] "m"  ADAS
 SG_ OBJ_CLS_TYPE1_012 : 271|4@0+ (1,0) [0|15] "NA"  ADAS
 SG_ OBJ_CLS_TYPE1_PROB_012 : 303|8@0+ (0.004,0) [0|1] "NA"  ADAS
 SG_ OBJ_CLS_TYPE2_012 : 267|4@0+ (1,0) [0|15] "NA"  ADAS
 SG_ OBJ_CLS_TYPE2_PROB_012 : 311|8@0+ (0.004,0) [0|1] "NA"  ADAS
 SG_ OBJ_CLS_TYPE3_012 : 279|4@0+ (1,0) [0|15] "NA"  ADAS
 SG_ OBJ_CLS_TYPE3_PROB_012 : 319|8@0+ (0.004,0) [0|1] "NA"  ADAS
 SG_ OBJ_CLS_TYPE4_012 : 275|4@0+ (1,0) [0|15] "NA"  ADAS
 SG_ OBJ_CLS_TYPE4_PROB_012 : 327|8@0+ (0.004,0) [0|1] "NA"  ADAS
 SG_ OBJ_CLS_TYPE5_012 : 287|4@0+ (1,0) [0|15] "NA"  ADAS
 SG_ OBJ_CLS_TYPE5_PROB_012 : 335|8@0+ (0.004,0) [0|1] "NA"  ADAS
 SG_ OBJ_CLS_TYPE6_012 : 282|4@0+ (1,0) [0|15] "NA"  ADAS
 SG_ OBJ_CLS_TYPE6_PROB_012 : 343|8@0+ (0.004,0) [0|1] "NA"  ADAS
 SG_ OBJ_RCS_012 : 351|7@0+ (1,-64) [-64|63] "dBsm"  ADAS
 SG_ OBJ_REF_PT_LONG_OFFSET_012 : 357|14@0+ (0.0001,0) [0|1] "NA"  ADAS
 SG_ OBJ_REF_PT_LAT_OFFSET_012 : 370|14@0+ (0.0001,0) [0|1] "NA"  ADAS
 SG_ OBJ_YAW_RATE_012 : 399|10@0+ (0.005,-2.24) [-2.24|2.24] "rad/s"  ADAS
 SG_ OBJ_YAW_RATE_ERR_012 : 388|5@0+ (0.025,0) [0|0.775] "rad/s"  ADAS
 SG_ OBJ_GROUP_ID_012 : 405|6@0+ (1,0) [0|63] "NA"  ADAS
 SG_ OBJ_POS_ERR_CRR_COEF_012 : 415|8@0+ (0.01,-1.2) [-1.2|1] "NA"  ADAS
 SG_ OBJ_VELOCITY_ERR_CRR_COEF_012 : 423|8@0+ (0.01,-1.2) [-1.2|1] "NA"  ADAS
 SG_ OBJ_ACCEL_ERR_CRR_COEF_012 : 431|8@0+ (0.01,-1.2) [-1.2|1] "NA"  ADAS

BO_ 1372 RDR_TRACKER_OBJ_013: 64 RDR02
 SG_ OBJ_ALIVE_TIME_013 : 255|16@0+ (1,0) [0|65535] "ms"  ADAS
 SG_ OBJ_ACCELERATION_LONG_ERR_013 : 215|8@0+ (0.025,0) [0|6.375] "m/s^2"  ADAS
 SG_ OBJ_ACCELERATION_LAT_ERR_013 : 223|8@0+ (0.025,0) [0|6.375] "m/s^2"  ADAS
 SG_ OBJ_VELOCITY_LONG_ERR_013 : 143|8@0+ (0.05,0) [0|12.75] "m/s"  ADAS
 SG_ OBJ_VELOCITY_LAT_ERR_013 : 151|8@0+ (0.05,0) [0|12.75] "m/s"  ADAS
 SG_ OBJ_POS_LONG_ERR_013 : 95|8@0+ (0.025,0) [0|6.375] "m"  ADAS
 SG_ OBJ_POS_LAT_ERR_013 : 103|8@0+ (0.025,0) [0|6.375] "m"  ADAS
 SG_ OBJ_TRACK_MOTION_MODEL_013 : 9|2@0+ (1,0) [0|3] "NA"  ADAS
 SG_ OBJ_DIMENSION_WIDTH_013 : 17|10@0+ (0.01,0) [0|10.23] "m"  ADAS
 SG_ OBJ_DIMENSION_LENGTH_013 : 37|12@0+ (0.01,0) [0|40.95] "m"  ADAS
 SG_ OBJ_EXISTENCE_PROB_013 : 229|14@0+ (0.0001,0) [0|1] "NA"  ADAS
 SG_ OBJ_YAW_ANGLE_013 : 155|12@0+ (0.005,-10) [-10|10.475] "rad"  ADAS
 SG_ OBJ_YAW_ANGLE_ERR_013 : 175|7@0+ (0.01,0) [0|1.27] "rad"  ADAS
 SG_ OBJ_ID_013 : 7|8@0+ (1,0) [0|255] "NA"  ADAS
 SG_ OBJ_MOVEMENT_STATUS_013 : 196|3@0+ (1,0) [0|3] "NA"  ADAS
 SG_ OBJ_MEASUREMENT_STATUS_013 : 14|3@0+ (1,0) [0|7] "NA"  ADAS
 SG_ OBJ_POS_LONG_013 : 63|16@0+ (0.01,-327) [-327|327] "m"  ADAS
 SG_ OBJ_POS_LAT_013 : 79|16@0+ (0.01,-327) [-327|327] "m"  ADAS
 SG_ OBJ_VELOCITY_LONG_013 : 110|15@0+ (0.01,-163) [-163|163] "m/s"  ADAS
 SG_ OBJ_VELOCITY_LAT_013 : 126|15@0+ (0.01,-163) [-163|163] "m/s"  ADAS
 SG_ OBJ_ACCELERATION_LONG_013 : 193|10@0+ (0.05,-20) [-20|20] "m/s^2"  ADAS
 SG_ OBJ_ACCELERATION_LAT_013 : 177|10@0+ (0.05,-20) [-20|20] "m/s^2"  ADAS
 SG_ OBJ_VEH_TRACK_FLAG_013 : 10|1@0+ (1,0) [0|1] "NA"  ADAS
 SG_ OBJ_MH_CYCLE_COUNTER_013 : 487|8@0+ (1,0) [0|255] "NA"  ADAS
 SG_ OBJ_MH_CRC16_013 : 495|16@0+ (1,0) [0|65535] "NA"  ADAS
 SG_ OBJ_TIMESTAMP_OFFSET_013 : 247|8@0+ (1,-127) [-127|128] "ms"  ADAS
 SG_ OBJ_DIMENSION_WIDTH_ERR_013 : 23|6@0+ (0.01,0) [0|0.63] "m"  ADAS
 SG_ OBJ_DIMENSION_LENGTH_ERR_013 : 41|10@0+ (0.01,0) [0|10.23] "m"  ADAS
 SG_ OBJ_CLS_TYPE1_013 : 271|4@0+ (1,0) [0|15] "NA"  ADAS
 SG_ OBJ_CLS_TYPE1_PROB_013 : 303|8@0+ (0.004,0) [0|1] "NA"  ADAS
 SG_ OBJ_CLS_TYPE2_013 : 267|4@0+ (1,0) [0|15] "NA"  ADAS
 SG_ OBJ_CLS_TYPE2_PROB_013 : 311|8@0+ (0.004,0) [0|1] "NA"  ADAS
 SG_ OBJ_CLS_TYPE3_013 : 279|4@0+ (1,0) [0|15] "NA"  ADAS
 SG_ OBJ_CLS_TYPE3_PROB_013 : 319|8@0+ (0.004,0) [0|1] "NA"  ADAS
 SG_ OBJ_CLS_TYPE4_013 : 275|4@0+ (1,0) [0|15] "NA"  ADAS
 SG_ OBJ_CLS_TYPE4_PROB_013 : 327|8@0+ (0.004,0) [0|1] "NA"  ADAS
 SG_ OBJ_CLS_TYPE5_013 : 287|4@0+ (1,0) [0|15] "NA"  ADAS
 SG_ OBJ_CLS_TYPE5_PROB_013 : 335|8@0+ (0.004,0) [0|1] "NA"  ADAS
 SG_ OBJ_CLS_TYPE6_013 : 282|4@0+ (1,0) [0|15] "NA"  ADAS
 SG_ OBJ_CLS_TYPE6_PROB_013 : 343|8@0+ (0.004,0) [0|1] "NA"  ADAS
 SG_ OBJ_RCS_013 : 351|7@0+ (1,-64) [-64|63] "dBsm"  ADAS
 SG_ OBJ_REF_PT_LONG_OFFSET_013 : 357|14@0+ (0.0001,0) [0|1] "NA"  ADAS
 SG_ OBJ_REF_PT_LAT_OFFSET_013 : 370|14@0+ (0.0001,0) [0|1] "NA"  ADAS
 SG_ OBJ_YAW_RATE_013 : 399|10@0+ (0.005,-2.24) [-2.24|2.24] "rad/s"  ADAS
 SG_ OBJ_YAW_RATE_ERR_013 : 388|5@0+ (0.025,0) [0|0.775] "rad/s"  ADAS
 SG_ OBJ_GROUP_ID_013 : 405|6@0+ (1,0) [0|63] "NA"  ADAS
 SG_ OBJ_POS_ERR_CRR_COEF_013 : 415|8@0+ (0.01,-1.2) [-1.2|1] "NA"  ADAS
 SG_ OBJ_VELOCITY_ERR_CRR_COEF_013 : 423|8@0+ (0.01,-1.2) [-1.2|1] "NA"  ADAS
 SG_ OBJ_ACCEL_ERR_CRR_COEF_013 : 431|8@0+ (0.01,-1.2) [-1.2|1] "NA"  ADAS

BO_ 1373 RDR_TRACKER_OBJ_014: 64 RDR02
 SG_ OBJ_ALIVE_TIME_014 : 255|16@0+ (1,0) [0|65535] "ms"  ADAS
 SG_ OBJ_ACCELERATION_LONG_ERR_014 : 215|8@0+ (0.025,0) [0|6.375] "m/s^2"  ADAS
 SG_ OBJ_ACCELERATION_LAT_ERR_014 : 223|8@0+ (0.025,0) [0|6.375] "m/s^2"  ADAS
 SG_ OBJ_VELOCITY_LONG_ERR_014 : 143|8@0+ (0.05,0) [0|12.75] "m/s"  ADAS
 SG_ OBJ_VELOCITY_LAT_ERR_014 : 151|8@0+ (0.05,0) [0|12.75] "m/s"  ADAS
 SG_ OBJ_POS_LONG_ERR_014 : 95|8@0+ (0.025,0) [0|6.375] "m"  ADAS
 SG_ OBJ_POS_LAT_ERR_014 : 103|8@0+ (0.025,0) [0|6.375] "m"  ADAS
 SG_ OBJ_TRACK_MOTION_MODEL_014 : 9|2@0+ (1,0) [0|3] "NA"  ADAS
 SG_ OBJ_DIMENSION_WIDTH_014 : 17|10@0+ (0.01,0) [0|10.23] "m"  ADAS
 SG_ OBJ_DIMENSION_LENGTH_014 : 37|12@0+ (0.01,0) [0|40.95] "m"  ADAS
 SG_ OBJ_EXISTENCE_PROB_014 : 229|14@0+ (0.0001,0) [0|1] "NA"  ADAS
 SG_ OBJ_YAW_ANGLE_014 : 155|12@0+ (0.005,-10) [-10|10.475] "rad"  ADAS
 SG_ OBJ_YAW_ANGLE_ERR_014 : 175|7@0+ (0.01,0) [0|1.27] "rad"  ADAS
 SG_ OBJ_ID_014 : 7|8@0+ (1,0) [0|255] "NA"  ADAS
 SG_ OBJ_MOVEMENT_STATUS_014 : 196|3@0+ (1,0) [0|3] "NA"  ADAS
 SG_ OBJ_MEASUREMENT_STATUS_014 : 14|3@0+ (1,0) [0|7] "NA"  ADAS
 SG_ OBJ_POS_LONG_014 : 63|16@0+ (0.01,-327) [-327|327] "m"  ADAS
 SG_ OBJ_POS_LAT_014 : 79|16@0+ (0.01,-327) [-327|327] "m"  ADAS
 SG_ OBJ_VELOCITY_LONG_014 : 110|15@0+ (0.01,-163) [-163|163] "m/s"  ADAS
 SG_ OBJ_VELOCITY_LAT_014 : 126|15@0+ (0.01,-163) [-163|163] "m/s"  ADAS
 SG_ OBJ_ACCELERATION_LONG_014 : 193|10@0+ (0.05,-20) [-20|20] "m/s^2"  ADAS
 SG_ OBJ_ACCELERATION_LAT_014 : 177|10@0+ (0.05,-20) [-20|20] "m/s^2"  ADAS
 SG_ OBJ_VEH_TRACK_FLAG_014 : 10|1@0+ (1,0) [0|1] "NA"  ADAS
 SG_ OBJ_MH_CYCLE_COUNTER_014 : 487|8@0+ (1,0) [0|255] "NA"  ADAS
 SG_ OBJ_MH_CRC16_014 : 495|16@0+ (1,0) [0|65535] "NA"  ADAS
 SG_ OBJ_TIMESTAMP_OFFSET_014 : 247|8@0+ (1,-127) [-127|128] "ms"  ADAS
 SG_ OBJ_DIMENSION_WIDTH_ERR_014 : 23|6@0+ (0.01,0) [0|0.63] "m"  ADAS
 SG_ OBJ_DIMENSION_LENGTH_ERR_014 : 41|10@0+ (0.01,0) [0|10.23] "m"  ADAS
 SG_ OBJ_CLS_TYPE1_014 : 271|4@0+ (1,0) [0|15] "NA"  ADAS
 SG_ OBJ_CLS_TYPE1_PROB_014 : 303|8@0+ (0.004,0) [0|1] "NA"  ADAS
 SG_ OBJ_CLS_TYPE2_014 : 267|4@0+ (1,0) [0|15] "NA"  ADAS
 SG_ OBJ_CLS_TYPE2_PROB_014 : 311|8@0+ (0.004,0) [0|1] "NA"  ADAS
 SG_ OBJ_CLS_TYPE3_014 : 279|4@0+ (1,0) [0|15] "NA"  ADAS
 SG_ OBJ_CLS_TYPE3_PROB_014 : 319|8@0+ (0.004,0) [0|1] "NA"  ADAS
 SG_ OBJ_CLS_TYPE4_014 : 275|4@0+ (1,0) [0|15] "NA"  ADAS
 SG_ OBJ_CLS_TYPE4_PROB_014 : 327|8@0+ (0.004,0) [0|1] "NA"  ADAS
 SG_ OBJ_CLS_TYPE5_014 : 287|4@0+ (1,0) [0|15] "NA"  ADAS
 SG_ OBJ_CLS_TYPE5_PROB_014 : 335|8@0+ (0.004,0) [0|1] "NA"  ADAS
 SG_ OBJ_CLS_TYPE6_014 : 282|4@0+ (1,0) [0|15] "NA"  ADAS
 SG_ OBJ_CLS_TYPE6_PROB_014 : 343|8@0+ (0.004,0) [0|1] "NA"  ADAS
 SG_ OBJ_RCS_014 : 351|7@0+ (1,-64) [-64|63] "dBsm"  ADAS
 SG_ OBJ_REF_PT_LONG_OFFSET_014 : 357|14@0+ (0.0001,0) [0|1] "NA"  ADAS
 SG_ OBJ_REF_PT_LAT_OFFSET_014 : 370|14@0+ (0.0001,0) [0|1] "NA"  ADAS
 SG_ OBJ_YAW_RATE_014 : 399|10@0+ (0.005,-2.24) [-2.24|2.24] "rad/s"  ADAS
 SG_ OBJ_YAW_RATE_ERR_014 : 388|5@0+ (0.025,0) [0|0.775] "rad/s"  ADAS
 SG_ OBJ_GROUP_ID_014 : 405|6@0+ (1,0) [0|63] "NA"  ADAS
 SG_ OBJ_POS_ERR_CRR_COEF_014 : 415|8@0+ (0.01,-1.2) [-1.2|1] "NA"  ADAS
 SG_ OBJ_VELOCITY_ERR_CRR_COEF_014 : 423|8@0+ (0.01,-1.2) [-1.2|1] "NA"  ADAS
 SG_ OBJ_ACCEL_ERR_CRR_COEF_014 : 431|8@0+ (0.01,-1.2) [-1.2|1] "NA"  ADAS

BO_ 1374 RDR_TRACKER_OBJ_015: 64 RDR02
 SG_ OBJ_ALIVE_TIME_015 : 255|16@0+ (1,0) [0|65535] "ms"  ADAS
 SG_ OBJ_ACCELERATION_LONG_ERR_015 : 215|8@0+ (0.025,0) [0|6.375] "m/s^2"  ADAS
 SG_ OBJ_ACCELERATION_LAT_ERR_015 : 223|8@0+ (0.025,0) [0|6.375] "m/s^2"  ADAS
 SG_ OBJ_VELOCITY_LONG_ERR_015 : 143|8@0+ (0.05,0) [0|12.75] "m/s"  ADAS
 SG_ OBJ_VELOCITY_LAT_ERR_015 : 151|8@0+ (0.05,0) [0|12.75] "m/s"  ADAS
 SG_ OBJ_POS_LONG_ERR_015 : 95|8@0+ (0.025,0) [0|6.375] "m"  ADAS
 SG_ OBJ_POS_LAT_ERR_015 : 103|8@0+ (0.025,0) [0|6.375] "m"  ADAS
 SG_ OBJ_TRACK_MOTION_MODEL_015 : 9|2@0+ (1,0) [0|3] "NA"  ADAS
 SG_ OBJ_DIMENSION_WIDTH_015 : 17|10@0+ (0.01,0) [0|10.23] "m"  ADAS
 SG_ OBJ_DIMENSION_LENGTH_015 : 37|12@0+ (0.01,0) [0|40.95] "m"  ADAS
 SG_ OBJ_EXISTENCE_PROB_015 : 229|14@0+ (0.0001,0) [0|1] "NA"  ADAS
 SG_ OBJ_YAW_ANGLE_015 : 155|12@0+ (0.005,-10) [-10|10.475] "rad"  ADAS
 SG_ OBJ_YAW_ANGLE_ERR_015 : 175|7@0+ (0.01,0) [0|1.27] "rad"  ADAS
 SG_ OBJ_ID_015 : 7|8@0+ (1,0) [0|255] "NA"  ADAS
 SG_ OBJ_MOVEMENT_STATUS_015 : 196|3@0+ (1,0) [0|3] "NA"  ADAS
 SG_ OBJ_MEASUREMENT_STATUS_015 : 14|3@0+ (1,0) [0|7] "NA"  ADAS
 SG_ OBJ_POS_LONG_015 : 63|16@0+ (0.01,-327) [-327|327] "m"  ADAS
 SG_ OBJ_POS_LAT_015 : 79|16@0+ (0.01,-327) [-327|327] "m"  ADAS
 SG_ OBJ_VELOCITY_LONG_015 : 110|15@0+ (0.01,-163) [-163|163] "m/s"  ADAS
 SG_ OBJ_VELOCITY_LAT_015 : 126|15@0+ (0.01,-163) [-163|163] "m/s"  ADAS
 SG_ OBJ_ACCELERATION_LONG_015 : 193|10@0+ (0.05,-20) [-20|20] "m/s^2"  ADAS
 SG_ OBJ_ACCELERATION_LAT_015 : 177|10@0+ (0.05,-20) [-20|20] "m/s^2"  ADAS
 SG_ OBJ_VEH_TRACK_FLAG_015 : 10|1@0+ (1,0) [0|1] "NA"  ADAS
 SG_ OBJ_MH_CYCLE_COUNTER_015 : 487|8@0+ (1,0) [0|255] "NA"  ADAS
 SG_ OBJ_MH_CRC16_015 : 495|16@0+ (1,0) [0|65535] "NA"  ADAS
 SG_ OBJ_TIMESTAMP_OFFSET_015 : 247|8@0+ (1,-127) [-127|128] "ms"  ADAS
 SG_ OBJ_DIMENSION_WIDTH_ERR_015 : 23|6@0+ (0.01,0) [0|0.63] "m"  ADAS
 SG_ OBJ_DIMENSION_LENGTH_ERR_015 : 41|10@0+ (0.01,0) [0|10.23] "m"  ADAS
 SG_ OBJ_CLS_TYPE1_015 : 271|4@0+ (1,0) [0|15] "NA"  ADAS
 SG_ OBJ_CLS_TYPE1_PROB_015 : 303|8@0+ (0.004,0) [0|1] "NA"  ADAS
 SG_ OBJ_CLS_TYPE2_015 : 267|4@0+ (1,0) [0|15] "NA"  ADAS
 SG_ OBJ_CLS_TYPE2_PROB_015 : 311|8@0+ (0.004,0) [0|1] "NA"  ADAS
 SG_ OBJ_CLS_TYPE3_015 : 279|4@0+ (1,0) [0|15] "NA"  ADAS
 SG_ OBJ_CLS_TYPE3_PROB_015 : 319|8@0+ (0.004,0) [0|1] "NA"  ADAS
 SG_ OBJ_CLS_TYPE4_015 : 275|4@0+ (1,0) [0|15] "NA"  ADAS
 SG_ OBJ_CLS_TYPE4_PROB_015 : 327|8@0+ (0.004,0) [0|1] "NA"  ADAS
 SG_ OBJ_CLS_TYPE5_015 : 287|4@0+ (1,0) [0|15] "NA"  ADAS
 SG_ OBJ_CLS_TYPE5_PROB_015 : 335|8@0+ (0.004,0) [0|1] "NA"  ADAS
 SG_ OBJ_CLS_TYPE6_015 : 282|4@0+ (1,0) [0|15] "NA"  ADAS
 SG_ OBJ_CLS_TYPE6_PROB_015 : 343|8@0+ (0.004,0) [0|1] "NA"  ADAS
 SG_ OBJ_RCS_015 : 351|7@0+ (1,-64) [-64|63] "dBsm"  ADAS
 SG_ OBJ_REF_PT_LONG_OFFSET_015 : 357|14@0+ (0.0001,0) [0|1] "NA"  ADAS
 SG_ OBJ_REF_PT_LAT_OFFSET_015 : 370|14@0+ (0.0001,0) [0|1] "NA"  ADAS
 SG_ OBJ_YAW_RATE_015 : 399|10@0+ (0.005,-2.24) [-2.24|2.24] "rad/s"  ADAS
 SG_ OBJ_YAW_RATE_ERR_015 : 388|5@0+ (0.025,0) [0|0.775] "rad/s"  ADAS
 SG_ OBJ_GROUP_ID_015 : 405|6@0+ (1,0) [0|63] "NA"  ADAS
 SG_ OBJ_POS_ERR_CRR_COEF_015 : 415|8@0+ (0.01,-1.2) [-1.2|1] "NA"  ADAS
 SG_ OBJ_VELOCITY_ERR_CRR_COEF_015 : 423|8@0+ (0.01,-1.2) [-1.2|1] "NA"  ADAS
 SG_ OBJ_ACCEL_ERR_CRR_COEF_015 : 431|8@0+ (0.01,-1.2) [-1.2|1] "NA"  ADAS

BO_ 1375 RDR_TRACKER_OBJ_016: 64 RDR02
 SG_ OBJ_ALIVE_TIME_016 : 255|16@0+ (1,0) [0|65535] "ms"  ADAS
 SG_ OBJ_ACCELERATION_LONG_ERR_016 : 215|8@0+ (0.025,0) [0|6.375] "m/s^2"  ADAS
 SG_ OBJ_ACCELERATION_LAT_ERR_016 : 223|8@0+ (0.025,0) [0|6.375] "m/s^2"  ADAS
 SG_ OBJ_VELOCITY_LONG_ERR_016 : 143|8@0+ (0.05,0) [0|12.75] "m/s"  ADAS
 SG_ OBJ_VELOCITY_LAT_ERR_016 : 151|8@0+ (0.05,0) [0|12.75] "m/s"  ADAS
 SG_ OBJ_POS_LONG_ERR_016 : 95|8@0+ (0.025,0) [0|6.375] "m"  ADAS
 SG_ OBJ_POS_LAT_ERR_016 : 103|8@0+ (0.025,0) [0|6.375] "m"  ADAS
 SG_ OBJ_TRACK_MOTION_MODEL_016 : 9|2@0+ (1,0) [0|3] "NA"  ADAS
 SG_ OBJ_DIMENSION_WIDTH_016 : 17|10@0+ (0.01,0) [0|10.23] "m"  ADAS
 SG_ OBJ_DIMENSION_LENGTH_016 : 37|12@0+ (0.01,0) [0|40.95] "m"  ADAS
 SG_ OBJ_EXISTENCE_PROB_016 : 229|14@0+ (0.0001,0) [0|1] "NA"  ADAS
 SG_ OBJ_YAW_ANGLE_016 : 155|12@0+ (0.005,-10) [-10|10.475] "rad"  ADAS
 SG_ OBJ_YAW_ANGLE_ERR_016 : 175|7@0+ (0.01,0) [0|1.27] "rad"  ADAS
 SG_ OBJ_ID_016 : 7|8@0+ (1,0) [0|255] "NA"  ADAS
 SG_ OBJ_MOVEMENT_STATUS_016 : 196|3@0+ (1,0) [0|3] "NA"  ADAS
 SG_ OBJ_MEASUREMENT_STATUS_016 : 14|3@0+ (1,0) [0|7] "NA"  ADAS
 SG_ OBJ_POS_LONG_016 : 63|16@0+ (0.01,-327) [-327|327] "m"  ADAS
 SG_ OBJ_POS_LAT_016 : 79|16@0+ (0.01,-327) [-327|327] "m"  ADAS
 SG_ OBJ_VELOCITY_LONG_016 : 110|15@0+ (0.01,-163) [-163|163] "m/s"  ADAS
 SG_ OBJ_VELOCITY_LAT_016 : 126|15@0+ (0.01,-163) [-163|163] "m/s"  ADAS
 SG_ OBJ_ACCELERATION_LONG_016 : 193|10@0+ (0.05,-20) [-20|20] "m/s^2"  ADAS
 SG_ OBJ_ACCELERATION_LAT_016 : 177|10@0+ (0.05,-20) [-20|20] "m/s^2"  ADAS
 SG_ OBJ_VEH_TRACK_FLAG_016 : 10|1@0+ (1,0) [0|1] "NA"  ADAS
 SG_ OBJ_MH_CYCLE_COUNTER_016 : 487|8@0+ (1,0) [0|255] "NA"  ADAS
 SG_ OBJ_MH_CRC16_016 : 495|16@0+ (1,0) [0|65535] "NA"  ADAS
 SG_ OBJ_TIMESTAMP_OFFSET_016 : 247|8@0+ (1,-127) [-127|128] "ms"  ADAS
 SG_ OBJ_DIMENSION_WIDTH_ERR_016 : 23|6@0+ (0.01,0) [0|0.63] "m"  ADAS
 SG_ OBJ_DIMENSION_LENGTH_ERR_016 : 41|10@0+ (0.01,0) [0|10.23] "m"  ADAS
 SG_ OBJ_CLS_TYPE1_016 : 271|4@0+ (1,0) [0|15] "NA"  ADAS
 SG_ OBJ_CLS_TYPE1_PROB_016 : 303|8@0+ (0.004,0) [0|1] "NA"  ADAS
 SG_ OBJ_CLS_TYPE2_016 : 267|4@0+ (1,0) [0|15] "NA"  ADAS
 SG_ OBJ_CLS_TYPE2_PROB_016 : 311|8@0+ (0.004,0) [0|1] "NA"  ADAS
 SG_ OBJ_CLS_TYPE3_016 : 279|4@0+ (1,0) [0|15] "NA"  ADAS
 SG_ OBJ_CLS_TYPE3_PROB_016 : 319|8@0+ (0.004,0) [0|1] "NA"  ADAS
 SG_ OBJ_CLS_TYPE4_016 : 275|4@0+ (1,0) [0|15] "NA"  ADAS
 SG_ OBJ_CLS_TYPE4_PROB_016 : 327|8@0+ (0.004,0) [0|1] "NA"  ADAS
 SG_ OBJ_CLS_TYPE5_016 : 287|4@0+ (1,0) [0|15] "NA"  ADAS
 SG_ OBJ_CLS_TYPE5_PROB_016 : 335|8@0+ (0.004,0) [0|1] "NA"  ADAS
 SG_ OBJ_CLS_TYPE6_016 : 282|4@0+ (1,0) [0|15] "NA"  ADAS
 SG_ OBJ_CLS_TYPE6_PROB_016 : 343|8@0+ (0.004,0) [0|1] "NA"  ADAS
 SG_ OBJ_RCS_016 : 351|7@0+ (1,-64) [-64|63] "dBsm"  ADAS
 SG_ OBJ_REF_PT_LONG_OFFSET_016 : 357|14@0+ (0.0001,0) [0|1] "NA"  ADAS
 SG_ OBJ_REF_PT_LAT_OFFSET_016 : 370|14@0+ (0.0001,0) [0|1] "NA"  ADAS
 SG_ OBJ_YAW_RATE_016 : 399|10@0+ (0.005,-2.24) [-2.24|2.24] "rad/s"  ADAS
 SG_ OBJ_YAW_RATE_ERR_016 : 388|5@0+ (0.025,0) [0|0.775] "rad/s"  ADAS
 SG_ OBJ_GROUP_ID_016 : 405|6@0+ (1,0) [0|63] "NA"  ADAS
 SG_ OBJ_POS_ERR_CRR_COEF_016 : 415|8@0+ (0.01,-1.2) [-1.2|1] "NA"  ADAS
 SG_ OBJ_VELOCITY_ERR_CRR_COEF_016 : 423|8@0+ (0.01,-1.2) [-1.2|1] "NA"  ADAS
 SG_ OBJ_ACCEL_ERR_CRR_COEF_016 : 431|8@0+ (0.01,-1.2) [-1.2|1] "NA"  ADAS

BO_ 1376 RDR_TRACKER_OBJ_017: 64 RDR02
 SG_ OBJ_ALIVE_TIME_017 : 255|16@0+ (1,0) [0|65535] "ms"  ADAS
 SG_ OBJ_ACCELERATION_LONG_ERR_017 : 215|8@0+ (0.025,0) [0|6.375] "m/s^2"  ADAS
 SG_ OBJ_ACCELERATION_LAT_ERR_017 : 223|8@0+ (0.025,0) [0|6.375] "m/s^2"  ADAS
 SG_ OBJ_VELOCITY_LONG_ERR_017 : 143|8@0+ (0.05,0) [0|12.75] "m/s"  ADAS
 SG_ OBJ_VELOCITY_LAT_ERR_017 : 151|8@0+ (0.05,0) [0|12.75] "m/s"  ADAS
 SG_ OBJ_POS_LONG_ERR_017 : 95|8@0+ (0.025,0) [0|6.375] "m"  ADAS
 SG_ OBJ_POS_LAT_ERR_017 : 103|8@0+ (0.025,0) [0|6.375] "m"  ADAS
 SG_ OBJ_TRACK_MOTION_MODEL_017 : 9|2@0+ (1,0) [0|3] "NA"  ADAS
 SG_ OBJ_DIMENSION_WIDTH_017 : 17|10@0+ (0.01,0) [0|10.23] "m"  ADAS
 SG_ OBJ_DIMENSION_LENGTH_017 : 37|12@0+ (0.01,0) [0|40.95] "m"  ADAS
 SG_ OBJ_EXISTENCE_PROB_017 : 229|14@0+ (0.0001,0) [0|1] "NA"  ADAS
 SG_ OBJ_YAW_ANGLE_017 : 155|12@0+ (0.005,-10) [-10|10.475] "rad"  ADAS
 SG_ OBJ_YAW_ANGLE_ERR_017 : 175|7@0+ (0.01,0) [0|1.27] "rad"  ADAS
 SG_ OBJ_ID_017 : 7|8@0+ (1,0) [0|255] "NA"  ADAS
 SG_ OBJ_MOVEMENT_STATUS_017 : 196|3@0+ (1,0) [0|3] "NA"  ADAS
 SG_ OBJ_MEASUREMENT_STATUS_017 : 14|3@0+ (1,0) [0|7] "NA"  ADAS
 SG_ OBJ_POS_LONG_017 : 63|16@0+ (0.01,-327) [-327|327] "m"  ADAS
 SG_ OBJ_POS_LAT_017 : 79|16@0+ (0.01,-327) [-327|327] "m"  ADAS
 SG_ OBJ_VELOCITY_LONG_017 : 110|15@0+ (0.01,-163) [-163|163] "m/s"  ADAS
 SG_ OBJ_VELOCITY_LAT_017 : 126|15@0+ (0.01,-163) [-163|163] "m/s"  ADAS
 SG_ OBJ_ACCELERATION_LONG_017 : 193|10@0+ (0.05,-20) [-20|20] "m/s^2"  ADAS
 SG_ OBJ_ACCELERATION_LAT_017 : 177|10@0+ (0.05,-20) [-20|20] "m/s^2"  ADAS
 SG_ OBJ_VEH_TRACK_FLAG_017 : 10|1@0+ (1,0) [0|1] "NA"  ADAS
 SG_ OBJ_MH_CYCLE_COUNTER_017 : 487|8@0+ (1,0) [0|255] "NA"  ADAS
 SG_ OBJ_MH_CRC16_017 : 495|16@0+ (1,0) [0|65535] "NA"  ADAS
 SG_ OBJ_TIMESTAMP_OFFSET_017 : 247|8@0+ (1,-127) [-127|128] "ms"  ADAS
 SG_ OBJ_DIMENSION_WIDTH_ERR_017 : 23|6@0+ (0.01,0) [0|0.63] "m"  ADAS
 SG_ OBJ_DIMENSION_LENGTH_ERR_017 : 41|10@0+ (0.01,0) [0|10.23] "m"  ADAS
 SG_ OBJ_CLS_TYPE1_017 : 271|4@0+ (1,0) [0|15] "NA"  ADAS
 SG_ OBJ_CLS_TYPE1_PROB_017 : 303|8@0+ (0.004,0) [0|1] "NA"  ADAS
 SG_ OBJ_CLS_TYPE2_017 : 267|4@0+ (1,0) [0|15] "NA"  ADAS
 SG_ OBJ_CLS_TYPE2_PROB_017 : 311|8@0+ (0.004,0) [0|1] "NA"  ADAS
 SG_ OBJ_CLS_TYPE3_017 : 279|4@0+ (1,0) [0|15] "NA"  ADAS
 SG_ OBJ_CLS_TYPE3_PROB_017 : 319|8@0+ (0.004,0) [0|1] "NA"  ADAS
 SG_ OBJ_CLS_TYPE4_017 : 275|4@0+ (1,0) [0|15] "NA"  ADAS
 SG_ OBJ_CLS_TYPE4_PROB_017 : 327|8@0+ (0.004,0) [0|1] "NA"  ADAS
 SG_ OBJ_CLS_TYPE5_017 : 287|4@0+ (1,0) [0|15] "NA"  ADAS
 SG_ OBJ_CLS_TYPE5_PROB_017 : 335|8@0+ (0.004,0) [0|1] "NA"  ADAS
 SG_ OBJ_CLS_TYPE6_017 : 282|4@0+ (1,0) [0|15] "NA"  ADAS
 SG_ OBJ_CLS_TYPE6_PROB_017 : 343|8@0+ (0.004,0) [0|1] "NA"  ADAS
 SG_ OBJ_RCS_017 : 351|7@0+ (1,-64) [-64|63] "dBsm"  ADAS
 SG_ OBJ_REF_PT_LONG_OFFSET_017 : 357|14@0+ (0.0001,0) [0|1] "NA"  ADAS
 SG_ OBJ_REF_PT_LAT_OFFSET_017 : 370|14@0+ (0.0001,0) [0|1] "NA"  ADAS
 SG_ OBJ_YAW_RATE_017 : 399|10@0+ (0.005,-2.24) [-2.24|2.24] "rad/s"  ADAS
 SG_ OBJ_YAW_RATE_ERR_017 : 388|5@0+ (0.025,0) [0|0.775] "rad/s"  ADAS
 SG_ OBJ_GROUP_ID_017 : 405|6@0+ (1,0) [0|63] "NA"  ADAS
 SG_ OBJ_POS_ERR_CRR_COEF_017 : 415|8@0+ (0.01,-1.2) [-1.2|1] "NA"  ADAS
 SG_ OBJ_VELOCITY_ERR_CRR_COEF_017 : 423|8@0+ (0.01,-1.2) [-1.2|1] "NA"  ADAS
 SG_ OBJ_ACCEL_ERR_CRR_COEF_017 : 431|8@0+ (0.01,-1.2) [-1.2|1] "NA"  ADAS

BO_ 1377 RDR_TRACKER_OBJ_018: 64 RDR02
 SG_ OBJ_ALIVE_TIME_018 : 255|16@0+ (1,0) [0|65535] "ms"  ADAS
 SG_ OBJ_ACCELERATION_LONG_ERR_018 : 215|8@0+ (0.025,0) [0|6.375] "m/s^2"  ADAS
 SG_ OBJ_ACCELERATION_LAT_ERR_018 : 223|8@0+ (0.025,0) [0|6.375] "m/s^2"  ADAS
 SG_ OBJ_VELOCITY_LONG_ERR_018 : 143|8@0+ (0.05,0) [0|12.75] "m/s"  ADAS
 SG_ OBJ_VELOCITY_LAT_ERR_018 : 151|8@0+ (0.05,0) [0|12.75] "m/s"  ADAS
 SG_ OBJ_POS_LONG_ERR_018 : 95|8@0+ (0.025,0) [0|6.375] "m"  ADAS
 SG_ OBJ_POS_LAT_ERR_018 : 103|8@0+ (0.025,0) [0|6.375] "m"  ADAS
 SG_ OBJ_TRACK_MOTION_MODEL_018 : 9|2@0+ (1,0) [0|3] "NA"  ADAS
 SG_ OBJ_DIMENSION_WIDTH_018 : 17|10@0+ (0.01,0) [0|10.23] "m"  ADAS
 SG_ OBJ_DIMENSION_LENGTH_018 : 37|12@0+ (0.01,0) [0|40.95] "m"  ADAS
 SG_ OBJ_EXISTENCE_PROB_018 : 229|14@0+ (0.0001,0) [0|1] "NA"  ADAS
 SG_ OBJ_YAW_ANGLE_018 : 155|12@0+ (0.005,-10) [-10|10.475] "rad"  ADAS
 SG_ OBJ_YAW_ANGLE_ERR_018 : 175|7@0+ (0.01,0) [0|1.27] "rad"  ADAS
 SG_ OBJ_ID_018 : 7|8@0+ (1,0) [0|255] "NA"  ADAS
 SG_ OBJ_MOVEMENT_STATUS_018 : 196|3@0+ (1,0) [0|3] "NA"  ADAS
 SG_ OBJ_MEASUREMENT_STATUS_018 : 14|3@0+ (1,0) [0|7] "NA"  ADAS
 SG_ OBJ_POS_LONG_018 : 63|16@0+ (0.01,-327) [-327|327] "m"  ADAS
 SG_ OBJ_POS_LAT_018 : 79|16@0+ (0.01,-327) [-327|327] "m"  ADAS
 SG_ OBJ_VELOCITY_LONG_018 : 110|15@0+ (0.01,-163) [-163|163] "m/s"  ADAS
 SG_ OBJ_VELOCITY_LAT_018 : 126|15@0+ (0.01,-163) [-163|163] "m/s"  ADAS
 SG_ OBJ_ACCELERATION_LONG_018 : 193|10@0+ (0.05,-20) [-20|20] "m/s^2"  ADAS
 SG_ OBJ_ACCELERATION_LAT_018 : 177|10@0+ (0.05,-20) [-20|20] "m/s^2"  ADAS
 SG_ OBJ_VEH_TRACK_FLAG_018 : 10|1@0+ (1,0) [0|1] "NA"  ADAS
 SG_ OBJ_MH_CYCLE_COUNTER_018 : 487|8@0+ (1,0) [0|255] "NA"  ADAS
 SG_ OBJ_MH_CRC16_018 : 495|16@0+ (1,0) [0|65535] "NA"  ADAS
 SG_ OBJ_TIMESTAMP_OFFSET_018 : 247|8@0+ (1,-127) [-127|128] "ms"  ADAS
 SG_ OBJ_DIMENSION_WIDTH_ERR_018 : 23|6@0+ (0.01,0) [0|0.63] "m"  ADAS
 SG_ OBJ_DIMENSION_LENGTH_ERR_018 : 41|10@0+ (0.01,0) [0|10.23] "m"  ADAS
 SG_ OBJ_CLS_TYPE1_018 : 271|4@0+ (1,0) [0|15] "NA"  ADAS
 SG_ OBJ_CLS_TYPE1_PROB_018 : 303|8@0+ (0.004,0) [0|1] "NA"  ADAS
 SG_ OBJ_CLS_TYPE2_018 : 267|4@0+ (1,0) [0|15] "NA"  ADAS
 SG_ OBJ_CLS_TYPE2_PROB_018 : 311|8@0+ (0.004,0) [0|1] "NA"  ADAS
 SG_ OBJ_CLS_TYPE3_018 : 279|4@0+ (1,0) [0|15] "NA"  ADAS
 SG_ OBJ_CLS_TYPE3_PROB_018 : 319|8@0+ (0.004,0) [0|1] "NA"  ADAS
 SG_ OBJ_CLS_TYPE4_018 : 275|4@0+ (1,0) [0|15] "NA"  ADAS
 SG_ OBJ_CLS_TYPE4_PROB_018 : 327|8@0+ (0.004,0) [0|1] "NA"  ADAS
 SG_ OBJ_CLS_TYPE5_018 : 287|4@0+ (1,0) [0|15] "NA"  ADAS
 SG_ OBJ_CLS_TYPE5_PROB_018 : 335|8@0+ (0.004,0) [0|1] "NA"  ADAS
 SG_ OBJ_CLS_TYPE6_018 : 282|4@0+ (1,0) [0|15] "NA"  ADAS
 SG_ OBJ_CLS_TYPE6_PROB_018 : 343|8@0+ (0.004,0) [0|1] "NA"  ADAS
 SG_ OBJ_RCS_018 : 351|7@0+ (1,-64) [-64|63] "dBsm"  ADAS
 SG_ OBJ_REF_PT_LONG_OFFSET_018 : 357|14@0+ (0.0001,0) [0|1] "NA"  ADAS
 SG_ OBJ_REF_PT_LAT_OFFSET_018 : 370|14@0+ (0.0001,0) [0|1] "NA"  ADAS
 SG_ OBJ_YAW_RATE_018 : 399|10@0+ (0.005,-2.24) [-2.24|2.24] "rad/s"  ADAS
 SG_ OBJ_YAW_RATE_ERR_018 : 388|5@0+ (0.025,0) [0|0.775] "rad/s"  ADAS
 SG_ OBJ_GROUP_ID_018 : 405|6@0+ (1,0) [0|63] "NA"  ADAS
 SG_ OBJ_POS_ERR_CRR_COEF_018 : 415|8@0+ (0.01,-1.2) [-1.2|1] "NA"  ADAS
 SG_ OBJ_VELOCITY_ERR_CRR_COEF_018 : 423|8@0+ (0.01,-1.2) [-1.2|1] "NA"  ADAS
 SG_ OBJ_ACCEL_ERR_CRR_COEF_018 : 431|8@0+ (0.01,-1.2) [-1.2|1] "NA"  ADAS

BO_ 1378 RDR_TRACKER_OBJ_019: 64 RDR02
 SG_ OBJ_ALIVE_TIME_019 : 255|16@0+ (1,0) [0|65535] "ms"  ADAS
 SG_ OBJ_ACCELERATION_LONG_ERR_019 : 215|8@0+ (0.025,0) [0|6.375] "m/s^2"  ADAS
 SG_ OBJ_ACCELERATION_LAT_ERR_019 : 223|8@0+ (0.025,0) [0|6.375] "m/s^2"  ADAS
 SG_ OBJ_VELOCITY_LONG_ERR_019 : 143|8@0+ (0.05,0) [0|12.75] "m/s"  ADAS
 SG_ OBJ_VELOCITY_LAT_ERR_019 : 151|8@0+ (0.05,0) [0|12.75] "m/s"  ADAS
 SG_ OBJ_POS_LONG_ERR_019 : 95|8@0+ (0.025,0) [0|6.375] "m"  ADAS
 SG_ OBJ_POS_LAT_ERR_019 : 103|8@0+ (0.025,0) [0|6.375] "m"  ADAS
 SG_ OBJ_TRACK_MOTION_MODEL_019 : 9|2@0+ (1,0) [0|3] "NA"  ADAS
 SG_ OBJ_DIMENSION_WIDTH_019 : 17|10@0+ (0.01,0) [0|10.23] "m"  ADAS
 SG_ OBJ_DIMENSION_LENGTH_019 : 37|12@0+ (0.01,0) [0|40.95] "m"  ADAS
 SG_ OBJ_EXISTENCE_PROB_019 : 229|14@0+ (0.0001,0) [0|1] "NA"  ADAS
 SG_ OBJ_YAW_ANGLE_019 : 155|12@0+ (0.005,-10) [-10|10.475] "rad"  ADAS
 SG_ OBJ_YAW_ANGLE_ERR_019 : 175|7@0+ (0.01,0) [0|1.27] "rad"  ADAS
 SG_ OBJ_ID_019 : 7|8@0+ (1,0) [0|255] "NA"  ADAS
 SG_ OBJ_MOVEMENT_STATUS_019 : 196|3@0+ (1,0) [0|3] "NA"  ADAS
 SG_ OBJ_MEASUREMENT_STATUS_019 : 14|3@0+ (1,0) [0|7] "NA"  ADAS
 SG_ OBJ_POS_LONG_019 : 63|16@0+ (0.01,-327) [-327|327] "m"  ADAS
 SG_ OBJ_POS_LAT_019 : 79|16@0+ (0.01,-327) [-327|327] "m"  ADAS
 SG_ OBJ_VELOCITY_LONG_019 : 110|15@0+ (0.01,-163) [-163|163] "m/s"  ADAS
 SG_ OBJ_VELOCITY_LAT_019 : 126|15@0+ (0.01,-163) [-163|163] "m/s"  ADAS
 SG_ OBJ_ACCELERATION_LONG_019 : 193|10@0+ (0.05,-20) [-20|20] "m/s^2"  ADAS
 SG_ OBJ_ACCELERATION_LAT_019 : 177|10@0+ (0.05,-20) [-20|20] "m/s^2"  ADAS
 SG_ OBJ_VEH_TRACK_FLAG_019 : 10|1@0+ (1,0) [0|1] "NA"  ADAS
 SG_ OBJ_MH_CYCLE_COUNTER_019 : 487|8@0+ (1,0) [0|255] "NA"  ADAS
 SG_ OBJ_MH_CRC16_019 : 495|16@0+ (1,0) [0|65535] "NA"  ADAS
 SG_ OBJ_TIMESTAMP_OFFSET_019 : 247|8@0+ (1,-127) [-127|128] "ms"  ADAS
 SG_ OBJ_DIMENSION_WIDTH_ERR_019 : 23|6@0+ (0.01,0) [0|0.63] "m"  ADAS
 SG_ OBJ_DIMENSION_LENGTH_ERR_019 : 41|10@0+ (0.01,0) [0|10.23] "m"  ADAS
 SG_ OBJ_CLS_TYPE1_019 : 271|4@0+ (1,0) [0|15] "NA"  ADAS
 SG_ OBJ_CLS_TYPE1_PROB_019 : 303|8@0+ (0.004,0) [0|1] "NA"  ADAS
 SG_ OBJ_CLS_TYPE2_019 : 267|4@0+ (1,0) [0|15] "NA"  ADAS
 SG_ OBJ_CLS_TYPE2_PROB_019 : 311|8@0+ (0.004,0) [0|1] "NA"  ADAS
 SG_ OBJ_CLS_TYPE3_019 : 279|4@0+ (1,0) [0|15] "NA"  ADAS
 SG_ OBJ_CLS_TYPE3_PROB_019 : 319|8@0+ (0.004,0) [0|1] "NA"  ADAS
 SG_ OBJ_CLS_TYPE4_019 : 275|4@0+ (1,0) [0|15] "NA"  ADAS
 SG_ OBJ_CLS_TYPE4_PROB_019 : 327|8@0+ (0.004,0) [0|1] "NA"  ADAS
 SG_ OBJ_CLS_TYPE5_019 : 287|4@0+ (1,0) [0|15] "NA"  ADAS
 SG_ OBJ_CLS_TYPE5_PROB_019 : 335|8@0+ (0.004,0) [0|1] "NA"  ADAS
 SG_ OBJ_CLS_TYPE6_019 : 282|4@0+ (1,0) [0|15] "NA"  ADAS
 SG_ OBJ_CLS_TYPE6_PROB_019 : 343|8@0+ (0.004,0) [0|1] "NA"  ADAS
 SG_ OBJ_RCS_019 : 351|7@0+ (1,-64) [-64|63] "dBsm"  ADAS
 SG_ OBJ_REF_PT_LONG_OFFSET_019 : 357|14@0+ (0.0001,0) [0|1] "NA"  ADAS
 SG_ OBJ_REF_PT_LAT_OFFSET_019 : 370|14@0+ (0.0001,0) [0|1] "NA"  ADAS
 SG_ OBJ_YAW_RATE_019 : 399|10@0+ (0.005,-2.24) [-2.24|2.24] "rad/s"  ADAS
 SG_ OBJ_YAW_RATE_ERR_019 : 388|5@0+ (0.025,0) [0|0.775] "rad/s"  ADAS
 SG_ OBJ_GROUP_ID_019 : 405|6@0+ (1,0) [0|63] "NA"  ADAS
 SG_ OBJ_POS_ERR_CRR_COEF_019 : 415|8@0+ (0.01,-1.2) [-1.2|1] "NA"  ADAS
 SG_ OBJ_VELOCITY_ERR_CRR_COEF_019 : 423|8@0+ (0.01,-1.2) [-1.2|1] "NA"  ADAS
 SG_ OBJ_ACCEL_ERR_CRR_COEF_019 : 431|8@0+ (0.01,-1.2) [-1.2|1] "NA"  ADAS

BO_ 1379 RDR_TRACKER_OBJ_020: 64 RDR02
 SG_ OBJ_ALIVE_TIME_020 : 255|16@0+ (1,0) [0|65535] "ms"  ADAS
 SG_ OBJ_ACCELERATION_LONG_ERR_020 : 215|8@0+ (0.025,0) [0|6.375] "m/s^2"  ADAS
 SG_ OBJ_ACCELERATION_LAT_ERR_020 : 223|8@0+ (0.025,0) [0|6.375] "m/s^2"  ADAS
 SG_ OBJ_VELOCITY_LONG_ERR_020 : 143|8@0+ (0.05,0) [0|12.75] "m/s"  ADAS
 SG_ OBJ_VELOCITY_LAT_ERR_020 : 151|8@0+ (0.05,0) [0|12.75] "m/s"  ADAS
 SG_ OBJ_POS_LONG_ERR_020 : 95|8@0+ (0.025,0) [0|6.375] "m"  ADAS
 SG_ OBJ_POS_LAT_ERR_020 : 103|8@0+ (0.025,0) [0|6.375] "m"  ADAS
 SG_ OBJ_TRACK_MOTION_MODEL_020 : 9|2@0+ (1,0) [0|3] "NA"  ADAS
 SG_ OBJ_DIMENSION_WIDTH_020 : 17|10@0+ (0.01,0) [0|10.23] "m"  ADAS
 SG_ OBJ_DIMENSION_LENGTH_020 : 37|12@0+ (0.01,0) [0|40.95] "m"  ADAS
 SG_ OBJ_EXISTENCE_PROB_020 : 229|14@0+ (0.0001,0) [0|1] "NA"  ADAS
 SG_ OBJ_YAW_ANGLE_020 : 155|12@0+ (0.005,-10) [-10|10.475] "rad"  ADAS
 SG_ OBJ_YAW_ANGLE_ERR_020 : 175|7@0+ (0.01,0) [0|1.27] "rad"  ADAS
 SG_ OBJ_ID_020 : 7|8@0+ (1,0) [0|255] "NA"  ADAS
 SG_ OBJ_MOVEMENT_STATUS_020 : 196|3@0+ (1,0) [0|3] "NA"  ADAS
 SG_ OBJ_MEASUREMENT_STATUS_020 : 14|3@0+ (1,0) [0|7] "NA"  ADAS
 SG_ OBJ_POS_LONG_020 : 63|16@0+ (0.01,-327) [-327|327] "m"  ADAS
 SG_ OBJ_POS_LAT_020 : 79|16@0+ (0.01,-327) [-327|327] "m"  ADAS
 SG_ OBJ_VELOCITY_LONG_020 : 110|15@0+ (0.01,-163) [-163|163] "m/s"  ADAS
 SG_ OBJ_VELOCITY_LAT_020 : 126|15@0+ (0.01,-163) [-163|163] "m/s"  ADAS
 SG_ OBJ_ACCELERATION_LONG_020 : 193|10@0+ (0.05,-20) [-20|20] "m/s^2"  ADAS
 SG_ OBJ_ACCELERATION_LAT_020 : 177|10@0+ (0.05,-20) [-20|20] "m/s^2"  ADAS
 SG_ OBJ_VEH_TRACK_FLAG_020 : 10|1@0+ (1,0) [0|1] "NA"  ADAS
 SG_ OBJ_MH_CYCLE_COUNTER_020 : 487|8@0+ (1,0) [0|255] "NA"  ADAS
 SG_ OBJ_MH_CRC16_020 : 495|16@0+ (1,0) [0|65535] "NA"  ADAS
 SG_ OBJ_TIMESTAMP_OFFSET_020 : 247|8@0+ (1,-127) [-127|128] "ms"  ADAS
 SG_ OBJ_DIMENSION_WIDTH_ERR_020 : 23|6@0+ (0.01,0) [0|0.63] "m"  ADAS
 SG_ OBJ_DIMENSION_LENGTH_ERR_020 : 41|10@0+ (0.01,0) [0|10.23] "m"  ADAS
 SG_ OBJ_CLS_TYPE1_020 : 271|4@0+ (1,0) [0|15] "NA"  ADAS
 SG_ OBJ_CLS_TYPE1_PROB_020 : 303|8@0+ (0.004,0) [0|1] "NA"  ADAS
 SG_ OBJ_CLS_TYPE2_020 : 267|4@0+ (1,0) [0|15] "NA"  ADAS
 SG_ OBJ_CLS_TYPE2_PROB_020 : 311|8@0+ (0.004,0) [0|1] "NA"  ADAS
 SG_ OBJ_CLS_TYPE3_020 : 279|4@0+ (1,0) [0|15] "NA"  ADAS
 SG_ OBJ_CLS_TYPE3_PROB_020 : 319|8@0+ (0.004,0) [0|1] "NA"  ADAS
 SG_ OBJ_CLS_TYPE4_020 : 275|4@0+ (1,0) [0|15] "NA"  ADAS
 SG_ OBJ_CLS_TYPE4_PROB_020 : 327|8@0+ (0.004,0) [0|1] "NA"  ADAS
 SG_ OBJ_CLS_TYPE5_020 : 287|4@0+ (1,0) [0|15] "NA"  ADAS
 SG_ OBJ_CLS_TYPE5_PROB_020 : 335|8@0+ (0.004,0) [0|1] "NA"  ADAS
 SG_ OBJ_CLS_TYPE6_020 : 282|4@0+ (1,0) [0|15] "NA"  ADAS
 SG_ OBJ_CLS_TYPE6_PROB_020 : 343|8@0+ (0.004,0) [0|1] "NA"  ADAS
 SG_ OBJ_RCS_020 : 351|7@0+ (1,-64) [-64|63] "dBsm"  ADAS
 SG_ OBJ_REF_PT_LONG_OFFSET_020 : 357|14@0+ (0.0001,0) [0|1] "NA"  ADAS
 SG_ OBJ_REF_PT_LAT_OFFSET_020 : 370|14@0+ (0.0001,0) [0|1] "NA"  ADAS
 SG_ OBJ_YAW_RATE_020 : 399|10@0+ (0.005,-2.24) [-2.24|2.24] "rad/s"  ADAS
 SG_ OBJ_YAW_RATE_ERR_020 : 388|5@0+ (0.025,0) [0|0.775] "rad/s"  ADAS
 SG_ OBJ_GROUP_ID_020 : 405|6@0+ (1,0) [0|63] "NA"  ADAS
 SG_ OBJ_POS_ERR_CRR_COEF_020 : 415|8@0+ (0.01,-1.2) [-1.2|1] "NA"  ADAS
 SG_ OBJ_VELOCITY_ERR_CRR_COEF_020 : 423|8@0+ (0.01,-1.2) [-1.2|1] "NA"  ADAS
 SG_ OBJ_ACCEL_ERR_CRR_COEF_020 : 431|8@0+ (0.01,-1.2) [-1.2|1] "NA"  ADAS

BO_ 1380 RDR_TRACKER_OBJ_021: 64 RDR02
 SG_ OBJ_ALIVE_TIME_021 : 255|16@0+ (1,0) [0|65535] "ms"  ADAS
 SG_ OBJ_ACCELERATION_LONG_ERR_021 : 215|8@0+ (0.025,0) [0|6.375] "m/s^2"  ADAS
 SG_ OBJ_ACCELERATION_LAT_ERR_021 : 223|8@0+ (0.025,0) [0|6.375] "m/s^2"  ADAS
 SG_ OBJ_VELOCITY_LONG_ERR_021 : 143|8@0+ (0.05,0) [0|12.75] "m/s"  ADAS
 SG_ OBJ_VELOCITY_LAT_ERR_021 : 151|8@0+ (0.05,0) [0|12.75] "m/s"  ADAS
 SG_ OBJ_POS_LONG_ERR_021 : 95|8@0+ (0.025,0) [0|6.375] "m"  ADAS
 SG_ OBJ_POS_LAT_ERR_021 : 103|8@0+ (0.025,0) [0|6.375] "m"  ADAS
 SG_ OBJ_TRACK_MOTION_MODEL_021 : 9|2@0+ (1,0) [0|3] "NA"  ADAS
 SG_ OBJ_DIMENSION_WIDTH_021 : 17|10@0+ (0.01,0) [0|10.23] "m"  ADAS
 SG_ OBJ_DIMENSION_LENGTH_021 : 37|12@0+ (0.01,0) [0|40.95] "m"  ADAS
 SG_ OBJ_EXISTENCE_PROB_021 : 229|14@0+ (0.0001,0) [0|1] "NA"  ADAS
 SG_ OBJ_YAW_ANGLE_021 : 155|12@0+ (0.005,-10) [-10|10.475] "rad"  ADAS
 SG_ OBJ_YAW_ANGLE_ERR_021 : 175|7@0+ (0.01,0) [0|1.27] "rad"  ADAS
 SG_ OBJ_ID_021 : 7|8@0+ (1,0) [0|255] "NA"  ADAS
 SG_ OBJ_MOVEMENT_STATUS_021 : 196|3@0+ (1,0) [0|3] "NA"  ADAS
 SG_ OBJ_MEASUREMENT_STATUS_021 : 14|3@0+ (1,0) [0|7] "NA"  ADAS
 SG_ OBJ_POS_LONG_021 : 63|16@0+ (0.01,-327) [-327|327] "m"  ADAS
 SG_ OBJ_POS_LAT_021 : 79|16@0+ (0.01,-327) [-327|327] "m"  ADAS
 SG_ OBJ_VELOCITY_LONG_021 : 110|15@0+ (0.01,-163) [-163|163] "m/s"  ADAS
 SG_ OBJ_VELOCITY_LAT_021 : 126|15@0+ (0.01,-163) [-163|163] "m/s"  ADAS
 SG_ OBJ_ACCELERATION_LONG_021 : 193|10@0+ (0.05,-20) [-20|20] "m/s^2"  ADAS
 SG_ OBJ_ACCELERATION_LAT_021 : 177|10@0+ (0.05,-20) [-20|20] "m/s^2"  ADAS
 SG_ OBJ_VEH_TRACK_FLAG_021 : 10|1@0+ (1,0) [0|1] "NA"  ADAS
 SG_ OBJ_MH_CYCLE_COUNTER_021 : 487|8@0+ (1,0) [0|255] "NA"  ADAS
 SG_ OBJ_MH_CRC16_021 : 495|16@0+ (1,0) [0|65535] "NA"  ADAS
 SG_ OBJ_TIMESTAMP_OFFSET_021 : 247|8@0+ (1,-127) [-127|128] "ms"  ADAS
 SG_ OBJ_DIMENSION_WIDTH_ERR_021 : 23|6@0+ (0.01,0) [0|0.63] "m"  ADAS
 SG_ OBJ_DIMENSION_LENGTH_ERR_021 : 41|10@0+ (0.01,0) [0|10.23] "m"  ADAS
 SG_ OBJ_CLS_TYPE1_021 : 271|4@0+ (1,0) [0|15] "NA"  ADAS
 SG_ OBJ_CLS_TYPE1_PROB_021 : 303|8@0+ (0.004,0) [0|1] "NA"  ADAS
 SG_ OBJ_CLS_TYPE2_021 : 267|4@0+ (1,0) [0|15] "NA"  ADAS
 SG_ OBJ_CLS_TYPE2_PROB_021 : 311|8@0+ (0.004,0) [0|1] "NA"  ADAS
 SG_ OBJ_CLS_TYPE3_021 : 279|4@0+ (1,0) [0|15] "NA"  ADAS
 SG_ OBJ_CLS_TYPE3_PROB_021 : 319|8@0+ (0.004,0) [0|1] "NA"  ADAS
 SG_ OBJ_CLS_TYPE4_021 : 275|4@0+ (1,0) [0|15] "NA"  ADAS
 SG_ OBJ_CLS_TYPE4_PROB_021 : 327|8@0+ (0.004,0) [0|1] "NA"  ADAS
 SG_ OBJ_CLS_TYPE5_021 : 287|4@0+ (1,0) [0|15] "NA"  ADAS
 SG_ OBJ_CLS_TYPE5_PROB_021 : 335|8@0+ (0.004,0) [0|1] "NA"  ADAS
 SG_ OBJ_CLS_TYPE6_021 : 282|4@0+ (1,0) [0|15] "NA"  ADAS
 SG_ OBJ_CLS_TYPE6_PROB_021 : 343|8@0+ (0.004,0) [0|1] "NA"  ADAS
 SG_ OBJ_RCS_021 : 351|7@0+ (1,-64) [-64|63] "dBsm"  ADAS
 SG_ OBJ_REF_PT_LONG_OFFSET_021 : 357|14@0+ (0.0001,0) [0|1] "NA"  ADAS
 SG_ OBJ_REF_PT_LAT_OFFSET_021 : 370|14@0+ (0.0001,0) [0|1] "NA"  ADAS
 SG_ OBJ_YAW_RATE_021 : 399|10@0+ (0.005,-2.24) [-2.24|2.24] "rad/s"  ADAS
 SG_ OBJ_YAW_RATE_ERR_021 : 388|5@0+ (0.025,0) [0|0.775] "rad/s"  ADAS
 SG_ OBJ_GROUP_ID_021 : 405|6@0+ (1,0) [0|63] "NA"  ADAS
 SG_ OBJ_POS_ERR_CRR_COEF_021 : 415|8@0+ (0.01,-1.2) [-1.2|1] "NA"  ADAS
 SG_ OBJ_VELOCITY_ERR_CRR_COEF_021 : 423|8@0+ (0.01,-1.2) [-1.2|1] "NA"  ADAS
 SG_ OBJ_ACCEL_ERR_CRR_COEF_021 : 431|8@0+ (0.01,-1.2) [-1.2|1] "NA"  ADAS

BO_ 1381 RDR_TRACKER_OBJ_022: 64 RDR02
 SG_ OBJ_ALIVE_TIME_022 : 255|16@0+ (1,0) [0|65535] "ms"  ADAS
 SG_ OBJ_ACCELERATION_LONG_ERR_022 : 215|8@0+ (0.025,0) [0|6.375] "m/s^2"  ADAS
 SG_ OBJ_ACCELERATION_LAT_ERR_022 : 223|8@0+ (0.025,0) [0|6.375] "m/s^2"  ADAS
 SG_ OBJ_VELOCITY_LONG_ERR_022 : 143|8@0+ (0.05,0) [0|12.75] "m/s"  ADAS
 SG_ OBJ_VELOCITY_LAT_ERR_022 : 151|8@0+ (0.05,0) [0|12.75] "m/s"  ADAS
 SG_ OBJ_POS_LONG_ERR_022 : 95|8@0+ (0.025,0) [0|6.375] "m"  ADAS
 SG_ OBJ_POS_LAT_ERR_022 : 103|8@0+ (0.025,0) [0|6.375] "m"  ADAS
 SG_ OBJ_TRACK_MOTION_MODEL_022 : 9|2@0+ (1,0) [0|3] "NA"  ADAS
 SG_ OBJ_DIMENSION_WIDTH_022 : 17|10@0+ (0.01,0) [0|10.23] "m"  ADAS
 SG_ OBJ_DIMENSION_LENGTH_022 : 37|12@0+ (0.01,0) [0|40.95] "m"  ADAS
 SG_ OBJ_EXISTENCE_PROB_022 : 229|14@0+ (0.0001,0) [0|1] "NA"  ADAS
 SG_ OBJ_YAW_ANGLE_022 : 155|12@0+ (0.005,-10) [-10|10.475] "rad"  ADAS
 SG_ OBJ_YAW_ANGLE_ERR_022 : 175|7@0+ (0.01,0) [0|1.27] "rad"  ADAS
 SG_ OBJ_ID_022 : 7|8@0+ (1,0) [0|255] "NA"  ADAS
 SG_ OBJ_MOVEMENT_STATUS_022 : 196|3@0+ (1,0) [0|3] "NA"  ADAS
 SG_ OBJ_MEASUREMENT_STATUS_022 : 14|3@0+ (1,0) [0|7] "NA"  ADAS
 SG_ OBJ_POS_LONG_022 : 63|16@0+ (0.01,-327) [-327|327] "m"  ADAS
 SG_ OBJ_POS_LAT_022 : 79|16@0+ (0.01,-327) [-327|327] "m"  ADAS
 SG_ OBJ_VELOCITY_LONG_022 : 110|15@0+ (0.01,-163) [-163|163] "m/s"  ADAS
 SG_ OBJ_VELOCITY_LAT_022 : 126|15@0+ (0.01,-163) [-163|163] "m/s"  ADAS
 SG_ OBJ_ACCELERATION_LONG_022 : 193|10@0+ (0.05,-20) [-20|20] "m/s^2"  ADAS
 SG_ OBJ_ACCELERATION_LAT_022 : 177|10@0+ (0.05,-20) [-20|20] "m/s^2"  ADAS
 SG_ OBJ_VEH_TRACK_FLAG_022 : 10|1@0+ (1,0) [0|1] "NA"  ADAS
 SG_ OBJ_MH_CYCLE_COUNTER_022 : 487|8@0+ (1,0) [0|255] "NA"  ADAS
 SG_ OBJ_MH_CRC16_022 : 495|16@0+ (1,0) [0|65535] "NA"  ADAS
 SG_ OBJ_TIMESTAMP_OFFSET_022 : 247|8@0+ (1,-127) [-127|128] "ms"  ADAS
 SG_ OBJ_DIMENSION_WIDTH_ERR_022 : 23|6@0+ (0.01,0) [0|0.63] "m"  ADAS
 SG_ OBJ_DIMENSION_LENGTH_ERR_022 : 41|10@0+ (0.01,0) [0|10.23] "m"  ADAS
 SG_ OBJ_CLS_TYPE1_022 : 271|4@0+ (1,0) [0|15] "NA"  ADAS
 SG_ OBJ_CLS_TYPE1_PROB_022 : 303|8@0+ (0.004,0) [0|1] "NA"  ADAS
 SG_ OBJ_CLS_TYPE2_022 : 267|4@0+ (1,0) [0|15] "NA"  ADAS
 SG_ OBJ_CLS_TYPE2_PROB_022 : 311|8@0+ (0.004,0) [0|1] "NA"  ADAS
 SG_ OBJ_CLS_TYPE3_022 : 279|4@0+ (1,0) [0|15] "NA"  ADAS
 SG_ OBJ_CLS_TYPE3_PROB_022 : 319|8@0+ (0.004,0) [0|1] "NA"  ADAS
 SG_ OBJ_CLS_TYPE4_022 : 275|4@0+ (1,0) [0|15] "NA"  ADAS
 SG_ OBJ_CLS_TYPE4_PROB_022 : 327|8@0+ (0.004,0) [0|1] "NA"  ADAS
 SG_ OBJ_CLS_TYPE5_022 : 287|4@0+ (1,0) [0|15] "NA"  ADAS
 SG_ OBJ_CLS_TYPE5_PROB_022 : 335|8@0+ (0.004,0) [0|1] "NA"  ADAS
 SG_ OBJ_CLS_TYPE6_022 : 282|4@0+ (1,0) [0|15] "NA"  ADAS
 SG_ OBJ_CLS_TYPE6_PROB_022 : 343|8@0+ (0.004,0) [0|1] "NA"  ADAS
 SG_ OBJ_RCS_022 : 351|7@0+ (1,-64) [-64|63] "dBsm"  ADAS
 SG_ OBJ_REF_PT_LONG_OFFSET_022 : 357|14@0+ (0.0001,0) [0|1] "NA"  ADAS
 SG_ OBJ_REF_PT_LAT_OFFSET_022 : 370|14@0+ (0.0001,0) [0|1] "NA"  ADAS
 SG_ OBJ_YAW_RATE_022 : 399|10@0+ (0.005,-2.24) [-2.24|2.24] "rad/s"  ADAS
 SG_ OBJ_YAW_RATE_ERR_022 : 388|5@0+ (0.025,0) [0|0.775] "rad/s"  ADAS
 SG_ OBJ_GROUP_ID_022 : 405|6@0+ (1,0) [0|63] "NA"  ADAS
 SG_ OBJ_POS_ERR_CRR_COEF_022 : 415|8@0+ (0.01,-1.2) [-1.2|1] "NA"  ADAS
 SG_ OBJ_VELOCITY_ERR_CRR_COEF_022 : 423|8@0+ (0.01,-1.2) [-1.2|1] "NA"  ADAS
 SG_ OBJ_ACCEL_ERR_CRR_COEF_022 : 431|8@0+ (0.01,-1.2) [-1.2|1] "NA"  ADAS

BO_ 1382 RDR_TRACKER_OBJ_023: 64 RDR02
 SG_ OBJ_ALIVE_TIME_023 : 255|16@0+ (1,0) [0|65535] "ms"  ADAS
 SG_ OBJ_ACCELERATION_LONG_ERR_023 : 215|8@0+ (0.025,0) [0|6.375] "m/s^2"  ADAS
 SG_ OBJ_ACCELERATION_LAT_ERR_023 : 223|8@0+ (0.025,0) [0|6.375] "m/s^2"  ADAS
 SG_ OBJ_VELOCITY_LONG_ERR_023 : 143|8@0+ (0.05,0) [0|12.75] "m/s"  ADAS
 SG_ OBJ_VELOCITY_LAT_ERR_023 : 151|8@0+ (0.05,0) [0|12.75] "m/s"  ADAS
 SG_ OBJ_POS_LONG_ERR_023 : 95|8@0+ (0.025,0) [0|6.375] "m"  ADAS
 SG_ OBJ_POS_LAT_ERR_023 : 103|8@0+ (0.025,0) [0|6.375] "m"  ADAS
 SG_ OBJ_TRACK_MOTION_MODEL_023 : 9|2@0+ (1,0) [0|3] "NA"  ADAS
 SG_ OBJ_DIMENSION_WIDTH_023 : 17|10@0+ (0.01,0) [0|10.23] "m"  ADAS
 SG_ OBJ_DIMENSION_LENGTH_023 : 37|12@0+ (0.01,0) [0|40.95] "m"  ADAS
 SG_ OBJ_EXISTENCE_PROB_023 : 229|14@0+ (0.0001,0) [0|1] "NA"  ADAS
 SG_ OBJ_YAW_ANGLE_023 : 155|12@0+ (0.005,-10) [-10|10.475] "rad"  ADAS
 SG_ OBJ_YAW_ANGLE_ERR_023 : 175|7@0+ (0.01,0) [0|1.27] "rad"  ADAS
 SG_ OBJ_ID_023 : 7|8@0+ (1,0) [0|255] "NA"  ADAS
 SG_ OBJ_MOVEMENT_STATUS_023 : 196|3@0+ (1,0) [0|3] "NA"  ADAS
 SG_ OBJ_MEASUREMENT_STATUS_023 : 14|3@0+ (1,0) [0|7] "NA"  ADAS
 SG_ OBJ_POS_LONG_023 : 63|16@0+ (0.01,-327) [-327|327] "m"  ADAS
 SG_ OBJ_POS_LAT_023 : 79|16@0+ (0.01,-327) [-327|327] "m"  ADAS
 SG_ OBJ_VELOCITY_LONG_023 : 110|15@0+ (0.01,-163) [-163|163] "m/s"  ADAS
 SG_ OBJ_VELOCITY_LAT_023 : 126|15@0+ (0.01,-163) [-163|163] "m/s"  ADAS
 SG_ OBJ_ACCELERATION_LONG_023 : 193|10@0+ (0.05,-20) [-20|20] "m/s^2"  ADAS
 SG_ OBJ_ACCELERATION_LAT_023 : 177|10@0+ (0.05,-20) [-20|20] "m/s^2"  ADAS
 SG_ OBJ_VEH_TRACK_FLAG_023 : 10|1@0+ (1,0) [0|1] "NA"  ADAS
 SG_ OBJ_MH_CYCLE_COUNTER_023 : 487|8@0+ (1,0) [0|255] "NA"  ADAS
 SG_ OBJ_MH_CRC16_023 : 495|16@0+ (1,0) [0|65535] "NA"  ADAS
 SG_ OBJ_TIMESTAMP_OFFSET_023 : 247|8@0+ (1,-127) [-127|128] "ms"  ADAS
 SG_ OBJ_DIMENSION_WIDTH_ERR_023 : 23|6@0+ (0.01,0) [0|0.63] "m"  ADAS
 SG_ OBJ_DIMENSION_LENGTH_ERR_023 : 41|10@0+ (0.01,0) [0|10.23] "m"  ADAS
 SG_ OBJ_CLS_TYPE1_023 : 271|4@0+ (1,0) [0|15] "NA"  ADAS
 SG_ OBJ_CLS_TYPE1_PROB_023 : 303|8@0+ (0.004,0) [0|1] "NA"  ADAS
 SG_ OBJ_CLS_TYPE2_023 : 267|4@0+ (1,0) [0|15] "NA"  ADAS
 SG_ OBJ_CLS_TYPE2_PROB_023 : 311|8@0+ (0.004,0) [0|1] "NA"  ADAS
 SG_ OBJ_CLS_TYPE3_023 : 279|4@0+ (1,0) [0|15] "NA"  ADAS
 SG_ OBJ_CLS_TYPE3_PROB_023 : 319|8@0+ (0.004,0) [0|1] "NA"  ADAS
 SG_ OBJ_CLS_TYPE4_023 : 275|4@0+ (1,0) [0|15] "NA"  ADAS
 SG_ OBJ_CLS_TYPE4_PROB_023 : 327|8@0+ (0.004,0) [0|1] "NA"  ADAS
 SG_ OBJ_CLS_TYPE5_023 : 287|4@0+ (1,0) [0|15] "NA"  ADAS
 SG_ OBJ_CLS_TYPE5_PROB_023 : 335|8@0+ (0.004,0) [0|1] "NA"  ADAS
 SG_ OBJ_CLS_TYPE6_023 : 282|4@0+ (1,0) [0|15] "NA"  ADAS
 SG_ OBJ_CLS_TYPE6_PROB_023 : 343|8@0+ (0.004,0) [0|1] "NA"  ADAS
 SG_ OBJ_RCS_023 : 351|7@0+ (1,-64) [-64|63] "dBsm"  ADAS
 SG_ OBJ_REF_PT_LONG_OFFSET_023 : 357|14@0+ (0.0001,0) [0|1] "NA"  ADAS
 SG_ OBJ_REF_PT_LAT_OFFSET_023 : 370|14@0+ (0.0001,0) [0|1] "NA"  ADAS
 SG_ OBJ_YAW_RATE_023 : 399|10@0+ (0.005,-2.24) [-2.24|2.24] "rad/s"  ADAS
 SG_ OBJ_YAW_RATE_ERR_023 : 388|5@0+ (0.025,0) [0|0.775] "rad/s"  ADAS
 SG_ OBJ_GROUP_ID_023 : 405|6@0+ (1,0) [0|63] "NA"  ADAS
 SG_ OBJ_POS_ERR_CRR_COEF_023 : 415|8@0+ (0.01,-1.2) [-1.2|1] "NA"  ADAS
 SG_ OBJ_VELOCITY_ERR_CRR_COEF_023 : 423|8@0+ (0.01,-1.2) [-1.2|1] "NA"  ADAS
 SG_ OBJ_ACCEL_ERR_CRR_COEF_023 : 431|8@0+ (0.01,-1.2) [-1.2|1] "NA"  ADAS

BO_ 1383 RDR_TRACKER_OBJ_024: 64 RDR02
 SG_ OBJ_ALIVE_TIME_024 : 255|16@0+ (1,0) [0|65535] "ms"  ADAS
 SG_ OBJ_ACCELERATION_LONG_ERR_024 : 215|8@0+ (0.025,0) [0|6.375] "m/s^2"  ADAS
 SG_ OBJ_ACCELERATION_LAT_ERR_024 : 223|8@0+ (0.025,0) [0|6.375] "m/s^2"  ADAS
 SG_ OBJ_VELOCITY_LONG_ERR_024 : 143|8@0+ (0.05,0) [0|12.75] "m/s"  ADAS
 SG_ OBJ_VELOCITY_LAT_ERR_024 : 151|8@0+ (0.05,0) [0|12.75] "m/s"  ADAS
 SG_ OBJ_POS_LONG_ERR_024 : 95|8@0+ (0.025,0) [0|6.375] "m"  ADAS
 SG_ OBJ_POS_LAT_ERR_024 : 103|8@0+ (0.025,0) [0|6.375] "m"  ADAS
 SG_ OBJ_TRACK_MOTION_MODEL_024 : 9|2@0+ (1,0) [0|3] "NA"  ADAS
 SG_ OBJ_DIMENSION_WIDTH_024 : 17|10@0+ (0.01,0) [0|10.23] "m"  ADAS
 SG_ OBJ_DIMENSION_LENGTH_024 : 37|12@0+ (0.01,0) [0|40.95] "m"  ADAS
 SG_ OBJ_EXISTENCE_PROB_024 : 229|14@0+ (0.0001,0) [0|1] "NA"  ADAS
 SG_ OBJ_YAW_ANGLE_024 : 155|12@0+ (0.005,-10) [-10|10.475] "rad"  ADAS
 SG_ OBJ_YAW_ANGLE_ERR_024 : 175|7@0+ (0.01,0) [0|1.27] "rad"  ADAS
 SG_ OBJ_ID_024 : 7|8@0+ (1,0) [0|255] "NA"  ADAS
 SG_ OBJ_MOVEMENT_STATUS_024 : 196|3@0+ (1,0) [0|3] "NA"  ADAS
 SG_ OBJ_MEASUREMENT_STATUS_024 : 14|3@0+ (1,0) [0|7] "NA"  ADAS
 SG_ OBJ_POS_LONG_024 : 63|16@0+ (0.01,-327) [-327|327] "m"  ADAS
 SG_ OBJ_POS_LAT_024 : 79|16@0+ (0.01,-327) [-327|327] "m"  ADAS
 SG_ OBJ_VELOCITY_LONG_024 : 110|15@0+ (0.01,-163) [-163|163] "m/s"  ADAS
 SG_ OBJ_VELOCITY_LAT_024 : 126|15@0+ (0.01,-163) [-163|163] "m/s"  ADAS
 SG_ OBJ_ACCELERATION_LONG_024 : 193|10@0+ (0.05,-20) [-20|20] "m/s^2"  ADAS
 SG_ OBJ_ACCELERATION_LAT_024 : 177|10@0+ (0.05,-20) [-20|20] "m/s^2"  ADAS
 SG_ OBJ_VEH_TRACK_FLAG_024 : 10|1@0+ (1,0) [0|1] "NA"  ADAS
 SG_ OBJ_MH_CYCLE_COUNTER_024 : 487|8@0+ (1,0) [0|255] "NA"  ADAS
 SG_ OBJ_MH_CRC16_024 : 495|16@0+ (1,0) [0|65535] "NA"  ADAS
 SG_ OBJ_TIMESTAMP_OFFSET_024 : 247|8@0+ (1,-127) [-127|128] "ms"  ADAS
 SG_ OBJ_DIMENSION_WIDTH_ERR_024 : 23|6@0+ (0.01,0) [0|0.63] "m"  ADAS
 SG_ OBJ_DIMENSION_LENGTH_ERR_024 : 41|10@0+ (0.01,0) [0|10.23] "m"  ADAS
 SG_ OBJ_CLS_TYPE1_024 : 271|4@0+ (1,0) [0|15] "NA"  ADAS
 SG_ OBJ_CLS_TYPE1_PROB_024 : 303|8@0+ (0.004,0) [0|1] "NA"  ADAS
 SG_ OBJ_CLS_TYPE2_024 : 267|4@0+ (1,0) [0|15] "NA"  ADAS
 SG_ OBJ_CLS_TYPE2_PROB_024 : 311|8@0+ (0.004,0) [0|1] "NA"  ADAS
 SG_ OBJ_CLS_TYPE3_024 : 279|4@0+ (1,0) [0|15] "NA"  ADAS
 SG_ OBJ_CLS_TYPE3_PROB_024 : 319|8@0+ (0.004,0) [0|1] "NA"  ADAS
 SG_ OBJ_CLS_TYPE4_024 : 275|4@0+ (1,0) [0|15] "NA"  ADAS
 SG_ OBJ_CLS_TYPE4_PROB_024 : 327|8@0+ (0.004,0) [0|1] "NA"  ADAS
 SG_ OBJ_CLS_TYPE5_024 : 287|4@0+ (1,0) [0|15] "NA"  ADAS
 SG_ OBJ_CLS_TYPE5_PROB_024 : 335|8@0+ (0.004,0) [0|1] "NA"  ADAS
 SG_ OBJ_CLS_TYPE6_024 : 282|4@0+ (1,0) [0|15] "NA"  ADAS
 SG_ OBJ_CLS_TYPE6_PROB_024 : 343|8@0+ (0.004,0) [0|1] "NA"  ADAS
 SG_ OBJ_RCS_024 : 351|7@0+ (1,-64) [-64|63] "dBsm"  ADAS
 SG_ OBJ_REF_PT_LONG_OFFSET_024 : 357|14@0+ (0.0001,0) [0|1] "NA"  ADAS
 SG_ OBJ_REF_PT_LAT_OFFSET_024 : 370|14@0+ (0.0001,0) [0|1] "NA"  ADAS
 SG_ OBJ_YAW_RATE_024 : 399|10@0+ (0.005,-2.24) [-2.24|2.24] "rad/s"  ADAS
 SG_ OBJ_YAW_RATE_ERR_024 : 388|5@0+ (0.025,0) [0|0.775] "rad/s"  ADAS
 SG_ OBJ_GROUP_ID_024 : 405|6@0+ (1,0) [0|63] "NA"  ADAS
 SG_ OBJ_POS_ERR_CRR_COEF_024 : 415|8@0+ (0.01,-1.2) [-1.2|1] "NA"  ADAS
 SG_ OBJ_VELOCITY_ERR_CRR_COEF_024 : 423|8@0+ (0.01,-1.2) [-1.2|1] "NA"  ADAS
 SG_ OBJ_ACCEL_ERR_CRR_COEF_024 : 431|8@0+ (0.01,-1.2) [-1.2|1] "NA"  ADAS

BO_ 1384 RDR_TRACKER_OBJ_025: 64 RDR02
 SG_ OBJ_ALIVE_TIME_025 : 255|16@0+ (1,0) [0|65535] "ms"  ADAS
 SG_ OBJ_ACCELERATION_LONG_ERR_025 : 215|8@0+ (0.025,0) [0|6.375] "m/s^2"  ADAS
 SG_ OBJ_ACCELERATION_LAT_ERR_025 : 223|8@0+ (0.025,0) [0|6.375] "m/s^2"  ADAS
 SG_ OBJ_VELOCITY_LONG_ERR_025 : 143|8@0+ (0.05,0) [0|12.75] "m/s"  ADAS
 SG_ OBJ_VELOCITY_LAT_ERR_025 : 151|8@0+ (0.05,0) [0|12.75] "m/s"  ADAS
 SG_ OBJ_POS_LONG_ERR_025 : 95|8@0+ (0.025,0) [0|6.375] "m"  ADAS
 SG_ OBJ_POS_LAT_ERR_025 : 103|8@0+ (0.025,0) [0|6.375] "m"  ADAS
 SG_ OBJ_TRACK_MOTION_MODEL_025 : 9|2@0+ (1,0) [0|3] "NA"  ADAS
 SG_ OBJ_DIMENSION_WIDTH_025 : 17|10@0+ (0.01,0) [0|10.23] "m"  ADAS
 SG_ OBJ_DIMENSION_LENGTH_025 : 37|12@0+ (0.01,0) [0|40.95] "m"  ADAS
 SG_ OBJ_EXISTENCE_PROB_025 : 229|14@0+ (0.0001,0) [0|1] "NA"  ADAS
 SG_ OBJ_YAW_ANGLE_025 : 155|12@0+ (0.005,-10) [-10|10.475] "rad"  ADAS
 SG_ OBJ_YAW_ANGLE_ERR_025 : 175|7@0+ (0.01,0) [0|1.27] "rad"  ADAS
 SG_ OBJ_ID_025 : 7|8@0+ (1,0) [0|255] "NA"  ADAS
 SG_ OBJ_MOVEMENT_STATUS_025 : 196|3@0+ (1,0) [0|3] "NA"  ADAS
 SG_ OBJ_MEASUREMENT_STATUS_025 : 14|3@0+ (1,0) [0|7] "NA"  ADAS
 SG_ OBJ_POS_LONG_025 : 63|16@0+ (0.01,-327) [-327|327] "m"  ADAS
 SG_ OBJ_POS_LAT_025 : 79|16@0+ (0.01,-327) [-327|327] "m"  ADAS
 SG_ OBJ_VELOCITY_LONG_025 : 110|15@0+ (0.01,-163) [-163|163] "m/s"  ADAS
 SG_ OBJ_VELOCITY_LAT_025 : 126|15@0+ (0.01,-163) [-163|163] "m/s"  ADAS
 SG_ OBJ_ACCELERATION_LONG_025 : 193|10@0+ (0.05,-20) [-20|20] "m/s^2"  ADAS
 SG_ OBJ_ACCELERATION_LAT_025 : 177|10@0+ (0.05,-20) [-20|20] "m/s^2"  ADAS
 SG_ OBJ_VEH_TRACK_FLAG_025 : 10|1@0+ (1,0) [0|1] "NA"  ADAS
 SG_ OBJ_MH_CYCLE_COUNTER_025 : 487|8@0+ (1,0) [0|255] "NA"  ADAS
 SG_ OBJ_MH_CRC16_025 : 495|16@0+ (1,0) [0|65535] "NA"  ADAS
 SG_ OBJ_TIMESTAMP_OFFSET_025 : 247|8@0+ (1,-127) [-127|128] "ms"  ADAS
 SG_ OBJ_DIMENSION_WIDTH_ERR_025 : 23|6@0+ (0.01,0) [0|0.63] "m"  ADAS
 SG_ OBJ_DIMENSION_LENGTH_ERR_025 : 41|10@0+ (0.01,0) [0|10.23] "m"  ADAS
 SG_ OBJ_CLS_TYPE1_025 : 271|4@0+ (1,0) [0|15] "NA"  ADAS
 SG_ OBJ_CLS_TYPE1_PROB_025 : 303|8@0+ (0.004,0) [0|1] "NA"  ADAS
 SG_ OBJ_CLS_TYPE2_025 : 267|4@0+ (1,0) [0|15] "NA"  ADAS
 SG_ OBJ_CLS_TYPE2_PROB_025 : 311|8@0+ (0.004,0) [0|1] "NA"  ADAS
 SG_ OBJ_CLS_TYPE3_025 : 279|4@0+ (1,0) [0|15] "NA"  ADAS
 SG_ OBJ_CLS_TYPE3_PROB_025 : 319|8@0+ (0.004,0) [0|1] "NA"  ADAS
 SG_ OBJ_CLS_TYPE4_025 : 275|4@0+ (1,0) [0|15] "NA"  ADAS
 SG_ OBJ_CLS_TYPE4_PROB_025 : 327|8@0+ (0.004,0) [0|1] "NA"  ADAS
 SG_ OBJ_CLS_TYPE5_025 : 287|4@0+ (1,0) [0|15] "NA"  ADAS
 SG_ OBJ_CLS_TYPE5_PROB_025 : 335|8@0+ (0.004,0) [0|1] "NA"  ADAS
 SG_ OBJ_CLS_TYPE6_025 : 282|4@0+ (1,0) [0|15] "NA"  ADAS
 SG_ OBJ_CLS_TYPE6_PROB_025 : 343|8@0+ (0.004,0) [0|1] "NA"  ADAS
 SG_ OBJ_RCS_025 : 351|7@0+ (1,-64) [-64|63] "dBsm"  ADAS
 SG_ OBJ_REF_PT_LONG_OFFSET_025 : 357|14@0+ (0.0001,0) [0|1] "NA"  ADAS
 SG_ OBJ_REF_PT_LAT_OFFSET_025 : 370|14@0+ (0.0001,0) [0|1] "NA"  ADAS
 SG_ OBJ_YAW_RATE_025 : 399|10@0+ (0.005,-2.24) [-2.24|2.24] "rad/s"  ADAS
 SG_ OBJ_YAW_RATE_ERR_025 : 388|5@0+ (0.025,0) [0|0.775] "rad/s"  ADAS
 SG_ OBJ_GROUP_ID_025 : 405|6@0+ (1,0) [0|63] "NA"  ADAS
 SG_ OBJ_POS_ERR_CRR_COEF_025 : 415|8@0+ (0.01,-1.2) [-1.2|1] "NA"  ADAS
 SG_ OBJ_VELOCITY_ERR_CRR_COEF_025 : 423|8@0+ (0.01,-1.2) [-1.2|1] "NA"  ADAS
 SG_ OBJ_ACCEL_ERR_CRR_COEF_025 : 431|8@0+ (0.01,-1.2) [-1.2|1] "NA"  ADAS

BO_ 1385 RDR_TRACKER_OBJ_026: 64 RDR02
 SG_ OBJ_ALIVE_TIME_026 : 255|16@0+ (1,0) [0|65535] "ms"  ADAS
 SG_ OBJ_ACCELERATION_LONG_ERR_026 : 215|8@0+ (0.025,0) [0|6.375] "m/s^2"  ADAS
 SG_ OBJ_ACCELERATION_LAT_ERR_026 : 223|8@0+ (0.025,0) [0|6.375] "m/s^2"  ADAS
 SG_ OBJ_VELOCITY_LONG_ERR_026 : 143|8@0+ (0.05,0) [0|12.75] "m/s"  ADAS
 SG_ OBJ_VELOCITY_LAT_ERR_026 : 151|8@0+ (0.05,0) [0|12.75] "m/s"  ADAS
 SG_ OBJ_POS_LONG_ERR_026 : 95|8@0+ (0.025,0) [0|6.375] "m"  ADAS
 SG_ OBJ_POS_LAT_ERR_026 : 103|8@0+ (0.025,0) [0|6.375] "m"  ADAS
 SG_ OBJ_TRACK_MOTION_MODEL_026 : 9|2@0+ (1,0) [0|3] "NA"  ADAS
 SG_ OBJ_DIMENSION_WIDTH_026 : 17|10@0+ (0.01,0) [0|10.23] "m"  ADAS
 SG_ OBJ_DIMENSION_LENGTH_026 : 37|12@0+ (0.01,0) [0|40.95] "m"  ADAS
 SG_ OBJ_EXISTENCE_PROB_026 : 229|14@0+ (0.0001,0) [0|1] "NA"  ADAS
 SG_ OBJ_YAW_ANGLE_026 : 155|12@0+ (0.005,-10) [-10|10.475] "rad"  ADAS
 SG_ OBJ_YAW_ANGLE_ERR_026 : 175|7@0+ (0.01,0) [0|1.27] "rad"  ADAS
 SG_ OBJ_ID_026 : 7|8@0+ (1,0) [0|255] "NA"  ADAS
 SG_ OBJ_MOVEMENT_STATUS_026 : 196|3@0+ (1,0) [0|3] "NA"  ADAS
 SG_ OBJ_MEASUREMENT_STATUS_026 : 14|3@0+ (1,0) [0|7] "NA"  ADAS
 SG_ OBJ_POS_LONG_026 : 63|16@0+ (0.01,-327) [-327|327] "m"  ADAS
 SG_ OBJ_POS_LAT_026 : 79|16@0+ (0.01,-327) [-327|327] "m"  ADAS
 SG_ OBJ_VELOCITY_LONG_026 : 110|15@0+ (0.01,-163) [-163|163] "m/s"  ADAS
 SG_ OBJ_VELOCITY_LAT_026 : 126|15@0+ (0.01,-163) [-163|163] "m/s"  ADAS
 SG_ OBJ_ACCELERATION_LONG_026 : 193|10@0+ (0.05,-20) [-20|20] "m/s^2"  ADAS
 SG_ OBJ_ACCELERATION_LAT_026 : 177|10@0+ (0.05,-20) [-20|20] "m/s^2"  ADAS
 SG_ OBJ_VEH_TRACK_FLAG_026 : 10|1@0+ (1,0) [0|1] "NA"  ADAS
 SG_ OBJ_MH_CYCLE_COUNTER_026 : 487|8@0+ (1,0) [0|255] "NA"  ADAS
 SG_ OBJ_MH_CRC16_026 : 495|16@0+ (1,0) [0|65535] "NA"  ADAS
 SG_ OBJ_TIMESTAMP_OFFSET_026 : 247|8@0+ (1,-127) [-127|128] "ms"  ADAS
 SG_ OBJ_DIMENSION_WIDTH_ERR_026 : 23|6@0+ (0.01,0) [0|0.63] "m"  ADAS
 SG_ OBJ_DIMENSION_LENGTH_ERR_026 : 41|10@0+ (0.01,0) [0|10.23] "m"  ADAS
 SG_ OBJ_CLS_TYPE1_026 : 271|4@0+ (1,0) [0|15] "NA"  ADAS
 SG_ OBJ_CLS_TYPE1_PROB_026 : 303|8@0+ (0.004,0) [0|1] "NA"  ADAS
 SG_ OBJ_CLS_TYPE2_026 : 267|4@0+ (1,0) [0|15] "NA"  ADAS
 SG_ OBJ_CLS_TYPE2_PROB_026 : 311|8@0+ (0.004,0) [0|1] "NA"  ADAS
 SG_ OBJ_CLS_TYPE3_026 : 279|4@0+ (1,0) [0|15] "NA"  ADAS
 SG_ OBJ_CLS_TYPE3_PROB_026 : 319|8@0+ (0.004,0) [0|1] "NA"  ADAS
 SG_ OBJ_CLS_TYPE4_026 : 275|4@0+ (1,0) [0|15] "NA"  ADAS
 SG_ OBJ_CLS_TYPE4_PROB_026 : 327|8@0+ (0.004,0) [0|1] "NA"  ADAS
 SG_ OBJ_CLS_TYPE5_026 : 287|4@0+ (1,0) [0|15] "NA"  ADAS
 SG_ OBJ_CLS_TYPE5_PROB_026 : 335|8@0+ (0.004,0) [0|1] "NA"  ADAS
 SG_ OBJ_CLS_TYPE6_026 : 282|4@0+ (1,0) [0|15] "NA"  ADAS
 SG_ OBJ_CLS_TYPE6_PROB_026 : 343|8@0+ (0.004,0) [0|1] "NA"  ADAS
 SG_ OBJ_RCS_026 : 351|7@0+ (1,-64) [-64|63] "dBsm"  ADAS
 SG_ OBJ_REF_PT_LONG_OFFSET_026 : 357|14@0+ (0.0001,0) [0|1] "NA"  ADAS
 SG_ OBJ_REF_PT_LAT_OFFSET_026 : 370|14@0+ (0.0001,0) [0|1] "NA"  ADAS
 SG_ OBJ_YAW_RATE_026 : 399|10@0+ (0.005,-2.24) [-2.24|2.24] "rad/s"  ADAS
 SG_ OBJ_YAW_RATE_ERR_026 : 388|5@0+ (0.025,0) [0|0.775] "rad/s"  ADAS
 SG_ OBJ_GROUP_ID_026 : 405|6@0+ (1,0) [0|63] "NA"  ADAS
 SG_ OBJ_POS_ERR_CRR_COEF_026 : 415|8@0+ (0.01,-1.2) [-1.2|1] "NA"  ADAS
 SG_ OBJ_VELOCITY_ERR_CRR_COEF_026 : 423|8@0+ (0.01,-1.2) [-1.2|1] "NA"  ADAS
 SG_ OBJ_ACCEL_ERR_CRR_COEF_026 : 431|8@0+ (0.01,-1.2) [-1.2|1] "NA"  ADAS

BO_ 1386 RDR_TRACKER_OBJ_027: 64 RDR02
 SG_ OBJ_ALIVE_TIME_027 : 255|16@0+ (1,0) [0|65535] "ms"  ADAS
 SG_ OBJ_ACCELERATION_LONG_ERR_027 : 215|8@0+ (0.025,0) [0|6.375] "m/s^2"  ADAS
 SG_ OBJ_ACCELERATION_LAT_ERR_027 : 223|8@0+ (0.025,0) [0|6.375] "m/s^2"  ADAS
 SG_ OBJ_VELOCITY_LONG_ERR_027 : 143|8@0+ (0.05,0) [0|12.75] "m/s"  ADAS
 SG_ OBJ_VELOCITY_LAT_ERR_027 : 151|8@0+ (0.05,0) [0|12.75] "m/s"  ADAS
 SG_ OBJ_POS_LONG_ERR_027 : 95|8@0+ (0.025,0) [0|6.375] "m"  ADAS
 SG_ OBJ_POS_LAT_ERR_027 : 103|8@0+ (0.025,0) [0|6.375] "m"  ADAS
 SG_ OBJ_TRACK_MOTION_MODEL_027 : 9|2@0+ (1,0) [0|3] "NA"  ADAS
 SG_ OBJ_DIMENSION_WIDTH_027 : 17|10@0+ (0.01,0) [0|10.23] "m"  ADAS
 SG_ OBJ_DIMENSION_LENGTH_027 : 37|12@0+ (0.01,0) [0|40.95] "m"  ADAS
 SG_ OBJ_EXISTENCE_PROB_027 : 229|14@0+ (0.0001,0) [0|1] "NA"  ADAS
 SG_ OBJ_YAW_ANGLE_027 : 155|12@0+ (0.005,-10) [-10|10.475] "rad"  ADAS
 SG_ OBJ_YAW_ANGLE_ERR_027 : 175|7@0+ (0.01,0) [0|1.27] "rad"  ADAS
 SG_ OBJ_ID_027 : 7|8@0+ (1,0) [0|255] "NA"  ADAS
 SG_ OBJ_MOVEMENT_STATUS_027 : 196|3@0+ (1,0) [0|3] "NA"  ADAS
 SG_ OBJ_MEASUREMENT_STATUS_027 : 14|3@0+ (1,0) [0|7] "NA"  ADAS
 SG_ OBJ_POS_LONG_027 : 63|16@0+ (0.01,-327) [-327|327] "m"  ADAS
 SG_ OBJ_POS_LAT_027 : 79|16@0+ (0.01,-327) [-327|327] "m"  ADAS
 SG_ OBJ_VELOCITY_LONG_027 : 110|15@0+ (0.01,-163) [-163|163] "m/s"  ADAS
 SG_ OBJ_VELOCITY_LAT_027 : 126|15@0+ (0.01,-163) [-163|163] "m/s"  ADAS
 SG_ OBJ_ACCELERATION_LONG_027 : 193|10@0+ (0.05,-20) [-20|20] "m/s^2"  ADAS
 SG_ OBJ_ACCELERATION_LAT_027 : 177|10@0+ (0.05,-20) [-20|20] "m/s^2"  ADAS
 SG_ OBJ_VEH_TRACK_FLAG_027 : 10|1@0+ (1,0) [0|1] "NA"  ADAS
 SG_ OBJ_MH_CYCLE_COUNTER_027 : 487|8@0+ (1,0) [0|255] "NA"  ADAS
 SG_ OBJ_MH_CRC16_027 : 495|16@0+ (1,0) [0|65535] "NA"  ADAS
 SG_ OBJ_TIMESTAMP_OFFSET_027 : 247|8@0+ (1,-127) [-127|128] "ms"  ADAS
 SG_ OBJ_DIMENSION_WIDTH_ERR_027 : 23|6@0+ (0.01,0) [0|0.63] "m"  ADAS
 SG_ OBJ_DIMENSION_LENGTH_ERR_027 : 41|10@0+ (0.01,0) [0|10.23] "m"  ADAS
 SG_ OBJ_CLS_TYPE1_027 : 271|4@0+ (1,0) [0|15] "NA"  ADAS
 SG_ OBJ_CLS_TYPE1_PROB_027 : 303|8@0+ (0.004,0) [0|1] "NA"  ADAS
 SG_ OBJ_CLS_TYPE2_027 : 267|4@0+ (1,0) [0|15] "NA"  ADAS
 SG_ OBJ_CLS_TYPE2_PROB_027 : 311|8@0+ (0.004,0) [0|1] "NA"  ADAS
 SG_ OBJ_CLS_TYPE3_027 : 279|4@0+ (1,0) [0|15] "NA"  ADAS
 SG_ OBJ_CLS_TYPE3_PROB_027 : 319|8@0+ (0.004,0) [0|1] "NA"  ADAS
 SG_ OBJ_CLS_TYPE4_027 : 275|4@0+ (1,0) [0|15] "NA"  ADAS
 SG_ OBJ_CLS_TYPE4_PROB_027 : 327|8@0+ (0.004,0) [0|1] "NA"  ADAS
 SG_ OBJ_CLS_TYPE5_027 : 287|4@0+ (1,0) [0|15] "NA"  ADAS
 SG_ OBJ_CLS_TYPE5_PROB_027 : 335|8@0+ (0.004,0) [0|1] "NA"  ADAS
 SG_ OBJ_CLS_TYPE6_027 : 282|4@0+ (1,0) [0|15] "NA"  ADAS
 SG_ OBJ_CLS_TYPE6_PROB_027 : 343|8@0+ (0.004,0) [0|1] "NA"  ADAS
 SG_ OBJ_RCS_027 : 351|7@0+ (1,-64) [-64|63] "dBsm"  ADAS
 SG_ OBJ_REF_PT_LONG_OFFSET_027 : 357|14@0+ (0.0001,0) [0|1] "NA"  ADAS
 SG_ OBJ_REF_PT_LAT_OFFSET_027 : 370|14@0+ (0.0001,0) [0|1] "NA"  ADAS
 SG_ OBJ_YAW_RATE_027 : 399|10@0+ (0.005,-2.24) [-2.24|2.24] "rad/s"  ADAS
 SG_ OBJ_YAW_RATE_ERR_027 : 388|5@0+ (0.025,0) [0|0.775] "rad/s"  ADAS
 SG_ OBJ_GROUP_ID_027 : 405|6@0+ (1,0) [0|63] "NA"  ADAS
 SG_ OBJ_POS_ERR_CRR_COEF_027 : 415|8@0+ (0.01,-1.2) [-1.2|1] "NA"  ADAS
 SG_ OBJ_VELOCITY_ERR_CRR_COEF_027 : 423|8@0+ (0.01,-1.2) [-1.2|1] "NA"  ADAS
 SG_ OBJ_ACCEL_ERR_CRR_COEF_027 : 431|8@0+ (0.01,-1.2) [-1.2|1] "NA"  ADAS

BO_ 1387 RDR_TRACKER_OBJ_028: 64 RDR02
 SG_ OBJ_ALIVE_TIME_028 : 255|16@0+ (1,0) [0|65535] "ms"  ADAS
 SG_ OBJ_ACCELERATION_LONG_ERR_028 : 215|8@0+ (0.025,0) [0|6.375] "m/s^2"  ADAS
 SG_ OBJ_ACCELERATION_LAT_ERR_028 : 223|8@0+ (0.025,0) [0|6.375] "m/s^2"  ADAS
 SG_ OBJ_VELOCITY_LONG_ERR_028 : 143|8@0+ (0.05,0) [0|12.75] "m/s"  ADAS
 SG_ OBJ_VELOCITY_LAT_ERR_028 : 151|8@0+ (0.05,0) [0|12.75] "m/s"  ADAS
 SG_ OBJ_POS_LONG_ERR_028 : 95|8@0+ (0.025,0) [0|6.375] "m"  ADAS
 SG_ OBJ_POS_LAT_ERR_028 : 103|8@0+ (0.025,0) [0|6.375] "m"  ADAS
 SG_ OBJ_TRACK_MOTION_MODEL_028 : 9|2@0+ (1,0) [0|3] "NA"  ADAS
 SG_ OBJ_DIMENSION_WIDTH_028 : 17|10@0+ (0.01,0) [0|10.23] "m"  ADAS
 SG_ OBJ_DIMENSION_LENGTH_028 : 37|12@0+ (0.01,0) [0|40.95] "m"  ADAS
 SG_ OBJ_EXISTENCE_PROB_028 : 229|14@0+ (0.0001,0) [0|1] "NA"  ADAS
 SG_ OBJ_YAW_ANGLE_028 : 155|12@0+ (0.005,-10) [-10|10.475] "rad"  ADAS
 SG_ OBJ_YAW_ANGLE_ERR_028 : 175|7@0+ (0.01,0) [0|1.27] "rad"  ADAS
 SG_ OBJ_ID_028 : 7|8@0+ (1,0) [0|255] "NA"  ADAS
 SG_ OBJ_MOVEMENT_STATUS_028 : 196|3@0+ (1,0) [0|3] "NA"  ADAS
 SG_ OBJ_MEASUREMENT_STATUS_028 : 14|3@0+ (1,0) [0|7] "NA"  ADAS
 SG_ OBJ_POS_LONG_028 : 63|16@0+ (0.01,-327) [-327|327] "m"  ADAS
 SG_ OBJ_POS_LAT_028 : 79|16@0+ (0.01,-327) [-327|327] "m"  ADAS
 SG_ OBJ_VELOCITY_LONG_028 : 110|15@0+ (0.01,-163) [-163|163] "m/s"  ADAS
 SG_ OBJ_VELOCITY_LAT_028 : 126|15@0+ (0.01,-163) [-163|163] "m/s"  ADAS
 SG_ OBJ_ACCELERATION_LONG_028 : 193|10@0+ (0.05,-20) [-20|20] "m/s^2"  ADAS
 SG_ OBJ_ACCELERATION_LAT_028 : 177|10@0+ (0.05,-20) [-20|20] "m/s^2"  ADAS
 SG_ OBJ_VEH_TRACK_FLAG_028 : 10|1@0+ (1,0) [0|1] "NA"  ADAS
 SG_ OBJ_MH_CYCLE_COUNTER_028 : 487|8@0+ (1,0) [0|255] "NA"  ADAS
 SG_ OBJ_MH_CRC16_028 : 495|16@0+ (1,0) [0|65535] "NA"  ADAS
 SG_ OBJ_TIMESTAMP_OFFSET_028 : 247|8@0+ (1,-127) [-127|128] "ms"  ADAS
 SG_ OBJ_DIMENSION_WIDTH_ERR_028 : 23|6@0+ (0.01,0) [0|0.63] "m"  ADAS
 SG_ OBJ_DIMENSION_LENGTH_ERR_028 : 41|10@0+ (0.01,0) [0|10.23] "m"  ADAS
 SG_ OBJ_CLS_TYPE1_028 : 271|4@0+ (1,0) [0|15] "NA"  ADAS
 SG_ OBJ_CLS_TYPE1_PROB_028 : 303|8@0+ (0.004,0) [0|1] "NA"  ADAS
 SG_ OBJ_CLS_TYPE2_028 : 267|4@0+ (1,0) [0|15] "NA"  ADAS
 SG_ OBJ_CLS_TYPE2_PROB_028 : 311|8@0+ (0.004,0) [0|1] "NA"  ADAS
 SG_ OBJ_CLS_TYPE3_028 : 279|4@0+ (1,0) [0|15] "NA"  ADAS
 SG_ OBJ_CLS_TYPE3_PROB_028 : 319|8@0+ (0.004,0) [0|1] "NA"  ADAS
 SG_ OBJ_CLS_TYPE4_028 : 275|4@0+ (1,0) [0|15] "NA"  ADAS
 SG_ OBJ_CLS_TYPE4_PROB_028 : 327|8@0+ (0.004,0) [0|1] "NA"  ADAS
 SG_ OBJ_CLS_TYPE5_028 : 287|4@0+ (1,0) [0|15] "NA"  ADAS
 SG_ OBJ_CLS_TYPE5_PROB_028 : 335|8@0+ (0.004,0) [0|1] "NA"  ADAS
 SG_ OBJ_CLS_TYPE6_028 : 282|4@0+ (1,0) [0|15] "NA"  ADAS
 SG_ OBJ_CLS_TYPE6_PROB_028 : 343|8@0+ (0.004,0) [0|1] "NA"  ADAS
 SG_ OBJ_RCS_028 : 351|7@0+ (1,-64) [-64|63] "dBsm"  ADAS
 SG_ OBJ_REF_PT_LONG_OFFSET_028 : 357|14@0+ (0.0001,0) [0|1] "NA"  ADAS
 SG_ OBJ_REF_PT_LAT_OFFSET_028 : 370|14@0+ (0.0001,0) [0|1] "NA"  ADAS
 SG_ OBJ_YAW_RATE_028 : 399|10@0+ (0.005,-2.24) [-2.24|2.24] "rad/s"  ADAS
 SG_ OBJ_YAW_RATE_ERR_028 : 388|5@0+ (0.025,0) [0|0.775] "rad/s"  ADAS
 SG_ OBJ_GROUP_ID_028 : 405|6@0+ (1,0) [0|63] "NA"  ADAS
 SG_ OBJ_POS_ERR_CRR_COEF_028 : 415|8@0+ (0.01,-1.2) [-1.2|1] "NA"  ADAS
 SG_ OBJ_VELOCITY_ERR_CRR_COEF_028 : 423|8@0+ (0.01,-1.2) [-1.2|1] "NA"  ADAS
 SG_ OBJ_ACCEL_ERR_CRR_COEF_028 : 431|8@0+ (0.01,-1.2) [-1.2|1] "NA"  ADAS

BO_ 1388 RDR_TRACKER_OBJ_029: 64 RDR02
 SG_ OBJ_ALIVE_TIME_029 : 255|16@0+ (1,0) [0|65535] "ms"  ADAS
 SG_ OBJ_ACCELERATION_LONG_ERR_029 : 215|8@0+ (0.025,0) [0|6.375] "m/s^2"  ADAS
 SG_ OBJ_ACCELERATION_LAT_ERR_029 : 223|8@0+ (0.025,0) [0|6.375] "m/s^2"  ADAS
 SG_ OBJ_VELOCITY_LONG_ERR_029 : 143|8@0+ (0.05,0) [0|12.75] "m/s"  ADAS
 SG_ OBJ_VELOCITY_LAT_ERR_029 : 151|8@0+ (0.05,0) [0|12.75] "m/s"  ADAS
 SG_ OBJ_POS_LONG_ERR_029 : 95|8@0+ (0.025,0) [0|6.375] "m"  ADAS
 SG_ OBJ_POS_LAT_ERR_029 : 103|8@0+ (0.025,0) [0|6.375] "m"  ADAS
 SG_ OBJ_TRACK_MOTION_MODEL_029 : 9|2@0+ (1,0) [0|3] "NA"  ADAS
 SG_ OBJ_DIMENSION_WIDTH_029 : 17|10@0+ (0.01,0) [0|10.23] "m"  ADAS
 SG_ OBJ_DIMENSION_LENGTH_029 : 37|12@0+ (0.01,0) [0|40.95] "m"  ADAS
 SG_ OBJ_EXISTENCE_PROB_029 : 229|14@0+ (0.0001,0) [0|1] "NA"  ADAS
 SG_ OBJ_YAW_ANGLE_029 : 155|12@0+ (0.005,-10) [-10|10.475] "rad"  ADAS
 SG_ OBJ_YAW_ANGLE_ERR_029 : 175|7@0+ (0.01,0) [0|1.27] "rad"  ADAS
 SG_ OBJ_ID_029 : 7|8@0+ (1,0) [0|255] "NA"  ADAS
 SG_ OBJ_MOVEMENT_STATUS_029 : 196|3@0+ (1,0) [0|3] "NA"  ADAS
 SG_ OBJ_MEASUREMENT_STATUS_029 : 14|3@0+ (1,0) [0|7] "NA"  ADAS
 SG_ OBJ_POS_LONG_029 : 63|16@0+ (0.01,-327) [-327|327] "m"  ADAS
 SG_ OBJ_POS_LAT_029 : 79|16@0+ (0.01,-327) [-327|327] "m"  ADAS
 SG_ OBJ_VELOCITY_LONG_029 : 110|15@0+ (0.01,-163) [-163|163] "m/s"  ADAS
 SG_ OBJ_VELOCITY_LAT_029 : 126|15@0+ (0.01,-163) [-163|163] "m/s"  ADAS
 SG_ OBJ_ACCELERATION_LONG_029 : 193|10@0+ (0.05,-20) [-20|20] "m/s^2"  ADAS
 SG_ OBJ_ACCELERATION_LAT_029 : 177|10@0+ (0.05,-20) [-20|20] "m/s^2"  ADAS
 SG_ OBJ_VEH_TRACK_FLAG_029 : 10|1@0+ (1,0) [0|1] "NA"  ADAS
 SG_ OBJ_MH_CYCLE_COUNTER_029 : 487|8@0+ (1,0) [0|255] "NA"  ADAS
 SG_ OBJ_MH_CRC16_029 : 495|16@0+ (1,0) [0|65535] "NA"  ADAS
 SG_ OBJ_TIMESTAMP_OFFSET_029 : 247|8@0+ (1,-127) [-127|128] "ms"  ADAS
 SG_ OBJ_DIMENSION_WIDTH_ERR_029 : 23|6@0+ (0.01,0) [0|0.63] "m"  ADAS
 SG_ OBJ_DIMENSION_LENGTH_ERR_029 : 41|10@0+ (0.01,0) [0|10.23] "m"  ADAS
 SG_ OBJ_CLS_TYPE1_029 : 271|4@0+ (1,0) [0|15] "NA"  ADAS
 SG_ OBJ_CLS_TYPE1_PROB_029 : 303|8@0+ (0.004,0) [0|1] "NA"  ADAS
 SG_ OBJ_CLS_TYPE2_029 : 267|4@0+ (1,0) [0|15] "NA"  ADAS
 SG_ OBJ_CLS_TYPE2_PROB_029 : 311|8@0+ (0.004,0) [0|1] "NA"  ADAS
 SG_ OBJ_CLS_TYPE3_029 : 279|4@0+ (1,0) [0|15] "NA"  ADAS
 SG_ OBJ_CLS_TYPE3_PROB_029 : 319|8@0+ (0.004,0) [0|1] "NA"  ADAS
 SG_ OBJ_CLS_TYPE4_029 : 275|4@0+ (1,0) [0|15] "NA"  ADAS
 SG_ OBJ_CLS_TYPE4_PROB_029 : 327|8@0+ (0.004,0) [0|1] "NA"  ADAS
 SG_ OBJ_CLS_TYPE5_029 : 287|4@0+ (1,0) [0|15] "NA"  ADAS
 SG_ OBJ_CLS_TYPE5_PROB_029 : 335|8@0+ (0.004,0) [0|1] "NA"  ADAS
 SG_ OBJ_CLS_TYPE6_029 : 282|4@0+ (1,0) [0|15] "NA"  ADAS
 SG_ OBJ_CLS_TYPE6_PROB_029 : 343|8@0+ (0.004,0) [0|1] "NA"  ADAS
 SG_ OBJ_RCS_029 : 351|7@0+ (1,-64) [-64|63] "dBsm"  ADAS
 SG_ OBJ_REF_PT_LONG_OFFSET_029 : 357|14@0+ (0.0001,0) [0|1] "NA"  ADAS
 SG_ OBJ_REF_PT_LAT_OFFSET_029 : 370|14@0+ (0.0001,0) [0|1] "NA"  ADAS
 SG_ OBJ_YAW_RATE_029 : 399|10@0+ (0.005,-2.24) [-2.24|2.24] "rad/s"  ADAS
 SG_ OBJ_YAW_RATE_ERR_029 : 388|5@0+ (0.025,0) [0|0.775] "rad/s"  ADAS
 SG_ OBJ_GROUP_ID_029 : 405|6@0+ (1,0) [0|63] "NA"  ADAS
 SG_ OBJ_POS_ERR_CRR_COEF_029 : 415|8@0+ (0.01,-1.2) [-1.2|1] "NA"  ADAS
 SG_ OBJ_VELOCITY_ERR_CRR_COEF_029 : 423|8@0+ (0.01,-1.2) [-1.2|1] "NA"  ADAS
 SG_ OBJ_ACCEL_ERR_CRR_COEF_029 : 431|8@0+ (0.01,-1.2) [-1.2|1] "NA"  ADAS

BO_ 1389 RDR_TRACKER_OBJ_030: 64 RDR02
 SG_ OBJ_ALIVE_TIME_030 : 255|16@0+ (1,0) [0|65535] "ms"  ADAS
 SG_ OBJ_ACCELERATION_LONG_ERR_030 : 215|8@0+ (0.025,0) [0|6.375] "m/s^2"  ADAS
 SG_ OBJ_ACCELERATION_LAT_ERR_030 : 223|8@0+ (0.025,0) [0|6.375] "m/s^2"  ADAS
 SG_ OBJ_VELOCITY_LONG_ERR_030 : 143|8@0+ (0.05,0) [0|12.75] "m/s"  ADAS
 SG_ OBJ_VELOCITY_LAT_ERR_030 : 151|8@0+ (0.05,0) [0|12.75] "m/s"  ADAS
 SG_ OBJ_POS_LONG_ERR_030 : 95|8@0+ (0.025,0) [0|6.375] "m"  ADAS
 SG_ OBJ_POS_LAT_ERR_030 : 103|8@0+ (0.025,0) [0|6.375] "m"  ADAS
 SG_ OBJ_TRACK_MOTION_MODEL_030 : 9|2@0+ (1,0) [0|3] "NA"  ADAS
 SG_ OBJ_DIMENSION_WIDTH_030 : 17|10@0+ (0.01,0) [0|10.23] "m"  ADAS
 SG_ OBJ_DIMENSION_LENGTH_030 : 37|12@0+ (0.01,0) [0|40.95] "m"  ADAS
 SG_ OBJ_EXISTENCE_PROB_030 : 229|14@0+ (0.0001,0) [0|1] "NA"  ADAS
 SG_ OBJ_YAW_ANGLE_030 : 155|12@0+ (0.005,-10) [-10|10.475] "rad"  ADAS
 SG_ OBJ_YAW_ANGLE_ERR_030 : 175|7@0+ (0.01,0) [0|1.27] "rad"  ADAS
 SG_ OBJ_ID_030 : 7|8@0+ (1,0) [0|255] "NA"  ADAS
 SG_ OBJ_MOVEMENT_STATUS_030 : 196|3@0+ (1,0) [0|3] "NA"  ADAS
 SG_ OBJ_MEASUREMENT_STATUS_030 : 14|3@0+ (1,0) [0|7] "NA"  ADAS
 SG_ OBJ_POS_LONG_030 : 63|16@0+ (0.01,-327) [-327|327] "m"  ADAS
 SG_ OBJ_POS_LAT_030 : 79|16@0+ (0.01,-327) [-327|327] "m"  ADAS
 SG_ OBJ_VELOCITY_LONG_030 : 110|15@0+ (0.01,-163) [-163|163] "m/s"  ADAS
 SG_ OBJ_VELOCITY_LAT_030 : 126|15@0+ (0.01,-163) [-163|163] "m/s"  ADAS
 SG_ OBJ_ACCELERATION_LONG_030 : 193|10@0+ (0.05,-20) [-20|20] "m/s^2"  ADAS
 SG_ OBJ_ACCELERATION_LAT_030 : 177|10@0+ (0.05,-20) [-20|20] "m/s^2"  ADAS
 SG_ OBJ_VEH_TRACK_FLAG_030 : 10|1@0+ (1,0) [0|1] "NA"  ADAS
 SG_ OBJ_MH_CYCLE_COUNTER_030 : 487|8@0+ (1,0) [0|255] "NA"  ADAS
 SG_ OBJ_MH_CRC16_030 : 495|16@0+ (1,0) [0|65535] "NA"  ADAS
 SG_ OBJ_TIMESTAMP_OFFSET_030 : 247|8@0+ (1,-127) [-127|128] "ms"  ADAS
 SG_ OBJ_DIMENSION_WIDTH_ERR_030 : 23|6@0+ (0.01,0) [0|0.63] "m"  ADAS
 SG_ OBJ_DIMENSION_LENGTH_ERR_030 : 41|10@0+ (0.01,0) [0|10.23] "m"  ADAS
 SG_ OBJ_CLS_TYPE1_030 : 271|4@0+ (1,0) [0|15] "NA"  ADAS
 SG_ OBJ_CLS_TYPE1_PROB_030 : 303|8@0+ (0.004,0) [0|1] "NA"  ADAS
 SG_ OBJ_CLS_TYPE2_030 : 267|4@0+ (1,0) [0|15] "NA"  ADAS
 SG_ OBJ_CLS_TYPE2_PROB_030 : 311|8@0+ (0.004,0) [0|1] "NA"  ADAS
 SG_ OBJ_CLS_TYPE3_030 : 279|4@0+ (1,0) [0|15] "NA"  ADAS
 SG_ OBJ_CLS_TYPE3_PROB_030 : 319|8@0+ (0.004,0) [0|1] "NA"  ADAS
 SG_ OBJ_CLS_TYPE4_030 : 275|4@0+ (1,0) [0|15] "NA"  ADAS
 SG_ OBJ_CLS_TYPE4_PROB_030 : 327|8@0+ (0.004,0) [0|1] "NA"  ADAS
 SG_ OBJ_CLS_TYPE5_030 : 287|4@0+ (1,0) [0|15] "NA"  ADAS
 SG_ OBJ_CLS_TYPE5_PROB_030 : 335|8@0+ (0.004,0) [0|1] "NA"  ADAS
 SG_ OBJ_CLS_TYPE6_030 : 282|4@0+ (1,0) [0|15] "NA"  ADAS
 SG_ OBJ_CLS_TYPE6_PROB_030 : 343|8@0+ (0.004,0) [0|1] "NA"  ADAS
 SG_ OBJ_RCS_030 : 351|7@0+ (1,-64) [-64|63] "dBsm"  ADAS
 SG_ OBJ_REF_PT_LONG_OFFSET_030 : 357|14@0+ (0.0001,0) [0|1] "NA"  ADAS
 SG_ OBJ_REF_PT_LAT_OFFSET_030 : 370|14@0+ (0.0001,0) [0|1] "NA"  ADAS
 SG_ OBJ_YAW_RATE_030 : 399|10@0+ (0.005,-2.24) [-2.24|2.24] "rad/s"  ADAS
 SG_ OBJ_YAW_RATE_ERR_030 : 388|5@0+ (0.025,0) [0|0.775] "rad/s"  ADAS
 SG_ OBJ_GROUP_ID_030 : 405|6@0+ (1,0) [0|63] "NA"  ADAS
 SG_ OBJ_POS_ERR_CRR_COEF_030 : 415|8@0+ (0.01,-1.2) [-1.2|1] "NA"  ADAS
 SG_ OBJ_VELOCITY_ERR_CRR_COEF_030 : 423|8@0+ (0.01,-1.2) [-1.2|1] "NA"  ADAS
 SG_ OBJ_ACCEL_ERR_CRR_COEF_030 : 431|8@0+ (0.01,-1.2) [-1.2|1] "NA"  ADAS

BO_ 1390 RDR_TRACKER_OBJ_031: 64 RDR02
 SG_ OBJ_ALIVE_TIME_031 : 255|16@0+ (1,0) [0|65535] "ms"  ADAS
 SG_ OBJ_ACCELERATION_LONG_ERR_031 : 215|8@0+ (0.025,0) [0|6.375] "m/s^2"  ADAS
 SG_ OBJ_ACCELERATION_LAT_ERR_031 : 223|8@0+ (0.025,0) [0|6.375] "m/s^2"  ADAS
 SG_ OBJ_VELOCITY_LONG_ERR_031 : 143|8@0+ (0.05,0) [0|12.75] "m/s"  ADAS
 SG_ OBJ_VELOCITY_LAT_ERR_031 : 151|8@0+ (0.05,0) [0|12.75] "m/s"  ADAS
 SG_ OBJ_POS_LONG_ERR_031 : 95|8@0+ (0.025,0) [0|6.375] "m"  ADAS
 SG_ OBJ_POS_LAT_ERR_031 : 103|8@0+ (0.025,0) [0|6.375] "m"  ADAS
 SG_ OBJ_TRACK_MOTION_MODEL_031 : 9|2@0+ (1,0) [0|3] "NA"  ADAS
 SG_ OBJ_DIMENSION_WIDTH_031 : 17|10@0+ (0.01,0) [0|10.23] "m"  ADAS
 SG_ OBJ_DIMENSION_LENGTH_031 : 37|12@0+ (0.01,0) [0|40.95] "m"  ADAS
 SG_ OBJ_EXISTENCE_PROB_031 : 229|14@0+ (0.0001,0) [0|1] "NA"  ADAS
 SG_ OBJ_YAW_ANGLE_031 : 155|12@0+ (0.005,-10) [-10|10.475] "rad"  ADAS
 SG_ OBJ_YAW_ANGLE_ERR_031 : 175|7@0+ (0.01,0) [0|1.27] "rad"  ADAS
 SG_ OBJ_ID_031 : 7|8@0+ (1,0) [0|255] "NA"  ADAS
 SG_ OBJ_MOVEMENT_STATUS_031 : 196|3@0+ (1,0) [0|3] "NA"  ADAS
 SG_ OBJ_MEASUREMENT_STATUS_031 : 14|3@0+ (1,0) [0|7] "NA"  ADAS
 SG_ OBJ_POS_LONG_031 : 63|16@0+ (0.01,-327) [-327|327] "m"  ADAS
 SG_ OBJ_POS_LAT_031 : 79|16@0+ (0.01,-327) [-327|327] "m"  ADAS
 SG_ OBJ_VELOCITY_LONG_031 : 110|15@0+ (0.01,-163) [-163|163] "m/s"  ADAS
 SG_ OBJ_VELOCITY_LAT_031 : 126|15@0+ (0.01,-163) [-163|163] "m/s"  ADAS
 SG_ OBJ_ACCELERATION_LONG_031 : 193|10@0+ (0.05,-20) [-20|20] "m/s^2"  ADAS
 SG_ OBJ_ACCELERATION_LAT_031 : 177|10@0+ (0.05,-20) [-20|20] "m/s^2"  ADAS
 SG_ OBJ_VEH_TRACK_FLAG_031 : 10|1@0+ (1,0) [0|1] "NA"  ADAS
 SG_ OBJ_MH_CYCLE_COUNTER_031 : 487|8@0+ (1,0) [0|255] "NA"  ADAS
 SG_ OBJ_MH_CRC16_031 : 495|16@0+ (1,0) [0|65535] "NA"  ADAS
 SG_ OBJ_TIMESTAMP_OFFSET_031 : 247|8@0+ (1,-127) [-127|128] "ms"  ADAS
 SG_ OBJ_DIMENSION_WIDTH_ERR_031 : 23|6@0+ (0.01,0) [0|0.63] "m"  ADAS
 SG_ OBJ_DIMENSION_LENGTH_ERR_031 : 41|10@0+ (0.01,0) [0|10.23] "m"  ADAS
 SG_ OBJ_CLS_TYPE1_031 : 271|4@0+ (1,0) [0|15] "NA"  ADAS
 SG_ OBJ_CLS_TYPE1_PROB_031 : 303|8@0+ (0.004,0) [0|1] "NA"  ADAS
 SG_ OBJ_CLS_TYPE2_031 : 267|4@0+ (1,0) [0|15] "NA"  ADAS
 SG_ OBJ_CLS_TYPE2_PROB_031 : 311|8@0+ (0.004,0) [0|1] "NA"  ADAS
 SG_ OBJ_CLS_TYPE3_031 : 279|4@0+ (1,0) [0|15] "NA"  ADAS
 SG_ OBJ_CLS_TYPE3_PROB_031 : 319|8@0+ (0.004,0) [0|1] "NA"  ADAS
 SG_ OBJ_CLS_TYPE4_031 : 275|4@0+ (1,0) [0|15] "NA"  ADAS
 SG_ OBJ_CLS_TYPE4_PROB_031 : 327|8@0+ (0.004,0) [0|1] "NA"  ADAS
 SG_ OBJ_CLS_TYPE5_031 : 287|4@0+ (1,0) [0|15] "NA"  ADAS
 SG_ OBJ_CLS_TYPE5_PROB_031 : 335|8@0+ (0.004,0) [0|1] "NA"  ADAS
 SG_ OBJ_CLS_TYPE6_031 : 282|4@0+ (1,0) [0|15] "NA"  ADAS
 SG_ OBJ_CLS_TYPE6_PROB_031 : 343|8@0+ (0.004,0) [0|1] "NA"  ADAS
 SG_ OBJ_RCS_031 : 351|7@0+ (1,-64) [-64|63] "dBsm"  ADAS
 SG_ OBJ_REF_PT_LONG_OFFSET_031 : 357|14@0+ (0.0001,0) [0|1] "NA"  ADAS
 SG_ OBJ_REF_PT_LAT_OFFSET_031 : 370|14@0+ (0.0001,0) [0|1] "NA"  ADAS
 SG_ OBJ_YAW_RATE_031 : 399|10@0+ (0.005,-2.24) [-2.24|2.24] "rad/s"  ADAS
 SG_ OBJ_YAW_RATE_ERR_031 : 388|5@0+ (0.025,0) [0|0.775] "rad/s"  ADAS
 SG_ OBJ_GROUP_ID_031 : 405|6@0+ (1,0) [0|63] "NA"  ADAS
 SG_ OBJ_POS_ERR_CRR_COEF_031 : 415|8@0+ (0.01,-1.2) [-1.2|1] "NA"  ADAS
 SG_ OBJ_VELOCITY_ERR_CRR_COEF_031 : 423|8@0+ (0.01,-1.2) [-1.2|1] "NA"  ADAS
 SG_ OBJ_ACCEL_ERR_CRR_COEF_031 : 431|8@0+ (0.01,-1.2) [-1.2|1] "NA"  ADAS

BO_ 1391 RDR_TRACKER_OBJ_032: 64 RDR02
 SG_ OBJ_ALIVE_TIME_032 : 255|16@0+ (1,0) [0|65535] "ms"  ADAS
 SG_ OBJ_ACCELERATION_LONG_ERR_032 : 215|8@0+ (0.025,0) [0|6.375] "m/s^2"  ADAS
 SG_ OBJ_ACCELERATION_LAT_ERR_032 : 223|8@0+ (0.025,0) [0|6.375] "m/s^2"  ADAS
 SG_ OBJ_VELOCITY_LONG_ERR_032 : 143|8@0+ (0.05,0) [0|12.75] "m/s"  ADAS
 SG_ OBJ_VELOCITY_LAT_ERR_032 : 151|8@0+ (0.05,0) [0|12.75] "m/s"  ADAS
 SG_ OBJ_POS_LONG_ERR_032 : 95|8@0+ (0.025,0) [0|6.375] "m"  ADAS
 SG_ OBJ_POS_LAT_ERR_032 : 103|8@0+ (0.025,0) [0|6.375] "m"  ADAS
 SG_ OBJ_TRACK_MOTION_MODEL_032 : 9|2@0+ (1,0) [0|3] "NA"  ADAS
 SG_ OBJ_DIMENSION_WIDTH_032 : 17|10@0+ (0.01,0) [0|10.23] "m"  ADAS
 SG_ OBJ_DIMENSION_LENGTH_032 : 37|12@0+ (0.01,0) [0|40.95] "m"  ADAS
 SG_ OBJ_EXISTENCE_PROB_032 : 229|14@0+ (0.0001,0) [0|1] "NA"  ADAS
 SG_ OBJ_YAW_ANGLE_032 : 155|12@0+ (0.005,-10) [-10|10.475] "rad"  ADAS
 SG_ OBJ_YAW_ANGLE_ERR_032 : 175|7@0+ (0.01,0) [0|1.27] "rad"  ADAS
 SG_ OBJ_ID_032 : 7|8@0+ (1,0) [0|255] "NA"  ADAS
 SG_ OBJ_MOVEMENT_STATUS_032 : 196|3@0+ (1,0) [0|3] "NA"  ADAS
 SG_ OBJ_MEASUREMENT_STATUS_032 : 14|3@0+ (1,0) [0|7] "NA"  ADAS
 SG_ OBJ_POS_LONG_032 : 63|16@0+ (0.01,-327) [-327|327] "m"  ADAS
 SG_ OBJ_POS_LAT_032 : 79|16@0+ (0.01,-327) [-327|327] "m"  ADAS
 SG_ OBJ_VELOCITY_LONG_032 : 110|15@0+ (0.01,-163) [-163|163] "m/s"  ADAS
 SG_ OBJ_VELOCITY_LAT_032 : 126|15@0+ (0.01,-163) [-163|163] "m/s"  ADAS
 SG_ OBJ_ACCELERATION_LONG_032 : 193|10@0+ (0.05,-20) [-20|20] "m/s^2"  ADAS
 SG_ OBJ_ACCELERATION_LAT_032 : 177|10@0+ (0.05,-20) [-20|20] "m/s^2"  ADAS
 SG_ OBJ_VEH_TRACK_FLAG_032 : 10|1@0+ (1,0) [0|1] "NA"  ADAS
 SG_ OBJ_MH_CYCLE_COUNTER_032 : 487|8@0+ (1,0) [0|255] "NA"  ADAS
 SG_ OBJ_MH_CRC16_032 : 495|16@0+ (1,0) [0|65535] "NA"  ADAS
 SG_ OBJ_TIMESTAMP_OFFSET_032 : 247|8@0+ (1,-127) [-127|128] "ms"  ADAS
 SG_ OBJ_DIMENSION_WIDTH_ERR_032 : 23|6@0+ (0.01,0) [0|0.63] "m"  ADAS
 SG_ OBJ_DIMENSION_LENGTH_ERR_032 : 41|10@0+ (0.01,0) [0|10.23] "m"  ADAS
 SG_ OBJ_CLS_TYPE1_032 : 271|4@0+ (1,0) [0|15] "NA"  ADAS
 SG_ OBJ_CLS_TYPE1_PROB_032 : 303|8@0+ (0.004,0) [0|1] "NA"  ADAS
 SG_ OBJ_CLS_TYPE2_032 : 267|4@0+ (1,0) [0|15] "NA"  ADAS
 SG_ OBJ_CLS_TYPE2_PROB_032 : 311|8@0+ (0.004,0) [0|1] "NA"  ADAS
 SG_ OBJ_CLS_TYPE3_032 : 279|4@0+ (1,0) [0|15] "NA"  ADAS
 SG_ OBJ_CLS_TYPE3_PROB_032 : 319|8@0+ (0.004,0) [0|1] "NA"  ADAS
 SG_ OBJ_CLS_TYPE4_032 : 275|4@0+ (1,0) [0|15] "NA"  ADAS
 SG_ OBJ_CLS_TYPE4_PROB_032 : 327|8@0+ (0.004,0) [0|1] "NA"  ADAS
 SG_ OBJ_CLS_TYPE5_032 : 287|4@0+ (1,0) [0|15] "NA"  ADAS
 SG_ OBJ_CLS_TYPE5_PROB_032 : 335|8@0+ (0.004,0) [0|1] "NA"  ADAS
 SG_ OBJ_CLS_TYPE6_032 : 282|4@0+ (1,0) [0|15] "NA"  ADAS
 SG_ OBJ_CLS_TYPE6_PROB_032 : 343|8@0+ (0.004,0) [0|1] "NA"  ADAS
 SG_ OBJ_RCS_032 : 351|7@0+ (1,-64) [-64|63] "dBsm"  ADAS
 SG_ OBJ_REF_PT_LONG_OFFSET_032 : 357|14@0+ (0.0001,0) [0|1] "NA"  ADAS
 SG_ OBJ_REF_PT_LAT_OFFSET_032 : 370|14@0+ (0.0001,0) [0|1] "NA"  ADAS
 SG_ OBJ_YAW_RATE_032 : 399|10@0+ (0.005,-2.24) [-2.24|2.24] "rad/s"  ADAS
 SG_ OBJ_YAW_RATE_ERR_032 : 388|5@0+ (0.025,0) [0|0.775] "rad/s"  ADAS
 SG_ OBJ_GROUP_ID_032 : 405|6@0+ (1,0) [0|63] "NA"  ADAS
 SG_ OBJ_POS_ERR_CRR_COEF_032 : 415|8@0+ (0.01,-1.2) [-1.2|1] "NA"  ADAS
 SG_ OBJ_VELOCITY_ERR_CRR_COEF_032 : 423|8@0+ (0.01,-1.2) [-1.2|1] "NA"  ADAS
 SG_ OBJ_ACCEL_ERR_CRR_COEF_032 : 431|8@0+ (0.01,-1.2) [-1.2|1] "NA"  ADAS

BO_ 1392 RDR_TRACKER_OBJ_033: 64 RDR02
 SG_ OBJ_ALIVE_TIME_033 : 255|16@0+ (1,0) [0|65535] "ms"  ADAS
 SG_ OBJ_ACCELERATION_LONG_ERR_033 : 215|8@0+ (0.025,0) [0|6.375] "m/s^2"  ADAS
 SG_ OBJ_ACCELERATION_LAT_ERR_033 : 223|8@0+ (0.025,0) [0|6.375] "m/s^2"  ADAS
 SG_ OBJ_VELOCITY_LONG_ERR_033 : 143|8@0+ (0.05,0) [0|12.75] "m/s"  ADAS
 SG_ OBJ_VELOCITY_LAT_ERR_033 : 151|8@0+ (0.05,0) [0|12.75] "m/s"  ADAS
 SG_ OBJ_POS_LONG_ERR_033 : 95|8@0+ (0.025,0) [0|6.375] "m"  ADAS
 SG_ OBJ_POS_LAT_ERR_033 : 103|8@0+ (0.025,0) [0|6.375] "m"  ADAS
 SG_ OBJ_TRACK_MOTION_MODEL_033 : 9|2@0+ (1,0) [0|3] "NA"  ADAS
 SG_ OBJ_DIMENSION_WIDTH_033 : 17|10@0+ (0.01,0) [0|10.23] "m"  ADAS
 SG_ OBJ_DIMENSION_LENGTH_033 : 37|12@0+ (0.01,0) [0|40.95] "m"  ADAS
 SG_ OBJ_EXISTENCE_PROB_033 : 229|14@0+ (0.0001,0) [0|1] "NA"  ADAS
 SG_ OBJ_YAW_ANGLE_033 : 155|12@0+ (0.005,-10) [-10|10.475] "rad"  ADAS
 SG_ OBJ_YAW_ANGLE_ERR_033 : 175|7@0+ (0.01,0) [0|1.27] "rad"  ADAS
 SG_ OBJ_ID_033 : 7|8@0+ (1,0) [0|255] "NA"  ADAS
 SG_ OBJ_MOVEMENT_STATUS_033 : 196|3@0+ (1,0) [0|3] "NA"  ADAS
 SG_ OBJ_MEASUREMENT_STATUS_033 : 14|3@0+ (1,0) [0|7] "NA"  ADAS
 SG_ OBJ_POS_LONG_033 : 63|16@0+ (0.01,-327) [-327|327] "m"  ADAS
 SG_ OBJ_POS_LAT_033 : 79|16@0+ (0.01,-327) [-327|327] "m"  ADAS
 SG_ OBJ_VELOCITY_LONG_033 : 110|15@0+ (0.01,-163) [-163|163] "m/s"  ADAS
 SG_ OBJ_VELOCITY_LAT_033 : 126|15@0+ (0.01,-163) [-163|163] "m/s"  ADAS
 SG_ OBJ_ACCELERATION_LONG_033 : 193|10@0+ (0.05,-20) [-20|20] "m/s^2"  ADAS
 SG_ OBJ_ACCELERATION_LAT_033 : 177|10@0+ (0.05,-20) [-20|20] "m/s^2"  ADAS
 SG_ OBJ_VEH_TRACK_FLAG_033 : 10|1@0+ (1,0) [0|1] "NA"  ADAS
 SG_ OBJ_MH_CYCLE_COUNTER_033 : 487|8@0+ (1,0) [0|255] "NA"  ADAS
 SG_ OBJ_MH_CRC16_033 : 495|16@0+ (1,0) [0|65535] "NA"  ADAS
 SG_ OBJ_TIMESTAMP_OFFSET_033 : 247|8@0+ (1,-127) [-127|128] "ms"  ADAS
 SG_ OBJ_DIMENSION_WIDTH_ERR_033 : 23|6@0+ (0.01,0) [0|0.63] "m"  ADAS
 SG_ OBJ_DIMENSION_LENGTH_ERR_033 : 41|10@0+ (0.01,0) [0|10.23] "m"  ADAS
 SG_ OBJ_CLS_TYPE1_033 : 271|4@0+ (1,0) [0|15] "NA"  ADAS
 SG_ OBJ_CLS_TYPE1_PROB_033 : 303|8@0+ (0.004,0) [0|1] "NA"  ADAS
 SG_ OBJ_CLS_TYPE2_033 : 267|4@0+ (1,0) [0|15] "NA"  ADAS
 SG_ OBJ_CLS_TYPE2_PROB_033 : 311|8@0+ (0.004,0) [0|1] "NA"  ADAS
 SG_ OBJ_CLS_TYPE3_033 : 279|4@0+ (1,0) [0|15] "NA"  ADAS
 SG_ OBJ_CLS_TYPE3_PROB_033 : 319|8@0+ (0.004,0) [0|1] "NA"  ADAS
 SG_ OBJ_CLS_TYPE4_033 : 275|4@0+ (1,0) [0|15] "NA"  ADAS
 SG_ OBJ_CLS_TYPE4_PROB_033 : 327|8@0+ (0.004,0) [0|1] "NA"  ADAS
 SG_ OBJ_CLS_TYPE5_033 : 287|4@0+ (1,0) [0|15] "NA"  ADAS
 SG_ OBJ_CLS_TYPE5_PROB_033 : 335|8@0+ (0.004,0) [0|1] "NA"  ADAS
 SG_ OBJ_CLS_TYPE6_033 : 282|4@0+ (1,0) [0|15] "NA"  ADAS
 SG_ OBJ_CLS_TYPE6_PROB_033 : 343|8@0+ (0.004,0) [0|1] "NA"  ADAS
 SG_ OBJ_RCS_033 : 351|7@0+ (1,-64) [-64|63] "dBsm"  ADAS
 SG_ OBJ_REF_PT_LONG_OFFSET_033 : 357|14@0+ (0.0001,0) [0|1] "NA"  ADAS
 SG_ OBJ_REF_PT_LAT_OFFSET_033 : 370|14@0+ (0.0001,0) [0|1] "NA"  ADAS
 SG_ OBJ_YAW_RATE_033 : 399|10@0+ (0.005,-2.24) [-2.24|2.24] "rad/s"  ADAS
 SG_ OBJ_YAW_RATE_ERR_033 : 388|5@0+ (0.025,0) [0|0.775] "rad/s"  ADAS
 SG_ OBJ_GROUP_ID_033 : 405|6@0+ (1,0) [0|63] "NA"  ADAS
 SG_ OBJ_POS_ERR_CRR_COEF_033 : 415|8@0+ (0.01,-1.2) [-1.2|1] "NA"  ADAS
 SG_ OBJ_VELOCITY_ERR_CRR_COEF_033 : 423|8@0+ (0.01,-1.2) [-1.2|1] "NA"  ADAS
 SG_ OBJ_ACCEL_ERR_CRR_COEF_033 : 431|8@0+ (0.01,-1.2) [-1.2|1] "NA"  ADAS

BO_ 1393 RDR_TRACKER_OBJ_034: 64 RDR02
 SG_ OBJ_ALIVE_TIME_034 : 255|16@0+ (1,0) [0|65535] "ms"  ADAS
 SG_ OBJ_ACCELERATION_LONG_ERR_034 : 215|8@0+ (0.025,0) [0|6.375] "m/s^2"  ADAS
 SG_ OBJ_ACCELERATION_LAT_ERR_034 : 223|8@0+ (0.025,0) [0|6.375] "m/s^2"  ADAS
 SG_ OBJ_VELOCITY_LONG_ERR_034 : 143|8@0+ (0.05,0) [0|12.75] "m/s"  ADAS
 SG_ OBJ_VELOCITY_LAT_ERR_034 : 151|8@0+ (0.05,0) [0|12.75] "m/s"  ADAS
 SG_ OBJ_POS_LONG_ERR_034 : 95|8@0+ (0.025,0) [0|6.375] "m"  ADAS
 SG_ OBJ_POS_LAT_ERR_034 : 103|8@0+ (0.025,0) [0|6.375] "m"  ADAS
 SG_ OBJ_TRACK_MOTION_MODEL_034 : 9|2@0+ (1,0) [0|3] "NA"  ADAS
 SG_ OBJ_DIMENSION_WIDTH_034 : 17|10@0+ (0.01,0) [0|10.23] "m"  ADAS
 SG_ OBJ_DIMENSION_LENGTH_034 : 37|12@0+ (0.01,0) [0|40.95] "m"  ADAS
 SG_ OBJ_EXISTENCE_PROB_034 : 229|14@0+ (0.0001,0) [0|1] "NA"  ADAS
 SG_ OBJ_YAW_ANGLE_034 : 155|12@0+ (0.005,-10) [-10|10.475] "rad"  ADAS
 SG_ OBJ_YAW_ANGLE_ERR_034 : 175|7@0+ (0.01,0) [0|1.27] "rad"  ADAS
 SG_ OBJ_ID_034 : 7|8@0+ (1,0) [0|255] "NA"  ADAS
 SG_ OBJ_MOVEMENT_STATUS_034 : 196|3@0+ (1,0) [0|3] "NA"  ADAS
 SG_ OBJ_MEASUREMENT_STATUS_034 : 14|3@0+ (1,0) [0|7] "NA"  ADAS
 SG_ OBJ_POS_LONG_034 : 63|16@0+ (0.01,-327) [-327|327] "m"  ADAS
 SG_ OBJ_POS_LAT_034 : 79|16@0+ (0.01,-327) [-327|327] "m"  ADAS
 SG_ OBJ_VELOCITY_LONG_034 : 110|15@0+ (0.01,-163) [-163|163] "m/s"  ADAS
 SG_ OBJ_VELOCITY_LAT_034 : 126|15@0+ (0.01,-163) [-163|163] "m/s"  ADAS
 SG_ OBJ_ACCELERATION_LONG_034 : 193|10@0+ (0.05,-20) [-20|20] "m/s^2"  ADAS
 SG_ OBJ_ACCELERATION_LAT_034 : 177|10@0+ (0.05,-20) [-20|20] "m/s^2"  ADAS
 SG_ OBJ_VEH_TRACK_FLAG_034 : 10|1@0+ (1,0) [0|1] "NA"  ADAS
 SG_ OBJ_MH_CYCLE_COUNTER_034 : 487|8@0+ (1,0) [0|255] "NA"  ADAS
 SG_ OBJ_MH_CRC16_034 : 495|16@0+ (1,0) [0|65535] "NA"  ADAS
 SG_ OBJ_TIMESTAMP_OFFSET_034 : 247|8@0+ (1,-127) [-127|128] "ms"  ADAS
 SG_ OBJ_DIMENSION_WIDTH_ERR_034 : 23|6@0+ (0.01,0) [0|0.63] "m"  ADAS
 SG_ OBJ_DIMENSION_LENGTH_ERR_034 : 41|10@0+ (0.01,0) [0|10.23] "m"  ADAS
 SG_ OBJ_CLS_TYPE1_034 : 271|4@0+ (1,0) [0|15] "NA"  ADAS
 SG_ OBJ_CLS_TYPE1_PROB_034 : 303|8@0+ (0.004,0) [0|1] "NA"  ADAS
 SG_ OBJ_CLS_TYPE2_034 : 267|4@0+ (1,0) [0|15] "NA"  ADAS
 SG_ OBJ_CLS_TYPE2_PROB_034 : 311|8@0+ (0.004,0) [0|1] "NA"  ADAS
 SG_ OBJ_CLS_TYPE3_034 : 279|4@0+ (1,0) [0|15] "NA"  ADAS
 SG_ OBJ_CLS_TYPE3_PROB_034 : 319|8@0+ (0.004,0) [0|1] "NA"  ADAS
 SG_ OBJ_CLS_TYPE4_034 : 275|4@0+ (1,0) [0|15] "NA"  ADAS
 SG_ OBJ_CLS_TYPE4_PROB_034 : 327|8@0+ (0.004,0) [0|1] "NA"  ADAS
 SG_ OBJ_CLS_TYPE5_034 : 287|4@0+ (1,0) [0|15] "NA"  ADAS
 SG_ OBJ_CLS_TYPE5_PROB_034 : 335|8@0+ (0.004,0) [0|1] "NA"  ADAS
 SG_ OBJ_CLS_TYPE6_034 : 282|4@0+ (1,0) [0|15] "NA"  ADAS
 SG_ OBJ_CLS_TYPE6_PROB_034 : 343|8@0+ (0.004,0) [0|1] "NA"  ADAS
 SG_ OBJ_RCS_034 : 351|7@0+ (1,-64) [-64|63] "dBsm"  ADAS
 SG_ OBJ_REF_PT_LONG_OFFSET_034 : 357|14@0+ (0.0001,0) [0|1] "NA"  ADAS
 SG_ OBJ_REF_PT_LAT_OFFSET_034 : 370|14@0+ (0.0001,0) [0|1] "NA"  ADAS
 SG_ OBJ_YAW_RATE_034 : 399|10@0+ (0.005,-2.24) [-2.24|2.24] "rad/s"  ADAS
 SG_ OBJ_YAW_RATE_ERR_034 : 388|5@0+ (0.025,0) [0|0.775] "rad/s"  ADAS
 SG_ OBJ_GROUP_ID_034 : 405|6@0+ (1,0) [0|63] "NA"  ADAS
 SG_ OBJ_POS_ERR_CRR_COEF_034 : 415|8@0+ (0.01,-1.2) [-1.2|1] "NA"  ADAS
 SG_ OBJ_VELOCITY_ERR_CRR_COEF_034 : 423|8@0+ (0.01,-1.2) [-1.2|1] "NA"  ADAS
 SG_ OBJ_ACCEL_ERR_CRR_COEF_034 : 431|8@0+ (0.01,-1.2) [-1.2|1] "NA"  ADAS

BO_ 1394 RDR_TRACKER_OBJ_035: 64 RDR02
 SG_ OBJ_ALIVE_TIME_035 : 255|16@0+ (1,0) [0|65535] "ms"  ADAS
 SG_ OBJ_ACCELERATION_LONG_ERR_035 : 215|8@0+ (0.025,0) [0|6.375] "m/s^2"  ADAS
 SG_ OBJ_ACCELERATION_LAT_ERR_035 : 223|8@0+ (0.025,0) [0|6.375] "m/s^2"  ADAS
 SG_ OBJ_VELOCITY_LONG_ERR_035 : 143|8@0+ (0.05,0) [0|12.75] "m/s"  ADAS
 SG_ OBJ_VELOCITY_LAT_ERR_035 : 151|8@0+ (0.05,0) [0|12.75] "m/s"  ADAS
 SG_ OBJ_POS_LONG_ERR_035 : 95|8@0+ (0.025,0) [0|6.375] "m"  ADAS
 SG_ OBJ_POS_LAT_ERR_035 : 103|8@0+ (0.025,0) [0|6.375] "m"  ADAS
 SG_ OBJ_TRACK_MOTION_MODEL_035 : 9|2@0+ (1,0) [0|3] "NA"  ADAS
 SG_ OBJ_DIMENSION_WIDTH_035 : 17|10@0+ (0.01,0) [0|10.23] "m"  ADAS
 SG_ OBJ_DIMENSION_LENGTH_035 : 37|12@0+ (0.01,0) [0|40.95] "m"  ADAS
 SG_ OBJ_EXISTENCE_PROB_035 : 229|14@0+ (0.0001,0) [0|1] "NA"  ADAS
 SG_ OBJ_YAW_ANGLE_035 : 155|12@0+ (0.005,-10) [-10|10.475] "rad"  ADAS
 SG_ OBJ_YAW_ANGLE_ERR_035 : 175|7@0+ (0.01,0) [0|1.27] "rad"  ADAS
 SG_ OBJ_ID_035 : 7|8@0+ (1,0) [0|255] "NA"  ADAS
 SG_ OBJ_MOVEMENT_STATUS_035 : 196|3@0+ (1,0) [0|3] "NA"  ADAS
 SG_ OBJ_MEASUREMENT_STATUS_035 : 14|3@0+ (1,0) [0|7] "NA"  ADAS
 SG_ OBJ_POS_LONG_035 : 63|16@0+ (0.01,-327) [-327|327] "m"  ADAS
 SG_ OBJ_POS_LAT_035 : 79|16@0+ (0.01,-327) [-327|327] "m"  ADAS
 SG_ OBJ_VELOCITY_LONG_035 : 110|15@0+ (0.01,-163) [-163|163] "m/s"  ADAS
 SG_ OBJ_VELOCITY_LAT_035 : 126|15@0+ (0.01,-163) [-163|163] "m/s"  ADAS
 SG_ OBJ_ACCELERATION_LONG_035 : 193|10@0+ (0.05,-20) [-20|20] "m/s^2"  ADAS
 SG_ OBJ_ACCELERATION_LAT_035 : 177|10@0+ (0.05,-20) [-20|20] "m/s^2"  ADAS
 SG_ OBJ_VEH_TRACK_FLAG_035 : 10|1@0+ (1,0) [0|1] "NA"  ADAS
 SG_ OBJ_MH_CYCLE_COUNTER_035 : 487|8@0+ (1,0) [0|255] "NA"  ADAS
 SG_ OBJ_MH_CRC16_035 : 495|16@0+ (1,0) [0|65535] "NA"  ADAS
 SG_ OBJ_TIMESTAMP_OFFSET_035 : 247|8@0+ (1,-127) [-127|128] "ms"  ADAS
 SG_ OBJ_DIMENSION_WIDTH_ERR_035 : 23|6@0+ (0.01,0) [0|0.63] "m"  ADAS
 SG_ OBJ_DIMENSION_LENGTH_ERR_035 : 41|10@0+ (0.01,0) [0|10.23] "m"  ADAS
 SG_ OBJ_CLS_TYPE1_035 : 271|4@0+ (1,0) [0|15] "NA"  ADAS
 SG_ OBJ_CLS_TYPE1_PROB_035 : 303|8@0+ (0.004,0) [0|1] "NA"  ADAS
 SG_ OBJ_CLS_TYPE2_035 : 267|4@0+ (1,0) [0|15] "NA"  ADAS
 SG_ OBJ_CLS_TYPE2_PROB_035 : 311|8@0+ (0.004,0) [0|1] "NA"  ADAS
 SG_ OBJ_CLS_TYPE3_035 : 279|4@0+ (1,0) [0|15] "NA"  ADAS
 SG_ OBJ_CLS_TYPE3_PROB_035 : 319|8@0+ (0.004,0) [0|1] "NA"  ADAS
 SG_ OBJ_CLS_TYPE4_035 : 275|4@0+ (1,0) [0|15] "NA"  ADAS
 SG_ OBJ_CLS_TYPE4_PROB_035 : 327|8@0+ (0.004,0) [0|1] "NA"  ADAS
 SG_ OBJ_CLS_TYPE5_035 : 287|4@0+ (1,0) [0|15] "NA"  ADAS
 SG_ OBJ_CLS_TYPE5_PROB_035 : 335|8@0+ (0.004,0) [0|1] "NA"  ADAS
 SG_ OBJ_CLS_TYPE6_035 : 282|4@0+ (1,0) [0|15] "NA"  ADAS
 SG_ OBJ_CLS_TYPE6_PROB_035 : 343|8@0+ (0.004,0) [0|1] "NA"  ADAS
 SG_ OBJ_RCS_035 : 351|7@0+ (1,-64) [-64|63] "dBsm"  ADAS
 SG_ OBJ_REF_PT_LONG_OFFSET_035 : 357|14@0+ (0.0001,0) [0|1] "NA"  ADAS
 SG_ OBJ_REF_PT_LAT_OFFSET_035 : 370|14@0+ (0.0001,0) [0|1] "NA"  ADAS
 SG_ OBJ_YAW_RATE_035 : 399|10@0+ (0.005,-2.24) [-2.24|2.24] "rad/s"  ADAS
 SG_ OBJ_YAW_RATE_ERR_035 : 388|5@0+ (0.025,0) [0|0.775] "rad/s"  ADAS
 SG_ OBJ_GROUP_ID_035 : 405|6@0+ (1,0) [0|63] "NA"  ADAS
 SG_ OBJ_POS_ERR_CRR_COEF_035 : 415|8@0+ (0.01,-1.2) [-1.2|1] "NA"  ADAS
 SG_ OBJ_VELOCITY_ERR_CRR_COEF_035 : 423|8@0+ (0.01,-1.2) [-1.2|1] "NA"  ADAS
 SG_ OBJ_ACCEL_ERR_CRR_COEF_035 : 431|8@0+ (0.01,-1.2) [-1.2|1] "NA"  ADAS

BO_ 1395 RDR_TRACKER_OBJ_036: 64 RDR02
 SG_ OBJ_ALIVE_TIME_036 : 255|16@0+ (1,0) [0|65535] "ms"  ADAS
 SG_ OBJ_ACCELERATION_LONG_ERR_036 : 215|8@0+ (0.025,0) [0|6.375] "m/s^2"  ADAS
 SG_ OBJ_ACCELERATION_LAT_ERR_036 : 223|8@0+ (0.025,0) [0|6.375] "m/s^2"  ADAS
 SG_ OBJ_VELOCITY_LONG_ERR_036 : 143|8@0+ (0.05,0) [0|12.75] "m/s"  ADAS
 SG_ OBJ_VELOCITY_LAT_ERR_036 : 151|8@0+ (0.05,0) [0|12.75] "m/s"  ADAS
 SG_ OBJ_POS_LONG_ERR_036 : 95|8@0+ (0.025,0) [0|6.375] "m"  ADAS
 SG_ OBJ_POS_LAT_ERR_036 : 103|8@0+ (0.025,0) [0|6.375] "m"  ADAS
 SG_ OBJ_TRACK_MOTION_MODEL_036 : 9|2@0+ (1,0) [0|3] "NA"  ADAS
 SG_ OBJ_DIMENSION_WIDTH_036 : 17|10@0+ (0.01,0) [0|10.23] "m"  ADAS
 SG_ OBJ_DIMENSION_LENGTH_036 : 37|12@0+ (0.01,0) [0|40.95] "m"  ADAS
 SG_ OBJ_EXISTENCE_PROB_036 : 229|14@0+ (0.0001,0) [0|1] "NA"  ADAS
 SG_ OBJ_YAW_ANGLE_036 : 155|12@0+ (0.005,-10) [-10|10.475] "rad"  ADAS
 SG_ OBJ_YAW_ANGLE_ERR_036 : 175|7@0+ (0.01,0) [0|1.27] "rad"  ADAS
 SG_ OBJ_ID_036 : 7|8@0+ (1,0) [0|255] "NA"  ADAS
 SG_ OBJ_MOVEMENT_STATUS_036 : 196|3@0+ (1,0) [0|3] "NA"  ADAS
 SG_ OBJ_MEASUREMENT_STATUS_036 : 14|3@0+ (1,0) [0|7] "NA"  ADAS
 SG_ OBJ_POS_LONG_036 : 63|16@0+ (0.01,-327) [-327|327] "m"  ADAS
 SG_ OBJ_POS_LAT_036 : 79|16@0+ (0.01,-327) [-327|327] "m"  ADAS
 SG_ OBJ_VELOCITY_LONG_036 : 110|15@0+ (0.01,-163) [-163|163] "m/s"  ADAS
 SG_ OBJ_VELOCITY_LAT_036 : 126|15@0+ (0.01,-163) [-163|163] "m/s"  ADAS
 SG_ OBJ_ACCELERATION_LONG_036 : 193|10@0+ (0.05,-20) [-20|20] "m/s^2"  ADAS
 SG_ OBJ_ACCELERATION_LAT_036 : 177|10@0+ (0.05,-20) [-20|20] "m/s^2"  ADAS
 SG_ OBJ_VEH_TRACK_FLAG_036 : 10|1@0+ (1,0) [0|1] "NA"  ADAS
 SG_ OBJ_MH_CYCLE_COUNTER_036 : 487|8@0+ (1,0) [0|255] "NA"  ADAS
 SG_ OBJ_MH_CRC16_036 : 495|16@0+ (1,0) [0|65535] "NA"  ADAS
 SG_ OBJ_TIMESTAMP_OFFSET_036 : 247|8@0+ (1,-127) [-127|128] "ms"  ADAS
 SG_ OBJ_DIMENSION_WIDTH_ERR_036 : 23|6@0+ (0.01,0) [0|0.63] "m"  ADAS
 SG_ OBJ_DIMENSION_LENGTH_ERR_036 : 41|10@0+ (0.01,0) [0|10.23] "m"  ADAS
 SG_ OBJ_CLS_TYPE1_036 : 271|4@0+ (1,0) [0|15] "NA"  ADAS
 SG_ OBJ_CLS_TYPE1_PROB_036 : 303|8@0+ (0.004,0) [0|1] "NA"  ADAS
 SG_ OBJ_CLS_TYPE2_036 : 267|4@0+ (1,0) [0|15] "NA"  ADAS
 SG_ OBJ_CLS_TYPE2_PROB_036 : 311|8@0+ (0.004,0) [0|1] "NA"  ADAS
 SG_ OBJ_CLS_TYPE3_036 : 279|4@0+ (1,0) [0|15] "NA"  ADAS
 SG_ OBJ_CLS_TYPE3_PROB_036 : 319|8@0+ (0.004,0) [0|1] "NA"  ADAS
 SG_ OBJ_CLS_TYPE4_036 : 275|4@0+ (1,0) [0|15] "NA"  ADAS
 SG_ OBJ_CLS_TYPE4_PROB_036 : 327|8@0+ (0.004,0) [0|1] "NA"  ADAS
 SG_ OBJ_CLS_TYPE5_036 : 287|4@0+ (1,0) [0|15] "NA"  ADAS
 SG_ OBJ_CLS_TYPE5_PROB_036 : 335|8@0+ (0.004,0) [0|1] "NA"  ADAS
 SG_ OBJ_CLS_TYPE6_036 : 282|4@0+ (1,0) [0|15] "NA"  ADAS
 SG_ OBJ_CLS_TYPE6_PROB_036 : 343|8@0+ (0.004,0) [0|1] "NA"  ADAS
 SG_ OBJ_RCS_036 : 351|7@0+ (1,-64) [-64|63] "dBsm"  ADAS
 SG_ OBJ_REF_PT_LONG_OFFSET_036 : 357|14@0+ (0.0001,0) [0|1] "NA"  ADAS
 SG_ OBJ_REF_PT_LAT_OFFSET_036 : 370|14@0+ (0.0001,0) [0|1] "NA"  ADAS
 SG_ OBJ_YAW_RATE_036 : 399|10@0+ (0.005,-2.24) [-2.24|2.24] "rad/s"  ADAS
 SG_ OBJ_YAW_RATE_ERR_036 : 388|5@0+ (0.025,0) [0|0.775] "rad/s"  ADAS
 SG_ OBJ_GROUP_ID_036 : 405|6@0+ (1,0) [0|63] "NA"  ADAS
 SG_ OBJ_POS_ERR_CRR_COEF_036 : 415|8@0+ (0.01,-1.2) [-1.2|1] "NA"  ADAS
 SG_ OBJ_VELOCITY_ERR_CRR_COEF_036 : 423|8@0+ (0.01,-1.2) [-1.2|1] "NA"  ADAS
 SG_ OBJ_ACCEL_ERR_CRR_COEF_036 : 431|8@0+ (0.01,-1.2) [-1.2|1] "NA"  ADAS

BO_ 1396 RDR_TRACKER_OBJ_037: 64 RDR02
 SG_ OBJ_ALIVE_TIME_037 : 255|16@0+ (1,0) [0|65535] "ms"  ADAS
 SG_ OBJ_ACCELERATION_LONG_ERR_037 : 215|8@0+ (0.025,0) [0|6.375] "m/s^2"  ADAS
 SG_ OBJ_ACCELERATION_LAT_ERR_037 : 223|8@0+ (0.025,0) [0|6.375] "m/s^2"  ADAS
 SG_ OBJ_VELOCITY_LONG_ERR_037 : 143|8@0+ (0.05,0) [0|12.75] "m/s"  ADAS
 SG_ OBJ_VELOCITY_LAT_ERR_037 : 151|8@0+ (0.05,0) [0|12.75] "m/s"  ADAS
 SG_ OBJ_POS_LONG_ERR_037 : 95|8@0+ (0.025,0) [0|6.375] "m"  ADAS
 SG_ OBJ_POS_LAT_ERR_037 : 103|8@0+ (0.025,0) [0|6.375] "m"  ADAS
 SG_ OBJ_TRACK_MOTION_MODEL_037 : 9|2@0+ (1,0) [0|3] "NA"  ADAS
 SG_ OBJ_DIMENSION_WIDTH_037 : 17|10@0+ (0.01,0) [0|10.23] "m"  ADAS
 SG_ OBJ_DIMENSION_LENGTH_037 : 37|12@0+ (0.01,0) [0|40.95] "m"  ADAS
 SG_ OBJ_EXISTENCE_PROB_037 : 229|14@0+ (0.0001,0) [0|1] "NA"  ADAS
 SG_ OBJ_YAW_ANGLE_037 : 155|12@0+ (0.005,-10) [-10|10.475] "rad"  ADAS
 SG_ OBJ_YAW_ANGLE_ERR_037 : 175|7@0+ (0.01,0) [0|1.27] "rad"  ADAS
 SG_ OBJ_ID_037 : 7|8@0+ (1,0) [0|255] "NA"  ADAS
 SG_ OBJ_MOVEMENT_STATUS_037 : 196|3@0+ (1,0) [0|3] "NA"  ADAS
 SG_ OBJ_MEASUREMENT_STATUS_037 : 14|3@0+ (1,0) [0|7] "NA"  ADAS
 SG_ OBJ_POS_LONG_037 : 63|16@0+ (0.01,-327) [-327|327] "m"  ADAS
 SG_ OBJ_POS_LAT_037 : 79|16@0+ (0.01,-327) [-327|327] "m"  ADAS
 SG_ OBJ_VELOCITY_LONG_037 : 110|15@0+ (0.01,-163) [-163|163] "m/s"  ADAS
 SG_ OBJ_VELOCITY_LAT_037 : 126|15@0+ (0.01,-163) [-163|163] "m/s"  ADAS
 SG_ OBJ_ACCELERATION_LONG_037 : 193|10@0+ (0.05,-20) [-20|20] "m/s^2"  ADAS
 SG_ OBJ_ACCELERATION_LAT_037 : 177|10@0+ (0.05,-20) [-20|20] "m/s^2"  ADAS
 SG_ OBJ_VEH_TRACK_FLAG_037 : 10|1@0+ (1,0) [0|1] "NA"  ADAS
 SG_ OBJ_MH_CYCLE_COUNTER_037 : 487|8@0+ (1,0) [0|255] "NA"  ADAS
 SG_ OBJ_MH_CRC16_037 : 495|16@0+ (1,0) [0|65535] "NA"  ADAS
 SG_ OBJ_TIMESTAMP_OFFSET_037 : 247|8@0+ (1,-127) [-127|128] "ms"  ADAS
 SG_ OBJ_DIMENSION_WIDTH_ERR_037 : 23|6@0+ (0.01,0) [0|0.63] "m"  ADAS
 SG_ OBJ_DIMENSION_LENGTH_ERR_037 : 41|10@0+ (0.01,0) [0|10.23] "m"  ADAS
 SG_ OBJ_CLS_TYPE1_037 : 271|4@0+ (1,0) [0|15] "NA"  ADAS
 SG_ OBJ_CLS_TYPE1_PROB_037 : 303|8@0+ (0.004,0) [0|1] "NA"  ADAS
 SG_ OBJ_CLS_TYPE2_037 : 267|4@0+ (1,0) [0|15] "NA"  ADAS
 SG_ OBJ_CLS_TYPE2_PROB_037 : 311|8@0+ (0.004,0) [0|1] "NA"  ADAS
 SG_ OBJ_CLS_TYPE3_037 : 279|4@0+ (1,0) [0|15] "NA"  ADAS
 SG_ OBJ_CLS_TYPE3_PROB_037 : 319|8@0+ (0.004,0) [0|1] "NA"  ADAS
 SG_ OBJ_CLS_TYPE4_037 : 275|4@0+ (1,0) [0|15] "NA"  ADAS
 SG_ OBJ_CLS_TYPE4_PROB_037 : 327|8@0+ (0.004,0) [0|1] "NA"  ADAS
 SG_ OBJ_CLS_TYPE5_037 : 287|4@0+ (1,0) [0|15] "NA"  ADAS
 SG_ OBJ_CLS_TYPE5_PROB_037 : 335|8@0+ (0.004,0) [0|1] "NA"  ADAS
 SG_ OBJ_CLS_TYPE6_037 : 282|4@0+ (1,0) [0|15] "NA"  ADAS
 SG_ OBJ_CLS_TYPE6_PROB_037 : 343|8@0+ (0.004,0) [0|1] "NA"  ADAS
 SG_ OBJ_RCS_037 : 351|7@0+ (1,-64) [-64|63] "dBsm"  ADAS
 SG_ OBJ_REF_PT_LONG_OFFSET_037 : 357|14@0+ (0.0001,0) [0|1] "NA"  ADAS
 SG_ OBJ_REF_PT_LAT_OFFSET_037 : 370|14@0+ (0.0001,0) [0|1] "NA"  ADAS
 SG_ OBJ_YAW_RATE_037 : 399|10@0+ (0.005,-2.24) [-2.24|2.24] "rad/s"  ADAS
 SG_ OBJ_YAW_RATE_ERR_037 : 388|5@0+ (0.025,0) [0|0.775] "rad/s"  ADAS
 SG_ OBJ_GROUP_ID_037 : 405|6@0+ (1,0) [0|63] "NA"  ADAS
 SG_ OBJ_POS_ERR_CRR_COEF_037 : 415|8@0+ (0.01,-1.2) [-1.2|1] "NA"  ADAS
 SG_ OBJ_VELOCITY_ERR_CRR_COEF_037 : 423|8@0+ (0.01,-1.2) [-1.2|1] "NA"  ADAS
 SG_ OBJ_ACCEL_ERR_CRR_COEF_037 : 431|8@0+ (0.01,-1.2) [-1.2|1] "NA"  ADAS

BO_ 1397 RDR_TRACKER_OBJ_038: 64 RDR02
 SG_ OBJ_ALIVE_TIME_038 : 255|16@0+ (1,0) [0|65535] "ms"  ADAS
 SG_ OBJ_ACCELERATION_LONG_ERR_038 : 215|8@0+ (0.025,0) [0|6.375] "m/s^2"  ADAS
 SG_ OBJ_ACCELERATION_LAT_ERR_038 : 223|8@0+ (0.025,0) [0|6.375] "m/s^2"  ADAS
 SG_ OBJ_VELOCITY_LONG_ERR_038 : 143|8@0+ (0.05,0) [0|12.75] "m/s"  ADAS
 SG_ OBJ_VELOCITY_LAT_ERR_038 : 151|8@0+ (0.05,0) [0|12.75] "m/s"  ADAS
 SG_ OBJ_POS_LONG_ERR_038 : 95|8@0+ (0.025,0) [0|6.375] "m"  ADAS
 SG_ OBJ_POS_LAT_ERR_038 : 103|8@0+ (0.025,0) [0|6.375] "m"  ADAS
 SG_ OBJ_TRACK_MOTION_MODEL_038 : 9|2@0+ (1,0) [0|3] "NA"  ADAS
 SG_ OBJ_DIMENSION_WIDTH_038 : 17|10@0+ (0.01,0) [0|10.23] "m"  ADAS
 SG_ OBJ_DIMENSION_LENGTH_038 : 37|12@0+ (0.01,0) [0|40.95] "m"  ADAS
 SG_ OBJ_EXISTENCE_PROB_038 : 229|14@0+ (0.0001,0) [0|1] "NA"  ADAS
 SG_ OBJ_YAW_ANGLE_038 : 155|12@0+ (0.005,-10) [-10|10.475] "rad"  ADAS
 SG_ OBJ_YAW_ANGLE_ERR_038 : 175|7@0+ (0.01,0) [0|1.27] "rad"  ADAS
 SG_ OBJ_ID_038 : 7|8@0+ (1,0) [0|255] "NA"  ADAS
 SG_ OBJ_MOVEMENT_STATUS_038 : 196|3@0+ (1,0) [0|3] "NA"  ADAS
 SG_ OBJ_MEASUREMENT_STATUS_038 : 14|3@0+ (1,0) [0|7] "NA"  ADAS
 SG_ OBJ_POS_LONG_038 : 63|16@0+ (0.01,-327) [-327|327] "m"  ADAS
 SG_ OBJ_POS_LAT_038 : 79|16@0+ (0.01,-327) [-327|327] "m"  ADAS
 SG_ OBJ_VELOCITY_LONG_038 : 110|15@0+ (0.01,-163) [-163|163] "m/s"  ADAS
 SG_ OBJ_VELOCITY_LAT_038 : 126|15@0+ (0.01,-163) [-163|163] "m/s"  ADAS
 SG_ OBJ_ACCELERATION_LONG_038 : 193|10@0+ (0.05,-20) [-20|20] "m/s^2"  ADAS
 SG_ OBJ_ACCELERATION_LAT_038 : 177|10@0+ (0.05,-20) [-20|20] "m/s^2"  ADAS
 SG_ OBJ_VEH_TRACK_FLAG_038 : 10|1@0+ (1,0) [0|1] "NA"  ADAS
 SG_ OBJ_MH_CYCLE_COUNTER_038 : 487|8@0+ (1,0) [0|255] "NA"  ADAS
 SG_ OBJ_MH_CRC16_038 : 495|16@0+ (1,0) [0|65535] "NA"  ADAS
 SG_ OBJ_TIMESTAMP_OFFSET_038 : 247|8@0+ (1,-127) [-127|128] "ms"  ADAS
 SG_ OBJ_DIMENSION_WIDTH_ERR_038 : 23|6@0+ (0.01,0) [0|0.63] "m"  ADAS
 SG_ OBJ_DIMENSION_LENGTH_ERR_038 : 41|10@0+ (0.01,0) [0|10.23] "m"  ADAS
 SG_ OBJ_CLS_TYPE1_038 : 271|4@0+ (1,0) [0|15] "NA"  ADAS
 SG_ OBJ_CLS_TYPE1_PROB_038 : 303|8@0+ (0.004,0) [0|1] "NA"  ADAS
 SG_ OBJ_CLS_TYPE2_038 : 267|4@0+ (1,0) [0|15] "NA"  ADAS
 SG_ OBJ_CLS_TYPE2_PROB_038 : 311|8@0+ (0.004,0) [0|1] "NA"  ADAS
 SG_ OBJ_CLS_TYPE3_038 : 279|4@0+ (1,0) [0|15] "NA"  ADAS
 SG_ OBJ_CLS_TYPE3_PROB_038 : 319|8@0+ (0.004,0) [0|1] "NA"  ADAS
 SG_ OBJ_CLS_TYPE4_038 : 275|4@0+ (1,0) [0|15] "NA"  ADAS
 SG_ OBJ_CLS_TYPE4_PROB_038 : 327|8@0+ (0.004,0) [0|1] "NA"  ADAS
 SG_ OBJ_CLS_TYPE5_038 : 287|4@0+ (1,0) [0|15] "NA"  ADAS
 SG_ OBJ_CLS_TYPE5_PROB_038 : 335|8@0+ (0.004,0) [0|1] "NA"  ADAS
 SG_ OBJ_CLS_TYPE6_038 : 282|4@0+ (1,0) [0|15] "NA"  ADAS
 SG_ OBJ_CLS_TYPE6_PROB_038 : 343|8@0+ (0.004,0) [0|1] "NA"  ADAS
 SG_ OBJ_RCS_038 : 351|7@0+ (1,-64) [-64|63] "dBsm"  ADAS
 SG_ OBJ_REF_PT_LONG_OFFSET_038 : 357|14@0+ (0.0001,0) [0|1] "NA"  ADAS
 SG_ OBJ_REF_PT_LAT_OFFSET_038 : 370|14@0+ (0.0001,0) [0|1] "NA"  ADAS
 SG_ OBJ_YAW_RATE_038 : 399|10@0+ (0.005,-2.24) [-2.24|2.24] "rad/s"  ADAS
 SG_ OBJ_YAW_RATE_ERR_038 : 388|5@0+ (0.025,0) [0|0.775] "rad/s"  ADAS
 SG_ OBJ_GROUP_ID_038 : 405|6@0+ (1,0) [0|63] "NA"  ADAS
 SG_ OBJ_POS_ERR_CRR_COEF_038 : 415|8@0+ (0.01,-1.2) [-1.2|1] "NA"  ADAS
 SG_ OBJ_VELOCITY_ERR_CRR_COEF_038 : 423|8@0+ (0.01,-1.2) [-1.2|1] "NA"  ADAS
 SG_ OBJ_ACCEL_ERR_CRR_COEF_038 : 431|8@0+ (0.01,-1.2) [-1.2|1] "NA"  ADAS

BO_ 1398 RDR_TRACKER_OBJ_039: 64 RDR02
 SG_ OBJ_ALIVE_TIME_039 : 255|16@0+ (1,0) [0|65535] "ms"  ADAS
 SG_ OBJ_ACCELERATION_LONG_ERR_039 : 215|8@0+ (0.025,0) [0|6.375] "m/s^2"  ADAS
 SG_ OBJ_ACCELERATION_LAT_ERR_039 : 223|8@0+ (0.025,0) [0|6.375] "m/s^2"  ADAS
 SG_ OBJ_VELOCITY_LONG_ERR_039 : 143|8@0+ (0.05,0) [0|12.75] "m/s"  ADAS
 SG_ OBJ_VELOCITY_LAT_ERR_039 : 151|8@0+ (0.05,0) [0|12.75] "m/s"  ADAS
 SG_ OBJ_POS_LONG_ERR_039 : 95|8@0+ (0.025,0) [0|6.375] "m"  ADAS
 SG_ OBJ_POS_LAT_ERR_039 : 103|8@0+ (0.025,0) [0|6.375] "m"  ADAS
 SG_ OBJ_TRACK_MOTION_MODEL_039 : 9|2@0+ (1,0) [0|3] "NA"  ADAS
 SG_ OBJ_DIMENSION_WIDTH_039 : 17|10@0+ (0.01,0) [0|10.23] "m"  ADAS
 SG_ OBJ_DIMENSION_LENGTH_039 : 37|12@0+ (0.01,0) [0|40.95] "m"  ADAS
 SG_ OBJ_EXISTENCE_PROB_039 : 229|14@0+ (0.0001,0) [0|1] "NA"  ADAS
 SG_ OBJ_YAW_ANGLE_039 : 155|12@0+ (0.005,-10) [-10|10.475] "rad"  ADAS
 SG_ OBJ_YAW_ANGLE_ERR_039 : 175|7@0+ (0.01,0) [0|1.27] "rad"  ADAS
 SG_ OBJ_ID_039 : 7|8@0+ (1,0) [0|255] "NA"  ADAS
 SG_ OBJ_MOVEMENT_STATUS_039 : 196|3@0+ (1,0) [0|3] "NA"  ADAS
 SG_ OBJ_MEASUREMENT_STATUS_039 : 14|3@0+ (1,0) [0|7] "NA"  ADAS
 SG_ OBJ_POS_LONG_039 : 63|16@0+ (0.01,-327) [-327|327] "m"  ADAS
 SG_ OBJ_POS_LAT_039 : 79|16@0+ (0.01,-327) [-327|327] "m"  ADAS
 SG_ OBJ_VELOCITY_LONG_039 : 110|15@0+ (0.01,-163) [-163|163] "m/s"  ADAS
 SG_ OBJ_VELOCITY_LAT_039 : 126|15@0+ (0.01,-163) [-163|163] "m/s"  ADAS
 SG_ OBJ_ACCELERATION_LONG_039 : 193|10@0+ (0.05,-20) [-20|20] "m/s^2"  ADAS
 SG_ OBJ_ACCELERATION_LAT_039 : 177|10@0+ (0.05,-20) [-20|20] "m/s^2"  ADAS
 SG_ OBJ_VEH_TRACK_FLAG_039 : 10|1@0+ (1,0) [0|1] "NA"  ADAS
 SG_ OBJ_MH_CYCLE_COUNTER_039 : 487|8@0+ (1,0) [0|255] "NA"  ADAS
 SG_ OBJ_MH_CRC16_039 : 495|16@0+ (1,0) [0|65535] "NA"  ADAS
 SG_ OBJ_TIMESTAMP_OFFSET_039 : 247|8@0+ (1,-127) [-127|128] "ms"  ADAS
 SG_ OBJ_DIMENSION_WIDTH_ERR_039 : 23|6@0+ (0.01,0) [0|0.63] "m"  ADAS
 SG_ OBJ_DIMENSION_LENGTH_ERR_039 : 41|10@0+ (0.01,0) [0|10.23] "m"  ADAS
 SG_ OBJ_CLS_TYPE1_039 : 271|4@0+ (1,0) [0|15] "NA"  ADAS
 SG_ OBJ_CLS_TYPE1_PROB_039 : 303|8@0+ (0.004,0) [0|1] "NA"  ADAS
 SG_ OBJ_CLS_TYPE2_039 : 267|4@0+ (1,0) [0|15] "NA"  ADAS
 SG_ OBJ_CLS_TYPE2_PROB_039 : 311|8@0+ (0.004,0) [0|1] "NA"  ADAS
 SG_ OBJ_CLS_TYPE3_039 : 279|4@0+ (1,0) [0|15] "NA"  ADAS
 SG_ OBJ_CLS_TYPE3_PROB_039 : 319|8@0+ (0.004,0) [0|1] "NA"  ADAS
 SG_ OBJ_CLS_TYPE4_039 : 275|4@0+ (1,0) [0|15] "NA"  ADAS
 SG_ OBJ_CLS_TYPE4_PROB_039 : 327|8@0+ (0.004,0) [0|1] "NA"  ADAS
 SG_ OBJ_CLS_TYPE5_039 : 287|4@0+ (1,0) [0|15] "NA"  ADAS
 SG_ OBJ_CLS_TYPE5_PROB_039 : 335|8@0+ (0.004,0) [0|1] "NA"  ADAS
 SG_ OBJ_CLS_TYPE6_039 : 282|4@0+ (1,0) [0|15] "NA"  ADAS
 SG_ OBJ_CLS_TYPE6_PROB_039 : 343|8@0+ (0.004,0) [0|1] "NA"  ADAS
 SG_ OBJ_RCS_039 : 351|7@0+ (1,-64) [-64|63] "dBsm"  ADAS
 SG_ OBJ_REF_PT_LONG_OFFSET_039 : 357|14@0+ (0.0001,0) [0|1] "NA"  ADAS
 SG_ OBJ_REF_PT_LAT_OFFSET_039 : 370|14@0+ (0.0001,0) [0|1] "NA"  ADAS
 SG_ OBJ_YAW_RATE_039 : 399|10@0+ (0.005,-2.24) [-2.24|2.24] "rad/s"  ADAS
 SG_ OBJ_YAW_RATE_ERR_039 : 388|5@0+ (0.025,0) [0|0.775] "rad/s"  ADAS
 SG_ OBJ_GROUP_ID_039 : 405|6@0+ (1,0) [0|63] "NA"  ADAS
 SG_ OBJ_POS_ERR_CRR_COEF_039 : 415|8@0+ (0.01,-1.2) [-1.2|1] "NA"  ADAS
 SG_ OBJ_VELOCITY_ERR_CRR_COEF_039 : 423|8@0+ (0.01,-1.2) [-1.2|1] "NA"  ADAS
 SG_ OBJ_ACCEL_ERR_CRR_COEF_039 : 431|8@0+ (0.01,-1.2) [-1.2|1] "NA"  ADAS

BO_ 1399 RDR_TRACKER_OBJ_040: 64 RDR02
 SG_ OBJ_ALIVE_TIME_040 : 255|16@0+ (1,0) [0|65535] "ms"  ADAS
 SG_ OBJ_ACCELERATION_LONG_ERR_040 : 215|8@0+ (0.025,0) [0|6.375] "m/s^2"  ADAS
 SG_ OBJ_ACCELERATION_LAT_ERR_040 : 223|8@0+ (0.025,0) [0|6.375] "m/s^2"  ADAS
 SG_ OBJ_VELOCITY_LONG_ERR_040 : 143|8@0+ (0.05,0) [0|12.75] "m/s"  ADAS
 SG_ OBJ_VELOCITY_LAT_ERR_040 : 151|8@0+ (0.05,0) [0|12.75] "m/s"  ADAS
 SG_ OBJ_POS_LONG_ERR_040 : 95|8@0+ (0.025,0) [0|6.375] "m"  ADAS
 SG_ OBJ_POS_LAT_ERR_040 : 103|8@0+ (0.025,0) [0|6.375] "m"  ADAS
 SG_ OBJ_TRACK_MOTION_MODEL_040 : 9|2@0+ (1,0) [0|3] "NA"  ADAS
 SG_ OBJ_DIMENSION_WIDTH_040 : 17|10@0+ (0.01,0) [0|10.23] "m"  ADAS
 SG_ OBJ_DIMENSION_LENGTH_040 : 37|12@0+ (0.01,0) [0|40.95] "m"  ADAS
 SG_ OBJ_EXISTENCE_PROB_040 : 229|14@0+ (0.0001,0) [0|1] "NA"  ADAS
 SG_ OBJ_YAW_ANGLE_040 : 155|12@0+ (0.005,-10) [-10|10.475] "rad"  ADAS
 SG_ OBJ_YAW_ANGLE_ERR_040 : 175|7@0+ (0.01,0) [0|1.27] "rad"  ADAS
 SG_ OBJ_ID_040 : 7|8@0+ (1,0) [0|255] "NA"  ADAS
 SG_ OBJ_MOVEMENT_STATUS_040 : 196|3@0+ (1,0) [0|3] "NA"  ADAS
 SG_ OBJ_MEASUREMENT_STATUS_040 : 14|3@0+ (1,0) [0|7] "NA"  ADAS
 SG_ OBJ_POS_LONG_040 : 63|16@0+ (0.01,-327) [-327|327] "m"  ADAS
 SG_ OBJ_POS_LAT_040 : 79|16@0+ (0.01,-327) [-327|327] "m"  ADAS
 SG_ OBJ_VELOCITY_LONG_040 : 110|15@0+ (0.01,-163) [-163|163] "m/s"  ADAS
 SG_ OBJ_VELOCITY_LAT_040 : 126|15@0+ (0.01,-163) [-163|163] "m/s"  ADAS
 SG_ OBJ_ACCELERATION_LONG_040 : 193|10@0+ (0.05,-20) [-20|20] "m/s^2"  ADAS
 SG_ OBJ_ACCELERATION_LAT_040 : 177|10@0+ (0.05,-20) [-20|20] "m/s^2"  ADAS
 SG_ OBJ_VEH_TRACK_FLAG_040 : 10|1@0+ (1,0) [0|1] "NA"  ADAS
 SG_ OBJ_MH_CYCLE_COUNTER_040 : 487|8@0+ (1,0) [0|255] "NA"  ADAS
 SG_ OBJ_MH_CRC16_040 : 495|16@0+ (1,0) [0|65535] "NA"  ADAS
 SG_ OBJ_TIMESTAMP_OFFSET_040 : 247|8@0+ (1,-127) [-127|128] "ms"  ADAS
 SG_ OBJ_DIMENSION_WIDTH_ERR_040 : 23|6@0+ (0.01,0) [0|0.63] "m"  ADAS
 SG_ OBJ_DIMENSION_LENGTH_ERR_040 : 41|10@0+ (0.01,0) [0|10.23] "m"  ADAS
 SG_ OBJ_CLS_TYPE1_040 : 271|4@0+ (1,0) [0|15] "NA"  ADAS
 SG_ OBJ_CLS_TYPE1_PROB_040 : 303|8@0+ (0.004,0) [0|1] "NA"  ADAS
 SG_ OBJ_CLS_TYPE2_040 : 267|4@0+ (1,0) [0|15] "NA"  ADAS
 SG_ OBJ_CLS_TYPE2_PROB_040 : 311|8@0+ (0.004,0) [0|1] "NA"  ADAS
 SG_ OBJ_CLS_TYPE3_040 : 279|4@0+ (1,0) [0|15] "NA"  ADAS
 SG_ OBJ_CLS_TYPE3_PROB_040 : 319|8@0+ (0.004,0) [0|1] "NA"  ADAS
 SG_ OBJ_CLS_TYPE4_040 : 275|4@0+ (1,0) [0|15] "NA"  ADAS
 SG_ OBJ_CLS_TYPE4_PROB_040 : 327|8@0+ (0.004,0) [0|1] "NA"  ADAS
 SG_ OBJ_CLS_TYPE5_040 : 287|4@0+ (1,0) [0|15] "NA"  ADAS
 SG_ OBJ_CLS_TYPE5_PROB_040 : 335|8@0+ (0.004,0) [0|1] "NA"  ADAS
 SG_ OBJ_CLS_TYPE6_040 : 282|4@0+ (1,0) [0|15] "NA"  ADAS
 SG_ OBJ_CLS_TYPE6_PROB_040 : 343|8@0+ (0.004,0) [0|1] "NA"  ADAS
 SG_ OBJ_RCS_040 : 351|7@0+ (1,-64) [-64|63] "dBsm"  ADAS
 SG_ OBJ_REF_PT_LONG_OFFSET_040 : 357|14@0+ (0.0001,0) [0|1] "NA"  ADAS
 SG_ OBJ_REF_PT_LAT_OFFSET_040 : 370|14@0+ (0.0001,0) [0|1] "NA"  ADAS
 SG_ OBJ_YAW_RATE_040 : 399|10@0+ (0.005,-2.24) [-2.24|2.24] "rad/s"  ADAS
 SG_ OBJ_YAW_RATE_ERR_040 : 388|5@0+ (0.025,0) [0|0.775] "rad/s"  ADAS
 SG_ OBJ_GROUP_ID_040 : 405|6@0+ (1,0) [0|63] "NA"  ADAS
 SG_ OBJ_POS_ERR_CRR_COEF_040 : 415|8@0+ (0.01,-1.2) [-1.2|1] "NA"  ADAS
 SG_ OBJ_VELOCITY_ERR_CRR_COEF_040 : 423|8@0+ (0.01,-1.2) [-1.2|1] "NA"  ADAS
 SG_ OBJ_ACCEL_ERR_CRR_COEF_040 : 431|8@0+ (0.01,-1.2) [-1.2|1] "NA"  ADAS

BO_ 1400 RDR_TRACKER_OBJ_041: 64 RDR02
 SG_ OBJ_ALIVE_TIME_041 : 255|16@0+ (1,0) [0|65535] "ms"  ADAS
 SG_ OBJ_ACCELERATION_LONG_ERR_041 : 215|8@0+ (0.025,0) [0|6.375] "m/s^2"  ADAS
 SG_ OBJ_ACCELERATION_LAT_ERR_041 : 223|8@0+ (0.025,0) [0|6.375] "m/s^2"  ADAS
 SG_ OBJ_VELOCITY_LONG_ERR_041 : 143|8@0+ (0.05,0) [0|12.75] "m/s"  ADAS
 SG_ OBJ_VELOCITY_LAT_ERR_041 : 151|8@0+ (0.05,0) [0|12.75] "m/s"  ADAS
 SG_ OBJ_POS_LONG_ERR_041 : 95|8@0+ (0.025,0) [0|6.375] "m"  ADAS
 SG_ OBJ_POS_LAT_ERR_041 : 103|8@0+ (0.025,0) [0|6.375] "m"  ADAS
 SG_ OBJ_TRACK_MOTION_MODEL_041 : 9|2@0+ (1,0) [0|3] "NA"  ADAS
 SG_ OBJ_DIMENSION_WIDTH_041 : 17|10@0+ (0.01,0) [0|10.23] "m"  ADAS
 SG_ OBJ_DIMENSION_LENGTH_041 : 37|12@0+ (0.01,0) [0|40.95] "m"  ADAS
 SG_ OBJ_EXISTENCE_PROB_041 : 229|14@0+ (0.0001,0) [0|1] "NA"  ADAS
 SG_ OBJ_YAW_ANGLE_041 : 155|12@0+ (0.005,-10) [-10|10.475] "rad"  ADAS
 SG_ OBJ_YAW_ANGLE_ERR_041 : 175|7@0+ (0.01,0) [0|1.27] "rad"  ADAS
 SG_ OBJ_ID_041 : 7|8@0+ (1,0) [0|255] "NA"  ADAS
 SG_ OBJ_MOVEMENT_STATUS_041 : 196|3@0+ (1,0) [0|3] "NA"  ADAS
 SG_ OBJ_MEASUREMENT_STATUS_041 : 14|3@0+ (1,0) [0|7] "NA"  ADAS
 SG_ OBJ_POS_LONG_041 : 63|16@0+ (0.01,-327) [-327|327] "m"  ADAS
 SG_ OBJ_POS_LAT_041 : 79|16@0+ (0.01,-327) [-327|327] "m"  ADAS
 SG_ OBJ_VELOCITY_LONG_041 : 110|15@0+ (0.01,-163) [-163|163] "m/s"  ADAS
 SG_ OBJ_VELOCITY_LAT_041 : 126|15@0+ (0.01,-163) [-163|163] "m/s"  ADAS
 SG_ OBJ_ACCELERATION_LONG_041 : 193|10@0+ (0.05,-20) [-20|20] "m/s^2"  ADAS
 SG_ OBJ_ACCELERATION_LAT_041 : 177|10@0+ (0.05,-20) [-20|20] "m/s^2"  ADAS
 SG_ OBJ_VEH_TRACK_FLAG_041 : 10|1@0+ (1,0) [0|1] "NA"  ADAS
 SG_ OBJ_MH_CYCLE_COUNTER_041 : 487|8@0+ (1,0) [0|255] "NA"  ADAS
 SG_ OBJ_MH_CRC16_041 : 495|16@0+ (1,0) [0|65535] "NA"  ADAS
 SG_ OBJ_TIMESTAMP_OFFSET_041 : 247|8@0+ (1,-127) [-127|128] "ms"  ADAS
 SG_ OBJ_DIMENSION_WIDTH_ERR_041 : 23|6@0+ (0.01,0) [0|0.63] "m"  ADAS
 SG_ OBJ_DIMENSION_LENGTH_ERR_041 : 41|10@0+ (0.01,0) [0|10.23] "m"  ADAS
 SG_ OBJ_CLS_TYPE1_041 : 271|4@0+ (1,0) [0|15] "NA"  ADAS
 SG_ OBJ_CLS_TYPE1_PROB_041 : 303|8@0+ (0.004,0) [0|1] "NA"  ADAS
 SG_ OBJ_CLS_TYPE2_041 : 267|4@0+ (1,0) [0|15] "NA"  ADAS
 SG_ OBJ_CLS_TYPE2_PROB_041 : 311|8@0+ (0.004,0) [0|1] "NA"  ADAS
 SG_ OBJ_CLS_TYPE3_041 : 279|4@0+ (1,0) [0|15] "NA"  ADAS
 SG_ OBJ_CLS_TYPE3_PROB_041 : 319|8@0+ (0.004,0) [0|1] "NA"  ADAS
 SG_ OBJ_CLS_TYPE4_041 : 275|4@0+ (1,0) [0|15] "NA"  ADAS
 SG_ OBJ_CLS_TYPE4_PROB_041 : 327|8@0+ (0.004,0) [0|1] "NA"  ADAS
 SG_ OBJ_CLS_TYPE5_041 : 287|4@0+ (1,0) [0|15] "NA"  ADAS
 SG_ OBJ_CLS_TYPE5_PROB_041 : 335|8@0+ (0.004,0) [0|1] "NA"  ADAS
 SG_ OBJ_CLS_TYPE6_041 : 282|4@0+ (1,0) [0|15] "NA"  ADAS
 SG_ OBJ_CLS_TYPE6_PROB_041 : 343|8@0+ (0.004,0) [0|1] "NA"  ADAS
 SG_ OBJ_RCS_041 : 351|7@0+ (1,-64) [-64|63] "dBsm"  ADAS
 SG_ OBJ_REF_PT_LONG_OFFSET_041 : 357|14@0+ (0.0001,0) [0|1] "NA"  ADAS
 SG_ OBJ_REF_PT_LAT_OFFSET_041 : 370|14@0+ (0.0001,0) [0|1] "NA"  ADAS
 SG_ OBJ_YAW_RATE_041 : 399|10@0+ (0.005,-2.24) [-2.24|2.24] "rad/s"  ADAS
 SG_ OBJ_YAW_RATE_ERR_041 : 388|5@0+ (0.025,0) [0|0.775] "rad/s"  ADAS
 SG_ OBJ_GROUP_ID_041 : 405|6@0+ (1,0) [0|63] "NA"  ADAS
 SG_ OBJ_POS_ERR_CRR_COEF_041 : 415|8@0+ (0.01,-1.2) [-1.2|1] "NA"  ADAS
 SG_ OBJ_VELOCITY_ERR_CRR_COEF_041 : 423|8@0+ (0.01,-1.2) [-1.2|1] "NA"  ADAS
 SG_ OBJ_ACCEL_ERR_CRR_COEF_041 : 431|8@0+ (0.01,-1.2) [-1.2|1] "NA"  ADAS

BO_ 1401 RDR_TRACKER_OBJ_042: 64 RDR02
 SG_ OBJ_ALIVE_TIME_042 : 255|16@0+ (1,0) [0|65535] "ms"  ADAS
 SG_ OBJ_ACCELERATION_LONG_ERR_042 : 215|8@0+ (0.025,0) [0|6.375] "m/s^2"  ADAS
 SG_ OBJ_ACCELERATION_LAT_ERR_042 : 223|8@0+ (0.025,0) [0|6.375] "m/s^2"  ADAS
 SG_ OBJ_VELOCITY_LONG_ERR_042 : 143|8@0+ (0.05,0) [0|12.75] "m/s"  ADAS
 SG_ OBJ_VELOCITY_LAT_ERR_042 : 151|8@0+ (0.05,0) [0|12.75] "m/s"  ADAS
 SG_ OBJ_POS_LONG_ERR_042 : 95|8@0+ (0.025,0) [0|6.375] "m"  ADAS
 SG_ OBJ_POS_LAT_ERR_042 : 103|8@0+ (0.025,0) [0|6.375] "m"  ADAS
 SG_ OBJ_TRACK_MOTION_MODEL_042 : 9|2@0+ (1,0) [0|3] "NA"  ADAS
 SG_ OBJ_DIMENSION_WIDTH_042 : 17|10@0+ (0.01,0) [0|10.23] "m"  ADAS
 SG_ OBJ_DIMENSION_LENGTH_042 : 37|12@0+ (0.01,0) [0|40.95] "m"  ADAS
 SG_ OBJ_EXISTENCE_PROB_042 : 229|14@0+ (0.0001,0) [0|1] "NA"  ADAS
 SG_ OBJ_YAW_ANGLE_042 : 155|12@0+ (0.005,-10) [-10|10.475] "rad"  ADAS
 SG_ OBJ_YAW_ANGLE_ERR_042 : 175|7@0+ (0.01,0) [0|1.27] "rad"  ADAS
 SG_ OBJ_ID_042 : 7|8@0+ (1,0) [0|255] "NA"  ADAS
 SG_ OBJ_MOVEMENT_STATUS_042 : 196|3@0+ (1,0) [0|3] "NA"  ADAS
 SG_ OBJ_MEASUREMENT_STATUS_042 : 14|3@0+ (1,0) [0|7] "NA"  ADAS
 SG_ OBJ_POS_LONG_042 : 63|16@0+ (0.01,-327) [-327|327] "m"  ADAS
 SG_ OBJ_POS_LAT_042 : 79|16@0+ (0.01,-327) [-327|327] "m"  ADAS
 SG_ OBJ_VELOCITY_LONG_042 : 110|15@0+ (0.01,-163) [-163|163] "m/s"  ADAS
 SG_ OBJ_VELOCITY_LAT_042 : 126|15@0+ (0.01,-163) [-163|163] "m/s"  ADAS
 SG_ OBJ_ACCELERATION_LONG_042 : 193|10@0+ (0.05,-20) [-20|20] "m/s^2"  ADAS
 SG_ OBJ_ACCELERATION_LAT_042 : 177|10@0+ (0.05,-20) [-20|20] "m/s^2"  ADAS
 SG_ OBJ_VEH_TRACK_FLAG_042 : 10|1@0+ (1,0) [0|1] "NA"  ADAS
 SG_ OBJ_MH_CYCLE_COUNTER_042 : 487|8@0+ (1,0) [0|255] "NA"  ADAS
 SG_ OBJ_MH_CRC16_042 : 495|16@0+ (1,0) [0|65535] "NA"  ADAS
 SG_ OBJ_TIMESTAMP_OFFSET_042 : 247|8@0+ (1,-127) [-127|128] "ms"  ADAS
 SG_ OBJ_DIMENSION_WIDTH_ERR_042 : 23|6@0+ (0.01,0) [0|0.63] "m"  ADAS
 SG_ OBJ_DIMENSION_LENGTH_ERR_042 : 41|10@0+ (0.01,0) [0|10.23] "m"  ADAS
 SG_ OBJ_CLS_TYPE1_042 : 271|4@0+ (1,0) [0|15] "NA"  ADAS
 SG_ OBJ_CLS_TYPE1_PROB_042 : 303|8@0+ (0.004,0) [0|1] "NA"  ADAS
 SG_ OBJ_CLS_TYPE2_042 : 267|4@0+ (1,0) [0|15] "NA"  ADAS
 SG_ OBJ_CLS_TYPE2_PROB_042 : 311|8@0+ (0.004,0) [0|1] "NA"  ADAS
 SG_ OBJ_CLS_TYPE3_042 : 279|4@0+ (1,0) [0|15] "NA"  ADAS
 SG_ OBJ_CLS_TYPE3_PROB_042 : 319|8@0+ (0.004,0) [0|1] "NA"  ADAS
 SG_ OBJ_CLS_TYPE4_042 : 275|4@0+ (1,0) [0|15] "NA"  ADAS
 SG_ OBJ_CLS_TYPE4_PROB_042 : 327|8@0+ (0.004,0) [0|1] "NA"  ADAS
 SG_ OBJ_CLS_TYPE5_042 : 287|4@0+ (1,0) [0|15] "NA"  ADAS
 SG_ OBJ_CLS_TYPE5_PROB_042 : 335|8@0+ (0.004,0) [0|1] "NA"  ADAS
 SG_ OBJ_CLS_TYPE6_042 : 282|4@0+ (1,0) [0|15] "NA"  ADAS
 SG_ OBJ_CLS_TYPE6_PROB_042 : 343|8@0+ (0.004,0) [0|1] "NA"  ADAS
 SG_ OBJ_RCS_042 : 351|7@0+ (1,-64) [-64|63] "dBsm"  ADAS
 SG_ OBJ_REF_PT_LONG_OFFSET_042 : 357|14@0+ (0.0001,0) [0|1] "NA"  ADAS
 SG_ OBJ_REF_PT_LAT_OFFSET_042 : 370|14@0+ (0.0001,0) [0|1] "NA"  ADAS
 SG_ OBJ_YAW_RATE_042 : 399|10@0+ (0.005,-2.24) [-2.24|2.24] "rad/s"  ADAS
 SG_ OBJ_YAW_RATE_ERR_042 : 388|5@0+ (0.025,0) [0|0.775] "rad/s"  ADAS
 SG_ OBJ_GROUP_ID_042 : 405|6@0+ (1,0) [0|63] "NA"  ADAS
 SG_ OBJ_POS_ERR_CRR_COEF_042 : 415|8@0+ (0.01,-1.2) [-1.2|1] "NA"  ADAS
 SG_ OBJ_VELOCITY_ERR_CRR_COEF_042 : 423|8@0+ (0.01,-1.2) [-1.2|1] "NA"  ADAS
 SG_ OBJ_ACCEL_ERR_CRR_COEF_042 : 431|8@0+ (0.01,-1.2) [-1.2|1] "NA"  ADAS

BO_ 1402 RDR_TRACKER_OBJ_043: 64 RDR02
 SG_ OBJ_ALIVE_TIME_043 : 255|16@0+ (1,0) [0|65535] "ms"  ADAS
 SG_ OBJ_ACCELERATION_LONG_ERR_043 : 215|8@0+ (0.025,0) [0|6.375] "m/s^2"  ADAS
 SG_ OBJ_ACCELERATION_LAT_ERR_043 : 223|8@0+ (0.025,0) [0|6.375] "m/s^2"  ADAS
 SG_ OBJ_VELOCITY_LONG_ERR_043 : 143|8@0+ (0.05,0) [0|12.75] "m/s"  ADAS
 SG_ OBJ_VELOCITY_LAT_ERR_043 : 151|8@0+ (0.05,0) [0|12.75] "m/s"  ADAS
 SG_ OBJ_POS_LONG_ERR_043 : 95|8@0+ (0.025,0) [0|6.375] "m"  ADAS
 SG_ OBJ_POS_LAT_ERR_043 : 103|8@0+ (0.025,0) [0|6.375] "m"  ADAS
 SG_ OBJ_TRACK_MOTION_MODEL_043 : 9|2@0+ (1,0) [0|3] "NA"  ADAS
 SG_ OBJ_DIMENSION_WIDTH_043 : 17|10@0+ (0.01,0) [0|10.23] "m"  ADAS
 SG_ OBJ_DIMENSION_LENGTH_043 : 37|12@0+ (0.01,0) [0|40.95] "m"  ADAS
 SG_ OBJ_EXISTENCE_PROB_043 : 229|14@0+ (0.0001,0) [0|1] "NA"  ADAS
 SG_ OBJ_YAW_ANGLE_043 : 155|12@0+ (0.005,-10) [-10|10.475] "rad"  ADAS
 SG_ OBJ_YAW_ANGLE_ERR_043 : 175|7@0+ (0.01,0) [0|1.27] "rad"  ADAS
 SG_ OBJ_ID_043 : 7|8@0+ (1,0) [0|255] "NA"  ADAS
 SG_ OBJ_MOVEMENT_STATUS_043 : 196|3@0+ (1,0) [0|3] "NA"  ADAS
 SG_ OBJ_MEASUREMENT_STATUS_043 : 14|3@0+ (1,0) [0|7] "NA"  ADAS
 SG_ OBJ_POS_LONG_043 : 63|16@0+ (0.01,-327) [-327|327] "m"  ADAS
 SG_ OBJ_POS_LAT_043 : 79|16@0+ (0.01,-327) [-327|327] "m"  ADAS
 SG_ OBJ_VELOCITY_LONG_043 : 110|15@0+ (0.01,-163) [-163|163] "m/s"  ADAS
 SG_ OBJ_VELOCITY_LAT_043 : 126|15@0+ (0.01,-163) [-163|163] "m/s"  ADAS
 SG_ OBJ_ACCELERATION_LONG_043 : 193|10@0+ (0.05,-20) [-20|20] "m/s^2"  ADAS
 SG_ OBJ_ACCELERATION_LAT_043 : 177|10@0+ (0.05,-20) [-20|20] "m/s^2"  ADAS
 SG_ OBJ_VEH_TRACK_FLAG_043 : 10|1@0+ (1,0) [0|1] "NA"  ADAS
 SG_ OBJ_MH_CYCLE_COUNTER_043 : 487|8@0+ (1,0) [0|255] "NA"  ADAS
 SG_ OBJ_MH_CRC16_043 : 495|16@0+ (1,0) [0|65535] "NA"  ADAS
 SG_ OBJ_TIMESTAMP_OFFSET_043 : 247|8@0+ (1,-127) [-127|128] "ms"  ADAS
 SG_ OBJ_DIMENSION_WIDTH_ERR_043 : 23|6@0+ (0.01,0) [0|0.63] "m"  ADAS
 SG_ OBJ_DIMENSION_LENGTH_ERR_043 : 41|10@0+ (0.01,0) [0|10.23] "m"  ADAS
 SG_ OBJ_CLS_TYPE1_043 : 271|4@0+ (1,0) [0|15] "NA"  ADAS
 SG_ OBJ_CLS_TYPE1_PROB_043 : 303|8@0+ (0.004,0) [0|1] "NA"  ADAS
 SG_ OBJ_CLS_TYPE2_043 : 267|4@0+ (1,0) [0|15] "NA"  ADAS
 SG_ OBJ_CLS_TYPE2_PROB_043 : 311|8@0+ (0.004,0) [0|1] "NA"  ADAS
 SG_ OBJ_CLS_TYPE3_043 : 279|4@0+ (1,0) [0|15] "NA"  ADAS
 SG_ OBJ_CLS_TYPE3_PROB_043 : 319|8@0+ (0.004,0) [0|1] "NA"  ADAS
 SG_ OBJ_CLS_TYPE4_043 : 275|4@0+ (1,0) [0|15] "NA"  ADAS
 SG_ OBJ_CLS_TYPE4_PROB_043 : 327|8@0+ (0.004,0) [0|1] "NA"  ADAS
 SG_ OBJ_CLS_TYPE5_043 : 287|4@0+ (1,0) [0|15] "NA"  ADAS
 SG_ OBJ_CLS_TYPE5_PROB_043 : 335|8@0+ (0.004,0) [0|1] "NA"  ADAS
 SG_ OBJ_CLS_TYPE6_043 : 282|4@0+ (1,0) [0|15] "NA"  ADAS
 SG_ OBJ_CLS_TYPE6_PROB_043 : 343|8@0+ (0.004,0) [0|1] "NA"  ADAS
 SG_ OBJ_RCS_043 : 351|7@0+ (1,-64) [-64|63] "dBsm"  ADAS
 SG_ OBJ_REF_PT_LONG_OFFSET_043 : 357|14@0+ (0.0001,0) [0|1] "NA"  ADAS
 SG_ OBJ_REF_PT_LAT_OFFSET_043 : 370|14@0+ (0.0001,0) [0|1] "NA"  ADAS
 SG_ OBJ_YAW_RATE_043 : 399|10@0+ (0.005,-2.24) [-2.24|2.24] "rad/s"  ADAS
 SG_ OBJ_YAW_RATE_ERR_043 : 388|5@0+ (0.025,0) [0|0.775] "rad/s"  ADAS
 SG_ OBJ_GROUP_ID_043 : 405|6@0+ (1,0) [0|63] "NA"  ADAS
 SG_ OBJ_POS_ERR_CRR_COEF_043 : 415|8@0+ (0.01,-1.2) [-1.2|1] "NA"  ADAS
 SG_ OBJ_VELOCITY_ERR_CRR_COEF_043 : 423|8@0+ (0.01,-1.2) [-1.2|1] "NA"  ADAS
 SG_ OBJ_ACCEL_ERR_CRR_COEF_043 : 431|8@0+ (0.01,-1.2) [-1.2|1] "NA"  ADAS

BO_ 1403 RDR_TRACKER_OBJ_044: 64 RDR02
 SG_ OBJ_ALIVE_TIME_044 : 255|16@0+ (1,0) [0|65535] "ms"  ADAS
 SG_ OBJ_ACCELERATION_LONG_ERR_044 : 215|8@0+ (0.025,0) [0|6.375] "m/s^2"  ADAS
 SG_ OBJ_ACCELERATION_LAT_ERR_044 : 223|8@0+ (0.025,0) [0|6.375] "m/s^2"  ADAS
 SG_ OBJ_VELOCITY_LONG_ERR_044 : 143|8@0+ (0.05,0) [0|12.75] "m/s"  ADAS
 SG_ OBJ_VELOCITY_LAT_ERR_044 : 151|8@0+ (0.05,0) [0|12.75] "m/s"  ADAS
 SG_ OBJ_POS_LONG_ERR_044 : 95|8@0+ (0.025,0) [0|6.375] "m"  ADAS
 SG_ OBJ_POS_LAT_ERR_044 : 103|8@0+ (0.025,0) [0|6.375] "m"  ADAS
 SG_ OBJ_TRACK_MOTION_MODEL_044 : 9|2@0+ (1,0) [0|3] "NA"  ADAS
 SG_ OBJ_DIMENSION_WIDTH_044 : 17|10@0+ (0.01,0) [0|10.23] "m"  ADAS
 SG_ OBJ_DIMENSION_LENGTH_044 : 37|12@0+ (0.01,0) [0|40.95] "m"  ADAS
 SG_ OBJ_EXISTENCE_PROB_044 : 229|14@0+ (0.0001,0) [0|1] "NA"  ADAS
 SG_ OBJ_YAW_ANGLE_044 : 155|12@0+ (0.005,-10) [-10|10.475] "rad"  ADAS
 SG_ OBJ_YAW_ANGLE_ERR_044 : 175|7@0+ (0.01,0) [0|1.27] "rad"  ADAS
 SG_ OBJ_ID_044 : 7|8@0+ (1,0) [0|255] "NA"  ADAS
 SG_ OBJ_MOVEMENT_STATUS_044 : 196|3@0+ (1,0) [0|3] "NA"  ADAS
 SG_ OBJ_MEASUREMENT_STATUS_044 : 14|3@0+ (1,0) [0|7] "NA"  ADAS
 SG_ OBJ_POS_LONG_044 : 63|16@0+ (0.01,-327) [-327|327] "m"  ADAS
 SG_ OBJ_POS_LAT_044 : 79|16@0+ (0.01,-327) [-327|327] "m"  ADAS
 SG_ OBJ_VELOCITY_LONG_044 : 110|15@0+ (0.01,-163) [-163|163] "m/s"  ADAS
 SG_ OBJ_VELOCITY_LAT_044 : 126|15@0+ (0.01,-163) [-163|163] "m/s"  ADAS
 SG_ OBJ_ACCELERATION_LONG_044 : 193|10@0+ (0.05,-20) [-20|20] "m/s^2"  ADAS
 SG_ OBJ_ACCELERATION_LAT_044 : 177|10@0+ (0.05,-20) [-20|20] "m/s^2"  ADAS
 SG_ OBJ_VEH_TRACK_FLAG_044 : 10|1@0+ (1,0) [0|1] "NA"  ADAS
 SG_ OBJ_MH_CYCLE_COUNTER_044 : 487|8@0+ (1,0) [0|255] "NA"  ADAS
 SG_ OBJ_MH_CRC16_044 : 495|16@0+ (1,0) [0|65535] "NA"  ADAS
 SG_ OBJ_TIMESTAMP_OFFSET_044 : 247|8@0+ (1,-127) [-127|128] "ms"  ADAS
 SG_ OBJ_DIMENSION_WIDTH_ERR_044 : 23|6@0+ (0.01,0) [0|0.63] "m"  ADAS
 SG_ OBJ_DIMENSION_LENGTH_ERR_044 : 41|10@0+ (0.01,0) [0|10.23] "m"  ADAS
 SG_ OBJ_CLS_TYPE1_044 : 271|4@0+ (1,0) [0|15] "NA"  ADAS
 SG_ OBJ_CLS_TYPE1_PROB_044 : 303|8@0+ (0.004,0) [0|1] "NA"  ADAS
 SG_ OBJ_CLS_TYPE2_044 : 267|4@0+ (1,0) [0|15] "NA"  ADAS
 SG_ OBJ_CLS_TYPE2_PROB_044 : 311|8@0+ (0.004,0) [0|1] "NA"  ADAS
 SG_ OBJ_CLS_TYPE3_044 : 279|4@0+ (1,0) [0|15] "NA"  ADAS
 SG_ OBJ_CLS_TYPE3_PROB_044 : 319|8@0+ (0.004,0) [0|1] "NA"  ADAS
 SG_ OBJ_CLS_TYPE4_044 : 275|4@0+ (1,0) [0|15] "NA"  ADAS
 SG_ OBJ_CLS_TYPE4_PROB_044 : 327|8@0+ (0.004,0) [0|1] "NA"  ADAS
 SG_ OBJ_CLS_TYPE5_044 : 287|4@0+ (1,0) [0|15] "NA"  ADAS
 SG_ OBJ_CLS_TYPE5_PROB_044 : 335|8@0+ (0.004,0) [0|1] "NA"  ADAS
 SG_ OBJ_CLS_TYPE6_044 : 282|4@0+ (1,0) [0|15] "NA"  ADAS
 SG_ OBJ_CLS_TYPE6_PROB_044 : 343|8@0+ (0.004,0) [0|1] "NA"  ADAS
 SG_ OBJ_RCS_044 : 351|7@0+ (1,-64) [-64|63] "dBsm"  ADAS
 SG_ OBJ_REF_PT_LONG_OFFSET_044 : 357|14@0+ (0.0001,0) [0|1] "NA"  ADAS
 SG_ OBJ_REF_PT_LAT_OFFSET_044 : 370|14@0+ (0.0001,0) [0|1] "NA"  ADAS
 SG_ OBJ_YAW_RATE_044 : 399|10@0+ (0.005,-2.24) [-2.24|2.24] "rad/s"  ADAS
 SG_ OBJ_YAW_RATE_ERR_044 : 388|5@0+ (0.025,0) [0|0.775] "rad/s"  ADAS
 SG_ OBJ_GROUP_ID_044 : 405|6@0+ (1,0) [0|63] "NA"  ADAS
 SG_ OBJ_POS_ERR_CRR_COEF_044 : 415|8@0+ (0.01,-1.2) [-1.2|1] "NA"  ADAS
 SG_ OBJ_VELOCITY_ERR_CRR_COEF_044 : 423|8@0+ (0.01,-1.2) [-1.2|1] "NA"  ADAS
 SG_ OBJ_ACCEL_ERR_CRR_COEF_044 : 431|8@0+ (0.01,-1.2) [-1.2|1] "NA"  ADAS

BO_ 1404 RDR_TRACKER_OBJ_045: 64 RDR02
 SG_ OBJ_ALIVE_TIME_045 : 255|16@0+ (1,0) [0|65535] "ms"  ADAS
 SG_ OBJ_ACCELERATION_LONG_ERR_045 : 215|8@0+ (0.025,0) [0|6.375] "m/s^2"  ADAS
 SG_ OBJ_ACCELERATION_LAT_ERR_045 : 223|8@0+ (0.025,0) [0|6.375] "m/s^2"  ADAS
 SG_ OBJ_VELOCITY_LONG_ERR_045 : 143|8@0+ (0.05,0) [0|12.75] "m/s"  ADAS
 SG_ OBJ_VELOCITY_LAT_ERR_045 : 151|8@0+ (0.05,0) [0|12.75] "m/s"  ADAS
 SG_ OBJ_POS_LONG_ERR_045 : 95|8@0+ (0.025,0) [0|6.375] "m"  ADAS
 SG_ OBJ_POS_LAT_ERR_045 : 103|8@0+ (0.025,0) [0|6.375] "m"  ADAS
 SG_ OBJ_TRACK_MOTION_MODEL_045 : 9|2@0+ (1,0) [0|3] "NA"  ADAS
 SG_ OBJ_DIMENSION_WIDTH_045 : 17|10@0+ (0.01,0) [0|10.23] "m"  ADAS
 SG_ OBJ_DIMENSION_LENGTH_045 : 37|12@0+ (0.01,0) [0|40.95] "m"  ADAS
 SG_ OBJ_EXISTENCE_PROB_045 : 229|14@0+ (0.0001,0) [0|1] "NA"  ADAS
 SG_ OBJ_YAW_ANGLE_045 : 155|12@0+ (0.005,-10) [-10|10.475] "rad"  ADAS
 SG_ OBJ_YAW_ANGLE_ERR_045 : 175|7@0+ (0.01,0) [0|1.27] "rad"  ADAS
 SG_ OBJ_ID_045 : 7|8@0+ (1,0) [0|255] "NA"  ADAS
 SG_ OBJ_MOVEMENT_STATUS_045 : 196|3@0+ (1,0) [0|3] "NA"  ADAS
 SG_ OBJ_MEASUREMENT_STATUS_045 : 14|3@0+ (1,0) [0|7] "NA"  ADAS
 SG_ OBJ_POS_LONG_045 : 63|16@0+ (0.01,-327) [-327|327] "m"  ADAS
 SG_ OBJ_POS_LAT_045 : 79|16@0+ (0.01,-327) [-327|327] "m"  ADAS
 SG_ OBJ_VELOCITY_LONG_045 : 110|15@0+ (0.01,-163) [-163|163] "m/s"  ADAS
 SG_ OBJ_VELOCITY_LAT_045 : 126|15@0+ (0.01,-163) [-163|163] "m/s"  ADAS
 SG_ OBJ_ACCELERATION_LONG_045 : 193|10@0+ (0.05,-20) [-20|20] "m/s^2"  ADAS
 SG_ OBJ_ACCELERATION_LAT_045 : 177|10@0+ (0.05,-20) [-20|20] "m/s^2"  ADAS
 SG_ OBJ_VEH_TRACK_FLAG_045 : 10|1@0+ (1,0) [0|1] "NA"  ADAS
 SG_ OBJ_MH_CYCLE_COUNTER_045 : 487|8@0+ (1,0) [0|255] "NA"  ADAS
 SG_ OBJ_MH_CRC16_045 : 495|16@0+ (1,0) [0|65535] "NA"  ADAS
 SG_ OBJ_TIMESTAMP_OFFSET_045 : 247|8@0+ (1,-127) [-127|128] "ms"  ADAS
 SG_ OBJ_DIMENSION_WIDTH_ERR_045 : 23|6@0+ (0.01,0) [0|0.63] "m"  ADAS
 SG_ OBJ_DIMENSION_LENGTH_ERR_045 : 41|10@0+ (0.01,0) [0|10.23] "m"  ADAS
 SG_ OBJ_CLS_TYPE1_045 : 271|4@0+ (1,0) [0|15] "NA"  ADAS
 SG_ OBJ_CLS_TYPE1_PROB_045 : 303|8@0+ (0.004,0) [0|1] "NA"  ADAS
 SG_ OBJ_CLS_TYPE2_045 : 267|4@0+ (1,0) [0|15] "NA"  ADAS
 SG_ OBJ_CLS_TYPE2_PROB_045 : 311|8@0+ (0.004,0) [0|1] "NA"  ADAS
 SG_ OBJ_CLS_TYPE3_045 : 279|4@0+ (1,0) [0|15] "NA"  ADAS
 SG_ OBJ_CLS_TYPE3_PROB_045 : 319|8@0+ (0.004,0) [0|1] "NA"  ADAS
 SG_ OBJ_CLS_TYPE4_045 : 275|4@0+ (1,0) [0|15] "NA"  ADAS
 SG_ OBJ_CLS_TYPE4_PROB_045 : 327|8@0+ (0.004,0) [0|1] "NA"  ADAS
 SG_ OBJ_CLS_TYPE5_045 : 287|4@0+ (1,0) [0|15] "NA"  ADAS
 SG_ OBJ_CLS_TYPE5_PROB_045 : 335|8@0+ (0.004,0) [0|1] "NA"  ADAS
 SG_ OBJ_CLS_TYPE6_045 : 282|4@0+ (1,0) [0|15] "NA"  ADAS
 SG_ OBJ_CLS_TYPE6_PROB_045 : 343|8@0+ (0.004,0) [0|1] "NA"  ADAS
 SG_ OBJ_RCS_045 : 351|7@0+ (1,-64) [-64|63] "dBsm"  ADAS
 SG_ OBJ_REF_PT_LONG_OFFSET_045 : 357|14@0+ (0.0001,0) [0|1] "NA"  ADAS
 SG_ OBJ_REF_PT_LAT_OFFSET_045 : 370|14@0+ (0.0001,0) [0|1] "NA"  ADAS
 SG_ OBJ_YAW_RATE_045 : 399|10@0+ (0.005,-2.24) [-2.24|2.24] "rad/s"  ADAS
 SG_ OBJ_YAW_RATE_ERR_045 : 388|5@0+ (0.025,0) [0|0.775] "rad/s"  ADAS
 SG_ OBJ_GROUP_ID_045 : 405|6@0+ (1,0) [0|63] "NA"  ADAS
 SG_ OBJ_POS_ERR_CRR_COEF_045 : 415|8@0+ (0.01,-1.2) [-1.2|1] "NA"  ADAS
 SG_ OBJ_VELOCITY_ERR_CRR_COEF_045 : 423|8@0+ (0.01,-1.2) [-1.2|1] "NA"  ADAS
 SG_ OBJ_ACCEL_ERR_CRR_COEF_045 : 431|8@0+ (0.01,-1.2) [-1.2|1] "NA"  ADAS

BO_ 1405 RDR_TRACKER_OBJ_046: 64 RDR02
 SG_ OBJ_ALIVE_TIME_046 : 255|16@0+ (1,0) [0|65535] "ms"  ADAS
 SG_ OBJ_ACCELERATION_LONG_ERR_046 : 215|8@0+ (0.025,0) [0|6.375] "m/s^2"  ADAS
 SG_ OBJ_ACCELERATION_LAT_ERR_046 : 223|8@0+ (0.025,0) [0|6.375] "m/s^2"  ADAS
 SG_ OBJ_VELOCITY_LONG_ERR_046 : 143|8@0+ (0.05,0) [0|12.75] "m/s"  ADAS
 SG_ OBJ_VELOCITY_LAT_ERR_046 : 151|8@0+ (0.05,0) [0|12.75] "m/s"  ADAS
 SG_ OBJ_POS_LONG_ERR_046 : 95|8@0+ (0.025,0) [0|6.375] "m"  ADAS
 SG_ OBJ_POS_LAT_ERR_046 : 103|8@0+ (0.025,0) [0|6.375] "m"  ADAS
 SG_ OBJ_TRACK_MOTION_MODEL_046 : 9|2@0+ (1,0) [0|3] "NA"  ADAS
 SG_ OBJ_DIMENSION_WIDTH_046 : 17|10@0+ (0.01,0) [0|10.23] "m"  ADAS
 SG_ OBJ_DIMENSION_LENGTH_046 : 37|12@0+ (0.01,0) [0|40.95] "m"  ADAS
 SG_ OBJ_EXISTENCE_PROB_046 : 229|14@0+ (0.0001,0) [0|1] "NA"  ADAS
 SG_ OBJ_YAW_ANGLE_046 : 155|12@0+ (0.005,-10) [-10|10.475] "rad"  ADAS
 SG_ OBJ_YAW_ANGLE_ERR_046 : 175|7@0+ (0.01,0) [0|1.27] "rad"  ADAS
 SG_ OBJ_ID_046 : 7|8@0+ (1,0) [0|255] "NA"  ADAS
 SG_ OBJ_MOVEMENT_STATUS_046 : 196|3@0+ (1,0) [0|3] "NA"  ADAS
 SG_ OBJ_MEASUREMENT_STATUS_046 : 14|3@0+ (1,0) [0|7] "NA"  ADAS
 SG_ OBJ_POS_LONG_046 : 63|16@0+ (0.01,-327) [-327|327] "m"  ADAS
 SG_ OBJ_POS_LAT_046 : 79|16@0+ (0.01,-327) [-327|327] "m"  ADAS
 SG_ OBJ_VELOCITY_LONG_046 : 110|15@0+ (0.01,-163) [-163|163] "m/s"  ADAS
 SG_ OBJ_VELOCITY_LAT_046 : 126|15@0+ (0.01,-163) [-163|163] "m/s"  ADAS
 SG_ OBJ_ACCELERATION_LONG_046 : 193|10@0+ (0.05,-20) [-20|20] "m/s^2"  ADAS
 SG_ OBJ_ACCELERATION_LAT_046 : 177|10@0+ (0.05,-20) [-20|20] "m/s^2"  ADAS
 SG_ OBJ_VEH_TRACK_FLAG_046 : 10|1@0+ (1,0) [0|1] "NA"  ADAS
 SG_ OBJ_MH_CYCLE_COUNTER_046 : 487|8@0+ (1,0) [0|255] "NA"  ADAS
 SG_ OBJ_MH_CRC16_046 : 495|16@0+ (1,0) [0|65535] "NA"  ADAS
 SG_ OBJ_TIMESTAMP_OFFSET_046 : 247|8@0+ (1,-127) [-127|128] "ms"  ADAS
 SG_ OBJ_DIMENSION_WIDTH_ERR_046 : 23|6@0+ (0.01,0) [0|0.63] "m"  ADAS
 SG_ OBJ_DIMENSION_LENGTH_ERR_046 : 41|10@0+ (0.01,0) [0|10.23] "m"  ADAS
 SG_ OBJ_CLS_TYPE1_046 : 271|4@0+ (1,0) [0|15] "NA"  ADAS
 SG_ OBJ_CLS_TYPE1_PROB_046 : 303|8@0+ (0.004,0) [0|1] "NA"  ADAS
 SG_ OBJ_CLS_TYPE2_046 : 267|4@0+ (1,0) [0|15] "NA"  ADAS
 SG_ OBJ_CLS_TYPE2_PROB_046 : 311|8@0+ (0.004,0) [0|1] "NA"  ADAS
 SG_ OBJ_CLS_TYPE3_046 : 279|4@0+ (1,0) [0|15] "NA"  ADAS
 SG_ OBJ_CLS_TYPE3_PROB_046 : 319|8@0+ (0.004,0) [0|1] "NA"  ADAS
 SG_ OBJ_CLS_TYPE4_046 : 275|4@0+ (1,0) [0|15] "NA"  ADAS
 SG_ OBJ_CLS_TYPE4_PROB_046 : 327|8@0+ (0.004,0) [0|1] "NA"  ADAS
 SG_ OBJ_CLS_TYPE5_046 : 287|4@0+ (1,0) [0|15] "NA"  ADAS
 SG_ OBJ_CLS_TYPE5_PROB_046 : 335|8@0+ (0.004,0) [0|1] "NA"  ADAS
 SG_ OBJ_CLS_TYPE6_046 : 282|4@0+ (1,0) [0|15] "NA"  ADAS
 SG_ OBJ_CLS_TYPE6_PROB_046 : 343|8@0+ (0.004,0) [0|1] "NA"  ADAS
 SG_ OBJ_RCS_046 : 351|7@0+ (1,-64) [-64|63] "dBsm"  ADAS
 SG_ OBJ_REF_PT_LONG_OFFSET_046 : 357|14@0+ (0.0001,0) [0|1] "NA"  ADAS
 SG_ OBJ_REF_PT_LAT_OFFSET_046 : 370|14@0+ (0.0001,0) [0|1] "NA"  ADAS
 SG_ OBJ_YAW_RATE_046 : 399|10@0+ (0.005,-2.24) [-2.24|2.24] "rad/s"  ADAS
 SG_ OBJ_YAW_RATE_ERR_046 : 388|5@0+ (0.025,0) [0|0.775] "rad/s"  ADAS
 SG_ OBJ_GROUP_ID_046 : 405|6@0+ (1,0) [0|63] "NA"  ADAS
 SG_ OBJ_POS_ERR_CRR_COEF_046 : 415|8@0+ (0.01,-1.2) [-1.2|1] "NA"  ADAS
 SG_ OBJ_VELOCITY_ERR_CRR_COEF_046 : 423|8@0+ (0.01,-1.2) [-1.2|1] "NA"  ADAS
 SG_ OBJ_ACCEL_ERR_CRR_COEF_046 : 431|8@0+ (0.01,-1.2) [-1.2|1] "NA"  ADAS

BO_ 1406 RDR_TRACKER_OBJ_047: 64 RDR02
 SG_ OBJ_ALIVE_TIME_047 : 255|16@0+ (1,0) [0|65535] "ms"  ADAS
 SG_ OBJ_ACCELERATION_LONG_ERR_047 : 215|8@0+ (0.025,0) [0|6.375] "m/s^2"  ADAS
 SG_ OBJ_ACCELERATION_LAT_ERR_047 : 223|8@0+ (0.025,0) [0|6.375] "m/s^2"  ADAS
 SG_ OBJ_VELOCITY_LONG_ERR_047 : 143|8@0+ (0.05,0) [0|12.75] "m/s"  ADAS
 SG_ OBJ_VELOCITY_LAT_ERR_047 : 151|8@0+ (0.05,0) [0|12.75] "m/s"  ADAS
 SG_ OBJ_POS_LONG_ERR_047 : 95|8@0+ (0.025,0) [0|6.375] "m"  ADAS
 SG_ OBJ_POS_LAT_ERR_047 : 103|8@0+ (0.025,0) [0|6.375] "m"  ADAS
 SG_ OBJ_TRACK_MOTION_MODEL_047 : 9|2@0+ (1,0) [0|3] "NA"  ADAS
 SG_ OBJ_DIMENSION_WIDTH_047 : 17|10@0+ (0.01,0) [0|10.23] "m"  ADAS
 SG_ OBJ_DIMENSION_LENGTH_047 : 37|12@0+ (0.01,0) [0|40.95] "m"  ADAS
 SG_ OBJ_EXISTENCE_PROB_047 : 229|14@0+ (0.0001,0) [0|1] "NA"  ADAS
 SG_ OBJ_YAW_ANGLE_047 : 155|12@0+ (0.005,-10) [-10|10.475] "rad"  ADAS
 SG_ OBJ_YAW_ANGLE_ERR_047 : 175|7@0+ (0.01,0) [0|1.27] "rad"  ADAS
 SG_ OBJ_ID_047 : 7|8@0+ (1,0) [0|255] "NA"  ADAS
 SG_ OBJ_MOVEMENT_STATUS_047 : 196|3@0+ (1,0) [0|3] "NA"  ADAS
 SG_ OBJ_MEASUREMENT_STATUS_047 : 14|3@0+ (1,0) [0|7] "NA"  ADAS
 SG_ OBJ_POS_LONG_047 : 63|16@0+ (0.01,-327) [-327|327] "m"  ADAS
 SG_ OBJ_POS_LAT_047 : 79|16@0+ (0.01,-327) [-327|327] "m"  ADAS
 SG_ OBJ_VELOCITY_LONG_047 : 110|15@0+ (0.01,-163) [-163|163] "m/s"  ADAS
 SG_ OBJ_VELOCITY_LAT_047 : 126|15@0+ (0.01,-163) [-163|163] "m/s"  ADAS
 SG_ OBJ_ACCELERATION_LONG_047 : 193|10@0+ (0.05,-20) [-20|20] "m/s^2"  ADAS
 SG_ OBJ_ACCELERATION_LAT_047 : 177|10@0+ (0.05,-20) [-20|20] "m/s^2"  ADAS
 SG_ OBJ_VEH_TRACK_FLAG_047 : 10|1@0+ (1,0) [0|1] "NA"  ADAS
 SG_ OBJ_MH_CYCLE_COUNTER_047 : 487|8@0+ (1,0) [0|255] "NA"  ADAS
 SG_ OBJ_MH_CRC16_047 : 495|16@0+ (1,0) [0|65535] "NA"  ADAS
 SG_ OBJ_TIMESTAMP_OFFSET_047 : 247|8@0+ (1,-127) [-127|128] "ms"  ADAS
 SG_ OBJ_DIMENSION_WIDTH_ERR_047 : 23|6@0+ (0.01,0) [0|0.63] "m"  ADAS
 SG_ OBJ_DIMENSION_LENGTH_ERR_047 : 41|10@0+ (0.01,0) [0|10.23] "m"  ADAS
 SG_ OBJ_CLS_TYPE1_047 : 271|4@0+ (1,0) [0|15] "NA"  ADAS
 SG_ OBJ_CLS_TYPE1_PROB_047 : 303|8@0+ (0.004,0) [0|1] "NA"  ADAS
 SG_ OBJ_CLS_TYPE2_047 : 267|4@0+ (1,0) [0|15] "NA"  ADAS
 SG_ OBJ_CLS_TYPE2_PROB_047 : 311|8@0+ (0.004,0) [0|1] "NA"  ADAS
 SG_ OBJ_CLS_TYPE3_047 : 279|4@0+ (1,0) [0|15] "NA"  ADAS
 SG_ OBJ_CLS_TYPE3_PROB_047 : 319|8@0+ (0.004,0) [0|1] "NA"  ADAS
 SG_ OBJ_CLS_TYPE4_047 : 275|4@0+ (1,0) [0|15] "NA"  ADAS
 SG_ OBJ_CLS_TYPE4_PROB_047 : 327|8@0+ (0.004,0) [0|1] "NA"  ADAS
 SG_ OBJ_CLS_TYPE5_047 : 287|4@0+ (1,0) [0|15] "NA"  ADAS
 SG_ OBJ_CLS_TYPE5_PROB_047 : 335|8@0+ (0.004,0) [0|1] "NA"  ADAS
 SG_ OBJ_CLS_TYPE6_047 : 282|4@0+ (1,0) [0|15] "NA"  ADAS
 SG_ OBJ_CLS_TYPE6_PROB_047 : 343|8@0+ (0.004,0) [0|1] "NA"  ADAS
 SG_ OBJ_RCS_047 : 351|7@0+ (1,-64) [-64|63] "dBsm"  ADAS
 SG_ OBJ_REF_PT_LONG_OFFSET_047 : 357|14@0+ (0.0001,0) [0|1] "NA"  ADAS
 SG_ OBJ_REF_PT_LAT_OFFSET_047 : 370|14@0+ (0.0001,0) [0|1] "NA"  ADAS
 SG_ OBJ_YAW_RATE_047 : 399|10@0+ (0.005,-2.24) [-2.24|2.24] "rad/s"  ADAS
 SG_ OBJ_YAW_RATE_ERR_047 : 388|5@0+ (0.025,0) [0|0.775] "rad/s"  ADAS
 SG_ OBJ_GROUP_ID_047 : 405|6@0+ (1,0) [0|63] "NA"  ADAS
 SG_ OBJ_POS_ERR_CRR_COEF_047 : 415|8@0+ (0.01,-1.2) [-1.2|1] "NA"  ADAS
 SG_ OBJ_VELOCITY_ERR_CRR_COEF_047 : 423|8@0+ (0.01,-1.2) [-1.2|1] "NA"  ADAS
 SG_ OBJ_ACCEL_ERR_CRR_COEF_047 : 431|8@0+ (0.01,-1.2) [-1.2|1] "NA"  ADAS

BO_ 1407 RDR_TRACKER_OBJ_048: 64 RDR02
 SG_ OBJ_ALIVE_TIME_048 : 255|16@0+ (1,0) [0|65535] "ms"  ADAS
 SG_ OBJ_ACCELERATION_LONG_ERR_048 : 215|8@0+ (0.025,0) [0|6.375] "m/s^2"  ADAS
 SG_ OBJ_ACCELERATION_LAT_ERR_048 : 223|8@0+ (0.025,0) [0|6.375] "m/s^2"  ADAS
 SG_ OBJ_VELOCITY_LONG_ERR_048 : 143|8@0+ (0.05,0) [0|12.75] "m/s"  ADAS
 SG_ OBJ_VELOCITY_LAT_ERR_048 : 151|8@0+ (0.05,0) [0|12.75] "m/s"  ADAS
 SG_ OBJ_POS_LONG_ERR_048 : 95|8@0+ (0.025,0) [0|6.375] "m"  ADAS
 SG_ OBJ_POS_LAT_ERR_048 : 103|8@0+ (0.025,0) [0|6.375] "m"  ADAS
 SG_ OBJ_TRACK_MOTION_MODEL_048 : 9|2@0+ (1,0) [0|3] "NA"  ADAS
 SG_ OBJ_DIMENSION_WIDTH_048 : 17|10@0+ (0.01,0) [0|10.23] "m"  ADAS
 SG_ OBJ_DIMENSION_LENGTH_048 : 37|12@0+ (0.01,0) [0|40.95] "m"  ADAS
 SG_ OBJ_EXISTENCE_PROB_048 : 229|14@0+ (0.0001,0) [0|1] "NA"  ADAS
 SG_ OBJ_YAW_ANGLE_048 : 155|12@0+ (0.005,-10) [-10|10.475] "rad"  ADAS
 SG_ OBJ_YAW_ANGLE_ERR_048 : 175|7@0+ (0.01,0) [0|1.27] "rad"  ADAS
 SG_ OBJ_ID_048 : 7|8@0+ (1,0) [0|255] "NA"  ADAS
 SG_ OBJ_MOVEMENT_STATUS_048 : 196|3@0+ (1,0) [0|3] "NA"  ADAS
 SG_ OBJ_MEASUREMENT_STATUS_048 : 14|3@0+ (1,0) [0|7] "NA"  ADAS
 SG_ OBJ_POS_LONG_048 : 63|16@0+ (0.01,-327) [-327|327] "m"  ADAS
 SG_ OBJ_POS_LAT_048 : 79|16@0+ (0.01,-327) [-327|327] "m"  ADAS
 SG_ OBJ_VELOCITY_LONG_048 : 110|15@0+ (0.01,-163) [-163|163] "m/s"  ADAS
 SG_ OBJ_VELOCITY_LAT_048 : 126|15@0+ (0.01,-163) [-163|163] "m/s"  ADAS
 SG_ OBJ_ACCELERATION_LONG_048 : 193|10@0+ (0.05,-20) [-20|20] "m/s^2"  ADAS
 SG_ OBJ_ACCELERATION_LAT_048 : 177|10@0+ (0.05,-20) [-20|20] "m/s^2"  ADAS
 SG_ OBJ_VEH_TRACK_FLAG_048 : 10|1@0+ (1,0) [0|1] "NA"  ADAS
 SG_ OBJ_MH_CYCLE_COUNTER_048 : 487|8@0+ (1,0) [0|255] "NA"  ADAS
 SG_ OBJ_MH_CRC16_048 : 495|16@0+ (1,0) [0|65535] "NA"  ADAS
 SG_ OBJ_TIMESTAMP_OFFSET_048 : 247|8@0+ (1,-127) [-127|128] "ms"  ADAS
 SG_ OBJ_DIMENSION_WIDTH_ERR_048 : 23|6@0+ (0.01,0) [0|0.63] "m"  ADAS
 SG_ OBJ_DIMENSION_LENGTH_ERR_048 : 41|10@0+ (0.01,0) [0|10.23] "m"  ADAS
 SG_ OBJ_CLS_TYPE1_048 : 271|4@0+ (1,0) [0|15] "NA"  ADAS
 SG_ OBJ_CLS_TYPE1_PROB_048 : 303|8@0+ (0.004,0) [0|1] "NA"  ADAS
 SG_ OBJ_CLS_TYPE2_048 : 267|4@0+ (1,0) [0|15] "NA"  ADAS
 SG_ OBJ_CLS_TYPE2_PROB_048 : 311|8@0+ (0.004,0) [0|1] "NA"  ADAS
 SG_ OBJ_CLS_TYPE3_048 : 279|4@0+ (1,0) [0|15] "NA"  ADAS
 SG_ OBJ_CLS_TYPE3_PROB_048 : 319|8@0+ (0.004,0) [0|1] "NA"  ADAS
 SG_ OBJ_CLS_TYPE4_048 : 275|4@0+ (1,0) [0|15] "NA"  ADAS
 SG_ OBJ_CLS_TYPE4_PROB_048 : 327|8@0+ (0.004,0) [0|1] "NA"  ADAS
 SG_ OBJ_CLS_TYPE5_048 : 287|4@0+ (1,0) [0|15] "NA"  ADAS
 SG_ OBJ_CLS_TYPE5_PROB_048 : 335|8@0+ (0.004,0) [0|1] "NA"  ADAS
 SG_ OBJ_CLS_TYPE6_048 : 282|4@0+ (1,0) [0|15] "NA"  ADAS
 SG_ OBJ_CLS_TYPE6_PROB_048 : 343|8@0+ (0.004,0) [0|1] "NA"  ADAS
 SG_ OBJ_RCS_048 : 351|7@0+ (1,-64) [-64|63] "dBsm"  ADAS
 SG_ OBJ_REF_PT_LONG_OFFSET_048 : 357|14@0+ (0.0001,0) [0|1] "NA"  ADAS
 SG_ OBJ_REF_PT_LAT_OFFSET_048 : 370|14@0+ (0.0001,0) [0|1] "NA"  ADAS
 SG_ OBJ_YAW_RATE_048 : 399|10@0+ (0.005,-2.24) [-2.24|2.24] "rad/s"  ADAS
 SG_ OBJ_YAW_RATE_ERR_048 : 388|5@0+ (0.025,0) [0|0.775] "rad/s"  ADAS
 SG_ OBJ_GROUP_ID_048 : 405|6@0+ (1,0) [0|63] "NA"  ADAS
 SG_ OBJ_POS_ERR_CRR_COEF_048 : 415|8@0+ (0.01,-1.2) [-1.2|1] "NA"  ADAS
 SG_ OBJ_VELOCITY_ERR_CRR_COEF_048 : 423|8@0+ (0.01,-1.2) [-1.2|1] "NA"  ADAS
 SG_ OBJ_ACCEL_ERR_CRR_COEF_048 : 431|8@0+ (0.01,-1.2) [-1.2|1] "NA"  ADAS

BO_ 1408 RDR_TRACKER_OBJ_049: 64 RDR02
 SG_ OBJ_ALIVE_TIME_049 : 255|16@0+ (1,0) [0|65535] "ms"  ADAS
 SG_ OBJ_ACCELERATION_LONG_ERR_049 : 215|8@0+ (0.025,0) [0|6.375] "m/s^2"  ADAS
 SG_ OBJ_ACCELERATION_LAT_ERR_049 : 223|8@0+ (0.025,0) [0|6.375] "m/s^2"  ADAS
 SG_ OBJ_VELOCITY_LONG_ERR_049 : 143|8@0+ (0.05,0) [0|12.75] "m/s"  ADAS
 SG_ OBJ_VELOCITY_LAT_ERR_049 : 151|8@0+ (0.05,0) [0|12.75] "m/s"  ADAS
 SG_ OBJ_POS_LONG_ERR_049 : 95|8@0+ (0.025,0) [0|6.375] "m"  ADAS
 SG_ OBJ_POS_LAT_ERR_049 : 103|8@0+ (0.025,0) [0|6.375] "m"  ADAS
 SG_ OBJ_TRACK_MOTION_MODEL_049 : 9|2@0+ (1,0) [0|3] "NA"  ADAS
 SG_ OBJ_DIMENSION_WIDTH_049 : 17|10@0+ (0.01,0) [0|10.23] "m"  ADAS
 SG_ OBJ_DIMENSION_LENGTH_049 : 37|12@0+ (0.01,0) [0|40.95] "m"  ADAS
 SG_ OBJ_EXISTENCE_PROB_049 : 229|14@0+ (0.0001,0) [0|1] "NA"  ADAS
 SG_ OBJ_YAW_ANGLE_049 : 155|12@0+ (0.005,-10) [-10|10.475] "rad"  ADAS
 SG_ OBJ_YAW_ANGLE_ERR_049 : 175|7@0+ (0.01,0) [0|1.27] "rad"  ADAS
 SG_ OBJ_ID_049 : 7|8@0+ (1,0) [0|255] "NA"  ADAS
 SG_ OBJ_MOVEMENT_STATUS_049 : 196|3@0+ (1,0) [0|3] "NA"  ADAS
 SG_ OBJ_MEASUREMENT_STATUS_049 : 14|3@0+ (1,0) [0|7] "NA"  ADAS
 SG_ OBJ_POS_LONG_049 : 63|16@0+ (0.01,-327) [-327|327] "m"  ADAS
 SG_ OBJ_POS_LAT_049 : 79|16@0+ (0.01,-327) [-327|327] "m"  ADAS
 SG_ OBJ_VELOCITY_LONG_049 : 110|15@0+ (0.01,-163) [-163|163] "m/s"  ADAS
 SG_ OBJ_VELOCITY_LAT_049 : 126|15@0+ (0.01,-163) [-163|163] "m/s"  ADAS
 SG_ OBJ_ACCELERATION_LONG_049 : 193|10@0+ (0.05,-20) [-20|20] "m/s^2"  ADAS
 SG_ OBJ_ACCELERATION_LAT_049 : 177|10@0+ (0.05,-20) [-20|20] "m/s^2"  ADAS
 SG_ OBJ_VEH_TRACK_FLAG_049 : 10|1@0+ (1,0) [0|1] "NA"  ADAS
 SG_ OBJ_MH_CYCLE_COUNTER_049 : 487|8@0+ (1,0) [0|255] "NA"  ADAS
 SG_ OBJ_MH_CRC16_049 : 495|16@0+ (1,0) [0|65535] "NA"  ADAS
 SG_ OBJ_TIMESTAMP_OFFSET_049 : 247|8@0+ (1,-127) [-127|128] "ms"  ADAS
 SG_ OBJ_DIMENSION_WIDTH_ERR_049 : 23|6@0+ (0.01,0) [0|0.63] "m"  ADAS
 SG_ OBJ_DIMENSION_LENGTH_ERR_049 : 41|10@0+ (0.01,0) [0|10.23] "m"  ADAS
 SG_ OBJ_CLS_TYPE1_049 : 271|4@0+ (1,0) [0|15] "NA"  ADAS
 SG_ OBJ_CLS_TYPE1_PROB_049 : 303|8@0+ (0.004,0) [0|1] "NA"  ADAS
 SG_ OBJ_CLS_TYPE2_049 : 267|4@0+ (1,0) [0|15] "NA"  ADAS
 SG_ OBJ_CLS_TYPE2_PROB_049 : 311|8@0+ (0.004,0) [0|1] "NA"  ADAS
 SG_ OBJ_CLS_TYPE3_049 : 279|4@0+ (1,0) [0|15] "NA"  ADAS
 SG_ OBJ_CLS_TYPE3_PROB_049 : 319|8@0+ (0.004,0) [0|1] "NA"  ADAS
 SG_ OBJ_CLS_TYPE4_049 : 275|4@0+ (1,0) [0|15] "NA"  ADAS
 SG_ OBJ_CLS_TYPE4_PROB_049 : 327|8@0+ (0.004,0) [0|1] "NA"  ADAS
 SG_ OBJ_CLS_TYPE5_049 : 287|4@0+ (1,0) [0|15] "NA"  ADAS
 SG_ OBJ_CLS_TYPE5_PROB_049 : 335|8@0+ (0.004,0) [0|1] "NA"  ADAS
 SG_ OBJ_CLS_TYPE6_049 : 282|4@0+ (1,0) [0|15] "NA"  ADAS
 SG_ OBJ_CLS_TYPE6_PROB_049 : 343|8@0+ (0.004,0) [0|1] "NA"  ADAS
 SG_ OBJ_RCS_049 : 351|7@0+ (1,-64) [-64|63] "dBsm"  ADAS
 SG_ OBJ_REF_PT_LONG_OFFSET_049 : 357|14@0+ (0.0001,0) [0|1] "NA"  ADAS
 SG_ OBJ_REF_PT_LAT_OFFSET_049 : 370|14@0+ (0.0001,0) [0|1] "NA"  ADAS
 SG_ OBJ_YAW_RATE_049 : 399|10@0+ (0.005,-2.24) [-2.24|2.24] "rad/s"  ADAS
 SG_ OBJ_YAW_RATE_ERR_049 : 388|5@0+ (0.025,0) [0|0.775] "rad/s"  ADAS
 SG_ OBJ_GROUP_ID_049 : 405|6@0+ (1,0) [0|63] "NA"  ADAS
 SG_ OBJ_POS_ERR_CRR_COEF_049 : 415|8@0+ (0.01,-1.2) [-1.2|1] "NA"  ADAS
 SG_ OBJ_VELOCITY_ERR_CRR_COEF_049 : 423|8@0+ (0.01,-1.2) [-1.2|1] "NA"  ADAS
 SG_ OBJ_ACCEL_ERR_CRR_COEF_049 : 431|8@0+ (0.01,-1.2) [-1.2|1] "NA"  ADAS

BO_ 1409 RDR_TRACKER_OBJ_050: 64 RDR02
 SG_ OBJ_ALIVE_TIME_050 : 255|16@0+ (1,0) [0|65535] "ms"  ADAS
 SG_ OBJ_ACCELERATION_LONG_ERR_050 : 215|8@0+ (0.025,0) [0|6.375] "m/s^2"  ADAS
 SG_ OBJ_ACCELERATION_LAT_ERR_050 : 223|8@0+ (0.025,0) [0|6.375] "m/s^2"  ADAS
 SG_ OBJ_VELOCITY_LONG_ERR_050 : 143|8@0+ (0.05,0) [0|12.75] "m/s"  ADAS
 SG_ OBJ_VELOCITY_LAT_ERR_050 : 151|8@0+ (0.05,0) [0|12.75] "m/s"  ADAS
 SG_ OBJ_POS_LONG_ERR_050 : 95|8@0+ (0.025,0) [0|6.375] "m"  ADAS
 SG_ OBJ_POS_LAT_ERR_050 : 103|8@0+ (0.025,0) [0|6.375] "m"  ADAS
 SG_ OBJ_TRACK_MOTION_MODEL_050 : 9|2@0+ (1,0) [0|3] "NA"  ADAS
 SG_ OBJ_DIMENSION_WIDTH_050 : 17|10@0+ (0.01,0) [0|10.23] "m"  ADAS
 SG_ OBJ_DIMENSION_LENGTH_050 : 37|12@0+ (0.01,0) [0|40.95] "m"  ADAS
 SG_ OBJ_EXISTENCE_PROB_050 : 229|14@0+ (0.0001,0) [0|1] "NA"  ADAS
 SG_ OBJ_YAW_ANGLE_050 : 155|12@0+ (0.005,-10) [-10|10.475] "rad"  ADAS
 SG_ OBJ_YAW_ANGLE_ERR_050 : 175|7@0+ (0.01,0) [0|1.27] "rad"  ADAS
 SG_ OBJ_ID_050 : 7|8@0+ (1,0) [0|255] "NA"  ADAS
 SG_ OBJ_MOVEMENT_STATUS_050 : 196|3@0+ (1,0) [0|3] "NA"  ADAS
 SG_ OBJ_MEASUREMENT_STATUS_050 : 14|3@0+ (1,0) [0|7] "NA"  ADAS
 SG_ OBJ_POS_LONG_050 : 63|16@0+ (0.01,-327) [-327|327] "m"  ADAS
 SG_ OBJ_POS_LAT_050 : 79|16@0+ (0.01,-327) [-327|327] "m"  ADAS
 SG_ OBJ_VELOCITY_LONG_050 : 110|15@0+ (0.01,-163) [-163|163] "m/s"  ADAS
 SG_ OBJ_VELOCITY_LAT_050 : 126|15@0+ (0.01,-163) [-163|163] "m/s"  ADAS
 SG_ OBJ_ACCELERATION_LONG_050 : 193|10@0+ (0.05,-20) [-20|20] "m/s^2"  ADAS
 SG_ OBJ_ACCELERATION_LAT_050 : 177|10@0+ (0.05,-20) [-20|20] "m/s^2"  ADAS
 SG_ OBJ_VEH_TRACK_FLAG_050 : 10|1@0+ (1,0) [0|1] "NA"  ADAS
 SG_ OBJ_MH_CYCLE_COUNTER_050 : 487|8@0+ (1,0) [0|255] "NA"  ADAS
 SG_ OBJ_MH_CRC16_050 : 495|16@0+ (1,0) [0|65535] "NA"  ADAS
 SG_ OBJ_TIMESTAMP_OFFSET_050 : 247|8@0+ (1,-127) [-127|128] "ms"  ADAS
 SG_ OBJ_DIMENSION_WIDTH_ERR_050 : 23|6@0+ (0.01,0) [0|0.63] "m"  ADAS
 SG_ OBJ_DIMENSION_LENGTH_ERR_050 : 41|10@0+ (0.01,0) [0|10.23] "m"  ADAS
 SG_ OBJ_CLS_TYPE1_050 : 271|4@0+ (1,0) [0|15] "NA"  ADAS
 SG_ OBJ_CLS_TYPE1_PROB_050 : 303|8@0+ (0.004,0) [0|1] "NA"  ADAS
 SG_ OBJ_CLS_TYPE2_050 : 267|4@0+ (1,0) [0|15] "NA"  ADAS
 SG_ OBJ_CLS_TYPE2_PROB_050 : 311|8@0+ (0.004,0) [0|1] "NA"  ADAS
 SG_ OBJ_CLS_TYPE3_050 : 279|4@0+ (1,0) [0|15] "NA"  ADAS
 SG_ OBJ_CLS_TYPE3_PROB_050 : 319|8@0+ (0.004,0) [0|1] "NA"  ADAS
 SG_ OBJ_CLS_TYPE4_050 : 275|4@0+ (1,0) [0|15] "NA"  ADAS
 SG_ OBJ_CLS_TYPE4_PROB_050 : 327|8@0+ (0.004,0) [0|1] "NA"  ADAS
 SG_ OBJ_CLS_TYPE5_050 : 287|4@0+ (1,0) [0|15] "NA"  ADAS
 SG_ OBJ_CLS_TYPE5_PROB_050 : 335|8@0+ (0.004,0) [0|1] "NA"  ADAS
 SG_ OBJ_CLS_TYPE6_050 : 282|4@0+ (1,0) [0|15] "NA"  ADAS
 SG_ OBJ_CLS_TYPE6_PROB_050 : 343|8@0+ (0.004,0) [0|1] "NA"  ADAS
 SG_ OBJ_RCS_050 : 351|7@0+ (1,-64) [-64|63] "dBsm"  ADAS
 SG_ OBJ_REF_PT_LONG_OFFSET_050 : 357|14@0+ (0.0001,0) [0|1] "NA"  ADAS
 SG_ OBJ_REF_PT_LAT_OFFSET_050 : 370|14@0+ (0.0001,0) [0|1] "NA"  ADAS
 SG_ OBJ_YAW_RATE_050 : 399|10@0+ (0.005,-2.24) [-2.24|2.24] "rad/s"  ADAS
 SG_ OBJ_YAW_RATE_ERR_050 : 388|5@0+ (0.025,0) [0|0.775] "rad/s"  ADAS
 SG_ OBJ_GROUP_ID_050 : 405|6@0+ (1,0) [0|63] "NA"  ADAS
 SG_ OBJ_POS_ERR_CRR_COEF_050 : 415|8@0+ (0.01,-1.2) [-1.2|1] "NA"  ADAS
 SG_ OBJ_VELOCITY_ERR_CRR_COEF_050 : 423|8@0+ (0.01,-1.2) [-1.2|1] "NA"  ADAS
 SG_ OBJ_ACCEL_ERR_CRR_COEF_050 : 431|8@0+ (0.01,-1.2) [-1.2|1] "NA"  ADAS

BO_ 1410 RDR_TRACKER_OBJ_051: 64 RDR02
 SG_ OBJ_ALIVE_TIME_051 : 255|16@0+ (1,0) [0|65535] "ms"  ADAS
 SG_ OBJ_ACCELERATION_LONG_ERR_051 : 215|8@0+ (0.025,0) [0|6.375] "m/s^2"  ADAS
 SG_ OBJ_ACCELERATION_LAT_ERR_051 : 223|8@0+ (0.025,0) [0|6.375] "m/s^2"  ADAS
 SG_ OBJ_VELOCITY_LONG_ERR_051 : 143|8@0+ (0.05,0) [0|12.75] "m/s"  ADAS
 SG_ OBJ_VELOCITY_LAT_ERR_051 : 151|8@0+ (0.05,0) [0|12.75] "m/s"  ADAS
 SG_ OBJ_POS_LONG_ERR_051 : 95|8@0+ (0.025,0) [0|6.375] "m"  ADAS
 SG_ OBJ_POS_LAT_ERR_051 : 103|8@0+ (0.025,0) [0|6.375] "m"  ADAS
 SG_ OBJ_TRACK_MOTION_MODEL_051 : 9|2@0+ (1,0) [0|3] "NA"  ADAS
 SG_ OBJ_DIMENSION_WIDTH_051 : 17|10@0+ (0.01,0) [0|10.23] "m"  ADAS
 SG_ OBJ_DIMENSION_LENGTH_051 : 37|12@0+ (0.01,0) [0|40.95] "m"  ADAS
 SG_ OBJ_EXISTENCE_PROB_051 : 229|14@0+ (0.0001,0) [0|1] "NA"  ADAS
 SG_ OBJ_YAW_ANGLE_051 : 155|12@0+ (0.005,-10) [-10|10.475] "rad"  ADAS
 SG_ OBJ_YAW_ANGLE_ERR_051 : 175|7@0+ (0.01,0) [0|1.27] "rad"  ADAS
 SG_ OBJ_ID_051 : 7|8@0+ (1,0) [0|255] "NA"  ADAS
 SG_ OBJ_MOVEMENT_STATUS_051 : 196|3@0+ (1,0) [0|3] "NA"  ADAS
 SG_ OBJ_MEASUREMENT_STATUS_051 : 14|3@0+ (1,0) [0|7] "NA"  ADAS
 SG_ OBJ_POS_LONG_051 : 63|16@0+ (0.01,-327) [-327|327] "m"  ADAS
 SG_ OBJ_POS_LAT_051 : 79|16@0+ (0.01,-327) [-327|327] "m"  ADAS
 SG_ OBJ_VELOCITY_LONG_051 : 110|15@0+ (0.01,-163) [-163|163] "m/s"  ADAS
 SG_ OBJ_VELOCITY_LAT_051 : 126|15@0+ (0.01,-163) [-163|163] "m/s"  ADAS
 SG_ OBJ_ACCELERATION_LONG_051 : 193|10@0+ (0.05,-20) [-20|20] "m/s^2"  ADAS
 SG_ OBJ_ACCELERATION_LAT_051 : 177|10@0+ (0.05,-20) [-20|20] "m/s^2"  ADAS
 SG_ OBJ_VEH_TRACK_FLAG_051 : 10|1@0+ (1,0) [0|1] "NA"  ADAS
 SG_ OBJ_MH_CYCLE_COUNTER_051 : 487|8@0+ (1,0) [0|255] "NA"  ADAS
 SG_ OBJ_MH_CRC16_051 : 495|16@0+ (1,0) [0|65535] "NA"  ADAS
 SG_ OBJ_TIMESTAMP_OFFSET_051 : 247|8@0+ (1,-127) [-127|128] "ms"  ADAS
 SG_ OBJ_DIMENSION_WIDTH_ERR_051 : 23|6@0+ (0.01,0) [0|0.63] "m"  ADAS
 SG_ OBJ_DIMENSION_LENGTH_ERR_051 : 41|10@0+ (0.01,0) [0|10.23] "m"  ADAS
 SG_ OBJ_CLS_TYPE1_051 : 271|4@0+ (1,0) [0|15] "NA"  ADAS
 SG_ OBJ_CLS_TYPE1_PROB_051 : 303|8@0+ (0.004,0) [0|1] "NA"  ADAS
 SG_ OBJ_CLS_TYPE2_051 : 267|4@0+ (1,0) [0|15] "NA"  ADAS
 SG_ OBJ_CLS_TYPE2_PROB_051 : 311|8@0+ (0.004,0) [0|1] "NA"  ADAS
 SG_ OBJ_CLS_TYPE3_051 : 279|4@0+ (1,0) [0|15] "NA"  ADAS
 SG_ OBJ_CLS_TYPE3_PROB_051 : 319|8@0+ (0.004,0) [0|1] "NA"  ADAS
 SG_ OBJ_CLS_TYPE4_051 : 275|4@0+ (1,0) [0|15] "NA"  ADAS
 SG_ OBJ_CLS_TYPE4_PROB_051 : 327|8@0+ (0.004,0) [0|1] "NA"  ADAS
 SG_ OBJ_CLS_TYPE5_051 : 287|4@0+ (1,0) [0|15] "NA"  ADAS
 SG_ OBJ_CLS_TYPE5_PROB_051 : 335|8@0+ (0.004,0) [0|1] "NA"  ADAS
 SG_ OBJ_CLS_TYPE6_051 : 282|4@0+ (1,0) [0|15] "NA"  ADAS
 SG_ OBJ_CLS_TYPE6_PROB_051 : 343|8@0+ (0.004,0) [0|1] "NA"  ADAS
 SG_ OBJ_RCS_051 : 351|7@0+ (1,-64) [-64|63] "dBsm"  ADAS
 SG_ OBJ_REF_PT_LONG_OFFSET_051 : 357|14@0+ (0.0001,0) [0|1] "NA"  ADAS
 SG_ OBJ_REF_PT_LAT_OFFSET_051 : 370|14@0+ (0.0001,0) [0|1] "NA"  ADAS
 SG_ OBJ_YAW_RATE_051 : 399|10@0+ (0.005,-2.24) [-2.24|2.24] "rad/s"  ADAS
 SG_ OBJ_YAW_RATE_ERR_051 : 388|5@0+ (0.025,0) [0|0.775] "rad/s"  ADAS
 SG_ OBJ_GROUP_ID_051 : 405|6@0+ (1,0) [0|63] "NA"  ADAS
 SG_ OBJ_POS_ERR_CRR_COEF_051 : 415|8@0+ (0.01,-1.2) [-1.2|1] "NA"  ADAS
 SG_ OBJ_VELOCITY_ERR_CRR_COEF_051 : 423|8@0+ (0.01,-1.2) [-1.2|1] "NA"  ADAS
 SG_ OBJ_ACCEL_ERR_CRR_COEF_051 : 431|8@0+ (0.01,-1.2) [-1.2|1] "NA"  ADAS

BO_ 1411 RDR_TRACKER_OBJ_052: 64 RDR02
 SG_ OBJ_ALIVE_TIME_052 : 255|16@0+ (1,0) [0|65535] "ms"  ADAS
 SG_ OBJ_ACCELERATION_LONG_ERR_052 : 215|8@0+ (0.025,0) [0|6.375] "m/s^2"  ADAS
 SG_ OBJ_ACCELERATION_LAT_ERR_052 : 223|8@0+ (0.025,0) [0|6.375] "m/s^2"  ADAS
 SG_ OBJ_VELOCITY_LONG_ERR_052 : 143|8@0+ (0.05,0) [0|12.75] "m/s"  ADAS
 SG_ OBJ_VELOCITY_LAT_ERR_052 : 151|8@0+ (0.05,0) [0|12.75] "m/s"  ADAS
 SG_ OBJ_POS_LONG_ERR_052 : 95|8@0+ (0.025,0) [0|6.375] "m"  ADAS
 SG_ OBJ_POS_LAT_ERR_052 : 103|8@0+ (0.025,0) [0|6.375] "m"  ADAS
 SG_ OBJ_TRACK_MOTION_MODEL_052 : 9|2@0+ (1,0) [0|3] "NA"  ADAS
 SG_ OBJ_DIMENSION_WIDTH_052 : 17|10@0+ (0.01,0) [0|10.23] "m"  ADAS
 SG_ OBJ_DIMENSION_LENGTH_052 : 37|12@0+ (0.01,0) [0|40.95] "m"  ADAS
 SG_ OBJ_EXISTENCE_PROB_052 : 229|14@0+ (0.0001,0) [0|1] "NA"  ADAS
 SG_ OBJ_YAW_ANGLE_052 : 155|12@0+ (0.005,-10) [-10|10.475] "rad"  ADAS
 SG_ OBJ_YAW_ANGLE_ERR_052 : 175|7@0+ (0.01,0) [0|1.27] "rad"  ADAS
 SG_ OBJ_ID_052 : 7|8@0+ (1,0) [0|255] "NA"  ADAS
 SG_ OBJ_MOVEMENT_STATUS_052 : 196|3@0+ (1,0) [0|3] "NA"  ADAS
 SG_ OBJ_MEASUREMENT_STATUS_052 : 14|3@0+ (1,0) [0|7] "NA"  ADAS
 SG_ OBJ_POS_LONG_052 : 63|16@0+ (0.01,-327) [-327|327] "m"  ADAS
 SG_ OBJ_POS_LAT_052 : 79|16@0+ (0.01,-327) [-327|327] "m"  ADAS
 SG_ OBJ_VELOCITY_LONG_052 : 110|15@0+ (0.01,-163) [-163|163] "m/s"  ADAS
 SG_ OBJ_VELOCITY_LAT_052 : 126|15@0+ (0.01,-163) [-163|163] "m/s"  ADAS
 SG_ OBJ_ACCELERATION_LONG_052 : 193|10@0+ (0.05,-20) [-20|20] "m/s^2"  ADAS
 SG_ OBJ_ACCELERATION_LAT_052 : 177|10@0+ (0.05,-20) [-20|20] "m/s^2"  ADAS
 SG_ OBJ_VEH_TRACK_FLAG_052 : 10|1@0+ (1,0) [0|1] "NA"  ADAS
 SG_ OBJ_MH_CYCLE_COUNTER_052 : 487|8@0+ (1,0) [0|255] "NA"  ADAS
 SG_ OBJ_MH_CRC16_052 : 495|16@0+ (1,0) [0|65535] "NA"  ADAS
 SG_ OBJ_TIMESTAMP_OFFSET_052 : 247|8@0+ (1,-127) [-127|128] "ms"  ADAS
 SG_ OBJ_DIMENSION_WIDTH_ERR_052 : 23|6@0+ (0.01,0) [0|0.63] "m"  ADAS
 SG_ OBJ_DIMENSION_LENGTH_ERR_052 : 41|10@0+ (0.01,0) [0|10.23] "m"  ADAS
 SG_ OBJ_CLS_TYPE1_052 : 271|4@0+ (1,0) [0|15] "NA"  ADAS
 SG_ OBJ_CLS_TYPE1_PROB_052 : 303|8@0+ (0.004,0) [0|1] "NA"  ADAS
 SG_ OBJ_CLS_TYPE2_052 : 267|4@0+ (1,0) [0|15] "NA"  ADAS
 SG_ OBJ_CLS_TYPE2_PROB_052 : 311|8@0+ (0.004,0) [0|1] "NA"  ADAS
 SG_ OBJ_CLS_TYPE3_052 : 279|4@0+ (1,0) [0|15] "NA"  ADAS
 SG_ OBJ_CLS_TYPE3_PROB_052 : 319|8@0+ (0.004,0) [0|1] "NA"  ADAS
 SG_ OBJ_CLS_TYPE4_052 : 275|4@0+ (1,0) [0|15] "NA"  ADAS
 SG_ OBJ_CLS_TYPE4_PROB_052 : 327|8@0+ (0.004,0) [0|1] "NA"  ADAS
 SG_ OBJ_CLS_TYPE5_052 : 287|4@0+ (1,0) [0|15] "NA"  ADAS
 SG_ OBJ_CLS_TYPE5_PROB_052 : 335|8@0+ (0.004,0) [0|1] "NA"  ADAS
 SG_ OBJ_CLS_TYPE6_052 : 282|4@0+ (1,0) [0|15] "NA"  ADAS
 SG_ OBJ_CLS_TYPE6_PROB_052 : 343|8@0+ (0.004,0) [0|1] "NA"  ADAS
 SG_ OBJ_RCS_052 : 351|7@0+ (1,-64) [-64|63] "dBsm"  ADAS
 SG_ OBJ_REF_PT_LONG_OFFSET_052 : 357|14@0+ (0.0001,0) [0|1] "NA"  ADAS
 SG_ OBJ_REF_PT_LAT_OFFSET_052 : 370|14@0+ (0.0001,0) [0|1] "NA"  ADAS
 SG_ OBJ_YAW_RATE_052 : 399|10@0+ (0.005,-2.24) [-2.24|2.24] "rad/s"  ADAS
 SG_ OBJ_YAW_RATE_ERR_052 : 388|5@0+ (0.025,0) [0|0.775] "rad/s"  ADAS
 SG_ OBJ_GROUP_ID_052 : 405|6@0+ (1,0) [0|63] "NA"  ADAS
 SG_ OBJ_POS_ERR_CRR_COEF_052 : 415|8@0+ (0.01,-1.2) [-1.2|1] "NA"  ADAS
 SG_ OBJ_VELOCITY_ERR_CRR_COEF_052 : 423|8@0+ (0.01,-1.2) [-1.2|1] "NA"  ADAS
 SG_ OBJ_ACCEL_ERR_CRR_COEF_052 : 431|8@0+ (0.01,-1.2) [-1.2|1] "NA"  ADAS

BA_DEF_ BO_  "VFrameFormat" ENUM  "StandardCAN","ExtendedCAN","reserved","reserved","reserved","reserved","reserved","reserved","reserved","reserved","reserved","reserved","reserved","reserved","StandardCAN_FD","ExtendedCAN_FD";
BA_DEF_ BO_  "CanTpBs" INT 0 255;
BA_DEF_ BO_  "DiagConnection" INT 0 65535;
BA_DEF_ BO_  "DiagRequest" ENUM  "No","Yes";
BA_DEF_ BO_  "DiagResponse" ENUM  "No","Yes";
BA_DEF_ BO_  "DiagState" ENUM  "No","Yes";
BA_DEF_ BO_  "E2EDataId" INT 0 65535;
BA_DEF_ BO_  "E2EDataLength" INT 0 65535;
BA_DEF_ BO_  "E2EProfile" STRING ;
BA_DEF_ BO_  "EventRateOfChange" INT 10 10000;
BA_DEF_ BO_  "GenMsgCycleTime" INT 0 100000;
BA_DEF_ BO_  "GenMsgILSupport" ENUM  "No","Yes";
BA_DEF_ BO_  "GenMsgNrOfRepetition" INT 0 100;
BA_DEF_ BO_  "GenMsgSendType" ENUM  "FixedPeriodic","Event","EnabledPeriodic","NotUsed","NotUsed","EventPeriodic","NotUsed","NotUsed","NoMsgSendType";
BA_DEF_ BO_  "NetworkInitialization" ENUM  "No","Yes";
BA_DEF_ BO_  "NmAsrMessage" ENUM  "No","Yes";
BA_DEF_ BO_  "NmMessage" ENUM  "No","Yes";
BA_DEF_ BO_  "SCP_AuthInfoTxLength" INT 0 512;
BA_DEF_ BO_  "SCP_FreshnessValueLength" INT 0 512;
BA_DEF_ BO_  "SCP_FreshnessValueTxLength" INT 0 512;
BA_DEF_ BO_  "TpTxIndex" INT 0 255;
BA_DEF_ SG_  "GenSigCmt" STRING ;
BA_DEF_ SG_  "GenSigCycleTime" INT 0 0;
BA_DEF_ SG_  "GenSigSendType" ENUM  "Cyclic","OnWrite","vector_leerstring","OnChange","vector_leerstring","IfActive","vector_leerstring","NoSigSendType";
BA_DEF_ SG_  "GenSigStartValue" INT 0 1000000000;
BA_DEF_ SG_  "GenSigTimeoutTime" INT 0 0;
BA_DEF_ SG_  "GenSigVtEn" STRING ;
BA_DEF_ SG_  "GenSigVtName" STRING ;
BA_DEF_ SG_  "InvalidValue" STRING ;
BA_DEF_ SG_  "SystemSignalLongSymbol" STRING ;
BA_DEF_REL_ BU_SG_REL_  "SC_Verification" ENUM  "No","Yes";
BA_DEF_DEF_  "VFrameFormat" "StandardCAN_FD";
BA_DEF_DEF_  "CanTpBs" 255;
BA_DEF_DEF_  "DiagConnection" 0;
BA_DEF_DEF_  "DiagRequest" "No";
BA_DEF_DEF_  "DiagResponse" "No";
BA_DEF_DEF_  "DiagState" "No";
BA_DEF_DEF_  "E2EDataId" 0;
BA_DEF_DEF_  "E2EDataLength" 0;
BA_DEF_DEF_  "E2EProfile" "";
BA_DEF_DEF_  "EventRateOfChange" 10000;
BA_DEF_DEF_  "GenMsgCycleTime" 0;
BA_DEF_DEF_  "GenMsgILSupport" "Yes";
BA_DEF_DEF_  "GenMsgNrOfRepetition" 0;
BA_DEF_DEF_  "GenMsgSendType" "NoMsgSendType";
BA_DEF_DEF_  "NetworkInitialization" "Yes";
BA_DEF_DEF_  "NmAsrMessage" "No";
BA_DEF_DEF_  "NmMessage" "No";
BA_DEF_DEF_  "SCP_AuthInfoTxLength" 28;
BA_DEF_DEF_  "SCP_FreshnessValueLength" 48;
BA_DEF_DEF_  "SCP_FreshnessValueTxLength" 4;
BA_DEF_DEF_  "TpTxIndex" 0;
BA_DEF_DEF_  "GenSigCmt" "";
BA_DEF_DEF_  "GenSigCycleTime" 0;
BA_DEF_DEF_  "GenSigSendType" "NoSigSendType";
BA_DEF_DEF_  "GenSigStartValue" 0;
BA_DEF_DEF_  "GenSigTimeoutTime" 0;
BA_DEF_DEF_  "GenSigVtEn" "";
BA_DEF_DEF_  "GenSigVtName" "";
BA_DEF_DEF_  "InvalidValue" "";
BA_DEF_DEF_REL_ "SC_Verification" "No";
BA_DEF_DEF_  "SystemSignalLongSymbol" "";
SIG_GROUP_ 1371 TrackerObject012 1 : OBJ_ALIVE_TIME_012 OBJ_ACCELERATION_LONG_ERR_012 OBJ_ACCELERATION_LAT_ERR_012 OBJ_VELOCITY_LONG_ERR_012 OBJ_VELOCITY_LAT_ERR_012 OBJ_POS_LONG_ERR_012 OBJ_POS_LAT_ERR_012 OBJ_TRACK_MOTION_MODEL_012 OBJ_DIMENSION_WIDTH_012 OBJ_DIMENSION_LENGTH_012 OBJ_EXISTENCE_PROB_012 OBJ_YAW_ANGLE_012 OBJ_YAW_ANGLE_ERR_012 OBJ_ID_012 OBJ_MOVEMENT_STATUS_012 OBJ_MEASUREMENT_STATUS_012 OBJ_POS_LONG_012 OBJ_POS_LAT_012 OBJ_VELOCITY_LONG_012 OBJ_VELOCITY_LAT_012 OBJ_ACCELERATION_LONG_012 OBJ_ACCELERATION_LAT_012 OBJ_VEH_TRACK_FLAG_012 OBJ_MH_CYCLE_COUNTER_012 OBJ_MH_CRC16_012 OBJ_TIMESTAMP_OFFSET_012 OBJ_DIMENSION_WIDTH_ERR_012 OBJ_DIMENSION_LENGTH_ERR_012 OBJ_CLS_TYPE1_012 OBJ_CLS_TYPE1_PROB_012 OBJ_CLS_TYPE2_012 OBJ_CLS_TYPE2_PROB_012 OBJ_CLS_TYPE3_012 OBJ_CLS_TYPE3_PROB_012 OBJ_CLS_TYPE4_012 OBJ_CLS_TYPE4_PROB_012 OBJ_CLS_TYPE5_012 OBJ_CLS_TYPE5_PROB_012 OBJ_CLS_TYPE6_012 OBJ_CLS_TYPE6_PROB_012 OBJ_RCS_012 OBJ_REF_PT_LONG_OFFSET_012 OBJ_REF_PT_LAT_OFFSET_012 OBJ_YAW_RATE_012 OBJ_YAW_RATE_ERR_012 OBJ_GROUP_ID_012 OBJ_POS_ERR_CRR_COEF_012 OBJ_VELOCITY_ERR_CRR_COEF_012 OBJ_ACCEL_ERR_CRR_COEF_012;
SIG_GROUP_ 1372 TrackerObject013 1 : OBJ_ALIVE_TIME_013 OBJ_ACCELERATION_LONG_ERR_013 OBJ_ACCELERATION_LAT_ERR_013 OBJ_VELOCITY_LONG_ERR_013 OBJ_VELOCITY_LAT_ERR_013 OBJ_POS_LONG_ERR_013 OBJ_POS_LAT_ERR_013 OBJ_TRACK_MOTION_MODEL_013 OBJ_DIMENSION_WIDTH_013 OBJ_DIMENSION_LENGTH_013 OBJ_EXISTENCE_PROB_013 OBJ_YAW_ANGLE_013 OBJ_YAW_ANGLE_ERR_013 OBJ_ID_013 OBJ_MOVEMENT_STATUS_013 OBJ_MEASUREMENT_STATUS_013 OBJ_POS_LONG_013 OBJ_POS_LAT_013 OBJ_VELOCITY_LONG_013 OBJ_VELOCITY_LAT_013 OBJ_ACCELERATION_LONG_013 OBJ_ACCELERATION_LAT_013 OBJ_VEH_TRACK_FLAG_013 OBJ_MH_CYCLE_COUNTER_013 OBJ_MH_CRC16_013 OBJ_TIMESTAMP_OFFSET_013 OBJ_DIMENSION_WIDTH_ERR_013 OBJ_DIMENSION_LENGTH_ERR_013 OBJ_CLS_TYPE1_013 OBJ_CLS_TYPE1_PROB_013 OBJ_CLS_TYPE2_013 OBJ_CLS_TYPE2_PROB_013 OBJ_CLS_TYPE3_013 OBJ_CLS_TYPE3_PROB_013 OBJ_CLS_TYPE4_013 OBJ_CLS_TYPE4_PROB_013 OBJ_CLS_TYPE5_013 OBJ_CLS_TYPE5_PROB_013 OBJ_CLS_TYPE6_013 OBJ_CLS_TYPE6_PROB_013 OBJ_RCS_013 OBJ_REF_PT_LONG_OFFSET_013 OBJ_REF_PT_LAT_OFFSET_013 OBJ_YAW_RATE_013 OBJ_YAW_RATE_ERR_013 OBJ_GROUP_ID_013 OBJ_POS_ERR_CRR_COEF_013 OBJ_VELOCITY_ERR_CRR_COEF_013 OBJ_ACCEL_ERR_CRR_COEF_013;
SIG_GROUP_ 1373 TrackerObject014 1 : OBJ_ALIVE_TIME_014 OBJ_ACCELERATION_LONG_ERR_014 OBJ_ACCELERATION_LAT_ERR_014 OBJ_VELOCITY_LONG_ERR_014 OBJ_VELOCITY_LAT_ERR_014 OBJ_POS_LONG_ERR_014 OBJ_POS_LAT_ERR_014 OBJ_TRACK_MOTION_MODEL_014 OBJ_DIMENSION_WIDTH_014 OBJ_DIMENSION_LENGTH_014 OBJ_EXISTENCE_PROB_014 OBJ_YAW_ANGLE_014 OBJ_YAW_ANGLE_ERR_014 OBJ_ID_014 OBJ_MOVEMENT_STATUS_014 OBJ_MEASUREMENT_STATUS_014 OBJ_POS_LONG_014 OBJ_POS_LAT_014 OBJ_VELOCITY_LONG_014 OBJ_VELOCITY_LAT_014 OBJ_ACCELERATION_LONG_014 OBJ_ACCELERATION_LAT_014 OBJ_VEH_TRACK_FLAG_014 OBJ_MH_CYCLE_COUNTER_014 OBJ_MH_CRC16_014 OBJ_TIMESTAMP_OFFSET_014 OBJ_DIMENSION_WIDTH_ERR_014 OBJ_DIMENSION_LENGTH_ERR_014 OBJ_CLS_TYPE1_014 OBJ_CLS_TYPE1_PROB_014 OBJ_CLS_TYPE2_014 OBJ_CLS_TYPE2_PROB_014 OBJ_CLS_TYPE3_014 OBJ_CLS_TYPE3_PROB_014 OBJ_CLS_TYPE4_014 OBJ_CLS_TYPE4_PROB_014 OBJ_CLS_TYPE5_014 OBJ_CLS_TYPE5_PROB_014 OBJ_CLS_TYPE6_014 OBJ_CLS_TYPE6_PROB_014 OBJ_RCS_014 OBJ_REF_PT_LONG_OFFSET_014 OBJ_REF_PT_LAT_OFFSET_014 OBJ_YAW_RATE_014 OBJ_YAW_RATE_ERR_014 OBJ_GROUP_ID_014 OBJ_POS_ERR_CRR_COEF_014 OBJ_VELOCITY_ERR_CRR_COEF_014 OBJ_ACCEL_ERR_CRR_COEF_014;
SIG_GROUP_ 1374 TrackerObject015 1 : OBJ_ALIVE_TIME_015 OBJ_ACCELERATION_LONG_ERR_015 OBJ_ACCELERATION_LAT_ERR_015 OBJ_VELOCITY_LONG_ERR_015 OBJ_VELOCITY_LAT_ERR_015 OBJ_POS_LONG_ERR_015 OBJ_POS_LAT_ERR_015 OBJ_TRACK_MOTION_MODEL_015 OBJ_DIMENSION_WIDTH_015 OBJ_DIMENSION_LENGTH_015 OBJ_EXISTENCE_PROB_015 OBJ_YAW_ANGLE_015 OBJ_YAW_ANGLE_ERR_015 OBJ_ID_015 OBJ_MOVEMENT_STATUS_015 OBJ_MEASUREMENT_STATUS_015 OBJ_POS_LONG_015 OBJ_POS_LAT_015 OBJ_VELOCITY_LONG_015 OBJ_VELOCITY_LAT_015 OBJ_ACCELERATION_LONG_015 OBJ_ACCELERATION_LAT_015 OBJ_VEH_TRACK_FLAG_015 OBJ_MH_CYCLE_COUNTER_015 OBJ_MH_CRC16_015 OBJ_TIMESTAMP_OFFSET_015 OBJ_DIMENSION_WIDTH_ERR_015 OBJ_DIMENSION_LENGTH_ERR_015 OBJ_CLS_TYPE1_015 OBJ_CLS_TYPE1_PROB_015 OBJ_CLS_TYPE2_015 OBJ_CLS_TYPE2_PROB_015 OBJ_CLS_TYPE3_015 OBJ_CLS_TYPE3_PROB_015 OBJ_CLS_TYPE4_015 OBJ_CLS_TYPE4_PROB_015 OBJ_CLS_TYPE5_015 OBJ_CLS_TYPE5_PROB_015 OBJ_CLS_TYPE6_015 OBJ_CLS_TYPE6_PROB_015 OBJ_RCS_015 OBJ_REF_PT_LONG_OFFSET_015 OBJ_REF_PT_LAT_OFFSET_015 OBJ_YAW_RATE_015 OBJ_YAW_RATE_ERR_015 OBJ_GROUP_ID_015 OBJ_POS_ERR_CRR_COEF_015 OBJ_VELOCITY_ERR_CRR_COEF_015 OBJ_ACCEL_ERR_CRR_COEF_015;
SIG_GROUP_ 1375 TrackerObject016 1 : OBJ_ALIVE_TIME_016 OBJ_ACCELERATION_LONG_ERR_016 OBJ_ACCELERATION_LAT_ERR_016 OBJ_VELOCITY_LONG_ERR_016 OBJ_VELOCITY_LAT_ERR_016 OBJ_POS_LONG_ERR_016 OBJ_POS_LAT_ERR_016 OBJ_TRACK_MOTION_MODEL_016 OBJ_DIMENSION_WIDTH_016 OBJ_DIMENSION_LENGTH_016 OBJ_EXISTENCE_PROB_016 OBJ_YAW_ANGLE_016 OBJ_YAW_ANGLE_ERR_016 OBJ_ID_016 OBJ_MOVEMENT_STATUS_016 OBJ_MEASUREMENT_STATUS_016 OBJ_POS_LONG_016 OBJ_POS_LAT_016 OBJ_VELOCITY_LONG_016 OBJ_VELOCITY_LAT_016 OBJ_ACCELERATION_LONG_016 OBJ_ACCELERATION_LAT_016 OBJ_VEH_TRACK_FLAG_016 OBJ_MH_CYCLE_COUNTER_016 OBJ_MH_CRC16_016 OBJ_TIMESTAMP_OFFSET_016 OBJ_DIMENSION_WIDTH_ERR_016 OBJ_DIMENSION_LENGTH_ERR_016 OBJ_CLS_TYPE1_016 OBJ_CLS_TYPE1_PROB_016 OBJ_CLS_TYPE2_016 OBJ_CLS_TYPE2_PROB_016 OBJ_CLS_TYPE3_016 OBJ_CLS_TYPE3_PROB_016 OBJ_CLS_TYPE4_016 OBJ_CLS_TYPE4_PROB_016 OBJ_CLS_TYPE5_016 OBJ_CLS_TYPE5_PROB_016 OBJ_CLS_TYPE6_016 OBJ_CLS_TYPE6_PROB_016 OBJ_RCS_016 OBJ_REF_PT_LONG_OFFSET_016 OBJ_REF_PT_LAT_OFFSET_016 OBJ_YAW_RATE_016 OBJ_YAW_RATE_ERR_016 OBJ_GROUP_ID_016 OBJ_POS_ERR_CRR_COEF_016 OBJ_VELOCITY_ERR_CRR_COEF_016 OBJ_ACCEL_ERR_CRR_COEF_016;
SIG_GROUP_ 1376 TrackerObject017 1 : OBJ_ALIVE_TIME_017 OBJ_ACCELERATION_LONG_ERR_017 OBJ_ACCELERATION_LAT_ERR_017 OBJ_VELOCITY_LONG_ERR_017 OBJ_VELOCITY_LAT_ERR_017 OBJ_POS_LONG_ERR_017 OBJ_POS_LAT_ERR_017 OBJ_TRACK_MOTION_MODEL_017 OBJ_DIMENSION_WIDTH_017 OBJ_DIMENSION_LENGTH_017 OBJ_EXISTENCE_PROB_017 OBJ_YAW_ANGLE_017 OBJ_YAW_ANGLE_ERR_017 OBJ_ID_017 OBJ_MOVEMENT_STATUS_017 OBJ_MEASUREMENT_STATUS_017 OBJ_POS_LONG_017 OBJ_POS_LAT_017 OBJ_VELOCITY_LONG_017 OBJ_VELOCITY_LAT_017 OBJ_ACCELERATION_LONG_017 OBJ_ACCELERATION_LAT_017 OBJ_VEH_TRACK_FLAG_017 OBJ_MH_CYCLE_COUNTER_017 OBJ_MH_CRC16_017 OBJ_TIMESTAMP_OFFSET_017 OBJ_DIMENSION_WIDTH_ERR_017 OBJ_DIMENSION_LENGTH_ERR_017 OBJ_CLS_TYPE1_017 OBJ_CLS_TYPE1_PROB_017 OBJ_CLS_TYPE2_017 OBJ_CLS_TYPE2_PROB_017 OBJ_CLS_TYPE3_017 OBJ_CLS_TYPE3_PROB_017 OBJ_CLS_TYPE4_017 OBJ_CLS_TYPE4_PROB_017 OBJ_CLS_TYPE5_017 OBJ_CLS_TYPE5_PROB_017 OBJ_CLS_TYPE6_017 OBJ_CLS_TYPE6_PROB_017 OBJ_RCS_017 OBJ_REF_PT_LONG_OFFSET_017 OBJ_REF_PT_LAT_OFFSET_017 OBJ_YAW_RATE_017 OBJ_YAW_RATE_ERR_017 OBJ_GROUP_ID_017 OBJ_POS_ERR_CRR_COEF_017 OBJ_VELOCITY_ERR_CRR_COEF_017 OBJ_ACCEL_ERR_CRR_COEF_017;
SIG_GROUP_ 1377 TrackerObject018 1 : OBJ_ALIVE_TIME_018 OBJ_ACCELERATION_LONG_ERR_018 OBJ_ACCELERATION_LAT_ERR_018 OBJ_VELOCITY_LONG_ERR_018 OBJ_VELOCITY_LAT_ERR_018 OBJ_POS_LONG_ERR_018 OBJ_POS_LAT_ERR_018 OBJ_TRACK_MOTION_MODEL_018 OBJ_DIMENSION_WIDTH_018 OBJ_DIMENSION_LENGTH_018 OBJ_EXISTENCE_PROB_018 OBJ_YAW_ANGLE_018 OBJ_YAW_ANGLE_ERR_018 OBJ_ID_018 OBJ_MOVEMENT_STATUS_018 OBJ_MEASUREMENT_STATUS_018 OBJ_POS_LONG_018 OBJ_POS_LAT_018 OBJ_VELOCITY_LONG_018 OBJ_VELOCITY_LAT_018 OBJ_ACCELERATION_LONG_018 OBJ_ACCELERATION_LAT_018 OBJ_VEH_TRACK_FLAG_018 OBJ_MH_CYCLE_COUNTER_018 OBJ_MH_CRC16_018 OBJ_TIMESTAMP_OFFSET_018 OBJ_DIMENSION_WIDTH_ERR_018 OBJ_DIMENSION_LENGTH_ERR_018 OBJ_CLS_TYPE1_018 OBJ_CLS_TYPE1_PROB_018 OBJ_CLS_TYPE2_018 OBJ_CLS_TYPE2_PROB_018 OBJ_CLS_TYPE3_018 OBJ_CLS_TYPE3_PROB_018 OBJ_CLS_TYPE4_018 OBJ_CLS_TYPE4_PROB_018 OBJ_CLS_TYPE5_018 OBJ_CLS_TYPE5_PROB_018 OBJ_CLS_TYPE6_018 OBJ_CLS_TYPE6_PROB_018 OBJ_RCS_018 OBJ_REF_PT_LONG_OFFSET_018 OBJ_REF_PT_LAT_OFFSET_018 OBJ_YAW_RATE_018 OBJ_YAW_RATE_ERR_018 OBJ_GROUP_ID_018 OBJ_POS_ERR_CRR_COEF_018 OBJ_VELOCITY_ERR_CRR_COEF_018 OBJ_ACCEL_ERR_CRR_COEF_018;
SIG_GROUP_ 1378 TrackerObject019 1 : OBJ_ALIVE_TIME_019 OBJ_ACCELERATION_LONG_ERR_019 OBJ_ACCELERATION_LAT_ERR_019 OBJ_VELOCITY_LONG_ERR_019 OBJ_VELOCITY_LAT_ERR_019 OBJ_POS_LONG_ERR_019 OBJ_POS_LAT_ERR_019 OBJ_TRACK_MOTION_MODEL_019 OBJ_DIMENSION_WIDTH_019 OBJ_DIMENSION_LENGTH_019 OBJ_EXISTENCE_PROB_019 OBJ_YAW_ANGLE_019 OBJ_YAW_ANGLE_ERR_019 OBJ_ID_019 OBJ_MOVEMENT_STATUS_019 OBJ_MEASUREMENT_STATUS_019 OBJ_POS_LONG_019 OBJ_POS_LAT_019 OBJ_VELOCITY_LONG_019 OBJ_VELOCITY_LAT_019 OBJ_ACCELERATION_LONG_019 OBJ_ACCELERATION_LAT_019 OBJ_VEH_TRACK_FLAG_019 OBJ_MH_CYCLE_COUNTER_019 OBJ_MH_CRC16_019 OBJ_TIMESTAMP_OFFSET_019 OBJ_DIMENSION_WIDTH_ERR_019 OBJ_DIMENSION_LENGTH_ERR_019 OBJ_CLS_TYPE1_019 OBJ_CLS_TYPE1_PROB_019 OBJ_CLS_TYPE2_019 OBJ_CLS_TYPE2_PROB_019 OBJ_CLS_TYPE3_019 OBJ_CLS_TYPE3_PROB_019 OBJ_CLS_TYPE4_019 OBJ_CLS_TYPE4_PROB_019 OBJ_CLS_TYPE5_019 OBJ_CLS_TYPE5_PROB_019 OBJ_CLS_TYPE6_019 OBJ_CLS_TYPE6_PROB_019 OBJ_RCS_019 OBJ_REF_PT_LONG_OFFSET_019 OBJ_REF_PT_LAT_OFFSET_019 OBJ_YAW_RATE_019 OBJ_YAW_RATE_ERR_019 OBJ_GROUP_ID_019 OBJ_POS_ERR_CRR_COEF_019 OBJ_VELOCITY_ERR_CRR_COEF_019 OBJ_ACCEL_ERR_CRR_COEF_019;
SIG_GROUP_ 1379 TrackerObject020 1 : OBJ_ALIVE_TIME_020 OBJ_ACCELERATION_LONG_ERR_020 OBJ_ACCELERATION_LAT_ERR_020 OBJ_VELOCITY_LONG_ERR_020 OBJ_VELOCITY_LAT_ERR_020 OBJ_POS_LONG_ERR_020 OBJ_POS_LAT_ERR_020 OBJ_TRACK_MOTION_MODEL_020 OBJ_DIMENSION_WIDTH_020 OBJ_DIMENSION_LENGTH_020 OBJ_EXISTENCE_PROB_020 OBJ_YAW_ANGLE_020 OBJ_YAW_ANGLE_ERR_020 OBJ_ID_020 OBJ_MOVEMENT_STATUS_020 OBJ_MEASUREMENT_STATUS_020 OBJ_POS_LONG_020 OBJ_POS_LAT_020 OBJ_VELOCITY_LONG_020 OBJ_VELOCITY_LAT_020 OBJ_ACCELERATION_LONG_020 OBJ_ACCELERATION_LAT_020 OBJ_VEH_TRACK_FLAG_020 OBJ_MH_CYCLE_COUNTER_020 OBJ_MH_CRC16_020 OBJ_TIMESTAMP_OFFSET_020 OBJ_DIMENSION_WIDTH_ERR_020 OBJ_DIMENSION_LENGTH_ERR_020 OBJ_CLS_TYPE1_020 OBJ_CLS_TYPE1_PROB_020 OBJ_CLS_TYPE2_020 OBJ_CLS_TYPE2_PROB_020 OBJ_CLS_TYPE3_020 OBJ_CLS_TYPE3_PROB_020 OBJ_CLS_TYPE4_020 OBJ_CLS_TYPE4_PROB_020 OBJ_CLS_TYPE5_020 OBJ_CLS_TYPE5_PROB_020 OBJ_CLS_TYPE6_020 OBJ_CLS_TYPE6_PROB_020 OBJ_RCS_020 OBJ_REF_PT_LONG_OFFSET_020 OBJ_REF_PT_LAT_OFFSET_020 OBJ_YAW_RATE_020 OBJ_YAW_RATE_ERR_020 OBJ_GROUP_ID_020 OBJ_POS_ERR_CRR_COEF_020 OBJ_VELOCITY_ERR_CRR_COEF_020 OBJ_ACCEL_ERR_CRR_COEF_020;
SIG_GROUP_ 1380 TrackerObject021 1 : OBJ_ALIVE_TIME_021 OBJ_ACCELERATION_LONG_ERR_021 OBJ_ACCELERATION_LAT_ERR_021 OBJ_VELOCITY_LONG_ERR_021 OBJ_VELOCITY_LAT_ERR_021 OBJ_POS_LONG_ERR_021 OBJ_POS_LAT_ERR_021 OBJ_TRACK_MOTION_MODEL_021 OBJ_DIMENSION_WIDTH_021 OBJ_DIMENSION_LENGTH_021 OBJ_EXISTENCE_PROB_021 OBJ_YAW_ANGLE_021 OBJ_YAW_ANGLE_ERR_021 OBJ_ID_021 OBJ_MOVEMENT_STATUS_021 OBJ_MEASUREMENT_STATUS_021 OBJ_POS_LONG_021 OBJ_POS_LAT_021 OBJ_VELOCITY_LONG_021 OBJ_VELOCITY_LAT_021 OBJ_ACCELERATION_LONG_021 OBJ_ACCELERATION_LAT_021 OBJ_VEH_TRACK_FLAG_021 OBJ_MH_CYCLE_COUNTER_021 OBJ_MH_CRC16_021 OBJ_TIMESTAMP_OFFSET_021 OBJ_DIMENSION_WIDTH_ERR_021 OBJ_DIMENSION_LENGTH_ERR_021 OBJ_CLS_TYPE1_021 OBJ_CLS_TYPE1_PROB_021 OBJ_CLS_TYPE2_021 OBJ_CLS_TYPE2_PROB_021 OBJ_CLS_TYPE3_021 OBJ_CLS_TYPE3_PROB_021 OBJ_CLS_TYPE4_021 OBJ_CLS_TYPE4_PROB_021 OBJ_CLS_TYPE5_021 OBJ_CLS_TYPE5_PROB_021 OBJ_CLS_TYPE6_021 OBJ_CLS_TYPE6_PROB_021 OBJ_RCS_021 OBJ_REF_PT_LONG_OFFSET_021 OBJ_REF_PT_LAT_OFFSET_021 OBJ_YAW_RATE_021 OBJ_YAW_RATE_ERR_021 OBJ_GROUP_ID_021 OBJ_POS_ERR_CRR_COEF_021 OBJ_VELOCITY_ERR_CRR_COEF_021 OBJ_ACCEL_ERR_CRR_COEF_021;
SIG_GROUP_ 1381 TrackerObject022 1 : OBJ_ALIVE_TIME_022 OBJ_ACCELERATION_LONG_ERR_022 OBJ_ACCELERATION_LAT_ERR_022 OBJ_VELOCITY_LONG_ERR_022 OBJ_VELOCITY_LAT_ERR_022 OBJ_POS_LONG_ERR_022 OBJ_POS_LAT_ERR_022 OBJ_TRACK_MOTION_MODEL_022 OBJ_DIMENSION_WIDTH_022 OBJ_DIMENSION_LENGTH_022 OBJ_EXISTENCE_PROB_022 OBJ_YAW_ANGLE_022 OBJ_YAW_ANGLE_ERR_022 OBJ_ID_022 OBJ_MOVEMENT_STATUS_022 OBJ_MEASUREMENT_STATUS_022 OBJ_POS_LONG_022 OBJ_POS_LAT_022 OBJ_VELOCITY_LONG_022 OBJ_VELOCITY_LAT_022 OBJ_ACCELERATION_LONG_022 OBJ_ACCELERATION_LAT_022 OBJ_VEH_TRACK_FLAG_022 OBJ_MH_CYCLE_COUNTER_022 OBJ_MH_CRC16_022 OBJ_TIMESTAMP_OFFSET_022 OBJ_DIMENSION_WIDTH_ERR_022 OBJ_DIMENSION_LENGTH_ERR_022 OBJ_CLS_TYPE1_022 OBJ_CLS_TYPE1_PROB_022 OBJ_CLS_TYPE2_022 OBJ_CLS_TYPE2_PROB_022 OBJ_CLS_TYPE3_022 OBJ_CLS_TYPE3_PROB_022 OBJ_CLS_TYPE4_022 OBJ_CLS_TYPE4_PROB_022 OBJ_CLS_TYPE5_022 OBJ_CLS_TYPE5_PROB_022 OBJ_CLS_TYPE6_022 OBJ_CLS_TYPE6_PROB_022 OBJ_RCS_022 OBJ_REF_PT_LONG_OFFSET_022 OBJ_REF_PT_LAT_OFFSET_022 OBJ_YAW_RATE_022 OBJ_YAW_RATE_ERR_022 OBJ_GROUP_ID_022 OBJ_POS_ERR_CRR_COEF_022 OBJ_VELOCITY_ERR_CRR_COEF_022 OBJ_ACCEL_ERR_CRR_COEF_022;
SIG_GROUP_ 1382 TrackerObject023 1 : OBJ_ALIVE_TIME_023 OBJ_ACCELERATION_LONG_ERR_023 OBJ_ACCELERATION_LAT_ERR_023 OBJ_VELOCITY_LONG_ERR_023 OBJ_VELOCITY_LAT_ERR_023 OBJ_POS_LONG_ERR_023 OBJ_POS_LAT_ERR_023 OBJ_TRACK_MOTION_MODEL_023 OBJ_DIMENSION_WIDTH_023 OBJ_DIMENSION_LENGTH_023 OBJ_EXISTENCE_PROB_023 OBJ_YAW_ANGLE_023 OBJ_YAW_ANGLE_ERR_023 OBJ_ID_023 OBJ_MOVEMENT_STATUS_023 OBJ_MEASUREMENT_STATUS_023 OBJ_POS_LONG_023 OBJ_POS_LAT_023 OBJ_VELOCITY_LONG_023 OBJ_VELOCITY_LAT_023 OBJ_ACCELERATION_LONG_023 OBJ_ACCELERATION_LAT_023 OBJ_VEH_TRACK_FLAG_023 OBJ_MH_CYCLE_COUNTER_023 OBJ_MH_CRC16_023 OBJ_TIMESTAMP_OFFSET_023 OBJ_DIMENSION_WIDTH_ERR_023 OBJ_DIMENSION_LENGTH_ERR_023 OBJ_CLS_TYPE1_023 OBJ_CLS_TYPE1_PROB_023 OBJ_CLS_TYPE2_023 OBJ_CLS_TYPE2_PROB_023 OBJ_CLS_TYPE3_023 OBJ_CLS_TYPE3_PROB_023 OBJ_CLS_TYPE4_023 OBJ_CLS_TYPE4_PROB_023 OBJ_CLS_TYPE5_023 OBJ_CLS_TYPE5_PROB_023 OBJ_CLS_TYPE6_023 OBJ_CLS_TYPE6_PROB_023 OBJ_RCS_023 OBJ_REF_PT_LONG_OFFSET_023 OBJ_REF_PT_LAT_OFFSET_023 OBJ_YAW_RATE_023 OBJ_YAW_RATE_ERR_023 OBJ_GROUP_ID_023 OBJ_POS_ERR_CRR_COEF_023 OBJ_VELOCITY_ERR_CRR_COEF_023 OBJ_ACCEL_ERR_CRR_COEF_023;
SIG_GROUP_ 1383 TrackerObject024 1 : OBJ_ALIVE_TIME_024 OBJ_ACCELERATION_LONG_ERR_024 OBJ_ACCELERATION_LAT_ERR_024 OBJ_VELOCITY_LONG_ERR_024 OBJ_VELOCITY_LAT_ERR_024 OBJ_POS_LONG_ERR_024 OBJ_POS_LAT_ERR_024 OBJ_TRACK_MOTION_MODEL_024 OBJ_DIMENSION_WIDTH_024 OBJ_DIMENSION_LENGTH_024 OBJ_EXISTENCE_PROB_024 OBJ_YAW_ANGLE_024 OBJ_YAW_ANGLE_ERR_024 OBJ_ID_024 OBJ_MOVEMENT_STATUS_024 OBJ_MEASUREMENT_STATUS_024 OBJ_POS_LONG_024 OBJ_POS_LAT_024 OBJ_VELOCITY_LONG_024 OBJ_VELOCITY_LAT_024 OBJ_ACCELERATION_LONG_024 OBJ_ACCELERATION_LAT_024 OBJ_VEH_TRACK_FLAG_024 OBJ_MH_CYCLE_COUNTER_024 OBJ_MH_CRC16_024 OBJ_TIMESTAMP_OFFSET_024 OBJ_DIMENSION_WIDTH_ERR_024 OBJ_DIMENSION_LENGTH_ERR_024 OBJ_CLS_TYPE1_024 OBJ_CLS_TYPE1_PROB_024 OBJ_CLS_TYPE2_024 OBJ_CLS_TYPE2_PROB_024 OBJ_CLS_TYPE3_024 OBJ_CLS_TYPE3_PROB_024 OBJ_CLS_TYPE4_024 OBJ_CLS_TYPE4_PROB_024 OBJ_CLS_TYPE5_024 OBJ_CLS_TYPE5_PROB_024 OBJ_CLS_TYPE6_024 OBJ_CLS_TYPE6_PROB_024 OBJ_RCS_024 OBJ_REF_PT_LONG_OFFSET_024 OBJ_REF_PT_LAT_OFFSET_024 OBJ_YAW_RATE_024 OBJ_YAW_RATE_ERR_024 OBJ_GROUP_ID_024 OBJ_POS_ERR_CRR_COEF_024 OBJ_VELOCITY_ERR_CRR_COEF_024 OBJ_ACCEL_ERR_CRR_COEF_024;
SIG_GROUP_ 1384 TrackerObject025 1 : OBJ_ALIVE_TIME_025 OBJ_ACCELERATION_LONG_ERR_025 OBJ_ACCELERATION_LAT_ERR_025 OBJ_VELOCITY_LONG_ERR_025 OBJ_VELOCITY_LAT_ERR_025 OBJ_POS_LONG_ERR_025 OBJ_POS_LAT_ERR_025 OBJ_TRACK_MOTION_MODEL_025 OBJ_DIMENSION_WIDTH_025 OBJ_DIMENSION_LENGTH_025 OBJ_EXISTENCE_PROB_025 OBJ_YAW_ANGLE_025 OBJ_YAW_ANGLE_ERR_025 OBJ_ID_025 OBJ_MOVEMENT_STATUS_025 OBJ_MEASUREMENT_STATUS_025 OBJ_POS_LONG_025 OBJ_POS_LAT_025 OBJ_VELOCITY_LONG_025 OBJ_VELOCITY_LAT_025 OBJ_ACCELERATION_LONG_025 OBJ_ACCELERATION_LAT_025 OBJ_VEH_TRACK_FLAG_025 OBJ_MH_CYCLE_COUNTER_025 OBJ_MH_CRC16_025 OBJ_TIMESTAMP_OFFSET_025 OBJ_DIMENSION_WIDTH_ERR_025 OBJ_DIMENSION_LENGTH_ERR_025 OBJ_CLS_TYPE1_025 OBJ_CLS_TYPE1_PROB_025 OBJ_CLS_TYPE2_025 OBJ_CLS_TYPE2_PROB_025 OBJ_CLS_TYPE3_025 OBJ_CLS_TYPE3_PROB_025 OBJ_CLS_TYPE4_025 OBJ_CLS_TYPE4_PROB_025 OBJ_CLS_TYPE5_025 OBJ_CLS_TYPE5_PROB_025 OBJ_CLS_TYPE6_025 OBJ_CLS_TYPE6_PROB_025 OBJ_RCS_025 OBJ_REF_PT_LONG_OFFSET_025 OBJ_REF_PT_LAT_OFFSET_025 OBJ_YAW_RATE_025 OBJ_YAW_RATE_ERR_025 OBJ_GROUP_ID_025 OBJ_POS_ERR_CRR_COEF_025 OBJ_VELOCITY_ERR_CRR_COEF_025 OBJ_ACCEL_ERR_CRR_COEF_025;
SIG_GROUP_ 1385 TrackerObject026 1 : OBJ_ALIVE_TIME_026 OBJ_ACCELERATION_LONG_ERR_026 OBJ_ACCELERATION_LAT_ERR_026 OBJ_VELOCITY_LONG_ERR_026 OBJ_VELOCITY_LAT_ERR_026 OBJ_POS_LONG_ERR_026 OBJ_POS_LAT_ERR_026 OBJ_TRACK_MOTION_MODEL_026 OBJ_DIMENSION_WIDTH_026 OBJ_DIMENSION_LENGTH_026 OBJ_EXISTENCE_PROB_026 OBJ_YAW_ANGLE_026 OBJ_YAW_ANGLE_ERR_026 OBJ_ID_026 OBJ_MOVEMENT_STATUS_026 OBJ_MEASUREMENT_STATUS_026 OBJ_POS_LONG_026 OBJ_POS_LAT_026 OBJ_VELOCITY_LONG_026 OBJ_VELOCITY_LAT_026 OBJ_ACCELERATION_LONG_026 OBJ_ACCELERATION_LAT_026 OBJ_VEH_TRACK_FLAG_026 OBJ_MH_CYCLE_COUNTER_026 OBJ_MH_CRC16_026 OBJ_TIMESTAMP_OFFSET_026 OBJ_DIMENSION_WIDTH_ERR_026 OBJ_DIMENSION_LENGTH_ERR_026 OBJ_CLS_TYPE1_026 OBJ_CLS_TYPE1_PROB_026 OBJ_CLS_TYPE2_026 OBJ_CLS_TYPE2_PROB_026 OBJ_CLS_TYPE3_026 OBJ_CLS_TYPE3_PROB_026 OBJ_CLS_TYPE4_026 OBJ_CLS_TYPE4_PROB_026 OBJ_CLS_TYPE5_026 OBJ_CLS_TYPE5_PROB_026 OBJ_CLS_TYPE6_026 OBJ_CLS_TYPE6_PROB_026 OBJ_RCS_026 OBJ_REF_PT_LONG_OFFSET_026 OBJ_REF_PT_LAT_OFFSET_026 OBJ_YAW_RATE_026 OBJ_YAW_RATE_ERR_026 OBJ_GROUP_ID_026 OBJ_POS_ERR_CRR_COEF_026 OBJ_VELOCITY_ERR_CRR_COEF_026 OBJ_ACCEL_ERR_CRR_COEF_026;
SIG_GROUP_ 1386 TrackerObject027 1 : OBJ_ALIVE_TIME_027 OBJ_ACCELERATION_LONG_ERR_027 OBJ_ACCELERATION_LAT_ERR_027 OBJ_VELOCITY_LONG_ERR_027 OBJ_VELOCITY_LAT_ERR_027 OBJ_POS_LONG_ERR_027 OBJ_POS_LAT_ERR_027 OBJ_TRACK_MOTION_MODEL_027 OBJ_DIMENSION_WIDTH_027 OBJ_DIMENSION_LENGTH_027 OBJ_EXISTENCE_PROB_027 OBJ_YAW_ANGLE_027 OBJ_YAW_ANGLE_ERR_027 OBJ_ID_027 OBJ_MOVEMENT_STATUS_027 OBJ_MEASUREMENT_STATUS_027 OBJ_POS_LONG_027 OBJ_POS_LAT_027 OBJ_VELOCITY_LONG_027 OBJ_VELOCITY_LAT_027 OBJ_ACCELERATION_LONG_027 OBJ_ACCELERATION_LAT_027 OBJ_VEH_TRACK_FLAG_027 OBJ_MH_CYCLE_COUNTER_027 OBJ_MH_CRC16_027 OBJ_TIMESTAMP_OFFSET_027 OBJ_DIMENSION_WIDTH_ERR_027 OBJ_DIMENSION_LENGTH_ERR_027 OBJ_CLS_TYPE1_027 OBJ_CLS_TYPE1_PROB_027 OBJ_CLS_TYPE2_027 OBJ_CLS_TYPE2_PROB_027 OBJ_CLS_TYPE3_027 OBJ_CLS_TYPE3_PROB_027 OBJ_CLS_TYPE4_027 OBJ_CLS_TYPE4_PROB_027 OBJ_CLS_TYPE5_027 OBJ_CLS_TYPE5_PROB_027 OBJ_CLS_TYPE6_027 OBJ_CLS_TYPE6_PROB_027 OBJ_RCS_027 OBJ_REF_PT_LONG_OFFSET_027 OBJ_REF_PT_LAT_OFFSET_027 OBJ_YAW_RATE_027 OBJ_YAW_RATE_ERR_027 OBJ_GROUP_ID_027 OBJ_POS_ERR_CRR_COEF_027 OBJ_VELOCITY_ERR_CRR_COEF_027 OBJ_ACCEL_ERR_CRR_COEF_027;
SIG_GROUP_ 1387 TrackerObject028 1 : OBJ_ALIVE_TIME_028 OBJ_ACCELERATION_LONG_ERR_028 OBJ_ACCELERATION_LAT_ERR_028 OBJ_VELOCITY_LONG_ERR_028 OBJ_VELOCITY_LAT_ERR_028 OBJ_POS_LONG_ERR_028 OBJ_POS_LAT_ERR_028 OBJ_TRACK_MOTION_MODEL_028 OBJ_DIMENSION_WIDTH_028 OBJ_DIMENSION_LENGTH_028 OBJ_EXISTENCE_PROB_028 OBJ_YAW_ANGLE_028 OBJ_YAW_ANGLE_ERR_028 OBJ_ID_028 OBJ_MOVEMENT_STATUS_028 OBJ_MEASUREMENT_STATUS_028 OBJ_POS_LONG_028 OBJ_POS_LAT_028 OBJ_VELOCITY_LONG_028 OBJ_VELOCITY_LAT_028 OBJ_ACCELERATION_LONG_028 OBJ_ACCELERATION_LAT_028 OBJ_VEH_TRACK_FLAG_028 OBJ_MH_CYCLE_COUNTER_028 OBJ_MH_CRC16_028 OBJ_TIMESTAMP_OFFSET_028 OBJ_DIMENSION_WIDTH_ERR_028 OBJ_DIMENSION_LENGTH_ERR_028 OBJ_CLS_TYPE1_028 OBJ_CLS_TYPE1_PROB_028 OBJ_CLS_TYPE2_028 OBJ_CLS_TYPE2_PROB_028 OBJ_CLS_TYPE3_028 OBJ_CLS_TYPE3_PROB_028 OBJ_CLS_TYPE4_028 OBJ_CLS_TYPE4_PROB_028 OBJ_CLS_TYPE5_028 OBJ_CLS_TYPE5_PROB_028 OBJ_CLS_TYPE6_028 OBJ_CLS_TYPE6_PROB_028 OBJ_RCS_028 OBJ_REF_PT_LONG_OFFSET_028 OBJ_REF_PT_LAT_OFFSET_028 OBJ_YAW_RATE_028 OBJ_YAW_RATE_ERR_028 OBJ_GROUP_ID_028 OBJ_POS_ERR_CRR_COEF_028 OBJ_VELOCITY_ERR_CRR_COEF_028 OBJ_ACCEL_ERR_CRR_COEF_028;
SIG_GROUP_ 1388 TrackerObject029 1 : OBJ_ALIVE_TIME_029 OBJ_ACCELERATION_LONG_ERR_029 OBJ_ACCELERATION_LAT_ERR_029 OBJ_VELOCITY_LONG_ERR_029 OBJ_VELOCITY_LAT_ERR_029 OBJ_POS_LONG_ERR_029 OBJ_POS_LAT_ERR_029 OBJ_TRACK_MOTION_MODEL_029 OBJ_DIMENSION_WIDTH_029 OBJ_DIMENSION_LENGTH_029 OBJ_EXISTENCE_PROB_029 OBJ_YAW_ANGLE_029 OBJ_YAW_ANGLE_ERR_029 OBJ_ID_029 OBJ_MOVEMENT_STATUS_029 OBJ_MEASUREMENT_STATUS_029 OBJ_POS_LONG_029 OBJ_POS_LAT_029 OBJ_VELOCITY_LONG_029 OBJ_VELOCITY_LAT_029 OBJ_ACCELERATION_LONG_029 OBJ_ACCELERATION_LAT_029 OBJ_VEH_TRACK_FLAG_029 OBJ_MH_CYCLE_COUNTER_029 OBJ_MH_CRC16_029 OBJ_TIMESTAMP_OFFSET_029 OBJ_DIMENSION_WIDTH_ERR_029 OBJ_DIMENSION_LENGTH_ERR_029 OBJ_CLS_TYPE1_029 OBJ_CLS_TYPE1_PROB_029 OBJ_CLS_TYPE2_029 OBJ_CLS_TYPE2_PROB_029 OBJ_CLS_TYPE3_029 OBJ_CLS_TYPE3_PROB_029 OBJ_CLS_TYPE4_029 OBJ_CLS_TYPE4_PROB_029 OBJ_CLS_TYPE5_029 OBJ_CLS_TYPE5_PROB_029 OBJ_CLS_TYPE6_029 OBJ_CLS_TYPE6_PROB_029 OBJ_RCS_029 OBJ_REF_PT_LONG_OFFSET_029 OBJ_REF_PT_LAT_OFFSET_029 OBJ_YAW_RATE_029 OBJ_YAW_RATE_ERR_029 OBJ_GROUP_ID_029 OBJ_POS_ERR_CRR_COEF_029 OBJ_VELOCITY_ERR_CRR_COEF_029 OBJ_ACCEL_ERR_CRR_COEF_029;
SIG_GROUP_ 1389 TrackerObject030 1 : OBJ_ALIVE_TIME_030 OBJ_ACCELERATION_LONG_ERR_030 OBJ_ACCELERATION_LAT_ERR_030 OBJ_VELOCITY_LONG_ERR_030 OBJ_VELOCITY_LAT_ERR_030 OBJ_POS_LONG_ERR_030 OBJ_POS_LAT_ERR_030 OBJ_TRACK_MOTION_MODEL_030 OBJ_DIMENSION_WIDTH_030 OBJ_DIMENSION_LENGTH_030 OBJ_EXISTENCE_PROB_030 OBJ_YAW_ANGLE_030 OBJ_YAW_ANGLE_ERR_030 OBJ_ID_030 OBJ_MOVEMENT_STATUS_030 OBJ_MEASUREMENT_STATUS_030 OBJ_POS_LONG_030 OBJ_POS_LAT_030 OBJ_VELOCITY_LONG_030 OBJ_VELOCITY_LAT_030 OBJ_ACCELERATION_LONG_030 OBJ_ACCELERATION_LAT_030 OBJ_VEH_TRACK_FLAG_030 OBJ_MH_CYCLE_COUNTER_030 OBJ_MH_CRC16_030 OBJ_TIMESTAMP_OFFSET_030 OBJ_DIMENSION_WIDTH_ERR_030 OBJ_DIMENSION_LENGTH_ERR_030 OBJ_CLS_TYPE1_030 OBJ_CLS_TYPE1_PROB_030 OBJ_CLS_TYPE2_030 OBJ_CLS_TYPE2_PROB_030 OBJ_CLS_TYPE3_030 OBJ_CLS_TYPE3_PROB_030 OBJ_CLS_TYPE4_030 OBJ_CLS_TYPE4_PROB_030 OBJ_CLS_TYPE5_030 OBJ_CLS_TYPE5_PROB_030 OBJ_CLS_TYPE6_030 OBJ_CLS_TYPE6_PROB_030 OBJ_RCS_030 OBJ_REF_PT_LONG_OFFSET_030 OBJ_REF_PT_LAT_OFFSET_030 OBJ_YAW_RATE_030 OBJ_YAW_RATE_ERR_030 OBJ_GROUP_ID_030 OBJ_POS_ERR_CRR_COEF_030 OBJ_VELOCITY_ERR_CRR_COEF_030 OBJ_ACCEL_ERR_CRR_COEF_030;
SIG_GROUP_ 1390 TrackerObject031 1 : OBJ_ALIVE_TIME_031 OBJ_ACCELERATION_LONG_ERR_031 OBJ_ACCELERATION_LAT_ERR_031 OBJ_VELOCITY_LONG_ERR_031 OBJ_VELOCITY_LAT_ERR_031 OBJ_POS_LONG_ERR_031 OBJ_POS_LAT_ERR_031 OBJ_TRACK_MOTION_MODEL_031 OBJ_DIMENSION_WIDTH_031 OBJ_DIMENSION_LENGTH_031 OBJ_EXISTENCE_PROB_031 OBJ_YAW_ANGLE_031 OBJ_YAW_ANGLE_ERR_031 OBJ_ID_031 OBJ_MOVEMENT_STATUS_031 OBJ_MEASUREMENT_STATUS_031 OBJ_POS_LONG_031 OBJ_POS_LAT_031 OBJ_VELOCITY_LONG_031 OBJ_VELOCITY_LAT_031 OBJ_ACCELERATION_LONG_031 OBJ_ACCELERATION_LAT_031 OBJ_VEH_TRACK_FLAG_031 OBJ_MH_CYCLE_COUNTER_031 OBJ_MH_CRC16_031 OBJ_TIMESTAMP_OFFSET_031 OBJ_DIMENSION_WIDTH_ERR_031 OBJ_DIMENSION_LENGTH_ERR_031 OBJ_CLS_TYPE1_031 OBJ_CLS_TYPE1_PROB_031 OBJ_CLS_TYPE2_031 OBJ_CLS_TYPE2_PROB_031 OBJ_CLS_TYPE3_031 OBJ_CLS_TYPE3_PROB_031 OBJ_CLS_TYPE4_031 OBJ_CLS_TYPE4_PROB_031 OBJ_CLS_TYPE5_031 OBJ_CLS_TYPE5_PROB_031 OBJ_CLS_TYPE6_031 OBJ_CLS_TYPE6_PROB_031 OBJ_RCS_031 OBJ_REF_PT_LONG_OFFSET_031 OBJ_REF_PT_LAT_OFFSET_031 OBJ_YAW_RATE_031 OBJ_YAW_RATE_ERR_031 OBJ_GROUP_ID_031 OBJ_POS_ERR_CRR_COEF_031 OBJ_VELOCITY_ERR_CRR_COEF_031 OBJ_ACCEL_ERR_CRR_COEF_031;
SIG_GROUP_ 1391 TrackerObject032 1 : OBJ_ALIVE_TIME_032 OBJ_ACCELERATION_LONG_ERR_032 OBJ_ACCELERATION_LAT_ERR_032 OBJ_VELOCITY_LONG_ERR_032 OBJ_VELOCITY_LAT_ERR_032 OBJ_POS_LONG_ERR_032 OBJ_POS_LAT_ERR_032 OBJ_TRACK_MOTION_MODEL_032 OBJ_DIMENSION_WIDTH_032 OBJ_DIMENSION_LENGTH_032 OBJ_EXISTENCE_PROB_032 OBJ_YAW_ANGLE_032 OBJ_YAW_ANGLE_ERR_032 OBJ_ID_032 OBJ_MOVEMENT_STATUS_032 OBJ_MEASUREMENT_STATUS_032 OBJ_POS_LONG_032 OBJ_POS_LAT_032 OBJ_VELOCITY_LONG_032 OBJ_VELOCITY_LAT_032 OBJ_ACCELERATION_LONG_032 OBJ_ACCELERATION_LAT_032 OBJ_VEH_TRACK_FLAG_032 OBJ_MH_CYCLE_COUNTER_032 OBJ_MH_CRC16_032 OBJ_TIMESTAMP_OFFSET_032 OBJ_DIMENSION_WIDTH_ERR_032 OBJ_DIMENSION_LENGTH_ERR_032 OBJ_CLS_TYPE1_032 OBJ_CLS_TYPE1_PROB_032 OBJ_CLS_TYPE2_032 OBJ_CLS_TYPE2_PROB_032 OBJ_CLS_TYPE3_032 OBJ_CLS_TYPE3_PROB_032 OBJ_CLS_TYPE4_032 OBJ_CLS_TYPE4_PROB_032 OBJ_CLS_TYPE5_032 OBJ_CLS_TYPE5_PROB_032 OBJ_CLS_TYPE6_032 OBJ_CLS_TYPE6_PROB_032 OBJ_RCS_032 OBJ_REF_PT_LONG_OFFSET_032 OBJ_REF_PT_LAT_OFFSET_032 OBJ_YAW_RATE_032 OBJ_YAW_RATE_ERR_032 OBJ_GROUP_ID_032 OBJ_POS_ERR_CRR_COEF_032 OBJ_VELOCITY_ERR_CRR_COEF_032 OBJ_ACCEL_ERR_CRR_COEF_032;
SIG_GROUP_ 1392 TrackerObject033 1 : OBJ_ALIVE_TIME_033 OBJ_ACCELERATION_LONG_ERR_033 OBJ_ACCELERATION_LAT_ERR_033 OBJ_VELOCITY_LONG_ERR_033 OBJ_VELOCITY_LAT_ERR_033 OBJ_POS_LONG_ERR_033 OBJ_POS_LAT_ERR_033 OBJ_TRACK_MOTION_MODEL_033 OBJ_DIMENSION_WIDTH_033 OBJ_DIMENSION_LENGTH_033 OBJ_EXISTENCE_PROB_033 OBJ_YAW_ANGLE_033 OBJ_YAW_ANGLE_ERR_033 OBJ_ID_033 OBJ_MOVEMENT_STATUS_033 OBJ_MEASUREMENT_STATUS_033 OBJ_POS_LONG_033 OBJ_POS_LAT_033 OBJ_VELOCITY_LONG_033 OBJ_VELOCITY_LAT_033 OBJ_ACCELERATION_LONG_033 OBJ_ACCELERATION_LAT_033 OBJ_VEH_TRACK_FLAG_033 OBJ_MH_CYCLE_COUNTER_033 OBJ_MH_CRC16_033 OBJ_TIMESTAMP_OFFSET_033 OBJ_DIMENSION_WIDTH_ERR_033 OBJ_DIMENSION_LENGTH_ERR_033 OBJ_CLS_TYPE1_033 OBJ_CLS_TYPE1_PROB_033 OBJ_CLS_TYPE2_033 OBJ_CLS_TYPE2_PROB_033 OBJ_CLS_TYPE3_033 OBJ_CLS_TYPE3_PROB_033 OBJ_CLS_TYPE4_033 OBJ_CLS_TYPE4_PROB_033 OBJ_CLS_TYPE5_033 OBJ_CLS_TYPE5_PROB_033 OBJ_CLS_TYPE6_033 OBJ_CLS_TYPE6_PROB_033 OBJ_RCS_033 OBJ_REF_PT_LONG_OFFSET_033 OBJ_REF_PT_LAT_OFFSET_033 OBJ_YAW_RATE_033 OBJ_YAW_RATE_ERR_033 OBJ_GROUP_ID_033 OBJ_POS_ERR_CRR_COEF_033 OBJ_VELOCITY_ERR_CRR_COEF_033 OBJ_ACCEL_ERR_CRR_COEF_033;
SIG_GROUP_ 1393 TrackerObject034 1 : OBJ_ALIVE_TIME_034 OBJ_ACCELERATION_LONG_ERR_034 OBJ_ACCELERATION_LAT_ERR_034 OBJ_VELOCITY_LONG_ERR_034 OBJ_VELOCITY_LAT_ERR_034 OBJ_POS_LONG_ERR_034 OBJ_POS_LAT_ERR_034 OBJ_TRACK_MOTION_MODEL_034 OBJ_DIMENSION_WIDTH_034 OBJ_DIMENSION_LENGTH_034 OBJ_EXISTENCE_PROB_034 OBJ_YAW_ANGLE_034 OBJ_YAW_ANGLE_ERR_034 OBJ_ID_034 OBJ_MOVEMENT_STATUS_034 OBJ_MEASUREMENT_STATUS_034 OBJ_POS_LONG_034 OBJ_POS_LAT_034 OBJ_VELOCITY_LONG_034 OBJ_VELOCITY_LAT_034 OBJ_ACCELERATION_LONG_034 OBJ_ACCELERATION_LAT_034 OBJ_VEH_TRACK_FLAG_034 OBJ_MH_CYCLE_COUNTER_034 OBJ_MH_CRC16_034 OBJ_TIMESTAMP_OFFSET_034 OBJ_DIMENSION_WIDTH_ERR_034 OBJ_DIMENSION_LENGTH_ERR_034 OBJ_CLS_TYPE1_034 OBJ_CLS_TYPE1_PROB_034 OBJ_CLS_TYPE2_034 OBJ_CLS_TYPE2_PROB_034 OBJ_CLS_TYPE3_034 OBJ_CLS_TYPE3_PROB_034 OBJ_CLS_TYPE4_034 OBJ_CLS_TYPE4_PROB_034 OBJ_CLS_TYPE5_034 OBJ_CLS_TYPE5_PROB_034 OBJ_CLS_TYPE6_034 OBJ_CLS_TYPE6_PROB_034 OBJ_RCS_034 OBJ_REF_PT_LONG_OFFSET_034 OBJ_REF_PT_LAT_OFFSET_034 OBJ_YAW_RATE_034 OBJ_YAW_RATE_ERR_034 OBJ_GROUP_ID_034 OBJ_POS_ERR_CRR_COEF_034 OBJ_VELOCITY_ERR_CRR_COEF_034 OBJ_ACCEL_ERR_CRR_COEF_034;
SIG_GROUP_ 1394 TrackerObject035 1 : OBJ_ALIVE_TIME_035 OBJ_ACCELERATION_LONG_ERR_035 OBJ_ACCELERATION_LAT_ERR_035 OBJ_VELOCITY_LONG_ERR_035 OBJ_VELOCITY_LAT_ERR_035 OBJ_POS_LONG_ERR_035 OBJ_POS_LAT_ERR_035 OBJ_TRACK_MOTION_MODEL_035 OBJ_DIMENSION_WIDTH_035 OBJ_DIMENSION_LENGTH_035 OBJ_EXISTENCE_PROB_035 OBJ_YAW_ANGLE_035 OBJ_YAW_ANGLE_ERR_035 OBJ_ID_035 OBJ_MOVEMENT_STATUS_035 OBJ_MEASUREMENT_STATUS_035 OBJ_POS_LONG_035 OBJ_POS_LAT_035 OBJ_VELOCITY_LONG_035 OBJ_VELOCITY_LAT_035 OBJ_ACCELERATION_LONG_035 OBJ_ACCELERATION_LAT_035 OBJ_VEH_TRACK_FLAG_035 OBJ_MH_CYCLE_COUNTER_035 OBJ_MH_CRC16_035 OBJ_TIMESTAMP_OFFSET_035 OBJ_DIMENSION_WIDTH_ERR_035 OBJ_DIMENSION_LENGTH_ERR_035 OBJ_CLS_TYPE1_035 OBJ_CLS_TYPE1_PROB_035 OBJ_CLS_TYPE2_035 OBJ_CLS_TYPE2_PROB_035 OBJ_CLS_TYPE3_035 OBJ_CLS_TYPE3_PROB_035 OBJ_CLS_TYPE4_035 OBJ_CLS_TYPE4_PROB_035 OBJ_CLS_TYPE5_035 OBJ_CLS_TYPE5_PROB_035 OBJ_CLS_TYPE6_035 OBJ_CLS_TYPE6_PROB_035 OBJ_RCS_035 OBJ_REF_PT_LONG_OFFSET_035 OBJ_REF_PT_LAT_OFFSET_035 OBJ_YAW_RATE_035 OBJ_YAW_RATE_ERR_035 OBJ_GROUP_ID_035 OBJ_POS_ERR_CRR_COEF_035 OBJ_VELOCITY_ERR_CRR_COEF_035 OBJ_ACCEL_ERR_CRR_COEF_035;
SIG_GROUP_ 1395 TrackerObject036 1 : OBJ_ALIVE_TIME_036 OBJ_ACCELERATION_LONG_ERR_036 OBJ_ACCELERATION_LAT_ERR_036 OBJ_VELOCITY_LONG_ERR_036 OBJ_VELOCITY_LAT_ERR_036 OBJ_POS_LONG_ERR_036 OBJ_POS_LAT_ERR_036 OBJ_TRACK_MOTION_MODEL_036 OBJ_DIMENSION_WIDTH_036 OBJ_DIMENSION_LENGTH_036 OBJ_EXISTENCE_PROB_036 OBJ_YAW_ANGLE_036 OBJ_YAW_ANGLE_ERR_036 OBJ_ID_036 OBJ_MOVEMENT_STATUS_036 OBJ_MEASUREMENT_STATUS_036 OBJ_POS_LONG_036 OBJ_POS_LAT_036 OBJ_VELOCITY_LONG_036 OBJ_VELOCITY_LAT_036 OBJ_ACCELERATION_LONG_036 OBJ_ACCELERATION_LAT_036 OBJ_VEH_TRACK_FLAG_036 OBJ_MH_CYCLE_COUNTER_036 OBJ_MH_CRC16_036 OBJ_TIMESTAMP_OFFSET_036 OBJ_DIMENSION_WIDTH_ERR_036 OBJ_DIMENSION_LENGTH_ERR_036 OBJ_CLS_TYPE1_036 OBJ_CLS_TYPE1_PROB_036 OBJ_CLS_TYPE2_036 OBJ_CLS_TYPE2_PROB_036 OBJ_CLS_TYPE3_036 OBJ_CLS_TYPE3_PROB_036 OBJ_CLS_TYPE4_036 OBJ_CLS_TYPE4_PROB_036 OBJ_CLS_TYPE5_036 OBJ_CLS_TYPE5_PROB_036 OBJ_CLS_TYPE6_036 OBJ_CLS_TYPE6_PROB_036 OBJ_RCS_036 OBJ_REF_PT_LONG_OFFSET_036 OBJ_REF_PT_LAT_OFFSET_036 OBJ_YAW_RATE_036 OBJ_YAW_RATE_ERR_036 OBJ_GROUP_ID_036 OBJ_POS_ERR_CRR_COEF_036 OBJ_VELOCITY_ERR_CRR_COEF_036 OBJ_ACCEL_ERR_CRR_COEF_036;
SIG_GROUP_ 1396 TrackerObject037 1 : OBJ_ALIVE_TIME_037 OBJ_ACCELERATION_LONG_ERR_037 OBJ_ACCELERATION_LAT_ERR_037 OBJ_VELOCITY_LONG_ERR_037 OBJ_VELOCITY_LAT_ERR_037 OBJ_POS_LONG_ERR_037 OBJ_POS_LAT_ERR_037 OBJ_TRACK_MOTION_MODEL_037 OBJ_DIMENSION_WIDTH_037 OBJ_DIMENSION_LENGTH_037 OBJ_EXISTENCE_PROB_037 OBJ_YAW_ANGLE_037 OBJ_YAW_ANGLE_ERR_037 OBJ_ID_037 OBJ_MOVEMENT_STATUS_037 OBJ_MEASUREMENT_STATUS_037 OBJ_POS_LONG_037 OBJ_POS_LAT_037 OBJ_VELOCITY_LONG_037 OBJ_VELOCITY_LAT_037 OBJ_ACCELERATION_LONG_037 OBJ_ACCELERATION_LAT_037 OBJ_VEH_TRACK_FLAG_037 OBJ_MH_CYCLE_COUNTER_037 OBJ_MH_CRC16_037 OBJ_TIMESTAMP_OFFSET_037 OBJ_DIMENSION_WIDTH_ERR_037 OBJ_DIMENSION_LENGTH_ERR_037 OBJ_CLS_TYPE1_037 OBJ_CLS_TYPE1_PROB_037 OBJ_CLS_TYPE2_037 OBJ_CLS_TYPE2_PROB_037 OBJ_CLS_TYPE3_037 OBJ_CLS_TYPE3_PROB_037 OBJ_CLS_TYPE4_037 OBJ_CLS_TYPE4_PROB_037 OBJ_CLS_TYPE5_037 OBJ_CLS_TYPE5_PROB_037 OBJ_CLS_TYPE6_037 OBJ_CLS_TYPE6_PROB_037 OBJ_RCS_037 OBJ_REF_PT_LONG_OFFSET_037 OBJ_REF_PT_LAT_OFFSET_037 OBJ_YAW_RATE_037 OBJ_YAW_RATE_ERR_037 OBJ_GROUP_ID_037 OBJ_POS_ERR_CRR_COEF_037 OBJ_VELOCITY_ERR_CRR_COEF_037 OBJ_ACCEL_ERR_CRR_COEF_037;
SIG_GROUP_ 1397 TrackerObject038 1 : OBJ_ALIVE_TIME_038 OBJ_ACCELERATION_LONG_ERR_038 OBJ_ACCELERATION_LAT_ERR_038 OBJ_VELOCITY_LONG_ERR_038 OBJ_VELOCITY_LAT_ERR_038 OBJ_POS_LONG_ERR_038 OBJ_POS_LAT_ERR_038 OBJ_TRACK_MOTION_MODEL_038 OBJ_DIMENSION_WIDTH_038 OBJ_DIMENSION_LENGTH_038 OBJ_EXISTENCE_PROB_038 OBJ_YAW_ANGLE_038 OBJ_YAW_ANGLE_ERR_038 OBJ_ID_038 OBJ_MOVEMENT_STATUS_038 OBJ_MEASUREMENT_STATUS_038 OBJ_POS_LONG_038 OBJ_POS_LAT_038 OBJ_VELOCITY_LONG_038 OBJ_VELOCITY_LAT_038 OBJ_ACCELERATION_LONG_038 OBJ_ACCELERATION_LAT_038 OBJ_VEH_TRACK_FLAG_038 OBJ_MH_CYCLE_COUNTER_038 OBJ_MH_CRC16_038 OBJ_TIMESTAMP_OFFSET_038 OBJ_DIMENSION_WIDTH_ERR_038 OBJ_DIMENSION_LENGTH_ERR_038 OBJ_CLS_TYPE1_038 OBJ_CLS_TYPE1_PROB_038 OBJ_CLS_TYPE2_038 OBJ_CLS_TYPE2_PROB_038 OBJ_CLS_TYPE3_038 OBJ_CLS_TYPE3_PROB_038 OBJ_CLS_TYPE4_038 OBJ_CLS_TYPE4_PROB_038 OBJ_CLS_TYPE5_038 OBJ_CLS_TYPE5_PROB_038 OBJ_CLS_TYPE6_038 OBJ_CLS_TYPE6_PROB_038 OBJ_RCS_038 OBJ_REF_PT_LONG_OFFSET_038 OBJ_REF_PT_LAT_OFFSET_038 OBJ_YAW_RATE_038 OBJ_YAW_RATE_ERR_038 OBJ_GROUP_ID_038 OBJ_POS_ERR_CRR_COEF_038 OBJ_VELOCITY_ERR_CRR_COEF_038 OBJ_ACCEL_ERR_CRR_COEF_038;
SIG_GROUP_ 1398 TrackerObject039 1 : OBJ_ALIVE_TIME_039 OBJ_ACCELERATION_LONG_ERR_039 OBJ_ACCELERATION_LAT_ERR_039 OBJ_VELOCITY_LONG_ERR_039 OBJ_VELOCITY_LAT_ERR_039 OBJ_POS_LONG_ERR_039 OBJ_POS_LAT_ERR_039 OBJ_TRACK_MOTION_MODEL_039 OBJ_DIMENSION_WIDTH_039 OBJ_DIMENSION_LENGTH_039 OBJ_EXISTENCE_PROB_039 OBJ_YAW_ANGLE_039 OBJ_YAW_ANGLE_ERR_039 OBJ_ID_039 OBJ_MOVEMENT_STATUS_039 OBJ_MEASUREMENT_STATUS_039 OBJ_POS_LONG_039 OBJ_POS_LAT_039 OBJ_VELOCITY_LONG_039 OBJ_VELOCITY_LAT_039 OBJ_ACCELERATION_LONG_039 OBJ_ACCELERATION_LAT_039 OBJ_VEH_TRACK_FLAG_039 OBJ_MH_CYCLE_COUNTER_039 OBJ_MH_CRC16_039 OBJ_TIMESTAMP_OFFSET_039 OBJ_DIMENSION_WIDTH_ERR_039 OBJ_DIMENSION_LENGTH_ERR_039 OBJ_CLS_TYPE1_039 OBJ_CLS_TYPE1_PROB_039 OBJ_CLS_TYPE2_039 OBJ_CLS_TYPE2_PROB_039 OBJ_CLS_TYPE3_039 OBJ_CLS_TYPE3_PROB_039 OBJ_CLS_TYPE4_039 OBJ_CLS_TYPE4_PROB_039 OBJ_CLS_TYPE5_039 OBJ_CLS_TYPE5_PROB_039 OBJ_CLS_TYPE6_039 OBJ_CLS_TYPE6_PROB_039 OBJ_RCS_039 OBJ_REF_PT_LONG_OFFSET_039 OBJ_REF_PT_LAT_OFFSET_039 OBJ_YAW_RATE_039 OBJ_YAW_RATE_ERR_039 OBJ_GROUP_ID_039 OBJ_POS_ERR_CRR_COEF_039 OBJ_VELOCITY_ERR_CRR_COEF_039 OBJ_ACCEL_ERR_CRR_COEF_039;
SIG_GROUP_ 1399 TrackerObject040 1 : OBJ_ALIVE_TIME_040 OBJ_ACCELERATION_LONG_ERR_040 OBJ_ACCELERATION_LAT_ERR_040 OBJ_VELOCITY_LONG_ERR_040 OBJ_VELOCITY_LAT_ERR_040 OBJ_POS_LONG_ERR_040 OBJ_POS_LAT_ERR_040 OBJ_TRACK_MOTION_MODEL_040 OBJ_DIMENSION_WIDTH_040 OBJ_DIMENSION_LENGTH_040 OBJ_EXISTENCE_PROB_040 OBJ_YAW_ANGLE_040 OBJ_YAW_ANGLE_ERR_040 OBJ_ID_040 OBJ_MOVEMENT_STATUS_040 OBJ_MEASUREMENT_STATUS_040 OBJ_POS_LONG_040 OBJ_POS_LAT_040 OBJ_VELOCITY_LONG_040 OBJ_VELOCITY_LAT_040 OBJ_ACCELERATION_LONG_040 OBJ_ACCELERATION_LAT_040 OBJ_VEH_TRACK_FLAG_040 OBJ_MH_CYCLE_COUNTER_040 OBJ_MH_CRC16_040 OBJ_TIMESTAMP_OFFSET_040 OBJ_DIMENSION_WIDTH_ERR_040 OBJ_DIMENSION_LENGTH_ERR_040 OBJ_CLS_TYPE1_040 OBJ_CLS_TYPE1_PROB_040 OBJ_CLS_TYPE2_040 OBJ_CLS_TYPE2_PROB_040 OBJ_CLS_TYPE3_040 OBJ_CLS_TYPE3_PROB_040 OBJ_CLS_TYPE4_040 OBJ_CLS_TYPE4_PROB_040 OBJ_CLS_TYPE5_040 OBJ_CLS_TYPE5_PROB_040 OBJ_CLS_TYPE6_040 OBJ_CLS_TYPE6_PROB_040 OBJ_RCS_040 OBJ_REF_PT_LONG_OFFSET_040 OBJ_REF_PT_LAT_OFFSET_040 OBJ_YAW_RATE_040 OBJ_YAW_RATE_ERR_040 OBJ_GROUP_ID_040 OBJ_POS_ERR_CRR_COEF_040 OBJ_VELOCITY_ERR_CRR_COEF_040 OBJ_ACCEL_ERR_CRR_COEF_040;
SIG_GROUP_ 1400 TrackerObject041 1 : OBJ_ALIVE_TIME_041 OBJ_ACCELERATION_LONG_ERR_041 OBJ_ACCELERATION_LAT_ERR_041 OBJ_VELOCITY_LONG_ERR_041 OBJ_VELOCITY_LAT_ERR_041 OBJ_POS_LONG_ERR_041 OBJ_POS_LAT_ERR_041 OBJ_TRACK_MOTION_MODEL_041 OBJ_DIMENSION_WIDTH_041 OBJ_DIMENSION_LENGTH_041 OBJ_EXISTENCE_PROB_041 OBJ_YAW_ANGLE_041 OBJ_YAW_ANGLE_ERR_041 OBJ_ID_041 OBJ_MOVEMENT_STATUS_041 OBJ_MEASUREMENT_STATUS_041 OBJ_POS_LONG_041 OBJ_POS_LAT_041 OBJ_VELOCITY_LONG_041 OBJ_VELOCITY_LAT_041 OBJ_ACCELERATION_LONG_041 OBJ_ACCELERATION_LAT_041 OBJ_VEH_TRACK_FLAG_041 OBJ_MH_CYCLE_COUNTER_041 OBJ_MH_CRC16_041 OBJ_TIMESTAMP_OFFSET_041 OBJ_DIMENSION_WIDTH_ERR_041 OBJ_DIMENSION_LENGTH_ERR_041 OBJ_CLS_TYPE1_041 OBJ_CLS_TYPE1_PROB_041 OBJ_CLS_TYPE2_041 OBJ_CLS_TYPE2_PROB_041 OBJ_CLS_TYPE3_041 OBJ_CLS_TYPE3_PROB_041 OBJ_CLS_TYPE4_041 OBJ_CLS_TYPE4_PROB_041 OBJ_CLS_TYPE5_041 OBJ_CLS_TYPE5_PROB_041 OBJ_CLS_TYPE6_041 OBJ_CLS_TYPE6_PROB_041 OBJ_RCS_041 OBJ_REF_PT_LONG_OFFSET_041 OBJ_REF_PT_LAT_OFFSET_041 OBJ_YAW_RATE_041 OBJ_YAW_RATE_ERR_041 OBJ_GROUP_ID_041 OBJ_POS_ERR_CRR_COEF_041 OBJ_VELOCITY_ERR_CRR_COEF_041 OBJ_ACCEL_ERR_CRR_COEF_041;
SIG_GROUP_ 1401 TrackerObject042 1 : OBJ_ALIVE_TIME_042 OBJ_ACCELERATION_LONG_ERR_042 OBJ_ACCELERATION_LAT_ERR_042 OBJ_VELOCITY_LONG_ERR_042 OBJ_VELOCITY_LAT_ERR_042 OBJ_POS_LONG_ERR_042 OBJ_POS_LAT_ERR_042 OBJ_TRACK_MOTION_MODEL_042 OBJ_DIMENSION_WIDTH_042 OBJ_DIMENSION_LENGTH_042 OBJ_EXISTENCE_PROB_042 OBJ_YAW_ANGLE_042 OBJ_YAW_ANGLE_ERR_042 OBJ_ID_042 OBJ_MOVEMENT_STATUS_042 OBJ_MEASUREMENT_STATUS_042 OBJ_POS_LONG_042 OBJ_POS_LAT_042 OBJ_VELOCITY_LONG_042 OBJ_VELOCITY_LAT_042 OBJ_ACCELERATION_LONG_042 OBJ_ACCELERATION_LAT_042 OBJ_VEH_TRACK_FLAG_042 OBJ_MH_CYCLE_COUNTER_042 OBJ_MH_CRC16_042 OBJ_TIMESTAMP_OFFSET_042 OBJ_DIMENSION_WIDTH_ERR_042 OBJ_DIMENSION_LENGTH_ERR_042 OBJ_CLS_TYPE1_042 OBJ_CLS_TYPE1_PROB_042 OBJ_CLS_TYPE2_042 OBJ_CLS_TYPE2_PROB_042 OBJ_CLS_TYPE3_042 OBJ_CLS_TYPE3_PROB_042 OBJ_CLS_TYPE4_042 OBJ_CLS_TYPE4_PROB_042 OBJ_CLS_TYPE5_042 OBJ_CLS_TYPE5_PROB_042 OBJ_CLS_TYPE6_042 OBJ_CLS_TYPE6_PROB_042 OBJ_RCS_042 OBJ_REF_PT_LONG_OFFSET_042 OBJ_REF_PT_LAT_OFFSET_042 OBJ_YAW_RATE_042 OBJ_YAW_RATE_ERR_042 OBJ_GROUP_ID_042 OBJ_POS_ERR_CRR_COEF_042 OBJ_VELOCITY_ERR_CRR_COEF_042 OBJ_ACCEL_ERR_CRR_COEF_042;
SIG_GROUP_ 1402 TrackerObject043 1 : OBJ_ALIVE_TIME_043 OBJ_ACCELERATION_LONG_ERR_043 OBJ_ACCELERATION_LAT_ERR_043 OBJ_VELOCITY_LONG_ERR_043 OBJ_VELOCITY_LAT_ERR_043 OBJ_POS_LONG_ERR_043 OBJ_POS_LAT_ERR_043 OBJ_TRACK_MOTION_MODEL_043 OBJ_DIMENSION_WIDTH_043 OBJ_DIMENSION_LENGTH_043 OBJ_EXISTENCE_PROB_043 OBJ_YAW_ANGLE_043 OBJ_YAW_ANGLE_ERR_043 OBJ_ID_043 OBJ_MOVEMENT_STATUS_043 OBJ_MEASUREMENT_STATUS_043 OBJ_POS_LONG_043 OBJ_POS_LAT_043 OBJ_VELOCITY_LONG_043 OBJ_VELOCITY_LAT_043 OBJ_ACCELERATION_LONG_043 OBJ_ACCELERATION_LAT_043 OBJ_VEH_TRACK_FLAG_043 OBJ_MH_CYCLE_COUNTER_043 OBJ_MH_CRC16_043 OBJ_TIMESTAMP_OFFSET_043 OBJ_DIMENSION_WIDTH_ERR_043 OBJ_DIMENSION_LENGTH_ERR_043 OBJ_CLS_TYPE1_043 OBJ_CLS_TYPE1_PROB_043 OBJ_CLS_TYPE2_043 OBJ_CLS_TYPE2_PROB_043 OBJ_CLS_TYPE3_043 OBJ_CLS_TYPE3_PROB_043 OBJ_CLS_TYPE4_043 OBJ_CLS_TYPE4_PROB_043 OBJ_CLS_TYPE5_043 OBJ_CLS_TYPE5_PROB_043 OBJ_CLS_TYPE6_043 OBJ_CLS_TYPE6_PROB_043 OBJ_RCS_043 OBJ_REF_PT_LONG_OFFSET_043 OBJ_REF_PT_LAT_OFFSET_043 OBJ_YAW_RATE_043 OBJ_YAW_RATE_ERR_043 OBJ_GROUP_ID_043 OBJ_POS_ERR_CRR_COEF_043 OBJ_VELOCITY_ERR_CRR_COEF_043 OBJ_ACCEL_ERR_CRR_COEF_043;
SIG_GROUP_ 1403 TrackerObject044 1 : OBJ_ALIVE_TIME_044 OBJ_ACCELERATION_LONG_ERR_044 OBJ_ACCELERATION_LAT_ERR_044 OBJ_VELOCITY_LONG_ERR_044 OBJ_VELOCITY_LAT_ERR_044 OBJ_POS_LONG_ERR_044 OBJ_POS_LAT_ERR_044 OBJ_TRACK_MOTION_MODEL_044 OBJ_DIMENSION_WIDTH_044 OBJ_DIMENSION_LENGTH_044 OBJ_EXISTENCE_PROB_044 OBJ_YAW_ANGLE_044 OBJ_YAW_ANGLE_ERR_044 OBJ_ID_044 OBJ_MOVEMENT_STATUS_044 OBJ_MEASUREMENT_STATUS_044 OBJ_POS_LONG_044 OBJ_POS_LAT_044 OBJ_VELOCITY_LONG_044 OBJ_VELOCITY_LAT_044 OBJ_ACCELERATION_LONG_044 OBJ_ACCELERATION_LAT_044 OBJ_VEH_TRACK_FLAG_044 OBJ_MH_CYCLE_COUNTER_044 OBJ_MH_CRC16_044 OBJ_TIMESTAMP_OFFSET_044 OBJ_DIMENSION_WIDTH_ERR_044 OBJ_DIMENSION_LENGTH_ERR_044 OBJ_CLS_TYPE1_044 OBJ_CLS_TYPE1_PROB_044 OBJ_CLS_TYPE2_044 OBJ_CLS_TYPE2_PROB_044 OBJ_CLS_TYPE3_044 OBJ_CLS_TYPE3_PROB_044 OBJ_CLS_TYPE4_044 OBJ_CLS_TYPE4_PROB_044 OBJ_CLS_TYPE5_044 OBJ_CLS_TYPE5_PROB_044 OBJ_CLS_TYPE6_044 OBJ_CLS_TYPE6_PROB_044 OBJ_RCS_044 OBJ_REF_PT_LONG_OFFSET_044 OBJ_REF_PT_LAT_OFFSET_044 OBJ_YAW_RATE_044 OBJ_YAW_RATE_ERR_044 OBJ_GROUP_ID_044 OBJ_POS_ERR_CRR_COEF_044 OBJ_VELOCITY_ERR_CRR_COEF_044 OBJ_ACCEL_ERR_CRR_COEF_044;
SIG_GROUP_ 1404 TrackerObject045 1 : OBJ_ALIVE_TIME_045 OBJ_ACCELERATION_LONG_ERR_045 OBJ_ACCELERATION_LAT_ERR_045 OBJ_VELOCITY_LONG_ERR_045 OBJ_VELOCITY_LAT_ERR_045 OBJ_POS_LONG_ERR_045 OBJ_POS_LAT_ERR_045 OBJ_TRACK_MOTION_MODEL_045 OBJ_DIMENSION_WIDTH_045 OBJ_DIMENSION_LENGTH_045 OBJ_EXISTENCE_PROB_045 OBJ_YAW_ANGLE_045 OBJ_YAW_ANGLE_ERR_045 OBJ_ID_045 OBJ_MOVEMENT_STATUS_045 OBJ_MEASUREMENT_STATUS_045 OBJ_POS_LONG_045 OBJ_POS_LAT_045 OBJ_VELOCITY_LONG_045 OBJ_VELOCITY_LAT_045 OBJ_ACCELERATION_LONG_045 OBJ_ACCELERATION_LAT_045 OBJ_VEH_TRACK_FLAG_045 OBJ_MH_CYCLE_COUNTER_045 OBJ_MH_CRC16_045 OBJ_TIMESTAMP_OFFSET_045 OBJ_DIMENSION_WIDTH_ERR_045 OBJ_DIMENSION_LENGTH_ERR_045 OBJ_CLS_TYPE1_045 OBJ_CLS_TYPE1_PROB_045 OBJ_CLS_TYPE2_045 OBJ_CLS_TYPE2_PROB_045 OBJ_CLS_TYPE3_045 OBJ_CLS_TYPE3_PROB_045 OBJ_CLS_TYPE4_045 OBJ_CLS_TYPE4_PROB_045 OBJ_CLS_TYPE5_045 OBJ_CLS_TYPE5_PROB_045 OBJ_CLS_TYPE6_045 OBJ_CLS_TYPE6_PROB_045 OBJ_RCS_045 OBJ_REF_PT_LONG_OFFSET_045 OBJ_REF_PT_LAT_OFFSET_045 OBJ_YAW_RATE_045 OBJ_YAW_RATE_ERR_045 OBJ_GROUP_ID_045 OBJ_POS_ERR_CRR_COEF_045 OBJ_VELOCITY_ERR_CRR_COEF_045 OBJ_ACCEL_ERR_CRR_COEF_045;
SIG_GROUP_ 1405 TrackerObject046 1 : OBJ_ALIVE_TIME_046 OBJ_ACCELERATION_LONG_ERR_046 OBJ_ACCELERATION_LAT_ERR_046 OBJ_VELOCITY_LONG_ERR_046 OBJ_VELOCITY_LAT_ERR_046 OBJ_POS_LONG_ERR_046 OBJ_POS_LAT_ERR_046 OBJ_TRACK_MOTION_MODEL_046 OBJ_DIMENSION_WIDTH_046 OBJ_DIMENSION_LENGTH_046 OBJ_EXISTENCE_PROB_046 OBJ_YAW_ANGLE_046 OBJ_YAW_ANGLE_ERR_046 OBJ_ID_046 OBJ_MOVEMENT_STATUS_046 OBJ_MEASUREMENT_STATUS_046 OBJ_POS_LONG_046 OBJ_POS_LAT_046 OBJ_VELOCITY_LONG_046 OBJ_VELOCITY_LAT_046 OBJ_ACCELERATION_LONG_046 OBJ_ACCELERATION_LAT_046 OBJ_VEH_TRACK_FLAG_046 OBJ_MH_CYCLE_COUNTER_046 OBJ_MH_CRC16_046 OBJ_TIMESTAMP_OFFSET_046 OBJ_DIMENSION_WIDTH_ERR_046 OBJ_DIMENSION_LENGTH_ERR_046 OBJ_CLS_TYPE1_046 OBJ_CLS_TYPE1_PROB_046 OBJ_CLS_TYPE2_046 OBJ_CLS_TYPE2_PROB_046 OBJ_CLS_TYPE3_046 OBJ_CLS_TYPE3_PROB_046 OBJ_CLS_TYPE4_046 OBJ_CLS_TYPE4_PROB_046 OBJ_CLS_TYPE5_046 OBJ_CLS_TYPE5_PROB_046 OBJ_CLS_TYPE6_046 OBJ_CLS_TYPE6_PROB_046 OBJ_RCS_046 OBJ_REF_PT_LONG_OFFSET_046 OBJ_REF_PT_LAT_OFFSET_046 OBJ_YAW_RATE_046 OBJ_YAW_RATE_ERR_046 OBJ_GROUP_ID_046 OBJ_POS_ERR_CRR_COEF_046 OBJ_VELOCITY_ERR_CRR_COEF_046 OBJ_ACCEL_ERR_CRR_COEF_046;
SIG_GROUP_ 1406 TrackerObject047 1 : OBJ_ALIVE_TIME_047 OBJ_ACCELERATION_LONG_ERR_047 OBJ_ACCELERATION_LAT_ERR_047 OBJ_VELOCITY_LONG_ERR_047 OBJ_VELOCITY_LAT_ERR_047 OBJ_POS_LONG_ERR_047 OBJ_POS_LAT_ERR_047 OBJ_TRACK_MOTION_MODEL_047 OBJ_DIMENSION_WIDTH_047 OBJ_DIMENSION_LENGTH_047 OBJ_EXISTENCE_PROB_047 OBJ_YAW_ANGLE_047 OBJ_YAW_ANGLE_ERR_047 OBJ_ID_047 OBJ_MOVEMENT_STATUS_047 OBJ_MEASUREMENT_STATUS_047 OBJ_POS_LONG_047 OBJ_POS_LAT_047 OBJ_VELOCITY_LONG_047 OBJ_VELOCITY_LAT_047 OBJ_ACCELERATION_LONG_047 OBJ_ACCELERATION_LAT_047 OBJ_VEH_TRACK_FLAG_047 OBJ_MH_CYCLE_COUNTER_047 OBJ_MH_CRC16_047 OBJ_TIMESTAMP_OFFSET_047 OBJ_DIMENSION_WIDTH_ERR_047 OBJ_DIMENSION_LENGTH_ERR_047 OBJ_CLS_TYPE1_047 OBJ_CLS_TYPE1_PROB_047 OBJ_CLS_TYPE2_047 OBJ_CLS_TYPE2_PROB_047 OBJ_CLS_TYPE3_047 OBJ_CLS_TYPE3_PROB_047 OBJ_CLS_TYPE4_047 OBJ_CLS_TYPE4_PROB_047 OBJ_CLS_TYPE5_047 OBJ_CLS_TYPE5_PROB_047 OBJ_CLS_TYPE6_047 OBJ_CLS_TYPE6_PROB_047 OBJ_RCS_047 OBJ_REF_PT_LONG_OFFSET_047 OBJ_REF_PT_LAT_OFFSET_047 OBJ_YAW_RATE_047 OBJ_YAW_RATE_ERR_047 OBJ_GROUP_ID_047 OBJ_POS_ERR_CRR_COEF_047 OBJ_VELOCITY_ERR_CRR_COEF_047 OBJ_ACCEL_ERR_CRR_COEF_047;
SIG_GROUP_ 1407 TrackerObject048 1 : OBJ_ALIVE_TIME_048 OBJ_ACCELERATION_LONG_ERR_048 OBJ_ACCELERATION_LAT_ERR_048 OBJ_VELOCITY_LONG_ERR_048 OBJ_VELOCITY_LAT_ERR_048 OBJ_POS_LONG_ERR_048 OBJ_POS_LAT_ERR_048 OBJ_TRACK_MOTION_MODEL_048 OBJ_DIMENSION_WIDTH_048 OBJ_DIMENSION_LENGTH_048 OBJ_EXISTENCE_PROB_048 OBJ_YAW_ANGLE_048 OBJ_YAW_ANGLE_ERR_048 OBJ_ID_048 OBJ_MOVEMENT_STATUS_048 OBJ_MEASUREMENT_STATUS_048 OBJ_POS_LONG_048 OBJ_POS_LAT_048 OBJ_VELOCITY_LONG_048 OBJ_VELOCITY_LAT_048 OBJ_ACCELERATION_LONG_048 OBJ_ACCELERATION_LAT_048 OBJ_VEH_TRACK_FLAG_048 OBJ_MH_CYCLE_COUNTER_048 OBJ_MH_CRC16_048 OBJ_TIMESTAMP_OFFSET_048 OBJ_DIMENSION_WIDTH_ERR_048 OBJ_DIMENSION_LENGTH_ERR_048 OBJ_CLS_TYPE1_048 OBJ_CLS_TYPE1_PROB_048 OBJ_CLS_TYPE2_048 OBJ_CLS_TYPE2_PROB_048 OBJ_CLS_TYPE3_048 OBJ_CLS_TYPE3_PROB_048 OBJ_CLS_TYPE4_048 OBJ_CLS_TYPE4_PROB_048 OBJ_CLS_TYPE5_048 OBJ_CLS_TYPE5_PROB_048 OBJ_CLS_TYPE6_048 OBJ_CLS_TYPE6_PROB_048 OBJ_RCS_048 OBJ_REF_PT_LONG_OFFSET_048 OBJ_REF_PT_LAT_OFFSET_048 OBJ_YAW_RATE_048 OBJ_YAW_RATE_ERR_048 OBJ_GROUP_ID_048 OBJ_POS_ERR_CRR_COEF_048 OBJ_VELOCITY_ERR_CRR_COEF_048 OBJ_ACCEL_ERR_CRR_COEF_048;
SIG_GROUP_ 1408 TrackerObject049 1 : OBJ_ALIVE_TIME_049 OBJ_ACCELERATION_LONG_ERR_049 OBJ_ACCELERATION_LAT_ERR_049 OBJ_VELOCITY_LONG_ERR_049 OBJ_VELOCITY_LAT_ERR_049 OBJ_POS_LONG_ERR_049 OBJ_POS_LAT_ERR_049 OBJ_TRACK_MOTION_MODEL_049 OBJ_DIMENSION_WIDTH_049 OBJ_DIMENSION_LENGTH_049 OBJ_EXISTENCE_PROB_049 OBJ_YAW_ANGLE_049 OBJ_YAW_ANGLE_ERR_049 OBJ_ID_049 OBJ_MOVEMENT_STATUS_049 OBJ_MEASUREMENT_STATUS_049 OBJ_POS_LONG_049 OBJ_POS_LAT_049 OBJ_VELOCITY_LONG_049 OBJ_VELOCITY_LAT_049 OBJ_ACCELERATION_LONG_049 OBJ_ACCELERATION_LAT_049 OBJ_VEH_TRACK_FLAG_049 OBJ_MH_CYCLE_COUNTER_049 OBJ_MH_CRC16_049 OBJ_TIMESTAMP_OFFSET_049 OBJ_DIMENSION_WIDTH_ERR_049 OBJ_DIMENSION_LENGTH_ERR_049 OBJ_CLS_TYPE1_049 OBJ_CLS_TYPE1_PROB_049 OBJ_CLS_TYPE2_049 OBJ_CLS_TYPE2_PROB_049 OBJ_CLS_TYPE3_049 OBJ_CLS_TYPE3_PROB_049 OBJ_CLS_TYPE4_049 OBJ_CLS_TYPE4_PROB_049 OBJ_CLS_TYPE5_049 OBJ_CLS_TYPE5_PROB_049 OBJ_CLS_TYPE6_049 OBJ_CLS_TYPE6_PROB_049 OBJ_RCS_049 OBJ_REF_PT_LONG_OFFSET_049 OBJ_REF_PT_LAT_OFFSET_049 OBJ_YAW_RATE_049 OBJ_YAW_RATE_ERR_049 OBJ_GROUP_ID_049 OBJ_POS_ERR_CRR_COEF_049 OBJ_VELOCITY_ERR_CRR_COEF_049 OBJ_ACCEL_ERR_CRR_COEF_049;
SIG_GROUP_ 1409 TrackerObject050 1 : OBJ_ALIVE_TIME_050 OBJ_ACCELERATION_LONG_ERR_050 OBJ_ACCELERATION_LAT_ERR_050 OBJ_VELOCITY_LONG_ERR_050 OBJ_VELOCITY_LAT_ERR_050 OBJ_POS_LONG_ERR_050 OBJ_POS_LAT_ERR_050 OBJ_TRACK_MOTION_MODEL_050 OBJ_DIMENSION_WIDTH_050 OBJ_DIMENSION_LENGTH_050 OBJ_EXISTENCE_PROB_050 OBJ_YAW_ANGLE_050 OBJ_YAW_ANGLE_ERR_050 OBJ_ID_050 OBJ_MOVEMENT_STATUS_050 OBJ_MEASUREMENT_STATUS_050 OBJ_POS_LONG_050 OBJ_POS_LAT_050 OBJ_VELOCITY_LONG_050 OBJ_VELOCITY_LAT_050 OBJ_ACCELERATION_LONG_050 OBJ_ACCELERATION_LAT_050 OBJ_VEH_TRACK_FLAG_050 OBJ_MH_CYCLE_COUNTER_050 OBJ_MH_CRC16_050 OBJ_TIMESTAMP_OFFSET_050 OBJ_DIMENSION_WIDTH_ERR_050 OBJ_DIMENSION_LENGTH_ERR_050 OBJ_CLS_TYPE1_050 OBJ_CLS_TYPE1_PROB_050 OBJ_CLS_TYPE2_050 OBJ_CLS_TYPE2_PROB_050 OBJ_CLS_TYPE3_050 OBJ_CLS_TYPE3_PROB_050 OBJ_CLS_TYPE4_050 OBJ_CLS_TYPE4_PROB_050 OBJ_CLS_TYPE5_050 OBJ_CLS_TYPE5_PROB_050 OBJ_CLS_TYPE6_050 OBJ_CLS_TYPE6_PROB_050 OBJ_RCS_050 OBJ_REF_PT_LONG_OFFSET_050 OBJ_REF_PT_LAT_OFFSET_050 OBJ_YAW_RATE_050 OBJ_YAW_RATE_ERR_050 OBJ_GROUP_ID_050 OBJ_POS_ERR_CRR_COEF_050 OBJ_VELOCITY_ERR_CRR_COEF_050 OBJ_ACCEL_ERR_CRR_COEF_050;
SIG_GROUP_ 1410 TrackerObject051 1 : OBJ_ALIVE_TIME_051 OBJ_ACCELERATION_LONG_ERR_051 OBJ_ACCELERATION_LAT_ERR_051 OBJ_VELOCITY_LONG_ERR_051 OBJ_VELOCITY_LAT_ERR_051 OBJ_POS_LONG_ERR_051 OBJ_POS_LAT_ERR_051 OBJ_TRACK_MOTION_MODEL_051 OBJ_DIMENSION_WIDTH_051 OBJ_DIMENSION_LENGTH_051 OBJ_EXISTENCE_PROB_051 OBJ_YAW_ANGLE_051 OBJ_YAW_ANGLE_ERR_051 OBJ_ID_051 OBJ_MOVEMENT_STATUS_051 OBJ_MEASUREMENT_STATUS_051 OBJ_POS_LONG_051 OBJ_POS_LAT_051 OBJ_VELOCITY_LONG_051 OBJ_VELOCITY_LAT_051 OBJ_ACCELERATION_LONG_051 OBJ_ACCELERATION_LAT_051 OBJ_VEH_TRACK_FLAG_051 OBJ_MH_CYCLE_COUNTER_051 OBJ_MH_CRC16_051 OBJ_TIMESTAMP_OFFSET_051 OBJ_DIMENSION_WIDTH_ERR_051 OBJ_DIMENSION_LENGTH_ERR_051 OBJ_CLS_TYPE1_051 OBJ_CLS_TYPE1_PROB_051 OBJ_CLS_TYPE2_051 OBJ_CLS_TYPE2_PROB_051 OBJ_CLS_TYPE3_051 OBJ_CLS_TYPE3_PROB_051 OBJ_CLS_TYPE4_051 OBJ_CLS_TYPE4_PROB_051 OBJ_CLS_TYPE5_051 OBJ_CLS_TYPE5_PROB_051 OBJ_CLS_TYPE6_051 OBJ_CLS_TYPE6_PROB_051 OBJ_RCS_051 OBJ_REF_PT_LONG_OFFSET_051 OBJ_REF_PT_LAT_OFFSET_051 OBJ_YAW_RATE_051 OBJ_YAW_RATE_ERR_051 OBJ_GROUP_ID_051 OBJ_POS_ERR_CRR_COEF_051 OBJ_VELOCITY_ERR_CRR_COEF_051 OBJ_ACCEL_ERR_CRR_COEF_051;
SIG_GROUP_ 1411 TrackerObject052 1 : OBJ_ALIVE_TIME_052 OBJ_ACCELERATION_LONG_ERR_052 OBJ_ACCELERATION_LAT_ERR_052 OBJ_VELOCITY_LONG_ERR_052 OBJ_VELOCITY_LAT_ERR_052 OBJ_POS_LONG_ERR_052 OBJ_POS_LAT_ERR_052 OBJ_TRACK_MOTION_MODEL_052 OBJ_DIMENSION_WIDTH_052 OBJ_DIMENSION_LENGTH_052 OBJ_EXISTENCE_PROB_052 OBJ_YAW_ANGLE_052 OBJ_YAW_ANGLE_ERR_052 OBJ_ID_052 OBJ_MOVEMENT_STATUS_052 OBJ_MEASUREMENT_STATUS_052 OBJ_POS_LONG_052 OBJ_POS_LAT_052 OBJ_VELOCITY_LONG_052 OBJ_VELOCITY_LAT_052 OBJ_ACCELERATION_LONG_052 OBJ_ACCELERATION_LAT_052 OBJ_VEH_TRACK_FLAG_052 OBJ_MH_CYCLE_COUNTER_052 OBJ_MH_CRC16_052 OBJ_TIMESTAMP_OFFSET_052 OBJ_DIMENSION_WIDTH_ERR_052 OBJ_DIMENSION_LENGTH_ERR_052 OBJ_CLS_TYPE1_052 OBJ_CLS_TYPE1_PROB_052 OBJ_CLS_TYPE2_052 OBJ_CLS_TYPE2_PROB_052 OBJ_CLS_TYPE3_052 OBJ_CLS_TYPE3_PROB_052 OBJ_CLS_TYPE4_052 OBJ_CLS_TYPE4_PROB_052 OBJ_CLS_TYPE5_052 OBJ_CLS_TYPE5_PROB_052 OBJ_CLS_TYPE6_052 OBJ_CLS_TYPE6_PROB_052 OBJ_RCS_052 OBJ_REF_PT_LONG_OFFSET_052 OBJ_REF_PT_LAT_OFFSET_052 OBJ_YAW_RATE_052 OBJ_YAW_RATE_ERR_052 OBJ_GROUP_ID_052 OBJ_POS_ERR_CRR_COEF_052 OBJ_VELOCITY_ERR_CRR_COEF_052 OBJ_ACCEL_ERR_CRR_COEF_052;
