VERSION "created by canmatrix"

NS_ :

BS_:

BU_: External_Tool ADAS RDR08 RDR_Fusion_Partner RDR_Gateway

BO_ 1208 RDR_DETECTION_225_228: 64 RDR08
 SG_ DET_RANGE_225 : 24|15@1+ (0.015625,0) [0|500] "m"  ADAS
 SG_ DET_RANGE_ERR_225 : 40|7@1+ (0.0075,0) [0|0.9525] "m"  ADAS
 SG_ DET_RANGE_VELOCITY_225 : 48|15@1+ (0.0078125,-128) [-128|127.9921875] "m/s"  ADAS
 SG_ DET_RANGE_VELOCITY_ERR_225 : 64|8@1+ (0.003,0) [0|0.765] "m/s"  ADAS
 SG_ DET_AZIMUTH_225 : 88|13@1+ (0.0004,-1.5708) [-1.5708|1.5708] "rad"  ADAS
 SG_ DET_AZIMUTH_ERR_225 : 105|7@1+ (0.00087267,0) [0|0.11082909] "rad"  ADAS
 SG_ DET_ELEVATION_225 : 72|8@1+ (0.00275,-0.34925) [-0.34925|0.34925] "rad"  ADAS
 SG_ DET_ELEVATION_ERR_225 : 80|6@1+ (0.00174533,0) [0|0.10995579] "rad"  ADAS
 SG_ DET_RCS_225 : 128|8@1+ (0.5,-64) [-64|63.5] "dBsm"  ADAS
 SG_ DET_BI_STATIC_FLAG_225 : 104|1@1+ (1,0) [0|1] ""  ADAS
 SG_ DET_SUPER_RES_TARGET_225 : 87|1@1+ (1,0) [0|1] ""  ADAS
 SG_ DET_SNR_225 : 120|8@1+ (0.35156,0) [0|89.6478] "dB"  ADAS
 SG_ DET_EXISTENCE_PROB_225 : 112|6@1+ (1.588,0) [0|100] "%"  ADAS
 SG_ DET_HVC_FLAG_225 : 86|1@1+ (1,0) [0|1] ""  ADAS
 SG_ DET_CONFD_AZIMUTH_225 : 118|2@1+ (1,0) [0|3] ""  ADAS
 SG_ DET_CONFD_ELEVATION_225 : 101|2@1+ (1,0) [0|3] ""  ADAS
 SG_ DET_PROB_1STAZHYPO_225 : 103|1@1+ (1,0) [0|1] ""  ADAS
 SG_ DET_IDM_225 : 63|1@1+ (1,0) [0|1] ""  ADAS
 SG_ DET_MTD_225 : 47|1@1+ (1,0) [0|1] ""  ADAS
 SG_ DET_BELOW_RAIN_THOLD_225 : 39|1@1+ (1,0) [0|1] ""  ADAS
 SG_ DET_RANGE_226 : 136|15@1+ (0.015625,0) [0|500] "m"  ADAS
 SG_ DET_RANGE_ERR_226 : 152|7@1+ (0.0075,0) [0|0.9525] "m"  ADAS
 SG_ DET_RANGE_VELOCITY_226 : 160|15@1+ (0.0078125,-128) [-128|127.9921875] "m/s"  ADAS
 SG_ DET_RANGE_VELOCITY_ERR_226 : 176|8@1+ (0.003,0) [0|0.765] "m/s"  ADAS
 SG_ DET_AZIMUTH_226 : 200|13@1+ (0.0004,-1.5708) [-1.5708|1.5708] "rad"  ADAS
 SG_ DET_AZIMUTH_ERR_226 : 217|7@1+ (0.00087267,0) [0|0.11082909] "rad"  ADAS
 SG_ DET_ELEVATION_226 : 184|8@1+ (0.00275,-0.34925) [-0.34925|0.34925] "rad"  ADAS
 SG_ DET_ELEVATION_ERR_226 : 192|6@1+ (0.00174533,0) [0|0.10995579] "rad"  ADAS
 SG_ DET_RCS_226 : 240|8@1+ (0.5,-64) [-64|63.5] "dBsm"  ADAS
 SG_ DET_BI_STATIC_FLAG_226 : 216|1@1+ (1,0) [0|1] ""  ADAS
 SG_ DET_SUPER_RES_TARGET_226 : 199|1@1+ (1,0) [0|1] ""  ADAS
 SG_ DET_SNR_226 : 232|8@1+ (0.35156,0) [0|89.6478] "dB"  ADAS
 SG_ DET_EXISTENCE_PROB_226 : 224|6@1+ (1.588,0) [0|100] "%"  ADAS
 SG_ DET_HVC_FLAG_226 : 198|1@1+ (1,0) [0|1] ""  ADAS
 SG_ DET_CONFD_AZIMUTH_226 : 230|2@1+ (1,0) [0|3] ""  ADAS
 SG_ DET_CONFD_ELEVATION_226 : 213|2@1+ (1,0) [0|3] ""  ADAS
 SG_ DET_PROB_1STAZHYPO_226 : 215|1@1+ (1,0) [0|1] ""  ADAS
 SG_ DET_IDM_226 : 175|1@1+ (1,0) [0|1] ""  ADAS
 SG_ DET_MTD_226 : 159|1@1+ (1,0) [0|1] ""  ADAS
 SG_ DET_BELOW_RAIN_THOLD_226 : 151|1@1+ (1,0) [0|1] ""  ADAS
 SG_ DET_RANGE_227 : 248|15@1+ (0.015625,0) [0|500] "m"  ADAS
 SG_ DET_RANGE_ERR_227 : 264|7@1+ (0.0075,0) [0|0.9525] "m"  ADAS
 SG_ DET_RANGE_VELOCITY_227 : 272|15@1+ (0.0078125,-128) [-128|127.9921875] "m/s"  ADAS
 SG_ DET_RANGE_VELOCITY_ERR_227 : 288|8@1+ (0.003,0) [0|0.765] "m/s"  ADAS
 SG_ DET_AZIMUTH_227 : 312|13@1+ (0.0004,-1.5708) [-1.5708|1.5708] "rad"  ADAS
 SG_ DET_AZIMUTH_ERR_227 : 329|7@1+ (0.00087267,0) [0|0.11082909] "rad"  ADAS
 SG_ DET_ELEVATION_227 : 296|8@1+ (0.00275,-0.34925) [-0.34925|0.34925] "rad"  ADAS
 SG_ DET_ELEVATION_ERR_227 : 304|6@1+ (0.00174533,0) [0|0.10995579] "rad"  ADAS
 SG_ DET_RCS_227 : 352|8@1+ (0.5,-64) [-64|63.5] "dBsm"  ADAS
 SG_ DET_BI_STATIC_FLAG_227 : 328|1@1+ (1,0) [0|1] ""  ADAS
 SG_ DET_SUPER_RES_TARGET_227 : 311|1@1+ (1,0) [0|1] ""  ADAS
 SG_ DET_SNR_227 : 344|8@1+ (0.35156,0) [0|89.6478] "dB"  ADAS
 SG_ DET_EXISTENCE_PROB_227 : 336|6@1+ (1.588,0) [0|100] "%"  ADAS
 SG_ DET_HVC_FLAG_227 : 310|1@1+ (1,0) [0|1] ""  ADAS
 SG_ DET_CONFD_AZIMUTH_227 : 342|2@1+ (1,0) [0|3] ""  ADAS
 SG_ DET_CONFD_ELEVATION_227 : 325|2@1+ (1,0) [0|3] ""  ADAS
 SG_ DET_PROB_1STAZHYPO_227 : 327|1@1+ (1,0) [0|1] ""  ADAS
 SG_ DET_IDM_227 : 287|1@1+ (1,0) [0|1] ""  ADAS
 SG_ DET_MTD_227 : 271|1@1+ (1,0) [0|1] ""  ADAS
 SG_ DET_BELOW_RAIN_THOLD_227 : 263|1@1+ (1,0) [0|1] ""  ADAS
 SG_ DET_RANGE_228 : 360|15@1+ (0.015625,0) [0|500] "m"  ADAS
 SG_ DET_RANGE_ERR_228 : 376|7@1+ (0.0075,0) [0|0.9525] "m"  ADAS
 SG_ DET_RANGE_VELOCITY_228 : 384|15@1+ (0.0078125,-128) [-128|127.9921875] "m/s"  ADAS
 SG_ DET_RANGE_VELOCITY_ERR_228 : 400|8@1+ (0.003,0) [0|0.765] "m/s"  ADAS
 SG_ DET_AZIMUTH_228 : 424|13@1+ (0.0004,-1.5708) [-1.5708|1.5708] "rad"  ADAS
 SG_ DET_AZIMUTH_ERR_228 : 441|7@1+ (0.00087267,0) [0|0.11082909] "rad"  ADAS
 SG_ DET_ELEVATION_228 : 408|8@1+ (0.00275,-0.34925) [-0.34925|0.34925] "rad"  ADAS
 SG_ DET_ELEVATION_ERR_228 : 416|6@1+ (0.00174533,0) [0|0.10995579] "rad"  ADAS
 SG_ DET_RCS_228 : 464|8@1+ (0.5,-64) [-64|63.5] "dBsm"  ADAS
 SG_ DET_BI_STATIC_FLAG_228 : 440|1@1+ (1,0) [0|1] ""  ADAS
 SG_ DET_SUPER_RES_TARGET_228 : 423|1@1+ (1,0) [0|1] ""  ADAS
 SG_ DET_SNR_228 : 456|8@1+ (0.35156,0) [0|89.6478] "dB"  ADAS
 SG_ DET_EXISTENCE_PROB_228 : 448|6@1+ (1.588,0) [0|100] "%"  ADAS
 SG_ DET_HVC_FLAG_228 : 422|1@1+ (1,0) [0|1] ""  ADAS
 SG_ DET_CONFD_AZIMUTH_228 : 454|2@1+ (1,0) [0|3] ""  ADAS
 SG_ DET_CONFD_ELEVATION_228 : 437|2@1+ (1,0) [0|3] ""  ADAS
 SG_ DET_MH_SCAN_INDEX_4LSB_225_228 : 476|4@1+ (1,0) [0|15] ""  ADAS
 SG_ DET_MH_CYCLE_COUNTER_225_228 : 16|8@1+ (1,0) [0|255] ""  ADAS
 SG_ DET_MH_CRC16_225_228 : 0|16@1+ (1,0) [0|65535] ""  ADAS
 SG_ DET_PROB_1STAZHYPO_228 : 439|1@1+ (1,0) [0|1] ""  ADAS
 SG_ DET_IDM_228 : 399|1@1+ (1,0) [0|1] ""  ADAS
 SG_ DET_MTD_228 : 383|1@1+ (1,0) [0|1] ""  ADAS
 SG_ DET_BELOW_RAIN_THOLD_228 : 375|1@1+ (1,0) [0|1] ""  ADAS

BO_ 1209 RDR_DETECTION_229_232: 64 RDR08
 SG_ DET_RANGE_229 : 24|15@1+ (0.015625,0) [0|500] "m"  ADAS
 SG_ DET_RANGE_ERR_229 : 40|7@1+ (0.0075,0) [0|0.9525] "m"  ADAS
 SG_ DET_RANGE_VELOCITY_229 : 48|15@1+ (0.0078125,-128) [-128|127.9921875] "m/s"  ADAS
 SG_ DET_RANGE_VELOCITY_ERR_229 : 64|8@1+ (0.003,0) [0|0.765] "m/s"  ADAS
 SG_ DET_AZIMUTH_229 : 88|13@1+ (0.0004,-1.5708) [-1.5708|1.5708] "rad"  ADAS
 SG_ DET_AZIMUTH_ERR_229 : 105|7@1+ (0.00087267,0) [0|0.11082909] "rad"  ADAS
 SG_ DET_ELEVATION_229 : 72|8@1+ (0.00275,-0.34925) [-0.34925|0.34925] "rad"  ADAS
 SG_ DET_ELEVATION_ERR_229 : 80|6@1+ (0.00174533,0) [0|0.10995579] "rad"  ADAS
 SG_ DET_RCS_229 : 128|8@1+ (0.5,-64) [-64|63.5] "dBsm"  ADAS
 SG_ DET_BI_STATIC_FLAG_229 : 104|1@1+ (1,0) [0|1] ""  ADAS
 SG_ DET_SUPER_RES_TARGET_229 : 87|1@1+ (1,0) [0|1] ""  ADAS
 SG_ DET_SNR_229 : 120|8@1+ (0.35156,0) [0|89.6478] "dB"  ADAS
 SG_ DET_EXISTENCE_PROB_229 : 112|6@1+ (1.588,0) [0|100] "%"  ADAS
 SG_ DET_HVC_FLAG_229 : 86|1@1+ (1,0) [0|1] ""  ADAS
 SG_ DET_CONFD_AZIMUTH_229 : 118|2@1+ (1,0) [0|3] ""  ADAS
 SG_ DET_CONFD_ELEVATION_229 : 101|2@1+ (1,0) [0|3] ""  ADAS
 SG_ DET_PROB_1STAZHYPO_229 : 103|1@1+ (1,0) [0|1] ""  ADAS
 SG_ DET_IDM_229 : 63|1@1+ (1,0) [0|1] ""  ADAS
 SG_ DET_MTD_229 : 47|1@1+ (1,0) [0|1] ""  ADAS
 SG_ DET_BELOW_RAIN_THOLD_229 : 39|1@1+ (1,0) [0|1] ""  ADAS
 SG_ DET_RANGE_230 : 136|15@1+ (0.015625,0) [0|500] "m"  ADAS
 SG_ DET_RANGE_ERR_230 : 152|7@1+ (0.0075,0) [0|0.9525] "m"  ADAS
 SG_ DET_RANGE_VELOCITY_230 : 160|15@1+ (0.0078125,-128) [-128|127.9921875] "m/s"  ADAS
 SG_ DET_RANGE_VELOCITY_ERR_230 : 176|8@1+ (0.003,0) [0|0.765] "m/s"  ADAS
 SG_ DET_AZIMUTH_230 : 200|13@1+ (0.0004,-1.5708) [-1.5708|1.5708] "rad"  ADAS
 SG_ DET_AZIMUTH_ERR_230 : 217|7@1+ (0.00087267,0) [0|0.11082909] "rad"  ADAS
 SG_ DET_ELEVATION_230 : 184|8@1+ (0.00275,-0.34925) [-0.34925|0.34925] "rad"  ADAS
 SG_ DET_ELEVATION_ERR_230 : 192|6@1+ (0.00174533,0) [0|0.10995579] "rad"  ADAS
 SG_ DET_RCS_230 : 240|8@1+ (0.5,-64) [-64|63.5] "dBsm"  ADAS
 SG_ DET_BI_STATIC_FLAG_230 : 216|1@1+ (1,0) [0|1] ""  ADAS
 SG_ DET_SUPER_RES_TARGET_230 : 199|1@1+ (1,0) [0|1] ""  ADAS
 SG_ DET_SNR_230 : 232|8@1+ (0.35156,0) [0|89.6478] "dB"  ADAS
 SG_ DET_EXISTENCE_PROB_230 : 224|6@1+ (1.588,0) [0|100] "%"  ADAS
 SG_ DET_HVC_FLAG_230 : 198|1@1+ (1,0) [0|1] ""  ADAS
 SG_ DET_CONFD_AZIMUTH_230 : 230|2@1+ (1,0) [0|3] ""  ADAS
 SG_ DET_CONFD_ELEVATION_230 : 213|2@1+ (1,0) [0|3] ""  ADAS
 SG_ DET_PROB_1STAZHYPO_230 : 215|1@1+ (1,0) [0|1] ""  ADAS
 SG_ DET_IDM_230 : 175|1@1+ (1,0) [0|1] ""  ADAS
 SG_ DET_MTD_230 : 159|1@1+ (1,0) [0|1] ""  ADAS
 SG_ DET_BELOW_RAIN_THOLD_230 : 151|1@1+ (1,0) [0|1] ""  ADAS
 SG_ DET_RANGE_231 : 248|15@1+ (0.015625,0) [0|500] "m"  ADAS
 SG_ DET_RANGE_ERR_231 : 264|7@1+ (0.0075,0) [0|0.9525] "m"  ADAS
 SG_ DET_RANGE_VELOCITY_231 : 272|15@1+ (0.0078125,-128) [-128|127.9921875] "m/s"  ADAS
 SG_ DET_RANGE_VELOCITY_ERR_231 : 288|8@1+ (0.003,0) [0|0.765] "m/s"  ADAS
 SG_ DET_AZIMUTH_231 : 312|13@1+ (0.0004,-1.5708) [-1.5708|1.5708] "rad"  ADAS
 SG_ DET_AZIMUTH_ERR_231 : 329|7@1+ (0.00087267,0) [0|0.11082909] "rad"  ADAS
 SG_ DET_ELEVATION_231 : 296|8@1+ (0.00275,-0.34925) [-0.34925|0.34925] "rad"  ADAS
 SG_ DET_ELEVATION_ERR_231 : 304|6@1+ (0.00174533,0) [0|0.10995579] "rad"  ADAS
 SG_ DET_RCS_231 : 352|8@1+ (0.5,-64) [-64|63.5] "dBsm"  ADAS
 SG_ DET_BI_STATIC_FLAG_231 : 328|1@1+ (1,0) [0|1] ""  ADAS
 SG_ DET_SUPER_RES_TARGET_231 : 311|1@1+ (1,0) [0|1] ""  ADAS
 SG_ DET_SNR_231 : 344|8@1+ (0.35156,0) [0|89.6478] "dB"  ADAS
 SG_ DET_EXISTENCE_PROB_231 : 336|6@1+ (1.588,0) [0|100] "%"  ADAS
 SG_ DET_HVC_FLAG_231 : 310|1@1+ (1,0) [0|1] ""  ADAS
 SG_ DET_CONFD_AZIMUTH_231 : 342|2@1+ (1,0) [0|3] ""  ADAS
 SG_ DET_CONFD_ELEVATION_231 : 325|2@1+ (1,0) [0|3] ""  ADAS
 SG_ DET_PROB_1STAZHYPO_231 : 327|1@1+ (1,0) [0|1] ""  ADAS
 SG_ DET_IDM_231 : 287|1@1+ (1,0) [0|1] ""  ADAS
 SG_ DET_MTD_231 : 271|1@1+ (1,0) [0|1] ""  ADAS
 SG_ DET_BELOW_RAIN_THOLD_231 : 263|1@1+ (1,0) [0|1] ""  ADAS
 SG_ DET_RANGE_232 : 360|15@1+ (0.015625,0) [0|500] "m"  ADAS
 SG_ DET_RANGE_ERR_232 : 376|7@1+ (0.0075,0) [0|0.9525] "m"  ADAS
 SG_ DET_RANGE_VELOCITY_232 : 384|15@1+ (0.0078125,-128) [-128|127.9921875] "m/s"  ADAS
 SG_ DET_RANGE_VELOCITY_ERR_232 : 400|8@1+ (0.003,0) [0|0.765] "m/s"  ADAS
 SG_ DET_AZIMUTH_232 : 424|13@1+ (0.0004,-1.5708) [-1.5708|1.5708] "rad"  ADAS
 SG_ DET_AZIMUTH_ERR_232 : 441|7@1+ (0.00087267,0) [0|0.11082909] "rad"  ADAS
 SG_ DET_ELEVATION_232 : 408|8@1+ (0.00275,-0.34925) [-0.34925|0.34925] "rad"  ADAS
 SG_ DET_ELEVATION_ERR_232 : 416|6@1+ (0.00174533,0) [0|0.10995579] "rad"  ADAS
 SG_ DET_RCS_232 : 464|8@1+ (0.5,-64) [-64|63.5] "dBsm"  ADAS
 SG_ DET_BI_STATIC_FLAG_232 : 440|1@1+ (1,0) [0|1] ""  ADAS
 SG_ DET_SUPER_RES_TARGET_232 : 423|1@1+ (1,0) [0|1] ""  ADAS
 SG_ DET_SNR_232 : 456|8@1+ (0.35156,0) [0|89.6478] "dB"  ADAS
 SG_ DET_EXISTENCE_PROB_232 : 448|6@1+ (1.588,0) [0|100] "%"  ADAS
 SG_ DET_HVC_FLAG_232 : 422|1@1+ (1,0) [0|1] ""  ADAS
 SG_ DET_CONFD_AZIMUTH_232 : 454|2@1+ (1,0) [0|3] ""  ADAS
 SG_ DET_CONFD_ELEVATION_232 : 437|2@1+ (1,0) [0|3] ""  ADAS
 SG_ DET_MH_SCAN_INDEX_4LSB_229_232 : 476|4@1+ (1,0) [0|15] ""  ADAS
 SG_ DET_MH_CYCLE_COUNTER_229_232 : 16|8@1+ (1,0) [0|255] ""  ADAS
 SG_ DET_MH_CRC16_229_232 : 0|16@1+ (1,0) [0|65535] ""  ADAS
 SG_ DET_PROB_1STAZHYPO_232 : 439|1@1+ (1,0) [0|1] ""  ADAS
 SG_ DET_IDM_232 : 399|1@1+ (1,0) [0|1] ""  ADAS
 SG_ DET_MTD_232 : 383|1@1+ (1,0) [0|1] ""  ADAS
 SG_ DET_BELOW_RAIN_THOLD_232 : 375|1@1+ (1,0) [0|1] ""  ADAS

BO_ 1210 RDR_DETECTION_233_236: 64 RDR08
 SG_ DET_RANGE_233 : 24|15@1+ (0.015625,0) [0|500] "m"  ADAS
 SG_ DET_RANGE_ERR_233 : 40|7@1+ (0.0075,0) [0|0.9525] "m"  ADAS
 SG_ DET_RANGE_VELOCITY_233 : 48|15@1+ (0.0078125,-128) [-128|127.9921875] "m/s"  ADAS
 SG_ DET_RANGE_VELOCITY_ERR_233 : 64|8@1+ (0.003,0) [0|0.765] "m/s"  ADAS
 SG_ DET_AZIMUTH_233 : 88|13@1+ (0.0004,-1.5708) [-1.5708|1.5708] "rad"  ADAS
 SG_ DET_AZIMUTH_ERR_233 : 105|7@1+ (0.00087267,0) [0|0.11082909] "rad"  ADAS
 SG_ DET_ELEVATION_233 : 72|8@1+ (0.00275,-0.34925) [-0.34925|0.34925] "rad"  ADAS
 SG_ DET_ELEVATION_ERR_233 : 80|6@1+ (0.00174533,0) [0|0.10995579] "rad"  ADAS
 SG_ DET_RCS_233 : 128|8@1+ (0.5,-64) [-64|63.5] "dBsm"  ADAS
 SG_ DET_BI_STATIC_FLAG_233 : 104|1@1+ (1,0) [0|1] ""  ADAS
 SG_ DET_SUPER_RES_TARGET_233 : 87|1@1+ (1,0) [0|1] ""  ADAS
 SG_ DET_SNR_233 : 120|8@1+ (0.35156,0) [0|89.6478] "dB"  ADAS
 SG_ DET_EXISTENCE_PROB_233 : 112|6@1+ (1.588,0) [0|100] "%"  ADAS
 SG_ DET_HVC_FLAG_233 : 86|1@1+ (1,0) [0|1] ""  ADAS
 SG_ DET_CONFD_AZIMUTH_233 : 118|2@1+ (1,0) [0|3] ""  ADAS
 SG_ DET_CONFD_ELEVATION_233 : 101|2@1+ (1,0) [0|3] ""  ADAS
 SG_ DET_PROB_1STAZHYPO_233 : 103|1@1+ (1,0) [0|1] ""  ADAS
 SG_ DET_IDM_233 : 63|1@1+ (1,0) [0|1] ""  ADAS
 SG_ DET_MTD_233 : 47|1@1+ (1,0) [0|1] ""  ADAS
 SG_ DET_BELOW_RAIN_THOLD_233 : 39|1@1+ (1,0) [0|1] ""  ADAS
 SG_ DET_RANGE_234 : 136|15@1+ (0.015625,0) [0|500] "m"  ADAS
 SG_ DET_RANGE_ERR_234 : 152|7@1+ (0.0075,0) [0|0.9525] "m"  ADAS
 SG_ DET_RANGE_VELOCITY_234 : 160|15@1+ (0.0078125,-128) [-128|127.9921875] "m/s"  ADAS
 SG_ DET_RANGE_VELOCITY_ERR_234 : 176|8@1+ (0.003,0) [0|0.765] "m/s"  ADAS
 SG_ DET_AZIMUTH_234 : 200|13@1+ (0.0004,-1.5708) [-1.5708|1.5708] "rad"  ADAS
 SG_ DET_AZIMUTH_ERR_234 : 217|7@1+ (0.00087267,0) [0|0.11082909] "rad"  ADAS
 SG_ DET_ELEVATION_234 : 184|8@1+ (0.00275,-0.34925) [-0.34925|0.34925] "rad"  ADAS
 SG_ DET_ELEVATION_ERR_234 : 192|6@1+ (0.00174533,0) [0|0.10995579] "rad"  ADAS
 SG_ DET_RCS_234 : 240|8@1+ (0.5,-64) [-64|63.5] "dBsm"  ADAS
 SG_ DET_BI_STATIC_FLAG_234 : 216|1@1+ (1,0) [0|1] ""  ADAS
 SG_ DET_SUPER_RES_TARGET_234 : 199|1@1+ (1,0) [0|1] ""  ADAS
 SG_ DET_SNR_234 : 232|8@1+ (0.35156,0) [0|89.6478] "dB"  ADAS
 SG_ DET_EXISTENCE_PROB_234 : 224|6@1+ (1.588,0) [0|100] "%"  ADAS
 SG_ DET_HVC_FLAG_234 : 198|1@1+ (1,0) [0|1] ""  ADAS
 SG_ DET_CONFD_AZIMUTH_234 : 230|2@1+ (1,0) [0|3] ""  ADAS
 SG_ DET_CONFD_ELEVATION_234 : 213|2@1+ (1,0) [0|3] ""  ADAS
 SG_ DET_PROB_1STAZHYPO_234 : 215|1@1+ (1,0) [0|1] ""  ADAS
 SG_ DET_IDM_234 : 175|1@1+ (1,0) [0|1] ""  ADAS
 SG_ DET_MTD_234 : 159|1@1+ (1,0) [0|1] ""  ADAS
 SG_ DET_BELOW_RAIN_THOLD_234 : 151|1@1+ (1,0) [0|1] ""  ADAS
 SG_ DET_RANGE_235 : 248|15@1+ (0.015625,0) [0|500] "m"  ADAS
 SG_ DET_RANGE_ERR_235 : 264|7@1+ (0.0075,0) [0|0.9525] "m"  ADAS
 SG_ DET_RANGE_VELOCITY_235 : 272|15@1+ (0.0078125,-128) [-128|127.9921875] "m/s"  ADAS
 SG_ DET_RANGE_VELOCITY_ERR_235 : 288|8@1+ (0.003,0) [0|0.765] "m/s"  ADAS
 SG_ DET_AZIMUTH_235 : 312|13@1+ (0.0004,-1.5708) [-1.5708|1.5708] "rad"  ADAS
 SG_ DET_AZIMUTH_ERR_235 : 329|7@1+ (0.00087267,0) [0|0.11082909] "rad"  ADAS
 SG_ DET_ELEVATION_235 : 296|8@1+ (0.00275,-0.34925) [-0.34925|0.34925] "rad"  ADAS
 SG_ DET_ELEVATION_ERR_235 : 304|6@1+ (0.00174533,0) [0|0.10995579] "rad"  ADAS
 SG_ DET_RCS_235 : 352|8@1+ (0.5,-64) [-64|63.5] "dBsm"  ADAS
 SG_ DET_BI_STATIC_FLAG_235 : 328|1@1+ (1,0) [0|1] ""  ADAS
 SG_ DET_SUPER_RES_TARGET_235 : 311|1@1+ (1,0) [0|1] ""  ADAS
 SG_ DET_SNR_235 : 344|8@1+ (0.35156,0) [0|89.6478] "dB"  ADAS
 SG_ DET_EXISTENCE_PROB_235 : 336|6@1+ (1.588,0) [0|100] "%"  ADAS
 SG_ DET_HVC_FLAG_235 : 310|1@1+ (1,0) [0|1] ""  ADAS
 SG_ DET_CONFD_AZIMUTH_235 : 342|2@1+ (1,0) [0|3] ""  ADAS
 SG_ DET_CONFD_ELEVATION_235 : 325|2@1+ (1,0) [0|3] ""  ADAS
 SG_ DET_PROB_1STAZHYPO_235 : 327|1@1+ (1,0) [0|1] ""  ADAS
 SG_ DET_IDM_235 : 287|1@1+ (1,0) [0|1] ""  ADAS
 SG_ DET_MTD_235 : 271|1@1+ (1,0) [0|1] ""  ADAS
 SG_ DET_BELOW_RAIN_THOLD_235 : 263|1@1+ (1,0) [0|1] ""  ADAS
 SG_ DET_RANGE_236 : 360|15@1+ (0.015625,0) [0|500] "m"  ADAS
 SG_ DET_RANGE_ERR_236 : 376|7@1+ (0.0075,0) [0|0.9525] "m"  ADAS
 SG_ DET_RANGE_VELOCITY_236 : 384|15@1+ (0.0078125,-128) [-128|127.9921875] "m/s"  ADAS
 SG_ DET_RANGE_VELOCITY_ERR_236 : 400|8@1+ (0.003,0) [0|0.765] "m/s"  ADAS
 SG_ DET_AZIMUTH_236 : 424|13@1+ (0.0004,-1.5708) [-1.5708|1.5708] "rad"  ADAS
 SG_ DET_AZIMUTH_ERR_236 : 441|7@1+ (0.00087267,0) [0|0.11082909] "rad"  ADAS
 SG_ DET_ELEVATION_236 : 408|8@1+ (0.00275,-0.34925) [-0.34925|0.34925] "rad"  ADAS
 SG_ DET_ELEVATION_ERR_236 : 416|6@1+ (0.00174533,0) [0|0.10995579] "rad"  ADAS
 SG_ DET_RCS_236 : 464|8@1+ (0.5,-64) [-64|63.5] "dBsm"  ADAS
 SG_ DET_BI_STATIC_FLAG_236 : 440|1@1+ (1,0) [0|1] ""  ADAS
 SG_ DET_SUPER_RES_TARGET_236 : 423|1@1+ (1,0) [0|1] ""  ADAS
 SG_ DET_SNR_236 : 456|8@1+ (0.35156,0) [0|89.6478] "dB"  ADAS
 SG_ DET_EXISTENCE_PROB_236 : 448|6@1+ (1.588,0) [0|100] "%"  ADAS
 SG_ DET_HVC_FLAG_236 : 422|1@1+ (1,0) [0|1] ""  ADAS
 SG_ DET_CONFD_AZIMUTH_236 : 454|2@1+ (1,0) [0|3] ""  ADAS
 SG_ DET_CONFD_ELEVATION_236 : 437|2@1+ (1,0) [0|3] ""  ADAS
 SG_ DET_MH_SCAN_INDEX_4LSB_233_236 : 476|4@1+ (1,0) [0|15] ""  ADAS
 SG_ DET_MH_CYCLE_COUNTER_233_236 : 16|8@1+ (1,0) [0|255] ""  ADAS
 SG_ DET_MH_CRC16_233_236 : 0|16@1+ (1,0) [0|65535] ""  ADAS
 SG_ DET_PROB_1STAZHYPO_236 : 439|1@1+ (1,0) [0|1] ""  ADAS
 SG_ DET_IDM_236 : 399|1@1+ (1,0) [0|1] ""  ADAS
 SG_ DET_MTD_236 : 383|1@1+ (1,0) [0|1] ""  ADAS
 SG_ DET_BELOW_RAIN_THOLD_236 : 375|1@1+ (1,0) [0|1] ""  ADAS

BO_ 1211 RDR_DETECTION_237_240: 64 RDR08
 SG_ DET_RANGE_237 : 24|15@1+ (0.015625,0) [0|500] "m"  ADAS
 SG_ DET_RANGE_ERR_237 : 40|7@1+ (0.0075,0) [0|0.9525] "m"  ADAS
 SG_ DET_RANGE_VELOCITY_237 : 48|15@1+ (0.0078125,-128) [-128|127.9921875] "m/s"  ADAS
 SG_ DET_RANGE_VELOCITY_ERR_237 : 64|8@1+ (0.003,0) [0|0.765] "m/s"  ADAS
 SG_ DET_AZIMUTH_237 : 88|13@1+ (0.0004,-1.5708) [-1.5708|1.5708] "rad"  ADAS
 SG_ DET_AZIMUTH_ERR_237 : 105|7@1+ (0.00087267,0) [0|0.11082909] "rad"  ADAS
 SG_ DET_ELEVATION_237 : 72|8@1+ (0.00275,-0.34925) [-0.34925|0.34925] "rad"  ADAS
 SG_ DET_ELEVATION_ERR_237 : 80|6@1+ (0.00174533,0) [0|0.10995579] "rad"  ADAS
 SG_ DET_RCS_237 : 128|8@1+ (0.5,-64) [-64|63.5] "dBsm"  ADAS
 SG_ DET_BI_STATIC_FLAG_237 : 104|1@1+ (1,0) [0|1] ""  ADAS
 SG_ DET_SUPER_RES_TARGET_237 : 87|1@1+ (1,0) [0|1] ""  ADAS
 SG_ DET_SNR_237 : 120|8@1+ (0.35156,0) [0|89.6478] "dB"  ADAS
 SG_ DET_EXISTENCE_PROB_237 : 112|6@1+ (1.588,0) [0|100] "%"  ADAS
 SG_ DET_HVC_FLAG_237 : 86|1@1+ (1,0) [0|1] ""  ADAS
 SG_ DET_CONFD_AZIMUTH_237 : 118|2@1+ (1,0) [0|3] ""  ADAS
 SG_ DET_CONFD_ELEVATION_237 : 101|2@1+ (1,0) [0|3] ""  ADAS
 SG_ DET_PROB_1STAZHYPO_237 : 103|1@1+ (1,0) [0|1] ""  ADAS
 SG_ DET_IDM_237 : 63|1@1+ (1,0) [0|1] ""  ADAS
 SG_ DET_MTD_237 : 47|1@1+ (1,0) [0|1] ""  ADAS
 SG_ DET_BELOW_RAIN_THOLD_237 : 39|1@1+ (1,0) [0|1] ""  ADAS
 SG_ DET_RANGE_238 : 136|15@1+ (0.015625,0) [0|500] "m"  ADAS
 SG_ DET_RANGE_ERR_238 : 152|7@1+ (0.0075,0) [0|0.9525] "m"  ADAS
 SG_ DET_RANGE_VELOCITY_238 : 160|15@1+ (0.0078125,-128) [-128|127.9921875] "m/s"  ADAS
 SG_ DET_RANGE_VELOCITY_ERR_238 : 176|8@1+ (0.003,0) [0|0.765] "m/s"  ADAS
 SG_ DET_AZIMUTH_238 : 200|13@1+ (0.0004,-1.5708) [-1.5708|1.5708] "rad"  ADAS
 SG_ DET_AZIMUTH_ERR_238 : 217|7@1+ (0.00087267,0) [0|0.11082909] "rad"  ADAS
 SG_ DET_ELEVATION_238 : 184|8@1+ (0.00275,-0.34925) [-0.34925|0.34925] "rad"  ADAS
 SG_ DET_ELEVATION_ERR_238 : 192|6@1+ (0.00174533,0) [0|0.10995579] "rad"  ADAS
 SG_ DET_RCS_238 : 240|8@1+ (0.5,-64) [-64|63.5] "dBsm"  ADAS
 SG_ DET_BI_STATIC_FLAG_238 : 216|1@1+ (1,0) [0|1] ""  ADAS
 SG_ DET_SUPER_RES_TARGET_238 : 199|1@1+ (1,0) [0|1] ""  ADAS
 SG_ DET_SNR_238 : 232|8@1+ (0.35156,0) [0|89.6478] "dB"  ADAS
 SG_ DET_EXISTENCE_PROB_238 : 224|6@1+ (1.588,0) [0|100] "%"  ADAS
 SG_ DET_HVC_FLAG_238 : 198|1@1+ (1,0) [0|1] ""  ADAS
 SG_ DET_CONFD_AZIMUTH_238 : 230|2@1+ (1,0) [0|3] ""  ADAS
 SG_ DET_CONFD_ELEVATION_238 : 213|2@1+ (1,0) [0|3] ""  ADAS
 SG_ DET_PROB_1STAZHYPO_238 : 215|1@1+ (1,0) [0|1] ""  ADAS
 SG_ DET_IDM_238 : 175|1@1+ (1,0) [0|1] ""  ADAS
 SG_ DET_MTD_238 : 159|1@1+ (1,0) [0|1] ""  ADAS
 SG_ DET_BELOW_RAIN_THOLD_238 : 151|1@1+ (1,0) [0|1] ""  ADAS
 SG_ DET_RANGE_239 : 248|15@1+ (0.015625,0) [0|500] "m"  ADAS
 SG_ DET_RANGE_ERR_239 : 264|7@1+ (0.0075,0) [0|0.9525] "m"  ADAS
 SG_ DET_RANGE_VELOCITY_239 : 272|15@1+ (0.0078125,-128) [-128|127.9921875] "m/s"  ADAS
 SG_ DET_RANGE_VELOCITY_ERR_239 : 288|8@1+ (0.003,0) [0|0.765] "m/s"  ADAS
 SG_ DET_AZIMUTH_239 : 312|13@1+ (0.0004,-1.5708) [-1.5708|1.5708] "rad"  ADAS
 SG_ DET_AZIMUTH_ERR_239 : 329|7@1+ (0.00087267,0) [0|0.11082909] "rad"  ADAS
 SG_ DET_ELEVATION_239 : 296|8@1+ (0.00275,-0.34925) [-0.34925|0.34925] "rad"  ADAS
 SG_ DET_ELEVATION_ERR_239 : 304|6@1+ (0.00174533,0) [0|0.10995579] "rad"  ADAS
 SG_ DET_RCS_239 : 352|8@1+ (0.5,-64) [-64|63.5] "dBsm"  ADAS
 SG_ DET_BI_STATIC_FLAG_239 : 328|1@1+ (1,0) [0|1] ""  ADAS
 SG_ DET_SUPER_RES_TARGET_239 : 311|1@1+ (1,0) [0|1] ""  ADAS
 SG_ DET_SNR_239 : 344|8@1+ (0.35156,0) [0|89.6478] "dB"  ADAS
 SG_ DET_EXISTENCE_PROB_239 : 336|6@1+ (1.588,0) [0|100] "%"  ADAS
 SG_ DET_HVC_FLAG_239 : 310|1@1+ (1,0) [0|1] ""  ADAS
 SG_ DET_CONFD_AZIMUTH_239 : 342|2@1+ (1,0) [0|3] ""  ADAS
 SG_ DET_CONFD_ELEVATION_239 : 325|2@1+ (1,0) [0|3] ""  ADAS
 SG_ DET_PROB_1STAZHYPO_239 : 327|1@1+ (1,0) [0|1] ""  ADAS
 SG_ DET_IDM_239 : 287|1@1+ (1,0) [0|1] ""  ADAS
 SG_ DET_MTD_239 : 271|1@1+ (1,0) [0|1] ""  ADAS
 SG_ DET_BELOW_RAIN_THOLD_239 : 263|1@1+ (1,0) [0|1] ""  ADAS
 SG_ DET_RANGE_240 : 360|15@1+ (0.015625,0) [0|500] "m"  ADAS
 SG_ DET_RANGE_ERR_240 : 376|7@1+ (0.0075,0) [0|0.9525] "m"  ADAS
 SG_ DET_RANGE_VELOCITY_240 : 384|15@1+ (0.0078125,-128) [-128|127.9921875] "m/s"  ADAS
 SG_ DET_RANGE_VELOCITY_ERR_240 : 400|8@1+ (0.003,0) [0|0.765] "m/s"  ADAS
 SG_ DET_AZIMUTH_240 : 424|13@1+ (0.0004,-1.5708) [-1.5708|1.5708] "rad"  ADAS
 SG_ DET_AZIMUTH_ERR_240 : 441|7@1+ (0.00087267,0) [0|0.11082909] "rad"  ADAS
 SG_ DET_ELEVATION_240 : 408|8@1+ (0.00275,-0.34925) [-0.34925|0.34925] "rad"  ADAS
 SG_ DET_ELEVATION_ERR_240 : 416|6@1+ (0.00174533,0) [0|0.10995579] "rad"  ADAS
 SG_ DET_RCS_240 : 464|8@1+ (0.5,-64) [-64|63.5] "dBsm"  ADAS
 SG_ DET_BI_STATIC_FLAG_240 : 440|1@1+ (1,0) [0|1] ""  ADAS
 SG_ DET_SUPER_RES_TARGET_240 : 423|1@1+ (1,0) [0|1] ""  ADAS
 SG_ DET_SNR_240 : 456|8@1+ (0.35156,0) [0|89.6478] "dB"  ADAS
 SG_ DET_EXISTENCE_PROB_240 : 448|6@1+ (1.588,0) [0|100] "%"  ADAS
 SG_ DET_HVC_FLAG_240 : 422|1@1+ (1,0) [0|1] ""  ADAS
 SG_ DET_CONFD_AZIMUTH_240 : 454|2@1+ (1,0) [0|3] ""  ADAS
 SG_ DET_CONFD_ELEVATION_240 : 437|2@1+ (1,0) [0|3] ""  ADAS
 SG_ DET_MH_SCAN_INDEX_4LSB_237_240 : 476|4@1+ (1,0) [0|15] ""  ADAS
 SG_ DET_MH_CYCLE_COUNTER_237_240 : 16|8@1+ (1,0) [0|255] ""  ADAS
 SG_ DET_MH_CRC16_237_240 : 0|16@1+ (1,0) [0|65535] ""  ADAS
 SG_ DET_PROB_1STAZHYPO_240 : 439|1@1+ (1,0) [0|1] ""  ADAS
 SG_ DET_IDM_240 : 399|1@1+ (1,0) [0|1] ""  ADAS
 SG_ DET_MTD_240 : 383|1@1+ (1,0) [0|1] ""  ADAS
 SG_ DET_BELOW_RAIN_THOLD_240 : 375|1@1+ (1,0) [0|1] ""  ADAS

BO_ 1212 RDR_DETECTION_241_244: 64 RDR08
 SG_ DET_RANGE_241 : 24|15@1+ (0.015625,0) [0|500] "m"  ADAS
 SG_ DET_RANGE_ERR_241 : 40|7@1+ (0.0075,0) [0|0.9525] "m"  ADAS
 SG_ DET_RANGE_VELOCITY_241 : 48|15@1+ (0.0078125,-128) [-128|127.9921875] "m/s"  ADAS
 SG_ DET_RANGE_VELOCITY_ERR_241 : 64|8@1+ (0.003,0) [0|0.765] "m/s"  ADAS
 SG_ DET_AZIMUTH_241 : 88|13@1+ (0.0004,-1.5708) [-1.5708|1.5708] "rad"  ADAS
 SG_ DET_AZIMUTH_ERR_241 : 105|7@1+ (0.00087267,0) [0|0.11082909] "rad"  ADAS
 SG_ DET_ELEVATION_241 : 72|8@1+ (0.00275,-0.34925) [-0.34925|0.34925] "rad"  ADAS
 SG_ DET_ELEVATION_ERR_241 : 80|6@1+ (0.00174533,0) [0|0.10995579] "rad"  ADAS
 SG_ DET_RCS_241 : 128|8@1+ (0.5,-64) [-64|63.5] "dBsm"  ADAS
 SG_ DET_BI_STATIC_FLAG_241 : 104|1@1+ (1,0) [0|1] ""  ADAS
 SG_ DET_SUPER_RES_TARGET_241 : 87|1@1+ (1,0) [0|1] ""  ADAS
 SG_ DET_SNR_241 : 120|8@1+ (0.35156,0) [0|89.6478] "dB"  ADAS
 SG_ DET_EXISTENCE_PROB_241 : 112|6@1+ (1.588,0) [0|100] "%"  ADAS
 SG_ DET_HVC_FLAG_241 : 86|1@1+ (1,0) [0|1] ""  ADAS
 SG_ DET_CONFD_AZIMUTH_241 : 118|2@1+ (1,0) [0|3] ""  ADAS
 SG_ DET_CONFD_ELEVATION_241 : 101|2@1+ (1,0) [0|3] ""  ADAS
 SG_ DET_PROB_1STAZHYPO_241 : 103|1@1+ (1,0) [0|1] ""  ADAS
 SG_ DET_IDM_241 : 63|1@1+ (1,0) [0|1] ""  ADAS
 SG_ DET_MTD_241 : 47|1@1+ (1,0) [0|1] ""  ADAS
 SG_ DET_BELOW_RAIN_THOLD_241 : 39|1@1+ (1,0) [0|1] ""  ADAS
 SG_ DET_RANGE_242 : 136|15@1+ (0.015625,0) [0|500] "m"  ADAS
 SG_ DET_RANGE_ERR_242 : 152|7@1+ (0.0075,0) [0|0.9525] "m"  ADAS
 SG_ DET_RANGE_VELOCITY_242 : 160|15@1+ (0.0078125,-128) [-128|127.9921875] "m/s"  ADAS
 SG_ DET_RANGE_VELOCITY_ERR_242 : 176|8@1+ (0.003,0) [0|0.765] "m/s"  ADAS
 SG_ DET_AZIMUTH_242 : 200|13@1+ (0.0004,-1.5708) [-1.5708|1.5708] "rad"  ADAS
 SG_ DET_AZIMUTH_ERR_242 : 217|7@1+ (0.00087267,0) [0|0.11082909] "rad"  ADAS
 SG_ DET_ELEVATION_242 : 184|8@1+ (0.00275,-0.34925) [-0.34925|0.34925] "rad"  ADAS
 SG_ DET_ELEVATION_ERR_242 : 192|6@1+ (0.00174533,0) [0|0.10995579] "rad"  ADAS
 SG_ DET_RCS_242 : 240|8@1+ (0.5,-64) [-64|63.5] "dBsm"  ADAS
 SG_ DET_BI_STATIC_FLAG_242 : 216|1@1+ (1,0) [0|1] ""  ADAS
 SG_ DET_SUPER_RES_TARGET_242 : 199|1@1+ (1,0) [0|1] ""  ADAS
 SG_ DET_SNR_242 : 232|8@1+ (0.35156,0) [0|89.6478] "dB"  ADAS
 SG_ DET_EXISTENCE_PROB_242 : 224|6@1+ (1.588,0) [0|100] "%"  ADAS
 SG_ DET_HVC_FLAG_242 : 198|1@1+ (1,0) [0|1] ""  ADAS
 SG_ DET_CONFD_AZIMUTH_242 : 230|2@1+ (1,0) [0|3] ""  ADAS
 SG_ DET_CONFD_ELEVATION_242 : 213|2@1+ (1,0) [0|3] ""  ADAS
 SG_ DET_PROB_1STAZHYPO_242 : 215|1@1+ (1,0) [0|1] ""  ADAS
 SG_ DET_IDM_242 : 175|1@1+ (1,0) [0|1] ""  ADAS
 SG_ DET_MTD_242 : 159|1@1+ (1,0) [0|1] ""  ADAS
 SG_ DET_BELOW_RAIN_THOLD_242 : 151|1@1+ (1,0) [0|1] ""  ADAS
 SG_ DET_RANGE_243 : 248|15@1+ (0.015625,0) [0|500] "m"  ADAS
 SG_ DET_RANGE_ERR_243 : 264|7@1+ (0.0075,0) [0|0.9525] "m"  ADAS
 SG_ DET_RANGE_VELOCITY_243 : 272|15@1+ (0.0078125,-128) [-128|127.9921875] "m/s"  ADAS
 SG_ DET_RANGE_VELOCITY_ERR_243 : 288|8@1+ (0.003,0) [0|0.765] "m/s"  ADAS
 SG_ DET_AZIMUTH_243 : 312|13@1+ (0.0004,-1.5708) [-1.5708|1.5708] "rad"  ADAS
 SG_ DET_AZIMUTH_ERR_243 : 329|7@1+ (0.00087267,0) [0|0.11082909] "rad"  ADAS
 SG_ DET_ELEVATION_243 : 296|8@1+ (0.00275,-0.34925) [-0.34925|0.34925] "rad"  ADAS
 SG_ DET_ELEVATION_ERR_243 : 304|6@1+ (0.00174533,0) [0|0.10995579] "rad"  ADAS
 SG_ DET_RCS_243 : 352|8@1+ (0.5,-64) [-64|63.5] "dBsm"  ADAS
 SG_ DET_BI_STATIC_FLAG_243 : 328|1@1+ (1,0) [0|1] ""  ADAS
 SG_ DET_SUPER_RES_TARGET_243 : 311|1@1+ (1,0) [0|1] ""  ADAS
 SG_ DET_SNR_243 : 344|8@1+ (0.35156,0) [0|89.6478] "dB"  ADAS
 SG_ DET_EXISTENCE_PROB_243 : 336|6@1+ (1.588,0) [0|100] "%"  ADAS
 SG_ DET_HVC_FLAG_243 : 310|1@1+ (1,0) [0|1] ""  ADAS
 SG_ DET_CONFD_AZIMUTH_243 : 342|2@1+ (1,0) [0|3] ""  ADAS
 SG_ DET_CONFD_ELEVATION_243 : 325|2@1+ (1,0) [0|3] ""  ADAS
 SG_ DET_PROB_1STAZHYPO_243 : 327|1@1+ (1,0) [0|1] ""  ADAS
 SG_ DET_IDM_243 : 287|1@1+ (1,0) [0|1] ""  ADAS
 SG_ DET_MTD_243 : 271|1@1+ (1,0) [0|1] ""  ADAS
 SG_ DET_BELOW_RAIN_THOLD_243 : 263|1@1+ (1,0) [0|1] ""  ADAS
 SG_ DET_RANGE_244 : 360|15@1+ (0.015625,0) [0|500] "m"  ADAS
 SG_ DET_RANGE_ERR_244 : 376|7@1+ (0.0075,0) [0|0.9525] "m"  ADAS
 SG_ DET_RANGE_VELOCITY_244 : 384|15@1+ (0.0078125,-128) [-128|127.9921875] "m/s"  ADAS
 SG_ DET_RANGE_VELOCITY_ERR_244 : 400|8@1+ (0.003,0) [0|0.765] "m/s"  ADAS
 SG_ DET_AZIMUTH_244 : 424|13@1+ (0.0004,-1.5708) [-1.5708|1.5708] "rad"  ADAS
 SG_ DET_AZIMUTH_ERR_244 : 441|7@1+ (0.00087267,0) [0|0.11082909] "rad"  ADAS
 SG_ DET_ELEVATION_244 : 408|8@1+ (0.00275,-0.34925) [-0.34925|0.34925] "rad"  ADAS
 SG_ DET_ELEVATION_ERR_244 : 416|6@1+ (0.00174533,0) [0|0.10995579] "rad"  ADAS
 SG_ DET_RCS_244 : 464|8@1+ (0.5,-64) [-64|63.5] "dBsm"  ADAS
 SG_ DET_BI_STATIC_FLAG_244 : 440|1@1+ (1,0) [0|1] ""  ADAS
 SG_ DET_SUPER_RES_TARGET_244 : 423|1@1+ (1,0) [0|1] ""  ADAS
 SG_ DET_SNR_244 : 456|8@1+ (0.35156,0) [0|89.6478] "dB"  ADAS
 SG_ DET_EXISTENCE_PROB_244 : 448|6@1+ (1.588,0) [0|100] "%"  ADAS
 SG_ DET_HVC_FLAG_244 : 422|1@1+ (1,0) [0|1] ""  ADAS
 SG_ DET_CONFD_AZIMUTH_244 : 454|2@1+ (1,0) [0|3] ""  ADAS
 SG_ DET_CONFD_ELEVATION_244 : 437|2@1+ (1,0) [0|3] ""  ADAS
 SG_ DET_MH_SCAN_INDEX_4LSB_241_244 : 476|4@1+ (1,0) [0|15] ""  ADAS
 SG_ DET_MH_CYCLE_COUNTER_241_244 : 16|8@1+ (1,0) [0|255] ""  ADAS
 SG_ DET_MH_CRC16_241_244 : 0|16@1+ (1,0) [0|65535] ""  ADAS
 SG_ DET_PROB_1STAZHYPO_244 : 439|1@1+ (1,0) [0|1] ""  ADAS
 SG_ DET_IDM_244 : 399|1@1+ (1,0) [0|1] ""  ADAS
 SG_ DET_MTD_244 : 383|1@1+ (1,0) [0|1] ""  ADAS
 SG_ DET_BELOW_RAIN_THOLD_244 : 375|1@1+ (1,0) [0|1] ""  ADAS

BO_ 1213 RDR_DETECTION_245_248: 64 RDR08
 SG_ DET_RANGE_245 : 24|15@1+ (0.015625,0) [0|500] "m"  ADAS
 SG_ DET_RANGE_ERR_245 : 40|7@1+ (0.0075,0) [0|0.9525] "m"  ADAS
 SG_ DET_RANGE_VELOCITY_245 : 48|15@1+ (0.0078125,-128) [-128|127.9921875] "m/s"  ADAS
 SG_ DET_RANGE_VELOCITY_ERR_245 : 64|8@1+ (0.003,0) [0|0.765] "m/s"  ADAS
 SG_ DET_AZIMUTH_245 : 88|13@1+ (0.0004,-1.5708) [-1.5708|1.5708] "rad"  ADAS
 SG_ DET_AZIMUTH_ERR_245 : 105|7@1+ (0.00087267,0) [0|0.11082909] "rad"  ADAS
 SG_ DET_ELEVATION_245 : 72|8@1+ (0.00275,-0.34925) [-0.34925|0.34925] "rad"  ADAS
 SG_ DET_ELEVATION_ERR_245 : 80|6@1+ (0.00174533,0) [0|0.10995579] "rad"  ADAS
 SG_ DET_RCS_245 : 128|8@1+ (0.5,-64) [-64|63.5] "dBsm"  ADAS
 SG_ DET_BI_STATIC_FLAG_245 : 104|1@1+ (1,0) [0|1] ""  ADAS
 SG_ DET_SUPER_RES_TARGET_245 : 87|1@1+ (1,0) [0|1] ""  ADAS
 SG_ DET_SNR_245 : 120|8@1+ (0.35156,0) [0|89.6478] "dB"  ADAS
 SG_ DET_EXISTENCE_PROB_245 : 112|6@1+ (1.588,0) [0|100] "%"  ADAS
 SG_ DET_HVC_FLAG_245 : 86|1@1+ (1,0) [0|1] ""  ADAS
 SG_ DET_CONFD_AZIMUTH_245 : 118|2@1+ (1,0) [0|3] ""  ADAS
 SG_ DET_CONFD_ELEVATION_245 : 101|2@1+ (1,0) [0|3] ""  ADAS
 SG_ DET_PROB_1STAZHYPO_245 : 103|1@1+ (1,0) [0|1] ""  ADAS
 SG_ DET_IDM_245 : 63|1@1+ (1,0) [0|1] ""  ADAS
 SG_ DET_MTD_245 : 47|1@1+ (1,0) [0|1] ""  ADAS
 SG_ DET_BELOW_RAIN_THOLD_245 : 39|1@1+ (1,0) [0|1] ""  ADAS
 SG_ DET_RANGE_246 : 136|15@1+ (0.015625,0) [0|500] "m"  ADAS
 SG_ DET_RANGE_ERR_246 : 152|7@1+ (0.0075,0) [0|0.9525] "m"  ADAS
 SG_ DET_RANGE_VELOCITY_246 : 160|15@1+ (0.0078125,-128) [-128|127.9921875] "m/s"  ADAS
 SG_ DET_RANGE_VELOCITY_ERR_246 : 176|8@1+ (0.003,0) [0|0.765] "m/s"  ADAS
 SG_ DET_AZIMUTH_246 : 200|13@1+ (0.0004,-1.5708) [-1.5708|1.5708] "rad"  ADAS
 SG_ DET_AZIMUTH_ERR_246 : 217|7@1+ (0.00087267,0) [0|0.11082909] "rad"  ADAS
 SG_ DET_ELEVATION_246 : 184|8@1+ (0.00275,-0.34925) [-0.34925|0.34925] "rad"  ADAS
 SG_ DET_ELEVATION_ERR_246 : 192|6@1+ (0.00174533,0) [0|0.10995579] "rad"  ADAS
 SG_ DET_RCS_246 : 240|8@1+ (0.5,-64) [-64|63.5] "dBsm"  ADAS
 SG_ DET_BI_STATIC_FLAG_246 : 216|1@1+ (1,0) [0|1] ""  ADAS
 SG_ DET_SUPER_RES_TARGET_246 : 199|1@1+ (1,0) [0|1] ""  ADAS
 SG_ DET_SNR_246 : 232|8@1+ (0.35156,0) [0|89.6478] "dB"  ADAS
 SG_ DET_EXISTENCE_PROB_246 : 224|6@1+ (1.588,0) [0|100] "%"  ADAS
 SG_ DET_HVC_FLAG_246 : 198|1@1+ (1,0) [0|1] ""  ADAS
 SG_ DET_CONFD_AZIMUTH_246 : 230|2@1+ (1,0) [0|3] ""  ADAS
 SG_ DET_CONFD_ELEVATION_246 : 213|2@1+ (1,0) [0|3] ""  ADAS
 SG_ DET_PROB_1STAZHYPO_246 : 215|1@1+ (1,0) [0|1] ""  ADAS
 SG_ DET_IDM_246 : 175|1@1+ (1,0) [0|1] ""  ADAS
 SG_ DET_MTD_246 : 159|1@1+ (1,0) [0|1] ""  ADAS
 SG_ DET_BELOW_RAIN_THOLD_246 : 151|1@1+ (1,0) [0|1] ""  ADAS
 SG_ DET_RANGE_247 : 248|15@1+ (0.015625,0) [0|500] "m"  ADAS
 SG_ DET_RANGE_ERR_247 : 264|7@1+ (0.0075,0) [0|0.9525] "m"  ADAS
 SG_ DET_RANGE_VELOCITY_247 : 272|15@1+ (0.0078125,-128) [-128|127.9921875] "m/s"  ADAS
 SG_ DET_RANGE_VELOCITY_ERR_247 : 288|8@1+ (0.003,0) [0|0.765] "m/s"  ADAS
 SG_ DET_AZIMUTH_247 : 312|13@1+ (0.0004,-1.5708) [-1.5708|1.5708] "rad"  ADAS
 SG_ DET_AZIMUTH_ERR_247 : 329|7@1+ (0.00087267,0) [0|0.11082909] "rad"  ADAS
 SG_ DET_ELEVATION_247 : 296|8@1+ (0.00275,-0.34925) [-0.34925|0.34925] "rad"  ADAS
 SG_ DET_ELEVATION_ERR_247 : 304|6@1+ (0.00174533,0) [0|0.10995579] "rad"  ADAS
 SG_ DET_RCS_247 : 352|8@1+ (0.5,-64) [-64|63.5] "dBsm"  ADAS
 SG_ DET_BI_STATIC_FLAG_247 : 328|1@1+ (1,0) [0|1] ""  ADAS
 SG_ DET_SUPER_RES_TARGET_247 : 311|1@1+ (1,0) [0|1] ""  ADAS
 SG_ DET_SNR_247 : 344|8@1+ (0.35156,0) [0|89.6478] "dB"  ADAS
 SG_ DET_EXISTENCE_PROB_247 : 336|6@1+ (1.588,0) [0|100] "%"  ADAS
 SG_ DET_HVC_FLAG_247 : 310|1@1+ (1,0) [0|1] ""  ADAS
 SG_ DET_CONFD_AZIMUTH_247 : 342|2@1+ (1,0) [0|3] ""  ADAS
 SG_ DET_CONFD_ELEVATION_247 : 325|2@1+ (1,0) [0|3] ""  ADAS
 SG_ DET_PROB_1STAZHYPO_247 : 327|1@1+ (1,0) [0|1] ""  ADAS
 SG_ DET_IDM_247 : 287|1@1+ (1,0) [0|1] ""  ADAS
 SG_ DET_MTD_247 : 271|1@1+ (1,0) [0|1] ""  ADAS
 SG_ DET_BELOW_RAIN_THOLD_247 : 263|1@1+ (1,0) [0|1] ""  ADAS
 SG_ DET_RANGE_248 : 360|15@1+ (0.015625,0) [0|500] "m"  ADAS
 SG_ DET_RANGE_ERR_248 : 376|7@1+ (0.0075,0) [0|0.9525] "m"  ADAS
 SG_ DET_RANGE_VELOCITY_248 : 384|15@1+ (0.0078125,-128) [-128|127.9921875] "m/s"  ADAS
 SG_ DET_RANGE_VELOCITY_ERR_248 : 400|8@1+ (0.003,0) [0|0.765] "m/s"  ADAS
 SG_ DET_AZIMUTH_248 : 424|13@1+ (0.0004,-1.5708) [-1.5708|1.5708] "rad"  ADAS
 SG_ DET_AZIMUTH_ERR_248 : 441|7@1+ (0.00087267,0) [0|0.11082909] "rad"  ADAS
 SG_ DET_ELEVATION_248 : 408|8@1+ (0.00275,-0.34925) [-0.34925|0.34925] "rad"  ADAS
 SG_ DET_ELEVATION_ERR_248 : 416|6@1+ (0.00174533,0) [0|0.10995579] "rad"  ADAS
 SG_ DET_RCS_248 : 464|8@1+ (0.5,-64) [-64|63.5] "dBsm"  ADAS
 SG_ DET_BI_STATIC_FLAG_248 : 440|1@1+ (1,0) [0|1] ""  ADAS
 SG_ DET_SUPER_RES_TARGET_248 : 423|1@1+ (1,0) [0|1] ""  ADAS
 SG_ DET_SNR_248 : 456|8@1+ (0.35156,0) [0|89.6478] "dB"  ADAS
 SG_ DET_EXISTENCE_PROB_248 : 448|6@1+ (1.588,0) [0|100] "%"  ADAS
 SG_ DET_HVC_FLAG_248 : 422|1@1+ (1,0) [0|1] ""  ADAS
 SG_ DET_CONFD_AZIMUTH_248 : 454|2@1+ (1,0) [0|3] ""  ADAS
 SG_ DET_CONFD_ELEVATION_248 : 437|2@1+ (1,0) [0|3] ""  ADAS
 SG_ DET_MH_SCAN_INDEX_4LSB_245_248 : 476|4@1+ (1,0) [0|15] ""  ADAS
 SG_ DET_MH_CYCLE_COUNTER_245_248 : 16|8@1+ (1,0) [0|255] ""  ADAS
 SG_ DET_MH_CRC16_245_248 : 0|16@1+ (1,0) [0|65535] ""  ADAS
 SG_ DET_PROB_1STAZHYPO_248 : 439|1@1+ (1,0) [0|1] ""  ADAS
 SG_ DET_IDM_248 : 399|1@1+ (1,0) [0|1] ""  ADAS
 SG_ DET_MTD_248 : 383|1@1+ (1,0) [0|1] ""  ADAS
 SG_ DET_BELOW_RAIN_THOLD_248 : 375|1@1+ (1,0) [0|1] ""  ADAS

BO_ 1214 RDR_DETECTION_249_252: 64 RDR08
 SG_ DET_RANGE_249 : 24|15@1+ (0.015625,0) [0|500] "m"  ADAS
 SG_ DET_RANGE_ERR_249 : 40|7@1+ (0.0075,0) [0|0.9525] "m"  ADAS
 SG_ DET_RANGE_VELOCITY_249 : 48|15@1+ (0.0078125,-128) [-128|127.9921875] "m/s"  ADAS
 SG_ DET_RANGE_VELOCITY_ERR_249 : 64|8@1+ (0.003,0) [0|0.765] "m/s"  ADAS
 SG_ DET_AZIMUTH_249 : 88|13@1+ (0.0004,-1.5708) [-1.5708|1.5708] "rad"  ADAS
 SG_ DET_AZIMUTH_ERR_249 : 105|7@1+ (0.00087267,0) [0|0.11082909] "rad"  ADAS
 SG_ DET_ELEVATION_249 : 72|8@1+ (0.00275,-0.34925) [-0.34925|0.34925] "rad"  ADAS
 SG_ DET_ELEVATION_ERR_249 : 80|6@1+ (0.00174533,0) [0|0.10995579] "rad"  ADAS
 SG_ DET_RCS_249 : 128|8@1+ (0.5,-64) [-64|63.5] "dBsm"  ADAS
 SG_ DET_BI_STATIC_FLAG_249 : 104|1@1+ (1,0) [0|1] ""  ADAS
 SG_ DET_SUPER_RES_TARGET_249 : 87|1@1+ (1,0) [0|1] ""  ADAS
 SG_ DET_SNR_249 : 120|8@1+ (0.35156,0) [0|89.6478] "dB"  ADAS
 SG_ DET_EXISTENCE_PROB_249 : 112|6@1+ (1.588,0) [0|100] "%"  ADAS
 SG_ DET_HVC_FLAG_249 : 86|1@1+ (1,0) [0|1] ""  ADAS
 SG_ DET_CONFD_AZIMUTH_249 : 118|2@1+ (1,0) [0|3] ""  ADAS
 SG_ DET_CONFD_ELEVATION_249 : 101|2@1+ (1,0) [0|3] ""  ADAS
 SG_ DET_PROB_1STAZHYPO_249 : 103|1@1+ (1,0) [0|1] ""  ADAS
 SG_ DET_IDM_249 : 63|1@1+ (1,0) [0|1] ""  ADAS
 SG_ DET_MTD_249 : 47|1@1+ (1,0) [0|1] ""  ADAS
 SG_ DET_BELOW_RAIN_THOLD_249 : 39|1@1+ (1,0) [0|1] ""  ADAS
 SG_ DET_RANGE_250 : 136|15@1+ (0.015625,0) [0|500] "m"  ADAS
 SG_ DET_RANGE_ERR_250 : 152|7@1+ (0.0075,0) [0|0.9525] "m"  ADAS
 SG_ DET_RANGE_VELOCITY_250 : 160|15@1+ (0.0078125,-128) [-128|127.9921875] "m/s"  ADAS
 SG_ DET_RANGE_VELOCITY_ERR_250 : 176|8@1+ (0.003,0) [0|0.765] "m/s"  ADAS
 SG_ DET_AZIMUTH_250 : 200|13@1+ (0.0004,-1.5708) [-1.5708|1.5708] "rad"  ADAS
 SG_ DET_AZIMUTH_ERR_250 : 217|7@1+ (0.00087267,0) [0|0.11082909] "rad"  ADAS
 SG_ DET_ELEVATION_250 : 184|8@1+ (0.00275,-0.34925) [-0.34925|0.34925] "rad"  ADAS
 SG_ DET_ELEVATION_ERR_250 : 192|6@1+ (0.00174533,0) [0|0.10995579] "rad"  ADAS
 SG_ DET_RCS_250 : 240|8@1+ (0.5,-64) [-64|63.5] "dBsm"  ADAS
 SG_ DET_BI_STATIC_FLAG_250 : 216|1@1+ (1,0) [0|1] ""  ADAS
 SG_ DET_SUPER_RES_TARGET_250 : 199|1@1+ (1,0) [0|1] ""  ADAS
 SG_ DET_SNR_250 : 232|8@1+ (0.35156,0) [0|89.6478] "dB"  ADAS
 SG_ DET_EXISTENCE_PROB_250 : 224|6@1+ (1.588,0) [0|100] "%"  ADAS
 SG_ DET_HVC_FLAG_250 : 198|1@1+ (1,0) [0|1] ""  ADAS
 SG_ DET_CONFD_AZIMUTH_250 : 230|2@1+ (1,0) [0|3] ""  ADAS
 SG_ DET_CONFD_ELEVATION_250 : 213|2@1+ (1,0) [0|3] ""  ADAS
 SG_ DET_PROB_1STAZHYPO_250 : 215|1@1+ (1,0) [0|1] ""  ADAS
 SG_ DET_IDM_250 : 175|1@1+ (1,0) [0|1] ""  ADAS
 SG_ DET_MTD_250 : 159|1@1+ (1,0) [0|1] ""  ADAS
 SG_ DET_BELOW_RAIN_THOLD_250 : 151|1@1+ (1,0) [0|1] ""  ADAS
 SG_ DET_RANGE_251 : 248|15@1+ (0.015625,0) [0|500] "m"  ADAS
 SG_ DET_RANGE_ERR_251 : 264|7@1+ (0.0075,0) [0|0.9525] "m"  ADAS
 SG_ DET_RANGE_VELOCITY_251 : 272|15@1+ (0.0078125,-128) [-128|127.9921875] "m/s"  ADAS
 SG_ DET_RANGE_VELOCITY_ERR_251 : 288|8@1+ (0.003,0) [0|0.765] "m/s"  ADAS
 SG_ DET_AZIMUTH_251 : 312|13@1+ (0.0004,-1.5708) [-1.5708|1.5708] "rad"  ADAS
 SG_ DET_AZIMUTH_ERR_251 : 329|7@1+ (0.00087267,0) [0|0.11082909] "rad"  ADAS
 SG_ DET_ELEVATION_251 : 296|8@1+ (0.00275,-0.34925) [-0.34925|0.34925] "rad"  ADAS
 SG_ DET_ELEVATION_ERR_251 : 304|6@1+ (0.00174533,0) [0|0.10995579] "rad"  ADAS
 SG_ DET_RCS_251 : 352|8@1+ (0.5,-64) [-64|63.5] "dBsm"  ADAS
 SG_ DET_BI_STATIC_FLAG_251 : 328|1@1+ (1,0) [0|1] ""  ADAS
 SG_ DET_SUPER_RES_TARGET_251 : 311|1@1+ (1,0) [0|1] ""  ADAS
 SG_ DET_SNR_251 : 344|8@1+ (0.35156,0) [0|89.6478] "dB"  ADAS
 SG_ DET_EXISTENCE_PROB_251 : 336|6@1+ (1.588,0) [0|100] "%"  ADAS
 SG_ DET_HVC_FLAG_251 : 310|1@1+ (1,0) [0|1] ""  ADAS
 SG_ DET_CONFD_AZIMUTH_251 : 342|2@1+ (1,0) [0|3] ""  ADAS
 SG_ DET_CONFD_ELEVATION_251 : 325|2@1+ (1,0) [0|3] ""  ADAS
 SG_ DET_PROB_1STAZHYPO_251 : 327|1@1+ (1,0) [0|1] ""  ADAS
 SG_ DET_IDM_251 : 287|1@1+ (1,0) [0|1] ""  ADAS
 SG_ DET_MTD_251 : 271|1@1+ (1,0) [0|1] ""  ADAS
 SG_ DET_BELOW_RAIN_THOLD_251 : 263|1@1+ (1,0) [0|1] ""  ADAS
 SG_ DET_RANGE_252 : 360|15@1+ (0.015625,0) [0|500] "m"  ADAS
 SG_ DET_RANGE_ERR_252 : 376|7@1+ (0.0075,0) [0|0.9525] "m"  ADAS
 SG_ DET_RANGE_VELOCITY_252 : 384|15@1+ (0.0078125,-128) [-128|127.9921875] "m/s"  ADAS
 SG_ DET_RANGE_VELOCITY_ERR_252 : 400|8@1+ (0.003,0) [0|0.765] "m/s"  ADAS
 SG_ DET_AZIMUTH_252 : 424|13@1+ (0.0004,-1.5708) [-1.5708|1.5708] "rad"  ADAS
 SG_ DET_AZIMUTH_ERR_252 : 441|7@1+ (0.00087267,0) [0|0.11082909] "rad"  ADAS
 SG_ DET_ELEVATION_252 : 408|8@1+ (0.00275,-0.34925) [-0.34925|0.34925] "rad"  ADAS
 SG_ DET_ELEVATION_ERR_252 : 416|6@1+ (0.00174533,0) [0|0.10995579] "rad"  ADAS
 SG_ DET_RCS_252 : 464|8@1+ (0.5,-64) [-64|63.5] "dBsm"  ADAS
 SG_ DET_BI_STATIC_FLAG_252 : 440|1@1+ (1,0) [0|1] ""  ADAS
 SG_ DET_SUPER_RES_TARGET_252 : 423|1@1+ (1,0) [0|1] ""  ADAS
 SG_ DET_SNR_252 : 456|8@1+ (0.35156,0) [0|89.6478] "dB"  ADAS
 SG_ DET_EXISTENCE_PROB_252 : 448|6@1+ (1.588,0) [0|100] "%"  ADAS
 SG_ DET_HVC_FLAG_252 : 422|1@1+ (1,0) [0|1] ""  ADAS
 SG_ DET_CONFD_AZIMUTH_252 : 454|2@1+ (1,0) [0|3] ""  ADAS
 SG_ DET_CONFD_ELEVATION_252 : 437|2@1+ (1,0) [0|3] ""  ADAS
 SG_ DET_MH_SCAN_INDEX_4LSB_249_252 : 476|4@1+ (1,0) [0|15] ""  ADAS
 SG_ DET_MH_CYCLE_COUNTER_249_252 : 16|8@1+ (1,0) [0|255] ""  ADAS
 SG_ DET_MH_CRC16_249_252 : 0|16@1+ (1,0) [0|65535] ""  ADAS
 SG_ DET_PROB_1STAZHYPO_252 : 439|1@1+ (1,0) [0|1] ""  ADAS
 SG_ DET_IDM_252 : 399|1@1+ (1,0) [0|1] ""  ADAS
 SG_ DET_MTD_252 : 383|1@1+ (1,0) [0|1] ""  ADAS
 SG_ DET_BELOW_RAIN_THOLD_252 : 375|1@1+ (1,0) [0|1] ""  ADAS

BO_ 1215 RDR_DETECTION_253_256: 64 RDR08
 SG_ DET_RANGE_253 : 24|15@1+ (0.015625,0) [0|500] "m"  ADAS
 SG_ DET_RANGE_ERR_253 : 40|7@1+ (0.0075,0) [0|0.9525] "m"  ADAS
 SG_ DET_RANGE_VELOCITY_253 : 48|15@1+ (0.0078125,-128) [-128|127.9921875] "m/s"  ADAS
 SG_ DET_RANGE_VELOCITY_ERR_253 : 64|8@1+ (0.003,0) [0|0.765] "m/s"  ADAS
 SG_ DET_AZIMUTH_253 : 88|13@1+ (0.0004,-1.5708) [-1.5708|1.5708] "rad"  ADAS
 SG_ DET_AZIMUTH_ERR_253 : 105|7@1+ (0.00087267,0) [0|0.11082909] "rad"  ADAS
 SG_ DET_ELEVATION_253 : 72|8@1+ (0.00275,-0.34925) [-0.34925|0.34925] "rad"  ADAS
 SG_ DET_ELEVATION_ERR_253 : 80|6@1+ (0.00174533,0) [0|0.10995579] "rad"  ADAS
 SG_ DET_RCS_253 : 128|8@1+ (0.5,-64) [-64|63.5] "dBsm"  ADAS
 SG_ DET_BI_STATIC_FLAG_253 : 104|1@1+ (1,0) [0|1] ""  ADAS
 SG_ DET_SUPER_RES_TARGET_253 : 87|1@1+ (1,0) [0|1] ""  ADAS
 SG_ DET_SNR_253 : 120|8@1+ (0.35156,0) [0|89.6478] "dB"  ADAS
 SG_ DET_EXISTENCE_PROB_253 : 112|6@1+ (1.588,0) [0|100] "%"  ADAS
 SG_ DET_HVC_FLAG_253 : 86|1@1+ (1,0) [0|1] ""  ADAS
 SG_ DET_CONFD_AZIMUTH_253 : 118|2@1+ (1,0) [0|3] ""  ADAS
 SG_ DET_CONFD_ELEVATION_253 : 101|2@1+ (1,0) [0|3] ""  ADAS
 SG_ DET_PROB_1STAZHYPO_253 : 103|1@1+ (1,0) [0|1] ""  ADAS
 SG_ DET_IDM_253 : 63|1@1+ (1,0) [0|1] ""  ADAS
 SG_ DET_MTD_253 : 47|1@1+ (1,0) [0|1] ""  ADAS
 SG_ DET_BELOW_RAIN_THOLD_253 : 39|1@1+ (1,0) [0|1] ""  ADAS
 SG_ DET_RANGE_254 : 136|15@1+ (0.015625,0) [0|500] "m"  ADAS
 SG_ DET_RANGE_ERR_254 : 152|7@1+ (0.0075,0) [0|0.9525] "m"  ADAS
 SG_ DET_RANGE_VELOCITY_254 : 160|15@1+ (0.0078125,-128) [-128|127.9921875] "m/s"  ADAS
 SG_ DET_RANGE_VELOCITY_ERR_254 : 176|8@1+ (0.003,0) [0|0.765] "m/s"  ADAS
 SG_ DET_AZIMUTH_254 : 200|13@1+ (0.0004,-1.5708) [-1.5708|1.5708] "rad"  ADAS
 SG_ DET_AZIMUTH_ERR_254 : 217|7@1+ (0.00087267,0) [0|0.11082909] "rad"  ADAS
 SG_ DET_ELEVATION_254 : 184|8@1+ (0.00275,-0.34925) [-0.34925|0.34925] "rad"  ADAS
 SG_ DET_ELEVATION_ERR_254 : 192|6@1+ (0.00174533,0) [0|0.10995579] "rad"  ADAS
 SG_ DET_RCS_254 : 240|8@1+ (0.5,-64) [-64|63.5] "dBsm"  ADAS
 SG_ DET_BI_STATIC_FLAG_254 : 216|1@1+ (1,0) [0|1] ""  ADAS
 SG_ DET_SUPER_RES_TARGET_254 : 199|1@1+ (1,0) [0|1] ""  ADAS
 SG_ DET_SNR_254 : 232|8@1+ (0.35156,0) [0|89.6478] "dB"  ADAS
 SG_ DET_EXISTENCE_PROB_254 : 224|6@1+ (1.588,0) [0|100] "%"  ADAS
 SG_ DET_HVC_FLAG_254 : 198|1@1+ (1,0) [0|1] ""  ADAS
 SG_ DET_CONFD_AZIMUTH_254 : 230|2@1+ (1,0) [0|3] ""  ADAS
 SG_ DET_CONFD_ELEVATION_254 : 213|2@1+ (1,0) [0|3] ""  ADAS
 SG_ DET_PROB_1STAZHYPO_254 : 215|1@1+ (1,0) [0|1] ""  ADAS
 SG_ DET_IDM_254 : 175|1@1+ (1,0) [0|1] ""  ADAS
 SG_ DET_MTD_254 : 159|1@1+ (1,0) [0|1] ""  ADAS
 SG_ DET_BELOW_RAIN_THOLD_254 : 151|1@1+ (1,0) [0|1] ""  ADAS
 SG_ DET_RANGE_255 : 248|15@1+ (0.015625,0) [0|500] "m"  ADAS
 SG_ DET_RANGE_ERR_255 : 264|7@1+ (0.0075,0) [0|0.9525] "m"  ADAS
 SG_ DET_RANGE_VELOCITY_255 : 272|15@1+ (0.0078125,-128) [-128|127.9921875] "m/s"  ADAS
 SG_ DET_RANGE_VELOCITY_ERR_255 : 288|8@1+ (0.003,0) [0|0.765] "m/s"  ADAS
 SG_ DET_AZIMUTH_255 : 312|13@1+ (0.0004,-1.5708) [-1.5708|1.5708] "rad"  ADAS
 SG_ DET_AZIMUTH_ERR_255 : 329|7@1+ (0.00087267,0) [0|0.11082909] "rad"  ADAS
 SG_ DET_ELEVATION_255 : 296|8@1+ (0.00275,-0.34925) [-0.34925|0.34925] "rad"  ADAS
 SG_ DET_ELEVATION_ERR_255 : 304|6@1+ (0.00174533,0) [0|0.10995579] "rad"  ADAS
 SG_ DET_RCS_255 : 352|8@1+ (0.5,-64) [-64|63.5] "dBsm"  ADAS
 SG_ DET_BI_STATIC_FLAG_255 : 328|1@1+ (1,0) [0|1] ""  ADAS
 SG_ DET_SUPER_RES_TARGET_255 : 311|1@1+ (1,0) [0|1] ""  ADAS
 SG_ DET_SNR_255 : 344|8@1+ (0.35156,0) [0|89.6478] "dB"  ADAS
 SG_ DET_EXISTENCE_PROB_255 : 336|6@1+ (1.588,0) [0|100] "%"  ADAS
 SG_ DET_HVC_FLAG_255 : 310|1@1+ (1,0) [0|1] ""  ADAS
 SG_ DET_CONFD_AZIMUTH_255 : 342|2@1+ (1,0) [0|3] ""  ADAS
 SG_ DET_CONFD_ELEVATION_255 : 325|2@1+ (1,0) [0|3] ""  ADAS
 SG_ DET_PROB_1STAZHYPO_255 : 327|1@1+ (1,0) [0|1] ""  ADAS
 SG_ DET_IDM_255 : 287|1@1+ (1,0) [0|1] ""  ADAS
 SG_ DET_MTD_255 : 271|1@1+ (1,0) [0|1] ""  ADAS
 SG_ DET_BELOW_RAIN_THOLD_255 : 263|1@1+ (1,0) [0|1] ""  ADAS
 SG_ DET_RANGE_256 : 360|15@1+ (0.015625,0) [0|500] "m"  ADAS
 SG_ DET_RANGE_ERR_256 : 376|7@1+ (0.0075,0) [0|0.9525] "m"  ADAS
 SG_ DET_RANGE_VELOCITY_256 : 384|15@1+ (0.0078125,-128) [-128|127.9921875] "m/s"  ADAS
 SG_ DET_RANGE_VELOCITY_ERR_256 : 400|8@1+ (0.003,0) [0|0.765] "m/s"  ADAS
 SG_ DET_AZIMUTH_256 : 424|13@1+ (0.0004,-1.5708) [-1.5708|1.5708] "rad"  ADAS
 SG_ DET_AZIMUTH_ERR_256 : 441|7@1+ (0.00087267,0) [0|0.11082909] "rad"  ADAS
 SG_ DET_ELEVATION_256 : 408|8@1+ (0.00275,-0.34925) [-0.34925|0.34925] "rad"  ADAS
 SG_ DET_ELEVATION_ERR_256 : 416|6@1+ (0.00174533,0) [0|0.10995579] "rad"  ADAS
 SG_ DET_RCS_256 : 464|8@1+ (0.5,-64) [-64|63.5] "dBsm"  ADAS
 SG_ DET_BI_STATIC_FLAG_256 : 440|1@1+ (1,0) [0|1] ""  ADAS
 SG_ DET_SUPER_RES_TARGET_256 : 423|1@1+ (1,0) [0|1] ""  ADAS
 SG_ DET_SNR_256 : 456|8@1+ (0.35156,0) [0|89.6478] "dB"  ADAS
 SG_ DET_EXISTENCE_PROB_256 : 448|6@1+ (1.588,0) [0|100] "%"  ADAS
 SG_ DET_HVC_FLAG_256 : 422|1@1+ (1,0) [0|1] ""  ADAS
 SG_ DET_CONFD_AZIMUTH_256 : 454|2@1+ (1,0) [0|3] ""  ADAS
 SG_ DET_CONFD_ELEVATION_256 : 437|2@1+ (1,0) [0|3] ""  ADAS
 SG_ DET_MH_SCAN_INDEX_4LSB_253_256 : 476|4@1+ (1,0) [0|15] ""  ADAS
 SG_ DET_MH_CYCLE_COUNTER_253_256 : 16|8@1+ (1,0) [0|255] ""  ADAS
 SG_ DET_MH_CRC16_253_256 : 0|16@1+ (1,0) [0|65535] ""  ADAS
 SG_ DET_PROB_1STAZHYPO_256 : 439|1@1+ (1,0) [0|1] ""  ADAS
 SG_ DET_IDM_256 : 399|1@1+ (1,0) [0|1] ""  ADAS
 SG_ DET_MTD_256 : 383|1@1+ (1,0) [0|1] ""  ADAS
 SG_ DET_BELOW_RAIN_THOLD_256 : 375|1@1+ (1,0) [0|1] ""  ADAS

BO_ 1216 RDR_DETECTION_257_260: 64 RDR08
 SG_ DET_RANGE_257 : 24|15@1+ (0.015625,0) [0|500] "m"  ADAS
 SG_ DET_RANGE_ERR_257 : 40|7@1+ (0.0075,0) [0|0.9525] "m"  ADAS
 SG_ DET_RANGE_VELOCITY_257 : 48|15@1+ (0.0078125,-128) [-128|127.9921875] "m/s"  ADAS
 SG_ DET_RANGE_VELOCITY_ERR_257 : 64|8@1+ (0.003,0) [0|0.765] "m/s"  ADAS
 SG_ DET_AZIMUTH_257 : 88|13@1+ (0.0004,-1.5708) [-1.5708|1.5708] "rad"  ADAS
 SG_ DET_AZIMUTH_ERR_257 : 105|7@1+ (0.00087267,0) [0|0.11082909] "rad"  ADAS
 SG_ DET_ELEVATION_257 : 72|8@1+ (0.00275,-0.34925) [-0.34925|0.34925] "rad"  ADAS
 SG_ DET_ELEVATION_ERR_257 : 80|6@1+ (0.00174533,0) [0|0.10995579] "rad"  ADAS
 SG_ DET_RCS_257 : 128|8@1+ (0.5,-64) [-64|63.5] "dBsm"  ADAS
 SG_ DET_BI_STATIC_FLAG_257 : 104|1@1+ (1,0) [0|1] ""  ADAS
 SG_ DET_SUPER_RES_TARGET_257 : 87|1@1+ (1,0) [0|1] ""  ADAS
 SG_ DET_SNR_257 : 120|8@1+ (0.35156,0) [0|89.6478] "dB"  ADAS
 SG_ DET_EXISTENCE_PROB_257 : 112|6@1+ (1.588,0) [0|100] "%"  ADAS
 SG_ DET_HVC_FLAG_257 : 86|1@1+ (1,0) [0|1] ""  ADAS
 SG_ DET_CONFD_AZIMUTH_257 : 118|2@1+ (1,0) [0|3] ""  ADAS
 SG_ DET_CONFD_ELEVATION_257 : 101|2@1+ (1,0) [0|3] ""  ADAS
 SG_ DET_PROB_1STAZHYPO_257 : 103|1@1+ (1,0) [0|1] ""  ADAS
 SG_ DET_IDM_257 : 63|1@1+ (1,0) [0|1] ""  ADAS
 SG_ DET_MTD_257 : 47|1@1+ (1,0) [0|1] ""  ADAS
 SG_ DET_BELOW_RAIN_THOLD_257 : 39|1@1+ (1,0) [0|1] ""  ADAS
 SG_ DET_RANGE_258 : 136|15@1+ (0.015625,0) [0|500] "m"  ADAS
 SG_ DET_RANGE_ERR_258 : 152|7@1+ (0.0075,0) [0|0.9525] "m"  ADAS
 SG_ DET_RANGE_VELOCITY_258 : 160|15@1+ (0.0078125,-128) [-128|127.9921875] "m/s"  ADAS
 SG_ DET_RANGE_VELOCITY_ERR_258 : 176|8@1+ (0.003,0) [0|0.765] "m/s"  ADAS
 SG_ DET_AZIMUTH_258 : 200|13@1+ (0.0004,-1.5708) [-1.5708|1.5708] "rad"  ADAS
 SG_ DET_AZIMUTH_ERR_258 : 217|7@1+ (0.00087267,0) [0|0.11082909] "rad"  ADAS
 SG_ DET_ELEVATION_258 : 184|8@1+ (0.00275,-0.34925) [-0.34925|0.34925] "rad"  ADAS
 SG_ DET_ELEVATION_ERR_258 : 192|6@1+ (0.00174533,0) [0|0.10995579] "rad"  ADAS
 SG_ DET_RCS_258 : 240|8@1+ (0.5,-64) [-64|63.5] "dBsm"  ADAS
 SG_ DET_BI_STATIC_FLAG_258 : 216|1@1+ (1,0) [0|1] ""  ADAS
 SG_ DET_SUPER_RES_TARGET_258 : 199|1@1+ (1,0) [0|1] ""  ADAS
 SG_ DET_SNR_258 : 232|8@1+ (0.35156,0) [0|89.6478] "dB"  ADAS
 SG_ DET_EXISTENCE_PROB_258 : 224|6@1+ (1.588,0) [0|100] "%"  ADAS
 SG_ DET_HVC_FLAG_258 : 198|1@1+ (1,0) [0|1] ""  ADAS
 SG_ DET_CONFD_AZIMUTH_258 : 230|2@1+ (1,0) [0|3] ""  ADAS
 SG_ DET_CONFD_ELEVATION_258 : 213|2@1+ (1,0) [0|3] ""  ADAS
 SG_ DET_PROB_1STAZHYPO_258 : 215|1@1+ (1,0) [0|1] ""  ADAS
 SG_ DET_IDM_258 : 175|1@1+ (1,0) [0|1] ""  ADAS
 SG_ DET_MTD_258 : 159|1@1+ (1,0) [0|1] ""  ADAS
 SG_ DET_BELOW_RAIN_THOLD_258 : 151|1@1+ (1,0) [0|1] ""  ADAS
 SG_ DET_RANGE_259 : 248|15@1+ (0.015625,0) [0|500] "m"  ADAS
 SG_ DET_RANGE_ERR_259 : 264|7@1+ (0.0075,0) [0|0.9525] "m"  ADAS
 SG_ DET_RANGE_VELOCITY_259 : 272|15@1+ (0.0078125,-128) [-128|127.9921875] "m/s"  ADAS
 SG_ DET_RANGE_VELOCITY_ERR_259 : 288|8@1+ (0.003,0) [0|0.765] "m/s"  ADAS
 SG_ DET_AZIMUTH_259 : 312|13@1+ (0.0004,-1.5708) [-1.5708|1.5708] "rad"  ADAS
 SG_ DET_AZIMUTH_ERR_259 : 329|7@1+ (0.00087267,0) [0|0.11082909] "rad"  ADAS
 SG_ DET_ELEVATION_259 : 296|8@1+ (0.00275,-0.34925) [-0.34925|0.34925] "rad"  ADAS
 SG_ DET_ELEVATION_ERR_259 : 304|6@1+ (0.00174533,0) [0|0.10995579] "rad"  ADAS
 SG_ DET_RCS_259 : 352|8@1+ (0.5,-64) [-64|63.5] "dBsm"  ADAS
 SG_ DET_BI_STATIC_FLAG_259 : 328|1@1+ (1,0) [0|1] ""  ADAS
 SG_ DET_SUPER_RES_TARGET_259 : 311|1@1+ (1,0) [0|1] ""  ADAS
 SG_ DET_SNR_259 : 344|8@1+ (0.35156,0) [0|89.6478] "dB"  ADAS
 SG_ DET_EXISTENCE_PROB_259 : 336|6@1+ (1.588,0) [0|100] "%"  ADAS
 SG_ DET_HVC_FLAG_259 : 310|1@1+ (1,0) [0|1] ""  ADAS
 SG_ DET_CONFD_AZIMUTH_259 : 342|2@1+ (1,0) [0|3] ""  ADAS
 SG_ DET_CONFD_ELEVATION_259 : 325|2@1+ (1,0) [0|3] ""  ADAS
 SG_ DET_PROB_1STAZHYPO_259 : 327|1@1+ (1,0) [0|1] ""  ADAS
 SG_ DET_IDM_259 : 287|1@1+ (1,0) [0|1] ""  ADAS
 SG_ DET_MTD_259 : 271|1@1+ (1,0) [0|1] ""  ADAS
 SG_ DET_BELOW_RAIN_THOLD_259 : 263|1@1+ (1,0) [0|1] ""  ADAS
 SG_ DET_RANGE_260 : 360|15@1+ (0.015625,0) [0|500] "m"  ADAS
 SG_ DET_RANGE_ERR_260 : 376|7@1+ (0.0075,0) [0|0.9525] "m"  ADAS
 SG_ DET_RANGE_VELOCITY_260 : 384|15@1+ (0.0078125,-128) [-128|127.9921875] "m/s"  ADAS
 SG_ DET_RANGE_VELOCITY_ERR_260 : 400|8@1+ (0.003,0) [0|0.765] "m/s"  ADAS
 SG_ DET_AZIMUTH_260 : 424|13@1+ (0.0004,-1.5708) [-1.5708|1.5708] "rad"  ADAS
 SG_ DET_AZIMUTH_ERR_260 : 441|7@1+ (0.00087267,0) [0|0.11082909] "rad"  ADAS
 SG_ DET_ELEVATION_260 : 408|8@1+ (0.00275,-0.34925) [-0.34925|0.34925] "rad"  ADAS
 SG_ DET_ELEVATION_ERR_260 : 416|6@1+ (0.00174533,0) [0|0.10995579] "rad"  ADAS
 SG_ DET_RCS_260 : 464|8@1+ (0.5,-64) [-64|63.5] "dBsm"  ADAS
 SG_ DET_BI_STATIC_FLAG_260 : 440|1@1+ (1,0) [0|1] ""  ADAS
 SG_ DET_SUPER_RES_TARGET_260 : 423|1@1+ (1,0) [0|1] ""  ADAS
 SG_ DET_SNR_260 : 456|8@1+ (0.35156,0) [0|89.6478] "dB"  ADAS
 SG_ DET_EXISTENCE_PROB_260 : 448|6@1+ (1.588,0) [0|100] "%"  ADAS
 SG_ DET_HVC_FLAG_260 : 422|1@1+ (1,0) [0|1] ""  ADAS
 SG_ DET_CONFD_AZIMUTH_260 : 454|2@1+ (1,0) [0|3] ""  ADAS
 SG_ DET_CONFD_ELEVATION_260 : 437|2@1+ (1,0) [0|3] ""  ADAS
 SG_ DET_MH_SCAN_INDEX_4LSB_257_260 : 476|4@1+ (1,0) [0|15] ""  ADAS
 SG_ DET_MH_CYCLE_COUNTER_257_260 : 16|8@1+ (1,0) [0|255] ""  ADAS
 SG_ DET_MH_CRC16_257_260 : 0|16@1+ (1,0) [0|65535] ""  ADAS
 SG_ DET_PROB_1STAZHYPO_260 : 439|1@1+ (1,0) [0|1] ""  ADAS
 SG_ DET_IDM_260 : 399|1@1+ (1,0) [0|1] ""  ADAS
 SG_ DET_MTD_260 : 383|1@1+ (1,0) [0|1] ""  ADAS
 SG_ DET_BELOW_RAIN_THOLD_260 : 375|1@1+ (1,0) [0|1] ""  ADAS

BO_ 1217 RDR_DETECTION_261_264: 64 RDR08
 SG_ DET_RANGE_261 : 24|15@1+ (0.015625,0) [0|500] "m"  ADAS
 SG_ DET_RANGE_ERR_261 : 40|7@1+ (0.0075,0) [0|0.9525] "m"  ADAS
 SG_ DET_RANGE_VELOCITY_261 : 48|15@1+ (0.0078125,-128) [-128|127.9921875] "m/s"  ADAS
 SG_ DET_RANGE_VELOCITY_ERR_261 : 64|8@1+ (0.003,0) [0|0.765] "m/s"  ADAS
 SG_ DET_AZIMUTH_261 : 88|13@1+ (0.0004,-1.5708) [-1.5708|1.5708] "rad"  ADAS
 SG_ DET_AZIMUTH_ERR_261 : 105|7@1+ (0.00087267,0) [0|0.11082909] "rad"  ADAS
 SG_ DET_ELEVATION_261 : 72|8@1+ (0.00275,-0.34925) [-0.34925|0.34925] "rad"  ADAS
 SG_ DET_ELEVATION_ERR_261 : 80|6@1+ (0.00174533,0) [0|0.10995579] "rad"  ADAS
 SG_ DET_RCS_261 : 128|8@1+ (0.5,-64) [-64|63.5] "dBsm"  ADAS
 SG_ DET_BI_STATIC_FLAG_261 : 104|1@1+ (1,0) [0|1] ""  ADAS
 SG_ DET_SUPER_RES_TARGET_261 : 87|1@1+ (1,0) [0|1] ""  ADAS
 SG_ DET_SNR_261 : 120|8@1+ (0.35156,0) [0|89.6478] "dB"  ADAS
 SG_ DET_EXISTENCE_PROB_261 : 112|6@1+ (1.588,0) [0|100] "%"  ADAS
 SG_ DET_HVC_FLAG_261 : 86|1@1+ (1,0) [0|1] ""  ADAS
 SG_ DET_CONFD_AZIMUTH_261 : 118|2@1+ (1,0) [0|3] ""  ADAS
 SG_ DET_CONFD_ELEVATION_261 : 101|2@1+ (1,0) [0|3] ""  ADAS
 SG_ DET_PROB_1STAZHYPO_261 : 103|1@1+ (1,0) [0|1] ""  ADAS
 SG_ DET_IDM_261 : 63|1@1+ (1,0) [0|1] ""  ADAS
 SG_ DET_MTD_261 : 47|1@1+ (1,0) [0|1] ""  ADAS
 SG_ DET_BELOW_RAIN_THOLD_261 : 39|1@1+ (1,0) [0|1] ""  ADAS
 SG_ DET_RANGE_262 : 136|15@1+ (0.015625,0) [0|500] "m"  ADAS
 SG_ DET_RANGE_ERR_262 : 152|7@1+ (0.0075,0) [0|0.9525] "m"  ADAS
 SG_ DET_RANGE_VELOCITY_262 : 160|15@1+ (0.0078125,-128) [-128|127.9921875] "m/s"  ADAS
 SG_ DET_RANGE_VELOCITY_ERR_262 : 176|8@1+ (0.003,0) [0|0.765] "m/s"  ADAS
 SG_ DET_AZIMUTH_262 : 200|13@1+ (0.0004,-1.5708) [-1.5708|1.5708] "rad"  ADAS
 SG_ DET_AZIMUTH_ERR_262 : 217|7@1+ (0.00087267,0) [0|0.11082909] "rad"  ADAS
 SG_ DET_ELEVATION_262 : 184|8@1+ (0.00275,-0.34925) [-0.34925|0.34925] "rad"  ADAS
 SG_ DET_ELEVATION_ERR_262 : 192|6@1+ (0.00174533,0) [0|0.10995579] "rad"  ADAS
 SG_ DET_RCS_262 : 240|8@1+ (0.5,-64) [-64|63.5] "dBsm"  ADAS
 SG_ DET_BI_STATIC_FLAG_262 : 216|1@1+ (1,0) [0|1] ""  ADAS
 SG_ DET_SUPER_RES_TARGET_262 : 199|1@1+ (1,0) [0|1] ""  ADAS
 SG_ DET_SNR_262 : 232|8@1+ (0.35156,0) [0|89.6478] "dB"  ADAS
 SG_ DET_EXISTENCE_PROB_262 : 224|6@1+ (1.588,0) [0|100] "%"  ADAS
 SG_ DET_HVC_FLAG_262 : 198|1@1+ (1,0) [0|1] ""  ADAS
 SG_ DET_CONFD_AZIMUTH_262 : 230|2@1+ (1,0) [0|3] ""  ADAS
 SG_ DET_CONFD_ELEVATION_262 : 213|2@1+ (1,0) [0|3] ""  ADAS
 SG_ DET_PROB_1STAZHYPO_262 : 215|1@1+ (1,0) [0|1] ""  ADAS
 SG_ DET_IDM_262 : 175|1@1+ (1,0) [0|1] ""  ADAS
 SG_ DET_MTD_262 : 159|1@1+ (1,0) [0|1] ""  ADAS
 SG_ DET_BELOW_RAIN_THOLD_262 : 151|1@1+ (1,0) [0|1] ""  ADAS
 SG_ DET_RANGE_263 : 248|15@1+ (0.015625,0) [0|500] "m"  ADAS
 SG_ DET_RANGE_ERR_263 : 264|7@1+ (0.0075,0) [0|0.9525] "m"  ADAS
 SG_ DET_RANGE_VELOCITY_263 : 272|15@1+ (0.0078125,-128) [-128|127.9921875] "m/s"  ADAS
 SG_ DET_RANGE_VELOCITY_ERR_263 : 288|8@1+ (0.003,0) [0|0.765] "m/s"  ADAS
 SG_ DET_AZIMUTH_263 : 312|13@1+ (0.0004,-1.5708) [-1.5708|1.5708] "rad"  ADAS
 SG_ DET_AZIMUTH_ERR_263 : 329|7@1+ (0.00087267,0) [0|0.11082909] "rad"  ADAS
 SG_ DET_ELEVATION_263 : 296|8@1+ (0.00275,-0.34925) [-0.34925|0.34925] "rad"  ADAS
 SG_ DET_ELEVATION_ERR_263 : 304|6@1+ (0.00174533,0) [0|0.10995579] "rad"  ADAS
 SG_ DET_RCS_263 : 352|8@1+ (0.5,-64) [-64|63.5] "dBsm"  ADAS
 SG_ DET_BI_STATIC_FLAG_263 : 328|1@1+ (1,0) [0|1] ""  ADAS
 SG_ DET_SUPER_RES_TARGET_263 : 311|1@1+ (1,0) [0|1] ""  ADAS
 SG_ DET_SNR_263 : 344|8@1+ (0.35156,0) [0|89.6478] "dB"  ADAS
 SG_ DET_EXISTENCE_PROB_263 : 336|6@1+ (1.588,0) [0|100] "%"  ADAS
 SG_ DET_HVC_FLAG_263 : 310|1@1+ (1,0) [0|1] ""  ADAS
 SG_ DET_CONFD_AZIMUTH_263 : 342|2@1+ (1,0) [0|3] ""  ADAS
 SG_ DET_CONFD_ELEVATION_263 : 325|2@1+ (1,0) [0|3] ""  ADAS
 SG_ DET_PROB_1STAZHYPO_263 : 327|1@1+ (1,0) [0|1] ""  ADAS
 SG_ DET_IDM_263 : 287|1@1+ (1,0) [0|1] ""  ADAS
 SG_ DET_MTD_263 : 271|1@1+ (1,0) [0|1] ""  ADAS
 SG_ DET_BELOW_RAIN_THOLD_263 : 263|1@1+ (1,0) [0|1] ""  ADAS
 SG_ DET_RANGE_264 : 360|15@1+ (0.015625,0) [0|500] "m"  ADAS
 SG_ DET_RANGE_ERR_264 : 376|7@1+ (0.0075,0) [0|0.9525] "m"  ADAS
 SG_ DET_RANGE_VELOCITY_264 : 384|15@1+ (0.0078125,-128) [-128|127.9921875] "m/s"  ADAS
 SG_ DET_RANGE_VELOCITY_ERR_264 : 400|8@1+ (0.003,0) [0|0.765] "m/s"  ADAS
 SG_ DET_AZIMUTH_264 : 424|13@1+ (0.0004,-1.5708) [-1.5708|1.5708] "rad"  ADAS
 SG_ DET_AZIMUTH_ERR_264 : 441|7@1+ (0.00087267,0) [0|0.11082909] "rad"  ADAS
 SG_ DET_ELEVATION_264 : 408|8@1+ (0.00275,-0.34925) [-0.34925|0.34925] "rad"  ADAS
 SG_ DET_ELEVATION_ERR_264 : 416|6@1+ (0.00174533,0) [0|0.10995579] "rad"  ADAS
 SG_ DET_RCS_264 : 464|8@1+ (0.5,-64) [-64|63.5] "dBsm"  ADAS
 SG_ DET_BI_STATIC_FLAG_264 : 440|1@1+ (1,0) [0|1] ""  ADAS
 SG_ DET_SUPER_RES_TARGET_264 : 423|1@1+ (1,0) [0|1] ""  ADAS
 SG_ DET_SNR_264 : 456|8@1+ (0.35156,0) [0|89.6478] "dB"  ADAS
 SG_ DET_EXISTENCE_PROB_264 : 448|6@1+ (1.588,0) [0|100] "%"  ADAS
 SG_ DET_HVC_FLAG_264 : 422|1@1+ (1,0) [0|1] ""  ADAS
 SG_ DET_CONFD_AZIMUTH_264 : 454|2@1+ (1,0) [0|3] ""  ADAS
 SG_ DET_CONFD_ELEVATION_264 : 437|2@1+ (1,0) [0|3] ""  ADAS
 SG_ DET_MH_SCAN_INDEX_4LSB_261_264 : 476|4@1+ (1,0) [0|15] ""  ADAS
 SG_ DET_MH_CYCLE_COUNTER_261_264 : 16|8@1+ (1,0) [0|255] ""  ADAS
 SG_ DET_MH_CRC16_261_264 : 0|16@1+ (1,0) [0|65535] ""  ADAS
 SG_ DET_PROB_1STAZHYPO_264 : 439|1@1+ (1,0) [0|1] ""  ADAS
 SG_ DET_IDM_264 : 399|1@1+ (1,0) [0|1] ""  ADAS
 SG_ DET_MTD_264 : 383|1@1+ (1,0) [0|1] ""  ADAS
 SG_ DET_BELOW_RAIN_THOLD_264 : 375|1@1+ (1,0) [0|1] ""  ADAS

BO_ 1218 RDR_DETECTION_265_268: 64 RDR08
 SG_ DET_RANGE_265 : 24|15@1+ (0.015625,0) [0|500] "m"  ADAS
 SG_ DET_RANGE_ERR_265 : 40|7@1+ (0.0075,0) [0|0.9525] "m"  ADAS
 SG_ DET_RANGE_VELOCITY_265 : 48|15@1+ (0.0078125,-128) [-128|127.9921875] "m/s"  ADAS
 SG_ DET_RANGE_VELOCITY_ERR_265 : 64|8@1+ (0.003,0) [0|0.765] "m/s"  ADAS
 SG_ DET_AZIMUTH_265 : 88|13@1+ (0.0004,-1.5708) [-1.5708|1.5708] "rad"  ADAS
 SG_ DET_AZIMUTH_ERR_265 : 105|7@1+ (0.00087267,0) [0|0.11082909] "rad"  ADAS
 SG_ DET_ELEVATION_265 : 72|8@1+ (0.00275,-0.34925) [-0.34925|0.34925] "rad"  ADAS
 SG_ DET_ELEVATION_ERR_265 : 80|6@1+ (0.00174533,0) [0|0.10995579] "rad"  ADAS
 SG_ DET_RCS_265 : 128|8@1+ (0.5,-64) [-64|63.5] "dBsm"  ADAS
 SG_ DET_BI_STATIC_FLAG_265 : 104|1@1+ (1,0) [0|1] ""  ADAS
 SG_ DET_SUPER_RES_TARGET_265 : 87|1@1+ (1,0) [0|1] ""  ADAS
 SG_ DET_SNR_265 : 120|8@1+ (0.35156,0) [0|89.6478] "dB"  ADAS
 SG_ DET_EXISTENCE_PROB_265 : 112|6@1+ (1.588,0) [0|100] "%"  ADAS
 SG_ DET_HVC_FLAG_265 : 86|1@1+ (1,0) [0|1] ""  ADAS
 SG_ DET_CONFD_AZIMUTH_265 : 118|2@1+ (1,0) [0|3] ""  ADAS
 SG_ DET_CONFD_ELEVATION_265 : 101|2@1+ (1,0) [0|3] ""  ADAS
 SG_ DET_PROB_1STAZHYPO_265 : 103|1@1+ (1,0) [0|1] ""  ADAS
 SG_ DET_IDM_265 : 63|1@1+ (1,0) [0|1] ""  ADAS
 SG_ DET_MTD_265 : 47|1@1+ (1,0) [0|1] ""  ADAS
 SG_ DET_BELOW_RAIN_THOLD_265 : 39|1@1+ (1,0) [0|1] ""  ADAS
 SG_ DET_RANGE_266 : 136|15@1+ (0.015625,0) [0|500] "m"  ADAS
 SG_ DET_RANGE_ERR_266 : 152|7@1+ (0.0075,0) [0|0.9525] "m"  ADAS
 SG_ DET_RANGE_VELOCITY_266 : 160|15@1+ (0.0078125,-128) [-128|127.9921875] "m/s"  ADAS
 SG_ DET_RANGE_VELOCITY_ERR_266 : 176|8@1+ (0.003,0) [0|0.765] "m/s"  ADAS
 SG_ DET_AZIMUTH_266 : 200|13@1+ (0.0004,-1.5708) [-1.5708|1.5708] "rad"  ADAS
 SG_ DET_AZIMUTH_ERR_266 : 217|7@1+ (0.00087267,0) [0|0.11082909] "rad"  ADAS
 SG_ DET_ELEVATION_266 : 184|8@1+ (0.00275,-0.34925) [-0.34925|0.34925] "rad"  ADAS
 SG_ DET_ELEVATION_ERR_266 : 192|6@1+ (0.00174533,0) [0|0.10995579] "rad"  ADAS
 SG_ DET_RCS_266 : 240|8@1+ (0.5,-64) [-64|63.5] "dBsm"  ADAS
 SG_ DET_BI_STATIC_FLAG_266 : 216|1@1+ (1,0) [0|1] ""  ADAS
 SG_ DET_SUPER_RES_TARGET_266 : 199|1@1+ (1,0) [0|1] ""  ADAS
 SG_ DET_SNR_266 : 232|8@1+ (0.35156,0) [0|89.6478] "dB"  ADAS
 SG_ DET_EXISTENCE_PROB_266 : 224|6@1+ (1.588,0) [0|100] "%"  ADAS
 SG_ DET_HVC_FLAG_266 : 198|1@1+ (1,0) [0|1] ""  ADAS
 SG_ DET_CONFD_AZIMUTH_266 : 230|2@1+ (1,0) [0|3] ""  ADAS
 SG_ DET_CONFD_ELEVATION_266 : 213|2@1+ (1,0) [0|3] ""  ADAS
 SG_ DET_PROB_1STAZHYPO_266 : 215|1@1+ (1,0) [0|1] ""  ADAS
 SG_ DET_IDM_266 : 175|1@1+ (1,0) [0|1] ""  ADAS
 SG_ DET_MTD_266 : 159|1@1+ (1,0) [0|1] ""  ADAS
 SG_ DET_BELOW_RAIN_THOLD_266 : 151|1@1+ (1,0) [0|1] ""  ADAS
 SG_ DET_RANGE_267 : 248|15@1+ (0.015625,0) [0|500] "m"  ADAS
 SG_ DET_RANGE_ERR_267 : 264|7@1+ (0.0075,0) [0|0.9525] "m"  ADAS
 SG_ DET_RANGE_VELOCITY_267 : 272|15@1+ (0.0078125,-128) [-128|127.9921875] "m/s"  ADAS
 SG_ DET_RANGE_VELOCITY_ERR_267 : 288|8@1+ (0.003,0) [0|0.765] "m/s"  ADAS
 SG_ DET_AZIMUTH_267 : 312|13@1+ (0.0004,-1.5708) [-1.5708|1.5708] "rad"  ADAS
 SG_ DET_AZIMUTH_ERR_267 : 329|7@1+ (0.00087267,0) [0|0.11082909] "rad"  ADAS
 SG_ DET_ELEVATION_267 : 296|8@1+ (0.00275,-0.34925) [-0.34925|0.34925] "rad"  ADAS
 SG_ DET_ELEVATION_ERR_267 : 304|6@1+ (0.00174533,0) [0|0.10995579] "rad"  ADAS
 SG_ DET_RCS_267 : 352|8@1+ (0.5,-64) [-64|63.5] "dBsm"  ADAS
 SG_ DET_BI_STATIC_FLAG_267 : 328|1@1+ (1,0) [0|1] ""  ADAS
 SG_ DET_SUPER_RES_TARGET_267 : 311|1@1+ (1,0) [0|1] ""  ADAS
 SG_ DET_SNR_267 : 344|8@1+ (0.35156,0) [0|89.6478] "dB"  ADAS
 SG_ DET_EXISTENCE_PROB_267 : 336|6@1+ (1.588,0) [0|100] "%"  ADAS
 SG_ DET_HVC_FLAG_267 : 310|1@1+ (1,0) [0|1] ""  ADAS
 SG_ DET_CONFD_AZIMUTH_267 : 342|2@1+ (1,0) [0|3] ""  ADAS
 SG_ DET_CONFD_ELEVATION_267 : 325|2@1+ (1,0) [0|3] ""  ADAS
 SG_ DET_PROB_1STAZHYPO_267 : 327|1@1+ (1,0) [0|1] ""  ADAS
 SG_ DET_IDM_267 : 287|1@1+ (1,0) [0|1] ""  ADAS
 SG_ DET_MTD_267 : 271|1@1+ (1,0) [0|1] ""  ADAS
 SG_ DET_BELOW_RAIN_THOLD_267 : 263|1@1+ (1,0) [0|1] ""  ADAS
 SG_ DET_RANGE_268 : 360|15@1+ (0.015625,0) [0|500] "m"  ADAS
 SG_ DET_RANGE_ERR_268 : 376|7@1+ (0.0075,0) [0|0.9525] "m"  ADAS
 SG_ DET_RANGE_VELOCITY_268 : 384|15@1+ (0.0078125,-128) [-128|127.9921875] "m/s"  ADAS
 SG_ DET_RANGE_VELOCITY_ERR_268 : 400|8@1+ (0.003,0) [0|0.765] "m/s"  ADAS
 SG_ DET_AZIMUTH_268 : 424|13@1+ (0.0004,-1.5708) [-1.5708|1.5708] "rad"  ADAS
 SG_ DET_AZIMUTH_ERR_268 : 441|7@1+ (0.00087267,0) [0|0.11082909] "rad"  ADAS
 SG_ DET_ELEVATION_268 : 408|8@1+ (0.00275,-0.34925) [-0.34925|0.34925] "rad"  ADAS
 SG_ DET_ELEVATION_ERR_268 : 416|6@1+ (0.00174533,0) [0|0.10995579] "rad"  ADAS
 SG_ DET_RCS_268 : 464|8@1+ (0.5,-64) [-64|63.5] "dBsm"  ADAS
 SG_ DET_BI_STATIC_FLAG_268 : 440|1@1+ (1,0) [0|1] ""  ADAS
 SG_ DET_SUPER_RES_TARGET_268 : 423|1@1+ (1,0) [0|1] ""  ADAS
 SG_ DET_SNR_268 : 456|8@1+ (0.35156,0) [0|89.6478] "dB"  ADAS
 SG_ DET_EXISTENCE_PROB_268 : 448|6@1+ (1.588,0) [0|100] "%"  ADAS
 SG_ DET_HVC_FLAG_268 : 422|1@1+ (1,0) [0|1] ""  ADAS
 SG_ DET_CONFD_AZIMUTH_268 : 454|2@1+ (1,0) [0|3] ""  ADAS
 SG_ DET_CONFD_ELEVATION_268 : 437|2@1+ (1,0) [0|3] ""  ADAS
 SG_ DET_MH_SCAN_INDEX_4LSB_265_268 : 476|4@1+ (1,0) [0|15] ""  ADAS
 SG_ DET_MH_CYCLE_COUNTER_265_268 : 16|8@1+ (1,0) [0|255] ""  ADAS
 SG_ DET_MH_CRC16_265_268 : 0|16@1+ (1,0) [0|65535] ""  ADAS
 SG_ DET_PROB_1STAZHYPO_268 : 439|1@1+ (1,0) [0|1] ""  ADAS
 SG_ DET_IDM_268 : 399|1@1+ (1,0) [0|1] ""  ADAS
 SG_ DET_MTD_268 : 383|1@1+ (1,0) [0|1] ""  ADAS
 SG_ DET_BELOW_RAIN_THOLD_268 : 375|1@1+ (1,0) [0|1] ""  ADAS

BO_ 1219 RDR_DETECTION_269_272: 64 RDR08
 SG_ DET_RANGE_269 : 24|15@1+ (0.015625,0) [0|500] "m"  ADAS
 SG_ DET_RANGE_ERR_269 : 40|7@1+ (0.0075,0) [0|0.9525] "m"  ADAS
 SG_ DET_RANGE_VELOCITY_269 : 48|15@1+ (0.0078125,-128) [-128|127.9921875] "m/s"  ADAS
 SG_ DET_RANGE_VELOCITY_ERR_269 : 64|8@1+ (0.003,0) [0|0.765] "m/s"  ADAS
 SG_ DET_AZIMUTH_269 : 88|13@1+ (0.0004,-1.5708) [-1.5708|1.5708] "rad"  ADAS
 SG_ DET_AZIMUTH_ERR_269 : 105|7@1+ (0.00087267,0) [0|0.11082909] "rad"  ADAS
 SG_ DET_ELEVATION_269 : 72|8@1+ (0.00275,-0.34925) [-0.34925|0.34925] "rad"  ADAS
 SG_ DET_ELEVATION_ERR_269 : 80|6@1+ (0.00174533,0) [0|0.10995579] "rad"  ADAS
 SG_ DET_RCS_269 : 128|8@1+ (0.5,-64) [-64|63.5] "dBsm"  ADAS
 SG_ DET_BI_STATIC_FLAG_269 : 104|1@1+ (1,0) [0|1] ""  ADAS
 SG_ DET_SUPER_RES_TARGET_269 : 87|1@1+ (1,0) [0|1] ""  ADAS
 SG_ DET_SNR_269 : 120|8@1+ (0.35156,0) [0|89.6478] "dB"  ADAS
 SG_ DET_EXISTENCE_PROB_269 : 112|6@1+ (1.588,0) [0|100] "%"  ADAS
 SG_ DET_HVC_FLAG_269 : 86|1@1+ (1,0) [0|1] ""  ADAS
 SG_ DET_CONFD_AZIMUTH_269 : 118|2@1+ (1,0) [0|3] ""  ADAS
 SG_ DET_CONFD_ELEVATION_269 : 101|2@1+ (1,0) [0|3] ""  ADAS
 SG_ DET_PROB_1STAZHYPO_269 : 103|1@1+ (1,0) [0|1] ""  ADAS
 SG_ DET_IDM_269 : 63|1@1+ (1,0) [0|1] ""  ADAS
 SG_ DET_MTD_269 : 47|1@1+ (1,0) [0|1] ""  ADAS
 SG_ DET_BELOW_RAIN_THOLD_269 : 39|1@1+ (1,0) [0|1] ""  ADAS
 SG_ DET_RANGE_270 : 136|15@1+ (0.015625,0) [0|500] "m"  ADAS
 SG_ DET_RANGE_ERR_270 : 152|7@1+ (0.0075,0) [0|0.9525] "m"  ADAS
 SG_ DET_RANGE_VELOCITY_270 : 160|15@1+ (0.0078125,-128) [-128|127.9921875] "m/s"  ADAS
 SG_ DET_RANGE_VELOCITY_ERR_270 : 176|8@1+ (0.003,0) [0|0.765] "m/s"  ADAS
 SG_ DET_AZIMUTH_270 : 200|13@1+ (0.0004,-1.5708) [-1.5708|1.5708] "rad"  ADAS
 SG_ DET_AZIMUTH_ERR_270 : 217|7@1+ (0.00087267,0) [0|0.11082909] "rad"  ADAS
 SG_ DET_ELEVATION_270 : 184|8@1+ (0.00275,-0.34925) [-0.34925|0.34925] "rad"  ADAS
 SG_ DET_ELEVATION_ERR_270 : 192|6@1+ (0.00174533,0) [0|0.10995579] "rad"  ADAS
 SG_ DET_RCS_270 : 240|8@1+ (0.5,-64) [-64|63.5] "dBsm"  ADAS
 SG_ DET_BI_STATIC_FLAG_270 : 216|1@1+ (1,0) [0|1] ""  ADAS
 SG_ DET_SUPER_RES_TARGET_270 : 199|1@1+ (1,0) [0|1] ""  ADAS
 SG_ DET_SNR_270 : 232|8@1+ (0.35156,0) [0|89.6478] "dB"  ADAS
 SG_ DET_EXISTENCE_PROB_270 : 224|6@1+ (1.588,0) [0|100] "%"  ADAS
 SG_ DET_HVC_FLAG_270 : 198|1@1+ (1,0) [0|1] ""  ADAS
 SG_ DET_CONFD_AZIMUTH_270 : 230|2@1+ (1,0) [0|3] ""  ADAS
 SG_ DET_CONFD_ELEVATION_270 : 213|2@1+ (1,0) [0|3] ""  ADAS
 SG_ DET_PROB_1STAZHYPO_270 : 215|1@1+ (1,0) [0|1] ""  ADAS
 SG_ DET_IDM_270 : 175|1@1+ (1,0) [0|1] ""  ADAS
 SG_ DET_MTD_270 : 159|1@1+ (1,0) [0|1] ""  ADAS
 SG_ DET_BELOW_RAIN_THOLD_270 : 151|1@1+ (1,0) [0|1] ""  ADAS
 SG_ DET_RANGE_271 : 248|15@1+ (0.015625,0) [0|500] "m"  ADAS
 SG_ DET_RANGE_ERR_271 : 264|7@1+ (0.0075,0) [0|0.9525] "m"  ADAS
 SG_ DET_RANGE_VELOCITY_271 : 272|15@1+ (0.0078125,-128) [-128|127.9921875] "m/s"  ADAS
 SG_ DET_RANGE_VELOCITY_ERR_271 : 288|8@1+ (0.003,0) [0|0.765] "m/s"  ADAS
 SG_ DET_AZIMUTH_271 : 312|13@1+ (0.0004,-1.5708) [-1.5708|1.5708] "rad"  ADAS
 SG_ DET_AZIMUTH_ERR_271 : 329|7@1+ (0.00087267,0) [0|0.11082909] "rad"  ADAS
 SG_ DET_ELEVATION_271 : 296|8@1+ (0.00275,-0.34925) [-0.34925|0.34925] "rad"  ADAS
 SG_ DET_ELEVATION_ERR_271 : 304|6@1+ (0.00174533,0) [0|0.10995579] "rad"  ADAS
 SG_ DET_RCS_271 : 352|8@1+ (0.5,-64) [-64|63.5] "dBsm"  ADAS
 SG_ DET_BI_STATIC_FLAG_271 : 328|1@1+ (1,0) [0|1] ""  ADAS
 SG_ DET_SUPER_RES_TARGET_271 : 311|1@1+ (1,0) [0|1] ""  ADAS
 SG_ DET_SNR_271 : 344|8@1+ (0.35156,0) [0|89.6478] "dB"  ADAS
 SG_ DET_EXISTENCE_PROB_271 : 336|6@1+ (1.588,0) [0|100] "%"  ADAS
 SG_ DET_HVC_FLAG_271 : 310|1@1+ (1,0) [0|1] ""  ADAS
 SG_ DET_CONFD_AZIMUTH_271 : 342|2@1+ (1,0) [0|3] ""  ADAS
 SG_ DET_CONFD_ELEVATION_271 : 325|2@1+ (1,0) [0|3] ""  ADAS
 SG_ DET_PROB_1STAZHYPO_271 : 327|1@1+ (1,0) [0|1] ""  ADAS
 SG_ DET_IDM_271 : 287|1@1+ (1,0) [0|1] ""  ADAS
 SG_ DET_MTD_271 : 271|1@1+ (1,0) [0|1] ""  ADAS
 SG_ DET_BELOW_RAIN_THOLD_271 : 263|1@1+ (1,0) [0|1] ""  ADAS
 SG_ DET_RANGE_272 : 360|15@1+ (0.015625,0) [0|500] "m"  ADAS
 SG_ DET_RANGE_ERR_272 : 376|7@1+ (0.0075,0) [0|0.9525] "m"  ADAS
 SG_ DET_RANGE_VELOCITY_272 : 384|15@1+ (0.0078125,-128) [-128|127.9921875] "m/s"  ADAS
 SG_ DET_RANGE_VELOCITY_ERR_272 : 400|8@1+ (0.003,0) [0|0.765] "m/s"  ADAS
 SG_ DET_AZIMUTH_272 : 424|13@1+ (0.0004,-1.5708) [-1.5708|1.5708] "rad"  ADAS
 SG_ DET_AZIMUTH_ERR_272 : 441|7@1+ (0.00087267,0) [0|0.11082909] "rad"  ADAS
 SG_ DET_ELEVATION_272 : 408|8@1+ (0.00275,-0.34925) [-0.34925|0.34925] "rad"  ADAS
 SG_ DET_ELEVATION_ERR_272 : 416|6@1+ (0.00174533,0) [0|0.10995579] "rad"  ADAS
 SG_ DET_RCS_272 : 464|8@1+ (0.5,-64) [-64|63.5] "dBsm"  ADAS
 SG_ DET_BI_STATIC_FLAG_272 : 440|1@1+ (1,0) [0|1] ""  ADAS
 SG_ DET_SUPER_RES_TARGET_272 : 423|1@1+ (1,0) [0|1] ""  ADAS
 SG_ DET_SNR_272 : 456|8@1+ (0.35156,0) [0|89.6478] "dB"  ADAS
 SG_ DET_EXISTENCE_PROB_272 : 448|6@1+ (1.588,0) [0|100] "%"  ADAS
 SG_ DET_HVC_FLAG_272 : 422|1@1+ (1,0) [0|1] ""  ADAS
 SG_ DET_CONFD_AZIMUTH_272 : 454|2@1+ (1,0) [0|3] ""  ADAS
 SG_ DET_CONFD_ELEVATION_272 : 437|2@1+ (1,0) [0|3] ""  ADAS
 SG_ DET_MH_SCAN_INDEX_4LSB_269_272 : 476|4@1+ (1,0) [0|15] ""  ADAS
 SG_ DET_MH_CYCLE_COUNTER_269_272 : 16|8@1+ (1,0) [0|255] ""  ADAS
 SG_ DET_MH_CRC16_269_272 : 0|16@1+ (1,0) [0|65535] ""  ADAS
 SG_ DET_PROB_1STAZHYPO_272 : 439|1@1+ (1,0) [0|1] ""  ADAS
 SG_ DET_IDM_272 : 399|1@1+ (1,0) [0|1] ""  ADAS
 SG_ DET_MTD_272 : 383|1@1+ (1,0) [0|1] ""  ADAS
 SG_ DET_BELOW_RAIN_THOLD_272 : 375|1@1+ (1,0) [0|1] ""  ADAS

BO_ 1220 RDR_DETECTION_273_276: 64 RDR08
 SG_ DET_RANGE_273 : 24|15@1+ (0.015625,0) [0|500] "m"  ADAS
 SG_ DET_RANGE_ERR_273 : 40|7@1+ (0.0075,0) [0|0.9525] "m"  ADAS
 SG_ DET_RANGE_VELOCITY_273 : 48|15@1+ (0.0078125,-128) [-128|127.9921875] "m/s"  ADAS
 SG_ DET_RANGE_VELOCITY_ERR_273 : 64|8@1+ (0.003,0) [0|0.765] "m/s"  ADAS
 SG_ DET_AZIMUTH_273 : 88|13@1+ (0.0004,-1.5708) [-1.5708|1.5708] "rad"  ADAS
 SG_ DET_AZIMUTH_ERR_273 : 105|7@1+ (0.00087267,0) [0|0.11082909] "rad"  ADAS
 SG_ DET_ELEVATION_273 : 72|8@1+ (0.00275,-0.34925) [-0.34925|0.34925] "rad"  ADAS
 SG_ DET_ELEVATION_ERR_273 : 80|6@1+ (0.00174533,0) [0|0.10995579] "rad"  ADAS
 SG_ DET_RCS_273 : 128|8@1+ (0.5,-64) [-64|63.5] "dBsm"  ADAS
 SG_ DET_BI_STATIC_FLAG_273 : 104|1@1+ (1,0) [0|1] ""  ADAS
 SG_ DET_SUPER_RES_TARGET_273 : 87|1@1+ (1,0) [0|1] ""  ADAS
 SG_ DET_SNR_273 : 120|8@1+ (0.35156,0) [0|89.6478] "dB"  ADAS
 SG_ DET_EXISTENCE_PROB_273 : 112|6@1+ (1.588,0) [0|100] "%"  ADAS
 SG_ DET_HVC_FLAG_273 : 86|1@1+ (1,0) [0|1] ""  ADAS
 SG_ DET_CONFD_AZIMUTH_273 : 118|2@1+ (1,0) [0|3] ""  ADAS
 SG_ DET_CONFD_ELEVATION_273 : 101|2@1+ (1,0) [0|3] ""  ADAS
 SG_ DET_PROB_1STAZHYPO_273 : 103|1@1+ (1,0) [0|1] ""  ADAS
 SG_ DET_IDM_273 : 63|1@1+ (1,0) [0|1] ""  ADAS
 SG_ DET_MTD_273 : 47|1@1+ (1,0) [0|1] ""  ADAS
 SG_ DET_BELOW_RAIN_THOLD_273 : 39|1@1+ (1,0) [0|1] ""  ADAS
 SG_ DET_RANGE_274 : 136|15@1+ (0.015625,0) [0|500] "m"  ADAS
 SG_ DET_RANGE_ERR_274 : 152|7@1+ (0.0075,0) [0|0.9525] "m"  ADAS
 SG_ DET_RANGE_VELOCITY_274 : 160|15@1+ (0.0078125,-128) [-128|127.9921875] "m/s"  ADAS
 SG_ DET_RANGE_VELOCITY_ERR_274 : 176|8@1+ (0.003,0) [0|0.765] "m/s"  ADAS
 SG_ DET_AZIMUTH_274 : 200|13@1+ (0.0004,-1.5708) [-1.5708|1.5708] "rad"  ADAS
 SG_ DET_AZIMUTH_ERR_274 : 217|7@1+ (0.00087267,0) [0|0.11082909] "rad"  ADAS
 SG_ DET_ELEVATION_274 : 184|8@1+ (0.00275,-0.34925) [-0.34925|0.34925] "rad"  ADAS
 SG_ DET_ELEVATION_ERR_274 : 192|6@1+ (0.00174533,0) [0|0.10995579] "rad"  ADAS
 SG_ DET_RCS_274 : 240|8@1+ (0.5,-64) [-64|63.5] "dBsm"  ADAS
 SG_ DET_BI_STATIC_FLAG_274 : 216|1@1+ (1,0) [0|1] ""  ADAS
 SG_ DET_SUPER_RES_TARGET_274 : 199|1@1+ (1,0) [0|1] ""  ADAS
 SG_ DET_SNR_274 : 232|8@1+ (0.35156,0) [0|89.6478] "dB"  ADAS
 SG_ DET_EXISTENCE_PROB_274 : 224|6@1+ (1.588,0) [0|100] "%"  ADAS
 SG_ DET_HVC_FLAG_274 : 198|1@1+ (1,0) [0|1] ""  ADAS
 SG_ DET_CONFD_AZIMUTH_274 : 230|2@1+ (1,0) [0|3] ""  ADAS
 SG_ DET_CONFD_ELEVATION_274 : 213|2@1+ (1,0) [0|3] ""  ADAS
 SG_ DET_PROB_1STAZHYPO_274 : 215|1@1+ (1,0) [0|1] ""  ADAS
 SG_ DET_IDM_274 : 175|1@1+ (1,0) [0|1] ""  ADAS
 SG_ DET_MTD_274 : 159|1@1+ (1,0) [0|1] ""  ADAS
 SG_ DET_BELOW_RAIN_THOLD_274 : 151|1@1+ (1,0) [0|1] ""  ADAS
 SG_ DET_RANGE_275 : 248|15@1+ (0.015625,0) [0|500] "m"  ADAS
 SG_ DET_RANGE_ERR_275 : 264|7@1+ (0.0075,0) [0|0.9525] "m"  ADAS
 SG_ DET_RANGE_VELOCITY_275 : 272|15@1+ (0.0078125,-128) [-128|127.9921875] "m/s"  ADAS
 SG_ DET_RANGE_VELOCITY_ERR_275 : 288|8@1+ (0.003,0) [0|0.765] "m/s"  ADAS
 SG_ DET_AZIMUTH_275 : 312|13@1+ (0.0004,-1.5708) [-1.5708|1.5708] "rad"  ADAS
 SG_ DET_AZIMUTH_ERR_275 : 329|7@1+ (0.00087267,0) [0|0.11082909] "rad"  ADAS
 SG_ DET_ELEVATION_275 : 296|8@1+ (0.00275,-0.34925) [-0.34925|0.34925] "rad"  ADAS
 SG_ DET_ELEVATION_ERR_275 : 304|6@1+ (0.00174533,0) [0|0.10995579] "rad"  ADAS
 SG_ DET_RCS_275 : 352|8@1+ (0.5,-64) [-64|63.5] "dBsm"  ADAS
 SG_ DET_BI_STATIC_FLAG_275 : 328|1@1+ (1,0) [0|1] ""  ADAS
 SG_ DET_SUPER_RES_TARGET_275 : 311|1@1+ (1,0) [0|1] ""  ADAS
 SG_ DET_SNR_275 : 344|8@1+ (0.35156,0) [0|89.6478] "dB"  ADAS
 SG_ DET_EXISTENCE_PROB_275 : 336|6@1+ (1.588,0) [0|100] "%"  ADAS
 SG_ DET_HVC_FLAG_275 : 310|1@1+ (1,0) [0|1] ""  ADAS
 SG_ DET_CONFD_AZIMUTH_275 : 342|2@1+ (1,0) [0|3] ""  ADAS
 SG_ DET_CONFD_ELEVATION_275 : 325|2@1+ (1,0) [0|3] ""  ADAS
 SG_ DET_PROB_1STAZHYPO_275 : 327|1@1+ (1,0) [0|1] ""  ADAS
 SG_ DET_IDM_275 : 287|1@1+ (1,0) [0|1] ""  ADAS
 SG_ DET_MTD_275 : 271|1@1+ (1,0) [0|1] ""  ADAS
 SG_ DET_BELOW_RAIN_THOLD_275 : 263|1@1+ (1,0) [0|1] ""  ADAS
 SG_ DET_RANGE_276 : 360|15@1+ (0.015625,0) [0|500] "m"  ADAS
 SG_ DET_RANGE_ERR_276 : 376|7@1+ (0.0075,0) [0|0.9525] "m"  ADAS
 SG_ DET_RANGE_VELOCITY_276 : 384|15@1+ (0.0078125,-128) [-128|127.9921875] "m/s"  ADAS
 SG_ DET_RANGE_VELOCITY_ERR_276 : 400|8@1+ (0.003,0) [0|0.765] "m/s"  ADAS
 SG_ DET_AZIMUTH_276 : 424|13@1+ (0.0004,-1.5708) [-1.5708|1.5708] "rad"  ADAS
 SG_ DET_AZIMUTH_ERR_276 : 441|7@1+ (0.00087267,0) [0|0.11082909] "rad"  ADAS
 SG_ DET_ELEVATION_276 : 408|8@1+ (0.00275,-0.34925) [-0.34925|0.34925] "rad"  ADAS
 SG_ DET_ELEVATION_ERR_276 : 416|6@1+ (0.00174533,0) [0|0.10995579] "rad"  ADAS
 SG_ DET_RCS_276 : 464|8@1+ (0.5,-64) [-64|63.5] "dBsm"  ADAS
 SG_ DET_BI_STATIC_FLAG_276 : 440|1@1+ (1,0) [0|1] ""  ADAS
 SG_ DET_SUPER_RES_TARGET_276 : 423|1@1+ (1,0) [0|1] ""  ADAS
 SG_ DET_SNR_276 : 456|8@1+ (0.35156,0) [0|89.6478] "dB"  ADAS
 SG_ DET_EXISTENCE_PROB_276 : 448|6@1+ (1.588,0) [0|100] "%"  ADAS
 SG_ DET_HVC_FLAG_276 : 422|1@1+ (1,0) [0|1] ""  ADAS
 SG_ DET_CONFD_AZIMUTH_276 : 454|2@1+ (1,0) [0|3] ""  ADAS
 SG_ DET_CONFD_ELEVATION_276 : 437|2@1+ (1,0) [0|3] ""  ADAS
 SG_ DET_MH_SCAN_INDEX_4LSB_273_276 : 476|4@1+ (1,0) [0|15] ""  ADAS
 SG_ DET_MH_CYCLE_COUNTER_273_276 : 16|8@1+ (1,0) [0|255] ""  ADAS
 SG_ DET_MH_CRC16_273_276 : 0|16@1+ (1,0) [0|65535] ""  ADAS
 SG_ DET_PROB_1STAZHYPO_276 : 439|1@1+ (1,0) [0|1] ""  ADAS
 SG_ DET_IDM_276 : 399|1@1+ (1,0) [0|1] ""  ADAS
 SG_ DET_MTD_276 : 383|1@1+ (1,0) [0|1] ""  ADAS
 SG_ DET_BELOW_RAIN_THOLD_276 : 375|1@1+ (1,0) [0|1] ""  ADAS

BO_ 1221 RDR_DETECTION_277_280: 64 RDR08
 SG_ DET_RANGE_277 : 24|15@1+ (0.015625,0) [0|500] "m"  ADAS
 SG_ DET_RANGE_ERR_277 : 40|7@1+ (0.0075,0) [0|0.9525] "m"  ADAS
 SG_ DET_RANGE_VELOCITY_277 : 48|15@1+ (0.0078125,-128) [-128|127.9921875] "m/s"  ADAS
 SG_ DET_RANGE_VELOCITY_ERR_277 : 64|8@1+ (0.003,0) [0|0.765] "m/s"  ADAS
 SG_ DET_AZIMUTH_277 : 88|13@1+ (0.0004,-1.5708) [-1.5708|1.5708] "rad"  ADAS
 SG_ DET_AZIMUTH_ERR_277 : 105|7@1+ (0.00087267,0) [0|0.11082909] "rad"  ADAS
 SG_ DET_ELEVATION_277 : 72|8@1+ (0.00275,-0.34925) [-0.34925|0.34925] "rad"  ADAS
 SG_ DET_ELEVATION_ERR_277 : 80|6@1+ (0.00174533,0) [0|0.10995579] "rad"  ADAS
 SG_ DET_RCS_277 : 128|8@1+ (0.5,-64) [-64|63.5] "dBsm"  ADAS
 SG_ DET_BI_STATIC_FLAG_277 : 104|1@1+ (1,0) [0|1] ""  ADAS
 SG_ DET_SUPER_RES_TARGET_277 : 87|1@1+ (1,0) [0|1] ""  ADAS
 SG_ DET_SNR_277 : 120|8@1+ (0.35156,0) [0|89.6478] "dB"  ADAS
 SG_ DET_EXISTENCE_PROB_277 : 112|6@1+ (1.588,0) [0|100] "%"  ADAS
 SG_ DET_HVC_FLAG_277 : 86|1@1+ (1,0) [0|1] ""  ADAS
 SG_ DET_CONFD_AZIMUTH_277 : 118|2@1+ (1,0) [0|3] ""  ADAS
 SG_ DET_CONFD_ELEVATION_277 : 101|2@1+ (1,0) [0|3] ""  ADAS
 SG_ DET_PROB_1STAZHYPO_277 : 103|1@1+ (1,0) [0|1] ""  ADAS
 SG_ DET_IDM_277 : 63|1@1+ (1,0) [0|1] ""  ADAS
 SG_ DET_MTD_277 : 47|1@1+ (1,0) [0|1] ""  ADAS
 SG_ DET_BELOW_RAIN_THOLD_277 : 39|1@1+ (1,0) [0|1] ""  ADAS
 SG_ DET_RANGE_278 : 136|15@1+ (0.015625,0) [0|500] "m"  ADAS
 SG_ DET_RANGE_ERR_278 : 152|7@1+ (0.0075,0) [0|0.9525] "m"  ADAS
 SG_ DET_RANGE_VELOCITY_278 : 160|15@1+ (0.0078125,-128) [-128|127.9921875] "m/s"  ADAS
 SG_ DET_RANGE_VELOCITY_ERR_278 : 176|8@1+ (0.003,0) [0|0.765] "m/s"  ADAS
 SG_ DET_AZIMUTH_278 : 200|13@1+ (0.0004,-1.5708) [-1.5708|1.5708] "rad"  ADAS
 SG_ DET_AZIMUTH_ERR_278 : 217|7@1+ (0.00087267,0) [0|0.11082909] "rad"  ADAS
 SG_ DET_ELEVATION_278 : 184|8@1+ (0.00275,-0.34925) [-0.34925|0.34925] "rad"  ADAS
 SG_ DET_ELEVATION_ERR_278 : 192|6@1+ (0.00174533,0) [0|0.10995579] "rad"  ADAS
 SG_ DET_RCS_278 : 240|8@1+ (0.5,-64) [-64|63.5] "dBsm"  ADAS
 SG_ DET_BI_STATIC_FLAG_278 : 216|1@1+ (1,0) [0|1] ""  ADAS
 SG_ DET_SUPER_RES_TARGET_278 : 199|1@1+ (1,0) [0|1] ""  ADAS
 SG_ DET_SNR_278 : 232|8@1+ (0.35156,0) [0|89.6478] "dB"  ADAS
 SG_ DET_EXISTENCE_PROB_278 : 224|6@1+ (1.588,0) [0|100] "%"  ADAS
 SG_ DET_HVC_FLAG_278 : 198|1@1+ (1,0) [0|1] ""  ADAS
 SG_ DET_CONFD_AZIMUTH_278 : 230|2@1+ (1,0) [0|3] ""  ADAS
 SG_ DET_CONFD_ELEVATION_278 : 213|2@1+ (1,0) [0|3] ""  ADAS
 SG_ DET_PROB_1STAZHYPO_278 : 215|1@1+ (1,0) [0|1] ""  ADAS
 SG_ DET_IDM_278 : 175|1@1+ (1,0) [0|1] ""  ADAS
 SG_ DET_MTD_278 : 159|1@1+ (1,0) [0|1] ""  ADAS
 SG_ DET_BELOW_RAIN_THOLD_278 : 151|1@1+ (1,0) [0|1] ""  ADAS
 SG_ DET_RANGE_279 : 248|15@1+ (0.015625,0) [0|500] "m"  ADAS
 SG_ DET_RANGE_ERR_279 : 264|7@1+ (0.0075,0) [0|0.9525] "m"  ADAS
 SG_ DET_RANGE_VELOCITY_279 : 272|15@1+ (0.0078125,-128) [-128|127.9921875] "m/s"  ADAS
 SG_ DET_RANGE_VELOCITY_ERR_279 : 288|8@1+ (0.003,0) [0|0.765] "m/s"  ADAS
 SG_ DET_AZIMUTH_279 : 312|13@1+ (0.0004,-1.5708) [-1.5708|1.5708] "rad"  ADAS
 SG_ DET_AZIMUTH_ERR_279 : 329|7@1+ (0.00087267,0) [0|0.11082909] "rad"  ADAS
 SG_ DET_ELEVATION_279 : 296|8@1+ (0.00275,-0.34925) [-0.34925|0.34925] "rad"  ADAS
 SG_ DET_ELEVATION_ERR_279 : 304|6@1+ (0.00174533,0) [0|0.10995579] "rad"  ADAS
 SG_ DET_RCS_279 : 352|8@1+ (0.5,-64) [-64|63.5] "dBsm"  ADAS
 SG_ DET_BI_STATIC_FLAG_279 : 328|1@1+ (1,0) [0|1] ""  ADAS
 SG_ DET_SUPER_RES_TARGET_279 : 311|1@1+ (1,0) [0|1] ""  ADAS
 SG_ DET_SNR_279 : 344|8@1+ (0.35156,0) [0|89.6478] "dB"  ADAS
 SG_ DET_EXISTENCE_PROB_279 : 336|6@1+ (1.588,0) [0|100] "%"  ADAS
 SG_ DET_HVC_FLAG_279 : 310|1@1+ (1,0) [0|1] ""  ADAS
 SG_ DET_CONFD_AZIMUTH_279 : 342|2@1+ (1,0) [0|3] ""  ADAS
 SG_ DET_CONFD_ELEVATION_279 : 325|2@1+ (1,0) [0|3] ""  ADAS
 SG_ DET_PROB_1STAZHYPO_279 : 327|1@1+ (1,0) [0|1] ""  ADAS
 SG_ DET_IDM_279 : 287|1@1+ (1,0) [0|1] ""  ADAS
 SG_ DET_MTD_279 : 271|1@1+ (1,0) [0|1] ""  ADAS
 SG_ DET_BELOW_RAIN_THOLD_279 : 263|1@1+ (1,0) [0|1] ""  ADAS
 SG_ DET_RANGE_280 : 360|15@1+ (0.015625,0) [0|500] "m"  ADAS
 SG_ DET_RANGE_ERR_280 : 376|7@1+ (0.0075,0) [0|0.9525] "m"  ADAS
 SG_ DET_RANGE_VELOCITY_280 : 384|15@1+ (0.0078125,-128) [-128|127.9921875] "m/s"  ADAS
 SG_ DET_RANGE_VELOCITY_ERR_280 : 400|8@1+ (0.003,0) [0|0.765] "m/s"  ADAS
 SG_ DET_AZIMUTH_280 : 424|13@1+ (0.0004,-1.5708) [-1.5708|1.5708] "rad"  ADAS
 SG_ DET_AZIMUTH_ERR_280 : 441|7@1+ (0.00087267,0) [0|0.11082909] "rad"  ADAS
 SG_ DET_ELEVATION_280 : 408|8@1+ (0.00275,-0.34925) [-0.34925|0.34925] "rad"  ADAS
 SG_ DET_ELEVATION_ERR_280 : 416|6@1+ (0.00174533,0) [0|0.10995579] "rad"  ADAS
 SG_ DET_RCS_280 : 464|8@1+ (0.5,-64) [-64|63.5] "dBsm"  ADAS
 SG_ DET_BI_STATIC_FLAG_280 : 440|1@1+ (1,0) [0|1] ""  ADAS
 SG_ DET_SUPER_RES_TARGET_280 : 423|1@1+ (1,0) [0|1] ""  ADAS
 SG_ DET_SNR_280 : 456|8@1+ (0.35156,0) [0|89.6478] "dB"  ADAS
 SG_ DET_EXISTENCE_PROB_280 : 448|6@1+ (1.588,0) [0|100] "%"  ADAS
 SG_ DET_HVC_FLAG_280 : 422|1@1+ (1,0) [0|1] ""  ADAS
 SG_ DET_CONFD_AZIMUTH_280 : 454|2@1+ (1,0) [0|3] ""  ADAS
 SG_ DET_CONFD_ELEVATION_280 : 437|2@1+ (1,0) [0|3] ""  ADAS
 SG_ DET_MH_SCAN_INDEX_4LSB_277_280 : 476|4@1+ (1,0) [0|15] ""  ADAS
 SG_ DET_MH_CYCLE_COUNTER_277_280 : 16|8@1+ (1,0) [0|255] ""  ADAS
 SG_ DET_MH_CRC16_277_280 : 0|16@1+ (1,0) [0|65535] ""  ADAS
 SG_ DET_PROB_1STAZHYPO_280 : 439|1@1+ (1,0) [0|1] ""  ADAS
 SG_ DET_IDM_280 : 399|1@1+ (1,0) [0|1] ""  ADAS
 SG_ DET_MTD_280 : 383|1@1+ (1,0) [0|1] ""  ADAS
 SG_ DET_BELOW_RAIN_THOLD_280 : 375|1@1+ (1,0) [0|1] ""  ADAS

BO_ 1222 RDR_DETECTION_281_284: 64 RDR08
 SG_ DET_RANGE_281 : 24|15@1+ (0.015625,0) [0|500] "m"  ADAS
 SG_ DET_RANGE_ERR_281 : 40|7@1+ (0.0075,0) [0|0.9525] "m"  ADAS
 SG_ DET_RANGE_VELOCITY_281 : 48|15@1+ (0.0078125,-128) [-128|127.9921875] "m/s"  ADAS
 SG_ DET_RANGE_VELOCITY_ERR_281 : 64|8@1+ (0.003,0) [0|0.765] "m/s"  ADAS
 SG_ DET_AZIMUTH_281 : 88|13@1+ (0.0004,-1.5708) [-1.5708|1.5708] "rad"  ADAS
 SG_ DET_AZIMUTH_ERR_281 : 105|7@1+ (0.00087267,0) [0|0.11082909] "rad"  ADAS
 SG_ DET_ELEVATION_281 : 72|8@1+ (0.00275,-0.34925) [-0.34925|0.34925] "rad"  ADAS
 SG_ DET_ELEVATION_ERR_281 : 80|6@1+ (0.00174533,0) [0|0.10995579] "rad"  ADAS
 SG_ DET_RCS_281 : 128|8@1+ (0.5,-64) [-64|63.5] "dBsm"  ADAS
 SG_ DET_BI_STATIC_FLAG_281 : 104|1@1+ (1,0) [0|1] ""  ADAS
 SG_ DET_SUPER_RES_TARGET_281 : 87|1@1+ (1,0) [0|1] ""  ADAS
 SG_ DET_SNR_281 : 120|8@1+ (0.35156,0) [0|89.6478] "dB"  ADAS
 SG_ DET_EXISTENCE_PROB_281 : 112|6@1+ (1.588,0) [0|100] "%"  ADAS
 SG_ DET_HVC_FLAG_281 : 86|1@1+ (1,0) [0|1] ""  ADAS
 SG_ DET_CONFD_AZIMUTH_281 : 118|2@1+ (1,0) [0|3] ""  ADAS
 SG_ DET_CONFD_ELEVATION_281 : 101|2@1+ (1,0) [0|3] ""  ADAS
 SG_ DET_PROB_1STAZHYPO_281 : 103|1@1+ (1,0) [0|1] ""  ADAS
 SG_ DET_IDM_281 : 63|1@1+ (1,0) [0|1] ""  ADAS
 SG_ DET_MTD_281 : 47|1@1+ (1,0) [0|1] ""  ADAS
 SG_ DET_BELOW_RAIN_THOLD_281 : 39|1@1+ (1,0) [0|1] ""  ADAS
 SG_ DET_RANGE_282 : 136|15@1+ (0.015625,0) [0|500] "m"  ADAS
 SG_ DET_RANGE_ERR_282 : 152|7@1+ (0.0075,0) [0|0.9525] "m"  ADAS
 SG_ DET_RANGE_VELOCITY_282 : 160|15@1+ (0.0078125,-128) [-128|127.9921875] "m/s"  ADAS
 SG_ DET_RANGE_VELOCITY_ERR_282 : 176|8@1+ (0.003,0) [0|0.765] "m/s"  ADAS
 SG_ DET_AZIMUTH_282 : 200|13@1+ (0.0004,-1.5708) [-1.5708|1.5708] "rad"  ADAS
 SG_ DET_AZIMUTH_ERR_282 : 217|7@1+ (0.00087267,0) [0|0.11082909] "rad"  ADAS
 SG_ DET_ELEVATION_282 : 184|8@1+ (0.00275,-0.34925) [-0.34925|0.34925] "rad"  ADAS
 SG_ DET_ELEVATION_ERR_282 : 192|6@1+ (0.00174533,0) [0|0.10995579] "rad"  ADAS
 SG_ DET_RCS_282 : 240|8@1+ (0.5,-64) [-64|63.5] "dBsm"  ADAS
 SG_ DET_BI_STATIC_FLAG_282 : 216|1@1+ (1,0) [0|1] ""  ADAS
 SG_ DET_SUPER_RES_TARGET_282 : 199|1@1+ (1,0) [0|1] ""  ADAS
 SG_ DET_SNR_282 : 232|8@1+ (0.35156,0) [0|89.6478] "dB"  ADAS
 SG_ DET_EXISTENCE_PROB_282 : 224|6@1+ (1.588,0) [0|100] "%"  ADAS
 SG_ DET_HVC_FLAG_282 : 198|1@1+ (1,0) [0|1] ""  ADAS
 SG_ DET_CONFD_AZIMUTH_282 : 230|2@1+ (1,0) [0|3] ""  ADAS
 SG_ DET_CONFD_ELEVATION_282 : 213|2@1+ (1,0) [0|3] ""  ADAS
 SG_ DET_PROB_1STAZHYPO_282 : 215|1@1+ (1,0) [0|1] ""  ADAS
 SG_ DET_IDM_282 : 175|1@1+ (1,0) [0|1] ""  ADAS
 SG_ DET_MTD_282 : 159|1@1+ (1,0) [0|1] ""  ADAS
 SG_ DET_BELOW_RAIN_THOLD_282 : 151|1@1+ (1,0) [0|1] ""  ADAS
 SG_ DET_RANGE_283 : 248|15@1+ (0.015625,0) [0|500] "m"  ADAS
 SG_ DET_RANGE_ERR_283 : 264|7@1+ (0.0075,0) [0|0.9525] "m"  ADAS
 SG_ DET_RANGE_VELOCITY_283 : 272|15@1+ (0.0078125,-128) [-128|127.9921875] "m/s"  ADAS
 SG_ DET_RANGE_VELOCITY_ERR_283 : 288|8@1+ (0.003,0) [0|0.765] "m/s"  ADAS
 SG_ DET_AZIMUTH_283 : 312|13@1+ (0.0004,-1.5708) [-1.5708|1.5708] "rad"  ADAS
 SG_ DET_AZIMUTH_ERR_283 : 329|7@1+ (0.00087267,0) [0|0.11082909] "rad"  ADAS
 SG_ DET_ELEVATION_283 : 296|8@1+ (0.00275,-0.34925) [-0.34925|0.34925] "rad"  ADAS
 SG_ DET_ELEVATION_ERR_283 : 304|6@1+ (0.00174533,0) [0|0.10995579] "rad"  ADAS
 SG_ DET_RCS_283 : 352|8@1+ (0.5,-64) [-64|63.5] "dBsm"  ADAS
 SG_ DET_BI_STATIC_FLAG_283 : 328|1@1+ (1,0) [0|1] ""  ADAS
 SG_ DET_SUPER_RES_TARGET_283 : 311|1@1+ (1,0) [0|1] ""  ADAS
 SG_ DET_SNR_283 : 344|8@1+ (0.35156,0) [0|89.6478] "dB"  ADAS
 SG_ DET_EXISTENCE_PROB_283 : 336|6@1+ (1.588,0) [0|100] "%"  ADAS
 SG_ DET_HVC_FLAG_283 : 310|1@1+ (1,0) [0|1] ""  ADAS
 SG_ DET_CONFD_AZIMUTH_283 : 342|2@1+ (1,0) [0|3] ""  ADAS
 SG_ DET_CONFD_ELEVATION_283 : 325|2@1+ (1,0) [0|3] ""  ADAS
 SG_ DET_PROB_1STAZHYPO_283 : 327|1@1+ (1,0) [0|1] ""  ADAS
 SG_ DET_IDM_283 : 287|1@1+ (1,0) [0|1] ""  ADAS
 SG_ DET_MTD_283 : 271|1@1+ (1,0) [0|1] ""  ADAS
 SG_ DET_BELOW_RAIN_THOLD_283 : 263|1@1+ (1,0) [0|1] ""  ADAS
 SG_ DET_RANGE_284 : 360|15@1+ (0.015625,0) [0|500] "m"  ADAS
 SG_ DET_RANGE_ERR_284 : 376|7@1+ (0.0075,0) [0|0.9525] "m"  ADAS
 SG_ DET_RANGE_VELOCITY_284 : 384|15@1+ (0.0078125,-128) [-128|127.9921875] "m/s"  ADAS
 SG_ DET_RANGE_VELOCITY_ERR_284 : 400|8@1+ (0.003,0) [0|0.765] "m/s"  ADAS
 SG_ DET_AZIMUTH_284 : 424|13@1+ (0.0004,-1.5708) [-1.5708|1.5708] "rad"  ADAS
 SG_ DET_AZIMUTH_ERR_284 : 441|7@1+ (0.00087267,0) [0|0.11082909] "rad"  ADAS
 SG_ DET_ELEVATION_284 : 408|8@1+ (0.00275,-0.34925) [-0.34925|0.34925] "rad"  ADAS
 SG_ DET_ELEVATION_ERR_284 : 416|6@1+ (0.00174533,0) [0|0.10995579] "rad"  ADAS
 SG_ DET_RCS_284 : 464|8@1+ (0.5,-64) [-64|63.5] "dBsm"  ADAS
 SG_ DET_BI_STATIC_FLAG_284 : 440|1@1+ (1,0) [0|1] ""  ADAS
 SG_ DET_SUPER_RES_TARGET_284 : 423|1@1+ (1,0) [0|1] ""  ADAS
 SG_ DET_SNR_284 : 456|8@1+ (0.35156,0) [0|89.6478] "dB"  ADAS
 SG_ DET_EXISTENCE_PROB_284 : 448|6@1+ (1.588,0) [0|100] "%"  ADAS
 SG_ DET_HVC_FLAG_284 : 422|1@1+ (1,0) [0|1] ""  ADAS
 SG_ DET_CONFD_AZIMUTH_284 : 454|2@1+ (1,0) [0|3] ""  ADAS
 SG_ DET_CONFD_ELEVATION_284 : 437|2@1+ (1,0) [0|3] ""  ADAS
 SG_ DET_MH_SCAN_INDEX_4LSB_281_284 : 476|4@1+ (1,0) [0|15] ""  ADAS
 SG_ DET_MH_CYCLE_COUNTER_281_284 : 16|8@1+ (1,0) [0|255] ""  ADAS
 SG_ DET_MH_CRC16_281_284 : 0|16@1+ (1,0) [0|65535] ""  ADAS
 SG_ DET_PROB_1STAZHYPO_284 : 439|1@1+ (1,0) [0|1] ""  ADAS
 SG_ DET_IDM_284 : 399|1@1+ (1,0) [0|1] ""  ADAS
 SG_ DET_MTD_284 : 383|1@1+ (1,0) [0|1] ""  ADAS
 SG_ DET_BELOW_RAIN_THOLD_284 : 375|1@1+ (1,0) [0|1] ""  ADAS

BO_ 1223 RDR_DETECTION_285_288: 64 RDR08
 SG_ DET_RANGE_285 : 24|15@1+ (0.015625,0) [0|500] "m"  ADAS
 SG_ DET_RANGE_ERR_285 : 40|7@1+ (0.0075,0) [0|0.9525] "m"  ADAS
 SG_ DET_RANGE_VELOCITY_285 : 48|15@1+ (0.0078125,-128) [-128|127.9921875] "m/s"  ADAS
 SG_ DET_RANGE_VELOCITY_ERR_285 : 64|8@1+ (0.003,0) [0|0.765] "m/s"  ADAS
 SG_ DET_AZIMUTH_285 : 88|13@1+ (0.0004,-1.5708) [-1.5708|1.5708] "rad"  ADAS
 SG_ DET_AZIMUTH_ERR_285 : 105|7@1+ (0.00087267,0) [0|0.11082909] "rad"  ADAS
 SG_ DET_ELEVATION_285 : 72|8@1+ (0.00275,-0.34925) [-0.34925|0.34925] "rad"  ADAS
 SG_ DET_ELEVATION_ERR_285 : 80|6@1+ (0.00174533,0) [0|0.10995579] "rad"  ADAS
 SG_ DET_RCS_285 : 128|8@1+ (0.5,-64) [-64|63.5] "dBsm"  ADAS
 SG_ DET_BI_STATIC_FLAG_285 : 104|1@1+ (1,0) [0|1] ""  ADAS
 SG_ DET_SUPER_RES_TARGET_285 : 87|1@1+ (1,0) [0|1] ""  ADAS
 SG_ DET_SNR_285 : 120|8@1+ (0.35156,0) [0|89.6478] "dB"  ADAS
 SG_ DET_EXISTENCE_PROB_285 : 112|6@1+ (1.588,0) [0|100] "%"  ADAS
 SG_ DET_HVC_FLAG_285 : 86|1@1+ (1,0) [0|1] ""  ADAS
 SG_ DET_CONFD_AZIMUTH_285 : 118|2@1+ (1,0) [0|3] ""  ADAS
 SG_ DET_CONFD_ELEVATION_285 : 101|2@1+ (1,0) [0|3] ""  ADAS
 SG_ DET_PROB_1STAZHYPO_285 : 103|1@1+ (1,0) [0|1] ""  ADAS
 SG_ DET_IDM_285 : 63|1@1+ (1,0) [0|1] ""  ADAS
 SG_ DET_MTD_285 : 47|1@1+ (1,0) [0|1] ""  ADAS
 SG_ DET_BELOW_RAIN_THOLD_285 : 39|1@1+ (1,0) [0|1] ""  ADAS
 SG_ DET_RANGE_286 : 136|15@1+ (0.015625,0) [0|500] "m"  ADAS
 SG_ DET_RANGE_ERR_286 : 152|7@1+ (0.0075,0) [0|0.9525] "m"  ADAS
 SG_ DET_RANGE_VELOCITY_286 : 160|15@1+ (0.0078125,-128) [-128|127.9921875] "m/s"  ADAS
 SG_ DET_RANGE_VELOCITY_ERR_286 : 176|8@1+ (0.003,0) [0|0.765] "m/s"  ADAS
 SG_ DET_AZIMUTH_286 : 200|13@1+ (0.0004,-1.5708) [-1.5708|1.5708] "rad"  ADAS
 SG_ DET_AZIMUTH_ERR_286 : 217|7@1+ (0.00087267,0) [0|0.11082909] "rad"  ADAS
 SG_ DET_ELEVATION_286 : 184|8@1+ (0.00275,-0.34925) [-0.34925|0.34925] "rad"  ADAS
 SG_ DET_ELEVATION_ERR_286 : 192|6@1+ (0.00174533,0) [0|0.10995579] "rad"  ADAS
 SG_ DET_RCS_286 : 240|8@1+ (0.5,-64) [-64|63.5] "dBsm"  ADAS
 SG_ DET_BI_STATIC_FLAG_286 : 216|1@1+ (1,0) [0|1] ""  ADAS
 SG_ DET_SUPER_RES_TARGET_286 : 199|1@1+ (1,0) [0|1] ""  ADAS
 SG_ DET_SNR_286 : 232|8@1+ (0.35156,0) [0|89.6478] "dB"  ADAS
 SG_ DET_EXISTENCE_PROB_286 : 224|6@1+ (1.588,0) [0|100] "%"  ADAS
 SG_ DET_HVC_FLAG_286 : 198|1@1+ (1,0) [0|1] ""  ADAS
 SG_ DET_CONFD_AZIMUTH_286 : 230|2@1+ (1,0) [0|3] ""  ADAS
 SG_ DET_CONFD_ELEVATION_286 : 213|2@1+ (1,0) [0|3] ""  ADAS
 SG_ DET_PROB_1STAZHYPO_286 : 215|1@1+ (1,0) [0|1] ""  ADAS
 SG_ DET_IDM_286 : 175|1@1+ (1,0) [0|1] ""  ADAS
 SG_ DET_MTD_286 : 159|1@1+ (1,0) [0|1] ""  ADAS
 SG_ DET_BELOW_RAIN_THOLD_286 : 151|1@1+ (1,0) [0|1] ""  ADAS
 SG_ DET_RANGE_287 : 248|15@1+ (0.015625,0) [0|500] "m"  ADAS
 SG_ DET_RANGE_ERR_287 : 264|7@1+ (0.0075,0) [0|0.9525] "m"  ADAS
 SG_ DET_RANGE_VELOCITY_287 : 272|15@1+ (0.0078125,-128) [-128|127.9921875] "m/s"  ADAS
 SG_ DET_RANGE_VELOCITY_ERR_287 : 288|8@1+ (0.003,0) [0|0.765] "m/s"  ADAS
 SG_ DET_AZIMUTH_287 : 312|13@1+ (0.0004,-1.5708) [-1.5708|1.5708] "rad"  ADAS
 SG_ DET_AZIMUTH_ERR_287 : 329|7@1+ (0.00087267,0) [0|0.11082909] "rad"  ADAS
 SG_ DET_ELEVATION_287 : 296|8@1+ (0.00275,-0.34925) [-0.34925|0.34925] "rad"  ADAS
 SG_ DET_ELEVATION_ERR_287 : 304|6@1+ (0.00174533,0) [0|0.10995579] "rad"  ADAS
 SG_ DET_RCS_287 : 352|8@1+ (0.5,-64) [-64|63.5] "dBsm"  ADAS
 SG_ DET_BI_STATIC_FLAG_287 : 328|1@1+ (1,0) [0|1] ""  ADAS
 SG_ DET_SUPER_RES_TARGET_287 : 311|1@1+ (1,0) [0|1] ""  ADAS
 SG_ DET_SNR_287 : 344|8@1+ (0.35156,0) [0|89.6478] "dB"  ADAS
 SG_ DET_EXISTENCE_PROB_287 : 336|6@1+ (1.588,0) [0|100] "%"  ADAS
 SG_ DET_HVC_FLAG_287 : 310|1@1+ (1,0) [0|1] ""  ADAS
 SG_ DET_CONFD_AZIMUTH_287 : 342|2@1+ (1,0) [0|3] ""  ADAS
 SG_ DET_CONFD_ELEVATION_287 : 325|2@1+ (1,0) [0|3] ""  ADAS
 SG_ DET_PROB_1STAZHYPO_287 : 327|1@1+ (1,0) [0|1] ""  ADAS
 SG_ DET_IDM_287 : 287|1@1+ (1,0) [0|1] ""  ADAS
 SG_ DET_MTD_287 : 271|1@1+ (1,0) [0|1] ""  ADAS
 SG_ DET_BELOW_RAIN_THOLD_287 : 263|1@1+ (1,0) [0|1] ""  ADAS
 SG_ DET_RANGE_288 : 360|15@1+ (0.015625,0) [0|500] "m"  ADAS
 SG_ DET_RANGE_ERR_288 : 376|7@1+ (0.0075,0) [0|0.9525] "m"  ADAS
 SG_ DET_RANGE_VELOCITY_288 : 384|15@1+ (0.0078125,-128) [-128|127.9921875] "m/s"  ADAS
 SG_ DET_RANGE_VELOCITY_ERR_288 : 400|8@1+ (0.003,0) [0|0.765] "m/s"  ADAS
 SG_ DET_AZIMUTH_288 : 424|13@1+ (0.0004,-1.5708) [-1.5708|1.5708] "rad"  ADAS
 SG_ DET_AZIMUTH_ERR_288 : 441|7@1+ (0.00087267,0) [0|0.11082909] "rad"  ADAS
 SG_ DET_ELEVATION_288 : 408|8@1+ (0.00275,-0.34925) [-0.34925|0.34925] "rad"  ADAS
 SG_ DET_ELEVATION_ERR_288 : 416|6@1+ (0.00174533,0) [0|0.10995579] "rad"  ADAS
 SG_ DET_RCS_288 : 464|8@1+ (0.5,-64) [-64|63.5] "dBsm"  ADAS
 SG_ DET_BI_STATIC_FLAG_288 : 440|1@1+ (1,0) [0|1] ""  ADAS
 SG_ DET_SUPER_RES_TARGET_288 : 423|1@1+ (1,0) [0|1] ""  ADAS
 SG_ DET_SNR_288 : 456|8@1+ (0.35156,0) [0|89.6478] "dB"  ADAS
 SG_ DET_EXISTENCE_PROB_288 : 448|6@1+ (1.588,0) [0|100] "%"  ADAS
 SG_ DET_HVC_FLAG_288 : 422|1@1+ (1,0) [0|1] ""  ADAS
 SG_ DET_CONFD_AZIMUTH_288 : 454|2@1+ (1,0) [0|3] ""  ADAS
 SG_ DET_CONFD_ELEVATION_288 : 437|2@1+ (1,0) [0|3] ""  ADAS
 SG_ DET_MH_SCAN_INDEX_4LSB_285_288 : 476|4@1+ (1,0) [0|15] ""  ADAS
 SG_ DET_MH_CYCLE_COUNTER_285_288 : 16|8@1+ (1,0) [0|255] ""  ADAS
 SG_ DET_MH_CRC16_285_288 : 0|16@1+ (1,0) [0|65535] ""  ADAS
 SG_ DET_PROB_1STAZHYPO_288 : 439|1@1+ (1,0) [0|1] ""  ADAS
 SG_ DET_IDM_288 : 399|1@1+ (1,0) [0|1] ""  ADAS
 SG_ DET_MTD_288 : 383|1@1+ (1,0) [0|1] ""  ADAS
 SG_ DET_BELOW_RAIN_THOLD_288 : 375|1@1+ (1,0) [0|1] ""  ADAS

CM_ SG_ 1208 DET_RANGE_225 " measured position  of the detection";
CM_ SG_ 1208 DET_RANGE_ERR_225 "RMSE or standard deviation of the measured angle  of the detection";
CM_ SG_ 1208 DET_RANGE_VELOCITY_225 "Radial velocity of the detection positive in direction to the sensor";
CM_ SG_ 1208 DET_RANGE_VELOCITY_ERR_225 "RMSE or standard deviation of the measure radial velocity of the detection";
CM_ SG_ 1208 DET_AZIMUTH_225 "Measured angle  of the detection";
CM_ SG_ 1208 DET_AZIMUTH_ERR_225 "RMSE or standard deviation of the measured angle  of the detection";
CM_ SG_ 1208 DET_ELEVATION_225 "measured elevation of the detection";
CM_ SG_ 1208 DET_ELEVATION_ERR_225 "RMSE or standard deviation of the measured elevation  of the detection";
CM_ SG_ 1208 DET_RCS_225 "Radar Cross Section or Amplitude, is a measure of how detectable an object is by radar. A larger RCS indicates that an object is more easily detected.";
CM_ SG_ 1208 DET_BI_STATIC_FLAG_225 "1 if detection is bi-static 0 otherwise";
CM_ SG_ 1208 DET_SUPER_RES_TARGET_225 "flasg is set if the detection is super resolution target";
CM_ SG_ 1208 DET_SNR_225 "The signal to noise ratio (SNR) of the radar detection";
CM_ SG_ 1208 DET_EXISTENCE_PROB_225 "Existence probability of the detection not based on history. Value does  not depend on any past experience with similar detections.
\note Use as confidence measure where a low value means less confidence
and a high value indicates strong confidence.";
CM_ SG_ 1208 DET_HVC_FLAG_225 "Core2 Vehicle clutter flag";
CM_ SG_ 1208 DET_CONFD_AZIMUTH_225 "Define the Confidence of Azimuth for Detection ";
CM_ SG_ 1208 DET_CONFD_ELEVATION_225 "Define the Confidence of Elevation for the Detection ";
CM_ SG_ 1208 DET_BI_STATIC_FLAG_226 "1 if detection is bi-static 0 otherwise";
CM_ SG_ 1208 DET_BI_STATIC_FLAG_227 "1 if detection is bi-static 0 otherwise";
CM_ SG_ 1208 DET_BI_STATIC_FLAG_228 "1 if detection is bi-static 0 otherwise";
CM_ SG_ 1208 DET_MH_SCAN_INDEX_4LSB_225_228 "Scan index of the measured detection";
CM_ SG_ 1208 DET_MH_CYCLE_COUNTER_225_228 "Detection Alive Counter";
CM_ SG_ 1209 DET_RANGE_229 " measured position  of the detection";
CM_ SG_ 1209 DET_RANGE_ERR_229 "RMSE or standard deviation of the measured angle  of the detection";
CM_ SG_ 1209 DET_RANGE_VELOCITY_229 "Radial velocity of the detection positive in direction to the sensor";
CM_ SG_ 1209 DET_RANGE_VELOCITY_ERR_229 "RMSE or standard deviation of the measure radial velocity of the detection";
CM_ SG_ 1209 DET_AZIMUTH_229 "Measured angle  of the detection";
CM_ SG_ 1209 DET_AZIMUTH_ERR_229 "RMSE or standard deviation of the measured angle  of the detection";
CM_ SG_ 1209 DET_ELEVATION_229 "measured elevation of the detection";
CM_ SG_ 1209 DET_ELEVATION_ERR_229 "RMSE or standard deviation of the measured elevation  of the detection";
CM_ SG_ 1209 DET_RCS_229 "Radar Cross Section or Amplitude, is a measure of how detectable an object is by radar. A larger RCS indicates that an object is more easily detected.";
CM_ SG_ 1209 DET_BI_STATIC_FLAG_229 "1 if detection is bi-static 0 otherwise";
CM_ SG_ 1209 DET_SUPER_RES_TARGET_229 "flasg is set if the detection is super resolution target";
CM_ SG_ 1209 DET_SNR_229 "The signal to noise ratio (SNR) of the radar detection";
CM_ SG_ 1209 DET_EXISTENCE_PROB_229 "Existence probability of the detection not based on history. Value does  not depend on any past experience with similar detections.
\note Use as confidence measure where a low value means less confidence
and a high value indicates strong confidence.";
CM_ SG_ 1209 DET_HVC_FLAG_229 "Core2 Vehicle clutter flag";
CM_ SG_ 1209 DET_CONFD_AZIMUTH_229 "Define the Confidence of Azimuth for Detection ";
CM_ SG_ 1209 DET_CONFD_ELEVATION_229 "Define the Confidence of Elevation for the Detection ";
CM_ SG_ 1209 DET_BI_STATIC_FLAG_230 "1 if detection is bi-static 0 otherwise";
CM_ SG_ 1209 DET_BI_STATIC_FLAG_231 "1 if detection is bi-static 0 otherwise";
CM_ SG_ 1209 DET_BI_STATIC_FLAG_232 "1 if detection is bi-static 0 otherwise";
CM_ SG_ 1209 DET_MH_SCAN_INDEX_4LSB_229_232 "Scan index of the measured detection";
CM_ SG_ 1209 DET_MH_CYCLE_COUNTER_229_232 "Detection Alive Counter";
CM_ SG_ 1210 DET_RANGE_233 " measured position  of the detection";
CM_ SG_ 1210 DET_RANGE_ERR_233 "RMSE or standard deviation of the measured angle  of the detection";
CM_ SG_ 1210 DET_RANGE_VELOCITY_233 "Radial velocity of the detection positive in direction to the sensor";
CM_ SG_ 1210 DET_RANGE_VELOCITY_ERR_233 "RMSE or standard deviation of the measure radial velocity of the detection";
CM_ SG_ 1210 DET_AZIMUTH_233 "Measured angle  of the detection";
CM_ SG_ 1210 DET_AZIMUTH_ERR_233 "RMSE or standard deviation of the measured angle  of the detection";
CM_ SG_ 1210 DET_ELEVATION_233 "measured elevation of the detection";
CM_ SG_ 1210 DET_ELEVATION_ERR_233 "RMSE or standard deviation of the measured elevation  of the detection";
CM_ SG_ 1210 DET_RCS_233 "Radar Cross Section or Amplitude, is a measure of how detectable an object is by radar. A larger RCS indicates that an object is more easily detected.";
CM_ SG_ 1210 DET_BI_STATIC_FLAG_233 "1 if detection is bi-static 0 otherwise";
CM_ SG_ 1210 DET_SUPER_RES_TARGET_233 "flasg is set if the detection is super resolution target";
CM_ SG_ 1210 DET_SNR_233 "The signal to noise ratio (SNR) of the radar detection";
CM_ SG_ 1210 DET_EXISTENCE_PROB_233 "Existence probability of the detection not based on history. Value does  not depend on any past experience with similar detections.
\note Use as confidence measure where a low value means less confidence
and a high value indicates strong confidence.";
CM_ SG_ 1210 DET_HVC_FLAG_233 "Core2 Vehicle clutter flag";
CM_ SG_ 1210 DET_CONFD_AZIMUTH_233 "Define the Confidence of Azimuth for Detection ";
CM_ SG_ 1210 DET_CONFD_ELEVATION_233 "Define the Confidence of Elevation for the Detection ";
CM_ SG_ 1210 DET_BI_STATIC_FLAG_234 "1 if detection is bi-static 0 otherwise";
CM_ SG_ 1210 DET_BI_STATIC_FLAG_235 "1 if detection is bi-static 0 otherwise";
CM_ SG_ 1210 DET_BI_STATIC_FLAG_236 "1 if detection is bi-static 0 otherwise";
CM_ SG_ 1210 DET_MH_SCAN_INDEX_4LSB_233_236 "Scan index of the measured detection";
CM_ SG_ 1210 DET_MH_CYCLE_COUNTER_233_236 "Detection Alive Counter";
CM_ SG_ 1211 DET_RANGE_237 " measured position  of the detection";
CM_ SG_ 1211 DET_RANGE_ERR_237 "RMSE or standard deviation of the measured angle  of the detection";
CM_ SG_ 1211 DET_RANGE_VELOCITY_237 "Radial velocity of the detection positive in direction to the sensor";
CM_ SG_ 1211 DET_RANGE_VELOCITY_ERR_237 "RMSE or standard deviation of the measure radial velocity of the detection";
CM_ SG_ 1211 DET_AZIMUTH_237 "Measured angle  of the detection";
CM_ SG_ 1211 DET_AZIMUTH_ERR_237 "RMSE or standard deviation of the measured angle  of the detection";
CM_ SG_ 1211 DET_ELEVATION_237 "measured elevation of the detection";
CM_ SG_ 1211 DET_ELEVATION_ERR_237 "RMSE or standard deviation of the measured elevation  of the detection";
CM_ SG_ 1211 DET_RCS_237 "Radar Cross Section or Amplitude, is a measure of how detectable an object is by radar. A larger RCS indicates that an object is more easily detected.";
CM_ SG_ 1211 DET_BI_STATIC_FLAG_237 "1 if detection is bi-static 0 otherwise";
CM_ SG_ 1211 DET_SUPER_RES_TARGET_237 "flasg is set if the detection is super resolution target";
CM_ SG_ 1211 DET_SNR_237 "The signal to noise ratio (SNR) of the radar detection";
CM_ SG_ 1211 DET_EXISTENCE_PROB_237 "Existence probability of the detection not based on history. Value does  not depend on any past experience with similar detections.
\note Use as confidence measure where a low value means less confidence
and a high value indicates strong confidence.";
CM_ SG_ 1211 DET_HVC_FLAG_237 "Core2 Vehicle clutter flag";
CM_ SG_ 1211 DET_CONFD_AZIMUTH_237 "Define the Confidence of Azimuth for Detection ";
CM_ SG_ 1211 DET_CONFD_ELEVATION_237 "Define the Confidence of Elevation for the Detection ";
CM_ SG_ 1211 DET_BI_STATIC_FLAG_238 "1 if detection is bi-static 0 otherwise";
CM_ SG_ 1211 DET_BI_STATIC_FLAG_239 "1 if detection is bi-static 0 otherwise";
CM_ SG_ 1211 DET_BI_STATIC_FLAG_240 "1 if detection is bi-static 0 otherwise";
CM_ SG_ 1211 DET_MH_SCAN_INDEX_4LSB_237_240 "Scan index of the measured detection";
CM_ SG_ 1211 DET_MH_CYCLE_COUNTER_237_240 "Detection Alive Counter";
CM_ SG_ 1212 DET_RANGE_241 " measured position  of the detection";
CM_ SG_ 1212 DET_RANGE_ERR_241 "RMSE or standard deviation of the measured angle  of the detection";
CM_ SG_ 1212 DET_RANGE_VELOCITY_241 "Radial velocity of the detection positive in direction to the sensor";
CM_ SG_ 1212 DET_RANGE_VELOCITY_ERR_241 "RMSE or standard deviation of the measure radial velocity of the detection";
CM_ SG_ 1212 DET_AZIMUTH_241 "Measured angle  of the detection";
CM_ SG_ 1212 DET_AZIMUTH_ERR_241 "RMSE or standard deviation of the measured angle  of the detection";
CM_ SG_ 1212 DET_ELEVATION_241 "measured elevation of the detection";
CM_ SG_ 1212 DET_ELEVATION_ERR_241 "RMSE or standard deviation of the measured elevation  of the detection";
CM_ SG_ 1212 DET_RCS_241 "Radar Cross Section or Amplitude, is a measure of how detectable an object is by radar. A larger RCS indicates that an object is more easily detected.";
CM_ SG_ 1212 DET_BI_STATIC_FLAG_241 "1 if detection is bi-static 0 otherwise";
CM_ SG_ 1212 DET_SUPER_RES_TARGET_241 "flasg is set if the detection is super resolution target";
CM_ SG_ 1212 DET_SNR_241 "The signal to noise ratio (SNR) of the radar detection";
CM_ SG_ 1212 DET_EXISTENCE_PROB_241 "Existence probability of the detection not based on history. Value does  not depend on any past experience with similar detections.
\note Use as confidence measure where a low value means less confidence
and a high value indicates strong confidence.";
CM_ SG_ 1212 DET_HVC_FLAG_241 "Core2 Vehicle clutter flag";
CM_ SG_ 1212 DET_CONFD_AZIMUTH_241 "Define the Confidence of Azimuth for Detection ";
CM_ SG_ 1212 DET_CONFD_ELEVATION_241 "Define the Confidence of Elevation for the Detection ";
CM_ SG_ 1212 DET_BI_STATIC_FLAG_242 "1 if detection is bi-static 0 otherwise";
CM_ SG_ 1212 DET_BI_STATIC_FLAG_243 "1 if detection is bi-static 0 otherwise";
CM_ SG_ 1212 DET_BI_STATIC_FLAG_244 "1 if detection is bi-static 0 otherwise";
CM_ SG_ 1212 DET_MH_SCAN_INDEX_4LSB_241_244 "Scan index of the measured detection";
CM_ SG_ 1212 DET_MH_CYCLE_COUNTER_241_244 "Detection Alive Counter";
CM_ SG_ 1213 DET_RANGE_245 " measured position  of the detection";
CM_ SG_ 1213 DET_RANGE_ERR_245 "RMSE or standard deviation of the measured angle  of the detection";
CM_ SG_ 1213 DET_RANGE_VELOCITY_245 "Radial velocity of the detection positive in direction to the sensor";
CM_ SG_ 1213 DET_RANGE_VELOCITY_ERR_245 "RMSE or standard deviation of the measure radial velocity of the detection";
CM_ SG_ 1213 DET_AZIMUTH_245 "Measured angle  of the detection";
CM_ SG_ 1213 DET_AZIMUTH_ERR_245 "RMSE or standard deviation of the measured angle  of the detection";
CM_ SG_ 1213 DET_ELEVATION_245 "measured elevation of the detection";
CM_ SG_ 1213 DET_ELEVATION_ERR_245 "RMSE or standard deviation of the measured elevation  of the detection";
CM_ SG_ 1213 DET_RCS_245 "Radar Cross Section or Amplitude, is a measure of how detectable an object is by radar. A larger RCS indicates that an object is more easily detected.";
CM_ SG_ 1213 DET_BI_STATIC_FLAG_245 "1 if detection is bi-static 0 otherwise";
CM_ SG_ 1213 DET_SUPER_RES_TARGET_245 "flasg is set if the detection is super resolution target";
CM_ SG_ 1213 DET_SNR_245 "The signal to noise ratio (SNR) of the radar detection";
CM_ SG_ 1213 DET_EXISTENCE_PROB_245 "Existence probability of the detection not based on history. Value does  not depend on any past experience with similar detections.
\note Use as confidence measure where a low value means less confidence
and a high value indicates strong confidence.";
CM_ SG_ 1213 DET_HVC_FLAG_245 "Core2 Vehicle clutter flag";
CM_ SG_ 1213 DET_CONFD_AZIMUTH_245 "Define the Confidence of Azimuth for Detection ";
CM_ SG_ 1213 DET_CONFD_ELEVATION_245 "Define the Confidence of Elevation for the Detection ";
CM_ SG_ 1213 DET_BI_STATIC_FLAG_246 "1 if detection is bi-static 0 otherwise";
CM_ SG_ 1213 DET_BI_STATIC_FLAG_247 "1 if detection is bi-static 0 otherwise";
CM_ SG_ 1213 DET_BI_STATIC_FLAG_248 "1 if detection is bi-static 0 otherwise";
CM_ SG_ 1213 DET_MH_SCAN_INDEX_4LSB_245_248 "Scan index of the measured detection";
CM_ SG_ 1213 DET_MH_CYCLE_COUNTER_245_248 "Detection Alive Counter";
CM_ SG_ 1214 DET_RANGE_249 " measured position  of the detection";
CM_ SG_ 1214 DET_RANGE_ERR_249 "RMSE or standard deviation of the measured angle  of the detection";
CM_ SG_ 1214 DET_RANGE_VELOCITY_249 "Radial velocity of the detection positive in direction to the sensor";
CM_ SG_ 1214 DET_RANGE_VELOCITY_ERR_249 "RMSE or standard deviation of the measure radial velocity of the detection";
CM_ SG_ 1214 DET_AZIMUTH_249 "Measured angle  of the detection";
CM_ SG_ 1214 DET_AZIMUTH_ERR_249 "RMSE or standard deviation of the measured angle  of the detection";
CM_ SG_ 1214 DET_ELEVATION_249 "measured elevation of the detection";
CM_ SG_ 1214 DET_ELEVATION_ERR_249 "RMSE or standard deviation of the measured elevation  of the detection";
CM_ SG_ 1214 DET_RCS_249 "Radar Cross Section or Amplitude, is a measure of how detectable an object is by radar. A larger RCS indicates that an object is more easily detected.";
CM_ SG_ 1214 DET_BI_STATIC_FLAG_249 "1 if detection is bi-static 0 otherwise";
CM_ SG_ 1214 DET_SUPER_RES_TARGET_249 "flasg is set if the detection is super resolution target";
CM_ SG_ 1214 DET_SNR_249 "The signal to noise ratio (SNR) of the radar detection";
CM_ SG_ 1214 DET_EXISTENCE_PROB_249 "Existence probability of the detection not based on history. Value does  not depend on any past experience with similar detections.
\note Use as confidence measure where a low value means less confidence
and a high value indicates strong confidence.";
CM_ SG_ 1214 DET_HVC_FLAG_249 "Core2 Vehicle clutter flag";
CM_ SG_ 1214 DET_CONFD_AZIMUTH_249 "Define the Confidence of Azimuth for Detection ";
CM_ SG_ 1214 DET_CONFD_ELEVATION_249 "Define the Confidence of Elevation for the Detection ";
CM_ SG_ 1214 DET_BI_STATIC_FLAG_250 "1 if detection is bi-static 0 otherwise";
CM_ SG_ 1214 DET_BI_STATIC_FLAG_251 "1 if detection is bi-static 0 otherwise";
CM_ SG_ 1214 DET_BI_STATIC_FLAG_252 "1 if detection is bi-static 0 otherwise";
CM_ SG_ 1214 DET_MH_SCAN_INDEX_4LSB_249_252 "Scan index of the measured detection";
CM_ SG_ 1214 DET_MH_CYCLE_COUNTER_249_252 "Detection Alive Counter";
CM_ SG_ 1215 DET_RANGE_253 " measured position  of the detection";
CM_ SG_ 1215 DET_RANGE_ERR_253 "RMSE or standard deviation of the measured angle  of the detection";
CM_ SG_ 1215 DET_RANGE_VELOCITY_253 "Radial velocity of the detection positive in direction to the sensor";
CM_ SG_ 1215 DET_RANGE_VELOCITY_ERR_253 "RMSE or standard deviation of the measure radial velocity of the detection";
CM_ SG_ 1215 DET_AZIMUTH_253 "Measured angle  of the detection";
CM_ SG_ 1215 DET_AZIMUTH_ERR_253 "RMSE or standard deviation of the measured angle  of the detection";
CM_ SG_ 1215 DET_ELEVATION_253 "measured elevation of the detection";
CM_ SG_ 1215 DET_ELEVATION_ERR_253 "RMSE or standard deviation of the measured elevation  of the detection";
CM_ SG_ 1215 DET_RCS_253 "Radar Cross Section or Amplitude, is a measure of how detectable an object is by radar. A larger RCS indicates that an object is more easily detected.";
CM_ SG_ 1215 DET_BI_STATIC_FLAG_253 "1 if detection is bi-static 0 otherwise";
CM_ SG_ 1215 DET_SUPER_RES_TARGET_253 "flasg is set if the detection is super resolution target";
CM_ SG_ 1215 DET_SNR_253 "The signal to noise ratio (SNR) of the radar detection";
CM_ SG_ 1215 DET_EXISTENCE_PROB_253 "Existence probability of the detection not based on history. Value does  not depend on any past experience with similar detections.
\note Use as confidence measure where a low value means less confidence
and a high value indicates strong confidence.";
CM_ SG_ 1215 DET_HVC_FLAG_253 "Core2 Vehicle clutter flag";
CM_ SG_ 1215 DET_CONFD_AZIMUTH_253 "Define the Confidence of Azimuth for Detection ";
CM_ SG_ 1215 DET_CONFD_ELEVATION_253 "Define the Confidence of Elevation for the Detection ";
CM_ SG_ 1215 DET_BI_STATIC_FLAG_254 "1 if detection is bi-static 0 otherwise";
CM_ SG_ 1215 DET_BI_STATIC_FLAG_255 "1 if detection is bi-static 0 otherwise";
CM_ SG_ 1215 DET_BI_STATIC_FLAG_256 "1 if detection is bi-static 0 otherwise";
CM_ SG_ 1215 DET_MH_SCAN_INDEX_4LSB_253_256 "Scan index of the measured detection";
CM_ SG_ 1215 DET_MH_CYCLE_COUNTER_253_256 "Detection Alive Counter";
CM_ SG_ 1216 DET_RANGE_257 " measured position  of the detection";
CM_ SG_ 1216 DET_RANGE_ERR_257 "RMSE or standard deviation of the measured angle  of the detection";
CM_ SG_ 1216 DET_RANGE_VELOCITY_257 "Radial velocity of the detection positive in direction to the sensor";
CM_ SG_ 1216 DET_RANGE_VELOCITY_ERR_257 "RMSE or standard deviation of the measure radial velocity of the detection";
CM_ SG_ 1216 DET_AZIMUTH_257 "Measured angle  of the detection";
CM_ SG_ 1216 DET_AZIMUTH_ERR_257 "RMSE or standard deviation of the measured angle  of the detection";
CM_ SG_ 1216 DET_ELEVATION_257 "measured elevation of the detection";
CM_ SG_ 1216 DET_ELEVATION_ERR_257 "RMSE or standard deviation of the measured elevation  of the detection";
CM_ SG_ 1216 DET_RCS_257 "Radar Cross Section or Amplitude, is a measure of how detectable an object is by radar. A larger RCS indicates that an object is more easily detected.";
CM_ SG_ 1216 DET_BI_STATIC_FLAG_257 "1 if detection is bi-static 0 otherwise";
CM_ SG_ 1216 DET_SUPER_RES_TARGET_257 "flasg is set if the detection is super resolution target";
CM_ SG_ 1216 DET_SNR_257 "The signal to noise ratio (SNR) of the radar detection";
CM_ SG_ 1216 DET_EXISTENCE_PROB_257 "Existence probability of the detection not based on history. Value does  not depend on any past experience with similar detections.
\note Use as confidence measure where a low value means less confidence
and a high value indicates strong confidence.";
CM_ SG_ 1216 DET_HVC_FLAG_257 "Core2 Vehicle clutter flag";
CM_ SG_ 1216 DET_CONFD_AZIMUTH_257 "Define the Confidence of Azimuth for Detection ";
CM_ SG_ 1216 DET_CONFD_ELEVATION_257 "Define the Confidence of Elevation for the Detection ";
CM_ SG_ 1216 DET_BI_STATIC_FLAG_258 "1 if detection is bi-static 0 otherwise";
CM_ SG_ 1216 DET_BI_STATIC_FLAG_259 "1 if detection is bi-static 0 otherwise";
CM_ SG_ 1216 DET_BI_STATIC_FLAG_260 "1 if detection is bi-static 0 otherwise";
CM_ SG_ 1216 DET_MH_SCAN_INDEX_4LSB_257_260 "Scan index of the measured detection";
CM_ SG_ 1216 DET_MH_CYCLE_COUNTER_257_260 "Detection Alive Counter";
CM_ SG_ 1217 DET_RANGE_261 " measured position  of the detection";
CM_ SG_ 1217 DET_RANGE_ERR_261 "RMSE or standard deviation of the measured angle  of the detection";
CM_ SG_ 1217 DET_RANGE_VELOCITY_261 "Radial velocity of the detection positive in direction to the sensor";
CM_ SG_ 1217 DET_RANGE_VELOCITY_ERR_261 "RMSE or standard deviation of the measure radial velocity of the detection";
CM_ SG_ 1217 DET_AZIMUTH_261 "Measured angle  of the detection";
CM_ SG_ 1217 DET_AZIMUTH_ERR_261 "RMSE or standard deviation of the measured angle  of the detection";
CM_ SG_ 1217 DET_ELEVATION_261 "measured elevation of the detection";
CM_ SG_ 1217 DET_ELEVATION_ERR_261 "RMSE or standard deviation of the measured elevation  of the detection";
CM_ SG_ 1217 DET_RCS_261 "Radar Cross Section or Amplitude, is a measure of how detectable an object is by radar. A larger RCS indicates that an object is more easily detected.";
CM_ SG_ 1217 DET_BI_STATIC_FLAG_261 "1 if detection is bi-static 0 otherwise";
CM_ SG_ 1217 DET_SUPER_RES_TARGET_261 "flasg is set if the detection is super resolution target";
CM_ SG_ 1217 DET_SNR_261 "The signal to noise ratio (SNR) of the radar detection";
CM_ SG_ 1217 DET_EXISTENCE_PROB_261 "Existence probability of the detection not based on history. Value does  not depend on any past experience with similar detections.
\note Use as confidence measure where a low value means less confidence
and a high value indicates strong confidence.";
CM_ SG_ 1217 DET_HVC_FLAG_261 "Core2 Vehicle clutter flag";
CM_ SG_ 1217 DET_CONFD_AZIMUTH_261 "Define the Confidence of Azimuth for Detection ";
CM_ SG_ 1217 DET_CONFD_ELEVATION_261 "Define the Confidence of Elevation for the Detection ";
CM_ SG_ 1217 DET_BI_STATIC_FLAG_262 "1 if detection is bi-static 0 otherwise";
CM_ SG_ 1217 DET_BI_STATIC_FLAG_263 "1 if detection is bi-static 0 otherwise";
CM_ SG_ 1217 DET_BI_STATIC_FLAG_264 "1 if detection is bi-static 0 otherwise";
CM_ SG_ 1217 DET_MH_SCAN_INDEX_4LSB_261_264 "Scan index of the measured detection";
CM_ SG_ 1217 DET_MH_CYCLE_COUNTER_261_264 "Detection Alive Counter";
CM_ SG_ 1218 DET_RANGE_265 " measured position  of the detection";
CM_ SG_ 1218 DET_RANGE_ERR_265 "RMSE or standard deviation of the measured angle  of the detection";
CM_ SG_ 1218 DET_RANGE_VELOCITY_265 "Radial velocity of the detection positive in direction to the sensor";
CM_ SG_ 1218 DET_RANGE_VELOCITY_ERR_265 "RMSE or standard deviation of the measure radial velocity of the detection";
CM_ SG_ 1218 DET_AZIMUTH_265 "Measured angle  of the detection";
CM_ SG_ 1218 DET_AZIMUTH_ERR_265 "RMSE or standard deviation of the measured angle  of the detection";
CM_ SG_ 1218 DET_ELEVATION_265 "measured elevation of the detection";
CM_ SG_ 1218 DET_ELEVATION_ERR_265 "RMSE or standard deviation of the measured elevation  of the detection";
CM_ SG_ 1218 DET_RCS_265 "Radar Cross Section or Amplitude, is a measure of how detectable an object is by radar. A larger RCS indicates that an object is more easily detected.";
CM_ SG_ 1218 DET_BI_STATIC_FLAG_265 "1 if detection is bi-static 0 otherwise";
CM_ SG_ 1218 DET_SUPER_RES_TARGET_265 "flasg is set if the detection is super resolution target";
CM_ SG_ 1218 DET_SNR_265 "The signal to noise ratio (SNR) of the radar detection";
CM_ SG_ 1218 DET_EXISTENCE_PROB_265 "Existence probability of the detection not based on history. Value does  not depend on any past experience with similar detections.
\note Use as confidence measure where a low value means less confidence
and a high value indicates strong confidence.";
CM_ SG_ 1218 DET_HVC_FLAG_265 "Core2 Vehicle clutter flag";
CM_ SG_ 1218 DET_CONFD_AZIMUTH_265 "Define the Confidence of Azimuth for Detection ";
CM_ SG_ 1218 DET_CONFD_ELEVATION_265 "Define the Confidence of Elevation for the Detection ";
CM_ SG_ 1218 DET_BI_STATIC_FLAG_266 "1 if detection is bi-static 0 otherwise";
CM_ SG_ 1218 DET_BI_STATIC_FLAG_267 "1 if detection is bi-static 0 otherwise";
CM_ SG_ 1218 DET_BI_STATIC_FLAG_268 "1 if detection is bi-static 0 otherwise";
CM_ SG_ 1218 DET_MH_SCAN_INDEX_4LSB_265_268 "Scan index of the measured detection";
CM_ SG_ 1218 DET_MH_CYCLE_COUNTER_265_268 "Detection Alive Counter";
CM_ SG_ 1219 DET_RANGE_269 " measured position  of the detection";
CM_ SG_ 1219 DET_RANGE_ERR_269 "RMSE or standard deviation of the measured angle  of the detection";
CM_ SG_ 1219 DET_RANGE_VELOCITY_269 "Radial velocity of the detection positive in direction to the sensor";
CM_ SG_ 1219 DET_RANGE_VELOCITY_ERR_269 "RMSE or standard deviation of the measure radial velocity of the detection";
CM_ SG_ 1219 DET_AZIMUTH_269 "Measured angle  of the detection";
CM_ SG_ 1219 DET_AZIMUTH_ERR_269 "RMSE or standard deviation of the measured angle  of the detection";
CM_ SG_ 1219 DET_ELEVATION_269 "measured elevation of the detection";
CM_ SG_ 1219 DET_ELEVATION_ERR_269 "RMSE or standard deviation of the measured elevation  of the detection";
CM_ SG_ 1219 DET_RCS_269 "Radar Cross Section or Amplitude, is a measure of how detectable an object is by radar. A larger RCS indicates that an object is more easily detected.";
CM_ SG_ 1219 DET_BI_STATIC_FLAG_269 "1 if detection is bi-static 0 otherwise";
CM_ SG_ 1219 DET_SUPER_RES_TARGET_269 "flasg is set if the detection is super resolution target";
CM_ SG_ 1219 DET_SNR_269 "The signal to noise ratio (SNR) of the radar detection";
CM_ SG_ 1219 DET_EXISTENCE_PROB_269 "Existence probability of the detection not based on history. Value does  not depend on any past experience with similar detections.
\note Use as confidence measure where a low value means less confidence
and a high value indicates strong confidence.";
CM_ SG_ 1219 DET_HVC_FLAG_269 "Core2 Vehicle clutter flag";
CM_ SG_ 1219 DET_CONFD_AZIMUTH_269 "Define the Confidence of Azimuth for Detection ";
CM_ SG_ 1219 DET_CONFD_ELEVATION_269 "Define the Confidence of Elevation for the Detection ";
CM_ SG_ 1219 DET_BI_STATIC_FLAG_270 "1 if detection is bi-static 0 otherwise";
CM_ SG_ 1219 DET_BI_STATIC_FLAG_271 "1 if detection is bi-static 0 otherwise";
CM_ SG_ 1219 DET_BI_STATIC_FLAG_272 "1 if detection is bi-static 0 otherwise";
CM_ SG_ 1219 DET_MH_SCAN_INDEX_4LSB_269_272 "Scan index of the measured detection";
CM_ SG_ 1219 DET_MH_CYCLE_COUNTER_269_272 "Detection Alive Counter";
CM_ SG_ 1220 DET_RANGE_273 " measured position  of the detection";
CM_ SG_ 1220 DET_RANGE_ERR_273 "RMSE or standard deviation of the measured angle  of the detection";
CM_ SG_ 1220 DET_RANGE_VELOCITY_273 "Radial velocity of the detection positive in direction to the sensor";
CM_ SG_ 1220 DET_RANGE_VELOCITY_ERR_273 "RMSE or standard deviation of the measure radial velocity of the detection";
CM_ SG_ 1220 DET_AZIMUTH_273 "Measured angle  of the detection";
CM_ SG_ 1220 DET_AZIMUTH_ERR_273 "RMSE or standard deviation of the measured angle  of the detection";
CM_ SG_ 1220 DET_ELEVATION_273 "measured elevation of the detection";
CM_ SG_ 1220 DET_ELEVATION_ERR_273 "RMSE or standard deviation of the measured elevation  of the detection";
CM_ SG_ 1220 DET_RCS_273 "Radar Cross Section or Amplitude, is a measure of how detectable an object is by radar. A larger RCS indicates that an object is more easily detected.";
CM_ SG_ 1220 DET_BI_STATIC_FLAG_273 "1 if detection is bi-static 0 otherwise";
CM_ SG_ 1220 DET_SUPER_RES_TARGET_273 "flasg is set if the detection is super resolution target";
CM_ SG_ 1220 DET_SNR_273 "The signal to noise ratio (SNR) of the radar detection";
CM_ SG_ 1220 DET_EXISTENCE_PROB_273 "Existence probability of the detection not based on history. Value does  not depend on any past experience with similar detections.
\note Use as confidence measure where a low value means less confidence
and a high value indicates strong confidence.";
CM_ SG_ 1220 DET_HVC_FLAG_273 "Core2 Vehicle clutter flag";
CM_ SG_ 1220 DET_CONFD_AZIMUTH_273 "Define the Confidence of Azimuth for Detection ";
CM_ SG_ 1220 DET_CONFD_ELEVATION_273 "Define the Confidence of Elevation for the Detection ";
CM_ SG_ 1220 DET_BI_STATIC_FLAG_274 "1 if detection is bi-static 0 otherwise";
CM_ SG_ 1220 DET_BI_STATIC_FLAG_275 "1 if detection is bi-static 0 otherwise";
CM_ SG_ 1220 DET_BI_STATIC_FLAG_276 "1 if detection is bi-static 0 otherwise";
CM_ SG_ 1220 DET_MH_SCAN_INDEX_4LSB_273_276 "Scan index of the measured detection";
CM_ SG_ 1220 DET_MH_CYCLE_COUNTER_273_276 "Detection Alive Counter";
CM_ SG_ 1221 DET_RANGE_277 " measured position  of the detection";
CM_ SG_ 1221 DET_RANGE_ERR_277 "RMSE or standard deviation of the measured angle  of the detection";
CM_ SG_ 1221 DET_RANGE_VELOCITY_277 "Radial velocity of the detection positive in direction to the sensor";
CM_ SG_ 1221 DET_RANGE_VELOCITY_ERR_277 "RMSE or standard deviation of the measure radial velocity of the detection";
CM_ SG_ 1221 DET_AZIMUTH_277 "Measured angle  of the detection";
CM_ SG_ 1221 DET_AZIMUTH_ERR_277 "RMSE or standard deviation of the measured angle  of the detection";
CM_ SG_ 1221 DET_ELEVATION_277 "measured elevation of the detection";
CM_ SG_ 1221 DET_ELEVATION_ERR_277 "RMSE or standard deviation of the measured elevation  of the detection";
CM_ SG_ 1221 DET_RCS_277 "Radar Cross Section or Amplitude, is a measure of how detectable an object is by radar. A larger RCS indicates that an object is more easily detected.";
CM_ SG_ 1221 DET_BI_STATIC_FLAG_277 "1 if detection is bi-static 0 otherwise";
CM_ SG_ 1221 DET_SUPER_RES_TARGET_277 "flasg is set if the detection is super resolution target";
CM_ SG_ 1221 DET_SNR_277 "The signal to noise ratio (SNR) of the radar detection";
CM_ SG_ 1221 DET_EXISTENCE_PROB_277 "Existence probability of the detection not based on history. Value does  not depend on any past experience with similar detections.
\note Use as confidence measure where a low value means less confidence
and a high value indicates strong confidence.";
CM_ SG_ 1221 DET_HVC_FLAG_277 "Core2 Vehicle clutter flag";
CM_ SG_ 1221 DET_CONFD_AZIMUTH_277 "Define the Confidence of Azimuth for Detection ";
CM_ SG_ 1221 DET_CONFD_ELEVATION_277 "Define the Confidence of Elevation for the Detection ";
CM_ SG_ 1221 DET_BI_STATIC_FLAG_278 "1 if detection is bi-static 0 otherwise";
CM_ SG_ 1221 DET_BI_STATIC_FLAG_279 "1 if detection is bi-static 0 otherwise";
CM_ SG_ 1221 DET_BI_STATIC_FLAG_280 "1 if detection is bi-static 0 otherwise";
CM_ SG_ 1221 DET_MH_SCAN_INDEX_4LSB_277_280 "Scan index of the measured detection";
CM_ SG_ 1221 DET_MH_CYCLE_COUNTER_277_280 "Detection Alive Counter";
CM_ SG_ 1222 DET_RANGE_281 " measured position  of the detection";
CM_ SG_ 1222 DET_RANGE_ERR_281 "RMSE or standard deviation of the measured angle  of the detection";
CM_ SG_ 1222 DET_RANGE_VELOCITY_281 "Radial velocity of the detection positive in direction to the sensor";
CM_ SG_ 1222 DET_RANGE_VELOCITY_ERR_281 "RMSE or standard deviation of the measure radial velocity of the detection";
CM_ SG_ 1222 DET_AZIMUTH_281 "Measured angle  of the detection";
CM_ SG_ 1222 DET_AZIMUTH_ERR_281 "RMSE or standard deviation of the measured angle  of the detection";
CM_ SG_ 1222 DET_ELEVATION_281 "measured elevation of the detection";
CM_ SG_ 1222 DET_ELEVATION_ERR_281 "RMSE or standard deviation of the measured elevation  of the detection";
CM_ SG_ 1222 DET_RCS_281 "Radar Cross Section or Amplitude, is a measure of how detectable an object is by radar. A larger RCS indicates that an object is more easily detected.";
CM_ SG_ 1222 DET_BI_STATIC_FLAG_281 "1 if detection is bi-static 0 otherwise";
CM_ SG_ 1222 DET_SUPER_RES_TARGET_281 "flasg is set if the detection is super resolution target";
CM_ SG_ 1222 DET_SNR_281 "The signal to noise ratio (SNR) of the radar detection";
CM_ SG_ 1222 DET_EXISTENCE_PROB_281 "Existence probability of the detection not based on history. Value does  not depend on any past experience with similar detections.
\note Use as confidence measure where a low value means less confidence
and a high value indicates strong confidence.";
CM_ SG_ 1222 DET_HVC_FLAG_281 "Core2 Vehicle clutter flag";
CM_ SG_ 1222 DET_CONFD_AZIMUTH_281 "Define the Confidence of Azimuth for Detection ";
CM_ SG_ 1222 DET_CONFD_ELEVATION_281 "Define the Confidence of Elevation for the Detection ";
CM_ SG_ 1222 DET_BI_STATIC_FLAG_282 "1 if detection is bi-static 0 otherwise";
CM_ SG_ 1222 DET_BI_STATIC_FLAG_283 "1 if detection is bi-static 0 otherwise";
CM_ SG_ 1222 DET_BI_STATIC_FLAG_284 "1 if detection is bi-static 0 otherwise";
CM_ SG_ 1222 DET_MH_SCAN_INDEX_4LSB_281_284 "Scan index of the measured detection";
CM_ SG_ 1222 DET_MH_CYCLE_COUNTER_281_284 "Detection Alive Counter";
CM_ SG_ 1223 DET_RANGE_285 " measured position  of the detection";
CM_ SG_ 1223 DET_RANGE_ERR_285 "RMSE or standard deviation of the measured angle  of the detection";
CM_ SG_ 1223 DET_RANGE_VELOCITY_285 "Radial velocity of the detection positive in direction to the sensor";
CM_ SG_ 1223 DET_RANGE_VELOCITY_ERR_285 "RMSE or standard deviation of the measure radial velocity of the detection";
CM_ SG_ 1223 DET_AZIMUTH_285 "Measured angle  of the detection";
CM_ SG_ 1223 DET_AZIMUTH_ERR_285 "RMSE or standard deviation of the measured angle  of the detection";
CM_ SG_ 1223 DET_ELEVATION_285 "measured elevation of the detection";
CM_ SG_ 1223 DET_ELEVATION_ERR_285 "RMSE or standard deviation of the measured elevation  of the detection";
CM_ SG_ 1223 DET_RCS_285 "Radar Cross Section or Amplitude, is a measure of how detectable an object is by radar. A larger RCS indicates that an object is more easily detected.";
CM_ SG_ 1223 DET_BI_STATIC_FLAG_285 "1 if detection is bi-static 0 otherwise";
CM_ SG_ 1223 DET_SUPER_RES_TARGET_285 "flasg is set if the detection is super resolution target";
CM_ SG_ 1223 DET_SNR_285 "The signal to noise ratio (SNR) of the radar detection";
CM_ SG_ 1223 DET_EXISTENCE_PROB_285 "Existence probability of the detection not based on history. Value does  not depend on any past experience with similar detections.
\note Use as confidence measure where a low value means less confidence
and a high value indicates strong confidence.";
CM_ SG_ 1223 DET_HVC_FLAG_285 "Core2 Vehicle clutter flag";
CM_ SG_ 1223 DET_CONFD_AZIMUTH_285 "Define the Confidence of Azimuth for Detection ";
CM_ SG_ 1223 DET_CONFD_ELEVATION_285 "Define the Confidence of Elevation for the Detection ";
CM_ SG_ 1223 DET_BI_STATIC_FLAG_286 "1 if detection is bi-static 0 otherwise";
CM_ SG_ 1223 DET_BI_STATIC_FLAG_287 "1 if detection is bi-static 0 otherwise";
CM_ SG_ 1223 DET_BI_STATIC_FLAG_288 "1 if detection is bi-static 0 otherwise";
CM_ SG_ 1223 DET_MH_SCAN_INDEX_4LSB_285_288 "Scan index of the measured detection";
CM_ SG_ 1223 DET_MH_CYCLE_COUNTER_285_288 "Detection Alive Counter";
BA_DEF_ BO_  "VFrameFormat" ENUM  "StandardCAN","ExtendedCAN","reserved","reserved","reserved","reserved","reserved","reserved","reserved","reserved","reserved","reserved","reserved","reserved","StandardCAN_FD","ExtendedCAN_FD";
BA_DEF_ BO_  "CanTpBs" INT 0 255;
BA_DEF_ BO_  "DiagConnection" INT 0 65535;
BA_DEF_ BO_  "DiagRequest" ENUM  "No","Yes";
BA_DEF_ BO_  "DiagResponse" ENUM  "No","Yes";
BA_DEF_ BO_  "DiagState" ENUM  "No","Yes";
BA_DEF_ BO_  "E2EDataId" INT 0 65535;
BA_DEF_ BO_  "E2EDataLength" INT 0 65535;
BA_DEF_ BO_  "E2EProfile" STRING ;
BA_DEF_ BO_  "EventRateOfChange" INT 10 10000;
BA_DEF_ BO_  "GenMsgCycleTime" INT 0 100000;
BA_DEF_ BO_  "GenMsgILSupport" ENUM  "No","Yes";
BA_DEF_ BO_  "GenMsgNrOfRepetition" INT 0 100;
BA_DEF_ BO_  "GenMsgSendType" ENUM  "FixedPeriodic","Event","EnabledPeriodic","NotUsed","NotUsed","EventPeriodic","NotUsed","NotUsed","NoMsgSendType";
BA_DEF_ BO_  "NetworkInitialization" ENUM  "No","Yes";
BA_DEF_ BO_  "NmAsrMessage" ENUM  "No","Yes";
BA_DEF_ BO_  "NmMessage" ENUM  "No","Yes";
BA_DEF_ BO_  "SCP_AuthInfoTxLength" INT 0 512;
BA_DEF_ BO_  "SCP_FreshnessValueLength" INT 0 512;
BA_DEF_ BO_  "SCP_FreshnessValueTxLength" INT 0 512;
BA_DEF_ BO_  "TpTxIndex" INT 0 255;
BA_DEF_ SG_  "GenSigCmt" STRING ;
BA_DEF_ SG_  "GenSigCycleTime" INT 0 0;
BA_DEF_ SG_  "GenSigSendType" ENUM  "Cyclic","OnWrite","vector_leerstring","OnChange","vector_leerstring","IfActive","vector_leerstring","NoSigSendType";
BA_DEF_ SG_  "GenSigStartValue" INT 0 1000000000;
BA_DEF_ SG_  "GenSigTimeoutTime" INT 0 0;
BA_DEF_ SG_  "GenSigVtEn" STRING ;
BA_DEF_ SG_  "GenSigVtName" STRING ;
BA_DEF_ SG_  "InvalidValue" STRING ;
BA_DEF_ SG_  "SystemSignalLongSymbol" STRING ;
BA_DEF_REL_ BU_SG_REL_  "SC_Verification" ENUM  "No","Yes";
BA_DEF_DEF_  "VFrameFormat" "StandardCAN_FD";
BA_DEF_DEF_  "CanTpBs" 255;
BA_DEF_DEF_  "DiagConnection" 0;
BA_DEF_DEF_  "DiagRequest" "No";
BA_DEF_DEF_  "DiagResponse" "No";
BA_DEF_DEF_  "DiagState" "No";
BA_DEF_DEF_  "E2EDataId" 0;
BA_DEF_DEF_  "E2EDataLength" 0;
BA_DEF_DEF_  "E2EProfile" "";
BA_DEF_DEF_  "EventRateOfChange" 10000;
BA_DEF_DEF_  "GenMsgCycleTime" 0;
BA_DEF_DEF_  "GenMsgILSupport" "Yes";
BA_DEF_DEF_  "GenMsgNrOfRepetition" 0;
BA_DEF_DEF_  "GenMsgSendType" "NoMsgSendType";
BA_DEF_DEF_  "NetworkInitialization" "Yes";
BA_DEF_DEF_  "NmAsrMessage" "No";
BA_DEF_DEF_  "NmMessage" "No";
BA_DEF_DEF_  "SCP_AuthInfoTxLength" 28;
BA_DEF_DEF_  "SCP_FreshnessValueLength" 48;
BA_DEF_DEF_  "SCP_FreshnessValueTxLength" 4;
BA_DEF_DEF_  "TpTxIndex" 0;
BA_DEF_DEF_  "GenSigCmt" "";
BA_DEF_DEF_  "GenSigCycleTime" 0;
BA_DEF_DEF_  "GenSigSendType" "NoSigSendType";
BA_DEF_DEF_  "GenSigStartValue" 0;
BA_DEF_DEF_  "GenSigTimeoutTime" 0;
BA_DEF_DEF_  "GenSigVtEn" "";
BA_DEF_DEF_  "GenSigVtName" "";
BA_DEF_DEF_  "InvalidValue" "";
BA_DEF_DEF_REL_ "SC_Verification" "No";
BA_DEF_DEF_  "SystemSignalLongSymbol" "";
BA_ "GenMsgSendType" BO_ 1208 1;
BA_ "GenMsgSendType" BO_ 1209 1;
BA_ "GenMsgSendType" BO_ 1210 1;
BA_ "GenMsgSendType" BO_ 1211 1;
BA_ "GenMsgSendType" BO_ 1212 1;
BA_ "GenMsgSendType" BO_ 1213 1;
BA_ "GenMsgSendType" BO_ 1214 1;
BA_ "GenMsgSendType" BO_ 1215 1;
BA_ "GenMsgSendType" BO_ 1216 1;
BA_ "GenMsgSendType" BO_ 1217 1;
BA_ "GenMsgSendType" BO_ 1218 1;
BA_ "GenMsgSendType" BO_ 1219 1;
BA_ "GenMsgSendType" BO_ 1220 1;
BA_ "GenMsgSendType" BO_ 1221 1;
BA_ "GenMsgSendType" BO_ 1222 1;
BA_ "GenMsgSendType" BO_ 1223 1;
BA_ "GenSigStartValue" SG_ 1208 DET_RANGE_VELOCITY_225 16384;
BA_ "GenSigStartValue" SG_ 1208 DET_RCS_225 128;
BA_ "GenSigStartValue" SG_ 1208 DET_RANGE_VELOCITY_226 16384;
BA_ "GenSigStartValue" SG_ 1208 DET_RCS_226 128;
BA_ "GenSigStartValue" SG_ 1208 DET_RANGE_VELOCITY_227 16384;
BA_ "GenSigStartValue" SG_ 1208 DET_RCS_227 128;
BA_ "GenSigStartValue" SG_ 1208 DET_RANGE_VELOCITY_228 16384;
BA_ "GenSigStartValue" SG_ 1208 DET_RCS_228 128;
BA_ "GenSigStartValue" SG_ 1209 DET_RANGE_VELOCITY_229 16384;
BA_ "GenSigStartValue" SG_ 1209 DET_RCS_229 128;
BA_ "GenSigStartValue" SG_ 1209 DET_RANGE_VELOCITY_230 16384;
BA_ "GenSigStartValue" SG_ 1209 DET_RCS_230 128;
BA_ "GenSigStartValue" SG_ 1209 DET_RANGE_VELOCITY_231 16384;
BA_ "GenSigStartValue" SG_ 1209 DET_RCS_231 128;
BA_ "GenSigStartValue" SG_ 1209 DET_RANGE_VELOCITY_232 16384;
BA_ "GenSigStartValue" SG_ 1209 DET_RCS_232 128;
BA_ "GenSigStartValue" SG_ 1210 DET_RANGE_VELOCITY_233 16384;
BA_ "GenSigStartValue" SG_ 1210 DET_RCS_233 128;
BA_ "GenSigStartValue" SG_ 1210 DET_RANGE_VELOCITY_234 16384;
BA_ "GenSigStartValue" SG_ 1210 DET_RCS_234 128;
BA_ "GenSigStartValue" SG_ 1210 DET_RANGE_VELOCITY_235 16384;
BA_ "GenSigStartValue" SG_ 1210 DET_RCS_235 128;
BA_ "GenSigStartValue" SG_ 1210 DET_RANGE_VELOCITY_236 16384;
BA_ "GenSigStartValue" SG_ 1210 DET_RCS_236 128;
BA_ "GenSigStartValue" SG_ 1211 DET_RANGE_VELOCITY_237 16384;
BA_ "GenSigStartValue" SG_ 1211 DET_RCS_237 128;
BA_ "GenSigStartValue" SG_ 1211 DET_RANGE_VELOCITY_238 16384;
BA_ "GenSigStartValue" SG_ 1211 DET_RCS_238 128;
BA_ "GenSigStartValue" SG_ 1211 DET_RANGE_VELOCITY_239 16384;
BA_ "GenSigStartValue" SG_ 1211 DET_RCS_239 128;
BA_ "GenSigStartValue" SG_ 1211 DET_RANGE_VELOCITY_240 16384;
BA_ "GenSigStartValue" SG_ 1211 DET_RCS_240 128;
BA_ "GenSigStartValue" SG_ 1212 DET_RANGE_VELOCITY_241 16384;
BA_ "GenSigStartValue" SG_ 1212 DET_RCS_241 128;
BA_ "GenSigStartValue" SG_ 1212 DET_RANGE_VELOCITY_242 16384;
BA_ "GenSigStartValue" SG_ 1212 DET_RCS_242 128;
BA_ "GenSigStartValue" SG_ 1212 DET_RANGE_VELOCITY_243 16384;
BA_ "GenSigStartValue" SG_ 1212 DET_RCS_243 128;
BA_ "GenSigStartValue" SG_ 1212 DET_RANGE_VELOCITY_244 16384;
BA_ "GenSigStartValue" SG_ 1212 DET_RCS_244 128;
BA_ "GenSigStartValue" SG_ 1213 DET_RANGE_VELOCITY_245 16384;
BA_ "GenSigStartValue" SG_ 1213 DET_RCS_245 128;
BA_ "GenSigStartValue" SG_ 1213 DET_RANGE_VELOCITY_246 16384;
BA_ "GenSigStartValue" SG_ 1213 DET_RCS_246 128;
BA_ "GenSigStartValue" SG_ 1213 DET_RANGE_VELOCITY_247 16384;
BA_ "GenSigStartValue" SG_ 1213 DET_RCS_247 128;
BA_ "GenSigStartValue" SG_ 1213 DET_RANGE_VELOCITY_248 16384;
BA_ "GenSigStartValue" SG_ 1213 DET_RCS_248 128;
BA_ "GenSigStartValue" SG_ 1214 DET_RANGE_VELOCITY_249 16384;
BA_ "GenSigStartValue" SG_ 1214 DET_RCS_249 128;
BA_ "GenSigStartValue" SG_ 1214 DET_RANGE_VELOCITY_250 16384;
BA_ "GenSigStartValue" SG_ 1214 DET_RCS_250 128;
BA_ "GenSigStartValue" SG_ 1214 DET_RANGE_VELOCITY_251 16384;
BA_ "GenSigStartValue" SG_ 1214 DET_RCS_251 128;
BA_ "GenSigStartValue" SG_ 1214 DET_RANGE_VELOCITY_252 16384;
BA_ "GenSigStartValue" SG_ 1214 DET_RCS_252 128;
BA_ "GenSigStartValue" SG_ 1215 DET_RANGE_VELOCITY_253 16384;
BA_ "GenSigStartValue" SG_ 1215 DET_RCS_253 128;
BA_ "GenSigStartValue" SG_ 1215 DET_RANGE_VELOCITY_254 16384;
BA_ "GenSigStartValue" SG_ 1215 DET_RCS_254 128;
BA_ "GenSigStartValue" SG_ 1215 DET_RANGE_VELOCITY_255 16384;
BA_ "GenSigStartValue" SG_ 1215 DET_RCS_255 128;
BA_ "GenSigStartValue" SG_ 1215 DET_RANGE_VELOCITY_256 16384;
BA_ "GenSigStartValue" SG_ 1215 DET_RCS_256 128;
BA_ "GenSigStartValue" SG_ 1216 DET_RANGE_VELOCITY_257 16384;
BA_ "GenSigStartValue" SG_ 1216 DET_RCS_257 128;
BA_ "GenSigStartValue" SG_ 1216 DET_RANGE_VELOCITY_258 16384;
BA_ "GenSigStartValue" SG_ 1216 DET_RCS_258 128;
BA_ "GenSigStartValue" SG_ 1216 DET_RANGE_VELOCITY_259 16384;
BA_ "GenSigStartValue" SG_ 1216 DET_RCS_259 128;
BA_ "GenSigStartValue" SG_ 1216 DET_RANGE_VELOCITY_260 16384;
BA_ "GenSigStartValue" SG_ 1216 DET_RCS_260 128;
BA_ "GenSigStartValue" SG_ 1217 DET_RANGE_VELOCITY_261 16384;
BA_ "GenSigStartValue" SG_ 1217 DET_RCS_261 128;
BA_ "GenSigStartValue" SG_ 1217 DET_RANGE_VELOCITY_262 16384;
BA_ "GenSigStartValue" SG_ 1217 DET_RCS_262 128;
BA_ "GenSigStartValue" SG_ 1217 DET_RANGE_VELOCITY_263 16384;
BA_ "GenSigStartValue" SG_ 1217 DET_RCS_263 128;
BA_ "GenSigStartValue" SG_ 1217 DET_RANGE_VELOCITY_264 16384;
BA_ "GenSigStartValue" SG_ 1217 DET_RCS_264 128;
BA_ "GenSigStartValue" SG_ 1218 DET_RANGE_VELOCITY_265 16384;
BA_ "GenSigStartValue" SG_ 1218 DET_RCS_265 128;
BA_ "GenSigStartValue" SG_ 1218 DET_RANGE_VELOCITY_266 16384;
BA_ "GenSigStartValue" SG_ 1218 DET_RCS_266 128;
BA_ "GenSigStartValue" SG_ 1218 DET_RANGE_VELOCITY_267 16384;
BA_ "GenSigStartValue" SG_ 1218 DET_RCS_267 128;
BA_ "GenSigStartValue" SG_ 1218 DET_RANGE_VELOCITY_268 16384;
BA_ "GenSigStartValue" SG_ 1218 DET_RCS_268 128;
BA_ "GenSigStartValue" SG_ 1219 DET_RANGE_VELOCITY_269 16384;
BA_ "GenSigStartValue" SG_ 1219 DET_RCS_269 128;
BA_ "GenSigStartValue" SG_ 1219 DET_RANGE_VELOCITY_270 16384;
BA_ "GenSigStartValue" SG_ 1219 DET_RCS_270 128;
BA_ "GenSigStartValue" SG_ 1219 DET_RANGE_VELOCITY_271 16384;
BA_ "GenSigStartValue" SG_ 1219 DET_RCS_271 128;
BA_ "GenSigStartValue" SG_ 1219 DET_RANGE_VELOCITY_272 16384;
BA_ "GenSigStartValue" SG_ 1219 DET_RCS_272 128;
BA_ "GenSigStartValue" SG_ 1220 DET_RANGE_VELOCITY_273 16384;
BA_ "GenSigStartValue" SG_ 1220 DET_RCS_273 128;
BA_ "GenSigStartValue" SG_ 1220 DET_RANGE_VELOCITY_274 16384;
BA_ "GenSigStartValue" SG_ 1220 DET_RCS_274 128;
BA_ "GenSigStartValue" SG_ 1220 DET_RANGE_VELOCITY_275 16384;
BA_ "GenSigStartValue" SG_ 1220 DET_RCS_275 128;
BA_ "GenSigStartValue" SG_ 1220 DET_RANGE_VELOCITY_276 16384;
BA_ "GenSigStartValue" SG_ 1220 DET_RCS_276 128;
BA_ "GenSigStartValue" SG_ 1221 DET_RANGE_VELOCITY_277 16384;
BA_ "GenSigStartValue" SG_ 1221 DET_RCS_277 128;
BA_ "GenSigStartValue" SG_ 1221 DET_RANGE_VELOCITY_278 16384;
BA_ "GenSigStartValue" SG_ 1221 DET_RCS_278 128;
BA_ "GenSigStartValue" SG_ 1221 DET_RANGE_VELOCITY_279 16384;
BA_ "GenSigStartValue" SG_ 1221 DET_RCS_279 128;
BA_ "GenSigStartValue" SG_ 1221 DET_RANGE_VELOCITY_280 16384;
BA_ "GenSigStartValue" SG_ 1221 DET_RCS_280 128;
BA_ "GenSigStartValue" SG_ 1222 DET_RANGE_VELOCITY_281 16384;
BA_ "GenSigStartValue" SG_ 1222 DET_RCS_281 128;
BA_ "GenSigStartValue" SG_ 1222 DET_RANGE_VELOCITY_282 16384;
BA_ "GenSigStartValue" SG_ 1222 DET_RCS_282 128;
BA_ "GenSigStartValue" SG_ 1222 DET_RANGE_VELOCITY_283 16384;
BA_ "GenSigStartValue" SG_ 1222 DET_RCS_283 128;
BA_ "GenSigStartValue" SG_ 1222 DET_RANGE_VELOCITY_284 16384;
BA_ "GenSigStartValue" SG_ 1222 DET_RCS_284 128;
BA_ "GenSigStartValue" SG_ 1223 DET_RANGE_VELOCITY_285 16384;
BA_ "GenSigStartValue" SG_ 1223 DET_RCS_285 128;
BA_ "GenSigStartValue" SG_ 1223 DET_RANGE_VELOCITY_286 16384;
BA_ "GenSigStartValue" SG_ 1223 DET_RCS_286 128;
BA_ "GenSigStartValue" SG_ 1223 DET_RANGE_VELOCITY_287 16384;
BA_ "GenSigStartValue" SG_ 1223 DET_RCS_287 128;
BA_ "GenSigStartValue" SG_ 1223 DET_RANGE_VELOCITY_288 16384;
BA_ "GenSigStartValue" SG_ 1223 DET_RCS_288 128;
VAL_ 1208 DET_CONFD_AZIMUTH_225 0 "High" 1 "MidHigh" 2 "MidLow" 3 "Low" ;
VAL_ 1208 DET_CONFD_ELEVATION_225 0 "High" 1 "MidHigh" 2 "MidLow" 3 "Low" ;
VAL_ 1208 DET_IDM_225 0 "Not_IDM_Output" 1 "IDM_Output" ;
VAL_ 1208 DET_MTD_225 0 "Not_MTD_Output" 1 "MTD_Output" ;
VAL_ 1208 DET_BELOW_RAIN_THOLD_225 0 "DetBelowRainThold" 1 "DetAboveRainThold" ;
VAL_ 1208 DET_CONFD_AZIMUTH_226 0 "High" 1 "MidHigh" 2 "MidLow" 3 "Low" ;
VAL_ 1208 DET_CONFD_ELEVATION_226 0 "High" 1 "MidHigh" 2 "MidLow" 3 "Low" ;
VAL_ 1208 DET_IDM_226 0 "Not_IDM_Output" 1 "IDM_Output" ;
VAL_ 1208 DET_MTD_226 0 "Not_MTD_Output" 1 "MTD_Output" ;
VAL_ 1208 DET_BELOW_RAIN_THOLD_226 0 "DetBelowRainThold" 1 "DetAboveRainThold" ;
VAL_ 1208 DET_CONFD_AZIMUTH_227 0 "High" 1 "MidHigh" 2 "MidLow" 3 "Low" ;
VAL_ 1208 DET_CONFD_ELEVATION_227 0 "High" 1 "MidHigh" 2 "MidLow" 3 "Low" ;
VAL_ 1208 DET_IDM_227 0 "Not_IDM_Output" 1 "IDM_Output" ;
VAL_ 1208 DET_MTD_227 0 "Not_MTD_Output" 1 "MTD_Output" ;
VAL_ 1208 DET_BELOW_RAIN_THOLD_227 0 "DetBelowRainThold" 1 "DetAboveRainThold" ;
VAL_ 1208 DET_IDM_228 0 "Not_IDM_Output" 1 "IDM_Output" ;
VAL_ 1208 DET_MTD_228 0 "Not_MTD_Output" 1 "MTD_Output" ;
VAL_ 1208 DET_BELOW_RAIN_THOLD_228 0 "DetBelowRainThold" 1 "DetAboveRainThold" ;
VAL_ 1209 DET_CONFD_AZIMUTH_229 0 "High" 1 "MidHigh" 2 "MidLow" 3 "Low" ;
VAL_ 1209 DET_CONFD_ELEVATION_229 0 "High" 1 "MidHigh" 2 "MidLow" 3 "Low" ;
VAL_ 1209 DET_IDM_229 0 "Not_IDM_Output" 1 "IDM_Output" ;
VAL_ 1209 DET_MTD_229 0 "Not_MTD_Output" 1 "MTD_Output" ;
VAL_ 1209 DET_BELOW_RAIN_THOLD_229 0 "DetBelowRainThold" 1 "DetAboveRainThold" ;
VAL_ 1209 DET_CONFD_AZIMUTH_230 0 "High" 1 "MidHigh" 2 "MidLow" 3 "Low" ;
VAL_ 1209 DET_CONFD_ELEVATION_230 0 "High" 1 "MidHigh" 2 "MidLow" 3 "Low" ;
VAL_ 1209 DET_IDM_230 0 "Not_IDM_Output" 1 "IDM_Output" ;
VAL_ 1209 DET_MTD_230 0 "Not_MTD_Output" 1 "MTD_Output" ;
VAL_ 1209 DET_BELOW_RAIN_THOLD_230 0 "DetBelowRainThold" 1 "DetAboveRainThold" ;
VAL_ 1209 DET_CONFD_AZIMUTH_231 0 "High" 1 "MidHigh" 2 "MidLow" 3 "Low" ;
VAL_ 1209 DET_CONFD_ELEVATION_231 0 "High" 1 "MidHigh" 2 "MidLow" 3 "Low" ;
VAL_ 1209 DET_IDM_231 0 "Not_IDM_Output" 1 "IDM_Output" ;
VAL_ 1209 DET_MTD_231 0 "Not_MTD_Output" 1 "MTD_Output" ;
VAL_ 1209 DET_BELOW_RAIN_THOLD_231 0 "DetBelowRainThold" 1 "DetAboveRainThold" ;
VAL_ 1209 DET_IDM_232 0 "Not_IDM_Output" 1 "IDM_Output" ;
VAL_ 1209 DET_MTD_232 0 "Not_MTD_Output" 1 "MTD_Output" ;
VAL_ 1209 DET_BELOW_RAIN_THOLD_232 0 "DetBelowRainThold" 1 "DetAboveRainThold" ;
VAL_ 1210 DET_CONFD_AZIMUTH_233 0 "High" 1 "MidHigh" 2 "MidLow" 3 "Low" ;
VAL_ 1210 DET_CONFD_ELEVATION_233 0 "High" 1 "MidHigh" 2 "MidLow" 3 "Low" ;
VAL_ 1210 DET_IDM_233 0 "Not_IDM_Output" 1 "IDM_Output" ;
VAL_ 1210 DET_MTD_233 0 "Not_MTD_Output" 1 "MTD_Output" ;
VAL_ 1210 DET_BELOW_RAIN_THOLD_233 0 "DetBelowRainThold" 1 "DetAboveRainThold" ;
VAL_ 1210 DET_CONFD_AZIMUTH_234 0 "High" 1 "MidHigh" 2 "MidLow" 3 "Low" ;
VAL_ 1210 DET_CONFD_ELEVATION_234 0 "High" 1 "MidHigh" 2 "MidLow" 3 "Low" ;
VAL_ 1210 DET_IDM_234 0 "Not_IDM_Output" 1 "IDM_Output" ;
VAL_ 1210 DET_MTD_234 0 "Not_MTD_Output" 1 "MTD_Output" ;
VAL_ 1210 DET_BELOW_RAIN_THOLD_234 0 "DetBelowRainThold" 1 "DetAboveRainThold" ;
VAL_ 1210 DET_CONFD_AZIMUTH_235 0 "High" 1 "MidHigh" 2 "MidLow" 3 "Low" ;
VAL_ 1210 DET_CONFD_ELEVATION_235 0 "High" 1 "MidHigh" 2 "MidLow" 3 "Low" ;
VAL_ 1210 DET_IDM_235 0 "Not_IDM_Output" 1 "IDM_Output" ;
VAL_ 1210 DET_MTD_235 0 "Not_MTD_Output" 1 "MTD_Output" ;
VAL_ 1210 DET_BELOW_RAIN_THOLD_235 0 "DetBelowRainThold" 1 "DetAboveRainThold" ;
VAL_ 1210 DET_IDM_236 0 "Not_IDM_Output" 1 "IDM_Output" ;
VAL_ 1210 DET_MTD_236 0 "Not_MTD_Output" 1 "MTD_Output" ;
VAL_ 1210 DET_BELOW_RAIN_THOLD_236 0 "DetBelowRainThold" 1 "DetAboveRainThold" ;
VAL_ 1211 DET_CONFD_AZIMUTH_237 0 "High" 1 "MidHigh" 2 "MidLow" 3 "Low" ;
VAL_ 1211 DET_CONFD_ELEVATION_237 0 "High" 1 "MidHigh" 2 "MidLow" 3 "Low" ;
VAL_ 1211 DET_IDM_237 0 "Not_IDM_Output" 1 "IDM_Output" ;
VAL_ 1211 DET_MTD_237 0 "Not_MTD_Output" 1 "MTD_Output" ;
VAL_ 1211 DET_BELOW_RAIN_THOLD_237 0 "DetBelowRainThold" 1 "DetAboveRainThold" ;
VAL_ 1211 DET_CONFD_AZIMUTH_238 0 "High" 1 "MidHigh" 2 "MidLow" 3 "Low" ;
VAL_ 1211 DET_CONFD_ELEVATION_238 0 "High" 1 "MidHigh" 2 "MidLow" 3 "Low" ;
VAL_ 1211 DET_IDM_238 0 "Not_IDM_Output" 1 "IDM_Output" ;
VAL_ 1211 DET_MTD_238 0 "Not_MTD_Output" 1 "MTD_Output" ;
VAL_ 1211 DET_BELOW_RAIN_THOLD_238 0 "DetBelowRainThold" 1 "DetAboveRainThold" ;
VAL_ 1211 DET_CONFD_AZIMUTH_239 0 "High" 1 "MidHigh" 2 "MidLow" 3 "Low" ;
VAL_ 1211 DET_CONFD_ELEVATION_239 0 "High" 1 "MidHigh" 2 "MidLow" 3 "Low" ;
VAL_ 1211 DET_IDM_239 0 "Not_IDM_Output" 1 "IDM_Output" ;
VAL_ 1211 DET_MTD_239 0 "Not_MTD_Output" 1 "MTD_Output" ;
VAL_ 1211 DET_BELOW_RAIN_THOLD_239 0 "DetBelowRainThold" 1 "DetAboveRainThold" ;
VAL_ 1211 DET_IDM_240 0 "Not_IDM_Output" 1 "IDM_Output" ;
VAL_ 1211 DET_MTD_240 0 "Not_MTD_Output" 1 "MTD_Output" ;
VAL_ 1211 DET_BELOW_RAIN_THOLD_240 0 "DetBelowRainThold" 1 "DetAboveRainThold" ;
VAL_ 1212 DET_CONFD_AZIMUTH_241 0 "High" 1 "MidHigh" 2 "MidLow" 3 "Low" ;
VAL_ 1212 DET_CONFD_ELEVATION_241 0 "High" 1 "MidHigh" 2 "MidLow" 3 "Low" ;
VAL_ 1212 DET_IDM_241 0 "Not_IDM_Output" 1 "IDM_Output" ;
VAL_ 1212 DET_MTD_241 0 "Not_MTD_Output" 1 "MTD_Output" ;
VAL_ 1212 DET_BELOW_RAIN_THOLD_241 0 "DetBelowRainThold" 1 "DetAboveRainThold" ;
VAL_ 1212 DET_CONFD_AZIMUTH_242 0 "High" 1 "MidHigh" 2 "MidLow" 3 "Low" ;
VAL_ 1212 DET_CONFD_ELEVATION_242 0 "High" 1 "MidHigh" 2 "MidLow" 3 "Low" ;
VAL_ 1212 DET_IDM_242 0 "Not_IDM_Output" 1 "IDM_Output" ;
VAL_ 1212 DET_MTD_242 0 "Not_MTD_Output" 1 "MTD_Output" ;
VAL_ 1212 DET_BELOW_RAIN_THOLD_242 0 "DetBelowRainThold" 1 "DetAboveRainThold" ;
VAL_ 1212 DET_CONFD_AZIMUTH_243 0 "High" 1 "MidHigh" 2 "MidLow" 3 "Low" ;
VAL_ 1212 DET_CONFD_ELEVATION_243 0 "High" 1 "MidHigh" 2 "MidLow" 3 "Low" ;
VAL_ 1212 DET_IDM_243 0 "Not_IDM_Output" 1 "IDM_Output" ;
VAL_ 1212 DET_MTD_243 0 "Not_MTD_Output" 1 "MTD_Output" ;
VAL_ 1212 DET_BELOW_RAIN_THOLD_243 0 "DetBelowRainThold" 1 "DetAboveRainThold" ;
VAL_ 1212 DET_IDM_244 0 "Not_IDM_Output" 1 "IDM_Output" ;
VAL_ 1212 DET_MTD_244 0 "Not_MTD_Output" 1 "MTD_Output" ;
VAL_ 1212 DET_BELOW_RAIN_THOLD_244 0 "DetBelowRainThold" 1 "DetAboveRainThold" ;
VAL_ 1213 DET_CONFD_AZIMUTH_245 0 "High" 1 "MidHigh" 2 "MidLow" 3 "Low" ;
VAL_ 1213 DET_CONFD_ELEVATION_245 0 "High" 1 "MidHigh" 2 "MidLow" 3 "Low" ;
VAL_ 1213 DET_IDM_245 0 "Not_IDM_Output" 1 "IDM_Output" ;
VAL_ 1213 DET_MTD_245 0 "Not_MTD_Output" 1 "MTD_Output" ;
VAL_ 1213 DET_BELOW_RAIN_THOLD_245 0 "DetBelowRainThold" 1 "DetAboveRainThold" ;
VAL_ 1213 DET_CONFD_AZIMUTH_246 0 "High" 1 "MidHigh" 2 "MidLow" 3 "Low" ;
VAL_ 1213 DET_CONFD_ELEVATION_246 0 "High" 1 "MidHigh" 2 "MidLow" 3 "Low" ;
VAL_ 1213 DET_IDM_246 0 "Not_IDM_Output" 1 "IDM_Output" ;
VAL_ 1213 DET_MTD_246 0 "Not_MTD_Output" 1 "MTD_Output" ;
VAL_ 1213 DET_BELOW_RAIN_THOLD_246 0 "DetBelowRainThold" 1 "DetAboveRainThold" ;
VAL_ 1213 DET_CONFD_AZIMUTH_247 0 "High" 1 "MidHigh" 2 "MidLow" 3 "Low" ;
VAL_ 1213 DET_CONFD_ELEVATION_247 0 "High" 1 "MidHigh" 2 "MidLow" 3 "Low" ;
VAL_ 1213 DET_IDM_247 0 "Not_IDM_Output" 1 "IDM_Output" ;
VAL_ 1213 DET_MTD_247 0 "Not_MTD_Output" 1 "MTD_Output" ;
VAL_ 1213 DET_BELOW_RAIN_THOLD_247 0 "DetBelowRainThold" 1 "DetAboveRainThold" ;
VAL_ 1213 DET_IDM_248 0 "Not_IDM_Output" 1 "IDM_Output" ;
VAL_ 1213 DET_MTD_248 0 "Not_MTD_Output" 1 "MTD_Output" ;
VAL_ 1213 DET_BELOW_RAIN_THOLD_248 0 "DetBelowRainThold" 1 "DetAboveRainThold" ;
VAL_ 1214 DET_CONFD_AZIMUTH_249 0 "High" 1 "MidHigh" 2 "MidLow" 3 "Low" ;
VAL_ 1214 DET_CONFD_ELEVATION_249 0 "High" 1 "MidHigh" 2 "MidLow" 3 "Low" ;
VAL_ 1214 DET_IDM_249 0 "Not_IDM_Output" 1 "IDM_Output" ;
VAL_ 1214 DET_MTD_249 0 "Not_MTD_Output" 1 "MTD_Output" ;
VAL_ 1214 DET_BELOW_RAIN_THOLD_249 0 "DetBelowRainThold" 1 "DetAboveRainThold" ;
VAL_ 1214 DET_CONFD_AZIMUTH_250 0 "High" 1 "MidHigh" 2 "MidLow" 3 "Low" ;
VAL_ 1214 DET_CONFD_ELEVATION_250 0 "High" 1 "MidHigh" 2 "MidLow" 3 "Low" ;
VAL_ 1214 DET_IDM_250 0 "Not_IDM_Output" 1 "IDM_Output" ;
VAL_ 1214 DET_MTD_250 0 "Not_MTD_Output" 1 "MTD_Output" ;
VAL_ 1214 DET_BELOW_RAIN_THOLD_250 0 "DetBelowRainThold" 1 "DetAboveRainThold" ;
VAL_ 1214 DET_CONFD_AZIMUTH_251 0 "High" 1 "MidHigh" 2 "MidLow" 3 "Low" ;
VAL_ 1214 DET_CONFD_ELEVATION_251 0 "High" 1 "MidHigh" 2 "MidLow" 3 "Low" ;
VAL_ 1214 DET_IDM_251 0 "Not_IDM_Output" 1 "IDM_Output" ;
VAL_ 1214 DET_MTD_251 0 "Not_MTD_Output" 1 "MTD_Output" ;
VAL_ 1214 DET_BELOW_RAIN_THOLD_251 0 "DetBelowRainThold" 1 "DetAboveRainThold" ;
VAL_ 1214 DET_IDM_252 0 "Not_IDM_Output" 1 "IDM_Output" ;
VAL_ 1214 DET_MTD_252 0 "Not_MTD_Output" 1 "MTD_Output" ;
VAL_ 1214 DET_BELOW_RAIN_THOLD_252 0 "DetBelowRainThold" 1 "DetAboveRainThold" ;
VAL_ 1215 DET_CONFD_AZIMUTH_253 0 "High" 1 "MidHigh" 2 "MidLow" 3 "Low" ;
VAL_ 1215 DET_CONFD_ELEVATION_253 0 "High" 1 "MidHigh" 2 "MidLow" 3 "Low" ;
VAL_ 1215 DET_IDM_253 0 "Not_IDM_Output" 1 "IDM_Output" ;
VAL_ 1215 DET_MTD_253 0 "Not_MTD_Output" 1 "MTD_Output" ;
VAL_ 1215 DET_BELOW_RAIN_THOLD_253 0 "DetBelowRainThold" 1 "DetAboveRainThold" ;
VAL_ 1215 DET_CONFD_AZIMUTH_254 0 "High" 1 "MidHigh" 2 "MidLow" 3 "Low" ;
VAL_ 1215 DET_CONFD_ELEVATION_254 0 "High" 1 "MidHigh" 2 "MidLow" 3 "Low" ;
VAL_ 1215 DET_IDM_254 0 "Not_IDM_Output" 1 "IDM_Output" ;
VAL_ 1215 DET_MTD_254 0 "Not_MTD_Output" 1 "MTD_Output" ;
VAL_ 1215 DET_BELOW_RAIN_THOLD_254 0 "DetBelowRainThold" 1 "DetAboveRainThold" ;
VAL_ 1215 DET_CONFD_AZIMUTH_255 0 "High" 1 "MidHigh" 2 "MidLow" 3 "Low" ;
VAL_ 1215 DET_CONFD_ELEVATION_255 0 "High" 1 "MidHigh" 2 "MidLow" 3 "Low" ;
VAL_ 1215 DET_IDM_255 0 "Not_IDM_Output" 1 "IDM_Output" ;
VAL_ 1215 DET_MTD_255 0 "Not_MTD_Output" 1 "MTD_Output" ;
VAL_ 1215 DET_BELOW_RAIN_THOLD_255 0 "DetBelowRainThold" 1 "DetAboveRainThold" ;
VAL_ 1215 DET_IDM_256 0 "Not_IDM_Output" 1 "IDM_Output" ;
VAL_ 1215 DET_MTD_256 0 "Not_MTD_Output" 1 "MTD_Output" ;
VAL_ 1215 DET_BELOW_RAIN_THOLD_256 0 "DetBelowRainThold" 1 "DetAboveRainThold" ;
VAL_ 1216 DET_CONFD_AZIMUTH_257 0 "High" 1 "MidHigh" 2 "MidLow" 3 "Low" ;
VAL_ 1216 DET_CONFD_ELEVATION_257 0 "High" 1 "MidHigh" 2 "MidLow" 3 "Low" ;
VAL_ 1216 DET_IDM_257 0 "Not_IDM_Output" 1 "IDM_Output" ;
VAL_ 1216 DET_MTD_257 0 "Not_MTD_Output" 1 "MTD_Output" ;
VAL_ 1216 DET_BELOW_RAIN_THOLD_257 0 "DetBelowRainThold" 1 "DetAboveRainThold" ;
VAL_ 1216 DET_CONFD_AZIMUTH_258 0 "High" 1 "MidHigh" 2 "MidLow" 3 "Low" ;
VAL_ 1216 DET_CONFD_ELEVATION_258 0 "High" 1 "MidHigh" 2 "MidLow" 3 "Low" ;
VAL_ 1216 DET_IDM_258 0 "Not_IDM_Output" 1 "IDM_Output" ;
VAL_ 1216 DET_MTD_258 0 "Not_MTD_Output" 1 "MTD_Output" ;
VAL_ 1216 DET_BELOW_RAIN_THOLD_258 0 "DetBelowRainThold" 1 "DetAboveRainThold" ;
VAL_ 1216 DET_CONFD_AZIMUTH_259 0 "High" 1 "MidHigh" 2 "MidLow" 3 "Low" ;
VAL_ 1216 DET_CONFD_ELEVATION_259 0 "High" 1 "MidHigh" 2 "MidLow" 3 "Low" ;
VAL_ 1216 DET_IDM_259 0 "Not_IDM_Output" 1 "IDM_Output" ;
VAL_ 1216 DET_MTD_259 0 "Not_MTD_Output" 1 "MTD_Output" ;
VAL_ 1216 DET_BELOW_RAIN_THOLD_259 0 "DetBelowRainThold" 1 "DetAboveRainThold" ;
VAL_ 1216 DET_IDM_260 0 "Not_IDM_Output" 1 "IDM_Output" ;
VAL_ 1216 DET_MTD_260 0 "Not_MTD_Output" 1 "MTD_Output" ;
VAL_ 1216 DET_BELOW_RAIN_THOLD_260 0 "DetBelowRainThold" 1 "DetAboveRainThold" ;
VAL_ 1217 DET_CONFD_AZIMUTH_261 0 "High" 1 "MidHigh" 2 "MidLow" 3 "Low" ;
VAL_ 1217 DET_CONFD_ELEVATION_261 0 "High" 1 "MidHigh" 2 "MidLow" 3 "Low" ;
VAL_ 1217 DET_IDM_261 0 "Not_IDM_Output" 1 "IDM_Output" ;
VAL_ 1217 DET_MTD_261 0 "Not_MTD_Output" 1 "MTD_Output" ;
VAL_ 1217 DET_BELOW_RAIN_THOLD_261 0 "DetBelowRainThold" 1 "DetAboveRainThold" ;
VAL_ 1217 DET_CONFD_AZIMUTH_262 0 "High" 1 "MidHigh" 2 "MidLow" 3 "Low" ;
VAL_ 1217 DET_CONFD_ELEVATION_262 0 "High" 1 "MidHigh" 2 "MidLow" 3 "Low" ;
VAL_ 1217 DET_IDM_262 0 "Not_IDM_Output" 1 "IDM_Output" ;
VAL_ 1217 DET_MTD_262 0 "Not_MTD_Output" 1 "MTD_Output" ;
VAL_ 1217 DET_BELOW_RAIN_THOLD_262 0 "DetBelowRainThold" 1 "DetAboveRainThold" ;
VAL_ 1217 DET_CONFD_AZIMUTH_263 0 "High" 1 "MidHigh" 2 "MidLow" 3 "Low" ;
VAL_ 1217 DET_CONFD_ELEVATION_263 0 "High" 1 "MidHigh" 2 "MidLow" 3 "Low" ;
VAL_ 1217 DET_IDM_263 0 "Not_IDM_Output" 1 "IDM_Output" ;
VAL_ 1217 DET_MTD_263 0 "Not_MTD_Output" 1 "MTD_Output" ;
VAL_ 1217 DET_BELOW_RAIN_THOLD_263 0 "DetBelowRainThold" 1 "DetAboveRainThold" ;
VAL_ 1217 DET_IDM_264 0 "Not_IDM_Output" 1 "IDM_Output" ;
VAL_ 1217 DET_MTD_264 0 "Not_MTD_Output" 1 "MTD_Output" ;
VAL_ 1217 DET_BELOW_RAIN_THOLD_264 0 "DetBelowRainThold" 1 "DetAboveRainThold" ;
VAL_ 1218 DET_CONFD_AZIMUTH_265 0 "High" 1 "MidHigh" 2 "MidLow" 3 "Low" ;
VAL_ 1218 DET_CONFD_ELEVATION_265 0 "High" 1 "MidHigh" 2 "MidLow" 3 "Low" ;
VAL_ 1218 DET_IDM_265 0 "Not_IDM_Output" 1 "IDM_Output" ;
VAL_ 1218 DET_MTD_265 0 "Not_MTD_Output" 1 "MTD_Output" ;
VAL_ 1218 DET_BELOW_RAIN_THOLD_265 0 "DetBelowRainThold" 1 "DetAboveRainThold" ;
VAL_ 1218 DET_CONFD_AZIMUTH_266 0 "High" 1 "MidHigh" 2 "MidLow" 3 "Low" ;
VAL_ 1218 DET_CONFD_ELEVATION_266 0 "High" 1 "MidHigh" 2 "MidLow" 3 "Low" ;
VAL_ 1218 DET_IDM_266 0 "Not_IDM_Output" 1 "IDM_Output" ;
VAL_ 1218 DET_MTD_266 0 "Not_MTD_Output" 1 "MTD_Output" ;
VAL_ 1218 DET_BELOW_RAIN_THOLD_266 0 "DetBelowRainThold" 1 "DetAboveRainThold" ;
VAL_ 1218 DET_CONFD_AZIMUTH_267 0 "High" 1 "MidHigh" 2 "MidLow" 3 "Low" ;
VAL_ 1218 DET_CONFD_ELEVATION_267 0 "High" 1 "MidHigh" 2 "MidLow" 3 "Low" ;
VAL_ 1218 DET_IDM_267 0 "Not_IDM_Output" 1 "IDM_Output" ;
VAL_ 1218 DET_MTD_267 0 "Not_MTD_Output" 1 "MTD_Output" ;
VAL_ 1218 DET_BELOW_RAIN_THOLD_267 0 "DetBelowRainThold" 1 "DetAboveRainThold" ;
VAL_ 1218 DET_IDM_268 0 "Not_IDM_Output" 1 "IDM_Output" ;
VAL_ 1218 DET_MTD_268 0 "Not_MTD_Output" 1 "MTD_Output" ;
VAL_ 1218 DET_BELOW_RAIN_THOLD_268 0 "DetBelowRainThold" 1 "DetAboveRainThold" ;
VAL_ 1219 DET_CONFD_AZIMUTH_269 0 "High" 1 "MidHigh" 2 "MidLow" 3 "Low" ;
VAL_ 1219 DET_CONFD_ELEVATION_269 0 "High" 1 "MidHigh" 2 "MidLow" 3 "Low" ;
VAL_ 1219 DET_IDM_269 0 "Not_IDM_Output" 1 "IDM_Output" ;
VAL_ 1219 DET_MTD_269 0 "Not_MTD_Output" 1 "MTD_Output" ;
VAL_ 1219 DET_BELOW_RAIN_THOLD_269 0 "DetBelowRainThold" 1 "DetAboveRainThold" ;
VAL_ 1219 DET_CONFD_AZIMUTH_270 0 "High" 1 "MidHigh" 2 "MidLow" 3 "Low" ;
VAL_ 1219 DET_CONFD_ELEVATION_270 0 "High" 1 "MidHigh" 2 "MidLow" 3 "Low" ;
VAL_ 1219 DET_IDM_270 0 "Not_IDM_Output" 1 "IDM_Output" ;
VAL_ 1219 DET_MTD_270 0 "Not_MTD_Output" 1 "MTD_Output" ;
VAL_ 1219 DET_BELOW_RAIN_THOLD_270 0 "DetBelowRainThold" 1 "DetAboveRainThold" ;
VAL_ 1219 DET_CONFD_AZIMUTH_271 0 "High" 1 "MidHigh" 2 "MidLow" 3 "Low" ;
VAL_ 1219 DET_CONFD_ELEVATION_271 0 "High" 1 "MidHigh" 2 "MidLow" 3 "Low" ;
VAL_ 1219 DET_IDM_271 0 "Not_IDM_Output" 1 "IDM_Output" ;
VAL_ 1219 DET_MTD_271 0 "Not_MTD_Output" 1 "MTD_Output" ;
VAL_ 1219 DET_BELOW_RAIN_THOLD_271 0 "DetBelowRainThold" 1 "DetAboveRainThold" ;
VAL_ 1219 DET_IDM_272 0 "Not_IDM_Output" 1 "IDM_Output" ;
VAL_ 1219 DET_MTD_272 0 "Not_MTD_Output" 1 "MTD_Output" ;
VAL_ 1219 DET_BELOW_RAIN_THOLD_272 0 "DetBelowRainThold" 1 "DetAboveRainThold" ;
VAL_ 1220 DET_CONFD_AZIMUTH_273 0 "High" 1 "MidHigh" 2 "MidLow" 3 "Low" ;
VAL_ 1220 DET_CONFD_ELEVATION_273 0 "High" 1 "MidHigh" 2 "MidLow" 3 "Low" ;
VAL_ 1220 DET_IDM_273 0 "Not_IDM_Output" 1 "IDM_Output" ;
VAL_ 1220 DET_MTD_273 0 "Not_MTD_Output" 1 "MTD_Output" ;
VAL_ 1220 DET_BELOW_RAIN_THOLD_273 0 "DetBelowRainThold" 1 "DetAboveRainThold" ;
VAL_ 1220 DET_CONFD_AZIMUTH_274 0 "High" 1 "MidHigh" 2 "MidLow" 3 "Low" ;
VAL_ 1220 DET_CONFD_ELEVATION_274 0 "High" 1 "MidHigh" 2 "MidLow" 3 "Low" ;
VAL_ 1220 DET_IDM_274 0 "Not_IDM_Output" 1 "IDM_Output" ;
VAL_ 1220 DET_MTD_274 0 "Not_MTD_Output" 1 "MTD_Output" ;
VAL_ 1220 DET_BELOW_RAIN_THOLD_274 0 "DetBelowRainThold" 1 "DetAboveRainThold" ;
VAL_ 1220 DET_CONFD_AZIMUTH_275 0 "High" 1 "MidHigh" 2 "MidLow" 3 "Low" ;
VAL_ 1220 DET_CONFD_ELEVATION_275 0 "High" 1 "MidHigh" 2 "MidLow" 3 "Low" ;
VAL_ 1220 DET_IDM_275 0 "Not_IDM_Output" 1 "IDM_Output" ;
VAL_ 1220 DET_MTD_275 0 "Not_MTD_Output" 1 "MTD_Output" ;
VAL_ 1220 DET_BELOW_RAIN_THOLD_275 0 "DetBelowRainThold" 1 "DetAboveRainThold" ;
VAL_ 1220 DET_IDM_276 0 "Not_IDM_Output" 1 "IDM_Output" ;
VAL_ 1220 DET_MTD_276 0 "Not_MTD_Output" 1 "MTD_Output" ;
VAL_ 1220 DET_BELOW_RAIN_THOLD_276 0 "DetBelowRainThold" 1 "DetAboveRainThold" ;
VAL_ 1221 DET_CONFD_AZIMUTH_277 0 "High" 1 "MidHigh" 2 "MidLow" 3 "Low" ;
VAL_ 1221 DET_CONFD_ELEVATION_277 0 "High" 1 "MidHigh" 2 "MidLow" 3 "Low" ;
VAL_ 1221 DET_IDM_277 0 "Not_IDM_Output" 1 "IDM_Output" ;
VAL_ 1221 DET_MTD_277 0 "Not_MTD_Output" 1 "MTD_Output" ;
VAL_ 1221 DET_BELOW_RAIN_THOLD_277 0 "DetBelowRainThold" 1 "DetAboveRainThold" ;
VAL_ 1221 DET_CONFD_AZIMUTH_278 0 "High" 1 "MidHigh" 2 "MidLow" 3 "Low" ;
VAL_ 1221 DET_CONFD_ELEVATION_278 0 "High" 1 "MidHigh" 2 "MidLow" 3 "Low" ;
VAL_ 1221 DET_IDM_278 0 "Not_IDM_Output" 1 "IDM_Output" ;
VAL_ 1221 DET_MTD_278 0 "Not_MTD_Output" 1 "MTD_Output" ;
VAL_ 1221 DET_BELOW_RAIN_THOLD_278 0 "DetBelowRainThold" 1 "DetAboveRainThold" ;
VAL_ 1221 DET_CONFD_AZIMUTH_279 0 "High" 1 "MidHigh" 2 "MidLow" 3 "Low" ;
VAL_ 1221 DET_CONFD_ELEVATION_279 0 "High" 1 "MidHigh" 2 "MidLow" 3 "Low" ;
VAL_ 1221 DET_IDM_279 0 "Not_IDM_Output" 1 "IDM_Output" ;
VAL_ 1221 DET_MTD_279 0 "Not_MTD_Output" 1 "MTD_Output" ;
VAL_ 1221 DET_BELOW_RAIN_THOLD_279 0 "DetBelowRainThold" 1 "DetAboveRainThold" ;
VAL_ 1221 DET_IDM_280 0 "Not_IDM_Output" 1 "IDM_Output" ;
VAL_ 1221 DET_MTD_280 0 "Not_MTD_Output" 1 "MTD_Output" ;
VAL_ 1221 DET_BELOW_RAIN_THOLD_280 0 "DetBelowRainThold" 1 "DetAboveRainThold" ;
VAL_ 1222 DET_CONFD_AZIMUTH_281 0 "High" 1 "MidHigh" 2 "MidLow" 3 "Low" ;
VAL_ 1222 DET_CONFD_ELEVATION_281 0 "High" 1 "MidHigh" 2 "MidLow" 3 "Low" ;
VAL_ 1222 DET_IDM_281 0 "Not_IDM_Output" 1 "IDM_Output" ;
VAL_ 1222 DET_MTD_281 0 "Not_MTD_Output" 1 "MTD_Output" ;
VAL_ 1222 DET_BELOW_RAIN_THOLD_281 0 "DetBelowRainThold" 1 "DetAboveRainThold" ;
VAL_ 1222 DET_CONFD_AZIMUTH_282 0 "High" 1 "MidHigh" 2 "MidLow" 3 "Low" ;
VAL_ 1222 DET_CONFD_ELEVATION_282 0 "High" 1 "MidHigh" 2 "MidLow" 3 "Low" ;
VAL_ 1222 DET_IDM_282 0 "Not_IDM_Output" 1 "IDM_Output" ;
VAL_ 1222 DET_MTD_282 0 "Not_MTD_Output" 1 "MTD_Output" ;
VAL_ 1222 DET_BELOW_RAIN_THOLD_282 0 "DetBelowRainThold" 1 "DetAboveRainThold" ;
VAL_ 1222 DET_CONFD_AZIMUTH_283 0 "High" 1 "MidHigh" 2 "MidLow" 3 "Low" ;
VAL_ 1222 DET_CONFD_ELEVATION_283 0 "High" 1 "MidHigh" 2 "MidLow" 3 "Low" ;
VAL_ 1222 DET_IDM_283 0 "Not_IDM_Output" 1 "IDM_Output" ;
VAL_ 1222 DET_MTD_283 0 "Not_MTD_Output" 1 "MTD_Output" ;
VAL_ 1222 DET_BELOW_RAIN_THOLD_283 0 "DetBelowRainThold" 1 "DetAboveRainThold" ;
VAL_ 1222 DET_IDM_284 0 "Not_IDM_Output" 1 "IDM_Output" ;
VAL_ 1222 DET_MTD_284 0 "Not_MTD_Output" 1 "MTD_Output" ;
VAL_ 1222 DET_BELOW_RAIN_THOLD_284 0 "DetBelowRainThold" 1 "DetAboveRainThold" ;
VAL_ 1223 DET_CONFD_AZIMUTH_285 0 "High" 1 "MidHigh" 2 "MidLow" 3 "Low" ;
VAL_ 1223 DET_CONFD_ELEVATION_285 0 "High" 1 "MidHigh" 2 "MidLow" 3 "Low" ;
VAL_ 1223 DET_IDM_285 0 "Not_IDM_Output" 1 "IDM_Output" ;
VAL_ 1223 DET_MTD_285 0 "Not_MTD_Output" 1 "MTD_Output" ;
VAL_ 1223 DET_BELOW_RAIN_THOLD_285 0 "DetBelowRainThold" 1 "DetAboveRainThold" ;
VAL_ 1223 DET_CONFD_AZIMUTH_286 0 "High" 1 "MidHigh" 2 "MidLow" 3 "Low" ;
VAL_ 1223 DET_CONFD_ELEVATION_286 0 "High" 1 "MidHigh" 2 "MidLow" 3 "Low" ;
VAL_ 1223 DET_IDM_286 0 "Not_IDM_Output" 1 "IDM_Output" ;
VAL_ 1223 DET_MTD_286 0 "Not_MTD_Output" 1 "MTD_Output" ;
VAL_ 1223 DET_BELOW_RAIN_THOLD_286 0 "DetBelowRainThold" 1 "DetAboveRainThold" ;
VAL_ 1223 DET_CONFD_AZIMUTH_287 0 "High" 1 "MidHigh" 2 "MidLow" 3 "Low" ;
VAL_ 1223 DET_CONFD_ELEVATION_287 0 "High" 1 "MidHigh" 2 "MidLow" 3 "Low" ;
VAL_ 1223 DET_IDM_287 0 "Not_IDM_Output" 1 "IDM_Output" ;
VAL_ 1223 DET_MTD_287 0 "Not_MTD_Output" 1 "MTD_Output" ;
VAL_ 1223 DET_BELOW_RAIN_THOLD_287 0 "DetBelowRainThold" 1 "DetAboveRainThold" ;
VAL_ 1223 DET_IDM_288 0 "Not_IDM_Output" 1 "IDM_Output" ;
VAL_ 1223 DET_MTD_288 0 "Not_MTD_Output" 1 "MTD_Output" ;
VAL_ 1223 DET_BELOW_RAIN_THOLD_288 0 "DetBelowRainThold" 1 "DetAboveRainThold" ;
SIG_GROUP_ 1208 Detections_225_228 1 : DET_PROB_1STAZHYPO_225 DET_PROB_1STAZHYPO_226 DET_PROB_1STAZHYPO_227 DET_PROB_1STAZHYPO_228 DET_IDM_225 DET_IDM_226 DET_IDM_227 DET_IDM_228 DET_MTD_228 DET_MTD_227 DET_MTD_226 DET_MTD_225 DET_BELOW_RAIN_THOLD_228 DET_BELOW_RAIN_THOLD_227 DET_BELOW_RAIN_THOLD_226 DET_BELOW_RAIN_THOLD_225 DET_MH_CRC16_225_228 DET_MH_CYCLE_COUNTER_225_228 DET_MH_SCAN_INDEX_4LSB_225_228 DET_CONFD_ELEVATION_225 DET_CONFD_AZIMUTH_225 DET_HVC_FLAG_225 DET_EXISTENCE_PROB_225 DET_SNR_225 DET_SUPER_RES_TARGET_225 DET_BI_STATIC_FLAG_225 DET_RCS_225 DET_ELEVATION_ERR_225 DET_ELEVATION_225 DET_AZIMUTH_ERR_225 DET_AZIMUTH_225 DET_RANGE_VELOCITY_ERR_225 DET_RANGE_VELOCITY_225 DET_RANGE_ERR_225 DET_RANGE_225 DET_CONFD_ELEVATION_226 DET_CONFD_AZIMUTH_226 DET_HVC_FLAG_226 DET_EXISTENCE_PROB_226 DET_SNR_226 DET_SUPER_RES_TARGET_226 DET_BI_STATIC_FLAG_226 DET_RCS_226 DET_ELEVATION_ERR_226 DET_ELEVATION_226 DET_AZIMUTH_ERR_226 DET_AZIMUTH_226 DET_RANGE_VELOCITY_ERR_226 DET_RANGE_VELOCITY_226 DET_RANGE_ERR_226 DET_RANGE_226 DET_CONFD_ELEVATION_227 DET_CONFD_AZIMUTH_227 DET_HVC_FLAG_227 DET_EXISTENCE_PROB_227 DET_SNR_227 DET_SUPER_RES_TARGET_227 DET_BI_STATIC_FLAG_227 DET_RCS_227 DET_ELEVATION_ERR_227 DET_ELEVATION_227 DET_AZIMUTH_ERR_227 DET_AZIMUTH_227 DET_RANGE_VELOCITY_ERR_227 DET_RANGE_VELOCITY_227 DET_RANGE_ERR_227 DET_RANGE_227 DET_CONFD_ELEVATION_228 DET_CONFD_AZIMUTH_228 DET_HVC_FLAG_228 DET_EXISTENCE_PROB_228 DET_SNR_228 DET_SUPER_RES_TARGET_228 DET_BI_STATIC_FLAG_228 DET_RCS_228 DET_ELEVATION_ERR_228 DET_ELEVATION_228 DET_AZIMUTH_ERR_228 DET_AZIMUTH_228 DET_RANGE_VELOCITY_ERR_228 DET_RANGE_VELOCITY_228 DET_RANGE_ERR_228 DET_RANGE_228;
SIG_GROUP_ 1209 Detections_229_232 1 : DET_PROB_1STAZHYPO_229 DET_PROB_1STAZHYPO_230 DET_PROB_1STAZHYPO_231 DET_PROB_1STAZHYPO_232 DET_IDM_229 DET_IDM_230 DET_IDM_231 DET_IDM_232 DET_MTD_232 DET_MTD_231 DET_MTD_230 DET_MTD_229 DET_BELOW_RAIN_THOLD_232 DET_BELOW_RAIN_THOLD_231 DET_BELOW_RAIN_THOLD_230 DET_BELOW_RAIN_THOLD_229 DET_MH_CRC16_229_232 DET_MH_CYCLE_COUNTER_229_232 DET_MH_SCAN_INDEX_4LSB_229_232 DET_CONFD_ELEVATION_229 DET_CONFD_AZIMUTH_229 DET_HVC_FLAG_229 DET_EXISTENCE_PROB_229 DET_SNR_229 DET_SUPER_RES_TARGET_229 DET_BI_STATIC_FLAG_229 DET_RCS_229 DET_ELEVATION_ERR_229 DET_ELEVATION_229 DET_AZIMUTH_ERR_229 DET_AZIMUTH_229 DET_RANGE_VELOCITY_ERR_229 DET_RANGE_VELOCITY_229 DET_RANGE_ERR_229 DET_RANGE_229 DET_CONFD_ELEVATION_230 DET_CONFD_AZIMUTH_230 DET_HVC_FLAG_230 DET_EXISTENCE_PROB_230 DET_SNR_230 DET_SUPER_RES_TARGET_230 DET_BI_STATIC_FLAG_230 DET_RCS_230 DET_ELEVATION_ERR_230 DET_ELEVATION_230 DET_AZIMUTH_ERR_230 DET_AZIMUTH_230 DET_RANGE_VELOCITY_ERR_230 DET_RANGE_VELOCITY_230 DET_RANGE_ERR_230 DET_RANGE_230 DET_CONFD_ELEVATION_231 DET_CONFD_AZIMUTH_231 DET_HVC_FLAG_231 DET_EXISTENCE_PROB_231 DET_SNR_231 DET_SUPER_RES_TARGET_231 DET_BI_STATIC_FLAG_231 DET_RCS_231 DET_ELEVATION_ERR_231 DET_ELEVATION_231 DET_AZIMUTH_ERR_231 DET_AZIMUTH_231 DET_RANGE_VELOCITY_ERR_231 DET_RANGE_VELOCITY_231 DET_RANGE_ERR_231 DET_RANGE_231 DET_CONFD_ELEVATION_232 DET_CONFD_AZIMUTH_232 DET_HVC_FLAG_232 DET_EXISTENCE_PROB_232 DET_SNR_232 DET_SUPER_RES_TARGET_232 DET_BI_STATIC_FLAG_232 DET_RCS_232 DET_ELEVATION_ERR_232 DET_ELEVATION_232 DET_AZIMUTH_ERR_232 DET_AZIMUTH_232 DET_RANGE_VELOCITY_ERR_232 DET_RANGE_VELOCITY_232 DET_RANGE_ERR_232 DET_RANGE_232;
SIG_GROUP_ 1210 Detections_233_236 1 : DET_PROB_1STAZHYPO_233 DET_PROB_1STAZHYPO_234 DET_PROB_1STAZHYPO_235 DET_PROB_1STAZHYPO_236 DET_IDM_233 DET_IDM_234 DET_IDM_235 DET_IDM_236 DET_MTD_236 DET_MTD_235 DET_MTD_234 DET_MTD_233 DET_BELOW_RAIN_THOLD_236 DET_BELOW_RAIN_THOLD_235 DET_BELOW_RAIN_THOLD_234 DET_BELOW_RAIN_THOLD_233 DET_MH_CRC16_233_236 DET_MH_CYCLE_COUNTER_233_236 DET_MH_SCAN_INDEX_4LSB_233_236 DET_CONFD_ELEVATION_233 DET_CONFD_AZIMUTH_233 DET_HVC_FLAG_233 DET_EXISTENCE_PROB_233 DET_SNR_233 DET_SUPER_RES_TARGET_233 DET_BI_STATIC_FLAG_233 DET_RCS_233 DET_ELEVATION_ERR_233 DET_ELEVATION_233 DET_AZIMUTH_ERR_233 DET_AZIMUTH_233 DET_RANGE_VELOCITY_ERR_233 DET_RANGE_VELOCITY_233 DET_RANGE_ERR_233 DET_RANGE_233 DET_CONFD_ELEVATION_234 DET_CONFD_AZIMUTH_234 DET_HVC_FLAG_234 DET_EXISTENCE_PROB_234 DET_SNR_234 DET_SUPER_RES_TARGET_234 DET_BI_STATIC_FLAG_234 DET_RCS_234 DET_ELEVATION_ERR_234 DET_ELEVATION_234 DET_AZIMUTH_ERR_234 DET_AZIMUTH_234 DET_RANGE_VELOCITY_ERR_234 DET_RANGE_VELOCITY_234 DET_RANGE_ERR_234 DET_RANGE_234 DET_CONFD_ELEVATION_235 DET_CONFD_AZIMUTH_235 DET_HVC_FLAG_235 DET_EXISTENCE_PROB_235 DET_SNR_235 DET_SUPER_RES_TARGET_235 DET_BI_STATIC_FLAG_235 DET_RCS_235 DET_ELEVATION_ERR_235 DET_ELEVATION_235 DET_AZIMUTH_ERR_235 DET_AZIMUTH_235 DET_RANGE_VELOCITY_ERR_235 DET_RANGE_VELOCITY_235 DET_RANGE_ERR_235 DET_RANGE_235 DET_CONFD_ELEVATION_236 DET_CONFD_AZIMUTH_236 DET_HVC_FLAG_236 DET_EXISTENCE_PROB_236 DET_SNR_236 DET_SUPER_RES_TARGET_236 DET_BI_STATIC_FLAG_236 DET_RCS_236 DET_ELEVATION_ERR_236 DET_ELEVATION_236 DET_AZIMUTH_ERR_236 DET_AZIMUTH_236 DET_RANGE_VELOCITY_ERR_236 DET_RANGE_VELOCITY_236 DET_RANGE_ERR_236 DET_RANGE_236;
SIG_GROUP_ 1211 Detections_237_240 1 : DET_PROB_1STAZHYPO_237 DET_PROB_1STAZHYPO_238 DET_PROB_1STAZHYPO_239 DET_PROB_1STAZHYPO_240 DET_IDM_237 DET_IDM_238 DET_IDM_239 DET_IDM_240 DET_MTD_240 DET_MTD_239 DET_MTD_238 DET_MTD_237 DET_BELOW_RAIN_THOLD_240 DET_BELOW_RAIN_THOLD_239 DET_BELOW_RAIN_THOLD_238 DET_BELOW_RAIN_THOLD_237 DET_MH_CRC16_237_240 DET_MH_CYCLE_COUNTER_237_240 DET_MH_SCAN_INDEX_4LSB_237_240 DET_CONFD_ELEVATION_237 DET_CONFD_AZIMUTH_237 DET_HVC_FLAG_237 DET_EXISTENCE_PROB_237 DET_SNR_237 DET_SUPER_RES_TARGET_237 DET_BI_STATIC_FLAG_237 DET_RCS_237 DET_ELEVATION_ERR_237 DET_ELEVATION_237 DET_AZIMUTH_ERR_237 DET_AZIMUTH_237 DET_RANGE_VELOCITY_ERR_237 DET_RANGE_VELOCITY_237 DET_RANGE_ERR_237 DET_RANGE_237 DET_CONFD_ELEVATION_238 DET_CONFD_AZIMUTH_238 DET_HVC_FLAG_238 DET_EXISTENCE_PROB_238 DET_SNR_238 DET_SUPER_RES_TARGET_238 DET_BI_STATIC_FLAG_238 DET_RCS_238 DET_ELEVATION_ERR_238 DET_ELEVATION_238 DET_AZIMUTH_ERR_238 DET_AZIMUTH_238 DET_RANGE_VELOCITY_ERR_238 DET_RANGE_VELOCITY_238 DET_RANGE_ERR_238 DET_RANGE_238 DET_CONFD_ELEVATION_239 DET_CONFD_AZIMUTH_239 DET_HVC_FLAG_239 DET_EXISTENCE_PROB_239 DET_SNR_239 DET_SUPER_RES_TARGET_239 DET_BI_STATIC_FLAG_239 DET_RCS_239 DET_ELEVATION_ERR_239 DET_ELEVATION_239 DET_AZIMUTH_ERR_239 DET_AZIMUTH_239 DET_RANGE_VELOCITY_ERR_239 DET_RANGE_VELOCITY_239 DET_RANGE_ERR_239 DET_RANGE_239 DET_CONFD_ELEVATION_240 DET_CONFD_AZIMUTH_240 DET_HVC_FLAG_240 DET_EXISTENCE_PROB_240 DET_SNR_240 DET_SUPER_RES_TARGET_240 DET_BI_STATIC_FLAG_240 DET_RCS_240 DET_ELEVATION_ERR_240 DET_ELEVATION_240 DET_AZIMUTH_ERR_240 DET_AZIMUTH_240 DET_RANGE_VELOCITY_ERR_240 DET_RANGE_VELOCITY_240 DET_RANGE_ERR_240 DET_RANGE_240;
SIG_GROUP_ 1212 Detections_241_244 1 : DET_PROB_1STAZHYPO_241 DET_PROB_1STAZHYPO_242 DET_PROB_1STAZHYPO_243 DET_PROB_1STAZHYPO_244 DET_IDM_241 DET_IDM_242 DET_IDM_243 DET_IDM_244 DET_MTD_244 DET_MTD_243 DET_MTD_242 DET_MTD_241 DET_BELOW_RAIN_THOLD_244 DET_BELOW_RAIN_THOLD_243 DET_BELOW_RAIN_THOLD_242 DET_BELOW_RAIN_THOLD_241 DET_MH_CRC16_241_244 DET_MH_CYCLE_COUNTER_241_244 DET_MH_SCAN_INDEX_4LSB_241_244 DET_CONFD_ELEVATION_241 DET_CONFD_AZIMUTH_241 DET_HVC_FLAG_241 DET_EXISTENCE_PROB_241 DET_SNR_241 DET_SUPER_RES_TARGET_241 DET_BI_STATIC_FLAG_241 DET_RCS_241 DET_ELEVATION_ERR_241 DET_ELEVATION_241 DET_AZIMUTH_ERR_241 DET_AZIMUTH_241 DET_RANGE_VELOCITY_ERR_241 DET_RANGE_VELOCITY_241 DET_RANGE_ERR_241 DET_RANGE_241 DET_CONFD_ELEVATION_242 DET_CONFD_AZIMUTH_242 DET_HVC_FLAG_242 DET_EXISTENCE_PROB_242 DET_SNR_242 DET_SUPER_RES_TARGET_242 DET_BI_STATIC_FLAG_242 DET_RCS_242 DET_ELEVATION_ERR_242 DET_ELEVATION_242 DET_AZIMUTH_ERR_242 DET_AZIMUTH_242 DET_RANGE_VELOCITY_ERR_242 DET_RANGE_VELOCITY_242 DET_RANGE_ERR_242 DET_RANGE_242 DET_CONFD_ELEVATION_243 DET_CONFD_AZIMUTH_243 DET_HVC_FLAG_243 DET_EXISTENCE_PROB_243 DET_SNR_243 DET_SUPER_RES_TARGET_243 DET_BI_STATIC_FLAG_243 DET_RCS_243 DET_ELEVATION_ERR_243 DET_ELEVATION_243 DET_AZIMUTH_ERR_243 DET_AZIMUTH_243 DET_RANGE_VELOCITY_ERR_243 DET_RANGE_VELOCITY_243 DET_RANGE_ERR_243 DET_RANGE_243 DET_CONFD_ELEVATION_244 DET_CONFD_AZIMUTH_244 DET_HVC_FLAG_244 DET_EXISTENCE_PROB_244 DET_SNR_244 DET_SUPER_RES_TARGET_244 DET_BI_STATIC_FLAG_244 DET_RCS_244 DET_ELEVATION_ERR_244 DET_ELEVATION_244 DET_AZIMUTH_ERR_244 DET_AZIMUTH_244 DET_RANGE_VELOCITY_ERR_244 DET_RANGE_VELOCITY_244 DET_RANGE_ERR_244 DET_RANGE_244;
SIG_GROUP_ 1213 Detections_245_248 1 : DET_PROB_1STAZHYPO_245 DET_PROB_1STAZHYPO_246 DET_PROB_1STAZHYPO_247 DET_PROB_1STAZHYPO_248 DET_IDM_245 DET_IDM_246 DET_IDM_247 DET_IDM_248 DET_MTD_248 DET_MTD_247 DET_MTD_246 DET_MTD_245 DET_BELOW_RAIN_THOLD_248 DET_BELOW_RAIN_THOLD_247 DET_BELOW_RAIN_THOLD_246 DET_BELOW_RAIN_THOLD_245 DET_MH_CRC16_245_248 DET_MH_CYCLE_COUNTER_245_248 DET_MH_SCAN_INDEX_4LSB_245_248 DET_CONFD_ELEVATION_245 DET_CONFD_AZIMUTH_245 DET_HVC_FLAG_245 DET_EXISTENCE_PROB_245 DET_SNR_245 DET_SUPER_RES_TARGET_245 DET_BI_STATIC_FLAG_245 DET_RCS_245 DET_ELEVATION_ERR_245 DET_ELEVATION_245 DET_AZIMUTH_ERR_245 DET_AZIMUTH_245 DET_RANGE_VELOCITY_ERR_245 DET_RANGE_VELOCITY_245 DET_RANGE_ERR_245 DET_RANGE_245 DET_CONFD_ELEVATION_246 DET_CONFD_AZIMUTH_246 DET_HVC_FLAG_246 DET_EXISTENCE_PROB_246 DET_SNR_246 DET_SUPER_RES_TARGET_246 DET_BI_STATIC_FLAG_246 DET_RCS_246 DET_ELEVATION_ERR_246 DET_ELEVATION_246 DET_AZIMUTH_ERR_246 DET_AZIMUTH_246 DET_RANGE_VELOCITY_ERR_246 DET_RANGE_VELOCITY_246 DET_RANGE_ERR_246 DET_RANGE_246 DET_CONFD_ELEVATION_247 DET_CONFD_AZIMUTH_247 DET_HVC_FLAG_247 DET_EXISTENCE_PROB_247 DET_SNR_247 DET_SUPER_RES_TARGET_247 DET_BI_STATIC_FLAG_247 DET_RCS_247 DET_ELEVATION_ERR_247 DET_ELEVATION_247 DET_AZIMUTH_ERR_247 DET_AZIMUTH_247 DET_RANGE_VELOCITY_ERR_247 DET_RANGE_VELOCITY_247 DET_RANGE_ERR_247 DET_RANGE_247 DET_CONFD_ELEVATION_248 DET_CONFD_AZIMUTH_248 DET_HVC_FLAG_248 DET_EXISTENCE_PROB_248 DET_SNR_248 DET_SUPER_RES_TARGET_248 DET_BI_STATIC_FLAG_248 DET_RCS_248 DET_ELEVATION_ERR_248 DET_ELEVATION_248 DET_AZIMUTH_ERR_248 DET_AZIMUTH_248 DET_RANGE_VELOCITY_ERR_248 DET_RANGE_VELOCITY_248 DET_RANGE_ERR_248 DET_RANGE_248;
SIG_GROUP_ 1214 Detections_249_252 1 : DET_PROB_1STAZHYPO_249 DET_PROB_1STAZHYPO_250 DET_PROB_1STAZHYPO_251 DET_PROB_1STAZHYPO_252 DET_IDM_249 DET_IDM_250 DET_IDM_251 DET_IDM_252 DET_MTD_252 DET_MTD_251 DET_MTD_250 DET_MTD_249 DET_BELOW_RAIN_THOLD_252 DET_BELOW_RAIN_THOLD_251 DET_BELOW_RAIN_THOLD_250 DET_BELOW_RAIN_THOLD_249 DET_MH_CRC16_249_252 DET_MH_CYCLE_COUNTER_249_252 DET_MH_SCAN_INDEX_4LSB_249_252 DET_CONFD_ELEVATION_249 DET_CONFD_AZIMUTH_249 DET_HVC_FLAG_249 DET_EXISTENCE_PROB_249 DET_SNR_249 DET_SUPER_RES_TARGET_249 DET_BI_STATIC_FLAG_249 DET_RCS_249 DET_ELEVATION_ERR_249 DET_ELEVATION_249 DET_AZIMUTH_ERR_249 DET_AZIMUTH_249 DET_RANGE_VELOCITY_ERR_249 DET_RANGE_VELOCITY_249 DET_RANGE_ERR_249 DET_RANGE_249 DET_CONFD_ELEVATION_250 DET_CONFD_AZIMUTH_250 DET_HVC_FLAG_250 DET_EXISTENCE_PROB_250 DET_SNR_250 DET_SUPER_RES_TARGET_250 DET_BI_STATIC_FLAG_250 DET_RCS_250 DET_ELEVATION_ERR_250 DET_ELEVATION_250 DET_AZIMUTH_ERR_250 DET_AZIMUTH_250 DET_RANGE_VELOCITY_ERR_250 DET_RANGE_VELOCITY_250 DET_RANGE_ERR_250 DET_RANGE_250 DET_CONFD_ELEVATION_251 DET_CONFD_AZIMUTH_251 DET_HVC_FLAG_251 DET_EXISTENCE_PROB_251 DET_SNR_251 DET_SUPER_RES_TARGET_251 DET_BI_STATIC_FLAG_251 DET_RCS_251 DET_ELEVATION_ERR_251 DET_ELEVATION_251 DET_AZIMUTH_ERR_251 DET_AZIMUTH_251 DET_RANGE_VELOCITY_ERR_251 DET_RANGE_VELOCITY_251 DET_RANGE_ERR_251 DET_RANGE_251 DET_CONFD_ELEVATION_252 DET_CONFD_AZIMUTH_252 DET_HVC_FLAG_252 DET_EXISTENCE_PROB_252 DET_SNR_252 DET_SUPER_RES_TARGET_252 DET_BI_STATIC_FLAG_252 DET_RCS_252 DET_ELEVATION_ERR_252 DET_ELEVATION_252 DET_AZIMUTH_ERR_252 DET_AZIMUTH_252 DET_RANGE_VELOCITY_ERR_252 DET_RANGE_VELOCITY_252 DET_RANGE_ERR_252 DET_RANGE_252;
SIG_GROUP_ 1215 Detections_253_256 1 : DET_PROB_1STAZHYPO_253 DET_PROB_1STAZHYPO_254 DET_PROB_1STAZHYPO_255 DET_PROB_1STAZHYPO_256 DET_IDM_253 DET_IDM_254 DET_IDM_255 DET_IDM_256 DET_MTD_256 DET_MTD_255 DET_MTD_254 DET_MTD_253 DET_BELOW_RAIN_THOLD_256 DET_BELOW_RAIN_THOLD_255 DET_BELOW_RAIN_THOLD_254 DET_BELOW_RAIN_THOLD_253 DET_MH_CRC16_253_256 DET_MH_CYCLE_COUNTER_253_256 DET_MH_SCAN_INDEX_4LSB_253_256 DET_CONFD_ELEVATION_253 DET_CONFD_AZIMUTH_253 DET_HVC_FLAG_253 DET_EXISTENCE_PROB_253 DET_SNR_253 DET_SUPER_RES_TARGET_253 DET_BI_STATIC_FLAG_253 DET_RCS_253 DET_ELEVATION_ERR_253 DET_ELEVATION_253 DET_AZIMUTH_ERR_253 DET_AZIMUTH_253 DET_RANGE_VELOCITY_ERR_253 DET_RANGE_VELOCITY_253 DET_RANGE_ERR_253 DET_RANGE_253 DET_CONFD_ELEVATION_254 DET_CONFD_AZIMUTH_254 DET_HVC_FLAG_254 DET_EXISTENCE_PROB_254 DET_SNR_254 DET_SUPER_RES_TARGET_254 DET_BI_STATIC_FLAG_254 DET_RCS_254 DET_ELEVATION_ERR_254 DET_ELEVATION_254 DET_AZIMUTH_ERR_254 DET_AZIMUTH_254 DET_RANGE_VELOCITY_ERR_254 DET_RANGE_VELOCITY_254 DET_RANGE_ERR_254 DET_RANGE_254 DET_CONFD_ELEVATION_255 DET_CONFD_AZIMUTH_255 DET_HVC_FLAG_255 DET_EXISTENCE_PROB_255 DET_SNR_255 DET_SUPER_RES_TARGET_255 DET_BI_STATIC_FLAG_255 DET_RCS_255 DET_ELEVATION_ERR_255 DET_ELEVATION_255 DET_AZIMUTH_ERR_255 DET_AZIMUTH_255 DET_RANGE_VELOCITY_ERR_255 DET_RANGE_VELOCITY_255 DET_RANGE_ERR_255 DET_RANGE_255 DET_CONFD_ELEVATION_256 DET_CONFD_AZIMUTH_256 DET_HVC_FLAG_256 DET_EXISTENCE_PROB_256 DET_SNR_256 DET_SUPER_RES_TARGET_256 DET_BI_STATIC_FLAG_256 DET_RCS_256 DET_ELEVATION_ERR_256 DET_ELEVATION_256 DET_AZIMUTH_ERR_256 DET_AZIMUTH_256 DET_RANGE_VELOCITY_ERR_256 DET_RANGE_VELOCITY_256 DET_RANGE_ERR_256 DET_RANGE_256;
SIG_GROUP_ 1216 Detections_257_260 1 : DET_PROB_1STAZHYPO_257 DET_PROB_1STAZHYPO_258 DET_PROB_1STAZHYPO_259 DET_PROB_1STAZHYPO_260 DET_IDM_257 DET_IDM_258 DET_IDM_259 DET_IDM_260 DET_MTD_260 DET_MTD_259 DET_MTD_258 DET_MTD_257 DET_BELOW_RAIN_THOLD_260 DET_BELOW_RAIN_THOLD_259 DET_BELOW_RAIN_THOLD_258 DET_BELOW_RAIN_THOLD_257 DET_MH_CRC16_257_260 DET_MH_CYCLE_COUNTER_257_260 DET_MH_SCAN_INDEX_4LSB_257_260 DET_CONFD_ELEVATION_257 DET_CONFD_AZIMUTH_257 DET_HVC_FLAG_257 DET_EXISTENCE_PROB_257 DET_SNR_257 DET_SUPER_RES_TARGET_257 DET_BI_STATIC_FLAG_257 DET_RCS_257 DET_ELEVATION_ERR_257 DET_ELEVATION_257 DET_AZIMUTH_ERR_257 DET_AZIMUTH_257 DET_RANGE_VELOCITY_ERR_257 DET_RANGE_VELOCITY_257 DET_RANGE_ERR_257 DET_RANGE_257 DET_CONFD_ELEVATION_258 DET_CONFD_AZIMUTH_258 DET_HVC_FLAG_258 DET_EXISTENCE_PROB_258 DET_SNR_258 DET_SUPER_RES_TARGET_258 DET_BI_STATIC_FLAG_258 DET_RCS_258 DET_ELEVATION_ERR_258 DET_ELEVATION_258 DET_AZIMUTH_ERR_258 DET_AZIMUTH_258 DET_RANGE_VELOCITY_ERR_258 DET_RANGE_VELOCITY_258 DET_RANGE_ERR_258 DET_RANGE_258 DET_CONFD_ELEVATION_259 DET_CONFD_AZIMUTH_259 DET_HVC_FLAG_259 DET_EXISTENCE_PROB_259 DET_SNR_259 DET_SUPER_RES_TARGET_259 DET_BI_STATIC_FLAG_259 DET_RCS_259 DET_ELEVATION_ERR_259 DET_ELEVATION_259 DET_AZIMUTH_ERR_259 DET_AZIMUTH_259 DET_RANGE_VELOCITY_ERR_259 DET_RANGE_VELOCITY_259 DET_RANGE_ERR_259 DET_RANGE_259 DET_CONFD_ELEVATION_260 DET_CONFD_AZIMUTH_260 DET_HVC_FLAG_260 DET_EXISTENCE_PROB_260 DET_SNR_260 DET_SUPER_RES_TARGET_260 DET_BI_STATIC_FLAG_260 DET_RCS_260 DET_ELEVATION_ERR_260 DET_ELEVATION_260 DET_AZIMUTH_ERR_260 DET_AZIMUTH_260 DET_RANGE_VELOCITY_ERR_260 DET_RANGE_VELOCITY_260 DET_RANGE_ERR_260 DET_RANGE_260;
SIG_GROUP_ 1217 Detections_261_264 1 : DET_PROB_1STAZHYPO_261 DET_PROB_1STAZHYPO_262 DET_PROB_1STAZHYPO_263 DET_PROB_1STAZHYPO_264 DET_IDM_261 DET_IDM_262 DET_IDM_263 DET_IDM_264 DET_MTD_264 DET_MTD_263 DET_MTD_262 DET_MTD_261 DET_BELOW_RAIN_THOLD_264 DET_BELOW_RAIN_THOLD_263 DET_BELOW_RAIN_THOLD_262 DET_BELOW_RAIN_THOLD_261 DET_MH_CRC16_261_264 DET_MH_CYCLE_COUNTER_261_264 DET_MH_SCAN_INDEX_4LSB_261_264 DET_CONFD_ELEVATION_261 DET_CONFD_AZIMUTH_261 DET_HVC_FLAG_261 DET_EXISTENCE_PROB_261 DET_SNR_261 DET_SUPER_RES_TARGET_261 DET_BI_STATIC_FLAG_261 DET_RCS_261 DET_ELEVATION_ERR_261 DET_ELEVATION_261 DET_AZIMUTH_ERR_261 DET_AZIMUTH_261 DET_RANGE_VELOCITY_ERR_261 DET_RANGE_VELOCITY_261 DET_RANGE_ERR_261 DET_RANGE_261 DET_CONFD_ELEVATION_262 DET_CONFD_AZIMUTH_262 DET_HVC_FLAG_262 DET_EXISTENCE_PROB_262 DET_SNR_262 DET_SUPER_RES_TARGET_262 DET_BI_STATIC_FLAG_262 DET_RCS_262 DET_ELEVATION_ERR_262 DET_ELEVATION_262 DET_AZIMUTH_ERR_262 DET_AZIMUTH_262 DET_RANGE_VELOCITY_ERR_262 DET_RANGE_VELOCITY_262 DET_RANGE_ERR_262 DET_RANGE_262 DET_CONFD_ELEVATION_263 DET_CONFD_AZIMUTH_263 DET_HVC_FLAG_263 DET_EXISTENCE_PROB_263 DET_SNR_263 DET_SUPER_RES_TARGET_263 DET_BI_STATIC_FLAG_263 DET_RCS_263 DET_ELEVATION_ERR_263 DET_ELEVATION_263 DET_AZIMUTH_ERR_263 DET_AZIMUTH_263 DET_RANGE_VELOCITY_ERR_263 DET_RANGE_VELOCITY_263 DET_RANGE_ERR_263 DET_RANGE_263 DET_CONFD_ELEVATION_264 DET_CONFD_AZIMUTH_264 DET_HVC_FLAG_264 DET_EXISTENCE_PROB_264 DET_SNR_264 DET_SUPER_RES_TARGET_264 DET_BI_STATIC_FLAG_264 DET_RCS_264 DET_ELEVATION_ERR_264 DET_ELEVATION_264 DET_AZIMUTH_ERR_264 DET_AZIMUTH_264 DET_RANGE_VELOCITY_ERR_264 DET_RANGE_VELOCITY_264 DET_RANGE_ERR_264 DET_RANGE_264;
SIG_GROUP_ 1218 Detections_265_268 1 : DET_PROB_1STAZHYPO_265 DET_PROB_1STAZHYPO_266 DET_PROB_1STAZHYPO_267 DET_PROB_1STAZHYPO_268 DET_IDM_265 DET_IDM_266 DET_IDM_267 DET_IDM_268 DET_MTD_268 DET_MTD_267 DET_MTD_266 DET_MTD_265 DET_BELOW_RAIN_THOLD_268 DET_BELOW_RAIN_THOLD_267 DET_BELOW_RAIN_THOLD_266 DET_BELOW_RAIN_THOLD_265 DET_MH_CRC16_265_268 DET_MH_CYCLE_COUNTER_265_268 DET_MH_SCAN_INDEX_4LSB_265_268 DET_CONFD_ELEVATION_265 DET_CONFD_AZIMUTH_265 DET_HVC_FLAG_265 DET_EXISTENCE_PROB_265 DET_SNR_265 DET_SUPER_RES_TARGET_265 DET_BI_STATIC_FLAG_265 DET_RCS_265 DET_ELEVATION_ERR_265 DET_ELEVATION_265 DET_AZIMUTH_ERR_265 DET_AZIMUTH_265 DET_RANGE_VELOCITY_ERR_265 DET_RANGE_VELOCITY_265 DET_RANGE_ERR_265 DET_RANGE_265 DET_CONFD_ELEVATION_266 DET_CONFD_AZIMUTH_266 DET_HVC_FLAG_266 DET_EXISTENCE_PROB_266 DET_SNR_266 DET_SUPER_RES_TARGET_266 DET_BI_STATIC_FLAG_266 DET_RCS_266 DET_ELEVATION_ERR_266 DET_ELEVATION_266 DET_AZIMUTH_ERR_266 DET_AZIMUTH_266 DET_RANGE_VELOCITY_ERR_266 DET_RANGE_VELOCITY_266 DET_RANGE_ERR_266 DET_RANGE_266 DET_CONFD_ELEVATION_267 DET_CONFD_AZIMUTH_267 DET_HVC_FLAG_267 DET_EXISTENCE_PROB_267 DET_SNR_267 DET_SUPER_RES_TARGET_267 DET_BI_STATIC_FLAG_267 DET_RCS_267 DET_ELEVATION_ERR_267 DET_ELEVATION_267 DET_AZIMUTH_ERR_267 DET_AZIMUTH_267 DET_RANGE_VELOCITY_ERR_267 DET_RANGE_VELOCITY_267 DET_RANGE_ERR_267 DET_RANGE_267 DET_CONFD_ELEVATION_268 DET_CONFD_AZIMUTH_268 DET_HVC_FLAG_268 DET_EXISTENCE_PROB_268 DET_SNR_268 DET_SUPER_RES_TARGET_268 DET_BI_STATIC_FLAG_268 DET_RCS_268 DET_ELEVATION_ERR_268 DET_ELEVATION_268 DET_AZIMUTH_ERR_268 DET_AZIMUTH_268 DET_RANGE_VELOCITY_ERR_268 DET_RANGE_VELOCITY_268 DET_RANGE_ERR_268 DET_RANGE_268;
SIG_GROUP_ 1219 Detections_269_272 1 : DET_PROB_1STAZHYPO_269 DET_PROB_1STAZHYPO_270 DET_PROB_1STAZHYPO_271 DET_PROB_1STAZHYPO_272 DET_IDM_269 DET_IDM_270 DET_IDM_271 DET_IDM_272 DET_MTD_272 DET_MTD_271 DET_MTD_270 DET_MTD_269 DET_BELOW_RAIN_THOLD_272 DET_BELOW_RAIN_THOLD_271 DET_BELOW_RAIN_THOLD_270 DET_BELOW_RAIN_THOLD_269 DET_MH_CRC16_269_272 DET_MH_CYCLE_COUNTER_269_272 DET_MH_SCAN_INDEX_4LSB_269_272 DET_CONFD_ELEVATION_269 DET_CONFD_AZIMUTH_269 DET_HVC_FLAG_269 DET_EXISTENCE_PROB_269 DET_SNR_269 DET_SUPER_RES_TARGET_269 DET_BI_STATIC_FLAG_269 DET_RCS_269 DET_ELEVATION_ERR_269 DET_ELEVATION_269 DET_AZIMUTH_ERR_269 DET_AZIMUTH_269 DET_RANGE_VELOCITY_ERR_269 DET_RANGE_VELOCITY_269 DET_RANGE_ERR_269 DET_RANGE_269 DET_CONFD_ELEVATION_270 DET_CONFD_AZIMUTH_270 DET_HVC_FLAG_270 DET_EXISTENCE_PROB_270 DET_SNR_270 DET_SUPER_RES_TARGET_270 DET_BI_STATIC_FLAG_270 DET_RCS_270 DET_ELEVATION_ERR_270 DET_ELEVATION_270 DET_AZIMUTH_ERR_270 DET_AZIMUTH_270 DET_RANGE_VELOCITY_ERR_270 DET_RANGE_VELOCITY_270 DET_RANGE_ERR_270 DET_RANGE_270 DET_CONFD_ELEVATION_271 DET_CONFD_AZIMUTH_271 DET_HVC_FLAG_271 DET_EXISTENCE_PROB_271 DET_SNR_271 DET_SUPER_RES_TARGET_271 DET_BI_STATIC_FLAG_271 DET_RCS_271 DET_ELEVATION_ERR_271 DET_ELEVATION_271 DET_AZIMUTH_ERR_271 DET_AZIMUTH_271 DET_RANGE_VELOCITY_ERR_271 DET_RANGE_VELOCITY_271 DET_RANGE_ERR_271 DET_RANGE_271 DET_CONFD_ELEVATION_272 DET_CONFD_AZIMUTH_272 DET_HVC_FLAG_272 DET_EXISTENCE_PROB_272 DET_SNR_272 DET_SUPER_RES_TARGET_272 DET_BI_STATIC_FLAG_272 DET_RCS_272 DET_ELEVATION_ERR_272 DET_ELEVATION_272 DET_AZIMUTH_ERR_272 DET_AZIMUTH_272 DET_RANGE_VELOCITY_ERR_272 DET_RANGE_VELOCITY_272 DET_RANGE_ERR_272 DET_RANGE_272;
SIG_GROUP_ 1220 Detections_273_276 1 : DET_PROB_1STAZHYPO_273 DET_PROB_1STAZHYPO_274 DET_PROB_1STAZHYPO_275 DET_PROB_1STAZHYPO_276 DET_IDM_273 DET_IDM_274 DET_IDM_275 DET_IDM_276 DET_MTD_276 DET_MTD_275 DET_MTD_274 DET_MTD_273 DET_BELOW_RAIN_THOLD_276 DET_BELOW_RAIN_THOLD_275 DET_BELOW_RAIN_THOLD_274 DET_BELOW_RAIN_THOLD_273 DET_MH_CRC16_273_276 DET_MH_CYCLE_COUNTER_273_276 DET_MH_SCAN_INDEX_4LSB_273_276 DET_CONFD_ELEVATION_273 DET_CONFD_AZIMUTH_273 DET_HVC_FLAG_273 DET_EXISTENCE_PROB_273 DET_SNR_273 DET_SUPER_RES_TARGET_273 DET_BI_STATIC_FLAG_273 DET_RCS_273 DET_ELEVATION_ERR_273 DET_ELEVATION_273 DET_AZIMUTH_ERR_273 DET_AZIMUTH_273 DET_RANGE_VELOCITY_ERR_273 DET_RANGE_VELOCITY_273 DET_RANGE_ERR_273 DET_RANGE_273 DET_CONFD_ELEVATION_274 DET_CONFD_AZIMUTH_274 DET_HVC_FLAG_274 DET_EXISTENCE_PROB_274 DET_SNR_274 DET_SUPER_RES_TARGET_274 DET_BI_STATIC_FLAG_274 DET_RCS_274 DET_ELEVATION_ERR_274 DET_ELEVATION_274 DET_AZIMUTH_ERR_274 DET_AZIMUTH_274 DET_RANGE_VELOCITY_ERR_274 DET_RANGE_VELOCITY_274 DET_RANGE_ERR_274 DET_RANGE_274 DET_CONFD_ELEVATION_275 DET_CONFD_AZIMUTH_275 DET_HVC_FLAG_275 DET_EXISTENCE_PROB_275 DET_SNR_275 DET_SUPER_RES_TARGET_275 DET_BI_STATIC_FLAG_275 DET_RCS_275 DET_ELEVATION_ERR_275 DET_ELEVATION_275 DET_AZIMUTH_ERR_275 DET_AZIMUTH_275 DET_RANGE_VELOCITY_ERR_275 DET_RANGE_VELOCITY_275 DET_RANGE_ERR_275 DET_RANGE_275 DET_CONFD_ELEVATION_276 DET_CONFD_AZIMUTH_276 DET_HVC_FLAG_276 DET_EXISTENCE_PROB_276 DET_SNR_276 DET_SUPER_RES_TARGET_276 DET_BI_STATIC_FLAG_276 DET_RCS_276 DET_ELEVATION_ERR_276 DET_ELEVATION_276 DET_AZIMUTH_ERR_276 DET_AZIMUTH_276 DET_RANGE_VELOCITY_ERR_276 DET_RANGE_VELOCITY_276 DET_RANGE_ERR_276 DET_RANGE_276;
SIG_GROUP_ 1221 Detections_277_280 1 : DET_PROB_1STAZHYPO_277 DET_PROB_1STAZHYPO_278 DET_PROB_1STAZHYPO_279 DET_PROB_1STAZHYPO_280 DET_IDM_277 DET_IDM_278 DET_IDM_279 DET_IDM_280 DET_MTD_280 DET_MTD_279 DET_MTD_278 DET_MTD_277 DET_BELOW_RAIN_THOLD_280 DET_BELOW_RAIN_THOLD_279 DET_BELOW_RAIN_THOLD_278 DET_BELOW_RAIN_THOLD_277 DET_MH_CRC16_277_280 DET_MH_CYCLE_COUNTER_277_280 DET_MH_SCAN_INDEX_4LSB_277_280 DET_CONFD_ELEVATION_277 DET_CONFD_AZIMUTH_277 DET_HVC_FLAG_277 DET_EXISTENCE_PROB_277 DET_SNR_277 DET_SUPER_RES_TARGET_277 DET_BI_STATIC_FLAG_277 DET_RCS_277 DET_ELEVATION_ERR_277 DET_ELEVATION_277 DET_AZIMUTH_ERR_277 DET_AZIMUTH_277 DET_RANGE_VELOCITY_ERR_277 DET_RANGE_VELOCITY_277 DET_RANGE_ERR_277 DET_RANGE_277 DET_CONFD_ELEVATION_278 DET_CONFD_AZIMUTH_278 DET_HVC_FLAG_278 DET_EXISTENCE_PROB_278 DET_SNR_278 DET_SUPER_RES_TARGET_278 DET_BI_STATIC_FLAG_278 DET_RCS_278 DET_ELEVATION_ERR_278 DET_ELEVATION_278 DET_AZIMUTH_ERR_278 DET_AZIMUTH_278 DET_RANGE_VELOCITY_ERR_278 DET_RANGE_VELOCITY_278 DET_RANGE_ERR_278 DET_RANGE_278 DET_CONFD_ELEVATION_279 DET_CONFD_AZIMUTH_279 DET_HVC_FLAG_279 DET_EXISTENCE_PROB_279 DET_SNR_279 DET_SUPER_RES_TARGET_279 DET_BI_STATIC_FLAG_279 DET_RCS_279 DET_ELEVATION_ERR_279 DET_ELEVATION_279 DET_AZIMUTH_ERR_279 DET_AZIMUTH_279 DET_RANGE_VELOCITY_ERR_279 DET_RANGE_VELOCITY_279 DET_RANGE_ERR_279 DET_RANGE_279 DET_CONFD_ELEVATION_280 DET_CONFD_AZIMUTH_280 DET_HVC_FLAG_280 DET_EXISTENCE_PROB_280 DET_SNR_280 DET_SUPER_RES_TARGET_280 DET_BI_STATIC_FLAG_280 DET_RCS_280 DET_ELEVATION_ERR_280 DET_ELEVATION_280 DET_AZIMUTH_ERR_280 DET_AZIMUTH_280 DET_RANGE_VELOCITY_ERR_280 DET_RANGE_VELOCITY_280 DET_RANGE_ERR_280 DET_RANGE_280;
SIG_GROUP_ 1222 Detections_281_284 1 : DET_PROB_1STAZHYPO_281 DET_PROB_1STAZHYPO_282 DET_PROB_1STAZHYPO_283 DET_PROB_1STAZHYPO_284 DET_IDM_281 DET_IDM_282 DET_IDM_283 DET_IDM_284 DET_MTD_284 DET_MTD_283 DET_MTD_282 DET_MTD_281 DET_BELOW_RAIN_THOLD_284 DET_BELOW_RAIN_THOLD_283 DET_BELOW_RAIN_THOLD_282 DET_BELOW_RAIN_THOLD_281 DET_MH_CRC16_281_284 DET_MH_CYCLE_COUNTER_281_284 DET_MH_SCAN_INDEX_4LSB_281_284 DET_CONFD_ELEVATION_281 DET_CONFD_AZIMUTH_281 DET_HVC_FLAG_281 DET_EXISTENCE_PROB_281 DET_SNR_281 DET_SUPER_RES_TARGET_281 DET_BI_STATIC_FLAG_281 DET_RCS_281 DET_ELEVATION_ERR_281 DET_ELEVATION_281 DET_AZIMUTH_ERR_281 DET_AZIMUTH_281 DET_RANGE_VELOCITY_ERR_281 DET_RANGE_VELOCITY_281 DET_RANGE_ERR_281 DET_RANGE_281 DET_CONFD_ELEVATION_282 DET_CONFD_AZIMUTH_282 DET_HVC_FLAG_282 DET_EXISTENCE_PROB_282 DET_SNR_282 DET_SUPER_RES_TARGET_282 DET_BI_STATIC_FLAG_282 DET_RCS_282 DET_ELEVATION_ERR_282 DET_ELEVATION_282 DET_AZIMUTH_ERR_282 DET_AZIMUTH_282 DET_RANGE_VELOCITY_ERR_282 DET_RANGE_VELOCITY_282 DET_RANGE_ERR_282 DET_RANGE_282 DET_CONFD_ELEVATION_283 DET_CONFD_AZIMUTH_283 DET_HVC_FLAG_283 DET_EXISTENCE_PROB_283 DET_SNR_283 DET_SUPER_RES_TARGET_283 DET_BI_STATIC_FLAG_283 DET_RCS_283 DET_ELEVATION_ERR_283 DET_ELEVATION_283 DET_AZIMUTH_ERR_283 DET_AZIMUTH_283 DET_RANGE_VELOCITY_ERR_283 DET_RANGE_VELOCITY_283 DET_RANGE_ERR_283 DET_RANGE_283 DET_CONFD_ELEVATION_284 DET_CONFD_AZIMUTH_284 DET_HVC_FLAG_284 DET_EXISTENCE_PROB_284 DET_SNR_284 DET_SUPER_RES_TARGET_284 DET_BI_STATIC_FLAG_284 DET_RCS_284 DET_ELEVATION_ERR_284 DET_ELEVATION_284 DET_AZIMUTH_ERR_284 DET_AZIMUTH_284 DET_RANGE_VELOCITY_ERR_284 DET_RANGE_VELOCITY_284 DET_RANGE_ERR_284 DET_RANGE_284;
SIG_GROUP_ 1223 Detections_285_288 1 : DET_PROB_1STAZHYPO_285 DET_PROB_1STAZHYPO_286 DET_PROB_1STAZHYPO_287 DET_PROB_1STAZHYPO_288 DET_IDM_285 DET_IDM_286 DET_IDM_287 DET_IDM_288 DET_MTD_288 DET_MTD_287 DET_MTD_286 DET_MTD_285 DET_BELOW_RAIN_THOLD_288 DET_BELOW_RAIN_THOLD_287 DET_BELOW_RAIN_THOLD_286 DET_BELOW_RAIN_THOLD_285 DET_MH_CRC16_285_288 DET_MH_CYCLE_COUNTER_285_288 DET_MH_SCAN_INDEX_4LSB_285_288 DET_CONFD_ELEVATION_285 DET_CONFD_AZIMUTH_285 DET_HVC_FLAG_285 DET_EXISTENCE_PROB_285 DET_SNR_285 DET_SUPER_RES_TARGET_285 DET_BI_STATIC_FLAG_285 DET_RCS_285 DET_ELEVATION_ERR_285 DET_ELEVATION_285 DET_AZIMUTH_ERR_285 DET_AZIMUTH_285 DET_RANGE_VELOCITY_ERR_285 DET_RANGE_VELOCITY_285 DET_RANGE_ERR_285 DET_RANGE_285 DET_CONFD_ELEVATION_286 DET_CONFD_AZIMUTH_286 DET_HVC_FLAG_286 DET_EXISTENCE_PROB_286 DET_SNR_286 DET_SUPER_RES_TARGET_286 DET_BI_STATIC_FLAG_286 DET_RCS_286 DET_ELEVATION_ERR_286 DET_ELEVATION_286 DET_AZIMUTH_ERR_286 DET_AZIMUTH_286 DET_RANGE_VELOCITY_ERR_286 DET_RANGE_VELOCITY_286 DET_RANGE_ERR_286 DET_RANGE_286 DET_CONFD_ELEVATION_287 DET_CONFD_AZIMUTH_287 DET_HVC_FLAG_287 DET_EXISTENCE_PROB_287 DET_SNR_287 DET_SUPER_RES_TARGET_287 DET_BI_STATIC_FLAG_287 DET_RCS_287 DET_ELEVATION_ERR_287 DET_ELEVATION_287 DET_AZIMUTH_ERR_287 DET_AZIMUTH_287 DET_RANGE_VELOCITY_ERR_287 DET_RANGE_VELOCITY_287 DET_RANGE_ERR_287 DET_RANGE_287 DET_CONFD_ELEVATION_288 DET_CONFD_AZIMUTH_288 DET_HVC_FLAG_288 DET_EXISTENCE_PROB_288 DET_SNR_288 DET_SUPER_RES_TARGET_288 DET_BI_STATIC_FLAG_288 DET_RCS_288 DET_ELEVATION_ERR_288 DET_ELEVATION_288 DET_AZIMUTH_ERR_288 DET_AZIMUTH_288 DET_RANGE_VELOCITY_ERR_288 DET_RANGE_VELOCITY_288 DET_RANGE_ERR_288 DET_RANGE_288;
