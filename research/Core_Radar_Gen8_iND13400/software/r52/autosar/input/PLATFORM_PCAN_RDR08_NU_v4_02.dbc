VERSION "created by canmatrix"

NS_ :

BS_:

BU_: External_Tool ADAS RDR08 RDR_Fusion_Partner RDR_Gateway

BO_ 1192 RDR_DETECTION_161_164: 64 RDR08
 SG_ DET_RANGE_161 : 24|15@1+ (0.015625,0) [0|500] "m"  ADAS
 SG_ DET_RANGE_ERR_161 : 40|7@1+ (0.0075,0) [0|0.9525] "m"  ADAS
 SG_ DET_RANGE_VELOCITY_161 : 48|15@1+ (0.0078125,-128) [-128|127.9921875] "m/s"  ADAS
 SG_ DET_RANGE_VELOCITY_ERR_161 : 64|8@1+ (0.003,0) [0|0.765] "m/s"  ADAS
 SG_ DET_AZIMUTH_161 : 88|13@1+ (0.0004,-1.5708) [-1.5708|1.5708] "rad"  ADAS
 SG_ DET_AZIMUTH_ERR_161 : 105|7@1+ (0.00087267,0) [0|0.11082909] "rad"  ADAS
 SG_ DET_ELEVATION_161 : 72|8@1+ (0.00275,-0.34925) [-0.34925|0.34925] "rad"  ADAS
 SG_ DET_ELEVATION_ERR_161 : 80|6@1+ (0.00174533,0) [0|0.10995579] "rad"  ADAS
 SG_ DET_RCS_161 : 128|8@1+ (0.5,-64) [-64|63.5] "dBsm"  ADAS
 SG_ DET_BI_STATIC_FLAG_161 : 104|1@1+ (1,0) [0|1] ""  ADAS
 SG_ DET_SUPER_RES_TARGET_161 : 87|1@1+ (1,0) [0|1] ""  ADAS
 SG_ DET_SNR_161 : 120|8@1+ (0.35156,0) [0|89.6478] "dB"  ADAS
 SG_ DET_EXISTENCE_PROB_161 : 112|6@1+ (1.588,0) [0|100] "%"  ADAS
 SG_ DET_HVC_FLAG_161 : 86|1@1+ (1,0) [0|1] ""  ADAS
 SG_ DET_CONFD_AZIMUTH_161 : 118|2@1+ (1,0) [0|3] ""  ADAS
 SG_ DET_CONFD_ELEVATION_161 : 101|2@1+ (1,0) [0|3] ""  ADAS
 SG_ DET_PROB_1STAZHYPO_161 : 103|1@1+ (1,0) [0|1] ""  ADAS
 SG_ DET_IDM_161 : 63|1@1+ (1,0) [0|1] ""  ADAS
 SG_ DET_MTD_161 : 47|1@1+ (1,0) [0|1] ""  ADAS
 SG_ DET_BELOW_RAIN_THOLD_161 : 39|1@1+ (1,0) [0|1] ""  ADAS
 SG_ DET_RANGE_162 : 136|15@1+ (0.015625,0) [0|500] "m"  ADAS
 SG_ DET_RANGE_ERR_162 : 152|7@1+ (0.0075,0) [0|0.9525] "m"  ADAS
 SG_ DET_RANGE_VELOCITY_162 : 160|15@1+ (0.0078125,-128) [-128|127.9921875] "m/s"  ADAS
 SG_ DET_RANGE_VELOCITY_ERR_162 : 176|8@1+ (0.003,0) [0|0.765] "m/s"  ADAS
 SG_ DET_AZIMUTH_162 : 200|13@1+ (0.0004,-1.5708) [-1.5708|1.5708] "rad"  ADAS
 SG_ DET_AZIMUTH_ERR_162 : 217|7@1+ (0.00087267,0) [0|0.11082909] "rad"  ADAS
 SG_ DET_ELEVATION_162 : 184|8@1+ (0.00275,-0.34925) [-0.34925|0.34925] "rad"  ADAS
 SG_ DET_ELEVATION_ERR_162 : 192|6@1+ (0.00174533,0) [0|0.10995579] "rad"  ADAS
 SG_ DET_RCS_162 : 240|8@1+ (0.5,-64) [-64|63.5] "dBsm"  ADAS
 SG_ DET_BI_STATIC_FLAG_162 : 216|1@1+ (1,0) [0|1] ""  ADAS
 SG_ DET_SUPER_RES_TARGET_162 : 199|1@1+ (1,0) [0|1] ""  ADAS
 SG_ DET_SNR_162 : 232|8@1+ (0.35156,0) [0|89.6478] "dB"  ADAS
 SG_ DET_EXISTENCE_PROB_162 : 224|6@1+ (1.588,0) [0|100] "%"  ADAS
 SG_ DET_HVC_FLAG_162 : 198|1@1+ (1,0) [0|1] ""  ADAS
 SG_ DET_CONFD_AZIMUTH_162 : 230|2@1+ (1,0) [0|3] ""  ADAS
 SG_ DET_CONFD_ELEVATION_162 : 213|2@1+ (1,0) [0|3] ""  ADAS
 SG_ DET_PROB_1STAZHYPO_162 : 215|1@1+ (1,0) [0|1] ""  ADAS
 SG_ DET_IDM_162 : 175|1@1+ (1,0) [0|1] ""  ADAS
 SG_ DET_MTD_162 : 159|1@1+ (1,0) [0|1] ""  ADAS
 SG_ DET_BELOW_RAIN_THOLD_162 : 151|1@1+ (1,0) [0|1] ""  ADAS
 SG_ DET_RANGE_163 : 248|15@1+ (0.015625,0) [0|500] "m"  ADAS
 SG_ DET_RANGE_ERR_163 : 264|7@1+ (0.0075,0) [0|0.9525] "m"  ADAS
 SG_ DET_RANGE_VELOCITY_163 : 272|15@1+ (0.0078125,-128) [-128|127.9921875] "m/s"  ADAS
 SG_ DET_RANGE_VELOCITY_ERR_163 : 288|8@1+ (0.003,0) [0|0.765] "m/s"  ADAS
 SG_ DET_AZIMUTH_163 : 312|13@1+ (0.0004,-1.5708) [-1.5708|1.5708] "rad"  ADAS
 SG_ DET_AZIMUTH_ERR_163 : 329|7@1+ (0.00087267,0) [0|0.11082909] "rad"  ADAS
 SG_ DET_ELEVATION_163 : 296|8@1+ (0.00275,-0.34925) [-0.34925|0.34925] "rad"  ADAS
 SG_ DET_ELEVATION_ERR_163 : 304|6@1+ (0.00174533,0) [0|0.10995579] "rad"  ADAS
 SG_ DET_RCS_163 : 352|8@1+ (0.5,-64) [-64|63.5] "dBsm"  ADAS
 SG_ DET_BI_STATIC_FLAG_163 : 328|1@1+ (1,0) [0|1] ""  ADAS
 SG_ DET_SUPER_RES_TARGET_163 : 311|1@1+ (1,0) [0|1] ""  ADAS
 SG_ DET_SNR_163 : 344|8@1+ (0.35156,0) [0|89.6478] "dB"  ADAS
 SG_ DET_EXISTENCE_PROB_163 : 336|6@1+ (1.588,0) [0|100] "%"  ADAS
 SG_ DET_HVC_FLAG_163 : 310|1@1+ (1,0) [0|1] ""  ADAS
 SG_ DET_CONFD_AZIMUTH_163 : 342|2@1+ (1,0) [0|3] ""  ADAS
 SG_ DET_CONFD_ELEVATION_163 : 325|2@1+ (1,0) [0|3] ""  ADAS
 SG_ DET_PROB_1STAZHYPO_163 : 327|1@1+ (1,0) [0|1] ""  ADAS
 SG_ DET_IDM_163 : 287|1@1+ (1,0) [0|1] ""  ADAS
 SG_ DET_MTD_163 : 271|1@1+ (1,0) [0|1] ""  ADAS
 SG_ DET_BELOW_RAIN_THOLD_163 : 263|1@1+ (1,0) [0|1] ""  ADAS
 SG_ DET_RANGE_164 : 360|15@1+ (0.015625,0) [0|500] "m"  ADAS
 SG_ DET_RANGE_ERR_164 : 376|7@1+ (0.0075,0) [0|0.9525] "m"  ADAS
 SG_ DET_RANGE_VELOCITY_164 : 384|15@1+ (0.0078125,-128) [-128|127.9921875] "m/s"  ADAS
 SG_ DET_RANGE_VELOCITY_ERR_164 : 400|8@1+ (0.003,0) [0|0.765] "m/s"  ADAS
 SG_ DET_AZIMUTH_164 : 424|13@1+ (0.0004,-1.5708) [-1.5708|1.5708] "rad"  ADAS
 SG_ DET_AZIMUTH_ERR_164 : 441|7@1+ (0.00087267,0) [0|0.11082909] "rad"  ADAS
 SG_ DET_ELEVATION_164 : 408|8@1+ (0.00275,-0.34925) [-0.34925|0.34925] "rad"  ADAS
 SG_ DET_ELEVATION_ERR_164 : 416|6@1+ (0.00174533,0) [0|0.10995579] "rad"  ADAS
 SG_ DET_RCS_164 : 464|8@1+ (0.5,-64) [-64|63.5] "dBsm"  ADAS
 SG_ DET_BI_STATIC_FLAG_164 : 440|1@1+ (1,0) [0|1] ""  ADAS
 SG_ DET_SUPER_RES_TARGET_164 : 423|1@1+ (1,0) [0|1] ""  ADAS
 SG_ DET_SNR_164 : 456|8@1+ (0.35156,0) [0|89.6478] "dB"  ADAS
 SG_ DET_EXISTENCE_PROB_164 : 448|6@1+ (1.588,0) [0|100] "%"  ADAS
 SG_ DET_HVC_FLAG_164 : 422|1@1+ (1,0) [0|1] ""  ADAS
 SG_ DET_CONFD_AZIMUTH_164 : 454|2@1+ (1,0) [0|3] ""  ADAS
 SG_ DET_CONFD_ELEVATION_164 : 437|2@1+ (1,0) [0|3] ""  ADAS
 SG_ DET_MH_SCAN_INDEX_4LSB_161_164 : 476|4@1+ (1,0) [0|15] ""  ADAS
 SG_ DET_MH_CYCLE_COUNTER_161_164 : 16|8@1+ (1,0) [0|255] ""  ADAS
 SG_ DET_MH_CRC16_161_164 : 0|16@1+ (1,0) [0|65535] ""  ADAS
 SG_ DET_PROB_1STAZHYPO_164 : 439|1@1+ (1,0) [0|1] ""  ADAS
 SG_ DET_IDM_164 : 399|1@1+ (1,0) [0|1] ""  ADAS
 SG_ DET_MTD_164 : 383|1@1+ (1,0) [0|1] ""  ADAS
 SG_ DET_BELOW_RAIN_THOLD_164 : 375|1@1+ (1,0) [0|1] ""  ADAS

BO_ 1193 RDR_DETECTION_165_168: 64 RDR08
 SG_ DET_RANGE_165 : 24|15@1+ (0.015625,0) [0|500] "m"  ADAS
 SG_ DET_RANGE_ERR_165 : 40|7@1+ (0.0075,0) [0|0.9525] "m"  ADAS
 SG_ DET_RANGE_VELOCITY_165 : 48|15@1+ (0.0078125,-128) [-128|127.9921875] "m/s"  ADAS
 SG_ DET_RANGE_VELOCITY_ERR_165 : 64|8@1+ (0.003,0) [0|0.765] "m/s"  ADAS
 SG_ DET_AZIMUTH_165 : 88|13@1+ (0.0004,-1.5708) [-1.5708|1.5708] "rad"  ADAS
 SG_ DET_AZIMUTH_ERR_165 : 105|7@1+ (0.00087267,0) [0|0.11082909] "rad"  ADAS
 SG_ DET_ELEVATION_165 : 72|8@1+ (0.00275,-0.34925) [-0.34925|0.34925] "rad"  ADAS
 SG_ DET_ELEVATION_ERR_165 : 80|6@1+ (0.00174533,0) [0|0.10995579] "rad"  ADAS
 SG_ DET_RCS_165 : 128|8@1+ (0.5,-64) [-64|63.5] "dBsm"  ADAS
 SG_ DET_BI_STATIC_FLAG_165 : 104|1@1+ (1,0) [0|1] ""  ADAS
 SG_ DET_SUPER_RES_TARGET_165 : 87|1@1+ (1,0) [0|1] ""  ADAS
 SG_ DET_SNR_165 : 120|8@1+ (0.35156,0) [0|89.6478] "dB"  ADAS
 SG_ DET_EXISTENCE_PROB_165 : 112|6@1+ (1.588,0) [0|100] "%"  ADAS
 SG_ DET_HVC_FLAG_165 : 86|1@1+ (1,0) [0|1] ""  ADAS
 SG_ DET_CONFD_AZIMUTH_165 : 118|2@1+ (1,0) [0|3] ""  ADAS
 SG_ DET_CONFD_ELEVATION_165 : 101|2@1+ (1,0) [0|3] ""  ADAS
 SG_ DET_PROB_1STAZHYPO_165 : 103|1@1+ (1,0) [0|1] ""  ADAS
 SG_ DET_IDM_165 : 63|1@1+ (1,0) [0|1] ""  ADAS
 SG_ DET_MTD_165 : 47|1@1+ (1,0) [0|1] ""  ADAS
 SG_ DET_BELOW_RAIN_THOLD_165 : 39|1@1+ (1,0) [0|1] ""  ADAS
 SG_ DET_RANGE_166 : 136|15@1+ (0.015625,0) [0|500] "m"  ADAS
 SG_ DET_RANGE_ERR_166 : 152|7@1+ (0.0075,0) [0|0.9525] "m"  ADAS
 SG_ DET_RANGE_VELOCITY_166 : 160|15@1+ (0.0078125,-128) [-128|127.9921875] "m/s"  ADAS
 SG_ DET_RANGE_VELOCITY_ERR_166 : 176|8@1+ (0.003,0) [0|0.765] "m/s"  ADAS
 SG_ DET_AZIMUTH_166 : 200|13@1+ (0.0004,-1.5708) [-1.5708|1.5708] "rad"  ADAS
 SG_ DET_AZIMUTH_ERR_166 : 217|7@1+ (0.00087267,0) [0|0.11082909] "rad"  ADAS
 SG_ DET_ELEVATION_166 : 184|8@1+ (0.00275,-0.34925) [-0.34925|0.34925] "rad"  ADAS
 SG_ DET_ELEVATION_ERR_166 : 192|6@1+ (0.00174533,0) [0|0.10995579] "rad"  ADAS
 SG_ DET_RCS_166 : 240|8@1+ (0.5,-64) [-64|63.5] "dBsm"  ADAS
 SG_ DET_BI_STATIC_FLAG_166 : 216|1@1+ (1,0) [0|1] ""  ADAS
 SG_ DET_SUPER_RES_TARGET_166 : 199|1@1+ (1,0) [0|1] ""  ADAS
 SG_ DET_SNR_166 : 232|8@1+ (0.35156,0) [0|89.6478] "dB"  ADAS
 SG_ DET_EXISTENCE_PROB_166 : 224|6@1+ (1.588,0) [0|100] "%"  ADAS
 SG_ DET_HVC_FLAG_166 : 198|1@1+ (1,0) [0|1] ""  ADAS
 SG_ DET_CONFD_AZIMUTH_166 : 230|2@1+ (1,0) [0|3] ""  ADAS
 SG_ DET_CONFD_ELEVATION_166 : 213|2@1+ (1,0) [0|3] ""  ADAS
 SG_ DET_PROB_1STAZHYPO_166 : 215|1@1+ (1,0) [0|1] ""  ADAS
 SG_ DET_IDM_166 : 175|1@1+ (1,0) [0|1] ""  ADAS
 SG_ DET_MTD_166 : 159|1@1+ (1,0) [0|1] ""  ADAS
 SG_ DET_BELOW_RAIN_THOLD_166 : 151|1@1+ (1,0) [0|1] ""  ADAS
 SG_ DET_RANGE_167 : 248|15@1+ (0.015625,0) [0|500] "m"  ADAS
 SG_ DET_RANGE_ERR_167 : 264|7@1+ (0.0075,0) [0|0.9525] "m"  ADAS
 SG_ DET_RANGE_VELOCITY_167 : 272|15@1+ (0.0078125,-128) [-128|127.9921875] "m/s"  ADAS
 SG_ DET_RANGE_VELOCITY_ERR_167 : 288|8@1+ (0.003,0) [0|0.765] "m/s"  ADAS
 SG_ DET_AZIMUTH_167 : 312|13@1+ (0.0004,-1.5708) [-1.5708|1.5708] "rad"  ADAS
 SG_ DET_AZIMUTH_ERR_167 : 329|7@1+ (0.00087267,0) [0|0.11082909] "rad"  ADAS
 SG_ DET_ELEVATION_167 : 296|8@1+ (0.00275,-0.34925) [-0.34925|0.34925] "rad"  ADAS
 SG_ DET_ELEVATION_ERR_167 : 304|6@1+ (0.00174533,0) [0|0.10995579] "rad"  ADAS
 SG_ DET_RCS_167 : 352|8@1+ (0.5,-64) [-64|63.5] "dBsm"  ADAS
 SG_ DET_BI_STATIC_FLAG_167 : 328|1@1+ (1,0) [0|1] ""  ADAS
 SG_ DET_SUPER_RES_TARGET_167 : 311|1@1+ (1,0) [0|1] ""  ADAS
 SG_ DET_SNR_167 : 344|8@1+ (0.35156,0) [0|89.6478] "dB"  ADAS
 SG_ DET_EXISTENCE_PROB_167 : 336|6@1+ (1.588,0) [0|100] "%"  ADAS
 SG_ DET_HVC_FLAG_167 : 310|1@1+ (1,0) [0|1] ""  ADAS
 SG_ DET_CONFD_AZIMUTH_167 : 342|2@1+ (1,0) [0|3] ""  ADAS
 SG_ DET_CONFD_ELEVATION_167 : 325|2@1+ (1,0) [0|3] ""  ADAS
 SG_ DET_PROB_1STAZHYPO_167 : 327|1@1+ (1,0) [0|1] ""  ADAS
 SG_ DET_IDM_167 : 287|1@1+ (1,0) [0|1] ""  ADAS
 SG_ DET_MTD_167 : 271|1@1+ (1,0) [0|1] ""  ADAS
 SG_ DET_BELOW_RAIN_THOLD_167 : 263|1@1+ (1,0) [0|1] ""  ADAS
 SG_ DET_RANGE_168 : 360|15@1+ (0.015625,0) [0|500] "m"  ADAS
 SG_ DET_RANGE_ERR_168 : 376|7@1+ (0.0075,0) [0|0.9525] "m"  ADAS
 SG_ DET_RANGE_VELOCITY_168 : 384|15@1+ (0.0078125,-128) [-128|127.9921875] "m/s"  ADAS
 SG_ DET_RANGE_VELOCITY_ERR_168 : 400|8@1+ (0.003,0) [0|0.765] "m/s"  ADAS
 SG_ DET_AZIMUTH_168 : 424|13@1+ (0.0004,-1.5708) [-1.5708|1.5708] "rad"  ADAS
 SG_ DET_AZIMUTH_ERR_168 : 441|7@1+ (0.00087267,0) [0|0.11082909] "rad"  ADAS
 SG_ DET_ELEVATION_168 : 408|8@1+ (0.00275,-0.34925) [-0.34925|0.34925] "rad"  ADAS
 SG_ DET_ELEVATION_ERR_168 : 416|6@1+ (0.00174533,0) [0|0.10995579] "rad"  ADAS
 SG_ DET_RCS_168 : 464|8@1+ (0.5,-64) [-64|63.5] "dBsm"  ADAS
 SG_ DET_BI_STATIC_FLAG_168 : 440|1@1+ (1,0) [0|1] ""  ADAS
 SG_ DET_SUPER_RES_TARGET_168 : 423|1@1+ (1,0) [0|1] ""  ADAS
 SG_ DET_SNR_168 : 456|8@1+ (0.35156,0) [0|89.6478] "dB"  ADAS
 SG_ DET_EXISTENCE_PROB_168 : 448|6@1+ (1.588,0) [0|100] "%"  ADAS
 SG_ DET_HVC_FLAG_168 : 422|1@1+ (1,0) [0|1] ""  ADAS
 SG_ DET_CONFD_AZIMUTH_168 : 454|2@1+ (1,0) [0|3] ""  ADAS
 SG_ DET_CONFD_ELEVATION_168 : 437|2@1+ (1,0) [0|3] ""  ADAS
 SG_ DET_MH_SCAN_INDEX_4LSB_165_168 : 476|4@1+ (1,0) [0|15] ""  ADAS
 SG_ DET_MH_CYCLE_COUNTER_165_168 : 16|8@1+ (1,0) [0|255] ""  ADAS
 SG_ DET_MH_CRC16_165_168 : 0|16@1+ (1,0) [0|65535] ""  ADAS
 SG_ DET_PROB_1STAZHYPO_168 : 439|1@1+ (1,0) [0|1] ""  ADAS
 SG_ DET_IDM_168 : 399|1@1+ (1,0) [0|1] ""  ADAS
 SG_ DET_MTD_168 : 383|1@1+ (1,0) [0|1] ""  ADAS
 SG_ DET_BELOW_RAIN_THOLD_168 : 375|1@1+ (1,0) [0|1] ""  ADAS

BO_ 1194 RDR_DETECTION_169_172: 64 RDR08
 SG_ DET_RANGE_169 : 24|15@1+ (0.015625,0) [0|500] "m"  ADAS
 SG_ DET_RANGE_ERR_169 : 40|7@1+ (0.0075,0) [0|0.9525] "m"  ADAS
 SG_ DET_RANGE_VELOCITY_169 : 48|15@1+ (0.0078125,-128) [-128|127.9921875] "m/s"  ADAS
 SG_ DET_RANGE_VELOCITY_ERR_169 : 64|8@1+ (0.003,0) [0|0.765] "m/s"  ADAS
 SG_ DET_AZIMUTH_169 : 88|13@1+ (0.0004,-1.5708) [-1.5708|1.5708] "rad"  ADAS
 SG_ DET_AZIMUTH_ERR_169 : 105|7@1+ (0.00087267,0) [0|0.11082909] "rad"  ADAS
 SG_ DET_ELEVATION_169 : 72|8@1+ (0.00275,-0.34925) [-0.34925|0.34925] "rad"  ADAS
 SG_ DET_ELEVATION_ERR_169 : 80|6@1+ (0.00174533,0) [0|0.10995579] "rad"  ADAS
 SG_ DET_RCS_169 : 128|8@1+ (0.5,-64) [-64|63.5] "dBsm"  ADAS
 SG_ DET_BI_STATIC_FLAG_169 : 104|1@1+ (1,0) [0|1] ""  ADAS
 SG_ DET_SUPER_RES_TARGET_169 : 87|1@1+ (1,0) [0|1] ""  ADAS
 SG_ DET_SNR_169 : 120|8@1+ (0.35156,0) [0|89.6478] "dB"  ADAS
 SG_ DET_EXISTENCE_PROB_169 : 112|6@1+ (1.588,0) [0|100] "%"  ADAS
 SG_ DET_HVC_FLAG_169 : 86|1@1+ (1,0) [0|1] ""  ADAS
 SG_ DET_CONFD_AZIMUTH_169 : 118|2@1+ (1,0) [0|3] ""  ADAS
 SG_ DET_CONFD_ELEVATION_169 : 101|2@1+ (1,0) [0|3] ""  ADAS
 SG_ DET_PROB_1STAZHYPO_169 : 103|1@1+ (1,0) [0|1] ""  ADAS
 SG_ DET_IDM_169 : 63|1@1+ (1,0) [0|1] ""  ADAS
 SG_ DET_MTD_169 : 47|1@1+ (1,0) [0|1] ""  ADAS
 SG_ DET_BELOW_RAIN_THOLD_169 : 39|1@1+ (1,0) [0|1] ""  ADAS
 SG_ DET_RANGE_170 : 136|15@1+ (0.015625,0) [0|500] "m"  ADAS
 SG_ DET_RANGE_ERR_170 : 152|7@1+ (0.0075,0) [0|0.9525] "m"  ADAS
 SG_ DET_RANGE_VELOCITY_170 : 160|15@1+ (0.0078125,-128) [-128|127.9921875] "m/s"  ADAS
 SG_ DET_RANGE_VELOCITY_ERR_170 : 176|8@1+ (0.003,0) [0|0.765] "m/s"  ADAS
 SG_ DET_AZIMUTH_170 : 200|13@1+ (0.0004,-1.5708) [-1.5708|1.5708] "rad"  ADAS
 SG_ DET_AZIMUTH_ERR_170 : 217|7@1+ (0.00087267,0) [0|0.11082909] "rad"  ADAS
 SG_ DET_ELEVATION_170 : 184|8@1+ (0.00275,-0.34925) [-0.34925|0.34925] "rad"  ADAS
 SG_ DET_ELEVATION_ERR_170 : 192|6@1+ (0.00174533,0) [0|0.10995579] "rad"  ADAS
 SG_ DET_RCS_170 : 240|8@1+ (0.5,-64) [-64|63.5] "dBsm"  ADAS
 SG_ DET_BI_STATIC_FLAG_170 : 216|1@1+ (1,0) [0|1] ""  ADAS
 SG_ DET_SUPER_RES_TARGET_170 : 199|1@1+ (1,0) [0|1] ""  ADAS
 SG_ DET_SNR_170 : 232|8@1+ (0.35156,0) [0|89.6478] "dB"  ADAS
 SG_ DET_EXISTENCE_PROB_170 : 224|6@1+ (1.588,0) [0|100] "%"  ADAS
 SG_ DET_HVC_FLAG_170 : 198|1@1+ (1,0) [0|1] ""  ADAS
 SG_ DET_CONFD_AZIMUTH_170 : 230|2@1+ (1,0) [0|3] ""  ADAS
 SG_ DET_CONFD_ELEVATION_170 : 213|2@1+ (1,0) [0|3] ""  ADAS
 SG_ DET_PROB_1STAZHYPO_170 : 215|1@1+ (1,0) [0|1] ""  ADAS
 SG_ DET_IDM_170 : 175|1@1+ (1,0) [0|1] ""  ADAS
 SG_ DET_MTD_170 : 159|1@1+ (1,0) [0|1] ""  ADAS
 SG_ DET_BELOW_RAIN_THOLD_170 : 151|1@1+ (1,0) [0|1] ""  ADAS
 SG_ DET_RANGE_171 : 248|15@1+ (0.015625,0) [0|500] "m"  ADAS
 SG_ DET_RANGE_ERR_171 : 264|7@1+ (0.0075,0) [0|0.9525] "m"  ADAS
 SG_ DET_RANGE_VELOCITY_171 : 272|15@1+ (0.0078125,-128) [-128|127.9921875] "m/s"  ADAS
 SG_ DET_RANGE_VELOCITY_ERR_171 : 288|8@1+ (0.003,0) [0|0.765] "m/s"  ADAS
 SG_ DET_AZIMUTH_171 : 312|13@1+ (0.0004,-1.5708) [-1.5708|1.5708] "rad"  ADAS
 SG_ DET_AZIMUTH_ERR_171 : 329|7@1+ (0.00087267,0) [0|0.11082909] "rad"  ADAS
 SG_ DET_ELEVATION_171 : 296|8@1+ (0.00275,-0.34925) [-0.34925|0.34925] "rad"  ADAS
 SG_ DET_ELEVATION_ERR_171 : 304|6@1+ (0.00174533,0) [0|0.10995579] "rad"  ADAS
 SG_ DET_RCS_171 : 352|8@1+ (0.5,-64) [-64|63.5] "dBsm"  ADAS
 SG_ DET_BI_STATIC_FLAG_171 : 328|1@1+ (1,0) [0|1] ""  ADAS
 SG_ DET_SUPER_RES_TARGET_171 : 311|1@1+ (1,0) [0|1] ""  ADAS
 SG_ DET_SNR_171 : 344|8@1+ (0.35156,0) [0|89.6478] "dB"  ADAS
 SG_ DET_EXISTENCE_PROB_171 : 336|6@1+ (1.588,0) [0|100] "%"  ADAS
 SG_ DET_HVC_FLAG_171 : 310|1@1+ (1,0) [0|1] ""  ADAS
 SG_ DET_CONFD_AZIMUTH_171 : 342|2@1+ (1,0) [0|3] ""  ADAS
 SG_ DET_CONFD_ELEVATION_171 : 325|2@1+ (1,0) [0|3] ""  ADAS
 SG_ DET_PROB_1STAZHYPO_171 : 327|1@1+ (1,0) [0|1] ""  ADAS
 SG_ DET_IDM_171 : 287|1@1+ (1,0) [0|1] ""  ADAS
 SG_ DET_MTD_171 : 271|1@1+ (1,0) [0|1] ""  ADAS
 SG_ DET_BELOW_RAIN_THOLD_171 : 263|1@1+ (1,0) [0|1] ""  ADAS
 SG_ DET_RANGE_172 : 360|15@1+ (0.015625,0) [0|500] "m"  ADAS
 SG_ DET_RANGE_ERR_172 : 376|7@1+ (0.0075,0) [0|0.9525] "m"  ADAS
 SG_ DET_RANGE_VELOCITY_172 : 384|15@1+ (0.0078125,-128) [-128|127.9921875] "m/s"  ADAS
 SG_ DET_RANGE_VELOCITY_ERR_172 : 400|8@1+ (0.003,0) [0|0.765] "m/s"  ADAS
 SG_ DET_AZIMUTH_172 : 424|13@1+ (0.0004,-1.5708) [-1.5708|1.5708] "rad"  ADAS
 SG_ DET_AZIMUTH_ERR_172 : 441|7@1+ (0.00087267,0) [0|0.11082909] "rad"  ADAS
 SG_ DET_ELEVATION_172 : 408|8@1+ (0.00275,-0.34925) [-0.34925|0.34925] "rad"  ADAS
 SG_ DET_ELEVATION_ERR_172 : 416|6@1+ (0.00174533,0) [0|0.10995579] "rad"  ADAS
 SG_ DET_RCS_172 : 464|8@1+ (0.5,-64) [-64|63.5] "dBsm"  ADAS
 SG_ DET_BI_STATIC_FLAG_172 : 440|1@1+ (1,0) [0|1] ""  ADAS
 SG_ DET_SUPER_RES_TARGET_172 : 423|1@1+ (1,0) [0|1] ""  ADAS
 SG_ DET_SNR_172 : 456|8@1+ (0.35156,0) [0|89.6478] "dB"  ADAS
 SG_ DET_EXISTENCE_PROB_172 : 448|6@1+ (1.588,0) [0|100] "%"  ADAS
 SG_ DET_HVC_FLAG_172 : 422|1@1+ (1,0) [0|1] ""  ADAS
 SG_ DET_CONFD_AZIMUTH_172 : 454|2@1+ (1,0) [0|3] ""  ADAS
 SG_ DET_CONFD_ELEVATION_172 : 437|2@1+ (1,0) [0|3] ""  ADAS
 SG_ DET_MH_SCAN_INDEX_4LSB_169_172 : 476|4@1+ (1,0) [0|15] ""  ADAS
 SG_ DET_MH_CYCLE_COUNTER_169_172 : 16|8@1+ (1,0) [0|255] ""  ADAS
 SG_ DET_MH_CRC16_169_172 : 0|16@1+ (1,0) [0|65535] ""  ADAS
 SG_ DET_PROB_1STAZHYPO_172 : 439|1@1+ (1,0) [0|1] ""  ADAS
 SG_ DET_IDM_172 : 399|1@1+ (1,0) [0|1] ""  ADAS
 SG_ DET_MTD_172 : 383|1@1+ (1,0) [0|1] ""  ADAS
 SG_ DET_BELOW_RAIN_THOLD_172 : 375|1@1+ (1,0) [0|1] ""  ADAS

BO_ 1195 RDR_DETECTION_173_176: 64 RDR08
 SG_ DET_RANGE_173 : 24|15@1+ (0.015625,0) [0|500] "m"  ADAS
 SG_ DET_RANGE_ERR_173 : 40|7@1+ (0.0075,0) [0|0.9525] "m"  ADAS
 SG_ DET_RANGE_VELOCITY_173 : 48|15@1+ (0.0078125,-128) [-128|127.9921875] "m/s"  ADAS
 SG_ DET_RANGE_VELOCITY_ERR_173 : 64|8@1+ (0.003,0) [0|0.765] "m/s"  ADAS
 SG_ DET_AZIMUTH_173 : 88|13@1+ (0.0004,-1.5708) [-1.5708|1.5708] "rad"  ADAS
 SG_ DET_AZIMUTH_ERR_173 : 105|7@1+ (0.00087267,0) [0|0.11082909] "rad"  ADAS
 SG_ DET_ELEVATION_173 : 72|8@1+ (0.00275,-0.34925) [-0.34925|0.34925] "rad"  ADAS
 SG_ DET_ELEVATION_ERR_173 : 80|6@1+ (0.00174533,0) [0|0.10995579] "rad"  ADAS
 SG_ DET_RCS_173 : 128|8@1+ (0.5,-64) [-64|63.5] "dBsm"  ADAS
 SG_ DET_BI_STATIC_FLAG_173 : 104|1@1+ (1,0) [0|1] ""  ADAS
 SG_ DET_SUPER_RES_TARGET_173 : 87|1@1+ (1,0) [0|1] ""  ADAS
 SG_ DET_SNR_173 : 120|8@1+ (0.35156,0) [0|89.6478] "dB"  ADAS
 SG_ DET_EXISTENCE_PROB_173 : 112|6@1+ (1.588,0) [0|100] "%"  ADAS
 SG_ DET_HVC_FLAG_173 : 86|1@1+ (1,0) [0|1] ""  ADAS
 SG_ DET_CONFD_AZIMUTH_173 : 118|2@1+ (1,0) [0|3] ""  ADAS
 SG_ DET_CONFD_ELEVATION_173 : 101|2@1+ (1,0) [0|3] ""  ADAS
 SG_ DET_PROB_1STAZHYPO_173 : 103|1@1+ (1,0) [0|1] ""  ADAS
 SG_ DET_IDM_173 : 63|1@1+ (1,0) [0|1] ""  ADAS
 SG_ DET_MTD_173 : 47|1@1+ (1,0) [0|1] ""  ADAS
 SG_ DET_BELOW_RAIN_THOLD_173 : 39|1@1+ (1,0) [0|1] ""  ADAS
 SG_ DET_RANGE_174 : 136|15@1+ (0.015625,0) [0|500] "m"  ADAS
 SG_ DET_RANGE_ERR_174 : 152|7@1+ (0.0075,0) [0|0.9525] "m"  ADAS
 SG_ DET_RANGE_VELOCITY_174 : 160|15@1+ (0.0078125,-128) [-128|127.9921875] "m/s"  ADAS
 SG_ DET_RANGE_VELOCITY_ERR_174 : 176|8@1+ (0.003,0) [0|0.765] "m/s"  ADAS
 SG_ DET_AZIMUTH_174 : 200|13@1+ (0.0004,-1.5708) [-1.5708|1.5708] "rad"  ADAS
 SG_ DET_AZIMUTH_ERR_174 : 217|7@1+ (0.00087267,0) [0|0.11082909] "rad"  ADAS
 SG_ DET_ELEVATION_174 : 184|8@1+ (0.00275,-0.34925) [-0.34925|0.34925] "rad"  ADAS
 SG_ DET_ELEVATION_ERR_174 : 192|6@1+ (0.00174533,0) [0|0.10995579] "rad"  ADAS
 SG_ DET_RCS_174 : 240|8@1+ (0.5,-64) [-64|63.5] "dBsm"  ADAS
 SG_ DET_BI_STATIC_FLAG_174 : 216|1@1+ (1,0) [0|1] ""  ADAS
 SG_ DET_SUPER_RES_TARGET_174 : 199|1@1+ (1,0) [0|1] ""  ADAS
 SG_ DET_SNR_174 : 232|8@1+ (0.35156,0) [0|89.6478] "dB"  ADAS
 SG_ DET_EXISTENCE_PROB_174 : 224|6@1+ (1.588,0) [0|100] "%"  ADAS
 SG_ DET_HVC_FLAG_174 : 198|1@1+ (1,0) [0|1] ""  ADAS
 SG_ DET_CONFD_AZIMUTH_174 : 230|2@1+ (1,0) [0|3] ""  ADAS
 SG_ DET_CONFD_ELEVATION_174 : 213|2@1+ (1,0) [0|3] ""  ADAS
 SG_ DET_PROB_1STAZHYPO_174 : 215|1@1+ (1,0) [0|1] ""  ADAS
 SG_ DET_IDM_174 : 175|1@1+ (1,0) [0|1] ""  ADAS
 SG_ DET_MTD_174 : 159|1@1+ (1,0) [0|1] ""  ADAS
 SG_ DET_BELOW_RAIN_THOLD_174 : 151|1@1+ (1,0) [0|1] ""  ADAS
 SG_ DET_RANGE_175 : 248|15@1+ (0.015625,0) [0|500] "m"  ADAS
 SG_ DET_RANGE_ERR_175 : 264|7@1+ (0.0075,0) [0|0.9525] "m"  ADAS
 SG_ DET_RANGE_VELOCITY_175 : 272|15@1+ (0.0078125,-128) [-128|127.9921875] "m/s"  ADAS
 SG_ DET_RANGE_VELOCITY_ERR_175 : 288|8@1+ (0.003,0) [0|0.765] "m/s"  ADAS
 SG_ DET_AZIMUTH_175 : 312|13@1+ (0.0004,-1.5708) [-1.5708|1.5708] "rad"  ADAS
 SG_ DET_AZIMUTH_ERR_175 : 329|7@1+ (0.00087267,0) [0|0.11082909] "rad"  ADAS
 SG_ DET_ELEVATION_175 : 296|8@1+ (0.00275,-0.34925) [-0.34925|0.34925] "rad"  ADAS
 SG_ DET_ELEVATION_ERR_175 : 304|6@1+ (0.00174533,0) [0|0.10995579] "rad"  ADAS
 SG_ DET_RCS_175 : 352|8@1+ (0.5,-64) [-64|63.5] "dBsm"  ADAS
 SG_ DET_BI_STATIC_FLAG_175 : 328|1@1+ (1,0) [0|1] ""  ADAS
 SG_ DET_SUPER_RES_TARGET_175 : 311|1@1+ (1,0) [0|1] ""  ADAS
 SG_ DET_SNR_175 : 344|8@1+ (0.35156,0) [0|89.6478] "dB"  ADAS
 SG_ DET_EXISTENCE_PROB_175 : 336|6@1+ (1.588,0) [0|100] "%"  ADAS
 SG_ DET_HVC_FLAG_175 : 310|1@1+ (1,0) [0|1] ""  ADAS
 SG_ DET_CONFD_AZIMUTH_175 : 342|2@1+ (1,0) [0|3] ""  ADAS
 SG_ DET_CONFD_ELEVATION_175 : 325|2@1+ (1,0) [0|3] ""  ADAS
 SG_ DET_PROB_1STAZHYPO_175 : 327|1@1+ (1,0) [0|1] ""  ADAS
 SG_ DET_IDM_175 : 287|1@1+ (1,0) [0|1] ""  ADAS
 SG_ DET_MTD_175 : 271|1@1+ (1,0) [0|1] ""  ADAS
 SG_ DET_BELOW_RAIN_THOLD_175 : 263|1@1+ (1,0) [0|1] ""  ADAS
 SG_ DET_RANGE_176 : 360|15@1+ (0.015625,0) [0|500] "m"  ADAS
 SG_ DET_RANGE_ERR_176 : 376|7@1+ (0.0075,0) [0|0.9525] "m"  ADAS
 SG_ DET_RANGE_VELOCITY_176 : 384|15@1+ (0.0078125,-128) [-128|127.9921875] "m/s"  ADAS
 SG_ DET_RANGE_VELOCITY_ERR_176 : 400|8@1+ (0.003,0) [0|0.765] "m/s"  ADAS
 SG_ DET_AZIMUTH_176 : 424|13@1+ (0.0004,-1.5708) [-1.5708|1.5708] "rad"  ADAS
 SG_ DET_AZIMUTH_ERR_176 : 441|7@1+ (0.00087267,0) [0|0.11082909] "rad"  ADAS
 SG_ DET_ELEVATION_176 : 408|8@1+ (0.00275,-0.34925) [-0.34925|0.34925] "rad"  ADAS
 SG_ DET_ELEVATION_ERR_176 : 416|6@1+ (0.00174533,0) [0|0.10995579] "rad"  ADAS
 SG_ DET_RCS_176 : 464|8@1+ (0.5,-64) [-64|63.5] "dBsm"  ADAS
 SG_ DET_BI_STATIC_FLAG_176 : 440|1@1+ (1,0) [0|1] ""  ADAS
 SG_ DET_SUPER_RES_TARGET_176 : 423|1@1+ (1,0) [0|1] ""  ADAS
 SG_ DET_SNR_176 : 456|8@1+ (0.35156,0) [0|89.6478] "dB"  ADAS
 SG_ DET_EXISTENCE_PROB_176 : 448|6@1+ (1.588,0) [0|100] "%"  ADAS
 SG_ DET_HVC_FLAG_176 : 422|1@1+ (1,0) [0|1] ""  ADAS
 SG_ DET_CONFD_AZIMUTH_176 : 454|2@1+ (1,0) [0|3] ""  ADAS
 SG_ DET_CONFD_ELEVATION_176 : 437|2@1+ (1,0) [0|3] ""  ADAS
 SG_ DET_MH_SCAN_INDEX_4LSB_173_176 : 476|4@1+ (1,0) [0|15] ""  ADAS
 SG_ DET_MH_CYCLE_COUNTER_173_176 : 16|8@1+ (1,0) [0|255] ""  ADAS
 SG_ DET_MH_CRC16_173_176 : 0|16@1+ (1,0) [0|65535] ""  ADAS
 SG_ DET_PROB_1STAZHYPO_176 : 439|1@1+ (1,0) [0|1] ""  ADAS
 SG_ DET_IDM_176 : 399|1@1+ (1,0) [0|1] ""  ADAS
 SG_ DET_MTD_176 : 383|1@1+ (1,0) [0|1] ""  ADAS
 SG_ DET_BELOW_RAIN_THOLD_176 : 375|1@1+ (1,0) [0|1] ""  ADAS

BO_ 1196 RDR_DETECTION_177_180: 64 RDR08
 SG_ DET_RANGE_177 : 24|15@1+ (0.015625,0) [0|500] "m"  ADAS
 SG_ DET_RANGE_ERR_177 : 40|7@1+ (0.0075,0) [0|0.9525] "m"  ADAS
 SG_ DET_RANGE_VELOCITY_177 : 48|15@1+ (0.0078125,-128) [-128|127.9921875] "m/s"  ADAS
 SG_ DET_RANGE_VELOCITY_ERR_177 : 64|8@1+ (0.003,0) [0|0.765] "m/s"  ADAS
 SG_ DET_AZIMUTH_177 : 88|13@1+ (0.0004,-1.5708) [-1.5708|1.5708] "rad"  ADAS
 SG_ DET_AZIMUTH_ERR_177 : 105|7@1+ (0.00087267,0) [0|0.11082909] "rad"  ADAS
 SG_ DET_ELEVATION_177 : 72|8@1+ (0.00275,-0.34925) [-0.34925|0.34925] "rad"  ADAS
 SG_ DET_ELEVATION_ERR_177 : 80|6@1+ (0.00174533,0) [0|0.10995579] "rad"  ADAS
 SG_ DET_RCS_177 : 128|8@1+ (0.5,-64) [-64|63.5] "dBsm"  ADAS
 SG_ DET_BI_STATIC_FLAG_177 : 104|1@1+ (1,0) [0|1] ""  ADAS
 SG_ DET_SUPER_RES_TARGET_177 : 87|1@1+ (1,0) [0|1] ""  ADAS
 SG_ DET_SNR_177 : 120|8@1+ (0.35156,0) [0|89.6478] "dB"  ADAS
 SG_ DET_EXISTENCE_PROB_177 : 112|6@1+ (1.588,0) [0|100] "%"  ADAS
 SG_ DET_HVC_FLAG_177 : 86|1@1+ (1,0) [0|1] ""  ADAS
 SG_ DET_CONFD_AZIMUTH_177 : 118|2@1+ (1,0) [0|3] ""  ADAS
 SG_ DET_CONFD_ELEVATION_177 : 101|2@1+ (1,0) [0|3] ""  ADAS
 SG_ DET_PROB_1STAZHYPO_177 : 103|1@1+ (1,0) [0|1] ""  ADAS
 SG_ DET_IDM_177 : 63|1@1+ (1,0) [0|1] ""  ADAS
 SG_ DET_MTD_177 : 47|1@1+ (1,0) [0|1] ""  ADAS
 SG_ DET_BELOW_RAIN_THOLD_177 : 39|1@1+ (1,0) [0|1] ""  ADAS
 SG_ DET_RANGE_178 : 136|15@1+ (0.015625,0) [0|500] "m"  ADAS
 SG_ DET_RANGE_ERR_178 : 152|7@1+ (0.0075,0) [0|0.9525] "m"  ADAS
 SG_ DET_RANGE_VELOCITY_178 : 160|15@1+ (0.0078125,-128) [-128|127.9921875] "m/s"  ADAS
 SG_ DET_RANGE_VELOCITY_ERR_178 : 176|8@1+ (0.003,0) [0|0.765] "m/s"  ADAS
 SG_ DET_AZIMUTH_178 : 200|13@1+ (0.0004,-1.5708) [-1.5708|1.5708] "rad"  ADAS
 SG_ DET_AZIMUTH_ERR_178 : 217|7@1+ (0.00087267,0) [0|0.11082909] "rad"  ADAS
 SG_ DET_ELEVATION_178 : 184|8@1+ (0.00275,-0.34925) [-0.34925|0.34925] "rad"  ADAS
 SG_ DET_ELEVATION_ERR_178 : 192|6@1+ (0.00174533,0) [0|0.10995579] "rad"  ADAS
 SG_ DET_RCS_178 : 240|8@1+ (0.5,-64) [-64|63.5] "dBsm"  ADAS
 SG_ DET_BI_STATIC_FLAG_178 : 216|1@1+ (1,0) [0|1] ""  ADAS
 SG_ DET_SUPER_RES_TARGET_178 : 199|1@1+ (1,0) [0|1] ""  ADAS
 SG_ DET_SNR_178 : 232|8@1+ (0.35156,0) [0|89.6478] "dB"  ADAS
 SG_ DET_EXISTENCE_PROB_178 : 224|6@1+ (1.588,0) [0|100] "%"  ADAS
 SG_ DET_HVC_FLAG_178 : 198|1@1+ (1,0) [0|1] ""  ADAS
 SG_ DET_CONFD_AZIMUTH_178 : 230|2@1+ (1,0) [0|3] ""  ADAS
 SG_ DET_CONFD_ELEVATION_178 : 213|2@1+ (1,0) [0|3] ""  ADAS
 SG_ DET_PROB_1STAZHYPO_178 : 215|1@1+ (1,0) [0|1] ""  ADAS
 SG_ DET_IDM_178 : 175|1@1+ (1,0) [0|1] ""  ADAS
 SG_ DET_MTD_178 : 159|1@1+ (1,0) [0|1] ""  ADAS
 SG_ DET_BELOW_RAIN_THOLD_178 : 151|1@1+ (1,0) [0|1] ""  ADAS
 SG_ DET_RANGE_179 : 248|15@1+ (0.015625,0) [0|500] "m"  ADAS
 SG_ DET_RANGE_ERR_179 : 264|7@1+ (0.0075,0) [0|0.9525] "m"  ADAS
 SG_ DET_RANGE_VELOCITY_179 : 272|15@1+ (0.0078125,-128) [-128|127.9921875] "m/s"  ADAS
 SG_ DET_RANGE_VELOCITY_ERR_179 : 288|8@1+ (0.003,0) [0|0.765] "m/s"  ADAS
 SG_ DET_AZIMUTH_179 : 312|13@1+ (0.0004,-1.5708) [-1.5708|1.5708] "rad"  ADAS
 SG_ DET_AZIMUTH_ERR_179 : 329|7@1+ (0.00087267,0) [0|0.11082909] "rad"  ADAS
 SG_ DET_ELEVATION_179 : 296|8@1+ (0.00275,-0.34925) [-0.34925|0.34925] "rad"  ADAS
 SG_ DET_ELEVATION_ERR_179 : 304|6@1+ (0.00174533,0) [0|0.10995579] "rad"  ADAS
 SG_ DET_RCS_179 : 352|8@1+ (0.5,-64) [-64|63.5] "dBsm"  ADAS
 SG_ DET_BI_STATIC_FLAG_179 : 328|1@1+ (1,0) [0|1] ""  ADAS
 SG_ DET_SUPER_RES_TARGET_179 : 311|1@1+ (1,0) [0|1] ""  ADAS
 SG_ DET_SNR_179 : 344|8@1+ (0.35156,0) [0|89.6478] "dB"  ADAS
 SG_ DET_EXISTENCE_PROB_179 : 336|6@1+ (1.588,0) [0|100] "%"  ADAS
 SG_ DET_HVC_FLAG_179 : 310|1@1+ (1,0) [0|1] ""  ADAS
 SG_ DET_CONFD_AZIMUTH_179 : 342|2@1+ (1,0) [0|3] ""  ADAS
 SG_ DET_CONFD_ELEVATION_179 : 325|2@1+ (1,0) [0|3] ""  ADAS
 SG_ DET_PROB_1STAZHYPO_179 : 327|1@1+ (1,0) [0|1] ""  ADAS
 SG_ DET_IDM_179 : 287|1@1+ (1,0) [0|1] ""  ADAS
 SG_ DET_MTD_179 : 271|1@1+ (1,0) [0|1] ""  ADAS
 SG_ DET_BELOW_RAIN_THOLD_179 : 263|1@1+ (1,0) [0|1] ""  ADAS
 SG_ DET_RANGE_180 : 360|15@1+ (0.015625,0) [0|500] "m"  ADAS
 SG_ DET_RANGE_ERR_180 : 376|7@1+ (0.0075,0) [0|0.9525] "m"  ADAS
 SG_ DET_RANGE_VELOCITY_180 : 384|15@1+ (0.0078125,-128) [-128|127.9921875] "m/s"  ADAS
 SG_ DET_RANGE_VELOCITY_ERR_180 : 400|8@1+ (0.003,0) [0|0.765] "m/s"  ADAS
 SG_ DET_AZIMUTH_180 : 424|13@1+ (0.0004,-1.5708) [-1.5708|1.5708] "rad"  ADAS
 SG_ DET_AZIMUTH_ERR_180 : 441|7@1+ (0.00087267,0) [0|0.11082909] "rad"  ADAS
 SG_ DET_ELEVATION_180 : 408|8@1+ (0.00275,-0.34925) [-0.34925|0.34925] "rad"  ADAS
 SG_ DET_ELEVATION_ERR_180 : 416|6@1+ (0.00174533,0) [0|0.10995579] "rad"  ADAS
 SG_ DET_RCS_180 : 464|8@1+ (0.5,-64) [-64|63.5] "dBsm"  ADAS
 SG_ DET_BI_STATIC_FLAG_180 : 440|1@1+ (1,0) [0|1] ""  ADAS
 SG_ DET_SUPER_RES_TARGET_180 : 423|1@1+ (1,0) [0|1] ""  ADAS
 SG_ DET_SNR_180 : 456|8@1+ (0.35156,0) [0|89.6478] "dB"  ADAS
 SG_ DET_EXISTENCE_PROB_180 : 448|6@1+ (1.588,0) [0|100] "%"  ADAS
 SG_ DET_HVC_FLAG_180 : 422|1@1+ (1,0) [0|1] ""  ADAS
 SG_ DET_CONFD_AZIMUTH_180 : 454|2@1+ (1,0) [0|3] ""  ADAS
 SG_ DET_CONFD_ELEVATION_180 : 437|2@1+ (1,0) [0|3] ""  ADAS
 SG_ DET_MH_SCAN_INDEX_4LSB_177_180 : 476|4@1+ (1,0) [0|15] ""  ADAS
 SG_ DET_MH_CYCLE_COUNTER_177_180 : 16|8@1+ (1,0) [0|255] ""  ADAS
 SG_ DET_MH_CRC16_177_180 : 0|16@1+ (1,0) [0|65535] ""  ADAS
 SG_ DET_PROB_1STAZHYPO_180 : 439|1@1+ (1,0) [0|1] ""  ADAS
 SG_ DET_IDM_180 : 399|1@1+ (1,0) [0|1] ""  ADAS
 SG_ DET_MTD_180 : 383|1@1+ (1,0) [0|1] ""  ADAS
 SG_ DET_BELOW_RAIN_THOLD_180 : 375|1@1+ (1,0) [0|1] ""  ADAS

BO_ 1197 RDR_DETECTION_181_184: 64 RDR08
 SG_ DET_RANGE_181 : 24|15@1+ (0.015625,0) [0|500] "m"  ADAS
 SG_ DET_RANGE_ERR_181 : 40|7@1+ (0.0075,0) [0|0.9525] "m"  ADAS
 SG_ DET_RANGE_VELOCITY_181 : 48|15@1+ (0.0078125,-128) [-128|127.9921875] "m/s"  ADAS
 SG_ DET_RANGE_VELOCITY_ERR_181 : 64|8@1+ (0.003,0) [0|0.765] "m/s"  ADAS
 SG_ DET_AZIMUTH_181 : 88|13@1+ (0.0004,-1.5708) [-1.5708|1.5708] "rad"  ADAS
 SG_ DET_AZIMUTH_ERR_181 : 105|7@1+ (0.00087267,0) [0|0.11082909] "rad"  ADAS
 SG_ DET_ELEVATION_181 : 72|8@1+ (0.00275,-0.34925) [-0.34925|0.34925] "rad"  ADAS
 SG_ DET_ELEVATION_ERR_181 : 80|6@1+ (0.00174533,0) [0|0.10995579] "rad"  ADAS
 SG_ DET_RCS_181 : 128|8@1+ (0.5,-64) [-64|63.5] "dBsm"  ADAS
 SG_ DET_BI_STATIC_FLAG_181 : 104|1@1+ (1,0) [0|1] ""  ADAS
 SG_ DET_SUPER_RES_TARGET_181 : 87|1@1+ (1,0) [0|1] ""  ADAS
 SG_ DET_SNR_181 : 120|8@1+ (0.35156,0) [0|89.6478] "dB"  ADAS
 SG_ DET_EXISTENCE_PROB_181 : 112|6@1+ (1.588,0) [0|100] "%"  ADAS
 SG_ DET_HVC_FLAG_181 : 86|1@1+ (1,0) [0|1] ""  ADAS
 SG_ DET_CONFD_AZIMUTH_181 : 118|2@1+ (1,0) [0|3] ""  ADAS
 SG_ DET_CONFD_ELEVATION_181 : 101|2@1+ (1,0) [0|3] ""  ADAS
 SG_ DET_PROB_1STAZHYPO_181 : 103|1@1+ (1,0) [0|1] ""  ADAS
 SG_ DET_IDM_181 : 63|1@1+ (1,0) [0|1] ""  ADAS
 SG_ DET_MTD_181 : 47|1@1+ (1,0) [0|1] ""  ADAS
 SG_ DET_BELOW_RAIN_THOLD_181 : 39|1@1+ (1,0) [0|1] ""  ADAS
 SG_ DET_RANGE_182 : 136|15@1+ (0.015625,0) [0|500] "m"  ADAS
 SG_ DET_RANGE_ERR_182 : 152|7@1+ (0.0075,0) [0|0.9525] "m"  ADAS
 SG_ DET_RANGE_VELOCITY_182 : 160|15@1+ (0.0078125,-128) [-128|127.9921875] "m/s"  ADAS
 SG_ DET_RANGE_VELOCITY_ERR_182 : 176|8@1+ (0.003,0) [0|0.765] "m/s"  ADAS
 SG_ DET_AZIMUTH_182 : 200|13@1+ (0.0004,-1.5708) [-1.5708|1.5708] "rad"  ADAS
 SG_ DET_AZIMUTH_ERR_182 : 217|7@1+ (0.00087267,0) [0|0.11082909] "rad"  ADAS
 SG_ DET_ELEVATION_182 : 184|8@1+ (0.00275,-0.34925) [-0.34925|0.34925] "rad"  ADAS
 SG_ DET_ELEVATION_ERR_182 : 192|6@1+ (0.00174533,0) [0|0.10995579] "rad"  ADAS
 SG_ DET_RCS_182 : 240|8@1+ (0.5,-64) [-64|63.5] "dBsm"  ADAS
 SG_ DET_BI_STATIC_FLAG_182 : 216|1@1+ (1,0) [0|1] ""  ADAS
 SG_ DET_SUPER_RES_TARGET_182 : 199|1@1+ (1,0) [0|1] ""  ADAS
 SG_ DET_SNR_182 : 232|8@1+ (0.35156,0) [0|89.6478] "dB"  ADAS
 SG_ DET_EXISTENCE_PROB_182 : 224|6@1+ (1.588,0) [0|100] "%"  ADAS
 SG_ DET_HVC_FLAG_182 : 198|1@1+ (1,0) [0|1] ""  ADAS
 SG_ DET_CONFD_AZIMUTH_182 : 230|2@1+ (1,0) [0|3] ""  ADAS
 SG_ DET_CONFD_ELEVATION_182 : 213|2@1+ (1,0) [0|3] ""  ADAS
 SG_ DET_PROB_1STAZHYPO_182 : 215|1@1+ (1,0) [0|1] ""  ADAS
 SG_ DET_IDM_182 : 175|1@1+ (1,0) [0|1] ""  ADAS
 SG_ DET_MTD_182 : 159|1@1+ (1,0) [0|1] ""  ADAS
 SG_ DET_BELOW_RAIN_THOLD_182 : 151|1@1+ (1,0) [0|1] ""  ADAS
 SG_ DET_RANGE_183 : 248|15@1+ (0.015625,0) [0|500] "m"  ADAS
 SG_ DET_RANGE_ERR_183 : 264|7@1+ (0.0075,0) [0|0.9525] "m"  ADAS
 SG_ DET_RANGE_VELOCITY_183 : 272|15@1+ (0.0078125,-128) [-128|127.9921875] "m/s"  ADAS
 SG_ DET_RANGE_VELOCITY_ERR_183 : 288|8@1+ (0.003,0) [0|0.765] "m/s"  ADAS
 SG_ DET_AZIMUTH_183 : 312|13@1+ (0.0004,-1.5708) [-1.5708|1.5708] "rad"  ADAS
 SG_ DET_AZIMUTH_ERR_183 : 329|7@1+ (0.00087267,0) [0|0.11082909] "rad"  ADAS
 SG_ DET_ELEVATION_183 : 296|8@1+ (0.00275,-0.34925) [-0.34925|0.34925] "rad"  ADAS
 SG_ DET_ELEVATION_ERR_183 : 304|6@1+ (0.00174533,0) [0|0.10995579] "rad"  ADAS
 SG_ DET_RCS_183 : 352|8@1+ (0.5,-64) [-64|63.5] "dBsm"  ADAS
 SG_ DET_BI_STATIC_FLAG_183 : 328|1@1+ (1,0) [0|1] ""  ADAS
 SG_ DET_SUPER_RES_TARGET_183 : 311|1@1+ (1,0) [0|1] ""  ADAS
 SG_ DET_SNR_183 : 344|8@1+ (0.35156,0) [0|89.6478] "dB"  ADAS
 SG_ DET_EXISTENCE_PROB_183 : 336|6@1+ (1.588,0) [0|100] "%"  ADAS
 SG_ DET_HVC_FLAG_183 : 310|1@1+ (1,0) [0|1] ""  ADAS
 SG_ DET_CONFD_AZIMUTH_183 : 342|2@1+ (1,0) [0|3] ""  ADAS
 SG_ DET_CONFD_ELEVATION_183 : 325|2@1+ (1,0) [0|3] ""  ADAS
 SG_ DET_PROB_1STAZHYPO_183 : 327|1@1+ (1,0) [0|1] ""  ADAS
 SG_ DET_IDM_183 : 287|1@1+ (1,0) [0|1] ""  ADAS
 SG_ DET_MTD_183 : 271|1@1+ (1,0) [0|1] ""  ADAS
 SG_ DET_BELOW_RAIN_THOLD_183 : 263|1@1+ (1,0) [0|1] ""  ADAS
 SG_ DET_RANGE_184 : 360|15@1+ (0.015625,0) [0|500] "m"  ADAS
 SG_ DET_RANGE_ERR_184 : 376|7@1+ (0.0075,0) [0|0.9525] "m"  ADAS
 SG_ DET_RANGE_VELOCITY_184 : 384|15@1+ (0.0078125,-128) [-128|127.9921875] "m/s"  ADAS
 SG_ DET_RANGE_VELOCITY_ERR_184 : 400|8@1+ (0.003,0) [0|0.765] "m/s"  ADAS
 SG_ DET_AZIMUTH_184 : 424|13@1+ (0.0004,-1.5708) [-1.5708|1.5708] "rad"  ADAS
 SG_ DET_AZIMUTH_ERR_184 : 441|7@1+ (0.00087267,0) [0|0.11082909] "rad"  ADAS
 SG_ DET_ELEVATION_184 : 408|8@1+ (0.00275,-0.34925) [-0.34925|0.34925] "rad"  ADAS
 SG_ DET_ELEVATION_ERR_184 : 416|6@1+ (0.00174533,0) [0|0.10995579] "rad"  ADAS
 SG_ DET_RCS_184 : 464|8@1+ (0.5,-64) [-64|63.5] "dBsm"  ADAS
 SG_ DET_BI_STATIC_FLAG_184 : 440|1@1+ (1,0) [0|1] ""  ADAS
 SG_ DET_SUPER_RES_TARGET_184 : 423|1@1+ (1,0) [0|1] ""  ADAS
 SG_ DET_SNR_184 : 456|8@1+ (0.35156,0) [0|89.6478] "dB"  ADAS
 SG_ DET_EXISTENCE_PROB_184 : 448|6@1+ (1.588,0) [0|100] "%"  ADAS
 SG_ DET_HVC_FLAG_184 : 422|1@1+ (1,0) [0|1] ""  ADAS
 SG_ DET_CONFD_AZIMUTH_184 : 454|2@1+ (1,0) [0|3] ""  ADAS
 SG_ DET_CONFD_ELEVATION_184 : 437|2@1+ (1,0) [0|3] ""  ADAS
 SG_ DET_MH_SCAN_INDEX_4LSB_181_184 : 476|4@1+ (1,0) [0|15] ""  ADAS
 SG_ DET_MH_CYCLE_COUNTER_181_184 : 16|8@1+ (1,0) [0|255] ""  ADAS
 SG_ DET_MH_CRC16_181_184 : 0|16@1+ (1,0) [0|65535] ""  ADAS
 SG_ DET_PROB_1STAZHYPO_184 : 439|1@1+ (1,0) [0|1] ""  ADAS
 SG_ DET_IDM_184 : 399|1@1+ (1,0) [0|1] ""  ADAS
 SG_ DET_MTD_184 : 383|1@1+ (1,0) [0|1] ""  ADAS
 SG_ DET_BELOW_RAIN_THOLD_184 : 375|1@1+ (1,0) [0|1] ""  ADAS

BO_ 1198 RDR_DETECTION_185_188: 64 RDR08
 SG_ DET_RANGE_185 : 24|15@1+ (0.015625,0) [0|500] "m"  ADAS
 SG_ DET_RANGE_ERR_185 : 40|7@1+ (0.0075,0) [0|0.9525] "m"  ADAS
 SG_ DET_RANGE_VELOCITY_185 : 48|15@1+ (0.0078125,-128) [-128|127.9921875] "m/s"  ADAS
 SG_ DET_RANGE_VELOCITY_ERR_185 : 64|8@1+ (0.003,0) [0|0.765] "m/s"  ADAS
 SG_ DET_AZIMUTH_185 : 88|13@1+ (0.0004,-1.5708) [-1.5708|1.5708] "rad"  ADAS
 SG_ DET_AZIMUTH_ERR_185 : 105|7@1+ (0.00087267,0) [0|0.11082909] "rad"  ADAS
 SG_ DET_ELEVATION_185 : 72|8@1+ (0.00275,-0.34925) [-0.34925|0.34925] "rad"  ADAS
 SG_ DET_ELEVATION_ERR_185 : 80|6@1+ (0.00174533,0) [0|0.10995579] "rad"  ADAS
 SG_ DET_RCS_185 : 128|8@1+ (0.5,-64) [-64|63.5] "dBsm"  ADAS
 SG_ DET_BI_STATIC_FLAG_185 : 104|1@1+ (1,0) [0|1] ""  ADAS
 SG_ DET_SUPER_RES_TARGET_185 : 87|1@1+ (1,0) [0|1] ""  ADAS
 SG_ DET_SNR_185 : 120|8@1+ (0.35156,0) [0|89.6478] "dB"  ADAS
 SG_ DET_EXISTENCE_PROB_185 : 112|6@1+ (1.588,0) [0|100] "%"  ADAS
 SG_ DET_HVC_FLAG_185 : 86|1@1+ (1,0) [0|1] ""  ADAS
 SG_ DET_CONFD_AZIMUTH_185 : 118|2@1+ (1,0) [0|3] ""  ADAS
 SG_ DET_CONFD_ELEVATION_185 : 101|2@1+ (1,0) [0|3] ""  ADAS
 SG_ DET_PROB_1STAZHYPO_185 : 103|1@1+ (1,0) [0|1] ""  ADAS
 SG_ DET_IDM_185 : 63|1@1+ (1,0) [0|1] ""  ADAS
 SG_ DET_MTD_185 : 47|1@1+ (1,0) [0|1] ""  ADAS
 SG_ DET_BELOW_RAIN_THOLD_185 : 39|1@1+ (1,0) [0|1] ""  ADAS
 SG_ DET_RANGE_186 : 136|15@1+ (0.015625,0) [0|500] "m"  ADAS
 SG_ DET_RANGE_ERR_186 : 152|7@1+ (0.0075,0) [0|0.9525] "m"  ADAS
 SG_ DET_RANGE_VELOCITY_186 : 160|15@1+ (0.0078125,-128) [-128|127.9921875] "m/s"  ADAS
 SG_ DET_RANGE_VELOCITY_ERR_186 : 176|8@1+ (0.003,0) [0|0.765] "m/s"  ADAS
 SG_ DET_AZIMUTH_186 : 200|13@1+ (0.0004,-1.5708) [-1.5708|1.5708] "rad"  ADAS
 SG_ DET_AZIMUTH_ERR_186 : 217|7@1+ (0.00087267,0) [0|0.11082909] "rad"  ADAS
 SG_ DET_ELEVATION_186 : 184|8@1+ (0.00275,-0.34925) [-0.34925|0.34925] "rad"  ADAS
 SG_ DET_ELEVATION_ERR_186 : 192|6@1+ (0.00174533,0) [0|0.10995579] "rad"  ADAS
 SG_ DET_RCS_186 : 240|8@1+ (0.5,-64) [-64|63.5] "dBsm"  ADAS
 SG_ DET_BI_STATIC_FLAG_186 : 216|1@1+ (1,0) [0|1] ""  ADAS
 SG_ DET_SUPER_RES_TARGET_186 : 199|1@1+ (1,0) [0|1] ""  ADAS
 SG_ DET_SNR_186 : 232|8@1+ (0.35156,0) [0|89.6478] "dB"  ADAS
 SG_ DET_EXISTENCE_PROB_186 : 224|6@1+ (1.588,0) [0|100] "%"  ADAS
 SG_ DET_HVC_FLAG_186 : 198|1@1+ (1,0) [0|1] ""  ADAS
 SG_ DET_CONFD_AZIMUTH_186 : 230|2@1+ (1,0) [0|3] ""  ADAS
 SG_ DET_CONFD_ELEVATION_186 : 213|2@1+ (1,0) [0|3] ""  ADAS
 SG_ DET_PROB_1STAZHYPO_186 : 215|1@1+ (1,0) [0|1] ""  ADAS
 SG_ DET_IDM_186 : 175|1@1+ (1,0) [0|1] ""  ADAS
 SG_ DET_MTD_186 : 159|1@1+ (1,0) [0|1] ""  ADAS
 SG_ DET_BELOW_RAIN_THOLD_186 : 151|1@1+ (1,0) [0|1] ""  ADAS
 SG_ DET_RANGE_187 : 248|15@1+ (0.015625,0) [0|500] "m"  ADAS
 SG_ DET_RANGE_ERR_187 : 264|7@1+ (0.0075,0) [0|0.9525] "m"  ADAS
 SG_ DET_RANGE_VELOCITY_187 : 272|15@1+ (0.0078125,-128) [-128|127.9921875] "m/s"  ADAS
 SG_ DET_RANGE_VELOCITY_ERR_187 : 288|8@1+ (0.003,0) [0|0.765] "m/s"  ADAS
 SG_ DET_AZIMUTH_187 : 312|13@1+ (0.0004,-1.5708) [-1.5708|1.5708] "rad"  ADAS
 SG_ DET_AZIMUTH_ERR_187 : 329|7@1+ (0.00087267,0) [0|0.11082909] "rad"  ADAS
 SG_ DET_ELEVATION_187 : 296|8@1+ (0.00275,-0.34925) [-0.34925|0.34925] "rad"  ADAS
 SG_ DET_ELEVATION_ERR_187 : 304|6@1+ (0.00174533,0) [0|0.10995579] "rad"  ADAS
 SG_ DET_RCS_187 : 352|8@1+ (0.5,-64) [-64|63.5] "dBsm"  ADAS
 SG_ DET_BI_STATIC_FLAG_187 : 328|1@1+ (1,0) [0|1] ""  ADAS
 SG_ DET_SUPER_RES_TARGET_187 : 311|1@1+ (1,0) [0|1] ""  ADAS
 SG_ DET_SNR_187 : 344|8@1+ (0.35156,0) [0|89.6478] "dB"  ADAS
 SG_ DET_EXISTENCE_PROB_187 : 336|6@1+ (1.588,0) [0|100] "%"  ADAS
 SG_ DET_HVC_FLAG_187 : 310|1@1+ (1,0) [0|1] ""  ADAS
 SG_ DET_CONFD_AZIMUTH_187 : 342|2@1+ (1,0) [0|3] ""  ADAS
 SG_ DET_CONFD_ELEVATION_187 : 325|2@1+ (1,0) [0|3] ""  ADAS
 SG_ DET_PROB_1STAZHYPO_187 : 327|1@1+ (1,0) [0|1] ""  ADAS
 SG_ DET_IDM_187 : 287|1@1+ (1,0) [0|1] ""  ADAS
 SG_ DET_MTD_187 : 271|1@1+ (1,0) [0|1] ""  ADAS
 SG_ DET_BELOW_RAIN_THOLD_187 : 263|1@1+ (1,0) [0|1] ""  ADAS
 SG_ DET_RANGE_188 : 360|15@1+ (0.015625,0) [0|500] "m"  ADAS
 SG_ DET_RANGE_ERR_188 : 376|7@1+ (0.0075,0) [0|0.9525] "m"  ADAS
 SG_ DET_RANGE_VELOCITY_188 : 384|15@1+ (0.0078125,-128) [-128|127.9921875] "m/s"  ADAS
 SG_ DET_RANGE_VELOCITY_ERR_188 : 400|8@1+ (0.003,0) [0|0.765] "m/s"  ADAS
 SG_ DET_AZIMUTH_188 : 424|13@1+ (0.0004,-1.5708) [-1.5708|1.5708] "rad"  ADAS
 SG_ DET_AZIMUTH_ERR_188 : 441|7@1+ (0.00087267,0) [0|0.11082909] "rad"  ADAS
 SG_ DET_ELEVATION_188 : 408|8@1+ (0.00275,-0.34925) [-0.34925|0.34925] "rad"  ADAS
 SG_ DET_ELEVATION_ERR_188 : 416|6@1+ (0.00174533,0) [0|0.10995579] "rad"  ADAS
 SG_ DET_RCS_188 : 464|8@1+ (0.5,-64) [-64|63.5] "dBsm"  ADAS
 SG_ DET_BI_STATIC_FLAG_188 : 440|1@1+ (1,0) [0|1] ""  ADAS
 SG_ DET_SUPER_RES_TARGET_188 : 423|1@1+ (1,0) [0|1] ""  ADAS
 SG_ DET_SNR_188 : 456|8@1+ (0.35156,0) [0|89.6478] "dB"  ADAS
 SG_ DET_EXISTENCE_PROB_188 : 448|6@1+ (1.588,0) [0|100] "%"  ADAS
 SG_ DET_HVC_FLAG_188 : 422|1@1+ (1,0) [0|1] ""  ADAS
 SG_ DET_CONFD_AZIMUTH_188 : 454|2@1+ (1,0) [0|3] ""  ADAS
 SG_ DET_CONFD_ELEVATION_188 : 437|2@1+ (1,0) [0|3] ""  ADAS
 SG_ DET_MH_SCAN_INDEX_4LSB_185_188 : 476|4@1+ (1,0) [0|15] ""  ADAS
 SG_ DET_MH_CYCLE_COUNTER_185_188 : 16|8@1+ (1,0) [0|255] ""  ADAS
 SG_ DET_MH_CRC16_185_188 : 0|16@1+ (1,0) [0|65535] ""  ADAS
 SG_ DET_PROB_1STAZHYPO_188 : 439|1@1+ (1,0) [0|1] ""  ADAS
 SG_ DET_IDM_188 : 399|1@1+ (1,0) [0|1] ""  ADAS
 SG_ DET_MTD_188 : 383|1@1+ (1,0) [0|1] ""  ADAS
 SG_ DET_BELOW_RAIN_THOLD_188 : 375|1@1+ (1,0) [0|1] ""  ADAS

BO_ 1199 RDR_DETECTION_189_192: 64 RDR08
 SG_ DET_RANGE_189 : 24|15@1+ (0.015625,0) [0|500] "m"  ADAS
 SG_ DET_RANGE_ERR_189 : 40|7@1+ (0.0075,0) [0|0.9525] "m"  ADAS
 SG_ DET_RANGE_VELOCITY_189 : 48|15@1+ (0.0078125,-128) [-128|127.9921875] "m/s"  ADAS
 SG_ DET_RANGE_VELOCITY_ERR_189 : 64|8@1+ (0.003,0) [0|0.765] "m/s"  ADAS
 SG_ DET_AZIMUTH_189 : 88|13@1+ (0.0004,-1.5708) [-1.5708|1.5708] "rad"  ADAS
 SG_ DET_AZIMUTH_ERR_189 : 105|7@1+ (0.00087267,0) [0|0.11082909] "rad"  ADAS
 SG_ DET_ELEVATION_189 : 72|8@1+ (0.00275,-0.34925) [-0.34925|0.34925] "rad"  ADAS
 SG_ DET_ELEVATION_ERR_189 : 80|6@1+ (0.00174533,0) [0|0.10995579] "rad"  ADAS
 SG_ DET_RCS_189 : 128|8@1+ (0.5,-64) [-64|63.5] "dBsm"  ADAS
 SG_ DET_BI_STATIC_FLAG_189 : 104|1@1+ (1,0) [0|1] ""  ADAS
 SG_ DET_SUPER_RES_TARGET_189 : 87|1@1+ (1,0) [0|1] ""  ADAS
 SG_ DET_SNR_189 : 120|8@1+ (0.35156,0) [0|89.6478] "dB"  ADAS
 SG_ DET_EXISTENCE_PROB_189 : 112|6@1+ (1.588,0) [0|100] "%"  ADAS
 SG_ DET_HVC_FLAG_189 : 86|1@1+ (1,0) [0|1] ""  ADAS
 SG_ DET_CONFD_AZIMUTH_189 : 118|2@1+ (1,0) [0|3] ""  ADAS
 SG_ DET_CONFD_ELEVATION_189 : 101|2@1+ (1,0) [0|3] ""  ADAS
 SG_ DET_PROB_1STAZHYPO_189 : 103|1@1+ (1,0) [0|1] ""  ADAS
 SG_ DET_IDM_189 : 63|1@1+ (1,0) [0|1] ""  ADAS
 SG_ DET_MTD_189 : 47|1@1+ (1,0) [0|1] ""  ADAS
 SG_ DET_BELOW_RAIN_THOLD_189 : 39|1@1+ (1,0) [0|1] ""  ADAS
 SG_ DET_RANGE_190 : 136|15@1+ (0.015625,0) [0|500] "m"  ADAS
 SG_ DET_RANGE_ERR_190 : 152|7@1+ (0.0075,0) [0|0.9525] "m"  ADAS
 SG_ DET_RANGE_VELOCITY_190 : 160|15@1+ (0.0078125,-128) [-128|127.9921875] "m/s"  ADAS
 SG_ DET_RANGE_VELOCITY_ERR_190 : 176|8@1+ (0.003,0) [0|0.765] "m/s"  ADAS
 SG_ DET_AZIMUTH_190 : 200|13@1+ (0.0004,-1.5708) [-1.5708|1.5708] "rad"  ADAS
 SG_ DET_AZIMUTH_ERR_190 : 217|7@1+ (0.00087267,0) [0|0.11082909] "rad"  ADAS
 SG_ DET_ELEVATION_190 : 184|8@1+ (0.00275,-0.34925) [-0.34925|0.34925] "rad"  ADAS
 SG_ DET_ELEVATION_ERR_190 : 192|6@1+ (0.00174533,0) [0|0.10995579] "rad"  ADAS
 SG_ DET_RCS_190 : 240|8@1+ (0.5,-64) [-64|63.5] "dBsm"  ADAS
 SG_ DET_BI_STATIC_FLAG_190 : 216|1@1+ (1,0) [0|1] ""  ADAS
 SG_ DET_SUPER_RES_TARGET_190 : 199|1@1+ (1,0) [0|1] ""  ADAS
 SG_ DET_SNR_190 : 232|8@1+ (0.35156,0) [0|89.6478] "dB"  ADAS
 SG_ DET_EXISTENCE_PROB_190 : 224|6@1+ (1.588,0) [0|100] "%"  ADAS
 SG_ DET_HVC_FLAG_190 : 198|1@1+ (1,0) [0|1] ""  ADAS
 SG_ DET_CONFD_AZIMUTH_190 : 230|2@1+ (1,0) [0|3] ""  ADAS
 SG_ DET_CONFD_ELEVATION_190 : 213|2@1+ (1,0) [0|3] ""  ADAS
 SG_ DET_PROB_1STAZHYPO_190 : 215|1@1+ (1,0) [0|1] ""  ADAS
 SG_ DET_IDM_190 : 175|1@1+ (1,0) [0|1] ""  ADAS
 SG_ DET_MTD_190 : 159|1@1+ (1,0) [0|1] ""  ADAS
 SG_ DET_BELOW_RAIN_THOLD_190 : 151|1@1+ (1,0) [0|1] ""  ADAS
 SG_ DET_RANGE_191 : 248|15@1+ (0.015625,0) [0|500] "m"  ADAS
 SG_ DET_RANGE_ERR_191 : 264|7@1+ (0.0075,0) [0|0.9525] "m"  ADAS
 SG_ DET_RANGE_VELOCITY_191 : 272|15@1+ (0.0078125,-128) [-128|127.9921875] "m/s"  ADAS
 SG_ DET_RANGE_VELOCITY_ERR_191 : 288|8@1+ (0.003,0) [0|0.765] "m/s"  ADAS
 SG_ DET_AZIMUTH_191 : 312|13@1+ (0.0004,-1.5708) [-1.5708|1.5708] "rad"  ADAS
 SG_ DET_AZIMUTH_ERR_191 : 329|7@1+ (0.00087267,0) [0|0.11082909] "rad"  ADAS
 SG_ DET_ELEVATION_191 : 296|8@1+ (0.00275,-0.34925) [-0.34925|0.34925] "rad"  ADAS
 SG_ DET_ELEVATION_ERR_191 : 304|6@1+ (0.00174533,0) [0|0.10995579] "rad"  ADAS
 SG_ DET_RCS_191 : 352|8@1+ (0.5,-64) [-64|63.5] "dBsm"  ADAS
 SG_ DET_BI_STATIC_FLAG_191 : 328|1@1+ (1,0) [0|1] ""  ADAS
 SG_ DET_SUPER_RES_TARGET_191 : 311|1@1+ (1,0) [0|1] ""  ADAS
 SG_ DET_SNR_191 : 344|8@1+ (0.35156,0) [0|89.6478] "dB"  ADAS
 SG_ DET_EXISTENCE_PROB_191 : 336|6@1+ (1.588,0) [0|100] "%"  ADAS
 SG_ DET_HVC_FLAG_191 : 310|1@1+ (1,0) [0|1] ""  ADAS
 SG_ DET_CONFD_AZIMUTH_191 : 342|2@1+ (1,0) [0|3] ""  ADAS
 SG_ DET_CONFD_ELEVATION_191 : 325|2@1+ (1,0) [0|3] ""  ADAS
 SG_ DET_PROB_1STAZHYPO_191 : 327|1@1+ (1,0) [0|1] ""  ADAS
 SG_ DET_IDM_191 : 287|1@1+ (1,0) [0|1] ""  ADAS
 SG_ DET_MTD_191 : 271|1@1+ (1,0) [0|1] ""  ADAS
 SG_ DET_BELOW_RAIN_THOLD_191 : 263|1@1+ (1,0) [0|1] ""  ADAS
 SG_ DET_RANGE_192 : 360|15@1+ (0.015625,0) [0|500] "m"  ADAS
 SG_ DET_RANGE_ERR_192 : 376|7@1+ (0.0075,0) [0|0.9525] "m"  ADAS
 SG_ DET_RANGE_VELOCITY_192 : 384|15@1+ (0.0078125,-128) [-128|127.9921875] "m/s"  ADAS
 SG_ DET_RANGE_VELOCITY_ERR_192 : 400|8@1+ (0.003,0) [0|0.765] "m/s"  ADAS
 SG_ DET_AZIMUTH_192 : 424|13@1+ (0.0004,-1.5708) [-1.5708|1.5708] "rad"  ADAS
 SG_ DET_AZIMUTH_ERR_192 : 441|7@1+ (0.00087267,0) [0|0.11082909] "rad"  ADAS
 SG_ DET_ELEVATION_192 : 408|8@1+ (0.00275,-0.34925) [-0.34925|0.34925] "rad"  ADAS
 SG_ DET_ELEVATION_ERR_192 : 416|6@1+ (0.00174533,0) [0|0.10995579] "rad"  ADAS
 SG_ DET_RCS_192 : 464|8@1+ (0.5,-64) [-64|63.5] "dBsm"  ADAS
 SG_ DET_BI_STATIC_FLAG_192 : 440|1@1+ (1,0) [0|1] ""  ADAS
 SG_ DET_SUPER_RES_TARGET_192 : 423|1@1+ (1,0) [0|1] ""  ADAS
 SG_ DET_SNR_192 : 456|8@1+ (0.35156,0) [0|89.6478] "dB"  ADAS
 SG_ DET_EXISTENCE_PROB_192 : 448|6@1+ (1.588,0) [0|100] "%"  ADAS
 SG_ DET_HVC_FLAG_192 : 422|1@1+ (1,0) [0|1] ""  ADAS
 SG_ DET_CONFD_AZIMUTH_192 : 454|2@1+ (1,0) [0|3] ""  ADAS
 SG_ DET_CONFD_ELEVATION_192 : 437|2@1+ (1,0) [0|3] ""  ADAS
 SG_ DET_MH_SCAN_INDEX_4LSB_189_192 : 476|4@1+ (1,0) [0|15] ""  ADAS
 SG_ DET_MH_CYCLE_COUNTER_189_192 : 16|8@1+ (1,0) [0|255] ""  ADAS
 SG_ DET_MH_CRC16_189_192 : 0|16@1+ (1,0) [0|65535] ""  ADAS
 SG_ DET_PROB_1STAZHYPO_192 : 439|1@1+ (1,0) [0|1] ""  ADAS
 SG_ DET_IDM_192 : 399|1@1+ (1,0) [0|1] ""  ADAS
 SG_ DET_MTD_192 : 383|1@1+ (1,0) [0|1] ""  ADAS
 SG_ DET_BELOW_RAIN_THOLD_192 : 375|1@1+ (1,0) [0|1] ""  ADAS

BO_ 1200 RDR_DETECTION_193_196: 64 RDR08
 SG_ DET_RANGE_193 : 24|15@1+ (0.015625,0) [0|500] "m"  ADAS
 SG_ DET_RANGE_ERR_193 : 40|7@1+ (0.0075,0) [0|0.9525] "m"  ADAS
 SG_ DET_RANGE_VELOCITY_193 : 48|15@1+ (0.0078125,-128) [-128|127.9921875] "m/s"  ADAS
 SG_ DET_RANGE_VELOCITY_ERR_193 : 64|8@1+ (0.003,0) [0|0.765] "m/s"  ADAS
 SG_ DET_AZIMUTH_193 : 88|13@1+ (0.0004,-1.5708) [-1.5708|1.5708] "rad"  ADAS
 SG_ DET_AZIMUTH_ERR_193 : 105|7@1+ (0.00087267,0) [0|0.11082909] "rad"  ADAS
 SG_ DET_ELEVATION_193 : 72|8@1+ (0.00275,-0.34925) [-0.34925|0.34925] "rad"  ADAS
 SG_ DET_ELEVATION_ERR_193 : 80|6@1+ (0.00174533,0) [0|0.10995579] "rad"  ADAS
 SG_ DET_RCS_193 : 128|8@1+ (0.5,-64) [-64|63.5] "dBsm"  ADAS
 SG_ DET_BI_STATIC_FLAG_193 : 104|1@1+ (1,0) [0|1] ""  ADAS
 SG_ DET_SUPER_RES_TARGET_193 : 87|1@1+ (1,0) [0|1] ""  ADAS
 SG_ DET_SNR_193 : 120|8@1+ (0.35156,0) [0|89.6478] "dB"  ADAS
 SG_ DET_EXISTENCE_PROB_193 : 112|6@1+ (1.588,0) [0|100] "%"  ADAS
 SG_ DET_HVC_FLAG_193 : 86|1@1+ (1,0) [0|1] ""  ADAS
 SG_ DET_CONFD_AZIMUTH_193 : 118|2@1+ (1,0) [0|3] ""  ADAS
 SG_ DET_CONFD_ELEVATION_193 : 101|2@1+ (1,0) [0|3] ""  ADAS
 SG_ DET_PROB_1STAZHYPO_193 : 103|1@1+ (1,0) [0|1] ""  ADAS
 SG_ DET_IDM_193 : 63|1@1+ (1,0) [0|1] ""  ADAS
 SG_ DET_MTD_193 : 47|1@1+ (1,0) [0|1] ""  ADAS
 SG_ DET_BELOW_RAIN_THOLD_193 : 39|1@1+ (1,0) [0|1] ""  ADAS
 SG_ DET_RANGE_194 : 136|15@1+ (0.015625,0) [0|500] "m"  ADAS
 SG_ DET_RANGE_ERR_194 : 152|7@1+ (0.0075,0) [0|0.9525] "m"  ADAS
 SG_ DET_RANGE_VELOCITY_194 : 160|15@1+ (0.0078125,-128) [-128|127.9921875] "m/s"  ADAS
 SG_ DET_RANGE_VELOCITY_ERR_194 : 176|8@1+ (0.003,0) [0|0.765] "m/s"  ADAS
 SG_ DET_AZIMUTH_194 : 200|13@1+ (0.0004,-1.5708) [-1.5708|1.5708] "rad"  ADAS
 SG_ DET_AZIMUTH_ERR_194 : 217|7@1+ (0.00087267,0) [0|0.11082909] "rad"  ADAS
 SG_ DET_ELEVATION_194 : 184|8@1+ (0.00275,-0.34925) [-0.34925|0.34925] "rad"  ADAS
 SG_ DET_ELEVATION_ERR_194 : 192|6@1+ (0.00174533,0) [0|0.10995579] "rad"  ADAS
 SG_ DET_RCS_194 : 240|8@1+ (0.5,-64) [-64|63.5] "dBsm"  ADAS
 SG_ DET_BI_STATIC_FLAG_194 : 216|1@1+ (1,0) [0|1] ""  ADAS
 SG_ DET_SUPER_RES_TARGET_194 : 199|1@1+ (1,0) [0|1] ""  ADAS
 SG_ DET_SNR_194 : 232|8@1+ (0.35156,0) [0|89.6478] "dB"  ADAS
 SG_ DET_EXISTENCE_PROB_194 : 224|6@1+ (1.588,0) [0|100] "%"  ADAS
 SG_ DET_HVC_FLAG_194 : 198|1@1+ (1,0) [0|1] ""  ADAS
 SG_ DET_CONFD_AZIMUTH_194 : 230|2@1+ (1,0) [0|3] ""  ADAS
 SG_ DET_CONFD_ELEVATION_194 : 213|2@1+ (1,0) [0|3] ""  ADAS
 SG_ DET_PROB_1STAZHYPO_194 : 215|1@1+ (1,0) [0|1] ""  ADAS
 SG_ DET_IDM_194 : 175|1@1+ (1,0) [0|1] ""  ADAS
 SG_ DET_MTD_194 : 159|1@1+ (1,0) [0|1] ""  ADAS
 SG_ DET_BELOW_RAIN_THOLD_194 : 151|1@1+ (1,0) [0|1] ""  ADAS
 SG_ DET_RANGE_195 : 248|15@1+ (0.015625,0) [0|500] "m"  ADAS
 SG_ DET_RANGE_ERR_195 : 264|7@1+ (0.0075,0) [0|0.9525] "m"  ADAS
 SG_ DET_RANGE_VELOCITY_195 : 272|15@1+ (0.0078125,-128) [-128|127.9921875] "m/s"  ADAS
 SG_ DET_RANGE_VELOCITY_ERR_195 : 288|8@1+ (0.003,0) [0|0.765] "m/s"  ADAS
 SG_ DET_AZIMUTH_195 : 312|13@1+ (0.0004,-1.5708) [-1.5708|1.5708] "rad"  ADAS
 SG_ DET_AZIMUTH_ERR_195 : 329|7@1+ (0.00087267,0) [0|0.11082909] "rad"  ADAS
 SG_ DET_ELEVATION_195 : 296|8@1+ (0.00275,-0.34925) [-0.34925|0.34925] "rad"  ADAS
 SG_ DET_ELEVATION_ERR_195 : 304|6@1+ (0.00174533,0) [0|0.10995579] "rad"  ADAS
 SG_ DET_RCS_195 : 352|8@1+ (0.5,-64) [-64|63.5] "dBsm"  ADAS
 SG_ DET_BI_STATIC_FLAG_195 : 328|1@1+ (1,0) [0|1] ""  ADAS
 SG_ DET_SUPER_RES_TARGET_195 : 311|1@1+ (1,0) [0|1] ""  ADAS
 SG_ DET_SNR_195 : 344|8@1+ (0.35156,0) [0|89.6478] "dB"  ADAS
 SG_ DET_EXISTENCE_PROB_195 : 336|6@1+ (1.588,0) [0|100] "%"  ADAS
 SG_ DET_HVC_FLAG_195 : 310|1@1+ (1,0) [0|1] ""  ADAS
 SG_ DET_CONFD_AZIMUTH_195 : 342|2@1+ (1,0) [0|3] ""  ADAS
 SG_ DET_CONFD_ELEVATION_195 : 325|2@1+ (1,0) [0|3] ""  ADAS
 SG_ DET_PROB_1STAZHYPO_195 : 327|1@1+ (1,0) [0|1] ""  ADAS
 SG_ DET_IDM_195 : 287|1@1+ (1,0) [0|1] ""  ADAS
 SG_ DET_MTD_195 : 271|1@1+ (1,0) [0|1] ""  ADAS
 SG_ DET_BELOW_RAIN_THOLD_195 : 263|1@1+ (1,0) [0|1] ""  ADAS
 SG_ DET_RANGE_196 : 360|15@1+ (0.015625,0) [0|500] "m"  ADAS
 SG_ DET_RANGE_ERR_196 : 376|7@1+ (0.0075,0) [0|0.9525] "m"  ADAS
 SG_ DET_RANGE_VELOCITY_196 : 384|15@1+ (0.0078125,-128) [-128|127.9921875] "m/s"  ADAS
 SG_ DET_RANGE_VELOCITY_ERR_196 : 400|8@1+ (0.003,0) [0|0.765] "m/s"  ADAS
 SG_ DET_AZIMUTH_196 : 424|13@1+ (0.0004,-1.5708) [-1.5708|1.5708] "rad"  ADAS
 SG_ DET_AZIMUTH_ERR_196 : 441|7@1+ (0.00087267,0) [0|0.11082909] "rad"  ADAS
 SG_ DET_ELEVATION_196 : 408|8@1+ (0.00275,-0.34925) [-0.34925|0.34925] "rad"  ADAS
 SG_ DET_ELEVATION_ERR_196 : 416|6@1+ (0.00174533,0) [0|0.10995579] "rad"  ADAS
 SG_ DET_RCS_196 : 464|8@1+ (0.5,-64) [-64|63.5] "dBsm"  ADAS
 SG_ DET_BI_STATIC_FLAG_196 : 440|1@1+ (1,0) [0|1] ""  ADAS
 SG_ DET_SUPER_RES_TARGET_196 : 423|1@1+ (1,0) [0|1] ""  ADAS
 SG_ DET_SNR_196 : 456|8@1+ (0.35156,0) [0|89.6478] "dB"  ADAS
 SG_ DET_EXISTENCE_PROB_196 : 448|6@1+ (1.588,0) [0|100] "%"  ADAS
 SG_ DET_HVC_FLAG_196 : 422|1@1+ (1,0) [0|1] ""  ADAS
 SG_ DET_CONFD_AZIMUTH_196 : 454|2@1+ (1,0) [0|3] ""  ADAS
 SG_ DET_CONFD_ELEVATION_196 : 437|2@1+ (1,0) [0|3] ""  ADAS
 SG_ DET_MH_SCAN_INDEX_4LSB_193_196 : 476|4@1+ (1,0) [0|15] ""  ADAS
 SG_ DET_MH_CYCLE_COUNTER_193_196 : 16|8@1+ (1,0) [0|255] ""  ADAS
 SG_ DET_MH_CRC16_193_196 : 0|16@1+ (1,0) [0|65535] ""  ADAS
 SG_ DET_PROB_1STAZHYPO_196 : 439|1@1+ (1,0) [0|1] ""  ADAS
 SG_ DET_IDM_196 : 399|1@1+ (1,0) [0|1] ""  ADAS
 SG_ DET_MTD_196 : 383|1@1+ (1,0) [0|1] ""  ADAS
 SG_ DET_BELOW_RAIN_THOLD_196 : 375|1@1+ (1,0) [0|1] ""  ADAS

BO_ 1201 RDR_DETECTION_197_200: 64 RDR08
 SG_ DET_RANGE_197 : 24|15@1+ (0.015625,0) [0|500] "m"  ADAS
 SG_ DET_RANGE_ERR_197 : 40|7@1+ (0.0075,0) [0|0.9525] "m"  ADAS
 SG_ DET_RANGE_VELOCITY_197 : 48|15@1+ (0.0078125,-128) [-128|127.9921875] "m/s"  ADAS
 SG_ DET_RANGE_VELOCITY_ERR_197 : 64|8@1+ (0.003,0) [0|0.765] "m/s"  ADAS
 SG_ DET_AZIMUTH_197 : 88|13@1+ (0.0004,-1.5708) [-1.5708|1.5708] "rad"  ADAS
 SG_ DET_AZIMUTH_ERR_197 : 105|7@1+ (0.00087267,0) [0|0.11082909] "rad"  ADAS
 SG_ DET_ELEVATION_197 : 72|8@1+ (0.00275,-0.34925) [-0.34925|0.34925] "rad"  ADAS
 SG_ DET_ELEVATION_ERR_197 : 80|6@1+ (0.00174533,0) [0|0.10995579] "rad"  ADAS
 SG_ DET_RCS_197 : 128|8@1+ (0.5,-64) [-64|63.5] "dBsm"  ADAS
 SG_ DET_BI_STATIC_FLAG_197 : 104|1@1+ (1,0) [0|1] ""  ADAS
 SG_ DET_SUPER_RES_TARGET_197 : 87|1@1+ (1,0) [0|1] ""  ADAS
 SG_ DET_SNR_197 : 120|8@1+ (0.35156,0) [0|89.6478] "dB"  ADAS
 SG_ DET_EXISTENCE_PROB_197 : 112|6@1+ (1.588,0) [0|100] "%"  ADAS
 SG_ DET_HVC_FLAG_197 : 86|1@1+ (1,0) [0|1] ""  ADAS
 SG_ DET_CONFD_AZIMUTH_197 : 118|2@1+ (1,0) [0|3] ""  ADAS
 SG_ DET_CONFD_ELEVATION_197 : 101|2@1+ (1,0) [0|3] ""  ADAS
 SG_ DET_PROB_1STAZHYPO_197 : 103|1@1+ (1,0) [0|1] ""  ADAS
 SG_ DET_IDM_197 : 63|1@1+ (1,0) [0|1] ""  ADAS
 SG_ DET_MTD_197 : 47|1@1+ (1,0) [0|1] ""  ADAS
 SG_ DET_BELOW_RAIN_THOLD_197 : 39|1@1+ (1,0) [0|1] ""  ADAS
 SG_ DET_RANGE_198 : 136|15@1+ (0.015625,0) [0|500] "m"  ADAS
 SG_ DET_RANGE_ERR_198 : 152|7@1+ (0.0075,0) [0|0.9525] "m"  ADAS
 SG_ DET_RANGE_VELOCITY_198 : 160|15@1+ (0.0078125,-128) [-128|127.9921875] "m/s"  ADAS
 SG_ DET_RANGE_VELOCITY_ERR_198 : 176|8@1+ (0.003,0) [0|0.765] "m/s"  ADAS
 SG_ DET_AZIMUTH_198 : 200|13@1+ (0.0004,-1.5708) [-1.5708|1.5708] "rad"  ADAS
 SG_ DET_AZIMUTH_ERR_198 : 217|7@1+ (0.00087267,0) [0|0.11082909] "rad"  ADAS
 SG_ DET_ELEVATION_198 : 184|8@1+ (0.00275,-0.34925) [-0.34925|0.34925] "rad"  ADAS
 SG_ DET_ELEVATION_ERR_198 : 192|6@1+ (0.00174533,0) [0|0.10995579] "rad"  ADAS
 SG_ DET_RCS_198 : 240|8@1+ (0.5,-64) [-64|63.5] "dBsm"  ADAS
 SG_ DET_BI_STATIC_FLAG_198 : 216|1@1+ (1,0) [0|1] ""  ADAS
 SG_ DET_SUPER_RES_TARGET_198 : 199|1@1+ (1,0) [0|1] ""  ADAS
 SG_ DET_SNR_198 : 232|8@1+ (0.35156,0) [0|89.6478] "dB"  ADAS
 SG_ DET_EXISTENCE_PROB_198 : 224|6@1+ (1.588,0) [0|100] "%"  ADAS
 SG_ DET_HVC_FLAG_198 : 198|1@1+ (1,0) [0|1] ""  ADAS
 SG_ DET_CONFD_AZIMUTH_198 : 230|2@1+ (1,0) [0|3] ""  ADAS
 SG_ DET_CONFD_ELEVATION_198 : 213|2@1+ (1,0) [0|3] ""  ADAS
 SG_ DET_PROB_1STAZHYPO_198 : 215|1@1+ (1,0) [0|1] ""  ADAS
 SG_ DET_IDM_198 : 175|1@1+ (1,0) [0|1] ""  ADAS
 SG_ DET_MTD_198 : 159|1@1+ (1,0) [0|1] ""  ADAS
 SG_ DET_BELOW_RAIN_THOLD_198 : 151|1@1+ (1,0) [0|1] ""  ADAS
 SG_ DET_RANGE_199 : 248|15@1+ (0.015625,0) [0|500] "m"  ADAS
 SG_ DET_RANGE_ERR_199 : 264|7@1+ (0.0075,0) [0|0.9525] "m"  ADAS
 SG_ DET_RANGE_VELOCITY_199 : 272|15@1+ (0.0078125,-128) [-128|127.9921875] "m/s"  ADAS
 SG_ DET_RANGE_VELOCITY_ERR_199 : 288|8@1+ (0.003,0) [0|0.765] "m/s"  ADAS
 SG_ DET_AZIMUTH_199 : 312|13@1+ (0.0004,-1.5708) [-1.5708|1.5708] "rad"  ADAS
 SG_ DET_AZIMUTH_ERR_199 : 329|7@1+ (0.00087267,0) [0|0.11082909] "rad"  ADAS
 SG_ DET_ELEVATION_199 : 296|8@1+ (0.00275,-0.34925) [-0.34925|0.34925] "rad"  ADAS
 SG_ DET_ELEVATION_ERR_199 : 304|6@1+ (0.00174533,0) [0|0.10995579] "rad"  ADAS
 SG_ DET_RCS_199 : 352|8@1+ (0.5,-64) [-64|63.5] "dBsm"  ADAS
 SG_ DET_BI_STATIC_FLAG_199 : 328|1@1+ (1,0) [0|1] ""  ADAS
 SG_ DET_SUPER_RES_TARGET_199 : 311|1@1+ (1,0) [0|1] ""  ADAS
 SG_ DET_SNR_199 : 344|8@1+ (0.35156,0) [0|89.6478] "dB"  ADAS
 SG_ DET_EXISTENCE_PROB_199 : 336|6@1+ (1.588,0) [0|100] "%"  ADAS
 SG_ DET_HVC_FLAG_199 : 310|1@1+ (1,0) [0|1] ""  ADAS
 SG_ DET_CONFD_AZIMUTH_199 : 342|2@1+ (1,0) [0|3] ""  ADAS
 SG_ DET_CONFD_ELEVATION_199 : 325|2@1+ (1,0) [0|3] ""  ADAS
 SG_ DET_PROB_1STAZHYPO_199 : 327|1@1+ (1,0) [0|1] ""  ADAS
 SG_ DET_IDM_199 : 287|1@1+ (1,0) [0|1] ""  ADAS
 SG_ DET_MTD_199 : 271|1@1+ (1,0) [0|1] ""  ADAS
 SG_ DET_BELOW_RAIN_THOLD_199 : 263|1@1+ (1,0) [0|1] ""  ADAS
 SG_ DET_RANGE_200 : 360|15@1+ (0.015625,0) [0|500] "m"  ADAS
 SG_ DET_RANGE_ERR_200 : 376|7@1+ (0.0075,0) [0|0.9525] "m"  ADAS
 SG_ DET_RANGE_VELOCITY_200 : 384|15@1+ (0.0078125,-128) [-128|127.9921875] "m/s"  ADAS
 SG_ DET_RANGE_VELOCITY_ERR_200 : 400|8@1+ (0.003,0) [0|0.765] "m/s"  ADAS
 SG_ DET_AZIMUTH_200 : 424|13@1+ (0.0004,-1.5708) [-1.5708|1.5708] "rad"  ADAS
 SG_ DET_AZIMUTH_ERR_200 : 441|7@1+ (0.00087267,0) [0|0.11082909] "rad"  ADAS
 SG_ DET_ELEVATION_200 : 408|8@1+ (0.00275,-0.34925) [-0.34925|0.34925] "rad"  ADAS
 SG_ DET_ELEVATION_ERR_200 : 416|6@1+ (0.00174533,0) [0|0.10995579] "rad"  ADAS
 SG_ DET_RCS_200 : 464|8@1+ (0.5,-64) [-64|63.5] "dBsm"  ADAS
 SG_ DET_BI_STATIC_FLAG_200 : 440|1@1+ (1,0) [0|1] ""  ADAS
 SG_ DET_SUPER_RES_TARGET_200 : 423|1@1+ (1,0) [0|1] ""  ADAS
 SG_ DET_SNR_200 : 456|8@1+ (0.35156,0) [0|89.6478] "dB"  ADAS
 SG_ DET_EXISTENCE_PROB_200 : 448|6@1+ (1.588,0) [0|100] "%"  ADAS
 SG_ DET_HVC_FLAG_200 : 422|1@1+ (1,0) [0|1] ""  ADAS
 SG_ DET_CONFD_AZIMUTH_200 : 454|2@1+ (1,0) [0|3] ""  ADAS
 SG_ DET_CONFD_ELEVATION_200 : 437|2@1+ (1,0) [0|3] ""  ADAS
 SG_ DET_MH_SCAN_INDEX_4LSB_197_200 : 476|4@1+ (1,0) [0|15] ""  ADAS
 SG_ DET_MH_CYCLE_COUNTER_197_200 : 16|8@1+ (1,0) [0|255] ""  ADAS
 SG_ DET_MH_CRC16_197_200 : 0|16@1+ (1,0) [0|65535] ""  ADAS
 SG_ DET_PROB_1STAZHYPO_200 : 439|1@1+ (1,0) [0|1] ""  ADAS
 SG_ DET_IDM_200 : 399|1@1+ (1,0) [0|1] ""  ADAS
 SG_ DET_MTD_200 : 383|1@1+ (1,0) [0|1] ""  ADAS
 SG_ DET_BELOW_RAIN_THOLD_200 : 375|1@1+ (1,0) [0|1] ""  ADAS

BO_ 1202 RDR_DETECTION_201_204: 64 RDR08
 SG_ DET_RANGE_201 : 24|15@1+ (0.015625,0) [0|500] "m"  ADAS
 SG_ DET_RANGE_ERR_201 : 40|7@1+ (0.0075,0) [0|0.9525] "m"  ADAS
 SG_ DET_RANGE_VELOCITY_201 : 48|15@1+ (0.0078125,-128) [-128|127.9921875] "m/s"  ADAS
 SG_ DET_RANGE_VELOCITY_ERR_201 : 64|8@1+ (0.003,0) [0|0.765] "m/s"  ADAS
 SG_ DET_AZIMUTH_201 : 88|13@1+ (0.0004,-1.5708) [-1.5708|1.5708] "rad"  ADAS
 SG_ DET_AZIMUTH_ERR_201 : 105|7@1+ (0.00087267,0) [0|0.11082909] "rad"  ADAS
 SG_ DET_ELEVATION_201 : 72|8@1+ (0.00275,-0.34925) [-0.34925|0.34925] "rad"  ADAS
 SG_ DET_ELEVATION_ERR_201 : 80|6@1+ (0.00174533,0) [0|0.10995579] "rad"  ADAS
 SG_ DET_RCS_201 : 128|8@1+ (0.5,-64) [-64|63.5] "dBsm"  ADAS
 SG_ DET_BI_STATIC_FLAG_201 : 104|1@1+ (1,0) [0|1] ""  ADAS
 SG_ DET_SUPER_RES_TARGET_201 : 87|1@1+ (1,0) [0|1] ""  ADAS
 SG_ DET_SNR_201 : 120|8@1+ (0.35156,0) [0|89.6478] "dB"  ADAS
 SG_ DET_EXISTENCE_PROB_201 : 112|6@1+ (1.588,0) [0|100] "%"  ADAS
 SG_ DET_HVC_FLAG_201 : 86|1@1+ (1,0) [0|1] ""  ADAS
 SG_ DET_CONFD_AZIMUTH_201 : 118|2@1+ (1,0) [0|3] ""  ADAS
 SG_ DET_CONFD_ELEVATION_201 : 101|2@1+ (1,0) [0|3] ""  ADAS
 SG_ DET_PROB_1STAZHYPO_201 : 103|1@1+ (1,0) [0|1] ""  ADAS
 SG_ DET_IDM_201 : 63|1@1+ (1,0) [0|1] ""  ADAS
 SG_ DET_MTD_201 : 47|1@1+ (1,0) [0|1] ""  ADAS
 SG_ DET_BELOW_RAIN_THOLD_201 : 39|1@1+ (1,0) [0|1] ""  ADAS
 SG_ DET_RANGE_202 : 136|15@1+ (0.015625,0) [0|500] "m"  ADAS
 SG_ DET_RANGE_ERR_202 : 152|7@1+ (0.0075,0) [0|0.9525] "m"  ADAS
 SG_ DET_RANGE_VELOCITY_202 : 160|15@1+ (0.0078125,-128) [-128|127.9921875] "m/s"  ADAS
 SG_ DET_RANGE_VELOCITY_ERR_202 : 176|8@1+ (0.003,0) [0|0.765] "m/s"  ADAS
 SG_ DET_AZIMUTH_202 : 200|13@1+ (0.0004,-1.5708) [-1.5708|1.5708] "rad"  ADAS
 SG_ DET_AZIMUTH_ERR_202 : 217|7@1+ (0.00087267,0) [0|0.11082909] "rad"  ADAS
 SG_ DET_ELEVATION_202 : 184|8@1+ (0.00275,-0.34925) [-0.34925|0.34925] "rad"  ADAS
 SG_ DET_ELEVATION_ERR_202 : 192|6@1+ (0.00174533,0) [0|0.10995579] "rad"  ADAS
 SG_ DET_RCS_202 : 240|8@1+ (0.5,-64) [-64|63.5] "dBsm"  ADAS
 SG_ DET_BI_STATIC_FLAG_202 : 216|1@1+ (1,0) [0|1] ""  ADAS
 SG_ DET_SUPER_RES_TARGET_202 : 199|1@1+ (1,0) [0|1] ""  ADAS
 SG_ DET_SNR_202 : 232|8@1+ (0.35156,0) [0|89.6478] "dB"  ADAS
 SG_ DET_EXISTENCE_PROB_202 : 224|6@1+ (1.588,0) [0|100] "%"  ADAS
 SG_ DET_HVC_FLAG_202 : 198|1@1+ (1,0) [0|1] ""  ADAS
 SG_ DET_CONFD_AZIMUTH_202 : 230|2@1+ (1,0) [0|3] ""  ADAS
 SG_ DET_CONFD_ELEVATION_202 : 213|2@1+ (1,0) [0|3] ""  ADAS
 SG_ DET_PROB_1STAZHYPO_202 : 215|1@1+ (1,0) [0|1] ""  ADAS
 SG_ DET_IDM_202 : 175|1@1+ (1,0) [0|1] ""  ADAS
 SG_ DET_MTD_202 : 159|1@1+ (1,0) [0|1] ""  ADAS
 SG_ DET_BELOW_RAIN_THOLD_202 : 151|1@1+ (1,0) [0|1] ""  ADAS
 SG_ DET_RANGE_203 : 248|15@1+ (0.015625,0) [0|500] "m"  ADAS
 SG_ DET_RANGE_ERR_203 : 264|7@1+ (0.0075,0) [0|0.9525] "m"  ADAS
 SG_ DET_RANGE_VELOCITY_203 : 272|15@1+ (0.0078125,-128) [-128|127.9921875] "m/s"  ADAS
 SG_ DET_RANGE_VELOCITY_ERR_203 : 288|8@1+ (0.003,0) [0|0.765] "m/s"  ADAS
 SG_ DET_AZIMUTH_203 : 312|13@1+ (0.0004,-1.5708) [-1.5708|1.5708] "rad"  ADAS
 SG_ DET_AZIMUTH_ERR_203 : 329|7@1+ (0.00087267,0) [0|0.11082909] "rad"  ADAS
 SG_ DET_ELEVATION_203 : 296|8@1+ (0.00275,-0.34925) [-0.34925|0.34925] "rad"  ADAS
 SG_ DET_ELEVATION_ERR_203 : 304|6@1+ (0.00174533,0) [0|0.10995579] "rad"  ADAS
 SG_ DET_RCS_203 : 352|8@1+ (0.5,-64) [-64|63.5] "dBsm"  ADAS
 SG_ DET_BI_STATIC_FLAG_203 : 328|1@1+ (1,0) [0|1] ""  ADAS
 SG_ DET_SUPER_RES_TARGET_203 : 311|1@1+ (1,0) [0|1] ""  ADAS
 SG_ DET_SNR_203 : 344|8@1+ (0.35156,0) [0|89.6478] "dB"  ADAS
 SG_ DET_EXISTENCE_PROB_203 : 336|6@1+ (1.588,0) [0|100] "%"  ADAS
 SG_ DET_HVC_FLAG_203 : 310|1@1+ (1,0) [0|1] ""  ADAS
 SG_ DET_CONFD_AZIMUTH_203 : 342|2@1+ (1,0) [0|3] ""  ADAS
 SG_ DET_CONFD_ELEVATION_203 : 325|2@1+ (1,0) [0|3] ""  ADAS
 SG_ DET_PROB_1STAZHYPO_203 : 327|1@1+ (1,0) [0|1] ""  ADAS
 SG_ DET_IDM_203 : 287|1@1+ (1,0) [0|1] ""  ADAS
 SG_ DET_MTD_203 : 271|1@1+ (1,0) [0|1] ""  ADAS
 SG_ DET_BELOW_RAIN_THOLD_203 : 263|1@1+ (1,0) [0|1] ""  ADAS
 SG_ DET_RANGE_204 : 360|15@1+ (0.015625,0) [0|500] "m"  ADAS
 SG_ DET_RANGE_ERR_204 : 376|7@1+ (0.0075,0) [0|0.9525] "m"  ADAS
 SG_ DET_RANGE_VELOCITY_204 : 384|15@1+ (0.0078125,-128) [-128|127.9921875] "m/s"  ADAS
 SG_ DET_RANGE_VELOCITY_ERR_204 : 400|8@1+ (0.003,0) [0|0.765] "m/s"  ADAS
 SG_ DET_AZIMUTH_204 : 424|13@1+ (0.0004,-1.5708) [-1.5708|1.5708] "rad"  ADAS
 SG_ DET_AZIMUTH_ERR_204 : 441|7@1+ (0.00087267,0) [0|0.11082909] "rad"  ADAS
 SG_ DET_ELEVATION_204 : 408|8@1+ (0.00275,-0.34925) [-0.34925|0.34925] "rad"  ADAS
 SG_ DET_ELEVATION_ERR_204 : 416|6@1+ (0.00174533,0) [0|0.10995579] "rad"  ADAS
 SG_ DET_RCS_204 : 464|8@1+ (0.5,-64) [-64|63.5] "dBsm"  ADAS
 SG_ DET_BI_STATIC_FLAG_204 : 440|1@1+ (1,0) [0|1] ""  ADAS
 SG_ DET_SUPER_RES_TARGET_204 : 423|1@1+ (1,0) [0|1] ""  ADAS
 SG_ DET_SNR_204 : 456|8@1+ (0.35156,0) [0|89.6478] "dB"  ADAS
 SG_ DET_EXISTENCE_PROB_204 : 448|6@1+ (1.588,0) [0|100] "%"  ADAS
 SG_ DET_HVC_FLAG_204 : 422|1@1+ (1,0) [0|1] ""  ADAS
 SG_ DET_CONFD_AZIMUTH_204 : 454|2@1+ (1,0) [0|3] ""  ADAS
 SG_ DET_CONFD_ELEVATION_204 : 437|2@1+ (1,0) [0|3] ""  ADAS
 SG_ DET_MH_SCAN_INDEX_4LSB_201_204 : 476|4@1+ (1,0) [0|15] ""  ADAS
 SG_ DET_MH_CYCLE_COUNTER_201_204 : 16|8@1+ (1,0) [0|255] ""  ADAS
 SG_ DET_MH_CRC16_201_204 : 0|16@1+ (1,0) [0|65535] ""  ADAS
 SG_ DET_PROB_1STAZHYPO_204 : 439|1@1+ (1,0) [0|1] ""  ADAS
 SG_ DET_IDM_204 : 399|1@1+ (1,0) [0|1] ""  ADAS
 SG_ DET_MTD_204 : 383|1@1+ (1,0) [0|1] ""  ADAS
 SG_ DET_BELOW_RAIN_THOLD_204 : 375|1@1+ (1,0) [0|1] ""  ADAS

BO_ 1203 RDR_DETECTION_205_208: 64 RDR08
 SG_ DET_RANGE_205 : 24|15@1+ (0.015625,0) [0|500] "m"  ADAS
 SG_ DET_RANGE_ERR_205 : 40|7@1+ (0.0075,0) [0|0.9525] "m"  ADAS
 SG_ DET_RANGE_VELOCITY_205 : 48|15@1+ (0.0078125,-128) [-128|127.9921875] "m/s"  ADAS
 SG_ DET_RANGE_VELOCITY_ERR_205 : 64|8@1+ (0.003,0) [0|0.765] "m/s"  ADAS
 SG_ DET_AZIMUTH_205 : 88|13@1+ (0.0004,-1.5708) [-1.5708|1.5708] "rad"  ADAS
 SG_ DET_AZIMUTH_ERR_205 : 105|7@1+ (0.00087267,0) [0|0.11082909] "rad"  ADAS
 SG_ DET_ELEVATION_205 : 72|8@1+ (0.00275,-0.34925) [-0.34925|0.34925] "rad"  ADAS
 SG_ DET_ELEVATION_ERR_205 : 80|6@1+ (0.00174533,0) [0|0.10995579] "rad"  ADAS
 SG_ DET_RCS_205 : 128|8@1+ (0.5,-64) [-64|63.5] "dBsm"  ADAS
 SG_ DET_BI_STATIC_FLAG_205 : 104|1@1+ (1,0) [0|1] ""  ADAS
 SG_ DET_SUPER_RES_TARGET_205 : 87|1@1+ (1,0) [0|1] ""  ADAS
 SG_ DET_SNR_205 : 120|8@1+ (0.35156,0) [0|89.6478] "dB"  ADAS
 SG_ DET_EXISTENCE_PROB_205 : 112|6@1+ (1.588,0) [0|100] "%"  ADAS
 SG_ DET_HVC_FLAG_205 : 86|1@1+ (1,0) [0|1] ""  ADAS
 SG_ DET_CONFD_AZIMUTH_205 : 118|2@1+ (1,0) [0|3] ""  ADAS
 SG_ DET_CONFD_ELEVATION_205 : 101|2@1+ (1,0) [0|3] ""  ADAS
 SG_ DET_PROB_1STAZHYPO_205 : 103|1@1+ (1,0) [0|1] ""  ADAS
 SG_ DET_IDM_205 : 63|1@1+ (1,0) [0|1] ""  ADAS
 SG_ DET_MTD_205 : 47|1@1+ (1,0) [0|1] ""  ADAS
 SG_ DET_BELOW_RAIN_THOLD_205 : 39|1@1+ (1,0) [0|1] ""  ADAS
 SG_ DET_RANGE_206 : 136|15@1+ (0.015625,0) [0|500] "m"  ADAS
 SG_ DET_RANGE_ERR_206 : 152|7@1+ (0.0075,0) [0|0.9525] "m"  ADAS
 SG_ DET_RANGE_VELOCITY_206 : 160|15@1+ (0.0078125,-128) [-128|127.9921875] "m/s"  ADAS
 SG_ DET_RANGE_VELOCITY_ERR_206 : 176|8@1+ (0.003,0) [0|0.765] "m/s"  ADAS
 SG_ DET_AZIMUTH_206 : 200|13@1+ (0.0004,-1.5708) [-1.5708|1.5708] "rad"  ADAS
 SG_ DET_AZIMUTH_ERR_206 : 217|7@1+ (0.00087267,0) [0|0.11082909] "rad"  ADAS
 SG_ DET_ELEVATION_206 : 184|8@1+ (0.00275,-0.34925) [-0.34925|0.34925] "rad"  ADAS
 SG_ DET_ELEVATION_ERR_206 : 192|6@1+ (0.00174533,0) [0|0.10995579] "rad"  ADAS
 SG_ DET_RCS_206 : 240|8@1+ (0.5,-64) [-64|63.5] "dBsm"  ADAS
 SG_ DET_BI_STATIC_FLAG_206 : 216|1@1+ (1,0) [0|1] ""  ADAS
 SG_ DET_SUPER_RES_TARGET_206 : 199|1@1+ (1,0) [0|1] ""  ADAS
 SG_ DET_SNR_206 : 232|8@1+ (0.35156,0) [0|89.6478] "dB"  ADAS
 SG_ DET_EXISTENCE_PROB_206 : 224|6@1+ (1.588,0) [0|100] "%"  ADAS
 SG_ DET_HVC_FLAG_206 : 198|1@1+ (1,0) [0|1] ""  ADAS
 SG_ DET_CONFD_AZIMUTH_206 : 230|2@1+ (1,0) [0|3] ""  ADAS
 SG_ DET_CONFD_ELEVATION_206 : 213|2@1+ (1,0) [0|3] ""  ADAS
 SG_ DET_PROB_1STAZHYPO_206 : 215|1@1+ (1,0) [0|1] ""  ADAS
 SG_ DET_IDM_206 : 175|1@1+ (1,0) [0|1] ""  ADAS
 SG_ DET_MTD_206 : 159|1@1+ (1,0) [0|1] ""  ADAS
 SG_ DET_BELOW_RAIN_THOLD_206 : 151|1@1+ (1,0) [0|1] ""  ADAS
 SG_ DET_RANGE_207 : 248|15@1+ (0.015625,0) [0|500] "m"  ADAS
 SG_ DET_RANGE_ERR_207 : 264|7@1+ (0.0075,0) [0|0.9525] "m"  ADAS
 SG_ DET_RANGE_VELOCITY_207 : 272|15@1+ (0.0078125,-128) [-128|127.9921875] "m/s"  ADAS
 SG_ DET_RANGE_VELOCITY_ERR_207 : 288|8@1+ (0.003,0) [0|0.765] "m/s"  ADAS
 SG_ DET_AZIMUTH_207 : 312|13@1+ (0.0004,-1.5708) [-1.5708|1.5708] "rad"  ADAS
 SG_ DET_AZIMUTH_ERR_207 : 329|7@1+ (0.00087267,0) [0|0.11082909] "rad"  ADAS
 SG_ DET_ELEVATION_207 : 296|8@1+ (0.00275,-0.34925) [-0.34925|0.34925] "rad"  ADAS
 SG_ DET_ELEVATION_ERR_207 : 304|6@1+ (0.00174533,0) [0|0.10995579] "rad"  ADAS
 SG_ DET_RCS_207 : 352|8@1+ (0.5,-64) [-64|63.5] "dBsm"  ADAS
 SG_ DET_BI_STATIC_FLAG_207 : 328|1@1+ (1,0) [0|1] ""  ADAS
 SG_ DET_SUPER_RES_TARGET_207 : 311|1@1+ (1,0) [0|1] ""  ADAS
 SG_ DET_SNR_207 : 344|8@1+ (0.35156,0) [0|89.6478] "dB"  ADAS
 SG_ DET_EXISTENCE_PROB_207 : 336|6@1+ (1.588,0) [0|100] "%"  ADAS
 SG_ DET_HVC_FLAG_207 : 310|1@1+ (1,0) [0|1] ""  ADAS
 SG_ DET_CONFD_AZIMUTH_207 : 342|2@1+ (1,0) [0|3] ""  ADAS
 SG_ DET_CONFD_ELEVATION_207 : 325|2@1+ (1,0) [0|3] ""  ADAS
 SG_ DET_PROB_1STAZHYPO_207 : 327|1@1+ (1,0) [0|1] ""  ADAS
 SG_ DET_IDM_207 : 287|1@1+ (1,0) [0|1] ""  ADAS
 SG_ DET_MTD_207 : 271|1@1+ (1,0) [0|1] ""  ADAS
 SG_ DET_BELOW_RAIN_THOLD_207 : 263|1@1+ (1,0) [0|1] ""  ADAS
 SG_ DET_RANGE_208 : 360|15@1+ (0.015625,0) [0|500] "m"  ADAS
 SG_ DET_RANGE_ERR_208 : 376|7@1+ (0.0075,0) [0|0.9525] "m"  ADAS
 SG_ DET_RANGE_VELOCITY_208 : 384|15@1+ (0.0078125,-128) [-128|127.9921875] "m/s"  ADAS
 SG_ DET_RANGE_VELOCITY_ERR_208 : 400|8@1+ (0.003,0) [0|0.765] "m/s"  ADAS
 SG_ DET_AZIMUTH_208 : 424|13@1+ (0.0004,-1.5708) [-1.5708|1.5708] "rad"  ADAS
 SG_ DET_AZIMUTH_ERR_208 : 441|7@1+ (0.00087267,0) [0|0.11082909] "rad"  ADAS
 SG_ DET_ELEVATION_208 : 408|8@1+ (0.00275,-0.34925) [-0.34925|0.34925] "rad"  ADAS
 SG_ DET_ELEVATION_ERR_208 : 416|6@1+ (0.00174533,0) [0|0.10995579] "rad"  ADAS
 SG_ DET_RCS_208 : 464|8@1+ (0.5,-64) [-64|63.5] "dBsm"  ADAS
 SG_ DET_BI_STATIC_FLAG_208 : 440|1@1+ (1,0) [0|1] ""  ADAS
 SG_ DET_SUPER_RES_TARGET_208 : 423|1@1+ (1,0) [0|1] ""  ADAS
 SG_ DET_SNR_208 : 456|8@1+ (0.35156,0) [0|89.6478] "dB"  ADAS
 SG_ DET_EXISTENCE_PROB_208 : 448|6@1+ (1.588,0) [0|100] "%"  ADAS
 SG_ DET_HVC_FLAG_208 : 422|1@1+ (1,0) [0|1] ""  ADAS
 SG_ DET_CONFD_AZIMUTH_208 : 454|2@1+ (1,0) [0|3] ""  ADAS
 SG_ DET_CONFD_ELEVATION_208 : 437|2@1+ (1,0) [0|3] ""  ADAS
 SG_ DET_MH_SCAN_INDEX_4LSB_205_208 : 476|4@1+ (1,0) [0|15] ""  ADAS
 SG_ DET_MH_CYCLE_COUNTER_205_208 : 16|8@1+ (1,0) [0|255] ""  ADAS
 SG_ DET_MH_CRC16_205_208 : 0|16@1+ (1,0) [0|65535] ""  ADAS
 SG_ DET_PROB_1STAZHYPO_208 : 439|1@1+ (1,0) [0|1] ""  ADAS
 SG_ DET_IDM_208 : 399|1@1+ (1,0) [0|1] ""  ADAS
 SG_ DET_MTD_208 : 383|1@1+ (1,0) [0|1] ""  ADAS
 SG_ DET_BELOW_RAIN_THOLD_208 : 375|1@1+ (1,0) [0|1] ""  ADAS

BO_ 1204 RDR_DETECTION_209_212: 64 RDR08
 SG_ DET_RANGE_209 : 24|15@1+ (0.015625,0) [0|500] "m"  ADAS
 SG_ DET_RANGE_ERR_209 : 40|7@1+ (0.0075,0) [0|0.9525] "m"  ADAS
 SG_ DET_RANGE_VELOCITY_209 : 48|15@1+ (0.0078125,-128) [-128|127.9921875] "m/s"  ADAS
 SG_ DET_RANGE_VELOCITY_ERR_209 : 64|8@1+ (0.003,0) [0|0.765] "m/s"  ADAS
 SG_ DET_AZIMUTH_209 : 88|13@1+ (0.0004,-1.5708) [-1.5708|1.5708] "rad"  ADAS
 SG_ DET_AZIMUTH_ERR_209 : 105|7@1+ (0.00087267,0) [0|0.11082909] "rad"  ADAS
 SG_ DET_ELEVATION_209 : 72|8@1+ (0.00275,-0.34925) [-0.34925|0.34925] "rad"  ADAS
 SG_ DET_ELEVATION_ERR_209 : 80|6@1+ (0.00174533,0) [0|0.10995579] "rad"  ADAS
 SG_ DET_RCS_209 : 128|8@1+ (0.5,-64) [-64|63.5] "dBsm"  ADAS
 SG_ DET_BI_STATIC_FLAG_209 : 104|1@1+ (1,0) [0|1] ""  ADAS
 SG_ DET_SUPER_RES_TARGET_209 : 87|1@1+ (1,0) [0|1] ""  ADAS
 SG_ DET_SNR_209 : 120|8@1+ (0.35156,0) [0|89.6478] "dB"  ADAS
 SG_ DET_EXISTENCE_PROB_209 : 112|6@1+ (1.588,0) [0|100] "%"  ADAS
 SG_ DET_HVC_FLAG_209 : 86|1@1+ (1,0) [0|1] ""  ADAS
 SG_ DET_CONFD_AZIMUTH_209 : 118|2@1+ (1,0) [0|3] ""  ADAS
 SG_ DET_CONFD_ELEVATION_209 : 101|2@1+ (1,0) [0|3] ""  ADAS
 SG_ DET_PROB_1STAZHYPO_209 : 103|1@1+ (1,0) [0|1] ""  ADAS
 SG_ DET_IDM_209 : 63|1@1+ (1,0) [0|1] ""  ADAS
 SG_ DET_MTD_209 : 47|1@1+ (1,0) [0|1] ""  ADAS
 SG_ DET_BELOW_RAIN_THOLD_209 : 39|1@1+ (1,0) [0|1] ""  ADAS
 SG_ DET_RANGE_210 : 136|15@1+ (0.015625,0) [0|500] "m"  ADAS
 SG_ DET_RANGE_ERR_210 : 152|7@1+ (0.0075,0) [0|0.9525] "m"  ADAS
 SG_ DET_RANGE_VELOCITY_210 : 160|15@1+ (0.0078125,-128) [-128|127.9921875] "m/s"  ADAS
 SG_ DET_RANGE_VELOCITY_ERR_210 : 176|8@1+ (0.003,0) [0|0.765] "m/s"  ADAS
 SG_ DET_AZIMUTH_210 : 200|13@1+ (0.0004,-1.5708) [-1.5708|1.5708] "rad"  ADAS
 SG_ DET_AZIMUTH_ERR_210 : 217|7@1+ (0.00087267,0) [0|0.11082909] "rad"  ADAS
 SG_ DET_ELEVATION_210 : 184|8@1+ (0.00275,-0.34925) [-0.34925|0.34925] "rad"  ADAS
 SG_ DET_ELEVATION_ERR_210 : 192|6@1+ (0.00174533,0) [0|0.10995579] "rad"  ADAS
 SG_ DET_RCS_210 : 240|8@1+ (0.5,-64) [-64|63.5] "dBsm"  ADAS
 SG_ DET_BI_STATIC_FLAG_210 : 216|1@1+ (1,0) [0|1] ""  ADAS
 SG_ DET_SUPER_RES_TARGET_210 : 199|1@1+ (1,0) [0|1] ""  ADAS
 SG_ DET_SNR_210 : 232|8@1+ (0.35156,0) [0|89.6478] "dB"  ADAS
 SG_ DET_EXISTENCE_PROB_210 : 224|6@1+ (1.588,0) [0|100] "%"  ADAS
 SG_ DET_HVC_FLAG_210 : 198|1@1+ (1,0) [0|1] ""  ADAS
 SG_ DET_CONFD_AZIMUTH_210 : 230|2@1+ (1,0) [0|3] ""  ADAS
 SG_ DET_CONFD_ELEVATION_210 : 213|2@1+ (1,0) [0|3] ""  ADAS
 SG_ DET_PROB_1STAZHYPO_210 : 215|1@1+ (1,0) [0|1] ""  ADAS
 SG_ DET_IDM_210 : 175|1@1+ (1,0) [0|1] ""  ADAS
 SG_ DET_MTD_210 : 159|1@1+ (1,0) [0|1] ""  ADAS
 SG_ DET_BELOW_RAIN_THOLD_210 : 151|1@1+ (1,0) [0|1] ""  ADAS
 SG_ DET_RANGE_211 : 248|15@1+ (0.015625,0) [0|500] "m"  ADAS
 SG_ DET_RANGE_ERR_211 : 264|7@1+ (0.0075,0) [0|0.9525] "m"  ADAS
 SG_ DET_RANGE_VELOCITY_211 : 272|15@1+ (0.0078125,-128) [-128|127.9921875] "m/s"  ADAS
 SG_ DET_RANGE_VELOCITY_ERR_211 : 288|8@1+ (0.003,0) [0|0.765] "m/s"  ADAS
 SG_ DET_AZIMUTH_211 : 312|13@1+ (0.0004,-1.5708) [-1.5708|1.5708] "rad"  ADAS
 SG_ DET_AZIMUTH_ERR_211 : 329|7@1+ (0.00087267,0) [0|0.11082909] "rad"  ADAS
 SG_ DET_ELEVATION_211 : 296|8@1+ (0.00275,-0.34925) [-0.34925|0.34925] "rad"  ADAS
 SG_ DET_ELEVATION_ERR_211 : 304|6@1+ (0.00174533,0) [0|0.10995579] "rad"  ADAS
 SG_ DET_RCS_211 : 352|8@1+ (0.5,-64) [-64|63.5] "dBsm"  ADAS
 SG_ DET_BI_STATIC_FLAG_211 : 328|1@1+ (1,0) [0|1] ""  ADAS
 SG_ DET_SUPER_RES_TARGET_211 : 311|1@1+ (1,0) [0|1] ""  ADAS
 SG_ DET_SNR_211 : 344|8@1+ (0.35156,0) [0|89.6478] "dB"  ADAS
 SG_ DET_EXISTENCE_PROB_211 : 336|6@1+ (1.588,0) [0|100] "%"  ADAS
 SG_ DET_HVC_FLAG_211 : 310|1@1+ (1,0) [0|1] ""  ADAS
 SG_ DET_CONFD_AZIMUTH_211 : 342|2@1+ (1,0) [0|3] ""  ADAS
 SG_ DET_CONFD_ELEVATION_211 : 325|2@1+ (1,0) [0|3] ""  ADAS
 SG_ DET_PROB_1STAZHYPO_211 : 327|1@1+ (1,0) [0|1] ""  ADAS
 SG_ DET_IDM_211 : 287|1@1+ (1,0) [0|1] ""  ADAS
 SG_ DET_MTD_211 : 271|1@1+ (1,0) [0|1] ""  ADAS
 SG_ DET_BELOW_RAIN_THOLD_211 : 263|1@1+ (1,0) [0|1] ""  ADAS
 SG_ DET_RANGE_212 : 360|15@1+ (0.015625,0) [0|500] "m"  ADAS
 SG_ DET_RANGE_ERR_212 : 376|7@1+ (0.0075,0) [0|0.9525] "m"  ADAS
 SG_ DET_RANGE_VELOCITY_212 : 384|15@1+ (0.0078125,-128) [-128|127.9921875] "m/s"  ADAS
 SG_ DET_RANGE_VELOCITY_ERR_212 : 400|8@1+ (0.003,0) [0|0.765] "m/s"  ADAS
 SG_ DET_AZIMUTH_212 : 424|13@1+ (0.0004,-1.5708) [-1.5708|1.5708] "rad"  ADAS
 SG_ DET_AZIMUTH_ERR_212 : 441|7@1+ (0.00087267,0) [0|0.11082909] "rad"  ADAS
 SG_ DET_ELEVATION_212 : 408|8@1+ (0.00275,-0.34925) [-0.34925|0.34925] "rad"  ADAS
 SG_ DET_ELEVATION_ERR_212 : 416|6@1+ (0.00174533,0) [0|0.10995579] "rad"  ADAS
 SG_ DET_RCS_212 : 464|8@1+ (0.5,-64) [-64|63.5] "dBsm"  ADAS
 SG_ DET_BI_STATIC_FLAG_212 : 440|1@1+ (1,0) [0|1] ""  ADAS
 SG_ DET_SUPER_RES_TARGET_212 : 423|1@1+ (1,0) [0|1] ""  ADAS
 SG_ DET_SNR_212 : 456|8@1+ (0.35156,0) [0|89.6478] "dB"  ADAS
 SG_ DET_EXISTENCE_PROB_212 : 448|6@1+ (1.588,0) [0|100] "%"  ADAS
 SG_ DET_HVC_FLAG_212 : 422|1@1+ (1,0) [0|1] ""  ADAS
 SG_ DET_CONFD_AZIMUTH_212 : 454|2@1+ (1,0) [0|3] ""  ADAS
 SG_ DET_CONFD_ELEVATION_212 : 437|2@1+ (1,0) [0|3] ""  ADAS
 SG_ DET_MH_SCAN_INDEX_4LSB_209_212 : 476|4@1+ (1,0) [0|15] ""  ADAS
 SG_ DET_MH_CYCLE_COUNTER_209_212 : 16|8@1+ (1,0) [0|255] ""  ADAS
 SG_ DET_MH_CRC16_209_212 : 0|16@1+ (1,0) [0|65535] ""  ADAS
 SG_ DET_PROB_1STAZHYPO_212 : 439|1@1+ (1,0) [0|1] ""  ADAS
 SG_ DET_IDM_212 : 399|1@1+ (1,0) [0|1] ""  ADAS
 SG_ DET_MTD_212 : 383|1@1+ (1,0) [0|1] ""  ADAS
 SG_ DET_BELOW_RAIN_THOLD_212 : 375|1@1+ (1,0) [0|1] ""  ADAS

BO_ 1205 RDR_DETECTION_213_216: 64 RDR08
 SG_ DET_RANGE_213 : 24|15@1+ (0.015625,0) [0|500] "m"  ADAS
 SG_ DET_RANGE_ERR_213 : 40|7@1+ (0.0075,0) [0|0.9525] "m"  ADAS
 SG_ DET_RANGE_VELOCITY_213 : 48|15@1+ (0.0078125,-128) [-128|127.9921875] "m/s"  ADAS
 SG_ DET_RANGE_VELOCITY_ERR_213 : 64|8@1+ (0.003,0) [0|0.765] "m/s"  ADAS
 SG_ DET_AZIMUTH_213 : 88|13@1+ (0.0004,-1.5708) [-1.5708|1.5708] "rad"  ADAS
 SG_ DET_AZIMUTH_ERR_213 : 105|7@1+ (0.00087267,0) [0|0.11082909] "rad"  ADAS
 SG_ DET_ELEVATION_213 : 72|8@1+ (0.00275,-0.34925) [-0.34925|0.34925] "rad"  ADAS
 SG_ DET_ELEVATION_ERR_213 : 80|6@1+ (0.00174533,0) [0|0.10995579] "rad"  ADAS
 SG_ DET_RCS_213 : 128|8@1+ (0.5,-64) [-64|63.5] "dBsm"  ADAS
 SG_ DET_BI_STATIC_FLAG_213 : 104|1@1+ (1,0) [0|1] ""  ADAS
 SG_ DET_SUPER_RES_TARGET_213 : 87|1@1+ (1,0) [0|1] ""  ADAS
 SG_ DET_SNR_213 : 120|8@1+ (0.35156,0) [0|89.6478] "dB"  ADAS
 SG_ DET_EXISTENCE_PROB_213 : 112|6@1+ (1.588,0) [0|100] "%"  ADAS
 SG_ DET_HVC_FLAG_213 : 86|1@1+ (1,0) [0|1] ""  ADAS
 SG_ DET_CONFD_AZIMUTH_213 : 118|2@1+ (1,0) [0|3] ""  ADAS
 SG_ DET_CONFD_ELEVATION_213 : 101|2@1+ (1,0) [0|3] ""  ADAS
 SG_ DET_PROB_1STAZHYPO_213 : 103|1@1+ (1,0) [0|1] ""  ADAS
 SG_ DET_IDM_213 : 63|1@1+ (1,0) [0|1] ""  ADAS
 SG_ DET_MTD_213 : 47|1@1+ (1,0) [0|1] ""  ADAS
 SG_ DET_BELOW_RAIN_THOLD_213 : 39|1@1+ (1,0) [0|1] ""  ADAS
 SG_ DET_RANGE_214 : 136|15@1+ (0.015625,0) [0|500] "m"  ADAS
 SG_ DET_RANGE_ERR_214 : 152|7@1+ (0.0075,0) [0|0.9525] "m"  ADAS
 SG_ DET_RANGE_VELOCITY_214 : 160|15@1+ (0.0078125,-128) [-128|127.9921875] "m/s"  ADAS
 SG_ DET_RANGE_VELOCITY_ERR_214 : 176|8@1+ (0.003,0) [0|0.765] "m/s"  ADAS
 SG_ DET_AZIMUTH_214 : 200|13@1+ (0.0004,-1.5708) [-1.5708|1.5708] "rad"  ADAS
 SG_ DET_AZIMUTH_ERR_214 : 217|7@1+ (0.00087267,0) [0|0.11082909] "rad"  ADAS
 SG_ DET_ELEVATION_214 : 184|8@1+ (0.00275,-0.34925) [-0.34925|0.34925] "rad"  ADAS
 SG_ DET_ELEVATION_ERR_214 : 192|6@1+ (0.00174533,0) [0|0.10995579] "rad"  ADAS
 SG_ DET_RCS_214 : 240|8@1+ (0.5,-64) [-64|63.5] "dBsm"  ADAS
 SG_ DET_BI_STATIC_FLAG_214 : 216|1@1+ (1,0) [0|1] ""  ADAS
 SG_ DET_SUPER_RES_TARGET_214 : 199|1@1+ (1,0) [0|1] ""  ADAS
 SG_ DET_SNR_214 : 232|8@1+ (0.35156,0) [0|89.6478] "dB"  ADAS
 SG_ DET_EXISTENCE_PROB_214 : 224|6@1+ (1.588,0) [0|100] "%"  ADAS
 SG_ DET_HVC_FLAG_214 : 198|1@1+ (1,0) [0|1] ""  ADAS
 SG_ DET_CONFD_AZIMUTH_214 : 230|2@1+ (1,0) [0|3] ""  ADAS
 SG_ DET_CONFD_ELEVATION_214 : 213|2@1+ (1,0) [0|3] ""  ADAS
 SG_ DET_PROB_1STAZHYPO_214 : 215|1@1+ (1,0) [0|1] ""  ADAS
 SG_ DET_IDM_214 : 175|1@1+ (1,0) [0|1] ""  ADAS
 SG_ DET_MTD_214 : 159|1@1+ (1,0) [0|1] ""  ADAS
 SG_ DET_BELOW_RAIN_THOLD_214 : 151|1@1+ (1,0) [0|1] ""  ADAS
 SG_ DET_RANGE_215 : 248|15@1+ (0.015625,0) [0|500] "m"  ADAS
 SG_ DET_RANGE_ERR_215 : 264|7@1+ (0.0075,0) [0|0.9525] "m"  ADAS
 SG_ DET_RANGE_VELOCITY_215 : 272|15@1+ (0.0078125,-128) [-128|127.9921875] "m/s"  ADAS
 SG_ DET_RANGE_VELOCITY_ERR_215 : 288|8@1+ (0.003,0) [0|0.765] "m/s"  ADAS
 SG_ DET_AZIMUTH_215 : 312|13@1+ (0.0004,-1.5708) [-1.5708|1.5708] "rad"  ADAS
 SG_ DET_AZIMUTH_ERR_215 : 329|7@1+ (0.00087267,0) [0|0.11082909] "rad"  ADAS
 SG_ DET_ELEVATION_215 : 296|8@1+ (0.00275,-0.34925) [-0.34925|0.34925] "rad"  ADAS
 SG_ DET_ELEVATION_ERR_215 : 304|6@1+ (0.00174533,0) [0|0.10995579] "rad"  ADAS
 SG_ DET_RCS_215 : 352|8@1+ (0.5,-64) [-64|63.5] "dBsm"  ADAS
 SG_ DET_BI_STATIC_FLAG_215 : 328|1@1+ (1,0) [0|1] ""  ADAS
 SG_ DET_SUPER_RES_TARGET_215 : 311|1@1+ (1,0) [0|1] ""  ADAS
 SG_ DET_SNR_215 : 344|8@1+ (0.35156,0) [0|89.6478] "dB"  ADAS
 SG_ DET_EXISTENCE_PROB_215 : 336|6@1+ (1.588,0) [0|100] "%"  ADAS
 SG_ DET_HVC_FLAG_215 : 310|1@1+ (1,0) [0|1] ""  ADAS
 SG_ DET_CONFD_AZIMUTH_215 : 342|2@1+ (1,0) [0|3] ""  ADAS
 SG_ DET_CONFD_ELEVATION_215 : 325|2@1+ (1,0) [0|3] ""  ADAS
 SG_ DET_PROB_1STAZHYPO_215 : 327|1@1+ (1,0) [0|1] ""  ADAS
 SG_ DET_IDM_215 : 287|1@1+ (1,0) [0|1] ""  ADAS
 SG_ DET_MTD_215 : 271|1@1+ (1,0) [0|1] ""  ADAS
 SG_ DET_BELOW_RAIN_THOLD_215 : 263|1@1+ (1,0) [0|1] ""  ADAS
 SG_ DET_RANGE_216 : 360|15@1+ (0.015625,0) [0|500] "m"  ADAS
 SG_ DET_RANGE_ERR_216 : 376|7@1+ (0.0075,0) [0|0.9525] "m"  ADAS
 SG_ DET_RANGE_VELOCITY_216 : 384|15@1+ (0.0078125,-128) [-128|127.9921875] "m/s"  ADAS
 SG_ DET_RANGE_VELOCITY_ERR_216 : 400|8@1+ (0.003,0) [0|0.765] "m/s"  ADAS
 SG_ DET_AZIMUTH_216 : 424|13@1+ (0.0004,-1.5708) [-1.5708|1.5708] "rad"  ADAS
 SG_ DET_AZIMUTH_ERR_216 : 441|7@1+ (0.00087267,0) [0|0.11082909] "rad"  ADAS
 SG_ DET_ELEVATION_216 : 408|8@1+ (0.00275,-0.34925) [-0.34925|0.34925] "rad"  ADAS
 SG_ DET_ELEVATION_ERR_216 : 416|6@1+ (0.00174533,0) [0|0.10995579] "rad"  ADAS
 SG_ DET_RCS_216 : 464|8@1+ (0.5,-64) [-64|63.5] "dBsm"  ADAS
 SG_ DET_BI_STATIC_FLAG_216 : 440|1@1+ (1,0) [0|1] ""  ADAS
 SG_ DET_SUPER_RES_TARGET_216 : 423|1@1+ (1,0) [0|1] ""  ADAS
 SG_ DET_SNR_216 : 456|8@1+ (0.35156,0) [0|89.6478] "dB"  ADAS
 SG_ DET_EXISTENCE_PROB_216 : 448|6@1+ (1.588,0) [0|100] "%"  ADAS
 SG_ DET_HVC_FLAG_216 : 422|1@1+ (1,0) [0|1] ""  ADAS
 SG_ DET_CONFD_AZIMUTH_216 : 454|2@1+ (1,0) [0|3] ""  ADAS
 SG_ DET_CONFD_ELEVATION_216 : 437|2@1+ (1,0) [0|3] ""  ADAS
 SG_ DET_MH_SCAN_INDEX_4LSB_213_216 : 476|4@1+ (1,0) [0|15] ""  ADAS
 SG_ DET_MH_CYCLE_COUNTER_213_216 : 16|8@1+ (1,0) [0|255] ""  ADAS
 SG_ DET_MH_CRC16_213_216 : 0|16@1+ (1,0) [0|65535] ""  ADAS
 SG_ DET_PROB_1STAZHYPO_216 : 439|1@1+ (1,0) [0|1] ""  ADAS
 SG_ DET_IDM_216 : 399|1@1+ (1,0) [0|1] ""  ADAS
 SG_ DET_MTD_216 : 383|1@1+ (1,0) [0|1] ""  ADAS
 SG_ DET_BELOW_RAIN_THOLD_216 : 375|1@1+ (1,0) [0|1] ""  ADAS

BO_ 1206 RDR_DETECTION_217_220: 64 RDR08
 SG_ DET_RANGE_217 : 24|15@1+ (0.015625,0) [0|500] "m"  ADAS
 SG_ DET_RANGE_ERR_217 : 40|7@1+ (0.0075,0) [0|0.9525] "m"  ADAS
 SG_ DET_RANGE_VELOCITY_217 : 48|15@1+ (0.0078125,-128) [-128|127.9921875] "m/s"  ADAS
 SG_ DET_RANGE_VELOCITY_ERR_217 : 64|8@1+ (0.003,0) [0|0.765] "m/s"  ADAS
 SG_ DET_AZIMUTH_217 : 88|13@1+ (0.0004,-1.5708) [-1.5708|1.5708] "rad"  ADAS
 SG_ DET_AZIMUTH_ERR_217 : 105|7@1+ (0.00087267,0) [0|0.11082909] "rad"  ADAS
 SG_ DET_ELEVATION_217 : 72|8@1+ (0.00275,-0.34925) [-0.34925|0.34925] "rad"  ADAS
 SG_ DET_ELEVATION_ERR_217 : 80|6@1+ (0.00174533,0) [0|0.10995579] "rad"  ADAS
 SG_ DET_RCS_217 : 128|8@1+ (0.5,-64) [-64|63.5] "dBsm"  ADAS
 SG_ DET_BI_STATIC_FLAG_217 : 104|1@1+ (1,0) [0|1] ""  ADAS
 SG_ DET_SUPER_RES_TARGET_217 : 87|1@1+ (1,0) [0|1] ""  ADAS
 SG_ DET_SNR_217 : 120|8@1+ (0.35156,0) [0|89.6478] "dB"  ADAS
 SG_ DET_EXISTENCE_PROB_217 : 112|6@1+ (1.588,0) [0|100] "%"  ADAS
 SG_ DET_HVC_FLAG_217 : 86|1@1+ (1,0) [0|1] ""  ADAS
 SG_ DET_CONFD_AZIMUTH_217 : 118|2@1+ (1,0) [0|3] ""  ADAS
 SG_ DET_CONFD_ELEVATION_217 : 101|2@1+ (1,0) [0|3] ""  ADAS
 SG_ DET_PROB_1STAZHYPO_217 : 103|1@1+ (1,0) [0|1] ""  ADAS
 SG_ DET_IDM_217 : 63|1@1+ (1,0) [0|1] ""  ADAS
 SG_ DET_MTD_217 : 47|1@1+ (1,0) [0|1] ""  ADAS
 SG_ DET_BELOW_RAIN_THOLD_217 : 39|1@1+ (1,0) [0|1] ""  ADAS
 SG_ DET_RANGE_218 : 136|15@1+ (0.015625,0) [0|500] "m"  ADAS
 SG_ DET_RANGE_ERR_218 : 152|7@1+ (0.0075,0) [0|0.9525] "m"  ADAS
 SG_ DET_RANGE_VELOCITY_218 : 160|15@1+ (0.0078125,-128) [-128|127.9921875] "m/s"  ADAS
 SG_ DET_RANGE_VELOCITY_ERR_218 : 176|8@1+ (0.003,0) [0|0.765] "m/s"  ADAS
 SG_ DET_AZIMUTH_218 : 200|13@1+ (0.0004,-1.5708) [-1.5708|1.5708] "rad"  ADAS
 SG_ DET_AZIMUTH_ERR_218 : 217|7@1+ (0.00087267,0) [0|0.11082909] "rad"  ADAS
 SG_ DET_ELEVATION_218 : 184|8@1+ (0.00275,-0.34925) [-0.34925|0.34925] "rad"  ADAS
 SG_ DET_ELEVATION_ERR_218 : 192|6@1+ (0.00174533,0) [0|0.10995579] "rad"  ADAS
 SG_ DET_RCS_218 : 240|8@1+ (0.5,-64) [-64|63.5] "dBsm"  ADAS
 SG_ DET_BI_STATIC_FLAG_218 : 216|1@1+ (1,0) [0|1] ""  ADAS
 SG_ DET_SUPER_RES_TARGET_218 : 199|1@1+ (1,0) [0|1] ""  ADAS
 SG_ DET_SNR_218 : 232|8@1+ (0.35156,0) [0|89.6478] "dB"  ADAS
 SG_ DET_EXISTENCE_PROB_218 : 224|6@1+ (1.588,0) [0|100] "%"  ADAS
 SG_ DET_HVC_FLAG_218 : 198|1@1+ (1,0) [0|1] ""  ADAS
 SG_ DET_CONFD_AZIMUTH_218 : 230|2@1+ (1,0) [0|3] ""  ADAS
 SG_ DET_CONFD_ELEVATION_218 : 213|2@1+ (1,0) [0|3] ""  ADAS
 SG_ DET_PROB_1STAZHYPO_218 : 215|1@1+ (1,0) [0|1] ""  ADAS
 SG_ DET_IDM_218 : 175|1@1+ (1,0) [0|1] ""  ADAS
 SG_ DET_MTD_218 : 159|1@1+ (1,0) [0|1] ""  ADAS
 SG_ DET_BELOW_RAIN_THOLD_218 : 151|1@1+ (1,0) [0|1] ""  ADAS
 SG_ DET_RANGE_219 : 248|15@1+ (0.015625,0) [0|500] "m"  ADAS
 SG_ DET_RANGE_ERR_219 : 264|7@1+ (0.0075,0) [0|0.9525] "m"  ADAS
 SG_ DET_RANGE_VELOCITY_219 : 272|15@1+ (0.0078125,-128) [-128|127.9921875] "m/s"  ADAS
 SG_ DET_RANGE_VELOCITY_ERR_219 : 288|8@1+ (0.003,0) [0|0.765] "m/s"  ADAS
 SG_ DET_AZIMUTH_219 : 312|13@1+ (0.0004,-1.5708) [-1.5708|1.5708] "rad"  ADAS
 SG_ DET_AZIMUTH_ERR_219 : 329|7@1+ (0.00087267,0) [0|0.11082909] "rad"  ADAS
 SG_ DET_ELEVATION_219 : 296|8@1+ (0.00275,-0.34925) [-0.34925|0.34925] "rad"  ADAS
 SG_ DET_ELEVATION_ERR_219 : 304|6@1+ (0.00174533,0) [0|0.10995579] "rad"  ADAS
 SG_ DET_RCS_219 : 352|8@1+ (0.5,-64) [-64|63.5] "dBsm"  ADAS
 SG_ DET_BI_STATIC_FLAG_219 : 328|1@1+ (1,0) [0|1] ""  ADAS
 SG_ DET_SUPER_RES_TARGET_219 : 311|1@1+ (1,0) [0|1] ""  ADAS
 SG_ DET_SNR_219 : 344|8@1+ (0.35156,0) [0|89.6478] "dB"  ADAS
 SG_ DET_EXISTENCE_PROB_219 : 336|6@1+ (1.588,0) [0|100] "%"  ADAS
 SG_ DET_HVC_FLAG_219 : 310|1@1+ (1,0) [0|1] ""  ADAS
 SG_ DET_CONFD_AZIMUTH_219 : 342|2@1+ (1,0) [0|3] ""  ADAS
 SG_ DET_CONFD_ELEVATION_219 : 325|2@1+ (1,0) [0|3] ""  ADAS
 SG_ DET_PROB_1STAZHYPO_219 : 327|1@1+ (1,0) [0|1] ""  ADAS
 SG_ DET_IDM_219 : 287|1@1+ (1,0) [0|1] ""  ADAS
 SG_ DET_MTD_219 : 271|1@1+ (1,0) [0|1] ""  ADAS
 SG_ DET_BELOW_RAIN_THOLD_219 : 263|1@1+ (1,0) [0|1] ""  ADAS
 SG_ DET_RANGE_220 : 360|15@1+ (0.015625,0) [0|500] "m"  ADAS
 SG_ DET_RANGE_ERR_220 : 376|7@1+ (0.0075,0) [0|0.9525] "m"  ADAS
 SG_ DET_RANGE_VELOCITY_220 : 384|15@1+ (0.0078125,-128) [-128|127.9921875] "m/s"  ADAS
 SG_ DET_RANGE_VELOCITY_ERR_220 : 400|8@1+ (0.003,0) [0|0.765] "m/s"  ADAS
 SG_ DET_AZIMUTH_220 : 424|13@1+ (0.0004,-1.5708) [-1.5708|1.5708] "rad"  ADAS
 SG_ DET_AZIMUTH_ERR_220 : 441|7@1+ (0.00087267,0) [0|0.11082909] "rad"  ADAS
 SG_ DET_ELEVATION_220 : 408|8@1+ (0.00275,-0.34925) [-0.34925|0.34925] "rad"  ADAS
 SG_ DET_ELEVATION_ERR_220 : 416|6@1+ (0.00174533,0) [0|0.10995579] "rad"  ADAS
 SG_ DET_RCS_220 : 464|8@1+ (0.5,-64) [-64|63.5] "dBsm"  ADAS
 SG_ DET_BI_STATIC_FLAG_220 : 440|1@1+ (1,0) [0|1] ""  ADAS
 SG_ DET_SUPER_RES_TARGET_220 : 423|1@1+ (1,0) [0|1] ""  ADAS
 SG_ DET_SNR_220 : 456|8@1+ (0.35156,0) [0|89.6478] "dB"  ADAS
 SG_ DET_EXISTENCE_PROB_220 : 448|6@1+ (1.588,0) [0|100] "%"  ADAS
 SG_ DET_HVC_FLAG_220 : 422|1@1+ (1,0) [0|1] ""  ADAS
 SG_ DET_CONFD_AZIMUTH_220 : 454|2@1+ (1,0) [0|3] ""  ADAS
 SG_ DET_CONFD_ELEVATION_220 : 437|2@1+ (1,0) [0|3] ""  ADAS
 SG_ DET_MH_SCAN_INDEX_4LSB_217_220 : 476|4@1+ (1,0) [0|15] ""  ADAS
 SG_ DET_MH_CYCLE_COUNTER_217_220 : 16|8@1+ (1,0) [0|255] ""  ADAS
 SG_ DET_MH_CRC16_217_220 : 0|16@1+ (1,0) [0|65535] ""  ADAS
 SG_ DET_PROB_1STAZHYPO_220 : 439|1@1+ (1,0) [0|1] ""  ADAS
 SG_ DET_IDM_220 : 399|1@1+ (1,0) [0|1] ""  ADAS
 SG_ DET_MTD_220 : 383|1@1+ (1,0) [0|1] ""  ADAS
 SG_ DET_BELOW_RAIN_THOLD_220 : 375|1@1+ (1,0) [0|1] ""  ADAS

BO_ 1207 RDR_DETECTION_221_224: 64 RDR08
 SG_ DET_RANGE_221 : 24|15@1+ (0.015625,0) [0|500] "m"  ADAS
 SG_ DET_RANGE_ERR_221 : 40|7@1+ (0.0075,0) [0|0.9525] "m"  ADAS
 SG_ DET_RANGE_VELOCITY_221 : 48|15@1+ (0.0078125,-128) [-128|127.9921875] "m/s"  ADAS
 SG_ DET_RANGE_VELOCITY_ERR_221 : 64|8@1+ (0.003,0) [0|0.765] "m/s"  ADAS
 SG_ DET_AZIMUTH_221 : 88|13@1+ (0.0004,-1.5708) [-1.5708|1.5708] "rad"  ADAS
 SG_ DET_AZIMUTH_ERR_221 : 105|7@1+ (0.00087267,0) [0|0.11082909] "rad"  ADAS
 SG_ DET_ELEVATION_221 : 72|8@1+ (0.00275,-0.34925) [-0.34925|0.34925] "rad"  ADAS
 SG_ DET_ELEVATION_ERR_221 : 80|6@1+ (0.00174533,0) [0|0.10995579] "rad"  ADAS
 SG_ DET_RCS_221 : 128|8@1+ (0.5,-64) [-64|63.5] "dBsm"  ADAS
 SG_ DET_BI_STATIC_FLAG_221 : 104|1@1+ (1,0) [0|1] ""  ADAS
 SG_ DET_SUPER_RES_TARGET_221 : 87|1@1+ (1,0) [0|1] ""  ADAS
 SG_ DET_SNR_221 : 120|8@1+ (0.35156,0) [0|89.6478] "dB"  ADAS
 SG_ DET_EXISTENCE_PROB_221 : 112|6@1+ (1.588,0) [0|100] "%"  ADAS
 SG_ DET_HVC_FLAG_221 : 86|1@1+ (1,0) [0|1] ""  ADAS
 SG_ DET_CONFD_AZIMUTH_221 : 118|2@1+ (1,0) [0|3] ""  ADAS
 SG_ DET_CONFD_ELEVATION_221 : 101|2@1+ (1,0) [0|3] ""  ADAS
 SG_ DET_PROB_1STAZHYPO_221 : 103|1@1+ (1,0) [0|1] ""  ADAS
 SG_ DET_IDM_221 : 63|1@1+ (1,0) [0|1] ""  ADAS
 SG_ DET_MTD_221 : 47|1@1+ (1,0) [0|1] ""  ADAS
 SG_ DET_BELOW_RAIN_THOLD_221 : 39|1@1+ (1,0) [0|1] ""  ADAS
 SG_ DET_RANGE_222 : 136|15@1+ (0.015625,0) [0|500] "m"  ADAS
 SG_ DET_RANGE_ERR_222 : 152|7@1+ (0.0075,0) [0|0.9525] "m"  ADAS
 SG_ DET_RANGE_VELOCITY_222 : 160|15@1+ (0.0078125,-128) [-128|127.9921875] "m/s"  ADAS
 SG_ DET_RANGE_VELOCITY_ERR_222 : 176|8@1+ (0.003,0) [0|0.765] "m/s"  ADAS
 SG_ DET_AZIMUTH_222 : 200|13@1+ (0.0004,-1.5708) [-1.5708|1.5708] "rad"  ADAS
 SG_ DET_AZIMUTH_ERR_222 : 217|7@1+ (0.00087267,0) [0|0.11082909] "rad"  ADAS
 SG_ DET_ELEVATION_222 : 184|8@1+ (0.00275,-0.34925) [-0.34925|0.34925] "rad"  ADAS
 SG_ DET_ELEVATION_ERR_222 : 192|6@1+ (0.00174533,0) [0|0.10995579] "rad"  ADAS
 SG_ DET_RCS_222 : 240|8@1+ (0.5,-64) [-64|63.5] "dBsm"  ADAS
 SG_ DET_BI_STATIC_FLAG_222 : 216|1@1+ (1,0) [0|1] ""  ADAS
 SG_ DET_SUPER_RES_TARGET_222 : 199|1@1+ (1,0) [0|1] ""  ADAS
 SG_ DET_SNR_222 : 232|8@1+ (0.35156,0) [0|89.6478] "dB"  ADAS
 SG_ DET_EXISTENCE_PROB_222 : 224|6@1+ (1.588,0) [0|100] "%"  ADAS
 SG_ DET_HVC_FLAG_222 : 198|1@1+ (1,0) [0|1] ""  ADAS
 SG_ DET_CONFD_AZIMUTH_222 : 230|2@1+ (1,0) [0|3] ""  ADAS
 SG_ DET_CONFD_ELEVATION_222 : 213|2@1+ (1,0) [0|3] ""  ADAS
 SG_ DET_PROB_1STAZHYPO_222 : 215|1@1+ (1,0) [0|1] ""  ADAS
 SG_ DET_IDM_222 : 175|1@1+ (1,0) [0|1] ""  ADAS
 SG_ DET_MTD_222 : 159|1@1+ (1,0) [0|1] ""  ADAS
 SG_ DET_BELOW_RAIN_THOLD_222 : 151|1@1+ (1,0) [0|1] ""  ADAS
 SG_ DET_RANGE_223 : 248|15@1+ (0.015625,0) [0|500] "m"  ADAS
 SG_ DET_RANGE_ERR_223 : 264|7@1+ (0.0075,0) [0|0.9525] "m"  ADAS
 SG_ DET_RANGE_VELOCITY_223 : 272|15@1+ (0.0078125,-128) [-128|127.9921875] "m/s"  ADAS
 SG_ DET_RANGE_VELOCITY_ERR_223 : 288|8@1+ (0.003,0) [0|0.765] "m/s"  ADAS
 SG_ DET_AZIMUTH_223 : 312|13@1+ (0.0004,-1.5708) [-1.5708|1.5708] "rad"  ADAS
 SG_ DET_AZIMUTH_ERR_223 : 329|7@1+ (0.00087267,0) [0|0.11082909] "rad"  ADAS
 SG_ DET_ELEVATION_223 : 296|8@1+ (0.00275,-0.34925) [-0.34925|0.34925] "rad"  ADAS
 SG_ DET_ELEVATION_ERR_223 : 304|6@1+ (0.00174533,0) [0|0.10995579] "rad"  ADAS
 SG_ DET_RCS_223 : 352|8@1+ (0.5,-64) [-64|63.5] "dBsm"  ADAS
 SG_ DET_BI_STATIC_FLAG_223 : 328|1@1+ (1,0) [0|1] ""  ADAS
 SG_ DET_SUPER_RES_TARGET_223 : 311|1@1+ (1,0) [0|1] ""  ADAS
 SG_ DET_SNR_223 : 344|8@1+ (0.35156,0) [0|89.6478] "dB"  ADAS
 SG_ DET_EXISTENCE_PROB_223 : 336|6@1+ (1.588,0) [0|100] "%"  ADAS
 SG_ DET_HVC_FLAG_223 : 310|1@1+ (1,0) [0|1] ""  ADAS
 SG_ DET_CONFD_AZIMUTH_223 : 342|2@1+ (1,0) [0|3] ""  ADAS
 SG_ DET_CONFD_ELEVATION_223 : 325|2@1+ (1,0) [0|3] ""  ADAS
 SG_ DET_PROB_1STAZHYPO_223 : 327|1@1+ (1,0) [0|1] ""  ADAS
 SG_ DET_IDM_223 : 287|1@1+ (1,0) [0|1] ""  ADAS
 SG_ DET_MTD_223 : 271|1@1+ (1,0) [0|1] ""  ADAS
 SG_ DET_BELOW_RAIN_THOLD_223 : 263|1@1+ (1,0) [0|1] ""  ADAS
 SG_ DET_RANGE_224 : 360|15@1+ (0.015625,0) [0|500] "m"  ADAS
 SG_ DET_RANGE_ERR_224 : 376|7@1+ (0.0075,0) [0|0.9525] "m"  ADAS
 SG_ DET_RANGE_VELOCITY_224 : 384|15@1+ (0.0078125,-128) [-128|127.9921875] "m/s"  ADAS
 SG_ DET_RANGE_VELOCITY_ERR_224 : 400|8@1+ (0.003,0) [0|0.765] "m/s"  ADAS
 SG_ DET_AZIMUTH_224 : 424|13@1+ (0.0004,-1.5708) [-1.5708|1.5708] "rad"  ADAS
 SG_ DET_AZIMUTH_ERR_224 : 441|7@1+ (0.00087267,0) [0|0.11082909] "rad"  ADAS
 SG_ DET_ELEVATION_224 : 408|8@1+ (0.00275,-0.34925) [-0.34925|0.34925] "rad"  ADAS
 SG_ DET_ELEVATION_ERR_224 : 416|6@1+ (0.00174533,0) [0|0.10995579] "rad"  ADAS
 SG_ DET_RCS_224 : 464|8@1+ (0.5,-64) [-64|63.5] "dBsm"  ADAS
 SG_ DET_BI_STATIC_FLAG_224 : 440|1@1+ (1,0) [0|1] ""  ADAS
 SG_ DET_SUPER_RES_TARGET_224 : 423|1@1+ (1,0) [0|1] ""  ADAS
 SG_ DET_SNR_224 : 456|8@1+ (0.35156,0) [0|89.6478] "dB"  ADAS
 SG_ DET_EXISTENCE_PROB_224 : 448|6@1+ (1.588,0) [0|100] "%"  ADAS
 SG_ DET_HVC_FLAG_224 : 422|1@1+ (1,0) [0|1] ""  ADAS
 SG_ DET_CONFD_AZIMUTH_224 : 454|2@1+ (1,0) [0|3] ""  ADAS
 SG_ DET_CONFD_ELEVATION_224 : 437|2@1+ (1,0) [0|3] ""  ADAS
 SG_ DET_MH_SCAN_INDEX_4LSB_221_224 : 476|4@1+ (1,0) [0|15] ""  ADAS
 SG_ DET_MH_CYCLE_COUNTER_221_224 : 16|8@1+ (1,0) [0|255] ""  ADAS
 SG_ DET_MH_CRC16_221_224 : 0|16@1+ (1,0) [0|65535] ""  ADAS
 SG_ DET_PROB_1STAZHYPO_224 : 439|1@1+ (1,0) [0|1] ""  ADAS
 SG_ DET_IDM_224 : 399|1@1+ (1,0) [0|1] ""  ADAS
 SG_ DET_MTD_224 : 383|1@1+ (1,0) [0|1] ""  ADAS
 SG_ DET_BELOW_RAIN_THOLD_224 : 375|1@1+ (1,0) [0|1] ""  ADAS

CM_ SG_ 1192 DET_RANGE_161 " measured position  of the detection";
CM_ SG_ 1192 DET_RANGE_ERR_161 "RMSE or standard deviation of the measured angle  of the detection";
CM_ SG_ 1192 DET_RANGE_VELOCITY_161 "Radial velocity of the detection positive in direction to the sensor";
CM_ SG_ 1192 DET_RANGE_VELOCITY_ERR_161 "RMSE or standard deviation of the measure radial velocity of the detection";
CM_ SG_ 1192 DET_AZIMUTH_161 "Measured angle  of the detection";
CM_ SG_ 1192 DET_AZIMUTH_ERR_161 "RMSE or standard deviation of the measured angle  of the detection";
CM_ SG_ 1192 DET_ELEVATION_161 "measured elevation of the detection";
CM_ SG_ 1192 DET_ELEVATION_ERR_161 "RMSE or standard deviation of the measured elevation  of the detection";
CM_ SG_ 1192 DET_RCS_161 "Radar Cross Section or Amplitude, is a measure of how detectable an object is by radar. A larger RCS indicates that an object is more easily detected.";
CM_ SG_ 1192 DET_BI_STATIC_FLAG_161 "1 if detection is bi-static 0 otherwise";
CM_ SG_ 1192 DET_SUPER_RES_TARGET_161 "flasg is set if the detection is super resolution target";
CM_ SG_ 1192 DET_SNR_161 "The signal to noise ratio (SNR) of the radar detection";
CM_ SG_ 1192 DET_EXISTENCE_PROB_161 "Existence probability of the detection not based on history. Value does  not depend on any past experience with similar detections.
\note Use as confidence measure where a low value means less confidence
and a high value indicates strong confidence.";
CM_ SG_ 1192 DET_HVC_FLAG_161 "Core2 Vehicle clutter flag";
CM_ SG_ 1192 DET_CONFD_AZIMUTH_161 "Define the Confidence of Azimuth for Detection ";
CM_ SG_ 1192 DET_CONFD_ELEVATION_161 "Define the Confidence of Elevation for the Detection ";
CM_ SG_ 1192 DET_BI_STATIC_FLAG_162 "1 if detection is bi-static 0 otherwise";
CM_ SG_ 1192 DET_BI_STATIC_FLAG_163 "1 if detection is bi-static 0 otherwise";
CM_ SG_ 1192 DET_BI_STATIC_FLAG_164 "1 if detection is bi-static 0 otherwise";
CM_ SG_ 1192 DET_MH_SCAN_INDEX_4LSB_161_164 "Scan index of the measured detection";
CM_ SG_ 1192 DET_MH_CYCLE_COUNTER_161_164 "Detection Alive Counter";
CM_ SG_ 1193 DET_RANGE_165 " measured position  of the detection";
CM_ SG_ 1193 DET_RANGE_ERR_165 "RMSE or standard deviation of the measured angle  of the detection";
CM_ SG_ 1193 DET_RANGE_VELOCITY_165 "Radial velocity of the detection positive in direction to the sensor";
CM_ SG_ 1193 DET_RANGE_VELOCITY_ERR_165 "RMSE or standard deviation of the measure radial velocity of the detection";
CM_ SG_ 1193 DET_AZIMUTH_165 "Measured angle  of the detection";
CM_ SG_ 1193 DET_AZIMUTH_ERR_165 "RMSE or standard deviation of the measured angle  of the detection";
CM_ SG_ 1193 DET_ELEVATION_165 "measured elevation of the detection";
CM_ SG_ 1193 DET_ELEVATION_ERR_165 "RMSE or standard deviation of the measured elevation  of the detection";
CM_ SG_ 1193 DET_RCS_165 "Radar Cross Section or Amplitude, is a measure of how detectable an object is by radar. A larger RCS indicates that an object is more easily detected.";
CM_ SG_ 1193 DET_BI_STATIC_FLAG_165 "1 if detection is bi-static 0 otherwise";
CM_ SG_ 1193 DET_SUPER_RES_TARGET_165 "flasg is set if the detection is super resolution target";
CM_ SG_ 1193 DET_SNR_165 "The signal to noise ratio (SNR) of the radar detection";
CM_ SG_ 1193 DET_EXISTENCE_PROB_165 "Existence probability of the detection not based on history. Value does  not depend on any past experience with similar detections.
\note Use as confidence measure where a low value means less confidence
and a high value indicates strong confidence.";
CM_ SG_ 1193 DET_HVC_FLAG_165 "Core2 Vehicle clutter flag";
CM_ SG_ 1193 DET_CONFD_AZIMUTH_165 "Define the Confidence of Azimuth for Detection ";
CM_ SG_ 1193 DET_CONFD_ELEVATION_165 "Define the Confidence of Elevation for the Detection ";
CM_ SG_ 1193 DET_BI_STATIC_FLAG_166 "1 if detection is bi-static 0 otherwise";
CM_ SG_ 1193 DET_BI_STATIC_FLAG_167 "1 if detection is bi-static 0 otherwise";
CM_ SG_ 1193 DET_BI_STATIC_FLAG_168 "1 if detection is bi-static 0 otherwise";
CM_ SG_ 1193 DET_MH_SCAN_INDEX_4LSB_165_168 "Scan index of the measured detection";
CM_ SG_ 1193 DET_MH_CYCLE_COUNTER_165_168 "Detection Alive Counter";
CM_ SG_ 1194 DET_RANGE_169 " measured position  of the detection";
CM_ SG_ 1194 DET_RANGE_ERR_169 "RMSE or standard deviation of the measured angle  of the detection";
CM_ SG_ 1194 DET_RANGE_VELOCITY_169 "Radial velocity of the detection positive in direction to the sensor";
CM_ SG_ 1194 DET_RANGE_VELOCITY_ERR_169 "RMSE or standard deviation of the measure radial velocity of the detection";
CM_ SG_ 1194 DET_AZIMUTH_169 "Measured angle  of the detection";
CM_ SG_ 1194 DET_AZIMUTH_ERR_169 "RMSE or standard deviation of the measured angle  of the detection";
CM_ SG_ 1194 DET_ELEVATION_169 "measured elevation of the detection";
CM_ SG_ 1194 DET_ELEVATION_ERR_169 "RMSE or standard deviation of the measured elevation  of the detection";
CM_ SG_ 1194 DET_RCS_169 "Radar Cross Section or Amplitude, is a measure of how detectable an object is by radar. A larger RCS indicates that an object is more easily detected.";
CM_ SG_ 1194 DET_BI_STATIC_FLAG_169 "1 if detection is bi-static 0 otherwise";
CM_ SG_ 1194 DET_SUPER_RES_TARGET_169 "flasg is set if the detection is super resolution target";
CM_ SG_ 1194 DET_SNR_169 "The signal to noise ratio (SNR) of the radar detection";
CM_ SG_ 1194 DET_EXISTENCE_PROB_169 "Existence probability of the detection not based on history. Value does  not depend on any past experience with similar detections.
\note Use as confidence measure where a low value means less confidence
and a high value indicates strong confidence.";
CM_ SG_ 1194 DET_HVC_FLAG_169 "Core2 Vehicle clutter flag";
CM_ SG_ 1194 DET_CONFD_AZIMUTH_169 "Define the Confidence of Azimuth for Detection ";
CM_ SG_ 1194 DET_CONFD_ELEVATION_169 "Define the Confidence of Elevation for the Detection ";
CM_ SG_ 1194 DET_BI_STATIC_FLAG_170 "1 if detection is bi-static 0 otherwise";
CM_ SG_ 1194 DET_BI_STATIC_FLAG_171 "1 if detection is bi-static 0 otherwise";
CM_ SG_ 1194 DET_BI_STATIC_FLAG_172 "1 if detection is bi-static 0 otherwise";
CM_ SG_ 1194 DET_MH_SCAN_INDEX_4LSB_169_172 "Scan index of the measured detection";
CM_ SG_ 1194 DET_MH_CYCLE_COUNTER_169_172 "Detection Alive Counter";
CM_ SG_ 1195 DET_RANGE_173 " measured position  of the detection";
CM_ SG_ 1195 DET_RANGE_ERR_173 "RMSE or standard deviation of the measured angle  of the detection";
CM_ SG_ 1195 DET_RANGE_VELOCITY_173 "Radial velocity of the detection positive in direction to the sensor";
CM_ SG_ 1195 DET_RANGE_VELOCITY_ERR_173 "RMSE or standard deviation of the measure radial velocity of the detection";
CM_ SG_ 1195 DET_AZIMUTH_173 "Measured angle  of the detection";
CM_ SG_ 1195 DET_AZIMUTH_ERR_173 "RMSE or standard deviation of the measured angle  of the detection";
CM_ SG_ 1195 DET_ELEVATION_173 "measured elevation of the detection";
CM_ SG_ 1195 DET_ELEVATION_ERR_173 "RMSE or standard deviation of the measured elevation  of the detection";
CM_ SG_ 1195 DET_RCS_173 "Radar Cross Section or Amplitude, is a measure of how detectable an object is by radar. A larger RCS indicates that an object is more easily detected.";
CM_ SG_ 1195 DET_BI_STATIC_FLAG_173 "1 if detection is bi-static 0 otherwise";
CM_ SG_ 1195 DET_SUPER_RES_TARGET_173 "flasg is set if the detection is super resolution target";
CM_ SG_ 1195 DET_SNR_173 "The signal to noise ratio (SNR) of the radar detection";
CM_ SG_ 1195 DET_EXISTENCE_PROB_173 "Existence probability of the detection not based on history. Value does  not depend on any past experience with similar detections.
\note Use as confidence measure where a low value means less confidence
and a high value indicates strong confidence.";
CM_ SG_ 1195 DET_HVC_FLAG_173 "Core2 Vehicle clutter flag";
CM_ SG_ 1195 DET_CONFD_AZIMUTH_173 "Define the Confidence of Azimuth for Detection ";
CM_ SG_ 1195 DET_CONFD_ELEVATION_173 "Define the Confidence of Elevation for the Detection ";
CM_ SG_ 1195 DET_BI_STATIC_FLAG_174 "1 if detection is bi-static 0 otherwise";
CM_ SG_ 1195 DET_BI_STATIC_FLAG_175 "1 if detection is bi-static 0 otherwise";
CM_ SG_ 1195 DET_BI_STATIC_FLAG_176 "1 if detection is bi-static 0 otherwise";
CM_ SG_ 1195 DET_MH_SCAN_INDEX_4LSB_173_176 "Scan index of the measured detection";
CM_ SG_ 1195 DET_MH_CYCLE_COUNTER_173_176 "Detection Alive Counter";
CM_ SG_ 1196 DET_RANGE_177 " measured position  of the detection";
CM_ SG_ 1196 DET_RANGE_ERR_177 "RMSE or standard deviation of the measured angle  of the detection";
CM_ SG_ 1196 DET_RANGE_VELOCITY_177 "Radial velocity of the detection positive in direction to the sensor";
CM_ SG_ 1196 DET_RANGE_VELOCITY_ERR_177 "RMSE or standard deviation of the measure radial velocity of the detection";
CM_ SG_ 1196 DET_AZIMUTH_177 "Measured angle  of the detection";
CM_ SG_ 1196 DET_AZIMUTH_ERR_177 "RMSE or standard deviation of the measured angle  of the detection";
CM_ SG_ 1196 DET_ELEVATION_177 "measured elevation of the detection";
CM_ SG_ 1196 DET_ELEVATION_ERR_177 "RMSE or standard deviation of the measured elevation  of the detection";
CM_ SG_ 1196 DET_RCS_177 "Radar Cross Section or Amplitude, is a measure of how detectable an object is by radar. A larger RCS indicates that an object is more easily detected.";
CM_ SG_ 1196 DET_BI_STATIC_FLAG_177 "1 if detection is bi-static 0 otherwise";
CM_ SG_ 1196 DET_SUPER_RES_TARGET_177 "flasg is set if the detection is super resolution target";
CM_ SG_ 1196 DET_SNR_177 "The signal to noise ratio (SNR) of the radar detection";
CM_ SG_ 1196 DET_EXISTENCE_PROB_177 "Existence probability of the detection not based on history. Value does  not depend on any past experience with similar detections.
\note Use as confidence measure where a low value means less confidence
and a high value indicates strong confidence.";
CM_ SG_ 1196 DET_HVC_FLAG_177 "Core2 Vehicle clutter flag";
CM_ SG_ 1196 DET_CONFD_AZIMUTH_177 "Define the Confidence of Azimuth for Detection ";
CM_ SG_ 1196 DET_CONFD_ELEVATION_177 "Define the Confidence of Elevation for the Detection ";
CM_ SG_ 1196 DET_BI_STATIC_FLAG_178 "1 if detection is bi-static 0 otherwise";
CM_ SG_ 1196 DET_BI_STATIC_FLAG_179 "1 if detection is bi-static 0 otherwise";
CM_ SG_ 1196 DET_BI_STATIC_FLAG_180 "1 if detection is bi-static 0 otherwise";
CM_ SG_ 1196 DET_MH_SCAN_INDEX_4LSB_177_180 "Scan index of the measured detection";
CM_ SG_ 1196 DET_MH_CYCLE_COUNTER_177_180 "Detection Alive Counter";
CM_ SG_ 1197 DET_RANGE_181 " measured position  of the detection";
CM_ SG_ 1197 DET_RANGE_ERR_181 "RMSE or standard deviation of the measured angle  of the detection";
CM_ SG_ 1197 DET_RANGE_VELOCITY_181 "Radial velocity of the detection positive in direction to the sensor";
CM_ SG_ 1197 DET_RANGE_VELOCITY_ERR_181 "RMSE or standard deviation of the measure radial velocity of the detection";
CM_ SG_ 1197 DET_AZIMUTH_181 "Measured angle  of the detection";
CM_ SG_ 1197 DET_AZIMUTH_ERR_181 "RMSE or standard deviation of the measured angle  of the detection";
CM_ SG_ 1197 DET_ELEVATION_181 "measured elevation of the detection";
CM_ SG_ 1197 DET_ELEVATION_ERR_181 "RMSE or standard deviation of the measured elevation  of the detection";
CM_ SG_ 1197 DET_RCS_181 "Radar Cross Section or Amplitude, is a measure of how detectable an object is by radar. A larger RCS indicates that an object is more easily detected.";
CM_ SG_ 1197 DET_BI_STATIC_FLAG_181 "1 if detection is bi-static 0 otherwise";
CM_ SG_ 1197 DET_SUPER_RES_TARGET_181 "flasg is set if the detection is super resolution target";
CM_ SG_ 1197 DET_SNR_181 "The signal to noise ratio (SNR) of the radar detection";
CM_ SG_ 1197 DET_EXISTENCE_PROB_181 "Existence probability of the detection not based on history. Value does  not depend on any past experience with similar detections.
\note Use as confidence measure where a low value means less confidence
and a high value indicates strong confidence.";
CM_ SG_ 1197 DET_HVC_FLAG_181 "Core2 Vehicle clutter flag";
CM_ SG_ 1197 DET_CONFD_AZIMUTH_181 "Define the Confidence of Azimuth for Detection ";
CM_ SG_ 1197 DET_CONFD_ELEVATION_181 "Define the Confidence of Elevation for the Detection ";
CM_ SG_ 1197 DET_BI_STATIC_FLAG_182 "1 if detection is bi-static 0 otherwise";
CM_ SG_ 1197 DET_BI_STATIC_FLAG_183 "1 if detection is bi-static 0 otherwise";
CM_ SG_ 1197 DET_BI_STATIC_FLAG_184 "1 if detection is bi-static 0 otherwise";
CM_ SG_ 1197 DET_MH_SCAN_INDEX_4LSB_181_184 "Scan index of the measured detection";
CM_ SG_ 1197 DET_MH_CYCLE_COUNTER_181_184 "Detection Alive Counter";
CM_ SG_ 1198 DET_RANGE_185 " measured position  of the detection";
CM_ SG_ 1198 DET_RANGE_ERR_185 "RMSE or standard deviation of the measured angle  of the detection";
CM_ SG_ 1198 DET_RANGE_VELOCITY_185 "Radial velocity of the detection positive in direction to the sensor";
CM_ SG_ 1198 DET_RANGE_VELOCITY_ERR_185 "RMSE or standard deviation of the measure radial velocity of the detection";
CM_ SG_ 1198 DET_AZIMUTH_185 "Measured angle  of the detection";
CM_ SG_ 1198 DET_AZIMUTH_ERR_185 "RMSE or standard deviation of the measured angle  of the detection";
CM_ SG_ 1198 DET_ELEVATION_185 "measured elevation of the detection";
CM_ SG_ 1198 DET_ELEVATION_ERR_185 "RMSE or standard deviation of the measured elevation  of the detection";
CM_ SG_ 1198 DET_RCS_185 "Radar Cross Section or Amplitude, is a measure of how detectable an object is by radar. A larger RCS indicates that an object is more easily detected.";
CM_ SG_ 1198 DET_BI_STATIC_FLAG_185 "1 if detection is bi-static 0 otherwise";
CM_ SG_ 1198 DET_SUPER_RES_TARGET_185 "flasg is set if the detection is super resolution target";
CM_ SG_ 1198 DET_SNR_185 "The signal to noise ratio (SNR) of the radar detection";
CM_ SG_ 1198 DET_EXISTENCE_PROB_185 "Existence probability of the detection not based on history. Value does  not depend on any past experience with similar detections.
\note Use as confidence measure where a low value means less confidence
and a high value indicates strong confidence.";
CM_ SG_ 1198 DET_HVC_FLAG_185 "Core2 Vehicle clutter flag";
CM_ SG_ 1198 DET_CONFD_AZIMUTH_185 "Define the Confidence of Azimuth for Detection ";
CM_ SG_ 1198 DET_CONFD_ELEVATION_185 "Define the Confidence of Elevation for the Detection ";
CM_ SG_ 1198 DET_BI_STATIC_FLAG_186 "1 if detection is bi-static 0 otherwise";
CM_ SG_ 1198 DET_BI_STATIC_FLAG_187 "1 if detection is bi-static 0 otherwise";
CM_ SG_ 1198 DET_BI_STATIC_FLAG_188 "1 if detection is bi-static 0 otherwise";
CM_ SG_ 1198 DET_MH_SCAN_INDEX_4LSB_185_188 "Scan index of the measured detection";
CM_ SG_ 1198 DET_MH_CYCLE_COUNTER_185_188 "Detection Alive Counter";
CM_ SG_ 1199 DET_RANGE_189 " measured position  of the detection";
CM_ SG_ 1199 DET_RANGE_ERR_189 "RMSE or standard deviation of the measured angle  of the detection";
CM_ SG_ 1199 DET_RANGE_VELOCITY_189 "Radial velocity of the detection positive in direction to the sensor";
CM_ SG_ 1199 DET_RANGE_VELOCITY_ERR_189 "RMSE or standard deviation of the measure radial velocity of the detection";
CM_ SG_ 1199 DET_AZIMUTH_189 "Measured angle  of the detection";
CM_ SG_ 1199 DET_AZIMUTH_ERR_189 "RMSE or standard deviation of the measured angle  of the detection";
CM_ SG_ 1199 DET_ELEVATION_189 "measured elevation of the detection";
CM_ SG_ 1199 DET_ELEVATION_ERR_189 "RMSE or standard deviation of the measured elevation  of the detection";
CM_ SG_ 1199 DET_RCS_189 "Radar Cross Section or Amplitude, is a measure of how detectable an object is by radar. A larger RCS indicates that an object is more easily detected.";
CM_ SG_ 1199 DET_BI_STATIC_FLAG_189 "1 if detection is bi-static 0 otherwise";
CM_ SG_ 1199 DET_SUPER_RES_TARGET_189 "flasg is set if the detection is super resolution target";
CM_ SG_ 1199 DET_SNR_189 "The signal to noise ratio (SNR) of the radar detection";
CM_ SG_ 1199 DET_EXISTENCE_PROB_189 "Existence probability of the detection not based on history. Value does  not depend on any past experience with similar detections.
\note Use as confidence measure where a low value means less confidence
and a high value indicates strong confidence.";
CM_ SG_ 1199 DET_HVC_FLAG_189 "Core2 Vehicle clutter flag";
CM_ SG_ 1199 DET_CONFD_AZIMUTH_189 "Define the Confidence of Azimuth for Detection ";
CM_ SG_ 1199 DET_CONFD_ELEVATION_189 "Define the Confidence of Elevation for the Detection ";
CM_ SG_ 1199 DET_BI_STATIC_FLAG_190 "1 if detection is bi-static 0 otherwise";
CM_ SG_ 1199 DET_BI_STATIC_FLAG_191 "1 if detection is bi-static 0 otherwise";
CM_ SG_ 1199 DET_BI_STATIC_FLAG_192 "1 if detection is bi-static 0 otherwise";
CM_ SG_ 1199 DET_MH_SCAN_INDEX_4LSB_189_192 "Scan index of the measured detection";
CM_ SG_ 1199 DET_MH_CYCLE_COUNTER_189_192 "Detection Alive Counter";
CM_ SG_ 1200 DET_RANGE_193 " measured position  of the detection";
CM_ SG_ 1200 DET_RANGE_ERR_193 "RMSE or standard deviation of the measured angle  of the detection";
CM_ SG_ 1200 DET_RANGE_VELOCITY_193 "Radial velocity of the detection positive in direction to the sensor";
CM_ SG_ 1200 DET_RANGE_VELOCITY_ERR_193 "RMSE or standard deviation of the measure radial velocity of the detection";
CM_ SG_ 1200 DET_AZIMUTH_193 "Measured angle  of the detection";
CM_ SG_ 1200 DET_AZIMUTH_ERR_193 "RMSE or standard deviation of the measured angle  of the detection";
CM_ SG_ 1200 DET_ELEVATION_193 "measured elevation of the detection";
CM_ SG_ 1200 DET_ELEVATION_ERR_193 "RMSE or standard deviation of the measured elevation  of the detection";
CM_ SG_ 1200 DET_RCS_193 "Radar Cross Section or Amplitude, is a measure of how detectable an object is by radar. A larger RCS indicates that an object is more easily detected.";
CM_ SG_ 1200 DET_BI_STATIC_FLAG_193 "1 if detection is bi-static 0 otherwise";
CM_ SG_ 1200 DET_SUPER_RES_TARGET_193 "flasg is set if the detection is super resolution target";
CM_ SG_ 1200 DET_SNR_193 "The signal to noise ratio (SNR) of the radar detection";
CM_ SG_ 1200 DET_EXISTENCE_PROB_193 "Existence probability of the detection not based on history. Value does  not depend on any past experience with similar detections.
\note Use as confidence measure where a low value means less confidence
and a high value indicates strong confidence.";
CM_ SG_ 1200 DET_HVC_FLAG_193 "Core2 Vehicle clutter flag";
CM_ SG_ 1200 DET_CONFD_AZIMUTH_193 "Define the Confidence of Azimuth for Detection ";
CM_ SG_ 1200 DET_CONFD_ELEVATION_193 "Define the Confidence of Elevation for the Detection ";
CM_ SG_ 1200 DET_BI_STATIC_FLAG_194 "1 if detection is bi-static 0 otherwise";
CM_ SG_ 1200 DET_BI_STATIC_FLAG_195 "1 if detection is bi-static 0 otherwise";
CM_ SG_ 1200 DET_BI_STATIC_FLAG_196 "1 if detection is bi-static 0 otherwise";
CM_ SG_ 1200 DET_MH_SCAN_INDEX_4LSB_193_196 "Scan index of the measured detection";
CM_ SG_ 1200 DET_MH_CYCLE_COUNTER_193_196 "Detection Alive Counter";
CM_ SG_ 1201 DET_RANGE_197 " measured position  of the detection";
CM_ SG_ 1201 DET_RANGE_ERR_197 "RMSE or standard deviation of the measured angle  of the detection";
CM_ SG_ 1201 DET_RANGE_VELOCITY_197 "Radial velocity of the detection positive in direction to the sensor";
CM_ SG_ 1201 DET_RANGE_VELOCITY_ERR_197 "RMSE or standard deviation of the measure radial velocity of the detection";
CM_ SG_ 1201 DET_AZIMUTH_197 "Measured angle  of the detection";
CM_ SG_ 1201 DET_AZIMUTH_ERR_197 "RMSE or standard deviation of the measured angle  of the detection";
CM_ SG_ 1201 DET_ELEVATION_197 "measured elevation of the detection";
CM_ SG_ 1201 DET_ELEVATION_ERR_197 "RMSE or standard deviation of the measured elevation  of the detection";
CM_ SG_ 1201 DET_RCS_197 "Radar Cross Section or Amplitude, is a measure of how detectable an object is by radar. A larger RCS indicates that an object is more easily detected.";
CM_ SG_ 1201 DET_BI_STATIC_FLAG_197 "1 if detection is bi-static 0 otherwise";
CM_ SG_ 1201 DET_SUPER_RES_TARGET_197 "flasg is set if the detection is super resolution target";
CM_ SG_ 1201 DET_SNR_197 "The signal to noise ratio (SNR) of the radar detection";
CM_ SG_ 1201 DET_EXISTENCE_PROB_197 "Existence probability of the detection not based on history. Value does  not depend on any past experience with similar detections.
\note Use as confidence measure where a low value means less confidence
and a high value indicates strong confidence.";
CM_ SG_ 1201 DET_HVC_FLAG_197 "Core2 Vehicle clutter flag";
CM_ SG_ 1201 DET_CONFD_AZIMUTH_197 "Define the Confidence of Azimuth for Detection ";
CM_ SG_ 1201 DET_CONFD_ELEVATION_197 "Define the Confidence of Elevation for the Detection ";
CM_ SG_ 1201 DET_BI_STATIC_FLAG_198 "1 if detection is bi-static 0 otherwise";
CM_ SG_ 1201 DET_BI_STATIC_FLAG_199 "1 if detection is bi-static 0 otherwise";
CM_ SG_ 1201 DET_BI_STATIC_FLAG_200 "1 if detection is bi-static 0 otherwise";
CM_ SG_ 1201 DET_MH_SCAN_INDEX_4LSB_197_200 "Scan index of the measured detection";
CM_ SG_ 1201 DET_MH_CYCLE_COUNTER_197_200 "Detection Alive Counter";
CM_ SG_ 1202 DET_RANGE_201 " measured position  of the detection";
CM_ SG_ 1202 DET_RANGE_ERR_201 "RMSE or standard deviation of the measured angle  of the detection";
CM_ SG_ 1202 DET_RANGE_VELOCITY_201 "Radial velocity of the detection positive in direction to the sensor";
CM_ SG_ 1202 DET_RANGE_VELOCITY_ERR_201 "RMSE or standard deviation of the measure radial velocity of the detection";
CM_ SG_ 1202 DET_AZIMUTH_201 "Measured angle  of the detection";
CM_ SG_ 1202 DET_AZIMUTH_ERR_201 "RMSE or standard deviation of the measured angle  of the detection";
CM_ SG_ 1202 DET_ELEVATION_201 "measured elevation of the detection";
CM_ SG_ 1202 DET_ELEVATION_ERR_201 "RMSE or standard deviation of the measured elevation  of the detection";
CM_ SG_ 1202 DET_RCS_201 "Radar Cross Section or Amplitude, is a measure of how detectable an object is by radar. A larger RCS indicates that an object is more easily detected.";
CM_ SG_ 1202 DET_BI_STATIC_FLAG_201 "1 if detection is bi-static 0 otherwise";
CM_ SG_ 1202 DET_SUPER_RES_TARGET_201 "flasg is set if the detection is super resolution target";
CM_ SG_ 1202 DET_SNR_201 "The signal to noise ratio (SNR) of the radar detection";
CM_ SG_ 1202 DET_EXISTENCE_PROB_201 "Existence probability of the detection not based on history. Value does  not depend on any past experience with similar detections.
\note Use as confidence measure where a low value means less confidence
and a high value indicates strong confidence.";
CM_ SG_ 1202 DET_HVC_FLAG_201 "Core2 Vehicle clutter flag";
CM_ SG_ 1202 DET_CONFD_AZIMUTH_201 "Define the Confidence of Azimuth for Detection ";
CM_ SG_ 1202 DET_CONFD_ELEVATION_201 "Define the Confidence of Elevation for the Detection ";
CM_ SG_ 1202 DET_BI_STATIC_FLAG_202 "1 if detection is bi-static 0 otherwise";
CM_ SG_ 1202 DET_BI_STATIC_FLAG_203 "1 if detection is bi-static 0 otherwise";
CM_ SG_ 1202 DET_BI_STATIC_FLAG_204 "1 if detection is bi-static 0 otherwise";
CM_ SG_ 1202 DET_MH_SCAN_INDEX_4LSB_201_204 "Scan index of the measured detection";
CM_ SG_ 1202 DET_MH_CYCLE_COUNTER_201_204 "Detection Alive Counter";
CM_ SG_ 1203 DET_RANGE_205 " measured position  of the detection";
CM_ SG_ 1203 DET_RANGE_ERR_205 "RMSE or standard deviation of the measured angle  of the detection";
CM_ SG_ 1203 DET_RANGE_VELOCITY_205 "Radial velocity of the detection positive in direction to the sensor";
CM_ SG_ 1203 DET_RANGE_VELOCITY_ERR_205 "RMSE or standard deviation of the measure radial velocity of the detection";
CM_ SG_ 1203 DET_AZIMUTH_205 "Measured angle  of the detection";
CM_ SG_ 1203 DET_AZIMUTH_ERR_205 "RMSE or standard deviation of the measured angle  of the detection";
CM_ SG_ 1203 DET_ELEVATION_205 "measured elevation of the detection";
CM_ SG_ 1203 DET_ELEVATION_ERR_205 "RMSE or standard deviation of the measured elevation  of the detection";
CM_ SG_ 1203 DET_RCS_205 "Radar Cross Section or Amplitude, is a measure of how detectable an object is by radar. A larger RCS indicates that an object is more easily detected.";
CM_ SG_ 1203 DET_BI_STATIC_FLAG_205 "1 if detection is bi-static 0 otherwise";
CM_ SG_ 1203 DET_SUPER_RES_TARGET_205 "flasg is set if the detection is super resolution target";
CM_ SG_ 1203 DET_SNR_205 "The signal to noise ratio (SNR) of the radar detection";
CM_ SG_ 1203 DET_EXISTENCE_PROB_205 "Existence probability of the detection not based on history. Value does  not depend on any past experience with similar detections.
\note Use as confidence measure where a low value means less confidence
and a high value indicates strong confidence.";
CM_ SG_ 1203 DET_HVC_FLAG_205 "Core2 Vehicle clutter flag";
CM_ SG_ 1203 DET_CONFD_AZIMUTH_205 "Define the Confidence of Azimuth for Detection ";
CM_ SG_ 1203 DET_CONFD_ELEVATION_205 "Define the Confidence of Elevation for the Detection ";
CM_ SG_ 1203 DET_BI_STATIC_FLAG_206 "1 if detection is bi-static 0 otherwise";
CM_ SG_ 1203 DET_BI_STATIC_FLAG_207 "1 if detection is bi-static 0 otherwise";
CM_ SG_ 1203 DET_BI_STATIC_FLAG_208 "1 if detection is bi-static 0 otherwise";
CM_ SG_ 1203 DET_MH_SCAN_INDEX_4LSB_205_208 "Scan index of the measured detection";
CM_ SG_ 1203 DET_MH_CYCLE_COUNTER_205_208 "Detection Alive Counter";
CM_ SG_ 1204 DET_RANGE_209 " measured position  of the detection";
CM_ SG_ 1204 DET_RANGE_ERR_209 "RMSE or standard deviation of the measured angle  of the detection";
CM_ SG_ 1204 DET_RANGE_VELOCITY_209 "Radial velocity of the detection positive in direction to the sensor";
CM_ SG_ 1204 DET_RANGE_VELOCITY_ERR_209 "RMSE or standard deviation of the measure radial velocity of the detection";
CM_ SG_ 1204 DET_AZIMUTH_209 "Measured angle  of the detection";
CM_ SG_ 1204 DET_AZIMUTH_ERR_209 "RMSE or standard deviation of the measured angle  of the detection";
CM_ SG_ 1204 DET_ELEVATION_209 "measured elevation of the detection";
CM_ SG_ 1204 DET_ELEVATION_ERR_209 "RMSE or standard deviation of the measured elevation  of the detection";
CM_ SG_ 1204 DET_RCS_209 "Radar Cross Section or Amplitude, is a measure of how detectable an object is by radar. A larger RCS indicates that an object is more easily detected.";
CM_ SG_ 1204 DET_BI_STATIC_FLAG_209 "1 if detection is bi-static 0 otherwise";
CM_ SG_ 1204 DET_SUPER_RES_TARGET_209 "flasg is set if the detection is super resolution target";
CM_ SG_ 1204 DET_SNR_209 "The signal to noise ratio (SNR) of the radar detection";
CM_ SG_ 1204 DET_EXISTENCE_PROB_209 "Existence probability of the detection not based on history. Value does  not depend on any past experience with similar detections.
\note Use as confidence measure where a low value means less confidence
and a high value indicates strong confidence.";
CM_ SG_ 1204 DET_HVC_FLAG_209 "Core2 Vehicle clutter flag";
CM_ SG_ 1204 DET_CONFD_AZIMUTH_209 "Define the Confidence of Azimuth for Detection ";
CM_ SG_ 1204 DET_CONFD_ELEVATION_209 "Define the Confidence of Elevation for the Detection ";
CM_ SG_ 1204 DET_BI_STATIC_FLAG_210 "1 if detection is bi-static 0 otherwise";
CM_ SG_ 1204 DET_BI_STATIC_FLAG_211 "1 if detection is bi-static 0 otherwise";
CM_ SG_ 1204 DET_BI_STATIC_FLAG_212 "1 if detection is bi-static 0 otherwise";
CM_ SG_ 1204 DET_MH_SCAN_INDEX_4LSB_209_212 "Scan index of the measured detection";
CM_ SG_ 1204 DET_MH_CYCLE_COUNTER_209_212 "Detection Alive Counter";
CM_ SG_ 1205 DET_RANGE_213 " measured position  of the detection";
CM_ SG_ 1205 DET_RANGE_ERR_213 "RMSE or standard deviation of the measured angle  of the detection";
CM_ SG_ 1205 DET_RANGE_VELOCITY_213 "Radial velocity of the detection positive in direction to the sensor";
CM_ SG_ 1205 DET_RANGE_VELOCITY_ERR_213 "RMSE or standard deviation of the measure radial velocity of the detection";
CM_ SG_ 1205 DET_AZIMUTH_213 "Measured angle  of the detection";
CM_ SG_ 1205 DET_AZIMUTH_ERR_213 "RMSE or standard deviation of the measured angle  of the detection";
CM_ SG_ 1205 DET_ELEVATION_213 "measured elevation of the detection";
CM_ SG_ 1205 DET_ELEVATION_ERR_213 "RMSE or standard deviation of the measured elevation  of the detection";
CM_ SG_ 1205 DET_RCS_213 "Radar Cross Section or Amplitude, is a measure of how detectable an object is by radar. A larger RCS indicates that an object is more easily detected.";
CM_ SG_ 1205 DET_BI_STATIC_FLAG_213 "1 if detection is bi-static 0 otherwise";
CM_ SG_ 1205 DET_SUPER_RES_TARGET_213 "flasg is set if the detection is super resolution target";
CM_ SG_ 1205 DET_SNR_213 "The signal to noise ratio (SNR) of the radar detection";
CM_ SG_ 1205 DET_EXISTENCE_PROB_213 "Existence probability of the detection not based on history. Value does  not depend on any past experience with similar detections.
\note Use as confidence measure where a low value means less confidence
and a high value indicates strong confidence.";
CM_ SG_ 1205 DET_HVC_FLAG_213 "Core2 Vehicle clutter flag";
CM_ SG_ 1205 DET_CONFD_AZIMUTH_213 "Define the Confidence of Azimuth for Detection ";
CM_ SG_ 1205 DET_CONFD_ELEVATION_213 "Define the Confidence of Elevation for the Detection ";
CM_ SG_ 1205 DET_BI_STATIC_FLAG_214 "1 if detection is bi-static 0 otherwise";
CM_ SG_ 1205 DET_BI_STATIC_FLAG_215 "1 if detection is bi-static 0 otherwise";
CM_ SG_ 1205 DET_BI_STATIC_FLAG_216 "1 if detection is bi-static 0 otherwise";
CM_ SG_ 1205 DET_MH_SCAN_INDEX_4LSB_213_216 "Scan index of the measured detection";
CM_ SG_ 1205 DET_MH_CYCLE_COUNTER_213_216 "Detection Alive Counter";
CM_ SG_ 1206 DET_RANGE_217 " measured position  of the detection";
CM_ SG_ 1206 DET_RANGE_ERR_217 "RMSE or standard deviation of the measured angle  of the detection";
CM_ SG_ 1206 DET_RANGE_VELOCITY_217 "Radial velocity of the detection positive in direction to the sensor";
CM_ SG_ 1206 DET_RANGE_VELOCITY_ERR_217 "RMSE or standard deviation of the measure radial velocity of the detection";
CM_ SG_ 1206 DET_AZIMUTH_217 "Measured angle  of the detection";
CM_ SG_ 1206 DET_AZIMUTH_ERR_217 "RMSE or standard deviation of the measured angle  of the detection";
CM_ SG_ 1206 DET_ELEVATION_217 "measured elevation of the detection";
CM_ SG_ 1206 DET_ELEVATION_ERR_217 "RMSE or standard deviation of the measured elevation  of the detection";
CM_ SG_ 1206 DET_RCS_217 "Radar Cross Section or Amplitude, is a measure of how detectable an object is by radar. A larger RCS indicates that an object is more easily detected.";
CM_ SG_ 1206 DET_BI_STATIC_FLAG_217 "1 if detection is bi-static 0 otherwise";
CM_ SG_ 1206 DET_SUPER_RES_TARGET_217 "flasg is set if the detection is super resolution target";
CM_ SG_ 1206 DET_SNR_217 "The signal to noise ratio (SNR) of the radar detection";
CM_ SG_ 1206 DET_EXISTENCE_PROB_217 "Existence probability of the detection not based on history. Value does  not depend on any past experience with similar detections.
\note Use as confidence measure where a low value means less confidence
and a high value indicates strong confidence.";
CM_ SG_ 1206 DET_HVC_FLAG_217 "Core2 Vehicle clutter flag";
CM_ SG_ 1206 DET_CONFD_AZIMUTH_217 "Define the Confidence of Azimuth for Detection ";
CM_ SG_ 1206 DET_CONFD_ELEVATION_217 "Define the Confidence of Elevation for the Detection ";
CM_ SG_ 1206 DET_BI_STATIC_FLAG_218 "1 if detection is bi-static 0 otherwise";
CM_ SG_ 1206 DET_BI_STATIC_FLAG_219 "1 if detection is bi-static 0 otherwise";
CM_ SG_ 1206 DET_BI_STATIC_FLAG_220 "1 if detection is bi-static 0 otherwise";
CM_ SG_ 1206 DET_MH_SCAN_INDEX_4LSB_217_220 "Scan index of the measured detection";
CM_ SG_ 1206 DET_MH_CYCLE_COUNTER_217_220 "Detection Alive Counter";
CM_ SG_ 1207 DET_RANGE_221 " measured position  of the detection";
CM_ SG_ 1207 DET_RANGE_ERR_221 "RMSE or standard deviation of the measured angle  of the detection";
CM_ SG_ 1207 DET_RANGE_VELOCITY_221 "Radial velocity of the detection positive in direction to the sensor";
CM_ SG_ 1207 DET_RANGE_VELOCITY_ERR_221 "RMSE or standard deviation of the measure radial velocity of the detection";
CM_ SG_ 1207 DET_AZIMUTH_221 "Measured angle  of the detection";
CM_ SG_ 1207 DET_AZIMUTH_ERR_221 "RMSE or standard deviation of the measured angle  of the detection";
CM_ SG_ 1207 DET_ELEVATION_221 "measured elevation of the detection";
CM_ SG_ 1207 DET_ELEVATION_ERR_221 "RMSE or standard deviation of the measured elevation  of the detection";
CM_ SG_ 1207 DET_RCS_221 "Radar Cross Section or Amplitude, is a measure of how detectable an object is by radar. A larger RCS indicates that an object is more easily detected.";
CM_ SG_ 1207 DET_BI_STATIC_FLAG_221 "1 if detection is bi-static 0 otherwise";
CM_ SG_ 1207 DET_SUPER_RES_TARGET_221 "flasg is set if the detection is super resolution target";
CM_ SG_ 1207 DET_SNR_221 "The signal to noise ratio (SNR) of the radar detection";
CM_ SG_ 1207 DET_EXISTENCE_PROB_221 "Existence probability of the detection not based on history. Value does  not depend on any past experience with similar detections.
\note Use as confidence measure where a low value means less confidence
and a high value indicates strong confidence.";
CM_ SG_ 1207 DET_HVC_FLAG_221 "Core2 Vehicle clutter flag";
CM_ SG_ 1207 DET_CONFD_AZIMUTH_221 "Define the Confidence of Azimuth for Detection ";
CM_ SG_ 1207 DET_CONFD_ELEVATION_221 "Define the Confidence of Elevation for the Detection ";
CM_ SG_ 1207 DET_BI_STATIC_FLAG_222 "1 if detection is bi-static 0 otherwise";
CM_ SG_ 1207 DET_BI_STATIC_FLAG_223 "1 if detection is bi-static 0 otherwise";
CM_ SG_ 1207 DET_BI_STATIC_FLAG_224 "1 if detection is bi-static 0 otherwise";
CM_ SG_ 1207 DET_MH_SCAN_INDEX_4LSB_221_224 "Scan index of the measured detection";
CM_ SG_ 1207 DET_MH_CYCLE_COUNTER_221_224 "Detection Alive Counter";
BA_DEF_ BO_  "VFrameFormat" ENUM  "StandardCAN","ExtendedCAN","reserved","reserved","reserved","reserved","reserved","reserved","reserved","reserved","reserved","reserved","reserved","reserved","StandardCAN_FD","ExtendedCAN_FD";
BA_DEF_ BO_  "CanTpBs" INT 0 255;
BA_DEF_ BO_  "DiagConnection" INT 0 65535;
BA_DEF_ BO_  "DiagRequest" ENUM  "No","Yes";
BA_DEF_ BO_  "DiagResponse" ENUM  "No","Yes";
BA_DEF_ BO_  "DiagState" ENUM  "No","Yes";
BA_DEF_ BO_  "E2EDataId" INT 0 65535;
BA_DEF_ BO_  "E2EDataLength" INT 0 65535;
BA_DEF_ BO_  "E2EProfile" STRING ;
BA_DEF_ BO_  "EventRateOfChange" INT 10 10000;
BA_DEF_ BO_  "GenMsgCycleTime" INT 0 100000;
BA_DEF_ BO_  "GenMsgILSupport" ENUM  "No","Yes";
BA_DEF_ BO_  "GenMsgNrOfRepetition" INT 0 100;
BA_DEF_ BO_  "GenMsgSendType" ENUM  "FixedPeriodic","Event","EnabledPeriodic","NotUsed","NotUsed","EventPeriodic","NotUsed","NotUsed","NoMsgSendType";
BA_DEF_ BO_  "NetworkInitialization" ENUM  "No","Yes";
BA_DEF_ BO_  "NmAsrMessage" ENUM  "No","Yes";
BA_DEF_ BO_  "NmMessage" ENUM  "No","Yes";
BA_DEF_ BO_  "SCP_AuthInfoTxLength" INT 0 512;
BA_DEF_ BO_  "SCP_FreshnessValueLength" INT 0 512;
BA_DEF_ BO_  "SCP_FreshnessValueTxLength" INT 0 512;
BA_DEF_ BO_  "TpTxIndex" INT 0 255;
BA_DEF_ SG_  "GenSigCmt" STRING ;
BA_DEF_ SG_  "GenSigCycleTime" INT 0 0;
BA_DEF_ SG_  "GenSigSendType" ENUM  "Cyclic","OnWrite","vector_leerstring","OnChange","vector_leerstring","IfActive","vector_leerstring","NoSigSendType";
BA_DEF_ SG_  "GenSigStartValue" INT 0 1000000000;
BA_DEF_ SG_  "GenSigTimeoutTime" INT 0 0;
BA_DEF_ SG_  "GenSigVtEn" STRING ;
BA_DEF_ SG_  "GenSigVtName" STRING ;
BA_DEF_ SG_  "InvalidValue" STRING ;
BA_DEF_ SG_  "SystemSignalLongSymbol" STRING ;
BA_DEF_REL_ BU_SG_REL_  "SC_Verification" ENUM  "No","Yes";
BA_DEF_DEF_  "VFrameFormat" "StandardCAN_FD";
BA_DEF_DEF_  "CanTpBs" 255;
BA_DEF_DEF_  "DiagConnection" 0;
BA_DEF_DEF_  "DiagRequest" "No";
BA_DEF_DEF_  "DiagResponse" "No";
BA_DEF_DEF_  "DiagState" "No";
BA_DEF_DEF_  "E2EDataId" 0;
BA_DEF_DEF_  "E2EDataLength" 0;
BA_DEF_DEF_  "E2EProfile" "";
BA_DEF_DEF_  "EventRateOfChange" 10000;
BA_DEF_DEF_  "GenMsgCycleTime" 0;
BA_DEF_DEF_  "GenMsgILSupport" "Yes";
BA_DEF_DEF_  "GenMsgNrOfRepetition" 0;
BA_DEF_DEF_  "GenMsgSendType" "NoMsgSendType";
BA_DEF_DEF_  "NetworkInitialization" "Yes";
BA_DEF_DEF_  "NmAsrMessage" "No";
BA_DEF_DEF_  "NmMessage" "No";
BA_DEF_DEF_  "SCP_AuthInfoTxLength" 28;
BA_DEF_DEF_  "SCP_FreshnessValueLength" 48;
BA_DEF_DEF_  "SCP_FreshnessValueTxLength" 4;
BA_DEF_DEF_  "TpTxIndex" 0;
BA_DEF_DEF_  "GenSigCmt" "";
BA_DEF_DEF_  "GenSigCycleTime" 0;
BA_DEF_DEF_  "GenSigSendType" "NoSigSendType";
BA_DEF_DEF_  "GenSigStartValue" 0;
BA_DEF_DEF_  "GenSigTimeoutTime" 0;
BA_DEF_DEF_  "GenSigVtEn" "";
BA_DEF_DEF_  "GenSigVtName" "";
BA_DEF_DEF_  "InvalidValue" "";
BA_DEF_DEF_REL_ "SC_Verification" "No";
BA_DEF_DEF_  "SystemSignalLongSymbol" "";
BA_ "GenMsgSendType" BO_ 1192 1;
BA_ "GenMsgSendType" BO_ 1193 1;
BA_ "GenMsgSendType" BO_ 1194 1;
BA_ "GenMsgSendType" BO_ 1195 1;
BA_ "GenMsgSendType" BO_ 1196 1;
BA_ "GenMsgSendType" BO_ 1197 1;
BA_ "GenMsgSendType" BO_ 1198 1;
BA_ "GenMsgSendType" BO_ 1199 1;
BA_ "GenMsgSendType" BO_ 1200 1;
BA_ "GenMsgSendType" BO_ 1201 1;
BA_ "GenMsgSendType" BO_ 1202 1;
BA_ "GenMsgSendType" BO_ 1203 1;
BA_ "GenMsgSendType" BO_ 1204 1;
BA_ "GenMsgSendType" BO_ 1205 1;
BA_ "GenMsgSendType" BO_ 1206 1;
BA_ "GenMsgSendType" BO_ 1207 1;
BA_ "GenSigStartValue" SG_ 1192 DET_RANGE_VELOCITY_161 16384;
BA_ "GenSigStartValue" SG_ 1192 DET_RCS_161 128;
BA_ "GenSigStartValue" SG_ 1192 DET_RANGE_VELOCITY_162 16384;
BA_ "GenSigStartValue" SG_ 1192 DET_RCS_162 128;
BA_ "GenSigStartValue" SG_ 1192 DET_RANGE_VELOCITY_163 16384;
BA_ "GenSigStartValue" SG_ 1192 DET_RCS_163 128;
BA_ "GenSigStartValue" SG_ 1192 DET_RANGE_VELOCITY_164 16384;
BA_ "GenSigStartValue" SG_ 1192 DET_RCS_164 128;
BA_ "GenSigStartValue" SG_ 1193 DET_RANGE_VELOCITY_165 16384;
BA_ "GenSigStartValue" SG_ 1193 DET_RCS_165 128;
BA_ "GenSigStartValue" SG_ 1193 DET_RANGE_VELOCITY_166 16384;
BA_ "GenSigStartValue" SG_ 1193 DET_RCS_166 128;
BA_ "GenSigStartValue" SG_ 1193 DET_RANGE_VELOCITY_167 16384;
BA_ "GenSigStartValue" SG_ 1193 DET_RCS_167 128;
BA_ "GenSigStartValue" SG_ 1193 DET_RANGE_VELOCITY_168 16384;
BA_ "GenSigStartValue" SG_ 1193 DET_RCS_168 128;
BA_ "GenSigStartValue" SG_ 1194 DET_RANGE_VELOCITY_169 16384;
BA_ "GenSigStartValue" SG_ 1194 DET_RCS_169 128;
BA_ "GenSigStartValue" SG_ 1194 DET_RANGE_VELOCITY_170 16384;
BA_ "GenSigStartValue" SG_ 1194 DET_RCS_170 128;
BA_ "GenSigStartValue" SG_ 1194 DET_RANGE_VELOCITY_171 16384;
BA_ "GenSigStartValue" SG_ 1194 DET_RCS_171 128;
BA_ "GenSigStartValue" SG_ 1194 DET_RANGE_VELOCITY_172 16384;
BA_ "GenSigStartValue" SG_ 1194 DET_RCS_172 128;
BA_ "GenSigStartValue" SG_ 1195 DET_RANGE_VELOCITY_173 16384;
BA_ "GenSigStartValue" SG_ 1195 DET_RCS_173 128;
BA_ "GenSigStartValue" SG_ 1195 DET_RANGE_VELOCITY_174 16384;
BA_ "GenSigStartValue" SG_ 1195 DET_RCS_174 128;
BA_ "GenSigStartValue" SG_ 1195 DET_RANGE_VELOCITY_175 16384;
BA_ "GenSigStartValue" SG_ 1195 DET_RCS_175 128;
BA_ "GenSigStartValue" SG_ 1195 DET_RANGE_VELOCITY_176 16384;
BA_ "GenSigStartValue" SG_ 1195 DET_RCS_176 128;
BA_ "GenSigStartValue" SG_ 1196 DET_RANGE_VELOCITY_177 16384;
BA_ "GenSigStartValue" SG_ 1196 DET_RCS_177 128;
BA_ "GenSigStartValue" SG_ 1196 DET_RANGE_VELOCITY_178 16384;
BA_ "GenSigStartValue" SG_ 1196 DET_RCS_178 128;
BA_ "GenSigStartValue" SG_ 1196 DET_RANGE_VELOCITY_179 16384;
BA_ "GenSigStartValue" SG_ 1196 DET_RCS_179 128;
BA_ "GenSigStartValue" SG_ 1196 DET_RANGE_VELOCITY_180 16384;
BA_ "GenSigStartValue" SG_ 1196 DET_RCS_180 128;
BA_ "GenSigStartValue" SG_ 1197 DET_RANGE_VELOCITY_181 16384;
BA_ "GenSigStartValue" SG_ 1197 DET_RCS_181 128;
BA_ "GenSigStartValue" SG_ 1197 DET_RANGE_VELOCITY_182 16384;
BA_ "GenSigStartValue" SG_ 1197 DET_RCS_182 128;
BA_ "GenSigStartValue" SG_ 1197 DET_RANGE_VELOCITY_183 16384;
BA_ "GenSigStartValue" SG_ 1197 DET_RCS_183 128;
BA_ "GenSigStartValue" SG_ 1197 DET_RANGE_VELOCITY_184 16384;
BA_ "GenSigStartValue" SG_ 1197 DET_RCS_184 128;
BA_ "GenSigStartValue" SG_ 1198 DET_RANGE_VELOCITY_185 16384;
BA_ "GenSigStartValue" SG_ 1198 DET_RCS_185 128;
BA_ "GenSigStartValue" SG_ 1198 DET_RANGE_VELOCITY_186 16384;
BA_ "GenSigStartValue" SG_ 1198 DET_RCS_186 128;
BA_ "GenSigStartValue" SG_ 1198 DET_RANGE_VELOCITY_187 16384;
BA_ "GenSigStartValue" SG_ 1198 DET_RCS_187 128;
BA_ "GenSigStartValue" SG_ 1198 DET_RANGE_VELOCITY_188 16384;
BA_ "GenSigStartValue" SG_ 1198 DET_RCS_188 128;
BA_ "GenSigStartValue" SG_ 1199 DET_RANGE_VELOCITY_189 16384;
BA_ "GenSigStartValue" SG_ 1199 DET_RCS_189 128;
BA_ "GenSigStartValue" SG_ 1199 DET_RANGE_VELOCITY_190 16384;
BA_ "GenSigStartValue" SG_ 1199 DET_RCS_190 128;
BA_ "GenSigStartValue" SG_ 1199 DET_RANGE_VELOCITY_191 16384;
BA_ "GenSigStartValue" SG_ 1199 DET_RCS_191 128;
BA_ "GenSigStartValue" SG_ 1199 DET_RANGE_VELOCITY_192 16384;
BA_ "GenSigStartValue" SG_ 1199 DET_RCS_192 128;
BA_ "GenSigStartValue" SG_ 1200 DET_RANGE_VELOCITY_193 16384;
BA_ "GenSigStartValue" SG_ 1200 DET_RCS_193 128;
BA_ "GenSigStartValue" SG_ 1200 DET_RANGE_VELOCITY_194 16384;
BA_ "GenSigStartValue" SG_ 1200 DET_RCS_194 128;
BA_ "GenSigStartValue" SG_ 1200 DET_RANGE_VELOCITY_195 16384;
BA_ "GenSigStartValue" SG_ 1200 DET_RCS_195 128;
BA_ "GenSigStartValue" SG_ 1200 DET_RANGE_VELOCITY_196 16384;
BA_ "GenSigStartValue" SG_ 1200 DET_RCS_196 128;
BA_ "GenSigStartValue" SG_ 1201 DET_RANGE_VELOCITY_197 16384;
BA_ "GenSigStartValue" SG_ 1201 DET_RCS_197 128;
BA_ "GenSigStartValue" SG_ 1201 DET_RANGE_VELOCITY_198 16384;
BA_ "GenSigStartValue" SG_ 1201 DET_RCS_198 128;
BA_ "GenSigStartValue" SG_ 1201 DET_RANGE_VELOCITY_199 16384;
BA_ "GenSigStartValue" SG_ 1201 DET_RCS_199 128;
BA_ "GenSigStartValue" SG_ 1201 DET_RANGE_VELOCITY_200 16384;
BA_ "GenSigStartValue" SG_ 1201 DET_RCS_200 128;
BA_ "GenSigStartValue" SG_ 1202 DET_RANGE_VELOCITY_201 16384;
BA_ "GenSigStartValue" SG_ 1202 DET_RCS_201 128;
BA_ "GenSigStartValue" SG_ 1202 DET_RANGE_VELOCITY_202 16384;
BA_ "GenSigStartValue" SG_ 1202 DET_RCS_202 128;
BA_ "GenSigStartValue" SG_ 1202 DET_RANGE_VELOCITY_203 16384;
BA_ "GenSigStartValue" SG_ 1202 DET_RCS_203 128;
BA_ "GenSigStartValue" SG_ 1202 DET_RANGE_VELOCITY_204 16384;
BA_ "GenSigStartValue" SG_ 1202 DET_RCS_204 128;
BA_ "GenSigStartValue" SG_ 1203 DET_RANGE_VELOCITY_205 16384;
BA_ "GenSigStartValue" SG_ 1203 DET_RCS_205 128;
BA_ "GenSigStartValue" SG_ 1203 DET_RANGE_VELOCITY_206 16384;
BA_ "GenSigStartValue" SG_ 1203 DET_RCS_206 128;
BA_ "GenSigStartValue" SG_ 1203 DET_RANGE_VELOCITY_207 16384;
BA_ "GenSigStartValue" SG_ 1203 DET_RCS_207 128;
BA_ "GenSigStartValue" SG_ 1203 DET_RANGE_VELOCITY_208 16384;
BA_ "GenSigStartValue" SG_ 1203 DET_RCS_208 128;
BA_ "GenSigStartValue" SG_ 1204 DET_RANGE_VELOCITY_209 16384;
BA_ "GenSigStartValue" SG_ 1204 DET_RCS_209 128;
BA_ "GenSigStartValue" SG_ 1204 DET_RANGE_VELOCITY_210 16384;
BA_ "GenSigStartValue" SG_ 1204 DET_RCS_210 128;
BA_ "GenSigStartValue" SG_ 1204 DET_RANGE_VELOCITY_211 16384;
BA_ "GenSigStartValue" SG_ 1204 DET_RCS_211 128;
BA_ "GenSigStartValue" SG_ 1204 DET_RANGE_VELOCITY_212 16384;
BA_ "GenSigStartValue" SG_ 1204 DET_RCS_212 128;
BA_ "GenSigStartValue" SG_ 1205 DET_RANGE_VELOCITY_213 16384;
BA_ "GenSigStartValue" SG_ 1205 DET_RCS_213 128;
BA_ "GenSigStartValue" SG_ 1205 DET_RANGE_VELOCITY_214 16384;
BA_ "GenSigStartValue" SG_ 1205 DET_RCS_214 128;
BA_ "GenSigStartValue" SG_ 1205 DET_RANGE_VELOCITY_215 16384;
BA_ "GenSigStartValue" SG_ 1205 DET_RCS_215 128;
BA_ "GenSigStartValue" SG_ 1205 DET_RANGE_VELOCITY_216 16384;
BA_ "GenSigStartValue" SG_ 1205 DET_RCS_216 128;
BA_ "GenSigStartValue" SG_ 1206 DET_RANGE_VELOCITY_217 16384;
BA_ "GenSigStartValue" SG_ 1206 DET_RCS_217 128;
BA_ "GenSigStartValue" SG_ 1206 DET_RANGE_VELOCITY_218 16384;
BA_ "GenSigStartValue" SG_ 1206 DET_RCS_218 128;
BA_ "GenSigStartValue" SG_ 1206 DET_RANGE_VELOCITY_219 16384;
BA_ "GenSigStartValue" SG_ 1206 DET_RCS_219 128;
BA_ "GenSigStartValue" SG_ 1206 DET_RANGE_VELOCITY_220 16384;
BA_ "GenSigStartValue" SG_ 1206 DET_RCS_220 128;
BA_ "GenSigStartValue" SG_ 1207 DET_RANGE_VELOCITY_221 16384;
BA_ "GenSigStartValue" SG_ 1207 DET_RCS_221 128;
BA_ "GenSigStartValue" SG_ 1207 DET_RANGE_VELOCITY_222 16384;
BA_ "GenSigStartValue" SG_ 1207 DET_RCS_222 128;
BA_ "GenSigStartValue" SG_ 1207 DET_RANGE_VELOCITY_223 16384;
BA_ "GenSigStartValue" SG_ 1207 DET_RCS_223 128;
BA_ "GenSigStartValue" SG_ 1207 DET_RANGE_VELOCITY_224 16384;
BA_ "GenSigStartValue" SG_ 1207 DET_RCS_224 128;
VAL_ 1192 DET_CONFD_AZIMUTH_161 0 "High" 1 "MidHigh" 2 "MidLow" 3 "Low" ;
VAL_ 1192 DET_CONFD_ELEVATION_161 0 "High" 1 "MidHigh" 2 "MidLow" 3 "Low" ;
VAL_ 1192 DET_IDM_161 0 "Not_IDM_Output" 1 "IDM_Output" ;
VAL_ 1192 DET_MTD_161 0 "Not_MTD_Output" 1 "MTD_Output" ;
VAL_ 1192 DET_BELOW_RAIN_THOLD_161 0 "DetBelowRainThold" 1 "DetAboveRainThold" ;
VAL_ 1192 DET_CONFD_AZIMUTH_162 0 "High" 1 "MidHigh" 2 "MidLow" 3 "Low" ;
VAL_ 1192 DET_CONFD_ELEVATION_162 0 "High" 1 "MidHigh" 2 "MidLow" 3 "Low" ;
VAL_ 1192 DET_IDM_162 0 "Not_IDM_Output" 1 "IDM_Output" ;
VAL_ 1192 DET_MTD_162 0 "Not_MTD_Output" 1 "MTD_Output" ;
VAL_ 1192 DET_BELOW_RAIN_THOLD_162 0 "DetBelowRainThold" 1 "DetAboveRainThold" ;
VAL_ 1192 DET_CONFD_AZIMUTH_163 0 "High" 1 "MidHigh" 2 "MidLow" 3 "Low" ;
VAL_ 1192 DET_CONFD_ELEVATION_163 0 "High" 1 "MidHigh" 2 "MidLow" 3 "Low" ;
VAL_ 1192 DET_IDM_163 0 "Not_IDM_Output" 1 "IDM_Output" ;
VAL_ 1192 DET_MTD_163 0 "Not_MTD_Output" 1 "MTD_Output" ;
VAL_ 1192 DET_BELOW_RAIN_THOLD_163 0 "DetBelowRainThold" 1 "DetAboveRainThold" ;
VAL_ 1192 DET_IDM_164 0 "Not_IDM_Output" 1 "IDM_Output" ;
VAL_ 1192 DET_MTD_164 0 "Not_MTD_Output" 1 "MTD_Output" ;
VAL_ 1192 DET_BELOW_RAIN_THOLD_164 0 "DetBelowRainThold" 1 "DetAboveRainThold" ;
VAL_ 1193 DET_CONFD_AZIMUTH_165 0 "High" 1 "MidHigh" 2 "MidLow" 3 "Low" ;
VAL_ 1193 DET_CONFD_ELEVATION_165 0 "High" 1 "MidHigh" 2 "MidLow" 3 "Low" ;
VAL_ 1193 DET_IDM_165 0 "Not_IDM_Output" 1 "IDM_Output" ;
VAL_ 1193 DET_MTD_165 0 "Not_MTD_Output" 1 "MTD_Output" ;
VAL_ 1193 DET_BELOW_RAIN_THOLD_165 0 "DetBelowRainThold" 1 "DetAboveRainThold" ;
VAL_ 1193 DET_CONFD_AZIMUTH_166 0 "High" 1 "MidHigh" 2 "MidLow" 3 "Low" ;
VAL_ 1193 DET_CONFD_ELEVATION_166 0 "High" 1 "MidHigh" 2 "MidLow" 3 "Low" ;
VAL_ 1193 DET_IDM_166 0 "Not_IDM_Output" 1 "IDM_Output" ;
VAL_ 1193 DET_MTD_166 0 "Not_MTD_Output" 1 "MTD_Output" ;
VAL_ 1193 DET_BELOW_RAIN_THOLD_166 0 "DetBelowRainThold" 1 "DetAboveRainThold" ;
VAL_ 1193 DET_CONFD_AZIMUTH_167 0 "High" 1 "MidHigh" 2 "MidLow" 3 "Low" ;
VAL_ 1193 DET_CONFD_ELEVATION_167 0 "High" 1 "MidHigh" 2 "MidLow" 3 "Low" ;
VAL_ 1193 DET_IDM_167 0 "Not_IDM_Output" 1 "IDM_Output" ;
VAL_ 1193 DET_MTD_167 0 "Not_MTD_Output" 1 "MTD_Output" ;
VAL_ 1193 DET_BELOW_RAIN_THOLD_167 0 "DetBelowRainThold" 1 "DetAboveRainThold" ;
VAL_ 1193 DET_IDM_168 0 "Not_IDM_Output" 1 "IDM_Output" ;
VAL_ 1193 DET_MTD_168 0 "Not_MTD_Output" 1 "MTD_Output" ;
VAL_ 1193 DET_BELOW_RAIN_THOLD_168 0 "DetBelowRainThold" 1 "DetAboveRainThold" ;
VAL_ 1194 DET_CONFD_AZIMUTH_169 0 "High" 1 "MidHigh" 2 "MidLow" 3 "Low" ;
VAL_ 1194 DET_CONFD_ELEVATION_169 0 "High" 1 "MidHigh" 2 "MidLow" 3 "Low" ;
VAL_ 1194 DET_IDM_169 0 "Not_IDM_Output" 1 "IDM_Output" ;
VAL_ 1194 DET_MTD_169 0 "Not_MTD_Output" 1 "MTD_Output" ;
VAL_ 1194 DET_BELOW_RAIN_THOLD_169 0 "DetBelowRainThold" 1 "DetAboveRainThold" ;
VAL_ 1194 DET_CONFD_AZIMUTH_170 0 "High" 1 "MidHigh" 2 "MidLow" 3 "Low" ;
VAL_ 1194 DET_CONFD_ELEVATION_170 0 "High" 1 "MidHigh" 2 "MidLow" 3 "Low" ;
VAL_ 1194 DET_IDM_170 0 "Not_IDM_Output" 1 "IDM_Output" ;
VAL_ 1194 DET_MTD_170 0 "Not_MTD_Output" 1 "MTD_Output" ;
VAL_ 1194 DET_BELOW_RAIN_THOLD_170 0 "DetBelowRainThold" 1 "DetAboveRainThold" ;
VAL_ 1194 DET_CONFD_AZIMUTH_171 0 "High" 1 "MidHigh" 2 "MidLow" 3 "Low" ;
VAL_ 1194 DET_CONFD_ELEVATION_171 0 "High" 1 "MidHigh" 2 "MidLow" 3 "Low" ;
VAL_ 1194 DET_IDM_171 0 "Not_IDM_Output" 1 "IDM_Output" ;
VAL_ 1194 DET_MTD_171 0 "Not_MTD_Output" 1 "MTD_Output" ;
VAL_ 1194 DET_BELOW_RAIN_THOLD_171 0 "DetBelowRainThold" 1 "DetAboveRainThold" ;
VAL_ 1194 DET_IDM_172 0 "Not_IDM_Output" 1 "IDM_Output" ;
VAL_ 1194 DET_MTD_172 0 "Not_MTD_Output" 1 "MTD_Output" ;
VAL_ 1194 DET_BELOW_RAIN_THOLD_172 0 "DetBelowRainThold" 1 "DetAboveRainThold" ;
VAL_ 1195 DET_CONFD_AZIMUTH_173 0 "High" 1 "MidHigh" 2 "MidLow" 3 "Low" ;
VAL_ 1195 DET_CONFD_ELEVATION_173 0 "High" 1 "MidHigh" 2 "MidLow" 3 "Low" ;
VAL_ 1195 DET_IDM_173 0 "Not_IDM_Output" 1 "IDM_Output" ;
VAL_ 1195 DET_MTD_173 0 "Not_MTD_Output" 1 "MTD_Output" ;
VAL_ 1195 DET_BELOW_RAIN_THOLD_173 0 "DetBelowRainThold" 1 "DetAboveRainThold" ;
VAL_ 1195 DET_CONFD_AZIMUTH_174 0 "High" 1 "MidHigh" 2 "MidLow" 3 "Low" ;
VAL_ 1195 DET_CONFD_ELEVATION_174 0 "High" 1 "MidHigh" 2 "MidLow" 3 "Low" ;
VAL_ 1195 DET_IDM_174 0 "Not_IDM_Output" 1 "IDM_Output" ;
VAL_ 1195 DET_MTD_174 0 "Not_MTD_Output" 1 "MTD_Output" ;
VAL_ 1195 DET_BELOW_RAIN_THOLD_174 0 "DetBelowRainThold" 1 "DetAboveRainThold" ;
VAL_ 1195 DET_CONFD_AZIMUTH_175 0 "High" 1 "MidHigh" 2 "MidLow" 3 "Low" ;
VAL_ 1195 DET_CONFD_ELEVATION_175 0 "High" 1 "MidHigh" 2 "MidLow" 3 "Low" ;
VAL_ 1195 DET_IDM_175 0 "Not_IDM_Output" 1 "IDM_Output" ;
VAL_ 1195 DET_MTD_175 0 "Not_MTD_Output" 1 "MTD_Output" ;
VAL_ 1195 DET_BELOW_RAIN_THOLD_175 0 "DetBelowRainThold" 1 "DetAboveRainThold" ;
VAL_ 1195 DET_IDM_176 0 "Not_IDM_Output" 1 "IDM_Output" ;
VAL_ 1195 DET_MTD_176 0 "Not_MTD_Output" 1 "MTD_Output" ;
VAL_ 1195 DET_BELOW_RAIN_THOLD_176 0 "DetBelowRainThold" 1 "DetAboveRainThold" ;
VAL_ 1196 DET_CONFD_AZIMUTH_177 0 "High" 1 "MidHigh" 2 "MidLow" 3 "Low" ;
VAL_ 1196 DET_CONFD_ELEVATION_177 0 "High" 1 "MidHigh" 2 "MidLow" 3 "Low" ;
VAL_ 1196 DET_IDM_177 0 "Not_IDM_Output" 1 "IDM_Output" ;
VAL_ 1196 DET_MTD_177 0 "Not_MTD_Output" 1 "MTD_Output" ;
VAL_ 1196 DET_BELOW_RAIN_THOLD_177 0 "DetBelowRainThold" 1 "DetAboveRainThold" ;
VAL_ 1196 DET_CONFD_AZIMUTH_178 0 "High" 1 "MidHigh" 2 "MidLow" 3 "Low" ;
VAL_ 1196 DET_CONFD_ELEVATION_178 0 "High" 1 "MidHigh" 2 "MidLow" 3 "Low" ;
VAL_ 1196 DET_IDM_178 0 "Not_IDM_Output" 1 "IDM_Output" ;
VAL_ 1196 DET_MTD_178 0 "Not_MTD_Output" 1 "MTD_Output" ;
VAL_ 1196 DET_BELOW_RAIN_THOLD_178 0 "DetBelowRainThold" 1 "DetAboveRainThold" ;
VAL_ 1196 DET_CONFD_AZIMUTH_179 0 "High" 1 "MidHigh" 2 "MidLow" 3 "Low" ;
VAL_ 1196 DET_CONFD_ELEVATION_179 0 "High" 1 "MidHigh" 2 "MidLow" 3 "Low" ;
VAL_ 1196 DET_IDM_179 0 "Not_IDM_Output" 1 "IDM_Output" ;
VAL_ 1196 DET_MTD_179 0 "Not_MTD_Output" 1 "MTD_Output" ;
VAL_ 1196 DET_BELOW_RAIN_THOLD_179 0 "DetBelowRainThold" 1 "DetAboveRainThold" ;
VAL_ 1196 DET_IDM_180 0 "Not_IDM_Output" 1 "IDM_Output" ;
VAL_ 1196 DET_MTD_180 0 "Not_MTD_Output" 1 "MTD_Output" ;
VAL_ 1196 DET_BELOW_RAIN_THOLD_180 0 "DetBelowRainThold" 1 "DetAboveRainThold" ;
VAL_ 1197 DET_CONFD_AZIMUTH_181 0 "High" 1 "MidHigh" 2 "MidLow" 3 "Low" ;
VAL_ 1197 DET_CONFD_ELEVATION_181 0 "High" 1 "MidHigh" 2 "MidLow" 3 "Low" ;
VAL_ 1197 DET_IDM_181 0 "Not_IDM_Output" 1 "IDM_Output" ;
VAL_ 1197 DET_MTD_181 0 "Not_MTD_Output" 1 "MTD_Output" ;
VAL_ 1197 DET_BELOW_RAIN_THOLD_181 0 "DetBelowRainThold" 1 "DetAboveRainThold" ;
VAL_ 1197 DET_CONFD_AZIMUTH_182 0 "High" 1 "MidHigh" 2 "MidLow" 3 "Low" ;
VAL_ 1197 DET_CONFD_ELEVATION_182 0 "High" 1 "MidHigh" 2 "MidLow" 3 "Low" ;
VAL_ 1197 DET_IDM_182 0 "Not_IDM_Output" 1 "IDM_Output" ;
VAL_ 1197 DET_MTD_182 0 "Not_MTD_Output" 1 "MTD_Output" ;
VAL_ 1197 DET_BELOW_RAIN_THOLD_182 0 "DetBelowRainThold" 1 "DetAboveRainThold" ;
VAL_ 1197 DET_CONFD_AZIMUTH_183 0 "High" 1 "MidHigh" 2 "MidLow" 3 "Low" ;
VAL_ 1197 DET_CONFD_ELEVATION_183 0 "High" 1 "MidHigh" 2 "MidLow" 3 "Low" ;
VAL_ 1197 DET_IDM_183 0 "Not_IDM_Output" 1 "IDM_Output" ;
VAL_ 1197 DET_MTD_183 0 "Not_MTD_Output" 1 "MTD_Output" ;
VAL_ 1197 DET_BELOW_RAIN_THOLD_183 0 "DetBelowRainThold" 1 "DetAboveRainThold" ;
VAL_ 1197 DET_IDM_184 0 "Not_IDM_Output" 1 "IDM_Output" ;
VAL_ 1197 DET_MTD_184 0 "Not_MTD_Output" 1 "MTD_Output" ;
VAL_ 1197 DET_BELOW_RAIN_THOLD_184 0 "DetBelowRainThold" 1 "DetAboveRainThold" ;
VAL_ 1198 DET_CONFD_AZIMUTH_185 0 "High" 1 "MidHigh" 2 "MidLow" 3 "Low" ;
VAL_ 1198 DET_CONFD_ELEVATION_185 0 "High" 1 "MidHigh" 2 "MidLow" 3 "Low" ;
VAL_ 1198 DET_IDM_185 0 "Not_IDM_Output" 1 "IDM_Output" ;
VAL_ 1198 DET_MTD_185 0 "Not_MTD_Output" 1 "MTD_Output" ;
VAL_ 1198 DET_BELOW_RAIN_THOLD_185 0 "DetBelowRainThold" 1 "DetAboveRainThold" ;
VAL_ 1198 DET_CONFD_AZIMUTH_186 0 "High" 1 "MidHigh" 2 "MidLow" 3 "Low" ;
VAL_ 1198 DET_CONFD_ELEVATION_186 0 "High" 1 "MidHigh" 2 "MidLow" 3 "Low" ;
VAL_ 1198 DET_IDM_186 0 "Not_IDM_Output" 1 "IDM_Output" ;
VAL_ 1198 DET_MTD_186 0 "Not_MTD_Output" 1 "MTD_Output" ;
VAL_ 1198 DET_BELOW_RAIN_THOLD_186 0 "DetBelowRainThold" 1 "DetAboveRainThold" ;
VAL_ 1198 DET_CONFD_AZIMUTH_187 0 "High" 1 "MidHigh" 2 "MidLow" 3 "Low" ;
VAL_ 1198 DET_CONFD_ELEVATION_187 0 "High" 1 "MidHigh" 2 "MidLow" 3 "Low" ;
VAL_ 1198 DET_IDM_187 0 "Not_IDM_Output" 1 "IDM_Output" ;
VAL_ 1198 DET_MTD_187 0 "Not_MTD_Output" 1 "MTD_Output" ;
VAL_ 1198 DET_BELOW_RAIN_THOLD_187 0 "DetBelowRainThold" 1 "DetAboveRainThold" ;
VAL_ 1198 DET_IDM_188 0 "Not_IDM_Output" 1 "IDM_Output" ;
VAL_ 1198 DET_MTD_188 0 "Not_MTD_Output" 1 "MTD_Output" ;
VAL_ 1198 DET_BELOW_RAIN_THOLD_188 0 "DetBelowRainThold" 1 "DetAboveRainThold" ;
VAL_ 1199 DET_CONFD_AZIMUTH_189 0 "High" 1 "MidHigh" 2 "MidLow" 3 "Low" ;
VAL_ 1199 DET_CONFD_ELEVATION_189 0 "High" 1 "MidHigh" 2 "MidLow" 3 "Low" ;
VAL_ 1199 DET_IDM_189 0 "Not_IDM_Output" 1 "IDM_Output" ;
VAL_ 1199 DET_MTD_189 0 "Not_MTD_Output" 1 "MTD_Output" ;
VAL_ 1199 DET_BELOW_RAIN_THOLD_189 0 "DetBelowRainThold" 1 "DetAboveRainThold" ;
VAL_ 1199 DET_CONFD_AZIMUTH_190 0 "High" 1 "MidHigh" 2 "MidLow" 3 "Low" ;
VAL_ 1199 DET_CONFD_ELEVATION_190 0 "High" 1 "MidHigh" 2 "MidLow" 3 "Low" ;
VAL_ 1199 DET_IDM_190 0 "Not_IDM_Output" 1 "IDM_Output" ;
VAL_ 1199 DET_MTD_190 0 "Not_MTD_Output" 1 "MTD_Output" ;
VAL_ 1199 DET_BELOW_RAIN_THOLD_190 0 "DetBelowRainThold" 1 "DetAboveRainThold" ;
VAL_ 1199 DET_CONFD_AZIMUTH_191 0 "High" 1 "MidHigh" 2 "MidLow" 3 "Low" ;
VAL_ 1199 DET_CONFD_ELEVATION_191 0 "High" 1 "MidHigh" 2 "MidLow" 3 "Low" ;
VAL_ 1199 DET_IDM_191 0 "Not_IDM_Output" 1 "IDM_Output" ;
VAL_ 1199 DET_MTD_191 0 "Not_MTD_Output" 1 "MTD_Output" ;
VAL_ 1199 DET_BELOW_RAIN_THOLD_191 0 "DetBelowRainThold" 1 "DetAboveRainThold" ;
VAL_ 1199 DET_IDM_192 0 "Not_IDM_Output" 1 "IDM_Output" ;
VAL_ 1199 DET_MTD_192 0 "Not_MTD_Output" 1 "MTD_Output" ;
VAL_ 1199 DET_BELOW_RAIN_THOLD_192 0 "DetBelowRainThold" 1 "DetAboveRainThold" ;
VAL_ 1200 DET_CONFD_AZIMUTH_193 0 "High" 1 "MidHigh" 2 "MidLow" 3 "Low" ;
VAL_ 1200 DET_CONFD_ELEVATION_193 0 "High" 1 "MidHigh" 2 "MidLow" 3 "Low" ;
VAL_ 1200 DET_IDM_193 0 "Not_IDM_Output" 1 "IDM_Output" ;
VAL_ 1200 DET_MTD_193 0 "Not_MTD_Output" 1 "MTD_Output" ;
VAL_ 1200 DET_BELOW_RAIN_THOLD_193 0 "DetBelowRainThold" 1 "DetAboveRainThold" ;
VAL_ 1200 DET_CONFD_AZIMUTH_194 0 "High" 1 "MidHigh" 2 "MidLow" 3 "Low" ;
VAL_ 1200 DET_CONFD_ELEVATION_194 0 "High" 1 "MidHigh" 2 "MidLow" 3 "Low" ;
VAL_ 1200 DET_IDM_194 0 "Not_IDM_Output" 1 "IDM_Output" ;
VAL_ 1200 DET_MTD_194 0 "Not_MTD_Output" 1 "MTD_Output" ;
VAL_ 1200 DET_BELOW_RAIN_THOLD_194 0 "DetBelowRainThold" 1 "DetAboveRainThold" ;
VAL_ 1200 DET_CONFD_AZIMUTH_195 0 "High" 1 "MidHigh" 2 "MidLow" 3 "Low" ;
VAL_ 1200 DET_CONFD_ELEVATION_195 0 "High" 1 "MidHigh" 2 "MidLow" 3 "Low" ;
VAL_ 1200 DET_IDM_195 0 "Not_IDM_Output" 1 "IDM_Output" ;
VAL_ 1200 DET_MTD_195 0 "Not_MTD_Output" 1 "MTD_Output" ;
VAL_ 1200 DET_BELOW_RAIN_THOLD_195 0 "DetBelowRainThold" 1 "DetAboveRainThold" ;
VAL_ 1200 DET_IDM_196 0 "Not_IDM_Output" 1 "IDM_Output" ;
VAL_ 1200 DET_MTD_196 0 "Not_MTD_Output" 1 "MTD_Output" ;
VAL_ 1200 DET_BELOW_RAIN_THOLD_196 0 "DetBelowRainThold" 1 "DetAboveRainThold" ;
VAL_ 1201 DET_CONFD_AZIMUTH_197 0 "High" 1 "MidHigh" 2 "MidLow" 3 "Low" ;
VAL_ 1201 DET_CONFD_ELEVATION_197 0 "High" 1 "MidHigh" 2 "MidLow" 3 "Low" ;
VAL_ 1201 DET_IDM_197 0 "Not_IDM_Output" 1 "IDM_Output" ;
VAL_ 1201 DET_MTD_197 0 "Not_MTD_Output" 1 "MTD_Output" ;
VAL_ 1201 DET_BELOW_RAIN_THOLD_197 0 "DetBelowRainThold" 1 "DetAboveRainThold" ;
VAL_ 1201 DET_CONFD_AZIMUTH_198 0 "High" 1 "MidHigh" 2 "MidLow" 3 "Low" ;
VAL_ 1201 DET_CONFD_ELEVATION_198 0 "High" 1 "MidHigh" 2 "MidLow" 3 "Low" ;
VAL_ 1201 DET_IDM_198 0 "Not_IDM_Output" 1 "IDM_Output" ;
VAL_ 1201 DET_MTD_198 0 "Not_MTD_Output" 1 "MTD_Output" ;
VAL_ 1201 DET_BELOW_RAIN_THOLD_198 0 "DetBelowRainThold" 1 "DetAboveRainThold" ;
VAL_ 1201 DET_CONFD_AZIMUTH_199 0 "High" 1 "MidHigh" 2 "MidLow" 3 "Low" ;
VAL_ 1201 DET_CONFD_ELEVATION_199 0 "High" 1 "MidHigh" 2 "MidLow" 3 "Low" ;
VAL_ 1201 DET_IDM_199 0 "Not_IDM_Output" 1 "IDM_Output" ;
VAL_ 1201 DET_MTD_199 0 "Not_MTD_Output" 1 "MTD_Output" ;
VAL_ 1201 DET_BELOW_RAIN_THOLD_199 0 "DetBelowRainThold" 1 "DetAboveRainThold" ;
VAL_ 1201 DET_IDM_200 0 "Not_IDM_Output" 1 "IDM_Output" ;
VAL_ 1201 DET_MTD_200 0 "Not_MTD_Output" 1 "MTD_Output" ;
VAL_ 1201 DET_BELOW_RAIN_THOLD_200 0 "DetBelowRainThold" 1 "DetAboveRainThold" ;
VAL_ 1202 DET_CONFD_AZIMUTH_201 0 "High" 1 "MidHigh" 2 "MidLow" 3 "Low" ;
VAL_ 1202 DET_CONFD_ELEVATION_201 0 "High" 1 "MidHigh" 2 "MidLow" 3 "Low" ;
VAL_ 1202 DET_IDM_201 0 "Not_IDM_Output" 1 "IDM_Output" ;
VAL_ 1202 DET_MTD_201 0 "Not_MTD_Output" 1 "MTD_Output" ;
VAL_ 1202 DET_BELOW_RAIN_THOLD_201 0 "DetBelowRainThold" 1 "DetAboveRainThold" ;
VAL_ 1202 DET_CONFD_AZIMUTH_202 0 "High" 1 "MidHigh" 2 "MidLow" 3 "Low" ;
VAL_ 1202 DET_CONFD_ELEVATION_202 0 "High" 1 "MidHigh" 2 "MidLow" 3 "Low" ;
VAL_ 1202 DET_IDM_202 0 "Not_IDM_Output" 1 "IDM_Output" ;
VAL_ 1202 DET_MTD_202 0 "Not_MTD_Output" 1 "MTD_Output" ;
VAL_ 1202 DET_BELOW_RAIN_THOLD_202 0 "DetBelowRainThold" 1 "DetAboveRainThold" ;
VAL_ 1202 DET_CONFD_AZIMUTH_203 0 "High" 1 "MidHigh" 2 "MidLow" 3 "Low" ;
VAL_ 1202 DET_CONFD_ELEVATION_203 0 "High" 1 "MidHigh" 2 "MidLow" 3 "Low" ;
VAL_ 1202 DET_IDM_203 0 "Not_IDM_Output" 1 "IDM_Output" ;
VAL_ 1202 DET_MTD_203 0 "Not_MTD_Output" 1 "MTD_Output" ;
VAL_ 1202 DET_BELOW_RAIN_THOLD_203 0 "DetBelowRainThold" 1 "DetAboveRainThold" ;
VAL_ 1202 DET_IDM_204 0 "Not_IDM_Output" 1 "IDM_Output" ;
VAL_ 1202 DET_MTD_204 0 "Not_MTD_Output" 1 "MTD_Output" ;
VAL_ 1202 DET_BELOW_RAIN_THOLD_204 0 "DetBelowRainThold" 1 "DetAboveRainThold" ;
VAL_ 1203 DET_CONFD_AZIMUTH_205 0 "High" 1 "MidHigh" 2 "MidLow" 3 "Low" ;
VAL_ 1203 DET_CONFD_ELEVATION_205 0 "High" 1 "MidHigh" 2 "MidLow" 3 "Low" ;
VAL_ 1203 DET_IDM_205 0 "Not_IDM_Output" 1 "IDM_Output" ;
VAL_ 1203 DET_MTD_205 0 "Not_MTD_Output" 1 "MTD_Output" ;
VAL_ 1203 DET_BELOW_RAIN_THOLD_205 0 "DetBelowRainThold" 1 "DetAboveRainThold" ;
VAL_ 1203 DET_CONFD_AZIMUTH_206 0 "High" 1 "MidHigh" 2 "MidLow" 3 "Low" ;
VAL_ 1203 DET_CONFD_ELEVATION_206 0 "High" 1 "MidHigh" 2 "MidLow" 3 "Low" ;
VAL_ 1203 DET_IDM_206 0 "Not_IDM_Output" 1 "IDM_Output" ;
VAL_ 1203 DET_MTD_206 0 "Not_MTD_Output" 1 "MTD_Output" ;
VAL_ 1203 DET_BELOW_RAIN_THOLD_206 0 "DetBelowRainThold" 1 "DetAboveRainThold" ;
VAL_ 1203 DET_CONFD_AZIMUTH_207 0 "High" 1 "MidHigh" 2 "MidLow" 3 "Low" ;
VAL_ 1203 DET_CONFD_ELEVATION_207 0 "High" 1 "MidHigh" 2 "MidLow" 3 "Low" ;
VAL_ 1203 DET_IDM_207 0 "Not_IDM_Output" 1 "IDM_Output" ;
VAL_ 1203 DET_MTD_207 0 "Not_MTD_Output" 1 "MTD_Output" ;
VAL_ 1203 DET_BELOW_RAIN_THOLD_207 0 "DetBelowRainThold" 1 "DetAboveRainThold" ;
VAL_ 1203 DET_IDM_208 0 "Not_IDM_Output" 1 "IDM_Output" ;
VAL_ 1203 DET_MTD_208 0 "Not_MTD_Output" 1 "MTD_Output" ;
VAL_ 1203 DET_BELOW_RAIN_THOLD_208 0 "DetBelowRainThold" 1 "DetAboveRainThold" ;
VAL_ 1204 DET_CONFD_AZIMUTH_209 0 "High" 1 "MidHigh" 2 "MidLow" 3 "Low" ;
VAL_ 1204 DET_CONFD_ELEVATION_209 0 "High" 1 "MidHigh" 2 "MidLow" 3 "Low" ;
VAL_ 1204 DET_IDM_209 0 "Not_IDM_Output" 1 "IDM_Output" ;
VAL_ 1204 DET_MTD_209 0 "Not_MTD_Output" 1 "MTD_Output" ;
VAL_ 1204 DET_BELOW_RAIN_THOLD_209 0 "DetBelowRainThold" 1 "DetAboveRainThold" ;
VAL_ 1204 DET_CONFD_AZIMUTH_210 0 "High" 1 "MidHigh" 2 "MidLow" 3 "Low" ;
VAL_ 1204 DET_CONFD_ELEVATION_210 0 "High" 1 "MidHigh" 2 "MidLow" 3 "Low" ;
VAL_ 1204 DET_IDM_210 0 "Not_IDM_Output" 1 "IDM_Output" ;
VAL_ 1204 DET_MTD_210 0 "Not_MTD_Output" 1 "MTD_Output" ;
VAL_ 1204 DET_BELOW_RAIN_THOLD_210 0 "DetBelowRainThold" 1 "DetAboveRainThold" ;
VAL_ 1204 DET_CONFD_AZIMUTH_211 0 "High" 1 "MidHigh" 2 "MidLow" 3 "Low" ;
VAL_ 1204 DET_CONFD_ELEVATION_211 0 "High" 1 "MidHigh" 2 "MidLow" 3 "Low" ;
VAL_ 1204 DET_IDM_211 0 "Not_IDM_Output" 1 "IDM_Output" ;
VAL_ 1204 DET_MTD_211 0 "Not_MTD_Output" 1 "MTD_Output" ;
VAL_ 1204 DET_BELOW_RAIN_THOLD_211 0 "DetBelowRainThold" 1 "DetAboveRainThold" ;
VAL_ 1204 DET_IDM_212 0 "Not_IDM_Output" 1 "IDM_Output" ;
VAL_ 1204 DET_MTD_212 0 "Not_MTD_Output" 1 "MTD_Output" ;
VAL_ 1204 DET_BELOW_RAIN_THOLD_212 0 "DetBelowRainThold" 1 "DetAboveRainThold" ;
VAL_ 1205 DET_CONFD_AZIMUTH_213 0 "High" 1 "MidHigh" 2 "MidLow" 3 "Low" ;
VAL_ 1205 DET_CONFD_ELEVATION_213 0 "High" 1 "MidHigh" 2 "MidLow" 3 "Low" ;
VAL_ 1205 DET_IDM_213 0 "Not_IDM_Output" 1 "IDM_Output" ;
VAL_ 1205 DET_MTD_213 0 "Not_MTD_Output" 1 "MTD_Output" ;
VAL_ 1205 DET_BELOW_RAIN_THOLD_213 0 "DetBelowRainThold" 1 "DetAboveRainThold" ;
VAL_ 1205 DET_CONFD_AZIMUTH_214 0 "High" 1 "MidHigh" 2 "MidLow" 3 "Low" ;
VAL_ 1205 DET_CONFD_ELEVATION_214 0 "High" 1 "MidHigh" 2 "MidLow" 3 "Low" ;
VAL_ 1205 DET_IDM_214 0 "Not_IDM_Output" 1 "IDM_Output" ;
VAL_ 1205 DET_MTD_214 0 "Not_MTD_Output" 1 "MTD_Output" ;
VAL_ 1205 DET_BELOW_RAIN_THOLD_214 0 "DetBelowRainThold" 1 "DetAboveRainThold" ;
VAL_ 1205 DET_CONFD_AZIMUTH_215 0 "High" 1 "MidHigh" 2 "MidLow" 3 "Low" ;
VAL_ 1205 DET_CONFD_ELEVATION_215 0 "High" 1 "MidHigh" 2 "MidLow" 3 "Low" ;
VAL_ 1205 DET_IDM_215 0 "Not_IDM_Output" 1 "IDM_Output" ;
VAL_ 1205 DET_MTD_215 0 "Not_MTD_Output" 1 "MTD_Output" ;
VAL_ 1205 DET_BELOW_RAIN_THOLD_215 0 "DetBelowRainThold" 1 "DetAboveRainThold" ;
VAL_ 1205 DET_IDM_216 0 "Not_IDM_Output" 1 "IDM_Output" ;
VAL_ 1205 DET_MTD_216 0 "Not_MTD_Output" 1 "MTD_Output" ;
VAL_ 1205 DET_BELOW_RAIN_THOLD_216 0 "DetBelowRainThold" 1 "DetAboveRainThold" ;
VAL_ 1206 DET_CONFD_AZIMUTH_217 0 "High" 1 "MidHigh" 2 "MidLow" 3 "Low" ;
VAL_ 1206 DET_CONFD_ELEVATION_217 0 "High" 1 "MidHigh" 2 "MidLow" 3 "Low" ;
VAL_ 1206 DET_IDM_217 0 "Not_IDM_Output" 1 "IDM_Output" ;
VAL_ 1206 DET_MTD_217 0 "Not_MTD_Output" 1 "MTD_Output" ;
VAL_ 1206 DET_BELOW_RAIN_THOLD_217 0 "DetBelowRainThold" 1 "DetAboveRainThold" ;
VAL_ 1206 DET_CONFD_AZIMUTH_218 0 "High" 1 "MidHigh" 2 "MidLow" 3 "Low" ;
VAL_ 1206 DET_CONFD_ELEVATION_218 0 "High" 1 "MidHigh" 2 "MidLow" 3 "Low" ;
VAL_ 1206 DET_IDM_218 0 "Not_IDM_Output" 1 "IDM_Output" ;
VAL_ 1206 DET_MTD_218 0 "Not_MTD_Output" 1 "MTD_Output" ;
VAL_ 1206 DET_BELOW_RAIN_THOLD_218 0 "DetBelowRainThold" 1 "DetAboveRainThold" ;
VAL_ 1206 DET_CONFD_AZIMUTH_219 0 "High" 1 "MidHigh" 2 "MidLow" 3 "Low" ;
VAL_ 1206 DET_CONFD_ELEVATION_219 0 "High" 1 "MidHigh" 2 "MidLow" 3 "Low" ;
VAL_ 1206 DET_IDM_219 0 "Not_IDM_Output" 1 "IDM_Output" ;
VAL_ 1206 DET_MTD_219 0 "Not_MTD_Output" 1 "MTD_Output" ;
VAL_ 1206 DET_BELOW_RAIN_THOLD_219 0 "DetBelowRainThold" 1 "DetAboveRainThold" ;
VAL_ 1206 DET_IDM_220 0 "Not_IDM_Output" 1 "IDM_Output" ;
VAL_ 1206 DET_MTD_220 0 "Not_MTD_Output" 1 "MTD_Output" ;
VAL_ 1206 DET_BELOW_RAIN_THOLD_220 0 "DetBelowRainThold" 1 "DetAboveRainThold" ;
VAL_ 1207 DET_CONFD_AZIMUTH_221 0 "High" 1 "MidHigh" 2 "MidLow" 3 "Low" ;
VAL_ 1207 DET_CONFD_ELEVATION_221 0 "High" 1 "MidHigh" 2 "MidLow" 3 "Low" ;
VAL_ 1207 DET_IDM_221 0 "Not_IDM_Output" 1 "IDM_Output" ;
VAL_ 1207 DET_MTD_221 0 "Not_MTD_Output" 1 "MTD_Output" ;
VAL_ 1207 DET_BELOW_RAIN_THOLD_221 0 "DetBelowRainThold" 1 "DetAboveRainThold" ;
VAL_ 1207 DET_CONFD_AZIMUTH_222 0 "High" 1 "MidHigh" 2 "MidLow" 3 "Low" ;
VAL_ 1207 DET_CONFD_ELEVATION_222 0 "High" 1 "MidHigh" 2 "MidLow" 3 "Low" ;
VAL_ 1207 DET_IDM_222 0 "Not_IDM_Output" 1 "IDM_Output" ;
VAL_ 1207 DET_MTD_222 0 "Not_MTD_Output" 1 "MTD_Output" ;
VAL_ 1207 DET_BELOW_RAIN_THOLD_222 0 "DetBelowRainThold" 1 "DetAboveRainThold" ;
VAL_ 1207 DET_CONFD_AZIMUTH_223 0 "High" 1 "MidHigh" 2 "MidLow" 3 "Low" ;
VAL_ 1207 DET_CONFD_ELEVATION_223 0 "High" 1 "MidHigh" 2 "MidLow" 3 "Low" ;
VAL_ 1207 DET_IDM_223 0 "Not_IDM_Output" 1 "IDM_Output" ;
VAL_ 1207 DET_MTD_223 0 "Not_MTD_Output" 1 "MTD_Output" ;
VAL_ 1207 DET_BELOW_RAIN_THOLD_223 0 "DetBelowRainThold" 1 "DetAboveRainThold" ;
VAL_ 1207 DET_IDM_224 0 "Not_IDM_Output" 1 "IDM_Output" ;
VAL_ 1207 DET_MTD_224 0 "Not_MTD_Output" 1 "MTD_Output" ;
VAL_ 1207 DET_BELOW_RAIN_THOLD_224 0 "DetBelowRainThold" 1 "DetAboveRainThold" ;
SIG_GROUP_ 1192 Detections_161_164 1 : DET_PROB_1STAZHYPO_161 DET_PROB_1STAZHYPO_162 DET_PROB_1STAZHYPO_163 DET_PROB_1STAZHYPO_164 DET_IDM_161 DET_IDM_162 DET_IDM_163 DET_IDM_164 DET_MTD_164 DET_MTD_163 DET_MTD_162 DET_MTD_161 DET_BELOW_RAIN_THOLD_164 DET_BELOW_RAIN_THOLD_163 DET_BELOW_RAIN_THOLD_162 DET_BELOW_RAIN_THOLD_161 DET_MH_CRC16_161_164 DET_MH_CYCLE_COUNTER_161_164 DET_MH_SCAN_INDEX_4LSB_161_164 DET_CONFD_ELEVATION_161 DET_CONFD_AZIMUTH_161 DET_HVC_FLAG_161 DET_EXISTENCE_PROB_161 DET_SNR_161 DET_SUPER_RES_TARGET_161 DET_BI_STATIC_FLAG_161 DET_RCS_161 DET_ELEVATION_ERR_161 DET_ELEVATION_161 DET_AZIMUTH_ERR_161 DET_AZIMUTH_161 DET_RANGE_VELOCITY_ERR_161 DET_RANGE_VELOCITY_161 DET_RANGE_ERR_161 DET_RANGE_161 DET_CONFD_ELEVATION_162 DET_CONFD_AZIMUTH_162 DET_HVC_FLAG_162 DET_EXISTENCE_PROB_162 DET_SNR_162 DET_SUPER_RES_TARGET_162 DET_BI_STATIC_FLAG_162 DET_RCS_162 DET_ELEVATION_ERR_162 DET_ELEVATION_162 DET_AZIMUTH_ERR_162 DET_AZIMUTH_162 DET_RANGE_VELOCITY_ERR_162 DET_RANGE_VELOCITY_162 DET_RANGE_ERR_162 DET_RANGE_162 DET_CONFD_ELEVATION_163 DET_CONFD_AZIMUTH_163 DET_HVC_FLAG_163 DET_EXISTENCE_PROB_163 DET_SNR_163 DET_SUPER_RES_TARGET_163 DET_BI_STATIC_FLAG_163 DET_RCS_163 DET_ELEVATION_ERR_163 DET_ELEVATION_163 DET_AZIMUTH_ERR_163 DET_AZIMUTH_163 DET_RANGE_VELOCITY_ERR_163 DET_RANGE_VELOCITY_163 DET_RANGE_ERR_163 DET_RANGE_163 DET_CONFD_ELEVATION_164 DET_CONFD_AZIMUTH_164 DET_HVC_FLAG_164 DET_EXISTENCE_PROB_164 DET_SNR_164 DET_SUPER_RES_TARGET_164 DET_BI_STATIC_FLAG_164 DET_RCS_164 DET_ELEVATION_ERR_164 DET_ELEVATION_164 DET_AZIMUTH_ERR_164 DET_AZIMUTH_164 DET_RANGE_VELOCITY_ERR_164 DET_RANGE_VELOCITY_164 DET_RANGE_ERR_164 DET_RANGE_164;
SIG_GROUP_ 1193 Detections_165_168 1 : DET_PROB_1STAZHYPO_165 DET_PROB_1STAZHYPO_166 DET_PROB_1STAZHYPO_167 DET_PROB_1STAZHYPO_168 DET_IDM_165 DET_IDM_166 DET_IDM_167 DET_IDM_168 DET_MTD_168 DET_MTD_167 DET_MTD_166 DET_MTD_165 DET_BELOW_RAIN_THOLD_168 DET_BELOW_RAIN_THOLD_167 DET_BELOW_RAIN_THOLD_166 DET_BELOW_RAIN_THOLD_165 DET_MH_CRC16_165_168 DET_MH_CYCLE_COUNTER_165_168 DET_MH_SCAN_INDEX_4LSB_165_168 DET_CONFD_ELEVATION_165 DET_CONFD_AZIMUTH_165 DET_HVC_FLAG_165 DET_EXISTENCE_PROB_165 DET_SNR_165 DET_SUPER_RES_TARGET_165 DET_BI_STATIC_FLAG_165 DET_RCS_165 DET_ELEVATION_ERR_165 DET_ELEVATION_165 DET_AZIMUTH_ERR_165 DET_AZIMUTH_165 DET_RANGE_VELOCITY_ERR_165 DET_RANGE_VELOCITY_165 DET_RANGE_ERR_165 DET_RANGE_165 DET_CONFD_ELEVATION_166 DET_CONFD_AZIMUTH_166 DET_HVC_FLAG_166 DET_EXISTENCE_PROB_166 DET_SNR_166 DET_SUPER_RES_TARGET_166 DET_BI_STATIC_FLAG_166 DET_RCS_166 DET_ELEVATION_ERR_166 DET_ELEVATION_166 DET_AZIMUTH_ERR_166 DET_AZIMUTH_166 DET_RANGE_VELOCITY_ERR_166 DET_RANGE_VELOCITY_166 DET_RANGE_ERR_166 DET_RANGE_166 DET_CONFD_ELEVATION_167 DET_CONFD_AZIMUTH_167 DET_HVC_FLAG_167 DET_EXISTENCE_PROB_167 DET_SNR_167 DET_SUPER_RES_TARGET_167 DET_BI_STATIC_FLAG_167 DET_RCS_167 DET_ELEVATION_ERR_167 DET_ELEVATION_167 DET_AZIMUTH_ERR_167 DET_AZIMUTH_167 DET_RANGE_VELOCITY_ERR_167 DET_RANGE_VELOCITY_167 DET_RANGE_ERR_167 DET_RANGE_167 DET_CONFD_ELEVATION_168 DET_CONFD_AZIMUTH_168 DET_HVC_FLAG_168 DET_EXISTENCE_PROB_168 DET_SNR_168 DET_SUPER_RES_TARGET_168 DET_BI_STATIC_FLAG_168 DET_RCS_168 DET_ELEVATION_ERR_168 DET_ELEVATION_168 DET_AZIMUTH_ERR_168 DET_AZIMUTH_168 DET_RANGE_VELOCITY_ERR_168 DET_RANGE_VELOCITY_168 DET_RANGE_ERR_168 DET_RANGE_168;
SIG_GROUP_ 1194 Detections_169_172 1 : DET_PROB_1STAZHYPO_169 DET_PROB_1STAZHYPO_170 DET_PROB_1STAZHYPO_171 DET_PROB_1STAZHYPO_172 DET_IDM_169 DET_IDM_170 DET_IDM_171 DET_IDM_172 DET_MTD_172 DET_MTD_171 DET_MTD_170 DET_MTD_169 DET_BELOW_RAIN_THOLD_172 DET_BELOW_RAIN_THOLD_171 DET_BELOW_RAIN_THOLD_170 DET_BELOW_RAIN_THOLD_169 DET_MH_CRC16_169_172 DET_MH_CYCLE_COUNTER_169_172 DET_MH_SCAN_INDEX_4LSB_169_172 DET_CONFD_ELEVATION_169 DET_CONFD_AZIMUTH_169 DET_HVC_FLAG_169 DET_EXISTENCE_PROB_169 DET_SNR_169 DET_SUPER_RES_TARGET_169 DET_BI_STATIC_FLAG_169 DET_RCS_169 DET_ELEVATION_ERR_169 DET_ELEVATION_169 DET_AZIMUTH_ERR_169 DET_AZIMUTH_169 DET_RANGE_VELOCITY_ERR_169 DET_RANGE_VELOCITY_169 DET_RANGE_ERR_169 DET_RANGE_169 DET_CONFD_ELEVATION_170 DET_CONFD_AZIMUTH_170 DET_HVC_FLAG_170 DET_EXISTENCE_PROB_170 DET_SNR_170 DET_SUPER_RES_TARGET_170 DET_BI_STATIC_FLAG_170 DET_RCS_170 DET_ELEVATION_ERR_170 DET_ELEVATION_170 DET_AZIMUTH_ERR_170 DET_AZIMUTH_170 DET_RANGE_VELOCITY_ERR_170 DET_RANGE_VELOCITY_170 DET_RANGE_ERR_170 DET_RANGE_170 DET_CONFD_ELEVATION_171 DET_CONFD_AZIMUTH_171 DET_HVC_FLAG_171 DET_EXISTENCE_PROB_171 DET_SNR_171 DET_SUPER_RES_TARGET_171 DET_BI_STATIC_FLAG_171 DET_RCS_171 DET_ELEVATION_ERR_171 DET_ELEVATION_171 DET_AZIMUTH_ERR_171 DET_AZIMUTH_171 DET_RANGE_VELOCITY_ERR_171 DET_RANGE_VELOCITY_171 DET_RANGE_ERR_171 DET_RANGE_171 DET_CONFD_ELEVATION_172 DET_CONFD_AZIMUTH_172 DET_HVC_FLAG_172 DET_EXISTENCE_PROB_172 DET_SNR_172 DET_SUPER_RES_TARGET_172 DET_BI_STATIC_FLAG_172 DET_RCS_172 DET_ELEVATION_ERR_172 DET_ELEVATION_172 DET_AZIMUTH_ERR_172 DET_AZIMUTH_172 DET_RANGE_VELOCITY_ERR_172 DET_RANGE_VELOCITY_172 DET_RANGE_ERR_172 DET_RANGE_172;
SIG_GROUP_ 1195 Detections_173_176 1 : DET_PROB_1STAZHYPO_173 DET_PROB_1STAZHYPO_174 DET_PROB_1STAZHYPO_175 DET_PROB_1STAZHYPO_176 DET_IDM_173 DET_IDM_174 DET_IDM_175 DET_IDM_176 DET_MTD_176 DET_MTD_175 DET_MTD_174 DET_MTD_173 DET_BELOW_RAIN_THOLD_176 DET_BELOW_RAIN_THOLD_175 DET_BELOW_RAIN_THOLD_174 DET_BELOW_RAIN_THOLD_173 DET_MH_CRC16_173_176 DET_MH_CYCLE_COUNTER_173_176 DET_MH_SCAN_INDEX_4LSB_173_176 DET_CONFD_ELEVATION_173 DET_CONFD_AZIMUTH_173 DET_HVC_FLAG_173 DET_EXISTENCE_PROB_173 DET_SNR_173 DET_SUPER_RES_TARGET_173 DET_BI_STATIC_FLAG_173 DET_RCS_173 DET_ELEVATION_ERR_173 DET_ELEVATION_173 DET_AZIMUTH_ERR_173 DET_AZIMUTH_173 DET_RANGE_VELOCITY_ERR_173 DET_RANGE_VELOCITY_173 DET_RANGE_ERR_173 DET_RANGE_173 DET_CONFD_ELEVATION_174 DET_CONFD_AZIMUTH_174 DET_HVC_FLAG_174 DET_EXISTENCE_PROB_174 DET_SNR_174 DET_SUPER_RES_TARGET_174 DET_BI_STATIC_FLAG_174 DET_RCS_174 DET_ELEVATION_ERR_174 DET_ELEVATION_174 DET_AZIMUTH_ERR_174 DET_AZIMUTH_174 DET_RANGE_VELOCITY_ERR_174 DET_RANGE_VELOCITY_174 DET_RANGE_ERR_174 DET_RANGE_174 DET_CONFD_ELEVATION_175 DET_CONFD_AZIMUTH_175 DET_HVC_FLAG_175 DET_EXISTENCE_PROB_175 DET_SNR_175 DET_SUPER_RES_TARGET_175 DET_BI_STATIC_FLAG_175 DET_RCS_175 DET_ELEVATION_ERR_175 DET_ELEVATION_175 DET_AZIMUTH_ERR_175 DET_AZIMUTH_175 DET_RANGE_VELOCITY_ERR_175 DET_RANGE_VELOCITY_175 DET_RANGE_ERR_175 DET_RANGE_175 DET_CONFD_ELEVATION_176 DET_CONFD_AZIMUTH_176 DET_HVC_FLAG_176 DET_EXISTENCE_PROB_176 DET_SNR_176 DET_SUPER_RES_TARGET_176 DET_BI_STATIC_FLAG_176 DET_RCS_176 DET_ELEVATION_ERR_176 DET_ELEVATION_176 DET_AZIMUTH_ERR_176 DET_AZIMUTH_176 DET_RANGE_VELOCITY_ERR_176 DET_RANGE_VELOCITY_176 DET_RANGE_ERR_176 DET_RANGE_176;
SIG_GROUP_ 1196 Detections_177_180 1 : DET_PROB_1STAZHYPO_177 DET_PROB_1STAZHYPO_178 DET_PROB_1STAZHYPO_179 DET_PROB_1STAZHYPO_180 DET_IDM_177 DET_IDM_178 DET_IDM_179 DET_IDM_180 DET_MTD_180 DET_MTD_179 DET_MTD_178 DET_MTD_177 DET_BELOW_RAIN_THOLD_180 DET_BELOW_RAIN_THOLD_179 DET_BELOW_RAIN_THOLD_178 DET_BELOW_RAIN_THOLD_177 DET_MH_CRC16_177_180 DET_MH_CYCLE_COUNTER_177_180 DET_MH_SCAN_INDEX_4LSB_177_180 DET_CONFD_ELEVATION_177 DET_CONFD_AZIMUTH_177 DET_HVC_FLAG_177 DET_EXISTENCE_PROB_177 DET_SNR_177 DET_SUPER_RES_TARGET_177 DET_BI_STATIC_FLAG_177 DET_RCS_177 DET_ELEVATION_ERR_177 DET_ELEVATION_177 DET_AZIMUTH_ERR_177 DET_AZIMUTH_177 DET_RANGE_VELOCITY_ERR_177 DET_RANGE_VELOCITY_177 DET_RANGE_ERR_177 DET_RANGE_177 DET_CONFD_ELEVATION_178 DET_CONFD_AZIMUTH_178 DET_HVC_FLAG_178 DET_EXISTENCE_PROB_178 DET_SNR_178 DET_SUPER_RES_TARGET_178 DET_BI_STATIC_FLAG_178 DET_RCS_178 DET_ELEVATION_ERR_178 DET_ELEVATION_178 DET_AZIMUTH_ERR_178 DET_AZIMUTH_178 DET_RANGE_VELOCITY_ERR_178 DET_RANGE_VELOCITY_178 DET_RANGE_ERR_178 DET_RANGE_178 DET_CONFD_ELEVATION_179 DET_CONFD_AZIMUTH_179 DET_HVC_FLAG_179 DET_EXISTENCE_PROB_179 DET_SNR_179 DET_SUPER_RES_TARGET_179 DET_BI_STATIC_FLAG_179 DET_RCS_179 DET_ELEVATION_ERR_179 DET_ELEVATION_179 DET_AZIMUTH_ERR_179 DET_AZIMUTH_179 DET_RANGE_VELOCITY_ERR_179 DET_RANGE_VELOCITY_179 DET_RANGE_ERR_179 DET_RANGE_179 DET_CONFD_ELEVATION_180 DET_CONFD_AZIMUTH_180 DET_HVC_FLAG_180 DET_EXISTENCE_PROB_180 DET_SNR_180 DET_SUPER_RES_TARGET_180 DET_BI_STATIC_FLAG_180 DET_RCS_180 DET_ELEVATION_ERR_180 DET_ELEVATION_180 DET_AZIMUTH_ERR_180 DET_AZIMUTH_180 DET_RANGE_VELOCITY_ERR_180 DET_RANGE_VELOCITY_180 DET_RANGE_ERR_180 DET_RANGE_180;
SIG_GROUP_ 1197 Detections_181_184 1 : DET_PROB_1STAZHYPO_181 DET_PROB_1STAZHYPO_182 DET_PROB_1STAZHYPO_183 DET_PROB_1STAZHYPO_184 DET_IDM_181 DET_IDM_182 DET_IDM_183 DET_IDM_184 DET_MTD_184 DET_MTD_183 DET_MTD_182 DET_MTD_181 DET_BELOW_RAIN_THOLD_184 DET_BELOW_RAIN_THOLD_183 DET_BELOW_RAIN_THOLD_182 DET_BELOW_RAIN_THOLD_181 DET_MH_CRC16_181_184 DET_MH_CYCLE_COUNTER_181_184 DET_MH_SCAN_INDEX_4LSB_181_184 DET_CONFD_ELEVATION_181 DET_CONFD_AZIMUTH_181 DET_HVC_FLAG_181 DET_EXISTENCE_PROB_181 DET_SNR_181 DET_SUPER_RES_TARGET_181 DET_BI_STATIC_FLAG_181 DET_RCS_181 DET_ELEVATION_ERR_181 DET_ELEVATION_181 DET_AZIMUTH_ERR_181 DET_AZIMUTH_181 DET_RANGE_VELOCITY_ERR_181 DET_RANGE_VELOCITY_181 DET_RANGE_ERR_181 DET_RANGE_181 DET_CONFD_ELEVATION_182 DET_CONFD_AZIMUTH_182 DET_HVC_FLAG_182 DET_EXISTENCE_PROB_182 DET_SNR_182 DET_SUPER_RES_TARGET_182 DET_BI_STATIC_FLAG_182 DET_RCS_182 DET_ELEVATION_ERR_182 DET_ELEVATION_182 DET_AZIMUTH_ERR_182 DET_AZIMUTH_182 DET_RANGE_VELOCITY_ERR_182 DET_RANGE_VELOCITY_182 DET_RANGE_ERR_182 DET_RANGE_182 DET_CONFD_ELEVATION_183 DET_CONFD_AZIMUTH_183 DET_HVC_FLAG_183 DET_EXISTENCE_PROB_183 DET_SNR_183 DET_SUPER_RES_TARGET_183 DET_BI_STATIC_FLAG_183 DET_RCS_183 DET_ELEVATION_ERR_183 DET_ELEVATION_183 DET_AZIMUTH_ERR_183 DET_AZIMUTH_183 DET_RANGE_VELOCITY_ERR_183 DET_RANGE_VELOCITY_183 DET_RANGE_ERR_183 DET_RANGE_183 DET_CONFD_ELEVATION_184 DET_CONFD_AZIMUTH_184 DET_HVC_FLAG_184 DET_EXISTENCE_PROB_184 DET_SNR_184 DET_SUPER_RES_TARGET_184 DET_BI_STATIC_FLAG_184 DET_RCS_184 DET_ELEVATION_ERR_184 DET_ELEVATION_184 DET_AZIMUTH_ERR_184 DET_AZIMUTH_184 DET_RANGE_VELOCITY_ERR_184 DET_RANGE_VELOCITY_184 DET_RANGE_ERR_184 DET_RANGE_184;
SIG_GROUP_ 1198 Detections_185_188 1 : DET_PROB_1STAZHYPO_185 DET_PROB_1STAZHYPO_186 DET_PROB_1STAZHYPO_187 DET_PROB_1STAZHYPO_188 DET_IDM_185 DET_IDM_186 DET_IDM_187 DET_IDM_188 DET_MTD_188 DET_MTD_187 DET_MTD_186 DET_MTD_185 DET_BELOW_RAIN_THOLD_188 DET_BELOW_RAIN_THOLD_187 DET_BELOW_RAIN_THOLD_186 DET_BELOW_RAIN_THOLD_185 DET_MH_CRC16_185_188 DET_MH_CYCLE_COUNTER_185_188 DET_MH_SCAN_INDEX_4LSB_185_188 DET_CONFD_ELEVATION_185 DET_CONFD_AZIMUTH_185 DET_HVC_FLAG_185 DET_EXISTENCE_PROB_185 DET_SNR_185 DET_SUPER_RES_TARGET_185 DET_BI_STATIC_FLAG_185 DET_RCS_185 DET_ELEVATION_ERR_185 DET_ELEVATION_185 DET_AZIMUTH_ERR_185 DET_AZIMUTH_185 DET_RANGE_VELOCITY_ERR_185 DET_RANGE_VELOCITY_185 DET_RANGE_ERR_185 DET_RANGE_185 DET_CONFD_ELEVATION_186 DET_CONFD_AZIMUTH_186 DET_HVC_FLAG_186 DET_EXISTENCE_PROB_186 DET_SNR_186 DET_SUPER_RES_TARGET_186 DET_BI_STATIC_FLAG_186 DET_RCS_186 DET_ELEVATION_ERR_186 DET_ELEVATION_186 DET_AZIMUTH_ERR_186 DET_AZIMUTH_186 DET_RANGE_VELOCITY_ERR_186 DET_RANGE_VELOCITY_186 DET_RANGE_ERR_186 DET_RANGE_186 DET_CONFD_ELEVATION_187 DET_CONFD_AZIMUTH_187 DET_HVC_FLAG_187 DET_EXISTENCE_PROB_187 DET_SNR_187 DET_SUPER_RES_TARGET_187 DET_BI_STATIC_FLAG_187 DET_RCS_187 DET_ELEVATION_ERR_187 DET_ELEVATION_187 DET_AZIMUTH_ERR_187 DET_AZIMUTH_187 DET_RANGE_VELOCITY_ERR_187 DET_RANGE_VELOCITY_187 DET_RANGE_ERR_187 DET_RANGE_187 DET_CONFD_ELEVATION_188 DET_CONFD_AZIMUTH_188 DET_HVC_FLAG_188 DET_EXISTENCE_PROB_188 DET_SNR_188 DET_SUPER_RES_TARGET_188 DET_BI_STATIC_FLAG_188 DET_RCS_188 DET_ELEVATION_ERR_188 DET_ELEVATION_188 DET_AZIMUTH_ERR_188 DET_AZIMUTH_188 DET_RANGE_VELOCITY_ERR_188 DET_RANGE_VELOCITY_188 DET_RANGE_ERR_188 DET_RANGE_188;
SIG_GROUP_ 1199 Detections_189_192 1 : DET_PROB_1STAZHYPO_189 DET_PROB_1STAZHYPO_190 DET_PROB_1STAZHYPO_191 DET_PROB_1STAZHYPO_192 DET_IDM_189 DET_IDM_190 DET_IDM_191 DET_IDM_192 DET_MTD_192 DET_MTD_191 DET_MTD_190 DET_MTD_189 DET_BELOW_RAIN_THOLD_192 DET_BELOW_RAIN_THOLD_191 DET_BELOW_RAIN_THOLD_190 DET_BELOW_RAIN_THOLD_189 DET_MH_CRC16_189_192 DET_MH_CYCLE_COUNTER_189_192 DET_MH_SCAN_INDEX_4LSB_189_192 DET_CONFD_ELEVATION_189 DET_CONFD_AZIMUTH_189 DET_HVC_FLAG_189 DET_EXISTENCE_PROB_189 DET_SNR_189 DET_SUPER_RES_TARGET_189 DET_BI_STATIC_FLAG_189 DET_RCS_189 DET_ELEVATION_ERR_189 DET_ELEVATION_189 DET_AZIMUTH_ERR_189 DET_AZIMUTH_189 DET_RANGE_VELOCITY_ERR_189 DET_RANGE_VELOCITY_189 DET_RANGE_ERR_189 DET_RANGE_189 DET_CONFD_ELEVATION_190 DET_CONFD_AZIMUTH_190 DET_HVC_FLAG_190 DET_EXISTENCE_PROB_190 DET_SNR_190 DET_SUPER_RES_TARGET_190 DET_BI_STATIC_FLAG_190 DET_RCS_190 DET_ELEVATION_ERR_190 DET_ELEVATION_190 DET_AZIMUTH_ERR_190 DET_AZIMUTH_190 DET_RANGE_VELOCITY_ERR_190 DET_RANGE_VELOCITY_190 DET_RANGE_ERR_190 DET_RANGE_190 DET_CONFD_ELEVATION_191 DET_CONFD_AZIMUTH_191 DET_HVC_FLAG_191 DET_EXISTENCE_PROB_191 DET_SNR_191 DET_SUPER_RES_TARGET_191 DET_BI_STATIC_FLAG_191 DET_RCS_191 DET_ELEVATION_ERR_191 DET_ELEVATION_191 DET_AZIMUTH_ERR_191 DET_AZIMUTH_191 DET_RANGE_VELOCITY_ERR_191 DET_RANGE_VELOCITY_191 DET_RANGE_ERR_191 DET_RANGE_191 DET_CONFD_ELEVATION_192 DET_CONFD_AZIMUTH_192 DET_HVC_FLAG_192 DET_EXISTENCE_PROB_192 DET_SNR_192 DET_SUPER_RES_TARGET_192 DET_BI_STATIC_FLAG_192 DET_RCS_192 DET_ELEVATION_ERR_192 DET_ELEVATION_192 DET_AZIMUTH_ERR_192 DET_AZIMUTH_192 DET_RANGE_VELOCITY_ERR_192 DET_RANGE_VELOCITY_192 DET_RANGE_ERR_192 DET_RANGE_192;
SIG_GROUP_ 1200 Detections_193_196 1 : DET_PROB_1STAZHYPO_193 DET_PROB_1STAZHYPO_194 DET_PROB_1STAZHYPO_195 DET_PROB_1STAZHYPO_196 DET_IDM_193 DET_IDM_194 DET_IDM_195 DET_IDM_196 DET_MTD_196 DET_MTD_195 DET_MTD_194 DET_MTD_193 DET_BELOW_RAIN_THOLD_196 DET_BELOW_RAIN_THOLD_195 DET_BELOW_RAIN_THOLD_194 DET_BELOW_RAIN_THOLD_193 DET_MH_CRC16_193_196 DET_MH_CYCLE_COUNTER_193_196 DET_MH_SCAN_INDEX_4LSB_193_196 DET_CONFD_ELEVATION_193 DET_CONFD_AZIMUTH_193 DET_HVC_FLAG_193 DET_EXISTENCE_PROB_193 DET_SNR_193 DET_SUPER_RES_TARGET_193 DET_BI_STATIC_FLAG_193 DET_RCS_193 DET_ELEVATION_ERR_193 DET_ELEVATION_193 DET_AZIMUTH_ERR_193 DET_AZIMUTH_193 DET_RANGE_VELOCITY_ERR_193 DET_RANGE_VELOCITY_193 DET_RANGE_ERR_193 DET_RANGE_193 DET_CONFD_ELEVATION_194 DET_CONFD_AZIMUTH_194 DET_HVC_FLAG_194 DET_EXISTENCE_PROB_194 DET_SNR_194 DET_SUPER_RES_TARGET_194 DET_BI_STATIC_FLAG_194 DET_RCS_194 DET_ELEVATION_ERR_194 DET_ELEVATION_194 DET_AZIMUTH_ERR_194 DET_AZIMUTH_194 DET_RANGE_VELOCITY_ERR_194 DET_RANGE_VELOCITY_194 DET_RANGE_ERR_194 DET_RANGE_194 DET_CONFD_ELEVATION_195 DET_CONFD_AZIMUTH_195 DET_HVC_FLAG_195 DET_EXISTENCE_PROB_195 DET_SNR_195 DET_SUPER_RES_TARGET_195 DET_BI_STATIC_FLAG_195 DET_RCS_195 DET_ELEVATION_ERR_195 DET_ELEVATION_195 DET_AZIMUTH_ERR_195 DET_AZIMUTH_195 DET_RANGE_VELOCITY_ERR_195 DET_RANGE_VELOCITY_195 DET_RANGE_ERR_195 DET_RANGE_195 DET_CONFD_ELEVATION_196 DET_CONFD_AZIMUTH_196 DET_HVC_FLAG_196 DET_EXISTENCE_PROB_196 DET_SNR_196 DET_SUPER_RES_TARGET_196 DET_BI_STATIC_FLAG_196 DET_RCS_196 DET_ELEVATION_ERR_196 DET_ELEVATION_196 DET_AZIMUTH_ERR_196 DET_AZIMUTH_196 DET_RANGE_VELOCITY_ERR_196 DET_RANGE_VELOCITY_196 DET_RANGE_ERR_196 DET_RANGE_196;
SIG_GROUP_ 1201 Detections_197_200 1 : DET_PROB_1STAZHYPO_197 DET_PROB_1STAZHYPO_198 DET_PROB_1STAZHYPO_199 DET_PROB_1STAZHYPO_200 DET_IDM_197 DET_IDM_198 DET_IDM_199 DET_IDM_200 DET_MTD_200 DET_MTD_199 DET_MTD_198 DET_MTD_197 DET_BELOW_RAIN_THOLD_200 DET_BELOW_RAIN_THOLD_199 DET_BELOW_RAIN_THOLD_198 DET_BELOW_RAIN_THOLD_197 DET_MH_CRC16_197_200 DET_MH_CYCLE_COUNTER_197_200 DET_MH_SCAN_INDEX_4LSB_197_200 DET_CONFD_ELEVATION_197 DET_CONFD_AZIMUTH_197 DET_HVC_FLAG_197 DET_EXISTENCE_PROB_197 DET_SNR_197 DET_SUPER_RES_TARGET_197 DET_BI_STATIC_FLAG_197 DET_RCS_197 DET_ELEVATION_ERR_197 DET_ELEVATION_197 DET_AZIMUTH_ERR_197 DET_AZIMUTH_197 DET_RANGE_VELOCITY_ERR_197 DET_RANGE_VELOCITY_197 DET_RANGE_ERR_197 DET_RANGE_197 DET_CONFD_ELEVATION_198 DET_CONFD_AZIMUTH_198 DET_HVC_FLAG_198 DET_EXISTENCE_PROB_198 DET_SNR_198 DET_SUPER_RES_TARGET_198 DET_BI_STATIC_FLAG_198 DET_RCS_198 DET_ELEVATION_ERR_198 DET_ELEVATION_198 DET_AZIMUTH_ERR_198 DET_AZIMUTH_198 DET_RANGE_VELOCITY_ERR_198 DET_RANGE_VELOCITY_198 DET_RANGE_ERR_198 DET_RANGE_198 DET_CONFD_ELEVATION_199 DET_CONFD_AZIMUTH_199 DET_HVC_FLAG_199 DET_EXISTENCE_PROB_199 DET_SNR_199 DET_SUPER_RES_TARGET_199 DET_BI_STATIC_FLAG_199 DET_RCS_199 DET_ELEVATION_ERR_199 DET_ELEVATION_199 DET_AZIMUTH_ERR_199 DET_AZIMUTH_199 DET_RANGE_VELOCITY_ERR_199 DET_RANGE_VELOCITY_199 DET_RANGE_ERR_199 DET_RANGE_199 DET_CONFD_ELEVATION_200 DET_CONFD_AZIMUTH_200 DET_HVC_FLAG_200 DET_EXISTENCE_PROB_200 DET_SNR_200 DET_SUPER_RES_TARGET_200 DET_BI_STATIC_FLAG_200 DET_RCS_200 DET_ELEVATION_ERR_200 DET_ELEVATION_200 DET_AZIMUTH_ERR_200 DET_AZIMUTH_200 DET_RANGE_VELOCITY_ERR_200 DET_RANGE_VELOCITY_200 DET_RANGE_ERR_200 DET_RANGE_200;
SIG_GROUP_ 1202 Detections_201_204 1 : DET_PROB_1STAZHYPO_201 DET_PROB_1STAZHYPO_202 DET_PROB_1STAZHYPO_203 DET_PROB_1STAZHYPO_204 DET_IDM_201 DET_IDM_202 DET_IDM_203 DET_IDM_204 DET_MTD_204 DET_MTD_203 DET_MTD_202 DET_MTD_201 DET_BELOW_RAIN_THOLD_204 DET_BELOW_RAIN_THOLD_203 DET_BELOW_RAIN_THOLD_202 DET_BELOW_RAIN_THOLD_201 DET_MH_CRC16_201_204 DET_MH_CYCLE_COUNTER_201_204 DET_MH_SCAN_INDEX_4LSB_201_204 DET_CONFD_ELEVATION_201 DET_CONFD_AZIMUTH_201 DET_HVC_FLAG_201 DET_EXISTENCE_PROB_201 DET_SNR_201 DET_SUPER_RES_TARGET_201 DET_BI_STATIC_FLAG_201 DET_RCS_201 DET_ELEVATION_ERR_201 DET_ELEVATION_201 DET_AZIMUTH_ERR_201 DET_AZIMUTH_201 DET_RANGE_VELOCITY_ERR_201 DET_RANGE_VELOCITY_201 DET_RANGE_ERR_201 DET_RANGE_201 DET_CONFD_ELEVATION_202 DET_CONFD_AZIMUTH_202 DET_HVC_FLAG_202 DET_EXISTENCE_PROB_202 DET_SNR_202 DET_SUPER_RES_TARGET_202 DET_BI_STATIC_FLAG_202 DET_RCS_202 DET_ELEVATION_ERR_202 DET_ELEVATION_202 DET_AZIMUTH_ERR_202 DET_AZIMUTH_202 DET_RANGE_VELOCITY_ERR_202 DET_RANGE_VELOCITY_202 DET_RANGE_ERR_202 DET_RANGE_202 DET_CONFD_ELEVATION_203 DET_CONFD_AZIMUTH_203 DET_HVC_FLAG_203 DET_EXISTENCE_PROB_203 DET_SNR_203 DET_SUPER_RES_TARGET_203 DET_BI_STATIC_FLAG_203 DET_RCS_203 DET_ELEVATION_ERR_203 DET_ELEVATION_203 DET_AZIMUTH_ERR_203 DET_AZIMUTH_203 DET_RANGE_VELOCITY_ERR_203 DET_RANGE_VELOCITY_203 DET_RANGE_ERR_203 DET_RANGE_203 DET_CONFD_ELEVATION_204 DET_CONFD_AZIMUTH_204 DET_HVC_FLAG_204 DET_EXISTENCE_PROB_204 DET_SNR_204 DET_SUPER_RES_TARGET_204 DET_BI_STATIC_FLAG_204 DET_RCS_204 DET_ELEVATION_ERR_204 DET_ELEVATION_204 DET_AZIMUTH_ERR_204 DET_AZIMUTH_204 DET_RANGE_VELOCITY_ERR_204 DET_RANGE_VELOCITY_204 DET_RANGE_ERR_204 DET_RANGE_204;
SIG_GROUP_ 1203 Detections_205_208 1 : DET_PROB_1STAZHYPO_205 DET_PROB_1STAZHYPO_206 DET_PROB_1STAZHYPO_207 DET_PROB_1STAZHYPO_208 DET_IDM_205 DET_IDM_206 DET_IDM_207 DET_IDM_208 DET_MTD_208 DET_MTD_207 DET_MTD_206 DET_MTD_205 DET_BELOW_RAIN_THOLD_208 DET_BELOW_RAIN_THOLD_207 DET_BELOW_RAIN_THOLD_206 DET_BELOW_RAIN_THOLD_205 DET_MH_CRC16_205_208 DET_MH_CYCLE_COUNTER_205_208 DET_MH_SCAN_INDEX_4LSB_205_208 DET_CONFD_ELEVATION_205 DET_CONFD_AZIMUTH_205 DET_HVC_FLAG_205 DET_EXISTENCE_PROB_205 DET_SNR_205 DET_SUPER_RES_TARGET_205 DET_BI_STATIC_FLAG_205 DET_RCS_205 DET_ELEVATION_ERR_205 DET_ELEVATION_205 DET_AZIMUTH_ERR_205 DET_AZIMUTH_205 DET_RANGE_VELOCITY_ERR_205 DET_RANGE_VELOCITY_205 DET_RANGE_ERR_205 DET_RANGE_205 DET_CONFD_ELEVATION_206 DET_CONFD_AZIMUTH_206 DET_HVC_FLAG_206 DET_EXISTENCE_PROB_206 DET_SNR_206 DET_SUPER_RES_TARGET_206 DET_BI_STATIC_FLAG_206 DET_RCS_206 DET_ELEVATION_ERR_206 DET_ELEVATION_206 DET_AZIMUTH_ERR_206 DET_AZIMUTH_206 DET_RANGE_VELOCITY_ERR_206 DET_RANGE_VELOCITY_206 DET_RANGE_ERR_206 DET_RANGE_206 DET_CONFD_ELEVATION_207 DET_CONFD_AZIMUTH_207 DET_HVC_FLAG_207 DET_EXISTENCE_PROB_207 DET_SNR_207 DET_SUPER_RES_TARGET_207 DET_BI_STATIC_FLAG_207 DET_RCS_207 DET_ELEVATION_ERR_207 DET_ELEVATION_207 DET_AZIMUTH_ERR_207 DET_AZIMUTH_207 DET_RANGE_VELOCITY_ERR_207 DET_RANGE_VELOCITY_207 DET_RANGE_ERR_207 DET_RANGE_207 DET_CONFD_ELEVATION_208 DET_CONFD_AZIMUTH_208 DET_HVC_FLAG_208 DET_EXISTENCE_PROB_208 DET_SNR_208 DET_SUPER_RES_TARGET_208 DET_BI_STATIC_FLAG_208 DET_RCS_208 DET_ELEVATION_ERR_208 DET_ELEVATION_208 DET_AZIMUTH_ERR_208 DET_AZIMUTH_208 DET_RANGE_VELOCITY_ERR_208 DET_RANGE_VELOCITY_208 DET_RANGE_ERR_208 DET_RANGE_208;
SIG_GROUP_ 1204 Detections_209_212 1 : DET_PROB_1STAZHYPO_209 DET_PROB_1STAZHYPO_210 DET_PROB_1STAZHYPO_211 DET_PROB_1STAZHYPO_212 DET_IDM_209 DET_IDM_210 DET_IDM_211 DET_IDM_212 DET_MTD_212 DET_MTD_211 DET_MTD_210 DET_MTD_209 DET_BELOW_RAIN_THOLD_212 DET_BELOW_RAIN_THOLD_211 DET_BELOW_RAIN_THOLD_210 DET_BELOW_RAIN_THOLD_209 DET_MH_CRC16_209_212 DET_MH_CYCLE_COUNTER_209_212 DET_MH_SCAN_INDEX_4LSB_209_212 DET_CONFD_ELEVATION_209 DET_CONFD_AZIMUTH_209 DET_HVC_FLAG_209 DET_EXISTENCE_PROB_209 DET_SNR_209 DET_SUPER_RES_TARGET_209 DET_BI_STATIC_FLAG_209 DET_RCS_209 DET_ELEVATION_ERR_209 DET_ELEVATION_209 DET_AZIMUTH_ERR_209 DET_AZIMUTH_209 DET_RANGE_VELOCITY_ERR_209 DET_RANGE_VELOCITY_209 DET_RANGE_ERR_209 DET_RANGE_209 DET_CONFD_ELEVATION_210 DET_CONFD_AZIMUTH_210 DET_HVC_FLAG_210 DET_EXISTENCE_PROB_210 DET_SNR_210 DET_SUPER_RES_TARGET_210 DET_BI_STATIC_FLAG_210 DET_RCS_210 DET_ELEVATION_ERR_210 DET_ELEVATION_210 DET_AZIMUTH_ERR_210 DET_AZIMUTH_210 DET_RANGE_VELOCITY_ERR_210 DET_RANGE_VELOCITY_210 DET_RANGE_ERR_210 DET_RANGE_210 DET_CONFD_ELEVATION_211 DET_CONFD_AZIMUTH_211 DET_HVC_FLAG_211 DET_EXISTENCE_PROB_211 DET_SNR_211 DET_SUPER_RES_TARGET_211 DET_BI_STATIC_FLAG_211 DET_RCS_211 DET_ELEVATION_ERR_211 DET_ELEVATION_211 DET_AZIMUTH_ERR_211 DET_AZIMUTH_211 DET_RANGE_VELOCITY_ERR_211 DET_RANGE_VELOCITY_211 DET_RANGE_ERR_211 DET_RANGE_211 DET_CONFD_ELEVATION_212 DET_CONFD_AZIMUTH_212 DET_HVC_FLAG_212 DET_EXISTENCE_PROB_212 DET_SNR_212 DET_SUPER_RES_TARGET_212 DET_BI_STATIC_FLAG_212 DET_RCS_212 DET_ELEVATION_ERR_212 DET_ELEVATION_212 DET_AZIMUTH_ERR_212 DET_AZIMUTH_212 DET_RANGE_VELOCITY_ERR_212 DET_RANGE_VELOCITY_212 DET_RANGE_ERR_212 DET_RANGE_212;
SIG_GROUP_ 1205 Detections_213_216 1 : DET_PROB_1STAZHYPO_213 DET_PROB_1STAZHYPO_214 DET_PROB_1STAZHYPO_215 DET_PROB_1STAZHYPO_216 DET_IDM_213 DET_IDM_214 DET_IDM_215 DET_IDM_216 DET_MTD_216 DET_MTD_215 DET_MTD_214 DET_MTD_213 DET_BELOW_RAIN_THOLD_216 DET_BELOW_RAIN_THOLD_215 DET_BELOW_RAIN_THOLD_214 DET_BELOW_RAIN_THOLD_213 DET_MH_CRC16_213_216 DET_MH_CYCLE_COUNTER_213_216 DET_MH_SCAN_INDEX_4LSB_213_216 DET_CONFD_ELEVATION_213 DET_CONFD_AZIMUTH_213 DET_HVC_FLAG_213 DET_EXISTENCE_PROB_213 DET_SNR_213 DET_SUPER_RES_TARGET_213 DET_BI_STATIC_FLAG_213 DET_RCS_213 DET_ELEVATION_ERR_213 DET_ELEVATION_213 DET_AZIMUTH_ERR_213 DET_AZIMUTH_213 DET_RANGE_VELOCITY_ERR_213 DET_RANGE_VELOCITY_213 DET_RANGE_ERR_213 DET_RANGE_213 DET_CONFD_ELEVATION_214 DET_CONFD_AZIMUTH_214 DET_HVC_FLAG_214 DET_EXISTENCE_PROB_214 DET_SNR_214 DET_SUPER_RES_TARGET_214 DET_BI_STATIC_FLAG_214 DET_RCS_214 DET_ELEVATION_ERR_214 DET_ELEVATION_214 DET_AZIMUTH_ERR_214 DET_AZIMUTH_214 DET_RANGE_VELOCITY_ERR_214 DET_RANGE_VELOCITY_214 DET_RANGE_ERR_214 DET_RANGE_214 DET_CONFD_ELEVATION_215 DET_CONFD_AZIMUTH_215 DET_HVC_FLAG_215 DET_EXISTENCE_PROB_215 DET_SNR_215 DET_SUPER_RES_TARGET_215 DET_BI_STATIC_FLAG_215 DET_RCS_215 DET_ELEVATION_ERR_215 DET_ELEVATION_215 DET_AZIMUTH_ERR_215 DET_AZIMUTH_215 DET_RANGE_VELOCITY_ERR_215 DET_RANGE_VELOCITY_215 DET_RANGE_ERR_215 DET_RANGE_215 DET_CONFD_ELEVATION_216 DET_CONFD_AZIMUTH_216 DET_HVC_FLAG_216 DET_EXISTENCE_PROB_216 DET_SNR_216 DET_SUPER_RES_TARGET_216 DET_BI_STATIC_FLAG_216 DET_RCS_216 DET_ELEVATION_ERR_216 DET_ELEVATION_216 DET_AZIMUTH_ERR_216 DET_AZIMUTH_216 DET_RANGE_VELOCITY_ERR_216 DET_RANGE_VELOCITY_216 DET_RANGE_ERR_216 DET_RANGE_216;
SIG_GROUP_ 1206 Detections_217_220 1 : DET_PROB_1STAZHYPO_217 DET_PROB_1STAZHYPO_218 DET_PROB_1STAZHYPO_219 DET_PROB_1STAZHYPO_220 DET_IDM_217 DET_IDM_218 DET_IDM_219 DET_IDM_220 DET_MTD_220 DET_MTD_219 DET_MTD_218 DET_MTD_217 DET_BELOW_RAIN_THOLD_220 DET_BELOW_RAIN_THOLD_219 DET_BELOW_RAIN_THOLD_218 DET_BELOW_RAIN_THOLD_217 DET_MH_CRC16_217_220 DET_MH_CYCLE_COUNTER_217_220 DET_MH_SCAN_INDEX_4LSB_217_220 DET_CONFD_ELEVATION_217 DET_CONFD_AZIMUTH_217 DET_HVC_FLAG_217 DET_EXISTENCE_PROB_217 DET_SNR_217 DET_SUPER_RES_TARGET_217 DET_BI_STATIC_FLAG_217 DET_RCS_217 DET_ELEVATION_ERR_217 DET_ELEVATION_217 DET_AZIMUTH_ERR_217 DET_AZIMUTH_217 DET_RANGE_VELOCITY_ERR_217 DET_RANGE_VELOCITY_217 DET_RANGE_ERR_217 DET_RANGE_217 DET_CONFD_ELEVATION_218 DET_CONFD_AZIMUTH_218 DET_HVC_FLAG_218 DET_EXISTENCE_PROB_218 DET_SNR_218 DET_SUPER_RES_TARGET_218 DET_BI_STATIC_FLAG_218 DET_RCS_218 DET_ELEVATION_ERR_218 DET_ELEVATION_218 DET_AZIMUTH_ERR_218 DET_AZIMUTH_218 DET_RANGE_VELOCITY_ERR_218 DET_RANGE_VELOCITY_218 DET_RANGE_ERR_218 DET_RANGE_218 DET_CONFD_ELEVATION_219 DET_CONFD_AZIMUTH_219 DET_HVC_FLAG_219 DET_EXISTENCE_PROB_219 DET_SNR_219 DET_SUPER_RES_TARGET_219 DET_BI_STATIC_FLAG_219 DET_RCS_219 DET_ELEVATION_ERR_219 DET_ELEVATION_219 DET_AZIMUTH_ERR_219 DET_AZIMUTH_219 DET_RANGE_VELOCITY_ERR_219 DET_RANGE_VELOCITY_219 DET_RANGE_ERR_219 DET_RANGE_219 DET_CONFD_ELEVATION_220 DET_CONFD_AZIMUTH_220 DET_HVC_FLAG_220 DET_EXISTENCE_PROB_220 DET_SNR_220 DET_SUPER_RES_TARGET_220 DET_BI_STATIC_FLAG_220 DET_RCS_220 DET_ELEVATION_ERR_220 DET_ELEVATION_220 DET_AZIMUTH_ERR_220 DET_AZIMUTH_220 DET_RANGE_VELOCITY_ERR_220 DET_RANGE_VELOCITY_220 DET_RANGE_ERR_220 DET_RANGE_220;
SIG_GROUP_ 1207 Detections_221_224 1 : DET_PROB_1STAZHYPO_221 DET_PROB_1STAZHYPO_222 DET_PROB_1STAZHYPO_223 DET_PROB_1STAZHYPO_224 DET_IDM_221 DET_IDM_222 DET_IDM_223 DET_IDM_224 DET_MTD_224 DET_MTD_223 DET_MTD_222 DET_MTD_221 DET_BELOW_RAIN_THOLD_224 DET_BELOW_RAIN_THOLD_223 DET_BELOW_RAIN_THOLD_222 DET_BELOW_RAIN_THOLD_221 DET_MH_CRC16_221_224 DET_MH_CYCLE_COUNTER_221_224 DET_MH_SCAN_INDEX_4LSB_221_224 DET_CONFD_ELEVATION_221 DET_CONFD_AZIMUTH_221 DET_HVC_FLAG_221 DET_EXISTENCE_PROB_221 DET_SNR_221 DET_SUPER_RES_TARGET_221 DET_BI_STATIC_FLAG_221 DET_RCS_221 DET_ELEVATION_ERR_221 DET_ELEVATION_221 DET_AZIMUTH_ERR_221 DET_AZIMUTH_221 DET_RANGE_VELOCITY_ERR_221 DET_RANGE_VELOCITY_221 DET_RANGE_ERR_221 DET_RANGE_221 DET_CONFD_ELEVATION_222 DET_CONFD_AZIMUTH_222 DET_HVC_FLAG_222 DET_EXISTENCE_PROB_222 DET_SNR_222 DET_SUPER_RES_TARGET_222 DET_BI_STATIC_FLAG_222 DET_RCS_222 DET_ELEVATION_ERR_222 DET_ELEVATION_222 DET_AZIMUTH_ERR_222 DET_AZIMUTH_222 DET_RANGE_VELOCITY_ERR_222 DET_RANGE_VELOCITY_222 DET_RANGE_ERR_222 DET_RANGE_222 DET_CONFD_ELEVATION_223 DET_CONFD_AZIMUTH_223 DET_HVC_FLAG_223 DET_EXISTENCE_PROB_223 DET_SNR_223 DET_SUPER_RES_TARGET_223 DET_BI_STATIC_FLAG_223 DET_RCS_223 DET_ELEVATION_ERR_223 DET_ELEVATION_223 DET_AZIMUTH_ERR_223 DET_AZIMUTH_223 DET_RANGE_VELOCITY_ERR_223 DET_RANGE_VELOCITY_223 DET_RANGE_ERR_223 DET_RANGE_223 DET_CONFD_ELEVATION_224 DET_CONFD_AZIMUTH_224 DET_HVC_FLAG_224 DET_EXISTENCE_PROB_224 DET_SNR_224 DET_SUPER_RES_TARGET_224 DET_BI_STATIC_FLAG_224 DET_RCS_224 DET_ELEVATION_ERR_224 DET_ELEVATION_224 DET_AZIMUTH_ERR_224 DET_AZIMUTH_224 DET_RANGE_VELOCITY_ERR_224 DET_RANGE_VELOCITY_224 DET_RANGE_ERR_224 DET_RANGE_224;
