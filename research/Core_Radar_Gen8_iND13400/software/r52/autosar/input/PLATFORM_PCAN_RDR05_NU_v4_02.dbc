VERSION ""

NS_ :

BS_:

BU_: External_Tool ADAS RDR05 RDR_Fusion_Partner RDR_Gateway

BO_ 3221225472 VECTOR__INDEPENDENT_SIG_MSG: 0 Vector__XXX
 SG_ DET_MH_CRC16_113_116 : 0|16@1+ (1,0) [0|65535] "" Vector__XXX
 SG_ DET_PROB_1STAZHYPO_116 : 0|1@1+ (1,0) [0|1] "" Vector__XXX
 SG_ DET_IDM_116 : 0|1@1+ (1,0) [0|1] "" Vector__XXX
 SG_ DET_MTD_116 : 0|1@1+ (1,0) [0|1] "" Vector__XXX
 SG_ DET_BELOW_RAIN_THOLD_116 : 0|1@1+ (1,0) [0|1] "" Vector__XXX
 SG_ DET_RANGE_117 : 0|15@1+ (0.015625,0) [0|500] "m" Vector__XXX
 SG_ DET_RANGE_ERR_117 : 0|7@1+ (0.0075,0) [0|0.9525] "m" Vector__XXX
 SG_ DET_RANGE_VELOCITY_117 : 0|15@1+ (0.0078125,-128) [-128|127.9921875] "m/s" Vector__XXX
 SG_ DET_RANGE_VELOCITY_ERR_117 : 0|8@1+ (0.003,0) [0|0.765] "m/s" Vector__XXX
 SG_ DET_AZIMUTH_117 : 0|13@1+ (0.0004,-1.5708) [-1.5708|1.5708] "rad" Vector__XXX
 SG_ DET_AZIMUTH_ERR_117 : 0|7@1+ (0.00087267,0) [0|0.11082909] "rad" Vector__XXX
 SG_ DET_ELEVATION_117 : 0|8@1+ (0.00275,-0.34925) [-0.34925|0.34925] "rad" Vector__XXX
 SG_ DET_ELEVATION_ERR_117 : 0|6@1+ (0.00174533,0) [0|0.10995579] "rad" Vector__XXX
 SG_ DET_RCS_117 : 0|8@1+ (0.5,-64) [-64|63.5] "dBsm" Vector__XXX
 SG_ DET_BI_STATIC_FLAG_117 : 0|1@1+ (1,0) [0|1] "" Vector__XXX
 SG_ DET_SUPER_RES_TARGET_117 : 0|1@1+ (1,0) [0|1] "" Vector__XXX
 SG_ DET_SNR_117 : 0|8@1+ (0.35156,0) [0|89.6478] "dB" Vector__XXX
 SG_ DET_EXISTENCE_PROB_117 : 0|6@1+ (1.588,0) [0|100] "%" Vector__XXX
 SG_ DET_HVC_FLAG_117 : 0|1@1+ (1,0) [0|1] "" Vector__XXX
 SG_ DET_CONFD_AZIMUTH_117 : 0|2@1+ (1,0) [0|3] "" Vector__XXX
 SG_ DET_CONFD_ELEVATION_117 : 0|2@1+ (1,0) [0|3] "" Vector__XXX
 SG_ DET_PROB_1STAZHYPO_117 : 0|1@1+ (1,0) [0|1] "" Vector__XXX
 SG_ DET_IDM_117 : 0|1@1+ (1,0) [0|1] "" Vector__XXX
 SG_ DET_MTD_117 : 0|1@1+ (1,0) [0|1] "" Vector__XXX
 SG_ DET_BELOW_RAIN_THOLD_117 : 0|1@1+ (1,0) [0|1] "" Vector__XXX
 SG_ DET_RANGE_118 : 0|15@1+ (0.015625,0) [0|500] "m" Vector__XXX
 SG_ DET_RANGE_ERR_118 : 0|7@1+ (0.0075,0) [0|0.9525] "m" Vector__XXX
 SG_ DET_RANGE_VELOCITY_118 : 0|15@1+ (0.0078125,-128) [-128|127.9921875] "m/s" Vector__XXX
 SG_ DET_RANGE_VELOCITY_ERR_118 : 0|8@1+ (0.003,0) [0|0.765] "m/s" Vector__XXX
 SG_ DET_AZIMUTH_118 : 0|13@1+ (0.0004,-1.5708) [-1.5708|1.5708] "rad" Vector__XXX
 SG_ DET_AZIMUTH_ERR_118 : 0|7@1+ (0.00087267,0) [0|0.11082909] "rad" Vector__XXX
 SG_ DET_ELEVATION_118 : 0|8@1+ (0.00275,-0.34925) [-0.34925|0.34925] "rad" Vector__XXX
 SG_ DET_ELEVATION_ERR_118 : 0|6@1+ (0.00174533,0) [0|0.10995579] "rad" Vector__XXX
 SG_ DET_RCS_118 : 0|8@1+ (0.5,-64) [-64|63.5] "dBsm" Vector__XXX
 SG_ DET_BI_STATIC_FLAG_118 : 0|1@1+ (1,0) [0|1] "" Vector__XXX
 SG_ DET_SUPER_RES_TARGET_118 : 0|1@1+ (1,0) [0|1] "" Vector__XXX
 SG_ DET_SNR_118 : 0|8@1+ (0.35156,0) [0|89.6478] "dB" Vector__XXX
 SG_ DET_EXISTENCE_PROB_118 : 0|6@1+ (1.588,0) [0|100] "%" Vector__XXX
 SG_ DET_HVC_FLAG_118 : 0|1@1+ (1,0) [0|1] "" Vector__XXX
 SG_ DET_CONFD_AZIMUTH_118 : 0|2@1+ (1,0) [0|3] "" Vector__XXX
 SG_ DET_CONFD_ELEVATION_118 : 0|2@1+ (1,0) [0|3] "" Vector__XXX
 SG_ DET_PROB_1STAZHYPO_118 : 0|1@1+ (1,0) [0|1] "" Vector__XXX
 SG_ DET_IDM_118 : 0|1@1+ (1,0) [0|1] "" Vector__XXX
 SG_ DET_MTD_118 : 0|1@1+ (1,0) [0|1] "" Vector__XXX
 SG_ DET_BELOW_RAIN_THOLD_118 : 0|1@1+ (1,0) [0|1] "" Vector__XXX
 SG_ DET_RANGE_119 : 0|15@1+ (0.015625,0) [0|500] "m" Vector__XXX
 SG_ DET_RANGE_ERR_119 : 0|7@1+ (0.0075,0) [0|0.9525] "m" Vector__XXX
 SG_ DET_RANGE_VELOCITY_119 : 0|15@1+ (0.0078125,-128) [-128|127.9921875] "m/s" Vector__XXX
 SG_ DET_RANGE_VELOCITY_ERR_119 : 0|8@1+ (0.003,0) [0|0.765] "m/s" Vector__XXX
 SG_ DET_AZIMUTH_119 : 0|13@1+ (0.0004,-1.5708) [-1.5708|1.5708] "rad" Vector__XXX
 SG_ DET_AZIMUTH_ERR_119 : 0|7@1+ (0.00087267,0) [0|0.11082909] "rad" Vector__XXX
 SG_ DET_ELEVATION_119 : 0|8@1+ (0.00275,-0.34925) [-0.34925|0.34925] "rad" Vector__XXX
 SG_ DET_ELEVATION_ERR_119 : 0|6@1+ (0.00174533,0) [0|0.10995579] "rad" Vector__XXX
 SG_ DET_RCS_119 : 0|8@1+ (0.5,-64) [-64|63.5] "dBsm" Vector__XXX
 SG_ DET_BI_STATIC_FLAG_119 : 0|1@1+ (1,0) [0|1] "" Vector__XXX
 SG_ DET_SUPER_RES_TARGET_119 : 0|1@1+ (1,0) [0|1] "" Vector__XXX
 SG_ DET_SNR_119 : 0|8@1+ (0.35156,0) [0|89.6478] "dB" Vector__XXX
 SG_ DET_EXISTENCE_PROB_119 : 0|6@1+ (1.588,0) [0|100] "%" Vector__XXX
 SG_ DET_HVC_FLAG_119 : 0|1@1+ (1,0) [0|1] "" Vector__XXX
 SG_ DET_CONFD_AZIMUTH_119 : 0|2@1+ (1,0) [0|3] "" Vector__XXX
 SG_ DET_CONFD_ELEVATION_119 : 0|2@1+ (1,0) [0|3] "" Vector__XXX
 SG_ DET_PROB_1STAZHYPO_119 : 0|1@1+ (1,0) [0|1] "" Vector__XXX
 SG_ DET_IDM_119 : 0|1@1+ (1,0) [0|1] "" Vector__XXX
 SG_ DET_MTD_119 : 0|1@1+ (1,0) [0|1] "" Vector__XXX
 SG_ DET_BELOW_RAIN_THOLD_119 : 0|1@1+ (1,0) [0|1] "" Vector__XXX
 SG_ DET_RANGE_120 : 0|15@1+ (0.015625,0) [0|500] "m" Vector__XXX
 SG_ DET_RANGE_ERR_120 : 0|7@1+ (0.0075,0) [0|0.9525] "m" Vector__XXX
 SG_ DET_RANGE_VELOCITY_120 : 0|15@1+ (0.0078125,-128) [-128|127.9921875] "m/s" Vector__XXX
 SG_ DET_RANGE_VELOCITY_ERR_120 : 0|8@1+ (0.003,0) [0|0.765] "m/s" Vector__XXX
 SG_ DET_AZIMUTH_120 : 0|13@1+ (0.0004,-1.5708) [-1.5708|1.5708] "rad" Vector__XXX
 SG_ DET_AZIMUTH_ERR_120 : 0|7@1+ (0.00087267,0) [0|0.11082909] "rad" Vector__XXX
 SG_ DET_ELEVATION_120 : 0|8@1+ (0.00275,-0.34925) [-0.34925|0.34925] "rad" Vector__XXX
 SG_ DET_ELEVATION_ERR_120 : 0|6@1+ (0.00174533,0) [0|0.10995579] "rad" Vector__XXX
 SG_ DET_RCS_120 : 0|8@1+ (0.5,-64) [-64|63.5] "dBsm" Vector__XXX
 SG_ DET_BI_STATIC_FLAG_120 : 0|1@1+ (1,0) [0|1] "" Vector__XXX
 SG_ DET_SUPER_RES_TARGET_120 : 0|1@1+ (1,0) [0|1] "" Vector__XXX
 SG_ DET_SNR_120 : 0|8@1+ (0.35156,0) [0|89.6478] "dB" Vector__XXX
 SG_ DET_EXISTENCE_PROB_120 : 0|6@1+ (1.588,0) [0|100] "%" Vector__XXX
 SG_ DET_HVC_FLAG_120 : 0|1@1+ (1,0) [0|1] "" Vector__XXX
 SG_ DET_CONFD_AZIMUTH_120 : 0|2@1+ (1,0) [0|3] "" Vector__XXX
 SG_ DET_CONFD_ELEVATION_120 : 0|2@1+ (1,0) [0|3] "" Vector__XXX
 SG_ DET_MH_SCAN_INDEX_4LSB_117_120 : 0|4@1+ (1,0) [0|15] "" Vector__XXX
 SG_ DET_MH_CYCLE_COUNTER_117_120 : 0|8@1+ (1,0) [0|255] "" Vector__XXX
 SG_ DET_MH_CRC16_117_120 : 0|16@1+ (1,0) [0|65535] "" Vector__XXX
 SG_ DET_PROB_1STAZHYPO_120 : 0|1@1+ (1,0) [0|1] "" Vector__XXX
 SG_ DET_IDM_120 : 0|1@1+ (1,0) [0|1] "" Vector__XXX
 SG_ DET_MTD_120 : 0|1@1+ (1,0) [0|1] "" Vector__XXX
 SG_ DET_BELOW_RAIN_THOLD_120 : 0|1@1+ (1,0) [0|1] "" Vector__XXX
 SG_ DET_RANGE_121 : 0|15@1+ (0.015625,0) [0|500] "m" Vector__XXX
 SG_ DET_RANGE_ERR_121 : 0|7@1+ (0.0075,0) [0|0.9525] "m" Vector__XXX
 SG_ DET_RANGE_VELOCITY_121 : 0|15@1+ (0.0078125,-128) [-128|127.9921875] "m/s" Vector__XXX
 SG_ DET_RANGE_VELOCITY_ERR_121 : 0|8@1+ (0.003,0) [0|0.765] "m/s" Vector__XXX
 SG_ DET_AZIMUTH_121 : 0|13@1+ (0.0004,-1.5708) [-1.5708|1.5708] "rad" Vector__XXX
 SG_ DET_AZIMUTH_ERR_121 : 0|7@1+ (0.00087267,0) [0|0.11082909] "rad" Vector__XXX
 SG_ DET_ELEVATION_121 : 0|8@1+ (0.00275,-0.34925) [-0.34925|0.34925] "rad" Vector__XXX
 SG_ DET_ELEVATION_ERR_121 : 0|6@1+ (0.00174533,0) [0|0.10995579] "rad" Vector__XXX
 SG_ DET_RCS_121 : 0|8@1+ (0.5,-64) [-64|63.5] "dBsm" Vector__XXX
 SG_ DET_BI_STATIC_FLAG_121 : 0|1@1+ (1,0) [0|1] "" Vector__XXX
 SG_ DET_SUPER_RES_TARGET_121 : 0|1@1+ (1,0) [0|1] "" Vector__XXX
 SG_ DET_SNR_121 : 0|8@1+ (0.35156,0) [0|89.6478] "dB" Vector__XXX
 SG_ DET_EXISTENCE_PROB_121 : 0|6@1+ (1.588,0) [0|100] "%" Vector__XXX
 SG_ DET_HVC_FLAG_121 : 0|1@1+ (1,0) [0|1] "" Vector__XXX
 SG_ DET_CONFD_AZIMUTH_121 : 0|2@1+ (1,0) [0|3] "" Vector__XXX
 SG_ DET_CONFD_ELEVATION_121 : 0|2@1+ (1,0) [0|3] "" Vector__XXX
 SG_ DET_PROB_1STAZHYPO_121 : 0|1@1+ (1,0) [0|1] "" Vector__XXX
 SG_ DET_IDM_121 : 0|1@1+ (1,0) [0|1] "" Vector__XXX
 SG_ DET_MTD_121 : 0|1@1+ (1,0) [0|1] "" Vector__XXX
 SG_ DET_BELOW_RAIN_THOLD_121 : 0|1@1+ (1,0) [0|1] "" Vector__XXX
 SG_ DET_RANGE_122 : 0|15@1+ (0.015625,0) [0|500] "m" Vector__XXX
 SG_ DET_RANGE_ERR_122 : 0|7@1+ (0.0075,0) [0|0.9525] "m" Vector__XXX
 SG_ DET_RANGE_VELOCITY_122 : 0|15@1+ (0.0078125,-128) [-128|127.9921875] "m/s" Vector__XXX
 SG_ DET_RANGE_VELOCITY_ERR_122 : 0|8@1+ (0.003,0) [0|0.765] "m/s" Vector__XXX
 SG_ DET_AZIMUTH_122 : 0|13@1+ (0.0004,-1.5708) [-1.5708|1.5708] "rad" Vector__XXX
 SG_ DET_AZIMUTH_ERR_122 : 0|7@1+ (0.00087267,0) [0|0.11082909] "rad" Vector__XXX
 SG_ DET_ELEVATION_122 : 0|8@1+ (0.00275,-0.34925) [-0.34925|0.34925] "rad" Vector__XXX
 SG_ DET_ELEVATION_ERR_122 : 0|6@1+ (0.00174533,0) [0|0.10995579] "rad" Vector__XXX
 SG_ DET_RCS_122 : 0|8@1+ (0.5,-64) [-64|63.5] "dBsm" Vector__XXX
 SG_ DET_BI_STATIC_FLAG_122 : 0|1@1+ (1,0) [0|1] "" Vector__XXX
 SG_ DET_SUPER_RES_TARGET_122 : 0|1@1+ (1,0) [0|1] "" Vector__XXX
 SG_ DET_SNR_122 : 0|8@1+ (0.35156,0) [0|89.6478] "dB" Vector__XXX
 SG_ DET_EXISTENCE_PROB_122 : 0|6@1+ (1.588,0) [0|100] "%" Vector__XXX
 SG_ DET_HVC_FLAG_122 : 0|1@1+ (1,0) [0|1] "" Vector__XXX
 SG_ DET_CONFD_AZIMUTH_122 : 0|2@1+ (1,0) [0|3] "" Vector__XXX
 SG_ DET_CONFD_ELEVATION_122 : 0|2@1+ (1,0) [0|3] "" Vector__XXX
 SG_ DET_PROB_1STAZHYPO_122 : 0|1@1+ (1,0) [0|1] "" Vector__XXX
 SG_ DET_IDM_122 : 0|1@1+ (1,0) [0|1] "" Vector__XXX
 SG_ DET_MTD_122 : 0|1@1+ (1,0) [0|1] "" Vector__XXX
 SG_ DET_BELOW_RAIN_THOLD_122 : 0|1@1+ (1,0) [0|1] "" Vector__XXX
 SG_ DET_RANGE_123 : 0|15@1+ (0.015625,0) [0|500] "m" Vector__XXX
 SG_ DET_RANGE_ERR_123 : 0|7@1+ (0.0075,0) [0|0.9525] "m" Vector__XXX
 SG_ DET_RANGE_VELOCITY_123 : 0|15@1+ (0.0078125,-128) [-128|127.9921875] "m/s" Vector__XXX
 SG_ DET_RANGE_VELOCITY_ERR_123 : 0|8@1+ (0.003,0) [0|0.765] "m/s" Vector__XXX
 SG_ DET_AZIMUTH_123 : 0|13@1+ (0.0004,-1.5708) [-1.5708|1.5708] "rad" Vector__XXX
 SG_ DET_AZIMUTH_ERR_123 : 0|7@1+ (0.00087267,0) [0|0.11082909] "rad" Vector__XXX
 SG_ DET_ELEVATION_123 : 0|8@1+ (0.00275,-0.34925) [-0.34925|0.34925] "rad" Vector__XXX
 SG_ DET_ELEVATION_ERR_123 : 0|6@1+ (0.00174533,0) [0|0.10995579] "rad" Vector__XXX
 SG_ DET_RCS_123 : 0|8@1+ (0.5,-64) [-64|63.5] "dBsm" Vector__XXX
 SG_ DET_BI_STATIC_FLAG_123 : 0|1@1+ (1,0) [0|1] "" Vector__XXX
 SG_ DET_SUPER_RES_TARGET_123 : 0|1@1+ (1,0) [0|1] "" Vector__XXX
 SG_ DET_SNR_123 : 0|8@1+ (0.35156,0) [0|89.6478] "dB" Vector__XXX
 SG_ DET_EXISTENCE_PROB_123 : 0|6@1+ (1.588,0) [0|100] "%" Vector__XXX
 SG_ DET_HVC_FLAG_123 : 0|1@1+ (1,0) [0|1] "" Vector__XXX
 SG_ DET_CONFD_AZIMUTH_123 : 0|2@1+ (1,0) [0|3] "" Vector__XXX
 SG_ DET_CONFD_ELEVATION_123 : 0|2@1+ (1,0) [0|3] "" Vector__XXX
 SG_ DET_PROB_1STAZHYPO_123 : 0|1@1+ (1,0) [0|1] "" Vector__XXX
 SG_ DET_IDM_123 : 0|1@1+ (1,0) [0|1] "" Vector__XXX
 SG_ DET_MTD_123 : 0|1@1+ (1,0) [0|1] "" Vector__XXX
 SG_ DET_BELOW_RAIN_THOLD_123 : 0|1@1+ (1,0) [0|1] "" Vector__XXX
 SG_ DET_RANGE_124 : 0|15@1+ (0.015625,0) [0|500] "m" Vector__XXX
 SG_ DET_RANGE_ERR_124 : 0|7@1+ (0.0075,0) [0|0.9525] "m" Vector__XXX
 SG_ DET_RANGE_VELOCITY_124 : 0|15@1+ (0.0078125,-128) [-128|127.9921875] "m/s" Vector__XXX
 SG_ DET_RANGE_VELOCITY_ERR_124 : 0|8@1+ (0.003,0) [0|0.765] "m/s" Vector__XXX
 SG_ DET_AZIMUTH_124 : 0|13@1+ (0.0004,-1.5708) [-1.5708|1.5708] "rad" Vector__XXX
 SG_ DET_AZIMUTH_ERR_124 : 0|7@1+ (0.00087267,0) [0|0.11082909] "rad" Vector__XXX
 SG_ DET_ELEVATION_124 : 0|8@1+ (0.00275,-0.34925) [-0.34925|0.34925] "rad" Vector__XXX
 SG_ DET_ELEVATION_ERR_124 : 0|6@1+ (0.00174533,0) [0|0.10995579] "rad" Vector__XXX
 SG_ DET_RCS_124 : 0|8@1+ (0.5,-64) [-64|63.5] "dBsm" Vector__XXX
 SG_ DET_BI_STATIC_FLAG_124 : 0|1@1+ (1,0) [0|1] "" Vector__XXX
 SG_ DET_SUPER_RES_TARGET_124 : 0|1@1+ (1,0) [0|1] "" Vector__XXX
 SG_ DET_SNR_124 : 0|8@1+ (0.35156,0) [0|89.6478] "dB" Vector__XXX
 SG_ DET_EXISTENCE_PROB_124 : 0|6@1+ (1.588,0) [0|100] "%" Vector__XXX
 SG_ DET_HVC_FLAG_124 : 0|1@1+ (1,0) [0|1] "" Vector__XXX
 SG_ DET_CONFD_AZIMUTH_124 : 0|2@1+ (1,0) [0|3] "" Vector__XXX
 SG_ DET_CONFD_ELEVATION_124 : 0|2@1+ (1,0) [0|3] "" Vector__XXX
 SG_ DET_MH_SCAN_INDEX_4LSB_121_124 : 0|4@1+ (1,0) [0|15] "" Vector__XXX
 SG_ DET_MH_CYCLE_COUNTER_121_124 : 0|8@1+ (1,0) [0|255] "" Vector__XXX
 SG_ DET_MH_CRC16_121_124 : 0|16@1+ (1,0) [0|65535] "" Vector__XXX
 SG_ DET_PROB_1STAZHYPO_124 : 0|1@1+ (1,0) [0|1] "" Vector__XXX
 SG_ DET_IDM_124 : 0|1@1+ (1,0) [0|1] "" Vector__XXX
 SG_ DET_MTD_124 : 0|1@1+ (1,0) [0|1] "" Vector__XXX
 SG_ DET_BELOW_RAIN_THOLD_124 : 0|1@1+ (1,0) [0|1] "" Vector__XXX
 SG_ DET_RANGE_125 : 0|15@1+ (0.015625,0) [0|500] "m" Vector__XXX
 SG_ DET_RANGE_ERR_125 : 0|7@1+ (0.0075,0) [0|0.9525] "m" Vector__XXX
 SG_ DET_RANGE_VELOCITY_125 : 0|15@1+ (0.0078125,-128) [-128|127.9921875] "m/s" Vector__XXX
 SG_ DET_RANGE_VELOCITY_ERR_125 : 0|8@1+ (0.003,0) [0|0.765] "m/s" Vector__XXX
 SG_ DET_AZIMUTH_125 : 0|13@1+ (0.0004,-1.5708) [-1.5708|1.5708] "rad" Vector__XXX
 SG_ DET_AZIMUTH_ERR_125 : 0|7@1+ (0.00087267,0) [0|0.11082909] "rad" Vector__XXX
 SG_ DET_ELEVATION_125 : 0|8@1+ (0.00275,-0.34925) [-0.34925|0.34925] "rad" Vector__XXX
 SG_ DET_ELEVATION_ERR_125 : 0|6@1+ (0.00174533,0) [0|0.10995579] "rad" Vector__XXX
 SG_ DET_RCS_125 : 0|8@1+ (0.5,-64) [-64|63.5] "dBsm" Vector__XXX
 SG_ DET_BI_STATIC_FLAG_125 : 0|1@1+ (1,0) [0|1] "" Vector__XXX
 SG_ DET_SUPER_RES_TARGET_125 : 0|1@1+ (1,0) [0|1] "" Vector__XXX
 SG_ DET_SNR_125 : 0|8@1+ (0.35156,0) [0|89.6478] "dB" Vector__XXX
 SG_ DET_EXISTENCE_PROB_125 : 0|6@1+ (1.588,0) [0|100] "%" Vector__XXX
 SG_ DET_HVC_FLAG_125 : 0|1@1+ (1,0) [0|1] "" Vector__XXX
 SG_ DET_CONFD_AZIMUTH_125 : 0|2@1+ (1,0) [0|3] "" Vector__XXX
 SG_ DET_CONFD_ELEVATION_125 : 0|2@1+ (1,0) [0|3] "" Vector__XXX
 SG_ DET_PROB_1STAZHYPO_125 : 0|1@1+ (1,0) [0|1] "" Vector__XXX
 SG_ DET_IDM_125 : 0|1@1+ (1,0) [0|1] "" Vector__XXX
 SG_ DET_MTD_125 : 0|1@1+ (1,0) [0|1] "" Vector__XXX
 SG_ DET_BELOW_RAIN_THOLD_125 : 0|1@1+ (1,0) [0|1] "" Vector__XXX
 SG_ DET_RANGE_126 : 0|15@1+ (0.015625,0) [0|500] "m" Vector__XXX
 SG_ DET_RANGE_ERR_126 : 0|7@1+ (0.0075,0) [0|0.9525] "m" Vector__XXX
 SG_ DET_RANGE_VELOCITY_126 : 0|15@1+ (0.0078125,-128) [-128|127.9921875] "m/s" Vector__XXX
 SG_ DET_RANGE_VELOCITY_ERR_126 : 0|8@1+ (0.003,0) [0|0.765] "m/s" Vector__XXX
 SG_ DET_AZIMUTH_126 : 0|13@1+ (0.0004,-1.5708) [-1.5708|1.5708] "rad" Vector__XXX
 SG_ DET_AZIMUTH_ERR_126 : 0|7@1+ (0.00087267,0) [0|0.11082909] "rad" Vector__XXX
 SG_ DET_ELEVATION_126 : 0|8@1+ (0.00275,-0.34925) [-0.34925|0.34925] "rad" Vector__XXX
 SG_ DET_ELEVATION_ERR_126 : 0|6@1+ (0.00174533,0) [0|0.10995579] "rad" Vector__XXX
 SG_ DET_RCS_126 : 0|8@1+ (0.5,-64) [-64|63.5] "dBsm" Vector__XXX
 SG_ DET_BI_STATIC_FLAG_126 : 0|1@1+ (1,0) [0|1] "" Vector__XXX
 SG_ DET_SUPER_RES_TARGET_126 : 0|1@1+ (1,0) [0|1] "" Vector__XXX
 SG_ DET_SNR_126 : 0|8@1+ (0.35156,0) [0|89.6478] "dB" Vector__XXX
 SG_ DET_EXISTENCE_PROB_126 : 0|6@1+ (1.588,0) [0|100] "%" Vector__XXX
 SG_ DET_HVC_FLAG_126 : 0|1@1+ (1,0) [0|1] "" Vector__XXX
 SG_ DET_CONFD_AZIMUTH_126 : 0|2@1+ (1,0) [0|3] "" Vector__XXX
 SG_ DET_CONFD_ELEVATION_126 : 0|2@1+ (1,0) [0|3] "" Vector__XXX
 SG_ DET_PROB_1STAZHYPO_126 : 0|1@1+ (1,0) [0|1] "" Vector__XXX
 SG_ DET_IDM_126 : 0|1@1+ (1,0) [0|1] "" Vector__XXX
 SG_ DET_MTD_126 : 0|1@1+ (1,0) [0|1] "" Vector__XXX
 SG_ DET_BELOW_RAIN_THOLD_126 : 0|1@1+ (1,0) [0|1] "" Vector__XXX
 SG_ DET_RANGE_127 : 0|15@1+ (0.015625,0) [0|500] "m" Vector__XXX
 SG_ DET_RANGE_ERR_127 : 0|7@1+ (0.0075,0) [0|0.9525] "m" Vector__XXX
 SG_ DET_RANGE_VELOCITY_127 : 0|15@1+ (0.0078125,-128) [-128|127.9921875] "m/s" Vector__XXX
 SG_ DET_RANGE_VELOCITY_ERR_127 : 0|8@1+ (0.003,0) [0|0.765] "m/s" Vector__XXX
 SG_ DET_AZIMUTH_127 : 0|13@1+ (0.0004,-1.5708) [-1.5708|1.5708] "rad" Vector__XXX
 SG_ DET_AZIMUTH_ERR_127 : 0|7@1+ (0.00087267,0) [0|0.11082909] "rad" Vector__XXX
 SG_ DET_ELEVATION_127 : 0|8@1+ (0.00275,-0.34925) [-0.34925|0.34925] "rad" Vector__XXX
 SG_ DET_ELEVATION_ERR_127 : 0|6@1+ (0.00174533,0) [0|0.10995579] "rad" Vector__XXX
 SG_ DET_RCS_127 : 0|8@1+ (0.5,-64) [-64|63.5] "dBsm" Vector__XXX
 SG_ DET_BI_STATIC_FLAG_127 : 0|1@1+ (1,0) [0|1] "" Vector__XXX
 SG_ DET_SUPER_RES_TARGET_127 : 0|1@1+ (1,0) [0|1] "" Vector__XXX
 SG_ DET_SNR_127 : 0|8@1+ (0.35156,0) [0|89.6478] "dB" Vector__XXX
 SG_ DET_EXISTENCE_PROB_127 : 0|6@1+ (1.588,0) [0|100] "%" Vector__XXX
 SG_ DET_HVC_FLAG_127 : 0|1@1+ (1,0) [0|1] "" Vector__XXX
 SG_ DET_CONFD_AZIMUTH_127 : 0|2@1+ (1,0) [0|3] "" Vector__XXX
 SG_ DET_CONFD_ELEVATION_127 : 0|2@1+ (1,0) [0|3] "" Vector__XXX
 SG_ DET_PROB_1STAZHYPO_127 : 0|1@1+ (1,0) [0|1] "" Vector__XXX
 SG_ DET_IDM_127 : 0|1@1+ (1,0) [0|1] "" Vector__XXX
 SG_ DET_MTD_127 : 0|1@1+ (1,0) [0|1] "" Vector__XXX
 SG_ DET_BELOW_RAIN_THOLD_127 : 0|1@1+ (1,0) [0|1] "" Vector__XXX
 SG_ DET_RANGE_128 : 0|15@1+ (0.015625,0) [0|500] "m" Vector__XXX
 SG_ DET_RANGE_ERR_128 : 0|7@1+ (0.0075,0) [0|0.9525] "m" Vector__XXX
 SG_ DET_RANGE_VELOCITY_128 : 0|15@1+ (0.0078125,-128) [-128|127.9921875] "m/s" Vector__XXX
 SG_ DET_RANGE_VELOCITY_ERR_128 : 0|8@1+ (0.003,0) [0|0.765] "m/s" Vector__XXX
 SG_ DET_AZIMUTH_128 : 0|13@1+ (0.0004,-1.5708) [-1.5708|1.5708] "rad" Vector__XXX
 SG_ DET_AZIMUTH_ERR_128 : 0|7@1+ (0.00087267,0) [0|0.11082909] "rad" Vector__XXX
 SG_ DET_ELEVATION_128 : 0|8@1+ (0.00275,-0.34925) [-0.34925|0.34925] "rad" Vector__XXX
 SG_ DET_ELEVATION_ERR_128 : 0|6@1+ (0.00174533,0) [0|0.10995579] "rad" Vector__XXX
 SG_ DET_RCS_128 : 0|8@1+ (0.5,-64) [-64|63.5] "dBsm" Vector__XXX
 SG_ DET_BI_STATIC_FLAG_128 : 0|1@1+ (1,0) [0|1] "" Vector__XXX
 SG_ DET_SUPER_RES_TARGET_128 : 0|1@1+ (1,0) [0|1] "" Vector__XXX
 SG_ DET_SNR_128 : 0|8@1+ (0.35156,0) [0|89.6478] "dB" Vector__XXX
 SG_ DET_EXISTENCE_PROB_128 : 0|6@1+ (1.588,0) [0|100] "%" Vector__XXX
 SG_ DET_HVC_FLAG_128 : 0|1@1+ (1,0) [0|1] "" Vector__XXX
 SG_ DET_CONFD_AZIMUTH_128 : 0|2@1+ (1,0) [0|3] "" Vector__XXX
 SG_ DET_CONFD_ELEVATION_128 : 0|2@1+ (1,0) [0|3] "" Vector__XXX
 SG_ DET_MH_SCAN_INDEX_4LSB_125_128 : 0|4@1+ (1,0) [0|15] "" Vector__XXX
 SG_ DET_MH_CYCLE_COUNTER_125_128 : 0|8@1+ (1,0) [0|255] "" Vector__XXX
 SG_ DET_MH_CRC16_125_128 : 0|16@1+ (1,0) [0|65535] "" Vector__XXX
 SG_ DET_PROB_1STAZHYPO_128 : 0|1@1+ (1,0) [0|1] "" Vector__XXX
 SG_ DET_IDM_128 : 0|1@1+ (1,0) [0|1] "" Vector__XXX
 SG_ DET_MTD_128 : 0|1@1+ (1,0) [0|1] "" Vector__XXX
 SG_ DET_BELOW_RAIN_THOLD_128 : 0|1@1+ (1,0) [0|1] "" Vector__XXX
 SG_ BlindSpotWarnigRelevantObjD_0000 : 0|3@1+ (1,0) [0|7] "" Vector__XXX
 SG_ BendOffPrbablityofMstImport_0000 : 0|3@1+ (1,0) [0|7] "" Vector__XXX
 SG_ SuspectParameterNumber : 0|8@1+ (1,0) [-128|127] "" Vector__XXX
 SG_ SPNConversionMethod : 0|8@1+ (1,0) [0|255] "" Vector__XXX
 SG_ RedStopLampState : 0|2@1+ (1,0) [0|3] "" Vector__XXX
 SG_ ProtectLampStatus : 0|2@1+ (1,0) [0|3] "" Vector__XXX
 SG_ OccurrenceCount : 0|8@1+ (1,0) [0|0] "" Vector__XXX
 SG_ MalfunctionIndicatorLampStatus : 0|2@1+ (1,0) [0|3] "" Vector__XXX
 SG_ FailureModeIdentifier : 0|8@1+ (1,0) [0|255] "" Vector__XXX
 SG_ AmberWarningLampStatus : 0|2@1+ (1,0) [0|3] "" Vector__XXX

BO_ 2566890672 GW_prop_ADAS_BSIS_info: 8 RDR05
 SG_ BlindSpotCollisionWarningLevel : 4|4@1- (1,0) [0|15] "" Vector__XXX
 SG_ BlindSpotDetectionState : 0|4@1- (1,0) [0|15] "" Vector__XXX

BO_ 2566890673 RDR_prop_ADAS_BSIS_info: 8 Vector__XXX
 SG_ BlindSpotCollisionWarningLevel : 4|4@1- (1,0) [0|15] "" RDR05
 SG_ BlindSpotDetectionState : 0|4@1- (1,0) [0|15] "" RDR05

BO_ 53 RDR_IDSM_Audit_Log: 64 RDR05
 SG_ IDSM_Audit_Log : 7|64@0+ (1,0) [0|1.8446744074E+19] ""  ADAS

BO_ 166 RDR_ALIGNMENT_STATUS_002: 64 RDR05
 SG_ AL_STS_002_CYCLE_COUNTER : 16|8@1+ (1,0) [0|255] ""  ADAS
 SG_ AL_STS_002_MH_CRC16 : 0|16@1+ (1,0) [0|65535] ""  ADAS
 SG_ STS_AlignmentShortTrackStatus : 107|3@1+ (1,0) [0|4] "NA"  ADAS
 SG_ STS_AverageSpeed : 240|32@1+ (0.01,0) [0|200] "m/s"  ADAS
 SG_ STS_DurationEffective : 272|32@1+ (1,0) [0|4294967295] "ms"  ADAS
 SG_ STS_DurationAbsolute : 208|32@1+ (1,0) [0|4294967295] "ms"  ADAS
 SG_ STS_AverageNumberOfDetections : 144|32@1+ (1,0) [0|4294967295] "NA"  ADAS
 SG_ STS_DistanceEffective : 176|32@1+ (1,0) [0|4294967295] "m"  ADAS
 SG_ STS_DistanceAbsolute : 112|32@1+ (1,0) [0|4294967295] "m"  ADAS
 SG_ STS_VehicleCondition : 104|3@1+ (1,0) [0|6] "NA"  ADAS
 SG_ STS_AlignmentServiceStatus : 308|3@1+ (1,0) [0|4] "NA"  ADAS
 SG_ STS_ImpactByInterference : 307|1@1+ (1,0) [0|1] "NA"  ADAS
 SG_ STS_MeasuredAmpSTD : 88|15@1+ (0.01,0) [0|327.67] "dBsm"  ADAS
 SG_ STS_MeasuredRawAmplitude : 56|13@1- (0.01,0) [-5|40] "dBsm"  ADAS
 SG_ STS_MeasuredRangeRateStd : 40|16@1- (1,0) [-10000|10000] "mm/s"  ADAS
 SG_ STS_MeasuredRangeRate : 69|18@1- (1,0) [-128000|128000] "mm/s"  ADAS
 SG_ STS_MeasuredRangeStd : 24|16@1+ (1,0) [0|10000] "mm"  ADAS
 SG_ STS_Measured_Range : 312|14@1+ (1,0) [0|10000] "mm"  ADAS
 SG_ STS_AlignmentStaticStatus : 304|3@1+ (1,0) [0|4] ""  ADAS

BO_ 165 RDR_ALIGNMENT_STATUS_001: 64 RDR05
 SG_ STS_StartRoll : 496|15@1- (0.0002,0) [-3.14|3.14] "rad"  ADAS
 SG_ STS_AACurrentRoll : 481|15@1- (0.0002,0) [-3.14159|3.14159] "rad"  ADAS
 SG_ STS_AARoll_Std : 464|14@1+ (0.0002,0) [0|3.14] "rad"  ADAS
 SG_ STS_RollErrorNegative : 448|15@1- (0.0002,0) [-3.14|3.14] "rad"  ADAS
 SG_ STS_Roll_Updates : 416|32@1+ (1,0) [0|4294967295] ""  ADAS
 SG_ AL_STS_001_CYCLE_COUNTER : 16|8@1+ (1,0) [0|255] ""  ADAS
 SG_ AL_STS_001_MH_CRC16 : 0|16@1+ (1,0) [0|65535] ""  ADAS
 SG_ STS_ElevationUpdates : 352|32@1+ (1,0) [0|4294967295] "NA"  ADAS
 SG_ STS_AzimuthUpdates : 320|32@1+ (1,0) [0|4294967295] "NA"  ADAS
 SG_ STS_HostSpdCompensationFactorQF : 61|2@1+ (1,0) [0|3] ""  ADAS
 SG_ STS_HostSpeedCompensationFactor : 313|7@1+ (0.01,0) [0.9|1.1] ""  ADAS
 SG_ STS_ElevationErrorNegative : 287|11@1- (0.0002,0) [-0.1745|0.1745] "rad"  ADAS
 SG_ STS_AzimuthErrorNegative : 96|15@1- (0.0002,0) [-3.14|3.14] "rad"  ADAS
 SG_ STS_RollErrorPositive : 221|10@1- (0.01,0) [-3.14|3.14] "rad"  ADAS
 SG_ STS_ElevationErrorPositive : 232|11@1- (0.0002,0) [-0.1745|0.1745] "rad"  ADAS
 SG_ STS_AzimuthErrorPositive : 192|15@1- (0.0002,0) [-3.14|3.14] "rad"  ADAS
 SG_ STS_AAElevationStd : 257|14@1+ (0.0002,0) [0|3.14] "rad"  ADAS
 SG_ STS_AAAzimuthStd : 243|14@1+ (0.0002,0) [0|3.14] "rad"  ADAS
 SG_ STS_AACurrentElevation : 207|11@1+ (0.0002,-0.1745) [-0.1745|0.1745] "rad"  ADAS
 SG_ STS_AACurrentAzimuth : 177|15@1+ (0.0002,-3.1416) [-3.1416|3.1416] "rad"  ADAS
 SG_ STS_StartElevation : 48|11@1- (0.0002,0) [-0.139|0.139] "rad"  ADAS
 SG_ STS_StartAzimuth : 149|15@1- (0.0002,0) [-3.14|3.14] "rad"  ADAS
 SG_ STS_AutoAlignmentFailRootCause : 144|5@1+ (1,0) [0|20] "NA"  ADAS
 SG_ STS_AlignmentAutoStatus : 133|3@1+ (1,0) [0|4] "NA"  ADAS
 SG_ STS_CalDisplay : 95|1@1+ (1,0) [0|1] "NA"  ADAS
 SG_ STS_AlignmentError : 128|5@1+ (1,0) [0|18] "NA"  ADAS
 SG_ STS_ProgressPercent : 136|7@1+ (1,0) [0|100] "%"  ADAS
 SG_ STS_CalTime : 80|12@1+ (1,0) [0|3600] "s"  ADAS
 SG_ STS_ElevationStd : 111|13@1+ (0.001,0) [0|6] "degree"  ADAS
 SG_ STS_AzimuthStd : 164|13@1+ (0.001,0) [0|6] "degree"  ADAS
 SG_ STS_AlignmentElevation : 400|15@1+ (0.001,-10) [-10|10] "degree"  ADAS
 SG_ STS_AlignmentAzimuth : 384|15@1+ (0.001,-10) [-10|10] "degree"  ADAS
 SG_ STS_InitAlignRsltHostSpdCompFac : 40|7@1+ (0.01,0) [0.9|1.1] ""  ADAS
 SG_ STS_InitAlignRsltElevationUpdate : 24|16@1+ (1,0) [0|65535] ""  ADAS
 SG_ STS_InitAlignResultAzimuthUpdate : 64|16@1+ (1,0) [0|65535] ""  ADAS
 SG_ STS_AlignmentModeOut : 218|3@1+ (1,0) [0|4] "NA"  ADAS
 SG_ STS_InitLastSuccessfulAlignMode : 478|3@1+ (1,0) [0|5] "NA"  ADAS
 SG_ STS_InitAlignmentResultElevation : 298|14@1- (0.001,0) [-6|6] "degree"  ADAS
 SG_ STS_InitAlignmentResultAzimuth : 272|15@1- (0.001,0) [-10|10] "degree"  ADAS
 SG_ STS_RadarTypeInput : 124|3@1+ (1,0) [0|7] "NA"  ADAS
 SG_ STS_CoordinateSystemInput : 59|2@1+ (1,0) [0|2] "NA"  ADAS
 SG_ STS_AlignmentModeIn : 92|3@1+ (1,0) [0|5] "NA"  ADAS

BO_ 167 RDR_CAPABILITY: 64 RDR05
 SG_ CAP_MaxDetRangePedestrian_2 : 153|9@1+ (1,0) [0|500] "m"  ADAS
 SG_ CAP_MaxDetRangePedestrian_1 : 135|9@1+ (1,0) [0|500] "m"  ADAS
 SG_ CAP_MaxDetRangeMotorbike_2 : 144|9@1+ (1,0) [0|500] "m"  ADAS
 SG_ CAP_MaxDetRangeMotorbike_0 : 126|9@1+ (1,0) [0|500] "m"  ADAS
 SG_ CAP_MaxDetectionRangeCar_2 : 117|9@1+ (1,0) [0|500] "m"  ADAS
 SG_ CAP_MaxDetectionRangeCar_1 : 108|9@1+ (1,0) [0|500] "m"  ADAS
 SG_ CAP_CYCLE_COUNTER : 16|8@1+ (1,0) [0|255] ""  ADAS
 SG_ CAP_MH_CRC16 : 0|16@1+ (1,0) [0|65535] ""  ADAS
 SG_ CAP_SideLobeLevelBeamformer : 168|8@1+ (1,0) [0|255] "NA"  ADAS
 SG_ CAP_SLLMonitoringStatus : 60|3@1+ (1,0) [0|4] "NA"  ADAS
 SG_ CAP_SLLMonitoringActive : 59|1@1+ (1,0) [0|1] "NA"  ADAS
 SG_ CAP_AngleAzimuthRangeEnd : 99|9@1- (1,0) [-180|180] "degree"  ADAS
 SG_ CAP_AngleAzimuthRangeStart : 90|9@1- (1,0) [-180|180] "degree"  ADAS
 SG_ CAP_MaxDetRangePedestrian_0 : 81|9@1+ (1,0) [0|500] "m"  ADAS
 SG_ CAP_MaxDetRangeMotorbike_1 : 72|9@1+ (1,0) [0|500] "m"  ADAS
 SG_ CAP_MaxDetectionRangeCar_0 : 63|9@1+ (1,0) [0|500] "m"  ADAS
 SG_ CAP_RangeEstimationStatus : 56|3@1+ (1,0) [0|4] "NA"  ADAS
 SG_ CAP_RangeEstimationActive : 31|1@1+ (1,0) [0|1] "NA"  ADAS
 SG_ CAP_DampingStandardDeviation : 48|8@1+ (1,0) [0|255] "dB"  ADAS
 SG_ CAP_DampingStatus : 187|3@1+ (1,0) [0|4] "NA"  ADAS
 SG_ CAP_DampingActive : 215|1@1+ (1,0) [0|1] "NA"  ADAS
 SG_ CAP_DampingCurrent : 32|16@1+ (0.01,0) [0|255] "dB"  ADAS
 SG_ CAP_SLBlockageFilterValue : 25|6@1+ (1,0) [0|35] "dB"  ADAS
 SG_ CAP_SLBlockageFlag : 24|1@1+ (1,0) [0|1] "NA"  ADAS
 SG_ CAP_FreeSightCheckStatus : 192|8@1+ (1,0) [0|255] ""  ADAS
 SG_ CAP_FreeSightCheckActive : 176|8@1+ (1,0) [0|255] ""  ADAS
 SG_ CAP_BlockageProbability : 208|7@1+ (1,0) [0|100] "%"  ADAS
 SG_ CAP_BlockageValue : 184|3@1+ (1,0) [0|6] "NA"  ADAS
 SG_ CAP_BlockageStatus : 163|3@1+ (1,0) [0|4] "NA"  ADAS
 SG_ CAP_BlockageActive : 162|1@1+ (1,0) [0|1] "NA"  ADAS
 SG_ CAP_BlockageSensitivity : 200|8@1+ (1,0) [0|255] ""  ADAS

BO_ 1280 SYS_NM: 64 ADAS
 SG_ SYS_NM_PNC_Reserved3 : 63|8@0+ (1,0) [0|255] ""  RDR05
 SG_ SYS_NM_PNC_Reserved2 : 55|8@0+ (1,0) [0|255] ""  RDR05
 SG_ SYS_NM_PNC_Reserved1 : 47|8@0+ (1,0) [0|255] ""  RDR05
 SG_ SYS_NM_Wakeup_And_Reason : 39|8@0+ (1,0) [0|255] ""  RDR05
 SG_ SYS_NM_CAN_NM_State : 31|8@0+ (1,0) [0|255] ""  RDR05
 SG_ SYS_NM_PN_User_Data : 23|8@0+ (1,0) [0|255] ""  RDR05
 SG_ SYS_NM_CBV_ResdBit_7 : 15|1@0+ (1,0) [0|1] ""  RDR05
 SG_ SYS_NM_CBV_ResdBit_5 : 13|1@0+ (1,0) [0|1] ""  RDR05
 SG_ SYS_NM_CBV_ResdBit_2 : 10|1@0+ (1,0) [0|1] ""  RDR05
 SG_ SYS_NM_CBV_ResdBit_1 : 9|1@0+ (1,0) [0|1] ""  RDR05
 SG_ SYS_NM_CBV_ReptMsgBit0 : 8|1@0+ (1,0) [0|1] ""  RDR05
 SG_ SYS_NM_CBV_PNIBit_6 : 14|1@0+ (1,0) [0|1] ""  RDR05
 SG_ SYS_NM_CBV_NMCoordBit_3 : 11|1@0+ (1,0) [0|1] ""  RDR05
 SG_ SYS_NM_CBV_ActWakeBit_4 : 12|1@0+ (1,0) [0|1] ""  RDR05
 SG_ SYS_NM_SrcNodeID : 7|8@0+ (1,0) [0|255] ""  RDR05

BO_ 1285 RDR_NM: 64 RDR05
 SG_ RDR_NM_PNC_Reserved3 : 63|8@0+ (1,0) [0|255] ""  ADAS
 SG_ RDR_NM_PNC_Reserved2 : 55|8@0+ (1,0) [0|255] ""  ADAS
 SG_ RDR_NM_PNC_Reserved1 : 47|8@0+ (1,0) [0|255] ""  ADAS
 SG_ RDR_NM_Wakeup_And_Reason : 39|8@0+ (1,0) [0|255] ""  ADAS
 SG_ RDR_NM_PN_User_Data : 23|8@0+ (1,0) [0|255] ""  ADAS
 SG_ RDR_NM_CAN_NM_State : 31|8@0+ (1,0) [0|255] ""  ADAS
 SG_ RDR_NM_CBV_ResdBit_7 : 15|1@0+ (1,0) [0|1] ""  ADAS
 SG_ RDR_NM_CBV_ResdBit_5 : 13|1@0+ (1,0) [0|1] ""  ADAS
 SG_ RDR_NM_CBV_ResdBit_2 : 10|1@0+ (1,0) [0|1] ""  ADAS
 SG_ RDR_NM_CBV_ResdBit_1 : 9|1@0+ (1,0) [0|1] ""  ADAS
 SG_ RDR_NM_CBV_ReptMsgBit0 : 8|1@0+ (1,0) [0|1] ""  ADAS
 SG_ RDR_NM_CBV_PNIBit_6 : 14|1@0+ (1,0) [0|1] ""  ADAS
 SG_ RDR_NM_CBV_NMCoordBit_3 : 11|1@0+ (1,0) [0|1] ""  ADAS
 SG_ RDR_NM_CBV_ActWakeBit_4 : 12|1@0+ (1,0) [0|1] ""  ADAS
 SG_ RDR_NM_SrcNodeID : 7|8@0+ (1,0) [0|255] ""  ADAS

BO_ 768 RDR_DETECTION_001_004: 64 RDR05
 SG_ DET_RANGE_001 : 24|15@1+ (0.015625,0) [0|500] "m"  ADAS
 SG_ DET_RANGE_ERR_001 : 40|7@1+ (0.0075,0) [0|0.9525] "m"  ADAS
 SG_ DET_RANGE_VELOCITY_001 : 48|15@1+ (0.0078125,-128) [-128|127.9921875] "m/s"  ADAS
 SG_ DET_RANGE_VELOCITY_ERR_001 : 64|8@1+ (0.003,0) [0|0.765] "m/s"  ADAS
 SG_ DET_AZIMUTH_001 : 88|13@1+ (0.0004,-1.5708) [-1.5708|1.5708] "rad"  ADAS
 SG_ DET_AZIMUTH_ERR_001 : 105|7@1+ (0.00087267,0) [0|0.11082909] "rad"  ADAS
 SG_ DET_ELEVATION_001 : 72|8@1+ (0.00275,-0.34925) [-0.34925|0.34925] "rad"  ADAS
 SG_ DET_ELEVATION_ERR_001 : 80|6@1+ (0.00174533,0) [0|0.10995579] "rad"  ADAS
 SG_ DET_RCS_001 : 128|8@1+ (0.5,-64) [-64|63.5] "dBsm"  ADAS
 SG_ DET_BI_STATIC_FLAG_001 : 104|1@1+ (1,0) [0|1] ""  ADAS
 SG_ DET_SUPER_RES_TARGET_001 : 87|1@1+ (1,0) [0|1] ""  ADAS
 SG_ DET_SNR_001 : 120|8@1+ (0.35156,0) [0|89.6478] "dB"  ADAS
 SG_ DET_EXISTENCE_PROB_001 : 112|6@1+ (1.588,0) [0|100] "%"  ADAS
 SG_ DET_HVC_FLAG_001 : 86|1@1+ (1,0) [0|1] ""  ADAS
 SG_ DET_CONFD_AZIMUTH_001 : 118|2@1+ (1,0) [0|3] ""  ADAS
 SG_ DET_CONFD_ELEVATION_001 : 101|2@1+ (1,0) [0|3] ""  ADAS
 SG_ DET_PROB_1STAZHYPO_001 : 103|1@1+ (1,0) [0|1] ""  ADAS
 SG_ DET_IDM_001 : 63|1@1+ (1,0) [0|1] ""  ADAS
 SG_ DET_MTD_001 : 47|1@1+ (1,0) [0|1] ""  ADAS
 SG_ DET_BELOW_RAIN_THOLD_001 : 39|1@1+ (1,0) [0|1] ""  ADAS
 SG_ DET_RANGE_002 : 136|15@1+ (0.015625,0) [0|500] "m"  ADAS
 SG_ DET_RANGE_ERR_002 : 152|7@1+ (0.0075,0) [0|0.9525] "m"  ADAS
 SG_ DET_RANGE_VELOCITY_002 : 160|15@1+ (0.0078125,-128) [-128|127.9921875] "m/s"  ADAS
 SG_ DET_RANGE_VELOCITY_ERR_002 : 176|8@1+ (0.003,0) [0|0.765] "m/s"  ADAS
 SG_ DET_AZIMUTH_002 : 200|13@1+ (0.0004,-1.5708) [-1.5708|1.5708] "rad"  ADAS
 SG_ DET_AZIMUTH_ERR_002 : 217|7@1+ (0.00087267,0) [0|0.11082909] "rad"  ADAS
 SG_ DET_ELEVATION_002 : 184|8@1+ (0.00275,-0.34925) [-0.34925|0.34925] "rad"  ADAS
 SG_ DET_ELEVATION_ERR_002 : 192|6@1+ (0.00174533,0) [0|0.10995579] "rad"  ADAS
 SG_ DET_RCS_002 : 240|8@1+ (0.5,-64) [-64|63.5] "dBsm"  ADAS
 SG_ DET_BI_STATIC_FLAG_002 : 216|1@1+ (1,0) [0|1] ""  ADAS
 SG_ DET_SUPER_RES_TARGET_002 : 199|1@1+ (1,0) [0|1] ""  ADAS
 SG_ DET_SNR_002 : 232|8@1+ (0.35156,0) [0|89.6478] "dB"  ADAS
 SG_ DET_EXISTENCE_PROB_002 : 224|6@1+ (1.588,0) [0|100] "%"  ADAS
 SG_ DET_HVC_FLAG_002 : 198|1@1+ (1,0) [0|1] ""  ADAS
 SG_ DET_CONFD_AZIMUTH_002 : 230|2@1+ (1,0) [0|3] ""  ADAS
 SG_ DET_CONFD_ELEVATION_002 : 213|2@1+ (1,0) [0|3] ""  ADAS
 SG_ DET_PROB_1STAZHYPO_002 : 215|1@1+ (1,0) [0|1] ""  ADAS
 SG_ DET_IDM_002 : 175|1@1+ (1,0) [0|1] ""  ADAS
 SG_ DET_MTD_002 : 159|1@1+ (1,0) [0|1] ""  ADAS
 SG_ DET_BELOW_RAIN_THOLD_002 : 151|1@1+ (1,0) [0|1] ""  ADAS
 SG_ DET_RANGE_003 : 248|15@1+ (0.015625,0) [0|500] "m"  ADAS
 SG_ DET_RANGE_ERR_003 : 264|7@1+ (0.0075,0) [0|0.9525] "m"  ADAS
 SG_ DET_RANGE_VELOCITY_003 : 272|15@1+ (0.0078125,-128) [-128|127.9921875] "m/s"  ADAS
 SG_ DET_RANGE_VELOCITY_ERR_003 : 288|8@1+ (0.003,0) [0|0.765] "m/s"  ADAS
 SG_ DET_AZIMUTH_003 : 312|13@1+ (0.0004,-1.5708) [-1.5708|1.5708] "rad"  ADAS
 SG_ DET_AZIMUTH_ERR_003 : 329|7@1+ (0.00087267,0) [0|0.11082909] "rad"  ADAS
 SG_ DET_ELEVATION_003 : 296|8@1+ (0.00275,-0.34925) [-0.34925|0.34925] "rad"  ADAS
 SG_ DET_ELEVATION_ERR_003 : 304|6@1+ (0.00174533,0) [0|0.10995579] "rad"  ADAS
 SG_ DET_RCS_003 : 352|8@1+ (0.5,-64) [-64|63.5] "dBsm"  ADAS
 SG_ DET_BI_STATIC_FLAG_003 : 328|1@1+ (1,0) [0|1] ""  ADAS
 SG_ DET_SUPER_RES_TARGET_003 : 311|1@1+ (1,0) [0|1] ""  ADAS
 SG_ DET_SNR_003 : 344|8@1+ (0.35156,0) [0|89.6478] "dB"  ADAS
 SG_ DET_EXISTENCE_PROB_003 : 336|6@1+ (1.588,0) [0|100] "%"  ADAS
 SG_ DET_HVC_FLAG_003 : 310|1@1+ (1,0) [0|1] ""  ADAS
 SG_ DET_CONFD_AZIMUTH_003 : 342|2@1+ (1,0) [0|3] ""  ADAS
 SG_ DET_CONFD_ELEVATION_003 : 325|2@1+ (1,0) [0|3] ""  ADAS
 SG_ DET_PROB_1STAZHYPO_003 : 327|1@1+ (1,0) [0|1] ""  ADAS
 SG_ DET_IDM_003 : 287|1@1+ (1,0) [0|1] ""  ADAS
 SG_ DET_MTD_003 : 271|1@1+ (1,0) [0|1] ""  ADAS
 SG_ DET_BELOW_RAIN_THOLD_003 : 263|1@1+ (1,0) [0|1] ""  ADAS
 SG_ DET_RANGE_004 : 360|15@1+ (0.015625,0) [0|500] "m"  ADAS
 SG_ DET_RANGE_ERR_004 : 376|7@1+ (0.0075,0) [0|0.9525] "m"  ADAS
 SG_ DET_RANGE_VELOCITY_004 : 384|15@1+ (0.0078125,-128) [-128|127.9921875] "m/s"  ADAS
 SG_ DET_RANGE_VELOCITY_ERR_004 : 400|8@1+ (0.003,0) [0|0.765] "m/s"  ADAS
 SG_ DET_AZIMUTH_004 : 424|13@1+ (0.0004,-1.5708) [-1.5708|1.5708] "rad"  ADAS
 SG_ DET_AZIMUTH_ERR_004 : 441|7@1+ (0.00087267,0) [0|0.11082909] "rad"  ADAS
 SG_ DET_ELEVATION_004 : 408|8@1+ (0.00275,-0.34925) [-0.34925|0.34925] "rad"  ADAS
 SG_ DET_ELEVATION_ERR_004 : 416|6@1+ (0.00174533,0) [0|0.10995579] "rad"  ADAS
 SG_ DET_RCS_004 : 464|8@1+ (0.5,-64) [-64|63.5] "dBsm"  ADAS
 SG_ DET_BI_STATIC_FLAG_004 : 440|1@1+ (1,0) [0|1] ""  ADAS
 SG_ DET_SUPER_RES_TARGET_004 : 423|1@1+ (1,0) [0|1] ""  ADAS
 SG_ DET_SNR_004 : 456|8@1+ (0.35156,0) [0|89.6478] "dB"  ADAS
 SG_ DET_EXISTENCE_PROB_004 : 448|6@1+ (1.588,0) [0|100] "%"  ADAS
 SG_ DET_HVC_FLAG_004 : 422|1@1+ (1,0) [0|1] ""  ADAS
 SG_ DET_CONFD_AZIMUTH_004 : 454|2@1+ (1,0) [0|3] ""  ADAS
 SG_ DET_CONFD_ELEVATION_004 : 437|2@1+ (1,0) [0|3] ""  ADAS
 SG_ DET_MH_SCAN_INDEX_4LSB_001_004 : 476|4@1+ (1,0) [0|15] ""  ADAS
 SG_ DET_MH_CYCLE_COUNTER_001_004 : 16|8@1+ (1,0) [0|255] ""  ADAS
 SG_ DET_MH_CRC16_001_004 : 0|16@1+ (1,0) [0|65535] ""  ADAS
 SG_ DET_PROB_1STAZHYPO_004 : 439|1@1+ (1,0) [0|1] ""  ADAS
 SG_ DET_IDM_004 : 399|1@1+ (1,0) [0|1] ""  ADAS
 SG_ DET_MTD_004 : 383|1@1+ (1,0) [0|1] ""  ADAS
 SG_ DET_BELOW_RAIN_THOLD_004 : 375|1@1+ (1,0) [0|1] ""  ADAS

BO_ 51 RDR_DIAG_REQ_PHYS: 64 ADAS
 SG_ Diag_Req_Phys : 7|64@0+ (1,0) [0|0] ""  RDR05

BO_ 52 RDR_DIAG_RESP_PHYS: 64 RDR05
 SG_ Diag_Resp_Phys : 7|64@0+ (1,0) [0|0] ""  ADAS

BO_ 1 SYS_TIME_SYNC: 8 RDR05
 SG_ TSYN_USERBYTE m32 : 31|8@0+ (1,0) [0|255] ""  ADAS
 SG_ TSYN_TIMEDOMAIN : 23|4@0+ (1,0) [0|15] ""  ADAS
 SG_ TSYN_SYNCTIME_SEC m32 : 39|32@0+ (1,0) [0|4294967295] "s"  ADAS
 SG_ TSYN_SYNCTIME_NANOSEC m40 : 39|32@0+ (1,0) [0|999999999] "ns"  ADAS
 SG_ TSYN_SGW m40 : 26|1@0+ (1,0) [0|1] ""  ADAS
 SG_ TSYN_SEQUENCE_COUNTER : 19|4@0+ (1,0) [0|15] ""  ADAS
 SG_ TSYN_RESERVED m40 : 31|5@0+ (1,0) [0|31] ""  ADAS
 SG_ TSYN_PDU M : 7|8@0+ (1,0) [0|255] ""  ADAS
 SG_ TSYN_OVS m40 : 25|2@0+ (1,0) [0|3] ""  ADAS
 SG_ TSYNC_CRC : 15|8@0+ (1,0) [0|255] "" Vector__XXX

BO_ 2 SYS_VEHICLE_STATUS: 64 ADAS
 SG_ SSTS_VEH_Status_CMAC : 472|40@1+ (1,0) [0|1099511627800] ""  RDR05
 SG_ SSTS_VEH_Status_FV : 416|56@1+ (1,0) [0|7.2057594038E+16] ""  RDR05
 SG_ SSTS_VEH_TRAILER_CONNECTED : 53|1@1+ (1,0) [0|1] ""  RDR05
 SG_ SSTS_VEH_VARIANT : 102|2@1+ (1,0) [0|3] ""  RDR05
 SG_ SSTS_VIN_Data_Byte6 : 232|8@1+ (1,0) [0|255] ""  RDR05
 SG_ SSTS_VIN_Data_Byte5 : 224|8@1+ (1,0) [0|255] ""  RDR05
 SG_ SSTS_VIN_Data_Byte4 : 216|8@1+ (1,0) [0|255] ""  RDR05
 SG_ SSTS_VIN_Data_Byte3 : 208|8@1+ (1,0) [0|255] ""  RDR05
 SG_ SSTS_VIN_Data_Byte1 : 192|8@1+ (1,0) [0|255] ""  RDR05
 SG_ SSTS_VIN_Data_Byte2 : 200|8@1+ (1,0) [0|255] ""  RDR05
 SG_ SSTS_VIN_Data_Byte0 : 184|8@1+ (1,0) [0|255] ""  RDR05
 SG_ SSTS_VIN_FrameIdx : 176|8@1+ (1,0) [0|3] ""  RDR05
 SG_ SSTS_DRIVE_DIR : 78|2@1+ (1,0) [0|3] ""  RDR05
 SG_ SSTS_DRIVE_REVERSE : 36|1@1+ (1,0) [0|1] ""  RDR05
 SG_ SSTS_VEHICLE_STATE : 85|3@1+ (1,0) [0|5] ""  RDR05
 SG_ SSTS_VEH_AbsoluteTime_Year : 168|8@1+ (1,1970) [1970|2100] "Year"  RDR05
 SG_ SSTS_VEH_AbsoluteTime_Second : 96|6@1+ (1,0) [0|59] "s"  RDR05
 SG_ SSTS_VEH_AbsoluteTime_Month : 92|4@1+ (1,0) [0|12] "Month"  RDR05
 SG_ SSTS_VEH_AbsoluteTime_Minute : 120|6@1+ (1,0) [0|59] "Min"  RDR05
 SG_ SSTS_VEH_AbsoluteTime_Hour : 112|5@1+ (1,0) [0|23] "H"  RDR05
 SG_ SSTS_VEH_AbsoluteTime_Day : 80|5@1+ (1,0) [1|31] "Day"  RDR05
 SG_ SSTS_VEH_SYSTEM_VOLTAGE : 152|12@1+ (0.1,0) [0|255] ""  RDR05
 SG_ SSTS_VEH_POWER_MODE_STATUS : 50|3@1+ (1,0) [0|7] ""  RDR05
 SG_ SSTS_VEH_ODOMETER : 128|20@1+ (1,0) [0|999999] "Km"  RDR05
 SG_ SSTS_SW_VERSION_ADAS : 248|32@1+ (1,0) [0|4294967295] ""  RDR05
 SG_ SSTS_CAN_PCAN_MINOR_ADAS : 24|8@1+ (1,0) [0|255] ""  RDR05
 SG_ SSTS_CAN_PCAN_MAJOR_ADAS : 240|8@1+ (1,0) [0|255] ""  RDR05
 SG_ SSTS_YAW_RATE_CALC_QF : 48|2@1+ (1,0) [0|3] ""  RDR05
 SG_ SSTS_YAW_RATE_BIAS : 32|4@1+ (0.025,0) [0|0.375] "rad/s"  RDR05
 SG_ SSTS_YAW_RATE_CALC : 38|10@1+ (0.005,-2.24) [-2.24|2.24] "rad/s"  RDR05
 SG_ SSTS_VEH_SPD_COMP_FACTOR : 56|8@1- (0.001953125,1) [0.75|1.248046875] "NA"  RDR05
 SG_ SSTS_VEHICLE_SPEED_CALC_QF : 54|2@1+ (1,0) [0|3] ""  RDR05
 SG_ SSTS_VEHICLE_SPEED_CALC : 64|14@1+ (0.01,0) [0|163.83] "m/s"  RDR05
 SG_ SSTS_IGN_STATUS : 88|3@1+ (1,0) [0|5] ""  RDR05
 SG_ SSTS_GEAR_POSITION : 148|4@1+ (1,0) [0|15] ""  RDR05
 SG_ SSTS_STEERING_ANGLE_SIGN : 37|1@1+ (1,0) [0|1] ""  RDR05
 SG_ SSTS_STEERING_ANGLE : 104|8@1+ (0.0174533,0) [0|3.141599] "rad"  RDR05
 SG_ SSTS_MH_VS_CYCLE_COUNTER : 16|8@1+ (1,0) [0|255] ""  RDR05
 SG_ SSTS_MH_VS_CRC16 : 0|16@1+ (1,0) [0|65535] ""  RDR05

BO_ 163 RDR_STATUS_001: 64 RDR05
 SG_ STS_VIN_Status : 118|2@1+ (1,0) [0|3] ""  ADAS
 SG_ STS_DIST_FRNT_BMPR_TO_RR_AXL : 248|13@1+ (0.001,0) [0|8.191] "m"  ADAS
 SG_ STS_SENSOR_POLARITY : 246|1@1+ (1,0) [0|1] ""  ADAS
 SG_ STS_SP_CORE_TIME_PEAK : 472|8@1+ (0.5,0) [0|127.5] "ms"  ADAS
 SG_ STS_SP_CORE_TIME_INST : 480|8@1+ (0.5,0) [0|127.5] "ms"  ADAS
 SG_ STS_RDD_CORE_TIME_PEAK : 464|8@1+ (0.5,0) [0|127.5] "ms"  ADAS
 SG_ STS_RDD_CORE_TIME_INST : 456|8@1+ (0.5,0) [0|127.5] "ms"  ADAS
 SG_ STS_MAIN_CORE_TIME_PEAK : 448|8@1+ (0.5,0) [0|127.5] "ms"  ADAS
 SG_ STS_MAIN_CORE_TIME_INST : 440|8@1+ (0.5,0) [0|127.5] "ms"  ADAS
 SG_ STS_AF_TIME_PEAK : 432|8@1+ (0.5,0) [0|127.5] "ms"  ADAS
 SG_ STS_AF_TIME_INST : 424|8@1+ (0.5,0) [0|127.5] "ms"  ADAS
 SG_ STS_PCAN_PROTOCOL_VER_MINOR : 128|8@1+ (1,0) [0|255] ""  ADAS
 SG_ STS_PCAN_PROTOCOL_VER_MAJOR : 120|8@1+ (1,0) [0|255] ""  ADAS
 SG_ STS_PLATFORM_VARIANT : 162|5@1+ (1,0) [0|18] ""  ADAS
 SG_ STS_HARDWARE_VERSION : 112|3@1+ (1,0) [0|5] ""  ADAS
 SG_ STS_SERIAL_NUMBER_SEQUENCE : 148|14@1+ (1,0) [0|9999] ""  ADAS
 SG_ STS_SERIAL_NUM_JULIAN_YEAR : 145|3@1+ (1,2020) [2020|2027] "years"  ADAS
 SG_ STS_SERIAL_NUM_JULIAN_DAY : 136|9@1+ (1,0) [0|366] ""  ADAS
 SG_ STS_SW_VERSION_FIELD1 : 168|8@1+ (1,0) [0|255] ""  ADAS
 SG_ STS_SW_VERSION_FIELD2 : 176|8@1+ (1,0) [0|255] ""  ADAS
 SG_ STS_SW_VERSION_FIELD3 : 184|8@1+ (1,0) [0|255] ""  ADAS
 SG_ STS_SW_VERSION_FIELD4 : 192|8@1+ (1,0) [0|255] ""  ADAS
 SG_ STS_PBL_VERSION_FIELD1 : 200|8@1+ (1,0) [0|255] ""  ADAS
 SG_ STS_PBL_VERSION_FIELD2 : 208|8@1+ (1,0) [0|255] ""  ADAS
 SG_ STS_PBL_VERSION_FIELD3 : 216|8@1+ (1,0) [0|255] ""  ADAS
 SG_ STS_PBL_VERSION_FIELD4 : 224|8@1+ (1,0) [0|255] ""  ADAS
 SG_ STS_USC_CAL_VER_MAJOR : 24|16@1+ (1,0) [0|65535] ""  ADAS
 SG_ STS_USC_CAL_VER_MINOR : 40|16@1+ (1,0) [0|65535] ""  ADAS
 SG_ STS_USC_SECTION_COMPTBLITY : 56|16@1+ (1,0) [0|255] ""  ADAS
 SG_ STS_SMC_CAL_VER_MAJOR : 72|16@1+ (1,0) [0|65535] ""  ADAS
 SG_ STS_SMC_CAL_VER_MINOR : 88|16@1+ (1,0) [0|65535] ""  ADAS
 SG_ STS_SMC_SECTION_COMPTBLITY : 488|16@1+ (1,0) [0|65535] ""  ADAS
 SG_ STS_SMC_PLATFROM_VERSION : 104|8@1+ (1,0) [0|14] ""  ADAS
 SG_ STS_SENSOR_MOUNT_POS_X : 296|14@1+ (0.001,-8.192) [-8.192|8.191] "m"  ADAS
 SG_ STS_SENSOR_MOUNT_POS_Y : 312|16@1+ (0.0001,-3.2768) [-3.2768|3.2767] "m"  ADAS
 SG_ STS_SENSOR_MOUNT_POS_Z : 328|16@1+ (0.0001,-3.2768) [-3.2768|3.2767] "m"  ADAS
 SG_ STS_SENSOR_MOUNT_ORNT_YAW : 232|14@1- (0.0004,0) [-3.14|3.14] "rad"  ADAS
 SG_ STS_SENSOR_MOUNT_ORNT_PITCH : 264|14@1- (0.0004,0) [-3.14|3.14] "rad"  ADAS
 SG_ STS_SENSOR_MOUNT_ORNT_ROLL : 280|14@1+ (0.0004,-3.14159) [-3.14159|3.41161] "rad"  ADAS
 SG_ STS_SENSOR_HEIGHT : 344|32@1+ (0.01,0) [0|42949672.95] "m"  ADAS
 SG_ STS_DET_DBC_BASE_VER_MINOR : 384|8@1+ (1,0) [0|255] ""  ADAS
 SG_ STS_DET_DBC_BASE_VER_MAJOR : 376|8@1+ (1,0) [0|255] ""  ADAS
 SG_ STS_TIME_SINCE_POWER_ON : 392|32@1+ (1,0) [0|4294967295] "s"  ADAS
 SG_ STS_SENSOR_POSITION : 115|3@1+ (1,0) [0|7] ""  ADAS
 SG_ STS_MH_001_CRC16 : 0|16@1+ (1,0) [0|65535] ""  ADAS
 SG_ STS_MH_001_CYCLE_COUNTER : 16|8@1+ (1,0) [0|255] ""  ADAS

BO_ 164 RDR_STATUS_002: 64 RDR05
 SG_ STS_INTRFC_VERSION_ID_PATCH : 392|8@1+ (1,0) [0|255] ""  ADAS
 SG_ STS_INTRFC_VERSION_ID_MINOR : 384|8@1+ (1,0) [0|255] ""  ADAS
 SG_ STS_INTRFC_VERSION_ID_MAJOR : 376|8@1+ (1,0) [0|255] ""  ADAS
 SG_ STS_Yaw_Rate_Calc_QF : 142|2@1+ (1,0) [0|3] ""  ADAS
 SG_ STS_Vehicle_Speed_Calc_QF : 134|2@1+ (1,0) [0|3] ""  ADAS
 SG_ STS_Gear_Position : 59|4@1+ (1,0) [0|15] ""  ADAS
 SG_ STS_RAIN_COUNT : 360|9@1+ (1,0) [0|400] ""  ADAS
 SG_ STS_Last_CAN_Det_Inst_Latency : 336|12@1+ (0.1,0) [0|255] "ms"  ADAS
 SG_ STS_First_CAN_Det_Inst_Latency : 348|12@1+ (0.1,0) [0|255] "ms"  ADAS
 SG_ STS_CAN_NM_State : 64|8@1+ (1,0) [0|255] ""  ADAS
 SG_ STS_TKEY_ACTV_FLT_BYTE_4_to_5 : 320|16@1+ (1,0) [0|65535] ""  ADAS
 SG_ STS_TKEY_ACTV_FLT_BYTE_0_to_3 : 288|32@1+ (1,0) [0|4294967295] ""  ADAS
 SG_ STS_CORE_ACTV_FLT_BYTE_11_to_15 : 256|32@1+ (1,0) [0|4294967295] ""  ADAS
 SG_ STS_CORE_ACTV_FLT_BYTE_8_to_11 : 224|32@1+ (1,0) [0|4294967295] ""  ADAS
 SG_ STS_CORE_ACTV_FLT_BYTE_0_to_3 : 192|32@1+ (1,0) [0|4294967295] ""  ADAS
 SG_ STS_MMIC_TEMP_TX0 : 168|8@1+ (1,-50) [-50|205] "C"  ADAS
 SG_ STS_VEHICLE_SUPPLY_VOLTAGE : 24|4@1+ (1,0) [0|15] ""  ADAS
 SG_ STS_MH_002_CYCLE_COUNTER : 16|8@1+ (1,0) [0|255] ""  ADAS
 SG_ STS_MH_002_CRC16 : 0|16@1+ (1,0) [0|65535] ""  ADAS
 SG_ STS_POINT_OF_TRIGGER : 48|10@1+ (0.1,0) [0|102.3] "ms"  ADAS
 SG_ STS_NO_TSYN_ERROR : 40|1@1+ (1,0) [0|1] ""  ADAS
 SG_ STS_BRR_STATUS : 41|2@1+ (1,0) [0|2] ""  ADAS
 SG_ STS_MMIC_TEMP_RX : 144|8@1+ (1,-50) [-50|205] "C"  ADAS
 SG_ STS_MMIC_RE_INIT_COUNT : 44|4@1+ (1,0) [0|15] "NA"  ADAS
 SG_ STS_MCU_TEMP : 88|8@1+ (1,-50) [-50|205] "C"  ADAS
 SG_ STS_MMIC_TEMP_TX3_4 : 80|8@1+ (1,-50) [-50|205] "C"  ADAS
 SG_ STS_MMIC_TEMP_TX1_2 : 72|8@1+ (1,-50) [-50|205] "C"  ADAS
 SG_ STS_RDD_CORE_THROUGHPUT : 136|6@1+ (1.588,0) [0|100] "%"  ADAS
 SG_ STS_AF_CORE_THROUGHPUT : 128|6@1+ (1.588,0) [0|100] "%"  ADAS
 SG_ STS_SCAN_TYPE : 58|1@1+ (1,0) [0|1] ""  ADAS
 SG_ STS_XCVR_OPERATIONAL : 43|1@1+ (1,0) [0|1] ""  ADAS
 SG_ STS_YAW_RATE_BIAS : 28|4@1+ (0.025,0) [0|0.375] "rad/s"  ADAS
 SG_ STS_CORE_ACTV_FLT_BYTE_4_to_7 : 96|32@1+ (1,0) [0|4294967295] ""  ADAS
 SG_ STS_VEH_SPEED_DIRECTION : 177|1@1+ (1,0) [0|1] ""  ADAS
 SG_ STS_STEERING_ANGLE_SIGN : 176|1@1+ (1,0) [0|1] ""  ADAS
 SG_ STS_STEERING_ANGLE : 32|8@1+ (0.0174533,0) [0|3.141599] "rad"  ADAS
 SG_ STS_VEHICLE_SPEED_CALC : 178|14@1+ (0.01,0) [0|163.83] "m/s"  ADAS
 SG_ STS_TIME_SYNC_OFFSET : 152|16@1- (1,0) [-32768|32767] "us"  ADAS

BO_ 160 RDR_HEADER_001: 64 RDR05
 SG_ HED_RDR_HEADER_CMAC : 472|40@1+ (1,0) [0|1099511627800] ""  ADAS
 SG_ HED_RDR_HEADER_FV : 416|56@1+ (1,0) [0|7.2057594038E+16] ""  ADAS
 SG_ HED_Rain_Level : 318|2@1+ (1,0) [0|2] ""  ADAS
 SG_ HED_V_WRAPPING : 197|11@1+ (0.01,-40) [-40|-19.53] "mps"  ADAS
 SG_ HED_R_WRAPPING : 368|8@1+ (0.01,-0.9) [-0.9|1.65] "m"  ADAS
 SG_ HED_Auth_CRC32 : 376|32@1+ (1,0) [0|4294967295] ""  ADAS
 SG_ HED_SLOPE_CORR_EXECUTIONFLAG : 172|2@1+ (1,0) [0|3] ""  ADAS
 SG_ HED_PROCESSED_RANGE : 160|9@1+ (1,0) [0|500] ""  ADAS
 SG_ HED_LOOK_INDEX : 208|16@1+ (1,0) [0|65535] ""  ADAS
 SG_ HED_OPERATION_MODE : 315|3@1+ (1,0) [0|5] ""  ADAS
 SG_ HED_MAX_NUM_OF_DETECTIONS : 352|9@1+ (1,0) [0|400] ""  ADAS
 SG_ HED_NUM_OF_RESTBINS_USED : 24|9@1+ (1,0) [0|511] ""  ADAS
 SG_ HED_NUM_OF_VALID_DETECTIONS : 33|9@1+ (1,0) [0|500] ""  ADAS
 SG_ HED_LOOK_ID : 42|2@1+ (1,0) [0|3] ""  ADAS
 SG_ HED_SCAN_INDEX : 48|16@1+ (1,0) [0|65535] ""  ADAS
 SG_ HED_MH_CYCLE_COUNTER : 16|8@1+ (1,0) [0|255] ""  ADAS
 SG_ HED_DATA_QUALIFIER : 44|3@1+ (1,0) [0|7] ""  ADAS
 SG_ HED_DET_RANGE_MAX : 64|16@1+ (0.01,0) [0|500] "m"  ADAS
 SG_ HED_DET_SPEED_RANGE_MAX : 96|16@1+ (0.00390625,-128) [-128|127.99609375] "m/s"  ADAS
 SG_ HED_FOV_HOR_MAX : 136|8@1+ (0.0174533,0) [0|3.14159] "rad"  ADAS
 SG_ HED_FOV_VER_MAX : 152|8@1+ (0.0174533,0) [0|3.14159] "rad"  ADAS
 SG_ HED_DET_RANGE_MIN : 80|16@1+ (0.01,0) [0|500] "m"  ADAS
 SG_ HED_DET_SPEED_RANGE_MIN : 112|16@1+ (0.00390625,-128) [-128|127.99609375] "m/s"  ADAS
 SG_ HED_FOV_HOR_MIN : 128|8@1+ (0.0174533,-2.2340224) [-2.2340224|2.2165691] "rad"  ADAS
 SG_ HED_FOV_VER_MIN : 144|8@1+ (0.0174533,0) [-2.2340224|2.2165691] "rad"  ADAS
 SG_ HED_ALIGN_VER_REF : 174|10@1+ (0.0005,-0.1745) [-0.1745|0.337] "rad"  ADAS
 SG_ HED_ALIGN_HOR_REF : 184|13@1+ (0.0005,-0.1745) [-0.1745|3.921] "rad"  ADAS
 SG_ HED_SENSOR_TIME_STAMP_NS : 224|32@1+ (1,0) [0|4294967295] "ns"  ADAS
 SG_ HED_SENSOR_TIME_STAMP_SEC : 256|32@1+ (1,0) [0|4294967295] "s"  ADAS
 SG_ HED_TIME_SYNC_SRC_MASTER : 169|1@1+ (1,0) [0|1] ""  ADAS
 SG_ HED_TIME_SYNC_VALIDITY_FLAG : 170|2@1+ (1,0) [0|2] ""  ADAS
 SG_ HED_MH_CRC16 : 0|16@1+ (1,0) [0|65535] ""  ADAS
 SG_ HED_DET_NUM_OF_1PASS : 296|10@1+ (1,0) [0|1023] ""  ADAS
 SG_ HED_DET_NUM_OF_2PASS : 306|9@1+ (1,0) [0|511] ""  ADAS
 SG_ HED_TRIGGER_TIME : 320|32@1+ (1,0) [0|4294967295] "ns"  ADAS
 SG_ HED_DET_BI_STATIC_COUNT : 288|8@1+ (1,0) [0|255] ""  ADAS

BO_ 48 RDR_XCP_CTO_REQ: 64 External_Tool
 SG_ STS_XCP_REQ_CTO_Byte1 : 15|8@0+ (1,0) [0|255] ""  RDR05
 SG_ STS_XCP_REQ_CTO_Byte2 : 23|8@0+ (1,0) [0|255] ""  RDR05
 SG_ STS_XCP_REQ_CTO_Byte3 : 31|8@0+ (1,0) [0|255] ""  RDR05
 SG_ STS_XCP_REQ_CTO_Byte4 : 39|8@0+ (1,0) [0|255] ""  RDR05
 SG_ STS_XCP_REQ_CTO_Byte5 : 47|8@0+ (1,0) [0|255] ""  RDR05
 SG_ STS_XCP_REQ_CTO_Byte6 : 55|8@0+ (1,0) [0|255] ""  RDR05
 SG_ STS_XCP_REQ_CTO_Byte7 : 63|8@0+ (1,0) [0|255] ""  RDR05
 SG_ STS_XCP_REQ_CTO_Byte8 : 71|8@0+ (1,0) [0|255] ""  RDR05
 SG_ STS_XCP_REQ_CTO_Byte9 : 79|8@0+ (1,0) [0|255] ""  RDR05
 SG_ STS_XCP_REQ_CTO_Byte10 : 87|8@0+ (1,0) [0|255] ""  RDR05
 SG_ STS_XCP_REQ_CTO_Byte11 : 95|8@0+ (1,0) [0|255] ""  RDR05
 SG_ STS_XCP_REQ_CTO_Byte12 : 103|8@0+ (1,0) [0|255] ""  RDR05
 SG_ STS_XCP_REQ_CTO_Byte13 : 111|8@0+ (1,0) [0|255] ""  RDR05
 SG_ STS_XCP_REQ_CTO_Byte14 : 119|8@0+ (1,0) [0|255] ""  RDR05
 SG_ STS_XCP_REQ_CTO_Byte15 : 127|8@0+ (1,0) [0|255] ""  RDR05
 SG_ STS_XCP_REQ_CTO_Byte16 : 135|8@0+ (1,0) [0|255] ""  RDR05
 SG_ STS_XCP_REQ_CTO_Byte17 : 143|8@0+ (1,0) [0|255] ""  RDR05
 SG_ STS_XCP_REQ_CTO_Byte18 : 151|8@0+ (1,0) [0|255] ""  RDR05
 SG_ STS_XCP_REQ_CTO_Byte19 : 159|8@0+ (1,0) [0|255] ""  RDR05
 SG_ STS_XCP_REQ_CTO_Byte20 : 167|8@0+ (1,0) [0|255] ""  RDR05
 SG_ STS_XCP_REQ_CTO_Byte21 : 175|8@0+ (1,0) [0|255] ""  RDR05
 SG_ STS_XCP_REQ_CTO_Byte22 : 183|8@0+ (1,0) [0|255] ""  RDR05
 SG_ STS_XCP_REQ_CTO_Byte23 : 191|8@0+ (1,0) [0|255] ""  RDR05
 SG_ STS_XCP_REQ_CTO_Byte24 : 199|8@0+ (1,0) [0|255] ""  RDR05
 SG_ STS_XCP_REQ_CTO_Byte25 : 207|8@0+ (1,0) [0|255] ""  RDR05
 SG_ STS_XCP_REQ_CTO_Byte26 : 215|8@0+ (1,0) [0|255] ""  RDR05
 SG_ STS_XCP_REQ_CTO_Byte27 : 223|8@0+ (1,0) [0|255] ""  RDR05
 SG_ STS_XCP_REQ_CTO_Byte28 : 231|8@0+ (1,0) [0|255] ""  RDR05
 SG_ STS_XCP_REQ_CTO_Byte29 : 239|8@0+ (1,0) [0|255] ""  RDR05
 SG_ STS_XCP_REQ_CTO_Byte30 : 247|8@0+ (1,0) [0|255] ""  RDR05
 SG_ STS_XCP_REQ_CTO_Byte31 : 255|8@0+ (1,0) [0|255] ""  RDR05
 SG_ STS_XCP_REQ_CTO_Byte32 : 263|8@0+ (1,0) [0|255] ""  RDR05
 SG_ STS_XCP_REQ_CTO_Byte33 : 271|8@0+ (1,0) [0|255] ""  RDR05
 SG_ STS_XCP_REQ_CTO_Byte34 : 279|8@0+ (1,0) [0|255] ""  RDR05
 SG_ STS_XCP_REQ_CTO_Byte35 : 287|8@0+ (1,0) [0|255] ""  RDR05
 SG_ STS_XCP_REQ_CTO_Byte36 : 295|8@0+ (1,0) [0|255] ""  RDR05
 SG_ STS_XCP_REQ_CTO_Byte37 : 303|8@0+ (1,0) [0|255] ""  RDR05
 SG_ STS_XCP_REQ_CTO_Byte38 : 311|8@0+ (1,0) [0|255] ""  RDR05
 SG_ STS_XCP_REQ_CTO_Byte39 : 319|8@0+ (1,0) [0|255] ""  RDR05
 SG_ STS_XCP_REQ_CTO_Byte40 : 327|8@0+ (1,0) [0|255] ""  RDR05
 SG_ STS_XCP_REQ_CTO_Byte41 : 335|8@0+ (1,0) [0|255] ""  RDR05
 SG_ STS_XCP_REQ_CTO_Byte42 : 343|8@0+ (1,0) [0|255] ""  RDR05
 SG_ STS_XCP_REQ_CTO_Byte43 : 351|8@0+ (1,0) [0|255] ""  RDR05
 SG_ STS_XCP_REQ_CTO_Byte44 : 359|8@0+ (1,0) [0|255] ""  RDR05
 SG_ STS_XCP_REQ_CTO_Byte45 : 367|8@0+ (1,0) [0|255] ""  RDR05
 SG_ STS_XCP_REQ_CTO_Byte46 : 375|8@0+ (1,0) [0|255] ""  RDR05
 SG_ STS_XCP_REQ_CTO_Byte47 : 383|8@0+ (1,0) [0|255] ""  RDR05
 SG_ STS_XCP_REQ_CTO_Byte48 : 391|8@0+ (1,0) [0|255] ""  RDR05
 SG_ STS_XCP_REQ_CTO_Byte49 : 399|8@0+ (1,0) [0|255] ""  RDR05
 SG_ STS_XCP_REQ_CTO_Byte50 : 407|8@0+ (1,0) [0|255] ""  RDR05
 SG_ STS_XCP_REQ_CTO_Byte51 : 415|8@0+ (1,0) [0|255] ""  RDR05
 SG_ STS_XCP_REQ_CTO_Byte52 : 423|8@0+ (1,0) [0|255] ""  RDR05
 SG_ STS_XCP_REQ_CTO_Byte53 : 431|8@0+ (1,0) [0|255] ""  RDR05
 SG_ STS_XCP_REQ_CTO_Byte54 : 439|8@0+ (1,0) [0|255] ""  RDR05
 SG_ STS_XCP_REQ_CTO_Byte55 : 447|8@0+ (1,0) [0|255] ""  RDR05
 SG_ STS_XCP_REQ_CTO_Byte56 : 455|8@0+ (1,0) [0|255] ""  RDR05
 SG_ STS_XCP_REQ_CTO_Byte57 : 463|8@0+ (1,0) [0|255] ""  RDR05
 SG_ STS_XCP_REQ_CTO_Byte58 : 471|8@0+ (1,0) [0|255] ""  RDR05
 SG_ STS_XCP_REQ_CTO_Byte59 : 479|8@0+ (1,0) [0|255] ""  RDR05
 SG_ STS_XCP_REQ_CTO_Byte60 : 487|8@0+ (1,0) [0|255] ""  RDR05
 SG_ STS_XCP_REQ_CTO_Byte61 : 495|8@0+ (1,0) [0|255] ""  RDR05
 SG_ STS_XCP_REQ_CTO_Byte62 : 503|8@0+ (1,0) [0|255] ""  RDR05
 SG_ STS_XCP_REQ_CTO_Byte63 : 511|8@0+ (1,0) [0|255] ""  RDR05
 SG_ STS_PID : 7|8@0+ (1,0) [0|255] ""  RDR05

BO_ 49 RDR_XCP_CTO_RESP: 64 RDR05
 SG_ STS_XCP_RES_CTO_Byte0 : 7|8@0+ (1,0) [0|255] ""  External_Tool
 SG_ STS_XCP_RES_CTO_Byte1 : 15|8@0+ (1,0) [0|255] ""  External_Tool
 SG_ STS_XCP_RES_CTO_Byte2 : 23|8@0+ (1,0) [0|255] ""  External_Tool
 SG_ STS_XCP_RES_CTO_Byte3 : 31|8@0+ (1,0) [0|255] ""  External_Tool
 SG_ STS_XCP_RES_CTO_Byte4 : 39|8@0+ (1,0) [0|255] ""  External_Tool
 SG_ STS_XCP_RES_CTO_Byte5 : 47|8@0+ (1,0) [0|255] ""  External_Tool
 SG_ STS_XCP_RES_CTO_Byte6 : 55|8@0+ (1,0) [0|255] ""  External_Tool
 SG_ STS_XCP_RES_CTO_Byte7 : 63|8@0+ (1,0) [0|255] ""  External_Tool
 SG_ STS_XCP_RES_CTO_Byte8 : 71|8@0+ (1,0) [0|255] ""  External_Tool
 SG_ STS_XCP_RES_CTO_Byte9 : 79|8@0+ (1,0) [0|255] ""  External_Tool
 SG_ STS_XCP_RES_CTO_Byte10 : 87|8@0+ (1,0) [0|255] ""  External_Tool
 SG_ STS_XCP_RES_CTO_Byte11 : 95|8@0+ (1,0) [0|255] ""  External_Tool
 SG_ STS_XCP_RES_CTO_Byte12 : 103|8@0+ (1,0) [0|255] ""  External_Tool
 SG_ STS_XCP_RES_CTO_Byte13 : 111|8@0+ (1,0) [0|255] ""  External_Tool
 SG_ STS_XCP_RES_CTO_Byte14 : 119|8@0+ (1,0) [0|255] ""  External_Tool
 SG_ STS_XCP_RES_CTO_Byte15 : 127|8@0+ (1,0) [0|255] ""  External_Tool
 SG_ STS_XCP_RES_CTO_Byte16 : 135|8@0+ (1,0) [0|255] ""  External_Tool
 SG_ STS_XCP_RES_CTO_Byte17 : 143|8@0+ (1,0) [0|255] ""  External_Tool
 SG_ STS_XCP_RES_CTO_Byte18 : 151|8@0+ (1,0) [0|255] ""  External_Tool
 SG_ STS_XCP_RES_CTO_Byte19 : 159|8@0+ (1,0) [0|255] ""  External_Tool
 SG_ STS_XCP_RES_CTO_Byte20 : 167|8@0+ (1,0) [0|255] ""  External_Tool
 SG_ STS_XCP_RES_CTO_Byte21 : 175|8@0+ (1,0) [0|255] ""  External_Tool
 SG_ STS_XCP_RES_CTO_Byte22 : 183|8@0+ (1,0) [0|255] ""  External_Tool
 SG_ STS_XCP_RES_CTO_Byte23 : 191|8@0+ (1,0) [0|255] ""  External_Tool
 SG_ STS_XCP_RES_CTO_Byte24 : 199|8@0+ (1,0) [0|255] ""  External_Tool
 SG_ STS_XCP_RES_CTO_Byte25 : 207|8@0+ (1,0) [0|255] ""  External_Tool
 SG_ STS_XCP_RES_CTO_Byte26 : 215|8@0+ (1,0) [0|255] ""  External_Tool
 SG_ STS_XCP_RES_CTO_Byte27 : 223|8@0+ (1,0) [0|255] ""  External_Tool
 SG_ STS_XCP_RES_CTO_Byte28 : 231|8@0+ (1,0) [0|255] ""  External_Tool
 SG_ STS_XCP_RES_CTO_Byte29 : 239|8@0+ (1,0) [0|255] ""  External_Tool
 SG_ STS_XCP_RES_CTO_Byte30 : 247|8@0+ (1,0) [0|255] ""  External_Tool
 SG_ STS_XCP_RES_CTO_Byte31 : 255|8@0+ (1,0) [0|255] ""  External_Tool
 SG_ STS_XCP_RES_CTO_Byte32 : 263|8@0+ (1,0) [0|255] ""  External_Tool
 SG_ STS_XCP_RES_CTO_Byte33 : 271|8@0+ (1,0) [0|255] ""  External_Tool
 SG_ STS_XCP_RES_CTO_Byte34 : 279|8@0+ (1,0) [0|255] ""  External_Tool
 SG_ STS_XCP_RES_CTO_Byte35 : 287|8@0+ (1,0) [0|255] ""  External_Tool
 SG_ STS_XCP_RES_CTO_Byte36 : 295|8@0+ (1,0) [0|255] ""  External_Tool
 SG_ STS_XCP_RES_CTO_Byte37 : 303|8@0+ (1,0) [0|255] ""  External_Tool
 SG_ STS_XCP_RES_CTO_Byte38 : 311|8@0+ (1,0) [0|255] ""  External_Tool
 SG_ STS_XCP_RES_CTO_Byte39 : 319|8@0+ (1,0) [0|255] ""  External_Tool
 SG_ STS_XCP_RES_CTO_Byte40 : 327|8@0+ (1,0) [0|255] ""  External_Tool
 SG_ STS_XCP_RES_CTO_Byte41 : 335|8@0+ (1,0) [0|255] ""  External_Tool
 SG_ STS_XCP_RES_CTO_Byte42 : 343|8@0+ (1,0) [0|255] ""  External_Tool
 SG_ STS_XCP_RES_CTO_Byte43 : 351|8@0+ (1,0) [0|255] ""  External_Tool
 SG_ STS_XCP_RES_CTO_Byte44 : 359|8@0+ (1,0) [0|255] ""  External_Tool
 SG_ STS_XCP_RES_CTO_Byte45 : 367|8@0+ (1,0) [0|255] ""  External_Tool
 SG_ STS_XCP_RES_CTO_Byte46 : 375|8@0+ (1,0) [0|255] ""  External_Tool
 SG_ STS_XCP_RES_CTO_Byte47 : 383|8@0+ (1,0) [0|255] ""  External_Tool
 SG_ STS_XCP_RES_CTO_Byte48 : 391|8@0+ (1,0) [0|255] ""  External_Tool
 SG_ STS_XCP_RES_CTO_Byte49 : 399|8@0+ (1,0) [0|255] ""  External_Tool
 SG_ STS_XCP_RES_CTO_Byte50 : 407|8@0+ (1,0) [0|255] ""  External_Tool
 SG_ STS_XCP_RES_CTO_Byte51 : 415|8@0+ (1,0) [0|255] ""  External_Tool
 SG_ STS_XCP_RES_CTO_Byte52 : 423|8@0+ (1,0) [0|255] ""  External_Tool
 SG_ STS_XCP_RES_CTO_Byte53 : 431|8@0+ (1,0) [0|255] ""  External_Tool
 SG_ STS_XCP_RES_CTO_Byte54 : 439|8@0+ (1,0) [0|255] ""  External_Tool
 SG_ STS_XCP_RES_CTO_Byte55 : 447|8@0+ (1,0) [0|255] ""  External_Tool
 SG_ STS_XCP_RES_CTO_Byte56 : 455|8@0+ (1,0) [0|255] ""  External_Tool
 SG_ STS_XCP_RES_CTO_Byte57 : 463|8@0+ (1,0) [0|255] ""  External_Tool
 SG_ STS_XCP_RES_CTO_Byte58 : 471|8@0+ (1,0) [0|255] ""  External_Tool
 SG_ STS_XCP_RES_CTO_Byte59 : 479|8@0+ (1,0) [0|255] ""  External_Tool
 SG_ STS_XCP_RES_CTO_Byte60 : 487|8@0+ (1,0) [0|255] ""  External_Tool
 SG_ STS_XCP_RES_CTO_Byte61 : 495|8@0+ (1,0) [0|255] ""  External_Tool
 SG_ STS_XCP_RES_CTO_Byte62 : 503|8@0+ (1,0) [0|255] ""  External_Tool
 SG_ STS_XCP_RES_CTO_Byte63 : 511|8@0+ (1,0) [0|255] ""  External_Tool

BO_ 50 RDR_XCP_DAQ_RESP: 64 RDR05
 SG_ STS_XCP_RES_DAQ_Byte0 : 7|8@0+ (1,0) [0|255] ""  External_Tool
 SG_ STS_XCP_RES_DAQ_Byte1 : 15|8@0+ (1,0) [0|255] ""  External_Tool
 SG_ STS_XCP_RES_DAQ_Byte2 : 23|8@0+ (1,0) [0|255] ""  External_Tool
 SG_ STS_XCP_RES_DAQ_Byte3 : 31|8@0+ (1,0) [0|255] ""  External_Tool
 SG_ STS_XCP_RES_DAQ_Byte4 : 39|8@0+ (1,0) [0|255] ""  External_Tool
 SG_ STS_XCP_RES_DAQ_Byte5 : 47|8@0+ (1,0) [0|255] ""  External_Tool
 SG_ STS_XCP_RES_DAQ_Byte6 : 55|8@0+ (1,0) [0|255] ""  External_Tool
 SG_ STS_XCP_RES_DAQ_Byte7 : 63|8@0+ (1,0) [0|255] ""  External_Tool
 SG_ STS_XCP_RES_DAQ_Byte8 : 71|8@0+ (1,0) [0|255] ""  External_Tool
 SG_ STS_XCP_RES_DAQ_Byte9 : 79|8@0+ (1,0) [0|255] ""  External_Tool
 SG_ STS_XCP_RES_DAQ_Byte10 : 87|8@0+ (1,0) [0|255] ""  External_Tool
 SG_ STS_XCP_RES_DAQ_Byte11 : 95|8@0+ (1,0) [0|255] ""  External_Tool
 SG_ STS_XCP_RES_DAQ_Byte12 : 103|8@0+ (1,0) [0|255] ""  External_Tool
 SG_ STS_XCP_RES_DAQ_Byte13 : 111|8@0+ (1,0) [0|255] ""  External_Tool
 SG_ STS_XCP_RES_DAQ_Byte14 : 119|8@0+ (1,0) [0|255] ""  External_Tool
 SG_ STS_XCP_RES_DAQ_Byte15 : 127|8@0+ (1,0) [0|255] ""  External_Tool
 SG_ STS_XCP_RES_DAQ_Byte16 : 135|8@0+ (1,0) [0|255] ""  External_Tool
 SG_ STS_XCP_RES_DAQ_Byte17 : 143|8@0+ (1,0) [0|255] ""  External_Tool
 SG_ STS_XCP_RES_DAQ_Byte18 : 151|8@0+ (1,0) [0|255] ""  External_Tool
 SG_ STS_XCP_RES_DAQ_Byte19 : 159|8@0+ (1,0) [0|255] ""  External_Tool
 SG_ STS_XCP_RES_DAQ_Byte20 : 167|8@0+ (1,0) [0|255] ""  External_Tool
 SG_ STS_XCP_RES_DAQ_Byte21 : 175|8@0+ (1,0) [0|255] ""  External_Tool
 SG_ STS_XCP_RES_DAQ_Byte22 : 183|8@0+ (1,0) [0|255] ""  External_Tool
 SG_ STS_XCP_RES_DAQ_Byte23 : 191|8@0+ (1,0) [0|255] ""  External_Tool
 SG_ STS_XCP_RES_DAQ_Byte24 : 199|8@0+ (1,0) [0|255] ""  External_Tool
 SG_ STS_XCP_RES_DAQ_Byte25 : 207|8@0+ (1,0) [0|255] ""  External_Tool
 SG_ STS_XCP_RES_DAQ_Byte26 : 215|8@0+ (1,0) [0|255] ""  External_Tool
 SG_ STS_XCP_RES_DAQ_Byte27 : 223|8@0+ (1,0) [0|255] ""  External_Tool
 SG_ STS_XCP_RES_DAQ_Byte28 : 231|8@0+ (1,0) [0|255] ""  External_Tool
 SG_ STS_XCP_RES_DAQ_Byte29 : 239|8@0+ (1,0) [0|255] ""  External_Tool
 SG_ STS_XCP_RES_DAQ_Byte30 : 247|8@0+ (1,0) [0|255] ""  External_Tool
 SG_ STS_XCP_RES_DAQ_Byte31 : 255|8@0+ (1,0) [0|255] ""  External_Tool
 SG_ STS_XCP_RES_DAQ_Byte32 : 263|8@0+ (1,0) [0|255] ""  External_Tool
 SG_ STS_XCP_RES_DAQ_Byte33 : 271|8@0+ (1,0) [0|255] ""  External_Tool
 SG_ STS_XCP_RES_DAQ_Byte34 : 279|8@0+ (1,0) [0|255] ""  External_Tool
 SG_ STS_XCP_RES_DAQ_Byte35 : 287|8@0+ (1,0) [0|255] ""  External_Tool
 SG_ STS_XCP_RES_DAQ_Byte36 : 295|8@0+ (1,0) [0|255] ""  External_Tool
 SG_ STS_XCP_RES_DAQ_Byte37 : 303|8@0+ (1,0) [0|255] ""  External_Tool
 SG_ STS_XCP_RES_DAQ_Byte38 : 311|8@0+ (1,0) [0|255] ""  External_Tool
 SG_ STS_XCP_RES_DAQ_Byte39 : 319|8@0+ (1,0) [0|255] ""  External_Tool
 SG_ STS_XCP_RES_DAQ_Byte40 : 327|8@0+ (1,0) [0|255] ""  External_Tool
 SG_ STS_XCP_RES_DAQ_Byte41 : 335|8@0+ (1,0) [0|255] ""  External_Tool
 SG_ STS_XCP_RES_DAQ_Byte42 : 343|8@0+ (1,0) [0|255] ""  External_Tool
 SG_ STS_XCP_RES_DAQ_Byte43 : 351|8@0+ (1,0) [0|255] ""  External_Tool
 SG_ STS_XCP_RES_DAQ_Byte44 : 359|8@0+ (1,0) [0|255] ""  External_Tool
 SG_ STS_XCP_RES_DAQ_Byte45 : 367|8@0+ (1,0) [0|255] ""  External_Tool
 SG_ STS_XCP_RES_DAQ_Byte46 : 375|8@0+ (1,0) [0|255] ""  External_Tool
 SG_ STS_XCP_RES_DAQ_Byte47 : 383|8@0+ (1,0) [0|255] ""  External_Tool
 SG_ STS_XCP_RES_DAQ_Byte48 : 391|8@0+ (1,0) [0|255] ""  External_Tool
 SG_ STS_XCP_RES_DAQ_Byte49 : 399|8@0+ (1,0) [0|255] ""  External_Tool
 SG_ STS_XCP_RES_DAQ_Byte50 : 407|8@0+ (1,0) [0|255] ""  External_Tool
 SG_ STS_XCP_RES_DAQ_Byte51 : 415|8@0+ (1,0) [0|255] ""  External_Tool
 SG_ STS_XCP_RES_DAQ_Byte52 : 423|8@0+ (1,0) [0|255] ""  External_Tool
 SG_ STS_XCP_RES_DAQ_Byte53 : 431|8@0+ (1,0) [0|255] ""  External_Tool
 SG_ STS_XCP_RES_DAQ_Byte54 : 439|8@0+ (1,0) [0|255] ""  External_Tool
 SG_ STS_XCP_RES_DAQ_Byte55 : 447|8@0+ (1,0) [0|255] ""  External_Tool
 SG_ STS_XCP_RES_DAQ_Byte56 : 455|8@0+ (1,0) [0|255] ""  External_Tool
 SG_ STS_XCP_RES_DAQ_Byte57 : 463|8@0+ (1,0) [0|255] ""  External_Tool
 SG_ STS_XCP_RES_DAQ_Byte58 : 471|8@0+ (1,0) [0|255] ""  External_Tool
 SG_ STS_XCP_RES_DAQ_Byte59 : 479|8@0+ (1,0) [0|255] ""  External_Tool
 SG_ STS_XCP_RES_DAQ_Byte60 : 487|8@0+ (1,0) [0|255] ""  External_Tool
 SG_ STS_XCP_RES_DAQ_Byte61 : 495|8@0+ (1,0) [0|255] ""  External_Tool
 SG_ STS_XCP_RES_DAQ_Byte62 : 503|8@0+ (1,0) [0|255] ""  External_Tool
 SG_ STS_XCP_RES_DAQ_Byte63 : 511|8@0+ (1,0) [0|255] ""  External_Tool

BO_ 769 RDR_DETECTION_005_008: 64 RDR05
 SG_ DET_RANGE_005 : 24|15@1+ (0.015625,0) [0|500] "m"  ADAS
 SG_ DET_RANGE_ERR_005 : 40|7@1+ (0.0075,0) [0|0.9525] "m"  ADAS
 SG_ DET_RANGE_VELOCITY_005 : 48|15@1+ (0.0078125,-128) [-128|127.9921875] "m/s"  ADAS
 SG_ DET_RANGE_VELOCITY_ERR_005 : 64|8@1+ (0.003,0) [0|0.765] "m/s"  ADAS
 SG_ DET_AZIMUTH_005 : 88|13@1+ (0.0004,-1.5708) [-1.5708|1.5708] "rad"  ADAS
 SG_ DET_AZIMUTH_ERR_005 : 105|7@1+ (0.00087267,0) [0|0.11082909] "rad"  ADAS
 SG_ DET_ELEVATION_005 : 72|8@1+ (0.00275,-0.34925) [-0.34925|0.34925] "rad"  ADAS
 SG_ DET_ELEVATION_ERR_005 : 80|6@1+ (0.00174533,0) [0|0.10995579] "rad"  ADAS
 SG_ DET_RCS_005 : 128|8@1+ (0.5,-64) [-64|63.5] "dBsm"  ADAS
 SG_ DET_BI_STATIC_FLAG_005 : 104|1@1+ (1,0) [0|1] ""  ADAS
 SG_ DET_SUPER_RES_TARGET_005 : 87|1@1+ (1,0) [0|1] ""  ADAS
 SG_ DET_SNR_005 : 120|8@1+ (0.35156,0) [0|89.6478] "dB"  ADAS
 SG_ DET_EXISTENCE_PROB_005 : 112|6@1+ (1.588,0) [0|100] "%"  ADAS
 SG_ DET_HVC_FLAG_005 : 86|1@1+ (1,0) [0|1] ""  ADAS
 SG_ DET_CONFD_AZIMUTH_005 : 118|2@1+ (1,0) [0|3] ""  ADAS
 SG_ DET_CONFD_ELEVATION_005 : 101|2@1+ (1,0) [0|3] ""  ADAS
 SG_ DET_PROB_1STAZHYPO_005 : 103|1@1+ (1,0) [0|1] ""  ADAS
 SG_ DET_IDM_005 : 63|1@1+ (1,0) [0|1] ""  ADAS
 SG_ DET_MTD_005 : 47|1@1+ (1,0) [0|1] ""  ADAS
 SG_ DET_BELOW_RAIN_THOLD_005 : 39|1@1+ (1,0) [0|1] ""  ADAS
 SG_ DET_RANGE_006 : 136|15@1+ (0.015625,0) [0|500] "m"  ADAS
 SG_ DET_RANGE_ERR_006 : 152|7@1+ (0.0075,0) [0|0.9525] "m"  ADAS
 SG_ DET_RANGE_VELOCITY_006 : 160|15@1+ (0.0078125,-128) [-128|127.9921875] "m/s"  ADAS
 SG_ DET_RANGE_VELOCITY_ERR_006 : 176|8@1+ (0.003,0) [0|0.765] "m/s"  ADAS
 SG_ DET_AZIMUTH_006 : 200|13@1+ (0.0004,-1.5708) [-1.5708|1.5708] "rad"  ADAS
 SG_ DET_AZIMUTH_ERR_006 : 217|7@1+ (0.00087267,0) [0|0.11082909] "rad"  ADAS
 SG_ DET_ELEVATION_006 : 184|8@1+ (0.00275,-0.34925) [-0.34925|0.34925] "rad"  ADAS
 SG_ DET_ELEVATION_ERR_006 : 192|6@1+ (0.00174533,0) [0|0.10995579] "rad"  ADAS
 SG_ DET_RCS_006 : 240|8@1+ (0.5,-64) [-64|63.5] "dBsm"  ADAS
 SG_ DET_BI_STATIC_FLAG_006 : 216|1@1+ (1,0) [0|1] ""  ADAS
 SG_ DET_SUPER_RES_TARGET_006 : 199|1@1+ (1,0) [0|1] ""  ADAS
 SG_ DET_SNR_006 : 232|8@1+ (0.35156,0) [0|89.6478] "dB"  ADAS
 SG_ DET_EXISTENCE_PROB_006 : 224|6@1+ (1.588,0) [0|100] "%"  ADAS
 SG_ DET_HVC_FLAG_006 : 198|1@1+ (1,0) [0|1] ""  ADAS
 SG_ DET_CONFD_AZIMUTH_006 : 230|2@1+ (1,0) [0|3] ""  ADAS
 SG_ DET_CONFD_ELEVATION_006 : 213|2@1+ (1,0) [0|3] ""  ADAS
 SG_ DET_PROB_1STAZHYPO_006 : 215|1@1+ (1,0) [0|1] ""  ADAS
 SG_ DET_IDM_006 : 175|1@1+ (1,0) [0|1] ""  ADAS
 SG_ DET_MTD_006 : 159|1@1+ (1,0) [0|1] ""  ADAS
 SG_ DET_BELOW_RAIN_THOLD_006 : 151|1@1+ (1,0) [0|1] ""  ADAS
 SG_ DET_RANGE_007 : 248|15@1+ (0.015625,0) [0|500] "m"  ADAS
 SG_ DET_RANGE_ERR_007 : 264|7@1+ (0.0075,0) [0|0.9525] "m"  ADAS
 SG_ DET_RANGE_VELOCITY_007 : 272|15@1+ (0.0078125,-128) [-128|127.9921875] "m/s"  ADAS
 SG_ DET_RANGE_VELOCITY_ERR_007 : 288|8@1+ (0.003,0) [0|0.765] "m/s"  ADAS
 SG_ DET_AZIMUTH_007 : 312|13@1+ (0.0004,-1.5708) [-1.5708|1.5708] "rad"  ADAS
 SG_ DET_AZIMUTH_ERR_007 : 329|7@1+ (0.00087267,0) [0|0.11082909] "rad"  ADAS
 SG_ DET_ELEVATION_007 : 296|8@1+ (0.00275,-0.34925) [-0.34925|0.34925] "rad"  ADAS
 SG_ DET_ELEVATION_ERR_007 : 304|6@1+ (0.00174533,0) [0|0.10995579] "rad"  ADAS
 SG_ DET_RCS_007 : 352|8@1+ (0.5,-64) [-64|63.5] "dBsm"  ADAS
 SG_ DET_BI_STATIC_FLAG_007 : 328|1@1+ (1,0) [0|1] ""  ADAS
 SG_ DET_SUPER_RES_TARGET_007 : 311|1@1+ (1,0) [0|1] ""  ADAS
 SG_ DET_SNR_007 : 344|8@1+ (0.35156,0) [0|89.6478] "dB"  ADAS
 SG_ DET_EXISTENCE_PROB_007 : 336|6@1+ (1.588,0) [0|100] "%"  ADAS
 SG_ DET_HVC_FLAG_007 : 310|1@1+ (1,0) [0|1] ""  ADAS
 SG_ DET_CONFD_AZIMUTH_007 : 342|2@1+ (1,0) [0|3] ""  ADAS
 SG_ DET_CONFD_ELEVATION_007 : 325|2@1+ (1,0) [0|3] ""  ADAS
 SG_ DET_PROB_1STAZHYPO_007 : 327|1@1+ (1,0) [0|1] ""  ADAS
 SG_ DET_IDM_007 : 287|1@1+ (1,0) [0|1] ""  ADAS
 SG_ DET_MTD_007 : 271|1@1+ (1,0) [0|1] ""  ADAS
 SG_ DET_BELOW_RAIN_THOLD_007 : 263|1@1+ (1,0) [0|1] ""  ADAS
 SG_ DET_RANGE_008 : 360|15@1+ (0.015625,0) [0|500] "m"  ADAS
 SG_ DET_RANGE_ERR_008 : 376|7@1+ (0.0075,0) [0|0.9525] "m"  ADAS
 SG_ DET_RANGE_VELOCITY_008 : 384|15@1+ (0.0078125,-128) [-128|127.9921875] "m/s"  ADAS
 SG_ DET_RANGE_VELOCITY_ERR_008 : 400|8@1+ (0.003,0) [0|0.765] "m/s"  ADAS
 SG_ DET_AZIMUTH_008 : 424|13@1+ (0.0004,-1.5708) [-1.5708|1.5708] "rad"  ADAS
 SG_ DET_AZIMUTH_ERR_008 : 441|7@1+ (0.00087267,0) [0|0.11082909] "rad"  ADAS
 SG_ DET_ELEVATION_008 : 408|8@1+ (0.00275,-0.34925) [-0.34925|0.34925] "rad"  ADAS
 SG_ DET_ELEVATION_ERR_008 : 416|6@1+ (0.00174533,0) [0|0.10995579] "rad"  ADAS
 SG_ DET_RCS_008 : 464|8@1+ (0.5,-64) [-64|63.5] "dBsm"  ADAS
 SG_ DET_BI_STATIC_FLAG_008 : 440|1@1+ (1,0) [0|1] ""  ADAS
 SG_ DET_SUPER_RES_TARGET_008 : 423|1@1+ (1,0) [0|1] ""  ADAS
 SG_ DET_SNR_008 : 456|8@1+ (0.35156,0) [0|89.6478] "dB"  ADAS
 SG_ DET_EXISTENCE_PROB_008 : 448|6@1+ (1.588,0) [0|100] "%"  ADAS
 SG_ DET_HVC_FLAG_008 : 422|1@1+ (1,0) [0|1] ""  ADAS
 SG_ DET_CONFD_AZIMUTH_008 : 454|2@1+ (1,0) [0|3] ""  ADAS
 SG_ DET_CONFD_ELEVATION_008 : 437|2@1+ (1,0) [0|3] ""  ADAS
 SG_ DET_MH_SCAN_INDEX_4LSB_005_008 : 476|4@1+ (1,0) [0|15] ""  ADAS
 SG_ DET_MH_CYCLE_COUNTER_005_008 : 16|8@1+ (1,0) [0|255] ""  ADAS
 SG_ DET_MH_CRC16_005_008 : 0|16@1+ (1,0) [0|65535] ""  ADAS
 SG_ DET_PROB_1STAZHYPO_008 : 439|1@1+ (1,0) [0|1] ""  ADAS
 SG_ DET_IDM_008 : 399|1@1+ (1,0) [0|1] ""  ADAS
 SG_ DET_MTD_008 : 383|1@1+ (1,0) [0|1] ""  ADAS
 SG_ DET_BELOW_RAIN_THOLD_008 : 375|1@1+ (1,0) [0|1] ""  ADAS

BO_ 770 RDR_DETECTION_009_012: 64 RDR05
 SG_ DET_RANGE_009 : 24|15@1+ (0.015625,0) [0|500] "m"  ADAS
 SG_ DET_RANGE_ERR_009 : 40|7@1+ (0.0075,0) [0|0.9525] "m"  ADAS
 SG_ DET_RANGE_VELOCITY_009 : 48|15@1+ (0.0078125,-128) [-128|127.9921875] "m/s"  ADAS
 SG_ DET_RANGE_VELOCITY_ERR_009 : 64|8@1+ (0.003,0) [0|0.765] "m/s"  ADAS
 SG_ DET_AZIMUTH_009 : 88|13@1+ (0.0004,-1.5708) [-1.5708|1.5708] "rad"  ADAS
 SG_ DET_AZIMUTH_ERR_009 : 105|7@1+ (0.00087267,0) [0|0.11082909] "rad"  ADAS
 SG_ DET_ELEVATION_009 : 72|8@1+ (0.00275,-0.34925) [-0.34925|0.34925] "rad"  ADAS
 SG_ DET_ELEVATION_ERR_009 : 80|6@1+ (0.00174533,0) [0|0.10995579] "rad"  ADAS
 SG_ DET_RCS_009 : 128|8@1+ (0.5,-64) [-64|63.5] "dBsm"  ADAS
 SG_ DET_BI_STATIC_FLAG_009 : 104|1@1+ (1,0) [0|1] ""  ADAS
 SG_ DET_SUPER_RES_TARGET_009 : 87|1@1+ (1,0) [0|1] ""  ADAS
 SG_ DET_SNR_009 : 120|8@1+ (0.35156,0) [0|89.6478] "dB"  ADAS
 SG_ DET_EXISTENCE_PROB_009 : 112|6@1+ (1.588,0) [0|100] "%"  ADAS
 SG_ DET_HVC_FLAG_009 : 86|1@1+ (1,0) [0|1] ""  ADAS
 SG_ DET_CONFD_AZIMUTH_009 : 118|2@1+ (1,0) [0|3] ""  ADAS
 SG_ DET_CONFD_ELEVATION_009 : 101|2@1+ (1,0) [0|3] ""  ADAS
 SG_ DET_PROB_1STAZHYPO_009 : 103|1@1+ (1,0) [0|1] ""  ADAS
 SG_ DET_IDM_009 : 63|1@1+ (1,0) [0|1] ""  ADAS
 SG_ DET_MTD_009 : 47|1@1+ (1,0) [0|1] ""  ADAS
 SG_ DET_BELOW_RAIN_THOLD_009 : 39|1@1+ (1,0) [0|1] ""  ADAS
 SG_ DET_RANGE_010 : 136|15@1+ (0.015625,0) [0|500] "m"  ADAS
 SG_ DET_RANGE_ERR_010 : 152|7@1+ (0.0075,0) [0|0.9525] "m"  ADAS
 SG_ DET_RANGE_VELOCITY_010 : 160|15@1+ (0.0078125,-128) [-128|127.9921875] "m/s"  ADAS
 SG_ DET_RANGE_VELOCITY_ERR_010 : 176|8@1+ (0.003,0) [0|0.765] "m/s"  ADAS
 SG_ DET_AZIMUTH_010 : 200|13@1+ (0.0004,-1.5708) [-1.5708|1.5708] "rad"  ADAS
 SG_ DET_AZIMUTH_ERR_010 : 217|7@1+ (0.00087267,0) [0|0.11082909] "rad"  ADAS
 SG_ DET_ELEVATION_010 : 184|8@1+ (0.00275,-0.34925) [-0.34925|0.34925] "rad"  ADAS
 SG_ DET_ELEVATION_ERR_010 : 192|6@1+ (0.00174533,0) [0|0.10995579] "rad"  ADAS
 SG_ DET_RCS_010 : 240|8@1+ (0.5,-64) [-64|63.5] "dBsm"  ADAS
 SG_ DET_BI_STATIC_FLAG_010 : 216|1@1+ (1,0) [0|1] ""  ADAS
 SG_ DET_SUPER_RES_TARGET_010 : 199|1@1+ (1,0) [0|1] ""  ADAS
 SG_ DET_SNR_010 : 232|8@1+ (0.35156,0) [0|89.6478] "dB"  ADAS
 SG_ DET_EXISTENCE_PROB_010 : 224|6@1+ (1.588,0) [0|100] "%"  ADAS
 SG_ DET_HVC_FLAG_010 : 198|1@1+ (1,0) [0|1] ""  ADAS
 SG_ DET_CONFD_AZIMUTH_010 : 230|2@1+ (1,0) [0|3] ""  ADAS
 SG_ DET_CONFD_ELEVATION_010 : 213|2@1+ (1,0) [0|3] ""  ADAS
 SG_ DET_PROB_1STAZHYPO_010 : 215|1@1+ (1,0) [0|1] ""  ADAS
 SG_ DET_IDM_010 : 175|1@1+ (1,0) [0|1] ""  ADAS
 SG_ DET_MTD_010 : 159|1@1+ (1,0) [0|1] ""  ADAS
 SG_ DET_BELOW_RAIN_THOLD_010 : 151|1@1+ (1,0) [0|1] ""  ADAS
 SG_ DET_RANGE_011 : 248|15@1+ (0.015625,0) [0|500] "m"  ADAS
 SG_ DET_RANGE_ERR_011 : 264|7@1+ (0.0075,0) [0|0.9525] "m"  ADAS
 SG_ DET_RANGE_VELOCITY_011 : 272|15@1+ (0.0078125,-128) [-128|127.9921875] "m/s"  ADAS
 SG_ DET_RANGE_VELOCITY_ERR_011 : 288|8@1+ (0.003,0) [0|0.765] "m/s"  ADAS
 SG_ DET_AZIMUTH_011 : 312|13@1+ (0.0004,-1.5708) [-1.5708|1.5708] "rad"  ADAS
 SG_ DET_AZIMUTH_ERR_011 : 329|7@1+ (0.00087267,0) [0|0.11082909] "rad"  ADAS
 SG_ DET_ELEVATION_011 : 296|8@1+ (0.00275,-0.34925) [-0.34925|0.34925] "rad"  ADAS
 SG_ DET_ELEVATION_ERR_011 : 304|6@1+ (0.00174533,0) [0|0.10995579] "rad"  ADAS
 SG_ DET_RCS_011 : 352|8@1+ (0.5,-64) [-64|63.5] "dBsm"  ADAS
 SG_ DET_BI_STATIC_FLAG_011 : 328|1@1+ (1,0) [0|1] ""  ADAS
 SG_ DET_SUPER_RES_TARGET_011 : 311|1@1+ (1,0) [0|1] ""  ADAS
 SG_ DET_SNR_011 : 344|8@1+ (0.35156,0) [0|89.6478] "dB"  ADAS
 SG_ DET_EXISTENCE_PROB_011 : 336|6@1+ (1.588,0) [0|100] "%"  ADAS
 SG_ DET_HVC_FLAG_011 : 310|1@1+ (1,0) [0|1] ""  ADAS
 SG_ DET_CONFD_AZIMUTH_011 : 342|2@1+ (1,0) [0|3] ""  ADAS
 SG_ DET_CONFD_ELEVATION_011 : 325|2@1+ (1,0) [0|3] ""  ADAS
 SG_ DET_PROB_1STAZHYPO_011 : 327|1@1+ (1,0) [0|1] ""  ADAS
 SG_ DET_IDM_011 : 287|1@1+ (1,0) [0|1] ""  ADAS
 SG_ DET_MTD_011 : 271|1@1+ (1,0) [0|1] ""  ADAS
 SG_ DET_BELOW_RAIN_THOLD_011 : 263|1@1+ (1,0) [0|1] ""  ADAS
 SG_ DET_RANGE_012 : 360|15@1+ (0.015625,0) [0|500] "m"  ADAS
 SG_ DET_RANGE_ERR_012 : 376|7@1+ (0.0075,0) [0|0.9525] "m"  ADAS
 SG_ DET_RANGE_VELOCITY_012 : 384|15@1+ (0.0078125,-128) [-128|127.9921875] "m/s"  ADAS
 SG_ DET_RANGE_VELOCITY_ERR_012 : 400|8@1+ (0.003,0) [0|0.765] "m/s"  ADAS
 SG_ DET_AZIMUTH_012 : 424|13@1+ (0.0004,-1.5708) [-1.5708|1.5708] "rad"  ADAS
 SG_ DET_AZIMUTH_ERR_012 : 441|7@1+ (0.00087267,0) [0|0.11082909] "rad"  ADAS
 SG_ DET_ELEVATION_012 : 408|8@1+ (0.00275,-0.34925) [-0.34925|0.34925] "rad"  ADAS
 SG_ DET_ELEVATION_ERR_012 : 416|6@1+ (0.00174533,0) [0|0.10995579] "rad"  ADAS
 SG_ DET_RCS_012 : 464|8@1+ (0.5,-64) [-64|63.5] "dBsm"  ADAS
 SG_ DET_BI_STATIC_FLAG_012 : 440|1@1+ (1,0) [0|1] ""  ADAS
 SG_ DET_SUPER_RES_TARGET_012 : 423|1@1+ (1,0) [0|1] ""  ADAS
 SG_ DET_SNR_012 : 456|8@1+ (0.35156,0) [0|89.6478] "dB"  ADAS
 SG_ DET_EXISTENCE_PROB_012 : 448|6@1+ (1.588,0) [0|100] "%"  ADAS
 SG_ DET_HVC_FLAG_012 : 422|1@1+ (1,0) [0|1] ""  ADAS
 SG_ DET_CONFD_AZIMUTH_012 : 454|2@1+ (1,0) [0|3] ""  ADAS
 SG_ DET_CONFD_ELEVATION_012 : 437|2@1+ (1,0) [0|3] ""  ADAS
 SG_ DET_MH_SCAN_INDEX_4LSB_009_012 : 476|4@1+ (1,0) [0|15] ""  ADAS
 SG_ DET_MH_CYCLE_COUNTER_009_012 : 16|8@1+ (1,0) [0|255] ""  ADAS
 SG_ DET_MH_CRC16_009_012 : 0|16@1+ (1,0) [0|65535] ""  ADAS
 SG_ DET_PROB_1STAZHYPO_012 : 439|1@1+ (1,0) [0|1] ""  ADAS
 SG_ DET_IDM_012 : 399|1@1+ (1,0) [0|1] ""  ADAS
 SG_ DET_MTD_012 : 383|1@1+ (1,0) [0|1] ""  ADAS
 SG_ DET_BELOW_RAIN_THOLD_012 : 375|1@1+ (1,0) [0|1] ""  ADAS

BO_ 771 RDR_DETECTION_013_016: 64 RDR05
 SG_ DET_RANGE_013 : 24|15@1+ (0.015625,0) [0|500] "m"  ADAS
 SG_ DET_RANGE_ERR_013 : 40|7@1+ (0.0075,0) [0|0.9525] "m"  ADAS
 SG_ DET_RANGE_VELOCITY_013 : 48|15@1+ (0.0078125,-128) [-128|127.9921875] "m/s"  ADAS
 SG_ DET_RANGE_VELOCITY_ERR_013 : 64|8@1+ (0.003,0) [0|0.765] "m/s"  ADAS
 SG_ DET_AZIMUTH_013 : 88|13@1+ (0.0004,-1.5708) [-1.5708|1.5708] "rad"  ADAS
 SG_ DET_AZIMUTH_ERR_013 : 105|7@1+ (0.00087267,0) [0|0.11082909] "rad"  ADAS
 SG_ DET_ELEVATION_013 : 72|8@1+ (0.00275,-0.34925) [-0.34925|0.34925] "rad"  ADAS
 SG_ DET_ELEVATION_ERR_013 : 80|6@1+ (0.00174533,0) [0|0.10995579] "rad"  ADAS
 SG_ DET_RCS_013 : 128|8@1+ (0.5,-64) [-64|63.5] "dBsm"  ADAS
 SG_ DET_BI_STATIC_FLAG_013 : 104|1@1+ (1,0) [0|1] ""  ADAS
 SG_ DET_SUPER_RES_TARGET_013 : 87|1@1+ (1,0) [0|1] ""  ADAS
 SG_ DET_SNR_013 : 120|8@1+ (0.35156,0) [0|89.6478] "dB"  ADAS
 SG_ DET_EXISTENCE_PROB_013 : 112|6@1+ (1.588,0) [0|100] "%"  ADAS
 SG_ DET_HVC_FLAG_013 : 86|1@1+ (1,0) [0|1] ""  ADAS
 SG_ DET_CONFD_AZIMUTH_013 : 118|2@1+ (1,0) [0|3] ""  ADAS
 SG_ DET_CONFD_ELEVATION_013 : 101|2@1+ (1,0) [0|3] ""  ADAS
 SG_ DET_PROB_1STAZHYPO_013 : 103|1@1+ (1,0) [0|1] ""  ADAS
 SG_ DET_IDM_013 : 63|1@1+ (1,0) [0|1] ""  ADAS
 SG_ DET_MTD_013 : 47|1@1+ (1,0) [0|1] ""  ADAS
 SG_ DET_BELOW_RAIN_THOLD_013 : 39|1@1+ (1,0) [0|1] ""  ADAS
 SG_ DET_RANGE_014 : 136|15@1+ (0.015625,0) [0|500] "m"  ADAS
 SG_ DET_RANGE_ERR_014 : 152|7@1+ (0.0075,0) [0|0.9525] "m"  ADAS
 SG_ DET_RANGE_VELOCITY_014 : 160|15@1+ (0.0078125,-128) [-128|127.9921875] "m/s"  ADAS
 SG_ DET_RANGE_VELOCITY_ERR_014 : 176|8@1+ (0.003,0) [0|0.765] "m/s"  ADAS
 SG_ DET_AZIMUTH_014 : 200|13@1+ (0.0004,-1.5708) [-1.5708|1.5708] "rad"  ADAS
 SG_ DET_AZIMUTH_ERR_014 : 217|7@1+ (0.00087267,0) [0|0.11082909] "rad"  ADAS
 SG_ DET_ELEVATION_014 : 184|8@1+ (0.00275,-0.34925) [-0.34925|0.34925] "rad"  ADAS
 SG_ DET_ELEVATION_ERR_014 : 192|6@1+ (0.00174533,0) [0|0.10995579] "rad"  ADAS
 SG_ DET_RCS_014 : 240|8@1+ (0.5,-64) [-64|63.5] "dBsm"  ADAS
 SG_ DET_BI_STATIC_FLAG_014 : 216|1@1+ (1,0) [0|1] ""  ADAS
 SG_ DET_SUPER_RES_TARGET_014 : 199|1@1+ (1,0) [0|1] ""  ADAS
 SG_ DET_SNR_014 : 232|8@1+ (0.35156,0) [0|89.6478] "dB"  ADAS
 SG_ DET_EXISTENCE_PROB_014 : 224|6@1+ (1.588,0) [0|100] "%"  ADAS
 SG_ DET_HVC_FLAG_014 : 198|1@1+ (1,0) [0|1] ""  ADAS
 SG_ DET_CONFD_AZIMUTH_014 : 230|2@1+ (1,0) [0|3] ""  ADAS
 SG_ DET_CONFD_ELEVATION_014 : 213|2@1+ (1,0) [0|3] ""  ADAS
 SG_ DET_PROB_1STAZHYPO_014 : 215|1@1+ (1,0) [0|1] ""  ADAS
 SG_ DET_IDM_014 : 175|1@1+ (1,0) [0|1] ""  ADAS
 SG_ DET_MTD_014 : 159|1@1+ (1,0) [0|1] ""  ADAS
 SG_ DET_BELOW_RAIN_THOLD_014 : 151|1@1+ (1,0) [0|1] ""  ADAS
 SG_ DET_RANGE_015 : 248|15@1+ (0.015625,0) [0|500] "m"  ADAS
 SG_ DET_RANGE_ERR_015 : 264|7@1+ (0.0075,0) [0|0.9525] "m"  ADAS
 SG_ DET_RANGE_VELOCITY_015 : 272|15@1+ (0.0078125,-128) [-128|127.9921875] "m/s"  ADAS
 SG_ DET_RANGE_VELOCITY_ERR_015 : 288|8@1+ (0.003,0) [0|0.765] "m/s"  ADAS
 SG_ DET_AZIMUTH_015 : 312|13@1+ (0.0004,-1.5708) [-1.5708|1.5708] "rad"  ADAS
 SG_ DET_AZIMUTH_ERR_015 : 329|7@1+ (0.00087267,0) [0|0.11082909] "rad"  ADAS
 SG_ DET_ELEVATION_015 : 296|8@1+ (0.00275,-0.34925) [-0.34925|0.34925] "rad"  ADAS
 SG_ DET_ELEVATION_ERR_015 : 304|6@1+ (0.00174533,0) [0|0.10995579] "rad"  ADAS
 SG_ DET_RCS_015 : 352|8@1+ (0.5,-64) [-64|63.5] "dBsm"  ADAS
 SG_ DET_BI_STATIC_FLAG_015 : 328|1@1+ (1,0) [0|1] ""  ADAS
 SG_ DET_SUPER_RES_TARGET_015 : 311|1@1+ (1,0) [0|1] ""  ADAS
 SG_ DET_SNR_015 : 344|8@1+ (0.35156,0) [0|89.6478] "dB"  ADAS
 SG_ DET_EXISTENCE_PROB_015 : 336|6@1+ (1.588,0) [0|100] "%"  ADAS
 SG_ DET_HVC_FLAG_015 : 310|1@1+ (1,0) [0|1] ""  ADAS
 SG_ DET_CONFD_AZIMUTH_015 : 342|2@1+ (1,0) [0|3] ""  ADAS
 SG_ DET_CONFD_ELEVATION_015 : 325|2@1+ (1,0) [0|3] ""  ADAS
 SG_ DET_PROB_1STAZHYPO_015 : 327|1@1+ (1,0) [0|1] ""  ADAS
 SG_ DET_IDM_015 : 287|1@1+ (1,0) [0|1] ""  ADAS
 SG_ DET_MTD_015 : 271|1@1+ (1,0) [0|1] ""  ADAS
 SG_ DET_BELOW_RAIN_THOLD_015 : 263|1@1+ (1,0) [0|1] ""  ADAS
 SG_ DET_RANGE_016 : 360|15@1+ (0.015625,0) [0|500] "m"  ADAS
 SG_ DET_RANGE_ERR_016 : 376|7@1+ (0.0075,0) [0|0.9525] "m"  ADAS
 SG_ DET_RANGE_VELOCITY_016 : 384|15@1+ (0.0078125,-128) [-128|127.9921875] "m/s"  ADAS
 SG_ DET_RANGE_VELOCITY_ERR_016 : 400|8@1+ (0.003,0) [0|0.765] "m/s"  ADAS
 SG_ DET_AZIMUTH_016 : 424|13@1+ (0.0004,-1.5708) [-1.5708|1.5708] "rad"  ADAS
 SG_ DET_AZIMUTH_ERR_016 : 441|7@1+ (0.00087267,0) [0|0.11082909] "rad"  ADAS
 SG_ DET_ELEVATION_016 : 408|8@1+ (0.00275,-0.34925) [-0.34925|0.34925] "rad"  ADAS
 SG_ DET_ELEVATION_ERR_016 : 416|6@1+ (0.00174533,0) [0|0.10995579] "rad"  ADAS
 SG_ DET_RCS_016 : 464|8@1+ (0.5,-64) [-64|63.5] "dBsm"  ADAS
 SG_ DET_BI_STATIC_FLAG_016 : 440|1@1+ (1,0) [0|1] ""  ADAS
 SG_ DET_SUPER_RES_TARGET_016 : 423|1@1+ (1,0) [0|1] ""  ADAS
 SG_ DET_SNR_016 : 456|8@1+ (0.35156,0) [0|89.6478] "dB"  ADAS
 SG_ DET_EXISTENCE_PROB_016 : 448|6@1+ (1.588,0) [0|100] "%"  ADAS
 SG_ DET_HVC_FLAG_016 : 422|1@1+ (1,0) [0|1] ""  ADAS
 SG_ DET_CONFD_AZIMUTH_016 : 454|2@1+ (1,0) [0|3] ""  ADAS
 SG_ DET_CONFD_ELEVATION_016 : 437|2@1+ (1,0) [0|3] ""  ADAS
 SG_ DET_MH_SCAN_INDEX_4LSB_013_016 : 476|4@1+ (1,0) [0|15] ""  ADAS
 SG_ DET_MH_CYCLE_COUNTER_013_016 : 16|8@1+ (1,0) [0|255] ""  ADAS
 SG_ DET_MH_CRC16_013_016 : 0|16@1+ (1,0) [0|65535] ""  ADAS
 SG_ DET_PROB_1STAZHYPO_016 : 439|1@1+ (1,0) [0|1] ""  ADAS
 SG_ DET_IDM_016 : 399|1@1+ (1,0) [0|1] ""  ADAS
 SG_ DET_MTD_016 : 383|1@1+ (1,0) [0|1] ""  ADAS
 SG_ DET_BELOW_RAIN_THOLD_016 : 375|1@1+ (1,0) [0|1] ""  ADAS

BO_ 772 RDR_DETECTION_017_020: 64 RDR05
 SG_ DET_RANGE_017 : 24|15@1+ (0.015625,0) [0|500] "m"  ADAS
 SG_ DET_RANGE_ERR_017 : 40|7@1+ (0.0075,0) [0|0.9525] "m"  ADAS
 SG_ DET_RANGE_VELOCITY_017 : 48|15@1+ (0.0078125,-128) [-128|127.9921875] "m/s"  ADAS
 SG_ DET_RANGE_VELOCITY_ERR_017 : 64|8@1+ (0.003,0) [0|0.765] "m/s"  ADAS
 SG_ DET_AZIMUTH_017 : 88|13@1+ (0.0004,-1.5708) [-1.5708|1.5708] "rad"  ADAS
 SG_ DET_AZIMUTH_ERR_017 : 105|7@1+ (0.00087267,0) [0|0.11082909] "rad"  ADAS
 SG_ DET_ELEVATION_017 : 72|8@1+ (0.00275,-0.34925) [-0.34925|0.34925] "rad"  ADAS
 SG_ DET_ELEVATION_ERR_017 : 80|6@1+ (0.00174533,0) [0|0.10995579] "rad"  ADAS
 SG_ DET_RCS_017 : 128|8@1+ (0.5,-64) [-64|63.5] "dBsm"  ADAS
 SG_ DET_BI_STATIC_FLAG_017 : 104|1@1+ (1,0) [0|1] ""  ADAS
 SG_ DET_SUPER_RES_TARGET_017 : 87|1@1+ (1,0) [0|1] ""  ADAS
 SG_ DET_SNR_017 : 120|8@1+ (0.35156,0) [0|89.6478] "dB"  ADAS
 SG_ DET_EXISTENCE_PROB_017 : 112|6@1+ (1.588,0) [0|100] "%"  ADAS
 SG_ DET_HVC_FLAG_017 : 86|1@1+ (1,0) [0|1] ""  ADAS
 SG_ DET_CONFD_AZIMUTH_017 : 118|2@1+ (1,0) [0|3] ""  ADAS
 SG_ DET_CONFD_ELEVATION_017 : 101|2@1+ (1,0) [0|3] ""  ADAS
 SG_ DET_PROB_1STAZHYPO_017 : 103|1@1+ (1,0) [0|1] ""  ADAS
 SG_ DET_IDM_017 : 63|1@1+ (1,0) [0|1] ""  ADAS
 SG_ DET_MTD_017 : 47|1@1+ (1,0) [0|1] ""  ADAS
 SG_ DET_BELOW_RAIN_THOLD_017 : 39|1@1+ (1,0) [0|1] ""  ADAS
 SG_ DET_RANGE_018 : 136|15@1+ (0.015625,0) [0|500] "m"  ADAS
 SG_ DET_RANGE_ERR_018 : 152|7@1+ (0.0075,0) [0|0.9525] "m"  ADAS
 SG_ DET_RANGE_VELOCITY_018 : 160|15@1+ (0.0078125,-128) [-128|127.9921875] "m/s"  ADAS
 SG_ DET_RANGE_VELOCITY_ERR_018 : 176|8@1+ (0.003,0) [0|0.765] "m/s"  ADAS
 SG_ DET_AZIMUTH_018 : 200|13@1+ (0.0004,-1.5708) [-1.5708|1.5708] "rad"  ADAS
 SG_ DET_AZIMUTH_ERR_018 : 217|7@1+ (0.00087267,0) [0|0.11082909] "rad"  ADAS
 SG_ DET_ELEVATION_018 : 184|8@1+ (0.00275,-0.34925) [-0.34925|0.34925] "rad"  ADAS
 SG_ DET_ELEVATION_ERR_018 : 192|6@1+ (0.00174533,0) [0|0.10995579] "rad"  ADAS
 SG_ DET_RCS_018 : 240|8@1+ (0.5,-64) [-64|63.5] "dBsm"  ADAS
 SG_ DET_BI_STATIC_FLAG_018 : 216|1@1+ (1,0) [0|1] ""  ADAS
 SG_ DET_SUPER_RES_TARGET_018 : 199|1@1+ (1,0) [0|1] ""  ADAS
 SG_ DET_SNR_018 : 232|8@1+ (0.35156,0) [0|89.6478] "dB"  ADAS
 SG_ DET_EXISTENCE_PROB_018 : 224|6@1+ (1.588,0) [0|100] "%"  ADAS
 SG_ DET_HVC_FLAG_018 : 198|1@1+ (1,0) [0|1] ""  ADAS
 SG_ DET_CONFD_AZIMUTH_018 : 230|2@1+ (1,0) [0|3] ""  ADAS
 SG_ DET_CONFD_ELEVATION_018 : 213|2@1+ (1,0) [0|3] ""  ADAS
 SG_ DET_PROB_1STAZHYPO_018 : 215|1@1+ (1,0) [0|1] ""  ADAS
 SG_ DET_IDM_018 : 175|1@1+ (1,0) [0|1] ""  ADAS
 SG_ DET_MTD_018 : 159|1@1+ (1,0) [0|1] ""  ADAS
 SG_ DET_BELOW_RAIN_THOLD_018 : 151|1@1+ (1,0) [0|1] ""  ADAS
 SG_ DET_RANGE_019 : 248|15@1+ (0.015625,0) [0|500] "m"  ADAS
 SG_ DET_RANGE_ERR_019 : 264|7@1+ (0.0075,0) [0|0.9525] "m"  ADAS
 SG_ DET_RANGE_VELOCITY_019 : 272|15@1+ (0.0078125,-128) [-128|127.9921875] "m/s"  ADAS
 SG_ DET_RANGE_VELOCITY_ERR_019 : 288|8@1+ (0.003,0) [0|0.765] "m/s"  ADAS
 SG_ DET_AZIMUTH_019 : 312|13@1+ (0.0004,-1.5708) [-1.5708|1.5708] "rad"  ADAS
 SG_ DET_AZIMUTH_ERR_019 : 329|7@1+ (0.00087267,0) [0|0.11082909] "rad"  ADAS
 SG_ DET_ELEVATION_019 : 296|8@1+ (0.00275,-0.34925) [-0.34925|0.34925] "rad"  ADAS
 SG_ DET_ELEVATION_ERR_019 : 304|6@1+ (0.00174533,0) [0|0.10995579] "rad"  ADAS
 SG_ DET_RCS_019 : 352|8@1+ (0.5,-64) [-64|63.5] "dBsm"  ADAS
 SG_ DET_BI_STATIC_FLAG_019 : 328|1@1+ (1,0) [0|1] ""  ADAS
 SG_ DET_SUPER_RES_TARGET_019 : 311|1@1+ (1,0) [0|1] ""  ADAS
 SG_ DET_SNR_019 : 344|8@1+ (0.35156,0) [0|89.6478] "dB"  ADAS
 SG_ DET_EXISTENCE_PROB_019 : 336|6@1+ (1.588,0) [0|100] "%"  ADAS
 SG_ DET_HVC_FLAG_019 : 310|1@1+ (1,0) [0|1] ""  ADAS
 SG_ DET_CONFD_AZIMUTH_019 : 342|2@1+ (1,0) [0|3] ""  ADAS
 SG_ DET_CONFD_ELEVATION_019 : 325|2@1+ (1,0) [0|3] ""  ADAS
 SG_ DET_PROB_1STAZHYPO_019 : 327|1@1+ (1,0) [0|1] ""  ADAS
 SG_ DET_IDM_019 : 287|1@1+ (1,0) [0|1] ""  ADAS
 SG_ DET_MTD_019 : 271|1@1+ (1,0) [0|1] ""  ADAS
 SG_ DET_BELOW_RAIN_THOLD_019 : 263|1@1+ (1,0) [0|1] ""  ADAS
 SG_ DET_RANGE_020 : 360|15@1+ (0.015625,0) [0|500] "m"  ADAS
 SG_ DET_RANGE_ERR_020 : 376|7@1+ (0.0075,0) [0|0.9525] "m"  ADAS
 SG_ DET_RANGE_VELOCITY_020 : 384|15@1+ (0.0078125,-128) [-128|127.9921875] "m/s"  ADAS
 SG_ DET_RANGE_VELOCITY_ERR_020 : 400|8@1+ (0.003,0) [0|0.765] "m/s"  ADAS
 SG_ DET_AZIMUTH_020 : 424|13@1+ (0.0004,-1.5708) [-1.5708|1.5708] "rad"  ADAS
 SG_ DET_AZIMUTH_ERR_020 : 441|7@1+ (0.00087267,0) [0|0.11082909] "rad"  ADAS
 SG_ DET_ELEVATION_020 : 408|8@1+ (0.00275,-0.34925) [-0.34925|0.34925] "rad"  ADAS
 SG_ DET_ELEVATION_ERR_020 : 416|6@1+ (0.00174533,0) [0|0.10995579] "rad"  ADAS
 SG_ DET_RCS_020 : 464|8@1+ (0.5,-64) [-64|63.5] "dBsm"  ADAS
 SG_ DET_BI_STATIC_FLAG_020 : 440|1@1+ (1,0) [0|1] ""  ADAS
 SG_ DET_SUPER_RES_TARGET_020 : 423|1@1+ (1,0) [0|1] ""  ADAS
 SG_ DET_SNR_020 : 456|8@1+ (0.35156,0) [0|89.6478] "dB"  ADAS
 SG_ DET_EXISTENCE_PROB_020 : 448|6@1+ (1.588,0) [0|100] "%"  ADAS
 SG_ DET_HVC_FLAG_020 : 422|1@1+ (1,0) [0|1] ""  ADAS
 SG_ DET_CONFD_AZIMUTH_020 : 454|2@1+ (1,0) [0|3] ""  ADAS
 SG_ DET_CONFD_ELEVATION_020 : 437|2@1+ (1,0) [0|3] ""  ADAS
 SG_ DET_MH_SCAN_INDEX_4LSB_017_020 : 476|4@1+ (1,0) [0|15] ""  ADAS
 SG_ DET_MH_CYCLE_COUNTER_017_020 : 16|8@1+ (1,0) [0|255] ""  ADAS
 SG_ DET_MH_CRC16_017_020 : 0|16@1+ (1,0) [0|65535] ""  ADAS
 SG_ DET_PROB_1STAZHYPO_020 : 439|1@1+ (1,0) [0|1] ""  ADAS
 SG_ DET_IDM_020 : 399|1@1+ (1,0) [0|1] ""  ADAS
 SG_ DET_MTD_020 : 383|1@1+ (1,0) [0|1] ""  ADAS
 SG_ DET_BELOW_RAIN_THOLD_020 : 375|1@1+ (1,0) [0|1] ""  ADAS

BO_ 773 RDR_DETECTION_021_024: 64 RDR05
 SG_ DET_RANGE_021 : 24|15@1+ (0.015625,0) [0|500] "m"  ADAS
 SG_ DET_RANGE_ERR_021 : 40|7@1+ (0.0075,0) [0|0.9525] "m"  ADAS
 SG_ DET_RANGE_VELOCITY_021 : 48|15@1+ (0.0078125,-128) [-128|127.9921875] "m/s"  ADAS
 SG_ DET_RANGE_VELOCITY_ERR_021 : 64|8@1+ (0.003,0) [0|0.765] "m/s"  ADAS
 SG_ DET_AZIMUTH_021 : 88|13@1+ (0.0004,-1.5708) [-1.5708|1.5708] "rad"  ADAS
 SG_ DET_AZIMUTH_ERR_021 : 105|7@1+ (0.00087267,0) [0|0.11082909] "rad"  ADAS
 SG_ DET_ELEVATION_021 : 72|8@1+ (0.00275,-0.34925) [-0.34925|0.34925] "rad"  ADAS
 SG_ DET_ELEVATION_ERR_021 : 80|6@1+ (0.00174533,0) [0|0.10995579] "rad"  ADAS
 SG_ DET_RCS_021 : 128|8@1+ (0.5,-64) [-64|63.5] "dBsm"  ADAS
 SG_ DET_BI_STATIC_FLAG_021 : 104|1@1+ (1,0) [0|1] ""  ADAS
 SG_ DET_SUPER_RES_TARGET_021 : 87|1@1+ (1,0) [0|1] ""  ADAS
 SG_ DET_SNR_021 : 120|8@1+ (0.35156,0) [0|89.6478] "dB"  ADAS
 SG_ DET_EXISTENCE_PROB_021 : 112|6@1+ (1.588,0) [0|100] "%"  ADAS
 SG_ DET_HVC_FLAG_021 : 86|1@1+ (1,0) [0|1] ""  ADAS
 SG_ DET_CONFD_AZIMUTH_021 : 118|2@1+ (1,0) [0|3] ""  ADAS
 SG_ DET_CONFD_ELEVATION_021 : 101|2@1+ (1,0) [0|3] ""  ADAS
 SG_ DET_PROB_1STAZHYPO_021 : 103|1@1+ (1,0) [0|1] ""  ADAS
 SG_ DET_IDM_021 : 63|1@1+ (1,0) [0|1] ""  ADAS
 SG_ DET_MTD_021 : 47|1@1+ (1,0) [0|1] ""  ADAS
 SG_ DET_BELOW_RAIN_THOLD_021 : 39|1@1+ (1,0) [0|1] ""  ADAS
 SG_ DET_RANGE_022 : 136|15@1+ (0.015625,0) [0|500] "m"  ADAS
 SG_ DET_RANGE_ERR_022 : 152|7@1+ (0.0075,0) [0|0.9525] "m"  ADAS
 SG_ DET_RANGE_VELOCITY_022 : 160|15@1+ (0.0078125,-128) [-128|127.9921875] "m/s"  ADAS
 SG_ DET_RANGE_VELOCITY_ERR_022 : 176|8@1+ (0.003,0) [0|0.765] "m/s"  ADAS
 SG_ DET_AZIMUTH_022 : 200|13@1+ (0.0004,-1.5708) [-1.5708|1.5708] "rad"  ADAS
 SG_ DET_AZIMUTH_ERR_022 : 217|7@1+ (0.00087267,0) [0|0.11082909] "rad"  ADAS
 SG_ DET_ELEVATION_022 : 184|8@1+ (0.00275,-0.34925) [-0.34925|0.34925] "rad"  ADAS
 SG_ DET_ELEVATION_ERR_022 : 192|6@1+ (0.00174533,0) [0|0.10995579] "rad"  ADAS
 SG_ DET_RCS_022 : 240|8@1+ (0.5,-64) [-64|63.5] "dBsm"  ADAS
 SG_ DET_BI_STATIC_FLAG_022 : 216|1@1+ (1,0) [0|1] ""  ADAS
 SG_ DET_SUPER_RES_TARGET_022 : 199|1@1+ (1,0) [0|1] ""  ADAS
 SG_ DET_SNR_022 : 232|8@1+ (0.35156,0) [0|89.6478] "dB"  ADAS
 SG_ DET_EXISTENCE_PROB_022 : 224|6@1+ (1.588,0) [0|100] "%"  ADAS
 SG_ DET_HVC_FLAG_022 : 198|1@1+ (1,0) [0|1] ""  ADAS
 SG_ DET_CONFD_AZIMUTH_022 : 230|2@1+ (1,0) [0|3] ""  ADAS
 SG_ DET_CONFD_ELEVATION_022 : 213|2@1+ (1,0) [0|3] ""  ADAS
 SG_ DET_PROB_1STAZHYPO_022 : 215|1@1+ (1,0) [0|1] ""  ADAS
 SG_ DET_IDM_022 : 175|1@1+ (1,0) [0|1] ""  ADAS
 SG_ DET_MTD_022 : 159|1@1+ (1,0) [0|1] ""  ADAS
 SG_ DET_BELOW_RAIN_THOLD_022 : 151|1@1+ (1,0) [0|1] ""  ADAS
 SG_ DET_RANGE_023 : 248|15@1+ (0.015625,0) [0|500] "m"  ADAS
 SG_ DET_RANGE_ERR_023 : 264|7@1+ (0.0075,0) [0|0.9525] "m"  ADAS
 SG_ DET_RANGE_VELOCITY_023 : 272|15@1+ (0.0078125,-128) [-128|127.9921875] "m/s"  ADAS
 SG_ DET_RANGE_VELOCITY_ERR_023 : 288|8@1+ (0.003,0) [0|0.765] "m/s"  ADAS
 SG_ DET_AZIMUTH_023 : 312|13@1+ (0.0004,-1.5708) [-1.5708|1.5708] "rad"  ADAS
 SG_ DET_AZIMUTH_ERR_023 : 329|7@1+ (0.00087267,0) [0|0.11082909] "rad"  ADAS
 SG_ DET_ELEVATION_023 : 296|8@1+ (0.00275,-0.34925) [-0.34925|0.34925] "rad"  ADAS
 SG_ DET_ELEVATION_ERR_023 : 304|6@1+ (0.00174533,0) [0|0.10995579] "rad"  ADAS
 SG_ DET_RCS_023 : 352|8@1+ (0.5,-64) [-64|63.5] "dBsm"  ADAS
 SG_ DET_BI_STATIC_FLAG_023 : 328|1@1+ (1,0) [0|1] ""  ADAS
 SG_ DET_SUPER_RES_TARGET_023 : 311|1@1+ (1,0) [0|1] ""  ADAS
 SG_ DET_SNR_023 : 344|8@1+ (0.35156,0) [0|89.6478] "dB"  ADAS
 SG_ DET_EXISTENCE_PROB_023 : 336|6@1+ (1.588,0) [0|100] "%"  ADAS
 SG_ DET_HVC_FLAG_023 : 310|1@1+ (1,0) [0|1] ""  ADAS
 SG_ DET_CONFD_AZIMUTH_023 : 342|2@1+ (1,0) [0|3] ""  ADAS
 SG_ DET_CONFD_ELEVATION_023 : 325|2@1+ (1,0) [0|3] ""  ADAS
 SG_ DET_PROB_1STAZHYPO_023 : 327|1@1+ (1,0) [0|1] ""  ADAS
 SG_ DET_IDM_023 : 287|1@1+ (1,0) [0|1] ""  ADAS
 SG_ DET_MTD_023 : 271|1@1+ (1,0) [0|1] ""  ADAS
 SG_ DET_BELOW_RAIN_THOLD_023 : 263|1@1+ (1,0) [0|1] ""  ADAS
 SG_ DET_RANGE_024 : 360|15@1+ (0.015625,0) [0|500] "m"  ADAS
 SG_ DET_RANGE_ERR_024 : 376|7@1+ (0.0075,0) [0|0.9525] "m"  ADAS
 SG_ DET_RANGE_VELOCITY_024 : 384|15@1+ (0.0078125,-128) [-128|127.9921875] "m/s"  ADAS
 SG_ DET_RANGE_VELOCITY_ERR_024 : 400|8@1+ (0.003,0) [0|0.765] "m/s"  ADAS
 SG_ DET_AZIMUTH_024 : 424|13@1+ (0.0004,-1.5708) [-1.5708|1.5708] "rad"  ADAS
 SG_ DET_AZIMUTH_ERR_024 : 441|7@1+ (0.00087267,0) [0|0.11082909] "rad"  ADAS
 SG_ DET_ELEVATION_024 : 408|8@1+ (0.00275,-0.34925) [-0.34925|0.34925] "rad"  ADAS
 SG_ DET_ELEVATION_ERR_024 : 416|6@1+ (0.00174533,0) [0|0.10995579] "rad"  ADAS
 SG_ DET_RCS_024 : 464|8@1+ (0.5,-64) [-64|63.5] "dBsm"  ADAS
 SG_ DET_BI_STATIC_FLAG_024 : 440|1@1+ (1,0) [0|1] ""  ADAS
 SG_ DET_SUPER_RES_TARGET_024 : 423|1@1+ (1,0) [0|1] ""  ADAS
 SG_ DET_SNR_024 : 456|8@1+ (0.35156,0) [0|89.6478] "dB"  ADAS
 SG_ DET_EXISTENCE_PROB_024 : 448|6@1+ (1.588,0) [0|100] "%"  ADAS
 SG_ DET_HVC_FLAG_024 : 422|1@1+ (1,0) [0|1] ""  ADAS
 SG_ DET_CONFD_AZIMUTH_024 : 454|2@1+ (1,0) [0|3] ""  ADAS
 SG_ DET_CONFD_ELEVATION_024 : 437|2@1+ (1,0) [0|3] ""  ADAS
 SG_ DET_MH_SCAN_INDEX_4LSB_021_024 : 476|4@1+ (1,0) [0|15] ""  ADAS
 SG_ DET_MH_CYCLE_COUNTER_021_024 : 16|8@1+ (1,0) [0|255] ""  ADAS
 SG_ DET_MH_CRC16_021_024 : 0|16@1+ (1,0) [0|65535] ""  ADAS
 SG_ DET_PROB_1STAZHYPO_024 : 439|1@1+ (1,0) [0|1] ""  ADAS
 SG_ DET_IDM_024 : 399|1@1+ (1,0) [0|1] ""  ADAS
 SG_ DET_MTD_024 : 383|1@1+ (1,0) [0|1] ""  ADAS
 SG_ DET_BELOW_RAIN_THOLD_024 : 375|1@1+ (1,0) [0|1] ""  ADAS

BO_ 774 RDR_DETECTION_025_028: 64 RDR05
 SG_ DET_RANGE_025 : 24|15@1+ (0.015625,0) [0|500] "m"  ADAS
 SG_ DET_RANGE_ERR_025 : 40|7@1+ (0.0075,0) [0|0.9525] "m"  ADAS
 SG_ DET_RANGE_VELOCITY_025 : 48|15@1+ (0.0078125,-128) [-128|127.9921875] "m/s"  ADAS
 SG_ DET_RANGE_VELOCITY_ERR_025 : 64|8@1+ (0.003,0) [0|0.765] "m/s"  ADAS
 SG_ DET_AZIMUTH_025 : 88|13@1+ (0.0004,-1.5708) [-1.5708|1.5708] "rad"  ADAS
 SG_ DET_AZIMUTH_ERR_025 : 105|7@1+ (0.00087267,0) [0|0.11082909] "rad"  ADAS
 SG_ DET_ELEVATION_025 : 72|8@1+ (0.00275,-0.34925) [-0.34925|0.34925] "rad"  ADAS
 SG_ DET_ELEVATION_ERR_025 : 80|6@1+ (0.00174533,0) [0|0.10995579] "rad"  ADAS
 SG_ DET_RCS_025 : 128|8@1+ (0.5,-64) [-64|63.5] "dBsm"  ADAS
 SG_ DET_BI_STATIC_FLAG_025 : 104|1@1+ (1,0) [0|1] ""  ADAS
 SG_ DET_SUPER_RES_TARGET_025 : 87|1@1+ (1,0) [0|1] ""  ADAS
 SG_ DET_SNR_025 : 120|8@1+ (0.35156,0) [0|89.6478] "dB"  ADAS
 SG_ DET_EXISTENCE_PROB_025 : 112|6@1+ (1.588,0) [0|100] "%"  ADAS
 SG_ DET_HVC_FLAG_025 : 86|1@1+ (1,0) [0|1] ""  ADAS
 SG_ DET_CONFD_AZIMUTH_025 : 118|2@1+ (1,0) [0|3] ""  ADAS
 SG_ DET_CONFD_ELEVATION_025 : 101|2@1+ (1,0) [0|3] ""  ADAS
 SG_ DET_PROB_1STAZHYPO_025 : 103|1@1+ (1,0) [0|1] ""  ADAS
 SG_ DET_IDM_025 : 63|1@1+ (1,0) [0|1] ""  ADAS
 SG_ DET_MTD_025 : 47|1@1+ (1,0) [0|1] ""  ADAS
 SG_ DET_BELOW_RAIN_THOLD_025 : 39|1@1+ (1,0) [0|1] ""  ADAS
 SG_ DET_RANGE_026 : 136|15@1+ (0.015625,0) [0|500] "m"  ADAS
 SG_ DET_RANGE_ERR_026 : 152|7@1+ (0.0075,0) [0|0.9525] "m"  ADAS
 SG_ DET_RANGE_VELOCITY_026 : 160|15@1+ (0.0078125,-128) [-128|127.9921875] "m/s"  ADAS
 SG_ DET_RANGE_VELOCITY_ERR_026 : 176|8@1+ (0.003,0) [0|0.765] "m/s"  ADAS
 SG_ DET_AZIMUTH_026 : 200|13@1+ (0.0004,-1.5708) [-1.5708|1.5708] "rad"  ADAS
 SG_ DET_AZIMUTH_ERR_026 : 217|7@1+ (0.00087267,0) [0|0.11082909] "rad"  ADAS
 SG_ DET_ELEVATION_026 : 184|8@1+ (0.00275,-0.34925) [-0.34925|0.34925] "rad"  ADAS
 SG_ DET_ELEVATION_ERR_026 : 192|6@1+ (0.00174533,0) [0|0.10995579] "rad"  ADAS
 SG_ DET_RCS_026 : 240|8@1+ (0.5,-64) [-64|63.5] "dBsm"  ADAS
 SG_ DET_BI_STATIC_FLAG_026 : 216|1@1+ (1,0) [0|1] ""  ADAS
 SG_ DET_SUPER_RES_TARGET_026 : 199|1@1+ (1,0) [0|1] ""  ADAS
 SG_ DET_SNR_026 : 232|8@1+ (0.35156,0) [0|89.6478] "dB"  ADAS
 SG_ DET_EXISTENCE_PROB_026 : 224|6@1+ (1.588,0) [0|100] "%"  ADAS
 SG_ DET_HVC_FLAG_026 : 198|1@1+ (1,0) [0|1] ""  ADAS
 SG_ DET_CONFD_AZIMUTH_026 : 230|2@1+ (1,0) [0|3] ""  ADAS
 SG_ DET_CONFD_ELEVATION_026 : 213|2@1+ (1,0) [0|3] ""  ADAS
 SG_ DET_PROB_1STAZHYPO_026 : 215|1@1+ (1,0) [0|1] ""  ADAS
 SG_ DET_IDM_026 : 175|1@1+ (1,0) [0|1] ""  ADAS
 SG_ DET_MTD_026 : 159|1@1+ (1,0) [0|1] ""  ADAS
 SG_ DET_BELOW_RAIN_THOLD_026 : 151|1@1+ (1,0) [0|1] ""  ADAS
 SG_ DET_RANGE_027 : 248|15@1+ (0.015625,0) [0|500] "m"  ADAS
 SG_ DET_RANGE_ERR_027 : 264|7@1+ (0.0075,0) [0|0.9525] "m"  ADAS
 SG_ DET_RANGE_VELOCITY_027 : 272|15@1+ (0.0078125,-128) [-128|127.9921875] "m/s"  ADAS
 SG_ DET_RANGE_VELOCITY_ERR_027 : 288|8@1+ (0.003,0) [0|0.765] "m/s"  ADAS
 SG_ DET_AZIMUTH_027 : 312|13@1+ (0.0004,-1.5708) [-1.5708|1.5708] "rad"  ADAS
 SG_ DET_AZIMUTH_ERR_027 : 329|7@1+ (0.00087267,0) [0|0.11082909] "rad"  ADAS
 SG_ DET_ELEVATION_027 : 296|8@1+ (0.00275,-0.34925) [-0.34925|0.34925] "rad"  ADAS
 SG_ DET_ELEVATION_ERR_027 : 304|6@1+ (0.00174533,0) [0|0.10995579] "rad"  ADAS
 SG_ DET_RCS_027 : 352|8@1+ (0.5,-64) [-64|63.5] "dBsm"  ADAS
 SG_ DET_BI_STATIC_FLAG_027 : 328|1@1+ (1,0) [0|1] ""  ADAS
 SG_ DET_SUPER_RES_TARGET_027 : 311|1@1+ (1,0) [0|1] ""  ADAS
 SG_ DET_SNR_027 : 344|8@1+ (0.35156,0) [0|89.6478] "dB"  ADAS
 SG_ DET_EXISTENCE_PROB_027 : 336|6@1+ (1.588,0) [0|100] "%"  ADAS
 SG_ DET_HVC_FLAG_027 : 310|1@1+ (1,0) [0|1] ""  ADAS
 SG_ DET_CONFD_AZIMUTH_027 : 342|2@1+ (1,0) [0|3] ""  ADAS
 SG_ DET_CONFD_ELEVATION_027 : 325|2@1+ (1,0) [0|3] ""  ADAS
 SG_ DET_PROB_1STAZHYPO_027 : 327|1@1+ (1,0) [0|1] ""  ADAS
 SG_ DET_IDM_027 : 287|1@1+ (1,0) [0|1] ""  ADAS
 SG_ DET_MTD_027 : 271|1@1+ (1,0) [0|1] ""  ADAS
 SG_ DET_BELOW_RAIN_THOLD_027 : 263|1@1+ (1,0) [0|1] ""  ADAS
 SG_ DET_RANGE_028 : 360|15@1+ (0.015625,0) [0|500] "m"  ADAS
 SG_ DET_RANGE_ERR_028 : 376|7@1+ (0.0075,0) [0|0.9525] "m"  ADAS
 SG_ DET_RANGE_VELOCITY_028 : 384|15@1+ (0.0078125,-128) [-128|127.9921875] "m/s"  ADAS
 SG_ DET_RANGE_VELOCITY_ERR_028 : 400|8@1+ (0.003,0) [0|0.765] "m/s"  ADAS
 SG_ DET_AZIMUTH_028 : 424|13@1+ (0.0004,-1.5708) [-1.5708|1.5708] "rad"  ADAS
 SG_ DET_AZIMUTH_ERR_028 : 441|7@1+ (0.00087267,0) [0|0.11082909] "rad"  ADAS
 SG_ DET_ELEVATION_028 : 408|8@1+ (0.00275,-0.34925) [-0.34925|0.34925] "rad"  ADAS
 SG_ DET_ELEVATION_ERR_028 : 416|6@1+ (0.00174533,0) [0|0.10995579] "rad"  ADAS
 SG_ DET_RCS_028 : 464|8@1+ (0.5,-64) [-64|63.5] "dBsm"  ADAS
 SG_ DET_BI_STATIC_FLAG_028 : 440|1@1+ (1,0) [0|1] ""  ADAS
 SG_ DET_SUPER_RES_TARGET_028 : 423|1@1+ (1,0) [0|1] ""  ADAS
 SG_ DET_SNR_028 : 456|8@1+ (0.35156,0) [0|89.6478] "dB"  ADAS
 SG_ DET_EXISTENCE_PROB_028 : 448|6@1+ (1.588,0) [0|100] "%"  ADAS
 SG_ DET_HVC_FLAG_028 : 422|1@1+ (1,0) [0|1] ""  ADAS
 SG_ DET_CONFD_AZIMUTH_028 : 454|2@1+ (1,0) [0|3] ""  ADAS
 SG_ DET_CONFD_ELEVATION_028 : 437|2@1+ (1,0) [0|3] ""  ADAS
 SG_ DET_MH_SCAN_INDEX_4LSB_025_028 : 476|4@1+ (1,0) [0|15] ""  ADAS
 SG_ DET_MH_CYCLE_COUNTER_025_028 : 16|8@1+ (1,0) [0|255] ""  ADAS
 SG_ DET_MH_CRC16_025_028 : 0|16@1+ (1,0) [0|65535] ""  ADAS
 SG_ DET_PROB_1STAZHYPO_028 : 439|1@1+ (1,0) [0|1] ""  ADAS
 SG_ DET_IDM_028 : 399|1@1+ (1,0) [0|1] ""  ADAS
 SG_ DET_MTD_028 : 383|1@1+ (1,0) [0|1] ""  ADAS
 SG_ DET_BELOW_RAIN_THOLD_028 : 375|1@1+ (1,0) [0|1] ""  ADAS

BO_ 775 RDR_DETECTION_029_032: 64 RDR05
 SG_ DET_RANGE_029 : 24|15@1+ (0.015625,0) [0|500] "m"  ADAS
 SG_ DET_RANGE_ERR_029 : 40|7@1+ (0.0075,0) [0|0.9525] "m"  ADAS
 SG_ DET_RANGE_VELOCITY_029 : 48|15@1+ (0.0078125,-128) [-128|127.9921875] "m/s"  ADAS
 SG_ DET_RANGE_VELOCITY_ERR_029 : 64|8@1+ (0.003,0) [0|0.765] "m/s"  ADAS
 SG_ DET_AZIMUTH_029 : 88|13@1+ (0.0004,-1.5708) [-1.5708|1.5708] "rad"  ADAS
 SG_ DET_AZIMUTH_ERR_029 : 105|7@1+ (0.00087267,0) [0|0.11082909] "rad"  ADAS
 SG_ DET_ELEVATION_029 : 72|8@1+ (0.00275,-0.34925) [-0.34925|0.34925] "rad"  ADAS
 SG_ DET_ELEVATION_ERR_029 : 80|6@1+ (0.00174533,0) [0|0.10995579] "rad"  ADAS
 SG_ DET_RCS_029 : 128|8@1+ (0.5,-64) [-64|63.5] "dBsm"  ADAS
 SG_ DET_BI_STATIC_FLAG_029 : 104|1@1+ (1,0) [0|1] ""  ADAS
 SG_ DET_SUPER_RES_TARGET_029 : 87|1@1+ (1,0) [0|1] ""  ADAS
 SG_ DET_SNR_029 : 120|8@1+ (0.35156,0) [0|89.6478] "dB"  ADAS
 SG_ DET_EXISTENCE_PROB_029 : 112|6@1+ (1.588,0) [0|100] "%"  ADAS
 SG_ DET_HVC_FLAG_029 : 86|1@1+ (1,0) [0|1] ""  ADAS
 SG_ DET_CONFD_AZIMUTH_029 : 118|2@1+ (1,0) [0|3] ""  ADAS
 SG_ DET_CONFD_ELEVATION_029 : 101|2@1+ (1,0) [0|3] ""  ADAS
 SG_ DET_PROB_1STAZHYPO_029 : 103|1@1+ (1,0) [0|1] ""  ADAS
 SG_ DET_IDM_029 : 63|1@1+ (1,0) [0|1] ""  ADAS
 SG_ DET_MTD_029 : 47|1@1+ (1,0) [0|1] ""  ADAS
 SG_ DET_BELOW_RAIN_THOLD_029 : 39|1@1+ (1,0) [0|1] ""  ADAS
 SG_ DET_RANGE_030 : 136|15@1+ (0.015625,0) [0|500] "m"  ADAS
 SG_ DET_RANGE_ERR_030 : 152|7@1+ (0.0075,0) [0|0.9525] "m"  ADAS
 SG_ DET_RANGE_VELOCITY_030 : 160|15@1+ (0.0078125,-128) [-128|127.9921875] "m/s"  ADAS
 SG_ DET_RANGE_VELOCITY_ERR_030 : 176|8@1+ (0.003,0) [0|0.765] "m/s"  ADAS
 SG_ DET_AZIMUTH_030 : 200|13@1+ (0.0004,-1.5708) [-1.5708|1.5708] "rad"  ADAS
 SG_ DET_AZIMUTH_ERR_030 : 217|7@1+ (0.00087267,0) [0|0.11082909] "rad"  ADAS
 SG_ DET_ELEVATION_030 : 184|8@1+ (0.00275,-0.34925) [-0.34925|0.34925] "rad"  ADAS
 SG_ DET_ELEVATION_ERR_030 : 192|6@1+ (0.00174533,0) [0|0.10995579] "rad"  ADAS
 SG_ DET_RCS_030 : 240|8@1+ (0.5,-64) [-64|63.5] "dBsm"  ADAS
 SG_ DET_BI_STATIC_FLAG_030 : 216|1@1+ (1,0) [0|1] ""  ADAS
 SG_ DET_SUPER_RES_TARGET_030 : 199|1@1+ (1,0) [0|1] ""  ADAS
 SG_ DET_SNR_030 : 232|8@1+ (0.35156,0) [0|89.6478] "dB"  ADAS
 SG_ DET_EXISTENCE_PROB_030 : 224|6@1+ (1.588,0) [0|100] "%"  ADAS
 SG_ DET_HVC_FLAG_030 : 198|1@1+ (1,0) [0|1] ""  ADAS
 SG_ DET_CONFD_AZIMUTH_030 : 230|2@1+ (1,0) [0|3] ""  ADAS
 SG_ DET_CONFD_ELEVATION_030 : 213|2@1+ (1,0) [0|3] ""  ADAS
 SG_ DET_PROB_1STAZHYPO_030 : 215|1@1+ (1,0) [0|1] ""  ADAS
 SG_ DET_IDM_030 : 175|1@1+ (1,0) [0|1] ""  ADAS
 SG_ DET_MTD_030 : 159|1@1+ (1,0) [0|1] ""  ADAS
 SG_ DET_BELOW_RAIN_THOLD_030 : 151|1@1+ (1,0) [0|1] ""  ADAS
 SG_ DET_RANGE_031 : 248|15@1+ (0.015625,0) [0|500] "m"  ADAS
 SG_ DET_RANGE_ERR_031 : 264|7@1+ (0.0075,0) [0|0.9525] "m"  ADAS
 SG_ DET_RANGE_VELOCITY_031 : 272|15@1+ (0.0078125,-128) [-128|127.9921875] "m/s"  ADAS
 SG_ DET_RANGE_VELOCITY_ERR_031 : 288|8@1+ (0.003,0) [0|0.765] "m/s"  ADAS
 SG_ DET_AZIMUTH_031 : 312|13@1+ (0.0004,-1.5708) [-1.5708|1.5708] "rad"  ADAS
 SG_ DET_AZIMUTH_ERR_031 : 329|7@1+ (0.00087267,0) [0|0.11082909] "rad"  ADAS
 SG_ DET_ELEVATION_031 : 296|8@1+ (0.00275,-0.34925) [-0.34925|0.34925] "rad"  ADAS
 SG_ DET_ELEVATION_ERR_031 : 304|6@1+ (0.00174533,0) [0|0.10995579] "rad"  ADAS
 SG_ DET_RCS_031 : 352|8@1+ (0.5,-64) [-64|63.5] "dBsm"  ADAS
 SG_ DET_BI_STATIC_FLAG_031 : 328|1@1+ (1,0) [0|1] ""  ADAS
 SG_ DET_SUPER_RES_TARGET_031 : 311|1@1+ (1,0) [0|1] ""  ADAS
 SG_ DET_SNR_031 : 344|8@1+ (0.35156,0) [0|89.6478] "dB"  ADAS
 SG_ DET_EXISTENCE_PROB_031 : 336|6@1+ (1.588,0) [0|100] "%"  ADAS
 SG_ DET_HVC_FLAG_031 : 310|1@1+ (1,0) [0|1] ""  ADAS
 SG_ DET_CONFD_AZIMUTH_031 : 342|2@1+ (1,0) [0|3] ""  ADAS
 SG_ DET_CONFD_ELEVATION_031 : 325|2@1+ (1,0) [0|3] ""  ADAS
 SG_ DET_PROB_1STAZHYPO_031 : 327|1@1+ (1,0) [0|1] ""  ADAS
 SG_ DET_IDM_031 : 287|1@1+ (1,0) [0|1] ""  ADAS
 SG_ DET_MTD_031 : 271|1@1+ (1,0) [0|1] ""  ADAS
 SG_ DET_BELOW_RAIN_THOLD_031 : 263|1@1+ (1,0) [0|1] ""  ADAS
 SG_ DET_RANGE_032 : 360|15@1+ (0.015625,0) [0|500] "m"  ADAS
 SG_ DET_RANGE_ERR_032 : 376|7@1+ (0.0075,0) [0|0.9525] "m"  ADAS
 SG_ DET_RANGE_VELOCITY_032 : 384|15@1+ (0.0078125,-128) [-128|127.9921875] "m/s"  ADAS
 SG_ DET_RANGE_VELOCITY_ERR_032 : 400|8@1+ (0.003,0) [0|0.765] "m/s"  ADAS
 SG_ DET_AZIMUTH_032 : 424|13@1+ (0.0004,-1.5708) [-1.5708|1.5708] "rad"  ADAS
 SG_ DET_AZIMUTH_ERR_032 : 441|7@1+ (0.00087267,0) [0|0.11082909] "rad"  ADAS
 SG_ DET_ELEVATION_032 : 408|8@1+ (0.00275,-0.34925) [-0.34925|0.34925] "rad"  ADAS
 SG_ DET_ELEVATION_ERR_032 : 416|6@1+ (0.00174533,0) [0|0.10995579] "rad"  ADAS
 SG_ DET_RCS_032 : 464|8@1+ (0.5,-64) [-64|63.5] "dBsm"  ADAS
 SG_ DET_BI_STATIC_FLAG_032 : 440|1@1+ (1,0) [0|1] ""  ADAS
 SG_ DET_SUPER_RES_TARGET_032 : 423|1@1+ (1,0) [0|1] ""  ADAS
 SG_ DET_SNR_032 : 456|8@1+ (0.35156,0) [0|89.6478] "dB"  ADAS
 SG_ DET_EXISTENCE_PROB_032 : 448|6@1+ (1.588,0) [0|100] "%"  ADAS
 SG_ DET_HVC_FLAG_032 : 422|1@1+ (1,0) [0|1] ""  ADAS
 SG_ DET_CONFD_AZIMUTH_032 : 454|2@1+ (1,0) [0|3] ""  ADAS
 SG_ DET_CONFD_ELEVATION_032 : 437|2@1+ (1,0) [0|3] ""  ADAS
 SG_ DET_MH_SCAN_INDEX_4LSB_029_032 : 476|4@1+ (1,0) [0|15] ""  ADAS
 SG_ DET_MH_CYCLE_COUNTER_029_032 : 16|8@1+ (1,0) [0|255] ""  ADAS
 SG_ DET_MH_CRC16_029_032 : 0|16@1+ (1,0) [0|65535] ""  ADAS
 SG_ DET_PROB_1STAZHYPO_032 : 439|1@1+ (1,0) [0|1] ""  ADAS
 SG_ DET_IDM_032 : 399|1@1+ (1,0) [0|1] ""  ADAS
 SG_ DET_MTD_032 : 383|1@1+ (1,0) [0|1] ""  ADAS
 SG_ DET_BELOW_RAIN_THOLD_032 : 375|1@1+ (1,0) [0|1] ""  ADAS

CM_ SG_ 768 DET_RANGE_001 " measured position  of the detection";
CM_ SG_ 768 DET_RANGE_ERR_001 "RMSE or standard deviation of the measured angle  of the detection";
CM_ SG_ 768 DET_RANGE_VELOCITY_001 "Radial velocity of the detection positive in direction to the sensor";
CM_ SG_ 768 DET_RANGE_VELOCITY_ERR_001 "RMSE or standard deviation of the measure radial velocity of the detection";
CM_ SG_ 768 DET_AZIMUTH_001 "Measured angle  of the detection";
CM_ SG_ 768 DET_AZIMUTH_ERR_001 "RMSE or standard deviation of the measured angle  of the detection";
CM_ SG_ 768 DET_ELEVATION_001 "measured elevation of the detection";
CM_ SG_ 768 DET_ELEVATION_ERR_001 "RMSE or standard deviation of the measured elevation  of the detection";
CM_ SG_ 768 DET_RCS_001 "Radar Cross Section or Amplitude, is a measure of how detectable an object is by radar. A larger RCS indicates that an object is more easily detected.";
CM_ SG_ 768 DET_BI_STATIC_FLAG_001 "1 if detection is bi-static 0 otherwise";
CM_ SG_ 768 DET_SUPER_RES_TARGET_001 "flasg is set if the detection is super resolution target";
CM_ SG_ 768 DET_SNR_001 "The signal to noise ratio (SNR) of the radar detection";
CM_ SG_ 768 DET_EXISTENCE_PROB_001 "Existence probability of the detection not based on history. Value does  not depend on any past experience with similar detections.

ote Use as confidence measure where a low value means less confidence
and a high value indicates strong confidence.";
CM_ SG_ 768 DET_HVC_FLAG_001 "Core2 Vehicle clutter flag";
CM_ SG_ 768 DET_CONFD_AZIMUTH_001 "Define the Confidence of Azimuth for Detection ";
CM_ SG_ 768 DET_CONFD_ELEVATION_001 "Define the Confidence of Elevation for the Detection ";
CM_ SG_ 768 DET_BI_STATIC_FLAG_002 "1 if detection is bi-static 0 otherwise";
CM_ SG_ 768 DET_BI_STATIC_FLAG_003 "1 if detection is bi-static 0 otherwise";
CM_ SG_ 768 DET_BI_STATIC_FLAG_004 "1 if detection is bi-static 0 otherwise";
CM_ SG_ 768 DET_MH_SCAN_INDEX_4LSB_001_004 "Scan index of the measured detection";
CM_ SG_ 768 DET_MH_CYCLE_COUNTER_001_004 "Detection Alive Counter";
CM_ BO_ 1 "The CAN message from the Time Master is a multiplexed message, viz. CAN-SYN and CAN-FUP";
CM_ SG_ 1 TSYN_USERBYTE "User specific data within the time measurement and synchronization protocol";
CM_ SG_ 1 TSYN_TIMEDOMAIN "Time Domian ID";
CM_ SG_ 1 TSYN_SYNCTIME_SEC "TIme in Seconds";
CM_ SG_ 1 TSYN_SYNCTIME_NANOSEC "Time in Nano Seconds";
CM_ SG_ 1 TSYN_SGW "Sync to Global Time or Sync to Sub Domian";
CM_ SG_ 1 TSYN_SEQUENCE_COUNTER "Sequence Counter (SC) of 4 bit is representing numbers from 0 to 15 per Time
Domain";
CM_ SG_ 1 TSYN_RESERVED "resreved for future extension";
CM_ SG_ 1 TSYN_PDU "TSyn_PDU signal value of 0x20 is  CAN-SYN. and TSyn_PDU signal value of 0x28 is CAN-FUP";
CM_ SG_ 1 TSYN_OVS "Overflow of seconds. If the value calculated for TSyn_SynTimeNSec overflows";
CM_ SG_ 1 TSYNC_CRC "CRC CRC8H2F";
CM_ SG_ 2 SSTS_YAW_RATE_CALC_QF "Yaw Rate quallity factor";
CM_ SG_ 2 SSTS_VEHICLE_SPEED_CALC_QF "Speed Quality factor";
CM_ SG_ 2 SSTS_STEERING_ANGLE_SIGN "Actual steering angle direction, from the centre position of the steering wheel.";
CM_ SG_ 2 SSTS_STEERING_ANGLE "Actual steering wheel angle. Datum (zero) of the steering wheel position is determined at the time of calibration in the factory.   This is only the magnitude of the steering wheel angle.";
CM_ SG_ 163 STS_AF_TIME_PEAK "Angle Finding Latency peak";
CM_ SG_ 163 STS_AF_TIME_INST "Angle Finding Latency instantaneous";
CM_ SG_ 163 STS_SW_VERSION_FIELD1 "Release_Number is incremented for major every release";
CM_ SG_ 163 STS_SW_VERSION_FIELD2 "Promote_Revision, increment with every promote or minor release";
CM_ SG_ 163 STS_SW_VERSION_FIELD3 "Field_Revision  or Variant number";
CM_ SG_ 163 STS_SW_VERSION_FIELD4 "Increment with SW patch release";
CM_ SG_ 163 STS_PBL_VERSION_FIELD1 "Release_Number is incremented for major every release";
CM_ SG_ 163 STS_PBL_VERSION_FIELD2 "Promote_Revision, increment with every promote or minor release";
CM_ SG_ 163 STS_PBL_VERSION_FIELD3 "Field_Revision  or Variant number";
CM_ SG_ 163 STS_PBL_VERSION_FIELD4 "Increment with patch release";
CM_ SG_ 163 STS_SMC_SECTION_COMPTBLITY "Section compatiblity bits as specified in EXEC spec";
CM_ SG_ 163 STS_SMC_PLATFROM_VERSION "Variant ID";
CM_ SG_ 163 STS_SENSOR_MOUNT_POS_X "Correction of the mounting position w.r.t. the optimal position. Correction is determined by calibration";
CM_ SG_ 163 STS_SENSOR_MOUNT_ORNT_PITCH "Correction of the mounting position orientation w.r.t. the optimal orientation";
CM_ SG_ 163 STS_SENSOR_HEIGHT "Radar height from ground to center of radar elevation field-of-view";
CM_ SG_ 163 STS_DET_DBC_BASE_VER_MINOR "Detection base dbc Minor version";
CM_ SG_ 163 STS_DET_DBC_BASE_VER_MAJOR "Detection base dbc Major version";
CM_ SG_ 164 STS_INTRFC_VERSION_ID_PATCH "Version number for patch";
CM_ SG_ 164 STS_INTRFC_VERSION_ID_MINOR "Version number for minor";
CM_ SG_ 164 STS_INTRFC_VERSION_ID_MAJOR "Version number for major";
CM_ SG_ 164 STS_POINT_OF_TRIGGER "Delay betwen TymSyc message received and actual trigger";
CM_ SG_ 164 STS_BRR_STATUS "Current status of BRR , active/inactive/fault";
CM_ SG_ 164 STS_MMIC_TEMP_TX1_2 "Internal MMIC Temperature #1";
CM_ SG_ 164 STS_XCVR_OPERATIONAL "Indication that the transceiver is operational";
CM_ SG_ 164 STS_VEH_SPEED_DIRECTION "Provides indication of vehicle direction of travel";
CM_ SG_ 164 STS_STEERING_ANGLE_SIGN "Actual steering angle direction, from the centre position of the steering wheel.";
CM_ SG_ 164 STS_STEERING_ANGLE "Actual steering wheel angle. Datum (zero) of the steering wheel position is determined at the time of calibration in the factory.   This is only the magnitude of the steering wheel angle.";
CM_ SG_ 164 STS_VEHICLE_SPEED_CALC "Vehicle speed";
CM_ SG_ 164 STS_TIME_SYNC_OFFSET "Current offset from desired Time Sync Sync point";
CM_ SG_ 160 HED_NUM_OF_VALID_DETECTIONS "The current number of valid detections in the detections list";
CM_ SG_ 160 HED_LOOK_ID "Indicates the look type values 1 to 4 base on medium/long look and near/far look. Each radar scan is a look.";
CM_ SG_ 160 HED_SCAN_INDEX "Scan index";
CM_ SG_ 160 HED_MH_CYCLE_COUNTER "ALIVE counter";
CM_ SG_ 160 HED_DATA_QUALIFIER "Data qualifier communicates the overall availability of the interface or expresses to what extent the content of this event can be relied on ";
CM_ SG_ 160 HED_DET_RANGE_MAX "Detection range max is the farthest possible detection with respect to the sensor origin.";
CM_ SG_ 160 HED_DET_SPEED_RANGE_MAX "Describes the relative radial speed range in the sensor coordinate system. Range is defined by
two range values: negative values indicate lower speed than the ego-vehicle, positive values
indicate higher velocity than ego-vehicle";
CM_ SG_ 160 HED_FOV_HOR_MAX "Field of view defined by opening angles in sensor XY-plane.";
CM_ SG_ 160 HED_FOV_VER_MAX "Field of view defined by opening angles in sensor XZ-plane.";
CM_ SG_ 160 HED_DET_RANGE_MIN "Detection range max is the Closest possible detection with respect to the sensor origin.";
CM_ SG_ 160 HED_DET_SPEED_RANGE_MIN "Describes the relative radial speed range in the sensor coordinate system. Range is defined by
two range values: negative values indicate lower speed than the ego-vehicle, positive values
indicate higher velocity than ego-vehicle";
CM_ SG_ 160 HED_FOV_HOR_MIN "Field of view defined by opening angles in sensor XY-plane.";
CM_ SG_ 160 HED_FOV_VER_MIN "Field of view defined by opening angles in sensor XZ-plane.";
CM_ SG_ 160 HED_ALIGN_HOR_REF "Alignment horizontal reference";
CM_ SG_ 160 HED_SENSOR_TIME_STAMP_NS "sensor absolute time when the radar measurement was taken";
CM_ SG_ 160 HED_TIME_SYNC_SRC_MASTER "Indicate if sensor is synch to global master or local master";
CM_ SG_ 160 HED_TIME_SYNC_VALIDITY_FLAG "indicates the validity of Time Sync message data";
CM_ SG_ 160 HED_TRIGGER_TIME "Data Acquisition start time";
CM_ SG_ 769 DET_RANGE_005 " measured position  of the detection";
CM_ SG_ 769 DET_RANGE_ERR_005 "RMSE or standard deviation of the measured angle  of the detection";
CM_ SG_ 769 DET_RANGE_VELOCITY_005 "Radial velocity of the detection positive in direction to the sensor";
CM_ SG_ 769 DET_RANGE_VELOCITY_ERR_005 "RMSE or standard deviation of the measure radial velocity of the detection";
CM_ SG_ 769 DET_AZIMUTH_005 "Measured angle  of the detection";
CM_ SG_ 769 DET_AZIMUTH_ERR_005 "RMSE or standard deviation of the measured angle  of the detection";
CM_ SG_ 769 DET_ELEVATION_005 "measured elevation of the detection";
CM_ SG_ 769 DET_ELEVATION_ERR_005 "RMSE or standard deviation of the measured elevation  of the detection";
CM_ SG_ 769 DET_RCS_005 "Radar Cross Section or Amplitude, is a measure of how detectable an object is by radar. A larger RCS indicates that an object is more easily detected.";
CM_ SG_ 769 DET_BI_STATIC_FLAG_005 "1 if detection is bi-static 0 otherwise";
CM_ SG_ 769 DET_SUPER_RES_TARGET_005 "flasg is set if the detection is super resolution target";
CM_ SG_ 769 DET_SNR_005 "The signal to noise ratio (SNR) of the radar detection";
CM_ SG_ 769 DET_EXISTENCE_PROB_005 "Existence probability of the detection not based on history. Value does  not depend on any past experience with similar detections.

ote Use as confidence measure where a low value means less confidence
and a high value indicates strong confidence.";
CM_ SG_ 769 DET_HVC_FLAG_005 "Core2 Vehicle clutter flag";
CM_ SG_ 769 DET_CONFD_AZIMUTH_005 "Define the Confidence of Azimuth for Detection ";
CM_ SG_ 769 DET_CONFD_ELEVATION_005 "Define the Confidence of Elevation for the Detection ";
CM_ SG_ 769 DET_BI_STATIC_FLAG_006 "1 if detection is bi-static 0 otherwise";
CM_ SG_ 769 DET_BI_STATIC_FLAG_007 "1 if detection is bi-static 0 otherwise";
CM_ SG_ 769 DET_BI_STATIC_FLAG_008 "1 if detection is bi-static 0 otherwise";
CM_ SG_ 769 DET_MH_SCAN_INDEX_4LSB_005_008 "Scan index of the measured detection";
CM_ SG_ 769 DET_MH_CYCLE_COUNTER_005_008 "Detection Alive Counter";
CM_ SG_ 770 DET_RANGE_009 " measured position  of the detection";
CM_ SG_ 770 DET_RANGE_ERR_009 "RMSE or standard deviation of the measured angle  of the detection";
CM_ SG_ 770 DET_RANGE_VELOCITY_009 "Radial velocity of the detection positive in direction to the sensor";
CM_ SG_ 770 DET_RANGE_VELOCITY_ERR_009 "RMSE or standard deviation of the measure radial velocity of the detection";
CM_ SG_ 770 DET_AZIMUTH_009 "Measured angle  of the detection";
CM_ SG_ 770 DET_AZIMUTH_ERR_009 "RMSE or standard deviation of the measured angle  of the detection";
CM_ SG_ 770 DET_ELEVATION_009 "measured elevation of the detection";
CM_ SG_ 770 DET_ELEVATION_ERR_009 "RMSE or standard deviation of the measured elevation  of the detection";
CM_ SG_ 770 DET_RCS_009 "Radar Cross Section or Amplitude, is a measure of how detectable an object is by radar. A larger RCS indicates that an object is more easily detected.";
CM_ SG_ 770 DET_BI_STATIC_FLAG_009 "1 if detection is bi-static 0 otherwise";
CM_ SG_ 770 DET_SUPER_RES_TARGET_009 "flasg is set if the detection is super resolution target";
CM_ SG_ 770 DET_SNR_009 "The signal to noise ratio (SNR) of the radar detection";
CM_ SG_ 770 DET_EXISTENCE_PROB_009 "Existence probability of the detection not based on history. Value does  not depend on any past experience with similar detections.

ote Use as confidence measure where a low value means less confidence
and a high value indicates strong confidence.";
CM_ SG_ 770 DET_HVC_FLAG_009 "Core2 Vehicle clutter flag";
CM_ SG_ 770 DET_CONFD_AZIMUTH_009 "Define the Confidence of Azimuth for Detection ";
CM_ SG_ 770 DET_CONFD_ELEVATION_009 "Define the Confidence of Elevation for the Detection ";
CM_ SG_ 770 DET_BI_STATIC_FLAG_010 "1 if detection is bi-static 0 otherwise";
CM_ SG_ 770 DET_BI_STATIC_FLAG_011 "1 if detection is bi-static 0 otherwise";
CM_ SG_ 770 DET_BI_STATIC_FLAG_012 "1 if detection is bi-static 0 otherwise";
CM_ SG_ 770 DET_MH_SCAN_INDEX_4LSB_009_012 "Scan index of the measured detection";
CM_ SG_ 770 DET_MH_CYCLE_COUNTER_009_012 "Detection Alive Counter";
CM_ SG_ 771 DET_RANGE_013 " measured position  of the detection";
CM_ SG_ 771 DET_RANGE_ERR_013 "RMSE or standard deviation of the measured angle  of the detection";
CM_ SG_ 771 DET_RANGE_VELOCITY_013 "Radial velocity of the detection positive in direction to the sensor";
CM_ SG_ 771 DET_RANGE_VELOCITY_ERR_013 "RMSE or standard deviation of the measure radial velocity of the detection";
CM_ SG_ 771 DET_AZIMUTH_013 "Measured angle  of the detection";
CM_ SG_ 771 DET_AZIMUTH_ERR_013 "RMSE or standard deviation of the measured angle  of the detection";
CM_ SG_ 771 DET_ELEVATION_013 "measured elevation of the detection";
CM_ SG_ 771 DET_ELEVATION_ERR_013 "RMSE or standard deviation of the measured elevation  of the detection";
CM_ SG_ 771 DET_RCS_013 "Radar Cross Section or Amplitude, is a measure of how detectable an object is by radar. A larger RCS indicates that an object is more easily detected.";
CM_ SG_ 771 DET_BI_STATIC_FLAG_013 "1 if detection is bi-static 0 otherwise";
CM_ SG_ 771 DET_SUPER_RES_TARGET_013 "flasg is set if the detection is super resolution target";
CM_ SG_ 771 DET_SNR_013 "The signal to noise ratio (SNR) of the radar detection";
CM_ SG_ 771 DET_EXISTENCE_PROB_013 "Existence probability of the detection not based on history. Value does  not depend on any past experience with similar detections.

ote Use as confidence measure where a low value means less confidence
and a high value indicates strong confidence.";
CM_ SG_ 771 DET_HVC_FLAG_013 "Core2 Vehicle clutter flag";
CM_ SG_ 771 DET_CONFD_AZIMUTH_013 "Define the Confidence of Azimuth for Detection ";
CM_ SG_ 771 DET_CONFD_ELEVATION_013 "Define the Confidence of Elevation for the Detection ";
CM_ SG_ 771 DET_BI_STATIC_FLAG_014 "1 if detection is bi-static 0 otherwise";
CM_ SG_ 771 DET_BI_STATIC_FLAG_015 "1 if detection is bi-static 0 otherwise";
CM_ SG_ 771 DET_BI_STATIC_FLAG_016 "1 if detection is bi-static 0 otherwise";
CM_ SG_ 771 DET_MH_SCAN_INDEX_4LSB_013_016 "Scan index of the measured detection";
CM_ SG_ 771 DET_MH_CYCLE_COUNTER_013_016 "Detection Alive Counter";
CM_ SG_ 772 DET_RANGE_017 " measured position  of the detection";
CM_ SG_ 772 DET_RANGE_ERR_017 "RMSE or standard deviation of the measured angle  of the detection";
CM_ SG_ 772 DET_RANGE_VELOCITY_017 "Radial velocity of the detection positive in direction to the sensor";
CM_ SG_ 772 DET_RANGE_VELOCITY_ERR_017 "RMSE or standard deviation of the measure radial velocity of the detection";
CM_ SG_ 772 DET_AZIMUTH_017 "Measured angle  of the detection";
CM_ SG_ 772 DET_AZIMUTH_ERR_017 "RMSE or standard deviation of the measured angle  of the detection";
CM_ SG_ 772 DET_ELEVATION_017 "measured elevation of the detection";
CM_ SG_ 772 DET_ELEVATION_ERR_017 "RMSE or standard deviation of the measured elevation  of the detection";
CM_ SG_ 772 DET_RCS_017 "Radar Cross Section or Amplitude, is a measure of how detectable an object is by radar. A larger RCS indicates that an object is more easily detected.";
CM_ SG_ 772 DET_BI_STATIC_FLAG_017 "1 if detection is bi-static 0 otherwise";
CM_ SG_ 772 DET_SUPER_RES_TARGET_017 "flasg is set if the detection is super resolution target";
CM_ SG_ 772 DET_SNR_017 "The signal to noise ratio (SNR) of the radar detection";
CM_ SG_ 772 DET_EXISTENCE_PROB_017 "Existence probability of the detection not based on history. Value does  not depend on any past experience with similar detections.

ote Use as confidence measure where a low value means less confidence
and a high value indicates strong confidence.";
CM_ SG_ 772 DET_HVC_FLAG_017 "Core2 Vehicle clutter flag";
CM_ SG_ 772 DET_CONFD_AZIMUTH_017 "Define the Confidence of Azimuth for Detection ";
CM_ SG_ 772 DET_CONFD_ELEVATION_017 "Define the Confidence of Elevation for the Detection ";
CM_ SG_ 772 DET_BI_STATIC_FLAG_018 "1 if detection is bi-static 0 otherwise";
CM_ SG_ 772 DET_BI_STATIC_FLAG_019 "1 if detection is bi-static 0 otherwise";
CM_ SG_ 772 DET_BI_STATIC_FLAG_020 "1 if detection is bi-static 0 otherwise";
CM_ SG_ 772 DET_MH_SCAN_INDEX_4LSB_017_020 "Scan index of the measured detection";
CM_ SG_ 772 DET_MH_CYCLE_COUNTER_017_020 "Detection Alive Counter";
CM_ SG_ 773 DET_RANGE_021 " measured position  of the detection";
CM_ SG_ 773 DET_RANGE_ERR_021 "RMSE or standard deviation of the measured angle  of the detection";
CM_ SG_ 773 DET_RANGE_VELOCITY_021 "Radial velocity of the detection positive in direction to the sensor";
CM_ SG_ 773 DET_RANGE_VELOCITY_ERR_021 "RMSE or standard deviation of the measure radial velocity of the detection";
CM_ SG_ 773 DET_AZIMUTH_021 "Measured angle  of the detection";
CM_ SG_ 773 DET_AZIMUTH_ERR_021 "RMSE or standard deviation of the measured angle  of the detection";
CM_ SG_ 773 DET_ELEVATION_021 "measured elevation of the detection";
CM_ SG_ 773 DET_ELEVATION_ERR_021 "RMSE or standard deviation of the measured elevation  of the detection";
CM_ SG_ 773 DET_RCS_021 "Radar Cross Section or Amplitude, is a measure of how detectable an object is by radar. A larger RCS indicates that an object is more easily detected.";
CM_ SG_ 773 DET_BI_STATIC_FLAG_021 "1 if detection is bi-static 0 otherwise";
CM_ SG_ 773 DET_SUPER_RES_TARGET_021 "flasg is set if the detection is super resolution target";
CM_ SG_ 773 DET_SNR_021 "The signal to noise ratio (SNR) of the radar detection";
CM_ SG_ 773 DET_EXISTENCE_PROB_021 "Existence probability of the detection not based on history. Value does  not depend on any past experience with similar detections.

ote Use as confidence measure where a low value means less confidence
and a high value indicates strong confidence.";
CM_ SG_ 773 DET_HVC_FLAG_021 "Core2 Vehicle clutter flag";
CM_ SG_ 773 DET_CONFD_AZIMUTH_021 "Define the Confidence of Azimuth for Detection ";
CM_ SG_ 773 DET_CONFD_ELEVATION_021 "Define the Confidence of Elevation for the Detection ";
CM_ SG_ 773 DET_BI_STATIC_FLAG_022 "1 if detection is bi-static 0 otherwise";
CM_ SG_ 773 DET_BI_STATIC_FLAG_023 "1 if detection is bi-static 0 otherwise";
CM_ SG_ 773 DET_BI_STATIC_FLAG_024 "1 if detection is bi-static 0 otherwise";
CM_ SG_ 773 DET_MH_SCAN_INDEX_4LSB_021_024 "Scan index of the measured detection";
CM_ SG_ 773 DET_MH_CYCLE_COUNTER_021_024 "Detection Alive Counter";
CM_ SG_ 774 DET_RANGE_025 " measured position  of the detection";
CM_ SG_ 774 DET_RANGE_ERR_025 "RMSE or standard deviation of the measured angle  of the detection";
CM_ SG_ 774 DET_RANGE_VELOCITY_025 "Radial velocity of the detection positive in direction to the sensor";
CM_ SG_ 774 DET_RANGE_VELOCITY_ERR_025 "RMSE or standard deviation of the measure radial velocity of the detection";
CM_ SG_ 774 DET_AZIMUTH_025 "Measured angle  of the detection";
CM_ SG_ 774 DET_AZIMUTH_ERR_025 "RMSE or standard deviation of the measured angle  of the detection";
CM_ SG_ 774 DET_ELEVATION_025 "measured elevation of the detection";
CM_ SG_ 774 DET_ELEVATION_ERR_025 "RMSE or standard deviation of the measured elevation  of the detection";
CM_ SG_ 774 DET_RCS_025 "Radar Cross Section or Amplitude, is a measure of how detectable an object is by radar. A larger RCS indicates that an object is more easily detected.";
CM_ SG_ 774 DET_BI_STATIC_FLAG_025 "1 if detection is bi-static 0 otherwise";
CM_ SG_ 774 DET_SUPER_RES_TARGET_025 "flasg is set if the detection is super resolution target";
CM_ SG_ 774 DET_SNR_025 "The signal to noise ratio (SNR) of the radar detection";
CM_ SG_ 774 DET_EXISTENCE_PROB_025 "Existence probability of the detection not based on history. Value does  not depend on any past experience with similar detections.

ote Use as confidence measure where a low value means less confidence
and a high value indicates strong confidence.";
CM_ SG_ 774 DET_HVC_FLAG_025 "Core2 Vehicle clutter flag";
CM_ SG_ 774 DET_CONFD_AZIMUTH_025 "Define the Confidence of Azimuth for Detection ";
CM_ SG_ 774 DET_CONFD_ELEVATION_025 "Define the Confidence of Elevation for the Detection ";
CM_ SG_ 774 DET_BI_STATIC_FLAG_026 "1 if detection is bi-static 0 otherwise";
CM_ SG_ 774 DET_BI_STATIC_FLAG_027 "1 if detection is bi-static 0 otherwise";
CM_ SG_ 774 DET_BI_STATIC_FLAG_028 "1 if detection is bi-static 0 otherwise";
CM_ SG_ 774 DET_MH_SCAN_INDEX_4LSB_025_028 "Scan index of the measured detection";
CM_ SG_ 774 DET_MH_CYCLE_COUNTER_025_028 "Detection Alive Counter";
CM_ SG_ 775 DET_RANGE_029 " measured position  of the detection";
CM_ SG_ 775 DET_RANGE_ERR_029 "RMSE or standard deviation of the measured angle  of the detection";
CM_ SG_ 775 DET_RANGE_VELOCITY_029 "Radial velocity of the detection positive in direction to the sensor";
CM_ SG_ 775 DET_RANGE_VELOCITY_ERR_029 "RMSE or standard deviation of the measure radial velocity of the detection";
CM_ SG_ 775 DET_AZIMUTH_029 "Measured angle  of the detection";
CM_ SG_ 775 DET_AZIMUTH_ERR_029 "RMSE or standard deviation of the measured angle  of the detection";
CM_ SG_ 775 DET_ELEVATION_029 "measured elevation of the detection";
CM_ SG_ 775 DET_ELEVATION_ERR_029 "RMSE or standard deviation of the measured elevation  of the detection";
CM_ SG_ 775 DET_RCS_029 "Radar Cross Section or Amplitude, is a measure of how detectable an object is by radar. A larger RCS indicates that an object is more easily detected.";
CM_ SG_ 775 DET_BI_STATIC_FLAG_029 "1 if detection is bi-static 0 otherwise";
CM_ SG_ 775 DET_SUPER_RES_TARGET_029 "flasg is set if the detection is super resolution target";
CM_ SG_ 775 DET_SNR_029 "The signal to noise ratio (SNR) of the radar detection";
CM_ SG_ 775 DET_EXISTENCE_PROB_029 "Existence probability of the detection not based on history. Value does  not depend on any past experience with similar detections.

ote Use as confidence measure where a low value means less confidence
and a high value indicates strong confidence.";
CM_ SG_ 775 DET_HVC_FLAG_029 "Core2 Vehicle clutter flag";
CM_ SG_ 775 DET_CONFD_AZIMUTH_029 "Define the Confidence of Azimuth for Detection ";
CM_ SG_ 775 DET_CONFD_ELEVATION_029 "Define the Confidence of Elevation for the Detection ";
CM_ SG_ 775 DET_BI_STATIC_FLAG_030 "1 if detection is bi-static 0 otherwise";
CM_ SG_ 775 DET_BI_STATIC_FLAG_031 "1 if detection is bi-static 0 otherwise";
CM_ SG_ 775 DET_BI_STATIC_FLAG_032 "1 if detection is bi-static 0 otherwise";
CM_ SG_ 775 DET_MH_SCAN_INDEX_4LSB_029_032 "Scan index of the measured detection";
CM_ SG_ 775 DET_MH_CYCLE_COUNTER_029_032 "Detection Alive Counter";
BA_DEF_ BO_  "VFrameFormat" ENUM  "StandardCAN","ExtendedCAN","reserved","reserved","reserved","reserved","reserved","reserved","reserved","reserved","reserved","reserved","reserved","reserved","StandardCAN_FD","ExtendedCAN_FD";
BA_DEF_ BO_  "CanTpBs" INT 0 255;
BA_DEF_ BO_  "DiagConnection" INT 0 65535;
BA_DEF_ BO_  "DiagRequest" ENUM  "No","Yes";
BA_DEF_ BO_  "DiagResponse" ENUM  "No","Yes";
BA_DEF_ BO_  "DiagState" ENUM  "No","Yes";
BA_DEF_ BO_  "E2EDataId" INT 0 65535;
BA_DEF_ BO_  "E2EDataLength" INT 0 65535;
BA_DEF_ BO_  "E2EProfile" STRING ;
BA_DEF_ BO_  "EventRateOfChange" INT 10 10000;
BA_DEF_ BO_  "GenMsgCycleTime" INT 0 100000;
BA_DEF_ BO_  "GenMsgILSupport" ENUM  "No","Yes";
BA_DEF_ BO_  "GenMsgNrOfRepetition" INT 0 100;
BA_DEF_ BO_  "GenMsgSendType" ENUM  "FixedPeriodic","Event","EnabledPeriodic","NotUsed","NotUsed","EventPeriodic","NotUsed","NotUsed","NoMsgSendType";
BA_DEF_ BO_  "NetworkInitialization" ENUM  "No","Yes";
BA_DEF_ BO_  "NmAsrMessage" ENUM  "No","Yes";
BA_DEF_ BO_  "NmMessage" ENUM  "No","Yes";
BA_DEF_ BO_  "SCP_AuthInfoTxLength" INT 0 512;
BA_DEF_ BO_  "SCP_FreshnessValueLength" INT 0 512;
BA_DEF_ BO_  "SCP_FreshnessValueTxLength" INT 0 512;
BA_DEF_ BO_  "TpTxIndex" INT 0 255;
BA_DEF_ SG_  "GenSigCmt" STRING ;
BA_DEF_ SG_  "GenSigCycleTime" INT 0 0;
BA_DEF_ SG_  "GenSigSendType" ENUM  "Cyclic","OnWrite","vector_leerstring","OnChange","vector_leerstring","IfActive","vector_leerstring","NoSigSendType";
BA_DEF_ SG_  "GenSigStartValue" INT 0 1000000000;
BA_DEF_ SG_  "GenSigTimeoutTime" INT 0 0;
BA_DEF_ SG_  "GenSigVtEn" STRING ;
BA_DEF_ SG_  "GenSigVtName" STRING ;
BA_DEF_ SG_  "InvalidValue" STRING ;
BA_DEF_ SG_  "SystemSignalLongSymbol" STRING ;
BA_DEF_DEF_  "VFrameFormat" "StandardCAN_FD";
BA_DEF_DEF_  "CanTpBs" 255;
BA_DEF_DEF_  "DiagConnection" 0;
BA_DEF_DEF_  "DiagRequest" "No";
BA_DEF_DEF_  "DiagResponse" "No";
BA_DEF_DEF_  "DiagState" "No";
BA_DEF_DEF_  "E2EDataId" 0;
BA_DEF_DEF_  "E2EDataLength" 0;
BA_DEF_DEF_  "E2EProfile" "";
BA_DEF_DEF_  "EventRateOfChange" 10000;
BA_DEF_DEF_  "GenMsgCycleTime" 0;
BA_DEF_DEF_  "GenMsgILSupport" "Yes";
BA_DEF_DEF_  "GenMsgNrOfRepetition" 0;
BA_DEF_DEF_  "GenMsgSendType" "NoMsgSendType";
BA_DEF_DEF_  "NetworkInitialization" "Yes";
BA_DEF_DEF_  "NmAsrMessage" "No";
BA_DEF_DEF_  "NmMessage" "No";
BA_DEF_DEF_  "SCP_AuthInfoTxLength" 28;
BA_DEF_DEF_  "SCP_FreshnessValueLength" 48;
BA_DEF_DEF_  "SCP_FreshnessValueTxLength" 4;
BA_DEF_DEF_  "TpTxIndex" 0;
BA_DEF_DEF_  "GenSigCmt" "";
BA_DEF_DEF_  "GenSigCycleTime" 0;
BA_DEF_DEF_  "GenSigSendType" "NoSigSendType";
BA_DEF_DEF_  "GenSigStartValue" 0;
BA_DEF_DEF_  "GenSigTimeoutTime" 0;
BA_DEF_DEF_  "GenSigVtEn" "";
BA_DEF_DEF_  "GenSigVtName" "";
BA_DEF_DEF_  "InvalidValue" "";
BA_DEF_DEF_  "SystemSignalLongSymbol" "";
BA_ "VFrameFormat" BO_ 2566890672 15;
BA_ "TpTxIndex" BO_ 53 1;
BA_ "E2EProfile" BO_ 166 "P05";
BA_ "E2EDataLength" BO_ 166 328;
BA_ "E2EDataId" BO_ 166 1446;
BA_ "GenMsgSendType" BO_ 166 1;
BA_ "E2EProfile" BO_ 165 "P05";
BA_ "E2EDataLength" BO_ 165 512;
BA_ "E2EDataId" BO_ 165 1445;
BA_ "GenMsgSendType" BO_ 165 0;
BA_ "GenMsgCycleTime" BO_ 165 50;
BA_ "E2EProfile" BO_ 167 "P05";
BA_ "E2EDataLength" BO_ 167 216;
BA_ "E2EDataId" BO_ 167 1447;
BA_ "GenMsgSendType" BO_ 167 0;
BA_ "GenMsgCycleTime" BO_ 167 50;
BA_ "NmMessage" BO_ 1280 1;
BA_ "NmAsrMessage" BO_ 1280 1;
BA_ "GenMsgSendType" BO_ 1280 0;
BA_ "GenMsgCycleTime" BO_ 1280 640;
BA_ "NmMessage" BO_ 1285 1;
BA_ "NmAsrMessage" BO_ 1285 1;
BA_ "GenMsgSendType" BO_ 1285 0;
BA_ "GenMsgCycleTime" BO_ 1285 640;
BA_ "GenMsgSendType" BO_ 768 1;
BA_ "GenMsgSendType" BO_ 51 1;
BA_ "DiagRequest" BO_ 51 1;
BA_ "GenMsgSendType" BO_ 52 1;
BA_ "DiagResponse" BO_ 52 1;
BA_ "GenMsgSendType" BO_ 1 0;
BA_ "GenMsgCycleTime" BO_ 1 1000;
BA_ "GenMsgSendType" BO_ 2 0;
BA_ "GenMsgCycleTime" BO_ 2 25;
BA_ "E2EProfile" BO_ 163 "P05";
BA_ "E2EDataLength" BO_ 163 504;
BA_ "E2EDataId" BO_ 163 1443;
BA_ "GenMsgSendType" BO_ 163 0;
BA_ "GenMsgCycleTime" BO_ 163 1000;
BA_ "E2EProfile" BO_ 164 "P05";
BA_ "E2EDataLength" BO_ 164 400;
BA_ "E2EDataId" BO_ 164 1444;
BA_ "GenMsgSendType" BO_ 164 0;
BA_ "GenMsgCycleTime" BO_ 164 50;
BA_ "E2EProfile" BO_ 160 "P05";
BA_ "E2EDataLength" BO_ 160 408;
BA_ "E2EDataId" BO_ 160 1440;
BA_ "GenMsgSendType" BO_ 160 1;
BA_ "GenMsgSendType" BO_ 48 1;
BA_ "GenMsgSendType" BO_ 49 1;
BA_ "GenMsgSendType" BO_ 50 1;
BA_ "GenMsgSendType" BO_ 769 1;
BA_ "GenMsgSendType" BO_ 770 1;
BA_ "GenMsgSendType" BO_ 771 1;
BA_ "GenMsgSendType" BO_ 772 1;
BA_ "GenMsgSendType" BO_ 773 1;
BA_ "GenMsgSendType" BO_ 774 1;
BA_ "GenMsgSendType" BO_ 775 1;
BA_ "GenMsgILSupport" BO_ 2566890673 0;
BA_ "SystemSignalLongSymbol" SG_ 3221225472 BlindSpotWarnigRelevantObjD_0000 "BlindSpotWarnigRelevantObjDetect_Tx";
BA_ "SystemSignalLongSymbol" SG_ 3221225472 BendOffPrbablityofMstImport_0000 "BendOffPrbablityofMstImportatObj_Tx";
BA_ "GenSigStartValue" SG_ 166 STS_VehicleCondition 6;
BA_ "GenSigSendType" SG_ 165 STS_StartRoll 0;
BA_ "GenSigCycleTime" SG_ 165 STS_StartRoll 50;
BA_ "GenSigSendType" SG_ 165 STS_AACurrentRoll 0;
BA_ "GenSigCycleTime" SG_ 165 STS_AACurrentRoll 50;
BA_ "GenSigSendType" SG_ 165 STS_AARoll_Std 0;
BA_ "GenSigCycleTime" SG_ 165 STS_AARoll_Std 50;
BA_ "GenSigSendType" SG_ 165 STS_RollErrorNegative 0;
BA_ "GenSigCycleTime" SG_ 165 STS_RollErrorNegative 50;
BA_ "GenSigSendType" SG_ 165 STS_Roll_Updates 0;
BA_ "GenSigCycleTime" SG_ 165 STS_Roll_Updates 50;
BA_ "GenSigSendType" SG_ 165 AL_STS_001_CYCLE_COUNTER 0;
BA_ "GenSigCycleTime" SG_ 165 AL_STS_001_CYCLE_COUNTER 50;
BA_ "GenSigSendType" SG_ 165 AL_STS_001_MH_CRC16 0;
BA_ "GenSigCycleTime" SG_ 165 AL_STS_001_MH_CRC16 50;
BA_ "GenSigSendType" SG_ 165 STS_ElevationUpdates 0;
BA_ "GenSigCycleTime" SG_ 165 STS_ElevationUpdates 50;
BA_ "GenSigSendType" SG_ 165 STS_AzimuthUpdates 0;
BA_ "GenSigCycleTime" SG_ 165 STS_AzimuthUpdates 50;
BA_ "GenSigSendType" SG_ 165 STS_HostSpdCompensationFactorQF 0;
BA_ "GenSigCycleTime" SG_ 165 STS_HostSpdCompensationFactorQF 50;
BA_ "GenSigStartValue" SG_ 165 STS_HostSpeedCompensationFactor 100;
BA_ "GenSigSendType" SG_ 165 STS_HostSpeedCompensationFactor 0;
BA_ "GenSigCycleTime" SG_ 165 STS_HostSpeedCompensationFactor 50;
BA_ "GenSigSendType" SG_ 165 STS_ElevationErrorNegative 0;
BA_ "GenSigCycleTime" SG_ 165 STS_ElevationErrorNegative 50;
BA_ "GenSigSendType" SG_ 165 STS_AzimuthErrorNegative 0;
BA_ "GenSigCycleTime" SG_ 165 STS_AzimuthErrorNegative 50;
BA_ "GenSigSendType" SG_ 165 STS_RollErrorPositive 0;
BA_ "GenSigCycleTime" SG_ 165 STS_RollErrorPositive 50;
BA_ "GenSigSendType" SG_ 165 STS_ElevationErrorPositive 0;
BA_ "GenSigCycleTime" SG_ 165 STS_ElevationErrorPositive 50;
BA_ "GenSigSendType" SG_ 165 STS_AzimuthErrorPositive 0;
BA_ "GenSigCycleTime" SG_ 165 STS_AzimuthErrorPositive 50;
BA_ "GenSigSendType" SG_ 165 STS_AAElevationStd 0;
BA_ "GenSigCycleTime" SG_ 165 STS_AAElevationStd 50;
BA_ "GenSigSendType" SG_ 165 STS_AAAzimuthStd 0;
BA_ "GenSigCycleTime" SG_ 165 STS_AAAzimuthStd 50;
BA_ "GenSigStartValue" SG_ 165 STS_AACurrentElevation 872.5;
BA_ "GenSigSendType" SG_ 165 STS_AACurrentElevation 0;
BA_ "GenSigCycleTime" SG_ 165 STS_AACurrentElevation 50;
BA_ "GenSigStartValue" SG_ 165 STS_AACurrentAzimuth 15708;
BA_ "GenSigSendType" SG_ 165 STS_AACurrentAzimuth 0;
BA_ "GenSigCycleTime" SG_ 165 STS_AACurrentAzimuth 50;
BA_ "GenSigSendType" SG_ 165 STS_StartElevation 0;
BA_ "GenSigCycleTime" SG_ 165 STS_StartElevation 50;
BA_ "GenSigSendType" SG_ 165 STS_StartAzimuth 0;
BA_ "GenSigCycleTime" SG_ 165 STS_StartAzimuth 50;
BA_ "GenSigStartValue" SG_ 165 STS_AutoAlignmentFailRootCause 5;
BA_ "GenSigSendType" SG_ 165 STS_AutoAlignmentFailRootCause 0;
BA_ "GenSigCycleTime" SG_ 165 STS_AutoAlignmentFailRootCause 50;
BA_ "GenSigSendType" SG_ 165 STS_AlignmentAutoStatus 0;
BA_ "GenSigCycleTime" SG_ 165 STS_AlignmentAutoStatus 50;
BA_ "GenSigSendType" SG_ 165 STS_CalDisplay 0;
BA_ "GenSigCycleTime" SG_ 165 STS_CalDisplay 50;
BA_ "GenSigSendType" SG_ 165 STS_AlignmentError 0;
BA_ "GenSigCycleTime" SG_ 165 STS_AlignmentError 50;
BA_ "GenSigSendType" SG_ 165 STS_ProgressPercent 0;
BA_ "GenSigCycleTime" SG_ 165 STS_ProgressPercent 50;
BA_ "GenSigSendType" SG_ 165 STS_CalTime 0;
BA_ "GenSigCycleTime" SG_ 165 STS_CalTime 50;
BA_ "GenSigSendType" SG_ 165 STS_ElevationStd 0;
BA_ "GenSigCycleTime" SG_ 165 STS_ElevationStd 50;
BA_ "GenSigSendType" SG_ 165 STS_AzimuthStd 0;
BA_ "GenSigCycleTime" SG_ 165 STS_AzimuthStd 50;
BA_ "GenSigStartValue" SG_ 165 STS_AlignmentElevation 10000;
BA_ "GenSigSendType" SG_ 165 STS_AlignmentElevation 0;
BA_ "GenSigCycleTime" SG_ 165 STS_AlignmentElevation 50;
BA_ "GenSigStartValue" SG_ 165 STS_AlignmentAzimuth 10000;
BA_ "GenSigSendType" SG_ 165 STS_AlignmentAzimuth 0;
BA_ "GenSigCycleTime" SG_ 165 STS_AlignmentAzimuth 50;
BA_ "GenSigStartValue" SG_ 165 STS_InitAlignRsltHostSpdCompFac 100;
BA_ "GenSigSendType" SG_ 165 STS_InitAlignRsltHostSpdCompFac 0;
BA_ "GenSigCycleTime" SG_ 165 STS_InitAlignRsltHostSpdCompFac 50;
BA_ "GenSigSendType" SG_ 165 STS_InitAlignRsltElevationUpdate 0;
BA_ "GenSigCycleTime" SG_ 165 STS_InitAlignRsltElevationUpdate 50;
BA_ "GenSigSendType" SG_ 165 STS_InitAlignResultAzimuthUpdate 0;
BA_ "GenSigCycleTime" SG_ 165 STS_InitAlignResultAzimuthUpdate 50;
BA_ "GenSigSendType" SG_ 165 STS_AlignmentModeOut 0;
BA_ "GenSigCycleTime" SG_ 165 STS_AlignmentModeOut 50;
BA_ "GenSigSendType" SG_ 165 STS_InitLastSuccessfulAlignMode 0;
BA_ "GenSigCycleTime" SG_ 165 STS_InitLastSuccessfulAlignMode 50;
BA_ "GenSigSendType" SG_ 165 STS_InitAlignmentResultElevation 0;
BA_ "GenSigCycleTime" SG_ 165 STS_InitAlignmentResultElevation 50;
BA_ "GenSigSendType" SG_ 165 STS_InitAlignmentResultAzimuth 0;
BA_ "GenSigCycleTime" SG_ 165 STS_InitAlignmentResultAzimuth 50;
BA_ "GenSigSendType" SG_ 165 STS_RadarTypeInput 0;
BA_ "GenSigCycleTime" SG_ 165 STS_RadarTypeInput 50;
BA_ "GenSigSendType" SG_ 165 STS_CoordinateSystemInput 0;
BA_ "GenSigCycleTime" SG_ 165 STS_CoordinateSystemInput 50;
BA_ "GenSigSendType" SG_ 165 STS_AlignmentModeIn 0;
BA_ "GenSigCycleTime" SG_ 165 STS_AlignmentModeIn 50;
BA_ "GenSigSendType" SG_ 167 CAP_MaxDetRangePedestrian_2 0;
BA_ "GenSigCycleTime" SG_ 167 CAP_MaxDetRangePedestrian_2 50;
BA_ "GenSigSendType" SG_ 167 CAP_MaxDetRangePedestrian_1 0;
BA_ "GenSigCycleTime" SG_ 167 CAP_MaxDetRangePedestrian_1 50;
BA_ "GenSigSendType" SG_ 167 CAP_MaxDetRangeMotorbike_2 0;
BA_ "GenSigCycleTime" SG_ 167 CAP_MaxDetRangeMotorbike_2 50;
BA_ "GenSigSendType" SG_ 167 CAP_MaxDetRangeMotorbike_0 0;
BA_ "GenSigCycleTime" SG_ 167 CAP_MaxDetRangeMotorbike_0 50;
BA_ "GenSigSendType" SG_ 167 CAP_MaxDetectionRangeCar_2 0;
BA_ "GenSigCycleTime" SG_ 167 CAP_MaxDetectionRangeCar_2 50;
BA_ "GenSigSendType" SG_ 167 CAP_MaxDetectionRangeCar_1 0;
BA_ "GenSigCycleTime" SG_ 167 CAP_MaxDetectionRangeCar_1 50;
BA_ "GenSigSendType" SG_ 167 CAP_SideLobeLevelBeamformer 0;
BA_ "GenSigCycleTime" SG_ 167 CAP_SideLobeLevelBeamformer 50;
BA_ "InvalidValue" SG_ 167 CAP_SLLMonitoringStatus "4";
BA_ "GenSigStartValue" SG_ 167 CAP_SLLMonitoringStatus 3;
BA_ "GenSigSendType" SG_ 167 CAP_SLLMonitoringStatus 0;
BA_ "GenSigCycleTime" SG_ 167 CAP_SLLMonitoringStatus 50;
BA_ "GenSigStartValue" SG_ 167 CAP_SLLMonitoringActive 1;
BA_ "GenSigSendType" SG_ 167 CAP_SLLMonitoringActive 0;
BA_ "GenSigCycleTime" SG_ 167 CAP_SLLMonitoringActive 50;
BA_ "GenSigSendType" SG_ 167 CAP_AngleAzimuthRangeEnd 0;
BA_ "GenSigCycleTime" SG_ 167 CAP_AngleAzimuthRangeEnd 50;
BA_ "GenSigSendType" SG_ 167 CAP_AngleAzimuthRangeStart 0;
BA_ "GenSigCycleTime" SG_ 167 CAP_AngleAzimuthRangeStart 50;
BA_ "GenSigSendType" SG_ 167 CAP_MaxDetRangePedestrian_0 0;
BA_ "GenSigCycleTime" SG_ 167 CAP_MaxDetRangePedestrian_0 50;
BA_ "GenSigSendType" SG_ 167 CAP_MaxDetRangeMotorbike_1 0;
BA_ "GenSigCycleTime" SG_ 167 CAP_MaxDetRangeMotorbike_1 50;
BA_ "GenSigSendType" SG_ 167 CAP_MaxDetectionRangeCar_0 0;
BA_ "GenSigCycleTime" SG_ 167 CAP_MaxDetectionRangeCar_0 50;
BA_ "InvalidValue" SG_ 167 CAP_RangeEstimationStatus "4";
BA_ "GenSigStartValue" SG_ 167 CAP_RangeEstimationStatus 3;
BA_ "GenSigSendType" SG_ 167 CAP_RangeEstimationStatus 0;
BA_ "GenSigCycleTime" SG_ 167 CAP_RangeEstimationStatus 50;
BA_ "GenSigStartValue" SG_ 167 CAP_RangeEstimationActive 1;
BA_ "GenSigSendType" SG_ 167 CAP_RangeEstimationActive 0;
BA_ "GenSigCycleTime" SG_ 167 CAP_RangeEstimationActive 50;
BA_ "GenSigSendType" SG_ 167 CAP_DampingStandardDeviation 0;
BA_ "GenSigCycleTime" SG_ 167 CAP_DampingStandardDeviation 50;
BA_ "InvalidValue" SG_ 167 CAP_DampingStatus "4";
BA_ "GenSigStartValue" SG_ 167 CAP_DampingStatus 3;
BA_ "GenSigSendType" SG_ 167 CAP_DampingStatus 0;
BA_ "GenSigCycleTime" SG_ 167 CAP_DampingStatus 50;
BA_ "GenSigSendType" SG_ 167 CAP_DampingActive 0;
BA_ "GenSigCycleTime" SG_ 167 CAP_DampingActive 50;
BA_ "GenSigStartValue" SG_ 167 CAP_DampingCurrent 25500;
BA_ "GenSigSendType" SG_ 167 CAP_DampingCurrent 0;
BA_ "GenSigCycleTime" SG_ 167 CAP_DampingCurrent 50;
BA_ "GenSigSendType" SG_ 167 CAP_SLBlockageFilterValue 0;
BA_ "GenSigCycleTime" SG_ 167 CAP_SLBlockageFilterValue 50;
BA_ "GenSigSendType" SG_ 167 CAP_SLBlockageFlag 0;
BA_ "GenSigCycleTime" SG_ 167 CAP_SLBlockageFlag 50;
BA_ "InvalidValue" SG_ 167 CAP_FreeSightCheckStatus "2";
BA_ "GenSigStartValue" SG_ 167 CAP_FreeSightCheckStatus 255;
BA_ "GenSigSendType" SG_ 167 CAP_FreeSightCheckStatus 0;
BA_ "GenSigCycleTime" SG_ 167 CAP_FreeSightCheckStatus 50;
BA_ "InvalidValue" SG_ 167 CAP_FreeSightCheckActive "3";
BA_ "GenSigStartValue" SG_ 167 CAP_FreeSightCheckActive 1;
BA_ "GenSigSendType" SG_ 167 CAP_FreeSightCheckActive 0;
BA_ "GenSigCycleTime" SG_ 167 CAP_FreeSightCheckActive 50;
BA_ "GenSigSendType" SG_ 167 CAP_BlockageProbability 0;
BA_ "GenSigCycleTime" SG_ 167 CAP_BlockageProbability 50;
BA_ "InvalidValue" SG_ 167 CAP_BlockageValue "6";
BA_ "GenSigStartValue" SG_ 167 CAP_BlockageValue 5;
BA_ "InvalidValue" SG_ 167 CAP_BlockageStatus "4";
BA_ "GenSigStartValue" SG_ 167 CAP_BlockageStatus 3;
BA_ "GenSigSendType" SG_ 167 CAP_BlockageStatus 0;
BA_ "GenSigCycleTime" SG_ 167 CAP_BlockageStatus 50;
BA_ "GenSigStartValue" SG_ 167 CAP_BlockageActive 1;
BA_ "GenSigSendType" SG_ 167 CAP_BlockageActive 0;
BA_ "GenSigCycleTime" SG_ 167 CAP_BlockageActive 50;
BA_ "InvalidValue" SG_ 167 CAP_BlockageSensitivity "3";
BA_ "GenSigStartValue" SG_ 167 CAP_BlockageSensitivity 2;
BA_ "GenSigSendType" SG_ 167 CAP_BlockageSensitivity 0;
BA_ "GenSigCycleTime" SG_ 167 CAP_BlockageSensitivity 50;
BA_ "GenSigStartValue" SG_ 768 DET_RANGE_VELOCITY_001 16384;
BA_ "GenSigStartValue" SG_ 768 DET_RCS_001 128;
BA_ "GenSigStartValue" SG_ 768 DET_RANGE_VELOCITY_002 16384;
BA_ "GenSigStartValue" SG_ 768 DET_RCS_002 128;
BA_ "GenSigStartValue" SG_ 768 DET_RANGE_VELOCITY_003 16384;
BA_ "GenSigStartValue" SG_ 768 DET_RCS_003 128;
BA_ "GenSigStartValue" SG_ 768 DET_RANGE_VELOCITY_004 16384;
BA_ "GenSigStartValue" SG_ 768 DET_RCS_004 128;
BA_ "GenSigStartValue" SG_ 2 SSTS_VEH_AbsoluteTime_Month 1;
BA_ "GenSigStartValue" SG_ 2 SSTS_VEH_AbsoluteTime_Day 1;
BA_ "InvalidValue" SG_ 2 SSTS_VEH_POWER_MODE_STATUS "7";
BA_ "GenSigVtName" SG_ 2 SSTS_YAW_RATE_CALC_QF "VtSig_CAN_YAW_RATE_CALC_QF";
BA_ "GenSigVtEn" SG_ 2 SSTS_YAW_RATE_CALC_QF "TRUE";
BA_ "GenSigCmt" SG_ 2 SSTS_YAW_RATE_CALC_QF "Quality factor of the CAN_YAW_RATE_CALC signal";
BA_ "GenSigCmt" SG_ 2 SSTS_YAW_RATE_BIAS "Yaw rate bias";
BA_ "GenSigStartValue" SG_ 2 SSTS_YAW_RATE_CALC 448;
BA_ "GenSigCmt" SG_ 2 SSTS_YAW_RATE_CALC "Contains the bias-compensated yaw rate";
BA_ "GenSigCmt" SG_ 2 SSTS_VEH_SPD_COMP_FACTOR "Compensated vehicle speed factor";
BA_ "GenSigVtName" SG_ 2 SSTS_VEHICLE_SPEED_CALC_QF "VtSig_CAN_VEHICLE_SPEED_CALC_QF";
BA_ "GenSigVtEn" SG_ 2 SSTS_VEHICLE_SPEED_CALC_QF "TRUE";
BA_ "GenSigCmt" SG_ 2 SSTS_VEHICLE_SPEED_CALC_QF "Quality factor of the CAN_VEHICLE_SPEED_CALC";
BA_ "GenSigCmt" SG_ 2 SSTS_VEHICLE_SPEED_CALC "Contains the compensated vehicle speed used within the FCR";
BA_ "InvalidValue" SG_ 2 SSTS_IGN_STATUS "F";
BA_ "GenSigVtName" SG_ 2 SSTS_GEAR_POSITION "VtSig_CAN_GEAR_POSITION";
BA_ "GenSigVtEn" SG_ 2 SSTS_GEAR_POSITION "TRUE";
BA_ "GenSigCmt" SG_ 2 SSTS_GEAR_POSITION "Gear Position";
BA_ "GenSigTimeoutTime" SG_ 163 STS_PCAN_PROTOCOL_VER_MINOR 150;
BA_ "GenSigSendType" SG_ 163 STS_PCAN_PROTOCOL_VER_MINOR 0;
BA_ "GenSigCycleTime" SG_ 163 STS_PCAN_PROTOCOL_VER_MINOR 50;
BA_ "GenSigTimeoutTime" SG_ 163 STS_PCAN_PROTOCOL_VER_MAJOR 150;
BA_ "GenSigSendType" SG_ 163 STS_PCAN_PROTOCOL_VER_MAJOR 0;
BA_ "GenSigCycleTime" SG_ 163 STS_PCAN_PROTOCOL_VER_MAJOR 50;
BA_ "GenSigTimeoutTime" SG_ 163 STS_SERIAL_NUMBER_SEQUENCE 150;
BA_ "GenSigStartValue" SG_ 163 STS_SERIAL_NUMBER_SEQUENCE 1234;
BA_ "GenSigSendType" SG_ 163 STS_SERIAL_NUMBER_SEQUENCE 0;
BA_ "GenSigCycleTime" SG_ 163 STS_SERIAL_NUMBER_SEQUENCE 50;
BA_ "GenSigTimeoutTime" SG_ 163 STS_SERIAL_NUM_JULIAN_YEAR 150;
BA_ "GenSigSendType" SG_ 163 STS_SERIAL_NUM_JULIAN_YEAR 0;
BA_ "GenSigCycleTime" SG_ 163 STS_SERIAL_NUM_JULIAN_YEAR 50;
BA_ "GenSigTimeoutTime" SG_ 163 STS_SERIAL_NUM_JULIAN_DAY 150;
BA_ "GenSigStartValue" SG_ 163 STS_SERIAL_NUM_JULIAN_DAY 365;
BA_ "GenSigSendType" SG_ 163 STS_SERIAL_NUM_JULIAN_DAY 0;
BA_ "GenSigCycleTime" SG_ 163 STS_SERIAL_NUM_JULIAN_DAY 50;
BA_ "GenSigStartValue" SG_ 163 STS_SENSOR_MOUNT_POS_X 8192;
BA_ "GenSigStartValue" SG_ 163 STS_SENSOR_MOUNT_POS_Y 32768;
BA_ "GenSigStartValue" SG_ 163 STS_SENSOR_MOUNT_POS_Z 32768;
BA_ "GenSigCmt" SG_ 164 STS_TKEY_ACTV_FLT_BYTE_4_to_5 "Active faults";
BA_ "GenSigCmt" SG_ 164 STS_TKEY_ACTV_FLT_BYTE_0_to_3 "Active faults";
BA_ "GenSigCmt" SG_ 164 STS_CORE_ACTV_FLT_BYTE_11_to_15 "Active faults";
BA_ "GenSigCmt" SG_ 164 STS_CORE_ACTV_FLT_BYTE_8_to_11 "Active faults";
BA_ "GenSigTimeoutTime" SG_ 164 STS_SCAN_TYPE 150;
BA_ "GenSigSendType" SG_ 164 STS_SCAN_TYPE 0;
BA_ "GenSigCycleTime" SG_ 164 STS_SCAN_TYPE 50;
BA_ "GenSigTimeoutTime" SG_ 164 STS_XCVR_OPERATIONAL 150;
BA_ "GenSigSendType" SG_ 164 STS_XCVR_OPERATIONAL 0;
BA_ "GenSigCycleTime" SG_ 164 STS_XCVR_OPERATIONAL 50;
BA_ "GenSigTimeoutTime" SG_ 164 STS_YAW_RATE_BIAS 150;
BA_ "GenSigSendType" SG_ 164 STS_YAW_RATE_BIAS 0;
BA_ "GenSigCycleTime" SG_ 164 STS_YAW_RATE_BIAS 50;
BA_ "GenSigCmt" SG_ 164 STS_CORE_ACTV_FLT_BYTE_4_to_7 "Active faults";
BA_ "GenSigTimeoutTime" SG_ 164 STS_VEH_SPEED_DIRECTION 150;
BA_ "GenSigSendType" SG_ 164 STS_VEH_SPEED_DIRECTION 0;
BA_ "GenSigCycleTime" SG_ 164 STS_VEH_SPEED_DIRECTION 50;
BA_ "GenSigTimeoutTime" SG_ 164 STS_STEERING_ANGLE_SIGN 150;
BA_ "GenSigSendType" SG_ 164 STS_STEERING_ANGLE_SIGN 0;
BA_ "GenSigCycleTime" SG_ 164 STS_STEERING_ANGLE_SIGN 50;
BA_ "GenSigTimeoutTime" SG_ 164 STS_STEERING_ANGLE 150;
BA_ "GenSigSendType" SG_ 164 STS_STEERING_ANGLE 0;
BA_ "GenSigCycleTime" SG_ 164 STS_STEERING_ANGLE 50;
BA_ "GenSigTimeoutTime" SG_ 164 STS_VEHICLE_SPEED_CALC 150;
BA_ "GenSigSendType" SG_ 164 STS_VEHICLE_SPEED_CALC 0;
BA_ "GenSigCycleTime" SG_ 164 STS_VEHICLE_SPEED_CALC 50;
BA_ "GenSigStartValue" SG_ 160 HED_R_WRAPPING 90;
BA_ "GenSigCmt" SG_ 160 HED_NUM_OF_VALID_DETECTIONS "Number of detections sent";
BA_ "GenSigCmt" SG_ 160 HED_LOOK_ID "Indicates the look type values 1 to 4 base on medium/long look and near/far look";
BA_ "GenSigCmt" SG_ 160 HED_SCAN_INDEX "Scan index for SODFL";
BA_ "GenSigStartValue" SG_ 160 HED_DATA_QUALIFIER 1;
BA_ "GenSigCmt" SG_ 160 HED_DET_RANGE_MAX "CAN range coverage";
BA_ "GenSigStartValue" SG_ 160 HED_DET_SPEED_RANGE_MAX 32768;
BA_ "GenSigCmt" SG_ 160 HED_DET_SPEED_RANGE_MAX "CAN range coverage";
BA_ "GenSigCmt" SG_ 160 HED_FOV_HOR_MAX "CAN range coverage";
BA_ "GenSigCmt" SG_ 160 HED_FOV_VER_MAX "CAN range coverage";
BA_ "GenSigStartValue" SG_ 160 HED_DET_SPEED_RANGE_MIN 32768;
BA_ "GenSigStartValue" SG_ 160 HED_FOV_HOR_MIN 128;
BA_ "GenSigStartValue" SG_ 769 DET_RANGE_VELOCITY_005 16384;
BA_ "GenSigStartValue" SG_ 769 DET_RCS_005 128;
BA_ "GenSigStartValue" SG_ 769 DET_RANGE_VELOCITY_006 16384;
BA_ "GenSigStartValue" SG_ 769 DET_RCS_006 128;
BA_ "GenSigStartValue" SG_ 769 DET_RANGE_VELOCITY_007 16384;
BA_ "GenSigStartValue" SG_ 769 DET_RCS_007 128;
BA_ "GenSigStartValue" SG_ 769 DET_RANGE_VELOCITY_008 16384;
BA_ "GenSigStartValue" SG_ 769 DET_RCS_008 128;
BA_ "GenSigStartValue" SG_ 770 DET_RANGE_VELOCITY_009 16384;
BA_ "GenSigStartValue" SG_ 770 DET_RCS_009 128;
BA_ "GenSigStartValue" SG_ 770 DET_RANGE_VELOCITY_010 16384;
BA_ "GenSigStartValue" SG_ 770 DET_RCS_010 128;
BA_ "GenSigStartValue" SG_ 770 DET_RANGE_VELOCITY_011 16384;
BA_ "GenSigStartValue" SG_ 770 DET_RCS_011 128;
BA_ "GenSigStartValue" SG_ 770 DET_RANGE_VELOCITY_012 16384;
BA_ "GenSigStartValue" SG_ 770 DET_RCS_012 128;
BA_ "GenSigStartValue" SG_ 771 DET_RANGE_VELOCITY_013 16384;
BA_ "GenSigStartValue" SG_ 771 DET_RCS_013 128;
BA_ "GenSigStartValue" SG_ 771 DET_RANGE_VELOCITY_014 16384;
BA_ "GenSigStartValue" SG_ 771 DET_RCS_014 128;
BA_ "GenSigStartValue" SG_ 771 DET_RANGE_VELOCITY_015 16384;
BA_ "GenSigStartValue" SG_ 771 DET_RCS_015 128;
BA_ "GenSigStartValue" SG_ 771 DET_RANGE_VELOCITY_016 16384;
BA_ "GenSigStartValue" SG_ 771 DET_RCS_016 128;
BA_ "GenSigStartValue" SG_ 772 DET_RANGE_VELOCITY_017 16384;
BA_ "GenSigStartValue" SG_ 772 DET_RCS_017 128;
BA_ "GenSigStartValue" SG_ 772 DET_RANGE_VELOCITY_018 16384;
BA_ "GenSigStartValue" SG_ 772 DET_RCS_018 128;
BA_ "GenSigStartValue" SG_ 772 DET_RANGE_VELOCITY_019 16384;
BA_ "GenSigStartValue" SG_ 772 DET_RCS_019 128;
BA_ "GenSigStartValue" SG_ 772 DET_RANGE_VELOCITY_020 16384;
BA_ "GenSigStartValue" SG_ 772 DET_RCS_020 128;
BA_ "GenSigStartValue" SG_ 773 DET_RANGE_VELOCITY_021 16384;
BA_ "GenSigStartValue" SG_ 773 DET_RCS_021 128;
BA_ "GenSigStartValue" SG_ 773 DET_RANGE_VELOCITY_022 16384;
BA_ "GenSigStartValue" SG_ 773 DET_RCS_022 128;
BA_ "GenSigStartValue" SG_ 773 DET_RANGE_VELOCITY_023 16384;
BA_ "GenSigStartValue" SG_ 773 DET_RCS_023 128;
BA_ "GenSigStartValue" SG_ 773 DET_RANGE_VELOCITY_024 16384;
BA_ "GenSigStartValue" SG_ 773 DET_RCS_024 128;
BA_ "GenSigStartValue" SG_ 774 DET_RANGE_VELOCITY_025 16384;
BA_ "GenSigStartValue" SG_ 774 DET_RCS_025 128;
BA_ "GenSigStartValue" SG_ 774 DET_RANGE_VELOCITY_026 16384;
BA_ "GenSigStartValue" SG_ 774 DET_RCS_026 128;
BA_ "GenSigStartValue" SG_ 774 DET_RANGE_VELOCITY_027 16384;
BA_ "GenSigStartValue" SG_ 774 DET_RCS_027 128;
BA_ "GenSigStartValue" SG_ 774 DET_RANGE_VELOCITY_028 16384;
BA_ "GenSigStartValue" SG_ 774 DET_RCS_028 128;
BA_ "GenSigStartValue" SG_ 775 DET_RANGE_VELOCITY_029 16384;
BA_ "GenSigStartValue" SG_ 775 DET_RCS_029 128;
BA_ "GenSigStartValue" SG_ 775 DET_RANGE_VELOCITY_030 16384;
BA_ "GenSigStartValue" SG_ 775 DET_RCS_030 128;
BA_ "GenSigStartValue" SG_ 775 DET_RANGE_VELOCITY_031 16384;
BA_ "GenSigStartValue" SG_ 775 DET_RCS_031 128;
BA_ "GenSigStartValue" SG_ 775 DET_RANGE_VELOCITY_032 16384;
BA_ "GenSigStartValue" SG_ 775 DET_RCS_032 128;
VAL_ 2566890672 BlindSpotDetectionState 15 "not available / not installed" 14 "error indication / temp error" 13 "reserved for future use" 12 "reserved for future use" 11 "reserved for future use" 10 "reserved for future use" 9 "reserved for future use" 8 "not used" 7 "not used" 6 "not used" 5 "collision warning active" 4 "not used" 3 "system is ready and activated" 2 "system is deactivated by driver" 1 "not used" 0 "system is not ready" ;
VAL_ 166 STS_AlignmentShortTrackStatus 0 "AShortTrackSts_Off" 1 "AShortTrackSts_Running" 2 "AShortTrackSts_Paused" 3 "AShortTrackSts_Failed" 4 "AShortTrackSts_Success" ;
VAL_ 166 STS_VehicleCondition 0 "VelocityTooLow" 1 "VelocityTooHigh" 2 "YawRateTooHigh" 3 "QualityFctrVelocityInsufficient" 4 "QualityFctrYawRateInsufficient" 5 "VehicleInReverse" 6 "NoIssue" ;
VAL_ 166 STS_AlignmentServiceStatus 0 "AServcStatus_Off" 1 "AServcStatus_Running" 2 "AServcStatus_Paused" 3 "AServcStatus_Failed" 4 "AServcStatus_Success" ;
VAL_ 166 STS_AlignmentStaticStatus 0 "AlgnAuto_Off" 1 "AlgnAuto_Running" 2 "AlgnAuto_Paused" 3 "AlgnAuto_Failed" 4 "AlgnAuto_Success" ;
VAL_ 165 STS_HostSpdCompensationFactorQF 0 "DRA_QF_UNKNOWN" 1 "DRA_QF_FAULTY" 2 "DRA_QF_INACCURATE" 3 "DRA_QF_ACCURATE" ;
VAL_ 165 STS_AutoAlignmentFailRootCause 0 "InvalidInput" 1 "SensorFacingUpwards" 2 "SensorFacingDownwards" 3 "SensorFacingRight" 4 "SensorFacingLeft" 5 "VelocityTooLow" 6 "YawRateTooHigh" 7 "VehicleReverse" 8 "InvalidVehicleSignal" 9 "TargetsTooSlow" 10 "QualityTooLow" 11 "Blockage" 12 "OperationModeFaulty" 13 "DataQualifierInvalid" 14 "SuddenJumpDetection" 15 "CriticalMisalignment" 16 "CorruptedNVM" 17 "InaccurateMisalignValue" 18 "InitAlignNotDone" 19 "AlignQFNotOk" 20 "TrailerCncted_AutoAlgnLimited" 255 "AA_None" ;
VAL_ 165 STS_AlignmentAutoStatus 0 "AAstatus_Off" 1 "AAstatus_Active" 2 "AAstatus_Paused" 3 "AAstatus_Failed" 4 "AAstatus_Success" ;
VAL_ 165 STS_CalDisplay 0 "CalDisplay_None" 1 "CalDisplay_Display" ;
VAL_ 165 STS_AlignmentError 0 "NoError" 1 "SensorFacingUpwards" 2 "SensorFacingDownwards" 3 "SensorFacingRight" 4 "SensorFacingLeft" 7 "TargetSignalTooWeak" 8 "TargetSignalTooStrong" 9 "TargetNotStatic" 10 "TargetDistanceTooHigh" 11 "TargetDistanceTooLow" 12 "TargetNotFound" 13 "Interference" 14 "InvalidInput" 15 "InvalidVehicleSignal" 16 "Blockage" 17 "MaxDistanceCrossed" 18 "MaxDurationCrossed" 19 "OperationModeFaulty _Dyn" 20 "DataQualifierInvalid_Dyn" ;
VAL_ 165 STS_AlignmentModeOut 0 "AModeOut_Off" 1 "AutoAlignment" 2 "ShortTrackAlignment" 3 "ServiceAlignment" 4 "StaticAlignment" ;
VAL_ 165 STS_InitLastSuccessfulAlignMode 0 "LastAMode_None" 1 "LastAMode_NotUsed" 2 "ShortTrackAlignment" 3 "ServiceAlignment" 4 "StaticAlignment" 5 "ExternalAlignment" ;
VAL_ 165 STS_RadarTypeInput 0 "DRA_RADAR_TYPE_UNKNOWN" 1 "DRA_RADAR_TYPE_SRR6" 2 "DRA_RADAR_TYPE_SRR6P_HIGH_GAIN" 3 "DRA_RADAR_TYPE_SRR6P_LOW_GAIN" 4 "DRA_RADAR_TYPE_SRR7P" 5 "DRA_RADAR_TYPE_FLR4 " 6 "DRA_RADAR_TYPE_FLR4P" 7 "DRA_RADAR_TYPE_FLR7" ;
VAL_ 165 STS_CoordinateSystemInput 0 "DRA_DET_COORD_SYS_UNDEFINED" 1 "DRA_DET_COORD_SYS_SAE" 2 "DRA_DET_COORD_SYS_ISO" ;
VAL_ 165 STS_AlignmentModeIn 0 "AModeIn_Off" 1 "AutoAlignment" 2 "ShortTrackAlignment" 3 "ServiceAlignment" 4 "StaticAlignment" 5 "ManualAlignment" ;
VAL_ 167 CAP_SLLMonitoringStatus 0 "SLL_Faulty" 1 "SLL_Ok" 2 "SLL_Reserved" 3 "SLL_Initialization" 4 "SLL_Invalid" ;
VAL_ 167 CAP_SLLMonitoringActive 0 "SLLMonitor_Off" 1 "SLLMonitor_Active" ;
VAL_ 167 CAP_RangeEstimationStatus 0 "RgeEstim_Faulty" 1 "RgeEstim_Ok" 2 "RgeEstim_Reserved" 3 "RgeEstim_Initialization" 4 "RgeEstim_Invalid" ;
VAL_ 167 CAP_RangeEstimationActive 0 "RgeEstim_Off" 1 "RgeEstim_Active" ;
VAL_ 167 CAP_DampingStatus 0 "Damp_Faulty" 1 "Damp_Ok" 2 "Damp_Reserved" 3 "Damp_Initialization" 4 "Damp_Invalid" ;
VAL_ 167 CAP_DampingActive 0 "Damp_Off" 1 "Damp_Active" ;
VAL_ 167 CAP_SLBlockageFlag 0 "Not_Degraded" 1 "Degraded" ;
VAL_ 167 CAP_FreeSightCheckStatus 0 "CAP_SightCheckStatus_Ok" 1 "CAP_SightCheckStatus_Failed" 255 "CAP_SightCheckStatus_Invalid" ;
VAL_ 167 CAP_FreeSightCheckActive 0 "CAP_SightCheck_Active" 1 "CAP_SightCheck_Inactive" 2 "CAP_SightCheck_Paused" 255 "CAP_SightCheck_Invalid" ;
VAL_ 167 CAP_BlockageValue 0 "Not_Blocked" 1 "Slightly_Blocked" 2 "Moderately_Blocked" 3 "Highly_Blocked" 4 "Fully_Blocked" 5 "Limited_Sight" 6 "BlockgVal_Invalid" ;
VAL_ 167 CAP_BlockageStatus 0 "BlockSts_Faulty" 1 "BlockSts_Ok" 2 "BlockSts_Reserved" 3 "BlockSts_Initialization" 4 "BlockSts_Invalid" ;
VAL_ 167 CAP_BlockageActive 0 "Blockage_Active" 1 "Blockage_Off" ;
VAL_ 167 CAP_BlockageSensitivity 0 "CAP_BlockgSens_Low" 1 "CAP_BlockgSens_Mid" 2 "CAP_BlockgSens_High" 255 "CAP_BlockgSens_Invalid" ;
VAL_ 768 DET_CONFD_AZIMUTH_001 0 "High" 1 "MidHigh" 2 "MidLow" 3 "Low" ;
VAL_ 768 DET_CONFD_ELEVATION_001 0 "High" 1 "MidHigh" 2 "MidLow" 3 "Low" ;
VAL_ 768 DET_IDM_001 0 "Not_IDM_Output" 1 "IDM_Output" ;
VAL_ 768 DET_MTD_001 0 "Not_MTD_Output" 1 "MTD_Output" ;
VAL_ 768 DET_BELOW_RAIN_THOLD_001 0 "DetBelowRainThold" 1 "DetAboveRainThold" ;
VAL_ 768 DET_CONFD_AZIMUTH_002 0 "High" 1 "MidHigh" 2 "MidLow" 3 "Low" ;
VAL_ 768 DET_CONFD_ELEVATION_002 0 "High" 1 "MidHigh" 2 "MidLow" 3 "Low" ;
VAL_ 768 DET_IDM_002 0 "Not_IDM_Output" 1 "IDM_Output" ;
VAL_ 768 DET_MTD_002 0 "Not_MTD_Output" 1 "MTD_Output" ;
VAL_ 768 DET_BELOW_RAIN_THOLD_002 0 "DetBelowRainThold" 1 "DetAboveRainThold" ;
VAL_ 768 DET_CONFD_AZIMUTH_003 0 "High" 1 "MidHigh" 2 "MidLow" 3 "Low" ;
VAL_ 768 DET_CONFD_ELEVATION_003 0 "High" 1 "MidHigh" 2 "MidLow" 3 "Low" ;
VAL_ 768 DET_IDM_003 0 "Not_IDM_Output" 1 "IDM_Output" ;
VAL_ 768 DET_MTD_003 0 "Not_MTD_Output" 1 "MTD_Output" ;
VAL_ 768 DET_BELOW_RAIN_THOLD_003 0 "DetBelowRainThold" 1 "DetAboveRainThold" ;
VAL_ 768 DET_IDM_004 0 "Not_IDM_Output" 1 "IDM_Output" ;
VAL_ 768 DET_MTD_004 0 "Not_MTD_Output" 1 "MTD_Output" ;
VAL_ 768 DET_BELOW_RAIN_THOLD_004 0 "DetBelowRainThold" 1 "DetAboveRainThold" ;
VAL_ 1 TSYN_SGW 0 "SyncToGTM" 1 "SyncToSubDomain" ;
VAL_ 1 TSYN_PDU 32 "CAN-SYN" 40 "CAN-FUP" ;
VAL_ 2 SSTS_VEH_TRAILER_CONNECTED 0 "TrailerConnected_False" 1 "TrailerConnected_True" ;
VAL_ 2 SSTS_VEH_VARIANT 0 "Veh_Line_1" 1 "Veh_Line_2" 2 "Veh_Line_3" 3 "Veh_Line_4" ;
VAL_ 2 SSTS_DRIVE_REVERSE 0 "Driving_Forward" 1 "Driving_Reverse" ;
VAL_ 2 SSTS_VEHICLE_STATE 0 "Unknown" 1 "VehicleParked" 2 "VehicleAlive" 3 "VehicleEntry" 4 "VehicleDriving" 5 "VehicleUpgrade" ;
VAL_ 2 SSTS_VEH_POWER_MODE_STATUS 0 "VehPwrMode_Off" 1 "VehPwrMode_Standby" 2 "VehPwrMode_Accessories" 3 "VehPwrMode_IgnitionOn" 4 "VehPwrMode_HVOn" 5 "VehPwrMode_Reserved1" 6 "VehPwrMode_Reserved2" 7 "VehPwrMode_Invalid" ;
VAL_ 2 SSTS_YAW_RATE_CALC_QF 0 "YawRateCalcQF_Undefined" 1 "YawRateCalcQF_TempUndefined" 2 "YawRateCalcQF_Innaccurate" 3 "YawRateCalcQF_Accurate" ;
VAL_ 2 SSTS_VEHICLE_SPEED_CALC_QF 0 "VehSpdCalcQF_Undefined" 1 "VehSpdCalcQF_TempUndefined" 2 "VehSpdCalcQF_Innaccurate" 3 "VehSpdCalcQF_Accurate" ;
VAL_ 2 SSTS_IGN_STATUS 0 "IgnSts_Unknown" 1 "IgnSts_Off" 2 "IgnSts_Accessory" 3 "IgnSts_Run" 4 "IgnSts_Start" 5 "IgnSts_Invalid" ;
VAL_ 2 SSTS_GEAR_POSITION 0 "GearPosition_Park" 1 "GearPosition_Reverse" 2 "GearPosition_Neutral" 3 "GearPosition_Drive" 4 "GearPosition_Sport_DriveSport" 5 "GearPosition_Low" 6 "GearPosition_First" 7 "GearPosition_Second" 8 "GearPosition_Third" 9 "GearPosition_Fourth" 10 "GearPosition_Fifth" 11 "GearPosition_Sixth" 12 "GearPosition_NotUsed_1" 13 "GearPosition_NotUsed_2" 14 "GearPosition_Unknown_Position" 15 "GearPosition_Fault" ;
VAL_ 163 STS_VIN_Status 0 "VINsts_Init" 1 "VINsts_Invalid" 2 "VINsts_Successful" 3 "VINsts_Unsuccessful" ;
VAL_ 163 STS_PLATFORM_VARIANT 18 "VARIANT_FLR8" 17 " VARIANT_SRR8" 0 "VARIANT_INVALID" 1 "VARIANT_MRR3" 2 "VARIANT_SRR5" 3 "VARIANT_RACAM" 4 "VARIANT_MRR360" 5 "VARIANT_MRR3LLP" 6 "VARIANT_MRR3LLP_STD" 7 "VARIANT_MRR3LLP_AMOD" 8 "VARIANT_SRRAD" 9 "VARIANT_FLR4" 10 "VARIANT_FLR4PLUS" 11 "VARIANT_SRR6" 12 "VARIANT_SRR6PLUS" 13 "VARIANT_SRR_V2" 14 "VARIANT_FLR_V2" 15 "VARIANT_SRR_V1" 16 "VARIANT_FLR_V1" ;
VAL_ 163 STS_HARDWARE_VERSION 0 "EDU" 1 "A1" 2 "B1_USCAR" 3 "CEER" 4 "UNDEFINED" 5 "RESERVED" ;
VAL_ 163 STS_SMC_PLATFROM_VERSION 0 "INVALID" 1 "MRR3" 2 "SRR5" 3 "RACAM" 4 "MRR360" 5 "MRR3LLP" 6 "MRRLLP_STD" 7 "MRRLLP_AMOD" 8 "SRRAD" 9 "FLR4" 10 "FLR4PLUS" 11 "SRR6" 12 "SRR6PLUS" 13 "SRR8" 14 "FLR8" ;
VAL_ 163 STS_SENSOR_POSITION 0 "Reserved_0" 1 "Rear_Left" 2 "Rear_Right" 3 "Front_Right" 4 "Front_Left" 5 "Front_Center" 6 "Reserved_6" 7 "Reserved_7" ;
VAL_ 164 STS_Yaw_Rate_Calc_QF 0 "YawRateCalcQF_Undefined" 1 "YawRateCalcQF_TempUndefined" 2 "YawRateCalcQF_Innaccurate" 3 "YawRateCalcQF_Accurate" ;
VAL_ 164 STS_Vehicle_Speed_Calc_QF 0 "VehSpdCalcQF_Undefined" 1 "VehSpdCalcQF_TempUndefined" 2 "VehSpdCalcQF_Innaccurate" 3 "VehSpdCalcQF_Accurate" ;
VAL_ 164 STS_Gear_Position 0 "GearPosition_Park" 1 "GearPosition_Reverse" 2 "GearPosition_Neutral" 3 "GearPosition_Drive" 4 "GearPosition_Sport_DriveSport" 5 "GearPosition_Low" 6 "GearPosition_First" 7 "GearPosition_Second" 8 "GearPosition_Third" 9 "GearPosition_Fourth" 10 "GearPosition_Fifth" 11 "GearPosition_Sixth" 12 "GearPosition_NotUsed_1" 13 "GearPosition_NotUsed_2" 14 "GearPosition_Unknown_Position" 15 "GearPosition_Fault" ;
VAL_ 164 STS_VEHICLE_SUPPLY_VOLTAGE 0 "normV" 1 "lowVtemp" 2 "lowVtempToNorm" 3 "lowV1" 4 "lowV2" 5 "lowV1ToNorm" 6 "lowV2ToNorm" 7 "highVtemp" 8 "highVtempToNorm" 9 "highV1" 10 "highV2" 11 "highV1ToNorm" 12 "highV2ToNorm" ;
VAL_ 164 STS_BRR_STATUS 0 "BRR_Inactive" 1 "BRR_Active" 2 "BRR_Fault" ;
VAL_ 164 STS_SCAN_TYPE 0 "MEDIUM_LOOK" 1 "LONG_LOOK" ;
VAL_ 160 HED_Rain_Level 0 "No_Rain" 1 "Low_Medium" 2 "Medium_High" ;
VAL_ 160 HED_SLOPE_CORR_EXECUTIONFLAG 0 "AzimuthElevationNotCompensated" 1 "AzimuthCompensated" 2 "ElevationCompensated" 3 "AzimuthElevationCompensated" ;
VAL_ 160 HED_OPERATION_MODE 0 "Init_MCU" 1 "Radar_Not_Configured" 2 "Operational" 3 "OpMode_Faulty" 4 "Shutdown_Initiated" 5 "Power_Off" ;
VAL_ 160 HED_LOOK_ID 0 "LOOK_A" 1 "LOOK_B" 2 "LOOK_C" 3 "LOOK_D" ;
VAL_ 160 HED_DATA_QUALIFIER 0 "DataQual_Invalid" 1 "Not_Available" 2 "Reduced_In_Performance" 3 "Test_Mode" 4 "DataQual_Normal" 5 "Reduced_In_Coverage" 6 "Reduced_In_Perf_And_Cov" 7 "DataQual_Unknown" ;
VAL_ 160 HED_TIME_SYNC_SRC_MASTER 0 "LOCAL" 1 "GLOBAL" ;
VAL_ 160 HED_TIME_SYNC_VALIDITY_FLAG 0 "OUT_OF_SYNC" 1 "SYNCED_AT_LEAST_ONCE" 2 "SYNC_MSG_TIMEOUT_OR_CRC_ERR" ;
VAL_ 769 DET_CONFD_AZIMUTH_005 0 "High" 1 "MidHigh" 2 "MidLow" 3 "Low" ;
VAL_ 769 DET_CONFD_ELEVATION_005 0 "High" 1 "MidHigh" 2 "MidLow" 3 "Low" ;
VAL_ 769 DET_IDM_005 0 "Not_IDM_Output" 1 "IDM_Output" ;
VAL_ 769 DET_MTD_005 0 "Not_MTD_Output" 1 "MTD_Output" ;
VAL_ 769 DET_BELOW_RAIN_THOLD_005 0 "DetBelowRainThold" 1 "DetAboveRainThold" ;
VAL_ 769 DET_CONFD_AZIMUTH_006 0 "High" 1 "MidHigh" 2 "MidLow" 3 "Low" ;
VAL_ 769 DET_CONFD_ELEVATION_006 0 "High" 1 "MidHigh" 2 "MidLow" 3 "Low" ;
VAL_ 769 DET_IDM_006 0 "Not_IDM_Output" 1 "IDM_Output" ;
VAL_ 769 DET_MTD_006 0 "Not_MTD_Output" 1 "MTD_Output" ;
VAL_ 769 DET_BELOW_RAIN_THOLD_006 0 "DetBelowRainThold" 1 "DetAboveRainThold" ;
VAL_ 769 DET_CONFD_AZIMUTH_007 0 "High" 1 "MidHigh" 2 "MidLow" 3 "Low" ;
VAL_ 769 DET_CONFD_ELEVATION_007 0 "High" 1 "MidHigh" 2 "MidLow" 3 "Low" ;
VAL_ 769 DET_IDM_007 0 "Not_IDM_Output" 1 "IDM_Output" ;
VAL_ 769 DET_MTD_007 0 "Not_MTD_Output" 1 "MTD_Output" ;
VAL_ 769 DET_BELOW_RAIN_THOLD_007 0 "DetBelowRainThold" 1 "DetAboveRainThold" ;
VAL_ 769 DET_IDM_008 0 "Not_IDM_Output" 1 "IDM_Output" ;
VAL_ 769 DET_MTD_008 0 "Not_MTD_Output" 1 "MTD_Output" ;
VAL_ 769 DET_BELOW_RAIN_THOLD_008 0 "DetBelowRainThold" 1 "DetAboveRainThold" ;
VAL_ 770 DET_CONFD_AZIMUTH_009 0 "High" 1 "MidHigh" 2 "MidLow" 3 "Low" ;
VAL_ 770 DET_CONFD_ELEVATION_009 0 "High" 1 "MidHigh" 2 "MidLow" 3 "Low" ;
VAL_ 770 DET_IDM_009 0 "Not_IDM_Output" 1 "IDM_Output" ;
VAL_ 770 DET_MTD_009 0 "Not_MTD_Output" 1 "MTD_Output" ;
VAL_ 770 DET_BELOW_RAIN_THOLD_009 0 "DetBelowRainThold" 1 "DetAboveRainThold" ;
VAL_ 770 DET_CONFD_AZIMUTH_010 0 "High" 1 "MidHigh" 2 "MidLow" 3 "Low" ;
VAL_ 770 DET_CONFD_ELEVATION_010 0 "High" 1 "MidHigh" 2 "MidLow" 3 "Low" ;
VAL_ 770 DET_IDM_010 0 "Not_IDM_Output" 1 "IDM_Output" ;
VAL_ 770 DET_MTD_010 0 "Not_MTD_Output" 1 "MTD_Output" ;
VAL_ 770 DET_BELOW_RAIN_THOLD_010 0 "DetBelowRainThold" 1 "DetAboveRainThold" ;
VAL_ 770 DET_CONFD_AZIMUTH_011 0 "High" 1 "MidHigh" 2 "MidLow" 3 "Low" ;
VAL_ 770 DET_CONFD_ELEVATION_011 0 "High" 1 "MidHigh" 2 "MidLow" 3 "Low" ;
VAL_ 770 DET_IDM_011 0 "Not_IDM_Output" 1 "IDM_Output" ;
VAL_ 770 DET_MTD_011 0 "Not_MTD_Output" 1 "MTD_Output" ;
VAL_ 770 DET_BELOW_RAIN_THOLD_011 0 "DetBelowRainThold" 1 "DetAboveRainThold" ;
VAL_ 770 DET_IDM_012 0 "Not_IDM_Output" 1 "IDM_Output" ;
VAL_ 770 DET_MTD_012 0 "Not_MTD_Output" 1 "MTD_Output" ;
VAL_ 770 DET_BELOW_RAIN_THOLD_012 0 "DetBelowRainThold" 1 "DetAboveRainThold" ;
VAL_ 771 DET_CONFD_AZIMUTH_013 0 "High" 1 "MidHigh" 2 "MidLow" 3 "Low" ;
VAL_ 771 DET_CONFD_ELEVATION_013 0 "High" 1 "MidHigh" 2 "MidLow" 3 "Low" ;
VAL_ 771 DET_IDM_013 0 "Not_IDM_Output" 1 "IDM_Output" ;
VAL_ 771 DET_MTD_013 0 "Not_MTD_Output" 1 "MTD_Output" ;
VAL_ 771 DET_BELOW_RAIN_THOLD_013 0 "DetBelowRainThold" 1 "DetAboveRainThold" ;
VAL_ 771 DET_CONFD_AZIMUTH_014 0 "High" 1 "MidHigh" 2 "MidLow" 3 "Low" ;
VAL_ 771 DET_CONFD_ELEVATION_014 0 "High" 1 "MidHigh" 2 "MidLow" 3 "Low" ;
VAL_ 771 DET_IDM_014 0 "Not_IDM_Output" 1 "IDM_Output" ;
VAL_ 771 DET_MTD_014 0 "Not_MTD_Output" 1 "MTD_Output" ;
VAL_ 771 DET_BELOW_RAIN_THOLD_014 0 "DetBelowRainThold" 1 "DetAboveRainThold" ;
VAL_ 771 DET_CONFD_AZIMUTH_015 0 "High" 1 "MidHigh" 2 "MidLow" 3 "Low" ;
VAL_ 771 DET_CONFD_ELEVATION_015 0 "High" 1 "MidHigh" 2 "MidLow" 3 "Low" ;
VAL_ 771 DET_IDM_015 0 "Not_IDM_Output" 1 "IDM_Output" ;
VAL_ 771 DET_MTD_015 0 "Not_MTD_Output" 1 "MTD_Output" ;
VAL_ 771 DET_BELOW_RAIN_THOLD_015 0 "DetBelowRainThold" 1 "DetAboveRainThold" ;
VAL_ 771 DET_IDM_016 0 "Not_IDM_Output" 1 "IDM_Output" ;
VAL_ 771 DET_MTD_016 0 "Not_MTD_Output" 1 "MTD_Output" ;
VAL_ 771 DET_BELOW_RAIN_THOLD_016 0 "DetBelowRainThold" 1 "DetAboveRainThold" ;
VAL_ 772 DET_CONFD_AZIMUTH_017 0 "High" 1 "MidHigh" 2 "MidLow" 3 "Low" ;
VAL_ 772 DET_CONFD_ELEVATION_017 0 "High" 1 "MidHigh" 2 "MidLow" 3 "Low" ;
VAL_ 772 DET_IDM_017 0 "Not_IDM_Output" 1 "IDM_Output" ;
VAL_ 772 DET_MTD_017 0 "Not_MTD_Output" 1 "MTD_Output" ;
VAL_ 772 DET_BELOW_RAIN_THOLD_017 0 "DetBelowRainThold" 1 "DetAboveRainThold" ;
VAL_ 772 DET_CONFD_AZIMUTH_018 0 "High" 1 "MidHigh" 2 "MidLow" 3 "Low" ;
VAL_ 772 DET_CONFD_ELEVATION_018 0 "High" 1 "MidHigh" 2 "MidLow" 3 "Low" ;
VAL_ 772 DET_IDM_018 0 "Not_IDM_Output" 1 "IDM_Output" ;
VAL_ 772 DET_MTD_018 0 "Not_MTD_Output" 1 "MTD_Output" ;
VAL_ 772 DET_BELOW_RAIN_THOLD_018 0 "DetBelowRainThold" 1 "DetAboveRainThold" ;
VAL_ 772 DET_CONFD_AZIMUTH_019 0 "High" 1 "MidHigh" 2 "MidLow" 3 "Low" ;
VAL_ 772 DET_CONFD_ELEVATION_019 0 "High" 1 "MidHigh" 2 "MidLow" 3 "Low" ;
VAL_ 772 DET_IDM_019 0 "Not_IDM_Output" 1 "IDM_Output" ;
VAL_ 772 DET_MTD_019 0 "Not_MTD_Output" 1 "MTD_Output" ;
VAL_ 772 DET_BELOW_RAIN_THOLD_019 0 "DetBelowRainThold" 1 "DetAboveRainThold" ;
VAL_ 772 DET_IDM_020 0 "Not_IDM_Output" 1 "IDM_Output" ;
VAL_ 772 DET_MTD_020 0 "Not_MTD_Output" 1 "MTD_Output" ;
VAL_ 772 DET_BELOW_RAIN_THOLD_020 0 "DetBelowRainThold" 1 "DetAboveRainThold" ;
VAL_ 773 DET_CONFD_AZIMUTH_021 0 "High" 1 "MidHigh" 2 "MidLow" 3 "Low" ;
VAL_ 773 DET_CONFD_ELEVATION_021 0 "High" 1 "MidHigh" 2 "MidLow" 3 "Low" ;
VAL_ 773 DET_IDM_021 0 "Not_IDM_Output" 1 "IDM_Output" ;
VAL_ 773 DET_MTD_021 0 "Not_MTD_Output" 1 "MTD_Output" ;
VAL_ 773 DET_BELOW_RAIN_THOLD_021 0 "DetBelowRainThold" 1 "DetAboveRainThold" ;
VAL_ 773 DET_CONFD_AZIMUTH_022 0 "High" 1 "MidHigh" 2 "MidLow" 3 "Low" ;
VAL_ 773 DET_CONFD_ELEVATION_022 0 "High" 1 "MidHigh" 2 "MidLow" 3 "Low" ;
VAL_ 773 DET_IDM_022 0 "Not_IDM_Output" 1 "IDM_Output" ;
VAL_ 773 DET_MTD_022 0 "Not_MTD_Output" 1 "MTD_Output" ;
VAL_ 773 DET_BELOW_RAIN_THOLD_022 0 "DetBelowRainThold" 1 "DetAboveRainThold" ;
VAL_ 773 DET_CONFD_AZIMUTH_023 0 "High" 1 "MidHigh" 2 "MidLow" 3 "Low" ;
VAL_ 773 DET_CONFD_ELEVATION_023 0 "High" 1 "MidHigh" 2 "MidLow" 3 "Low" ;
VAL_ 773 DET_IDM_023 0 "Not_IDM_Output" 1 "IDM_Output" ;
VAL_ 773 DET_MTD_023 0 "Not_MTD_Output" 1 "MTD_Output" ;
VAL_ 773 DET_BELOW_RAIN_THOLD_023 0 "DetBelowRainThold" 1 "DetAboveRainThold" ;
VAL_ 773 DET_IDM_024 0 "Not_IDM_Output" 1 "IDM_Output" ;
VAL_ 773 DET_MTD_024 0 "Not_MTD_Output" 1 "MTD_Output" ;
VAL_ 773 DET_BELOW_RAIN_THOLD_024 0 "DetBelowRainThold" 1 "DetAboveRainThold" ;
VAL_ 774 DET_CONFD_AZIMUTH_025 0 "High" 1 "MidHigh" 2 "MidLow" 3 "Low" ;
VAL_ 774 DET_CONFD_ELEVATION_025 0 "High" 1 "MidHigh" 2 "MidLow" 3 "Low" ;
VAL_ 774 DET_IDM_025 0 "Not_IDM_Output" 1 "IDM_Output" ;
VAL_ 774 DET_MTD_025 0 "Not_MTD_Output" 1 "MTD_Output" ;
VAL_ 774 DET_BELOW_RAIN_THOLD_025 0 "DetBelowRainThold" 1 "DetAboveRainThold" ;
VAL_ 774 DET_CONFD_AZIMUTH_026 0 "High" 1 "MidHigh" 2 "MidLow" 3 "Low" ;
VAL_ 774 DET_CONFD_ELEVATION_026 0 "High" 1 "MidHigh" 2 "MidLow" 3 "Low" ;
VAL_ 774 DET_IDM_026 0 "Not_IDM_Output" 1 "IDM_Output" ;
VAL_ 774 DET_MTD_026 0 "Not_MTD_Output" 1 "MTD_Output" ;
VAL_ 774 DET_BELOW_RAIN_THOLD_026 0 "DetBelowRainThold" 1 "DetAboveRainThold" ;
VAL_ 774 DET_CONFD_AZIMUTH_027 0 "High" 1 "MidHigh" 2 "MidLow" 3 "Low" ;
VAL_ 774 DET_CONFD_ELEVATION_027 0 "High" 1 "MidHigh" 2 "MidLow" 3 "Low" ;
VAL_ 774 DET_IDM_027 0 "Not_IDM_Output" 1 "IDM_Output" ;
VAL_ 774 DET_MTD_027 0 "Not_MTD_Output" 1 "MTD_Output" ;
VAL_ 774 DET_BELOW_RAIN_THOLD_027 0 "DetBelowRainThold" 1 "DetAboveRainThold" ;
VAL_ 774 DET_IDM_028 0 "Not_IDM_Output" 1 "IDM_Output" ;
VAL_ 774 DET_MTD_028 0 "Not_MTD_Output" 1 "MTD_Output" ;
VAL_ 774 DET_BELOW_RAIN_THOLD_028 0 "DetBelowRainThold" 1 "DetAboveRainThold" ;
VAL_ 775 DET_CONFD_AZIMUTH_029 0 "High" 1 "MidHigh" 2 "MidLow" 3 "Low" ;
VAL_ 775 DET_CONFD_ELEVATION_029 0 "High" 1 "MidHigh" 2 "MidLow" 3 "Low" ;
VAL_ 775 DET_IDM_029 0 "Not_IDM_Output" 1 "IDM_Output" ;
VAL_ 775 DET_MTD_029 0 "Not_MTD_Output" 1 "MTD_Output" ;
VAL_ 775 DET_BELOW_RAIN_THOLD_029 0 "DetBelowRainThold" 1 "DetAboveRainThold" ;
VAL_ 775 DET_CONFD_AZIMUTH_030 0 "High" 1 "MidHigh" 2 "MidLow" 3 "Low" ;
VAL_ 775 DET_CONFD_ELEVATION_030 0 "High" 1 "MidHigh" 2 "MidLow" 3 "Low" ;
VAL_ 775 DET_IDM_030 0 "Not_IDM_Output" 1 "IDM_Output" ;
VAL_ 775 DET_MTD_030 0 "Not_MTD_Output" 1 "MTD_Output" ;
VAL_ 775 DET_BELOW_RAIN_THOLD_030 0 "DetBelowRainThold" 1 "DetAboveRainThold" ;
VAL_ 775 DET_CONFD_AZIMUTH_031 0 "High" 1 "MidHigh" 2 "MidLow" 3 "Low" ;
VAL_ 775 DET_CONFD_ELEVATION_031 0 "High" 1 "MidHigh" 2 "MidLow" 3 "Low" ;
VAL_ 775 DET_IDM_031 0 "Not_IDM_Output" 1 "IDM_Output" ;
VAL_ 775 DET_MTD_031 0 "Not_MTD_Output" 1 "MTD_Output" ;
VAL_ 775 DET_BELOW_RAIN_THOLD_031 0 "DetBelowRainThold" 1 "DetAboveRainThold" ;
VAL_ 775 DET_IDM_032 0 "Not_IDM_Output" 1 "IDM_Output" ;
VAL_ 775 DET_MTD_032 0 "Not_MTD_Output" 1 "MTD_Output" ;
VAL_ 775 DET_BELOW_RAIN_THOLD_032 0 "DetBelowRainThold" 1 "DetAboveRainThold" ;
SIG_GROUP_ 166 AlignmentStatus2 1 : AL_STS_002_MH_CRC16 AL_STS_002_CYCLE_COUNTER STS_AlignmentStaticStatus STS_Measured_Range STS_MeasuredRangeStd STS_MeasuredRangeRate STS_MeasuredRangeRateStd STS_MeasuredRawAmplitude STS_MeasuredAmpSTD STS_ImpactByInterference STS_AlignmentServiceStatus STS_VehicleCondition STS_DistanceAbsolute STS_DistanceEffective STS_AverageNumberOfDetections STS_DurationAbsolute STS_DurationEffective STS_AverageSpeed STS_AlignmentShortTrackStatus;
SIG_GROUP_ 165 AlignmentStatus1 1 : STS_Roll_Updates STS_RollErrorNegative STS_AARoll_Std STS_AACurrentRoll STS_StartRoll AL_STS_001_MH_CRC16 AL_STS_001_CYCLE_COUNTER STS_AlignmentModeIn STS_CoordinateSystemInput STS_RadarTypeInput STS_InitAlignmentResultAzimuth STS_InitAlignmentResultElevation STS_InitLastSuccessfulAlignMode STS_AlignmentModeOut STS_InitAlignResultAzimuthUpdate STS_InitAlignRsltElevationUpdate STS_InitAlignRsltHostSpdCompFac STS_AlignmentAzimuth STS_AlignmentElevation STS_AzimuthStd STS_ElevationStd STS_CalTime STS_ProgressPercent STS_AlignmentError STS_CalDisplay STS_AlignmentAutoStatus STS_AutoAlignmentFailRootCause STS_StartAzimuth STS_StartElevation STS_AACurrentAzimuth STS_AACurrentElevation STS_AAAzimuthStd STS_AAElevationStd STS_AzimuthErrorPositive STS_ElevationErrorPositive STS_RollErrorPositive STS_AzimuthErrorNegative STS_ElevationErrorNegative STS_HostSpeedCompensationFactor STS_HostSpdCompensationFactorQF STS_AzimuthUpdates STS_ElevationUpdates;
SIG_GROUP_ 167 RadarCapability 1 : CAP_MH_CRC16 CAP_CYCLE_COUNTER CAP_BlockageSensitivity CAP_BlockageActive CAP_BlockageStatus CAP_BlockageValue CAP_BlockageProbability CAP_FreeSightCheckActive CAP_FreeSightCheckStatus CAP_SLBlockageFlag CAP_SLBlockageFilterValue CAP_DampingCurrent CAP_DampingActive CAP_DampingStatus CAP_DampingStandardDeviation CAP_SLLMonitoringActive CAP_SLLMonitoringStatus CAP_SideLobeLevelBeamformer CAP_RangeEstimationActive CAP_RangeEstimationStatus CAP_MaxDetectionRangeCar_0 CAP_MaxDetRangeMotorbike_1 CAP_MaxDetRangePedestrian_0 CAP_AngleAzimuthRangeStart CAP_AngleAzimuthRangeEnd CAP_MaxDetectionRangeCar_1 CAP_MaxDetectionRangeCar_2 CAP_MaxDetRangeMotorbike_0 CAP_MaxDetRangeMotorbike_2 CAP_MaxDetRangePedestrian_1 CAP_MaxDetRangePedestrian_2;
SIG_GROUP_ 768 Detections_001_004 1 : DET_PROB_1STAZHYPO_001 DET_PROB_1STAZHYPO_002 DET_PROB_1STAZHYPO_003 DET_PROB_1STAZHYPO_004 DET_IDM_001 DET_IDM_002 DET_IDM_003 DET_IDM_004 DET_MTD_004 DET_MTD_003 DET_MTD_002 DET_MTD_001 DET_BELOW_RAIN_THOLD_004 DET_BELOW_RAIN_THOLD_003 DET_BELOW_RAIN_THOLD_002 DET_BELOW_RAIN_THOLD_001 DET_MH_CRC16_001_004 DET_MH_CYCLE_COUNTER_001_004 DET_MH_SCAN_INDEX_4LSB_001_004 DET_CONFD_ELEVATION_001 DET_CONFD_AZIMUTH_001 DET_HVC_FLAG_001 DET_EXISTENCE_PROB_001 DET_SNR_001 DET_SUPER_RES_TARGET_001 DET_BI_STATIC_FLAG_001 DET_RCS_001 DET_ELEVATION_ERR_001 DET_ELEVATION_001 DET_AZIMUTH_ERR_001 DET_AZIMUTH_001 DET_RANGE_VELOCITY_ERR_001 DET_RANGE_VELOCITY_001 DET_RANGE_ERR_001 DET_RANGE_001 DET_CONFD_ELEVATION_002 DET_CONFD_AZIMUTH_002 DET_HVC_FLAG_002 DET_EXISTENCE_PROB_002 DET_SNR_002 DET_SUPER_RES_TARGET_002 DET_BI_STATIC_FLAG_002 DET_RCS_002 DET_ELEVATION_ERR_002 DET_ELEVATION_002 DET_AZIMUTH_ERR_002 DET_AZIMUTH_002 DET_RANGE_VELOCITY_ERR_002 DET_RANGE_VELOCITY_002 DET_RANGE_ERR_002 DET_RANGE_002 DET_CONFD_ELEVATION_003 DET_CONFD_AZIMUTH_003 DET_HVC_FLAG_003 DET_EXISTENCE_PROB_003 DET_SNR_003 DET_SUPER_RES_TARGET_003 DET_BI_STATIC_FLAG_003 DET_RCS_003 DET_ELEVATION_ERR_003 DET_ELEVATION_003 DET_AZIMUTH_ERR_003 DET_AZIMUTH_003 DET_RANGE_VELOCITY_ERR_003 DET_RANGE_VELOCITY_003 DET_RANGE_ERR_003 DET_RANGE_003 DET_CONFD_ELEVATION_004 DET_CONFD_AZIMUTH_004 DET_HVC_FLAG_004 DET_EXISTENCE_PROB_004 DET_SNR_004 DET_SUPER_RES_TARGET_004 DET_BI_STATIC_FLAG_004 DET_RCS_004 DET_ELEVATION_ERR_004 DET_ELEVATION_004 DET_AZIMUTH_ERR_004 DET_AZIMUTH_004 DET_RANGE_VELOCITY_ERR_004 DET_RANGE_VELOCITY_004 DET_RANGE_ERR_004 DET_RANGE_004;
SIG_GROUP_ 2 VehicleStatus 1 : SSTS_VEH_Status_FV SSTS_VEH_Status_CMAC SSTS_VEH_TRAILER_CONNECTED SSTS_VEH_VARIANT SSTS_MH_VS_CRC16 SSTS_MH_VS_CYCLE_COUNTER SSTS_CAN_PCAN_MAJOR_ADAS SSTS_CAN_PCAN_MINOR_ADAS SSTS_YAW_RATE_CALC SSTS_SW_VERSION_ADAS SSTS_GEAR_POSITION SSTS_IGN_STATUS SSTS_DRIVE_REVERSE SSTS_DRIVE_DIR SSTS_STEERING_ANGLE SSTS_STEERING_ANGLE_SIGN SSTS_VEHICLE_SPEED_CALC SSTS_VEHICLE_SPEED_CALC_QF SSTS_VEH_SPD_COMP_FACTOR SSTS_YAW_RATE_BIAS SSTS_YAW_RATE_CALC_QF SSTS_VEH_ODOMETER SSTS_VEH_POWER_MODE_STATUS SSTS_VEHICLE_STATE SSTS_VEH_SYSTEM_VOLTAGE SSTS_VEH_AbsoluteTime_Day SSTS_VEH_AbsoluteTime_Hour SSTS_VEH_AbsoluteTime_Minute SSTS_VEH_AbsoluteTime_Month SSTS_VEH_AbsoluteTime_Second SSTS_VEH_AbsoluteTime_Year SSTS_VIN_FrameIdx SSTS_VIN_Data_Byte0 SSTS_VIN_Data_Byte2 SSTS_VIN_Data_Byte1 SSTS_VIN_Data_Byte3 SSTS_VIN_Data_Byte4 SSTS_VIN_Data_Byte5 SSTS_VIN_Data_Byte6;
SIG_GROUP_ 163 RadarStatus1 1 : STS_DIST_FRNT_BMPR_TO_RR_AXL STS_VIN_Status STS_MH_001_CYCLE_COUNTER STS_MH_001_CRC16 STS_SMC_PLATFROM_VERSION STS_SMC_SECTION_COMPTBLITY STS_SMC_CAL_VER_MINOR STS_SMC_CAL_VER_MAJOR STS_USC_SECTION_COMPTBLITY STS_USC_CAL_VER_MINOR STS_USC_CAL_VER_MAJOR STS_SENSOR_POSITION STS_SENSOR_HEIGHT STS_SENSOR_MOUNT_ORNT_ROLL STS_SENSOR_MOUNT_ORNT_PITCH STS_SENSOR_MOUNT_ORNT_YAW STS_SENSOR_MOUNT_POS_Z STS_SENSOR_MOUNT_POS_Y STS_SENSOR_MOUNT_POS_X STS_SENSOR_POLARITY STS_PBL_VERSION_FIELD4 STS_PBL_VERSION_FIELD3 STS_PBL_VERSION_FIELD2 STS_PBL_VERSION_FIELD1 STS_SW_VERSION_FIELD4 STS_SW_VERSION_FIELD3 STS_SW_VERSION_FIELD2 STS_SW_VERSION_FIELD1 STS_DET_DBC_BASE_VER_MAJOR STS_DET_DBC_BASE_VER_MINOR STS_SERIAL_NUM_JULIAN_DAY STS_SERIAL_NUM_JULIAN_YEAR STS_SERIAL_NUMBER_SEQUENCE STS_HARDWARE_VERSION STS_PCAN_PROTOCOL_VER_MAJOR STS_PLATFORM_VARIANT STS_PCAN_PROTOCOL_VER_MINOR STS_TIME_SINCE_POWER_ON STS_AF_TIME_INST STS_AF_TIME_PEAK STS_MAIN_CORE_TIME_INST STS_MAIN_CORE_TIME_PEAK STS_RDD_CORE_TIME_INST STS_RDD_CORE_TIME_PEAK STS_SP_CORE_TIME_INST STS_SP_CORE_TIME_PEAK;
SIG_GROUP_ 164 RadarStatus2 1 : STS_INTRFC_VERSION_ID_PATCH STS_INTRFC_VERSION_ID_MINOR STS_INTRFC_VERSION_ID_MAJOR STS_Yaw_Rate_Calc_QF STS_Vehicle_Speed_Calc_QF STS_Gear_Position STS_RAIN_COUNT STS_Last_CAN_Det_Inst_Latency STS_First_CAN_Det_Inst_Latency STS_CORE_ACTV_FLT_BYTE_0_to_3 STS_CORE_ACTV_FLT_BYTE_8_to_11 STS_CORE_ACTV_FLT_BYTE_11_to_15 STS_TKEY_ACTV_FLT_BYTE_0_to_3 STS_TKEY_ACTV_FLT_BYTE_4_to_5 STS_CAN_NM_State STS_TIME_SYNC_OFFSET STS_RDD_CORE_THROUGHPUT STS_MH_002_CRC16 STS_MH_002_CYCLE_COUNTER STS_NO_TSYN_ERROR STS_POINT_OF_TRIGGER STS_BRR_STATUS STS_CORE_ACTV_FLT_BYTE_4_to_7 STS_MMIC_TEMP_TX1_2 STS_MMIC_TEMP_TX3_4 STS_MCU_TEMP STS_MMIC_TEMP_RX STS_MMIC_TEMP_TX0 STS_XCVR_OPERATIONAL STS_SCAN_TYPE STS_AF_CORE_THROUGHPUT STS_MMIC_RE_INIT_COUNT STS_VEHICLE_SPEED_CALC STS_STEERING_ANGLE STS_STEERING_ANGLE_SIGN STS_VEH_SPEED_DIRECTION STS_YAW_RATE_BIAS STS_VEHICLE_SUPPLY_VOLTAGE;
SIG_GROUP_ 160 RadarHeader 1 : HED_RDR_HEADER_CMAC HED_RDR_HEADER_FV HED_Rain_Level HED_MH_CRC16 HED_MH_CYCLE_COUNTER HED_Auth_CRC32 HED_FOV_VER_MIN HED_FOV_HOR_MIN HED_DET_SPEED_RANGE_MIN HED_DET_RANGE_MIN HED_FOV_VER_MAX HED_FOV_HOR_MAX HED_DET_SPEED_RANGE_MAX HED_DET_RANGE_MAX HED_R_WRAPPING HED_V_WRAPPING HED_DATA_QUALIFIER HED_SCAN_INDEX HED_LOOK_ID HED_NUM_OF_VALID_DETECTIONS HED_ALIGN_HOR_REF HED_LOOK_INDEX HED_ALIGN_VER_REF HED_TRIGGER_TIME HED_TIME_SYNC_VALIDITY_FLAG HED_TIME_SYNC_SRC_MASTER HED_SENSOR_TIME_STAMP_NS HED_SENSOR_TIME_STAMP_SEC HED_DET_BI_STATIC_COUNT HED_DET_NUM_OF_2PASS HED_DET_NUM_OF_1PASS HED_NUM_OF_RESTBINS_USED HED_MAX_NUM_OF_DETECTIONS HED_OPERATION_MODE HED_PROCESSED_RANGE HED_SLOPE_CORR_EXECUTIONFLAG;
SIG_GROUP_ 48 XcpCTOReq 1 : STS_XCP_REQ_CTO_Byte63 STS_XCP_REQ_CTO_Byte62 STS_XCP_REQ_CTO_Byte61 STS_XCP_REQ_CTO_Byte60 STS_XCP_REQ_CTO_Byte59 STS_XCP_REQ_CTO_Byte58 STS_XCP_REQ_CTO_Byte57 STS_XCP_REQ_CTO_Byte56 STS_XCP_REQ_CTO_Byte55 STS_XCP_REQ_CTO_Byte54 STS_XCP_REQ_CTO_Byte53 STS_XCP_REQ_CTO_Byte52 STS_XCP_REQ_CTO_Byte51 STS_XCP_REQ_CTO_Byte50 STS_XCP_REQ_CTO_Byte49 STS_XCP_REQ_CTO_Byte48 STS_XCP_REQ_CTO_Byte47 STS_XCP_REQ_CTO_Byte46 STS_XCP_REQ_CTO_Byte45 STS_XCP_REQ_CTO_Byte44 STS_XCP_REQ_CTO_Byte43 STS_XCP_REQ_CTO_Byte42 STS_XCP_REQ_CTO_Byte41 STS_XCP_REQ_CTO_Byte40 STS_XCP_REQ_CTO_Byte39 STS_XCP_REQ_CTO_Byte38 STS_XCP_REQ_CTO_Byte37 STS_XCP_REQ_CTO_Byte36 STS_XCP_REQ_CTO_Byte35 STS_XCP_REQ_CTO_Byte34 STS_XCP_REQ_CTO_Byte33 STS_XCP_REQ_CTO_Byte32 STS_PID STS_XCP_REQ_CTO_Byte1 STS_XCP_REQ_CTO_Byte2 STS_XCP_REQ_CTO_Byte3 STS_XCP_REQ_CTO_Byte4 STS_XCP_REQ_CTO_Byte5 STS_XCP_REQ_CTO_Byte6 STS_XCP_REQ_CTO_Byte7 STS_XCP_REQ_CTO_Byte8 STS_XCP_REQ_CTO_Byte9 STS_XCP_REQ_CTO_Byte10 STS_XCP_REQ_CTO_Byte11 STS_XCP_REQ_CTO_Byte12 STS_XCP_REQ_CTO_Byte13 STS_XCP_REQ_CTO_Byte14 STS_XCP_REQ_CTO_Byte15 STS_XCP_REQ_CTO_Byte16 STS_XCP_REQ_CTO_Byte17 STS_XCP_REQ_CTO_Byte18 STS_XCP_REQ_CTO_Byte19 STS_XCP_REQ_CTO_Byte20 STS_XCP_REQ_CTO_Byte21 STS_XCP_REQ_CTO_Byte22 STS_XCP_REQ_CTO_Byte23 STS_XCP_REQ_CTO_Byte24 STS_XCP_REQ_CTO_Byte25 STS_XCP_REQ_CTO_Byte26 STS_XCP_REQ_CTO_Byte27 STS_XCP_REQ_CTO_Byte28 STS_XCP_REQ_CTO_Byte29 STS_XCP_REQ_CTO_Byte30 STS_XCP_REQ_CTO_Byte31;
SIG_GROUP_ 49 XcpCTOResp 1 : STS_XCP_RES_CTO_Byte63 STS_XCP_RES_CTO_Byte62 STS_XCP_RES_CTO_Byte61 STS_XCP_RES_CTO_Byte60 STS_XCP_RES_CTO_Byte59 STS_XCP_RES_CTO_Byte58 STS_XCP_RES_CTO_Byte57 STS_XCP_RES_CTO_Byte56 STS_XCP_RES_CTO_Byte55 STS_XCP_RES_CTO_Byte54 STS_XCP_RES_CTO_Byte53 STS_XCP_RES_CTO_Byte52 STS_XCP_RES_CTO_Byte51 STS_XCP_RES_CTO_Byte50 STS_XCP_RES_CTO_Byte49 STS_XCP_RES_CTO_Byte48 STS_XCP_RES_CTO_Byte47 STS_XCP_RES_CTO_Byte46 STS_XCP_RES_CTO_Byte45 STS_XCP_RES_CTO_Byte44 STS_XCP_RES_CTO_Byte43 STS_XCP_RES_CTO_Byte42 STS_XCP_RES_CTO_Byte41 STS_XCP_RES_CTO_Byte40 STS_XCP_RES_CTO_Byte39 STS_XCP_RES_CTO_Byte38 STS_XCP_RES_CTO_Byte37 STS_XCP_RES_CTO_Byte36 STS_XCP_RES_CTO_Byte35 STS_XCP_RES_CTO_Byte34 STS_XCP_RES_CTO_Byte33 STS_XCP_RES_CTO_Byte32 STS_XCP_RES_CTO_Byte0 STS_XCP_RES_CTO_Byte1 STS_XCP_RES_CTO_Byte2 STS_XCP_RES_CTO_Byte3 STS_XCP_RES_CTO_Byte4 STS_XCP_RES_CTO_Byte5 STS_XCP_RES_CTO_Byte6 STS_XCP_RES_CTO_Byte7 STS_XCP_RES_CTO_Byte8 STS_XCP_RES_CTO_Byte9 STS_XCP_RES_CTO_Byte10 STS_XCP_RES_CTO_Byte11 STS_XCP_RES_CTO_Byte12 STS_XCP_RES_CTO_Byte13 STS_XCP_RES_CTO_Byte14 STS_XCP_RES_CTO_Byte15 STS_XCP_RES_CTO_Byte16 STS_XCP_RES_CTO_Byte17 STS_XCP_RES_CTO_Byte18 STS_XCP_RES_CTO_Byte19 STS_XCP_RES_CTO_Byte20 STS_XCP_RES_CTO_Byte21 STS_XCP_RES_CTO_Byte22 STS_XCP_RES_CTO_Byte23 STS_XCP_RES_CTO_Byte24 STS_XCP_RES_CTO_Byte25 STS_XCP_RES_CTO_Byte26 STS_XCP_RES_CTO_Byte27 STS_XCP_RES_CTO_Byte28 STS_XCP_RES_CTO_Byte29 STS_XCP_RES_CTO_Byte30 STS_XCP_RES_CTO_Byte31;
SIG_GROUP_ 50 XcpDAQResp 1 : STS_XCP_RES_DAQ_Byte63 STS_XCP_RES_DAQ_Byte62 STS_XCP_RES_DAQ_Byte61 STS_XCP_RES_DAQ_Byte60 STS_XCP_RES_DAQ_Byte59 STS_XCP_RES_DAQ_Byte58 STS_XCP_RES_DAQ_Byte57 STS_XCP_RES_DAQ_Byte56 STS_XCP_RES_DAQ_Byte55 STS_XCP_RES_DAQ_Byte54 STS_XCP_RES_DAQ_Byte53 STS_XCP_RES_DAQ_Byte52 STS_XCP_RES_DAQ_Byte51 STS_XCP_RES_DAQ_Byte50 STS_XCP_RES_DAQ_Byte49 STS_XCP_RES_DAQ_Byte48 STS_XCP_RES_DAQ_Byte47 STS_XCP_RES_DAQ_Byte46 STS_XCP_RES_DAQ_Byte45 STS_XCP_RES_DAQ_Byte44 STS_XCP_RES_DAQ_Byte43 STS_XCP_RES_DAQ_Byte42 STS_XCP_RES_DAQ_Byte41 STS_XCP_RES_DAQ_Byte40 STS_XCP_RES_DAQ_Byte39 STS_XCP_RES_DAQ_Byte38 STS_XCP_RES_DAQ_Byte37 STS_XCP_RES_DAQ_Byte36 STS_XCP_RES_DAQ_Byte35 STS_XCP_RES_DAQ_Byte34 STS_XCP_RES_DAQ_Byte33 STS_XCP_RES_DAQ_Byte32 STS_XCP_RES_DAQ_Byte31 STS_XCP_RES_DAQ_Byte30 STS_XCP_RES_DAQ_Byte29 STS_XCP_RES_DAQ_Byte28 STS_XCP_RES_DAQ_Byte27 STS_XCP_RES_DAQ_Byte26 STS_XCP_RES_DAQ_Byte25 STS_XCP_RES_DAQ_Byte24 STS_XCP_RES_DAQ_Byte23 STS_XCP_RES_DAQ_Byte22 STS_XCP_RES_DAQ_Byte21 STS_XCP_RES_DAQ_Byte20 STS_XCP_RES_DAQ_Byte19 STS_XCP_RES_DAQ_Byte18 STS_XCP_RES_DAQ_Byte17 STS_XCP_RES_DAQ_Byte16 STS_XCP_RES_DAQ_Byte15 STS_XCP_RES_DAQ_Byte14 STS_XCP_RES_DAQ_Byte13 STS_XCP_RES_DAQ_Byte12 STS_XCP_RES_DAQ_Byte11 STS_XCP_RES_DAQ_Byte10 STS_XCP_RES_DAQ_Byte9 STS_XCP_RES_DAQ_Byte8 STS_XCP_RES_DAQ_Byte7 STS_XCP_RES_DAQ_Byte6 STS_XCP_RES_DAQ_Byte5 STS_XCP_RES_DAQ_Byte4 STS_XCP_RES_DAQ_Byte3 STS_XCP_RES_DAQ_Byte2 STS_XCP_RES_DAQ_Byte1 STS_XCP_RES_DAQ_Byte0;
SIG_GROUP_ 769 Detections_005_008 1 : DET_PROB_1STAZHYPO_005 DET_PROB_1STAZHYPO_006 DET_PROB_1STAZHYPO_007 DET_PROB_1STAZHYPO_008 DET_IDM_005 DET_IDM_006 DET_IDM_007 DET_IDM_008 DET_MTD_008 DET_MTD_007 DET_MTD_006 DET_MTD_005 DET_BELOW_RAIN_THOLD_008 DET_BELOW_RAIN_THOLD_007 DET_BELOW_RAIN_THOLD_006 DET_BELOW_RAIN_THOLD_005 DET_MH_CRC16_005_008 DET_MH_CYCLE_COUNTER_005_008 DET_MH_SCAN_INDEX_4LSB_005_008 DET_CONFD_ELEVATION_005 DET_CONFD_AZIMUTH_005 DET_HVC_FLAG_005 DET_EXISTENCE_PROB_005 DET_SNR_005 DET_SUPER_RES_TARGET_005 DET_BI_STATIC_FLAG_005 DET_RCS_005 DET_ELEVATION_ERR_005 DET_ELEVATION_005 DET_AZIMUTH_ERR_005 DET_AZIMUTH_005 DET_RANGE_VELOCITY_ERR_005 DET_RANGE_VELOCITY_005 DET_RANGE_ERR_005 DET_RANGE_005 DET_CONFD_ELEVATION_006 DET_CONFD_AZIMUTH_006 DET_HVC_FLAG_006 DET_EXISTENCE_PROB_006 DET_SNR_006 DET_SUPER_RES_TARGET_006 DET_BI_STATIC_FLAG_006 DET_RCS_006 DET_ELEVATION_ERR_006 DET_ELEVATION_006 DET_AZIMUTH_ERR_006 DET_AZIMUTH_006 DET_RANGE_VELOCITY_ERR_006 DET_RANGE_VELOCITY_006 DET_RANGE_ERR_006 DET_RANGE_006 DET_CONFD_ELEVATION_007 DET_CONFD_AZIMUTH_007 DET_HVC_FLAG_007 DET_EXISTENCE_PROB_007 DET_SNR_007 DET_SUPER_RES_TARGET_007 DET_BI_STATIC_FLAG_007 DET_RCS_007 DET_ELEVATION_ERR_007 DET_ELEVATION_007 DET_AZIMUTH_ERR_007 DET_AZIMUTH_007 DET_RANGE_VELOCITY_ERR_007 DET_RANGE_VELOCITY_007 DET_RANGE_ERR_007 DET_RANGE_007 DET_CONFD_ELEVATION_008 DET_CONFD_AZIMUTH_008 DET_HVC_FLAG_008 DET_EXISTENCE_PROB_008 DET_SNR_008 DET_SUPER_RES_TARGET_008 DET_BI_STATIC_FLAG_008 DET_RCS_008 DET_ELEVATION_ERR_008 DET_ELEVATION_008 DET_AZIMUTH_ERR_008 DET_AZIMUTH_008 DET_RANGE_VELOCITY_ERR_008 DET_RANGE_VELOCITY_008 DET_RANGE_ERR_008 DET_RANGE_008;
SIG_GROUP_ 770 Detections_009_012 1 : DET_PROB_1STAZHYPO_009 DET_PROB_1STAZHYPO_010 DET_PROB_1STAZHYPO_011 DET_PROB_1STAZHYPO_012 DET_IDM_009 DET_IDM_010 DET_IDM_011 DET_IDM_012 DET_MTD_012 DET_MTD_011 DET_MTD_010 DET_MTD_009 DET_BELOW_RAIN_THOLD_012 DET_BELOW_RAIN_THOLD_011 DET_BELOW_RAIN_THOLD_010 DET_BELOW_RAIN_THOLD_009 DET_MH_CRC16_009_012 DET_MH_CYCLE_COUNTER_009_012 DET_MH_SCAN_INDEX_4LSB_009_012 DET_CONFD_ELEVATION_009 DET_CONFD_AZIMUTH_009 DET_HVC_FLAG_009 DET_EXISTENCE_PROB_009 DET_SNR_009 DET_SUPER_RES_TARGET_009 DET_BI_STATIC_FLAG_009 DET_RCS_009 DET_ELEVATION_ERR_009 DET_ELEVATION_009 DET_AZIMUTH_ERR_009 DET_AZIMUTH_009 DET_RANGE_VELOCITY_ERR_009 DET_RANGE_VELOCITY_009 DET_RANGE_ERR_009 DET_RANGE_009 DET_CONFD_ELEVATION_010 DET_CONFD_AZIMUTH_010 DET_HVC_FLAG_010 DET_EXISTENCE_PROB_010 DET_SNR_010 DET_SUPER_RES_TARGET_010 DET_BI_STATIC_FLAG_010 DET_RCS_010 DET_ELEVATION_ERR_010 DET_ELEVATION_010 DET_AZIMUTH_ERR_010 DET_AZIMUTH_010 DET_RANGE_VELOCITY_ERR_010 DET_RANGE_VELOCITY_010 DET_RANGE_ERR_010 DET_RANGE_010 DET_CONFD_ELEVATION_011 DET_CONFD_AZIMUTH_011 DET_HVC_FLAG_011 DET_EXISTENCE_PROB_011 DET_SNR_011 DET_SUPER_RES_TARGET_011 DET_BI_STATIC_FLAG_011 DET_RCS_011 DET_ELEVATION_ERR_011 DET_ELEVATION_011 DET_AZIMUTH_ERR_011 DET_AZIMUTH_011 DET_RANGE_VELOCITY_ERR_011 DET_RANGE_VELOCITY_011 DET_RANGE_ERR_011 DET_RANGE_011 DET_CONFD_ELEVATION_012 DET_CONFD_AZIMUTH_012 DET_HVC_FLAG_012 DET_EXISTENCE_PROB_012 DET_SNR_012 DET_SUPER_RES_TARGET_012 DET_BI_STATIC_FLAG_012 DET_RCS_012 DET_ELEVATION_ERR_012 DET_ELEVATION_012 DET_AZIMUTH_ERR_012 DET_AZIMUTH_012 DET_RANGE_VELOCITY_ERR_012 DET_RANGE_VELOCITY_012 DET_RANGE_ERR_012 DET_RANGE_012;
SIG_GROUP_ 771 Detections_013_016 1 : DET_PROB_1STAZHYPO_013 DET_PROB_1STAZHYPO_014 DET_PROB_1STAZHYPO_015 DET_PROB_1STAZHYPO_016 DET_IDM_013 DET_IDM_014 DET_IDM_015 DET_IDM_016 DET_MTD_016 DET_MTD_015 DET_MTD_014 DET_MTD_013 DET_BELOW_RAIN_THOLD_016 DET_BELOW_RAIN_THOLD_015 DET_BELOW_RAIN_THOLD_014 DET_BELOW_RAIN_THOLD_013 DET_MH_CRC16_013_016 DET_MH_CYCLE_COUNTER_013_016 DET_MH_SCAN_INDEX_4LSB_013_016 DET_CONFD_ELEVATION_013 DET_CONFD_AZIMUTH_013 DET_HVC_FLAG_013 DET_EXISTENCE_PROB_013 DET_SNR_013 DET_SUPER_RES_TARGET_013 DET_BI_STATIC_FLAG_013 DET_RCS_013 DET_ELEVATION_ERR_013 DET_ELEVATION_013 DET_AZIMUTH_ERR_013 DET_AZIMUTH_013 DET_RANGE_VELOCITY_ERR_013 DET_RANGE_VELOCITY_013 DET_RANGE_ERR_013 DET_RANGE_013 DET_CONFD_ELEVATION_014 DET_CONFD_AZIMUTH_014 DET_HVC_FLAG_014 DET_EXISTENCE_PROB_014 DET_SNR_014 DET_SUPER_RES_TARGET_014 DET_BI_STATIC_FLAG_014 DET_RCS_014 DET_ELEVATION_ERR_014 DET_ELEVATION_014 DET_AZIMUTH_ERR_014 DET_AZIMUTH_014 DET_RANGE_VELOCITY_ERR_014 DET_RANGE_VELOCITY_014 DET_RANGE_ERR_014 DET_RANGE_014 DET_CONFD_ELEVATION_015 DET_CONFD_AZIMUTH_015 DET_HVC_FLAG_015 DET_EXISTENCE_PROB_015 DET_SNR_015 DET_SUPER_RES_TARGET_015 DET_BI_STATIC_FLAG_015 DET_RCS_015 DET_ELEVATION_ERR_015 DET_ELEVATION_015 DET_AZIMUTH_ERR_015 DET_AZIMUTH_015 DET_RANGE_VELOCITY_ERR_015 DET_RANGE_VELOCITY_015 DET_RANGE_ERR_015 DET_RANGE_015 DET_CONFD_ELEVATION_016 DET_CONFD_AZIMUTH_016 DET_HVC_FLAG_016 DET_EXISTENCE_PROB_016 DET_SNR_016 DET_SUPER_RES_TARGET_016 DET_BI_STATIC_FLAG_016 DET_RCS_016 DET_ELEVATION_ERR_016 DET_ELEVATION_016 DET_AZIMUTH_ERR_016 DET_AZIMUTH_016 DET_RANGE_VELOCITY_ERR_016 DET_RANGE_VELOCITY_016 DET_RANGE_ERR_016 DET_RANGE_016;
SIG_GROUP_ 772 Detections_017_020 1 : DET_PROB_1STAZHYPO_017 DET_PROB_1STAZHYPO_018 DET_PROB_1STAZHYPO_019 DET_PROB_1STAZHYPO_020 DET_IDM_017 DET_IDM_018 DET_IDM_019 DET_IDM_020 DET_MTD_020 DET_MTD_019 DET_MTD_018 DET_MTD_017 DET_BELOW_RAIN_THOLD_020 DET_BELOW_RAIN_THOLD_019 DET_BELOW_RAIN_THOLD_018 DET_BELOW_RAIN_THOLD_017 DET_MH_CRC16_017_020 DET_MH_CYCLE_COUNTER_017_020 DET_MH_SCAN_INDEX_4LSB_017_020 DET_CONFD_ELEVATION_017 DET_CONFD_AZIMUTH_017 DET_HVC_FLAG_017 DET_EXISTENCE_PROB_017 DET_SNR_017 DET_SUPER_RES_TARGET_017 DET_BI_STATIC_FLAG_017 DET_RCS_017 DET_ELEVATION_ERR_017 DET_ELEVATION_017 DET_AZIMUTH_ERR_017 DET_AZIMUTH_017 DET_RANGE_VELOCITY_ERR_017 DET_RANGE_VELOCITY_017 DET_RANGE_ERR_017 DET_RANGE_017 DET_CONFD_ELEVATION_018 DET_CONFD_AZIMUTH_018 DET_HVC_FLAG_018 DET_EXISTENCE_PROB_018 DET_SNR_018 DET_SUPER_RES_TARGET_018 DET_BI_STATIC_FLAG_018 DET_RCS_018 DET_ELEVATION_ERR_018 DET_ELEVATION_018 DET_AZIMUTH_ERR_018 DET_AZIMUTH_018 DET_RANGE_VELOCITY_ERR_018 DET_RANGE_VELOCITY_018 DET_RANGE_ERR_018 DET_RANGE_018 DET_CONFD_ELEVATION_019 DET_CONFD_AZIMUTH_019 DET_HVC_FLAG_019 DET_EXISTENCE_PROB_019 DET_SNR_019 DET_SUPER_RES_TARGET_019 DET_BI_STATIC_FLAG_019 DET_RCS_019 DET_ELEVATION_ERR_019 DET_ELEVATION_019 DET_AZIMUTH_ERR_019 DET_AZIMUTH_019 DET_RANGE_VELOCITY_ERR_019 DET_RANGE_VELOCITY_019 DET_RANGE_ERR_019 DET_RANGE_019 DET_CONFD_ELEVATION_020 DET_CONFD_AZIMUTH_020 DET_HVC_FLAG_020 DET_EXISTENCE_PROB_020 DET_SNR_020 DET_SUPER_RES_TARGET_020 DET_BI_STATIC_FLAG_020 DET_RCS_020 DET_ELEVATION_ERR_020 DET_ELEVATION_020 DET_AZIMUTH_ERR_020 DET_AZIMUTH_020 DET_RANGE_VELOCITY_ERR_020 DET_RANGE_VELOCITY_020 DET_RANGE_ERR_020 DET_RANGE_020;
SIG_GROUP_ 773 Detections_021_024 1 : DET_PROB_1STAZHYPO_021 DET_PROB_1STAZHYPO_022 DET_PROB_1STAZHYPO_023 DET_PROB_1STAZHYPO_024 DET_IDM_021 DET_IDM_022 DET_IDM_023 DET_IDM_024 DET_MTD_024 DET_MTD_023 DET_MTD_022 DET_MTD_021 DET_BELOW_RAIN_THOLD_024 DET_BELOW_RAIN_THOLD_023 DET_BELOW_RAIN_THOLD_022 DET_BELOW_RAIN_THOLD_021 DET_MH_CRC16_021_024 DET_MH_CYCLE_COUNTER_021_024 DET_MH_SCAN_INDEX_4LSB_021_024 DET_CONFD_ELEVATION_021 DET_CONFD_AZIMUTH_021 DET_HVC_FLAG_021 DET_EXISTENCE_PROB_021 DET_SNR_021 DET_SUPER_RES_TARGET_021 DET_BI_STATIC_FLAG_021 DET_RCS_021 DET_ELEVATION_ERR_021 DET_ELEVATION_021 DET_AZIMUTH_ERR_021 DET_AZIMUTH_021 DET_RANGE_VELOCITY_ERR_021 DET_RANGE_VELOCITY_021 DET_RANGE_ERR_021 DET_RANGE_021 DET_CONFD_ELEVATION_022 DET_CONFD_AZIMUTH_022 DET_HVC_FLAG_022 DET_EXISTENCE_PROB_022 DET_SNR_022 DET_SUPER_RES_TARGET_022 DET_BI_STATIC_FLAG_022 DET_RCS_022 DET_ELEVATION_ERR_022 DET_ELEVATION_022 DET_AZIMUTH_ERR_022 DET_AZIMUTH_022 DET_RANGE_VELOCITY_ERR_022 DET_RANGE_VELOCITY_022 DET_RANGE_ERR_022 DET_RANGE_022 DET_CONFD_ELEVATION_023 DET_CONFD_AZIMUTH_023 DET_HVC_FLAG_023 DET_EXISTENCE_PROB_023 DET_SNR_023 DET_SUPER_RES_TARGET_023 DET_BI_STATIC_FLAG_023 DET_RCS_023 DET_ELEVATION_ERR_023 DET_ELEVATION_023 DET_AZIMUTH_ERR_023 DET_AZIMUTH_023 DET_RANGE_VELOCITY_ERR_023 DET_RANGE_VELOCITY_023 DET_RANGE_ERR_023 DET_RANGE_023 DET_CONFD_ELEVATION_024 DET_CONFD_AZIMUTH_024 DET_HVC_FLAG_024 DET_EXISTENCE_PROB_024 DET_SNR_024 DET_SUPER_RES_TARGET_024 DET_BI_STATIC_FLAG_024 DET_RCS_024 DET_ELEVATION_ERR_024 DET_ELEVATION_024 DET_AZIMUTH_ERR_024 DET_AZIMUTH_024 DET_RANGE_VELOCITY_ERR_024 DET_RANGE_VELOCITY_024 DET_RANGE_ERR_024 DET_RANGE_024;
SIG_GROUP_ 774 Detections_025_028 1 : DET_PROB_1STAZHYPO_025 DET_PROB_1STAZHYPO_026 DET_PROB_1STAZHYPO_027 DET_PROB_1STAZHYPO_028 DET_IDM_025 DET_IDM_026 DET_IDM_027 DET_IDM_028 DET_MTD_028 DET_MTD_027 DET_MTD_026 DET_MTD_025 DET_BELOW_RAIN_THOLD_028 DET_BELOW_RAIN_THOLD_027 DET_BELOW_RAIN_THOLD_026 DET_BELOW_RAIN_THOLD_025 DET_MH_CRC16_025_028 DET_MH_CYCLE_COUNTER_025_028 DET_MH_SCAN_INDEX_4LSB_025_028 DET_CONFD_ELEVATION_025 DET_CONFD_AZIMUTH_025 DET_HVC_FLAG_025 DET_EXISTENCE_PROB_025 DET_SNR_025 DET_SUPER_RES_TARGET_025 DET_BI_STATIC_FLAG_025 DET_RCS_025 DET_ELEVATION_ERR_025 DET_ELEVATION_025 DET_AZIMUTH_ERR_025 DET_AZIMUTH_025 DET_RANGE_VELOCITY_ERR_025 DET_RANGE_VELOCITY_025 DET_RANGE_ERR_025 DET_RANGE_025 DET_CONFD_ELEVATION_026 DET_CONFD_AZIMUTH_026 DET_HVC_FLAG_026 DET_EXISTENCE_PROB_026 DET_SNR_026 DET_SUPER_RES_TARGET_026 DET_BI_STATIC_FLAG_026 DET_RCS_026 DET_ELEVATION_ERR_026 DET_ELEVATION_026 DET_AZIMUTH_ERR_026 DET_AZIMUTH_026 DET_RANGE_VELOCITY_ERR_026 DET_RANGE_VELOCITY_026 DET_RANGE_ERR_026 DET_RANGE_026 DET_CONFD_ELEVATION_027 DET_CONFD_AZIMUTH_027 DET_HVC_FLAG_027 DET_EXISTENCE_PROB_027 DET_SNR_027 DET_SUPER_RES_TARGET_027 DET_BI_STATIC_FLAG_027 DET_RCS_027 DET_ELEVATION_ERR_027 DET_ELEVATION_027 DET_AZIMUTH_ERR_027 DET_AZIMUTH_027 DET_RANGE_VELOCITY_ERR_027 DET_RANGE_VELOCITY_027 DET_RANGE_ERR_027 DET_RANGE_027 DET_CONFD_ELEVATION_028 DET_CONFD_AZIMUTH_028 DET_HVC_FLAG_028 DET_EXISTENCE_PROB_028 DET_SNR_028 DET_SUPER_RES_TARGET_028 DET_BI_STATIC_FLAG_028 DET_RCS_028 DET_ELEVATION_ERR_028 DET_ELEVATION_028 DET_AZIMUTH_ERR_028 DET_AZIMUTH_028 DET_RANGE_VELOCITY_ERR_028 DET_RANGE_VELOCITY_028 DET_RANGE_ERR_028 DET_RANGE_028;
SIG_GROUP_ 775 Detections_029_032 1 : DET_PROB_1STAZHYPO_029 DET_PROB_1STAZHYPO_030 DET_PROB_1STAZHYPO_031 DET_PROB_1STAZHYPO_032 DET_IDM_029 DET_IDM_030 DET_IDM_031 DET_IDM_032 DET_MTD_032 DET_MTD_031 DET_MTD_030 DET_MTD_029 DET_BELOW_RAIN_THOLD_032 DET_BELOW_RAIN_THOLD_031 DET_BELOW_RAIN_THOLD_030 DET_BELOW_RAIN_THOLD_029 DET_MH_CRC16_029_032 DET_MH_CYCLE_COUNTER_029_032 DET_MH_SCAN_INDEX_4LSB_029_032 DET_CONFD_ELEVATION_029 DET_CONFD_AZIMUTH_029 DET_HVC_FLAG_029 DET_EXISTENCE_PROB_029 DET_SNR_029 DET_SUPER_RES_TARGET_029 DET_BI_STATIC_FLAG_029 DET_RCS_029 DET_ELEVATION_ERR_029 DET_ELEVATION_029 DET_AZIMUTH_ERR_029 DET_AZIMUTH_029 DET_RANGE_VELOCITY_ERR_029 DET_RANGE_VELOCITY_029 DET_RANGE_ERR_029 DET_RANGE_029 DET_CONFD_ELEVATION_030 DET_CONFD_AZIMUTH_030 DET_HVC_FLAG_030 DET_EXISTENCE_PROB_030 DET_SNR_030 DET_SUPER_RES_TARGET_030 DET_BI_STATIC_FLAG_030 DET_RCS_030 DET_ELEVATION_ERR_030 DET_ELEVATION_030 DET_AZIMUTH_ERR_030 DET_AZIMUTH_030 DET_RANGE_VELOCITY_ERR_030 DET_RANGE_VELOCITY_030 DET_RANGE_ERR_030 DET_RANGE_030 DET_CONFD_ELEVATION_031 DET_CONFD_AZIMUTH_031 DET_HVC_FLAG_031 DET_EXISTENCE_PROB_031 DET_SNR_031 DET_SUPER_RES_TARGET_031 DET_BI_STATIC_FLAG_031 DET_RCS_031 DET_ELEVATION_ERR_031 DET_ELEVATION_031 DET_AZIMUTH_ERR_031 DET_AZIMUTH_031 DET_RANGE_VELOCITY_ERR_031 DET_RANGE_VELOCITY_031 DET_RANGE_ERR_031 DET_RANGE_031 DET_CONFD_ELEVATION_032 DET_CONFD_AZIMUTH_032 DET_HVC_FLAG_032 DET_EXISTENCE_PROB_032 DET_SNR_032 DET_SUPER_RES_TARGET_032 DET_BI_STATIC_FLAG_032 DET_RCS_032 DET_ELEVATION_ERR_032 DET_ELEVATION_032 DET_AZIMUTH_ERR_032 DET_AZIMUTH_032 DET_RANGE_VELOCITY_ERR_032 DET_RANGE_VELOCITY_032 DET_RANGE_ERR_032 DET_RANGE_032;
SIG_GROUP_ 2566890672 GW_prop_ADAS_BSIS_info 1 : BlindSpotCollisionWarningLevel BlindSpotDetectionState;
