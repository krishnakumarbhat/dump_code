VERSION ""

NS_ :

BS_:

BU_: External_Tool ADAS RDR05 RDR_Fusion_Partner RDR_Gateway

BO_ 3221225472 VECTOR__INDEPENDENT_SIG_MSG: 0 Vector__XXX
 SG_ AEBSReadinessState : 0|2@1+ (1,0) [0|3] "" Vector__XXX
 SG_ Year : 0|8@1+ (1,0) [0|255] "year" Vector__XXX
 SG_ Seconds : 0|8@1+ (0.25,0) [0|59] "s" Vector__XXX
 SG_ Month : 0|8@1+ (1,0) [0|12] "month" Vector__XXX
 SG_ Minutes : 0|8@1+ (1,0) [0|59] "min" Vector__XXX
 SG_ LocalMinuteOffset : 0|8@1+ (1,-125) [-23|23] "h" Vector__XXX
 SG_ LocalHourOffset : 0|8@1+ (1,-125) [-59|59] "min" Vector__XXX
 SG_ Hours : 0|8@1+ (1,0) [0|23] "h" Vector__XXX
 SG_ Day : 0|8@1+ (0.25,0) [0|31] "day" Vector__XXX
 SG_ MOIS_Fn_Switch_sts : 0|3@1+ (1,0) [0|7] "" Vector__XXX
 SG_ MessageCounter : 0|4@1+ (1,0) [0|15] "" Vector__XXX
 SG_ MessageChecksum : 0|4@1+ (1,0) [0|15] "count" Vector__XXX
 SG_ LDWS_FN_Switch_sts : 0|3@1+ (1,0) [0|7] "" Vector__XXX
 SG_ DDAW_fn_switch_sts : 0|3@1+ (1,0) [0|7] "" Vector__XXX
 SG_ BSIS_fn_Switch_Sts : 0|3@1+ (1,0) [0|7] "" Vector__XXX
 SG_ AEBS_FN_Switch_sts : 0|3@1+ (1,0) [0|7] "" Vector__XXX
 SG_ TransmissionShiftInProcess : 0|2@1+ (1,0) [0|3] "" Vector__XXX
 SG_ TransmissionDrivelineEngaged : 0|2@1+ (1,0) [0|3] "" Vector__XXX
 SG_ TransmissionOutputShaftSpeed : 0|16@1+ (0.125,0) [0|8031.875] "rpm" Vector__XXX
 SG_ TransmissionMode1Indicator : 0|2@1+ (1,0) [0|3] "" Vector__XXX
 SG_ Transmission_type_info : 0|3@1+ (1,0) [0|7] "" Vector__XXX
 SG_ Crawler_confi_status_info : 0|1@1+ (1,0) [0|1] "" Vector__XXX
 SG_ Ignition : 0|2@1+ (1,0) [0|3] "" Vector__XXX
 SG_ ReverseSwitchInfo : 0|2@1+ (1,0) [0|3] "" Vector__XXX
 SG_ ParameterGroupNumber : 0|24@1+ (1,0) [0|16777215] "" Vector__XXX
 SG_ AddressBusy : 0|8@1+ (1,0) [0|255] "" Vector__XXX
 SG_ AddressAccessDenied : 0|8@1+ (1,0) [0|255] "" Vector__XXX
 SG_ AddressNegativeAcknowledgement : 0|8@1+ (1,0) [0|255] "" Vector__XXX
 SG_ AddressAcknowledged : 0|8@1+ (1,0) [0|255] "" Vector__XXX
 SG_ GroupFunctionValue : 0|8@1+ (1,0) [0|255] "" Vector__XXX
 SG_ ControlByte : 0|8@1+ (1,0) [0|255] "" Vector__XXX
 SG_ VehicleIdentification : 0|8@1+ (1,0) [0|255] "" Vector__XXX
 SG_ ParkingBrakeSwitch : 0|2@1+ (1,0) [0|3] "" Vector__XXX
 SG_ WheelBasedVehicleSpeed : 0|16@1+ (0.00390625,0) [0|250.99609375] "km/h" Vector__XXX
 SG_ BrakeSwitch : 0|2@1+ (1,0) [0|3] "" Vector__XXX
 SG_ ATC_ASRInformationSignal : 0|2@1+ (1,0) [0|3] "" Vector__XXX
 SG_ ABS_EBSAmberWarningSignal : 0|2@1+ (1,0) [0|3] "" Vector__XXX
 SG_ ASROffRoadSwitch : 0|2@1+ (1,0) [0|3] "" Vector__XXX
 SG_ BrakePedalPos : 0|8@1+ (0.4,0) [0|100] "%" Vector__XXX
 SG_ AntiLockBrakingActive : 0|2@1+ (1,0) [0|3] "" Vector__XXX
 SG_ ABSFullyOperational : 0|2@1+ (1,0) [0|3] "" Vector__XXX
 SG_ RelativeSpeedRearAxle2RightWheel : 0|8@1+ (0.0625,-7.8125) [-7.8125|7.8125] "km/h" Vector__XXX
 SG_ RelativeSpeedRearAxle2LeftWheel : 0|8@1+ (0.0625,-7.8125) [-7.8125|7.8125] "km/h" Vector__XXX
 SG_ RelativeSpeedRearAxle1RightWheel : 0|8@1+ (0.0625,-7.8125) [-7.8125|7.8125] "kmph" Vector__XXX
 SG_ RelativeSpeedRearAxle1LeftWheel : 0|8@1+ (0.0625,-7.8125) [-7.8125|7.8125] "kmph" Vector__XXX
 SG_ RelativeSpeedFrontAxleRightWheel : 0|8@1+ (0.0625,-7.8125) [-7.8125|7.8125] "kmph" Vector__XXX
 SG_ RelativeSpeedFrontAxleLeftWheel : 0|8@1+ (0.0625,-7.8125) [-7.8125|7.8125] "kmph" Vector__XXX
 SG_ FrontAxleSpeed : 0|16@1+ (0.0039,0) [0|250.996] "kmph" Vector__XXX
 SG_ Engine_Operating_Mode : 0|4@1+ (1,0) [0|15] "state" Vector__XXX
 SG_ TransCurrentRange : 0|16@1+ (1,0) [0|255] "" Vector__XXX
 SG_ TransRequestedRange : 0|16@1+ (1,0) [0|255] "" Vector__XXX
 SG_ TransCurrentGear_00 : 0|8@1+ (1,-125) [-125|125] "" Vector__XXX
 SG_ TransActualGearRatio : 0|16@1+ (0.001,0) [0|64.255] "" Vector__XXX
 SG_ TransSelectedGear : 0|8@1+ (1,-125) [-125|125] "" Vector__XXX
 SG_ RearAxleRightWheelSpeed : 0|16@1+ (0.00390625,0) [0|250.996] "kmph" Vector__XXX
 SG_ RearAxleLeftWheelSpeed : 0|16@1+ (0.00390625,0) [0|250.996] "kmph" Vector__XXX
 SG_ FrontAxleRightWheelSpeed : 0|16@1+ (0.00390625,0) [0|250.996] "kmph" Vector__XXX
 SG_ FrontAxleLeftWheelSpeed : 0|16@1+ (0.00390625,0) [0|250.996] "kmph" Vector__XXX
 SG_ TurnSignalSwitch : 0|4@1+ (1,0) [0|15] "" Vector__XXX
 SG_ HighLowBeamSwitch : 0|2@1+ (1,0) [0|3] "" Vector__XXX
 SG_ HazardLightSwitch : 0|2@1+ (1,0) [0|3] "" Vector__XXX
 SG_ SteerWheelAngleRangeCounterType : 0|2@1+ (1,0) [0|3] "" Vector__XXX
 SG_ SteerWheelAngleRangeCounter : 0|6@1+ (1,-32) [-32|29] "ranges" Vector__XXX
 SG_ SteerWheelAngleRange : 0|16@1+ (0.0009765625,-31.374) [0|31.374] "rad" Vector__XXX
 SG_ SteerWheelAngle : 0|16@1+ (0.0009765625,-31.374) [-31.374|31.374] "rad" Vector__XXX
 SG_ SteerAngleSensorCalibrated : 0|2@1+ (1,0) [0|3] "" Vector__XXX
 SG_ SteerAngleSensorActiveMode : 0|2@1+ (1,0) [0|3] "" Vector__XXX
 SG_ MessageCounter : 0|4@1+ (1,0) [0|15] "" Vector__XXX
 SG_ MessageChecksum : 0|4@1+ (1,0) [0|15] "" Vector__XXX
 SG_ TripDistance : 0|32@1+ (0.125,0) [0|526385151.88] "km" Vector__XXX
 SG_ TotalVehicleDistance : 0|32@1+ (0.125,0) [0|526385151.88] "km" Vector__XXX
 SG_ YawRate : 0|16@1+ (0.00012207,-3.92) [-3.92|3.92] "" Vector__XXX
 SG_ SteerWheelAngle : 0|16@1+ (0.00097656,-31.374) [-31.374|31.374] "" Vector__XXX
 SG_ LongitudinalAcceleration : 0|8@1+ (0.1,-12.5) [-12.5|12.5] "" Vector__XXX
 SG_ LateralAcceleration : 0|16@1+ (0.00048828,-15.687) [-15.687|15.687] "" Vector__XXX
 SG_ Diag_Req_Func : 0|64@0+ (1,0) [0|0] "" Vector__XXX
 SG_ Diag_Req_Func : 0|64@0+ (1,0) [0|0] "" Vector__XXX
 SG_ Diag_Req_Func : 0|64@0+ (1,0) [0|0] "" Vector__XXX
 SG_ Diag_Req_Phys : 0|64@0+ (1,0) [0|0] "" Vector__XXX
 SG_ Diag_Req_Phys : 0|64@0+ (1,0) [0|0] "" Vector__XXX
 SG_ Diag_Req_Phys : 0|64@0+ (1,0) [0|0] "" Vector__XXX
 SG_ HED_RDR_HEADER_CMAC : 0|40@1+ (1,0) [0|1099511627800] "" Vector__XXX
 SG_ HED_RDR_HEADER_FV : 0|56@1+ (1,0) [0|7.2057594038E+16] "" Vector__XXX
 SG_ HED_Rain_Level : 0|2@1+ (1,0) [0|2] "" Vector__XXX
 SG_ HED_V_WRAPPING : 0|11@1+ (0.01,-40) [-40|-19.53] "mps" Vector__XXX
 SG_ HED_R_WRAPPING : 0|8@1+ (0.01,-0.9) [-0.9|1.65] "m" Vector__XXX
 SG_ HED_Auth_CRC32 : 0|32@1+ (1,0) [0|4294967295] "" Vector__XXX
 SG_ HED_SLOPE_CORR_EXECUTIONFLAG : 0|2@1+ (1,0) [0|3] "" Vector__XXX
 SG_ HED_PROCESSED_RANGE : 0|9@1+ (1,0) [0|500] "" Vector__XXX
 SG_ HED_LOOK_INDEX : 0|16@1+ (1,0) [0|65535] "" Vector__XXX
 SG_ HED_OPERATION_MODE : 0|3@1+ (1,0) [0|5] "" Vector__XXX
 SG_ HED_MAX_NUM_OF_DETECTIONS : 0|9@1+ (1,0) [0|400] "" Vector__XXX
 SG_ HED_NUM_OF_RESTBINS_USED : 0|9@1+ (1,0) [0|511] "" Vector__XXX
 SG_ HED_NUM_OF_VALID_DETECTIONS : 0|9@1+ (1,0) [0|500] "" Vector__XXX
 SG_ HED_LOOK_ID : 0|2@1+ (1,0) [0|3] "" Vector__XXX
 SG_ HED_SCAN_INDEX : 0|16@1+ (1,0) [0|65535] "" Vector__XXX
 SG_ HED_MH_CYCLE_COUNTER : 0|8@1+ (1,0) [0|255] "" Vector__XXX
 SG_ HED_DATA_QUALIFIER : 0|3@1+ (1,0) [0|7] "" Vector__XXX
 SG_ HED_DET_RANGE_MAX : 0|16@1+ (0.01,0) [0|500] "m" Vector__XXX
 SG_ HED_DET_SPEED_RANGE_MAX : 0|16@1+ (0.00390625,-128) [-128|127.99609375] "m/s" Vector__XXX
 SG_ HED_FOV_HOR_MAX : 0|8@1+ (0.0174533,0) [0|3.14159] "rad" Vector__XXX
 SG_ HED_FOV_VER_MAX : 0|8@1+ (0.0174533,0) [0|3.14159] "rad" Vector__XXX
 SG_ HED_DET_RANGE_MIN : 0|16@1+ (0.01,0) [0|500] "m" Vector__XXX
 SG_ HED_DET_SPEED_RANGE_MIN : 0|16@1+ (0.00390625,-128) [-128|127.99609375] "m/s" Vector__XXX
 SG_ HED_FOV_HOR_MIN : 0|8@1- (0.0174533,0) [-2.2340224|2.2165691] "rad" Vector__XXX
 SG_ HED_FOV_VER_MIN : 0|8@1- (0.0174533,0) [-2.2340224|2.2165691] "rad" Vector__XXX
 SG_ HED_ALIGN_VER_REF : 0|10@1+ (0.0005,-0.1745) [-0.1745|0.337] "rad" Vector__XXX
 SG_ HED_ALIGN_HOR_REF : 0|13@1+ (0.0005,-0.1745) [-0.1745|3.921] "rad" Vector__XXX
 SG_ HED_SENSOR_TIME_STAMP_NS : 0|32@1+ (1,0) [0|4294967295] "ns" Vector__XXX
 SG_ HED_SENSOR_TIME_STAMP_SEC : 0|32@1+ (1,0) [0|4294967295] "s" Vector__XXX
 SG_ HED_TIME_SYNC_SRC_MASTER : 0|1@1+ (1,0) [0|1] "" Vector__XXX
 SG_ HED_TIME_SYNC_VALIDITY_FLAG : 0|2@1+ (1,0) [0|2] "" Vector__XXX
 SG_ HED_MH_CRC16 : 0|16@1+ (1,0) [0|65535] "" Vector__XXX
 SG_ HED_DET_NUM_OF_1PASS : 0|10@1+ (1,0) [0|1023] "" Vector__XXX
 SG_ HED_DET_NUM_OF_2PASS : 0|9@1+ (1,0) [0|511] "" Vector__XXX
 SG_ HED_TRIGGER_TIME : 0|32@1+ (1,0) [0|4294967295] "ns" Vector__XXX
 SG_ HED_DET_BI_STATIC_COUNT : 0|8@1+ (1,0) [0|255] "" Vector__XXX
 SG_ STS_VIN_Status : 0|2@1+ (1,0) [0|3] "" Vector__XXX
 SG_ STS_DIST_FRNT_BMPR_TO_RR_AXL : 0|13@1+ (0.001,0) [0|8.191] "m" Vector__XXX
 SG_ STS_SENSOR_POLARITY : 0|1@1+ (1,0) [0|1] "" Vector__XXX
 SG_ STS_SP_CORE_TIME_PEAK : 0|8@1+ (0.5,0) [0|127.5] "ms" Vector__XXX
 SG_ STS_SP_CORE_TIME_INST : 0|8@1+ (0.5,0) [0|127.5] "ms" Vector__XXX
 SG_ STS_RDD_CORE_TIME_PEAK : 0|8@1+ (0.5,0) [0|127.5] "ms" Vector__XXX
 SG_ STS_RDD_CORE_TIME_INST : 0|8@1+ (0.5,0) [0|127.5] "ms" Vector__XXX
 SG_ STS_MAIN_CORE_TIME_PEAK : 0|8@1+ (0.5,0) [0|127.5] "ms" Vector__XXX
 SG_ STS_MAIN_CORE_TIME_INST : 0|8@1+ (0.5,0) [0|127.5] "ms" Vector__XXX
 SG_ STS_AF_TIME_PEAK : 0|8@1+ (0.5,0) [0|127.5] "ms" Vector__XXX
 SG_ STS_AF_TIME_INST : 0|8@1+ (0.5,0) [0|127.5] "ms" Vector__XXX
 SG_ STS_PCAN_PROTOCOL_VER_MINOR : 0|8@1+ (1,0) [0|255] "" Vector__XXX
 SG_ STS_PCAN_PROTOCOL_VER_MAJOR : 0|8@1+ (1,0) [0|255] "" Vector__XXX
 SG_ STS_PLATFORM_VARIANT : 0|5@1+ (1,0) [0|16] "" Vector__XXX
 SG_ STS_HARDWARE_VERSION : 0|3@1+ (1,0) [0|5] "" Vector__XXX
 SG_ STS_SERIAL_NUMBER_SEQUENCE : 0|14@1+ (1,0) [0|9999] "" Vector__XXX
 SG_ STS_SERIAL_NUM_JULIAN_YEAR : 0|3@1+ (1,2020) [2020|2027] "years" Vector__XXX
 SG_ STS_SERIAL_NUM_JULIAN_DAY : 0|9@1+ (1,0) [0|366] "" Vector__XXX
 SG_ STS_SW_VERSION_FIELD1 : 0|8@1+ (1,0) [0|255] "" Vector__XXX
 SG_ STS_SW_VERSION_FIELD2 : 0|8@1+ (1,0) [0|255] "" Vector__XXX
 SG_ STS_SW_VERSION_FIELD3 : 0|8@1+ (1,0) [0|255] "" Vector__XXX
 SG_ STS_SW_VERSION_FIELD4 : 0|8@1+ (1,0) [0|255] "" Vector__XXX
 SG_ STS_PBL_VERSION_FIELD1 : 0|8@1+ (1,0) [0|255] "" Vector__XXX
 SG_ STS_PBL_VERSION_FIELD2 : 0|8@1+ (1,0) [0|255] "" Vector__XXX
 SG_ STS_PBL_VERSION_FIELD3 : 0|8@1+ (1,0) [0|255] "" Vector__XXX
 SG_ STS_PBL_VERSION_FIELD4 : 0|8@1+ (1,0) [0|255] "" Vector__XXX
 SG_ STS_USC_CAL_VER_MAJOR : 0|16@1+ (1,0) [0|65535] "" Vector__XXX
 SG_ STS_USC_CAL_VER_MINOR : 0|16@1+ (1,0) [0|65535] "" Vector__XXX
 SG_ STS_USC_SECTION_COMPTBLITY : 0|16@1+ (1,0) [0|255] "" Vector__XXX
 SG_ STS_SMC_CAL_VER_MAJOR : 0|16@1+ (1,0) [0|65535] "" Vector__XXX
 SG_ STS_SMC_CAL_VER_MINOR : 0|16@1+ (1,0) [0|65535] "" Vector__XXX
 SG_ STS_SMC_SECTION_COMPTBLITY : 0|16@1+ (1,0) [0|65535] "" Vector__XXX
 SG_ STS_SMC_PLATFROM_VERSION : 0|8@1+ (1,0) [0|14] "" Vector__XXX
 SG_ STS_SENSOR_MOUNT_POS_X : 0|14@1- (0.001,0) [-8.192|8.191] "m" Vector__XXX
 SG_ STS_SENSOR_MOUNT_POS_Y : 0|16@1- (0.0001,0) [-3.2768|3.2767] "m" Vector__XXX
 SG_ STS_SENSOR_MOUNT_POS_Z : 0|16@1- (0.0001,0) [-3.2768|3.2767] "m" Vector__XXX
 SG_ STS_SENSOR_MOUNT_ORNT_YAW : 0|14@1- (0.0004,0) [-3.14|3.14] "rad" Vector__XXX
 SG_ STS_SENSOR_MOUNT_ORNT_PITCH : 0|14@1- (0.0004,0) [-3.14|3.14] "rad" Vector__XXX
 SG_ STS_SENSOR_MOUNT_ORNT_ROLL : 0|14@1- (0.0004,0) [-3.14159|3.14159] "rad" Vector__XXX
 SG_ STS_SENSOR_HEIGHT : 0|32@1+ (0.01,0) [0|42949672.95] "m" Vector__XXX
 SG_ STS_DET_DBC_BASE_VER_MINOR : 0|8@1+ (1,0) [0|255] "" Vector__XXX
 SG_ STS_DET_DBC_BASE_VER_MAJOR : 0|8@1+ (1,0) [0|255] "" Vector__XXX
 SG_ STS_TIME_SINCE_POWER_ON : 0|32@1+ (1,0) [0|4294967295] "s" Vector__XXX
 SG_ STS_SENSOR_POSITION : 0|3@1+ (1,0) [0|7] "" Vector__XXX
 SG_ STS_MH_001_CRC16 : 0|16@1+ (1,0) [0|65535] "" Vector__XXX
 SG_ STS_MH_001_CYCLE_COUNTER : 0|8@1+ (1,0) [0|255] "" Vector__XXX
 SG_ DET_RANGE_001 : 0|15@1+ (0.015625,0) [0|500] "m" Vector__XXX
 SG_ DET_RANGE_ERR_001 : 0|7@1+ (0.0075,0) [0|0.9525] "m" Vector__XXX
 SG_ DET_RANGE_VELOCITY_001 : 0|15@1+ (0.0078125,-128) [-128|127.9921875] "m/s" Vector__XXX
 SG_ DET_RANGE_VELOCITY_ERR_001 : 0|8@1+ (0.003,0) [0|0.765] "m/s" Vector__XXX
 SG_ DET_AZIMUTH_001 : 0|13@1+ (0.0004,-1.5708) [-1.5708|1.5708] "rad" Vector__XXX
 SG_ DET_AZIMUTH_ERR_001 : 0|7@1+ (0.00087267,0) [0|0.11082909] "rad" Vector__XXX
 SG_ DET_ELEVATION_001 : 0|8@1+ (0.00275,-0.34925) [-0.34925|0.34925] "rad" Vector__XXX
 SG_ DET_ELEVATION_ERR_001 : 0|6@1+ (0.00174533,0) [0|0.10995579] "rad" Vector__XXX
 SG_ DET_RCS_001 : 0|8@1+ (0.5,-64) [-64|63.5] "dBsm" Vector__XXX
 SG_ DET_BI_STATIC_FLAG_001 : 0|1@1+ (1,0) [0|1] "" Vector__XXX
 SG_ DET_SUPER_RES_TARGET_001 : 0|1@1+ (1,0) [0|1] "" Vector__XXX
 SG_ DET_SNR_001 : 0|8@1+ (0.35156,0) [0|89.6478] "dB" Vector__XXX
 SG_ DET_EXISTENCE_PROB_001 : 0|6@1+ (1.588,0) [0|100] "%" Vector__XXX
 SG_ DET_HVC_FLAG_001 : 0|1@1+ (1,0) [0|1] "" Vector__XXX
 SG_ DET_CONFD_AZIMUTH_001 : 0|2@1+ (1,0) [0|3] "" Vector__XXX
 SG_ DET_CONFD_ELEVATION_001 : 0|2@1+ (1,0) [0|3] "" Vector__XXX
 SG_ DET_PROB_1STAZHYPO_001 : 0|1@1+ (1,0) [0|1] "" Vector__XXX
 SG_ DET_IDM_001 : 0|1@1+ (1,0) [0|1] "" Vector__XXX
 SG_ DET_MTD_001 : 0|1@1+ (1,0) [0|1] "" Vector__XXX
 SG_ DET_BELOW_RAIN_THOLD_001 : 0|1@1+ (1,0) [0|1] "" Vector__XXX
 SG_ DET_RANGE_002 : 0|15@1+ (0.015625,0) [0|500] "m" Vector__XXX
 SG_ DET_RANGE_ERR_002 : 0|7@1+ (0.0075,0) [0|0.9525] "m" Vector__XXX
 SG_ DET_RANGE_VELOCITY_002 : 0|15@1+ (0.0078125,-128) [-128|127.9921875] "m/s" Vector__XXX
 SG_ DET_RANGE_VELOCITY_ERR_002 : 0|8@1+ (0.003,0) [0|0.765] "m/s" Vector__XXX
 SG_ DET_AZIMUTH_002 : 0|13@1+ (0.0004,-1.5708) [-1.5708|1.5708] "rad" Vector__XXX
 SG_ DET_AZIMUTH_ERR_002 : 0|7@1+ (0.00087267,0) [0|0.11082909] "rad" Vector__XXX
 SG_ DET_ELEVATION_002 : 0|8@1+ (0.00275,-0.34925) [-0.34925|0.34925] "rad" Vector__XXX
 SG_ DET_ELEVATION_ERR_002 : 0|6@1+ (0.00174533,0) [0|0.10995579] "rad" Vector__XXX
 SG_ DET_RCS_002 : 0|8@1+ (0.5,-64) [-64|63.5] "dBsm" Vector__XXX
 SG_ DET_BI_STATIC_FLAG_002 : 0|1@1+ (1,0) [0|1] "" Vector__XXX
 SG_ DET_SUPER_RES_TARGET_002 : 0|1@1+ (1,0) [0|1] "" Vector__XXX
 SG_ DET_SNR_002 : 0|8@1+ (0.35156,0) [0|89.6478] "dB" Vector__XXX
 SG_ DET_EXISTENCE_PROB_002 : 0|6@1+ (1.588,0) [0|100] "%" Vector__XXX
 SG_ DET_HVC_FLAG_002 : 0|1@1+ (1,0) [0|1] "" Vector__XXX
 SG_ DET_CONFD_AZIMUTH_002 : 0|2@1+ (1,0) [0|3] "" Vector__XXX
 SG_ DET_CONFD_ELEVATION_002 : 0|2@1+ (1,0) [0|3] "" Vector__XXX
 SG_ DET_PROB_1STAZHYPO_002 : 0|1@1+ (1,0) [0|1] "" Vector__XXX
 SG_ DET_IDM_002 : 0|1@1+ (1,0) [0|1] "" Vector__XXX
 SG_ DET_MTD_002 : 0|1@1+ (1,0) [0|1] "" Vector__XXX
 SG_ DET_BELOW_RAIN_THOLD_002 : 0|1@1+ (1,0) [0|1] "" Vector__XXX
 SG_ DET_RANGE_003 : 0|15@1+ (0.015625,0) [0|500] "m" Vector__XXX
 SG_ DET_RANGE_ERR_003 : 0|7@1+ (0.0075,0) [0|0.9525] "m" Vector__XXX
 SG_ DET_RANGE_VELOCITY_003 : 0|15@1+ (0.0078125,-128) [-128|127.9921875] "m/s" Vector__XXX
 SG_ DET_RANGE_VELOCITY_ERR_003 : 0|8@1+ (0.003,0) [0|0.765] "m/s" Vector__XXX
 SG_ DET_AZIMUTH_003 : 0|13@1+ (0.0004,-1.5708) [-1.5708|1.5708] "rad" Vector__XXX
 SG_ DET_AZIMUTH_ERR_003 : 0|7@1+ (0.00087267,0) [0|0.11082909] "rad" Vector__XXX
 SG_ DET_ELEVATION_003 : 0|8@1+ (0.00275,-0.34925) [-0.34925|0.34925] "rad" Vector__XXX
 SG_ DET_ELEVATION_ERR_003 : 0|6@1+ (0.00174533,0) [0|0.10995579] "rad" Vector__XXX
 SG_ DET_RCS_003 : 0|8@1+ (0.5,-64) [-64|63.5] "dBsm" Vector__XXX
 SG_ DET_BI_STATIC_FLAG_003 : 0|1@1+ (1,0) [0|1] "" Vector__XXX
 SG_ DET_SUPER_RES_TARGET_003 : 0|1@1+ (1,0) [0|1] "" Vector__XXX
 SG_ DET_SNR_003 : 0|8@1+ (0.35156,0) [0|89.6478] "dB" Vector__XXX
 SG_ DET_EXISTENCE_PROB_003 : 0|6@1+ (1.588,0) [0|100] "%" Vector__XXX
 SG_ DET_HVC_FLAG_003 : 0|1@1+ (1,0) [0|1] "" Vector__XXX
 SG_ DET_CONFD_AZIMUTH_003 : 0|2@1+ (1,0) [0|3] "" Vector__XXX
 SG_ DET_CONFD_ELEVATION_003 : 0|2@1+ (1,0) [0|3] "" Vector__XXX
 SG_ DET_PROB_1STAZHYPO_003 : 0|1@1+ (1,0) [0|1] "" Vector__XXX
 SG_ DET_IDM_003 : 0|1@1+ (1,0) [0|1] "" Vector__XXX
 SG_ DET_MTD_003 : 0|1@1+ (1,0) [0|1] "" Vector__XXX
 SG_ DET_BELOW_RAIN_THOLD_003 : 0|1@1+ (1,0) [0|1] "" Vector__XXX
 SG_ DET_RANGE_004 : 0|15@1+ (0.015625,0) [0|500] "m" Vector__XXX
 SG_ DET_RANGE_ERR_004 : 0|7@1+ (0.0075,0) [0|0.9525] "m" Vector__XXX
 SG_ DET_RANGE_VELOCITY_004 : 0|15@1+ (0.0078125,-128) [-128|127.9921875] "m/s" Vector__XXX
 SG_ DET_RANGE_VELOCITY_ERR_004 : 0|8@1+ (0.003,0) [0|0.765] "m/s" Vector__XXX
 SG_ DET_AZIMUTH_004 : 0|13@1+ (0.0004,-1.5708) [-1.5708|1.5708] "rad" Vector__XXX
 SG_ DET_AZIMUTH_ERR_004 : 0|7@1+ (0.00087267,0) [0|0.11082909] "rad" Vector__XXX
 SG_ DET_ELEVATION_004 : 0|8@1+ (0.00275,-0.34925) [-0.34925|0.34925] "rad" Vector__XXX
 SG_ DET_ELEVATION_ERR_004 : 0|6@1+ (0.00174533,0) [0|0.10995579] "rad" Vector__XXX
 SG_ DET_RCS_004 : 0|8@1+ (0.5,-64) [-64|63.5] "dBsm" Vector__XXX
 SG_ DET_BI_STATIC_FLAG_004 : 0|1@1+ (1,0) [0|1] "" Vector__XXX
 SG_ DET_SUPER_RES_TARGET_004 : 0|1@1+ (1,0) [0|1] "" Vector__XXX
 SG_ DET_SNR_004 : 0|8@1+ (0.35156,0) [0|89.6478] "dB" Vector__XXX
 SG_ DET_EXISTENCE_PROB_004 : 0|6@1+ (1.588,0) [0|100] "%" Vector__XXX
 SG_ DET_HVC_FLAG_004 : 0|1@1+ (1,0) [0|1] "" Vector__XXX
 SG_ DET_CONFD_AZIMUTH_004 : 0|2@1+ (1,0) [0|3] "" Vector__XXX
 SG_ DET_CONFD_ELEVATION_004 : 0|2@1+ (1,0) [0|3] "" Vector__XXX
 SG_ DET_MH_SCAN_INDEX_4LSB_001_004 : 0|4@1+ (1,0) [0|15] "" Vector__XXX
 SG_ DET_MH_CYCLE_COUNTER_001_004 : 0|8@1+ (1,0) [0|255] "" Vector__XXX
 SG_ DET_MH_CRC16_001_004 : 0|16@1+ (1,0) [0|65535] "" Vector__XXX
 SG_ DET_PROB_1STAZHYPO_004 : 0|1@1+ (1,0) [0|1] "" Vector__XXX
 SG_ DET_IDM_004 : 0|1@1+ (1,0) [0|1] "" Vector__XXX
 SG_ DET_MTD_004 : 0|1@1+ (1,0) [0|1] "" Vector__XXX
 SG_ DET_BELOW_RAIN_THOLD_004 : 0|1@1+ (1,0) [0|1] "" Vector__XXX
 SG_ DET_RANGE_005 : 0|15@1+ (0.015625,0) [0|500] "m" Vector__XXX
 SG_ DET_RANGE_ERR_005 : 0|7@1+ (0.0075,0) [0|0.9525] "m" Vector__XXX
 SG_ DET_RANGE_VELOCITY_005 : 0|15@1+ (0.0078125,-128) [-128|127.9921875] "m/s" Vector__XXX
 SG_ DET_RANGE_VELOCITY_ERR_005 : 0|8@1+ (0.003,0) [0|0.765] "m/s" Vector__XXX
 SG_ DET_AZIMUTH_005 : 0|13@1+ (0.0004,-1.5708) [-1.5708|1.5708] "rad" Vector__XXX
 SG_ DET_AZIMUTH_ERR_005 : 0|7@1+ (0.00087267,0) [0|0.11082909] "rad" Vector__XXX
 SG_ DET_ELEVATION_005 : 0|8@1+ (0.00275,-0.34925) [-0.34925|0.34925] "rad" Vector__XXX
 SG_ DET_ELEVATION_ERR_005 : 0|6@1+ (0.00174533,0) [0|0.10995579] "rad" Vector__XXX
 SG_ DET_RCS_005 : 0|8@1+ (0.5,-64) [-64|63.5] "dBsm" Vector__XXX
 SG_ DET_BI_STATIC_FLAG_005 : 0|1@1+ (1,0) [0|1] "" Vector__XXX
 SG_ DET_SUPER_RES_TARGET_005 : 0|1@1+ (1,0) [0|1] "" Vector__XXX
 SG_ DET_SNR_005 : 0|8@1+ (0.35156,0) [0|89.6478] "dB" Vector__XXX
 SG_ DET_EXISTENCE_PROB_005 : 0|6@1+ (1.588,0) [0|100] "%" Vector__XXX
 SG_ DET_HVC_FLAG_005 : 0|1@1+ (1,0) [0|1] "" Vector__XXX
 SG_ DET_CONFD_AZIMUTH_005 : 0|2@1+ (1,0) [0|3] "" Vector__XXX
 SG_ DET_CONFD_ELEVATION_005 : 0|2@1+ (1,0) [0|3] "" Vector__XXX
 SG_ DET_PROB_1STAZHYPO_005 : 0|1@1+ (1,0) [0|1] "" Vector__XXX
 SG_ DET_IDM_005 : 0|1@1+ (1,0) [0|1] "" Vector__XXX
 SG_ DET_MTD_005 : 0|1@1+ (1,0) [0|1] "" Vector__XXX
 SG_ DET_BELOW_RAIN_THOLD_005 : 0|1@1+ (1,0) [0|1] "" Vector__XXX
 SG_ DET_RANGE_006 : 0|15@1+ (0.015625,0) [0|500] "m" Vector__XXX
 SG_ DET_RANGE_ERR_006 : 0|7@1+ (0.0075,0) [0|0.9525] "m" Vector__XXX
 SG_ DET_RANGE_VELOCITY_006 : 0|15@1+ (0.0078125,-128) [-128|127.9921875] "m/s" Vector__XXX
 SG_ DET_RANGE_VELOCITY_ERR_006 : 0|8@1+ (0.003,0) [0|0.765] "m/s" Vector__XXX
 SG_ DET_AZIMUTH_006 : 0|13@1+ (0.0004,-1.5708) [-1.5708|1.5708] "rad" Vector__XXX
 SG_ DET_AZIMUTH_ERR_006 : 0|7@1+ (0.00087267,0) [0|0.11082909] "rad" Vector__XXX
 SG_ DET_ELEVATION_006 : 0|8@1+ (0.00275,-0.34925) [-0.34925|0.34925] "rad" Vector__XXX
 SG_ DET_ELEVATION_ERR_006 : 0|6@1+ (0.00174533,0) [0|0.10995579] "rad" Vector__XXX
 SG_ DET_RCS_006 : 0|8@1+ (0.5,-64) [-64|63.5] "dBsm" Vector__XXX
 SG_ DET_BI_STATIC_FLAG_006 : 0|1@1+ (1,0) [0|1] "" Vector__XXX
 SG_ DET_SUPER_RES_TARGET_006 : 0|1@1+ (1,0) [0|1] "" Vector__XXX
 SG_ DET_SNR_006 : 0|8@1+ (0.35156,0) [0|89.6478] "dB" Vector__XXX
 SG_ DET_EXISTENCE_PROB_006 : 0|6@1+ (1.588,0) [0|100] "%" Vector__XXX
 SG_ DET_HVC_FLAG_006 : 0|1@1+ (1,0) [0|1] "" Vector__XXX
 SG_ DET_CONFD_AZIMUTH_006 : 0|2@1+ (1,0) [0|3] "" Vector__XXX
 SG_ DET_CONFD_ELEVATION_006 : 0|2@1+ (1,0) [0|3] "" Vector__XXX
 SG_ DET_PROB_1STAZHYPO_006 : 0|1@1+ (1,0) [0|1] "" Vector__XXX
 SG_ DET_IDM_006 : 0|1@1+ (1,0) [0|1] "" Vector__XXX
 SG_ DET_MTD_006 : 0|1@1+ (1,0) [0|1] "" Vector__XXX
 SG_ DET_BELOW_RAIN_THOLD_006 : 0|1@1+ (1,0) [0|1] "" Vector__XXX
 SG_ DET_RANGE_007 : 0|15@1+ (0.015625,0) [0|500] "m" Vector__XXX
 SG_ DET_RANGE_ERR_007 : 0|7@1+ (0.0075,0) [0|0.9525] "m" Vector__XXX
 SG_ DET_RANGE_VELOCITY_007 : 0|15@1+ (0.0078125,-128) [-128|127.9921875] "m/s" Vector__XXX
 SG_ DET_RANGE_VELOCITY_ERR_007 : 0|8@1+ (0.003,0) [0|0.765] "m/s" Vector__XXX
 SG_ DET_AZIMUTH_007 : 0|13@1+ (0.0004,-1.5708) [-1.5708|1.5708] "rad" Vector__XXX
 SG_ DET_AZIMUTH_ERR_007 : 0|7@1+ (0.00087267,0) [0|0.11082909] "rad" Vector__XXX
 SG_ DET_ELEVATION_007 : 0|8@1+ (0.00275,-0.34925) [-0.34925|0.34925] "rad" Vector__XXX
 SG_ DET_ELEVATION_ERR_007 : 0|6@1+ (0.00174533,0) [0|0.10995579] "rad" Vector__XXX
 SG_ DET_RCS_007 : 0|8@1+ (0.5,-64) [-64|63.5] "dBsm" Vector__XXX
 SG_ DET_BI_STATIC_FLAG_007 : 0|1@1+ (1,0) [0|1] "" Vector__XXX
 SG_ DET_SUPER_RES_TARGET_007 : 0|1@1+ (1,0) [0|1] "" Vector__XXX
 SG_ DET_SNR_007 : 0|8@1+ (0.35156,0) [0|89.6478] "dB" Vector__XXX
 SG_ DET_EXISTENCE_PROB_007 : 0|6@1+ (1.588,0) [0|100] "%" Vector__XXX
 SG_ DET_HVC_FLAG_007 : 0|1@1+ (1,0) [0|1] "" Vector__XXX
 SG_ DET_CONFD_AZIMUTH_007 : 0|2@1+ (1,0) [0|3] "" Vector__XXX
 SG_ DET_CONFD_ELEVATION_007 : 0|2@1+ (1,0) [0|3] "" Vector__XXX
 SG_ DET_PROB_1STAZHYPO_007 : 0|1@1+ (1,0) [0|1] "" Vector__XXX
 SG_ DET_IDM_007 : 0|1@1+ (1,0) [0|1] "" Vector__XXX
 SG_ DET_MTD_007 : 0|1@1+ (1,0) [0|1] "" Vector__XXX
 SG_ DET_BELOW_RAIN_THOLD_007 : 0|1@1+ (1,0) [0|1] "" Vector__XXX
 SG_ DET_RANGE_008 : 0|15@1+ (0.015625,0) [0|500] "m" Vector__XXX
 SG_ DET_RANGE_ERR_008 : 0|7@1+ (0.0075,0) [0|0.9525] "m" Vector__XXX
 SG_ DET_RANGE_VELOCITY_008 : 0|15@1+ (0.0078125,-128) [-128|127.9921875] "m/s" Vector__XXX
 SG_ DET_RANGE_VELOCITY_ERR_008 : 0|8@1+ (0.003,0) [0|0.765] "m/s" Vector__XXX
 SG_ DET_AZIMUTH_008 : 0|13@1+ (0.0004,-1.5708) [-1.5708|1.5708] "rad" Vector__XXX
 SG_ DET_AZIMUTH_ERR_008 : 0|7@1+ (0.00087267,0) [0|0.11082909] "rad" Vector__XXX
 SG_ DET_ELEVATION_008 : 0|8@1+ (0.00275,-0.34925) [-0.34925|0.34925] "rad" Vector__XXX
 SG_ DET_ELEVATION_ERR_008 : 0|6@1+ (0.00174533,0) [0|0.10995579] "rad" Vector__XXX
 SG_ DET_RCS_008 : 0|8@1+ (0.5,-64) [-64|63.5] "dBsm" Vector__XXX
 SG_ DET_BI_STATIC_FLAG_008 : 0|1@1+ (1,0) [0|1] "" Vector__XXX
 SG_ DET_SUPER_RES_TARGET_008 : 0|1@1+ (1,0) [0|1] "" Vector__XXX
 SG_ DET_SNR_008 : 0|8@1+ (0.35156,0) [0|89.6478] "dB" Vector__XXX
 SG_ DET_EXISTENCE_PROB_008 : 0|6@1+ (1.588,0) [0|100] "%" Vector__XXX
 SG_ DET_HVC_FLAG_008 : 0|1@1+ (1,0) [0|1] "" Vector__XXX
 SG_ DET_CONFD_AZIMUTH_008 : 0|2@1+ (1,0) [0|3] "" Vector__XXX
 SG_ DET_CONFD_ELEVATION_008 : 0|2@1+ (1,0) [0|3] "" Vector__XXX
 SG_ DET_MH_SCAN_INDEX_4LSB_005_008 : 0|4@1+ (1,0) [0|15] "" Vector__XXX
 SG_ DET_MH_CYCLE_COUNTER_005_008 : 0|8@1+ (1,0) [0|255] "" Vector__XXX
 SG_ DET_MH_CRC16_005_008 : 0|16@1+ (1,0) [0|65535] "" Vector__XXX
 SG_ DET_PROB_1STAZHYPO_008 : 0|1@1+ (1,0) [0|1] "" Vector__XXX
 SG_ DET_IDM_008 : 0|1@1+ (1,0) [0|1] "" Vector__XXX
 SG_ DET_MTD_008 : 0|1@1+ (1,0) [0|1] "" Vector__XXX
 SG_ DET_BELOW_RAIN_THOLD_008 : 0|1@1+ (1,0) [0|1] "" Vector__XXX
 SG_ DET_RANGE_009 : 0|15@1+ (0.015625,0) [0|500] "m" Vector__XXX
 SG_ DET_RANGE_ERR_009 : 0|7@1+ (0.0075,0) [0|0.9525] "m" Vector__XXX
 SG_ DET_RANGE_VELOCITY_009 : 0|15@1+ (0.0078125,-128) [-128|127.9921875] "m/s" Vector__XXX
 SG_ DET_RANGE_VELOCITY_ERR_009 : 0|8@1+ (0.003,0) [0|0.765] "m/s" Vector__XXX
 SG_ DET_AZIMUTH_009 : 0|13@1+ (0.0004,-1.5708) [-1.5708|1.5708] "rad" Vector__XXX
 SG_ DET_AZIMUTH_ERR_009 : 0|7@1+ (0.00087267,0) [0|0.11082909] "rad" Vector__XXX
 SG_ DET_ELEVATION_009 : 0|8@1+ (0.00275,-0.34925) [-0.34925|0.34925] "rad" Vector__XXX
 SG_ DET_ELEVATION_ERR_009 : 0|6@1+ (0.00174533,0) [0|0.10995579] "rad" Vector__XXX
 SG_ DET_RCS_009 : 0|8@1+ (0.5,-64) [-64|63.5] "dBsm" Vector__XXX
 SG_ DET_BI_STATIC_FLAG_009 : 0|1@1+ (1,0) [0|1] "" Vector__XXX
 SG_ DET_SUPER_RES_TARGET_009 : 0|1@1+ (1,0) [0|1] "" Vector__XXX
 SG_ DET_SNR_009 : 0|8@1+ (0.35156,0) [0|89.6478] "dB" Vector__XXX
 SG_ DET_EXISTENCE_PROB_009 : 0|6@1+ (1.588,0) [0|100] "%" Vector__XXX
 SG_ DET_HVC_FLAG_009 : 0|1@1+ (1,0) [0|1] "" Vector__XXX
 SG_ DET_CONFD_AZIMUTH_009 : 0|2@1+ (1,0) [0|3] "" Vector__XXX
 SG_ DET_CONFD_ELEVATION_009 : 0|2@1+ (1,0) [0|3] "" Vector__XXX
 SG_ DET_PROB_1STAZHYPO_009 : 0|1@1+ (1,0) [0|1] "" Vector__XXX
 SG_ DET_IDM_009 : 0|1@1+ (1,0) [0|1] "" Vector__XXX
 SG_ DET_MTD_009 : 0|1@1+ (1,0) [0|1] "" Vector__XXX
 SG_ DET_BELOW_RAIN_THOLD_009 : 0|1@1+ (1,0) [0|1] "" Vector__XXX
 SG_ DET_RANGE_010 : 0|15@1+ (0.015625,0) [0|500] "m" Vector__XXX
 SG_ DET_RANGE_ERR_010 : 0|7@1+ (0.0075,0) [0|0.9525] "m" Vector__XXX
 SG_ DET_RANGE_VELOCITY_010 : 0|15@1+ (0.0078125,-128) [-128|127.9921875] "m/s" Vector__XXX
 SG_ DET_RANGE_VELOCITY_ERR_010 : 0|8@1+ (0.003,0) [0|0.765] "m/s" Vector__XXX
 SG_ DET_AZIMUTH_010 : 0|13@1+ (0.0004,-1.5708) [-1.5708|1.5708] "rad" Vector__XXX
 SG_ DET_AZIMUTH_ERR_010 : 0|7@1+ (0.00087267,0) [0|0.11082909] "rad" Vector__XXX
 SG_ DET_ELEVATION_010 : 0|8@1+ (0.00275,-0.34925) [-0.34925|0.34925] "rad" Vector__XXX
 SG_ DET_ELEVATION_ERR_010 : 0|6@1+ (0.00174533,0) [0|0.10995579] "rad" Vector__XXX
 SG_ DET_RCS_010 : 0|8@1+ (0.5,-64) [-64|63.5] "dBsm" Vector__XXX
 SG_ DET_BI_STATIC_FLAG_010 : 0|1@1+ (1,0) [0|1] "" Vector__XXX
 SG_ DET_SUPER_RES_TARGET_010 : 0|1@1+ (1,0) [0|1] "" Vector__XXX
 SG_ DET_SNR_010 : 0|8@1+ (0.35156,0) [0|89.6478] "dB" Vector__XXX
 SG_ DET_EXISTENCE_PROB_010 : 0|6@1+ (1.588,0) [0|100] "%" Vector__XXX
 SG_ DET_HVC_FLAG_010 : 0|1@1+ (1,0) [0|1] "" Vector__XXX
 SG_ DET_CONFD_AZIMUTH_010 : 0|2@1+ (1,0) [0|3] "" Vector__XXX
 SG_ DET_CONFD_ELEVATION_010 : 0|2@1+ (1,0) [0|3] "" Vector__XXX
 SG_ DET_PROB_1STAZHYPO_010 : 0|1@1+ (1,0) [0|1] "" Vector__XXX
 SG_ DET_IDM_010 : 0|1@1+ (1,0) [0|1] "" Vector__XXX
 SG_ DET_MTD_010 : 0|1@1+ (1,0) [0|1] "" Vector__XXX
 SG_ DET_BELOW_RAIN_THOLD_010 : 0|1@1+ (1,0) [0|1] "" Vector__XXX
 SG_ DET_RANGE_011 : 0|15@1+ (0.015625,0) [0|500] "m" Vector__XXX
 SG_ DET_RANGE_ERR_011 : 0|7@1+ (0.0075,0) [0|0.9525] "m" Vector__XXX
 SG_ DET_RANGE_VELOCITY_011 : 0|15@1+ (0.0078125,-128) [-128|127.9921875] "m/s" Vector__XXX
 SG_ DET_RANGE_VELOCITY_ERR_011 : 0|8@1+ (0.003,0) [0|0.765] "m/s" Vector__XXX
 SG_ DET_AZIMUTH_011 : 0|13@1+ (0.0004,-1.5708) [-1.5708|1.5708] "rad" Vector__XXX
 SG_ DET_AZIMUTH_ERR_011 : 0|7@1+ (0.00087267,0) [0|0.11082909] "rad" Vector__XXX
 SG_ DET_ELEVATION_011 : 0|8@1+ (0.00275,-0.34925) [-0.34925|0.34925] "rad" Vector__XXX
 SG_ DET_ELEVATION_ERR_011 : 0|6@1+ (0.00174533,0) [0|0.10995579] "rad" Vector__XXX
 SG_ DET_RCS_011 : 0|8@1+ (0.5,-64) [-64|63.5] "dBsm" Vector__XXX
 SG_ DET_BI_STATIC_FLAG_011 : 0|1@1+ (1,0) [0|1] "" Vector__XXX
 SG_ DET_SUPER_RES_TARGET_011 : 0|1@1+ (1,0) [0|1] "" Vector__XXX
 SG_ DET_SNR_011 : 0|8@1+ (0.35156,0) [0|89.6478] "dB" Vector__XXX
 SG_ DET_EXISTENCE_PROB_011 : 0|6@1+ (1.588,0) [0|100] "%" Vector__XXX
 SG_ DET_HVC_FLAG_011 : 0|1@1+ (1,0) [0|1] "" Vector__XXX
 SG_ DET_CONFD_AZIMUTH_011 : 0|2@1+ (1,0) [0|3] "" Vector__XXX
 SG_ DET_CONFD_ELEVATION_011 : 0|2@1+ (1,0) [0|3] "" Vector__XXX
 SG_ DET_PROB_1STAZHYPO_011 : 0|1@1+ (1,0) [0|1] "" Vector__XXX
 SG_ DET_IDM_011 : 0|1@1+ (1,0) [0|1] "" Vector__XXX
 SG_ DET_MTD_011 : 0|1@1+ (1,0) [0|1] "" Vector__XXX
 SG_ DET_BELOW_RAIN_THOLD_011 : 0|1@1+ (1,0) [0|1] "" Vector__XXX
 SG_ DET_RANGE_012 : 0|15@1+ (0.015625,0) [0|500] "m" Vector__XXX
 SG_ DET_RANGE_ERR_012 : 0|7@1+ (0.0075,0) [0|0.9525] "m" Vector__XXX
 SG_ DET_RANGE_VELOCITY_012 : 0|15@1+ (0.0078125,-128) [-128|127.9921875] "m/s" Vector__XXX
 SG_ DET_RANGE_VELOCITY_ERR_012 : 0|8@1+ (0.003,0) [0|0.765] "m/s" Vector__XXX
 SG_ DET_AZIMUTH_012 : 0|13@1+ (0.0004,-1.5708) [-1.5708|1.5708] "rad" Vector__XXX
 SG_ DET_AZIMUTH_ERR_012 : 0|7@1+ (0.00087267,0) [0|0.11082909] "rad" Vector__XXX
 SG_ DET_ELEVATION_012 : 0|8@1+ (0.00275,-0.34925) [-0.34925|0.34925] "rad" Vector__XXX
 SG_ DET_ELEVATION_ERR_012 : 0|6@1+ (0.00174533,0) [0|0.10995579] "rad" Vector__XXX
 SG_ DET_RCS_012 : 0|8@1+ (0.5,-64) [-64|63.5] "dBsm" Vector__XXX
 SG_ DET_BI_STATIC_FLAG_012 : 0|1@1+ (1,0) [0|1] "" Vector__XXX
 SG_ DET_SUPER_RES_TARGET_012 : 0|1@1+ (1,0) [0|1] "" Vector__XXX
 SG_ DET_SNR_012 : 0|8@1+ (0.35156,0) [0|89.6478] "dB" Vector__XXX
 SG_ DET_EXISTENCE_PROB_012 : 0|6@1+ (1.588,0) [0|100] "%" Vector__XXX
 SG_ DET_HVC_FLAG_012 : 0|1@1+ (1,0) [0|1] "" Vector__XXX
 SG_ DET_CONFD_AZIMUTH_012 : 0|2@1+ (1,0) [0|3] "" Vector__XXX
 SG_ DET_CONFD_ELEVATION_012 : 0|2@1+ (1,0) [0|3] "" Vector__XXX
 SG_ DET_MH_SCAN_INDEX_4LSB_009_012 : 0|4@1+ (1,0) [0|15] "" Vector__XXX
 SG_ DET_MH_CYCLE_COUNTER_009_012 : 0|8@1+ (1,0) [0|255] "" Vector__XXX
 SG_ DET_MH_CRC16_009_012 : 0|16@1+ (1,0) [0|65535] "" Vector__XXX
 SG_ DET_PROB_1STAZHYPO_012 : 0|1@1+ (1,0) [0|1] "" Vector__XXX
 SG_ DET_IDM_012 : 0|1@1+ (1,0) [0|1] "" Vector__XXX
 SG_ DET_MTD_012 : 0|1@1+ (1,0) [0|1] "" Vector__XXX
 SG_ DET_BELOW_RAIN_THOLD_012 : 0|1@1+ (1,0) [0|1] "" Vector__XXX
 SG_ DET_RANGE_013 : 0|15@1+ (0.015625,0) [0|500] "m" Vector__XXX
 SG_ DET_RANGE_ERR_013 : 0|7@1+ (0.0075,0) [0|0.9525] "m" Vector__XXX
 SG_ DET_RANGE_VELOCITY_013 : 0|15@1+ (0.0078125,-128) [-128|127.9921875] "m/s" Vector__XXX
 SG_ DET_RANGE_VELOCITY_ERR_013 : 0|8@1+ (0.003,0) [0|0.765] "m/s" Vector__XXX
 SG_ DET_AZIMUTH_013 : 0|13@1+ (0.0004,-1.5708) [-1.5708|1.5708] "rad" Vector__XXX
 SG_ DET_AZIMUTH_ERR_013 : 0|7@1+ (0.00087267,0) [0|0.11082909] "rad" Vector__XXX
 SG_ DET_ELEVATION_013 : 0|8@1+ (0.00275,-0.34925) [-0.34925|0.34925] "rad" Vector__XXX
 SG_ DET_ELEVATION_ERR_013 : 0|6@1+ (0.00174533,0) [0|0.10995579] "rad" Vector__XXX
 SG_ DET_RCS_013 : 0|8@1+ (0.5,-64) [-64|63.5] "dBsm" Vector__XXX
 SG_ DET_BI_STATIC_FLAG_013 : 0|1@1+ (1,0) [0|1] "" Vector__XXX
 SG_ DET_SUPER_RES_TARGET_013 : 0|1@1+ (1,0) [0|1] "" Vector__XXX
 SG_ DET_SNR_013 : 0|8@1+ (0.35156,0) [0|89.6478] "dB" Vector__XXX
 SG_ DET_EXISTENCE_PROB_013 : 0|6@1+ (1.588,0) [0|100] "%" Vector__XXX
 SG_ DET_HVC_FLAG_013 : 0|1@1+ (1,0) [0|1] "" Vector__XXX
 SG_ DET_CONFD_AZIMUTH_013 : 0|2@1+ (1,0) [0|3] "" Vector__XXX
 SG_ DET_CONFD_ELEVATION_013 : 0|2@1+ (1,0) [0|3] "" Vector__XXX
 SG_ DET_PROB_1STAZHYPO_013 : 0|1@1+ (1,0) [0|1] "" Vector__XXX
 SG_ DET_IDM_013 : 0|1@1+ (1,0) [0|1] "" Vector__XXX
 SG_ DET_MTD_013 : 0|1@1+ (1,0) [0|1] "" Vector__XXX
 SG_ DET_BELOW_RAIN_THOLD_013 : 0|1@1+ (1,0) [0|1] "" Vector__XXX
 SG_ DET_RANGE_014 : 0|15@1+ (0.015625,0) [0|500] "m" Vector__XXX
 SG_ DET_RANGE_ERR_014 : 0|7@1+ (0.0075,0) [0|0.9525] "m" Vector__XXX
 SG_ DET_RANGE_VELOCITY_014 : 0|15@1+ (0.0078125,-128) [-128|127.9921875] "m/s" Vector__XXX
 SG_ DET_RANGE_VELOCITY_ERR_014 : 0|8@1+ (0.003,0) [0|0.765] "m/s" Vector__XXX
 SG_ DET_AZIMUTH_014 : 0|13@1+ (0.0004,-1.5708) [-1.5708|1.5708] "rad" Vector__XXX
 SG_ DET_AZIMUTH_ERR_014 : 0|7@1+ (0.00087267,0) [0|0.11082909] "rad" Vector__XXX
 SG_ DET_ELEVATION_014 : 0|8@1+ (0.00275,-0.34925) [-0.34925|0.34925] "rad" Vector__XXX
 SG_ DET_ELEVATION_ERR_014 : 0|6@1+ (0.00174533,0) [0|0.10995579] "rad" Vector__XXX
 SG_ DET_RCS_014 : 0|8@1+ (0.5,-64) [-64|63.5] "dBsm" Vector__XXX
 SG_ DET_BI_STATIC_FLAG_014 : 0|1@1+ (1,0) [0|1] "" Vector__XXX
 SG_ DET_SUPER_RES_TARGET_014 : 0|1@1+ (1,0) [0|1] "" Vector__XXX
 SG_ DET_SNR_014 : 0|8@1+ (0.35156,0) [0|89.6478] "dB" Vector__XXX
 SG_ DET_EXISTENCE_PROB_014 : 0|6@1+ (1.588,0) [0|100] "%" Vector__XXX
 SG_ DET_HVC_FLAG_014 : 0|1@1+ (1,0) [0|1] "" Vector__XXX
 SG_ DET_CONFD_AZIMUTH_014 : 0|2@1+ (1,0) [0|3] "" Vector__XXX
 SG_ DET_CONFD_ELEVATION_014 : 0|2@1+ (1,0) [0|3] "" Vector__XXX
 SG_ DET_PROB_1STAZHYPO_014 : 0|1@1+ (1,0) [0|1] "" Vector__XXX
 SG_ DET_IDM_014 : 0|1@1+ (1,0) [0|1] "" Vector__XXX
 SG_ DET_MTD_014 : 0|1@1+ (1,0) [0|1] "" Vector__XXX
 SG_ DET_BELOW_RAIN_THOLD_014 : 0|1@1+ (1,0) [0|1] "" Vector__XXX
 SG_ DET_RANGE_015 : 0|15@1+ (0.015625,0) [0|500] "m" Vector__XXX
 SG_ DET_RANGE_ERR_015 : 0|7@1+ (0.0075,0) [0|0.9525] "m" Vector__XXX
 SG_ DET_RANGE_VELOCITY_015 : 0|15@1+ (0.0078125,-128) [-128|127.9921875] "m/s" Vector__XXX
 SG_ DET_RANGE_VELOCITY_ERR_015 : 0|8@1+ (0.003,0) [0|0.765] "m/s" Vector__XXX
 SG_ DET_AZIMUTH_015 : 0|13@1+ (0.0004,-1.5708) [-1.5708|1.5708] "rad" Vector__XXX
 SG_ DET_AZIMUTH_ERR_015 : 0|7@1+ (0.00087267,0) [0|0.11082909] "rad" Vector__XXX
 SG_ DET_ELEVATION_015 : 0|8@1+ (0.00275,-0.34925) [-0.34925|0.34925] "rad" Vector__XXX
 SG_ DET_ELEVATION_ERR_015 : 0|6@1+ (0.00174533,0) [0|0.10995579] "rad" Vector__XXX
 SG_ DET_RCS_015 : 0|8@1+ (0.5,-64) [-64|63.5] "dBsm" Vector__XXX
 SG_ DET_BI_STATIC_FLAG_015 : 0|1@1+ (1,0) [0|1] "" Vector__XXX
 SG_ DET_SUPER_RES_TARGET_015 : 0|1@1+ (1,0) [0|1] "" Vector__XXX
 SG_ DET_SNR_015 : 0|8@1+ (0.35156,0) [0|89.6478] "dB" Vector__XXX
 SG_ DET_EXISTENCE_PROB_015 : 0|6@1+ (1.588,0) [0|100] "%" Vector__XXX
 SG_ DET_HVC_FLAG_015 : 0|1@1+ (1,0) [0|1] "" Vector__XXX
 SG_ DET_CONFD_AZIMUTH_015 : 0|2@1+ (1,0) [0|3] "" Vector__XXX
 SG_ DET_CONFD_ELEVATION_015 : 0|2@1+ (1,0) [0|3] "" Vector__XXX
 SG_ DET_PROB_1STAZHYPO_015 : 0|1@1+ (1,0) [0|1] "" Vector__XXX
 SG_ DET_IDM_015 : 0|1@1+ (1,0) [0|1] "" Vector__XXX
 SG_ DET_MTD_015 : 0|1@1+ (1,0) [0|1] "" Vector__XXX
 SG_ DET_BELOW_RAIN_THOLD_015 : 0|1@1+ (1,0) [0|1] "" Vector__XXX
 SG_ DET_RANGE_016 : 0|15@1+ (0.015625,0) [0|500] "m" Vector__XXX
 SG_ DET_RANGE_ERR_016 : 0|7@1+ (0.0075,0) [0|0.9525] "m" Vector__XXX
 SG_ DET_RANGE_VELOCITY_016 : 0|15@1+ (0.0078125,-128) [-128|127.9921875] "m/s" Vector__XXX
 SG_ DET_RANGE_VELOCITY_ERR_016 : 0|8@1+ (0.003,0) [0|0.765] "m/s" Vector__XXX
 SG_ DET_AZIMUTH_016 : 0|13@1+ (0.0004,-1.5708) [-1.5708|1.5708] "rad" Vector__XXX
 SG_ DET_AZIMUTH_ERR_016 : 0|7@1+ (0.00087267,0) [0|0.11082909] "rad" Vector__XXX
 SG_ DET_ELEVATION_016 : 0|8@1+ (0.00275,-0.34925) [-0.34925|0.34925] "rad" Vector__XXX
 SG_ DET_ELEVATION_ERR_016 : 0|6@1+ (0.00174533,0) [0|0.10995579] "rad" Vector__XXX
 SG_ DET_RCS_016 : 0|8@1+ (0.5,-64) [-64|63.5] "dBsm" Vector__XXX
 SG_ DET_BI_STATIC_FLAG_016 : 0|1@1+ (1,0) [0|1] "" Vector__XXX
 SG_ DET_SUPER_RES_TARGET_016 : 0|1@1+ (1,0) [0|1] "" Vector__XXX
 SG_ DET_SNR_016 : 0|8@1+ (0.35156,0) [0|89.6478] "dB" Vector__XXX
 SG_ DET_EXISTENCE_PROB_016 : 0|6@1+ (1.588,0) [0|100] "%" Vector__XXX
 SG_ DET_HVC_FLAG_016 : 0|1@1+ (1,0) [0|1] "" Vector__XXX
 SG_ DET_CONFD_AZIMUTH_016 : 0|2@1+ (1,0) [0|3] "" Vector__XXX
 SG_ DET_CONFD_ELEVATION_016 : 0|2@1+ (1,0) [0|3] "" Vector__XXX
 SG_ DET_MH_SCAN_INDEX_4LSB_013_016 : 0|4@1+ (1,0) [0|15] "" Vector__XXX
 SG_ DET_MH_CYCLE_COUNTER_013_016 : 0|8@1+ (1,0) [0|255] "" Vector__XXX
 SG_ DET_MH_CRC16_013_016 : 0|16@1+ (1,0) [0|65535] "" Vector__XXX
 SG_ DET_PROB_1STAZHYPO_016 : 0|1@1+ (1,0) [0|1] "" Vector__XXX
 SG_ DET_IDM_016 : 0|1@1+ (1,0) [0|1] "" Vector__XXX
 SG_ DET_MTD_016 : 0|1@1+ (1,0) [0|1] "" Vector__XXX
 SG_ DET_BELOW_RAIN_THOLD_016 : 0|1@1+ (1,0) [0|1] "" Vector__XXX
 SG_ DET_RANGE_017 : 0|15@1+ (0.015625,0) [0|500] "m" Vector__XXX
 SG_ DET_RANGE_ERR_017 : 0|7@1+ (0.0075,0) [0|0.9525] "m" Vector__XXX
 SG_ DET_RANGE_VELOCITY_017 : 0|15@1+ (0.0078125,-128) [-128|127.9921875] "m/s" Vector__XXX
 SG_ DET_RANGE_VELOCITY_ERR_017 : 0|8@1+ (0.003,0) [0|0.765] "m/s" Vector__XXX
 SG_ DET_AZIMUTH_017 : 0|13@1+ (0.0004,-1.5708) [-1.5708|1.5708] "rad" Vector__XXX
 SG_ DET_AZIMUTH_ERR_017 : 0|7@1+ (0.00087267,0) [0|0.11082909] "rad" Vector__XXX
 SG_ DET_ELEVATION_017 : 0|8@1+ (0.00275,-0.34925) [-0.34925|0.34925] "rad" Vector__XXX
 SG_ DET_ELEVATION_ERR_017 : 0|6@1+ (0.00174533,0) [0|0.10995579] "rad" Vector__XXX
 SG_ DET_RCS_017 : 0|8@1+ (0.5,-64) [-64|63.5] "dBsm" Vector__XXX
 SG_ DET_BI_STATIC_FLAG_017 : 0|1@1+ (1,0) [0|1] "" Vector__XXX
 SG_ DET_SUPER_RES_TARGET_017 : 0|1@1+ (1,0) [0|1] "" Vector__XXX
 SG_ DET_SNR_017 : 0|8@1+ (0.35156,0) [0|89.6478] "dB" Vector__XXX
 SG_ DET_EXISTENCE_PROB_017 : 0|6@1+ (1.588,0) [0|100] "%" Vector__XXX
 SG_ DET_HVC_FLAG_017 : 0|1@1+ (1,0) [0|1] "" Vector__XXX
 SG_ DET_CONFD_AZIMUTH_017 : 0|2@1+ (1,0) [0|3] "" Vector__XXX
 SG_ DET_CONFD_ELEVATION_017 : 0|2@1+ (1,0) [0|3] "" Vector__XXX
 SG_ DET_PROB_1STAZHYPO_017 : 0|1@1+ (1,0) [0|1] "" Vector__XXX
 SG_ DET_IDM_017 : 0|1@1+ (1,0) [0|1] "" Vector__XXX
 SG_ DET_MTD_017 : 0|1@1+ (1,0) [0|1] "" Vector__XXX
 SG_ DET_BELOW_RAIN_THOLD_017 : 0|1@1+ (1,0) [0|1] "" Vector__XXX
 SG_ DET_RANGE_018 : 0|15@1+ (0.015625,0) [0|500] "m" Vector__XXX
 SG_ DET_RANGE_ERR_018 : 0|7@1+ (0.0075,0) [0|0.9525] "m" Vector__XXX
 SG_ DET_RANGE_VELOCITY_018 : 0|15@1+ (0.0078125,-128) [-128|127.9921875] "m/s" Vector__XXX
 SG_ DET_RANGE_VELOCITY_ERR_018 : 0|8@1+ (0.003,0) [0|0.765] "m/s" Vector__XXX
 SG_ DET_AZIMUTH_018 : 0|13@1+ (0.0004,-1.5708) [-1.5708|1.5708] "rad" Vector__XXX
 SG_ DET_AZIMUTH_ERR_018 : 0|7@1+ (0.00087267,0) [0|0.11082909] "rad" Vector__XXX
 SG_ DET_ELEVATION_018 : 0|8@1+ (0.00275,-0.34925) [-0.34925|0.34925] "rad" Vector__XXX
 SG_ DET_ELEVATION_ERR_018 : 0|6@1+ (0.00174533,0) [0|0.10995579] "rad" Vector__XXX
 SG_ DET_RCS_018 : 0|8@1+ (0.5,-64) [-64|63.5] "dBsm" Vector__XXX
 SG_ DET_BI_STATIC_FLAG_018 : 0|1@1+ (1,0) [0|1] "" Vector__XXX
 SG_ DET_SUPER_RES_TARGET_018 : 0|1@1+ (1,0) [0|1] "" Vector__XXX
 SG_ DET_SNR_018 : 0|8@1+ (0.35156,0) [0|89.6478] "dB" Vector__XXX
 SG_ DET_EXISTENCE_PROB_018 : 0|6@1+ (1.588,0) [0|100] "%" Vector__XXX
 SG_ DET_HVC_FLAG_018 : 0|1@1+ (1,0) [0|1] "" Vector__XXX
 SG_ DET_CONFD_AZIMUTH_018 : 0|2@1+ (1,0) [0|3] "" Vector__XXX
 SG_ DET_CONFD_ELEVATION_018 : 0|2@1+ (1,0) [0|3] "" Vector__XXX
 SG_ DET_PROB_1STAZHYPO_018 : 0|1@1+ (1,0) [0|1] "" Vector__XXX
 SG_ DET_IDM_018 : 0|1@1+ (1,0) [0|1] "" Vector__XXX
 SG_ DET_MTD_018 : 0|1@1+ (1,0) [0|1] "" Vector__XXX
 SG_ DET_BELOW_RAIN_THOLD_018 : 0|1@1+ (1,0) [0|1] "" Vector__XXX
 SG_ DET_RANGE_019 : 0|15@1+ (0.015625,0) [0|500] "m" Vector__XXX
 SG_ DET_RANGE_ERR_019 : 0|7@1+ (0.0075,0) [0|0.9525] "m" Vector__XXX
 SG_ DET_RANGE_VELOCITY_019 : 0|15@1+ (0.0078125,-128) [-128|127.9921875] "m/s" Vector__XXX
 SG_ DET_RANGE_VELOCITY_ERR_019 : 0|8@1+ (0.003,0) [0|0.765] "m/s" Vector__XXX
 SG_ DET_AZIMUTH_019 : 0|13@1+ (0.0004,-1.5708) [-1.5708|1.5708] "rad" Vector__XXX
 SG_ DET_AZIMUTH_ERR_019 : 0|7@1+ (0.00087267,0) [0|0.11082909] "rad" Vector__XXX
 SG_ DET_ELEVATION_019 : 0|8@1+ (0.00275,-0.34925) [-0.34925|0.34925] "rad" Vector__XXX
 SG_ DET_ELEVATION_ERR_019 : 0|6@1+ (0.00174533,0) [0|0.10995579] "rad" Vector__XXX
 SG_ DET_RCS_019 : 0|8@1+ (0.5,-64) [-64|63.5] "dBsm" Vector__XXX
 SG_ DET_BI_STATIC_FLAG_019 : 0|1@1+ (1,0) [0|1] "" Vector__XXX
 SG_ DET_SUPER_RES_TARGET_019 : 0|1@1+ (1,0) [0|1] "" Vector__XXX
 SG_ DET_SNR_019 : 0|8@1+ (0.35156,0) [0|89.6478] "dB" Vector__XXX
 SG_ DET_EXISTENCE_PROB_019 : 0|6@1+ (1.588,0) [0|100] "%" Vector__XXX
 SG_ DET_HVC_FLAG_019 : 0|1@1+ (1,0) [0|1] "" Vector__XXX
 SG_ DET_CONFD_AZIMUTH_019 : 0|2@1+ (1,0) [0|3] "" Vector__XXX
 SG_ DET_CONFD_ELEVATION_019 : 0|2@1+ (1,0) [0|3] "" Vector__XXX
 SG_ DET_PROB_1STAZHYPO_019 : 0|1@1+ (1,0) [0|1] "" Vector__XXX
 SG_ DET_IDM_019 : 0|1@1+ (1,0) [0|1] "" Vector__XXX
 SG_ DET_MTD_019 : 0|1@1+ (1,0) [0|1] "" Vector__XXX
 SG_ DET_BELOW_RAIN_THOLD_019 : 0|1@1+ (1,0) [0|1] "" Vector__XXX
 SG_ DET_RANGE_020 : 0|15@1+ (0.015625,0) [0|500] "m" Vector__XXX
 SG_ DET_RANGE_ERR_020 : 0|7@1+ (0.0075,0) [0|0.9525] "m" Vector__XXX
 SG_ DET_RANGE_VELOCITY_020 : 0|15@1+ (0.0078125,-128) [-128|127.9921875] "m/s" Vector__XXX
 SG_ DET_RANGE_VELOCITY_ERR_020 : 0|8@1+ (0.003,0) [0|0.765] "m/s" Vector__XXX
 SG_ DET_AZIMUTH_020 : 0|13@1+ (0.0004,-1.5708) [-1.5708|1.5708] "rad" Vector__XXX
 SG_ DET_AZIMUTH_ERR_020 : 0|7@1+ (0.00087267,0) [0|0.11082909] "rad" Vector__XXX
 SG_ DET_ELEVATION_020 : 0|8@1+ (0.00275,-0.34925) [-0.34925|0.34925] "rad" Vector__XXX
 SG_ DET_ELEVATION_ERR_020 : 0|6@1+ (0.00174533,0) [0|0.10995579] "rad" Vector__XXX
 SG_ DET_RCS_020 : 0|8@1+ (0.5,-64) [-64|63.5] "dBsm" Vector__XXX
 SG_ DET_BI_STATIC_FLAG_020 : 0|1@1+ (1,0) [0|1] "" Vector__XXX
 SG_ DET_SUPER_RES_TARGET_020 : 0|1@1+ (1,0) [0|1] "" Vector__XXX
 SG_ DET_SNR_020 : 0|8@1+ (0.35156,0) [0|89.6478] "dB" Vector__XXX
 SG_ DET_EXISTENCE_PROB_020 : 0|6@1+ (1.588,0) [0|100] "%" Vector__XXX
 SG_ DET_HVC_FLAG_020 : 0|1@1+ (1,0) [0|1] "" Vector__XXX
 SG_ DET_CONFD_AZIMUTH_020 : 0|2@1+ (1,0) [0|3] "" Vector__XXX
 SG_ DET_CONFD_ELEVATION_020 : 0|2@1+ (1,0) [0|3] "" Vector__XXX
 SG_ DET_MH_SCAN_INDEX_4LSB_017_020 : 0|4@1+ (1,0) [0|15] "" Vector__XXX
 SG_ DET_MH_CYCLE_COUNTER_017_020 : 0|8@1+ (1,0) [0|255] "" Vector__XXX
 SG_ DET_MH_CRC16_017_020 : 0|16@1+ (1,0) [0|65535] "" Vector__XXX
 SG_ DET_PROB_1STAZHYPO_020 : 0|1@1+ (1,0) [0|1] "" Vector__XXX
 SG_ DET_IDM_020 : 0|1@1+ (1,0) [0|1] "" Vector__XXX
 SG_ DET_MTD_020 : 0|1@1+ (1,0) [0|1] "" Vector__XXX
 SG_ DET_BELOW_RAIN_THOLD_020 : 0|1@1+ (1,0) [0|1] "" Vector__XXX
 SG_ DET_RANGE_021 : 0|15@1+ (0.015625,0) [0|500] "m" Vector__XXX
 SG_ DET_RANGE_ERR_021 : 0|7@1+ (0.0075,0) [0|0.9525] "m" Vector__XXX
 SG_ DET_RANGE_VELOCITY_021 : 0|15@1+ (0.0078125,-128) [-128|127.9921875] "m/s" Vector__XXX
 SG_ DET_RANGE_VELOCITY_ERR_021 : 0|8@1+ (0.003,0) [0|0.765] "m/s" Vector__XXX
 SG_ DET_AZIMUTH_021 : 0|13@1+ (0.0004,-1.5708) [-1.5708|1.5708] "rad" Vector__XXX
 SG_ DET_AZIMUTH_ERR_021 : 0|7@1+ (0.00087267,0) [0|0.11082909] "rad" Vector__XXX
 SG_ DET_ELEVATION_021 : 0|8@1+ (0.00275,-0.34925) [-0.34925|0.34925] "rad" Vector__XXX
 SG_ DET_ELEVATION_ERR_021 : 0|6@1+ (0.00174533,0) [0|0.10995579] "rad" Vector__XXX
 SG_ DET_RCS_021 : 0|8@1+ (0.5,-64) [-64|63.5] "dBsm" Vector__XXX
 SG_ DET_BI_STATIC_FLAG_021 : 0|1@1+ (1,0) [0|1] "" Vector__XXX
 SG_ DET_SUPER_RES_TARGET_021 : 0|1@1+ (1,0) [0|1] "" Vector__XXX
 SG_ DET_SNR_021 : 0|8@1+ (0.35156,0) [0|89.6478] "dB" Vector__XXX
 SG_ DET_EXISTENCE_PROB_021 : 0|6@1+ (1.588,0) [0|100] "%" Vector__XXX
 SG_ DET_HVC_FLAG_021 : 0|1@1+ (1,0) [0|1] "" Vector__XXX
 SG_ DET_CONFD_AZIMUTH_021 : 0|2@1+ (1,0) [0|3] "" Vector__XXX
 SG_ DET_CONFD_ELEVATION_021 : 0|2@1+ (1,0) [0|3] "" Vector__XXX
 SG_ DET_PROB_1STAZHYPO_021 : 0|1@1+ (1,0) [0|1] "" Vector__XXX
 SG_ DET_IDM_021 : 0|1@1+ (1,0) [0|1] "" Vector__XXX
 SG_ DET_MTD_021 : 0|1@1+ (1,0) [0|1] "" Vector__XXX
 SG_ DET_BELOW_RAIN_THOLD_021 : 0|1@1+ (1,0) [0|1] "" Vector__XXX
 SG_ DET_RANGE_022 : 0|15@1+ (0.015625,0) [0|500] "m" Vector__XXX
 SG_ DET_RANGE_ERR_022 : 0|7@1+ (0.0075,0) [0|0.9525] "m" Vector__XXX
 SG_ DET_RANGE_VELOCITY_022 : 0|15@1+ (0.0078125,-128) [-128|127.9921875] "m/s" Vector__XXX
 SG_ DET_RANGE_VELOCITY_ERR_022 : 0|8@1+ (0.003,0) [0|0.765] "m/s" Vector__XXX
 SG_ DET_AZIMUTH_022 : 0|13@1+ (0.0004,-1.5708) [-1.5708|1.5708] "rad" Vector__XXX
 SG_ DET_AZIMUTH_ERR_022 : 0|7@1+ (0.00087267,0) [0|0.11082909] "rad" Vector__XXX
 SG_ DET_ELEVATION_022 : 0|8@1+ (0.00275,-0.34925) [-0.34925|0.34925] "rad" Vector__XXX
 SG_ DET_ELEVATION_ERR_022 : 0|6@1+ (0.00174533,0) [0|0.10995579] "rad" Vector__XXX
 SG_ DET_RCS_022 : 0|8@1+ (0.5,-64) [-64|63.5] "dBsm" Vector__XXX
 SG_ DET_BI_STATIC_FLAG_022 : 0|1@1+ (1,0) [0|1] "" Vector__XXX
 SG_ DET_SUPER_RES_TARGET_022 : 0|1@1+ (1,0) [0|1] "" Vector__XXX
 SG_ DET_SNR_022 : 0|8@1+ (0.35156,0) [0|89.6478] "dB" Vector__XXX
 SG_ DET_EXISTENCE_PROB_022 : 0|6@1+ (1.588,0) [0|100] "%" Vector__XXX
 SG_ DET_HVC_FLAG_022 : 0|1@1+ (1,0) [0|1] "" Vector__XXX
 SG_ DET_CONFD_AZIMUTH_022 : 0|2@1+ (1,0) [0|3] "" Vector__XXX
 SG_ DET_CONFD_ELEVATION_022 : 0|2@1+ (1,0) [0|3] "" Vector__XXX
 SG_ DET_PROB_1STAZHYPO_022 : 0|1@1+ (1,0) [0|1] "" Vector__XXX
 SG_ DET_IDM_022 : 0|1@1+ (1,0) [0|1] "" Vector__XXX
 SG_ DET_MTD_022 : 0|1@1+ (1,0) [0|1] "" Vector__XXX
 SG_ DET_BELOW_RAIN_THOLD_022 : 0|1@1+ (1,0) [0|1] "" Vector__XXX
 SG_ DET_RANGE_023 : 0|15@1+ (0.015625,0) [0|500] "m" Vector__XXX
 SG_ DET_RANGE_ERR_023 : 0|7@1+ (0.0075,0) [0|0.9525] "m" Vector__XXX
 SG_ DET_RANGE_VELOCITY_023 : 0|15@1+ (0.0078125,-128) [-128|127.9921875] "m/s" Vector__XXX
 SG_ DET_RANGE_VELOCITY_ERR_023 : 0|8@1+ (0.003,0) [0|0.765] "m/s" Vector__XXX
 SG_ DET_AZIMUTH_023 : 0|13@1+ (0.0004,-1.5708) [-1.5708|1.5708] "rad" Vector__XXX
 SG_ DET_AZIMUTH_ERR_023 : 0|7@1+ (0.00087267,0) [0|0.11082909] "rad" Vector__XXX
 SG_ DET_ELEVATION_023 : 0|8@1+ (0.00275,-0.34925) [-0.34925|0.34925] "rad" Vector__XXX
 SG_ DET_ELEVATION_ERR_023 : 0|6@1+ (0.00174533,0) [0|0.10995579] "rad" Vector__XXX
 SG_ DET_RCS_023 : 0|8@1+ (0.5,-64) [-64|63.5] "dBsm" Vector__XXX
 SG_ DET_BI_STATIC_FLAG_023 : 0|1@1+ (1,0) [0|1] "" Vector__XXX
 SG_ DET_SUPER_RES_TARGET_023 : 0|1@1+ (1,0) [0|1] "" Vector__XXX
 SG_ DET_SNR_023 : 0|8@1+ (0.35156,0) [0|89.6478] "dB" Vector__XXX
 SG_ DET_EXISTENCE_PROB_023 : 0|6@1+ (1.588,0) [0|100] "%" Vector__XXX
 SG_ DET_HVC_FLAG_023 : 0|1@1+ (1,0) [0|1] "" Vector__XXX
 SG_ DET_CONFD_AZIMUTH_023 : 0|2@1+ (1,0) [0|3] "" Vector__XXX
 SG_ DET_CONFD_ELEVATION_023 : 0|2@1+ (1,0) [0|3] "" Vector__XXX
 SG_ DET_PROB_1STAZHYPO_023 : 0|1@1+ (1,0) [0|1] "" Vector__XXX
 SG_ DET_IDM_023 : 0|1@1+ (1,0) [0|1] "" Vector__XXX
 SG_ DET_MTD_023 : 0|1@1+ (1,0) [0|1] "" Vector__XXX
 SG_ DET_BELOW_RAIN_THOLD_023 : 0|1@1+ (1,0) [0|1] "" Vector__XXX
 SG_ DET_RANGE_024 : 0|15@1+ (0.015625,0) [0|500] "m" Vector__XXX
 SG_ DET_RANGE_ERR_024 : 0|7@1+ (0.0075,0) [0|0.9525] "m" Vector__XXX
 SG_ DET_RANGE_VELOCITY_024 : 0|15@1+ (0.0078125,-128) [-128|127.9921875] "m/s" Vector__XXX
 SG_ DET_RANGE_VELOCITY_ERR_024 : 0|8@1+ (0.003,0) [0|0.765] "m/s" Vector__XXX
 SG_ DET_AZIMUTH_024 : 0|13@1+ (0.0004,-1.5708) [-1.5708|1.5708] "rad" Vector__XXX
 SG_ DET_AZIMUTH_ERR_024 : 0|7@1+ (0.00087267,0) [0|0.11082909] "rad" Vector__XXX
 SG_ DET_ELEVATION_024 : 0|8@1+ (0.00275,-0.34925) [-0.34925|0.34925] "rad" Vector__XXX
 SG_ DET_ELEVATION_ERR_024 : 0|6@1+ (0.00174533,0) [0|0.10995579] "rad" Vector__XXX
 SG_ DET_RCS_024 : 0|8@1+ (0.5,-64) [-64|63.5] "dBsm" Vector__XXX
 SG_ DET_BI_STATIC_FLAG_024 : 0|1@1+ (1,0) [0|1] "" Vector__XXX
 SG_ DET_SUPER_RES_TARGET_024 : 0|1@1+ (1,0) [0|1] "" Vector__XXX
 SG_ DET_SNR_024 : 0|8@1+ (0.35156,0) [0|89.6478] "dB" Vector__XXX
 SG_ DET_EXISTENCE_PROB_024 : 0|6@1+ (1.588,0) [0|100] "%" Vector__XXX
 SG_ DET_HVC_FLAG_024 : 0|1@1+ (1,0) [0|1] "" Vector__XXX
 SG_ DET_CONFD_AZIMUTH_024 : 0|2@1+ (1,0) [0|3] "" Vector__XXX
 SG_ DET_CONFD_ELEVATION_024 : 0|2@1+ (1,0) [0|3] "" Vector__XXX
 SG_ DET_MH_SCAN_INDEX_4LSB_021_024 : 0|4@1+ (1,0) [0|15] "" Vector__XXX
 SG_ DET_MH_CYCLE_COUNTER_021_024 : 0|8@1+ (1,0) [0|255] "" Vector__XXX
 SG_ DET_MH_CRC16_021_024 : 0|16@1+ (1,0) [0|65535] "" Vector__XXX
 SG_ DET_PROB_1STAZHYPO_024 : 0|1@1+ (1,0) [0|1] "" Vector__XXX
 SG_ DET_IDM_024 : 0|1@1+ (1,0) [0|1] "" Vector__XXX
 SG_ DET_MTD_024 : 0|1@1+ (1,0) [0|1] "" Vector__XXX
 SG_ DET_BELOW_RAIN_THOLD_024 : 0|1@1+ (1,0) [0|1] "" Vector__XXX
 SG_ DET_RANGE_025 : 0|15@1+ (0.015625,0) [0|500] "m" Vector__XXX
 SG_ DET_RANGE_ERR_025 : 0|7@1+ (0.0075,0) [0|0.9525] "m" Vector__XXX
 SG_ DET_RANGE_VELOCITY_025 : 0|15@1+ (0.0078125,-128) [-128|127.9921875] "m/s" Vector__XXX
 SG_ DET_RANGE_VELOCITY_ERR_025 : 0|8@1+ (0.003,0) [0|0.765] "m/s" Vector__XXX
 SG_ DET_AZIMUTH_025 : 0|13@1+ (0.0004,-1.5708) [-1.5708|1.5708] "rad" Vector__XXX
 SG_ DET_AZIMUTH_ERR_025 : 0|7@1+ (0.00087267,0) [0|0.11082909] "rad" Vector__XXX
 SG_ DET_ELEVATION_025 : 0|8@1+ (0.00275,-0.34925) [-0.34925|0.34925] "rad" Vector__XXX
 SG_ DET_ELEVATION_ERR_025 : 0|6@1+ (0.00174533,0) [0|0.10995579] "rad" Vector__XXX
 SG_ DET_RCS_025 : 0|8@1+ (0.5,-64) [-64|63.5] "dBsm" Vector__XXX
 SG_ DET_BI_STATIC_FLAG_025 : 0|1@1+ (1,0) [0|1] "" Vector__XXX
 SG_ DET_SUPER_RES_TARGET_025 : 0|1@1+ (1,0) [0|1] "" Vector__XXX
 SG_ DET_SNR_025 : 0|8@1+ (0.35156,0) [0|89.6478] "dB" Vector__XXX
 SG_ DET_EXISTENCE_PROB_025 : 0|6@1+ (1.588,0) [0|100] "%" Vector__XXX
 SG_ DET_HVC_FLAG_025 : 0|1@1+ (1,0) [0|1] "" Vector__XXX
 SG_ DET_CONFD_AZIMUTH_025 : 0|2@1+ (1,0) [0|3] "" Vector__XXX
 SG_ DET_CONFD_ELEVATION_025 : 0|2@1+ (1,0) [0|3] "" Vector__XXX
 SG_ DET_PROB_1STAZHYPO_025 : 0|1@1+ (1,0) [0|1] "" Vector__XXX
 SG_ DET_IDM_025 : 0|1@1+ (1,0) [0|1] "" Vector__XXX
 SG_ DET_MTD_025 : 0|1@1+ (1,0) [0|1] "" Vector__XXX
 SG_ DET_BELOW_RAIN_THOLD_025 : 0|1@1+ (1,0) [0|1] "" Vector__XXX
 SG_ DET_RANGE_026 : 0|15@1+ (0.015625,0) [0|500] "m" Vector__XXX
 SG_ DET_RANGE_ERR_026 : 0|7@1+ (0.0075,0) [0|0.9525] "m" Vector__XXX
 SG_ DET_RANGE_VELOCITY_026 : 0|15@1+ (0.0078125,-128) [-128|127.9921875] "m/s" Vector__XXX
 SG_ DET_RANGE_VELOCITY_ERR_026 : 0|8@1+ (0.003,0) [0|0.765] "m/s" Vector__XXX
 SG_ DET_AZIMUTH_026 : 0|13@1+ (0.0004,-1.5708) [-1.5708|1.5708] "rad" Vector__XXX
 SG_ DET_AZIMUTH_ERR_026 : 0|7@1+ (0.00087267,0) [0|0.11082909] "rad" Vector__XXX
 SG_ DET_ELEVATION_026 : 0|8@1+ (0.00275,-0.34925) [-0.34925|0.34925] "rad" Vector__XXX
 SG_ DET_ELEVATION_ERR_026 : 0|6@1+ (0.00174533,0) [0|0.10995579] "rad" Vector__XXX
 SG_ DET_RCS_026 : 0|8@1+ (0.5,-64) [-64|63.5] "dBsm" Vector__XXX
 SG_ DET_BI_STATIC_FLAG_026 : 0|1@1+ (1,0) [0|1] "" Vector__XXX
 SG_ DET_SUPER_RES_TARGET_026 : 0|1@1+ (1,0) [0|1] "" Vector__XXX
 SG_ DET_SNR_026 : 0|8@1+ (0.35156,0) [0|89.6478] "dB" Vector__XXX
 SG_ DET_EXISTENCE_PROB_026 : 0|6@1+ (1.588,0) [0|100] "%" Vector__XXX
 SG_ DET_HVC_FLAG_026 : 0|1@1+ (1,0) [0|1] "" Vector__XXX
 SG_ DET_CONFD_AZIMUTH_026 : 0|2@1+ (1,0) [0|3] "" Vector__XXX
 SG_ DET_CONFD_ELEVATION_026 : 0|2@1+ (1,0) [0|3] "" Vector__XXX
 SG_ DET_PROB_1STAZHYPO_026 : 0|1@1+ (1,0) [0|1] "" Vector__XXX
 SG_ DET_IDM_026 : 0|1@1+ (1,0) [0|1] "" Vector__XXX
 SG_ DET_MTD_026 : 0|1@1+ (1,0) [0|1] "" Vector__XXX
 SG_ DET_BELOW_RAIN_THOLD_026 : 0|1@1+ (1,0) [0|1] "" Vector__XXX
 SG_ DET_RANGE_027 : 0|15@1+ (0.015625,0) [0|500] "m" Vector__XXX
 SG_ DET_RANGE_ERR_027 : 0|7@1+ (0.0075,0) [0|0.9525] "m" Vector__XXX
 SG_ DET_RANGE_VELOCITY_027 : 0|15@1+ (0.0078125,-128) [-128|127.9921875] "m/s" Vector__XXX
 SG_ DET_RANGE_VELOCITY_ERR_027 : 0|8@1+ (0.003,0) [0|0.765] "m/s" Vector__XXX
 SG_ DET_AZIMUTH_027 : 0|13@1+ (0.0004,-1.5708) [-1.5708|1.5708] "rad" Vector__XXX
 SG_ DET_AZIMUTH_ERR_027 : 0|7@1+ (0.00087267,0) [0|0.11082909] "rad" Vector__XXX
 SG_ DET_ELEVATION_027 : 0|8@1+ (0.00275,-0.34925) [-0.34925|0.34925] "rad" Vector__XXX
 SG_ DET_ELEVATION_ERR_027 : 0|6@1+ (0.00174533,0) [0|0.10995579] "rad" Vector__XXX
 SG_ DET_RCS_027 : 0|8@1+ (0.5,-64) [-64|63.5] "dBsm" Vector__XXX
 SG_ DET_BI_STATIC_FLAG_027 : 0|1@1+ (1,0) [0|1] "" Vector__XXX
 SG_ DET_SUPER_RES_TARGET_027 : 0|1@1+ (1,0) [0|1] "" Vector__XXX
 SG_ DET_SNR_027 : 0|8@1+ (0.35156,0) [0|89.6478] "dB" Vector__XXX
 SG_ DET_EXISTENCE_PROB_027 : 0|6@1+ (1.588,0) [0|100] "%" Vector__XXX
 SG_ DET_HVC_FLAG_027 : 0|1@1+ (1,0) [0|1] "" Vector__XXX
 SG_ DET_CONFD_AZIMUTH_027 : 0|2@1+ (1,0) [0|3] "" Vector__XXX
 SG_ DET_CONFD_ELEVATION_027 : 0|2@1+ (1,0) [0|3] "" Vector__XXX
 SG_ DET_PROB_1STAZHYPO_027 : 0|1@1+ (1,0) [0|1] "" Vector__XXX
 SG_ DET_IDM_027 : 0|1@1+ (1,0) [0|1] "" Vector__XXX
 SG_ DET_MTD_027 : 0|1@1+ (1,0) [0|1] "" Vector__XXX
 SG_ DET_BELOW_RAIN_THOLD_027 : 0|1@1+ (1,0) [0|1] "" Vector__XXX
 SG_ DET_RANGE_028 : 0|15@1+ (0.015625,0) [0|500] "m" Vector__XXX
 SG_ DET_RANGE_ERR_028 : 0|7@1+ (0.0075,0) [0|0.9525] "m" Vector__XXX
 SG_ DET_RANGE_VELOCITY_028 : 0|15@1+ (0.0078125,-128) [-128|127.9921875] "m/s" Vector__XXX
 SG_ DET_RANGE_VELOCITY_ERR_028 : 0|8@1+ (0.003,0) [0|0.765] "m/s" Vector__XXX
 SG_ DET_AZIMUTH_028 : 0|13@1+ (0.0004,-1.5708) [-1.5708|1.5708] "rad" Vector__XXX
 SG_ DET_AZIMUTH_ERR_028 : 0|7@1+ (0.00087267,0) [0|0.11082909] "rad" Vector__XXX
 SG_ DET_ELEVATION_028 : 0|8@1+ (0.00275,-0.34925) [-0.34925|0.34925] "rad" Vector__XXX
 SG_ DET_ELEVATION_ERR_028 : 0|6@1+ (0.00174533,0) [0|0.10995579] "rad" Vector__XXX
 SG_ DET_RCS_028 : 0|8@1+ (0.5,-64) [-64|63.5] "dBsm" Vector__XXX
 SG_ DET_BI_STATIC_FLAG_028 : 0|1@1+ (1,0) [0|1] "" Vector__XXX
 SG_ DET_SUPER_RES_TARGET_028 : 0|1@1+ (1,0) [0|1] "" Vector__XXX
 SG_ DET_SNR_028 : 0|8@1+ (0.35156,0) [0|89.6478] "dB" Vector__XXX
 SG_ DET_EXISTENCE_PROB_028 : 0|6@1+ (1.588,0) [0|100] "%" Vector__XXX
 SG_ DET_HVC_FLAG_028 : 0|1@1+ (1,0) [0|1] "" Vector__XXX
 SG_ DET_CONFD_AZIMUTH_028 : 0|2@1+ (1,0) [0|3] "" Vector__XXX
 SG_ DET_CONFD_ELEVATION_028 : 0|2@1+ (1,0) [0|3] "" Vector__XXX
 SG_ DET_MH_SCAN_INDEX_4LSB_025_028 : 0|4@1+ (1,0) [0|15] "" Vector__XXX
 SG_ DET_MH_CYCLE_COUNTER_025_028 : 0|8@1+ (1,0) [0|255] "" Vector__XXX
 SG_ DET_MH_CRC16_025_028 : 0|16@1+ (1,0) [0|65535] "" Vector__XXX
 SG_ DET_PROB_1STAZHYPO_028 : 0|1@1+ (1,0) [0|1] "" Vector__XXX
 SG_ DET_IDM_028 : 0|1@1+ (1,0) [0|1] "" Vector__XXX
 SG_ DET_MTD_028 : 0|1@1+ (1,0) [0|1] "" Vector__XXX
 SG_ DET_BELOW_RAIN_THOLD_028 : 0|1@1+ (1,0) [0|1] "" Vector__XXX
 SG_ DET_RANGE_029 : 0|15@1+ (0.015625,0) [0|500] "m" Vector__XXX
 SG_ DET_RANGE_ERR_029 : 0|7@1+ (0.0075,0) [0|0.9525] "m" Vector__XXX
 SG_ DET_RANGE_VELOCITY_029 : 0|15@1+ (0.0078125,-128) [-128|127.9921875] "m/s" Vector__XXX
 SG_ DET_RANGE_VELOCITY_ERR_029 : 0|8@1+ (0.003,0) [0|0.765] "m/s" Vector__XXX
 SG_ DET_AZIMUTH_029 : 0|13@1+ (0.0004,-1.5708) [-1.5708|1.5708] "rad" Vector__XXX
 SG_ DET_AZIMUTH_ERR_029 : 0|7@1+ (0.00087267,0) [0|0.11082909] "rad" Vector__XXX
 SG_ DET_ELEVATION_029 : 0|8@1+ (0.00275,-0.34925) [-0.34925|0.34925] "rad" Vector__XXX
 SG_ DET_ELEVATION_ERR_029 : 0|6@1+ (0.00174533,0) [0|0.10995579] "rad" Vector__XXX
 SG_ DET_RCS_029 : 0|8@1+ (0.5,-64) [-64|63.5] "dBsm" Vector__XXX
 SG_ DET_BI_STATIC_FLAG_029 : 0|1@1+ (1,0) [0|1] "" Vector__XXX
 SG_ DET_SUPER_RES_TARGET_029 : 0|1@1+ (1,0) [0|1] "" Vector__XXX
 SG_ DET_SNR_029 : 0|8@1+ (0.35156,0) [0|89.6478] "dB" Vector__XXX
 SG_ DET_EXISTENCE_PROB_029 : 0|6@1+ (1.588,0) [0|100] "%" Vector__XXX
 SG_ DET_HVC_FLAG_029 : 0|1@1+ (1,0) [0|1] "" Vector__XXX
 SG_ DET_CONFD_AZIMUTH_029 : 0|2@1+ (1,0) [0|3] "" Vector__XXX
 SG_ DET_CONFD_ELEVATION_029 : 0|2@1+ (1,0) [0|3] "" Vector__XXX
 SG_ DET_PROB_1STAZHYPO_029 : 0|1@1+ (1,0) [0|1] "" Vector__XXX
 SG_ DET_IDM_029 : 0|1@1+ (1,0) [0|1] "" Vector__XXX
 SG_ DET_MTD_029 : 0|1@1+ (1,0) [0|1] "" Vector__XXX
 SG_ DET_BELOW_RAIN_THOLD_029 : 0|1@1+ (1,0) [0|1] "" Vector__XXX
 SG_ DET_RANGE_030 : 0|15@1+ (0.015625,0) [0|500] "m" Vector__XXX
 SG_ DET_RANGE_ERR_030 : 0|7@1+ (0.0075,0) [0|0.9525] "m" Vector__XXX
 SG_ DET_RANGE_VELOCITY_030 : 0|15@1+ (0.0078125,-128) [-128|127.9921875] "m/s" Vector__XXX
 SG_ DET_RANGE_VELOCITY_ERR_030 : 0|8@1+ (0.003,0) [0|0.765] "m/s" Vector__XXX
 SG_ DET_AZIMUTH_030 : 0|13@1+ (0.0004,-1.5708) [-1.5708|1.5708] "rad" Vector__XXX
 SG_ DET_AZIMUTH_ERR_030 : 0|7@1+ (0.00087267,0) [0|0.11082909] "rad" Vector__XXX
 SG_ DET_ELEVATION_030 : 0|8@1+ (0.00275,-0.34925) [-0.34925|0.34925] "rad" Vector__XXX
 SG_ DET_ELEVATION_ERR_030 : 0|6@1+ (0.00174533,0) [0|0.10995579] "rad" Vector__XXX
 SG_ DET_RCS_030 : 0|8@1+ (0.5,-64) [-64|63.5] "dBsm" Vector__XXX
 SG_ DET_BI_STATIC_FLAG_030 : 0|1@1+ (1,0) [0|1] "" Vector__XXX
 SG_ DET_SUPER_RES_TARGET_030 : 0|1@1+ (1,0) [0|1] "" Vector__XXX
 SG_ DET_SNR_030 : 0|8@1+ (0.35156,0) [0|89.6478] "dB" Vector__XXX
 SG_ DET_EXISTENCE_PROB_030 : 0|6@1+ (1.588,0) [0|100] "%" Vector__XXX
 SG_ DET_HVC_FLAG_030 : 0|1@1+ (1,0) [0|1] "" Vector__XXX
 SG_ DET_CONFD_AZIMUTH_030 : 0|2@1+ (1,0) [0|3] "" Vector__XXX
 SG_ DET_CONFD_ELEVATION_030 : 0|2@1+ (1,0) [0|3] "" Vector__XXX
 SG_ DET_PROB_1STAZHYPO_030 : 0|1@1+ (1,0) [0|1] "" Vector__XXX
 SG_ DET_IDM_030 : 0|1@1+ (1,0) [0|1] "" Vector__XXX
 SG_ DET_MTD_030 : 0|1@1+ (1,0) [0|1] "" Vector__XXX
 SG_ DET_BELOW_RAIN_THOLD_030 : 0|1@1+ (1,0) [0|1] "" Vector__XXX
 SG_ DET_RANGE_031 : 0|15@1+ (0.015625,0) [0|500] "m" Vector__XXX
 SG_ DET_RANGE_ERR_031 : 0|7@1+ (0.0075,0) [0|0.9525] "m" Vector__XXX
 SG_ DET_RANGE_VELOCITY_031 : 0|15@1+ (0.0078125,-128) [-128|127.9921875] "m/s" Vector__XXX
 SG_ DET_RANGE_VELOCITY_ERR_031 : 0|8@1+ (0.003,0) [0|0.765] "m/s" Vector__XXX
 SG_ DET_AZIMUTH_031 : 0|13@1+ (0.0004,-1.5708) [-1.5708|1.5708] "rad" Vector__XXX
 SG_ DET_AZIMUTH_ERR_031 : 0|7@1+ (0.00087267,0) [0|0.11082909] "rad" Vector__XXX
 SG_ DET_ELEVATION_031 : 0|8@1+ (0.00275,-0.34925) [-0.34925|0.34925] "rad" Vector__XXX
 SG_ DET_ELEVATION_ERR_031 : 0|6@1+ (0.00174533,0) [0|0.10995579] "rad" Vector__XXX
 SG_ DET_RCS_031 : 0|8@1+ (0.5,-64) [-64|63.5] "dBsm" Vector__XXX
 SG_ DET_BI_STATIC_FLAG_031 : 0|1@1+ (1,0) [0|1] "" Vector__XXX
 SG_ DET_SUPER_RES_TARGET_031 : 0|1@1+ (1,0) [0|1] "" Vector__XXX
 SG_ DET_SNR_031 : 0|8@1+ (0.35156,0) [0|89.6478] "dB" Vector__XXX
 SG_ DET_EXISTENCE_PROB_031 : 0|6@1+ (1.588,0) [0|100] "%" Vector__XXX
 SG_ DET_HVC_FLAG_031 : 0|1@1+ (1,0) [0|1] "" Vector__XXX
 SG_ DET_CONFD_AZIMUTH_031 : 0|2@1+ (1,0) [0|3] "" Vector__XXX
 SG_ DET_CONFD_ELEVATION_031 : 0|2@1+ (1,0) [0|3] "" Vector__XXX
 SG_ DET_PROB_1STAZHYPO_031 : 0|1@1+ (1,0) [0|1] "" Vector__XXX
 SG_ DET_IDM_031 : 0|1@1+ (1,0) [0|1] "" Vector__XXX
 SG_ DET_MTD_031 : 0|1@1+ (1,0) [0|1] "" Vector__XXX
 SG_ DET_BELOW_RAIN_THOLD_031 : 0|1@1+ (1,0) [0|1] "" Vector__XXX
 SG_ DET_RANGE_032 : 0|15@1+ (0.015625,0) [0|500] "m" Vector__XXX
 SG_ DET_RANGE_ERR_032 : 0|7@1+ (0.0075,0) [0|0.9525] "m" Vector__XXX
 SG_ DET_RANGE_VELOCITY_032 : 0|15@1+ (0.0078125,-128) [-128|127.9921875] "m/s" Vector__XXX
 SG_ DET_RANGE_VELOCITY_ERR_032 : 0|8@1+ (0.003,0) [0|0.765] "m/s" Vector__XXX
 SG_ DET_AZIMUTH_032 : 0|13@1+ (0.0004,-1.5708) [-1.5708|1.5708] "rad" Vector__XXX
 SG_ DET_AZIMUTH_ERR_032 : 0|7@1+ (0.00087267,0) [0|0.11082909] "rad" Vector__XXX
 SG_ DET_ELEVATION_032 : 0|8@1+ (0.00275,-0.34925) [-0.34925|0.34925] "rad" Vector__XXX
 SG_ DET_ELEVATION_ERR_032 : 0|6@1+ (0.00174533,0) [0|0.10995579] "rad" Vector__XXX
 SG_ DET_RCS_032 : 0|8@1+ (0.5,-64) [-64|63.5] "dBsm" Vector__XXX
 SG_ DET_BI_STATIC_FLAG_032 : 0|1@1+ (1,0) [0|1] "" Vector__XXX
 SG_ DET_SUPER_RES_TARGET_032 : 0|1@1+ (1,0) [0|1] "" Vector__XXX
 SG_ DET_SNR_032 : 0|8@1+ (0.35156,0) [0|89.6478] "dB" Vector__XXX
 SG_ DET_EXISTENCE_PROB_032 : 0|6@1+ (1.588,0) [0|100] "%" Vector__XXX
 SG_ DET_HVC_FLAG_032 : 0|1@1+ (1,0) [0|1] "" Vector__XXX
 SG_ DET_CONFD_AZIMUTH_032 : 0|2@1+ (1,0) [0|3] "" Vector__XXX
 SG_ DET_CONFD_ELEVATION_032 : 0|2@1+ (1,0) [0|3] "" Vector__XXX
 SG_ DET_MH_SCAN_INDEX_4LSB_029_032 : 0|4@1+ (1,0) [0|15] "" Vector__XXX
 SG_ DET_MH_CYCLE_COUNTER_029_032 : 0|8@1+ (1,0) [0|255] "" Vector__XXX
 SG_ DET_MH_CRC16_029_032 : 0|16@1+ (1,0) [0|65535] "" Vector__XXX
 SG_ DET_PROB_1STAZHYPO_032 : 0|1@1+ (1,0) [0|1] "" Vector__XXX
 SG_ DET_IDM_032 : 0|1@1+ (1,0) [0|1] "" Vector__XXX
 SG_ DET_MTD_032 : 0|1@1+ (1,0) [0|1] "" Vector__XXX
 SG_ DET_BELOW_RAIN_THOLD_032 : 0|1@1+ (1,0) [0|1] "" Vector__XXX
 SG_ DET_RANGE_033 : 0|15@1+ (0.015625,0) [0|500] "m" Vector__XXX
 SG_ DET_RANGE_ERR_033 : 0|7@1+ (0.0075,0) [0|0.9525] "m" Vector__XXX
 SG_ DET_RANGE_VELOCITY_033 : 0|15@1+ (0.0078125,-128) [-128|127.9921875] "m/s" Vector__XXX
 SG_ DET_RANGE_VELOCITY_ERR_033 : 0|8@1+ (0.003,0) [0|0.765] "m/s" Vector__XXX
 SG_ DET_AZIMUTH_033 : 0|13@1+ (0.0004,-1.5708) [-1.5708|1.5708] "rad" Vector__XXX
 SG_ DET_AZIMUTH_ERR_033 : 0|7@1+ (0.00087267,0) [0|0.11082909] "rad" Vector__XXX
 SG_ DET_ELEVATION_033 : 0|8@1+ (0.00275,-0.34925) [-0.34925|0.34925] "rad" Vector__XXX
 SG_ DET_ELEVATION_ERR_033 : 0|6@1+ (0.00174533,0) [0|0.10995579] "rad" Vector__XXX
 SG_ DET_RCS_033 : 0|8@1+ (0.5,-64) [-64|63.5] "dBsm" Vector__XXX
 SG_ DET_BI_STATIC_FLAG_033 : 0|1@1+ (1,0) [0|1] "" Vector__XXX
 SG_ DET_SUPER_RES_TARGET_033 : 0|1@1+ (1,0) [0|1] "" Vector__XXX
 SG_ DET_SNR_033 : 0|8@1+ (0.35156,0) [0|89.6478] "dB" Vector__XXX
 SG_ DET_EXISTENCE_PROB_033 : 0|6@1+ (1.588,0) [0|100] "%" Vector__XXX
 SG_ DET_HVC_FLAG_033 : 0|1@1+ (1,0) [0|1] "" Vector__XXX
 SG_ DET_CONFD_AZIMUTH_033 : 0|2@1+ (1,0) [0|3] "" Vector__XXX
 SG_ DET_CONFD_ELEVATION_033 : 0|2@1+ (1,0) [0|3] "" Vector__XXX
 SG_ DET_PROB_1STAZHYPO_033 : 0|1@1+ (1,0) [0|1] "" Vector__XXX
 SG_ DET_IDM_033 : 0|1@1+ (1,0) [0|1] "" Vector__XXX
 SG_ DET_MTD_033 : 0|1@1+ (1,0) [0|1] "" Vector__XXX
 SG_ DET_BELOW_RAIN_THOLD_033 : 0|1@1+ (1,0) [0|1] "" Vector__XXX
 SG_ DET_RANGE_034 : 0|15@1+ (0.015625,0) [0|500] "m" Vector__XXX
 SG_ DET_RANGE_ERR_034 : 0|7@1+ (0.0075,0) [0|0.9525] "m" Vector__XXX
 SG_ DET_RANGE_VELOCITY_034 : 0|15@1+ (0.0078125,-128) [-128|127.9921875] "m/s" Vector__XXX
 SG_ DET_RANGE_VELOCITY_ERR_034 : 0|8@1+ (0.003,0) [0|0.765] "m/s" Vector__XXX
 SG_ DET_AZIMUTH_034 : 0|13@1+ (0.0004,-1.5708) [-1.5708|1.5708] "rad" Vector__XXX
 SG_ DET_AZIMUTH_ERR_034 : 0|7@1+ (0.00087267,0) [0|0.11082909] "rad" Vector__XXX
 SG_ DET_ELEVATION_034 : 0|8@1+ (0.00275,-0.34925) [-0.34925|0.34925] "rad" Vector__XXX
 SG_ DET_ELEVATION_ERR_034 : 0|6@1+ (0.00174533,0) [0|0.10995579] "rad" Vector__XXX
 SG_ DET_RCS_034 : 0|8@1+ (0.5,-64) [-64|63.5] "dBsm" Vector__XXX
 SG_ DET_BI_STATIC_FLAG_034 : 0|1@1+ (1,0) [0|1] "" Vector__XXX
 SG_ DET_SUPER_RES_TARGET_034 : 0|1@1+ (1,0) [0|1] "" Vector__XXX
 SG_ DET_SNR_034 : 0|8@1+ (0.35156,0) [0|89.6478] "dB" Vector__XXX
 SG_ DET_EXISTENCE_PROB_034 : 0|6@1+ (1.588,0) [0|100] "%" Vector__XXX
 SG_ DET_HVC_FLAG_034 : 0|1@1+ (1,0) [0|1] "" Vector__XXX
 SG_ DET_CONFD_AZIMUTH_034 : 0|2@1+ (1,0) [0|3] "" Vector__XXX
 SG_ DET_CONFD_ELEVATION_034 : 0|2@1+ (1,0) [0|3] "" Vector__XXX
 SG_ DET_PROB_1STAZHYPO_034 : 0|1@1+ (1,0) [0|1] "" Vector__XXX
 SG_ DET_IDM_034 : 0|1@1+ (1,0) [0|1] "" Vector__XXX
 SG_ DET_MTD_034 : 0|1@1+ (1,0) [0|1] "" Vector__XXX
 SG_ DET_BELOW_RAIN_THOLD_034 : 0|1@1+ (1,0) [0|1] "" Vector__XXX
 SG_ DET_RANGE_035 : 0|15@1+ (0.015625,0) [0|500] "m" Vector__XXX
 SG_ DET_RANGE_ERR_035 : 0|7@1+ (0.0075,0) [0|0.9525] "m" Vector__XXX
 SG_ DET_RANGE_VELOCITY_035 : 0|15@1+ (0.0078125,-128) [-128|127.9921875] "m/s" Vector__XXX
 SG_ DET_RANGE_VELOCITY_ERR_035 : 0|8@1+ (0.003,0) [0|0.765] "m/s" Vector__XXX
 SG_ DET_AZIMUTH_035 : 0|13@1+ (0.0004,-1.5708) [-1.5708|1.5708] "rad" Vector__XXX
 SG_ DET_AZIMUTH_ERR_035 : 0|7@1+ (0.00087267,0) [0|0.11082909] "rad" Vector__XXX
 SG_ DET_ELEVATION_035 : 0|8@1+ (0.00275,-0.34925) [-0.34925|0.34925] "rad" Vector__XXX
 SG_ DET_ELEVATION_ERR_035 : 0|6@1+ (0.00174533,0) [0|0.10995579] "rad" Vector__XXX
 SG_ DET_RCS_035 : 0|8@1+ (0.5,-64) [-64|63.5] "dBsm" Vector__XXX
 SG_ DET_BI_STATIC_FLAG_035 : 0|1@1+ (1,0) [0|1] "" Vector__XXX
 SG_ DET_SUPER_RES_TARGET_035 : 0|1@1+ (1,0) [0|1] "" Vector__XXX
 SG_ DET_SNR_035 : 0|8@1+ (0.35156,0) [0|89.6478] "dB" Vector__XXX
 SG_ DET_EXISTENCE_PROB_035 : 0|6@1+ (1.588,0) [0|100] "%" Vector__XXX
 SG_ DET_HVC_FLAG_035 : 0|1@1+ (1,0) [0|1] "" Vector__XXX
 SG_ DET_CONFD_AZIMUTH_035 : 0|2@1+ (1,0) [0|3] "" Vector__XXX
 SG_ DET_CONFD_ELEVATION_035 : 0|2@1+ (1,0) [0|3] "" Vector__XXX
 SG_ DET_PROB_1STAZHYPO_035 : 0|1@1+ (1,0) [0|1] "" Vector__XXX
 SG_ DET_IDM_035 : 0|1@1+ (1,0) [0|1] "" Vector__XXX
 SG_ DET_MTD_035 : 0|1@1+ (1,0) [0|1] "" Vector__XXX
 SG_ DET_BELOW_RAIN_THOLD_035 : 0|1@1+ (1,0) [0|1] "" Vector__XXX
 SG_ DET_RANGE_036 : 0|15@1+ (0.015625,0) [0|500] "m" Vector__XXX
 SG_ DET_RANGE_ERR_036 : 0|7@1+ (0.0075,0) [0|0.9525] "m" Vector__XXX
 SG_ DET_RANGE_VELOCITY_036 : 0|15@1+ (0.0078125,-128) [-128|127.9921875] "m/s" Vector__XXX
 SG_ DET_RANGE_VELOCITY_ERR_036 : 0|8@1+ (0.003,0) [0|0.765] "m/s" Vector__XXX
 SG_ DET_AZIMUTH_036 : 0|13@1+ (0.0004,-1.5708) [-1.5708|1.5708] "rad" Vector__XXX
 SG_ DET_AZIMUTH_ERR_036 : 0|7@1+ (0.00087267,0) [0|0.11082909] "rad" Vector__XXX
 SG_ DET_ELEVATION_036 : 0|8@1+ (0.00275,-0.34925) [-0.34925|0.34925] "rad" Vector__XXX
 SG_ DET_ELEVATION_ERR_036 : 0|6@1+ (0.00174533,0) [0|0.10995579] "rad" Vector__XXX
 SG_ DET_RCS_036 : 0|8@1+ (0.5,-64) [-64|63.5] "dBsm" Vector__XXX
 SG_ DET_BI_STATIC_FLAG_036 : 0|1@1+ (1,0) [0|1] "" Vector__XXX
 SG_ DET_SUPER_RES_TARGET_036 : 0|1@1+ (1,0) [0|1] "" Vector__XXX
 SG_ DET_SNR_036 : 0|8@1+ (0.35156,0) [0|89.6478] "dB" Vector__XXX
 SG_ DET_EXISTENCE_PROB_036 : 0|6@1+ (1.588,0) [0|100] "%" Vector__XXX
 SG_ DET_HVC_FLAG_036 : 0|1@1+ (1,0) [0|1] "" Vector__XXX
 SG_ DET_CONFD_AZIMUTH_036 : 0|2@1+ (1,0) [0|3] "" Vector__XXX
 SG_ DET_CONFD_ELEVATION_036 : 0|2@1+ (1,0) [0|3] "" Vector__XXX
 SG_ DET_MH_SCAN_INDEX_4LSB_033_036 : 0|4@1+ (1,0) [0|15] "" Vector__XXX
 SG_ DET_MH_CYCLE_COUNTER_033_036 : 0|8@1+ (1,0) [0|255] "" Vector__XXX
 SG_ DET_MH_CRC16_033_036 : 0|16@1+ (1,0) [0|65535] "" Vector__XXX
 SG_ DET_PROB_1STAZHYPO_036 : 0|1@1+ (1,0) [0|1] "" Vector__XXX
 SG_ DET_IDM_036 : 0|1@1+ (1,0) [0|1] "" Vector__XXX
 SG_ DET_MTD_036 : 0|1@1+ (1,0) [0|1] "" Vector__XXX
 SG_ DET_BELOW_RAIN_THOLD_036 : 0|1@1+ (1,0) [0|1] "" Vector__XXX
 SG_ DET_RANGE_037 : 0|15@1+ (0.015625,0) [0|500] "m" Vector__XXX
 SG_ DET_RANGE_ERR_037 : 0|7@1+ (0.0075,0) [0|0.9525] "m" Vector__XXX
 SG_ DET_RANGE_VELOCITY_037 : 0|15@1+ (0.0078125,-128) [-128|127.9921875] "m/s" Vector__XXX
 SG_ DET_RANGE_VELOCITY_ERR_037 : 0|8@1+ (0.003,0) [0|0.765] "m/s" Vector__XXX
 SG_ DET_AZIMUTH_037 : 0|13@1+ (0.0004,-1.5708) [-1.5708|1.5708] "rad" Vector__XXX
 SG_ DET_AZIMUTH_ERR_037 : 0|7@1+ (0.00087267,0) [0|0.11082909] "rad" Vector__XXX
 SG_ DET_ELEVATION_037 : 0|8@1+ (0.00275,-0.34925) [-0.34925|0.34925] "rad" Vector__XXX
 SG_ DET_ELEVATION_ERR_037 : 0|6@1+ (0.00174533,0) [0|0.10995579] "rad" Vector__XXX
 SG_ DET_RCS_037 : 0|8@1+ (0.5,-64) [-64|63.5] "dBsm" Vector__XXX
 SG_ DET_BI_STATIC_FLAG_037 : 0|1@1+ (1,0) [0|1] "" Vector__XXX
 SG_ DET_SUPER_RES_TARGET_037 : 0|1@1+ (1,0) [0|1] "" Vector__XXX
 SG_ DET_SNR_037 : 0|8@1+ (0.35156,0) [0|89.6478] "dB" Vector__XXX
 SG_ DET_EXISTENCE_PROB_037 : 0|6@1+ (1.588,0) [0|100] "%" Vector__XXX
 SG_ DET_HVC_FLAG_037 : 0|1@1+ (1,0) [0|1] "" Vector__XXX
 SG_ DET_CONFD_AZIMUTH_037 : 0|2@1+ (1,0) [0|3] "" Vector__XXX
 SG_ DET_CONFD_ELEVATION_037 : 0|2@1+ (1,0) [0|3] "" Vector__XXX
 SG_ DET_PROB_1STAZHYPO_037 : 0|1@1+ (1,0) [0|1] "" Vector__XXX
 SG_ DET_IDM_037 : 0|1@1+ (1,0) [0|1] "" Vector__XXX
 SG_ DET_MTD_037 : 0|1@1+ (1,0) [0|1] "" Vector__XXX
 SG_ DET_BELOW_RAIN_THOLD_037 : 0|1@1+ (1,0) [0|1] "" Vector__XXX
 SG_ DET_RANGE_038 : 0|15@1+ (0.015625,0) [0|500] "m" Vector__XXX
 SG_ DET_RANGE_ERR_038 : 0|7@1+ (0.0075,0) [0|0.9525] "m" Vector__XXX
 SG_ DET_RANGE_VELOCITY_038 : 0|15@1+ (0.0078125,-128) [-128|127.9921875] "m/s" Vector__XXX
 SG_ DET_RANGE_VELOCITY_ERR_038 : 0|8@1+ (0.003,0) [0|0.765] "m/s" Vector__XXX
 SG_ DET_AZIMUTH_038 : 0|13@1+ (0.0004,-1.5708) [-1.5708|1.5708] "rad" Vector__XXX
 SG_ DET_AZIMUTH_ERR_038 : 0|7@1+ (0.00087267,0) [0|0.11082909] "rad" Vector__XXX
 SG_ DET_ELEVATION_038 : 0|8@1+ (0.00275,-0.34925) [-0.34925|0.34925] "rad" Vector__XXX
 SG_ DET_ELEVATION_ERR_038 : 0|6@1+ (0.00174533,0) [0|0.10995579] "rad" Vector__XXX
 SG_ DET_RCS_038 : 0|8@1+ (0.5,-64) [-64|63.5] "dBsm" Vector__XXX
 SG_ DET_BI_STATIC_FLAG_038 : 0|1@1+ (1,0) [0|1] "" Vector__XXX
 SG_ DET_SUPER_RES_TARGET_038 : 0|1@1+ (1,0) [0|1] "" Vector__XXX
 SG_ DET_SNR_038 : 0|8@1+ (0.35156,0) [0|89.6478] "dB" Vector__XXX
 SG_ DET_EXISTENCE_PROB_038 : 0|6@1+ (1.588,0) [0|100] "%" Vector__XXX
 SG_ DET_HVC_FLAG_038 : 0|1@1+ (1,0) [0|1] "" Vector__XXX
 SG_ DET_CONFD_AZIMUTH_038 : 0|2@1+ (1,0) [0|3] "" Vector__XXX
 SG_ DET_CONFD_ELEVATION_038 : 0|2@1+ (1,0) [0|3] "" Vector__XXX
 SG_ DET_PROB_1STAZHYPO_038 : 0|1@1+ (1,0) [0|1] "" Vector__XXX
 SG_ DET_IDM_038 : 0|1@1+ (1,0) [0|1] "" Vector__XXX
 SG_ DET_MTD_038 : 0|1@1+ (1,0) [0|1] "" Vector__XXX
 SG_ DET_BELOW_RAIN_THOLD_038 : 0|1@1+ (1,0) [0|1] "" Vector__XXX
 SG_ DET_RANGE_039 : 0|15@1+ (0.015625,0) [0|500] "m" Vector__XXX
 SG_ DET_RANGE_ERR_039 : 0|7@1+ (0.0075,0) [0|0.9525] "m" Vector__XXX
 SG_ DET_RANGE_VELOCITY_039 : 0|15@1+ (0.0078125,-128) [-128|127.9921875] "m/s" Vector__XXX
 SG_ DET_RANGE_VELOCITY_ERR_039 : 0|8@1+ (0.003,0) [0|0.765] "m/s" Vector__XXX
 SG_ DET_AZIMUTH_039 : 0|13@1+ (0.0004,-1.5708) [-1.5708|1.5708] "rad" Vector__XXX
 SG_ DET_AZIMUTH_ERR_039 : 0|7@1+ (0.00087267,0) [0|0.11082909] "rad" Vector__XXX
 SG_ DET_ELEVATION_039 : 0|8@1+ (0.00275,-0.34925) [-0.34925|0.34925] "rad" Vector__XXX
 SG_ DET_ELEVATION_ERR_039 : 0|6@1+ (0.00174533,0) [0|0.10995579] "rad" Vector__XXX
 SG_ DET_RCS_039 : 0|8@1+ (0.5,-64) [-64|63.5] "dBsm" Vector__XXX
 SG_ DET_BI_STATIC_FLAG_039 : 0|1@1+ (1,0) [0|1] "" Vector__XXX
 SG_ DET_SUPER_RES_TARGET_039 : 0|1@1+ (1,0) [0|1] "" Vector__XXX
 SG_ DET_SNR_039 : 0|8@1+ (0.35156,0) [0|89.6478] "dB" Vector__XXX
 SG_ DET_EXISTENCE_PROB_039 : 0|6@1+ (1.588,0) [0|100] "%" Vector__XXX
 SG_ DET_HVC_FLAG_039 : 0|1@1+ (1,0) [0|1] "" Vector__XXX
 SG_ DET_CONFD_AZIMUTH_039 : 0|2@1+ (1,0) [0|3] "" Vector__XXX
 SG_ DET_CONFD_ELEVATION_039 : 0|2@1+ (1,0) [0|3] "" Vector__XXX
 SG_ DET_PROB_1STAZHYPO_039 : 0|1@1+ (1,0) [0|1] "" Vector__XXX
 SG_ DET_IDM_039 : 0|1@1+ (1,0) [0|1] "" Vector__XXX
 SG_ DET_MTD_039 : 0|1@1+ (1,0) [0|1] "" Vector__XXX
 SG_ DET_BELOW_RAIN_THOLD_039 : 0|1@1+ (1,0) [0|1] "" Vector__XXX
 SG_ DET_RANGE_040 : 0|15@1+ (0.015625,0) [0|500] "m" Vector__XXX
 SG_ DET_RANGE_ERR_040 : 0|7@1+ (0.0075,0) [0|0.9525] "m" Vector__XXX
 SG_ DET_RANGE_VELOCITY_040 : 0|15@1+ (0.0078125,-128) [-128|127.9921875] "m/s" Vector__XXX
 SG_ DET_RANGE_VELOCITY_ERR_040 : 0|8@1+ (0.003,0) [0|0.765] "m/s" Vector__XXX
 SG_ DET_AZIMUTH_040 : 0|13@1+ (0.0004,-1.5708) [-1.5708|1.5708] "rad" Vector__XXX
 SG_ DET_AZIMUTH_ERR_040 : 0|7@1+ (0.00087267,0) [0|0.11082909] "rad" Vector__XXX
 SG_ DET_ELEVATION_040 : 0|8@1+ (0.00275,-0.34925) [-0.34925|0.34925] "rad" Vector__XXX
 SG_ DET_ELEVATION_ERR_040 : 0|6@1+ (0.00174533,0) [0|0.10995579] "rad" Vector__XXX
 SG_ DET_RCS_040 : 0|8@1+ (0.5,-64) [-64|63.5] "dBsm" Vector__XXX
 SG_ DET_BI_STATIC_FLAG_040 : 0|1@1+ (1,0) [0|1] "" Vector__XXX
 SG_ DET_SUPER_RES_TARGET_040 : 0|1@1+ (1,0) [0|1] "" Vector__XXX
 SG_ DET_SNR_040 : 0|8@1+ (0.35156,0) [0|89.6478] "dB" Vector__XXX
 SG_ DET_EXISTENCE_PROB_040 : 0|6@1+ (1.588,0) [0|100] "%" Vector__XXX
 SG_ DET_HVC_FLAG_040 : 0|1@1+ (1,0) [0|1] "" Vector__XXX
 SG_ DET_CONFD_AZIMUTH_040 : 0|2@1+ (1,0) [0|3] "" Vector__XXX
 SG_ DET_CONFD_ELEVATION_040 : 0|2@1+ (1,0) [0|3] "" Vector__XXX
 SG_ DET_MH_SCAN_INDEX_4LSB_037_040 : 0|4@1+ (1,0) [0|15] "" Vector__XXX
 SG_ DET_MH_CYCLE_COUNTER_037_040 : 0|8@1+ (1,0) [0|255] "" Vector__XXX
 SG_ DET_MH_CRC16_037_040 : 0|16@1+ (1,0) [0|65535] "" Vector__XXX
 SG_ DET_PROB_1STAZHYPO_040 : 0|1@1+ (1,0) [0|1] "" Vector__XXX
 SG_ DET_IDM_040 : 0|1@1+ (1,0) [0|1] "" Vector__XXX
 SG_ DET_MTD_040 : 0|1@1+ (1,0) [0|1] "" Vector__XXX
 SG_ DET_BELOW_RAIN_THOLD_040 : 0|1@1+ (1,0) [0|1] "" Vector__XXX
 SG_ DET_RANGE_041 : 0|15@1+ (0.015625,0) [0|500] "m" Vector__XXX
 SG_ DET_RANGE_ERR_041 : 0|7@1+ (0.0075,0) [0|0.9525] "m" Vector__XXX
 SG_ DET_RANGE_VELOCITY_041 : 0|15@1+ (0.0078125,-128) [-128|127.9921875] "m/s" Vector__XXX
 SG_ DET_RANGE_VELOCITY_ERR_041 : 0|8@1+ (0.003,0) [0|0.765] "m/s" Vector__XXX
 SG_ DET_AZIMUTH_041 : 0|13@1+ (0.0004,-1.5708) [-1.5708|1.5708] "rad" Vector__XXX
 SG_ DET_AZIMUTH_ERR_041 : 0|7@1+ (0.00087267,0) [0|0.11082909] "rad" Vector__XXX
 SG_ DET_ELEVATION_041 : 0|8@1+ (0.00275,-0.34925) [-0.34925|0.34925] "rad" Vector__XXX
 SG_ DET_ELEVATION_ERR_041 : 0|6@1+ (0.00174533,0) [0|0.10995579] "rad" Vector__XXX
 SG_ DET_RCS_041 : 0|8@1+ (0.5,-64) [-64|63.5] "dBsm" Vector__XXX
 SG_ DET_BI_STATIC_FLAG_041 : 0|1@1+ (1,0) [0|1] "" Vector__XXX
 SG_ DET_SUPER_RES_TARGET_041 : 0|1@1+ (1,0) [0|1] "" Vector__XXX
 SG_ DET_SNR_041 : 0|8@1+ (0.35156,0) [0|89.6478] "dB" Vector__XXX
 SG_ DET_EXISTENCE_PROB_041 : 0|6@1+ (1.588,0) [0|100] "%" Vector__XXX
 SG_ DET_HVC_FLAG_041 : 0|1@1+ (1,0) [0|1] "" Vector__XXX
 SG_ DET_CONFD_AZIMUTH_041 : 0|2@1+ (1,0) [0|3] "" Vector__XXX
 SG_ DET_CONFD_ELEVATION_041 : 0|2@1+ (1,0) [0|3] "" Vector__XXX
 SG_ DET_PROB_1STAZHYPO_041 : 0|1@1+ (1,0) [0|1] "" Vector__XXX
 SG_ DET_IDM_041 : 0|1@1+ (1,0) [0|1] "" Vector__XXX
 SG_ DET_MTD_041 : 0|1@1+ (1,0) [0|1] "" Vector__XXX
 SG_ DET_BELOW_RAIN_THOLD_041 : 0|1@1+ (1,0) [0|1] "" Vector__XXX
 SG_ DET_RANGE_042 : 0|15@1+ (0.015625,0) [0|500] "m" Vector__XXX
 SG_ DET_RANGE_ERR_042 : 0|7@1+ (0.0075,0) [0|0.9525] "m" Vector__XXX
 SG_ DET_RANGE_VELOCITY_042 : 0|15@1+ (0.0078125,-128) [-128|127.9921875] "m/s" Vector__XXX
 SG_ DET_RANGE_VELOCITY_ERR_042 : 0|8@1+ (0.003,0) [0|0.765] "m/s" Vector__XXX
 SG_ DET_AZIMUTH_042 : 0|13@1+ (0.0004,-1.5708) [-1.5708|1.5708] "rad" Vector__XXX
 SG_ DET_AZIMUTH_ERR_042 : 0|7@1+ (0.00087267,0) [0|0.11082909] "rad" Vector__XXX
 SG_ DET_ELEVATION_042 : 0|8@1+ (0.00275,-0.34925) [-0.34925|0.34925] "rad" Vector__XXX
 SG_ DET_ELEVATION_ERR_042 : 0|6@1+ (0.00174533,0) [0|0.10995579] "rad" Vector__XXX
 SG_ DET_RCS_042 : 0|8@1+ (0.5,-64) [-64|63.5] "dBsm" Vector__XXX
 SG_ DET_BI_STATIC_FLAG_042 : 0|1@1+ (1,0) [0|1] "" Vector__XXX
 SG_ DET_SUPER_RES_TARGET_042 : 0|1@1+ (1,0) [0|1] "" Vector__XXX
 SG_ DET_SNR_042 : 0|8@1+ (0.35156,0) [0|89.6478] "dB" Vector__XXX
 SG_ DET_EXISTENCE_PROB_042 : 0|6@1+ (1.588,0) [0|100] "%" Vector__XXX
 SG_ DET_HVC_FLAG_042 : 0|1@1+ (1,0) [0|1] "" Vector__XXX
 SG_ DET_CONFD_AZIMUTH_042 : 0|2@1+ (1,0) [0|3] "" Vector__XXX
 SG_ DET_CONFD_ELEVATION_042 : 0|2@1+ (1,0) [0|3] "" Vector__XXX
 SG_ DET_PROB_1STAZHYPO_042 : 0|1@1+ (1,0) [0|1] "" Vector__XXX
 SG_ DET_IDM_042 : 0|1@1+ (1,0) [0|1] "" Vector__XXX
 SG_ DET_MTD_042 : 0|1@1+ (1,0) [0|1] "" Vector__XXX
 SG_ DET_BELOW_RAIN_THOLD_042 : 0|1@1+ (1,0) [0|1] "" Vector__XXX
 SG_ DET_RANGE_043 : 0|15@1+ (0.015625,0) [0|500] "m" Vector__XXX
 SG_ DET_RANGE_ERR_043 : 0|7@1+ (0.0075,0) [0|0.9525] "m" Vector__XXX
 SG_ DET_RANGE_VELOCITY_043 : 0|15@1+ (0.0078125,-128) [-128|127.9921875] "m/s" Vector__XXX
 SG_ DET_RANGE_VELOCITY_ERR_043 : 0|8@1+ (0.003,0) [0|0.765] "m/s" Vector__XXX
 SG_ DET_AZIMUTH_043 : 0|13@1+ (0.0004,-1.5708) [-1.5708|1.5708] "rad" Vector__XXX
 SG_ DET_AZIMUTH_ERR_043 : 0|7@1+ (0.00087267,0) [0|0.11082909] "rad" Vector__XXX
 SG_ DET_ELEVATION_043 : 0|8@1+ (0.00275,-0.34925) [-0.34925|0.34925] "rad" Vector__XXX
 SG_ DET_ELEVATION_ERR_043 : 0|6@1+ (0.00174533,0) [0|0.10995579] "rad" Vector__XXX
 SG_ DET_RCS_043 : 0|8@1+ (0.5,-64) [-64|63.5] "dBsm" Vector__XXX
 SG_ DET_BI_STATIC_FLAG_043 : 0|1@1+ (1,0) [0|1] "" Vector__XXX
 SG_ DET_SUPER_RES_TARGET_043 : 0|1@1+ (1,0) [0|1] "" Vector__XXX
 SG_ DET_SNR_043 : 0|8@1+ (0.35156,0) [0|89.6478] "dB" Vector__XXX
 SG_ DET_EXISTENCE_PROB_043 : 0|6@1+ (1.588,0) [0|100] "%" Vector__XXX
 SG_ DET_HVC_FLAG_043 : 0|1@1+ (1,0) [0|1] "" Vector__XXX
 SG_ DET_CONFD_AZIMUTH_043 : 0|2@1+ (1,0) [0|3] "" Vector__XXX
 SG_ DET_CONFD_ELEVATION_043 : 0|2@1+ (1,0) [0|3] "" Vector__XXX
 SG_ DET_PROB_1STAZHYPO_043 : 0|1@1+ (1,0) [0|1] "" Vector__XXX
 SG_ DET_IDM_043 : 0|1@1+ (1,0) [0|1] "" Vector__XXX
 SG_ DET_MTD_043 : 0|1@1+ (1,0) [0|1] "" Vector__XXX
 SG_ DET_BELOW_RAIN_THOLD_043 : 0|1@1+ (1,0) [0|1] "" Vector__XXX
 SG_ DET_RANGE_044 : 0|15@1+ (0.015625,0) [0|500] "m" Vector__XXX
 SG_ DET_RANGE_ERR_044 : 0|7@1+ (0.0075,0) [0|0.9525] "m" Vector__XXX
 SG_ DET_RANGE_VELOCITY_044 : 0|15@1+ (0.0078125,-128) [-128|127.9921875] "m/s" Vector__XXX
 SG_ DET_RANGE_VELOCITY_ERR_044 : 0|8@1+ (0.003,0) [0|0.765] "m/s" Vector__XXX
 SG_ DET_AZIMUTH_044 : 0|13@1+ (0.0004,-1.5708) [-1.5708|1.5708] "rad" Vector__XXX
 SG_ DET_AZIMUTH_ERR_044 : 0|7@1+ (0.00087267,0) [0|0.11082909] "rad" Vector__XXX
 SG_ DET_ELEVATION_044 : 0|8@1+ (0.00275,-0.34925) [-0.34925|0.34925] "rad" Vector__XXX
 SG_ DET_ELEVATION_ERR_044 : 0|6@1+ (0.00174533,0) [0|0.10995579] "rad" Vector__XXX
 SG_ DET_RCS_044 : 0|8@1+ (0.5,-64) [-64|63.5] "dBsm" Vector__XXX
 SG_ DET_BI_STATIC_FLAG_044 : 0|1@1+ (1,0) [0|1] "" Vector__XXX
 SG_ DET_SUPER_RES_TARGET_044 : 0|1@1+ (1,0) [0|1] "" Vector__XXX
 SG_ DET_SNR_044 : 0|8@1+ (0.35156,0) [0|89.6478] "dB" Vector__XXX
 SG_ DET_EXISTENCE_PROB_044 : 0|6@1+ (1.588,0) [0|100] "%" Vector__XXX
 SG_ DET_HVC_FLAG_044 : 0|1@1+ (1,0) [0|1] "" Vector__XXX
 SG_ DET_CONFD_AZIMUTH_044 : 0|2@1+ (1,0) [0|3] "" Vector__XXX
 SG_ DET_CONFD_ELEVATION_044 : 0|2@1+ (1,0) [0|3] "" Vector__XXX
 SG_ DET_MH_SCAN_INDEX_4LSB_041_044 : 0|4@1+ (1,0) [0|15] "" Vector__XXX
 SG_ DET_MH_CYCLE_COUNTER_041_044 : 0|8@1+ (1,0) [0|255] "" Vector__XXX
 SG_ DET_MH_CRC16_041_044 : 0|16@1+ (1,0) [0|65535] "" Vector__XXX
 SG_ DET_PROB_1STAZHYPO_044 : 0|1@1+ (1,0) [0|1] "" Vector__XXX
 SG_ DET_IDM_044 : 0|1@1+ (1,0) [0|1] "" Vector__XXX
 SG_ DET_MTD_044 : 0|1@1+ (1,0) [0|1] "" Vector__XXX
 SG_ DET_BELOW_RAIN_THOLD_044 : 0|1@1+ (1,0) [0|1] "" Vector__XXX
 SG_ DET_RANGE_045 : 0|15@1+ (0.015625,0) [0|500] "m" Vector__XXX
 SG_ DET_RANGE_ERR_045 : 0|7@1+ (0.0075,0) [0|0.9525] "m" Vector__XXX
 SG_ DET_RANGE_VELOCITY_045 : 0|15@1+ (0.0078125,-128) [-128|127.9921875] "m/s" Vector__XXX
 SG_ DET_RANGE_VELOCITY_ERR_045 : 0|8@1+ (0.003,0) [0|0.765] "m/s" Vector__XXX
 SG_ DET_AZIMUTH_045 : 0|13@1+ (0.0004,-1.5708) [-1.5708|1.5708] "rad" Vector__XXX
 SG_ DET_AZIMUTH_ERR_045 : 0|7@1+ (0.00087267,0) [0|0.11082909] "rad" Vector__XXX
 SG_ DET_ELEVATION_045 : 0|8@1+ (0.00275,-0.34925) [-0.34925|0.34925] "rad" Vector__XXX
 SG_ DET_ELEVATION_ERR_045 : 0|6@1+ (0.00174533,0) [0|0.10995579] "rad" Vector__XXX
 SG_ DET_RCS_045 : 0|8@1+ (0.5,-64) [-64|63.5] "dBsm" Vector__XXX
 SG_ DET_BI_STATIC_FLAG_045 : 0|1@1+ (1,0) [0|1] "" Vector__XXX
 SG_ DET_SUPER_RES_TARGET_045 : 0|1@1+ (1,0) [0|1] "" Vector__XXX
 SG_ DET_SNR_045 : 0|8@1+ (0.35156,0) [0|89.6478] "dB" Vector__XXX
 SG_ DET_EXISTENCE_PROB_045 : 0|6@1+ (1.588,0) [0|100] "%" Vector__XXX
 SG_ DET_HVC_FLAG_045 : 0|1@1+ (1,0) [0|1] "" Vector__XXX
 SG_ DET_CONFD_AZIMUTH_045 : 0|2@1+ (1,0) [0|3] "" Vector__XXX
 SG_ DET_CONFD_ELEVATION_045 : 0|2@1+ (1,0) [0|3] "" Vector__XXX
 SG_ DET_PROB_1STAZHYPO_045 : 0|1@1+ (1,0) [0|1] "" Vector__XXX
 SG_ DET_IDM_045 : 0|1@1+ (1,0) [0|1] "" Vector__XXX
 SG_ DET_MTD_045 : 0|1@1+ (1,0) [0|1] "" Vector__XXX
 SG_ DET_BELOW_RAIN_THOLD_045 : 0|1@1+ (1,0) [0|1] "" Vector__XXX
 SG_ DET_RANGE_046 : 0|15@1+ (0.015625,0) [0|500] "m" Vector__XXX
 SG_ DET_RANGE_ERR_046 : 0|7@1+ (0.0075,0) [0|0.9525] "m" Vector__XXX
 SG_ DET_RANGE_VELOCITY_046 : 0|15@1+ (0.0078125,-128) [-128|127.9921875] "m/s" Vector__XXX
 SG_ DET_RANGE_VELOCITY_ERR_046 : 0|8@1+ (0.003,0) [0|0.765] "m/s" Vector__XXX
 SG_ DET_AZIMUTH_046 : 0|13@1+ (0.0004,-1.5708) [-1.5708|1.5708] "rad" Vector__XXX
 SG_ DET_AZIMUTH_ERR_046 : 0|7@1+ (0.00087267,0) [0|0.11082909] "rad" Vector__XXX
 SG_ DET_ELEVATION_046 : 0|8@1+ (0.00275,-0.34925) [-0.34925|0.34925] "rad" Vector__XXX
 SG_ DET_ELEVATION_ERR_046 : 0|6@1+ (0.00174533,0) [0|0.10995579] "rad" Vector__XXX
 SG_ DET_RCS_046 : 0|8@1+ (0.5,-64) [-64|63.5] "dBsm" Vector__XXX
 SG_ DET_BI_STATIC_FLAG_046 : 0|1@1+ (1,0) [0|1] "" Vector__XXX
 SG_ DET_SUPER_RES_TARGET_046 : 0|1@1+ (1,0) [0|1] "" Vector__XXX
 SG_ DET_SNR_046 : 0|8@1+ (0.35156,0) [0|89.6478] "dB" Vector__XXX
 SG_ DET_EXISTENCE_PROB_046 : 0|6@1+ (1.588,0) [0|100] "%" Vector__XXX
 SG_ DET_HVC_FLAG_046 : 0|1@1+ (1,0) [0|1] "" Vector__XXX
 SG_ DET_CONFD_AZIMUTH_046 : 0|2@1+ (1,0) [0|3] "" Vector__XXX
 SG_ DET_CONFD_ELEVATION_046 : 0|2@1+ (1,0) [0|3] "" Vector__XXX
 SG_ DET_PROB_1STAZHYPO_046 : 0|1@1+ (1,0) [0|1] "" Vector__XXX
 SG_ DET_IDM_046 : 0|1@1+ (1,0) [0|1] "" Vector__XXX
 SG_ DET_MTD_046 : 0|1@1+ (1,0) [0|1] "" Vector__XXX
 SG_ DET_BELOW_RAIN_THOLD_046 : 0|1@1+ (1,0) [0|1] "" Vector__XXX
 SG_ DET_RANGE_047 : 0|15@1+ (0.015625,0) [0|500] "m" Vector__XXX
 SG_ DET_RANGE_ERR_047 : 0|7@1+ (0.0075,0) [0|0.9525] "m" Vector__XXX
 SG_ DET_RANGE_VELOCITY_047 : 0|15@1+ (0.0078125,-128) [-128|127.9921875] "m/s" Vector__XXX
 SG_ DET_RANGE_VELOCITY_ERR_047 : 0|8@1+ (0.003,0) [0|0.765] "m/s" Vector__XXX
 SG_ DET_AZIMUTH_047 : 0|13@1+ (0.0004,-1.5708) [-1.5708|1.5708] "rad" Vector__XXX
 SG_ DET_AZIMUTH_ERR_047 : 0|7@1+ (0.00087267,0) [0|0.11082909] "rad" Vector__XXX
 SG_ DET_ELEVATION_047 : 0|8@1+ (0.00275,-0.34925) [-0.34925|0.34925] "rad" Vector__XXX
 SG_ DET_ELEVATION_ERR_047 : 0|6@1+ (0.00174533,0) [0|0.10995579] "rad" Vector__XXX
 SG_ DET_RCS_047 : 0|8@1+ (0.5,-64) [-64|63.5] "dBsm" Vector__XXX
 SG_ DET_BI_STATIC_FLAG_047 : 0|1@1+ (1,0) [0|1] "" Vector__XXX
 SG_ DET_SUPER_RES_TARGET_047 : 0|1@1+ (1,0) [0|1] "" Vector__XXX
 SG_ DET_SNR_047 : 0|8@1+ (0.35156,0) [0|89.6478] "dB" Vector__XXX
 SG_ DET_EXISTENCE_PROB_047 : 0|6@1+ (1.588,0) [0|100] "%" Vector__XXX
 SG_ DET_HVC_FLAG_047 : 0|1@1+ (1,0) [0|1] "" Vector__XXX
 SG_ DET_CONFD_AZIMUTH_047 : 0|2@1+ (1,0) [0|3] "" Vector__XXX
 SG_ DET_CONFD_ELEVATION_047 : 0|2@1+ (1,0) [0|3] "" Vector__XXX
 SG_ DET_PROB_1STAZHYPO_047 : 0|1@1+ (1,0) [0|1] "" Vector__XXX
 SG_ DET_IDM_047 : 0|1@1+ (1,0) [0|1] "" Vector__XXX
 SG_ DET_MTD_047 : 0|1@1+ (1,0) [0|1] "" Vector__XXX
 SG_ DET_BELOW_RAIN_THOLD_047 : 0|1@1+ (1,0) [0|1] "" Vector__XXX
 SG_ DET_RANGE_048 : 0|15@1+ (0.015625,0) [0|500] "m" Vector__XXX
 SG_ DET_RANGE_ERR_048 : 0|7@1+ (0.0075,0) [0|0.9525] "m" Vector__XXX
 SG_ DET_RANGE_VELOCITY_048 : 0|15@1+ (0.0078125,-128) [-128|127.9921875] "m/s" Vector__XXX
 SG_ DET_RANGE_VELOCITY_ERR_048 : 0|8@1+ (0.003,0) [0|0.765] "m/s" Vector__XXX
 SG_ DET_AZIMUTH_048 : 0|13@1+ (0.0004,-1.5708) [-1.5708|1.5708] "rad" Vector__XXX
 SG_ DET_AZIMUTH_ERR_048 : 0|7@1+ (0.00087267,0) [0|0.11082909] "rad" Vector__XXX
 SG_ DET_ELEVATION_048 : 0|8@1+ (0.00275,-0.34925) [-0.34925|0.34925] "rad" Vector__XXX
 SG_ DET_ELEVATION_ERR_048 : 0|6@1+ (0.00174533,0) [0|0.10995579] "rad" Vector__XXX
 SG_ DET_RCS_048 : 0|8@1+ (0.5,-64) [-64|63.5] "dBsm" Vector__XXX
 SG_ DET_BI_STATIC_FLAG_048 : 0|1@1+ (1,0) [0|1] "" Vector__XXX
 SG_ DET_SUPER_RES_TARGET_048 : 0|1@1+ (1,0) [0|1] "" Vector__XXX
 SG_ DET_SNR_048 : 0|8@1+ (0.35156,0) [0|89.6478] "dB" Vector__XXX
 SG_ DET_EXISTENCE_PROB_048 : 0|6@1+ (1.588,0) [0|100] "%" Vector__XXX
 SG_ DET_HVC_FLAG_048 : 0|1@1+ (1,0) [0|1] "" Vector__XXX
 SG_ DET_CONFD_AZIMUTH_048 : 0|2@1+ (1,0) [0|3] "" Vector__XXX
 SG_ DET_CONFD_ELEVATION_048 : 0|2@1+ (1,0) [0|3] "" Vector__XXX
 SG_ DET_MH_SCAN_INDEX_4LSB_045_048 : 0|4@1+ (1,0) [0|15] "" Vector__XXX
 SG_ DET_MH_CYCLE_COUNTER_045_048 : 0|8@1+ (1,0) [0|255] "" Vector__XXX
 SG_ DET_MH_CRC16_045_048 : 0|16@1+ (1,0) [0|65535] "" Vector__XXX
 SG_ DET_PROB_1STAZHYPO_048 : 0|1@1+ (1,0) [0|1] "" Vector__XXX
 SG_ DET_IDM_048 : 0|1@1+ (1,0) [0|1] "" Vector__XXX
 SG_ DET_MTD_048 : 0|1@1+ (1,0) [0|1] "" Vector__XXX
 SG_ DET_BELOW_RAIN_THOLD_048 : 0|1@1+ (1,0) [0|1] "" Vector__XXX
 SG_ DET_RANGE_049 : 0|15@1+ (0.015625,0) [0|500] "m" Vector__XXX
 SG_ DET_RANGE_ERR_049 : 0|7@1+ (0.0075,0) [0|0.9525] "m" Vector__XXX
 SG_ DET_RANGE_VELOCITY_049 : 0|15@1+ (0.0078125,-128) [-128|127.9921875] "m/s" Vector__XXX
 SG_ DET_RANGE_VELOCITY_ERR_049 : 0|8@1+ (0.003,0) [0|0.765] "m/s" Vector__XXX
 SG_ DET_AZIMUTH_049 : 0|13@1+ (0.0004,-1.5708) [-1.5708|1.5708] "rad" Vector__XXX
 SG_ DET_AZIMUTH_ERR_049 : 0|7@1+ (0.00087267,0) [0|0.11082909] "rad" Vector__XXX
 SG_ DET_ELEVATION_049 : 0|8@1+ (0.00275,-0.34925) [-0.34925|0.34925] "rad" Vector__XXX
 SG_ DET_ELEVATION_ERR_049 : 0|6@1+ (0.00174533,0) [0|0.10995579] "rad" Vector__XXX
 SG_ DET_RCS_049 : 0|8@1+ (0.5,-64) [-64|63.5] "dBsm" Vector__XXX
 SG_ DET_BI_STATIC_FLAG_049 : 0|1@1+ (1,0) [0|1] "" Vector__XXX
 SG_ DET_SUPER_RES_TARGET_049 : 0|1@1+ (1,0) [0|1] "" Vector__XXX
 SG_ DET_SNR_049 : 0|8@1+ (0.35156,0) [0|89.6478] "dB" Vector__XXX
 SG_ DET_EXISTENCE_PROB_049 : 0|6@1+ (1.588,0) [0|100] "%" Vector__XXX
 SG_ DET_HVC_FLAG_049 : 0|1@1+ (1,0) [0|1] "" Vector__XXX
 SG_ DET_CONFD_AZIMUTH_049 : 0|2@1+ (1,0) [0|3] "" Vector__XXX
 SG_ DET_CONFD_ELEVATION_049 : 0|2@1+ (1,0) [0|3] "" Vector__XXX
 SG_ DET_PROB_1STAZHYPO_049 : 0|1@1+ (1,0) [0|1] "" Vector__XXX
 SG_ DET_IDM_049 : 0|1@1+ (1,0) [0|1] "" Vector__XXX
 SG_ DET_MTD_049 : 0|1@1+ (1,0) [0|1] "" Vector__XXX
 SG_ DET_BELOW_RAIN_THOLD_049 : 0|1@1+ (1,0) [0|1] "" Vector__XXX
 SG_ DET_RANGE_050 : 0|15@1+ (0.015625,0) [0|500] "m" Vector__XXX
 SG_ DET_RANGE_ERR_050 : 0|7@1+ (0.0075,0) [0|0.9525] "m" Vector__XXX
 SG_ DET_RANGE_VELOCITY_050 : 0|15@1+ (0.0078125,-128) [-128|127.9921875] "m/s" Vector__XXX
 SG_ DET_RANGE_VELOCITY_ERR_050 : 0|8@1+ (0.003,0) [0|0.765] "m/s" Vector__XXX
 SG_ DET_AZIMUTH_050 : 0|13@1+ (0.0004,-1.5708) [-1.5708|1.5708] "rad" Vector__XXX
 SG_ DET_AZIMUTH_ERR_050 : 0|7@1+ (0.00087267,0) [0|0.11082909] "rad" Vector__XXX
 SG_ DET_ELEVATION_050 : 0|8@1+ (0.00275,-0.34925) [-0.34925|0.34925] "rad" Vector__XXX
 SG_ DET_ELEVATION_ERR_050 : 0|6@1+ (0.00174533,0) [0|0.10995579] "rad" Vector__XXX
 SG_ DET_RCS_050 : 0|8@1+ (0.5,-64) [-64|63.5] "dBsm" Vector__XXX
 SG_ DET_BI_STATIC_FLAG_050 : 0|1@1+ (1,0) [0|1] "" Vector__XXX
 SG_ DET_SUPER_RES_TARGET_050 : 0|1@1+ (1,0) [0|1] "" Vector__XXX
 SG_ DET_SNR_050 : 0|8@1+ (0.35156,0) [0|89.6478] "dB" Vector__XXX
 SG_ DET_EXISTENCE_PROB_050 : 0|6@1+ (1.588,0) [0|100] "%" Vector__XXX
 SG_ DET_HVC_FLAG_050 : 0|1@1+ (1,0) [0|1] "" Vector__XXX
 SG_ DET_CONFD_AZIMUTH_050 : 0|2@1+ (1,0) [0|3] "" Vector__XXX
 SG_ DET_CONFD_ELEVATION_050 : 0|2@1+ (1,0) [0|3] "" Vector__XXX
 SG_ DET_PROB_1STAZHYPO_050 : 0|1@1+ (1,0) [0|1] "" Vector__XXX
 SG_ DET_IDM_050 : 0|1@1+ (1,0) [0|1] "" Vector__XXX
 SG_ DET_MTD_050 : 0|1@1+ (1,0) [0|1] "" Vector__XXX
 SG_ DET_BELOW_RAIN_THOLD_050 : 0|1@1+ (1,0) [0|1] "" Vector__XXX
 SG_ DET_RANGE_051 : 0|15@1+ (0.015625,0) [0|500] "m" Vector__XXX
 SG_ DET_RANGE_ERR_051 : 0|7@1+ (0.0075,0) [0|0.9525] "m" Vector__XXX
 SG_ DET_RANGE_VELOCITY_051 : 0|15@1+ (0.0078125,-128) [-128|127.9921875] "m/s" Vector__XXX
 SG_ DET_RANGE_VELOCITY_ERR_051 : 0|8@1+ (0.003,0) [0|0.765] "m/s" Vector__XXX
 SG_ DET_AZIMUTH_051 : 0|13@1+ (0.0004,-1.5708) [-1.5708|1.5708] "rad" Vector__XXX
 SG_ DET_AZIMUTH_ERR_051 : 0|7@1+ (0.00087267,0) [0|0.11082909] "rad" Vector__XXX
 SG_ DET_ELEVATION_051 : 0|8@1+ (0.00275,-0.34925) [-0.34925|0.34925] "rad" Vector__XXX
 SG_ DET_ELEVATION_ERR_051 : 0|6@1+ (0.00174533,0) [0|0.10995579] "rad" Vector__XXX
 SG_ DET_RCS_051 : 0|8@1+ (0.5,-64) [-64|63.5] "dBsm" Vector__XXX
 SG_ DET_BI_STATIC_FLAG_051 : 0|1@1+ (1,0) [0|1] "" Vector__XXX
 SG_ DET_SUPER_RES_TARGET_051 : 0|1@1+ (1,0) [0|1] "" Vector__XXX
 SG_ DET_SNR_051 : 0|8@1+ (0.35156,0) [0|89.6478] "dB" Vector__XXX
 SG_ DET_EXISTENCE_PROB_051 : 0|6@1+ (1.588,0) [0|100] "%" Vector__XXX
 SG_ DET_HVC_FLAG_051 : 0|1@1+ (1,0) [0|1] "" Vector__XXX
 SG_ DET_CONFD_AZIMUTH_051 : 0|2@1+ (1,0) [0|3] "" Vector__XXX
 SG_ DET_CONFD_ELEVATION_051 : 0|2@1+ (1,0) [0|3] "" Vector__XXX
 SG_ DET_PROB_1STAZHYPO_051 : 0|1@1+ (1,0) [0|1] "" Vector__XXX
 SG_ DET_IDM_051 : 0|1@1+ (1,0) [0|1] "" Vector__XXX
 SG_ DET_MTD_051 : 0|1@1+ (1,0) [0|1] "" Vector__XXX
 SG_ DET_BELOW_RAIN_THOLD_051 : 0|1@1+ (1,0) [0|1] "" Vector__XXX
 SG_ DET_RANGE_052 : 0|15@1+ (0.015625,0) [0|500] "m" Vector__XXX
 SG_ DET_RANGE_ERR_052 : 0|7@1+ (0.0075,0) [0|0.9525] "m" Vector__XXX
 SG_ DET_RANGE_VELOCITY_052 : 0|15@1+ (0.0078125,-128) [-128|127.9921875] "m/s" Vector__XXX
 SG_ DET_RANGE_VELOCITY_ERR_052 : 0|8@1+ (0.003,0) [0|0.765] "m/s" Vector__XXX
 SG_ DET_AZIMUTH_052 : 0|13@1+ (0.0004,-1.5708) [-1.5708|1.5708] "rad" Vector__XXX
 SG_ DET_AZIMUTH_ERR_052 : 0|7@1+ (0.00087267,0) [0|0.11082909] "rad" Vector__XXX
 SG_ DET_ELEVATION_052 : 0|8@1+ (0.00275,-0.34925) [-0.34925|0.34925] "rad" Vector__XXX
 SG_ DET_ELEVATION_ERR_052 : 0|6@1+ (0.00174533,0) [0|0.10995579] "rad" Vector__XXX
 SG_ DET_RCS_052 : 0|8@1+ (0.5,-64) [-64|63.5] "dBsm" Vector__XXX
 SG_ DET_BI_STATIC_FLAG_052 : 0|1@1+ (1,0) [0|1] "" Vector__XXX
 SG_ DET_SUPER_RES_TARGET_052 : 0|1@1+ (1,0) [0|1] "" Vector__XXX
 SG_ DET_SNR_052 : 0|8@1+ (0.35156,0) [0|89.6478] "dB" Vector__XXX
 SG_ DET_EXISTENCE_PROB_052 : 0|6@1+ (1.588,0) [0|100] "%" Vector__XXX
 SG_ DET_HVC_FLAG_052 : 0|1@1+ (1,0) [0|1] "" Vector__XXX
 SG_ DET_CONFD_AZIMUTH_052 : 0|2@1+ (1,0) [0|3] "" Vector__XXX
 SG_ DET_CONFD_ELEVATION_052 : 0|2@1+ (1,0) [0|3] "" Vector__XXX
 SG_ DET_MH_SCAN_INDEX_4LSB_049_052 : 0|4@1+ (1,0) [0|15] "" Vector__XXX
 SG_ DET_MH_CYCLE_COUNTER_049_052 : 0|8@1+ (1,0) [0|255] "" Vector__XXX
 SG_ DET_MH_CRC16_049_052 : 0|16@1+ (1,0) [0|65535] "" Vector__XXX
 SG_ DET_PROB_1STAZHYPO_052 : 0|1@1+ (1,0) [0|1] "" Vector__XXX
 SG_ DET_IDM_052 : 0|1@1+ (1,0) [0|1] "" Vector__XXX
 SG_ DET_MTD_052 : 0|1@1+ (1,0) [0|1] "" Vector__XXX
 SG_ DET_BELOW_RAIN_THOLD_052 : 0|1@1+ (1,0) [0|1] "" Vector__XXX
 SG_ DET_RANGE_053 : 0|15@1+ (0.015625,0) [0|500] "m" Vector__XXX
 SG_ DET_RANGE_ERR_053 : 0|7@1+ (0.0075,0) [0|0.9525] "m" Vector__XXX
 SG_ DET_RANGE_VELOCITY_053 : 0|15@1+ (0.0078125,-128) [-128|127.9921875] "m/s" Vector__XXX
 SG_ DET_RANGE_VELOCITY_ERR_053 : 0|8@1+ (0.003,0) [0|0.765] "m/s" Vector__XXX
 SG_ DET_AZIMUTH_053 : 0|13@1+ (0.0004,-1.5708) [-1.5708|1.5708] "rad" Vector__XXX
 SG_ DET_AZIMUTH_ERR_053 : 0|7@1+ (0.00087267,0) [0|0.11082909] "rad" Vector__XXX
 SG_ DET_ELEVATION_053 : 0|8@1+ (0.00275,-0.34925) [-0.34925|0.34925] "rad" Vector__XXX
 SG_ DET_ELEVATION_ERR_053 : 0|6@1+ (0.00174533,0) [0|0.10995579] "rad" Vector__XXX
 SG_ DET_RCS_053 : 0|8@1+ (0.5,-64) [-64|63.5] "dBsm" Vector__XXX
 SG_ DET_BI_STATIC_FLAG_053 : 0|1@1+ (1,0) [0|1] "" Vector__XXX
 SG_ DET_SUPER_RES_TARGET_053 : 0|1@1+ (1,0) [0|1] "" Vector__XXX
 SG_ DET_SNR_053 : 0|8@1+ (0.35156,0) [0|89.6478] "dB" Vector__XXX
 SG_ DET_EXISTENCE_PROB_053 : 0|6@1+ (1.588,0) [0|100] "%" Vector__XXX
 SG_ DET_HVC_FLAG_053 : 0|1@1+ (1,0) [0|1] "" Vector__XXX
 SG_ DET_CONFD_AZIMUTH_053 : 0|2@1+ (1,0) [0|3] "" Vector__XXX
 SG_ DET_CONFD_ELEVATION_053 : 0|2@1+ (1,0) [0|3] "" Vector__XXX
 SG_ DET_PROB_1STAZHYPO_053 : 0|1@1+ (1,0) [0|1] "" Vector__XXX
 SG_ DET_IDM_053 : 0|1@1+ (1,0) [0|1] "" Vector__XXX
 SG_ DET_MTD_053 : 0|1@1+ (1,0) [0|1] "" Vector__XXX
 SG_ DET_BELOW_RAIN_THOLD_053 : 0|1@1+ (1,0) [0|1] "" Vector__XXX
 SG_ DET_RANGE_054 : 0|15@1+ (0.015625,0) [0|500] "m" Vector__XXX
 SG_ DET_RANGE_ERR_054 : 0|7@1+ (0.0075,0) [0|0.9525] "m" Vector__XXX
 SG_ DET_RANGE_VELOCITY_054 : 0|15@1+ (0.0078125,-128) [-128|127.9921875] "m/s" Vector__XXX
 SG_ DET_RANGE_VELOCITY_ERR_054 : 0|8@1+ (0.003,0) [0|0.765] "m/s" Vector__XXX
 SG_ DET_AZIMUTH_054 : 0|13@1+ (0.0004,-1.5708) [-1.5708|1.5708] "rad" Vector__XXX
 SG_ DET_AZIMUTH_ERR_054 : 0|7@1+ (0.00087267,0) [0|0.11082909] "rad" Vector__XXX
 SG_ DET_ELEVATION_054 : 0|8@1+ (0.00275,-0.34925) [-0.34925|0.34925] "rad" Vector__XXX
 SG_ DET_ELEVATION_ERR_054 : 0|6@1+ (0.00174533,0) [0|0.10995579] "rad" Vector__XXX
 SG_ DET_RCS_054 : 0|8@1+ (0.5,-64) [-64|63.5] "dBsm" Vector__XXX
 SG_ DET_BI_STATIC_FLAG_054 : 0|1@1+ (1,0) [0|1] "" Vector__XXX
 SG_ DET_SUPER_RES_TARGET_054 : 0|1@1+ (1,0) [0|1] "" Vector__XXX
 SG_ DET_SNR_054 : 0|8@1+ (0.35156,0) [0|89.6478] "dB" Vector__XXX
 SG_ DET_EXISTENCE_PROB_054 : 0|6@1+ (1.588,0) [0|100] "%" Vector__XXX
 SG_ DET_HVC_FLAG_054 : 0|1@1+ (1,0) [0|1] "" Vector__XXX
 SG_ DET_CONFD_AZIMUTH_054 : 0|2@1+ (1,0) [0|3] "" Vector__XXX
 SG_ DET_CONFD_ELEVATION_054 : 0|2@1+ (1,0) [0|3] "" Vector__XXX
 SG_ DET_PROB_1STAZHYPO_054 : 0|1@1+ (1,0) [0|1] "" Vector__XXX
 SG_ DET_IDM_054 : 0|1@1+ (1,0) [0|1] "" Vector__XXX
 SG_ DET_MTD_054 : 0|1@1+ (1,0) [0|1] "" Vector__XXX
 SG_ DET_BELOW_RAIN_THOLD_054 : 0|1@1+ (1,0) [0|1] "" Vector__XXX
 SG_ DET_RANGE_055 : 0|15@1+ (0.015625,0) [0|500] "m" Vector__XXX
 SG_ DET_RANGE_ERR_055 : 0|7@1+ (0.0075,0) [0|0.9525] "m" Vector__XXX
 SG_ DET_RANGE_VELOCITY_055 : 0|15@1+ (0.0078125,-128) [-128|127.9921875] "m/s" Vector__XXX
 SG_ DET_RANGE_VELOCITY_ERR_055 : 0|8@1+ (0.003,0) [0|0.765] "m/s" Vector__XXX
 SG_ DET_AZIMUTH_055 : 0|13@1+ (0.0004,-1.5708) [-1.5708|1.5708] "rad" Vector__XXX
 SG_ DET_AZIMUTH_ERR_055 : 0|7@1+ (0.00087267,0) [0|0.11082909] "rad" Vector__XXX
 SG_ DET_ELEVATION_055 : 0|8@1+ (0.00275,-0.34925) [-0.34925|0.34925] "rad" Vector__XXX
 SG_ DET_ELEVATION_ERR_055 : 0|6@1+ (0.00174533,0) [0|0.10995579] "rad" Vector__XXX
 SG_ DET_RCS_055 : 0|8@1+ (0.5,-64) [-64|63.5] "dBsm" Vector__XXX
 SG_ DET_BI_STATIC_FLAG_055 : 0|1@1+ (1,0) [0|1] "" Vector__XXX
 SG_ DET_SUPER_RES_TARGET_055 : 0|1@1+ (1,0) [0|1] "" Vector__XXX
 SG_ DET_SNR_055 : 0|8@1+ (0.35156,0) [0|89.6478] "dB" Vector__XXX
 SG_ DET_EXISTENCE_PROB_055 : 0|6@1+ (1.588,0) [0|100] "%" Vector__XXX
 SG_ DET_HVC_FLAG_055 : 0|1@1+ (1,0) [0|1] "" Vector__XXX
 SG_ DET_CONFD_AZIMUTH_055 : 0|2@1+ (1,0) [0|3] "" Vector__XXX
 SG_ DET_CONFD_ELEVATION_055 : 0|2@1+ (1,0) [0|3] "" Vector__XXX
 SG_ DET_PROB_1STAZHYPO_055 : 0|1@1+ (1,0) [0|1] "" Vector__XXX
 SG_ DET_IDM_055 : 0|1@1+ (1,0) [0|1] "" Vector__XXX
 SG_ DET_MTD_055 : 0|1@1+ (1,0) [0|1] "" Vector__XXX
 SG_ DET_BELOW_RAIN_THOLD_055 : 0|1@1+ (1,0) [0|1] "" Vector__XXX
 SG_ DET_RANGE_056 : 0|15@1+ (0.015625,0) [0|500] "m" Vector__XXX
 SG_ DET_RANGE_ERR_056 : 0|7@1+ (0.0075,0) [0|0.9525] "m" Vector__XXX
 SG_ DET_RANGE_VELOCITY_056 : 0|15@1+ (0.0078125,-128) [-128|127.9921875] "m/s" Vector__XXX
 SG_ DET_RANGE_VELOCITY_ERR_056 : 0|8@1+ (0.003,0) [0|0.765] "m/s" Vector__XXX
 SG_ DET_AZIMUTH_056 : 0|13@1+ (0.0004,-1.5708) [-1.5708|1.5708] "rad" Vector__XXX
 SG_ DET_AZIMUTH_ERR_056 : 0|7@1+ (0.00087267,0) [0|0.11082909] "rad" Vector__XXX
 SG_ DET_ELEVATION_056 : 0|8@1+ (0.00275,-0.34925) [-0.34925|0.34925] "rad" Vector__XXX
 SG_ DET_ELEVATION_ERR_056 : 0|6@1+ (0.00174533,0) [0|0.10995579] "rad" Vector__XXX
 SG_ DET_RCS_056 : 0|8@1+ (0.5,-64) [-64|63.5] "dBsm" Vector__XXX
 SG_ DET_BI_STATIC_FLAG_056 : 0|1@1+ (1,0) [0|1] "" Vector__XXX
 SG_ DET_SUPER_RES_TARGET_056 : 0|1@1+ (1,0) [0|1] "" Vector__XXX
 SG_ DET_SNR_056 : 0|8@1+ (0.35156,0) [0|89.6478] "dB" Vector__XXX
 SG_ DET_EXISTENCE_PROB_056 : 0|6@1+ (1.588,0) [0|100] "%" Vector__XXX
 SG_ DET_HVC_FLAG_056 : 0|1@1+ (1,0) [0|1] "" Vector__XXX
 SG_ DET_CONFD_AZIMUTH_056 : 0|2@1+ (1,0) [0|3] "" Vector__XXX
 SG_ DET_CONFD_ELEVATION_056 : 0|2@1+ (1,0) [0|3] "" Vector__XXX
 SG_ DET_MH_SCAN_INDEX_4LSB_053_056 : 0|4@1+ (1,0) [0|15] "" Vector__XXX
 SG_ DET_MH_CYCLE_COUNTER_053_056 : 0|8@1+ (1,0) [0|255] "" Vector__XXX
 SG_ DET_MH_CRC16_053_056 : 0|16@1+ (1,0) [0|65535] "" Vector__XXX
 SG_ DET_PROB_1STAZHYPO_056 : 0|1@1+ (1,0) [0|1] "" Vector__XXX
 SG_ DET_IDM_056 : 0|1@1+ (1,0) [0|1] "" Vector__XXX
 SG_ DET_MTD_056 : 0|1@1+ (1,0) [0|1] "" Vector__XXX
 SG_ DET_BELOW_RAIN_THOLD_056 : 0|1@1+ (1,0) [0|1] "" Vector__XXX
 SG_ DET_RANGE_057 : 0|15@1+ (0.015625,0) [0|500] "m" Vector__XXX
 SG_ DET_RANGE_ERR_057 : 0|7@1+ (0.0075,0) [0|0.9525] "m" Vector__XXX
 SG_ DET_RANGE_VELOCITY_057 : 0|15@1+ (0.0078125,-128) [-128|127.9921875] "m/s" Vector__XXX
 SG_ DET_RANGE_VELOCITY_ERR_057 : 0|8@1+ (0.003,0) [0|0.765] "m/s" Vector__XXX
 SG_ DET_AZIMUTH_057 : 0|13@1+ (0.0004,-1.5708) [-1.5708|1.5708] "rad" Vector__XXX
 SG_ DET_AZIMUTH_ERR_057 : 0|7@1+ (0.00087267,0) [0|0.11082909] "rad" Vector__XXX
 SG_ DET_ELEVATION_057 : 0|8@1+ (0.00275,-0.34925) [-0.34925|0.34925] "rad" Vector__XXX
 SG_ DET_ELEVATION_ERR_057 : 0|6@1+ (0.00174533,0) [0|0.10995579] "rad" Vector__XXX
 SG_ DET_RCS_057 : 0|8@1+ (0.5,-64) [-64|63.5] "dBsm" Vector__XXX
 SG_ DET_BI_STATIC_FLAG_057 : 0|1@1+ (1,0) [0|1] "" Vector__XXX
 SG_ DET_SUPER_RES_TARGET_057 : 0|1@1+ (1,0) [0|1] "" Vector__XXX
 SG_ DET_SNR_057 : 0|8@1+ (0.35156,0) [0|89.6478] "dB" Vector__XXX
 SG_ DET_EXISTENCE_PROB_057 : 0|6@1+ (1.588,0) [0|100] "%" Vector__XXX
 SG_ DET_HVC_FLAG_057 : 0|1@1+ (1,0) [0|1] "" Vector__XXX
 SG_ DET_CONFD_AZIMUTH_057 : 0|2@1+ (1,0) [0|3] "" Vector__XXX
 SG_ DET_CONFD_ELEVATION_057 : 0|2@1+ (1,0) [0|3] "" Vector__XXX
 SG_ DET_PROB_1STAZHYPO_057 : 0|1@1+ (1,0) [0|1] "" Vector__XXX
 SG_ DET_IDM_057 : 0|1@1+ (1,0) [0|1] "" Vector__XXX
 SG_ DET_MTD_057 : 0|1@1+ (1,0) [0|1] "" Vector__XXX
 SG_ DET_BELOW_RAIN_THOLD_057 : 0|1@1+ (1,0) [0|1] "" Vector__XXX
 SG_ DET_RANGE_058 : 0|15@1+ (0.015625,0) [0|500] "m" Vector__XXX
 SG_ DET_RANGE_ERR_058 : 0|7@1+ (0.0075,0) [0|0.9525] "m" Vector__XXX
 SG_ DET_RANGE_VELOCITY_058 : 0|15@1+ (0.0078125,-128) [-128|127.9921875] "m/s" Vector__XXX
 SG_ DET_RANGE_VELOCITY_ERR_058 : 0|8@1+ (0.003,0) [0|0.765] "m/s" Vector__XXX
 SG_ DET_AZIMUTH_058 : 0|13@1+ (0.0004,-1.5708) [-1.5708|1.5708] "rad" Vector__XXX
 SG_ DET_AZIMUTH_ERR_058 : 0|7@1+ (0.00087267,0) [0|0.11082909] "rad" Vector__XXX
 SG_ DET_ELEVATION_058 : 0|8@1+ (0.00275,-0.34925) [-0.34925|0.34925] "rad" Vector__XXX
 SG_ DET_ELEVATION_ERR_058 : 0|6@1+ (0.00174533,0) [0|0.10995579] "rad" Vector__XXX
 SG_ DET_RCS_058 : 0|8@1+ (0.5,-64) [-64|63.5] "dBsm" Vector__XXX
 SG_ DET_BI_STATIC_FLAG_058 : 0|1@1+ (1,0) [0|1] "" Vector__XXX
 SG_ DET_SUPER_RES_TARGET_058 : 0|1@1+ (1,0) [0|1] "" Vector__XXX
 SG_ DET_SNR_058 : 0|8@1+ (0.35156,0) [0|89.6478] "dB" Vector__XXX
 SG_ DET_EXISTENCE_PROB_058 : 0|6@1+ (1.588,0) [0|100] "%" Vector__XXX
 SG_ DET_HVC_FLAG_058 : 0|1@1+ (1,0) [0|1] "" Vector__XXX
 SG_ DET_CONFD_AZIMUTH_058 : 0|2@1+ (1,0) [0|3] "" Vector__XXX
 SG_ DET_CONFD_ELEVATION_058 : 0|2@1+ (1,0) [0|3] "" Vector__XXX
 SG_ DET_PROB_1STAZHYPO_058 : 0|1@1+ (1,0) [0|1] "" Vector__XXX
 SG_ DET_IDM_058 : 0|1@1+ (1,0) [0|1] "" Vector__XXX
 SG_ DET_MTD_058 : 0|1@1+ (1,0) [0|1] "" Vector__XXX
 SG_ DET_BELOW_RAIN_THOLD_058 : 0|1@1+ (1,0) [0|1] "" Vector__XXX
 SG_ DET_RANGE_059 : 0|15@1+ (0.015625,0) [0|500] "m" Vector__XXX
 SG_ DET_RANGE_ERR_059 : 0|7@1+ (0.0075,0) [0|0.9525] "m" Vector__XXX
 SG_ DET_RANGE_VELOCITY_059 : 0|15@1+ (0.0078125,-128) [-128|127.9921875] "m/s" Vector__XXX
 SG_ DET_RANGE_VELOCITY_ERR_059 : 0|8@1+ (0.003,0) [0|0.765] "m/s" Vector__XXX
 SG_ DET_AZIMUTH_059 : 0|13@1+ (0.0004,-1.5708) [-1.5708|1.5708] "rad" Vector__XXX
 SG_ DET_AZIMUTH_ERR_059 : 0|7@1+ (0.00087267,0) [0|0.11082909] "rad" Vector__XXX
 SG_ DET_ELEVATION_059 : 0|8@1+ (0.00275,-0.34925) [-0.34925|0.34925] "rad" Vector__XXX
 SG_ DET_ELEVATION_ERR_059 : 0|6@1+ (0.00174533,0) [0|0.10995579] "rad" Vector__XXX
 SG_ DET_RCS_059 : 0|8@1+ (0.5,-64) [-64|63.5] "dBsm" Vector__XXX
 SG_ DET_BI_STATIC_FLAG_059 : 0|1@1+ (1,0) [0|1] "" Vector__XXX
 SG_ DET_SUPER_RES_TARGET_059 : 0|1@1+ (1,0) [0|1] "" Vector__XXX
 SG_ DET_SNR_059 : 0|8@1+ (0.35156,0) [0|89.6478] "dB" Vector__XXX
 SG_ DET_EXISTENCE_PROB_059 : 0|6@1+ (1.588,0) [0|100] "%" Vector__XXX
 SG_ DET_HVC_FLAG_059 : 0|1@1+ (1,0) [0|1] "" Vector__XXX
 SG_ DET_CONFD_AZIMUTH_059 : 0|2@1+ (1,0) [0|3] "" Vector__XXX
 SG_ DET_CONFD_ELEVATION_059 : 0|2@1+ (1,0) [0|3] "" Vector__XXX
 SG_ DET_PROB_1STAZHYPO_059 : 0|1@1+ (1,0) [0|1] "" Vector__XXX
 SG_ DET_IDM_059 : 0|1@1+ (1,0) [0|1] "" Vector__XXX
 SG_ DET_MTD_059 : 0|1@1+ (1,0) [0|1] "" Vector__XXX
 SG_ DET_BELOW_RAIN_THOLD_059 : 0|1@1+ (1,0) [0|1] "" Vector__XXX
 SG_ DET_RANGE_060 : 0|15@1+ (0.015625,0) [0|500] "m" Vector__XXX
 SG_ DET_RANGE_ERR_060 : 0|7@1+ (0.0075,0) [0|0.9525] "m" Vector__XXX
 SG_ DET_RANGE_VELOCITY_060 : 0|15@1+ (0.0078125,-128) [-128|127.9921875] "m/s" Vector__XXX
 SG_ DET_RANGE_VELOCITY_ERR_060 : 0|8@1+ (0.003,0) [0|0.765] "m/s" Vector__XXX
 SG_ DET_AZIMUTH_060 : 0|13@1+ (0.0004,-1.5708) [-1.5708|1.5708] "rad" Vector__XXX
 SG_ DET_AZIMUTH_ERR_060 : 0|7@1+ (0.00087267,0) [0|0.11082909] "rad" Vector__XXX
 SG_ DET_ELEVATION_060 : 0|8@1+ (0.00275,-0.34925) [-0.34925|0.34925] "rad" Vector__XXX
 SG_ DET_ELEVATION_ERR_060 : 0|6@1+ (0.00174533,0) [0|0.10995579] "rad" Vector__XXX
 SG_ DET_RCS_060 : 0|8@1+ (0.5,-64) [-64|63.5] "dBsm" Vector__XXX
 SG_ DET_BI_STATIC_FLAG_060 : 0|1@1+ (1,0) [0|1] "" Vector__XXX
 SG_ DET_SUPER_RES_TARGET_060 : 0|1@1+ (1,0) [0|1] "" Vector__XXX
 SG_ DET_SNR_060 : 0|8@1+ (0.35156,0) [0|89.6478] "dB" Vector__XXX
 SG_ DET_EXISTENCE_PROB_060 : 0|6@1+ (1.588,0) [0|100] "%" Vector__XXX
 SG_ DET_HVC_FLAG_060 : 0|1@1+ (1,0) [0|1] "" Vector__XXX
 SG_ DET_CONFD_AZIMUTH_060 : 0|2@1+ (1,0) [0|3] "" Vector__XXX
 SG_ DET_CONFD_ELEVATION_060 : 0|2@1+ (1,0) [0|3] "" Vector__XXX
 SG_ DET_MH_SCAN_INDEX_4LSB_057_060 : 0|4@1+ (1,0) [0|15] "" Vector__XXX
 SG_ DET_MH_CYCLE_COUNTER_057_060 : 0|8@1+ (1,0) [0|255] "" Vector__XXX
 SG_ DET_MH_CRC16_057_060 : 0|16@1+ (1,0) [0|65535] "" Vector__XXX
 SG_ DET_PROB_1STAZHYPO_060 : 0|1@1+ (1,0) [0|1] "" Vector__XXX
 SG_ DET_IDM_060 : 0|1@1+ (1,0) [0|1] "" Vector__XXX
 SG_ DET_MTD_060 : 0|1@1+ (1,0) [0|1] "" Vector__XXX
 SG_ DET_BELOW_RAIN_THOLD_060 : 0|1@1+ (1,0) [0|1] "" Vector__XXX
 SG_ DET_RANGE_061 : 0|15@1+ (0.015625,0) [0|500] "m" Vector__XXX
 SG_ DET_RANGE_ERR_061 : 0|7@1+ (0.0075,0) [0|0.9525] "m" Vector__XXX
 SG_ DET_RANGE_VELOCITY_061 : 0|15@1+ (0.0078125,-128) [-128|127.9921875] "m/s" Vector__XXX
 SG_ DET_RANGE_VELOCITY_ERR_061 : 0|8@1+ (0.003,0) [0|0.765] "m/s" Vector__XXX
 SG_ DET_AZIMUTH_061 : 0|13@1+ (0.0004,-1.5708) [-1.5708|1.5708] "rad" Vector__XXX
 SG_ DET_AZIMUTH_ERR_061 : 0|7@1+ (0.00087267,0) [0|0.11082909] "rad" Vector__XXX
 SG_ DET_ELEVATION_061 : 0|8@1+ (0.00275,-0.34925) [-0.34925|0.34925] "rad" Vector__XXX
 SG_ DET_ELEVATION_ERR_061 : 0|6@1+ (0.00174533,0) [0|0.10995579] "rad" Vector__XXX
 SG_ DET_RCS_061 : 0|8@1+ (0.5,-64) [-64|63.5] "dBsm" Vector__XXX
 SG_ DET_BI_STATIC_FLAG_061 : 0|1@1+ (1,0) [0|1] "" Vector__XXX
 SG_ DET_SUPER_RES_TARGET_061 : 0|1@1+ (1,0) [0|1] "" Vector__XXX
 SG_ DET_SNR_061 : 0|8@1+ (0.35156,0) [0|89.6478] "dB" Vector__XXX
 SG_ DET_EXISTENCE_PROB_061 : 0|6@1+ (1.588,0) [0|100] "%" Vector__XXX
 SG_ DET_HVC_FLAG_061 : 0|1@1+ (1,0) [0|1] "" Vector__XXX
 SG_ DET_CONFD_AZIMUTH_061 : 0|2@1+ (1,0) [0|3] "" Vector__XXX
 SG_ DET_CONFD_ELEVATION_061 : 0|2@1+ (1,0) [0|3] "" Vector__XXX
 SG_ DET_PROB_1STAZHYPO_061 : 0|1@1+ (1,0) [0|1] "" Vector__XXX
 SG_ DET_IDM_061 : 0|1@1+ (1,0) [0|1] "" Vector__XXX
 SG_ DET_MTD_061 : 0|1@1+ (1,0) [0|1] "" Vector__XXX
 SG_ DET_BELOW_RAIN_THOLD_061 : 0|1@1+ (1,0) [0|1] "" Vector__XXX
 SG_ DET_RANGE_062 : 0|15@1+ (0.015625,0) [0|500] "m" Vector__XXX
 SG_ DET_RANGE_ERR_062 : 0|7@1+ (0.0075,0) [0|0.9525] "m" Vector__XXX
 SG_ DET_RANGE_VELOCITY_062 : 0|15@1+ (0.0078125,-128) [-128|127.9921875] "m/s" Vector__XXX
 SG_ DET_RANGE_VELOCITY_ERR_062 : 0|8@1+ (0.003,0) [0|0.765] "m/s" Vector__XXX
 SG_ DET_AZIMUTH_062 : 0|13@1+ (0.0004,-1.5708) [-1.5708|1.5708] "rad" Vector__XXX
 SG_ DET_AZIMUTH_ERR_062 : 0|7@1+ (0.00087267,0) [0|0.11082909] "rad" Vector__XXX
 SG_ DET_ELEVATION_062 : 0|8@1+ (0.00275,-0.34925) [-0.34925|0.34925] "rad" Vector__XXX
 SG_ DET_ELEVATION_ERR_062 : 0|6@1+ (0.00174533,0) [0|0.10995579] "rad" Vector__XXX
 SG_ DET_RCS_062 : 0|8@1+ (0.5,-64) [-64|63.5] "dBsm" Vector__XXX
 SG_ DET_BI_STATIC_FLAG_062 : 0|1@1+ (1,0) [0|1] "" Vector__XXX
 SG_ DET_SUPER_RES_TARGET_062 : 0|1@1+ (1,0) [0|1] "" Vector__XXX
 SG_ DET_SNR_062 : 0|8@1+ (0.35156,0) [0|89.6478] "dB" Vector__XXX
 SG_ DET_EXISTENCE_PROB_062 : 0|6@1+ (1.588,0) [0|100] "%" Vector__XXX
 SG_ DET_HVC_FLAG_062 : 0|1@1+ (1,0) [0|1] "" Vector__XXX
 SG_ DET_CONFD_AZIMUTH_062 : 0|2@1+ (1,0) [0|3] "" Vector__XXX
 SG_ DET_CONFD_ELEVATION_062 : 0|2@1+ (1,0) [0|3] "" Vector__XXX
 SG_ DET_PROB_1STAZHYPO_062 : 0|1@1+ (1,0) [0|1] "" Vector__XXX
 SG_ DET_IDM_062 : 0|1@1+ (1,0) [0|1] "" Vector__XXX
 SG_ DET_MTD_062 : 0|1@1+ (1,0) [0|1] "" Vector__XXX
 SG_ DET_BELOW_RAIN_THOLD_062 : 0|1@1+ (1,0) [0|1] "" Vector__XXX
 SG_ DET_RANGE_063 : 0|15@1+ (0.015625,0) [0|500] "m" Vector__XXX
 SG_ DET_RANGE_ERR_063 : 0|7@1+ (0.0075,0) [0|0.9525] "m" Vector__XXX
 SG_ DET_RANGE_VELOCITY_063 : 0|15@1+ (0.0078125,-128) [-128|127.9921875] "m/s" Vector__XXX
 SG_ DET_RANGE_VELOCITY_ERR_063 : 0|8@1+ (0.003,0) [0|0.765] "m/s" Vector__XXX
 SG_ DET_AZIMUTH_063 : 0|13@1+ (0.0004,-1.5708) [-1.5708|1.5708] "rad" Vector__XXX
 SG_ DET_AZIMUTH_ERR_063 : 0|7@1+ (0.00087267,0) [0|0.11082909] "rad" Vector__XXX
 SG_ DET_ELEVATION_063 : 0|8@1+ (0.00275,-0.34925) [-0.34925|0.34925] "rad" Vector__XXX
 SG_ DET_ELEVATION_ERR_063 : 0|6@1+ (0.00174533,0) [0|0.10995579] "rad" Vector__XXX
 SG_ DET_RCS_063 : 0|8@1+ (0.5,-64) [-64|63.5] "dBsm" Vector__XXX
 SG_ DET_BI_STATIC_FLAG_063 : 0|1@1+ (1,0) [0|1] "" Vector__XXX
 SG_ DET_SUPER_RES_TARGET_063 : 0|1@1+ (1,0) [0|1] "" Vector__XXX
 SG_ DET_SNR_063 : 0|8@1+ (0.35156,0) [0|89.6478] "dB" Vector__XXX
 SG_ DET_EXISTENCE_PROB_063 : 0|6@1+ (1.588,0) [0|100] "%" Vector__XXX
 SG_ DET_HVC_FLAG_063 : 0|1@1+ (1,0) [0|1] "" Vector__XXX
 SG_ DET_CONFD_AZIMUTH_063 : 0|2@1+ (1,0) [0|3] "" Vector__XXX
 SG_ DET_CONFD_ELEVATION_063 : 0|2@1+ (1,0) [0|3] "" Vector__XXX
 SG_ DET_PROB_1STAZHYPO_063 : 0|1@1+ (1,0) [0|1] "" Vector__XXX
 SG_ DET_IDM_063 : 0|1@1+ (1,0) [0|1] "" Vector__XXX
 SG_ DET_MTD_063 : 0|1@1+ (1,0) [0|1] "" Vector__XXX
 SG_ DET_BELOW_RAIN_THOLD_063 : 0|1@1+ (1,0) [0|1] "" Vector__XXX
 SG_ DET_RANGE_064 : 0|15@1+ (0.015625,0) [0|500] "m" Vector__XXX
 SG_ DET_RANGE_ERR_064 : 0|7@1+ (0.0075,0) [0|0.9525] "m" Vector__XXX
 SG_ DET_RANGE_VELOCITY_064 : 0|15@1+ (0.0078125,-128) [-128|127.9921875] "m/s" Vector__XXX
 SG_ DET_RANGE_VELOCITY_ERR_064 : 0|8@1+ (0.003,0) [0|0.765] "m/s" Vector__XXX
 SG_ DET_AZIMUTH_064 : 0|13@1+ (0.0004,-1.5708) [-1.5708|1.5708] "rad" Vector__XXX
 SG_ DET_AZIMUTH_ERR_064 : 0|7@1+ (0.00087267,0) [0|0.11082909] "rad" Vector__XXX
 SG_ DET_ELEVATION_064 : 0|8@1+ (0.00275,-0.34925) [-0.34925|0.34925] "rad" Vector__XXX
 SG_ DET_ELEVATION_ERR_064 : 0|6@1+ (0.00174533,0) [0|0.10995579] "rad" Vector__XXX
 SG_ DET_RCS_064 : 0|8@1+ (0.5,-64) [-64|63.5] "dBsm" Vector__XXX
 SG_ DET_BI_STATIC_FLAG_064 : 0|1@1+ (1,0) [0|1] "" Vector__XXX
 SG_ DET_SUPER_RES_TARGET_064 : 0|1@1+ (1,0) [0|1] "" Vector__XXX
 SG_ DET_SNR_064 : 0|8@1+ (0.35156,0) [0|89.6478] "dB" Vector__XXX
 SG_ DET_EXISTENCE_PROB_064 : 0|6@1+ (1.588,0) [0|100] "%" Vector__XXX
 SG_ DET_HVC_FLAG_064 : 0|1@1+ (1,0) [0|1] "" Vector__XXX
 SG_ DET_CONFD_AZIMUTH_064 : 0|2@1+ (1,0) [0|3] "" Vector__XXX
 SG_ DET_CONFD_ELEVATION_064 : 0|2@1+ (1,0) [0|3] "" Vector__XXX
 SG_ DET_MH_SCAN_INDEX_4LSB_061_064 : 0|4@1+ (1,0) [0|15] "" Vector__XXX
 SG_ DET_MH_CYCLE_COUNTER_061_064 : 0|8@1+ (1,0) [0|255] "" Vector__XXX
 SG_ DET_MH_CRC16_061_064 : 0|16@1+ (1,0) [0|65535] "" Vector__XXX
 SG_ DET_PROB_1STAZHYPO_064 : 0|1@1+ (1,0) [0|1] "" Vector__XXX
 SG_ DET_IDM_064 : 0|1@1+ (1,0) [0|1] "" Vector__XXX
 SG_ DET_MTD_064 : 0|1@1+ (1,0) [0|1] "" Vector__XXX
 SG_ DET_BELOW_RAIN_THOLD_064 : 0|1@1+ (1,0) [0|1] "" Vector__XXX
 SG_ DET_RANGE_065 : 0|15@1+ (0.015625,0) [0|500] "m" Vector__XXX
 SG_ DET_RANGE_ERR_065 : 0|7@1+ (0.0075,0) [0|0.9525] "m" Vector__XXX
 SG_ DET_RANGE_VELOCITY_065 : 0|15@1+ (0.0078125,-128) [-128|127.9921875] "m/s" Vector__XXX
 SG_ DET_RANGE_VELOCITY_ERR_065 : 0|8@1+ (0.003,0) [0|0.765] "m/s" Vector__XXX
 SG_ DET_AZIMUTH_065 : 0|13@1+ (0.0004,-1.5708) [-1.5708|1.5708] "rad" Vector__XXX
 SG_ DET_AZIMUTH_ERR_065 : 0|7@1+ (0.00087267,0) [0|0.11082909] "rad" Vector__XXX
 SG_ DET_ELEVATION_065 : 0|8@1+ (0.00275,-0.34925) [-0.34925|0.34925] "rad" Vector__XXX
 SG_ DET_ELEVATION_ERR_065 : 0|6@1+ (0.00174533,0) [0|0.10995579] "rad" Vector__XXX
 SG_ DET_RCS_065 : 0|8@1+ (0.5,-64) [-64|63.5] "dBsm" Vector__XXX
 SG_ DET_BI_STATIC_FLAG_065 : 0|1@1+ (1,0) [0|1] "" Vector__XXX
 SG_ DET_SUPER_RES_TARGET_065 : 0|1@1+ (1,0) [0|1] "" Vector__XXX
 SG_ DET_SNR_065 : 0|8@1+ (0.35156,0) [0|89.6478] "dB" Vector__XXX
 SG_ DET_EXISTENCE_PROB_065 : 0|6@1+ (1.588,0) [0|100] "%" Vector__XXX
 SG_ DET_HVC_FLAG_065 : 0|1@1+ (1,0) [0|1] "" Vector__XXX
 SG_ DET_CONFD_AZIMUTH_065 : 0|2@1+ (1,0) [0|3] "" Vector__XXX
 SG_ DET_CONFD_ELEVATION_065 : 0|2@1+ (1,0) [0|3] "" Vector__XXX
 SG_ DET_PROB_1STAZHYPO_065 : 0|1@1+ (1,0) [0|1] "" Vector__XXX
 SG_ DET_IDM_065 : 0|1@1+ (1,0) [0|1] "" Vector__XXX
 SG_ DET_MTD_065 : 0|1@1+ (1,0) [0|1] "" Vector__XXX
 SG_ DET_BELOW_RAIN_THOLD_065 : 0|1@1+ (1,0) [0|1] "" Vector__XXX
 SG_ DET_RANGE_066 : 0|15@1+ (0.015625,0) [0|500] "m" Vector__XXX
 SG_ DET_RANGE_ERR_066 : 0|7@1+ (0.0075,0) [0|0.9525] "m" Vector__XXX
 SG_ DET_RANGE_VELOCITY_066 : 0|15@1+ (0.0078125,-128) [-128|127.9921875] "m/s" Vector__XXX
 SG_ DET_RANGE_VELOCITY_ERR_066 : 0|8@1+ (0.003,0) [0|0.765] "m/s" Vector__XXX
 SG_ DET_AZIMUTH_066 : 0|13@1+ (0.0004,-1.5708) [-1.5708|1.5708] "rad" Vector__XXX
 SG_ DET_AZIMUTH_ERR_066 : 0|7@1+ (0.00087267,0) [0|0.11082909] "rad" Vector__XXX
 SG_ DET_ELEVATION_066 : 0|8@1+ (0.00275,-0.34925) [-0.34925|0.34925] "rad" Vector__XXX
 SG_ DET_ELEVATION_ERR_066 : 0|6@1+ (0.00174533,0) [0|0.10995579] "rad" Vector__XXX
 SG_ DET_RCS_066 : 0|8@1+ (0.5,-64) [-64|63.5] "dBsm" Vector__XXX
 SG_ DET_BI_STATIC_FLAG_066 : 0|1@1+ (1,0) [0|1] "" Vector__XXX
 SG_ DET_SUPER_RES_TARGET_066 : 0|1@1+ (1,0) [0|1] "" Vector__XXX
 SG_ DET_SNR_066 : 0|8@1+ (0.35156,0) [0|89.6478] "dB" Vector__XXX
 SG_ DET_EXISTENCE_PROB_066 : 0|6@1+ (1.588,0) [0|100] "%" Vector__XXX
 SG_ DET_HVC_FLAG_066 : 0|1@1+ (1,0) [0|1] "" Vector__XXX
 SG_ DET_CONFD_AZIMUTH_066 : 0|2@1+ (1,0) [0|3] "" Vector__XXX
 SG_ DET_CONFD_ELEVATION_066 : 0|2@1+ (1,0) [0|3] "" Vector__XXX
 SG_ DET_PROB_1STAZHYPO_066 : 0|1@1+ (1,0) [0|1] "" Vector__XXX
 SG_ DET_IDM_066 : 0|1@1+ (1,0) [0|1] "" Vector__XXX
 SG_ DET_MTD_066 : 0|1@1+ (1,0) [0|1] "" Vector__XXX
 SG_ DET_BELOW_RAIN_THOLD_066 : 0|1@1+ (1,0) [0|1] "" Vector__XXX
 SG_ DET_RANGE_067 : 0|15@1+ (0.015625,0) [0|500] "m" Vector__XXX
 SG_ DET_RANGE_ERR_067 : 0|7@1+ (0.0075,0) [0|0.9525] "m" Vector__XXX
 SG_ DET_RANGE_VELOCITY_067 : 0|15@1+ (0.0078125,-128) [-128|127.9921875] "m/s" Vector__XXX
 SG_ DET_RANGE_VELOCITY_ERR_067 : 0|8@1+ (0.003,0) [0|0.765] "m/s" Vector__XXX
 SG_ DET_AZIMUTH_067 : 0|13@1+ (0.0004,-1.5708) [-1.5708|1.5708] "rad" Vector__XXX
 SG_ DET_AZIMUTH_ERR_067 : 0|7@1+ (0.00087267,0) [0|0.11082909] "rad" Vector__XXX
 SG_ DET_ELEVATION_067 : 0|8@1+ (0.00275,-0.34925) [-0.34925|0.34925] "rad" Vector__XXX
 SG_ DET_ELEVATION_ERR_067 : 0|6@1+ (0.00174533,0) [0|0.10995579] "rad" Vector__XXX
 SG_ DET_RCS_067 : 0|8@1+ (0.5,-64) [-64|63.5] "dBsm" Vector__XXX
 SG_ DET_BI_STATIC_FLAG_067 : 0|1@1+ (1,0) [0|1] "" Vector__XXX
 SG_ DET_SUPER_RES_TARGET_067 : 0|1@1+ (1,0) [0|1] "" Vector__XXX
 SG_ DET_SNR_067 : 0|8@1+ (0.35156,0) [0|89.6478] "dB" Vector__XXX
 SG_ DET_EXISTENCE_PROB_067 : 0|6@1+ (1.588,0) [0|100] "%" Vector__XXX
 SG_ DET_HVC_FLAG_067 : 0|1@1+ (1,0) [0|1] "" Vector__XXX
 SG_ DET_CONFD_AZIMUTH_067 : 0|2@1+ (1,0) [0|3] "" Vector__XXX
 SG_ DET_CONFD_ELEVATION_067 : 0|2@1+ (1,0) [0|3] "" Vector__XXX
 SG_ DET_PROB_1STAZHYPO_067 : 0|1@1+ (1,0) [0|1] "" Vector__XXX
 SG_ DET_IDM_067 : 0|1@1+ (1,0) [0|1] "" Vector__XXX
 SG_ DET_MTD_067 : 0|1@1+ (1,0) [0|1] "" Vector__XXX
 SG_ DET_BELOW_RAIN_THOLD_067 : 0|1@1+ (1,0) [0|1] "" Vector__XXX
 SG_ DET_RANGE_068 : 0|15@1+ (0.015625,0) [0|500] "m" Vector__XXX
 SG_ DET_RANGE_ERR_068 : 0|7@1+ (0.0075,0) [0|0.9525] "m" Vector__XXX
 SG_ DET_RANGE_VELOCITY_068 : 0|15@1+ (0.0078125,-128) [-128|127.9921875] "m/s" Vector__XXX
 SG_ DET_RANGE_VELOCITY_ERR_068 : 0|8@1+ (0.003,0) [0|0.765] "m/s" Vector__XXX
 SG_ DET_AZIMUTH_068 : 0|13@1+ (0.0004,-1.5708) [-1.5708|1.5708] "rad" Vector__XXX
 SG_ DET_AZIMUTH_ERR_068 : 0|7@1+ (0.00087267,0) [0|0.11082909] "rad" Vector__XXX
 SG_ DET_ELEVATION_068 : 0|8@1+ (0.00275,-0.34925) [-0.34925|0.34925] "rad" Vector__XXX
 SG_ DET_ELEVATION_ERR_068 : 0|6@1+ (0.00174533,0) [0|0.10995579] "rad" Vector__XXX
 SG_ DET_RCS_068 : 0|8@1+ (0.5,-64) [-64|63.5] "dBsm" Vector__XXX
 SG_ DET_BI_STATIC_FLAG_068 : 0|1@1+ (1,0) [0|1] "" Vector__XXX
 SG_ DET_SUPER_RES_TARGET_068 : 0|1@1+ (1,0) [0|1] "" Vector__XXX
 SG_ DET_SNR_068 : 0|8@1+ (0.35156,0) [0|89.6478] "dB" Vector__XXX
 SG_ DET_EXISTENCE_PROB_068 : 0|6@1+ (1.588,0) [0|100] "%" Vector__XXX
 SG_ DET_HVC_FLAG_068 : 0|1@1+ (1,0) [0|1] "" Vector__XXX
 SG_ DET_CONFD_AZIMUTH_068 : 0|2@1+ (1,0) [0|3] "" Vector__XXX
 SG_ DET_CONFD_ELEVATION_068 : 0|2@1+ (1,0) [0|3] "" Vector__XXX
 SG_ DET_MH_SCAN_INDEX_4LSB_065_068 : 0|4@1+ (1,0) [0|15] "" Vector__XXX
 SG_ DET_MH_CYCLE_COUNTER_065_068 : 0|8@1+ (1,0) [0|255] "" Vector__XXX
 SG_ DET_MH_CRC16_065_068 : 0|16@1+ (1,0) [0|65535] "" Vector__XXX
 SG_ DET_PROB_1STAZHYPO_068 : 0|1@1+ (1,0) [0|1] "" Vector__XXX
 SG_ DET_IDM_068 : 0|1@1+ (1,0) [0|1] "" Vector__XXX
 SG_ DET_MTD_068 : 0|1@1+ (1,0) [0|1] "" Vector__XXX
 SG_ DET_BELOW_RAIN_THOLD_068 : 0|1@1+ (1,0) [0|1] "" Vector__XXX
 SG_ DET_RANGE_069 : 0|15@1+ (0.015625,0) [0|500] "m" Vector__XXX
 SG_ DET_RANGE_ERR_069 : 0|7@1+ (0.0075,0) [0|0.9525] "m" Vector__XXX
 SG_ DET_RANGE_VELOCITY_069 : 0|15@1+ (0.0078125,-128) [-128|127.9921875] "m/s" Vector__XXX
 SG_ DET_RANGE_VELOCITY_ERR_069 : 0|8@1+ (0.003,0) [0|0.765] "m/s" Vector__XXX
 SG_ DET_AZIMUTH_069 : 0|13@1+ (0.0004,-1.5708) [-1.5708|1.5708] "rad" Vector__XXX
 SG_ DET_AZIMUTH_ERR_069 : 0|7@1+ (0.00087267,0) [0|0.11082909] "rad" Vector__XXX
 SG_ DET_ELEVATION_069 : 0|8@1+ (0.00275,-0.34925) [-0.34925|0.34925] "rad" Vector__XXX
 SG_ DET_ELEVATION_ERR_069 : 0|6@1+ (0.00174533,0) [0|0.10995579] "rad" Vector__XXX
 SG_ DET_RCS_069 : 0|8@1+ (0.5,-64) [-64|63.5] "dBsm" Vector__XXX
 SG_ DET_BI_STATIC_FLAG_069 : 0|1@1+ (1,0) [0|1] "" Vector__XXX
 SG_ DET_SUPER_RES_TARGET_069 : 0|1@1+ (1,0) [0|1] "" Vector__XXX
 SG_ DET_SNR_069 : 0|8@1+ (0.35156,0) [0|89.6478] "dB" Vector__XXX
 SG_ DET_EXISTENCE_PROB_069 : 0|6@1+ (1.588,0) [0|100] "%" Vector__XXX
 SG_ DET_HVC_FLAG_069 : 0|1@1+ (1,0) [0|1] "" Vector__XXX
 SG_ DET_CONFD_AZIMUTH_069 : 0|2@1+ (1,0) [0|3] "" Vector__XXX
 SG_ DET_CONFD_ELEVATION_069 : 0|2@1+ (1,0) [0|3] "" Vector__XXX
 SG_ DET_PROB_1STAZHYPO_069 : 0|1@1+ (1,0) [0|1] "" Vector__XXX
 SG_ DET_IDM_069 : 0|1@1+ (1,0) [0|1] "" Vector__XXX
 SG_ DET_MTD_069 : 0|1@1+ (1,0) [0|1] "" Vector__XXX
 SG_ DET_BELOW_RAIN_THOLD_069 : 0|1@1+ (1,0) [0|1] "" Vector__XXX
 SG_ DET_RANGE_070 : 0|15@1+ (0.015625,0) [0|500] "m" Vector__XXX
 SG_ DET_RANGE_ERR_070 : 0|7@1+ (0.0075,0) [0|0.9525] "m" Vector__XXX
 SG_ DET_RANGE_VELOCITY_070 : 0|15@1+ (0.0078125,-128) [-128|127.9921875] "m/s" Vector__XXX
 SG_ DET_RANGE_VELOCITY_ERR_070 : 0|8@1+ (0.003,0) [0|0.765] "m/s" Vector__XXX
 SG_ DET_AZIMUTH_070 : 0|13@1+ (0.0004,-1.5708) [-1.5708|1.5708] "rad" Vector__XXX
 SG_ DET_AZIMUTH_ERR_070 : 0|7@1+ (0.00087267,0) [0|0.11082909] "rad" Vector__XXX
 SG_ DET_ELEVATION_070 : 0|8@1+ (0.00275,-0.34925) [-0.34925|0.34925] "rad" Vector__XXX
 SG_ DET_ELEVATION_ERR_070 : 0|6@1+ (0.00174533,0) [0|0.10995579] "rad" Vector__XXX
 SG_ DET_RCS_070 : 0|8@1+ (0.5,-64) [-64|63.5] "dBsm" Vector__XXX
 SG_ DET_BI_STATIC_FLAG_070 : 0|1@1+ (1,0) [0|1] "" Vector__XXX
 SG_ DET_SUPER_RES_TARGET_070 : 0|1@1+ (1,0) [0|1] "" Vector__XXX
 SG_ DET_SNR_070 : 0|8@1+ (0.35156,0) [0|89.6478] "dB" Vector__XXX
 SG_ DET_EXISTENCE_PROB_070 : 0|6@1+ (1.588,0) [0|100] "%" Vector__XXX
 SG_ DET_HVC_FLAG_070 : 0|1@1+ (1,0) [0|1] "" Vector__XXX
 SG_ DET_CONFD_AZIMUTH_070 : 0|2@1+ (1,0) [0|3] "" Vector__XXX
 SG_ DET_CONFD_ELEVATION_070 : 0|2@1+ (1,0) [0|3] "" Vector__XXX
 SG_ DET_PROB_1STAZHYPO_070 : 0|1@1+ (1,0) [0|1] "" Vector__XXX
 SG_ DET_IDM_070 : 0|1@1+ (1,0) [0|1] "" Vector__XXX
 SG_ DET_MTD_070 : 0|1@1+ (1,0) [0|1] "" Vector__XXX
 SG_ DET_BELOW_RAIN_THOLD_070 : 0|1@1+ (1,0) [0|1] "" Vector__XXX
 SG_ DET_RANGE_071 : 0|15@1+ (0.015625,0) [0|500] "m" Vector__XXX
 SG_ DET_RANGE_ERR_071 : 0|7@1+ (0.0075,0) [0|0.9525] "m" Vector__XXX
 SG_ DET_RANGE_VELOCITY_071 : 0|15@1+ (0.0078125,-128) [-128|127.9921875] "m/s" Vector__XXX
 SG_ DET_RANGE_VELOCITY_ERR_071 : 0|8@1+ (0.003,0) [0|0.765] "m/s" Vector__XXX
 SG_ DET_AZIMUTH_071 : 0|13@1+ (0.0004,-1.5708) [-1.5708|1.5708] "rad" Vector__XXX
 SG_ DET_AZIMUTH_ERR_071 : 0|7@1+ (0.00087267,0) [0|0.11082909] "rad" Vector__XXX
 SG_ DET_ELEVATION_071 : 0|8@1+ (0.00275,-0.34925) [-0.34925|0.34925] "rad" Vector__XXX
 SG_ DET_ELEVATION_ERR_071 : 0|6@1+ (0.00174533,0) [0|0.10995579] "rad" Vector__XXX
 SG_ DET_RCS_071 : 0|8@1+ (0.5,-64) [-64|63.5] "dBsm" Vector__XXX
 SG_ DET_BI_STATIC_FLAG_071 : 0|1@1+ (1,0) [0|1] "" Vector__XXX
 SG_ DET_SUPER_RES_TARGET_071 : 0|1@1+ (1,0) [0|1] "" Vector__XXX
 SG_ DET_SNR_071 : 0|8@1+ (0.35156,0) [0|89.6478] "dB" Vector__XXX
 SG_ DET_EXISTENCE_PROB_071 : 0|6@1+ (1.588,0) [0|100] "%" Vector__XXX
 SG_ DET_HVC_FLAG_071 : 0|1@1+ (1,0) [0|1] "" Vector__XXX
 SG_ DET_CONFD_AZIMUTH_071 : 0|2@1+ (1,0) [0|3] "" Vector__XXX
 SG_ DET_CONFD_ELEVATION_071 : 0|2@1+ (1,0) [0|3] "" Vector__XXX
 SG_ DET_PROB_1STAZHYPO_071 : 0|1@1+ (1,0) [0|1] "" Vector__XXX
 SG_ DET_IDM_071 : 0|1@1+ (1,0) [0|1] "" Vector__XXX
 SG_ DET_MTD_071 : 0|1@1+ (1,0) [0|1] "" Vector__XXX
 SG_ DET_BELOW_RAIN_THOLD_071 : 0|1@1+ (1,0) [0|1] "" Vector__XXX
 SG_ DET_RANGE_072 : 0|15@1+ (0.015625,0) [0|500] "m" Vector__XXX
 SG_ DET_RANGE_ERR_072 : 0|7@1+ (0.0075,0) [0|0.9525] "m" Vector__XXX
 SG_ DET_RANGE_VELOCITY_072 : 0|15@1+ (0.0078125,-128) [-128|127.9921875] "m/s" Vector__XXX
 SG_ DET_RANGE_VELOCITY_ERR_072 : 0|8@1+ (0.003,0) [0|0.765] "m/s" Vector__XXX
 SG_ DET_AZIMUTH_072 : 0|13@1+ (0.0004,-1.5708) [-1.5708|1.5708] "rad" Vector__XXX
 SG_ DET_AZIMUTH_ERR_072 : 0|7@1+ (0.00087267,0) [0|0.11082909] "rad" Vector__XXX
 SG_ DET_ELEVATION_072 : 0|8@1+ (0.00275,-0.34925) [-0.34925|0.34925] "rad" Vector__XXX
 SG_ DET_ELEVATION_ERR_072 : 0|6@1+ (0.00174533,0) [0|0.10995579] "rad" Vector__XXX
 SG_ DET_RCS_072 : 0|8@1+ (0.5,-64) [-64|63.5] "dBsm" Vector__XXX
 SG_ DET_BI_STATIC_FLAG_072 : 0|1@1+ (1,0) [0|1] "" Vector__XXX
 SG_ DET_SUPER_RES_TARGET_072 : 0|1@1+ (1,0) [0|1] "" Vector__XXX
 SG_ DET_SNR_072 : 0|8@1+ (0.35156,0) [0|89.6478] "dB" Vector__XXX
 SG_ DET_EXISTENCE_PROB_072 : 0|6@1+ (1.588,0) [0|100] "%" Vector__XXX
 SG_ DET_HVC_FLAG_072 : 0|1@1+ (1,0) [0|1] "" Vector__XXX
 SG_ DET_CONFD_AZIMUTH_072 : 0|2@1+ (1,0) [0|3] "" Vector__XXX
 SG_ DET_CONFD_ELEVATION_072 : 0|2@1+ (1,0) [0|3] "" Vector__XXX
 SG_ DET_MH_SCAN_INDEX_4LSB_069_072 : 0|4@1+ (1,0) [0|15] "" Vector__XXX
 SG_ DET_MH_CYCLE_COUNTER_069_072 : 0|8@1+ (1,0) [0|255] "" Vector__XXX
 SG_ DET_MH_CRC16_069_072 : 0|16@1+ (1,0) [0|65535] "" Vector__XXX
 SG_ DET_PROB_1STAZHYPO_072 : 0|1@1+ (1,0) [0|1] "" Vector__XXX
 SG_ DET_IDM_072 : 0|1@1+ (1,0) [0|1] "" Vector__XXX
 SG_ DET_MTD_072 : 0|1@1+ (1,0) [0|1] "" Vector__XXX
 SG_ DET_BELOW_RAIN_THOLD_072 : 0|1@1+ (1,0) [0|1] "" Vector__XXX
 SG_ DET_RANGE_073 : 0|15@1+ (0.015625,0) [0|500] "m" Vector__XXX
 SG_ DET_RANGE_ERR_073 : 0|7@1+ (0.0075,0) [0|0.9525] "m" Vector__XXX
 SG_ DET_RANGE_VELOCITY_073 : 0|15@1+ (0.0078125,-128) [-128|127.9921875] "m/s" Vector__XXX
 SG_ DET_RANGE_VELOCITY_ERR_073 : 0|8@1+ (0.003,0) [0|0.765] "m/s" Vector__XXX
 SG_ DET_AZIMUTH_073 : 0|13@1+ (0.0004,-1.5708) [-1.5708|1.5708] "rad" Vector__XXX
 SG_ DET_AZIMUTH_ERR_073 : 0|7@1+ (0.00087267,0) [0|0.11082909] "rad" Vector__XXX
 SG_ DET_ELEVATION_073 : 0|8@1+ (0.00275,-0.34925) [-0.34925|0.34925] "rad" Vector__XXX
 SG_ DET_ELEVATION_ERR_073 : 0|6@1+ (0.00174533,0) [0|0.10995579] "rad" Vector__XXX
 SG_ DET_RCS_073 : 0|8@1+ (0.5,-64) [-64|63.5] "dBsm" Vector__XXX
 SG_ DET_BI_STATIC_FLAG_073 : 0|1@1+ (1,0) [0|1] "" Vector__XXX
 SG_ DET_SUPER_RES_TARGET_073 : 0|1@1+ (1,0) [0|1] "" Vector__XXX
 SG_ DET_SNR_073 : 0|8@1+ (0.35156,0) [0|89.6478] "dB" Vector__XXX
 SG_ DET_EXISTENCE_PROB_073 : 0|6@1+ (1.588,0) [0|100] "%" Vector__XXX
 SG_ DET_HVC_FLAG_073 : 0|1@1+ (1,0) [0|1] "" Vector__XXX
 SG_ DET_CONFD_AZIMUTH_073 : 0|2@1+ (1,0) [0|3] "" Vector__XXX
 SG_ DET_CONFD_ELEVATION_073 : 0|2@1+ (1,0) [0|3] "" Vector__XXX
 SG_ DET_PROB_1STAZHYPO_073 : 0|1@1+ (1,0) [0|1] "" Vector__XXX
 SG_ DET_IDM_073 : 0|1@1+ (1,0) [0|1] "" Vector__XXX
 SG_ DET_MTD_073 : 0|1@1+ (1,0) [0|1] "" Vector__XXX
 SG_ DET_BELOW_RAIN_THOLD_073 : 0|1@1+ (1,0) [0|1] "" Vector__XXX
 SG_ DET_RANGE_074 : 0|15@1+ (0.015625,0) [0|500] "m" Vector__XXX
 SG_ DET_RANGE_ERR_074 : 0|7@1+ (0.0075,0) [0|0.9525] "m" Vector__XXX
 SG_ DET_RANGE_VELOCITY_074 : 0|15@1+ (0.0078125,-128) [-128|127.9921875] "m/s" Vector__XXX
 SG_ DET_RANGE_VELOCITY_ERR_074 : 0|8@1+ (0.003,0) [0|0.765] "m/s" Vector__XXX
 SG_ DET_AZIMUTH_074 : 0|13@1+ (0.0004,-1.5708) [-1.5708|1.5708] "rad" Vector__XXX
 SG_ DET_AZIMUTH_ERR_074 : 0|7@1+ (0.00087267,0) [0|0.11082909] "rad" Vector__XXX
 SG_ DET_ELEVATION_074 : 0|8@1+ (0.00275,-0.34925) [-0.34925|0.34925] "rad" Vector__XXX
 SG_ DET_ELEVATION_ERR_074 : 0|6@1+ (0.00174533,0) [0|0.10995579] "rad" Vector__XXX
 SG_ DET_RCS_074 : 0|8@1+ (0.5,-64) [-64|63.5] "dBsm" Vector__XXX
 SG_ DET_BI_STATIC_FLAG_074 : 0|1@1+ (1,0) [0|1] "" Vector__XXX
 SG_ DET_SUPER_RES_TARGET_074 : 0|1@1+ (1,0) [0|1] "" Vector__XXX
 SG_ DET_SNR_074 : 0|8@1+ (0.35156,0) [0|89.6478] "dB" Vector__XXX
 SG_ DET_EXISTENCE_PROB_074 : 0|6@1+ (1.588,0) [0|100] "%" Vector__XXX
 SG_ DET_HVC_FLAG_074 : 0|1@1+ (1,0) [0|1] "" Vector__XXX
 SG_ DET_CONFD_AZIMUTH_074 : 0|2@1+ (1,0) [0|3] "" Vector__XXX
 SG_ DET_CONFD_ELEVATION_074 : 0|2@1+ (1,0) [0|3] "" Vector__XXX
 SG_ DET_PROB_1STAZHYPO_074 : 0|1@1+ (1,0) [0|1] "" Vector__XXX
 SG_ DET_IDM_074 : 0|1@1+ (1,0) [0|1] "" Vector__XXX
 SG_ DET_MTD_074 : 0|1@1+ (1,0) [0|1] "" Vector__XXX
 SG_ DET_BELOW_RAIN_THOLD_074 : 0|1@1+ (1,0) [0|1] "" Vector__XXX
 SG_ DET_RANGE_075 : 0|15@1+ (0.015625,0) [0|500] "m" Vector__XXX
 SG_ DET_RANGE_ERR_075 : 0|7@1+ (0.0075,0) [0|0.9525] "m" Vector__XXX
 SG_ DET_RANGE_VELOCITY_075 : 0|15@1+ (0.0078125,-128) [-128|127.9921875] "m/s" Vector__XXX
 SG_ DET_RANGE_VELOCITY_ERR_075 : 0|8@1+ (0.003,0) [0|0.765] "m/s" Vector__XXX
 SG_ DET_AZIMUTH_075 : 0|13@1+ (0.0004,-1.5708) [-1.5708|1.5708] "rad" Vector__XXX
 SG_ DET_AZIMUTH_ERR_075 : 0|7@1+ (0.00087267,0) [0|0.11082909] "rad" Vector__XXX
 SG_ DET_ELEVATION_075 : 0|8@1+ (0.00275,-0.34925) [-0.34925|0.34925] "rad" Vector__XXX
 SG_ DET_ELEVATION_ERR_075 : 0|6@1+ (0.00174533,0) [0|0.10995579] "rad" Vector__XXX
 SG_ DET_RCS_075 : 0|8@1+ (0.5,-64) [-64|63.5] "dBsm" Vector__XXX
 SG_ DET_BI_STATIC_FLAG_075 : 0|1@1+ (1,0) [0|1] "" Vector__XXX
 SG_ DET_SUPER_RES_TARGET_075 : 0|1@1+ (1,0) [0|1] "" Vector__XXX
 SG_ DET_SNR_075 : 0|8@1+ (0.35156,0) [0|89.6478] "dB" Vector__XXX
 SG_ DET_EXISTENCE_PROB_075 : 0|6@1+ (1.588,0) [0|100] "%" Vector__XXX
 SG_ DET_HVC_FLAG_075 : 0|1@1+ (1,0) [0|1] "" Vector__XXX
 SG_ DET_CONFD_AZIMUTH_075 : 0|2@1+ (1,0) [0|3] "" Vector__XXX
 SG_ DET_CONFD_ELEVATION_075 : 0|2@1+ (1,0) [0|3] "" Vector__XXX
 SG_ DET_PROB_1STAZHYPO_075 : 0|1@1+ (1,0) [0|1] "" Vector__XXX
 SG_ DET_IDM_075 : 0|1@1+ (1,0) [0|1] "" Vector__XXX
 SG_ DET_MTD_075 : 0|1@1+ (1,0) [0|1] "" Vector__XXX
 SG_ DET_BELOW_RAIN_THOLD_075 : 0|1@1+ (1,0) [0|1] "" Vector__XXX
 SG_ DET_RANGE_076 : 0|15@1+ (0.015625,0) [0|500] "m" Vector__XXX
 SG_ DET_RANGE_ERR_076 : 0|7@1+ (0.0075,0) [0|0.9525] "m" Vector__XXX
 SG_ DET_RANGE_VELOCITY_076 : 0|15@1+ (0.0078125,-128) [-128|127.9921875] "m/s" Vector__XXX
 SG_ DET_RANGE_VELOCITY_ERR_076 : 0|8@1+ (0.003,0) [0|0.765] "m/s" Vector__XXX
 SG_ DET_AZIMUTH_076 : 0|13@1+ (0.0004,-1.5708) [-1.5708|1.5708] "rad" Vector__XXX
 SG_ DET_AZIMUTH_ERR_076 : 0|7@1+ (0.00087267,0) [0|0.11082909] "rad" Vector__XXX
 SG_ DET_ELEVATION_076 : 0|8@1+ (0.00275,-0.34925) [-0.34925|0.34925] "rad" Vector__XXX
 SG_ DET_ELEVATION_ERR_076 : 0|6@1+ (0.00174533,0) [0|0.10995579] "rad" Vector__XXX
 SG_ DET_RCS_076 : 0|8@1+ (0.5,-64) [-64|63.5] "dBsm" Vector__XXX
 SG_ DET_BI_STATIC_FLAG_076 : 0|1@1+ (1,0) [0|1] "" Vector__XXX
 SG_ DET_SUPER_RES_TARGET_076 : 0|1@1+ (1,0) [0|1] "" Vector__XXX
 SG_ DET_SNR_076 : 0|8@1+ (0.35156,0) [0|89.6478] "dB" Vector__XXX
 SG_ DET_EXISTENCE_PROB_076 : 0|6@1+ (1.588,0) [0|100] "%" Vector__XXX
 SG_ DET_HVC_FLAG_076 : 0|1@1+ (1,0) [0|1] "" Vector__XXX
 SG_ DET_CONFD_AZIMUTH_076 : 0|2@1+ (1,0) [0|3] "" Vector__XXX
 SG_ DET_CONFD_ELEVATION_076 : 0|2@1+ (1,0) [0|3] "" Vector__XXX
 SG_ DET_MH_SCAN_INDEX_4LSB_073_076 : 0|4@1+ (1,0) [0|15] "" Vector__XXX
 SG_ DET_MH_CYCLE_COUNTER_073_076 : 0|8@1+ (1,0) [0|255] "" Vector__XXX
 SG_ DET_MH_CRC16_073_076 : 0|16@1+ (1,0) [0|65535] "" Vector__XXX
 SG_ DET_PROB_1STAZHYPO_076 : 0|1@1+ (1,0) [0|1] "" Vector__XXX
 SG_ DET_IDM_076 : 0|1@1+ (1,0) [0|1] "" Vector__XXX
 SG_ DET_MTD_076 : 0|1@1+ (1,0) [0|1] "" Vector__XXX
 SG_ DET_BELOW_RAIN_THOLD_076 : 0|1@1+ (1,0) [0|1] "" Vector__XXX
 SG_ DET_RANGE_077 : 0|15@1+ (0.015625,0) [0|500] "m" Vector__XXX
 SG_ DET_RANGE_ERR_077 : 0|7@1+ (0.0075,0) [0|0.9525] "m" Vector__XXX
 SG_ DET_RANGE_VELOCITY_077 : 0|15@1+ (0.0078125,-128) [-128|127.9921875] "m/s" Vector__XXX
 SG_ DET_RANGE_VELOCITY_ERR_077 : 0|8@1+ (0.003,0) [0|0.765] "m/s" Vector__XXX
 SG_ DET_AZIMUTH_077 : 0|13@1+ (0.0004,-1.5708) [-1.5708|1.5708] "rad" Vector__XXX
 SG_ DET_AZIMUTH_ERR_077 : 0|7@1+ (0.00087267,0) [0|0.11082909] "rad" Vector__XXX
 SG_ DET_ELEVATION_077 : 0|8@1+ (0.00275,-0.34925) [-0.34925|0.34925] "rad" Vector__XXX
 SG_ DET_ELEVATION_ERR_077 : 0|6@1+ (0.00174533,0) [0|0.10995579] "rad" Vector__XXX
 SG_ DET_RCS_077 : 0|8@1+ (0.5,-64) [-64|63.5] "dBsm" Vector__XXX
 SG_ DET_BI_STATIC_FLAG_077 : 0|1@1+ (1,0) [0|1] "" Vector__XXX
 SG_ DET_SUPER_RES_TARGET_077 : 0|1@1+ (1,0) [0|1] "" Vector__XXX
 SG_ DET_SNR_077 : 0|8@1+ (0.35156,0) [0|89.6478] "dB" Vector__XXX
 SG_ DET_EXISTENCE_PROB_077 : 0|6@1+ (1.588,0) [0|100] "%" Vector__XXX
 SG_ DET_HVC_FLAG_077 : 0|1@1+ (1,0) [0|1] "" Vector__XXX
 SG_ DET_CONFD_AZIMUTH_077 : 0|2@1+ (1,0) [0|3] "" Vector__XXX
 SG_ DET_CONFD_ELEVATION_077 : 0|2@1+ (1,0) [0|3] "" Vector__XXX
 SG_ DET_PROB_1STAZHYPO_077 : 0|1@1+ (1,0) [0|1] "" Vector__XXX
 SG_ DET_IDM_077 : 0|1@1+ (1,0) [0|1] "" Vector__XXX
 SG_ DET_MTD_077 : 0|1@1+ (1,0) [0|1] "" Vector__XXX
 SG_ DET_BELOW_RAIN_THOLD_077 : 0|1@1+ (1,0) [0|1] "" Vector__XXX
 SG_ DET_RANGE_078 : 0|15@1+ (0.015625,0) [0|500] "m" Vector__XXX
 SG_ DET_RANGE_ERR_078 : 0|7@1+ (0.0075,0) [0|0.9525] "m" Vector__XXX
 SG_ DET_RANGE_VELOCITY_078 : 0|15@1+ (0.0078125,-128) [-128|127.9921875] "m/s" Vector__XXX
 SG_ DET_RANGE_VELOCITY_ERR_078 : 0|8@1+ (0.003,0) [0|0.765] "m/s" Vector__XXX
 SG_ DET_AZIMUTH_078 : 0|13@1+ (0.0004,-1.5708) [-1.5708|1.5708] "rad" Vector__XXX
 SG_ DET_AZIMUTH_ERR_078 : 0|7@1+ (0.00087267,0) [0|0.11082909] "rad" Vector__XXX
 SG_ DET_ELEVATION_078 : 0|8@1+ (0.00275,-0.34925) [-0.34925|0.34925] "rad" Vector__XXX
 SG_ DET_ELEVATION_ERR_078 : 0|6@1+ (0.00174533,0) [0|0.10995579] "rad" Vector__XXX
 SG_ DET_RCS_078 : 0|8@1+ (0.5,-64) [-64|63.5] "dBsm" Vector__XXX
 SG_ DET_BI_STATIC_FLAG_078 : 0|1@1+ (1,0) [0|1] "" Vector__XXX
 SG_ DET_SUPER_RES_TARGET_078 : 0|1@1+ (1,0) [0|1] "" Vector__XXX
 SG_ DET_SNR_078 : 0|8@1+ (0.35156,0) [0|89.6478] "dB" Vector__XXX
 SG_ DET_EXISTENCE_PROB_078 : 0|6@1+ (1.588,0) [0|100] "%" Vector__XXX
 SG_ DET_HVC_FLAG_078 : 0|1@1+ (1,0) [0|1] "" Vector__XXX
 SG_ DET_CONFD_AZIMUTH_078 : 0|2@1+ (1,0) [0|3] "" Vector__XXX
 SG_ DET_CONFD_ELEVATION_078 : 0|2@1+ (1,0) [0|3] "" Vector__XXX
 SG_ DET_PROB_1STAZHYPO_078 : 0|1@1+ (1,0) [0|1] "" Vector__XXX
 SG_ DET_IDM_078 : 0|1@1+ (1,0) [0|1] "" Vector__XXX
 SG_ DET_MTD_078 : 0|1@1+ (1,0) [0|1] "" Vector__XXX
 SG_ DET_BELOW_RAIN_THOLD_078 : 0|1@1+ (1,0) [0|1] "" Vector__XXX
 SG_ DET_RANGE_079 : 0|15@1+ (0.015625,0) [0|500] "m" Vector__XXX
 SG_ DET_RANGE_ERR_079 : 0|7@1+ (0.0075,0) [0|0.9525] "m" Vector__XXX
 SG_ DET_RANGE_VELOCITY_079 : 0|15@1+ (0.0078125,-128) [-128|127.9921875] "m/s" Vector__XXX
 SG_ DET_RANGE_VELOCITY_ERR_079 : 0|8@1+ (0.003,0) [0|0.765] "m/s" Vector__XXX
 SG_ DET_AZIMUTH_079 : 0|13@1+ (0.0004,-1.5708) [-1.5708|1.5708] "rad" Vector__XXX
 SG_ DET_AZIMUTH_ERR_079 : 0|7@1+ (0.00087267,0) [0|0.11082909] "rad" Vector__XXX
 SG_ DET_ELEVATION_079 : 0|8@1+ (0.00275,-0.34925) [-0.34925|0.34925] "rad" Vector__XXX
 SG_ DET_ELEVATION_ERR_079 : 0|6@1+ (0.00174533,0) [0|0.10995579] "rad" Vector__XXX
 SG_ DET_RCS_079 : 0|8@1+ (0.5,-64) [-64|63.5] "dBsm" Vector__XXX
 SG_ DET_BI_STATIC_FLAG_079 : 0|1@1+ (1,0) [0|1] "" Vector__XXX
 SG_ DET_SUPER_RES_TARGET_079 : 0|1@1+ (1,0) [0|1] "" Vector__XXX
 SG_ DET_SNR_079 : 0|8@1+ (0.35156,0) [0|89.6478] "dB" Vector__XXX
 SG_ DET_EXISTENCE_PROB_079 : 0|6@1+ (1.588,0) [0|100] "%" Vector__XXX
 SG_ DET_HVC_FLAG_079 : 0|1@1+ (1,0) [0|1] "" Vector__XXX
 SG_ DET_CONFD_AZIMUTH_079 : 0|2@1+ (1,0) [0|3] "" Vector__XXX
 SG_ DET_CONFD_ELEVATION_079 : 0|2@1+ (1,0) [0|3] "" Vector__XXX
 SG_ DET_PROB_1STAZHYPO_079 : 0|1@1+ (1,0) [0|1] "" Vector__XXX
 SG_ DET_IDM_079 : 0|1@1+ (1,0) [0|1] "" Vector__XXX
 SG_ DET_MTD_079 : 0|1@1+ (1,0) [0|1] "" Vector__XXX
 SG_ DET_BELOW_RAIN_THOLD_079 : 0|1@1+ (1,0) [0|1] "" Vector__XXX
 SG_ DET_RANGE_080 : 0|15@1+ (0.015625,0) [0|500] "m" Vector__XXX
 SG_ DET_RANGE_ERR_080 : 0|7@1+ (0.0075,0) [0|0.9525] "m" Vector__XXX
 SG_ DET_RANGE_VELOCITY_080 : 0|15@1+ (0.0078125,-128) [-128|127.9921875] "m/s" Vector__XXX
 SG_ DET_RANGE_VELOCITY_ERR_080 : 0|8@1+ (0.003,0) [0|0.765] "m/s" Vector__XXX
 SG_ DET_AZIMUTH_080 : 0|13@1+ (0.0004,-1.5708) [-1.5708|1.5708] "rad" Vector__XXX
 SG_ DET_AZIMUTH_ERR_080 : 0|7@1+ (0.00087267,0) [0|0.11082909] "rad" Vector__XXX
 SG_ DET_ELEVATION_080 : 0|8@1+ (0.00275,-0.34925) [-0.34925|0.34925] "rad" Vector__XXX
 SG_ DET_ELEVATION_ERR_080 : 0|6@1+ (0.00174533,0) [0|0.10995579] "rad" Vector__XXX
 SG_ DET_RCS_080 : 0|8@1+ (0.5,-64) [-64|63.5] "dBsm" Vector__XXX
 SG_ DET_BI_STATIC_FLAG_080 : 0|1@1+ (1,0) [0|1] "" Vector__XXX
 SG_ DET_SUPER_RES_TARGET_080 : 0|1@1+ (1,0) [0|1] "" Vector__XXX
 SG_ DET_SNR_080 : 0|8@1+ (0.35156,0) [0|89.6478] "dB" Vector__XXX
 SG_ DET_EXISTENCE_PROB_080 : 0|6@1+ (1.588,0) [0|100] "%" Vector__XXX
 SG_ DET_HVC_FLAG_080 : 0|1@1+ (1,0) [0|1] "" Vector__XXX
 SG_ DET_CONFD_AZIMUTH_080 : 0|2@1+ (1,0) [0|3] "" Vector__XXX
 SG_ DET_CONFD_ELEVATION_080 : 0|2@1+ (1,0) [0|3] "" Vector__XXX
 SG_ DET_MH_SCAN_INDEX_4LSB_077_080 : 0|4@1+ (1,0) [0|15] "" Vector__XXX
 SG_ DET_MH_CYCLE_COUNTER_077_080 : 0|8@1+ (1,0) [0|255] "" Vector__XXX
 SG_ DET_MH_CRC16_077_080 : 0|16@1+ (1,0) [0|65535] "" Vector__XXX
 SG_ DET_PROB_1STAZHYPO_080 : 0|1@1+ (1,0) [0|1] "" Vector__XXX
 SG_ DET_IDM_080 : 0|1@1+ (1,0) [0|1] "" Vector__XXX
 SG_ DET_MTD_080 : 0|1@1+ (1,0) [0|1] "" Vector__XXX
 SG_ DET_BELOW_RAIN_THOLD_080 : 0|1@1+ (1,0) [0|1] "" Vector__XXX
 SG_ DET_RANGE_081 : 0|15@1+ (0.015625,0) [0|500] "m" Vector__XXX
 SG_ DET_RANGE_ERR_081 : 0|7@1+ (0.0075,0) [0|0.9525] "m" Vector__XXX
 SG_ DET_RANGE_VELOCITY_081 : 0|15@1+ (0.0078125,-128) [-128|127.9921875] "m/s" Vector__XXX
 SG_ DET_RANGE_VELOCITY_ERR_081 : 0|8@1+ (0.003,0) [0|0.765] "m/s" Vector__XXX
 SG_ DET_AZIMUTH_081 : 0|13@1+ (0.0004,-1.5708) [-1.5708|1.5708] "rad" Vector__XXX
 SG_ DET_AZIMUTH_ERR_081 : 0|7@1+ (0.00087267,0) [0|0.11082909] "rad" Vector__XXX
 SG_ DET_ELEVATION_081 : 0|8@1+ (0.00275,-0.34925) [-0.34925|0.34925] "rad" Vector__XXX
 SG_ DET_ELEVATION_ERR_081 : 0|6@1+ (0.00174533,0) [0|0.10995579] "rad" Vector__XXX
 SG_ DET_RCS_081 : 0|8@1+ (0.5,-64) [-64|63.5] "dBsm" Vector__XXX
 SG_ DET_BI_STATIC_FLAG_081 : 0|1@1+ (1,0) [0|1] "" Vector__XXX
 SG_ DET_SUPER_RES_TARGET_081 : 0|1@1+ (1,0) [0|1] "" Vector__XXX
 SG_ DET_SNR_081 : 0|8@1+ (0.35156,0) [0|89.6478] "dB" Vector__XXX
 SG_ DET_EXISTENCE_PROB_081 : 0|6@1+ (1.588,0) [0|100] "%" Vector__XXX
 SG_ DET_HVC_FLAG_081 : 0|1@1+ (1,0) [0|1] "" Vector__XXX
 SG_ DET_CONFD_AZIMUTH_081 : 0|2@1+ (1,0) [0|3] "" Vector__XXX
 SG_ DET_CONFD_ELEVATION_081 : 0|2@1+ (1,0) [0|3] "" Vector__XXX
 SG_ DET_PROB_1STAZHYPO_081 : 0|1@1+ (1,0) [0|1] "" Vector__XXX
 SG_ DET_IDM_081 : 0|1@1+ (1,0) [0|1] "" Vector__XXX
 SG_ DET_MTD_081 : 0|1@1+ (1,0) [0|1] "" Vector__XXX
 SG_ DET_BELOW_RAIN_THOLD_081 : 0|1@1+ (1,0) [0|1] "" Vector__XXX
 SG_ DET_RANGE_082 : 0|15@1+ (0.015625,0) [0|500] "m" Vector__XXX
 SG_ DET_RANGE_ERR_082 : 0|7@1+ (0.0075,0) [0|0.9525] "m" Vector__XXX
 SG_ DET_RANGE_VELOCITY_082 : 0|15@1+ (0.0078125,-128) [-128|127.9921875] "m/s" Vector__XXX
 SG_ DET_RANGE_VELOCITY_ERR_082 : 0|8@1+ (0.003,0) [0|0.765] "m/s" Vector__XXX
 SG_ DET_AZIMUTH_082 : 0|13@1+ (0.0004,-1.5708) [-1.5708|1.5708] "rad" Vector__XXX
 SG_ DET_AZIMUTH_ERR_082 : 0|7@1+ (0.00087267,0) [0|0.11082909] "rad" Vector__XXX
 SG_ DET_ELEVATION_082 : 0|8@1+ (0.00275,-0.34925) [-0.34925|0.34925] "rad" Vector__XXX
 SG_ DET_ELEVATION_ERR_082 : 0|6@1+ (0.00174533,0) [0|0.10995579] "rad" Vector__XXX
 SG_ DET_RCS_082 : 0|8@1+ (0.5,-64) [-64|63.5] "dBsm" Vector__XXX
 SG_ DET_BI_STATIC_FLAG_082 : 0|1@1+ (1,0) [0|1] "" Vector__XXX
 SG_ DET_SUPER_RES_TARGET_082 : 0|1@1+ (1,0) [0|1] "" Vector__XXX
 SG_ DET_SNR_082 : 0|8@1+ (0.35156,0) [0|89.6478] "dB" Vector__XXX
 SG_ DET_EXISTENCE_PROB_082 : 0|6@1+ (1.588,0) [0|100] "%" Vector__XXX
 SG_ DET_HVC_FLAG_082 : 0|1@1+ (1,0) [0|1] "" Vector__XXX
 SG_ DET_CONFD_AZIMUTH_082 : 0|2@1+ (1,0) [0|3] "" Vector__XXX
 SG_ DET_CONFD_ELEVATION_082 : 0|2@1+ (1,0) [0|3] "" Vector__XXX
 SG_ DET_PROB_1STAZHYPO_082 : 0|1@1+ (1,0) [0|1] "" Vector__XXX
 SG_ DET_IDM_082 : 0|1@1+ (1,0) [0|1] "" Vector__XXX
 SG_ DET_MTD_082 : 0|1@1+ (1,0) [0|1] "" Vector__XXX
 SG_ DET_BELOW_RAIN_THOLD_082 : 0|1@1+ (1,0) [0|1] "" Vector__XXX
 SG_ DET_RANGE_083 : 0|15@1+ (0.015625,0) [0|500] "m" Vector__XXX
 SG_ DET_RANGE_ERR_083 : 0|7@1+ (0.0075,0) [0|0.9525] "m" Vector__XXX
 SG_ DET_RANGE_VELOCITY_083 : 0|15@1+ (0.0078125,-128) [-128|127.9921875] "m/s" Vector__XXX
 SG_ DET_RANGE_VELOCITY_ERR_083 : 0|8@1+ (0.003,0) [0|0.765] "m/s" Vector__XXX
 SG_ DET_AZIMUTH_083 : 0|13@1+ (0.0004,-1.5708) [-1.5708|1.5708] "rad" Vector__XXX
 SG_ DET_AZIMUTH_ERR_083 : 0|7@1+ (0.00087267,0) [0|0.11082909] "rad" Vector__XXX
 SG_ DET_ELEVATION_083 : 0|8@1+ (0.00275,-0.34925) [-0.34925|0.34925] "rad" Vector__XXX
 SG_ DET_ELEVATION_ERR_083 : 0|6@1+ (0.00174533,0) [0|0.10995579] "rad" Vector__XXX
 SG_ DET_RCS_083 : 0|8@1+ (0.5,-64) [-64|63.5] "dBsm" Vector__XXX
 SG_ DET_BI_STATIC_FLAG_083 : 0|1@1+ (1,0) [0|1] "" Vector__XXX
 SG_ DET_SUPER_RES_TARGET_083 : 0|1@1+ (1,0) [0|1] "" Vector__XXX
 SG_ DET_SNR_083 : 0|8@1+ (0.35156,0) [0|89.6478] "dB" Vector__XXX
 SG_ DET_EXISTENCE_PROB_083 : 0|6@1+ (1.588,0) [0|100] "%" Vector__XXX
 SG_ DET_HVC_FLAG_083 : 0|1@1+ (1,0) [0|1] "" Vector__XXX
 SG_ DET_CONFD_AZIMUTH_083 : 0|2@1+ (1,0) [0|3] "" Vector__XXX
 SG_ DET_CONFD_ELEVATION_083 : 0|2@1+ (1,0) [0|3] "" Vector__XXX
 SG_ DET_PROB_1STAZHYPO_083 : 0|1@1+ (1,0) [0|1] "" Vector__XXX
 SG_ DET_IDM_083 : 0|1@1+ (1,0) [0|1] "" Vector__XXX
 SG_ DET_MTD_083 : 0|1@1+ (1,0) [0|1] "" Vector__XXX
 SG_ DET_BELOW_RAIN_THOLD_083 : 0|1@1+ (1,0) [0|1] "" Vector__XXX
 SG_ DET_RANGE_084 : 0|15@1+ (0.015625,0) [0|500] "m" Vector__XXX
 SG_ DET_RANGE_ERR_084 : 0|7@1+ (0.0075,0) [0|0.9525] "m" Vector__XXX
 SG_ DET_RANGE_VELOCITY_084 : 0|15@1+ (0.0078125,-128) [-128|127.9921875] "m/s" Vector__XXX
 SG_ DET_RANGE_VELOCITY_ERR_084 : 0|8@1+ (0.003,0) [0|0.765] "m/s" Vector__XXX
 SG_ DET_AZIMUTH_084 : 0|13@1+ (0.0004,-1.5708) [-1.5708|1.5708] "rad" Vector__XXX
 SG_ DET_AZIMUTH_ERR_084 : 0|7@1+ (0.00087267,0) [0|0.11082909] "rad" Vector__XXX
 SG_ DET_ELEVATION_084 : 0|8@1+ (0.00275,-0.34925) [-0.34925|0.34925] "rad" Vector__XXX
 SG_ DET_ELEVATION_ERR_084 : 0|6@1+ (0.00174533,0) [0|0.10995579] "rad" Vector__XXX
 SG_ DET_RCS_084 : 0|8@1+ (0.5,-64) [-64|63.5] "dBsm" Vector__XXX
 SG_ DET_BI_STATIC_FLAG_084 : 0|1@1+ (1,0) [0|1] "" Vector__XXX
 SG_ DET_SUPER_RES_TARGET_084 : 0|1@1+ (1,0) [0|1] "" Vector__XXX
 SG_ DET_SNR_084 : 0|8@1+ (0.35156,0) [0|89.6478] "dB" Vector__XXX
 SG_ DET_EXISTENCE_PROB_084 : 0|6@1+ (1.588,0) [0|100] "%" Vector__XXX
 SG_ DET_HVC_FLAG_084 : 0|1@1+ (1,0) [0|1] "" Vector__XXX
 SG_ DET_CONFD_AZIMUTH_084 : 0|2@1+ (1,0) [0|3] "" Vector__XXX
 SG_ DET_CONFD_ELEVATION_084 : 0|2@1+ (1,0) [0|3] "" Vector__XXX
 SG_ DET_MH_SCAN_INDEX_4LSB_081_084 : 0|4@1+ (1,0) [0|15] "" Vector__XXX
 SG_ DET_MH_CYCLE_COUNTER_081_084 : 0|8@1+ (1,0) [0|255] "" Vector__XXX
 SG_ DET_MH_CRC16_081_084 : 0|16@1+ (1,0) [0|65535] "" Vector__XXX
 SG_ DET_PROB_1STAZHYPO_084 : 0|1@1+ (1,0) [0|1] "" Vector__XXX
 SG_ DET_IDM_084 : 0|1@1+ (1,0) [0|1] "" Vector__XXX
 SG_ DET_MTD_084 : 0|1@1+ (1,0) [0|1] "" Vector__XXX
 SG_ DET_BELOW_RAIN_THOLD_084 : 0|1@1+ (1,0) [0|1] "" Vector__XXX
 SG_ DET_RANGE_085 : 0|15@1+ (0.015625,0) [0|500] "m" Vector__XXX
 SG_ DET_RANGE_ERR_085 : 0|7@1+ (0.0075,0) [0|0.9525] "m" Vector__XXX
 SG_ DET_RANGE_VELOCITY_085 : 0|15@1+ (0.0078125,-128) [-128|127.9921875] "m/s" Vector__XXX
 SG_ DET_RANGE_VELOCITY_ERR_085 : 0|8@1+ (0.003,0) [0|0.765] "m/s" Vector__XXX
 SG_ DET_AZIMUTH_085 : 0|13@1+ (0.0004,-1.5708) [-1.5708|1.5708] "rad" Vector__XXX
 SG_ DET_AZIMUTH_ERR_085 : 0|7@1+ (0.00087267,0) [0|0.11082909] "rad" Vector__XXX
 SG_ DET_ELEVATION_085 : 0|8@1+ (0.00275,-0.34925) [-0.34925|0.34925] "rad" Vector__XXX
 SG_ DET_ELEVATION_ERR_085 : 0|6@1+ (0.00174533,0) [0|0.10995579] "rad" Vector__XXX
 SG_ DET_RCS_085 : 0|8@1+ (0.5,-64) [-64|63.5] "dBsm" Vector__XXX
 SG_ DET_BI_STATIC_FLAG_085 : 0|1@1+ (1,0) [0|1] "" Vector__XXX
 SG_ DET_SUPER_RES_TARGET_085 : 0|1@1+ (1,0) [0|1] "" Vector__XXX
 SG_ DET_SNR_085 : 0|8@1+ (0.35156,0) [0|89.6478] "dB" Vector__XXX
 SG_ DET_EXISTENCE_PROB_085 : 0|6@1+ (1.588,0) [0|100] "%" Vector__XXX
 SG_ DET_HVC_FLAG_085 : 0|1@1+ (1,0) [0|1] "" Vector__XXX
 SG_ DET_CONFD_AZIMUTH_085 : 0|2@1+ (1,0) [0|3] "" Vector__XXX
 SG_ DET_CONFD_ELEVATION_085 : 0|2@1+ (1,0) [0|3] "" Vector__XXX
 SG_ DET_PROB_1STAZHYPO_085 : 0|1@1+ (1,0) [0|1] "" Vector__XXX
 SG_ DET_IDM_085 : 0|1@1+ (1,0) [0|1] "" Vector__XXX
 SG_ DET_MTD_085 : 0|1@1+ (1,0) [0|1] "" Vector__XXX
 SG_ DET_BELOW_RAIN_THOLD_085 : 0|1@1+ (1,0) [0|1] "" Vector__XXX
 SG_ DET_RANGE_086 : 0|15@1+ (0.015625,0) [0|500] "m" Vector__XXX
 SG_ DET_RANGE_ERR_086 : 0|7@1+ (0.0075,0) [0|0.9525] "m" Vector__XXX
 SG_ DET_RANGE_VELOCITY_086 : 0|15@1+ (0.0078125,-128) [-128|127.9921875] "m/s" Vector__XXX
 SG_ DET_RANGE_VELOCITY_ERR_086 : 0|8@1+ (0.003,0) [0|0.765] "m/s" Vector__XXX
 SG_ DET_AZIMUTH_086 : 0|13@1+ (0.0004,-1.5708) [-1.5708|1.5708] "rad" Vector__XXX
 SG_ DET_AZIMUTH_ERR_086 : 0|7@1+ (0.00087267,0) [0|0.11082909] "rad" Vector__XXX
 SG_ DET_ELEVATION_086 : 0|8@1+ (0.00275,-0.34925) [-0.34925|0.34925] "rad" Vector__XXX
 SG_ DET_ELEVATION_ERR_086 : 0|6@1+ (0.00174533,0) [0|0.10995579] "rad" Vector__XXX
 SG_ DET_RCS_086 : 0|8@1+ (0.5,-64) [-64|63.5] "dBsm" Vector__XXX
 SG_ DET_BI_STATIC_FLAG_086 : 0|1@1+ (1,0) [0|1] "" Vector__XXX
 SG_ DET_SUPER_RES_TARGET_086 : 0|1@1+ (1,0) [0|1] "" Vector__XXX
 SG_ DET_SNR_086 : 0|8@1+ (0.35156,0) [0|89.6478] "dB" Vector__XXX
 SG_ DET_EXISTENCE_PROB_086 : 0|6@1+ (1.588,0) [0|100] "%" Vector__XXX
 SG_ DET_HVC_FLAG_086 : 0|1@1+ (1,0) [0|1] "" Vector__XXX
 SG_ DET_CONFD_AZIMUTH_086 : 0|2@1+ (1,0) [0|3] "" Vector__XXX
 SG_ DET_CONFD_ELEVATION_086 : 0|2@1+ (1,0) [0|3] "" Vector__XXX
 SG_ DET_PROB_1STAZHYPO_086 : 0|1@1+ (1,0) [0|1] "" Vector__XXX
 SG_ DET_IDM_086 : 0|1@1+ (1,0) [0|1] "" Vector__XXX
 SG_ DET_MTD_086 : 0|1@1+ (1,0) [0|1] "" Vector__XXX
 SG_ DET_BELOW_RAIN_THOLD_086 : 0|1@1+ (1,0) [0|1] "" Vector__XXX
 SG_ DET_RANGE_087 : 0|15@1+ (0.015625,0) [0|500] "m" Vector__XXX
 SG_ DET_RANGE_ERR_087 : 0|7@1+ (0.0075,0) [0|0.9525] "m" Vector__XXX
 SG_ DET_RANGE_VELOCITY_087 : 0|15@1+ (0.0078125,-128) [-128|127.9921875] "m/s" Vector__XXX
 SG_ DET_RANGE_VELOCITY_ERR_087 : 0|8@1+ (0.003,0) [0|0.765] "m/s" Vector__XXX
 SG_ DET_AZIMUTH_087 : 0|13@1+ (0.0004,-1.5708) [-1.5708|1.5708] "rad" Vector__XXX
 SG_ DET_AZIMUTH_ERR_087 : 0|7@1+ (0.00087267,0) [0|0.11082909] "rad" Vector__XXX
 SG_ DET_ELEVATION_087 : 0|8@1+ (0.00275,-0.34925) [-0.34925|0.34925] "rad" Vector__XXX
 SG_ DET_ELEVATION_ERR_087 : 0|6@1+ (0.00174533,0) [0|0.10995579] "rad" Vector__XXX
 SG_ DET_RCS_087 : 0|8@1+ (0.5,-64) [-64|63.5] "dBsm" Vector__XXX
 SG_ DET_BI_STATIC_FLAG_087 : 0|1@1+ (1,0) [0|1] "" Vector__XXX
 SG_ DET_SUPER_RES_TARGET_087 : 0|1@1+ (1,0) [0|1] "" Vector__XXX
 SG_ DET_SNR_087 : 0|8@1+ (0.35156,0) [0|89.6478] "dB" Vector__XXX
 SG_ DET_EXISTENCE_PROB_087 : 0|6@1+ (1.588,0) [0|100] "%" Vector__XXX
 SG_ DET_HVC_FLAG_087 : 0|1@1+ (1,0) [0|1] "" Vector__XXX
 SG_ DET_CONFD_AZIMUTH_087 : 0|2@1+ (1,0) [0|3] "" Vector__XXX
 SG_ DET_CONFD_ELEVATION_087 : 0|2@1+ (1,0) [0|3] "" Vector__XXX
 SG_ DET_PROB_1STAZHYPO_087 : 0|1@1+ (1,0) [0|1] "" Vector__XXX
 SG_ DET_IDM_087 : 0|1@1+ (1,0) [0|1] "" Vector__XXX
 SG_ DET_MTD_087 : 0|1@1+ (1,0) [0|1] "" Vector__XXX
 SG_ DET_BELOW_RAIN_THOLD_087 : 0|1@1+ (1,0) [0|1] "" Vector__XXX
 SG_ DET_RANGE_088 : 0|15@1+ (0.015625,0) [0|500] "m" Vector__XXX
 SG_ DET_RANGE_ERR_088 : 0|7@1+ (0.0075,0) [0|0.9525] "m" Vector__XXX
 SG_ DET_RANGE_VELOCITY_088 : 0|15@1+ (0.0078125,-128) [-128|127.9921875] "m/s" Vector__XXX
 SG_ DET_RANGE_VELOCITY_ERR_088 : 0|8@1+ (0.003,0) [0|0.765] "m/s" Vector__XXX
 SG_ DET_AZIMUTH_088 : 0|13@1+ (0.0004,-1.5708) [-1.5708|1.5708] "rad" Vector__XXX
 SG_ DET_AZIMUTH_ERR_088 : 0|7@1+ (0.00087267,0) [0|0.11082909] "rad" Vector__XXX
 SG_ DET_ELEVATION_088 : 0|8@1+ (0.00275,-0.34925) [-0.34925|0.34925] "rad" Vector__XXX
 SG_ DET_ELEVATION_ERR_088 : 0|6@1+ (0.00174533,0) [0|0.10995579] "rad" Vector__XXX
 SG_ DET_RCS_088 : 0|8@1+ (0.5,-64) [-64|63.5] "dBsm" Vector__XXX
 SG_ DET_BI_STATIC_FLAG_088 : 0|1@1+ (1,0) [0|1] "" Vector__XXX
 SG_ DET_SUPER_RES_TARGET_088 : 0|1@1+ (1,0) [0|1] "" Vector__XXX
 SG_ DET_SNR_088 : 0|8@1+ (0.35156,0) [0|89.6478] "dB" Vector__XXX
 SG_ DET_EXISTENCE_PROB_088 : 0|6@1+ (1.588,0) [0|100] "%" Vector__XXX
 SG_ DET_HVC_FLAG_088 : 0|1@1+ (1,0) [0|1] "" Vector__XXX
 SG_ DET_CONFD_AZIMUTH_088 : 0|2@1+ (1,0) [0|3] "" Vector__XXX
 SG_ DET_CONFD_ELEVATION_088 : 0|2@1+ (1,0) [0|3] "" Vector__XXX
 SG_ DET_MH_SCAN_INDEX_4LSB_085_088 : 0|4@1+ (1,0) [0|15] "" Vector__XXX
 SG_ DET_MH_CYCLE_COUNTER_085_088 : 0|8@1+ (1,0) [0|255] "" Vector__XXX
 SG_ DET_MH_CRC16_085_088 : 0|16@1+ (1,0) [0|65535] "" Vector__XXX
 SG_ DET_PROB_1STAZHYPO_088 : 0|1@1+ (1,0) [0|1] "" Vector__XXX
 SG_ DET_IDM_088 : 0|1@1+ (1,0) [0|1] "" Vector__XXX
 SG_ DET_MTD_088 : 0|1@1+ (1,0) [0|1] "" Vector__XXX
 SG_ DET_BELOW_RAIN_THOLD_088 : 0|1@1+ (1,0) [0|1] "" Vector__XXX
 SG_ DET_RANGE_089 : 0|15@1+ (0.015625,0) [0|500] "m" Vector__XXX
 SG_ DET_RANGE_ERR_089 : 0|7@1+ (0.0075,0) [0|0.9525] "m" Vector__XXX
 SG_ DET_RANGE_VELOCITY_089 : 0|15@1+ (0.0078125,-128) [-128|127.9921875] "m/s" Vector__XXX
 SG_ DET_RANGE_VELOCITY_ERR_089 : 0|8@1+ (0.003,0) [0|0.765] "m/s" Vector__XXX
 SG_ DET_AZIMUTH_089 : 0|13@1+ (0.0004,-1.5708) [-1.5708|1.5708] "rad" Vector__XXX
 SG_ DET_AZIMUTH_ERR_089 : 0|7@1+ (0.00087267,0) [0|0.11082909] "rad" Vector__XXX
 SG_ DET_ELEVATION_089 : 0|8@1+ (0.00275,-0.34925) [-0.34925|0.34925] "rad" Vector__XXX
 SG_ DET_ELEVATION_ERR_089 : 0|6@1+ (0.00174533,0) [0|0.10995579] "rad" Vector__XXX
 SG_ DET_RCS_089 : 0|8@1+ (0.5,-64) [-64|63.5] "dBsm" Vector__XXX
 SG_ DET_BI_STATIC_FLAG_089 : 0|1@1+ (1,0) [0|1] "" Vector__XXX
 SG_ DET_SUPER_RES_TARGET_089 : 0|1@1+ (1,0) [0|1] "" Vector__XXX
 SG_ DET_SNR_089 : 0|8@1+ (0.35156,0) [0|89.6478] "dB" Vector__XXX
 SG_ DET_EXISTENCE_PROB_089 : 0|6@1+ (1.588,0) [0|100] "%" Vector__XXX
 SG_ DET_HVC_FLAG_089 : 0|1@1+ (1,0) [0|1] "" Vector__XXX
 SG_ DET_CONFD_AZIMUTH_089 : 0|2@1+ (1,0) [0|3] "" Vector__XXX
 SG_ DET_CONFD_ELEVATION_089 : 0|2@1+ (1,0) [0|3] "" Vector__XXX
 SG_ DET_PROB_1STAZHYPO_089 : 0|1@1+ (1,0) [0|1] "" Vector__XXX
 SG_ DET_IDM_089 : 0|1@1+ (1,0) [0|1] "" Vector__XXX
 SG_ DET_MTD_089 : 0|1@1+ (1,0) [0|1] "" Vector__XXX
 SG_ DET_BELOW_RAIN_THOLD_089 : 0|1@1+ (1,0) [0|1] "" Vector__XXX
 SG_ DET_RANGE_090 : 0|15@1+ (0.015625,0) [0|500] "m" Vector__XXX
 SG_ DET_RANGE_ERR_090 : 0|7@1+ (0.0075,0) [0|0.9525] "m" Vector__XXX
 SG_ DET_RANGE_VELOCITY_090 : 0|15@1+ (0.0078125,-128) [-128|127.9921875] "m/s" Vector__XXX
 SG_ DET_RANGE_VELOCITY_ERR_090 : 0|8@1+ (0.003,0) [0|0.765] "m/s" Vector__XXX
 SG_ DET_AZIMUTH_090 : 0|13@1+ (0.0004,-1.5708) [-1.5708|1.5708] "rad" Vector__XXX
 SG_ DET_AZIMUTH_ERR_090 : 0|7@1+ (0.00087267,0) [0|0.11082909] "rad" Vector__XXX
 SG_ DET_ELEVATION_090 : 0|8@1+ (0.00275,-0.34925) [-0.34925|0.34925] "rad" Vector__XXX
 SG_ DET_ELEVATION_ERR_090 : 0|6@1+ (0.00174533,0) [0|0.10995579] "rad" Vector__XXX
 SG_ DET_RCS_090 : 0|8@1+ (0.5,-64) [-64|63.5] "dBsm" Vector__XXX
 SG_ DET_BI_STATIC_FLAG_090 : 0|1@1+ (1,0) [0|1] "" Vector__XXX
 SG_ DET_SUPER_RES_TARGET_090 : 0|1@1+ (1,0) [0|1] "" Vector__XXX
 SG_ DET_SNR_090 : 0|8@1+ (0.35156,0) [0|89.6478] "dB" Vector__XXX
 SG_ DET_EXISTENCE_PROB_090 : 0|6@1+ (1.588,0) [0|100] "%" Vector__XXX
 SG_ DET_HVC_FLAG_090 : 0|1@1+ (1,0) [0|1] "" Vector__XXX
 SG_ DET_CONFD_AZIMUTH_090 : 0|2@1+ (1,0) [0|3] "" Vector__XXX
 SG_ DET_CONFD_ELEVATION_090 : 0|2@1+ (1,0) [0|3] "" Vector__XXX
 SG_ DET_PROB_1STAZHYPO_090 : 0|1@1+ (1,0) [0|1] "" Vector__XXX
 SG_ DET_IDM_090 : 0|1@1+ (1,0) [0|1] "" Vector__XXX
 SG_ DET_MTD_090 : 0|1@1+ (1,0) [0|1] "" Vector__XXX
 SG_ DET_BELOW_RAIN_THOLD_090 : 0|1@1+ (1,0) [0|1] "" Vector__XXX
 SG_ DET_RANGE_091 : 0|15@1+ (0.015625,0) [0|500] "m" Vector__XXX
 SG_ DET_RANGE_ERR_091 : 0|7@1+ (0.0075,0) [0|0.9525] "m" Vector__XXX
 SG_ DET_RANGE_VELOCITY_091 : 0|15@1+ (0.0078125,-128) [-128|127.9921875] "m/s" Vector__XXX
 SG_ DET_RANGE_VELOCITY_ERR_091 : 0|8@1+ (0.003,0) [0|0.765] "m/s" Vector__XXX
 SG_ DET_AZIMUTH_091 : 0|13@1+ (0.0004,-1.5708) [-1.5708|1.5708] "rad" Vector__XXX
 SG_ DET_AZIMUTH_ERR_091 : 0|7@1+ (0.00087267,0) [0|0.11082909] "rad" Vector__XXX
 SG_ DET_ELEVATION_091 : 0|8@1+ (0.00275,-0.34925) [-0.34925|0.34925] "rad" Vector__XXX
 SG_ DET_ELEVATION_ERR_091 : 0|6@1+ (0.00174533,0) [0|0.10995579] "rad" Vector__XXX
 SG_ DET_RCS_091 : 0|8@1+ (0.5,-64) [-64|63.5] "dBsm" Vector__XXX
 SG_ DET_BI_STATIC_FLAG_091 : 0|1@1+ (1,0) [0|1] "" Vector__XXX
 SG_ DET_SUPER_RES_TARGET_091 : 0|1@1+ (1,0) [0|1] "" Vector__XXX
 SG_ DET_SNR_091 : 0|8@1+ (0.35156,0) [0|89.6478] "dB" Vector__XXX
 SG_ DET_EXISTENCE_PROB_091 : 0|6@1+ (1.588,0) [0|100] "%" Vector__XXX
 SG_ DET_HVC_FLAG_091 : 0|1@1+ (1,0) [0|1] "" Vector__XXX
 SG_ DET_CONFD_AZIMUTH_091 : 0|2@1+ (1,0) [0|3] "" Vector__XXX
 SG_ DET_CONFD_ELEVATION_091 : 0|2@1+ (1,0) [0|3] "" Vector__XXX
 SG_ DET_PROB_1STAZHYPO_091 : 0|1@1+ (1,0) [0|1] "" Vector__XXX
 SG_ DET_IDM_091 : 0|1@1+ (1,0) [0|1] "" Vector__XXX
 SG_ DET_MTD_091 : 0|1@1+ (1,0) [0|1] "" Vector__XXX
 SG_ DET_BELOW_RAIN_THOLD_091 : 0|1@1+ (1,0) [0|1] "" Vector__XXX
 SG_ DET_RANGE_092 : 0|15@1+ (0.015625,0) [0|500] "m" Vector__XXX
 SG_ DET_RANGE_ERR_092 : 0|7@1+ (0.0075,0) [0|0.9525] "m" Vector__XXX
 SG_ DET_RANGE_VELOCITY_092 : 0|15@1+ (0.0078125,-128) [-128|127.9921875] "m/s" Vector__XXX
 SG_ DET_RANGE_VELOCITY_ERR_092 : 0|8@1+ (0.003,0) [0|0.765] "m/s" Vector__XXX
 SG_ DET_AZIMUTH_092 : 0|13@1+ (0.0004,-1.5708) [-1.5708|1.5708] "rad" Vector__XXX
 SG_ DET_AZIMUTH_ERR_092 : 0|7@1+ (0.00087267,0) [0|0.11082909] "rad" Vector__XXX
 SG_ DET_ELEVATION_092 : 0|8@1+ (0.00275,-0.34925) [-0.34925|0.34925] "rad" Vector__XXX
 SG_ DET_ELEVATION_ERR_092 : 0|6@1+ (0.00174533,0) [0|0.10995579] "rad" Vector__XXX
 SG_ DET_RCS_092 : 0|8@1+ (0.5,-64) [-64|63.5] "dBsm" Vector__XXX
 SG_ DET_BI_STATIC_FLAG_092 : 0|1@1+ (1,0) [0|1] "" Vector__XXX
 SG_ DET_SUPER_RES_TARGET_092 : 0|1@1+ (1,0) [0|1] "" Vector__XXX
 SG_ DET_SNR_092 : 0|8@1+ (0.35156,0) [0|89.6478] "dB" Vector__XXX
 SG_ DET_EXISTENCE_PROB_092 : 0|6@1+ (1.588,0) [0|100] "%" Vector__XXX
 SG_ DET_HVC_FLAG_092 : 0|1@1+ (1,0) [0|1] "" Vector__XXX
 SG_ DET_CONFD_AZIMUTH_092 : 0|2@1+ (1,0) [0|3] "" Vector__XXX
 SG_ DET_CONFD_ELEVATION_092 : 0|2@1+ (1,0) [0|3] "" Vector__XXX
 SG_ DET_MH_SCAN_INDEX_4LSB_089_092 : 0|4@1+ (1,0) [0|15] "" Vector__XXX
 SG_ DET_MH_CYCLE_COUNTER_089_092 : 0|8@1+ (1,0) [0|255] "" Vector__XXX
 SG_ DET_MH_CRC16_089_092 : 0|16@1+ (1,0) [0|65535] "" Vector__XXX
 SG_ DET_PROB_1STAZHYPO_092 : 0|1@1+ (1,0) [0|1] "" Vector__XXX
 SG_ DET_IDM_092 : 0|1@1+ (1,0) [0|1] "" Vector__XXX
 SG_ DET_MTD_092 : 0|1@1+ (1,0) [0|1] "" Vector__XXX
 SG_ DET_BELOW_RAIN_THOLD_092 : 0|1@1+ (1,0) [0|1] "" Vector__XXX
 SG_ DET_RANGE_093 : 0|15@1+ (0.015625,0) [0|500] "m" Vector__XXX
 SG_ DET_RANGE_ERR_093 : 0|7@1+ (0.0075,0) [0|0.9525] "m" Vector__XXX
 SG_ DET_RANGE_VELOCITY_093 : 0|15@1+ (0.0078125,-128) [-128|127.9921875] "m/s" Vector__XXX
 SG_ DET_RANGE_VELOCITY_ERR_093 : 0|8@1+ (0.003,0) [0|0.765] "m/s" Vector__XXX
 SG_ DET_AZIMUTH_093 : 0|13@1+ (0.0004,-1.5708) [-1.5708|1.5708] "rad" Vector__XXX
 SG_ DET_AZIMUTH_ERR_093 : 0|7@1+ (0.00087267,0) [0|0.11082909] "rad" Vector__XXX
 SG_ DET_ELEVATION_093 : 0|8@1+ (0.00275,-0.34925) [-0.34925|0.34925] "rad" Vector__XXX
 SG_ DET_ELEVATION_ERR_093 : 0|6@1+ (0.00174533,0) [0|0.10995579] "rad" Vector__XXX
 SG_ DET_RCS_093 : 0|8@1+ (0.5,-64) [-64|63.5] "dBsm" Vector__XXX
 SG_ DET_BI_STATIC_FLAG_093 : 0|1@1+ (1,0) [0|1] "" Vector__XXX
 SG_ DET_SUPER_RES_TARGET_093 : 0|1@1+ (1,0) [0|1] "" Vector__XXX
 SG_ DET_SNR_093 : 0|8@1+ (0.35156,0) [0|89.6478] "dB" Vector__XXX
 SG_ DET_EXISTENCE_PROB_093 : 0|6@1+ (1.588,0) [0|100] "%" Vector__XXX
 SG_ DET_HVC_FLAG_093 : 0|1@1+ (1,0) [0|1] "" Vector__XXX
 SG_ DET_CONFD_AZIMUTH_093 : 0|2@1+ (1,0) [0|3] "" Vector__XXX
 SG_ DET_CONFD_ELEVATION_093 : 0|2@1+ (1,0) [0|3] "" Vector__XXX
 SG_ DET_PROB_1STAZHYPO_093 : 0|1@1+ (1,0) [0|1] "" Vector__XXX
 SG_ DET_IDM_093 : 0|1@1+ (1,0) [0|1] "" Vector__XXX
 SG_ DET_MTD_093 : 0|1@1+ (1,0) [0|1] "" Vector__XXX
 SG_ DET_BELOW_RAIN_THOLD_093 : 0|1@1+ (1,0) [0|1] "" Vector__XXX
 SG_ DET_RANGE_094 : 0|15@1+ (0.015625,0) [0|500] "m" Vector__XXX
 SG_ DET_RANGE_ERR_094 : 0|7@1+ (0.0075,0) [0|0.9525] "m" Vector__XXX
 SG_ DET_RANGE_VELOCITY_094 : 0|15@1+ (0.0078125,-128) [-128|127.9921875] "m/s" Vector__XXX
 SG_ DET_RANGE_VELOCITY_ERR_094 : 0|8@1+ (0.003,0) [0|0.765] "m/s" Vector__XXX
 SG_ DET_AZIMUTH_094 : 0|13@1+ (0.0004,-1.5708) [-1.5708|1.5708] "rad" Vector__XXX
 SG_ DET_AZIMUTH_ERR_094 : 0|7@1+ (0.00087267,0) [0|0.11082909] "rad" Vector__XXX
 SG_ DET_ELEVATION_094 : 0|8@1+ (0.00275,-0.34925) [-0.34925|0.34925] "rad" Vector__XXX
 SG_ DET_ELEVATION_ERR_094 : 0|6@1+ (0.00174533,0) [0|0.10995579] "rad" Vector__XXX
 SG_ DET_RCS_094 : 0|8@1+ (0.5,-64) [-64|63.5] "dBsm" Vector__XXX
 SG_ DET_BI_STATIC_FLAG_094 : 0|1@1+ (1,0) [0|1] "" Vector__XXX
 SG_ DET_SUPER_RES_TARGET_094 : 0|1@1+ (1,0) [0|1] "" Vector__XXX
 SG_ DET_SNR_094 : 0|8@1+ (0.35156,0) [0|89.6478] "dB" Vector__XXX
 SG_ DET_EXISTENCE_PROB_094 : 0|6@1+ (1.588,0) [0|100] "%" Vector__XXX
 SG_ DET_HVC_FLAG_094 : 0|1@1+ (1,0) [0|1] "" Vector__XXX
 SG_ DET_CONFD_AZIMUTH_094 : 0|2@1+ (1,0) [0|3] "" Vector__XXX
 SG_ DET_CONFD_ELEVATION_094 : 0|2@1+ (1,0) [0|3] "" Vector__XXX
 SG_ DET_PROB_1STAZHYPO_094 : 0|1@1+ (1,0) [0|1] "" Vector__XXX
 SG_ DET_IDM_094 : 0|1@1+ (1,0) [0|1] "" Vector__XXX
 SG_ DET_MTD_094 : 0|1@1+ (1,0) [0|1] "" Vector__XXX
 SG_ DET_BELOW_RAIN_THOLD_094 : 0|1@1+ (1,0) [0|1] "" Vector__XXX
 SG_ DET_RANGE_095 : 0|15@1+ (0.015625,0) [0|500] "m" Vector__XXX
 SG_ DET_RANGE_ERR_095 : 0|7@1+ (0.0075,0) [0|0.9525] "m" Vector__XXX
 SG_ DET_RANGE_VELOCITY_095 : 0|15@1+ (0.0078125,-128) [-128|127.9921875] "m/s" Vector__XXX
 SG_ DET_RANGE_VELOCITY_ERR_095 : 0|8@1+ (0.003,0) [0|0.765] "m/s" Vector__XXX
 SG_ DET_AZIMUTH_095 : 0|13@1+ (0.0004,-1.5708) [-1.5708|1.5708] "rad" Vector__XXX
 SG_ DET_AZIMUTH_ERR_095 : 0|7@1+ (0.00087267,0) [0|0.11082909] "rad" Vector__XXX
 SG_ DET_ELEVATION_095 : 0|8@1+ (0.00275,-0.34925) [-0.34925|0.34925] "rad" Vector__XXX
 SG_ DET_ELEVATION_ERR_095 : 0|6@1+ (0.00174533,0) [0|0.10995579] "rad" Vector__XXX
 SG_ DET_RCS_095 : 0|8@1+ (0.5,-64) [-64|63.5] "dBsm" Vector__XXX
 SG_ DET_BI_STATIC_FLAG_095 : 0|1@1+ (1,0) [0|1] "" Vector__XXX
 SG_ DET_SUPER_RES_TARGET_095 : 0|1@1+ (1,0) [0|1] "" Vector__XXX
 SG_ DET_SNR_095 : 0|8@1+ (0.35156,0) [0|89.6478] "dB" Vector__XXX
 SG_ DET_EXISTENCE_PROB_095 : 0|6@1+ (1.588,0) [0|100] "%" Vector__XXX
 SG_ DET_HVC_FLAG_095 : 0|1@1+ (1,0) [0|1] "" Vector__XXX
 SG_ DET_CONFD_AZIMUTH_095 : 0|2@1+ (1,0) [0|3] "" Vector__XXX
 SG_ DET_CONFD_ELEVATION_095 : 0|2@1+ (1,0) [0|3] "" Vector__XXX
 SG_ DET_PROB_1STAZHYPO_095 : 0|1@1+ (1,0) [0|1] "" Vector__XXX
 SG_ DET_IDM_095 : 0|1@1+ (1,0) [0|1] "" Vector__XXX
 SG_ DET_MTD_095 : 0|1@1+ (1,0) [0|1] "" Vector__XXX
 SG_ DET_BELOW_RAIN_THOLD_095 : 0|1@1+ (1,0) [0|1] "" Vector__XXX
 SG_ DET_RANGE_096 : 0|15@1+ (0.015625,0) [0|500] "m" Vector__XXX
 SG_ DET_RANGE_ERR_096 : 0|7@1+ (0.0075,0) [0|0.9525] "m" Vector__XXX
 SG_ DET_RANGE_VELOCITY_096 : 0|15@1+ (0.0078125,-128) [-128|127.9921875] "m/s" Vector__XXX
 SG_ DET_RANGE_VELOCITY_ERR_096 : 0|8@1+ (0.003,0) [0|0.765] "m/s" Vector__XXX
 SG_ DET_AZIMUTH_096 : 0|13@1+ (0.0004,-1.5708) [-1.5708|1.5708] "rad" Vector__XXX
 SG_ DET_AZIMUTH_ERR_096 : 0|7@1+ (0.00087267,0) [0|0.11082909] "rad" Vector__XXX
 SG_ DET_ELEVATION_096 : 0|8@1+ (0.00275,-0.34925) [-0.34925|0.34925] "rad" Vector__XXX
 SG_ DET_ELEVATION_ERR_096 : 0|6@1+ (0.00174533,0) [0|0.10995579] "rad" Vector__XXX
 SG_ DET_RCS_096 : 0|8@1+ (0.5,-64) [-64|63.5] "dBsm" Vector__XXX
 SG_ DET_BI_STATIC_FLAG_096 : 0|1@1+ (1,0) [0|1] "" Vector__XXX
 SG_ DET_SUPER_RES_TARGET_096 : 0|1@1+ (1,0) [0|1] "" Vector__XXX
 SG_ DET_SNR_096 : 0|8@1+ (0.35156,0) [0|89.6478] "dB" Vector__XXX
 SG_ DET_EXISTENCE_PROB_096 : 0|6@1+ (1.588,0) [0|100] "%" Vector__XXX
 SG_ DET_HVC_FLAG_096 : 0|1@1+ (1,0) [0|1] "" Vector__XXX
 SG_ DET_CONFD_AZIMUTH_096 : 0|2@1+ (1,0) [0|3] "" Vector__XXX
 SG_ DET_CONFD_ELEVATION_096 : 0|2@1+ (1,0) [0|3] "" Vector__XXX
 SG_ DET_MH_SCAN_INDEX_4LSB_093_096 : 0|4@1+ (1,0) [0|15] "" Vector__XXX
 SG_ DET_MH_CYCLE_COUNTER_093_096 : 0|8@1+ (1,0) [0|255] "" Vector__XXX
 SG_ DET_MH_CRC16_093_096 : 0|16@1+ (1,0) [0|65535] "" Vector__XXX
 SG_ DET_PROB_1STAZHYPO_096 : 0|1@1+ (1,0) [0|1] "" Vector__XXX
 SG_ DET_IDM_096 : 0|1@1+ (1,0) [0|1] "" Vector__XXX
 SG_ DET_MTD_096 : 0|1@1+ (1,0) [0|1] "" Vector__XXX
 SG_ DET_BELOW_RAIN_THOLD_096 : 0|1@1+ (1,0) [0|1] "" Vector__XXX
 SG_ DET_RANGE_097 : 0|15@1+ (0.015625,0) [0|500] "m" Vector__XXX
 SG_ DET_RANGE_ERR_097 : 0|7@1+ (0.0075,0) [0|0.9525] "m" Vector__XXX
 SG_ DET_RANGE_VELOCITY_097 : 0|15@1+ (0.0078125,-128) [-128|127.9921875] "m/s" Vector__XXX
 SG_ DET_RANGE_VELOCITY_ERR_097 : 0|8@1+ (0.003,0) [0|0.765] "m/s" Vector__XXX
 SG_ DET_AZIMUTH_097 : 0|13@1+ (0.0004,-1.5708) [-1.5708|1.5708] "rad" Vector__XXX
 SG_ DET_AZIMUTH_ERR_097 : 0|7@1+ (0.00087267,0) [0|0.11082909] "rad" Vector__XXX
 SG_ DET_ELEVATION_097 : 0|8@1+ (0.00275,-0.34925) [-0.34925|0.34925] "rad" Vector__XXX
 SG_ DET_ELEVATION_ERR_097 : 0|6@1+ (0.00174533,0) [0|0.10995579] "rad" Vector__XXX
 SG_ DET_RCS_097 : 0|8@1+ (0.5,-64) [-64|63.5] "dBsm" Vector__XXX
 SG_ DET_BI_STATIC_FLAG_097 : 0|1@1+ (1,0) [0|1] "" Vector__XXX
 SG_ DET_SUPER_RES_TARGET_097 : 0|1@1+ (1,0) [0|1] "" Vector__XXX
 SG_ DET_SNR_097 : 0|8@1+ (0.35156,0) [0|89.6478] "dB" Vector__XXX
 SG_ DET_EXISTENCE_PROB_097 : 0|6@1+ (1.588,0) [0|100] "%" Vector__XXX
 SG_ DET_HVC_FLAG_097 : 0|1@1+ (1,0) [0|1] "" Vector__XXX
 SG_ DET_CONFD_AZIMUTH_097 : 0|2@1+ (1,0) [0|3] "" Vector__XXX
 SG_ DET_CONFD_ELEVATION_097 : 0|2@1+ (1,0) [0|3] "" Vector__XXX
 SG_ DET_PROB_1STAZHYPO_097 : 0|1@1+ (1,0) [0|1] "" Vector__XXX
 SG_ DET_IDM_097 : 0|1@1+ (1,0) [0|1] "" Vector__XXX
 SG_ DET_MTD_097 : 0|1@1+ (1,0) [0|1] "" Vector__XXX
 SG_ DET_BELOW_RAIN_THOLD_097 : 0|1@1+ (1,0) [0|1] "" Vector__XXX
 SG_ DET_RANGE_098 : 0|15@1+ (0.015625,0) [0|500] "m" Vector__XXX
 SG_ DET_RANGE_ERR_098 : 0|7@1+ (0.0075,0) [0|0.9525] "m" Vector__XXX
 SG_ DET_RANGE_VELOCITY_098 : 0|15@1+ (0.0078125,-128) [-128|127.9921875] "m/s" Vector__XXX
 SG_ DET_RANGE_VELOCITY_ERR_098 : 0|8@1+ (0.003,0) [0|0.765] "m/s" Vector__XXX
 SG_ DET_AZIMUTH_098 : 0|13@1+ (0.0004,-1.5708) [-1.5708|1.5708] "rad" Vector__XXX
 SG_ DET_AZIMUTH_ERR_098 : 0|7@1+ (0.00087267,0) [0|0.11082909] "rad" Vector__XXX
 SG_ DET_ELEVATION_098 : 0|8@1+ (0.00275,-0.34925) [-0.34925|0.34925] "rad" Vector__XXX
 SG_ DET_ELEVATION_ERR_098 : 0|6@1+ (0.00174533,0) [0|0.10995579] "rad" Vector__XXX
 SG_ DET_RCS_098 : 0|8@1+ (0.5,-64) [-64|63.5] "dBsm" Vector__XXX
 SG_ DET_BI_STATIC_FLAG_098 : 0|1@1+ (1,0) [0|1] "" Vector__XXX
 SG_ DET_SUPER_RES_TARGET_098 : 0|1@1+ (1,0) [0|1] "" Vector__XXX
 SG_ DET_SNR_098 : 0|8@1+ (0.35156,0) [0|89.6478] "dB" Vector__XXX
 SG_ DET_EXISTENCE_PROB_098 : 0|6@1+ (1.588,0) [0|100] "%" Vector__XXX
 SG_ DET_HVC_FLAG_098 : 0|1@1+ (1,0) [0|1] "" Vector__XXX
 SG_ DET_CONFD_AZIMUTH_098 : 0|2@1+ (1,0) [0|3] "" Vector__XXX
 SG_ DET_CONFD_ELEVATION_098 : 0|2@1+ (1,0) [0|3] "" Vector__XXX
 SG_ DET_PROB_1STAZHYPO_098 : 0|1@1+ (1,0) [0|1] "" Vector__XXX
 SG_ DET_IDM_098 : 0|1@1+ (1,0) [0|1] "" Vector__XXX
 SG_ DET_MTD_098 : 0|1@1+ (1,0) [0|1] "" Vector__XXX
 SG_ DET_BELOW_RAIN_THOLD_098 : 0|1@1+ (1,0) [0|1] "" Vector__XXX
 SG_ DET_RANGE_099 : 0|15@1+ (0.015625,0) [0|500] "m" Vector__XXX
 SG_ DET_RANGE_ERR_099 : 0|7@1+ (0.0075,0) [0|0.9525] "m" Vector__XXX
 SG_ DET_RANGE_VELOCITY_099 : 0|15@1+ (0.0078125,-128) [-128|127.9921875] "m/s" Vector__XXX
 SG_ DET_RANGE_VELOCITY_ERR_099 : 0|8@1+ (0.003,0) [0|0.765] "m/s" Vector__XXX
 SG_ DET_AZIMUTH_099 : 0|13@1+ (0.0004,-1.5708) [-1.5708|1.5708] "rad" Vector__XXX
 SG_ DET_AZIMUTH_ERR_099 : 0|7@1+ (0.00087267,0) [0|0.11082909] "rad" Vector__XXX
 SG_ DET_ELEVATION_099 : 0|8@1+ (0.00275,-0.34925) [-0.34925|0.34925] "rad" Vector__XXX
 SG_ DET_ELEVATION_ERR_099 : 0|6@1+ (0.00174533,0) [0|0.10995579] "rad" Vector__XXX
 SG_ DET_RCS_099 : 0|8@1+ (0.5,-64) [-64|63.5] "dBsm" Vector__XXX
 SG_ DET_BI_STATIC_FLAG_099 : 0|1@1+ (1,0) [0|1] "" Vector__XXX
 SG_ DET_SUPER_RES_TARGET_099 : 0|1@1+ (1,0) [0|1] "" Vector__XXX
 SG_ DET_SNR_099 : 0|8@1+ (0.35156,0) [0|89.6478] "dB" Vector__XXX
 SG_ DET_EXISTENCE_PROB_099 : 0|6@1+ (1.588,0) [0|100] "%" Vector__XXX
 SG_ DET_HVC_FLAG_099 : 0|1@1+ (1,0) [0|1] "" Vector__XXX
 SG_ DET_CONFD_AZIMUTH_099 : 0|2@1+ (1,0) [0|3] "" Vector__XXX
 SG_ DET_CONFD_ELEVATION_099 : 0|2@1+ (1,0) [0|3] "" Vector__XXX
 SG_ DET_PROB_1STAZHYPO_099 : 0|1@1+ (1,0) [0|1] "" Vector__XXX
 SG_ DET_IDM_099 : 0|1@1+ (1,0) [0|1] "" Vector__XXX
 SG_ DET_MTD_099 : 0|1@1+ (1,0) [0|1] "" Vector__XXX
 SG_ DET_BELOW_RAIN_THOLD_099 : 0|1@1+ (1,0) [0|1] "" Vector__XXX
 SG_ DET_RANGE_100 : 0|15@1+ (0.015625,0) [0|500] "m" Vector__XXX
 SG_ DET_RANGE_ERR_100 : 0|7@1+ (0.0075,0) [0|0.9525] "m" Vector__XXX
 SG_ DET_RANGE_VELOCITY_100 : 0|15@1+ (0.0078125,-128) [-128|127.9921875] "m/s" Vector__XXX
 SG_ DET_RANGE_VELOCITY_ERR_100 : 0|8@1+ (0.003,0) [0|0.765] "m/s" Vector__XXX
 SG_ DET_AZIMUTH_100 : 0|13@1+ (0.0004,-1.5708) [-1.5708|1.5708] "rad" Vector__XXX
 SG_ DET_AZIMUTH_ERR_100 : 0|7@1+ (0.00087267,0) [0|0.11082909] "rad" Vector__XXX
 SG_ DET_ELEVATION_100 : 0|8@1+ (0.00275,-0.34925) [-0.34925|0.34925] "rad" Vector__XXX
 SG_ DET_ELEVATION_ERR_100 : 0|6@1+ (0.00174533,0) [0|0.10995579] "rad" Vector__XXX
 SG_ DET_RCS_100 : 0|8@1+ (0.5,-64) [-64|63.5] "dBsm" Vector__XXX
 SG_ DET_BI_STATIC_FLAG_100 : 0|1@1+ (1,0) [0|1] "" Vector__XXX
 SG_ DET_SUPER_RES_TARGET_100 : 0|1@1+ (1,0) [0|1] "" Vector__XXX
 SG_ DET_SNR_100 : 0|8@1+ (0.35156,0) [0|89.6478] "dB" Vector__XXX
 SG_ DET_EXISTENCE_PROB_100 : 0|6@1+ (1.588,0) [0|100] "%" Vector__XXX
 SG_ DET_HVC_FLAG_100 : 0|1@1+ (1,0) [0|1] "" Vector__XXX
 SG_ DET_CONFD_AZIMUTH_100 : 0|2@1+ (1,0) [0|3] "" Vector__XXX
 SG_ DET_CONFD_ELEVATION_100 : 0|2@1+ (1,0) [0|3] "" Vector__XXX
 SG_ DET_MH_SCAN_INDEX_4LSB_097_100 : 0|4@1+ (1,0) [0|15] "" Vector__XXX
 SG_ DET_MH_CYCLE_COUNTER_097_100 : 0|8@1+ (1,0) [0|255] "" Vector__XXX
 SG_ DET_MH_CRC16_097_100 : 0|16@1+ (1,0) [0|65535] "" Vector__XXX
 SG_ DET_PROB_1STAZHYPO_100 : 0|1@1+ (1,0) [0|1] "" Vector__XXX
 SG_ DET_IDM_100 : 0|1@1+ (1,0) [0|1] "" Vector__XXX
 SG_ DET_MTD_100 : 0|1@1+ (1,0) [0|1] "" Vector__XXX
 SG_ DET_BELOW_RAIN_THOLD_100 : 0|1@1+ (1,0) [0|1] "" Vector__XXX
 SG_ DET_RANGE_101 : 0|15@1+ (0.015625,0) [0|500] "m" Vector__XXX
 SG_ DET_RANGE_ERR_101 : 0|7@1+ (0.0075,0) [0|0.9525] "m" Vector__XXX
 SG_ DET_RANGE_VELOCITY_101 : 0|15@1+ (0.0078125,-128) [-128|127.9921875] "m/s" Vector__XXX
 SG_ DET_RANGE_VELOCITY_ERR_101 : 0|8@1+ (0.003,0) [0|0.765] "m/s" Vector__XXX
 SG_ DET_AZIMUTH_101 : 0|13@1+ (0.0004,-1.5708) [-1.5708|1.5708] "rad" Vector__XXX
 SG_ DET_AZIMUTH_ERR_101 : 0|7@1+ (0.00087267,0) [0|0.11082909] "rad" Vector__XXX
 SG_ DET_ELEVATION_101 : 0|8@1+ (0.00275,-0.34925) [-0.34925|0.34925] "rad" Vector__XXX
 SG_ DET_ELEVATION_ERR_101 : 0|6@1+ (0.00174533,0) [0|0.10995579] "rad" Vector__XXX
 SG_ DET_RCS_101 : 0|8@1+ (0.5,-64) [-64|63.5] "dBsm" Vector__XXX
 SG_ DET_BI_STATIC_FLAG_101 : 0|1@1+ (1,0) [0|1] "" Vector__XXX
 SG_ DET_SUPER_RES_TARGET_101 : 0|1@1+ (1,0) [0|1] "" Vector__XXX
 SG_ DET_SNR_101 : 0|8@1+ (0.35156,0) [0|89.6478] "dB" Vector__XXX
 SG_ DET_EXISTENCE_PROB_101 : 0|6@1+ (1.588,0) [0|100] "%" Vector__XXX
 SG_ DET_HVC_FLAG_101 : 0|1@1+ (1,0) [0|1] "" Vector__XXX
 SG_ DET_CONFD_AZIMUTH_101 : 0|2@1+ (1,0) [0|3] "" Vector__XXX
 SG_ DET_CONFD_ELEVATION_101 : 0|2@1+ (1,0) [0|3] "" Vector__XXX
 SG_ DET_PROB_1STAZHYPO_101 : 0|1@1+ (1,0) [0|1] "" Vector__XXX
 SG_ DET_IDM_101 : 0|1@1+ (1,0) [0|1] "" Vector__XXX
 SG_ DET_MTD_101 : 0|1@1+ (1,0) [0|1] "" Vector__XXX
 SG_ DET_BELOW_RAIN_THOLD_101 : 0|1@1+ (1,0) [0|1] "" Vector__XXX
 SG_ DET_RANGE_102 : 0|15@1+ (0.015625,0) [0|500] "m" Vector__XXX
 SG_ DET_RANGE_ERR_102 : 0|7@1+ (0.0075,0) [0|0.9525] "m" Vector__XXX
 SG_ DET_RANGE_VELOCITY_102 : 0|15@1+ (0.0078125,-128) [-128|127.9921875] "m/s" Vector__XXX
 SG_ DET_RANGE_VELOCITY_ERR_102 : 0|8@1+ (0.003,0) [0|0.765] "m/s" Vector__XXX
 SG_ DET_AZIMUTH_102 : 0|13@1+ (0.0004,-1.5708) [-1.5708|1.5708] "rad" Vector__XXX
 SG_ DET_AZIMUTH_ERR_102 : 0|7@1+ (0.00087267,0) [0|0.11082909] "rad" Vector__XXX
 SG_ DET_ELEVATION_102 : 0|8@1+ (0.00275,-0.34925) [-0.34925|0.34925] "rad" Vector__XXX
 SG_ DET_ELEVATION_ERR_102 : 0|6@1+ (0.00174533,0) [0|0.10995579] "rad" Vector__XXX
 SG_ DET_RCS_102 : 0|8@1+ (0.5,-64) [-64|63.5] "dBsm" Vector__XXX
 SG_ DET_BI_STATIC_FLAG_102 : 0|1@1+ (1,0) [0|1] "" Vector__XXX
 SG_ DET_SUPER_RES_TARGET_102 : 0|1@1+ (1,0) [0|1] "" Vector__XXX
 SG_ DET_SNR_102 : 0|8@1+ (0.35156,0) [0|89.6478] "dB" Vector__XXX
 SG_ DET_EXISTENCE_PROB_102 : 0|6@1+ (1.588,0) [0|100] "%" Vector__XXX
 SG_ DET_HVC_FLAG_102 : 0|1@1+ (1,0) [0|1] "" Vector__XXX
 SG_ DET_CONFD_AZIMUTH_102 : 0|2@1+ (1,0) [0|3] "" Vector__XXX
 SG_ DET_CONFD_ELEVATION_102 : 0|2@1+ (1,0) [0|3] "" Vector__XXX
 SG_ DET_PROB_1STAZHYPO_102 : 0|1@1+ (1,0) [0|1] "" Vector__XXX
 SG_ DET_IDM_102 : 0|1@1+ (1,0) [0|1] "" Vector__XXX
 SG_ DET_MTD_102 : 0|1@1+ (1,0) [0|1] "" Vector__XXX
 SG_ DET_BELOW_RAIN_THOLD_102 : 0|1@1+ (1,0) [0|1] "" Vector__XXX
 SG_ DET_RANGE_103 : 0|15@1+ (0.015625,0) [0|500] "m" Vector__XXX
 SG_ DET_RANGE_ERR_103 : 0|7@1+ (0.0075,0) [0|0.9525] "m" Vector__XXX
 SG_ DET_RANGE_VELOCITY_103 : 0|15@1+ (0.0078125,-128) [-128|127.9921875] "m/s" Vector__XXX
 SG_ DET_RANGE_VELOCITY_ERR_103 : 0|8@1+ (0.003,0) [0|0.765] "m/s" Vector__XXX
 SG_ DET_AZIMUTH_103 : 0|13@1+ (0.0004,-1.5708) [-1.5708|1.5708] "rad" Vector__XXX
 SG_ DET_AZIMUTH_ERR_103 : 0|7@1+ (0.00087267,0) [0|0.11082909] "rad" Vector__XXX
 SG_ DET_ELEVATION_103 : 0|8@1+ (0.00275,-0.34925) [-0.34925|0.34925] "rad" Vector__XXX
 SG_ DET_ELEVATION_ERR_103 : 0|6@1+ (0.00174533,0) [0|0.10995579] "rad" Vector__XXX
 SG_ DET_RCS_103 : 0|8@1+ (0.5,-64) [-64|63.5] "dBsm" Vector__XXX
 SG_ DET_BI_STATIC_FLAG_103 : 0|1@1+ (1,0) [0|1] "" Vector__XXX
 SG_ DET_SUPER_RES_TARGET_103 : 0|1@1+ (1,0) [0|1] "" Vector__XXX
 SG_ DET_SNR_103 : 0|8@1+ (0.35156,0) [0|89.6478] "dB" Vector__XXX
 SG_ DET_EXISTENCE_PROB_103 : 0|6@1+ (1.588,0) [0|100] "%" Vector__XXX
 SG_ DET_HVC_FLAG_103 : 0|1@1+ (1,0) [0|1] "" Vector__XXX
 SG_ DET_CONFD_AZIMUTH_103 : 0|2@1+ (1,0) [0|3] "" Vector__XXX
 SG_ DET_CONFD_ELEVATION_103 : 0|2@1+ (1,0) [0|3] "" Vector__XXX
 SG_ DET_PROB_1STAZHYPO_103 : 0|1@1+ (1,0) [0|1] "" Vector__XXX
 SG_ DET_IDM_103 : 0|1@1+ (1,0) [0|1] "" Vector__XXX
 SG_ DET_MTD_103 : 0|1@1+ (1,0) [0|1] "" Vector__XXX
 SG_ DET_BELOW_RAIN_THOLD_103 : 0|1@1+ (1,0) [0|1] "" Vector__XXX
 SG_ DET_RANGE_104 : 0|15@1+ (0.015625,0) [0|500] "m" Vector__XXX
 SG_ DET_RANGE_ERR_104 : 0|7@1+ (0.0075,0) [0|0.9525] "m" Vector__XXX
 SG_ DET_RANGE_VELOCITY_104 : 0|15@1+ (0.0078125,-128) [-128|127.9921875] "m/s" Vector__XXX
 SG_ DET_RANGE_VELOCITY_ERR_104 : 0|8@1+ (0.003,0) [0|0.765] "m/s" Vector__XXX
 SG_ DET_AZIMUTH_104 : 0|13@1+ (0.0004,-1.5708) [-1.5708|1.5708] "rad" Vector__XXX
 SG_ DET_AZIMUTH_ERR_104 : 0|7@1+ (0.00087267,0) [0|0.11082909] "rad" Vector__XXX
 SG_ DET_ELEVATION_104 : 0|8@1+ (0.00275,-0.34925) [-0.34925|0.34925] "rad" Vector__XXX
 SG_ DET_ELEVATION_ERR_104 : 0|6@1+ (0.00174533,0) [0|0.10995579] "rad" Vector__XXX
 SG_ DET_RCS_104 : 0|8@1+ (0.5,-64) [-64|63.5] "dBsm" Vector__XXX
 SG_ DET_BI_STATIC_FLAG_104 : 0|1@1+ (1,0) [0|1] "" Vector__XXX
 SG_ DET_SUPER_RES_TARGET_104 : 0|1@1+ (1,0) [0|1] "" Vector__XXX
 SG_ DET_SNR_104 : 0|8@1+ (0.35156,0) [0|89.6478] "dB" Vector__XXX
 SG_ DET_EXISTENCE_PROB_104 : 0|6@1+ (1.588,0) [0|100] "%" Vector__XXX
 SG_ DET_HVC_FLAG_104 : 0|1@1+ (1,0) [0|1] "" Vector__XXX
 SG_ DET_CONFD_AZIMUTH_104 : 0|2@1+ (1,0) [0|3] "" Vector__XXX
 SG_ DET_CONFD_ELEVATION_104 : 0|2@1+ (1,0) [0|3] "" Vector__XXX
 SG_ DET_MH_SCAN_INDEX_4LSB_101_104 : 0|4@1+ (1,0) [0|15] "" Vector__XXX
 SG_ DET_MH_CYCLE_COUNTER_101_104 : 0|8@1+ (1,0) [0|255] "" Vector__XXX
 SG_ DET_MH_CRC16_101_104 : 0|16@1+ (1,0) [0|65535] "" Vector__XXX
 SG_ DET_PROB_1STAZHYPO_104 : 0|1@1+ (1,0) [0|1] "" Vector__XXX
 SG_ DET_IDM_104 : 0|1@1+ (1,0) [0|1] "" Vector__XXX
 SG_ DET_MTD_104 : 0|1@1+ (1,0) [0|1] "" Vector__XXX
 SG_ DET_BELOW_RAIN_THOLD_104 : 0|1@1+ (1,0) [0|1] "" Vector__XXX
 SG_ DET_RANGE_105 : 0|15@1+ (0.015625,0) [0|500] "m" Vector__XXX
 SG_ DET_RANGE_ERR_105 : 0|7@1+ (0.0075,0) [0|0.9525] "m" Vector__XXX
 SG_ DET_RANGE_VELOCITY_105 : 0|15@1+ (0.0078125,-128) [-128|127.9921875] "m/s" Vector__XXX
 SG_ DET_RANGE_VELOCITY_ERR_105 : 0|8@1+ (0.003,0) [0|0.765] "m/s" Vector__XXX
 SG_ DET_AZIMUTH_105 : 0|13@1+ (0.0004,-1.5708) [-1.5708|1.5708] "rad" Vector__XXX
 SG_ DET_AZIMUTH_ERR_105 : 0|7@1+ (0.00087267,0) [0|0.11082909] "rad" Vector__XXX
 SG_ DET_ELEVATION_105 : 0|8@1+ (0.00275,-0.34925) [-0.34925|0.34925] "rad" Vector__XXX
 SG_ DET_ELEVATION_ERR_105 : 0|6@1+ (0.00174533,0) [0|0.10995579] "rad" Vector__XXX
 SG_ DET_RCS_105 : 0|8@1+ (0.5,-64) [-64|63.5] "dBsm" Vector__XXX
 SG_ DET_BI_STATIC_FLAG_105 : 0|1@1+ (1,0) [0|1] "" Vector__XXX
 SG_ DET_SUPER_RES_TARGET_105 : 0|1@1+ (1,0) [0|1] "" Vector__XXX
 SG_ DET_SNR_105 : 0|8@1+ (0.35156,0) [0|89.6478] "dB" Vector__XXX
 SG_ DET_EXISTENCE_PROB_105 : 0|6@1+ (1.588,0) [0|100] "%" Vector__XXX
 SG_ DET_HVC_FLAG_105 : 0|1@1+ (1,0) [0|1] "" Vector__XXX
 SG_ DET_CONFD_AZIMUTH_105 : 0|2@1+ (1,0) [0|3] "" Vector__XXX
 SG_ DET_CONFD_ELEVATION_105 : 0|2@1+ (1,0) [0|3] "" Vector__XXX
 SG_ DET_PROB_1STAZHYPO_105 : 0|1@1+ (1,0) [0|1] "" Vector__XXX
 SG_ DET_IDM_105 : 0|1@1+ (1,0) [0|1] "" Vector__XXX
 SG_ DET_MTD_105 : 0|1@1+ (1,0) [0|1] "" Vector__XXX
 SG_ DET_BELOW_RAIN_THOLD_105 : 0|1@1+ (1,0) [0|1] "" Vector__XXX
 SG_ DET_RANGE_106 : 0|15@1+ (0.015625,0) [0|500] "m" Vector__XXX
 SG_ DET_RANGE_ERR_106 : 0|7@1+ (0.0075,0) [0|0.9525] "m" Vector__XXX
 SG_ DET_RANGE_VELOCITY_106 : 0|15@1+ (0.0078125,-128) [-128|127.9921875] "m/s" Vector__XXX
 SG_ DET_RANGE_VELOCITY_ERR_106 : 0|8@1+ (0.003,0) [0|0.765] "m/s" Vector__XXX
 SG_ DET_AZIMUTH_106 : 0|13@1+ (0.0004,-1.5708) [-1.5708|1.5708] "rad" Vector__XXX
 SG_ DET_AZIMUTH_ERR_106 : 0|7@1+ (0.00087267,0) [0|0.11082909] "rad" Vector__XXX
 SG_ DET_ELEVATION_106 : 0|8@1+ (0.00275,-0.34925) [-0.34925|0.34925] "rad" Vector__XXX
 SG_ DET_ELEVATION_ERR_106 : 0|6@1+ (0.00174533,0) [0|0.10995579] "rad" Vector__XXX
 SG_ DET_RCS_106 : 0|8@1+ (0.5,-64) [-64|63.5] "dBsm" Vector__XXX
 SG_ DET_BI_STATIC_FLAG_106 : 0|1@1+ (1,0) [0|1] "" Vector__XXX
 SG_ DET_SUPER_RES_TARGET_106 : 0|1@1+ (1,0) [0|1] "" Vector__XXX
 SG_ DET_SNR_106 : 0|8@1+ (0.35156,0) [0|89.6478] "dB" Vector__XXX
 SG_ DET_EXISTENCE_PROB_106 : 0|6@1+ (1.588,0) [0|100] "%" Vector__XXX
 SG_ DET_HVC_FLAG_106 : 0|1@1+ (1,0) [0|1] "" Vector__XXX
 SG_ DET_CONFD_AZIMUTH_106 : 0|2@1+ (1,0) [0|3] "" Vector__XXX
 SG_ DET_CONFD_ELEVATION_106 : 0|2@1+ (1,0) [0|3] "" Vector__XXX
 SG_ DET_PROB_1STAZHYPO_106 : 0|1@1+ (1,0) [0|1] "" Vector__XXX
 SG_ DET_IDM_106 : 0|1@1+ (1,0) [0|1] "" Vector__XXX
 SG_ DET_MTD_106 : 0|1@1+ (1,0) [0|1] "" Vector__XXX
 SG_ DET_BELOW_RAIN_THOLD_106 : 0|1@1+ (1,0) [0|1] "" Vector__XXX
 SG_ DET_RANGE_107 : 0|15@1+ (0.015625,0) [0|500] "m" Vector__XXX
 SG_ DET_RANGE_ERR_107 : 0|7@1+ (0.0075,0) [0|0.9525] "m" Vector__XXX
 SG_ DET_RANGE_VELOCITY_107 : 0|15@1+ (0.0078125,-128) [-128|127.9921875] "m/s" Vector__XXX
 SG_ DET_RANGE_VELOCITY_ERR_107 : 0|8@1+ (0.003,0) [0|0.765] "m/s" Vector__XXX
 SG_ DET_AZIMUTH_107 : 0|13@1+ (0.0004,-1.5708) [-1.5708|1.5708] "rad" Vector__XXX
 SG_ DET_AZIMUTH_ERR_107 : 0|7@1+ (0.00087267,0) [0|0.11082909] "rad" Vector__XXX
 SG_ DET_ELEVATION_107 : 0|8@1+ (0.00275,-0.34925) [-0.34925|0.34925] "rad" Vector__XXX
 SG_ DET_ELEVATION_ERR_107 : 0|6@1+ (0.00174533,0) [0|0.10995579] "rad" Vector__XXX
 SG_ DET_RCS_107 : 0|8@1+ (0.5,-64) [-64|63.5] "dBsm" Vector__XXX
 SG_ DET_BI_STATIC_FLAG_107 : 0|1@1+ (1,0) [0|1] "" Vector__XXX
 SG_ DET_SUPER_RES_TARGET_107 : 0|1@1+ (1,0) [0|1] "" Vector__XXX
 SG_ DET_SNR_107 : 0|8@1+ (0.35156,0) [0|89.6478] "dB" Vector__XXX
 SG_ DET_EXISTENCE_PROB_107 : 0|6@1+ (1.588,0) [0|100] "%" Vector__XXX
 SG_ DET_HVC_FLAG_107 : 0|1@1+ (1,0) [0|1] "" Vector__XXX
 SG_ DET_CONFD_AZIMUTH_107 : 0|2@1+ (1,0) [0|3] "" Vector__XXX
 SG_ DET_CONFD_ELEVATION_107 : 0|2@1+ (1,0) [0|3] "" Vector__XXX
 SG_ DET_PROB_1STAZHYPO_107 : 0|1@1+ (1,0) [0|1] "" Vector__XXX
 SG_ DET_IDM_107 : 0|1@1+ (1,0) [0|1] "" Vector__XXX
 SG_ DET_MTD_107 : 0|1@1+ (1,0) [0|1] "" Vector__XXX
 SG_ DET_BELOW_RAIN_THOLD_107 : 0|1@1+ (1,0) [0|1] "" Vector__XXX
 SG_ DET_RANGE_108 : 0|15@1+ (0.015625,0) [0|500] "m" Vector__XXX
 SG_ DET_RANGE_ERR_108 : 0|7@1+ (0.0075,0) [0|0.9525] "m" Vector__XXX
 SG_ DET_RANGE_VELOCITY_108 : 0|15@1+ (0.0078125,-128) [-128|127.9921875] "m/s" Vector__XXX
 SG_ DET_RANGE_VELOCITY_ERR_108 : 0|8@1+ (0.003,0) [0|0.765] "m/s" Vector__XXX
 SG_ DET_AZIMUTH_108 : 0|13@1+ (0.0004,-1.5708) [-1.5708|1.5708] "rad" Vector__XXX
 SG_ DET_AZIMUTH_ERR_108 : 0|7@1+ (0.00087267,0) [0|0.11082909] "rad" Vector__XXX
 SG_ DET_ELEVATION_108 : 0|8@1+ (0.00275,-0.34925) [-0.34925|0.34925] "rad" Vector__XXX
 SG_ DET_ELEVATION_ERR_108 : 0|6@1+ (0.00174533,0) [0|0.10995579] "rad" Vector__XXX
 SG_ DET_RCS_108 : 0|8@1+ (0.5,-64) [-64|63.5] "dBsm" Vector__XXX
 SG_ DET_BI_STATIC_FLAG_108 : 0|1@1+ (1,0) [0|1] "" Vector__XXX
 SG_ DET_SUPER_RES_TARGET_108 : 0|1@1+ (1,0) [0|1] "" Vector__XXX
 SG_ DET_SNR_108 : 0|8@1+ (0.35156,0) [0|89.6478] "dB" Vector__XXX
 SG_ DET_EXISTENCE_PROB_108 : 0|6@1+ (1.588,0) [0|100] "%" Vector__XXX
 SG_ DET_HVC_FLAG_108 : 0|1@1+ (1,0) [0|1] "" Vector__XXX
 SG_ DET_CONFD_AZIMUTH_108 : 0|2@1+ (1,0) [0|3] "" Vector__XXX
 SG_ DET_CONFD_ELEVATION_108 : 0|2@1+ (1,0) [0|3] "" Vector__XXX
 SG_ DET_MH_SCAN_INDEX_4LSB_105_108 : 0|4@1+ (1,0) [0|15] "" Vector__XXX
 SG_ DET_MH_CYCLE_COUNTER_105_108 : 0|8@1+ (1,0) [0|255] "" Vector__XXX
 SG_ DET_MH_CRC16_105_108 : 0|16@1+ (1,0) [0|65535] "" Vector__XXX
 SG_ DET_PROB_1STAZHYPO_108 : 0|1@1+ (1,0) [0|1] "" Vector__XXX
 SG_ DET_IDM_108 : 0|1@1+ (1,0) [0|1] "" Vector__XXX
 SG_ DET_MTD_108 : 0|1@1+ (1,0) [0|1] "" Vector__XXX
 SG_ DET_BELOW_RAIN_THOLD_108 : 0|1@1+ (1,0) [0|1] "" Vector__XXX
 SG_ DET_RANGE_109 : 0|15@1+ (0.015625,0) [0|500] "m" Vector__XXX
 SG_ DET_RANGE_ERR_109 : 0|7@1+ (0.0075,0) [0|0.9525] "m" Vector__XXX
 SG_ DET_RANGE_VELOCITY_109 : 0|15@1+ (0.0078125,-128) [-128|127.9921875] "m/s" Vector__XXX
 SG_ DET_RANGE_VELOCITY_ERR_109 : 0|8@1+ (0.003,0) [0|0.765] "m/s" Vector__XXX
 SG_ DET_AZIMUTH_109 : 0|13@1+ (0.0004,-1.5708) [-1.5708|1.5708] "rad" Vector__XXX
 SG_ DET_AZIMUTH_ERR_109 : 0|7@1+ (0.00087267,0) [0|0.11082909] "rad" Vector__XXX
 SG_ DET_ELEVATION_109 : 0|8@1+ (0.00275,-0.34925) [-0.34925|0.34925] "rad" Vector__XXX
 SG_ DET_ELEVATION_ERR_109 : 0|6@1+ (0.00174533,0) [0|0.10995579] "rad" Vector__XXX
 SG_ DET_RCS_109 : 0|8@1+ (0.5,-64) [-64|63.5] "dBsm" Vector__XXX
 SG_ DET_BI_STATIC_FLAG_109 : 0|1@1+ (1,0) [0|1] "" Vector__XXX
 SG_ DET_SUPER_RES_TARGET_109 : 0|1@1+ (1,0) [0|1] "" Vector__XXX
 SG_ DET_SNR_109 : 0|8@1+ (0.35156,0) [0|89.6478] "dB" Vector__XXX
 SG_ DET_EXISTENCE_PROB_109 : 0|6@1+ (1.588,0) [0|100] "%" Vector__XXX
 SG_ DET_HVC_FLAG_109 : 0|1@1+ (1,0) [0|1] "" Vector__XXX
 SG_ DET_CONFD_AZIMUTH_109 : 0|2@1+ (1,0) [0|3] "" Vector__XXX
 SG_ DET_CONFD_ELEVATION_109 : 0|2@1+ (1,0) [0|3] "" Vector__XXX
 SG_ DET_PROB_1STAZHYPO_109 : 0|1@1+ (1,0) [0|1] "" Vector__XXX
 SG_ DET_IDM_109 : 0|1@1+ (1,0) [0|1] "" Vector__XXX
 SG_ DET_MTD_109 : 0|1@1+ (1,0) [0|1] "" Vector__XXX
 SG_ DET_BELOW_RAIN_THOLD_109 : 0|1@1+ (1,0) [0|1] "" Vector__XXX
 SG_ DET_RANGE_110 : 0|15@1+ (0.015625,0) [0|500] "m" Vector__XXX
 SG_ DET_RANGE_ERR_110 : 0|7@1+ (0.0075,0) [0|0.9525] "m" Vector__XXX
 SG_ DET_RANGE_VELOCITY_110 : 0|15@1+ (0.0078125,-128) [-128|127.9921875] "m/s" Vector__XXX
 SG_ DET_RANGE_VELOCITY_ERR_110 : 0|8@1+ (0.003,0) [0|0.765] "m/s" Vector__XXX
 SG_ DET_AZIMUTH_110 : 0|13@1+ (0.0004,-1.5708) [-1.5708|1.5708] "rad" Vector__XXX
 SG_ DET_AZIMUTH_ERR_110 : 0|7@1+ (0.00087267,0) [0|0.11082909] "rad" Vector__XXX
 SG_ DET_ELEVATION_110 : 0|8@1+ (0.00275,-0.34925) [-0.34925|0.34925] "rad" Vector__XXX
 SG_ DET_ELEVATION_ERR_110 : 0|6@1+ (0.00174533,0) [0|0.10995579] "rad" Vector__XXX
 SG_ DET_RCS_110 : 0|8@1+ (0.5,-64) [-64|63.5] "dBsm" Vector__XXX
 SG_ DET_BI_STATIC_FLAG_110 : 0|1@1+ (1,0) [0|1] "" Vector__XXX
 SG_ DET_SUPER_RES_TARGET_110 : 0|1@1+ (1,0) [0|1] "" Vector__XXX
 SG_ DET_SNR_110 : 0|8@1+ (0.35156,0) [0|89.6478] "dB" Vector__XXX
 SG_ DET_EXISTENCE_PROB_110 : 0|6@1+ (1.588,0) [0|100] "%" Vector__XXX
 SG_ DET_HVC_FLAG_110 : 0|1@1+ (1,0) [0|1] "" Vector__XXX
 SG_ DET_CONFD_AZIMUTH_110 : 0|2@1+ (1,0) [0|3] "" Vector__XXX
 SG_ DET_CONFD_ELEVATION_110 : 0|2@1+ (1,0) [0|3] "" Vector__XXX
 SG_ DET_PROB_1STAZHYPO_110 : 0|1@1+ (1,0) [0|1] "" Vector__XXX
 SG_ DET_IDM_110 : 0|1@1+ (1,0) [0|1] "" Vector__XXX
 SG_ DET_MTD_110 : 0|1@1+ (1,0) [0|1] "" Vector__XXX
 SG_ DET_BELOW_RAIN_THOLD_110 : 0|1@1+ (1,0) [0|1] "" Vector__XXX
 SG_ DET_RANGE_111 : 0|15@1+ (0.015625,0) [0|500] "m" Vector__XXX
 SG_ DET_RANGE_ERR_111 : 0|7@1+ (0.0075,0) [0|0.9525] "m" Vector__XXX
 SG_ DET_RANGE_VELOCITY_111 : 0|15@1+ (0.0078125,-128) [-128|127.9921875] "m/s" Vector__XXX
 SG_ DET_RANGE_VELOCITY_ERR_111 : 0|8@1+ (0.003,0) [0|0.765] "m/s" Vector__XXX
 SG_ DET_AZIMUTH_111 : 0|13@1+ (0.0004,-1.5708) [-1.5708|1.5708] "rad" Vector__XXX
 SG_ DET_AZIMUTH_ERR_111 : 0|7@1+ (0.00087267,0) [0|0.11082909] "rad" Vector__XXX
 SG_ DET_ELEVATION_111 : 0|8@1+ (0.00275,-0.34925) [-0.34925|0.34925] "rad" Vector__XXX
 SG_ DET_ELEVATION_ERR_111 : 0|6@1+ (0.00174533,0) [0|0.10995579] "rad" Vector__XXX
 SG_ DET_RCS_111 : 0|8@1+ (0.5,-64) [-64|63.5] "dBsm" Vector__XXX
 SG_ DET_BI_STATIC_FLAG_111 : 0|1@1+ (1,0) [0|1] "" Vector__XXX
 SG_ DET_SUPER_RES_TARGET_111 : 0|1@1+ (1,0) [0|1] "" Vector__XXX
 SG_ DET_SNR_111 : 0|8@1+ (0.35156,0) [0|89.6478] "dB" Vector__XXX
 SG_ DET_EXISTENCE_PROB_111 : 0|6@1+ (1.588,0) [0|100] "%" Vector__XXX
 SG_ DET_HVC_FLAG_111 : 0|1@1+ (1,0) [0|1] "" Vector__XXX
 SG_ DET_CONFD_AZIMUTH_111 : 0|2@1+ (1,0) [0|3] "" Vector__XXX
 SG_ DET_CONFD_ELEVATION_111 : 0|2@1+ (1,0) [0|3] "" Vector__XXX
 SG_ DET_PROB_1STAZHYPO_111 : 0|1@1+ (1,0) [0|1] "" Vector__XXX
 SG_ DET_IDM_111 : 0|1@1+ (1,0) [0|1] "" Vector__XXX
 SG_ DET_MTD_111 : 0|1@1+ (1,0) [0|1] "" Vector__XXX
 SG_ DET_BELOW_RAIN_THOLD_111 : 0|1@1+ (1,0) [0|1] "" Vector__XXX
 SG_ DET_RANGE_112 : 0|15@1+ (0.015625,0) [0|500] "m" Vector__XXX
 SG_ DET_RANGE_ERR_112 : 0|7@1+ (0.0075,0) [0|0.9525] "m" Vector__XXX
 SG_ DET_RANGE_VELOCITY_112 : 0|15@1+ (0.0078125,-128) [-128|127.9921875] "m/s" Vector__XXX
 SG_ DET_RANGE_VELOCITY_ERR_112 : 0|8@1+ (0.003,0) [0|0.765] "m/s" Vector__XXX
 SG_ DET_AZIMUTH_112 : 0|13@1+ (0.0004,-1.5708) [-1.5708|1.5708] "rad" Vector__XXX
 SG_ DET_AZIMUTH_ERR_112 : 0|7@1+ (0.00087267,0) [0|0.11082909] "rad" Vector__XXX
 SG_ DET_ELEVATION_112 : 0|8@1+ (0.00275,-0.34925) [-0.34925|0.34925] "rad" Vector__XXX
 SG_ DET_ELEVATION_ERR_112 : 0|6@1+ (0.00174533,0) [0|0.10995579] "rad" Vector__XXX
 SG_ DET_RCS_112 : 0|8@1+ (0.5,-64) [-64|63.5] "dBsm" Vector__XXX
 SG_ DET_BI_STATIC_FLAG_112 : 0|1@1+ (1,0) [0|1] "" Vector__XXX
 SG_ DET_SUPER_RES_TARGET_112 : 0|1@1+ (1,0) [0|1] "" Vector__XXX
 SG_ DET_SNR_112 : 0|8@1+ (0.35156,0) [0|89.6478] "dB" Vector__XXX
 SG_ DET_EXISTENCE_PROB_112 : 0|6@1+ (1.588,0) [0|100] "%" Vector__XXX
 SG_ DET_HVC_FLAG_112 : 0|1@1+ (1,0) [0|1] "" Vector__XXX
 SG_ DET_CONFD_AZIMUTH_112 : 0|2@1+ (1,0) [0|3] "" Vector__XXX
 SG_ DET_CONFD_ELEVATION_112 : 0|2@1+ (1,0) [0|3] "" Vector__XXX
 SG_ DET_MH_SCAN_INDEX_4LSB_109_112 : 0|4@1+ (1,0) [0|15] "" Vector__XXX
 SG_ DET_MH_CYCLE_COUNTER_109_112 : 0|8@1+ (1,0) [0|255] "" Vector__XXX
 SG_ DET_MH_CRC16_109_112 : 0|16@1+ (1,0) [0|65535] "" Vector__XXX
 SG_ DET_PROB_1STAZHYPO_112 : 0|1@1+ (1,0) [0|1] "" Vector__XXX
 SG_ DET_IDM_112 : 0|1@1+ (1,0) [0|1] "" Vector__XXX
 SG_ DET_MTD_112 : 0|1@1+ (1,0) [0|1] "" Vector__XXX
 SG_ DET_BELOW_RAIN_THOLD_112 : 0|1@1+ (1,0) [0|1] "" Vector__XXX
 SG_ DET_RANGE_113 : 0|15@1+ (0.015625,0) [0|500] "m" Vector__XXX
 SG_ DET_RANGE_ERR_113 : 0|7@1+ (0.0075,0) [0|0.9525] "m" Vector__XXX
 SG_ DET_RANGE_VELOCITY_113 : 0|15@1+ (0.0078125,-128) [-128|127.9921875] "m/s" Vector__XXX
 SG_ DET_RANGE_VELOCITY_ERR_113 : 0|8@1+ (0.003,0) [0|0.765] "m/s" Vector__XXX
 SG_ DET_AZIMUTH_113 : 0|13@1+ (0.0004,-1.5708) [-1.5708|1.5708] "rad" Vector__XXX
 SG_ DET_AZIMUTH_ERR_113 : 0|7@1+ (0.00087267,0) [0|0.11082909] "rad" Vector__XXX
 SG_ DET_ELEVATION_113 : 0|8@1+ (0.00275,-0.34925) [-0.34925|0.34925] "rad" Vector__XXX
 SG_ DET_ELEVATION_ERR_113 : 0|6@1+ (0.00174533,0) [0|0.10995579] "rad" Vector__XXX
 SG_ DET_RCS_113 : 0|8@1+ (0.5,-64) [-64|63.5] "dBsm" Vector__XXX
 SG_ DET_BI_STATIC_FLAG_113 : 0|1@1+ (1,0) [0|1] "" Vector__XXX
 SG_ DET_SUPER_RES_TARGET_113 : 0|1@1+ (1,0) [0|1] "" Vector__XXX
 SG_ DET_SNR_113 : 0|8@1+ (0.35156,0) [0|89.6478] "dB" Vector__XXX
 SG_ DET_EXISTENCE_PROB_113 : 0|6@1+ (1.588,0) [0|100] "%" Vector__XXX
 SG_ DET_HVC_FLAG_113 : 0|1@1+ (1,0) [0|1] "" Vector__XXX
 SG_ DET_CONFD_AZIMUTH_113 : 0|2@1+ (1,0) [0|3] "" Vector__XXX
 SG_ DET_CONFD_ELEVATION_113 : 0|2@1+ (1,0) [0|3] "" Vector__XXX
 SG_ DET_PROB_1STAZHYPO_113 : 0|1@1+ (1,0) [0|1] "" Vector__XXX
 SG_ DET_IDM_113 : 0|1@1+ (1,0) [0|1] "" Vector__XXX
 SG_ DET_MTD_113 : 0|1@1+ (1,0) [0|1] "" Vector__XXX
 SG_ DET_BELOW_RAIN_THOLD_113 : 0|1@1+ (1,0) [0|1] "" Vector__XXX
 SG_ DET_RANGE_114 : 0|15@1+ (0.015625,0) [0|500] "m" Vector__XXX
 SG_ DET_RANGE_ERR_114 : 0|7@1+ (0.0075,0) [0|0.9525] "m" Vector__XXX
 SG_ DET_RANGE_VELOCITY_114 : 0|15@1+ (0.0078125,-128) [-128|127.9921875] "m/s" Vector__XXX
 SG_ DET_RANGE_VELOCITY_ERR_114 : 0|8@1+ (0.003,0) [0|0.765] "m/s" Vector__XXX
 SG_ DET_AZIMUTH_114 : 0|13@1+ (0.0004,-1.5708) [-1.5708|1.5708] "rad" Vector__XXX
 SG_ DET_AZIMUTH_ERR_114 : 0|7@1+ (0.00087267,0) [0|0.11082909] "rad" Vector__XXX
 SG_ DET_ELEVATION_114 : 0|8@1+ (0.00275,-0.34925) [-0.34925|0.34925] "rad" Vector__XXX
 SG_ DET_ELEVATION_ERR_114 : 0|6@1+ (0.00174533,0) [0|0.10995579] "rad" Vector__XXX
 SG_ DET_RCS_114 : 0|8@1+ (0.5,-64) [-64|63.5] "dBsm" Vector__XXX
 SG_ DET_BI_STATIC_FLAG_114 : 0|1@1+ (1,0) [0|1] "" Vector__XXX
 SG_ DET_SUPER_RES_TARGET_114 : 0|1@1+ (1,0) [0|1] "" Vector__XXX
 SG_ DET_SNR_114 : 0|8@1+ (0.35156,0) [0|89.6478] "dB" Vector__XXX
 SG_ DET_EXISTENCE_PROB_114 : 0|6@1+ (1.588,0) [0|100] "%" Vector__XXX
 SG_ DET_HVC_FLAG_114 : 0|1@1+ (1,0) [0|1] "" Vector__XXX
 SG_ DET_CONFD_AZIMUTH_114 : 0|2@1+ (1,0) [0|3] "" Vector__XXX
 SG_ DET_CONFD_ELEVATION_114 : 0|2@1+ (1,0) [0|3] "" Vector__XXX
 SG_ DET_PROB_1STAZHYPO_114 : 0|1@1+ (1,0) [0|1] "" Vector__XXX
 SG_ DET_IDM_114 : 0|1@1+ (1,0) [0|1] "" Vector__XXX
 SG_ DET_MTD_114 : 0|1@1+ (1,0) [0|1] "" Vector__XXX
 SG_ DET_BELOW_RAIN_THOLD_114 : 0|1@1+ (1,0) [0|1] "" Vector__XXX
 SG_ DET_RANGE_115 : 0|15@1+ (0.015625,0) [0|500] "m" Vector__XXX
 SG_ DET_RANGE_ERR_115 : 0|7@1+ (0.0075,0) [0|0.9525] "m" Vector__XXX
 SG_ DET_RANGE_VELOCITY_115 : 0|15@1+ (0.0078125,-128) [-128|127.9921875] "m/s" Vector__XXX
 SG_ DET_RANGE_VELOCITY_ERR_115 : 0|8@1+ (0.003,0) [0|0.765] "m/s" Vector__XXX
 SG_ DET_AZIMUTH_115 : 0|13@1+ (0.0004,-1.5708) [-1.5708|1.5708] "rad" Vector__XXX
 SG_ DET_AZIMUTH_ERR_115 : 0|7@1+ (0.00087267,0) [0|0.11082909] "rad" Vector__XXX
 SG_ DET_ELEVATION_115 : 0|8@1+ (0.00275,-0.34925) [-0.34925|0.34925] "rad" Vector__XXX
 SG_ DET_ELEVATION_ERR_115 : 0|6@1+ (0.00174533,0) [0|0.10995579] "rad" Vector__XXX
 SG_ DET_RCS_115 : 0|8@1+ (0.5,-64) [-64|63.5] "dBsm" Vector__XXX
 SG_ DET_BI_STATIC_FLAG_115 : 0|1@1+ (1,0) [0|1] "" Vector__XXX
 SG_ DET_SUPER_RES_TARGET_115 : 0|1@1+ (1,0) [0|1] "" Vector__XXX
 SG_ DET_SNR_115 : 0|8@1+ (0.35156,0) [0|89.6478] "dB" Vector__XXX
 SG_ DET_EXISTENCE_PROB_115 : 0|6@1+ (1.588,0) [0|100] "%" Vector__XXX
 SG_ DET_HVC_FLAG_115 : 0|1@1+ (1,0) [0|1] "" Vector__XXX
 SG_ DET_CONFD_AZIMUTH_115 : 0|2@1+ (1,0) [0|3] "" Vector__XXX
 SG_ DET_CONFD_ELEVATION_115 : 0|2@1+ (1,0) [0|3] "" Vector__XXX
 SG_ DET_PROB_1STAZHYPO_115 : 0|1@1+ (1,0) [0|1] "" Vector__XXX
 SG_ DET_IDM_115 : 0|1@1+ (1,0) [0|1] "" Vector__XXX
 SG_ DET_MTD_115 : 0|1@1+ (1,0) [0|1] "" Vector__XXX
 SG_ DET_BELOW_RAIN_THOLD_115 : 0|1@1+ (1,0) [0|1] "" Vector__XXX
 SG_ DET_RANGE_116 : 0|15@1+ (0.015625,0) [0|500] "m" Vector__XXX
 SG_ DET_RANGE_ERR_116 : 0|7@1+ (0.0075,0) [0|0.9525] "m" Vector__XXX
 SG_ DET_RANGE_VELOCITY_116 : 0|15@1+ (0.0078125,-128) [-128|127.9921875] "m/s" Vector__XXX
 SG_ DET_RANGE_VELOCITY_ERR_116 : 0|8@1+ (0.003,0) [0|0.765] "m/s" Vector__XXX
 SG_ DET_AZIMUTH_116 : 0|13@1+ (0.0004,-1.5708) [-1.5708|1.5708] "rad" Vector__XXX
 SG_ DET_AZIMUTH_ERR_116 : 0|7@1+ (0.00087267,0) [0|0.11082909] "rad" Vector__XXX
 SG_ DET_ELEVATION_116 : 0|8@1+ (0.00275,-0.34925) [-0.34925|0.34925] "rad" Vector__XXX
 SG_ DET_ELEVATION_ERR_116 : 0|6@1+ (0.00174533,0) [0|0.10995579] "rad" Vector__XXX
 SG_ DET_RCS_116 : 0|8@1+ (0.5,-64) [-64|63.5] "dBsm" Vector__XXX
 SG_ DET_BI_STATIC_FLAG_116 : 0|1@1+ (1,0) [0|1] "" Vector__XXX
 SG_ DET_SUPER_RES_TARGET_116 : 0|1@1+ (1,0) [0|1] "" Vector__XXX
 SG_ DET_SNR_116 : 0|8@1+ (0.35156,0) [0|89.6478] "dB" Vector__XXX
 SG_ DET_EXISTENCE_PROB_116 : 0|6@1+ (1.588,0) [0|100] "%" Vector__XXX
 SG_ DET_HVC_FLAG_116 : 0|1@1+ (1,0) [0|1] "" Vector__XXX
 SG_ DET_CONFD_AZIMUTH_116 : 0|2@1+ (1,0) [0|3] "" Vector__XXX
 SG_ DET_CONFD_ELEVATION_116 : 0|2@1+ (1,0) [0|3] "" Vector__XXX
 SG_ DET_MH_SCAN_INDEX_4LSB_113_116 : 0|4@1+ (1,0) [0|15] "" Vector__XXX
 SG_ DET_MH_CYCLE_COUNTER_113_116 : 0|8@1+ (1,0) [0|255] "" Vector__XXX
 SG_ Diag_Req_Func : 0|64@0+ (1,0) [0|0] "" Vector__XXX
 SG_ Diag_Req_Func : 0|64@0+ (1,0) [0|0] "" Vector__XXX
 SG_ Diag_Req_Func : 0|64@0+ (1,0) [0|0] "" Vector__XXX
 SG_ Diag_Req_Func : 0|64@0+ (1,0) [0|0] "" Vector__XXX
 SG_ Diag_Req_Phys : 0|64@0+ (1,0) [0|0] "" Vector__XXX
 SG_ Diag_Req_Phys : 0|64@0+ (1,0) [0|0] "" Vector__XXX
 SG_ Diag_Req_Phys : 0|64@0+ (1,0) [0|0] "" Vector__XXX

CM_ BO_ 3221225472 "This is a message for not used signals, created by Vector CANdb++ DBC OLE DB Provider.";
BA_DEF_  "J1939TransportLayer" ENUM  "ClassicTpOnly";
BA_DEF_  "SAE_J1939_21_SpecVersion" STRING ;
BA_DEF_ BO_  "VFrameFormat" ENUM  "StandardCAN","ExtendedCAN","reserved","reserved","reserved","reserved","reserved","reserved","reserved","reserved","reserved","reserved","reserved","reserved","StandardCAN_FD","ExtendedCAN_FD";
BA_DEF_ BO_  "CanTpBs" INT 0 255;
BA_DEF_ BO_  "DiagConnection" INT 0 65535;
BA_DEF_ BO_  "DiagRequest" ENUM  "No","Yes";
BA_DEF_ BO_  "DiagResponse" ENUM  "No","Yes";
BA_DEF_ BO_  "DiagState" ENUM  "No","Yes";
BA_DEF_ BO_  "E2EDataId" INT 0 65535;
BA_DEF_ BO_  "E2EDataLength" INT 0 65535;
BA_DEF_ BO_  "E2EProfile" STRING ;
BA_DEF_ BO_  "EventRateOfChange" INT 10 10000;
BA_DEF_ BO_  "GenMsgCycleTime" INT 0 100000;
BA_DEF_ BO_  "GenMsgILSupport" ENUM  "No","Yes";
BA_DEF_ BO_  "GenMsgNrOfRepetition" INT 0 100;
BA_DEF_ BO_  "GenMsgSendType" ENUM  "FixedPeriodic","Event","EnabledPeriodic","NotUsed","NotUsed","EventPeriodic","NotUsed","NotUsed","NoMsgSendType";
BA_DEF_ BO_  "NetworkInitialization" ENUM  "No","Yes";
BA_DEF_ BO_  "NmAsrMessage" ENUM  "No","Yes";
BA_DEF_ BO_  "NmMessage" ENUM  "No","Yes";
BA_DEF_ BO_  "SCP_AuthInfoTxLength" INT 0 512;
BA_DEF_ BO_  "SCP_FreshnessValueLength" INT 0 512;
BA_DEF_ BO_  "SCP_FreshnessValueTxLength" INT 0 512;
BA_DEF_ BO_  "TpTxIndex" INT 0 255;
BA_DEF_ SG_  "GenSigCmt" STRING ;
BA_DEF_ SG_  "GenSigCycleTime" INT 0 0;
BA_DEF_ SG_  "GenSigSendType" ENUM  "Cyclic","OnWrite","vector_leerstring","OnChange","vector_leerstring","IfActive","vector_leerstring","NoSigSendType";
BA_DEF_ SG_  "GenSigStartValue" INT 0 1000000000;
BA_DEF_ SG_  "GenSigTimeoutTime" INT 0 0;
BA_DEF_ SG_  "GenSigVtEn" STRING ;
BA_DEF_ SG_  "GenSigVtName" STRING ;
BA_DEF_ SG_  "InvalidValue" STRING ;
BA_DEF_ BU_  "NmAsrNodeIdentifier" HEX 128 255;
BA_DEF_ BU_  "NmStationAddress" HEX 0 0;
BA_DEF_ BU_  "NodeStartUpTime" INT 0 10000;
BA_DEF_ BU_  "NodeWakeUpTime" INT 0 10000;
BA_DEF_ BU_  "PowerType" ENUM  "Switched","Latched","Sleep","vector_leerstring","vector_leerstring";
BA_DEF_ BU_  "TpOwnSystemEcuNumber" HEX 0 255;
BA_DEF_  "Baudrate" INT 0 2000000;
BA_DEF_  "BaudrateCANFD" INT 0 2000000;
BA_DEF_  "BusType" STRING ;
BA_DEF_  "DBName" STRING ;
BA_DEF_  "E2EP05MaxDeltaCounter" INT 0 65535;
BA_DEF_  "E2EP05MaxErrorStateInit" INT 0 65535;
BA_DEF_  "E2EP05MaxErrorStateInvalid" INT 0 65535;
BA_DEF_  "E2EP05MaxErrorStateValid" INT 0 65535;
BA_DEF_  "E2EP05MinOkStateInit" INT 0 65535;
BA_DEF_  "E2EP05MinOkStateInvalid" INT 0 65535;
BA_DEF_  "E2EP05MinOkStateValid" INT 0 65535;
BA_DEF_  "E2EP05ProfileName" STRING ;
BA_DEF_  "E2EP05WindowSize" INT 0 65535;
BA_DEF_  "GenAuthor" STRING ;
BA_DEF_  "GenCompany" STRING ;
BA_DEF_  "GenDescription" STRING ;
BA_DEF_  "GenNetworkBaudrate" STRING ;
BA_DEF_  "GenNetworkMuxEn" STRING ;
BA_DEF_  "GenNetworkName" STRING ;
BA_DEF_  "GenRevision" STRING ;
BA_DEF_  "GenRevisionDate" STRING ;
BA_DEF_  "NmAsrBaseAddress" HEX 1280 1408;
BA_DEF_  "NmAsrMessageCount" INT 64 128;
BA_DEF_  "NmBaseAddress" HEX 1280 1280;
BA_DEF_  "NmMessageCount" INT 0 128;
BA_DEF_  "NmType" STRING ;
BA_DEF_  "VersionDay" INT 1 31;
BA_DEF_  "VersionMonth" INT 1 12;
BA_DEF_  "VersionYear" INT 2000 3000;
BA_DEF_ SG_  "SystemSignalLongSymbol" STRING ;
BA_DEF_DEF_  "J1939TransportLayer" "ClassicTpOnly";
BA_DEF_DEF_  "SAE_J1939_21_SpecVersion" "2006-10";
BA_DEF_DEF_  "VFrameFormat" "StandardCAN_FD";
BA_DEF_DEF_  "CanTpBs" 255;
BA_DEF_DEF_  "DiagConnection" 0;
BA_DEF_DEF_  "DiagRequest" "No";
BA_DEF_DEF_  "DiagResponse" "No";
BA_DEF_DEF_  "DiagState" "No";
BA_DEF_DEF_  "E2EDataId" 0;
BA_DEF_DEF_  "E2EDataLength" 0;
BA_DEF_DEF_  "E2EProfile" "";
BA_DEF_DEF_  "EventRateOfChange" 10000;
BA_DEF_DEF_  "GenMsgCycleTime" 0;
BA_DEF_DEF_  "GenMsgILSupport" "Yes";
BA_DEF_DEF_  "GenMsgNrOfRepetition" 0;
BA_DEF_DEF_  "GenMsgSendType" "NoMsgSendType";
BA_DEF_DEF_  "NetworkInitialization" "Yes";
BA_DEF_DEF_  "NmAsrMessage" "No";
BA_DEF_DEF_  "NmMessage" "No";
BA_DEF_DEF_  "SCP_AuthInfoTxLength" 28;
BA_DEF_DEF_  "SCP_FreshnessValueLength" 48;
BA_DEF_DEF_  "SCP_FreshnessValueTxLength" 4;
BA_DEF_DEF_  "TpTxIndex" 0;
BA_DEF_DEF_  "GenSigCmt" "";
BA_DEF_DEF_  "GenSigCycleTime" 0;
BA_DEF_DEF_  "GenSigSendType" "NoSigSendType";
BA_DEF_DEF_  "GenSigStartValue" 0;
BA_DEF_DEF_  "GenSigTimeoutTime" 0;
BA_DEF_DEF_  "GenSigVtEn" "";
BA_DEF_DEF_  "GenSigVtName" "";
BA_DEF_DEF_  "InvalidValue" "";
BA_DEF_DEF_  "NmAsrNodeIdentifier" 128;
BA_DEF_DEF_  "NmStationAddress" 0;
BA_DEF_DEF_  "NodeStartUpTime" 250;
BA_DEF_DEF_  "NodeWakeUpTime" 10;
BA_DEF_DEF_  "PowerType" "Switched";
BA_DEF_DEF_  "TpOwnSystemEcuNumber" 0;
BA_DEF_DEF_  "Baudrate" 500000;
BA_DEF_DEF_  "BaudrateCANFD" 2000000;
BA_DEF_DEF_  "BusType" "CAN";
BA_DEF_DEF_  "DBName" "";
BA_DEF_DEF_  "E2EP05MaxDeltaCounter" 1;
BA_DEF_DEF_  "E2EP05MaxErrorStateInit" 1;
BA_DEF_DEF_  "E2EP05MaxErrorStateInvalid" 1;
BA_DEF_DEF_  "E2EP05MaxErrorStateValid" 1;
BA_DEF_DEF_  "E2EP05MinOkStateInit" 1;
BA_DEF_DEF_  "E2EP05MinOkStateInvalid" 2;
BA_DEF_DEF_  "E2EP05MinOkStateValid" 1;
BA_DEF_DEF_  "E2EP05ProfileName" "PROFILE_05";
BA_DEF_DEF_  "E2EP05WindowSize" 3;
BA_DEF_DEF_  "GenAuthor" "xx";
BA_DEF_DEF_  "GenCompany" "APTIV";
BA_DEF_DEF_  "GenDescription" "CAN bus that communicates the radars";
BA_DEF_DEF_  "GenNetworkBaudrate" "500 kbps";
BA_DEF_DEF_  "GenNetworkMuxEn" "FALSE";
BA_DEF_DEF_  "GenNetworkName" "PCAN";
BA_DEF_DEF_  "GenRevision" "v1.00";
BA_DEF_DEF_  "GenRevisionDate" "March 03, 2026";
BA_DEF_DEF_  "NmAsrBaseAddress" 1280;
BA_DEF_DEF_  "NmAsrMessageCount" 64;
BA_DEF_DEF_  "NmBaseAddress" 1280;
BA_DEF_DEF_  "NmMessageCount" 128;
BA_DEF_DEF_  "NmType" "NmAsr";
BA_DEF_DEF_  "VersionDay" 2;
BA_DEF_DEF_  "VersionMonth" 1;
BA_DEF_DEF_  "VersionYear" 2021;
BA_DEF_DEF_  "SystemSignalLongSymbol" "";
BA_ "VersionYear" 2026;
BA_ "VersionMonth" 3;
BA_ "VersionDay" 3;
BA_ "NmMessageCount" 64;
BA_ "GenRevision" "V04.02";
BA_ "GenNetworkBaudrate" "500000";
BA_ "GenCompany" "Aptiv";
BA_ "E2EP05WindowSize" 2;
BA_ "E2EP05MinOkStateInvalid" 1;
BA_ "E2EP05MaxDeltaCounter" 3;
BA_ "BusType" "CAN FD";
BA_ "DBName" "PCAN_RADAR";
