AUTOSAR XML (schema 00053)
package /ActiveEcuC
  module config EthIf: implementation-config-variant=VARIANT-POST-BUILD-SELECTABLE, module-description=EthIf_Impl
    EthIfConfigSet
      TcpIp_ARP (EthIfFrameOwnerConfig): EthIfFrameType=2054, EthIfOwner=1, EthIfBswModuleRef=TcpIp
      TcpIp_IPv4 (EthIfFrameOwnerConfig): EthIfFrameType=2048, EthIfOwner=0, EthIfBswModuleRef=TcpIp
      TcpIp_ARP_RxIndication (EthIfRxIndicationConfig): EthIfRxIndicationFunction=IpV4_Arp_RxIndication, EthIfFrameOwnerConfigRef=TcpIp_ARP, EthIfControllerRef=cnctr_RDR_RdrNet_5172a59b
      TcpIp_IPv4_TxConfirmation (EthIfTxConfirmationConfig): EthIfTxConfirmationFunction=IpV4_Ip_TxConfirmation, EthIfFrameOwnerConfigRef=TcpIp_IPv4, EthIfControllerRef=cnctr_RDR_RdrNet_5172a59b
      TcpIp_IPv4_RxIndication (EthIfRxIndicationConfig): EthIfRxIndicationFunction=IpV4_Ip_RxIndication, EthIfFrameOwnerConfigRef=TcpIp_IPv4, EthIfControllerRef=cnctr_RDR_RdrNet_5172a59b
      EthIfTrcvLinkStateChgConfig: EthIfTrcvLinkStateChgFunction=EthSM_TrcvLinkStateChg
      EthIf_RADAR_EthConnector1_Controller_bbe781c0 (EthIfPhysController):
        EthIfPhysControllerIdx = 0
        EthIfEnableVPhcCorrection = false
        EthIfEthCtrlRef = RADAR_EthConnector1_Controller_bbe781c0
        EthIfEthWrapperCtrlRef = RDR_1_Eth_Controller_1_6addc1bb
      EthTSyn_PTP (EthIfFrameOwnerConfig): EthIfFrameType=35063, EthIfOwner=2, EthIfBswModuleRef=EthTSyn
      EthTSyn_TrcvLinkStateChg_EthTSyn (EthIfTrcvLinkStateChgConfig): EthIfTrcvLinkStateChgFunction=EthTSyn_TrcvLinkStateChg, EthIfFrameOwnerConfigRef=EthTSyn_PTP
      EthTSyn_TxConfirmation_EthTSyn (EthIfTxConfirmationConfig): EthIfTxConfirmationFunction=EthTSyn_TxConfirmation, EthIfFrameOwnerConfigRef=EthTSyn_PTP, EthIfControllerRef=cnctr_RDR_RdrNet_5172a59b
      EthTSyn_RxIndication_EthTSyn (EthIfRxIndicationConfig): EthIfRxIndicationFunction=EthTSyn_RxIndication, EthIfFrameOwnerConfigRef=EthTSyn_PTP, EthIfControllerRef=cnctr_RDR_RdrNet_5172a59b
      CDD_EthIfTrcvLinkStateChgConfig (EthIfTrcvLinkStateChgConfig): EthIfTrcvLinkStateChgFunction=CDD_Cbk_TrcvLinkStateChg
      cnctr_RDR_RdrNet_5172a59b (EthIfController):
        EthIfCtrlIdx = 0
        EthIfCtrlMtu = 1500
        EthIfEnableVLAN = false
        EthIfVlanId = 0
        EthIfPhysControllerRef = RDR_1_Eth_Controller_1_6addc1bb
        EthIfPhysCtrlRef = EthIf_RADAR_EthConnector1_Controller_bbe781c0
        EthIfTransceiverRef = EthTrcvConfig_9010BSA if post-build-variant-condition{matching-criterion=RDR_POS, value=0}
        EthIfEthTrcvRef = EthIf_EthTrcvConfig_9010BSA if post-build-variant-condition{matching-criterion=RDR_POS, value=0}
        EthIfTransceiverRef = EthTrcvConfig_9010BSA_100Mb if post-build-variant-condition{matching-criterion=RDR_POS, value=1}
        EthIfTransceiverRef = EthTrcvConfig_TJA1103B if post-build-variant-condition{matching-criterion=RDR_POS, value=2}
        EthIfTransceiverRef = EthTrcvConfig_9010BSA_100Mb if post-build-variant-condition{matching-criterion=RDR_POS, value={3..7}}
        EthIfEthTrcvRef = EthIf_EthTrcvConfig_9010BSA_100Mb if post-build-variant-condition{matching-criterion=RDR_POS, value=1}
        EthIfEthTrcvRef = EthIf_EthTrcvConfig_TJA_1103B if post-build-variant-condition{matching-criterion=RDR_POS, value=2}
        EthIfEthTrcvRef = EthIf_EthTrcvConfig_9010BSA_100Mb if post-build-variant-condition{matching-criterion=RDR_POS, value={3..7}}
      3 x EthIfTransceiver:
        EthIf_EthTrcvConfig_9010BSA: EthIfTransceiverIdx=0, EthIfEthTrcvRef=EthTrcvConfig_9010BSA
        EthIf_EthTrcvConfig_9010BSA_100Mb: EthIfTransceiverIdx=1, EthIfEthTrcvRef=EthTrcvConfig_9010BSA_100Mb
        EthIf_EthTrcvConfig_TJA_1103B: EthIfTransceiverIdx=2, EthIfEthTrcvRef=EthTrcvConfig_TJA1103B
    EthIfGeneral:
      EthIfDevErrorDetect = true
      EthIfEnableRxInterrupt = true
      EthIfEnableTxInterrupt = true
      EthIfMaxTrcvsTotal = 3
      EthIfMaxTxBufsTotal = 100
      EthIfTrcvLinkStateChgMainReload = 2
      EthIfVersionInfoApi = false
      EthIfMainFunctionPeriod = 0.005
      EthIfMainFunctionRxTimeout = 0.005
      EthIfRxIndicationIterations = 5
      EthIfUpdatePhysAddrFilter = true
      EthIfGlobalTimeSupport = true
      EthIfEnableHeaderAccessApi = false
      EthIfWakeupSupport = false
      EthIfSwitchManagementSupport = false
      EthIfSafeBswChecks = true
      EthIfEnableSignalQualityApi = false
      EthIfGetAndResetMeasurementDataApi = false
      EthIfEnableSecurityEventReporting = false
      EthIfPortStartupActiveTime = 0.5
      EthIfPhcSupport = false
      EthIfAutosarCallbackSignatureVersion = AR_4_3_0
      EthIfSwitchOffPortTimeDelay = 0.5
      EthIfModeRequestRetryCount = 5
      EthIfModeRequestRetryPeriod = 0.02
      EthIfEthSMSleepIndicationSupport = false
      EthIfLegacyWakeupSupport = false
      EthIfEnableZeroCopyExtensions = false
      EthIfMaxExtTxBufsTotal = 0
      EthIfPublicCddHeaderFile = EthIf_User_Cbk.h
      EthIfSetControllerModeTimeout = 1000
