AUTOSAR XML (schema 4-0-3)
package /DaVinci_Project
  module config Rte
    RteGeneration: RteEnableMemoryProtection=true, RteEnableMultiCore=false
    46 x RteBswModuleInstance:
      Adc
      BswM
        BswM_MainFunctionTimingEvent0 (RteBswEventToTaskMapping): RteBswUsedOsEventRef=Rte_Ev_Cyclic2_BSW_Task_0_10ms, RteBswUsedOsAlarmRef=Os/Rte_Al_TE2_BSW_Task_0_10ms
      Can
        Can_MainFunction_ModeTimingEvent0 (RteBswEventToTaskMapping)
      CanIf
      CanSM
        CanSM_MainFunctionTimingEvent0 (RteBswEventToTaskMapping): RteBswUsedOsEventRef=Rte_Ev_Cyclic2_BSW_Task_0_10ms, RteBswUsedOsAlarmRef=Os/Rte_Al_TE2_BSW_Task_0_10ms
      CanTSyn
        CanTSyn_MainFunctionTimingEvent0 (RteBswEventToTaskMapping): RteBswUsedOsEventRef=Rte_Ev_Cyclic2_Appl_Task_High_Prio_0_10ms, RteBswUsedOsAlarmRef=Os/Rte_Al_TE2_Appl_Task_High_Prio_0_10ms
      CanTp
        CanTp_MainFunctionTimingEvent0 (RteBswEventToTaskMapping): RteBswUsedOsEventRef=Rte_Ev_Cyclic2_BSW_Task_0_5ms, RteBswUsedOsAlarmRef=Os/Rte_Al_TE2_BSW_Task_0_5ms
      Com
        3 x RteBswEventToTaskMapping:
          Com_MainFunctionRx_ComMainFunctionRxTimingEvent0: RteBswUsedOsEventRef=Rte_Ev_Cyclic2_Appl_Task_Communication_0_10ms, RteBswUsedOsAlarmRef=Os/Rte_Al_TE2_Appl_Task_Communication_0_10ms
          Com_MainFunctionTx_ComMainFunctionTx_EventTimingEvent0: RteBswUsedOsEventRef=Rte_Ev_Cyclic2_Appl_Task_Communication_0_10ms, RteBswUsedOsAlarmRef=Os/Rte_Al_TE2_Appl_Task_Communication_0_10ms
          Com_MainFunctionTx_ComMainFunctionTx_PeriodicTimingEvent0: RteBswUsedOsEventRef=Rte_Ev_Run_Com_Com_MainFunctionTx_ComMainFunctionTx_Periodic, RteBswUsedOsAlarmRef=Os/Rte_Al_TE_Com_Com_MainFunctionTx_ComMainFunctionTx_Periodic
      ComM
        3 x RteBswEventToTaskMapping, all with RteBswUsedOsEventRef=Rte_Ev_Cyclic2_BSW_Task_0_20ms, RteBswUsedOsAlarmRef=Os/Rte_Al_TE2_BSW_Task_0_20ms:
          ComM_MainFunction_{0..2}TimingEvent0
      ComXf
      Crypto
        Crypto_182_iND13400_MainFunctionTimingEvent0 (RteBswEventToTaskMapping): RteBswUsedOsEventRef=Rte_Ev_Cyclic2_BSW_Task_0_10ms, RteBswUsedOsAlarmRef=Os/Rte_Al_TE2_BSW_Task_0_10ms
      Csm
        Csm_MainFunctionTimingEvent0 (RteBswEventToTaskMapping): RteBswUsedOsEventRef=Rte_Ev_Cyclic2_BSW_Task_0_10ms, RteBswUsedOsAlarmRef=Os/Rte_Al_TE2_BSW_Task_0_10ms
      Dcm
        Dcm_MainFunctionTimingEvent0 (RteBswEventToTaskMapping): RteBswUsedOsEventRef=Rte_Ev_Cyclic2_BSW_Task_0_10ms, RteBswUsedOsAlarmRef=Os/Rte_Al_TE2_BSW_Task_0_10ms
      Dem
        Dem_MasterMainFunctionTimingEvent0 (RteBswEventToTaskMapping): RteBswUsedOsEventRef=Rte_Ev_Cyclic2_BSW_Task_0_10ms, RteBswUsedOsAlarmRef=Os/Rte_Al_TE2_BSW_Task_0_10ms
        Dem_SatelliteMainFunctionTimingEvent0 (RteBswEventToTaskMapping): RteBswUsedOsEventRef=Rte_Ev_Cyclic2_BSW_Task_0_10ms, RteBswUsedOsAlarmRef=Os/Rte_Al_TE2_BSW_Task_0_10ms
      Det
      Dio
      E2EXf
      EcuM
        EcuM_MainFunctionTimingEvent0 (RteBswEventToTaskMapping): RteBswUsedOsEventRef=Rte_Ev_Cyclic2_BSW_Task_0_10ms, RteBswUsedOsAlarmRef=Os/Rte_Al_TE2_BSW_Task_0_10ms
      Eth_Indie
        Eth_MainFunctionTimingEvent0 (RteBswEventToTaskMapping)
      EthIf
        EthIf_MainFunctionRxTimingEvent0 (RteBswEventToTaskMapping): RteBswUsedOsEventRef=Rte_Ev_Cyclic2_BSW_Task_0_5ms, RteBswUsedOsAlarmRef=Os/Rte_Al_TE2_BSW_Task_0_5ms
        EthIf_MainFunctionTxTimingEvent0 (RteBswEventToTaskMapping): RteBswUsedOsEventRef=Rte_Ev_Cyclic2_BSW_Task_0_5ms, RteBswUsedOsAlarmRef=Os/Rte_Al_TE2_BSW_Task_0_5ms
      EthSM
        EthSM_MainFunctionTimingEvent0 (RteBswEventToTaskMapping): RteBswUsedOsEventRef=Rte_Ev_Cyclic2_BSW_Task_0_20ms, RteBswUsedOsAlarmRef=Os/Rte_Al_TE2_BSW_Task_0_20ms
      EthTSyn
        EthTSyn_MainFunctionTimingEvent0 (RteBswEventToTaskMapping): RteBswUsedOsEventRef=Rte_Ev_Cyclic2_Appl_Task_High_Prio_0_10ms, RteBswUsedOsAlarmRef=Os/Rte_Al_TE2_Appl_Task_High_Prio_0_10ms
      EthTrcv
        EthTrcv_30_Rtl9010_MainFunctionTimingEvent0 (RteBswEventToTaskMapping)
      EthTrcv_001
        EthTrcv_30_Tja1103_MainFunctionTimingEvent0 (RteBswEventToTaskMapping)
      Eth
      Fee
        Fee_30_FlexNor_MainFunctionTimingEvent0 (RteBswEventToTaskMapping): RteBswUsedOsEventRef=Rte_Ev_Cyclic2_Appl_BackgroundTask_0_5ms, RteBswUsedOsAlarmRef=Os/Rte_Al_TE2_Appl_BackgroundTask_0_5ms
      Fls
        Fls_MainFunctionTimingEvent0 (RteBswEventToTaskMapping): RteBswUsedOsEventRef=Rte_Ev_Cyclic2_Appl_BackgroundTask_0_5ms, RteBswUsedOsAlarmRef=Os/Rte_Al_TE2_Appl_BackgroundTask_0_5ms
      Gpt
      I2c
      J1939Dcm
        J1939Dcm_MainFunctionTimingEvent0 (RteBswEventToTaskMapping)
      J1939Tp
        J1939Tp_MainFunctionTimingEvent0 (RteBswEventToTaskMapping)
      LdCom
      NvM
        NvM_MainFunctionTimingEvent0 (RteBswEventToTaskMapping): RteBswUsedOsEventRef=Rte_Ev_Cyclic2_Appl_BackgroundTask_0_5ms, RteBswUsedOsAlarmRef=Os/Rte_Al_TE2_Appl_BackgroundTask_0_5ms
      PduR
      Rtm
        Rtm_MainFunctionTimingEvent0 (RteBswEventToTaskMapping): RteBswUsedOsEventRef=Rte_Ev_Run_Rtm_Rtm_MainFunction, RteBswUsedOsAlarmRef=Os/Rte_Al_TE_Rtm_Rtm_MainFunction
      Sd
        Sd_MainFunctionTimingEvent0 (RteBswEventToTaskMapping): RteBswUsedOsEventRef=Rte_Ev_Cyclic2_BSW_Task_0_5ms, RteBswUsedOsAlarmRef=Os/Rte_Al_TE2_BSW_Task_0_5ms
      SoAd
        SoAd_MainFunctionTimingEvent0 (RteBswEventToTaskMapping): RteBswUsedOsEventRef=Rte_Ev_Cyclic2_BSW_Task_0_5ms, RteBswUsedOsAlarmRef=Os/Rte_Al_TE2_BSW_Task_0_5ms
      SomeIpTp
        SomeIpTp_MainFunctionRxTimingEvent0 (RteBswEventToTaskMapping): RteBswUsedOsEventRef=Rte_Ev_Cyclic2_BSW_Task_0_5ms, RteBswUsedOsAlarmRef=Os/Rte_Al_TE2_BSW_Task_0_5ms
        SomeIpTp_MainFunctionTxTimingEvent0 (RteBswEventToTaskMapping): RteBswUsedOsEventRef=Rte_Ev_Cyclic2_BSW_Task_0_5ms, RteBswUsedOsAlarmRef=Os/Rte_Al_TE2_BSW_Task_0_5ms
      SomeIpXf
      Spi
        Spi_MainFunction_HandlingTimingEvent0 (RteBswEventToTaskMapping)
      StbM
        StbM_MainFunctionTimingEvent0 (RteBswEventToTaskMapping): RteBswUsedOsEventRef=Rte_Ev_Cyclic2_Appl_Task_High_Prio_0_10ms, RteBswUsedOsAlarmRef=Os/Rte_Al_TE2_Appl_Task_High_Prio_0_10ms
      TcpIp
        TcpIp_MainFunctionTimingEvent0 (RteBswEventToTaskMapping): RteBswUsedOsEventRef=Rte_Ev_Cyclic2_BSW_Task_0_5ms, RteBswUsedOsAlarmRef=Os/Rte_Al_TE2_BSW_Task_0_5ms
      Uart
        Uart_MainFunctionTimingEvent0 (RteBswEventToTaskMapping)
      Wdg
      WdgM
        WdgM_MainFunctionTimingEvent0 (RteBswEventToTaskMapping): RteBswUsedOsEventRef=Rte_Ev_Cyclic2_Appl_Task_High_Prio_0_5ms, RteBswUsedOsAlarmRef=Os/Rte_Al_TE2_Appl_Task_High_Prio_0_5ms
      Xcp
        3 x RteBswEventToTaskMapping, all with RteBswUsedOsEventRef=Rte_Ev_Cyclic2_BSW_Task_0_5ms, RteBswUsedOsAlarmRef=Os/Rte_Al_TE2_BSW_Task_0_5ms:
          CanXcp_MainFunctionTimingEvent0
          TcpIpXcp_MainFunctionTimingEvent0
          Xcp_MainFunctionTimingEvent0
    41 x RteSwComponentInstance:
      BswM_EcuSwComposition
        Timer_BswM_MainFunction (RteEventToTaskMapping): RteUsedOsEventRef=Rte_Ev_Cyclic2_BSW_Task_0_10ms, RteUsedOsAlarmRef=Os/Rte_Al_TE2_BSW_Task_0_10ms
      ComM_EcuSwComposition
        3 x RteEventToTaskMapping, all with RteUsedOsEventRef=Rte_Ev_Cyclic2_BSW_Task_0_20ms, RteUsedOsAlarmRef=Os/Rte_Al_TE2_BSW_Task_0_20ms:
          Timer_ComM_MainFunction_{0..2}
      Csm_EcuSwComposition
        Timer_Csm_MainFunction (RteEventToTaskMapping): RteUsedOsEventRef=Rte_Ev_Cyclic2_BSW_Task_0_10ms, RteUsedOsAlarmRef=Os/Rte_Al_TE2_BSW_Task_0_10ms
      Dcm_EcuSwComposition
        Timer_Dcm_MainFunction (RteEventToTaskMapping): RteUsedOsEventRef=Rte_Ev_Cyclic2_BSW_Task_0_10ms, RteUsedOsAlarmRef=Os/Rte_Al_TE2_BSW_Task_0_10ms
      DemMaster_Invalid_OsApplication_EcuSwComposition
        Timer_Dem_MasterMainFunction (RteEventToTaskMapping): RteUsedOsEventRef=Rte_Ev_Cyclic2_BSW_Task_0_10ms, RteUsedOsAlarmRef=Os/Rte_Al_TE2_BSW_Task_0_10ms
      DemSatellite_Invalid_OsApplication_EcuSwComposition
        Timer_Dem_SatelliteMainFunction (RteEventToTaskMapping): RteUsedOsEventRef=Rte_Ev_Cyclic2_BSW_Task_0_10ms, RteUsedOsAlarmRef=Os/Rte_Al_TE2_BSW_Task_0_10ms
      Det_EcuSwComposition
      EcuM_EcuSwComposition
        Timer_EcuM_MainFunction (RteEventToTaskMapping): RteUsedOsEventRef=Rte_Ev_Cyclic2_BSW_Task_0_10ms, RteUsedOsAlarmRef=Os/Rte_Al_TE2_BSW_Task_0_10ms
      NvM_EcuSwComposition
        Timer_NvM_MainFunction (RteEventToTaskMapping): RteUsedOsEventRef=Rte_Ev_Cyclic2_Appl_BackgroundTask_0_5ms, RteUsedOsAlarmRef=Os/Rte_Al_TE2_Appl_BackgroundTask_0_5ms
      Os_OsCore0_swc_EcuSwComposition
      SWC_Appl_Project_EcuSwComposition
        TMT_RE_Appl_Project_Main_50ms (RteEventToTaskMapping): RteUsedOsEventRef=Rte_Ev_Cyclic_Appl_Task_0_50ms, RteUsedOsAlarmRef=Os/Rte_Al_TE_Appl_Task_0_50ms
      SWC_CDD_IPC_EcuSwComposition
        5 x RteEventToTaskMapping:
          ITOE_Dsp_sp_post_processing_complete_ITP_RE_IPC_Trigger_50ms_Dsp_sp_post_processing_complete: RteUsedOsEventRef=Rte_Ev_Run_SWC_CDD_IPC_Dsp_sp_post_processing_complete
          TMT_RE_IPC_Rx_50ms: RteUsedOsEventRef=Rte_Ev_Cyclic_Appl_IPC_Task_0_50ms, RteUsedOsAlarmRef=Os/Rte_Al_TE_Appl_IPC_Task_0_50ms
          TMT_RE_IPC_Trigger_50ms: RteUsedOsEventRef=Rte_Ev_Cyclic_Appl_IPC_Task_0_50ms, RteUsedOsAlarmRef=Os/Rte_Al_TE_Appl_IPC_Task_0_50ms
          TMT_RE_IPC_Tx_50ms: RteUsedOsEventRef=Rte_Ev_Cyclic_Appl_IPC_Task_0_50ms, RteUsedOsAlarmRef=Os/Rte_Al_TE_Appl_IPC_Task_0_50ms
          TMT_RE_IPC_VSE_Handler_10ms: RteUsedOsEventRef=Rte_Ev_Run_SWC_CDD_IPC_RE_IPC_VSE_Handler_10ms, RteUsedOsAlarmRef=Os/Rte_Al_TE_SWC_CDD_IPC_RE_IPC_VSE_Handler_10ms
      SWC_CMP_PRJ_UDSHandler_EcuSwComposition
        TMT_RE_SWC_CMP_PRJ_UDSHandler_Main_50ms (RteEventToTaskMapping):
          RteUsedOsEventRef = Rte_Ev_Run_SWC_CMP_PRJ_UDSHandler_RE_SWC_CMP_PRJ_UDSHandler_Main_50ms
          RteUsedOsAlarmRef = Os/Rte_Al_TE_SWC_CMP_PRJ_UDSHandler_RE_SWC_CMP_PRJ_UDSHandler_Main_50ms
        NvmBlock_SWC_CMP_PRJ_UDSHandler_SWC_UDSHandler_VIN (RteNvRamAllocation):
          RteNvmRamBlockLocationSymbol = Rte_SWC_CMP_PRJ_UDSHandler_SWC_UDS_VIN
          RteNvmRomBlockLocationSymbol = Rte_SWC_CMP_PRJ_UDSHandler_SWC_UDSHandler_VIN_DefaultValue
          RteNvmBlockRef = SWC_CMP_PRJ_UDSHandlerSWC_UDSHandler_VIN
        NvmBlock_SWC_CMP_PRJ_UDSHandler_SWC_UDSHandler_Attemptcounter (RteNvRamAllocation):
          RteNvmRamBlockLocationSymbol = Rte_SWC_CMP_PRJ_UDSHandler_SWC_UDS_AttemptCounter
          RteNvmRomBlockLocationSymbol = Rte_SWC_CMP_PRJ_UDSHandler_SWC_UDSHandler_Attemptcounter_DefaultValue
          RteNvmBlockRef = SWC_CMP_PRJ_UDSHandlerSWC_UDSHandler_Attemptcounter
      SWC_PLT_Appl_Communication_EcuSwComposition
        4 x RteEventToTaskMapping:
          OIT_PostRadarProcessing_CAN_Tx_RE_Communication_Tx_PostRadarProcessing_CAN_Tx_RE_Communication_Tx: RteUsedOsEventRef=Rte_Ev_Run_SWC_PLT_Appl_Communication_PostRadarProcessing_CAN_Tx_RE_Communication_Tx
          TMT_RE_Communication_10ms: RteUsedOsEventRef=Rte_Ev_Cyclic_Appl_Task_0_10ms, RteUsedOsAlarmRef=Os/Rte_Al_TE_Appl_Task_0_10ms
          TMT_RE_Communication_Rx: RteUsedOsEventRef=Rte_Ev_Cyclic_Appl_Task_Communication_0_25ms, RteUsedOsAlarmRef=Os/Rte_Al_TE_Appl_Task_Communication_0_25ms
          TMT_RE_Communication_Tx: RteUsedOsEventRef=Rte_Ev_Run_SWC_PLT_Appl_Communication_RE_Communication_Tx_50ms, RteUsedOsAlarmRef=Os/Rte_Al_TE_SWC_PLT_Appl_Communication_RE_Communication_Tx_50ms
      SWC_PLT_Appl_Diag_EcuSwComposition
        11 x RteEventToTaskMapping:
          TMT_RE_PLT_Diag_Alignment_Diagnostics_50ms: RteUsedOsEventRef=Rte_Ev_Cyclic_Appl_Task_0_50ms, RteUsedOsAlarmRef=Os/Rte_Al_TE_Appl_Task_0_50ms
          TMT_RE_Validation_Battery_Fault_Tests: RteUsedOsEventRef=Rte_Ev_Cyclic_Appl_Task_0_50ms, RteUsedOsAlarmRef=Os/Rte_Al_TE_Appl_Task_0_50ms
          TMT_RE_Platform_Can_Bus_Off_Fault_Test: RteUsedOsEventRef=Rte_Ev_Cyclic_Appl_Task_0_50ms, RteUsedOsAlarmRef=Os/Rte_Al_TE_Appl_Task_0_50ms
          TMT_RE_Validation_Host_Microcontroller_Tests: RteUsedOsEventRef=Rte_Ev_Cyclic_Appl_Task_0_50ms, RteUsedOsAlarmRef=Os/Rte_Al_TE_Appl_Task_0_50ms
          TMT_RE_Validation_Inter_Processor_Communication_Diagnostics: RteUsedOsEventRef=Rte_Ev_Cyclic_Appl_Task_0_50ms, RteUsedOsAlarmRef=Os/Rte_Al_TE_Appl_Task_0_50ms
          TMT_RE_Validation_Memory_Diagnostics: RteUsedOsEventRef=Rte_Ev_Cyclic_Appl_Task_0_50ms, RteUsedOsAlarmRef=Os/Rte_Al_TE_Appl_Task_0_50ms
          TMT_RE_Validation_Microprocessor_Temp_Tests: RteUsedOsEventRef=Rte_Ev_Cyclic_Appl_Task_0_50ms, RteUsedOsAlarmRef=Os/Rte_Al_TE_Appl_Task_0_50ms
          TMT_RE_PLT_Diag_PlatformTime_Diagnostics_50ms: RteUsedOsEventRef=Rte_Ev_Run_SWC_PLT_Appl_Diag_RE_PLT_Diag_PlatformTime_50ms, RteUsedOsAlarmRef=Os/Rte_Al_TE_SWC_PLT_Appl_Diag_RE_PLT_Diag_PlatformTime_50ms
          TMT_RE_Validation_Radar_Blockage_Detection_Test: RteUsedOsEventRef=Rte_Ev_Cyclic_Appl_Task_0_50ms, RteUsedOsAlarmRef=Os/Rte_Al_TE_Appl_Task_0_50ms
          TMT_RE_Validation_Radar_Hardware_Tests: RteUsedOsEventRef=Rte_Ev_Cyclic_Appl_Task_0_50ms, RteUsedOsAlarmRef=Os/Rte_Al_TE_Appl_Task_0_50ms
          TMT_RE_Validation_Dolphin_Chip_Diagnostics: RteUsedOsEventRef=Rte_Ev_Cyclic_Appl_Task_0_50ms, RteUsedOsAlarmRef=Os/Rte_Al_TE_Appl_Task_0_50ms
      SWC_PLT_Appl_FaultMgr_EcuSwComposition
        14 x RteEventToTaskMapping:
          TMT_RE_Alignment_Diagnostics_50ms: RteUsedOsEventRef=Rte_Ev_Cyclic_Appl_Task_0_50ms, RteUsedOsAlarmRef=Os/Rte_Al_TE_Appl_Task_0_50ms
          TMT_RE_Fault_Mgr_Battery_Fault_Tests: RteUsedOsEventRef=Rte_Ev_Cyclic_Appl_Task_0_50ms, RteUsedOsAlarmRef=Os/Rte_Al_TE_Appl_Task_0_50ms
          TMT_RE_Fault_Mgr_Can_Bus_Off_Fault_Test: RteUsedOsEventRef=Rte_Ev_Cyclic_Appl_Task_0_50ms, RteUsedOsAlarmRef=Os/Rte_Al_TE_Appl_Task_0_50ms
          TMT_RE_General_Diagnostics_50ms: RteUsedOsEventRef=Rte_Ev_Cyclic_Appl_Task_0_50ms, RteUsedOsAlarmRef=Os/Rte_Al_TE_Appl_Task_0_50ms
          TMT_RE_Fault_Mgr_Host_Microcontroller_Tests: RteUsedOsEventRef=Rte_Ev_Cyclic_Appl_Task_0_50ms, RteUsedOsAlarmRef=Os/Rte_Al_TE_Appl_Task_0_50ms
          TMT_RE_Fault_Mgr_Interprocessor_Comm: RteUsedOsEventRef=Rte_Ev_Cyclic_Appl_Task_0_50ms, RteUsedOsAlarmRef=Os/Rte_Al_TE_Appl_Task_0_50ms
          TMT_RE_FaultMgr_Main_10ms: RteUsedOsEventRef=Rte_Ev_Cyclic_Appl_Task_0_10ms, RteUsedOsAlarmRef=Os/Rte_Al_TE_Appl_Task_0_10ms
          TMT_RE_Diag_Main_50ms: RteUsedOsEventRef=Rte_Ev_Cyclic_Appl_Task_0_50ms, RteUsedOsAlarmRef=Os/Rte_Al_TE_Appl_Task_0_50ms
          TMT_RE_Fault_Mgr_Memory_Diagnostics: RteUsedOsEventRef=Rte_Ev_Cyclic_Appl_Task_0_50ms, RteUsedOsAlarmRef=Os/Rte_Al_TE_Appl_Task_0_50ms
          TMT_RE_Fault_Mgr_Microprocessor_Temp_Tests: RteUsedOsEventRef=Rte_Ev_Cyclic_Appl_Task_0_50ms, RteUsedOsAlarmRef=Os/Rte_Al_TE_Appl_Task_0_50ms
          TMT_RE_Fault_Mgr_Radar_Blockage_Detection_Test: RteUsedOsEventRef=Rte_Ev_Cyclic_Appl_Task_0_50ms, RteUsedOsAlarmRef=Os/Rte_Al_TE_Appl_Task_0_50ms
          TMT_RE_Fault_Mgr_Radar_Hardware_Tests: RteUsedOsEventRef=Rte_Ev_Cyclic_Appl_Task_0_50ms, RteUsedOsAlarmRef=Os/Rte_Al_TE_Appl_Task_0_50ms
          TMT_RE_Fault_Mgr_Dolphin_Chip_Diagnostics: RteUsedOsEventRef=Rte_Ev_Cyclic_Appl_Task_0_50ms, RteUsedOsAlarmRef=Os/Rte_Al_TE_Appl_Task_0_50ms
          TMT_RE_Watchdog_Diagnostics_50ms: RteUsedOsEventRef=Rte_Ev_Cyclic_Appl_Task_0_50ms, RteUsedOsAlarmRef=Os/Rte_Al_TE_Appl_Task_0_50ms
      SWC_PLT_Appl_IntWDG_EcuSwComposition
        7 x RteEventToTaskMapping:
          TMT_RE_PLT_WDG_INTERNAL_WDG_Appl_IPC_Task: RteUsedOsEventRef=Rte_Ev_Cyclic_Appl_IPC_Task_0_50ms, RteUsedOsAlarmRef=Os/Rte_Al_TE_Appl_IPC_Task_0_50ms
          TMT_RE_PLT_WDG_INTERNAL_WDG_Appl_Task_Communication: RteUsedOsEventRef=Rte_Ev_Cyclic_Appl_Task_Communication_0_25ms, RteUsedOsAlarmRef=Os/Rte_Al_TE_Appl_Task_Communication_0_25ms
          TMT_RE_PLT_WDG_INTERNAL_WDG_Appl_Task_Radar_Control: RteUsedOsEventRef=Rte_Ev_Cyclic_Radar_Ctrl_Task_0_50ms, RteUsedOsAlarmRef=Os/Rte_Al_TE_Radar_Ctrl_Task_0_50ms
          TMT_RE_PLT_WDG_INTERNAL_WDG_BSW_Task: RteUsedOsEventRef=Rte_Ev_Run_SWC_PLT_Appl_IntWDG_RE_PLT_WDG_INTERNAL_WDG_BSW_Task, RteUsedOsAlarmRef=Os/Rte_Al_TE_SWC_PLT_Appl_IntWDG_RE_PLT_WDG_INTERNAL_WDG_BSW_Task
          TMT_RE_PLT_WDG_INTERNAL_WDG_PLT_Appl_Task: RteUsedOsEventRef=Rte_Ev_Run_SWC_PLT_Appl_IntWDG_RE_PLT_WDG_INTERNAL_WDG_PLT_Appl_Task, RteUsedOsAlarmRef=Os/Rte_Al_TE_SWC_PLT_Appl_IntWDG_RE_PLT_WDG_INTERNAL_WDG_PLT_Appl_Task
          TMT_RE_PLT_WDG_Main_50ms: RteUsedOsEventRef=Rte_Ev_Cyclic_Appl_Task_0_50ms, RteUsedOsAlarmRef=Os/Rte_Al_TE_Appl_Task_0_50ms
          TMT_RE_PLT_WDG_Main_5ms: RteUsedOsEventRef=Rte_Ev_Run_SWC_PLT_Appl_IntWDG_RE_PLT_WDG_Main_5ms, RteUsedOsAlarmRef=Os/Rte_Al_TE_SWC_PLT_Appl_IntWDG_RE_PLT_WDG_Main_5ms
      SWC_PLT_Appl_IoHwAb_001_EcuSwComposition
        3 x RteEventToTaskMapping:
          TMT_RE_PLT_IoHwAb_Main_10ms: RteUsedOsEventRef=Rte_Ev_Cyclic_Appl_Task_0_10ms, RteUsedOsAlarmRef=Os/Rte_Al_TE_Appl_Task_0_10ms
          TMT_RE_IoHwAb_Main_50ms: RteUsedOsEventRef=Rte_Ev_Cyclic_Appl_Task_0_50ms, RteUsedOsAlarmRef=Os/Rte_Al_TE_Appl_Task_0_50ms
          TMT_RE_IoHwAb_Main_5ms: RteUsedOsEventRef=Rte_Ev_Cyclic_Appl_Task_0_5ms, RteUsedOsAlarmRef=Os/Rte_Al_TE_Appl_Task_0_5ms
      SWC_PLT_Appl_ModeManager_EcuSwComposition
        TMT_RE_Platform_ModeManager_Main_50ms (RteEventToTaskMapping): RteUsedOsEventRef=Rte_Ev_Cyclic_Appl_Task_0_50ms, RteUsedOsAlarmRef=Os/Rte_Al_TE_Appl_Task_0_50ms
        TMT_RE_Platform_ModeManagerStateMachine_5ms (RteEventToTaskMapping): RteUsedOsEventRef=Rte_Ev_Cyclic_Appl_Task_0_5ms, RteUsedOsAlarmRef=Os/Rte_Al_TE_Appl_Task_0_5ms
      SWC_PLT_Appl_NvMHandler_EcuSwComposition
        TMT_SWC_PLT_Appl_NvMHandler_50ms (RteEventToTaskMapping): RteUsedOsEventRef=Rte_Ev_Cyclic_Appl_Task_0_50ms, RteUsedOsAlarmRef=Os/Rte_Al_TE_Appl_Task_0_50ms
        TMT_RE_PLT_Appl_NvMHandler_5ms (RteEventToTaskMapping):
          RteUsedOsEventRef = Rte_Ev_Run_SWC_PLT_Appl_NvMHandler_RE_PLT_Appl_NvMHandler_5ms
          RteUsedOsAlarmRef = Os/Rte_Al_TE_SWC_PLT_Appl_NvMHandler_RE_PLT_Appl_NvMHandler_5ms
        8 x RteNvRamAllocation:
          NvmBlock_SWC_PLT_Appl_NvMHandler_Correctable_Fault_NvM: RteNvmRamBlockLocationSymbol=Rte_SWC_PLT_Appl_NvMHandler_Correctable_Fault_PIM, RteNvmRomBlockLocationSymbol=Rte_SWC_PLT_Appl_NvMHandler_Correctable_Fault_NvM_DefaultValue, RteNvmBlockRef=SWC_PLT_Appl_NvMHandlerCorrectable_Fault_NvM
          NvmBlock_SWC_PLT_Appl_NvMHandler_SWC_PLT_CDD_FailSafe: RteNvmRamBlockLocationSymbol=Rte_SWC_PLT_Appl_NvMHandler_FailSafe_ResetReason_PIM, RteNvmRomBlockLocationSymbol=Rte_SWC_PLT_Appl_NvMHandler_SWC_PLT_CDD_FailSafe_DefaultValue, RteNvmBlockRef=SWC_PLT_Appl_NvMHandlerSWC_PLT_CDD_FailSafe
          NvmBlock_SWC_PLT_Appl_NvMHandler_SWC_Manual_alignment_Execution: RteNvmRamBlockLocationSymbol=Rte_SWC_PLT_Appl_NvMHandler_Manual_Alignment_Execution_Data_PIM, RteNvmRomBlockLocationSymbol=Rte_SWC_PLT_Appl_NvMHandler_SWC_Manual_alignment_Execution_DefaultValue, RteNvmBlockRef=SWC_PLT_Appl_NvMHandlerSWC_Manual_alignment_Execution
          NvmBlock_SWC_PLT_Appl_NvMHandler_Bringup_NvMBlock: RteNvmRamBlockLocationSymbol=Rte_SWC_PLT_Appl_NvMHandler_NvMBringUp_PIM, RteNvmRomBlockLocationSymbol=Rte_SWC_PLT_Appl_NvMHandler_NvMBringUp_DefaultValue, RteNvmBlockRef=SWC_PLT_Appl_NvMHandlerBringup_NvMBlock
          NvmBlock_SWC_PLT_Appl_NvMHandler_RFE_R1R2_Fault_NvM: RteNvmRamBlockLocationSymbol=Rte_SWC_PLT_Appl_NvMHandler_RFE_R1R2_PIM, RteNvmRomBlockLocationSymbol=Rte_SWC_PLT_Appl_NvMHandler_RFE_R1R2_Fault_NvM_DefaultValue, RteNvmBlockRef=SWC_PLT_Appl_NvMHandlerRFE_R1R2_Fault_NvM
          NvmBlock_SWC_PLT_Appl_NvMHandler_SensorPos_NvM: RteNvmRamBlockLocationSymbol=Rte_SWC_PLT_Appl_NvMHandler_Sensorpos_PIM_UDS, RteNvmRomBlockLocationSymbol=Rte_SWC_PLT_Appl_NvMHandler_SensorPos_NvM_DefaultValue, RteNvmBlockRef=SWC_PLT_Appl_NvMHandlerSensorPos_NvM
          NvmBlock_SWC_PLT_Appl_NvMHandler_SWC_Static_Alignment_Write_Parameters: RteNvmRamBlockLocationSymbol=Rte_SWC_PLT_Appl_NvMHandler_Static_Alignment_Engineering_Write_Configuration_Parameters_PIM, RteNvmRomBlockLocationSymbol=Rte_SWC_PLT_Appl_NvMHandler_SWC_Static_Alignment_Write_Parameters_DefaultValue, RteNvmBlockRef=SWC_PLT_Appl_NvMHandlerSWC_Static_Alignment_Write_Parameters
          NvmBlock_SWC_PLT_Appl_NvMHandler_SWC_VSE_NVM_Params: RteNvmRamBlockLocationSymbol=Rte_SWC_PLT_Appl_NvMHandler_VSE_NVM_Params_PIM, RteNvmRomBlockLocationSymbol=Rte_SWC_PLT_Appl_NvMHandler_SWC_VSE_NVM_Params_DefaultValue, RteNvmBlockRef=SWC_PLT_Appl_NvMHandlerSWC_VSE_NVM_Params
      SWC_PLT_Appl_PlatformTime_EcuSwComposition
        TMT_RE_PLT_PlatformTime_50ms (RteEventToTaskMapping): RteUsedOsEventRef=Rte_Ev_Cyclic_Appl_Task_0_50ms, RteUsedOsAlarmRef=Os/Rte_Al_TE_Appl_Task_0_50ms
      SWC_PLT_Appl_RTM_EcuSwComposition
        TMT_RE_RTM_Main_50ms (RteEventToTaskMapping): RteUsedOsEventRef=Rte_Ev_Cyclic_Appl_Task_0_50ms, RteUsedOsAlarmRef=Os/Rte_Al_TE_Appl_Task_0_50ms
      SWC_PLT_CDD_ECUSync_EcuSwComposition
      SWC_PLT_CDD_ExternalWdg_EcuSwComposition
        TMT_RE_CDD_Ext_Wdg_50ms (RteEventToTaskMapping): RteUsedOsEventRef=Rte_Ev_Cyclic_Appl_Task_0_50ms, RteUsedOsAlarmRef=Os/Rte_Al_TE_Appl_Task_0_50ms
        TMT_RE_CDD_Ext_Wdg_5ms (RteEventToTaskMapping): RteUsedOsEventRef=Rte_Ev_Cyclic_Appl_Task_0_5ms, RteUsedOsAlarmRef=Os/Rte_Al_TE_Appl_Task_0_5ms
      SWC_PLT_CDD_FCRU_EcuSwComposition
        TMT_RE_PLT_FCRU_Main_50ms (RteEventToTaskMapping): RteUsedOsEventRef=Rte_Ev_Cyclic_Appl_Task_0_50ms, RteUsedOsAlarmRef=Os/Rte_Al_TE_Appl_Task_0_50ms
      SWC_PLT_CDD_FailSafe_EcuSwComposition
        TMT_RE_FailSafe_Main_50ms (RteEventToTaskMapping): RteUsedOsEventRef=Rte_Ev_Cyclic_Appl_Task_0_50ms, RteUsedOsAlarmRef=Os/Rte_Al_TE_Appl_Task_0_50ms
      SWC_PLT_CDD_HIL_EcuSwComposition
        EXTO_RE_HIL_Periodic_Handler_Rp_HIL_Periodic_Handler_Trigger (RteEventToTaskMapping): RteUsedOsEventRef=Rte_Ev_Run_SWC_PLT_CDD_HIL_RE_HIL_Periodic_Handler_Rp_HIL_Periodic_Handler_Trigger
      SWC_PLT_CDD_Logging_EcuSwComposition
        13 x RteEventToTaskMapping:
          OIT_PostRadarProcessing_ADC_Populate_ADC_Stream_PostRadarProcessing_ADC_Populate_ADC_Stream: RteUsedOsEventRef=Rte_Ev_Run_SWC_PLT_CDD_Logging_PostRadarProcessing_ADC_Populate_ADC_Stream
          OIT_PostRadarProcessing_Debug_Populate_Debug_Stream_PostRadarProcessing_Debug_Populate_Debug_Stream: RteUsedOsEventRef=Rte_Ev_Run_SWC_PLT_CDD_Logging_PostRadarProcessing_Debug_Populate_Debug_Stream
          OIT_PostRadarProcessing_Detection_Populate_Detection_Stream_PostRadarProcessing_Detection_Populate_Detection_Stream: RteUsedOsEventRef=Rte_Ev_Run_SWC_PLT_CDD_Logging_PostRadarProcessing_Detection_Populate_Detection_Stream
          OIT_PostRadarProcessing_Header_Populate_Header_Stream_PostRadarProcessing_Header_Populate_Header_Stream: RteUsedOsEventRef=Rte_Ev_Run_SWC_PLT_CDD_Logging_PostRadarProcessing_Header_Populate_Header_Stream
          OIT_PostRadarProcessing_MMIC_Populate_MMIC_Stream_PostRadarProcessing_MMIC_Populate_MMIC_Stream: RteUsedOsEventRef=Rte_Ev_Run_SWC_PLT_CDD_Logging_PostRadarProcessing_MMIC_Populate_MMIC_Stream
          OIT_PostRadarProcessing_RDD_Populate_RDD_Stream_PostRadarProcessing_RDD_Populate_RDD_Stream: RteUsedOsEventRef=Rte_Ev_Run_SWC_PLT_CDD_Logging_PostRadarProcessing_RDD_Populate_RDD_Stream
          OIT_PostRadarProcessing_Radar_Capability_Populate_Radar_Capability_Stream_PostRadarProcessing_Radar_Capability_Populate_4F329E1C: RteUsedOsEventRef=Rte_Ev_Run_SWC_PLT_CDD_Logging_PostRadarProcessing_Radar_Capability_Populate_Radar_Capability_Stream
          OIT_PostRadarProcessing_Status_Populate_Status_Stream_PostRadarProcessing_Status_Populate_Status_Stream: RteUsedOsEventRef=Rte_Ev_Run_SWC_PLT_CDD_Logging_PostRadarProcessing_Status_Populate_Status_Stream
          TMT_RE_Logging_10ms: RteUsedOsEventRef=Rte_Ev_Run_SWC_PLT_CDD_Logging_RE_Logging_10ms, RteUsedOsAlarmRef=Os/Rte_Al_TE_SWC_PLT_CDD_Logging_RE_Logging_10ms
          TMT_RE_Logging_2ms: RteUsedOsEventRef=Rte_Ev_Run_SWC_PLT_CDD_Logging_RE_Logging_2ms, RteUsedOsAlarmRef=Os/Rte_Al_TE_SWC_PLT_CDD_Logging_RE_Logging_2ms
          TMT_RE_Logging_50ms: RteUsedOsEventRef=Rte_Ev_Run_SWC_PLT_CDD_Logging_RE_Logging_50ms, RteUsedOsAlarmRef=Os/Rte_Al_TE_SWC_PLT_CDD_Logging_RE_Logging_50ms
          TMT_RE_Logging_5ms: RteUsedOsEventRef=Rte_Ev_Run_SWC_PLT_CDD_Logging_RE_Logging_5ms, RteUsedOsAlarmRef=Os/Rte_Al_TE_SWC_PLT_CDD_Logging_RE_Logging_5ms
          OIT_StbM_MeasurementNotification_StbMSynchronizedTimeBase_TimeRecordBlock_Callback_StbM_MeasurementNotification_StbMSync71EECD83: RteUsedOsEventRef=Rte_Ev_Run_SWC_PLT_CDD_Logging_StbM_MeasurementNotification_StbMSynchronizedTimeBase_TimeRecordBlock_Callback
      SWC_PLT_CDD_MCU_Safety_EcuSwComposition
        TMT_RE_PLT_MCU_Safety_50ms (RteEventToTaskMapping): RteUsedOsEventRef=Rte_Ev_Cyclic_Appl_Task_0_50ms, RteUsedOsAlarmRef=Os/Rte_Al_TE_Appl_Task_0_50ms
      SWC_PLT_CDD_Radar_Control_EcuSwComposition
        6 x RteEventToTaskMapping:
          TMT_RE_Radar_Control_10ms: RteUsedOsEventRef=Rte_Ev_Run_SWC_PLT_CDD_Radar_Control_RE_Radar_Control_10ms, RteUsedOsAlarmRef=Os/Rte_Al_TE_SWC_PLT_CDD_Radar_Control_RE_Radar_Control_10ms
          TMT_RE_Radar_Control_50ms: RteUsedOsEventRef=Rte_Ev_Cyclic_Radar_Ctrl_Task_0_50ms, RteUsedOsAlarmRef=Os/Rte_Al_TE_Radar_Ctrl_Task_0_50ms
          EXTO_RE_Radar_Ctl_Look_Complete_Rp_Radar_Ctl_Look_Complete_Trigger: RteUsedOsEventRef=Rte_Ev_Run_SWC_PLT_CDD_Radar_Control_RE_Radar_Ctl_Look_Complete_Rp_Radar_Ctl_Look_Complete_Trigger
          TMT_RE_Radar_Ctl_Look_Complete_Post_RFBIST: RteUsedOsEventRef=Rte_Ev_Run_SWC_PLT_CDD_Radar_Control_RE_Radar_Ctl_Look_Complete_Post_RFBIST, RteUsedOsAlarmRef=Os/Rte_Al_TE_SWC_PLT_CDD_Radar_Control_RE_Radar_Ctl_Look_Complete_Post_RFBIST
          OIT_RE_Radar_Ctl_Look_Trigger_Pp_Radar_Ctl_Look_Trigger_Operation: RteUsedOsEventRef=Rte_Ev_Run_SWC_PLT_CDD_Radar_Control_RE_Radar_Ctl_Look_Trigger
          TMT_RE_Test: RteUsedOsEventRef=Rte_Ev_Cyclic_Radar_Ctrl_Task_0_50ms, RteUsedOsAlarmRef=Os/Rte_Al_TE_Radar_Ctrl_Task_0_50ms
      SWC_PLT_CDD_TimeSync_EcuSwComposition
        DRT_DRE_StatusNotification_Callback_Rp_StbMStatusNotificationCallback_StbMSynchronizedTimeBase_eventNotification (RteEventToTaskMapping): RteUsedOsEventRef=Rte_Ev_Run_SWC_PLT_CDD_TimeSync_DRE_StatusNotification_Callback
        TMT_RE_PLT_TimeSync_Main_50ms (RteEventToTaskMapping): RteUsedOsEventRef=Rte_Ev_Cyclic_Appl_Task_0_50ms, RteUsedOsAlarmRef=Os/Rte_Al_TE_Appl_Task_0_50ms
      SWC_PLT_CDD_WdgHandler_EcuSwComposition
      SWC_PLT_CDD_XCP_EcuSwComposition
        TMT_RE_XCP_10ms (RteEventToTaskMapping): RteUsedOsEventRef=Rte_Ev_Cyclic_Appl_Task_0_10ms, RteUsedOsAlarmRef=Os/Rte_Al_TE_Appl_Task_0_10ms
        SWC_PLT_CDD_XCP_50ms (RteEventToTaskMapping): RteUsedOsEventRef=Rte_Ev_Cyclic_Appl_Task_0_50ms, RteUsedOsAlarmRef=Os/Rte_Al_TE_Appl_Task_0_50ms
      SWC_PLT_Radar_Alignment_Handler_EcuSwComposition
        TMT_Runnable (RteEventToTaskMapping): RteUsedOsEventRef=Rte_Ev_Cyclic_Appl_Task_0_50ms, RteUsedOsAlarmRef=Os/Rte_Al_TE_Appl_Task_0_50ms
      SWC_PLT_Service_IoHwAb_EcuSwComposition
        TMT_RE_Service_IoHwAb_ADCFilter_5ms (RteEventToTaskMapping): RteUsedOsEventRef=Rte_Ev_Cyclic_Appl_Task_0_5ms, RteUsedOsAlarmRef=Os/Rte_Al_TE_Appl_Task_0_5ms
        TMT_RE_Service_IoHwAb_Main_5ms (RteEventToTaskMapping): RteUsedOsEventRef=Rte_Ev_Cyclic_Appl_Task_0_5ms, RteUsedOsAlarmRef=Os/Rte_Al_TE_Appl_Task_0_5ms
      SWC_PRJ_Appl_FaultMgr_EcuSwComposition
        18 x RteEventToTaskMapping:
          DRT_RE_PCAN_Timeout_Faults_Event_Rp_Alignment_Status_1_Com_Rx_Timeout_Status_De_Com_Rx_Timeout_Status: RteUsedOsEventRef=Rte_Ev_Run_SWC_PRJ_Appl_FaultMgr_RE_PCAN_Timeout_Faults_Event
          DRT_RE_PCAN_Timeout_Faults_Event_Rp_Header_msg_Com_Rx_Timeout_Status_De_Com_Rx_Timeout_Status: RteUsedOsEventRef=Rte_Ev_Run_SWC_PRJ_Appl_FaultMgr_RE_PCAN_Timeout_Faults_Event
          DRT_RE_PCAN_Timeout_Faults_Event_Rp_Radar_Capability_Com_Rx_Timeout_Status_De_Com_Rx_Timeout_Status: RteUsedOsEventRef=Rte_Ev_Run_SWC_PRJ_Appl_FaultMgr_RE_PCAN_Timeout_Faults_Event
          DRT_RE_PCAN_Timeout_Faults_Event_Rp_Radar_Status_1_Com_Rx_Timeout_Status_De_Com_Rx_Timeout_Status: RteUsedOsEventRef=Rte_Ev_Run_SWC_PRJ_Appl_FaultMgr_RE_PCAN_Timeout_Faults_Event
          DRT_RE_PCAN_Timeout_Faults_Event_Rp_Radar_Status_2_Com_Rx_Timeout_Status_De_Com_Rx_Timeout_Status: RteUsedOsEventRef=Rte_Ev_Run_SWC_PRJ_Appl_FaultMgr_RE_PCAN_Timeout_Faults_Event
          TMT_RE_PRJ_FaultMgr_50ms: RteUsedOsEventRef=Rte_Ev_Cyclic_Appl_Task_0_50ms, RteUsedOsAlarmRef=Os/Rte_Al_TE_Appl_Task_0_50ms
          TMT_RE_PRJ_FaultMgr_DEM_50ms: RteUsedOsEventRef=Rte_Ev_Cyclic_Appl_Task_0_50ms, RteUsedOsAlarmRef=Os/Rte_Al_TE_Appl_Task_0_50ms
          DRT_RE_VCAN_Timeout_Faults_100ms_1000ms_Event_Rp_CLS_TX_16_message_Non_Safety_Timeout_Status_De_Com_Rx_Vcan_Non_Safety_T1AF7BF27: RteUsedOsEventRef=Rte_Ev_Run_SWC_PRJ_Appl_FaultMgr_RE_VCAN_Timeout_Faults_100ms_1000ms_Event
          DRT_RE_VCAN_Timeout_Faults_100ms_1000ms_Event_Rp_CLS_TX_4_message_Non_Safety_Timeout_Status_De_Com_Rx_Vcan_Non_Safety_TiECCFE111: RteUsedOsEventRef=Rte_Ev_Run_SWC_PRJ_Appl_FaultMgr_RE_VCAN_Timeout_Faults_100ms_1000ms_Event
          DRT_RE_VCAN_Timeout_Faults_100ms_1000ms_Event_Rp_ETC2_AT_AMT_message_Vcan_Safety_Timeout_Status_De_Com_Rx_Vcan_Timeout_Status: RteUsedOsEventRef=Rte_Ev_Run_SWC_PRJ_Appl_FaultMgr_RE_VCAN_Timeout_Faults_100ms_1000ms_Event
          DRT_RE_VCAN_Timeout_Faults_100ms_1000ms_Event_Rp_ETC2_MT_Variant_message_Vcan_Safety_Timeout_Status_De_Com_Rx_Vcan_TimeoB50257A3: RteUsedOsEventRef=Rte_Ev_Run_SWC_PRJ_Appl_FaultMgr_RE_VCAN_Timeout_Faults_100ms_1000ms_Event
          DRT_RE_VCAN_Timeout_Faults_100ms_1000ms_Event_Rp_OEL_message_Non_Safety_Timeout_Status_De_Com_Rx_Vcan_Non_Safety_Timeout_Status: RteUsedOsEventRef=Rte_Ev_Run_SWC_PRJ_Appl_FaultMgr_RE_VCAN_Timeout_Faults_100ms_1000ms_Event
          DRT_RE_VCAN_Timeout_Faults_100ms_1000ms_Event_Rp_TD_message_Non_Safety_Timeout_Status_De_Com_Rx_Vcan_Non_Safety_Timeout_Status: RteUsedOsEventRef=Rte_Ev_Run_SWC_PRJ_Appl_FaultMgr_RE_VCAN_Timeout_Faults_100ms_1000ms_Event
          DRT_RE_VCAN_Timeout_Faults_100ms_1000ms_Event_Rp_VD_message_Non_Safety_Timeout_Status_De_Com_Rx_Vcan_Non_Safety_Timeout_Status: RteUsedOsEventRef=Rte_Ev_Run_SWC_PRJ_Appl_FaultMgr_RE_VCAN_Timeout_Faults_100ms_1000ms_Event
          DRT_RE_VCAN_Timeout_Faults_10ms_20ms_50ms_Event_Rp_ADAS_Function_Switch_message_Non_Safety_Timeout_Status_De_Com_Rx_Vcan730D83E3: RteUsedOsEventRef=Rte_Ev_Run_SWC_PRJ_Appl_FaultMgr_RE_VCAN_Timeout_Faults_10ms_20ms_50ms_Event
          DRT_RE_VCAN_Timeout_Faults_10ms_20ms_50ms_Event_Rp_CCVS1_message_Vcan_Safety_Timeout_Status_De_Com_Rx_Vcan_Timeout_Status: RteUsedOsEventRef=Rte_Ev_Run_SWC_PRJ_Appl_FaultMgr_RE_VCAN_Timeout_Faults_10ms_20ms_50ms_Event
          DRT_RE_VCAN_Timeout_Faults_10ms_20ms_50ms_Event_Rp_SAS_message_Non_Safety_Timeout_Status_De_Com_Rx_Vcan_Non_Safety_TimeoFAAB906B: RteUsedOsEventRef=Rte_Ev_Run_SWC_PRJ_Appl_FaultMgr_RE_VCAN_Timeout_Faults_10ms_20ms_50ms_Event
          DRT_RE_VCAN_Timeout_Faults_10ms_20ms_50ms_Event_Rp_VDC2_message_Vcan_Safety_Timeout_Status_De_Com_Rx_Vcan_Timeout_Status: RteUsedOsEventRef=Rte_Ev_Run_SWC_PRJ_Appl_FaultMgr_RE_VCAN_Timeout_Faults_10ms_20ms_50ms_Event
      SWC_PRJ_Appl_Power_Manager_EcuSwComposition
        TMT_RE_Power_Manager_5ms (RteEventToTaskMapping): RteUsedOsEventRef=Rte_Ev_Cyclic_Appl_Task_0_5ms, RteUsedOsAlarmRef=Os/Rte_Al_TE_Appl_Task_0_5ms
      SWC_PRJ_Appl_Security_Manager_EcuSwComposition
        TMT_RE_Security_Manager_50ms (RteEventToTaskMapping): RteUsedOsEventRef=Rte_Ev_Cyclic_Appl_Task_0_50ms, RteUsedOsAlarmRef=Os/Rte_Al_TE_Appl_Task_0_50ms
      SWC_PRJ_Appl_SensorPosition_EcuSwComposition
        TMT_RE_SensorPosition_50ms (RteEventToTaskMapping): RteUsedOsEventRef=Rte_Ev_Cyclic_Appl_Task_0_50ms, RteUsedOsAlarmRef=Os/Rte_Al_TE_Appl_Task_0_50ms
      StbM_EcuSwComposition
        Timer_StbM_MainFunction (RteEventToTaskMapping): RteUsedOsEventRef=Rte_Ev_Cyclic2_Appl_Task_High_Prio_0_10ms, RteUsedOsAlarmRef=Os/Rte_Al_TE2_Appl_Task_High_Prio_0_10ms
      WdgM_OsCore0_ASIL_EcuSwComposition
        Timer_WdgM_MainFunction (RteEventToTaskMapping): RteUsedOsEventRef=Rte_Ev_Cyclic2_Appl_Task_High_Prio_0_5ms, RteUsedOsAlarmRef=Os/Rte_Al_TE2_Appl_Task_High_Prio_0_5ms
    RteOsInteraction
      29 x RteUsedOsActivation, all with RteExpectedActivationOffset=0:
        Rte_Al_TE2_Appl_BackgroundTask_0_5ms: RteActivationOsAlarmRef=Os/Rte_Al_TE2_Appl_BackgroundTask_0_5ms, RteActivationOsTaskRef=Appl_BackgroundTask
        Rte_Al_TE_Appl_IPC_Task_0_50ms: RteActivationOsAlarmRef=Os/Rte_Al_TE_Appl_IPC_Task_0_50ms, RteActivationOsTaskRef=Appl_IPC_Task
        Rte_Al_TE_SWC_CDD_IPC_RE_IPC_VSE_Handler_10ms: RteActivationOsAlarmRef=Os/Rte_Al_TE_SWC_CDD_IPC_RE_IPC_VSE_Handler_10ms, RteActivationOsTaskRef=Appl_IPC_Task
        Rte_Al_TE_Appl_Task_0_10ms: RteActivationOsAlarmRef=Os/Rte_Al_TE_Appl_Task_0_10ms, RteActivationOsTaskRef=Appl_Task
        Rte_Al_TE_Appl_Task_0_50ms: RteActivationOsAlarmRef=Os/Rte_Al_TE_Appl_Task_0_50ms, RteActivationOsTaskRef=Appl_Task
        Rte_Al_TE_Appl_Task_0_5ms: RteActivationOsAlarmRef=Os/Rte_Al_TE_Appl_Task_0_5ms, RteActivationOsTaskRef=Appl_Task
        Rte_Al_TE_SWC_PLT_Appl_IntWDG_RE_PLT_WDG_INTERNAL_WDG_PLT_Appl_Task: RteActivationOsAlarmRef=Os/Rte_Al_TE_SWC_PLT_Appl_IntWDG_RE_PLT_WDG_INTERNAL_WDG_PLT_Appl_Task, RteActivationOsTaskRef=Appl_Task
        Rte_Al_TE2_Appl_Task_Communication_0_10ms: RteActivationOsAlarmRef=Os/Rte_Al_TE2_Appl_Task_Communication_0_10ms, RteActivationOsTaskRef=Appl_Task_Communication
        Rte_Al_TE_Appl_Task_Communication_0_25ms: RteActivationOsAlarmRef=Os/Rte_Al_TE_Appl_Task_Communication_0_25ms, RteActivationOsTaskRef=Appl_Task_Communication
        Rte_Al_TE_Com_Com_MainFunctionTx_ComMainFunctionTx_Periodic: RteActivationOsAlarmRef=Os/Rte_Al_TE_Com_Com_MainFunctionTx_ComMainFunctionTx_Periodic, RteActivationOsTaskRef=Appl_Task_Communication
        Rte_Al_TE_SWC_PLT_Appl_Communication_RE_Communication_Tx_50ms: RteActivationOsAlarmRef=Os/Rte_Al_TE_SWC_PLT_Appl_Communication_RE_Communication_Tx_50ms, RteActivationOsTaskRef=Appl_Task_Communication
        Rte_Al_TE_SWC_PLT_CDD_Logging_RE_Logging_10ms: RteActivationOsAlarmRef=Os/Rte_Al_TE_SWC_PLT_CDD_Logging_RE_Logging_10ms, RteActivationOsTaskRef=Appl_Task_Fast
        Rte_Al_TE_SWC_PLT_CDD_Logging_RE_Logging_2ms: RteActivationOsAlarmRef=Os/Rte_Al_TE_SWC_PLT_CDD_Logging_RE_Logging_2ms, RteActivationOsTaskRef=Appl_Task_Fast
        Rte_Al_TE_SWC_PLT_CDD_Logging_RE_Logging_50ms: RteActivationOsAlarmRef=Os/Rte_Al_TE_SWC_PLT_CDD_Logging_RE_Logging_50ms, RteActivationOsTaskRef=Appl_Task_Fast
        Rte_Al_TE_SWC_PLT_CDD_Logging_RE_Logging_5ms: RteActivationOsAlarmRef=Os/Rte_Al_TE_SWC_PLT_CDD_Logging_RE_Logging_5ms, RteActivationOsTaskRef=Appl_Task_Fast
        Rte_Al_TE2_Appl_Task_High_Prio_0_10ms: RteActivationOsAlarmRef=Os/Rte_Al_TE2_Appl_Task_High_Prio_0_10ms, RteActivationOsTaskRef=Appl_Task_High_Prio
        Rte_Al_TE2_Appl_Task_High_Prio_0_5ms: RteActivationOsAlarmRef=Os/Rte_Al_TE2_Appl_Task_High_Prio_0_5ms, RteActivationOsTaskRef=Appl_Task_High_Prio
        Rte_Al_TE_SWC_PLT_Appl_Diag_RE_PLT_Diag_PlatformTime_50ms: RteActivationOsAlarmRef=Os/Rte_Al_TE_SWC_PLT_Appl_Diag_RE_PLT_Diag_PlatformTime_50ms, RteActivationOsTaskRef=Appl_Task_High_Prio
        Rte_Al_TE_SWC_PLT_Appl_IntWDG_RE_PLT_WDG_Main_5ms: RteActivationOsAlarmRef=Os/Rte_Al_TE_SWC_PLT_Appl_IntWDG_RE_PLT_WDG_Main_5ms, RteActivationOsTaskRef=Appl_Task_High_Prio
        Rte_Al_TE_SWC_CMP_PRJ_UDSHandler_RE_SWC_CMP_PRJ_UDSHandler_Main_50ms: RteActivationOsAlarmRef=Os/Rte_Al_TE_SWC_CMP_PRJ_UDSHandler_RE_SWC_CMP_PRJ_UDSHandler_Main_50ms, RteActivationOsTaskRef=Appl_Task_Logging
        Rte_Al_TE2_BSW_Task_0_10ms: RteActivationOsAlarmRef=Os/Rte_Al_TE2_BSW_Task_0_10ms, RteActivationOsTaskRef=BSW_Task
        Rte_Al_TE2_BSW_Task_0_20ms: RteActivationOsAlarmRef=Os/Rte_Al_TE2_BSW_Task_0_20ms, RteActivationOsTaskRef=BSW_Task
        Rte_Al_TE2_BSW_Task_0_5ms: RteActivationOsAlarmRef=Os/Rte_Al_TE2_BSW_Task_0_5ms, RteActivationOsTaskRef=BSW_Task
        Rte_Al_TE_SWC_PLT_Appl_IntWDG_RE_PLT_WDG_INTERNAL_WDG_BSW_Task: RteActivationOsAlarmRef=Os/Rte_Al_TE_SWC_PLT_Appl_IntWDG_RE_PLT_WDG_INTERNAL_WDG_BSW_Task, RteActivationOsTaskRef=BSW_Task
        Rte_Al_TE_SWC_PLT_Appl_NvMHandler_RE_PLT_Appl_NvMHandler_5ms: RteActivationOsAlarmRef=Os/Rte_Al_TE_SWC_PLT_Appl_NvMHandler_RE_PLT_Appl_NvMHandler_5ms, RteActivationOsTaskRef=BSW_Task
        Rte_Al_TE_Radar_Ctrl_Task_0_50ms: RteActivationOsAlarmRef=Os/Rte_Al_TE_Radar_Ctrl_Task_0_50ms, RteActivationOsTaskRef=Radar_Ctrl_Task
        Rte_Al_TE_Rtm_Rtm_MainFunction: RteActivationOsAlarmRef=Os/Rte_Al_TE_Rtm_Rtm_MainFunction, RteActivationOsTaskRef=Radar_Ctrl_Task
        Rte_Al_TE_SWC_PLT_CDD_Radar_Control_RE_Radar_Control_10ms: RteActivationOsAlarmRef=Os/Rte_Al_TE_SWC_PLT_CDD_Radar_Control_RE_Radar_Control_10ms, RteActivationOsTaskRef=Radar_Ctrl_Task
        Rte_Al_TE_SWC_PLT_CDD_Radar_Control_RE_Radar_Ctl_Look_Complete_Post_RFBIST: RteActivationOsAlarmRef=Os/Rte_Al_TE_SWC_PLT_CDD_Radar_Control_RE_Radar_Ctl_Look_Complete_Post_RFBIST, RteActivationOsTaskRef=Radar_Ctrl_Task
  module config NvM
    10 x NvMBlockDescriptor:
      SWC_CMP_PRJ_UDSHandlerSWC_UDSHandler_VIN: NvMNvBlockLength=17, NvMRamBlockDataAddress=Rte_SWC_CMP_PRJ_UDSHandler_SWC_UDS_VIN, NvMRomBlockDataAddress=Rte_SWC_CMP_PRJ_UDSHandler_SWC_UDSHandler_VIN_DefaultValue
      SWC_CMP_PRJ_UDSHandlerSWC_UDSHandler_Attemptcounter: NvMNvBlockLength=2, NvMRamBlockDataAddress=Rte_SWC_CMP_PRJ_UDSHandler_SWC_UDS_AttemptCounter, NvMRomBlockDataAddress=Rte_SWC_CMP_PRJ_UDSHandler_SWC_UDSHandler_Attemptcounter_DefaultValue
      SWC_PLT_Appl_NvMHandlerCorrectable_Fault_NvM: NvMNvBlockLength=24, NvMRamBlockDataAddress=Rte_SWC_PLT_Appl_NvMHandler_Correctable_Fault_PIM, NvMRomBlockDataAddress=Rte_SWC_PLT_Appl_NvMHandler_Correctable_Fault_NvM_DefaultValue
      SWC_PLT_Appl_NvMHandlerSWC_PLT_CDD_FailSafe: NvMNvBlockLength=124, NvMRamBlockDataAddress=Rte_SWC_PLT_Appl_NvMHandler_FailSafe_ResetReason_PIM, NvMRomBlockDataAddress=Rte_SWC_PLT_Appl_NvMHandler_SWC_PLT_CDD_FailSafe_DefaultValue
      SWC_PLT_Appl_NvMHandlerSWC_Manual_alignment_Execution: NvMNvBlockLength=16, NvMRamBlockDataAddress=Rte_SWC_PLT_Appl_NvMHandler_Manual_Alignment_Execution_Data_PIM, NvMRomBlockDataAddress=Rte_SWC_PLT_Appl_NvMHandler_SWC_Manual_alignment_Execution_DefaultValue
      SWC_PLT_Appl_NvMHandlerBringup_NvMBlock: NvMNvBlockLength=64, NvMRamBlockDataAddress=Rte_SWC_PLT_Appl_NvMHandler_NvMBringUp_PIM, NvMRomBlockDataAddress=Rte_SWC_PLT_Appl_NvMHandler_NvMBringUp_DefaultValue
      SWC_PLT_Appl_NvMHandlerRFE_R1R2_Fault_NvM: NvMNvBlockLength=72, NvMRamBlockDataAddress=Rte_SWC_PLT_Appl_NvMHandler_RFE_R1R2_PIM, NvMRomBlockDataAddress=Rte_SWC_PLT_Appl_NvMHandler_RFE_R1R2_Fault_NvM_DefaultValue
      SWC_PLT_Appl_NvMHandlerSensorPos_NvM: NvMNvBlockLength=8, NvMRamBlockDataAddress=Rte_SWC_PLT_Appl_NvMHandler_Sensorpos_PIM_UDS, NvMRomBlockDataAddress=Rte_SWC_PLT_Appl_NvMHandler_SensorPos_NvM_DefaultValue
      SWC_PLT_Appl_NvMHandlerSWC_Static_Alignment_Write_Parameters: NvMNvBlockLength=12, NvMRamBlockDataAddress=Rte_SWC_PLT_Appl_NvMHandler_Static_Alignment_Engineering_Write_Configuration_Parameters_PIM, NvMRomBlockDataAddress=Rte_SWC_PLT_Appl_NvMHandler_SWC_Static_Alignment_Write_Parameters_DefaultValue
      SWC_PLT_Appl_NvMHandlerSWC_VSE_NVM_Params: NvMNvBlockLength=20, NvMRamBlockDataAddress=Rte_SWC_PLT_Appl_NvMHandler_VSE_NVM_Params_PIM, NvMRomBlockDataAddress=Rte_SWC_PLT_Appl_NvMHandler_SWC_VSE_NVM_Params_DefaultValue
  module config Os
    Appl_BackgroundTask (OsTask):
      OsTaskActivation = 1
      OsTaskPriority = 1
      OsTaskSchedule = FULL
      OsTaskEventRef = Rte_Ev_Cyclic2_Appl_BackgroundTask_0_5ms
      OsTaskAccessingApplication = OsCore_Qm
    Rte_Al_TE2_Appl_BackgroundTask_0_5ms (OsAlarm): OsAlarmCounterRef=OsCounter
      OsAlarmAction
        OsAlarmSetEvent: OsAlarmSetEventRef=Rte_Ev_Cyclic2_Appl_BackgroundTask_0_5ms, OsAlarmSetEventTaskRef=Appl_BackgroundTask
    Appl_IPC_Task (OsTask):
      OsTaskActivation = 1
      OsTaskPriority = 130
      OsTaskSchedule = FULL
      OsTaskEventRef = Rte_Ev_Cyclic_Appl_IPC_Task_0_50ms
      OsTaskEventRef = Rte_Ev_Run_SWC_CDD_IPC_Dsp_sp_post_processing_complete
      OsTaskEventRef = Rte_Ev_Run_SWC_CDD_IPC_RE_IPC_VSE_Handler_10ms
      OsTaskAccessingApplication = OsCore_Qm
    Rte_Al_TE_Appl_IPC_Task_0_50ms (OsAlarm): OsAlarmCounterRef=OsCounter
      OsAlarmAction
        OsAlarmSetEvent: OsAlarmSetEventRef=Rte_Ev_Cyclic_Appl_IPC_Task_0_50ms, OsAlarmSetEventTaskRef=Appl_IPC_Task
    Rte_Al_TE_SWC_CDD_IPC_RE_IPC_VSE_Handler_10ms (OsAlarm): OsAlarmCounterRef=OsCounter
      OsAlarmAction
        OsAlarmSetEvent: OsAlarmSetEventRef=Rte_Ev_Run_SWC_CDD_IPC_RE_IPC_VSE_Handler_10ms, OsAlarmSetEventTaskRef=Appl_IPC_Task
    Appl_Init (OsTask): OsTaskActivation=1, OsTaskPriority=190, OsTaskSchedule=NON, OsTaskAccessingApplication=OsCore_Qm
    Appl_Task (OsTask):
      OsTaskActivation = 1
      OsTaskPriority = 40
      OsTaskSchedule = FULL
      OsTaskEventRef = Rte_Ev_Cyclic_Appl_Task_0_10ms
      OsTaskEventRef = Rte_Ev_Cyclic_Appl_Task_0_50ms
      OsTaskEventRef = Rte_Ev_Cyclic_Appl_Task_0_5ms
      OsTaskEventRef = Rte_Ev_Run_SWC_PLT_Appl_IntWDG_RE_PLT_WDG_INTERNAL_WDG_PLT_Appl_Task
      OsTaskAccessingApplication = OsCore_Qm
    4 x OsAlarm, all with OsAlarmCounterRef=OsCounter:
      Rte_Al_TE_Appl_Task_0_10ms
        OsAlarmAction
          OsAlarmSetEvent: OsAlarmSetEventRef=Rte_Ev_Cyclic_Appl_Task_0_10ms, OsAlarmSetEventTaskRef=Appl_Task
      Rte_Al_TE_Appl_Task_0_50ms
        OsAlarmAction
          OsAlarmSetEvent: OsAlarmSetEventRef=Rte_Ev_Cyclic_Appl_Task_0_50ms, OsAlarmSetEventTaskRef=Appl_Task
      Rte_Al_TE_Appl_Task_0_5ms
        OsAlarmAction
          OsAlarmSetEvent: OsAlarmSetEventRef=Rte_Ev_Cyclic_Appl_Task_0_5ms, OsAlarmSetEventTaskRef=Appl_Task
      Rte_Al_TE_SWC_PLT_Appl_IntWDG_RE_PLT_WDG_INTERNAL_WDG_PLT_Appl_Task
        OsAlarmAction
          OsAlarmSetEvent: OsAlarmSetEventRef=Rte_Ev_Run_SWC_PLT_Appl_IntWDG_RE_PLT_WDG_INTERNAL_WDG_PLT_Appl_Task, OsAlarmSetEventTaskRef=Appl_Task
    Appl_Task_Communication (OsTask):
      OsTaskActivation = 1
      OsTaskPriority = 80
      OsTaskSchedule = FULL
      OsTaskEventRef = Rte_Ev_Cyclic2_Appl_Task_Communication_0_10ms
      OsTaskEventRef = Rte_Ev_Cyclic_Appl_Task_Communication_0_25ms
      OsTaskEventRef = Rte_Ev_Run_Com_Com_MainFunctionTx_ComMainFunctionTx_Periodic
      OsTaskEventRef = Rte_Ev_Run_SWC_PLT_Appl_Communication_PostRadarProcessing_CAN_Tx_RE_Communication_Tx
      OsTaskEventRef = Rte_Ev_Run_SWC_PLT_Appl_Communication_RE_Communication_Tx_50ms
      OsTaskEventRef = Rte_Ev_Run_SWC_PRJ_Appl_FaultMgr_RE_PCAN_Timeout_Faults_Event
      OsTaskEventRef = Rte_Ev_Run_SWC_PRJ_Appl_FaultMgr_RE_VCAN_Timeout_Faults_100ms_1000ms_Event
      OsTaskEventRef = Rte_Ev_Run_SWC_PRJ_Appl_FaultMgr_RE_VCAN_Timeout_Faults_10ms_20ms_50ms_Event
      OsTaskAccessingApplication = OsCore_Qm
    4 x OsAlarm, all with OsAlarmCounterRef=OsCounter:
      Rte_Al_TE2_Appl_Task_Communication_0_10ms
        OsAlarmAction
          OsAlarmSetEvent: OsAlarmSetEventRef=Rte_Ev_Cyclic2_Appl_Task_Communication_0_10ms, OsAlarmSetEventTaskRef=Appl_Task_Communication
      Rte_Al_TE_Appl_Task_Communication_0_25ms
        OsAlarmAction
          OsAlarmSetEvent: OsAlarmSetEventRef=Rte_Ev_Cyclic_Appl_Task_Communication_0_25ms, OsAlarmSetEventTaskRef=Appl_Task_Communication
      Rte_Al_TE_Com_Com_MainFunctionTx_ComMainFunctionTx_Periodic
        OsAlarmAction
          OsAlarmSetEvent: OsAlarmSetEventRef=Rte_Ev_Run_Com_Com_MainFunctionTx_ComMainFunctionTx_Periodic, OsAlarmSetEventTaskRef=Appl_Task_Communication
      Rte_Al_TE_SWC_PLT_Appl_Communication_RE_Communication_Tx_50ms
        OsAlarmAction
          OsAlarmSetEvent: OsAlarmSetEventRef=Rte_Ev_Run_SWC_PLT_Appl_Communication_RE_Communication_Tx_50ms, OsAlarmSetEventTaskRef=Appl_Task_Communication
    Appl_Task_Fast (OsTask):
      OsTaskActivation = 1
      OsTaskPriority = 50
      OsTaskSchedule = FULL
      OsTaskEventRef = Rte_Ev_Run_SWC_PLT_CDD_Logging_PostRadarProcessing_RDD_Populate_RDD_Stream
      OsTaskEventRef = Rte_Ev_Run_SWC_PLT_CDD_Logging_RE_Logging_10ms
      OsTaskEventRef = Rte_Ev_Run_SWC_PLT_CDD_Logging_RE_Logging_2ms
      OsTaskEventRef = Rte_Ev_Run_SWC_PLT_CDD_Logging_RE_Logging_50ms
      OsTaskEventRef = Rte_Ev_Run_SWC_PLT_CDD_Logging_RE_Logging_5ms
      OsTaskAccessingApplication = OsCore0_ASIL
    4 x OsAlarm, all with OsAlarmCounterRef=OsCounter, OsAlarmAccessingApplication=OsCore0_ASIL:
      Rte_Al_TE_SWC_PLT_CDD_Logging_RE_Logging_10ms
        OsAlarmAction
          OsAlarmSetEvent: OsAlarmSetEventRef=Rte_Ev_Run_SWC_PLT_CDD_Logging_RE_Logging_10ms, OsAlarmSetEventTaskRef=Appl_Task_Fast
      Rte_Al_TE_SWC_PLT_CDD_Logging_RE_Logging_2ms
        OsAlarmAction
          OsAlarmSetEvent: OsAlarmSetEventRef=Rte_Ev_Run_SWC_PLT_CDD_Logging_RE_Logging_2ms, OsAlarmSetEventTaskRef=Appl_Task_Fast
      Rte_Al_TE_SWC_PLT_CDD_Logging_RE_Logging_50ms
        OsAlarmAction
          OsAlarmSetEvent: OsAlarmSetEventRef=Rte_Ev_Run_SWC_PLT_CDD_Logging_RE_Logging_50ms, OsAlarmSetEventTaskRef=Appl_Task_Fast
      Rte_Al_TE_SWC_PLT_CDD_Logging_RE_Logging_5ms
        OsAlarmAction
          OsAlarmSetEvent: OsAlarmSetEventRef=Rte_Ev_Run_SWC_PLT_CDD_Logging_RE_Logging_5ms, OsAlarmSetEventTaskRef=Appl_Task_Fast
    Appl_Task_High_Prio (OsTask):
      OsTaskActivation = 1
      OsTaskPriority = 150
      OsTaskSchedule = FULL
      OsTaskEventRef = Rte_Ev_Cyclic2_Appl_Task_High_Prio_0_10ms
      OsTaskEventRef = Rte_Ev_Cyclic2_Appl_Task_High_Prio_0_5ms
      OsTaskEventRef = Rte_Ev_Run_SWC_PLT_Appl_Diag_RE_PLT_Diag_PlatformTime_50ms
      OsTaskEventRef = Rte_Ev_Run_SWC_PLT_Appl_IntWDG_RE_PLT_WDG_Main_5ms
      OsTaskEventRef = Rte_Ev_WP_Appl_Task_High_Prio
      OsTaskAccessingApplication = OsCore_Qm
    4 x OsAlarm, all with OsAlarmCounterRef=OsCounter:
      Rte_Al_TE2_Appl_Task_High_Prio_0_10ms
        OsAlarmAction
          OsAlarmSetEvent: OsAlarmSetEventRef=Rte_Ev_Cyclic2_Appl_Task_High_Prio_0_10ms, OsAlarmSetEventTaskRef=Appl_Task_High_Prio
      Rte_Al_TE2_Appl_Task_High_Prio_0_5ms
        OsAlarmAction
          OsAlarmSetEvent: OsAlarmSetEventRef=Rte_Ev_Cyclic2_Appl_Task_High_Prio_0_5ms, OsAlarmSetEventTaskRef=Appl_Task_High_Prio
      Rte_Al_TE_SWC_PLT_Appl_Diag_RE_PLT_Diag_PlatformTime_50ms
        OsAlarmAction
          OsAlarmSetEvent: OsAlarmSetEventRef=Rte_Ev_Run_SWC_PLT_Appl_Diag_RE_PLT_Diag_PlatformTime_50ms, OsAlarmSetEventTaskRef=Appl_Task_High_Prio
      Rte_Al_TE_SWC_PLT_Appl_IntWDG_RE_PLT_WDG_Main_5ms
        OsAlarmAction
          OsAlarmSetEvent: OsAlarmSetEventRef=Rte_Ev_Run_SWC_PLT_Appl_IntWDG_RE_PLT_WDG_Main_5ms, OsAlarmSetEventTaskRef=Appl_Task_High_Prio
    Appl_Task_Logging (OsTask):
      OsTaskActivation = 1
      OsTaskPriority = 90
      OsTaskSchedule = FULL
      OsTaskEventRef = Rte_Ev_Run_SWC_CMP_PRJ_UDSHandler_RE_SWC_CMP_PRJ_UDSHandler_Main_50ms
      OsTaskEventRef = Rte_Ev_Run_SWC_PLT_CDD_HIL_RE_HIL_Periodic_Handler_Rp_HIL_Periodic_Handler_Trigger
      OsTaskEventRef = Rte_Ev_Run_SWC_PLT_CDD_Logging_PostRadarProcessing_ADC_Populate_ADC_Stream
      OsTaskEventRef = Rte_Ev_Run_SWC_PLT_CDD_Logging_PostRadarProcessing_Debug_Populate_Debug_Stream
      OsTaskEventRef = Rte_Ev_Run_SWC_PLT_CDD_Logging_PostRadarProcessing_Detection_Populate_Detection_Stream
      OsTaskEventRef = Rte_Ev_Run_SWC_PLT_CDD_Logging_PostRadarProcessing_Header_Populate_Header_Stream
      OsTaskEventRef = Rte_Ev_Run_SWC_PLT_CDD_Logging_PostRadarProcessing_MMIC_Populate_MMIC_Stream
      OsTaskEventRef = Rte_Ev_Run_SWC_PLT_CDD_Logging_PostRadarProcessing_Radar_Capability_Populate_Radar_Capability_Stream
      OsTaskEventRef = Rte_Ev_Run_SWC_PLT_CDD_Logging_PostRadarProcessing_Status_Populate_Status_Stream
      OsTaskEventRef = Rte_Ev_Run_SWC_PLT_CDD_Logging_StbM_MeasurementNotification_StbMSynchronizedTimeBase_TimeRecordBlock_Callback
      OsTaskAccessingApplication = OsCore0_ASIL
    Rte_Al_TE_SWC_CMP_PRJ_UDSHandler_RE_SWC_CMP_PRJ_UDSHandler_Main_50ms (OsAlarm): OsAlarmCounterRef=OsCounter, OsAlarmAccessingApplication=OsCore0_ASIL
      OsAlarmAction
        OsAlarmSetEvent: OsAlarmSetEventRef=Rte_Ev_Run_SWC_CMP_PRJ_UDSHandler_RE_SWC_CMP_PRJ_UDSHandler_Main_50ms, OsAlarmSetEventTaskRef=Appl_Task_Logging
    BSW_Task (OsTask):
      OsTaskActivation = 1
      OsTaskPriority = 50
      OsTaskSchedule = FULL
      OsTaskEventRef = Rte_Ev_Cyclic2_BSW_Task_0_10ms
      OsTaskEventRef = Rte_Ev_Cyclic2_BSW_Task_0_20ms
      OsTaskEventRef = Rte_Ev_Cyclic2_BSW_Task_0_5ms
      OsTaskEventRef = Rte_Ev_Run_SWC_PLT_Appl_IntWDG_RE_PLT_WDG_INTERNAL_WDG_BSW_Task
      OsTaskEventRef = Rte_Ev_Run_SWC_PLT_Appl_NvMHandler_RE_PLT_Appl_NvMHandler_5ms
      OsTaskEventRef = Rte_Ev_Run_SWC_PLT_CDD_TimeSync_DRE_StatusNotification_Callback
      OsTaskAccessingApplication = OsCore_Qm
    5 x OsAlarm, all with OsAlarmCounterRef=OsCounter:
      Rte_Al_TE2_BSW_Task_0_10ms
        OsAlarmAction
          OsAlarmSetEvent: OsAlarmSetEventRef=Rte_Ev_Cyclic2_BSW_Task_0_10ms, OsAlarmSetEventTaskRef=BSW_Task
      Rte_Al_TE2_BSW_Task_0_20ms
        OsAlarmAction
          OsAlarmSetEvent: OsAlarmSetEventRef=Rte_Ev_Cyclic2_BSW_Task_0_20ms, OsAlarmSetEventTaskRef=BSW_Task
      Rte_Al_TE2_BSW_Task_0_5ms
        OsAlarmAction
          OsAlarmSetEvent: OsAlarmSetEventRef=Rte_Ev_Cyclic2_BSW_Task_0_5ms, OsAlarmSetEventTaskRef=BSW_Task
      Rte_Al_TE_SWC_PLT_Appl_IntWDG_RE_PLT_WDG_INTERNAL_WDG_BSW_Task
        OsAlarmAction
          OsAlarmSetEvent: OsAlarmSetEventRef=Rte_Ev_Run_SWC_PLT_Appl_IntWDG_RE_PLT_WDG_INTERNAL_WDG_BSW_Task, OsAlarmSetEventTaskRef=BSW_Task
      Rte_Al_TE_SWC_PLT_Appl_NvMHandler_RE_PLT_Appl_NvMHandler_5ms
        OsAlarmAction
          OsAlarmSetEvent: OsAlarmSetEventRef=Rte_Ev_Run_SWC_PLT_Appl_NvMHandler_RE_PLT_Appl_NvMHandler_5ms, OsAlarmSetEventTaskRef=BSW_Task
    Init_Task_Qm (OsTask): OsTaskActivation=1, OsTaskPriority=210, OsTaskSchedule=FULL, OsTaskAccessingApplication=OsCore0_ASIL
    Radar_Ctrl_Task (OsTask):
      OsTaskActivation = 1
      OsTaskPriority = 100
      OsTaskSchedule = FULL
      OsTaskEventRef = Rte_Ev_Cyclic_Radar_Ctrl_Task_0_50ms
      OsTaskEventRef = Rte_Ev_Run_Rtm_Rtm_MainFunction
      OsTaskEventRef = Rte_Ev_Run_SWC_PLT_CDD_Radar_Control_RE_Radar_Control_10ms
      OsTaskEventRef = Rte_Ev_Run_SWC_PLT_CDD_Radar_Control_RE_Radar_Ctl_Look_Complete_Post_RFBIST
      OsTaskEventRef = Rte_Ev_Run_SWC_PLT_CDD_Radar_Control_RE_Radar_Ctl_Look_Complete_Rp_Radar_Ctl_Look_Complete_Trigger
      OsTaskEventRef = Rte_Ev_Run_SWC_PLT_CDD_Radar_Control_RE_Radar_Ctl_Look_Trigger
      OsTaskAccessingApplication = OsCore_Qm
    4 x OsAlarm, all with OsAlarmCounterRef=OsCounter:
      Rte_Al_TE_Radar_Ctrl_Task_0_50ms
        OsAlarmAction
          OsAlarmSetEvent: OsAlarmSetEventRef=Rte_Ev_Cyclic_Radar_Ctrl_Task_0_50ms, OsAlarmSetEventTaskRef=Radar_Ctrl_Task
      Rte_Al_TE_Rtm_Rtm_MainFunction
        OsAlarmAction
          OsAlarmSetEvent: OsAlarmSetEventRef=Rte_Ev_Run_Rtm_Rtm_MainFunction, OsAlarmSetEventTaskRef=Radar_Ctrl_Task
      Rte_Al_TE_SWC_PLT_CDD_Radar_Control_RE_Radar_Control_10ms
        OsAlarmAction
          OsAlarmSetEvent: OsAlarmSetEventRef=Rte_Ev_Run_SWC_PLT_CDD_Radar_Control_RE_Radar_Control_10ms, OsAlarmSetEventTaskRef=Radar_Ctrl_Task
      Rte_Al_TE_SWC_PLT_CDD_Radar_Control_RE_Radar_Ctl_Look_Complete_Post_RFBIST
        OsAlarmAction
          OsAlarmSetEvent: OsAlarmSetEventRef=Rte_Ev_Run_SWC_PLT_CDD_Radar_Control_RE_Radar_Ctl_Look_Complete_Post_RFBIST, OsAlarmSetEventTaskRef=Radar_Ctrl_Task
    48 x OsEvent:
      Rte_Ev_Cyclic2_Appl_BackgroundTask_0_5ms
      Rte_Ev_Cyclic2_Appl_Task_Communication_0_10ms
      Rte_Ev_Cyclic2_Appl_Task_High_Prio_0_10ms
      Rte_Ev_Cyclic2_Appl_Task_High_Prio_0_5ms
      Rte_Ev_Cyclic2_BSW_Task_0_10ms
      Rte_Ev_Cyclic2_BSW_Task_0_20ms
      Rte_Ev_Cyclic2_BSW_Task_0_5ms
      Rte_Ev_Cyclic_Appl_IPC_Task_0_50ms
      Rte_Ev_Cyclic_Appl_Task_0_10ms
      Rte_Ev_Cyclic_Appl_Task_0_50ms
      Rte_Ev_Cyclic_Appl_Task_0_5ms
      Rte_Ev_Cyclic_Appl_Task_Communication_0_25ms
      Rte_Ev_Cyclic_Radar_Ctrl_Task_0_50ms
      Rte_Ev_Run_Com_Com_MainFunctionTx_ComMainFunctionTx_Periodic
      Rte_Ev_Run_Rtm_Rtm_MainFunction
      Rte_Ev_Run_SWC_CDD_IPC_Dsp_sp_post_processing_complete
      Rte_Ev_Run_SWC_CDD_IPC_RE_IPC_VSE_Handler_10ms
      Rte_Ev_Run_SWC_CMP_PRJ_UDSHandler_RE_SWC_CMP_PRJ_UDSHandler_Main_50ms
      Rte_Ev_Run_SWC_PLT_Appl_Communication_PostRadarProcessing_CAN_Tx_RE_Communication_Tx
      Rte_Ev_Run_SWC_PLT_Appl_Communication_RE_Communication_Tx_50ms
      Rte_Ev_Run_SWC_PLT_Appl_Diag_RE_PLT_Diag_PlatformTime_50ms
      Rte_Ev_Run_SWC_PLT_Appl_IntWDG_RE_PLT_WDG_INTERNAL_WDG_BSW_Task
      Rte_Ev_Run_SWC_PLT_Appl_IntWDG_RE_PLT_WDG_INTERNAL_WDG_PLT_Appl_Task
      Rte_Ev_Run_SWC_PLT_Appl_IntWDG_RE_PLT_WDG_Main_5ms
      Rte_Ev_Run_SWC_PLT_Appl_NvMHandler_RE_PLT_Appl_NvMHandler_5ms
      Rte_Ev_Run_SWC_PLT_CDD_HIL_RE_HIL_Periodic_Handler_Rp_HIL_Periodic_Handler_Trigger
      Rte_Ev_Run_SWC_PLT_CDD_Logging_PostRadarProcessing_ADC_Populate_ADC_Stream
      Rte_Ev_Run_SWC_PLT_CDD_Logging_PostRadarProcessing_Debug_Populate_Debug_Stream
      Rte_Ev_Run_SWC_PLT_CDD_Logging_PostRadarProcessing_Detection_Populate_Detection_Stream
      Rte_Ev_Run_SWC_PLT_CDD_Logging_PostRadarProcessing_Header_Populate_Header_Stream
      Rte_Ev_Run_SWC_PLT_CDD_Logging_PostRadarProcessing_MMIC_Populate_MMIC_Stream
      Rte_Ev_Run_SWC_PLT_CDD_Logging_PostRadarProcessing_RDD_Populate_RDD_Stream
      Rte_Ev_Run_SWC_PLT_CDD_Logging_PostRadarProcessing_Radar_Capability_Populate_Radar_Capability_Stream
      Rte_Ev_Run_SWC_PLT_CDD_Logging_PostRadarProcessing_Status_Populate_Status_Stream
      Rte_Ev_Run_SWC_PLT_CDD_Logging_RE_Logging_10ms
      Rte_Ev_Run_SWC_PLT_CDD_Logging_RE_Logging_2ms
      Rte_Ev_Run_SWC_PLT_CDD_Logging_RE_Logging_50ms
      Rte_Ev_Run_SWC_PLT_CDD_Logging_RE_Logging_5ms
      Rte_Ev_Run_SWC_PLT_CDD_Logging_StbM_MeasurementNotification_StbMSynchronizedTimeBase_TimeRecordBlock_Callback
      Rte_Ev_Run_SWC_PLT_CDD_Radar_Control_RE_Radar_Control_10ms
      Rte_Ev_Run_SWC_PLT_CDD_Radar_Control_RE_Radar_Ctl_Look_Complete_Post_RFBIST
      Rte_Ev_Run_SWC_PLT_CDD_Radar_Control_RE_Radar_Ctl_Look_Complete_Rp_Radar_Ctl_Look_Complete_Trigger
      Rte_Ev_Run_SWC_PLT_CDD_Radar_Control_RE_Radar_Ctl_Look_Trigger
      Rte_Ev_Run_SWC_PLT_CDD_TimeSync_DRE_StatusNotification_Callback
      Rte_Ev_Run_SWC_PRJ_Appl_FaultMgr_RE_PCAN_Timeout_Faults_Event
      Rte_Ev_Run_SWC_PRJ_Appl_FaultMgr_RE_VCAN_Timeout_Faults_100ms_1000ms_Event
      Rte_Ev_Run_SWC_PRJ_Appl_FaultMgr_RE_VCAN_Timeout_Faults_10ms_20ms_50ms_Event
      Rte_Ev_WP_Appl_Task_High_Prio: OsEventMask=2
    OsCore0_ASIL (OsApplication):
      OsTrusted = true
      OsAppTaskRef = Appl_BackgroundTask
      OsAppAlarmRef = Os/Rte_Al_TE2_Appl_BackgroundTask_0_5ms
      OsAppTaskRef = Appl_IPC_Task
      OsAppAlarmRef = Os/Rte_Al_TE_Appl_IPC_Task_0_50ms
      OsAppAlarmRef = Os/Rte_Al_TE_SWC_CDD_IPC_RE_IPC_VSE_Handler_10ms
      OsAppTaskRef = Appl_Init
      OsAppTaskRef = Appl_Task
      OsAppAlarmRef = Os/Rte_Al_TE_Appl_Task_0_10ms
      OsAppAlarmRef = Os/Rte_Al_TE_Appl_Task_0_50ms
      OsAppAlarmRef = Os/Rte_Al_TE_Appl_Task_0_5ms
      OsAppAlarmRef = Os/Rte_Al_TE_SWC_PLT_Appl_IntWDG_RE_PLT_WDG_INTERNAL_WDG_PLT_Appl_Task
      OsAppTaskRef = Appl_Task_Communication
      OsAppAlarmRef = Os/Rte_Al_TE2_Appl_Task_Communication_0_10ms
      OsAppAlarmRef = Os/Rte_Al_TE_Appl_Task_Communication_0_25ms
      OsAppAlarmRef = Os/Rte_Al_TE_Com_Com_MainFunctionTx_ComMainFunctionTx_Periodic
      OsAppAlarmRef = Os/Rte_Al_TE_SWC_PLT_Appl_Communication_RE_Communication_Tx_50ms
      OsAppTaskRef = Appl_Task_High_Prio
      OsAppAlarmRef = Os/Rte_Al_TE2_Appl_Task_High_Prio_0_10ms
      OsAppAlarmRef = Os/Rte_Al_TE2_Appl_Task_High_Prio_0_5ms
      OsAppAlarmRef = Os/Rte_Al_TE_SWC_PLT_Appl_Diag_RE_PLT_Diag_PlatformTime_50ms
      OsAppAlarmRef = Os/Rte_Al_TE_SWC_PLT_Appl_IntWDG_RE_PLT_WDG_Main_5ms
      OsAppTaskRef = BSW_Task
      OsAppAlarmRef = Os/Rte_Al_TE2_BSW_Task_0_10ms
      OsAppAlarmRef = Os/Rte_Al_TE2_BSW_Task_0_20ms
      OsAppAlarmRef = Os/Rte_Al_TE2_BSW_Task_0_5ms
      OsAppAlarmRef = Os/Rte_Al_TE_SWC_PLT_Appl_IntWDG_RE_PLT_WDG_INTERNAL_WDG_BSW_Task
      OsAppAlarmRef = Os/Rte_Al_TE_SWC_PLT_Appl_NvMHandler_RE_PLT_Appl_NvMHandler_5ms
      OsAppTaskRef = Radar_Ctrl_Task
      OsAppAlarmRef = Os/Rte_Al_TE_Radar_Ctrl_Task_0_50ms
      OsAppAlarmRef = Os/Rte_Al_TE_Rtm_Rtm_MainFunction
      OsAppAlarmRef = Os/Rte_Al_TE_SWC_PLT_CDD_Radar_Control_RE_Radar_Control_10ms
      OsAppAlarmRef = Os/Rte_Al_TE_SWC_PLT_CDD_Radar_Control_RE_Radar_Ctl_Look_Complete_Post_RFBIST
    OsCore_Qm (OsApplication):
      OsTrusted = true
      OsAppTaskRef = Appl_Task_Fast
      OsAppAlarmRef = Os/Rte_Al_TE_SWC_PLT_CDD_Logging_RE_Logging_10ms
      OsAppAlarmRef = Os/Rte_Al_TE_SWC_PLT_CDD_Logging_RE_Logging_2ms
      OsAppAlarmRef = Os/Rte_Al_TE_SWC_PLT_CDD_Logging_RE_Logging_50ms
      OsAppAlarmRef = Os/Rte_Al_TE_SWC_PLT_CDD_Logging_RE_Logging_5ms
      OsAppTaskRef = Appl_Task_Logging
      OsAppAlarmRef = Os/Rte_Al_TE_SWC_CMP_PRJ_UDSHandler_RE_SWC_CMP_PRJ_UDSHandler_Main_50ms
      OsAppTaskRef = Init_Task_Qm
  module config EcuC
  ecuc value collection DaVinci_Project: ecuc-values=[Rte, Os, EcuC, NvM]
  bsw implementation Rte_Impl
    mc-parameter-instances:
      15 x mc data instance:
        SWC_CMP_PRJ_UDSHandler_SWC_UDSHandler_Attemptcounter_DefaultValue: symbol=Rte_SWC_CMP_PRJ_UDSHandler_SWC_UDSHandler_Attemptcounter_DefaultValue
        SWC_CMP_PRJ_UDSHandler_SWC_UDSHandler_VIN_DefaultValue: symbol=Rte_SWC_CMP_PRJ_UDSHandler_SWC_UDSHandler_VIN_DefaultValue
        SWC_PLT_Appl_IoHwAb_ECU_Position_ROMDefault: symbol=Rte_SWC_PLT_Appl_IoHwAb_ECU_Position_ROMDefault
        SWC_PLT_Appl_NvMHandler_Alignment_NvMBlock_DefaultValue: symbol=Rte_SWC_PLT_Appl_NvMHandler_Alignment_NvMBlock_DefaultValue
        SWC_PLT_Appl_NvMHandler_Correctable_Fault_NvM_DefaultValue: symbol=Rte_SWC_PLT_Appl_NvMHandler_Correctable_Fault_NvM_DefaultValue
        SWC_PLT_Appl_NvMHandler_NvMBringUp_DefaultValue: symbol=Rte_SWC_PLT_Appl_NvMHandler_NvMBringUp_DefaultValue
        SWC_PLT_Appl_NvMHandler_RFE_R1R2_Fault_NvM_DefaultValue: symbol=Rte_SWC_PLT_Appl_NvMHandler_RFE_R1R2_Fault_NvM_DefaultValue
        SWC_PLT_Appl_NvMHandler_SWC_Manual_alignment_Execution_DefaultValue: symbol=Rte_SWC_PLT_Appl_NvMHandler_SWC_Manual_alignment_Execution_DefaultValue
        SWC_PLT_Appl_NvMHandler_SWC_PLT_CDD_FailSafe_DefaultValue: symbol=Rte_SWC_PLT_Appl_NvMHandler_SWC_PLT_CDD_FailSafe_DefaultValue
        SWC_PLT_Appl_NvMHandler_SWC_Static_Alignment_Write_Parameters_DefaultValue: symbol=Rte_SWC_PLT_Appl_NvMHandler_SWC_Static_Alignment_Write_Parameters_DefaultValue
        SWC_PLT_Appl_NvMHandler_SWC_VSE_NVM_Params_DefaultValue: symbol=Rte_SWC_PLT_Appl_NvMHandler_SWC_VSE_NVM_Params_DefaultValue
        SWC_PLT_Appl_NvMHandler_SensorPos_NvM_DefaultValue: symbol=Rte_SWC_PLT_Appl_NvMHandler_SensorPos_NvM_DefaultValue
        SWC_PLT_CDD_FailSafe_ExceptionReason_DefaultValue: symbol=Rte_SWC_PLT_CDD_FailSafe_ExceptionReason_DefaultValue
        SWC_PLT_CDD_FailSafe_ResetReason_DefaultValue: symbol=Rte_SWC_PLT_CDD_FailSafe_ResetReason_DefaultValue
        SWC_PLT_Radar_Alignment_Handler_Appl_AutoAlignment_DefaultValue: symbol=Rte_SWC_PLT_Radar_Alignment_Handler_Appl_AutoAlignment_DefaultValue
