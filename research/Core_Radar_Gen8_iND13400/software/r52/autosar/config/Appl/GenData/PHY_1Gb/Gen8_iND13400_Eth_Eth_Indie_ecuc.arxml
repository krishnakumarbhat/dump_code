AUTOSAR XML (schema 00053)
package /ActiveEcuC
  module config Eth_Indie: definition=Eth, implementation-config-variant=VARIANT-PRE-COMPILE, module-description=Eth_Impl
    EthConfigSet
      RADAR_EthConnector1_Controller_bbe781c0 (EthCtrlConfig):
        EthCtrlEnableMii = true
        EthCtrlEnableRxInterrupt = true
        EthCtrlEnableTxInterrupt = true
        EthCtrlIdx = 0
        EthCtrlMacLayerType = ETH_MAC_LAYER_TYPE_XGMII
        EthCtrlRxBufLenByte = 1522
        EthCtrlTxBufLenByte = 1522
        EthRxBufTotal = 16
        EthTxBufTotal = 12
        EthCtrlEnableMacWriteAccess = false
        EthCtrlEnableLoopbackMode = false
        EthCtrlEnablePtp = true
        EthCtrlEnableQoS = false
        EthCtrlEnableTrafficShaping = NO_TRAFFIC_SHAPING
        EthCtrlMiiInterface = ETH_SGMII_MODE
        EthEthSwtMgmtHdrLen = 0
        EthCtrlPreControllerInitCallout = false
        EthCtrlPostControllerInitCallout = false
        EthCfgEthCtrlConfigNumOfDmaChnEnabled = 1
        EthCtrlMacLayerSpeed = ETH_MAC_LAYER_SPEED_100M
        EthCtrlMacLayerSubType = SERIAL
        EthCtrlPhyAddress = 00:1A:A0:22:0E:B0
        EthCtrlMiiHwLoopMaxCycles = 1000000
        EthCtrlTransmitLoopCycles = 1000
        EthCtrlInterPacketGap = 44
        EthCtrlAutoNegotiation = true
        EthCtrlMacSecEnable = false
        EthCtrlMacSecAPIEnable = false
        EthCtrlMacSwResetTimeoutCount = 1000000
        EthCtrlMacSerdesLockTimeoutCount = 1000000
        EthCtrlConfigEgress: EthCtrlConfigEgressLastSchedulerRef=(unset)
          EthCtrlConfigEgressFifo:
            EthCtrlConfigEgressFifoBufLenByte = 1522
            EthCtrlConfigEgressFifoBufTotal = 4
            EthCtrlConfigEgressFifoIdx = 0
            EthCtrlEgressMTLSize = MTL_Q_Size_1536
            EthCtrlConfigEgressFifoPriorityAssignment = {0..2}
          EthCtrlConfigScheduler
            EthCtrlConfigSchedulerPredecessor: EthCtrlConfigSchedulerPredecessorOrder=0, EthCtrlConfigSchedulerPredecessorRef=EthCtrlConfigEgressFifo
          EthCtrlConfigEgressFifo_001 (EthCtrlConfigEgressFifo):
            EthCtrlConfigEgressFifoBufLenByte = 200
            EthCtrlConfigEgressFifoBufTotal = 4
            EthCtrlConfigEgressFifoIdx = 1
            EthCtrlEgressMTLSize = MTL_Q_Size_1536
            EthCtrlConfigEgressFifoPriorityAssignment = {3..5}
          EthCtrlConfigEgressFifo_002 (EthCtrlConfigEgressFifo):
            EthCtrlConfigEgressFifoBufLenByte = 200
            EthCtrlConfigEgressFifoBufTotal = 4
            EthCtrlConfigEgressFifoIdx = 2
            EthCtrlEgressMTLSize = MTL_Q_Size_1024
            EthCtrlConfigEgressFifoPriorityAssignment = 6
            EthCtrlConfigEgressFifoPriorityAssignment = 7
        EthCtrlConfigIngress
          EthCtrlConfigIngressFifo:
            EthCtrlConfigIngressFifoBufLenByte = 1522
            EthCtrlConfigIngressFifoBufTotal = 8
            EthCtrlConfigIngressFifoIdx = 0
            EthCtrlConfigIngressMaxProcessFrame = 5
            EthCtrlIngressMTLSize = MTL_Q_Size_3840
          EthCtrlConfigIngressFifo_001 (EthCtrlConfigIngressFifo):
            EthCtrlConfigIngressFifoBufLenByte = 200
            EthCtrlConfigIngressFifoBufTotal = 8
            EthCtrlConfigIngressFifoIdx = 1
            EthCtrlConfigIngressMaxProcessFrame = 5
            EthCtrlIngressMTLSize = MTL_Q_Size_256
        EthCtrlOffloading:
          EthCtrlEnableOffloadChecksumICMP = true
          EthCtrlEnableOffloadChecksumIPv4 = true
          EthCtrlEnableOffloadChecksumTCP = true
          EthCtrlEnableOffloadChecksumUDP = true
    EthGeneral:
      EthDevErrorDetect = false
      EthGetDropCountApi = false
      EthGetEtherStatsApi = false
      EthGetTxErrorCounterValuesApi = false
      EthGetTxStatsApi = false
      EthGlobalTimeSupport = true
      EthIndex = 0
      EthMainFunctionPeriod = 0.01
      EthVersionInfoApi = true
      EthMaxCtrlsSupported = 1
      EthEnableMibCounter = true
      EthOsIsrCategory = CATEGORY_2
      EthUpdatePhysAddrFilter = true
      EthEnableExplicitBufferMapping = false
      EthRuntimeMeasurementSupport = false
      EthEnableHeaderAccessApi = false
      EthUsePeripheralAccessApi = false
      EthGetRxStatsApi = false
      EthHardwareVariant = ETH_HARDWARE_B0_VARIANT
      EthSupportDem = false
      EthEnableMacSecHwBypass = true
      EthMacSecEnabled = false
      MaCsecVLanMode = MACSEC_VLAN_MODE_NOP
      EthCfgEnableEcc = true
      EthCfgEnableEccInjectionTest = false
      EthCfgEnableFsmOneHot = false
      EthCfgEnableFsmOneHotInjectionTest = false
      EthTrcvConfigRef = EthTrcvConfig_9010BSA
    EthVendor:
      EthDMASpecificMaping = true
      EthDMAChannel0Mode = RX_ONLY
      EthDMAChannel1Mode = TX_ONLY
      EthDMAChannel2Mode = RX_AND_TX
      EthCtrlEnableOffloadChecksumCompensationUDP = false
      EthCtrlEnableOffloadChecksumSWCompensationIPv4 = false
      EthCtrlEnableOffloadChecksumSWCompensationTCP = false
      EthVendorHwCustomOffloading:
        EthCtrlEnableOffloadReplyARP = false
        EthCtrlEnableSAInsertionVLAN = false
        EthCtrlEnableOffloadTimeStampPTP = false
        EthCtrlEnableOffloadRxChecksumMMC = false
