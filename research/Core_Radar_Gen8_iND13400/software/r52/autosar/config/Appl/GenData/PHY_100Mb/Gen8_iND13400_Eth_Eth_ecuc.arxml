AUTOSAR XML (schema 00053)
package /ActiveEcuC
  module config Eth: implementation-config-variant=VARIANT-PRE-COMPILE, module-description=Eth_Impl
    EthConfigSet
      RDR_1_Eth_Controller_1_6addc1bb (EthCtrlConfig):  # EthernetCluster1
        EthCtrlIdx = 0
        EthCtrlPhysAddr = 00:1A:A0:22:0E:B0
        EthCtrlEnableMii = true
        EthCtrlEnableMmd = false
        EthCtrlEnableRxInterrupt = true
        EthCtrlEnableTxInterrupt = true
        EthCtrlRxBufLenByte = 1522
        EthCtrlTxBufLenByte = 1522
        EthRxBufTotal = 2
        EthTxBufTotal = 100
        EthCtrlEnablePtp = true
        EthCtrlEnableTrafficShaping = NO_TRAFFIC_SHAPING
        EthCtrlEnableMacWriteAccess = false
        EthSupport3rdPartyEthDrvArVer = AR_4_4_0
        EthBufferIndexOffset = false
        EthCtrlEnableEgressHardwareSupportedDataTransfer = false
        SubCtrlRef = RADAR_EthConnector1_Controller_bbe781c0
        EthCtrlOffloading:
          EthCtrlEnableOffloadChecksumIPv4 = true
          EthCtrlEnableOffloadChecksumICMP = true
          EthCtrlEnableOffloadChecksumTCP = true
          EthCtrlEnableOffloadChecksumUDP = true
          EthCtrlEnableOffloadChecksumTCPv6 = false
          EthCtrlEnableOffloadChecksumICMPv6 = false
          EthCtrlEnableOffloadChecksumIPv6HeaderRouting = false
          EthCtrlEnableOffloadChecksumIPv6HeaderDestinationOptions = false
          EthCtrlEnableOffloadChecksumIPv6HeaderHopByHopOptions = false
          EthCtrlEnableOffloadChecksumUDPv6 = false
        EthTxBufConfig: EthCtrlTxBufLenByte=1522, EthTxBufTotal=50
        EthAPIConfig:
          Eth_ControllerInit = false
          Eth_SetControllerMode = true
          Eth_GetControllerMode = true
          Eth_GetPhysAddr = true
          Eth_SetPhysAddr = true
          Eth_UpdatePhysAddrFilter = true
          Eth_WriteMii = true
          Eth_ReadMii = true
          Eth_WriteMmd = false
          Eth_ReadMmd = false
          Eth_GetCurrentTime = true
          Eth_EnableEgressTimeStamp = true
          Eth_GetEgressTimeStamp = true
          Eth_GetIngressTimeStamp = true
          Eth_ProvideTxBuffer = true
          Eth_Transmit = true
          Eth_TxConfirmation = true
          Eth_Receive = true
          Eth_ReleaseRxBuffer = false
          Eth_ImmediateTransmit = false
          Eth_GetCurrentTimeTuple = false
          Eth_SetPhcTime = false
          Eth_SetPhcCorrection = false
          Eth_GetPhcTime = false
          Eth_SetPpsSignalMode = false
        EthCtrlConfigIngress
    EthGeneral:
      EthArReleaseRxBufferSupported = true
      EthDevErrorDetect = false
      EthVersionInfoApi = true
      EthEnableMibCounter = true
      EthIndex = 0
      EthMaxCtrlsSupported = 1
      EthUpdatePhysAddrFilter = true
      EthEnableHeaderAccessApi = false
      EthEnableZeroCopyExtensions = false
      EthGetEtherStatsApi = false
      EthEnableExplicitBufferMapping = false
      EthEnableRxInterrupt = true
      EthEnableTxInterrupt = true
      EthSafeBswChecks = true
      EthPhcSupport = false
