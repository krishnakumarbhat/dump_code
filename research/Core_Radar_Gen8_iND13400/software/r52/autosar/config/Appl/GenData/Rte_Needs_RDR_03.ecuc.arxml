[part 5 of 8: package /DaVinci_Project]
AUTOSAR XML (schema 4-0-3)
package /DaVinci_Project  (continued)
  module config Com  (continued)
    ComConfig  (continued)
      239 x ComSignalGroup:  (continued)
        SG_Detections_365_368_oRDR_DETECTION_365_368_oPCAN_RADAR_36ed26c5_Tx
          83 x ComGroupSignal:
            DET_AZIMUTH_365_oRDR_DETECTION_365_368_oPCAN_RADAR_a8c066a0_Tx: ComSignalType=UINT16
            DET_AZIMUTH_366_oRDR_DETECTION_365_368_oPCAN_RADAR_cc201d5e_Tx: ComSignalType=UINT16
            DET_AZIMUTH_367_oRDR_DETECTION_365_368_oPCAN_RADAR_5950c9cb_Tx: ComSignalType=UINT16
            DET_AZIMUTH_368_oRDR_DETECTION_365_368_oPCAN_RADAR_75405b8c_Tx: ComSignalType=UINT16
            DET_AZIMUTH_ERR_365_oRDR_DETECTION_365_368_oPCAN_RADAR_0c75f355_Tx: ComSignalType=UINT8
            DET_AZIMUTH_ERR_366_oRDR_DETECTION_365_368_oPCAN_RADAR_689588ab_Tx: ComSignalType=UINT8
            DET_AZIMUTH_ERR_367_oRDR_DETECTION_365_368_oPCAN_RADAR_fde55c3e_Tx: ComSignalType=UINT8
            DET_AZIMUTH_ERR_368_oRDR_DETECTION_365_368_oPCAN_RADAR_d1f5ce79_Tx: ComSignalType=UINT8
            DET_BELOW_RAIN_THOLD_365_oRDR_DETECTION_365_368_oPCAN_RADAR_7dc1f560_Tx: ComSignalType=UINT8
            DET_BELOW_RAIN_THOLD_366_oRDR_DETECTION_365_368_oPCAN_RADAR_19218e9e_Tx: ComSignalType=UINT8
            DET_BELOW_RAIN_THOLD_367_oRDR_DETECTION_365_368_oPCAN_RADAR_8c515a0b_Tx: ComSignalType=UINT8
            DET_BELOW_RAIN_THOLD_368_oRDR_DETECTION_365_368_oPCAN_RADAR_a041c84c_Tx: ComSignalType=UINT8
            DET_BI_STATIC_FLAG_365_oRDR_DETECTION_365_368_oPCAN_RADAR_feec2625_Tx: ComSignalType=BOOLEAN
            DET_BI_STATIC_FLAG_366_oRDR_DETECTION_365_368_oPCAN_RADAR_9a0c5ddb_Tx: ComSignalType=BOOLEAN
            DET_BI_STATIC_FLAG_367_oRDR_DETECTION_365_368_oPCAN_RADAR_0f7c894e_Tx: ComSignalType=BOOLEAN
            DET_BI_STATIC_FLAG_368_oRDR_DETECTION_365_368_oPCAN_RADAR_236c1b09_Tx: ComSignalType=BOOLEAN
            DET_CONFD_AZIMUTH_365_oRDR_DETECTION_365_368_oPCAN_RADAR_aa266c6a_Tx: ComSignalType=UINT8
            DET_CONFD_AZIMUTH_366_oRDR_DETECTION_365_368_oPCAN_RADAR_cec61794_Tx: ComSignalType=UINT8
            DET_CONFD_AZIMUTH_367_oRDR_DETECTION_365_368_oPCAN_RADAR_5bb6c301_Tx: ComSignalType=UINT8
            DET_CONFD_AZIMUTH_368_oRDR_DETECTION_365_368_oPCAN_RADAR_77a65146_Tx: ComSignalType=UINT8
            DET_CONFD_ELEVATION_365_oRDR_DETECTION_365_368_oPCAN_RADAR_a8b36d90_Tx: ComSignalType=UINT8
            DET_CONFD_ELEVATION_366_oRDR_DETECTION_365_368_oPCAN_RADAR_cc53166e_Tx: ComSignalType=UINT8
            DET_CONFD_ELEVATION_367_oRDR_DETECTION_365_368_oPCAN_RADAR_5923c2fb_Tx: ComSignalType=UINT8
            DET_CONFD_ELEVATION_368_oRDR_DETECTION_365_368_oPCAN_RADAR_753350bc_Tx: ComSignalType=UINT8
            DET_ELEVATION_365_oRDR_DETECTION_365_368_oPCAN_RADAR_7973b9ac_Tx: ComSignalType=UINT8
            DET_ELEVATION_366_oRDR_DETECTION_365_368_oPCAN_RADAR_1d93c252_Tx: ComSignalType=UINT8
            DET_ELEVATION_367_oRDR_DETECTION_365_368_oPCAN_RADAR_88e316c7_Tx: ComSignalType=UINT8
            DET_ELEVATION_368_oRDR_DETECTION_365_368_oPCAN_RADAR_a4f38480_Tx: ComSignalType=UINT8
            DET_ELEVATION_ERR_365_oRDR_DETECTION_365_368_oPCAN_RADAR_fe4a21d9_Tx: ComSignalType=UINT8
            DET_ELEVATION_ERR_366_oRDR_DETECTION_365_368_oPCAN_RADAR_9aaa5a27_Tx: ComSignalType=UINT8
            DET_ELEVATION_ERR_367_oRDR_DETECTION_365_368_oPCAN_RADAR_0fda8eb2_Tx: ComSignalType=UINT8
            DET_ELEVATION_ERR_368_oRDR_DETECTION_365_368_oPCAN_RADAR_23ca1cf5_Tx: ComSignalType=UINT8
            DET_EXISTENCE_PROB_365_oRDR_DETECTION_365_368_oPCAN_RADAR_2cd554b9_Tx: ComSignalType=UINT8
            DET_EXISTENCE_PROB_366_oRDR_DETECTION_365_368_oPCAN_RADAR_48352f47_Tx: ComSignalType=UINT8
            DET_EXISTENCE_PROB_367_oRDR_DETECTION_365_368_oPCAN_RADAR_dd45fbd2_Tx: ComSignalType=UINT8
            DET_EXISTENCE_PROB_368_oRDR_DETECTION_365_368_oPCAN_RADAR_f1556995_Tx: ComSignalType=UINT8
            DET_HVC_FLAG_365_oRDR_DETECTION_365_368_oPCAN_RADAR_cda117c6_Tx: ComSignalType=BOOLEAN
            DET_HVC_FLAG_366_oRDR_DETECTION_365_368_oPCAN_RADAR_a9416c38_Tx: ComSignalType=BOOLEAN
            DET_HVC_FLAG_367_oRDR_DETECTION_365_368_oPCAN_RADAR_3c31b8ad_Tx: ComSignalType=BOOLEAN
            DET_HVC_FLAG_368_oRDR_DETECTION_365_368_oPCAN_RADAR_10212aea_Tx: ComSignalType=BOOLEAN
            DET_IDM_365_oRDR_DETECTION_365_368_oPCAN_RADAR_46f32c7b_Tx: ComSignalType=UINT8
            DET_IDM_366_oRDR_DETECTION_365_368_oPCAN_RADAR_22135785_Tx: ComSignalType=UINT8
            DET_IDM_367_oRDR_DETECTION_365_368_oPCAN_RADAR_b7638310_Tx: ComSignalType=UINT8
            DET_IDM_368_oRDR_DETECTION_365_368_oPCAN_RADAR_9b731157_Tx: ComSignalType=UINT8
            DET_MH_CRC16_365_368_oRDR_DETECTION_365_368_oPCAN_RADAR_b265f4ce_Tx: ComSignalType=UINT16
            DET_MH_CYCLE_COUNTER_365_368_oRDR_DETECTION_365_368_oPCAN_RADAR_361055f9_Tx: ComSignalType=UINT8
            DET_MH_SCAN_INDEX_4LSB_365_368_oRDR_DETECTION_365_368_oPCAN_RADAR_fa3a7075_Tx: ComSignalType=UINT8
            DET_MTD_365_oRDR_DETECTION_365_368_oPCAN_RADAR_20401ea0_Tx: ComSignalType=UINT8
            DET_MTD_366_oRDR_DETECTION_365_368_oPCAN_RADAR_44a0655e_Tx: ComSignalType=UINT8
            DET_MTD_367_oRDR_DETECTION_365_368_oPCAN_RADAR_d1d0b1cb_Tx: ComSignalType=UINT8
            DET_MTD_368_oRDR_DETECTION_365_368_oPCAN_RADAR_fdc0238c_Tx: ComSignalType=UINT8
            DET_PROB_1STAZHYPO_365_oRDR_DETECTION_365_368_oPCAN_RADAR_b3f4f66d_Tx: ComSignalType=BOOLEAN
            DET_PROB_1STAZHYPO_366_oRDR_DETECTION_365_368_oPCAN_RADAR_d7148d93_Tx: ComSignalType=BOOLEAN
            DET_PROB_1STAZHYPO_367_oRDR_DETECTION_365_368_oPCAN_RADAR_42645906_Tx: ComSignalType=BOOLEAN
            DET_PROB_1STAZHYPO_368_oRDR_DETECTION_365_368_oPCAN_RADAR_6e74cb41_Tx: ComSignalType=BOOLEAN
            DET_RANGE_365_oRDR_DETECTION_365_368_oPCAN_RADAR_b85b151b_Tx: ComSignalType=UINT16
            DET_RANGE_366_oRDR_DETECTION_365_368_oPCAN_RADAR_dcbb6ee5_Tx: ComSignalType=UINT16
            DET_RANGE_367_oRDR_DETECTION_365_368_oPCAN_RADAR_49cbba70_Tx: ComSignalType=UINT16
            DET_RANGE_368_oRDR_DETECTION_365_368_oPCAN_RADAR_65db2837_Tx: ComSignalType=UINT16
            DET_RANGE_ERR_365_oRDR_DETECTION_365_368_oPCAN_RADAR_1fb3af72_Tx: ComSignalType=UINT8
            DET_RANGE_ERR_366_oRDR_DETECTION_365_368_oPCAN_RADAR_7b53d48c_Tx: ComSignalType=UINT8
            DET_RANGE_ERR_367_oRDR_DETECTION_365_368_oPCAN_RADAR_ee230019_Tx: ComSignalType=UINT8
            DET_RANGE_ERR_368_oRDR_DETECTION_365_368_oPCAN_RADAR_c233925e_Tx: ComSignalType=UINT8
            DET_RANGE_VELOCITY_365_oRDR_DETECTION_365_368_oPCAN_RADAR_cdfdd73e_Tx: ComSignalType=UINT16
            DET_RANGE_VELOCITY_366_oRDR_DETECTION_365_368_oPCAN_RADAR_a91dacc0_Tx: ComSignalType=UINT16
            DET_RANGE_VELOCITY_367_oRDR_DETECTION_365_368_oPCAN_RADAR_3c6d7855_Tx: ComSignalType=UINT16
            DET_RANGE_VELOCITY_368_oRDR_DETECTION_365_368_oPCAN_RADAR_107dea12_Tx: ComSignalType=UINT16
            DET_RANGE_VELOCITY_ERR_365_oRDR_DETECTION_365_368_oPCAN_RADAR_c2462c8c_Tx: ComSignalType=UINT8
            DET_RANGE_VELOCITY_ERR_366_oRDR_DETECTION_365_368_oPCAN_RADAR_a6a65772_Tx: ComSignalType=UINT8
            DET_RANGE_VELOCITY_ERR_367_oRDR_DETECTION_365_368_oPCAN_RADAR_33d683e7_Tx: ComSignalType=UINT8
            DET_RANGE_VELOCITY_ERR_368_oRDR_DETECTION_365_368_oPCAN_RADAR_1fc611a0_Tx: ComSignalType=UINT8
            DET_RCS_365_oRDR_DETECTION_365_368_oPCAN_RADAR_4a7de064_Tx: ComSignalType=UINT8
            DET_RCS_366_oRDR_DETECTION_365_368_oPCAN_RADAR_2e9d9b9a_Tx: ComSignalType=UINT8
            DET_RCS_367_oRDR_DETECTION_365_368_oPCAN_RADAR_bbed4f0f_Tx: ComSignalType=UINT8
            DET_RCS_368_oRDR_DETECTION_365_368_oPCAN_RADAR_97fddd48_Tx: ComSignalType=UINT8
            DET_SNR_365_oRDR_DETECTION_365_368_oPCAN_RADAR_97d3b466_Tx: ComSignalType=UINT8
            DET_SNR_366_oRDR_DETECTION_365_368_oPCAN_RADAR_f333cf98_Tx: ComSignalType=UINT8
            DET_SNR_367_oRDR_DETECTION_365_368_oPCAN_RADAR_66431b0d_Tx: ComSignalType=UINT8
            DET_SNR_368_oRDR_DETECTION_365_368_oPCAN_RADAR_4a53894a_Tx: ComSignalType=UINT8
            DET_SUPER_RES_TARGET_365_oRDR_DETECTION_365_368_oPCAN_RADAR_a64a9c03_Tx: ComSignalType=BOOLEAN
            DET_SUPER_RES_TARGET_366_oRDR_DETECTION_365_368_oPCAN_RADAR_c2aae7fd_Tx: ComSignalType=BOOLEAN
            DET_SUPER_RES_TARGET_367_oRDR_DETECTION_365_368_oPCAN_RADAR_57da3368_Tx: ComSignalType=BOOLEAN
            DET_SUPER_RES_TARGET_368_oRDR_DETECTION_365_368_oPCAN_RADAR_7bcaa12f_Tx: ComSignalType=BOOLEAN
        SG_Detections_369_372_oRDR_DETECTION_369_372_oPCAN_RADAR_af9702be_Tx
          83 x ComGroupSignal:
            DET_AZIMUTH_369_oRDR_DETECTION_369_372_oPCAN_RADAR_d2786018_Tx: ComSignalType=UINT16
            DET_AZIMUTH_370_oRDR_DETECTION_369_372_oPCAN_RADAR_b75812bc_Tx: ComSignalType=UINT16
            DET_AZIMUTH_371_oRDR_DETECTION_369_372_oPCAN_RADAR_2228c629_Tx: ComSignalType=UINT16
            DET_AZIMUTH_372_oRDR_DETECTION_369_372_oPCAN_RADAR_46c8bdd7_Tx: ComSignalType=UINT16
            DET_AZIMUTH_ERR_369_oRDR_DETECTION_369_372_oPCAN_RADAR_76cdf5ed_Tx: ComSignalType=UINT8
            DET_AZIMUTH_ERR_370_oRDR_DETECTION_369_372_oPCAN_RADAR_13ed8749_Tx: ComSignalType=UINT8
            DET_AZIMUTH_ERR_371_oRDR_DETECTION_369_372_oPCAN_RADAR_869d53dc_Tx: ComSignalType=UINT8
            DET_AZIMUTH_ERR_372_oRDR_DETECTION_369_372_oPCAN_RADAR_e27d2822_Tx: ComSignalType=UINT8
            DET_BELOW_RAIN_THOLD_369_oRDR_DETECTION_369_372_oPCAN_RADAR_0779f3d8_Tx: ComSignalType=UINT8
            DET_BELOW_RAIN_THOLD_370_oRDR_DETECTION_369_372_oPCAN_RADAR_6259817c_Tx: ComSignalType=UINT8
            DET_BELOW_RAIN_THOLD_371_oRDR_DETECTION_369_372_oPCAN_RADAR_f72955e9_Tx: ComSignalType=UINT8
            DET_BELOW_RAIN_THOLD_372_oRDR_DETECTION_369_372_oPCAN_RADAR_93c92e17_Tx: ComSignalType=UINT8
            DET_BI_STATIC_FLAG_369_oRDR_DETECTION_369_372_oPCAN_RADAR_8454209d_Tx: ComSignalType=BOOLEAN
            DET_BI_STATIC_FLAG_370_oRDR_DETECTION_369_372_oPCAN_RADAR_e1745239_Tx: ComSignalType=BOOLEAN
            DET_BI_STATIC_FLAG_371_oRDR_DETECTION_369_372_oPCAN_RADAR_740486ac_Tx: ComSignalType=BOOLEAN
            DET_BI_STATIC_FLAG_372_oRDR_DETECTION_369_372_oPCAN_RADAR_10e4fd52_Tx: ComSignalType=BOOLEAN
            DET_CONFD_AZIMUTH_369_oRDR_DETECTION_369_372_oPCAN_RADAR_d09e6ad2_Tx: ComSignalType=UINT8
            DET_CONFD_AZIMUTH_370_oRDR_DETECTION_369_372_oPCAN_RADAR_b5be1876_Tx: ComSignalType=UINT8
            DET_CONFD_AZIMUTH_371_oRDR_DETECTION_369_372_oPCAN_RADAR_20cecce3_Tx: ComSignalType=UINT8
            DET_CONFD_AZIMUTH_372_oRDR_DETECTION_369_372_oPCAN_RADAR_442eb71d_Tx: ComSignalType=UINT8
            DET_CONFD_ELEVATION_369_oRDR_DETECTION_369_372_oPCAN_RADAR_d20b6b28_Tx: ComSignalType=UINT8
            DET_CONFD_ELEVATION_370_oRDR_DETECTION_369_372_oPCAN_RADAR_b72b198c_Tx: ComSignalType=UINT8
            DET_CONFD_ELEVATION_371_oRDR_DETECTION_369_372_oPCAN_RADAR_225bcd19_Tx: ComSignalType=UINT8
            DET_CONFD_ELEVATION_372_oRDR_DETECTION_369_372_oPCAN_RADAR_46bbb6e7_Tx: ComSignalType=UINT8
            DET_ELEVATION_369_oRDR_DETECTION_369_372_oPCAN_RADAR_03cbbf14_Tx: ComSignalType=UINT8
            DET_ELEVATION_370_oRDR_DETECTION_369_372_oPCAN_RADAR_66ebcdb0_Tx: ComSignalType=UINT8
            DET_ELEVATION_371_oRDR_DETECTION_369_372_oPCAN_RADAR_f39b1925_Tx: ComSignalType=UINT8
            DET_ELEVATION_372_oRDR_DETECTION_369_372_oPCAN_RADAR_977b62db_Tx: ComSignalType=UINT8
            DET_ELEVATION_ERR_369_oRDR_DETECTION_369_372_oPCAN_RADAR_84f22761_Tx: ComSignalType=UINT8
            DET_ELEVATION_ERR_370_oRDR_DETECTION_369_372_oPCAN_RADAR_e1d255c5_Tx: ComSignalType=UINT8
            DET_ELEVATION_ERR_371_oRDR_DETECTION_369_372_oPCAN_RADAR_74a28150_Tx: ComSignalType=UINT8
            DET_ELEVATION_ERR_372_oRDR_DETECTION_369_372_oPCAN_RADAR_1042faae_Tx: ComSignalType=UINT8
            DET_EXISTENCE_PROB_369_oRDR_DETECTION_369_372_oPCAN_RADAR_566d5201_Tx: ComSignalType=UINT8
            DET_EXISTENCE_PROB_370_oRDR_DETECTION_369_372_oPCAN_RADAR_334d20a5_Tx: ComSignalType=UINT8
            DET_EXISTENCE_PROB_371_oRDR_DETECTION_369_372_oPCAN_RADAR_a63df430_Tx: ComSignalType=UINT8
            DET_EXISTENCE_PROB_372_oRDR_DETECTION_369_372_oPCAN_RADAR_c2dd8fce_Tx: ComSignalType=UINT8
            DET_HVC_FLAG_369_oRDR_DETECTION_369_372_oPCAN_RADAR_b719117e_Tx: ComSignalType=BOOLEAN
            DET_HVC_FLAG_370_oRDR_DETECTION_369_372_oPCAN_RADAR_d23963da_Tx: ComSignalType=BOOLEAN
            DET_HVC_FLAG_371_oRDR_DETECTION_369_372_oPCAN_RADAR_4749b74f_Tx: ComSignalType=BOOLEAN
            DET_HVC_FLAG_372_oRDR_DETECTION_369_372_oPCAN_RADAR_23a9ccb1_Tx: ComSignalType=BOOLEAN
            DET_IDM_369_oRDR_DETECTION_369_372_oPCAN_RADAR_3c4b2ac3_Tx: ComSignalType=UINT8
            DET_IDM_370_oRDR_DETECTION_369_372_oPCAN_RADAR_596b5867_Tx: ComSignalType=UINT8
            DET_IDM_371_oRDR_DETECTION_369_372_oPCAN_RADAR_cc1b8cf2_Tx: ComSignalType=UINT8
            DET_IDM_372_oRDR_DETECTION_369_372_oPCAN_RADAR_a8fbf70c_Tx: ComSignalType=UINT8
            DET_MH_CRC16_369_372_oRDR_DETECTION_369_372_oPCAN_RADAR_2b1fd0b5_Tx: ComSignalType=UINT16
            DET_MH_CYCLE_COUNTER_369_372_oRDR_DETECTION_369_372_oPCAN_RADAR_af6a7182_Tx: ComSignalType=UINT8
            DET_MH_SCAN_INDEX_4LSB_369_372_oRDR_DETECTION_369_372_oPCAN_RADAR_6340540e_Tx: ComSignalType=UINT8
            DET_MTD_369_oRDR_DETECTION_369_372_oPCAN_RADAR_5af81818_Tx: ComSignalType=UINT8
            DET_MTD_370_oRDR_DETECTION_369_372_oPCAN_RADAR_3fd86abc_Tx: ComSignalType=UINT8
            DET_MTD_371_oRDR_DETECTION_369_372_oPCAN_RADAR_aaa8be29_Tx: ComSignalType=UINT8
            DET_MTD_372_oRDR_DETECTION_369_372_oPCAN_RADAR_ce48c5d7_Tx: ComSignalType=UINT8
            DET_PROB_1STAZHYPO_369_oRDR_DETECTION_369_372_oPCAN_RADAR_c94cf0d5_Tx: ComSignalType=BOOLEAN
            DET_PROB_1STAZHYPO_370_oRDR_DETECTION_369_372_oPCAN_RADAR_ac6c8271_Tx: ComSignalType=BOOLEAN
            DET_PROB_1STAZHYPO_371_oRDR_DETECTION_369_372_oPCAN_RADAR_391c56e4_Tx: ComSignalType=BOOLEAN
            DET_PROB_1STAZHYPO_372_oRDR_DETECTION_369_372_oPCAN_RADAR_5dfc2d1a_Tx: ComSignalType=BOOLEAN
            DET_RANGE_369_oRDR_DETECTION_369_372_oPCAN_RADAR_c2e313a3_Tx: ComSignalType=UINT16
            DET_RANGE_370_oRDR_DETECTION_369_372_oPCAN_RADAR_a7c36107_Tx: ComSignalType=UINT16
            DET_RANGE_371_oRDR_DETECTION_369_372_oPCAN_RADAR_32b3b592_Tx: ComSignalType=UINT16
            DET_RANGE_372_oRDR_DETECTION_369_372_oPCAN_RADAR_5653ce6c_Tx: ComSignalType=UINT16
            DET_RANGE_ERR_369_oRDR_DETECTION_369_372_oPCAN_RADAR_650ba9ca_Tx: ComSignalType=UINT8
            DET_RANGE_ERR_370_oRDR_DETECTION_369_372_oPCAN_RADAR_002bdb6e_Tx: ComSignalType=UINT8
            DET_RANGE_ERR_371_oRDR_DETECTION_369_372_oPCAN_RADAR_955b0ffb_Tx: ComSignalType=UINT8
            DET_RANGE_ERR_372_oRDR_DETECTION_369_372_oPCAN_RADAR_f1bb7405_Tx: ComSignalType=UINT8
            DET_RANGE_VELOCITY_369_oRDR_DETECTION_369_372_oPCAN_RADAR_b745d186_Tx: ComSignalType=UINT16
            DET_RANGE_VELOCITY_370_oRDR_DETECTION_369_372_oPCAN_RADAR_d265a322_Tx: ComSignalType=UINT16
            DET_RANGE_VELOCITY_371_oRDR_DETECTION_369_372_oPCAN_RADAR_471577b7_Tx: ComSignalType=UINT16
            DET_RANGE_VELOCITY_372_oRDR_DETECTION_369_372_oPCAN_RADAR_23f50c49_Tx: ComSignalType=UINT16
            DET_RANGE_VELOCITY_ERR_369_oRDR_DETECTION_369_372_oPCAN_RADAR_b8fe2a34_Tx: ComSignalType=UINT8
            DET_RANGE_VELOCITY_ERR_370_oRDR_DETECTION_369_372_oPCAN_RADAR_ddde5890_Tx: ComSignalType=UINT8
            DET_RANGE_VELOCITY_ERR_371_oRDR_DETECTION_369_372_oPCAN_RADAR_48ae8c05_Tx: ComSignalType=UINT8
            DET_RANGE_VELOCITY_ERR_372_oRDR_DETECTION_369_372_oPCAN_RADAR_2c4ef7fb_Tx: ComSignalType=UINT8
            DET_RCS_369_oRDR_DETECTION_369_372_oPCAN_RADAR_30c5e6dc_Tx: ComSignalType=UINT8
            DET_RCS_370_oRDR_DETECTION_369_372_oPCAN_RADAR_55e59478_Tx: ComSignalType=UINT8
            DET_RCS_371_oRDR_DETECTION_369_372_oPCAN_RADAR_c09540ed_Tx: ComSignalType=UINT8
            DET_RCS_372_oRDR_DETECTION_369_372_oPCAN_RADAR_a4753b13_Tx: ComSignalType=UINT8
            DET_SNR_369_oRDR_DETECTION_369_372_oPCAN_RADAR_ed6bb2de_Tx: ComSignalType=UINT8
            DET_SNR_370_oRDR_DETECTION_369_372_oPCAN_RADAR_884bc07a_Tx: ComSignalType=UINT8
            DET_SNR_371_oRDR_DETECTION_369_372_oPCAN_RADAR_1d3b14ef_Tx: ComSignalType=UINT8
            DET_SNR_372_oRDR_DETECTION_369_372_oPCAN_RADAR_79db6f11_Tx: ComSignalType=UINT8
            DET_SUPER_RES_TARGET_369_oRDR_DETECTION_369_372_oPCAN_RADAR_dcf29abb_Tx: ComSignalType=BOOLEAN
            DET_SUPER_RES_TARGET_370_oRDR_DETECTION_369_372_oPCAN_RADAR_b9d2e81f_Tx: ComSignalType=BOOLEAN
            DET_SUPER_RES_TARGET_371_oRDR_DETECTION_369_372_oPCAN_RADAR_2ca23c8a_Tx: ComSignalType=BOOLEAN
            DET_SUPER_RES_TARGET_372_oRDR_DETECTION_369_372_oPCAN_RADAR_48424774_Tx: ComSignalType=BOOLEAN
        SG_Detections_373_376_oRDR_DETECTION_373_376_oPCAN_RADAR_9d9c6a96_Tx
          83 x ComGroupSignal:
            DET_AZIMUTH_373_oRDR_DETECTION_373_376_oPCAN_RADAR_ce7f6a6c_Tx: ComSignalType=UINT16
            DET_AZIMUTH_374_oRDR_DETECTION_373_376_oPCAN_RADAR_92cf4905_Tx: ComSignalType=UINT16
            DET_AZIMUTH_375_oRDR_DETECTION_373_376_oPCAN_RADAR_07bf9d90_Tx: ComSignalType=UINT16
            DET_AZIMUTH_376_oRDR_DETECTION_373_376_oPCAN_RADAR_635fe66e_Tx: ComSignalType=UINT16
            DET_AZIMUTH_ERR_373_oRDR_DETECTION_373_376_oPCAN_RADAR_6acaff99_Tx: ComSignalType=UINT8
            DET_AZIMUTH_ERR_374_oRDR_DETECTION_373_376_oPCAN_RADAR_367adcf0_Tx: ComSignalType=UINT8
            DET_AZIMUTH_ERR_375_oRDR_DETECTION_373_376_oPCAN_RADAR_a30a0865_Tx: ComSignalType=UINT8
            DET_AZIMUTH_ERR_376_oRDR_DETECTION_373_376_oPCAN_RADAR_c7ea739b_Tx: ComSignalType=UINT8
            DET_BELOW_RAIN_THOLD_373_oRDR_DETECTION_373_376_oPCAN_RADAR_1b7ef9ac_Tx: ComSignalType=UINT8
            DET_BELOW_RAIN_THOLD_374_oRDR_DETECTION_373_376_oPCAN_RADAR_47cedac5_Tx: ComSignalType=UINT8
            DET_BELOW_RAIN_THOLD_375_oRDR_DETECTION_373_376_oPCAN_RADAR_d2be0e50_Tx: ComSignalType=UINT8
            DET_BELOW_RAIN_THOLD_376_oRDR_DETECTION_373_376_oPCAN_RADAR_b65e75ae_Tx: ComSignalType=UINT8
            DET_BI_STATIC_FLAG_373_oRDR_DETECTION_373_376_oPCAN_RADAR_98532ae9_Tx: ComSignalType=BOOLEAN
            DET_BI_STATIC_FLAG_374_oRDR_DETECTION_373_376_oPCAN_RADAR_c4e30980_Tx: ComSignalType=BOOLEAN
            DET_BI_STATIC_FLAG_375_oRDR_DETECTION_373_376_oPCAN_RADAR_5193dd15_Tx: ComSignalType=BOOLEAN
            DET_BI_STATIC_FLAG_376_oRDR_DETECTION_373_376_oPCAN_RADAR_3573a6eb_Tx: ComSignalType=BOOLEAN
            DET_CONFD_AZIMUTH_373_oRDR_DETECTION_373_376_oPCAN_RADAR_cc9960a6_Tx: ComSignalType=UINT8
            DET_CONFD_AZIMUTH_374_oRDR_DETECTION_373_376_oPCAN_RADAR_902943cf_Tx: ComSignalType=UINT8
            DET_CONFD_AZIMUTH_375_oRDR_DETECTION_373_376_oPCAN_RADAR_0559975a_Tx: ComSignalType=UINT8
            DET_CONFD_AZIMUTH_376_oRDR_DETECTION_373_376_oPCAN_RADAR_61b9eca4_Tx: ComSignalType=UINT8
            DET_CONFD_ELEVATION_373_oRDR_DETECTION_373_376_oPCAN_RADAR_ce0c615c_Tx: ComSignalType=UINT8
            DET_CONFD_ELEVATION_374_oRDR_DETECTION_373_376_oPCAN_RADAR_92bc4235_Tx: ComSignalType=UINT8
            DET_CONFD_ELEVATION_375_oRDR_DETECTION_373_376_oPCAN_RADAR_07cc96a0_Tx: ComSignalType=UINT8
            DET_CONFD_ELEVATION_376_oRDR_DETECTION_373_376_oPCAN_RADAR_632ced5e_Tx: ComSignalType=UINT8
            DET_ELEVATION_373_oRDR_DETECTION_373_376_oPCAN_RADAR_1fccb560_Tx: ComSignalType=UINT8
            DET_ELEVATION_374_oRDR_DETECTION_373_376_oPCAN_RADAR_437c9609_Tx: ComSignalType=UINT8
            DET_ELEVATION_375_oRDR_DETECTION_373_376_oPCAN_RADAR_d60c429c_Tx: ComSignalType=UINT8
            DET_ELEVATION_376_oRDR_DETECTION_373_376_oPCAN_RADAR_b2ec3962_Tx: ComSignalType=UINT8
            DET_ELEVATION_ERR_373_oRDR_DETECTION_373_376_oPCAN_RADAR_98f52d15_Tx: ComSignalType=UINT8
            DET_ELEVATION_ERR_374_oRDR_DETECTION_373_376_oPCAN_RADAR_c4450e7c_Tx: ComSignalType=UINT8
            DET_ELEVATION_ERR_375_oRDR_DETECTION_373_376_oPCAN_RADAR_5135dae9_Tx: ComSignalType=UINT8
            DET_ELEVATION_ERR_376_oRDR_DETECTION_373_376_oPCAN_RADAR_35d5a117_Tx: ComSignalType=UINT8
            DET_EXISTENCE_PROB_373_oRDR_DETECTION_373_376_oPCAN_RADAR_4a6a5875_Tx: ComSignalType=UINT8
            DET_EXISTENCE_PROB_374_oRDR_DETECTION_373_376_oPCAN_RADAR_16da7b1c_Tx: ComSignalType=UINT8
            DET_EXISTENCE_PROB_375_oRDR_DETECTION_373_376_oPCAN_RADAR_83aaaf89_Tx: ComSignalType=UINT8
            DET_EXISTENCE_PROB_376_oRDR_DETECTION_373_376_oPCAN_RADAR_e74ad477_Tx: ComSignalType=UINT8
            DET_HVC_FLAG_373_oRDR_DETECTION_373_376_oPCAN_RADAR_ab1e1b0a_Tx: ComSignalType=BOOLEAN
            DET_HVC_FLAG_374_oRDR_DETECTION_373_376_oPCAN_RADAR_f7ae3863_Tx: ComSignalType=BOOLEAN
            DET_HVC_FLAG_375_oRDR_DETECTION_373_376_oPCAN_RADAR_62deecf6_Tx: ComSignalType=BOOLEAN
            DET_HVC_FLAG_376_oRDR_DETECTION_373_376_oPCAN_RADAR_063e9708_Tx: ComSignalType=BOOLEAN
            DET_IDM_373_oRDR_DETECTION_373_376_oPCAN_RADAR_204c20b7_Tx: ComSignalType=UINT8
            DET_IDM_374_oRDR_DETECTION_373_376_oPCAN_RADAR_7cfc03de_Tx: ComSignalType=UINT8
            DET_IDM_375_oRDR_DETECTION_373_376_oPCAN_RADAR_e98cd74b_Tx: ComSignalType=UINT8
            DET_IDM_376_oRDR_DETECTION_373_376_oPCAN_RADAR_8d6cacb5_Tx: ComSignalType=UINT8
            DET_MH_CRC16_373_376_oRDR_DETECTION_373_376_oPCAN_RADAR_1914b89d_Tx: ComSignalType=UINT16
            DET_MH_CYCLE_COUNTER_373_376_oRDR_DETECTION_373_376_oPCAN_RADAR_9d6119aa_Tx: ComSignalType=UINT8
            DET_MH_SCAN_INDEX_4LSB_373_376_oRDR_DETECTION_373_376_oPCAN_RADAR_514b3c26_Tx: ComSignalType=UINT8
            DET_MTD_373_oRDR_DETECTION_373_376_oPCAN_RADAR_46ff126c_Tx: ComSignalType=UINT8
            DET_MTD_374_oRDR_DETECTION_373_376_oPCAN_RADAR_1a4f3105_Tx: ComSignalType=UINT8
            DET_MTD_375_oRDR_DETECTION_373_376_oPCAN_RADAR_8f3fe590_Tx: ComSignalType=UINT8
            DET_MTD_376_oRDR_DETECTION_373_376_oPCAN_RADAR_ebdf9e6e_Tx: ComSignalType=UINT8
            DET_PROB_1STAZHYPO_373_oRDR_DETECTION_373_376_oPCAN_RADAR_d54bfaa1_Tx: ComSignalType=BOOLEAN
            DET_PROB_1STAZHYPO_374_oRDR_DETECTION_373_376_oPCAN_RADAR_89fbd9c8_Tx: ComSignalType=BOOLEAN
            DET_PROB_1STAZHYPO_375_oRDR_DETECTION_373_376_oPCAN_RADAR_1c8b0d5d_Tx: ComSignalType=BOOLEAN
            DET_PROB_1STAZHYPO_376_oRDR_DETECTION_373_376_oPCAN_RADAR_786b76a3_Tx: ComSignalType=BOOLEAN
            DET_RANGE_373_oRDR_DETECTION_373_376_oPCAN_RADAR_dee419d7_Tx: ComSignalType=UINT16
            DET_RANGE_374_oRDR_DETECTION_373_376_oPCAN_RADAR_82543abe_Tx: ComSignalType=UINT16
            DET_RANGE_375_oRDR_DETECTION_373_376_oPCAN_RADAR_1724ee2b_Tx: ComSignalType=UINT16
            DET_RANGE_376_oRDR_DETECTION_373_376_oPCAN_RADAR_73c495d5_Tx: ComSignalType=UINT16
            DET_RANGE_ERR_373_oRDR_DETECTION_373_376_oPCAN_RADAR_790ca3be_Tx: ComSignalType=UINT8
            DET_RANGE_ERR_374_oRDR_DETECTION_373_376_oPCAN_RADAR_25bc80d7_Tx: ComSignalType=UINT8
            DET_RANGE_ERR_375_oRDR_DETECTION_373_376_oPCAN_RADAR_b0cc5442_Tx: ComSignalType=UINT8
            DET_RANGE_ERR_376_oRDR_DETECTION_373_376_oPCAN_RADAR_d42c2fbc_Tx: ComSignalType=UINT8
            DET_RANGE_VELOCITY_373_oRDR_DETECTION_373_376_oPCAN_RADAR_ab42dbf2_Tx: ComSignalType=UINT16
            DET_RANGE_VELOCITY_374_oRDR_DETECTION_373_376_oPCAN_RADAR_f7f2f89b_Tx: ComSignalType=UINT16
            DET_RANGE_VELOCITY_375_oRDR_DETECTION_373_376_oPCAN_RADAR_62822c0e_Tx: ComSignalType=UINT16
            DET_RANGE_VELOCITY_376_oRDR_DETECTION_373_376_oPCAN_RADAR_066257f0_Tx: ComSignalType=UINT16
            DET_RANGE_VELOCITY_ERR_373_oRDR_DETECTION_373_376_oPCAN_RADAR_a4f92040_Tx: ComSignalType=UINT8
            DET_RANGE_VELOCITY_ERR_374_oRDR_DETECTION_373_376_oPCAN_RADAR_f8490329_Tx: ComSignalType=UINT8
            DET_RANGE_VELOCITY_ERR_375_oRDR_DETECTION_373_376_oPCAN_RADAR_6d39d7bc_Tx: ComSignalType=UINT8
            DET_RANGE_VELOCITY_ERR_376_oRDR_DETECTION_373_376_oPCAN_RADAR_09d9ac42_Tx: ComSignalType=UINT8
            DET_RCS_373_oRDR_DETECTION_373_376_oPCAN_RADAR_2cc2eca8_Tx: ComSignalType=UINT8
            DET_RCS_374_oRDR_DETECTION_373_376_oPCAN_RADAR_7072cfc1_Tx: ComSignalType=UINT8
            DET_RCS_375_oRDR_DETECTION_373_376_oPCAN_RADAR_e5021b54_Tx: ComSignalType=UINT8
            DET_RCS_376_oRDR_DETECTION_373_376_oPCAN_RADAR_81e260aa_Tx: ComSignalType=UINT8
            DET_SNR_373_oRDR_DETECTION_373_376_oPCAN_RADAR_f16cb8aa_Tx: ComSignalType=UINT8
            DET_SNR_374_oRDR_DETECTION_373_376_oPCAN_RADAR_addc9bc3_Tx: ComSignalType=UINT8
            DET_SNR_375_oRDR_DETECTION_373_376_oPCAN_RADAR_38ac4f56_Tx: ComSignalType=UINT8
            DET_SNR_376_oRDR_DETECTION_373_376_oPCAN_RADAR_5c4c34a8_Tx: ComSignalType=UINT8
            DET_SUPER_RES_TARGET_373_oRDR_DETECTION_373_376_oPCAN_RADAR_c0f590cf_Tx: ComSignalType=BOOLEAN
            DET_SUPER_RES_TARGET_374_oRDR_DETECTION_373_376_oPCAN_RADAR_9c45b3a6_Tx: ComSignalType=BOOLEAN
            DET_SUPER_RES_TARGET_375_oRDR_DETECTION_373_376_oPCAN_RADAR_09356733_Tx: ComSignalType=BOOLEAN
            DET_SUPER_RES_TARGET_376_oRDR_DETECTION_373_376_oPCAN_RADAR_6dd51ccd_Tx: ComSignalType=BOOLEAN
        SG_Detections_377_380_oRDR_DETECTION_377_380_oPCAN_RADAR_e93056f0_Tx
          83 x ComGroupSignal:
            DET_AZIMUTH_377_oRDR_DETECTION_377_380_oPCAN_RADAR_73567e1f_Tx: ComSignalType=UINT16
            DET_AZIMUTH_378_oRDR_DETECTION_377_380_oPCAN_RADAR_5f46ec58_Tx: ComSignalType=UINT16
            DET_AZIMUTH_379_oRDR_DETECTION_377_380_oPCAN_RADAR_ca3638cd_Tx: ComSignalType=UINT16
            DET_AZIMUTH_380_oRDR_DETECTION_377_380_oPCAN_RADAR_c77299d7_Tx: ComSignalType=UINT16
            DET_AZIMUTH_ERR_377_oRDR_DETECTION_377_380_oPCAN_RADAR_d7e3ebea_Tx: ComSignalType=UINT8
            DET_AZIMUTH_ERR_378_oRDR_DETECTION_377_380_oPCAN_RADAR_fbf379ad_Tx: ComSignalType=UINT8
            DET_AZIMUTH_ERR_379_oRDR_DETECTION_377_380_oPCAN_RADAR_6e83ad38_Tx: ComSignalType=UINT8
            DET_AZIMUTH_ERR_380_oRDR_DETECTION_377_380_oPCAN_RADAR_63c70c22_Tx: ComSignalType=UINT8
            DET_BELOW_RAIN_THOLD_377_oRDR_DETECTION_377_380_oPCAN_RADAR_a657eddf_Tx: ComSignalType=UINT8
            DET_BELOW_RAIN_THOLD_378_oRDR_DETECTION_377_380_oPCAN_RADAR_8a477f98_Tx: ComSignalType=UINT8
            DET_BELOW_RAIN_THOLD_379_oRDR_DETECTION_377_380_oPCAN_RADAR_1f37ab0d_Tx: ComSignalType=UINT8
            DET_BELOW_RAIN_THOLD_380_oRDR_DETECTION_377_380_oPCAN_RADAR_12730a17_Tx: ComSignalType=UINT8
            DET_BI_STATIC_FLAG_377_oRDR_DETECTION_377_380_oPCAN_RADAR_257a3e9a_Tx: ComSignalType=BOOLEAN
            DET_BI_STATIC_FLAG_378_oRDR_DETECTION_377_380_oPCAN_RADAR_096aacdd_Tx: ComSignalType=BOOLEAN
            DET_BI_STATIC_FLAG_379_oRDR_DETECTION_377_380_oPCAN_RADAR_9c1a7848_Tx: ComSignalType=BOOLEAN
            DET_BI_STATIC_FLAG_380_oRDR_DETECTION_377_380_oPCAN_RADAR_915ed952_Tx: ComSignalType=BOOLEAN
            DET_CONFD_AZIMUTH_377_oRDR_DETECTION_377_380_oPCAN_RADAR_71b074d5_Tx: ComSignalType=UINT8
            DET_CONFD_AZIMUTH_378_oRDR_DETECTION_377_380_oPCAN_RADAR_5da0e692_Tx: ComSignalType=UINT8
            DET_CONFD_AZIMUTH_379_oRDR_DETECTION_377_380_oPCAN_RADAR_c8d03207_Tx: ComSignalType=UINT8
            DET_CONFD_AZIMUTH_380_oRDR_DETECTION_377_380_oPCAN_RADAR_c594931d_Tx: ComSignalType=UINT8
            DET_CONFD_ELEVATION_377_oRDR_DETECTION_377_380_oPCAN_RADAR_7325752f_Tx: ComSignalType=UINT8
            DET_CONFD_ELEVATION_378_oRDR_DETECTION_377_380_oPCAN_RADAR_5f35e768_Tx: ComSignalType=UINT8
            DET_CONFD_ELEVATION_379_oRDR_DETECTION_377_380_oPCAN_RADAR_ca4533fd_Tx: ComSignalType=UINT8
            DET_CONFD_ELEVATION_380_oRDR_DETECTION_377_380_oPCAN_RADAR_c70192e7_Tx: ComSignalType=UINT8
            DET_ELEVATION_377_oRDR_DETECTION_377_380_oPCAN_RADAR_a2e5a113_Tx: ComSignalType=UINT8
            DET_ELEVATION_378_oRDR_DETECTION_377_380_oPCAN_RADAR_8ef53354_Tx: ComSignalType=UINT8
            DET_ELEVATION_379_oRDR_DETECTION_377_380_oPCAN_RADAR_1b85e7c1_Tx: ComSignalType=UINT8
            DET_ELEVATION_380_oRDR_DETECTION_377_380_oPCAN_RADAR_16c146db_Tx: ComSignalType=UINT8
            DET_ELEVATION_ERR_377_oRDR_DETECTION_377_380_oPCAN_RADAR_25dc3966_Tx: ComSignalType=UINT8
            DET_ELEVATION_ERR_378_oRDR_DETECTION_377_380_oPCAN_RADAR_09ccab21_Tx: ComSignalType=UINT8
            DET_ELEVATION_ERR_379_oRDR_DETECTION_377_380_oPCAN_RADAR_9cbc7fb4_Tx: ComSignalType=UINT8
            DET_ELEVATION_ERR_380_oRDR_DETECTION_377_380_oPCAN_RADAR_91f8deae_Tx: ComSignalType=UINT8
            DET_EXISTENCE_PROB_377_oRDR_DETECTION_377_380_oPCAN_RADAR_f7434c06_Tx: ComSignalType=UINT8
            DET_EXISTENCE_PROB_378_oRDR_DETECTION_377_380_oPCAN_RADAR_db53de41_Tx: ComSignalType=UINT8
            DET_EXISTENCE_PROB_379_oRDR_DETECTION_377_380_oPCAN_RADAR_4e230ad4_Tx: ComSignalType=UINT8
            DET_EXISTENCE_PROB_380_oRDR_DETECTION_377_380_oPCAN_RADAR_4367abce_Tx: ComSignalType=UINT8
            DET_HVC_FLAG_377_oRDR_DETECTION_377_380_oPCAN_RADAR_16370f79_Tx: ComSignalType=BOOLEAN
            DET_HVC_FLAG_378_oRDR_DETECTION_377_380_oPCAN_RADAR_3a279d3e_Tx: ComSignalType=BOOLEAN
            DET_HVC_FLAG_379_oRDR_DETECTION_377_380_oPCAN_RADAR_af5749ab_Tx: ComSignalType=BOOLEAN
            DET_HVC_FLAG_380_oRDR_DETECTION_377_380_oPCAN_RADAR_a213e8b1_Tx: ComSignalType=BOOLEAN
            DET_IDM_377_oRDR_DETECTION_377_380_oPCAN_RADAR_9d6534c4_Tx: ComSignalType=UINT8
            DET_IDM_378_oRDR_DETECTION_377_380_oPCAN_RADAR_b175a683_Tx: ComSignalType=UINT8
            DET_IDM_379_oRDR_DETECTION_377_380_oPCAN_RADAR_24057216_Tx: ComSignalType=UINT8
            DET_IDM_380_oRDR_DETECTION_377_380_oPCAN_RADAR_2941d30c_Tx: ComSignalType=UINT8
            DET_MH_CRC16_377_380_oRDR_DETECTION_377_380_oPCAN_RADAR_6db884fb_Tx: ComSignalType=UINT16
            DET_MH_CYCLE_COUNTER_377_380_oRDR_DETECTION_377_380_oPCAN_RADAR_e9cd25cc_Tx: ComSignalType=UINT8
            DET_MH_SCAN_INDEX_4LSB_377_380_oRDR_DETECTION_377_380_oPCAN_RADAR_25e70040_Tx: ComSignalType=UINT8
            DET_MTD_377_oRDR_DETECTION_377_380_oPCAN_RADAR_fbd6061f_Tx: ComSignalType=UINT8
            DET_MTD_378_oRDR_DETECTION_377_380_oPCAN_RADAR_d7c69458_Tx: ComSignalType=UINT8
            DET_MTD_379_oRDR_DETECTION_377_380_oPCAN_RADAR_42b640cd_Tx: ComSignalType=UINT8
            DET_MTD_380_oRDR_DETECTION_377_380_oPCAN_RADAR_4ff2e1d7_Tx: ComSignalType=UINT8
            DET_PROB_1STAZHYPO_377_oRDR_DETECTION_377_380_oPCAN_RADAR_6862eed2_Tx: ComSignalType=BOOLEAN
            DET_PROB_1STAZHYPO_378_oRDR_DETECTION_377_380_oPCAN_RADAR_44727c95_Tx: ComSignalType=BOOLEAN
            DET_PROB_1STAZHYPO_379_oRDR_DETECTION_377_380_oPCAN_RADAR_d102a800_Tx: ComSignalType=BOOLEAN
            DET_PROB_1STAZHYPO_380_oRDR_DETECTION_377_380_oPCAN_RADAR_dc46091a_Tx: ComSignalType=BOOLEAN
            DET_RANGE_377_oRDR_DETECTION_377_380_oPCAN_RADAR_63cd0da4_Tx: ComSignalType=UINT16
            DET_RANGE_378_oRDR_DETECTION_377_380_oPCAN_RADAR_4fdd9fe3_Tx: ComSignalType=UINT16
            DET_RANGE_379_oRDR_DETECTION_377_380_oPCAN_RADAR_daad4b76_Tx: ComSignalType=UINT16
            DET_RANGE_380_oRDR_DETECTION_377_380_oPCAN_RADAR_d7e9ea6c_Tx: ComSignalType=UINT16
            DET_RANGE_ERR_377_oRDR_DETECTION_377_380_oPCAN_RADAR_c425b7cd_Tx: ComSignalType=UINT8
            DET_RANGE_ERR_378_oRDR_DETECTION_377_380_oPCAN_RADAR_e835258a_Tx: ComSignalType=UINT8
            DET_RANGE_ERR_379_oRDR_DETECTION_377_380_oPCAN_RADAR_7d45f11f_Tx: ComSignalType=UINT8
            DET_RANGE_ERR_380_oRDR_DETECTION_377_380_oPCAN_RADAR_70015005_Tx: ComSignalType=UINT8
            DET_RANGE_VELOCITY_377_oRDR_DETECTION_377_380_oPCAN_RADAR_166bcf81_Tx: ComSignalType=UINT16
            DET_RANGE_VELOCITY_378_oRDR_DETECTION_377_380_oPCAN_RADAR_3a7b5dc6_Tx: ComSignalType=UINT16
            DET_RANGE_VELOCITY_379_oRDR_DETECTION_377_380_oPCAN_RADAR_af0b8953_Tx: ComSignalType=UINT16
            DET_RANGE_VELOCITY_380_oRDR_DETECTION_377_380_oPCAN_RADAR_a24f2849_Tx: ComSignalType=UINT16
            DET_RANGE_VELOCITY_ERR_377_oRDR_DETECTION_377_380_oPCAN_RADAR_19d03433_Tx: ComSignalType=UINT8
            DET_RANGE_VELOCITY_ERR_378_oRDR_DETECTION_377_380_oPCAN_RADAR_35c0a674_Tx: ComSignalType=UINT8
            DET_RANGE_VELOCITY_ERR_379_oRDR_DETECTION_377_380_oPCAN_RADAR_a0b072e1_Tx: ComSignalType=UINT8
            DET_RANGE_VELOCITY_ERR_380_oRDR_DETECTION_377_380_oPCAN_RADAR_adf4d3fb_Tx: ComSignalType=UINT8
            DET_RCS_377_oRDR_DETECTION_377_380_oPCAN_RADAR_91ebf8db_Tx: ComSignalType=UINT8
            DET_RCS_378_oRDR_DETECTION_377_380_oPCAN_RADAR_bdfb6a9c_Tx: ComSignalType=UINT8
            DET_RCS_379_oRDR_DETECTION_377_380_oPCAN_RADAR_288bbe09_Tx: ComSignalType=UINT8
            DET_RCS_380_oRDR_DETECTION_377_380_oPCAN_RADAR_25cf1f13_Tx: ComSignalType=UINT8
            DET_SNR_377_oRDR_DETECTION_377_380_oPCAN_RADAR_4c45acd9_Tx: ComSignalType=UINT8
            DET_SNR_378_oRDR_DETECTION_377_380_oPCAN_RADAR_60553e9e_Tx: ComSignalType=UINT8
            DET_SNR_379_oRDR_DETECTION_377_380_oPCAN_RADAR_f525ea0b_Tx: ComSignalType=UINT8
            DET_SNR_380_oRDR_DETECTION_377_380_oPCAN_RADAR_f8614b11_Tx: ComSignalType=UINT8
            DET_SUPER_RES_TARGET_377_oRDR_DETECTION_377_380_oPCAN_RADAR_7ddc84bc_Tx: ComSignalType=BOOLEAN
            DET_SUPER_RES_TARGET_378_oRDR_DETECTION_377_380_oPCAN_RADAR_51cc16fb_Tx: ComSignalType=BOOLEAN
            DET_SUPER_RES_TARGET_379_oRDR_DETECTION_377_380_oPCAN_RADAR_c4bcc26e_Tx: ComSignalType=BOOLEAN
            DET_SUPER_RES_TARGET_380_oRDR_DETECTION_377_380_oPCAN_RADAR_c9f86374_Tx: ComSignalType=BOOLEAN
        SG_Detections_381_384_oRDR_DETECTION_381_384_oPCAN_RADAR_cd667329_Tx
          83 x ComGroupSignal:
            DET_AZIMUTH_381_oRDR_DETECTION_381_384_oPCAN_RADAR_c3f034b4_Tx: ComSignalType=UINT16
            DET_AZIMUTH_382_oRDR_DETECTION_381_384_oPCAN_RADAR_a7104f4a_Tx: ComSignalType=UINT16
            DET_AZIMUTH_383_oRDR_DETECTION_381_384_oPCAN_RADAR_32609bdf_Tx: ComSignalType=UINT16
            DET_AZIMUTH_384_oRDR_DETECTION_381_384_oPCAN_RADAR_6ed0b8b6_Tx: ComSignalType=UINT16
            DET_AZIMUTH_ERR_381_oRDR_DETECTION_381_384_oPCAN_RADAR_6745a141_Tx: ComSignalType=UINT8
            DET_AZIMUTH_ERR_382_oRDR_DETECTION_381_384_oPCAN_RADAR_03a5dabf_Tx: ComSignalType=UINT8
            DET_AZIMUTH_ERR_383_oRDR_DETECTION_381_384_oPCAN_RADAR_96d50e2a_Tx: ComSignalType=UINT8
            DET_AZIMUTH_ERR_384_oRDR_DETECTION_381_384_oPCAN_RADAR_ca652d43_Tx: ComSignalType=UINT8
            DET_BELOW_RAIN_THOLD_381_oRDR_DETECTION_381_384_oPCAN_RADAR_16f1a774_Tx: ComSignalType=UINT8
            DET_BELOW_RAIN_THOLD_382_oRDR_DETECTION_381_384_oPCAN_RADAR_7211dc8a_Tx: ComSignalType=UINT8
            DET_BELOW_RAIN_THOLD_383_oRDR_DETECTION_381_384_oPCAN_RADAR_e761081f_Tx: ComSignalType=UINT8
            DET_BELOW_RAIN_THOLD_384_oRDR_DETECTION_381_384_oPCAN_RADAR_bbd12b76_Tx: ComSignalType=UINT8
            DET_BI_STATIC_FLAG_381_oRDR_DETECTION_381_384_oPCAN_RADAR_95dc7431_Tx: ComSignalType=BOOLEAN
            DET_BI_STATIC_FLAG_382_oRDR_DETECTION_381_384_oPCAN_RADAR_f13c0fcf_Tx: ComSignalType=BOOLEAN
            DET_BI_STATIC_FLAG_383_oRDR_DETECTION_381_384_oPCAN_RADAR_644cdb5a_Tx: ComSignalType=BOOLEAN
            DET_BI_STATIC_FLAG_384_oRDR_DETECTION_381_384_oPCAN_RADAR_38fcf833_Tx: ComSignalType=BOOLEAN
            DET_CONFD_AZIMUTH_381_oRDR_DETECTION_381_384_oPCAN_RADAR_c1163e7e_Tx: ComSignalType=UINT8
            DET_CONFD_AZIMUTH_382_oRDR_DETECTION_381_384_oPCAN_RADAR_a5f64580_Tx: ComSignalType=UINT8
            DET_CONFD_AZIMUTH_383_oRDR_DETECTION_381_384_oPCAN_RADAR_30869115_Tx: ComSignalType=UINT8
            DET_CONFD_AZIMUTH_384_oRDR_DETECTION_381_384_oPCAN_RADAR_6c36b27c_Tx: ComSignalType=UINT8
            DET_CONFD_ELEVATION_381_oRDR_DETECTION_381_384_oPCAN_RADAR_c3833f84_Tx: ComSignalType=UINT8
            DET_CONFD_ELEVATION_382_oRDR_DETECTION_381_384_oPCAN_RADAR_a763447a_Tx: ComSignalType=UINT8
            DET_CONFD_ELEVATION_383_oRDR_DETECTION_381_384_oPCAN_RADAR_321390ef_Tx: ComSignalType=UINT8
            DET_CONFD_ELEVATION_384_oRDR_DETECTION_381_384_oPCAN_RADAR_6ea3b386_Tx: ComSignalType=UINT8
            DET_ELEVATION_381_oRDR_DETECTION_381_384_oPCAN_RADAR_1243ebb8_Tx: ComSignalType=UINT8
            DET_ELEVATION_382_oRDR_DETECTION_381_384_oPCAN_RADAR_76a39046_Tx: ComSignalType=UINT8
            DET_ELEVATION_383_oRDR_DETECTION_381_384_oPCAN_RADAR_e3d344d3_Tx: ComSignalType=UINT8
            DET_ELEVATION_384_oRDR_DETECTION_381_384_oPCAN_RADAR_bf6367ba_Tx: ComSignalType=UINT8
            DET_ELEVATION_ERR_381_oRDR_DETECTION_381_384_oPCAN_RADAR_957a73cd_Tx: ComSignalType=UINT8
            DET_ELEVATION_ERR_382_oRDR_DETECTION_381_384_oPCAN_RADAR_f19a0833_Tx: ComSignalType=UINT8
            DET_ELEVATION_ERR_383_oRDR_DETECTION_381_384_oPCAN_RADAR_64eadca6_Tx: ComSignalType=UINT8
            DET_ELEVATION_ERR_384_oRDR_DETECTION_381_384_oPCAN_RADAR_385affcf_Tx: ComSignalType=UINT8
            DET_EXISTENCE_PROB_381_oRDR_DETECTION_381_384_oPCAN_RADAR_47e506ad_Tx: ComSignalType=UINT8
            DET_EXISTENCE_PROB_382_oRDR_DETECTION_381_384_oPCAN_RADAR_23057d53_Tx: ComSignalType=UINT8
            DET_EXISTENCE_PROB_383_oRDR_DETECTION_381_384_oPCAN_RADAR_b675a9c6_Tx: ComSignalType=UINT8
            DET_EXISTENCE_PROB_384_oRDR_DETECTION_381_384_oPCAN_RADAR_eac58aaf_Tx: ComSignalType=UINT8
            DET_HVC_FLAG_381_oRDR_DETECTION_381_384_oPCAN_RADAR_a69145d2_Tx: ComSignalType=BOOLEAN
            DET_HVC_FLAG_382_oRDR_DETECTION_381_384_oPCAN_RADAR_c2713e2c_Tx: ComSignalType=BOOLEAN
            DET_HVC_FLAG_383_oRDR_DETECTION_381_384_oPCAN_RADAR_5701eab9_Tx: ComSignalType=BOOLEAN
            DET_HVC_FLAG_384_oRDR_DETECTION_381_384_oPCAN_RADAR_0bb1c9d0_Tx: ComSignalType=BOOLEAN
            DET_IDM_381_oRDR_DETECTION_381_384_oPCAN_RADAR_2dc37e6f_Tx: ComSignalType=UINT8
            DET_IDM_382_oRDR_DETECTION_381_384_oPCAN_RADAR_49230591_Tx: ComSignalType=UINT8
            DET_IDM_383_oRDR_DETECTION_381_384_oPCAN_RADAR_dc53d104_Tx: ComSignalType=UINT8
            DET_IDM_384_oRDR_DETECTION_381_384_oPCAN_RADAR_80e3f26d_Tx: ComSignalType=UINT8
            DET_MH_CRC16_381_384_oRDR_DETECTION_381_384_oPCAN_RADAR_49eea122_Tx: ComSignalType=UINT16
            DET_MH_CYCLE_COUNTER_381_384_oRDR_DETECTION_381_384_oPCAN_RADAR_cd9b0015_Tx: ComSignalType=UINT8
            DET_MH_SCAN_INDEX_4LSB_381_384_oRDR_DETECTION_381_384_oPCAN_RADAR_01b12599_Tx: ComSignalType=UINT8
            DET_MTD_381_oRDR_DETECTION_381_384_oPCAN_RADAR_4b704cb4_Tx: ComSignalType=UINT8
            DET_MTD_382_oRDR_DETECTION_381_384_oPCAN_RADAR_2f90374a_Tx: ComSignalType=UINT8
            DET_MTD_383_oRDR_DETECTION_381_384_oPCAN_RADAR_bae0e3df_Tx: ComSignalType=UINT8
            DET_MTD_384_oRDR_DETECTION_381_384_oPCAN_RADAR_e650c0b6_Tx: ComSignalType=UINT8
            DET_PROB_1STAZHYPO_381_oRDR_DETECTION_381_384_oPCAN_RADAR_d8c4a479_Tx: ComSignalType=BOOLEAN
            DET_PROB_1STAZHYPO_382_oRDR_DETECTION_381_384_oPCAN_RADAR_bc24df87_Tx: ComSignalType=BOOLEAN
            DET_PROB_1STAZHYPO_383_oRDR_DETECTION_381_384_oPCAN_RADAR_29540b12_Tx: ComSignalType=BOOLEAN
            DET_PROB_1STAZHYPO_384_oRDR_DETECTION_381_384_oPCAN_RADAR_75e4287b_Tx: ComSignalType=BOOLEAN
            DET_RANGE_381_oRDR_DETECTION_381_384_oPCAN_RADAR_d36b470f_Tx: ComSignalType=UINT16
            DET_RANGE_382_oRDR_DETECTION_381_384_oPCAN_RADAR_b78b3cf1_Tx: ComSignalType=UINT16
            DET_RANGE_383_oRDR_DETECTION_381_384_oPCAN_RADAR_22fbe864_Tx: ComSignalType=UINT16
            DET_RANGE_384_oRDR_DETECTION_381_384_oPCAN_RADAR_7e4bcb0d_Tx: ComSignalType=UINT16
            DET_RANGE_ERR_381_oRDR_DETECTION_381_384_oPCAN_RADAR_7483fd66_Tx: ComSignalType=UINT8
            DET_RANGE_ERR_382_oRDR_DETECTION_381_384_oPCAN_RADAR_10638698_Tx: ComSignalType=UINT8
            DET_RANGE_ERR_383_oRDR_DETECTION_381_384_oPCAN_RADAR_8513520d_Tx: ComSignalType=UINT8
            DET_RANGE_ERR_384_oRDR_DETECTION_381_384_oPCAN_RADAR_d9a37164_Tx: ComSignalType=UINT8
            DET_RANGE_VELOCITY_381_oRDR_DETECTION_381_384_oPCAN_RADAR_a6cd852a_Tx: ComSignalType=UINT16
            DET_RANGE_VELOCITY_382_oRDR_DETECTION_381_384_oPCAN_RADAR_c22dfed4_Tx: ComSignalType=UINT16
            DET_RANGE_VELOCITY_383_oRDR_DETECTION_381_384_oPCAN_RADAR_575d2a41_Tx: ComSignalType=UINT16
            DET_RANGE_VELOCITY_384_oRDR_DETECTION_381_384_oPCAN_RADAR_0bed0928_Tx: ComSignalType=UINT16
            DET_RANGE_VELOCITY_ERR_381_oRDR_DETECTION_381_384_oPCAN_RADAR_a9767e98_Tx: ComSignalType=UINT8
            DET_RANGE_VELOCITY_ERR_382_oRDR_DETECTION_381_384_oPCAN_RADAR_cd960566_Tx: ComSignalType=UINT8
            DET_RANGE_VELOCITY_ERR_383_oRDR_DETECTION_381_384_oPCAN_RADAR_58e6d1f3_Tx: ComSignalType=UINT8
            DET_RANGE_VELOCITY_ERR_384_oRDR_DETECTION_381_384_oPCAN_RADAR_0456f29a_Tx: ComSignalType=UINT8
            DET_RCS_381_oRDR_DETECTION_381_384_oPCAN_RADAR_214db270_Tx: ComSignalType=UINT8
            DET_RCS_382_oRDR_DETECTION_381_384_oPCAN_RADAR_45adc98e_Tx: ComSignalType=UINT8
            DET_RCS_383_oRDR_DETECTION_381_384_oPCAN_RADAR_d0dd1d1b_Tx: ComSignalType=UINT8
            DET_RCS_384_oRDR_DETECTION_381_384_oPCAN_RADAR_8c6d3e72_Tx: ComSignalType=UINT8
            DET_SNR_381_oRDR_DETECTION_381_384_oPCAN_RADAR_fce3e672_Tx: ComSignalType=UINT8
            DET_SNR_382_oRDR_DETECTION_381_384_oPCAN_RADAR_98039d8c_Tx: ComSignalType=UINT8
            DET_SNR_383_oRDR_DETECTION_381_384_oPCAN_RADAR_0d734919_Tx: ComSignalType=UINT8
            DET_SNR_384_oRDR_DETECTION_381_384_oPCAN_RADAR_51c36a70_Tx: ComSignalType=UINT8
            DET_SUPER_RES_TARGET_381_oRDR_DETECTION_381_384_oPCAN_RADAR_cd7ace17_Tx: ComSignalType=BOOLEAN
            DET_SUPER_RES_TARGET_382_oRDR_DETECTION_381_384_oPCAN_RADAR_a99ab5e9_Tx: ComSignalType=BOOLEAN
            DET_SUPER_RES_TARGET_383_oRDR_DETECTION_381_384_oPCAN_RADAR_3cea617c_Tx: ComSignalType=BOOLEAN
            DET_SUPER_RES_TARGET_384_oRDR_DETECTION_381_384_oPCAN_RADAR_605a4215_Tx: ComSignalType=BOOLEAN
        SG_Detections_385_388_oRDR_DETECTION_385_388_oPCAN_RADAR_bca5477b_Tx
          83 x ComGroupSignal:
            DET_AZIMUTH_385_oRDR_DETECTION_385_388_oPCAN_RADAR_1212f217_Tx: ComSignalType=UINT16
            DET_AZIMUTH_386_oRDR_DETECTION_385_388_oPCAN_RADAR_76f289e9_Tx: ComSignalType=UINT16
            DET_AZIMUTH_387_oRDR_DETECTION_385_388_oPCAN_RADAR_e3825d7c_Tx: ComSignalType=UINT16
            DET_AZIMUTH_388_oRDR_DETECTION_385_388_oPCAN_RADAR_cf92cf3b_Tx: ComSignalType=UINT16
            DET_AZIMUTH_ERR_385_oRDR_DETECTION_385_388_oPCAN_RADAR_b6a767e2_Tx: ComSignalType=UINT8
            DET_AZIMUTH_ERR_386_oRDR_DETECTION_385_388_oPCAN_RADAR_d2471c1c_Tx: ComSignalType=UINT8
            DET_AZIMUTH_ERR_387_oRDR_DETECTION_385_388_oPCAN_RADAR_4737c889_Tx: ComSignalType=UINT8
            DET_AZIMUTH_ERR_388_oRDR_DETECTION_385_388_oPCAN_RADAR_6b275ace_Tx: ComSignalType=UINT8
            DET_BELOW_RAIN_THOLD_385_oRDR_DETECTION_385_388_oPCAN_RADAR_c71361d7_Tx: ComSignalType=UINT8
            DET_BELOW_RAIN_THOLD_386_oRDR_DETECTION_385_388_oPCAN_RADAR_a3f31a29_Tx: ComSignalType=UINT8
            DET_BELOW_RAIN_THOLD_387_oRDR_DETECTION_385_388_oPCAN_RADAR_3683cebc_Tx: ComSignalType=UINT8
            DET_BELOW_RAIN_THOLD_388_oRDR_DETECTION_385_388_oPCAN_RADAR_1a935cfb_Tx: ComSignalType=UINT8
            DET_BI_STATIC_FLAG_385_oRDR_DETECTION_385_388_oPCAN_RADAR_443eb292_Tx: ComSignalType=BOOLEAN
            DET_BI_STATIC_FLAG_386_oRDR_DETECTION_385_388_oPCAN_RADAR_20dec96c_Tx: ComSignalType=BOOLEAN
            DET_BI_STATIC_FLAG_387_oRDR_DETECTION_385_388_oPCAN_RADAR_b5ae1df9_Tx: ComSignalType=BOOLEAN
            DET_BI_STATIC_FLAG_388_oRDR_DETECTION_385_388_oPCAN_RADAR_99be8fbe_Tx: ComSignalType=BOOLEAN
            DET_CONFD_AZIMUTH_385_oRDR_DETECTION_385_388_oPCAN_RADAR_10f4f8dd_Tx: ComSignalType=UINT8
            DET_CONFD_AZIMUTH_386_oRDR_DETECTION_385_388_oPCAN_RADAR_74148323_Tx: ComSignalType=UINT8
            DET_CONFD_AZIMUTH_387_oRDR_DETECTION_385_388_oPCAN_RADAR_e16457b6_Tx: ComSignalType=UINT8
            DET_CONFD_AZIMUTH_388_oRDR_DETECTION_385_388_oPCAN_RADAR_cd74c5f1_Tx: ComSignalType=UINT8
            DET_CONFD_ELEVATION_385_oRDR_DETECTION_385_388_oPCAN_RADAR_1261f927_Tx: ComSignalType=UINT8
            DET_CONFD_ELEVATION_386_oRDR_DETECTION_385_388_oPCAN_RADAR_768182d9_Tx: ComSignalType=UINT8
            DET_CONFD_ELEVATION_387_oRDR_DETECTION_385_388_oPCAN_RADAR_e3f1564c_Tx: ComSignalType=UINT8
            DET_CONFD_ELEVATION_388_oRDR_DETECTION_385_388_oPCAN_RADAR_cfe1c40b_Tx: ComSignalType=UINT8
            DET_ELEVATION_385_oRDR_DETECTION_385_388_oPCAN_RADAR_c3a12d1b_Tx: ComSignalType=UINT8
            DET_ELEVATION_386_oRDR_DETECTION_385_388_oPCAN_RADAR_a74156e5_Tx: ComSignalType=UINT8
            DET_ELEVATION_387_oRDR_DETECTION_385_388_oPCAN_RADAR_32318270_Tx: ComSignalType=UINT8
            DET_ELEVATION_388_oRDR_DETECTION_385_388_oPCAN_RADAR_1e211037_Tx: ComSignalType=UINT8
            DET_ELEVATION_ERR_385_oRDR_DETECTION_385_388_oPCAN_RADAR_4498b56e_Tx: ComSignalType=UINT8
            DET_ELEVATION_ERR_386_oRDR_DETECTION_385_388_oPCAN_RADAR_2078ce90_Tx: ComSignalType=UINT8
            DET_ELEVATION_ERR_387_oRDR_DETECTION_385_388_oPCAN_RADAR_b5081a05_Tx: ComSignalType=UINT8
            DET_ELEVATION_ERR_388_oRDR_DETECTION_385_388_oPCAN_RADAR_99188842_Tx: ComSignalType=UINT8
            DET_EXISTENCE_PROB_385_oRDR_DETECTION_385_388_oPCAN_RADAR_9607c00e_Tx: ComSignalType=UINT8
            DET_EXISTENCE_PROB_386_oRDR_DETECTION_385_388_oPCAN_RADAR_f2e7bbf0_Tx: ComSignalType=UINT8
            DET_EXISTENCE_PROB_387_oRDR_DETECTION_385_388_oPCAN_RADAR_67976f65_Tx: ComSignalType=UINT8
            DET_EXISTENCE_PROB_388_oRDR_DETECTION_385_388_oPCAN_RADAR_4b87fd22_Tx: ComSignalType=UINT8
            DET_HVC_FLAG_385_oRDR_DETECTION_385_388_oPCAN_RADAR_77738371_Tx: ComSignalType=BOOLEAN
            DET_HVC_FLAG_386_oRDR_DETECTION_385_388_oPCAN_RADAR_1393f88f_Tx: ComSignalType=BOOLEAN
            DET_HVC_FLAG_387_oRDR_DETECTION_385_388_oPCAN_RADAR_86e32c1a_Tx: ComSignalType=BOOLEAN
            DET_HVC_FLAG_388_oRDR_DETECTION_385_388_oPCAN_RADAR_aaf3be5d_Tx: ComSignalType=BOOLEAN
            DET_IDM_385_oRDR_DETECTION_385_388_oPCAN_RADAR_fc21b8cc_Tx: ComSignalType=UINT8
            DET_IDM_386_oRDR_DETECTION_385_388_oPCAN_RADAR_98c1c332_Tx: ComSignalType=UINT8
            DET_IDM_387_oRDR_DETECTION_385_388_oPCAN_RADAR_0db117a7_Tx: ComSignalType=UINT8
            DET_IDM_388_oRDR_DETECTION_385_388_oPCAN_RADAR_21a185e0_Tx: ComSignalType=UINT8
            DET_MH_CRC16_385_388_oRDR_DETECTION_385_388_oPCAN_RADAR_382d9570_Tx: ComSignalType=UINT16
            DET_MH_CYCLE_COUNTER_385_388_oRDR_DETECTION_385_388_oPCAN_RADAR_bc583447_Tx: ComSignalType=UINT8
            DET_MH_SCAN_INDEX_4LSB_385_388_oRDR_DETECTION_385_388_oPCAN_RADAR_707211cb_Tx: ComSignalType=UINT8
            DET_MTD_385_oRDR_DETECTION_385_388_oPCAN_RADAR_9a928a17_Tx: ComSignalType=UINT8
            DET_MTD_386_oRDR_DETECTION_385_388_oPCAN_RADAR_fe72f1e9_Tx: ComSignalType=UINT8
            DET_MTD_387_oRDR_DETECTION_385_388_oPCAN_RADAR_6b02257c_Tx: ComSignalType=UINT8
            DET_MTD_388_oRDR_DETECTION_385_388_oPCAN_RADAR_4712b73b_Tx: ComSignalType=UINT8
            DET_PROB_1STAZHYPO_385_oRDR_DETECTION_385_388_oPCAN_RADAR_092662da_Tx: ComSignalType=BOOLEAN
            DET_PROB_1STAZHYPO_386_oRDR_DETECTION_385_388_oPCAN_RADAR_6dc61924_Tx: ComSignalType=BOOLEAN
            DET_PROB_1STAZHYPO_387_oRDR_DETECTION_385_388_oPCAN_RADAR_f8b6cdb1_Tx: ComSignalType=BOOLEAN
            DET_PROB_1STAZHYPO_388_oRDR_DETECTION_385_388_oPCAN_RADAR_d4a65ff6_Tx: ComSignalType=BOOLEAN
            DET_RANGE_385_oRDR_DETECTION_385_388_oPCAN_RADAR_028981ac_Tx: ComSignalType=UINT16
            DET_RANGE_386_oRDR_DETECTION_385_388_oPCAN_RADAR_6669fa52_Tx: ComSignalType=UINT16
            DET_RANGE_387_oRDR_DETECTION_385_388_oPCAN_RADAR_f3192ec7_Tx: ComSignalType=UINT16
            DET_RANGE_388_oRDR_DETECTION_385_388_oPCAN_RADAR_df09bc80_Tx: ComSignalType=UINT16
            DET_RANGE_ERR_385_oRDR_DETECTION_385_388_oPCAN_RADAR_a5613bc5_Tx: ComSignalType=UINT8
            DET_RANGE_ERR_386_oRDR_DETECTION_385_388_oPCAN_RADAR_c181403b_Tx: ComSignalType=UINT8
            DET_RANGE_ERR_387_oRDR_DETECTION_385_388_oPCAN_RADAR_54f194ae_Tx: ComSignalType=UINT8
            DET_RANGE_ERR_388_oRDR_DETECTION_385_388_oPCAN_RADAR_78e106e9_Tx: ComSignalType=UINT8
            DET_RANGE_VELOCITY_385_oRDR_DETECTION_385_388_oPCAN_RADAR_772f4389_Tx: ComSignalType=UINT16
            DET_RANGE_VELOCITY_386_oRDR_DETECTION_385_388_oPCAN_RADAR_13cf3877_Tx: ComSignalType=UINT16
            DET_RANGE_VELOCITY_387_oRDR_DETECTION_385_388_oPCAN_RADAR_86bfece2_Tx: ComSignalType=UINT16
            DET_RANGE_VELOCITY_388_oRDR_DETECTION_385_388_oPCAN_RADAR_aaaf7ea5_Tx: ComSignalType=UINT16
            DET_RANGE_VELOCITY_ERR_385_oRDR_DETECTION_385_388_oPCAN_RADAR_7894b83b_Tx: ComSignalType=UINT8
            DET_RANGE_VELOCITY_ERR_386_oRDR_DETECTION_385_388_oPCAN_RADAR_1c74c3c5_Tx: ComSignalType=UINT8
            DET_RANGE_VELOCITY_ERR_387_oRDR_DETECTION_385_388_oPCAN_RADAR_89041750_Tx: ComSignalType=UINT8
            DET_RANGE_VELOCITY_ERR_388_oRDR_DETECTION_385_388_oPCAN_RADAR_a5148517_Tx: ComSignalType=UINT8
            DET_RCS_385_oRDR_DETECTION_385_388_oPCAN_RADAR_f0af74d3_Tx: ComSignalType=UINT8
            DET_RCS_386_oRDR_DETECTION_385_388_oPCAN_RADAR_944f0f2d_Tx: ComSignalType=UINT8
            DET_RCS_387_oRDR_DETECTION_385_388_oPCAN_RADAR_013fdbb8_Tx: ComSignalType=UINT8
            DET_RCS_388_oRDR_DETECTION_385_388_oPCAN_RADAR_2d2f49ff_Tx: ComSignalType=UINT8
            DET_SNR_385_oRDR_DETECTION_385_388_oPCAN_RADAR_2d0120d1_Tx: ComSignalType=UINT8
            DET_SNR_386_oRDR_DETECTION_385_388_oPCAN_RADAR_49e15b2f_Tx: ComSignalType=UINT8
            DET_SNR_387_oRDR_DETECTION_385_388_oPCAN_RADAR_dc918fba_Tx: ComSignalType=UINT8
            DET_SNR_388_oRDR_DETECTION_385_388_oPCAN_RADAR_f0811dfd_Tx: ComSignalType=UINT8
            DET_SUPER_RES_TARGET_385_oRDR_DETECTION_385_388_oPCAN_RADAR_1c9808b4_Tx: ComSignalType=BOOLEAN
            DET_SUPER_RES_TARGET_386_oRDR_DETECTION_385_388_oPCAN_RADAR_7878734a_Tx: ComSignalType=BOOLEAN
            DET_SUPER_RES_TARGET_387_oRDR_DETECTION_385_388_oPCAN_RADAR_ed08a7df_Tx: ComSignalType=BOOLEAN
            DET_SUPER_RES_TARGET_388_oRDR_DETECTION_385_388_oPCAN_RADAR_c1183598_Tx: ComSignalType=BOOLEAN
        SG_Detections_389_392_oRDR_DETECTION_389_392_oPCAN_RADAR_25df6300_Tx
          83 x ComGroupSignal:
            DET_AZIMUTH_389_oRDR_DETECTION_389_392_oPCAN_RADAR_68aaf4af_Tx: ComSignalType=UINT16
            DET_AZIMUTH_390_oRDR_DETECTION_389_392_oPCAN_RADAR_0d8a860b_Tx: ComSignalType=UINT16
            DET_AZIMUTH_391_oRDR_DETECTION_389_392_oPCAN_RADAR_98fa529e_Tx: ComSignalType=UINT16
            DET_AZIMUTH_392_oRDR_DETECTION_389_392_oPCAN_RADAR_fc1a2960_Tx: ComSignalType=UINT16
            DET_AZIMUTH_ERR_389_oRDR_DETECTION_389_392_oPCAN_RADAR_cc1f615a_Tx: ComSignalType=UINT8
            DET_AZIMUTH_ERR_390_oRDR_DETECTION_389_392_oPCAN_RADAR_a93f13fe_Tx: ComSignalType=UINT8
            DET_AZIMUTH_ERR_391_oRDR_DETECTION_389_392_oPCAN_RADAR_3c4fc76b_Tx: ComSignalType=UINT8
            DET_AZIMUTH_ERR_392_oRDR_DETECTION_389_392_oPCAN_RADAR_58afbc95_Tx: ComSignalType=UINT8
            DET_BELOW_RAIN_THOLD_389_oRDR_DETECTION_389_392_oPCAN_RADAR_bdab676f_Tx: ComSignalType=UINT8
            DET_BELOW_RAIN_THOLD_390_oRDR_DETECTION_389_392_oPCAN_RADAR_d88b15cb_Tx: ComSignalType=UINT8
            DET_BELOW_RAIN_THOLD_391_oRDR_DETECTION_389_392_oPCAN_RADAR_4dfbc15e_Tx: ComSignalType=UINT8
            DET_BELOW_RAIN_THOLD_392_oRDR_DETECTION_389_392_oPCAN_RADAR_291bbaa0_Tx: ComSignalType=UINT8
            DET_BI_STATIC_FLAG_389_oRDR_DETECTION_389_392_oPCAN_RADAR_3e86b42a_Tx: ComSignalType=BOOLEAN
            DET_BI_STATIC_FLAG_390_oRDR_DETECTION_389_392_oPCAN_RADAR_5ba6c68e_Tx: ComSignalType=BOOLEAN
            DET_BI_STATIC_FLAG_391_oRDR_DETECTION_389_392_oPCAN_RADAR_ced6121b_Tx: ComSignalType=BOOLEAN
            DET_BI_STATIC_FLAG_392_oRDR_DETECTION_389_392_oPCAN_RADAR_aa3669e5_Tx: ComSignalType=BOOLEAN
            DET_CONFD_AZIMUTH_389_oRDR_DETECTION_389_392_oPCAN_RADAR_6a4cfe65_Tx: ComSignalType=UINT8
            DET_CONFD_AZIMUTH_390_oRDR_DETECTION_389_392_oPCAN_RADAR_0f6c8cc1_Tx: ComSignalType=UINT8
            DET_CONFD_AZIMUTH_391_oRDR_DETECTION_389_392_oPCAN_RADAR_9a1c5854_Tx: ComSignalType=UINT8
            DET_CONFD_AZIMUTH_392_oRDR_DETECTION_389_392_oPCAN_RADAR_fefc23aa_Tx: ComSignalType=UINT8
            DET_CONFD_ELEVATION_389_oRDR_DETECTION_389_392_oPCAN_RADAR_68d9ff9f_Tx: ComSignalType=UINT8
            DET_CONFD_ELEVATION_390_oRDR_DETECTION_389_392_oPCAN_RADAR_0df98d3b_Tx: ComSignalType=UINT8
            DET_CONFD_ELEVATION_391_oRDR_DETECTION_389_392_oPCAN_RADAR_988959ae_Tx: ComSignalType=UINT8
            DET_CONFD_ELEVATION_392_oRDR_DETECTION_389_392_oPCAN_RADAR_fc692250_Tx: ComSignalType=UINT8
            DET_ELEVATION_389_oRDR_DETECTION_389_392_oPCAN_RADAR_b9192ba3_Tx: ComSignalType=UINT8
            DET_ELEVATION_390_oRDR_DETECTION_389_392_oPCAN_RADAR_dc395907_Tx: ComSignalType=UINT8
            DET_ELEVATION_391_oRDR_DETECTION_389_392_oPCAN_RADAR_49498d92_Tx: ComSignalType=UINT8
            DET_ELEVATION_392_oRDR_DETECTION_389_392_oPCAN_RADAR_2da9f66c_Tx: ComSignalType=UINT8
            DET_ELEVATION_ERR_389_oRDR_DETECTION_389_392_oPCAN_RADAR_3e20b3d6_Tx: ComSignalType=UINT8
            DET_ELEVATION_ERR_390_oRDR_DETECTION_389_392_oPCAN_RADAR_5b00c172_Tx: ComSignalType=UINT8
            DET_ELEVATION_ERR_391_oRDR_DETECTION_389_392_oPCAN_RADAR_ce7015e7_Tx: ComSignalType=UINT8
            DET_ELEVATION_ERR_392_oRDR_DETECTION_389_392_oPCAN_RADAR_aa906e19_Tx: ComSignalType=UINT8
            DET_EXISTENCE_PROB_389_oRDR_DETECTION_389_392_oPCAN_RADAR_ecbfc6b6_Tx: ComSignalType=UINT8
            DET_EXISTENCE_PROB_390_oRDR_DETECTION_389_392_oPCAN_RADAR_899fb412_Tx: ComSignalType=UINT8
            DET_EXISTENCE_PROB_391_oRDR_DETECTION_389_392_oPCAN_RADAR_1cef6087_Tx: ComSignalType=UINT8
            DET_EXISTENCE_PROB_392_oRDR_DETECTION_389_392_oPCAN_RADAR_780f1b79_Tx: ComSignalType=UINT8
            DET_HVC_FLAG_389_oRDR_DETECTION_389_392_oPCAN_RADAR_0dcb85c9_Tx: ComSignalType=BOOLEAN
            DET_HVC_FLAG_390_oRDR_DETECTION_389_392_oPCAN_RADAR_68ebf76d_Tx: ComSignalType=BOOLEAN
            DET_HVC_FLAG_391_oRDR_DETECTION_389_392_oPCAN_RADAR_fd9b23f8_Tx: ComSignalType=BOOLEAN
            DET_HVC_FLAG_392_oRDR_DETECTION_389_392_oPCAN_RADAR_997b5806_Tx: ComSignalType=BOOLEAN
            DET_IDM_389_oRDR_DETECTION_389_392_oPCAN_RADAR_8699be74_Tx: ComSignalType=UINT8
            DET_IDM_390_oRDR_DETECTION_389_392_oPCAN_RADAR_e3b9ccd0_Tx: ComSignalType=UINT8
            DET_IDM_391_oRDR_DETECTION_389_392_oPCAN_RADAR_76c91845_Tx: ComSignalType=UINT8
            DET_IDM_392_oRDR_DETECTION_389_392_oPCAN_RADAR_122963bb_Tx: ComSignalType=UINT8
            DET_MH_CRC16_389_392_oRDR_DETECTION_389_392_oPCAN_RADAR_a157b10b_Tx: ComSignalType=UINT16
            DET_MH_CYCLE_COUNTER_389_392_oRDR_DETECTION_389_392_oPCAN_RADAR_2522103c_Tx: ComSignalType=UINT8
            DET_MH_SCAN_INDEX_4LSB_389_392_oRDR_DETECTION_389_392_oPCAN_RADAR_e90835b0_Tx: ComSignalType=UINT8
            DET_MTD_389_oRDR_DETECTION_389_392_oPCAN_RADAR_e02a8caf_Tx: ComSignalType=UINT8
            DET_MTD_390_oRDR_DETECTION_389_392_oPCAN_RADAR_850afe0b_Tx: ComSignalType=UINT8
            DET_MTD_391_oRDR_DETECTION_389_392_oPCAN_RADAR_107a2a9e_Tx: ComSignalType=UINT8
            DET_MTD_392_oRDR_DETECTION_389_392_oPCAN_RADAR_749a5160_Tx: ComSignalType=UINT8
            DET_PROB_1STAZHYPO_389_oRDR_DETECTION_389_392_oPCAN_RADAR_739e6462_Tx: ComSignalType=BOOLEAN
            DET_PROB_1STAZHYPO_390_oRDR_DETECTION_389_392_oPCAN_RADAR_16be16c6_Tx: ComSignalType=BOOLEAN
            DET_PROB_1STAZHYPO_391_oRDR_DETECTION_389_392_oPCAN_RADAR_83cec253_Tx: ComSignalType=BOOLEAN
            DET_PROB_1STAZHYPO_392_oRDR_DETECTION_389_392_oPCAN_RADAR_e72eb9ad_Tx: ComSignalType=BOOLEAN
            DET_RANGE_389_oRDR_DETECTION_389_392_oPCAN_RADAR_78318714_Tx: ComSignalType=UINT16
            DET_RANGE_390_oRDR_DETECTION_389_392_oPCAN_RADAR_1d11f5b0_Tx: ComSignalType=UINT16
            DET_RANGE_391_oRDR_DETECTION_389_392_oPCAN_RADAR_88612125_Tx: ComSignalType=UINT16
            DET_RANGE_392_oRDR_DETECTION_389_392_oPCAN_RADAR_ec815adb_Tx: ComSignalType=UINT16
            DET_RANGE_ERR_389_oRDR_DETECTION_389_392_oPCAN_RADAR_dfd93d7d_Tx: ComSignalType=UINT8
            DET_RANGE_ERR_390_oRDR_DETECTION_389_392_oPCAN_RADAR_baf94fd9_Tx: ComSignalType=UINT8
            DET_RANGE_ERR_391_oRDR_DETECTION_389_392_oPCAN_RADAR_2f899b4c_Tx: ComSignalType=UINT8
            DET_RANGE_ERR_392_oRDR_DETECTION_389_392_oPCAN_RADAR_4b69e0b2_Tx: ComSignalType=UINT8
            DET_RANGE_VELOCITY_389_oRDR_DETECTION_389_392_oPCAN_RADAR_0d974531_Tx: ComSignalType=UINT16
            DET_RANGE_VELOCITY_390_oRDR_DETECTION_389_392_oPCAN_RADAR_68b73795_Tx: ComSignalType=UINT16
            DET_RANGE_VELOCITY_391_oRDR_DETECTION_389_392_oPCAN_RADAR_fdc7e300_Tx: ComSignalType=UINT16
            DET_RANGE_VELOCITY_392_oRDR_DETECTION_389_392_oPCAN_RADAR_992798fe_Tx: ComSignalType=UINT16
            DET_RANGE_VELOCITY_ERR_389_oRDR_DETECTION_389_392_oPCAN_RADAR_022cbe83_Tx: ComSignalType=UINT8
            DET_RANGE_VELOCITY_ERR_390_oRDR_DETECTION_389_392_oPCAN_RADAR_670ccc27_Tx: ComSignalType=UINT8
            DET_RANGE_VELOCITY_ERR_391_oRDR_DETECTION_389_392_oPCAN_RADAR_f27c18b2_Tx: ComSignalType=UINT8
            DET_RANGE_VELOCITY_ERR_392_oRDR_DETECTION_389_392_oPCAN_RADAR_969c634c_Tx: ComSignalType=UINT8
            DET_RCS_389_oRDR_DETECTION_389_392_oPCAN_RADAR_8a17726b_Tx: ComSignalType=UINT8
            DET_RCS_390_oRDR_DETECTION_389_392_oPCAN_RADAR_ef3700cf_Tx: ComSignalType=UINT8
            DET_RCS_391_oRDR_DETECTION_389_392_oPCAN_RADAR_7a47d45a_Tx: ComSignalType=UINT8
            DET_RCS_392_oRDR_DETECTION_389_392_oPCAN_RADAR_1ea7afa4_Tx: ComSignalType=UINT8
            DET_SNR_389_oRDR_DETECTION_389_392_oPCAN_RADAR_57b92669_Tx: ComSignalType=UINT8
            DET_SNR_390_oRDR_DETECTION_389_392_oPCAN_RADAR_329954cd_Tx: ComSignalType=UINT8
            DET_SNR_391_oRDR_DETECTION_389_392_oPCAN_RADAR_a7e98058_Tx: ComSignalType=UINT8
            DET_SNR_392_oRDR_DETECTION_389_392_oPCAN_RADAR_c309fba6_Tx: ComSignalType=UINT8
            DET_SUPER_RES_TARGET_389_oRDR_DETECTION_389_392_oPCAN_RADAR_66200e0c_Tx: ComSignalType=BOOLEAN
            DET_SUPER_RES_TARGET_390_oRDR_DETECTION_389_392_oPCAN_RADAR_03007ca8_Tx: ComSignalType=BOOLEAN
            DET_SUPER_RES_TARGET_391_oRDR_DETECTION_389_392_oPCAN_RADAR_9670a83d_Tx: ComSignalType=BOOLEAN
            DET_SUPER_RES_TARGET_392_oRDR_DETECTION_389_392_oPCAN_RADAR_f290d3c3_Tx: ComSignalType=BOOLEAN
        SG_Detections_393_396_oRDR_DETECTION_393_396_oPCAN_RADAR_17d40b28_Tx
          83 x ComGroupSignal:
            DET_AZIMUTH_393_oRDR_DETECTION_393_396_oPCAN_RADAR_74adfedb_Tx: ComSignalType=UINT16
            DET_AZIMUTH_394_oRDR_DETECTION_393_396_oPCAN_RADAR_281dddb2_Tx: ComSignalType=UINT16
            DET_AZIMUTH_395_oRDR_DETECTION_393_396_oPCAN_RADAR_bd6d0927_Tx: ComSignalType=UINT16
            DET_AZIMUTH_396_oRDR_DETECTION_393_396_oPCAN_RADAR_d98d72d9_Tx: ComSignalType=UINT16
            DET_AZIMUTH_ERR_393_oRDR_DETECTION_393_396_oPCAN_RADAR_d0186b2e_Tx: ComSignalType=UINT8
            DET_AZIMUTH_ERR_394_oRDR_DETECTION_393_396_oPCAN_RADAR_8ca84847_Tx: ComSignalType=UINT8
            DET_AZIMUTH_ERR_395_oRDR_DETECTION_393_396_oPCAN_RADAR_19d89cd2_Tx: ComSignalType=UINT8
            DET_AZIMUTH_ERR_396_oRDR_DETECTION_393_396_oPCAN_RADAR_7d38e72c_Tx: ComSignalType=UINT8
            DET_BELOW_RAIN_THOLD_393_oRDR_DETECTION_393_396_oPCAN_RADAR_a1ac6d1b_Tx: ComSignalType=UINT8
            DET_BELOW_RAIN_THOLD_394_oRDR_DETECTION_393_396_oPCAN_RADAR_fd1c4e72_Tx: ComSignalType=UINT8
            DET_BELOW_RAIN_THOLD_395_oRDR_DETECTION_393_396_oPCAN_RADAR_686c9ae7_Tx: ComSignalType=UINT8
            DET_BELOW_RAIN_THOLD_396_oRDR_DETECTION_393_396_oPCAN_RADAR_0c8ce119_Tx: ComSignalType=UINT8
            DET_BI_STATIC_FLAG_393_oRDR_DETECTION_393_396_oPCAN_RADAR_2281be5e_Tx: ComSignalType=BOOLEAN
            DET_BI_STATIC_FLAG_394_oRDR_DETECTION_393_396_oPCAN_RADAR_7e319d37_Tx: ComSignalType=BOOLEAN
            DET_BI_STATIC_FLAG_395_oRDR_DETECTION_393_396_oPCAN_RADAR_eb4149a2_Tx: ComSignalType=BOOLEAN
            DET_BI_STATIC_FLAG_396_oRDR_DETECTION_393_396_oPCAN_RADAR_8fa1325c_Tx: ComSignalType=BOOLEAN
            DET_CONFD_AZIMUTH_393_oRDR_DETECTION_393_396_oPCAN_RADAR_764bf411_Tx: ComSignalType=UINT8
            DET_CONFD_AZIMUTH_394_oRDR_DETECTION_393_396_oPCAN_RADAR_2afbd778_Tx: ComSignalType=UINT8
            DET_CONFD_AZIMUTH_395_oRDR_DETECTION_393_396_oPCAN_RADAR_bf8b03ed_Tx: ComSignalType=UINT8
            DET_CONFD_AZIMUTH_396_oRDR_DETECTION_393_396_oPCAN_RADAR_db6b7813_Tx: ComSignalType=UINT8
            DET_CONFD_ELEVATION_393_oRDR_DETECTION_393_396_oPCAN_RADAR_74def5eb_Tx: ComSignalType=UINT8
            DET_CONFD_ELEVATION_394_oRDR_DETECTION_393_396_oPCAN_RADAR_286ed682_Tx: ComSignalType=UINT8
            DET_CONFD_ELEVATION_395_oRDR_DETECTION_393_396_oPCAN_RADAR_bd1e0217_Tx: ComSignalType=UINT8
            DET_CONFD_ELEVATION_396_oRDR_DETECTION_393_396_oPCAN_RADAR_d9fe79e9_Tx: ComSignalType=UINT8
            DET_ELEVATION_393_oRDR_DETECTION_393_396_oPCAN_RADAR_a51e21d7_Tx: ComSignalType=UINT8
            DET_ELEVATION_394_oRDR_DETECTION_393_396_oPCAN_RADAR_f9ae02be_Tx: ComSignalType=UINT8
            DET_ELEVATION_395_oRDR_DETECTION_393_396_oPCAN_RADAR_6cded62b_Tx: ComSignalType=UINT8
            DET_ELEVATION_396_oRDR_DETECTION_393_396_oPCAN_RADAR_083eadd5_Tx: ComSignalType=UINT8
            DET_ELEVATION_ERR_393_oRDR_DETECTION_393_396_oPCAN_RADAR_2227b9a2_Tx: ComSignalType=UINT8
            DET_ELEVATION_ERR_394_oRDR_DETECTION_393_396_oPCAN_RADAR_7e979acb_Tx: ComSignalType=UINT8
            DET_ELEVATION_ERR_395_oRDR_DETECTION_393_396_oPCAN_RADAR_ebe74e5e_Tx: ComSignalType=UINT8
            DET_ELEVATION_ERR_396_oRDR_DETECTION_393_396_oPCAN_RADAR_8f0735a0_Tx: ComSignalType=UINT8
            DET_EXISTENCE_PROB_393_oRDR_DETECTION_393_396_oPCAN_RADAR_f0b8ccc2_Tx: ComSignalType=UINT8
            DET_EXISTENCE_PROB_394_oRDR_DETECTION_393_396_oPCAN_RADAR_ac08efab_Tx: ComSignalType=UINT8
            DET_EXISTENCE_PROB_395_oRDR_DETECTION_393_396_oPCAN_RADAR_39783b3e_Tx: ComSignalType=UINT8
            DET_EXISTENCE_PROB_396_oRDR_DETECTION_393_396_oPCAN_RADAR_5d9840c0_Tx: ComSignalType=UINT8
            DET_HVC_FLAG_393_oRDR_DETECTION_393_396_oPCAN_RADAR_11cc8fbd_Tx: ComSignalType=BOOLEAN
            DET_HVC_FLAG_394_oRDR_DETECTION_393_396_oPCAN_RADAR_4d7cacd4_Tx: ComSignalType=BOOLEAN
            DET_HVC_FLAG_395_oRDR_DETECTION_393_396_oPCAN_RADAR_d80c7841_Tx: ComSignalType=BOOLEAN
            DET_HVC_FLAG_396_oRDR_DETECTION_393_396_oPCAN_RADAR_bcec03bf_Tx: ComSignalType=BOOLEAN
            DET_IDM_393_oRDR_DETECTION_393_396_oPCAN_RADAR_9a9eb400_Tx: ComSignalType=UINT8
            DET_IDM_394_oRDR_DETECTION_393_396_oPCAN_RADAR_c62e9769_Tx: ComSignalType=UINT8
            DET_IDM_395_oRDR_DETECTION_393_396_oPCAN_RADAR_535e43fc_Tx: ComSignalType=UINT8
            DET_IDM_396_oRDR_DETECTION_393_396_oPCAN_RADAR_37be3802_Tx: ComSignalType=UINT8
            DET_MH_CRC16_393_396_oRDR_DETECTION_393_396_oPCAN_RADAR_935cd923_Tx: ComSignalType=UINT16
            DET_MH_CYCLE_COUNTER_393_396_oRDR_DETECTION_393_396_oPCAN_RADAR_17297814_Tx: ComSignalType=UINT8
            DET_MH_SCAN_INDEX_4LSB_393_396_oRDR_DETECTION_393_396_oPCAN_RADAR_db035d98_Tx: ComSignalType=UINT8
            DET_MTD_393_oRDR_DETECTION_393_396_oPCAN_RADAR_fc2d86db_Tx: ComSignalType=UINT8
            DET_MTD_394_oRDR_DETECTION_393_396_oPCAN_RADAR_a09da5b2_Tx: ComSignalType=UINT8
            DET_MTD_395_oRDR_DETECTION_393_396_oPCAN_RADAR_35ed7127_Tx: ComSignalType=UINT8
            DET_MTD_396_oRDR_DETECTION_393_396_oPCAN_RADAR_510d0ad9_Tx: ComSignalType=UINT8
            DET_PROB_1STAZHYPO_393_oRDR_DETECTION_393_396_oPCAN_RADAR_6f996e16_Tx: ComSignalType=BOOLEAN
            DET_PROB_1STAZHYPO_394_oRDR_DETECTION_393_396_oPCAN_RADAR_33294d7f_Tx: ComSignalType=BOOLEAN
            DET_PROB_1STAZHYPO_395_oRDR_DETECTION_393_396_oPCAN_RADAR_a65999ea_Tx: ComSignalType=BOOLEAN
            DET_PROB_1STAZHYPO_396_oRDR_DETECTION_393_396_oPCAN_RADAR_c2b9e214_Tx: ComSignalType=BOOLEAN
            DET_RANGE_393_oRDR_DETECTION_393_396_oPCAN_RADAR_64368d60_Tx: ComSignalType=UINT16
            DET_RANGE_394_oRDR_DETECTION_393_396_oPCAN_RADAR_3886ae09_Tx: ComSignalType=UINT16
            DET_RANGE_395_oRDR_DETECTION_393_396_oPCAN_RADAR_adf67a9c_Tx: ComSignalType=UINT16
            DET_RANGE_396_oRDR_DETECTION_393_396_oPCAN_RADAR_c9160162_Tx: ComSignalType=UINT16
            DET_RANGE_ERR_393_oRDR_DETECTION_393_396_oPCAN_RADAR_c3de3709_Tx: ComSignalType=UINT8
            DET_RANGE_ERR_394_oRDR_DETECTION_393_396_oPCAN_RADAR_9f6e1460_Tx: ComSignalType=UINT8
            DET_RANGE_ERR_395_oRDR_DETECTION_393_396_oPCAN_RADAR_0a1ec0f5_Tx: ComSignalType=UINT8
            DET_RANGE_ERR_396_oRDR_DETECTION_393_396_oPCAN_RADAR_6efebb0b_Tx: ComSignalType=UINT8
            DET_RANGE_VELOCITY_393_oRDR_DETECTION_393_396_oPCAN_RADAR_11904f45_Tx: ComSignalType=UINT16
            DET_RANGE_VELOCITY_394_oRDR_DETECTION_393_396_oPCAN_RADAR_4d206c2c_Tx: ComSignalType=UINT16
            DET_RANGE_VELOCITY_395_oRDR_DETECTION_393_396_oPCAN_RADAR_d850b8b9_Tx: ComSignalType=UINT16
            DET_RANGE_VELOCITY_396_oRDR_DETECTION_393_396_oPCAN_RADAR_bcb0c347_Tx: ComSignalType=UINT16
            DET_RANGE_VELOCITY_ERR_393_oRDR_DETECTION_393_396_oPCAN_RADAR_1e2bb4f7_Tx: ComSignalType=UINT8
            DET_RANGE_VELOCITY_ERR_394_oRDR_DETECTION_393_396_oPCAN_RADAR_429b979e_Tx: ComSignalType=UINT8
            DET_RANGE_VELOCITY_ERR_395_oRDR_DETECTION_393_396_oPCAN_RADAR_d7eb430b_Tx: ComSignalType=UINT8
            DET_RANGE_VELOCITY_ERR_396_oRDR_DETECTION_393_396_oPCAN_RADAR_b30b38f5_Tx: ComSignalType=UINT8
            DET_RCS_393_oRDR_DETECTION_393_396_oPCAN_RADAR_9610781f_Tx: ComSignalType=UINT8
            DET_RCS_394_oRDR_DETECTION_393_396_oPCAN_RADAR_caa05b76_Tx: ComSignalType=UINT8
            DET_RCS_395_oRDR_DETECTION_393_396_oPCAN_RADAR_5fd08fe3_Tx: ComSignalType=UINT8
            DET_RCS_396_oRDR_DETECTION_393_396_oPCAN_RADAR_3b30f41d_Tx: ComSignalType=UINT8
            DET_SNR_393_oRDR_DETECTION_393_396_oPCAN_RADAR_4bbe2c1d_Tx: ComSignalType=UINT8
            DET_SNR_394_oRDR_DETECTION_393_396_oPCAN_RADAR_170e0f74_Tx: ComSignalType=UINT8
            DET_SNR_395_oRDR_DETECTION_393_396_oPCAN_RADAR_827edbe1_Tx: ComSignalType=UINT8
            DET_SNR_396_oRDR_DETECTION_393_396_oPCAN_RADAR_e69ea01f_Tx: ComSignalType=UINT8
            DET_SUPER_RES_TARGET_393_oRDR_DETECTION_393_396_oPCAN_RADAR_7a270478_Tx: ComSignalType=BOOLEAN
            DET_SUPER_RES_TARGET_394_oRDR_DETECTION_393_396_oPCAN_RADAR_26972711_Tx: ComSignalType=BOOLEAN
            DET_SUPER_RES_TARGET_395_oRDR_DETECTION_393_396_oPCAN_RADAR_b3e7f384_Tx: ComSignalType=BOOLEAN
            DET_SUPER_RES_TARGET_396_oRDR_DETECTION_393_396_oPCAN_RADAR_d707887a_Tx: ComSignalType=BOOLEAN
        SG_Detections_397_400_oRDR_DETECTION_397_400_oPCAN_RADAR_a221f00e_Tx
          83 x ComGroupSignal:
            DET_AZIMUTH_397_oRDR_DETECTION_397_400_oPCAN_RADAR_aa47ae04_Tx: ComSignalType=UINT16
            DET_AZIMUTH_398_oRDR_DETECTION_397_400_oPCAN_RADAR_86573c43_Tx: ComSignalType=UINT16
            DET_AZIMUTH_399_oRDR_DETECTION_397_400_oPCAN_RADAR_1327e8d6_Tx: ComSignalType=UINT16
            DET_AZIMUTH_400_oRDR_DETECTION_397_400_oPCAN_RADAR_bcf9ca20_Tx: ComSignalType=UINT16
            DET_AZIMUTH_ERR_397_oRDR_DETECTION_397_400_oPCAN_RADAR_0ef23bf1_Tx: ComSignalType=UINT8
            DET_AZIMUTH_ERR_398_oRDR_DETECTION_397_400_oPCAN_RADAR_22e2a9b6_Tx: ComSignalType=UINT8
            DET_AZIMUTH_ERR_399_oRDR_DETECTION_397_400_oPCAN_RADAR_b7927d23_Tx: ComSignalType=UINT8
            DET_AZIMUTH_ERR_400_oRDR_DETECTION_397_400_oPCAN_RADAR_184c5fd5_Tx: ComSignalType=UINT8
            DET_BELOW_RAIN_THOLD_397_oRDR_DETECTION_397_400_oPCAN_RADAR_7f463dc4_Tx: ComSignalType=UINT8
            DET_BELOW_RAIN_THOLD_398_oRDR_DETECTION_397_400_oPCAN_RADAR_5356af83_Tx: ComSignalType=UINT8
            DET_BELOW_RAIN_THOLD_399_oRDR_DETECTION_397_400_oPCAN_RADAR_c6267b16_Tx: ComSignalType=UINT8
            DET_BELOW_RAIN_THOLD_400_oRDR_DETECTION_397_400_oPCAN_RADAR_69f859e0_Tx: ComSignalType=UINT8
            DET_BI_STATIC_FLAG_397_oRDR_DETECTION_397_400_oPCAN_RADAR_fc6bee81_Tx: ComSignalType=BOOLEAN
            DET_BI_STATIC_FLAG_398_oRDR_DETECTION_397_400_oPCAN_RADAR_d07b7cc6_Tx: ComSignalType=BOOLEAN
            DET_BI_STATIC_FLAG_399_oRDR_DETECTION_397_400_oPCAN_RADAR_450ba853_Tx: ComSignalType=BOOLEAN
            DET_BI_STATIC_FLAG_400_oRDR_DETECTION_397_400_oPCAN_RADAR_ead58aa5_Tx: ComSignalType=BOOLEAN
            DET_CONFD_AZIMUTH_397_oRDR_DETECTION_397_400_oPCAN_RADAR_a8a1a4ce_Tx: ComSignalType=UINT8
            DET_CONFD_AZIMUTH_398_oRDR_DETECTION_397_400_oPCAN_RADAR_84b13689_Tx: ComSignalType=UINT8
            DET_CONFD_AZIMUTH_399_oRDR_DETECTION_397_400_oPCAN_RADAR_11c1e21c_Tx: ComSignalType=UINT8
            DET_CONFD_AZIMUTH_400_oRDR_DETECTION_397_400_oPCAN_RADAR_be1fc0ea_Tx: ComSignalType=UINT8
            DET_CONFD_ELEVATION_397_oRDR_DETECTION_397_400_oPCAN_RADAR_aa34a534_Tx: ComSignalType=UINT8
            DET_CONFD_ELEVATION_398_oRDR_DETECTION_397_400_oPCAN_RADAR_86243773_Tx: ComSignalType=UINT8
            DET_CONFD_ELEVATION_399_oRDR_DETECTION_397_400_oPCAN_RADAR_1354e3e6_Tx: ComSignalType=UINT8
            DET_CONFD_ELEVATION_400_oRDR_DETECTION_397_400_oPCAN_RADAR_bc8ac110_Tx: ComSignalType=UINT8
            DET_ELEVATION_397_oRDR_DETECTION_397_400_oPCAN_RADAR_7bf47108_Tx: ComSignalType=UINT8
            DET_ELEVATION_398_oRDR_DETECTION_397_400_oPCAN_RADAR_57e4e34f_Tx: ComSignalType=UINT8
            DET_ELEVATION_399_oRDR_DETECTION_397_400_oPCAN_RADAR_c29437da_Tx: ComSignalType=UINT8
            DET_ELEVATION_400_oRDR_DETECTION_397_400_oPCAN_RADAR_6d4a152c_Tx: ComSignalType=UINT8
            DET_ELEVATION_ERR_397_oRDR_DETECTION_397_400_oPCAN_RADAR_fccde97d_Tx: ComSignalType=UINT8
            DET_ELEVATION_ERR_398_oRDR_DETECTION_397_400_oPCAN_RADAR_d0dd7b3a_Tx: ComSignalType=UINT8
            DET_ELEVATION_ERR_399_oRDR_DETECTION_397_400_oPCAN_RADAR_45adafaf_Tx: ComSignalType=UINT8
            DET_ELEVATION_ERR_400_oRDR_DETECTION_397_400_oPCAN_RADAR_ea738d59_Tx: ComSignalType=UINT8
            DET_EXISTENCE_PROB_397_oRDR_DETECTION_397_400_oPCAN_RADAR_2e529c1d_Tx: ComSignalType=UINT8
            DET_EXISTENCE_PROB_398_oRDR_DETECTION_397_400_oPCAN_RADAR_02420e5a_Tx: ComSignalType=UINT8
            DET_EXISTENCE_PROB_399_oRDR_DETECTION_397_400_oPCAN_RADAR_9732dacf_Tx: ComSignalType=UINT8
            DET_EXISTENCE_PROB_400_oRDR_DETECTION_397_400_oPCAN_RADAR_38ecf839_Tx: ComSignalType=UINT8
            DET_HVC_FLAG_397_oRDR_DETECTION_397_400_oPCAN_RADAR_cf26df62_Tx: ComSignalType=BOOLEAN
            DET_HVC_FLAG_398_oRDR_DETECTION_397_400_oPCAN_RADAR_e3364d25_Tx: ComSignalType=BOOLEAN
            DET_HVC_FLAG_399_oRDR_DETECTION_397_400_oPCAN_RADAR_764699b0_Tx: ComSignalType=BOOLEAN
            DET_HVC_FLAG_400_oRDR_DETECTION_397_400_oPCAN_RADAR_d998bb46_Tx: ComSignalType=BOOLEAN
            DET_IDM_397_oRDR_DETECTION_397_400_oPCAN_RADAR_4474e4df_Tx: ComSignalType=UINT8
            DET_IDM_398_oRDR_DETECTION_397_400_oPCAN_RADAR_68647698_Tx: ComSignalType=UINT8
            DET_IDM_399_oRDR_DETECTION_397_400_oPCAN_RADAR_fd14a20d_Tx: ComSignalType=UINT8
            DET_IDM_400_oRDR_DETECTION_397_400_oPCAN_RADAR_52ca80fb_Tx: ComSignalType=UINT8
            DET_MH_CRC16_397_400_oRDR_DETECTION_397_400_oPCAN_RADAR_26a92205_Tx: ComSignalType=UINT16
            DET_MH_CYCLE_COUNTER_397_400_oRDR_DETECTION_397_400_oPCAN_RADAR_a2dc8332_Tx: ComSignalType=UINT8
            DET_MH_SCAN_INDEX_4LSB_397_400_oRDR_DETECTION_397_400_oPCAN_RADAR_6ef6a6be_Tx: ComSignalType=UINT8
            DET_MTD_397_oRDR_DETECTION_397_400_oPCAN_RADAR_22c7d604_Tx: ComSignalType=UINT8
            DET_MTD_398_oRDR_DETECTION_397_400_oPCAN_RADAR_0ed74443_Tx: ComSignalType=UINT8
            DET_MTD_399_oRDR_DETECTION_397_400_oPCAN_RADAR_9ba790d6_Tx: ComSignalType=UINT8
            DET_MTD_400_oRDR_DETECTION_397_400_oPCAN_RADAR_3479b220_Tx: ComSignalType=UINT8
            DET_PROB_1STAZHYPO_397_oRDR_DETECTION_397_400_oPCAN_RADAR_b1733ec9_Tx: ComSignalType=BOOLEAN
            DET_PROB_1STAZHYPO_398_oRDR_DETECTION_397_400_oPCAN_RADAR_9d63ac8e_Tx: ComSignalType=BOOLEAN
            DET_PROB_1STAZHYPO_399_oRDR_DETECTION_397_400_oPCAN_RADAR_0813781b_Tx: ComSignalType=BOOLEAN
            DET_PROB_1STAZHYPO_400_oRDR_DETECTION_397_400_oPCAN_RADAR_a7cd5aed_Tx: ComSignalType=BOOLEAN
            DET_RANGE_397_oRDR_DETECTION_397_400_oPCAN_RADAR_badcddbf_Tx: ComSignalType=UINT16
            DET_RANGE_398_oRDR_DETECTION_397_400_oPCAN_RADAR_96cc4ff8_Tx: ComSignalType=UINT16
            DET_RANGE_399_oRDR_DETECTION_397_400_oPCAN_RADAR_03bc9b6d_Tx: ComSignalType=UINT16
            DET_RANGE_400_oRDR_DETECTION_397_400_oPCAN_RADAR_ac62b99b_Tx: ComSignalType=UINT16
            DET_RANGE_ERR_397_oRDR_DETECTION_397_400_oPCAN_RADAR_1d3467d6_Tx: ComSignalType=UINT8
            DET_RANGE_ERR_398_oRDR_DETECTION_397_400_oPCAN_RADAR_3124f591_Tx: ComSignalType=UINT8
            DET_RANGE_ERR_399_oRDR_DETECTION_397_400_oPCAN_RADAR_a4542104_Tx: ComSignalType=UINT8
            DET_RANGE_ERR_400_oRDR_DETECTION_397_400_oPCAN_RADAR_0b8a03f2_Tx: ComSignalType=UINT8
            DET_RANGE_VELOCITY_397_oRDR_DETECTION_397_400_oPCAN_RADAR_cf7a1f9a_Tx: ComSignalType=UINT16
            DET_RANGE_VELOCITY_398_oRDR_DETECTION_397_400_oPCAN_RADAR_e36a8ddd_Tx: ComSignalType=UINT16
            DET_RANGE_VELOCITY_399_oRDR_DETECTION_397_400_oPCAN_RADAR_761a5948_Tx: ComSignalType=UINT16
            DET_RANGE_VELOCITY_400_oRDR_DETECTION_397_400_oPCAN_RADAR_d9c47bbe_Tx: ComSignalType=UINT16
            DET_RANGE_VELOCITY_ERR_397_oRDR_DETECTION_397_400_oPCAN_RADAR_c0c1e428_Tx: ComSignalType=UINT8
            DET_RANGE_VELOCITY_ERR_398_oRDR_DETECTION_397_400_oPCAN_RADAR_ecd1766f_Tx: ComSignalType=UINT8
            DET_RANGE_VELOCITY_ERR_399_oRDR_DETECTION_397_400_oPCAN_RADAR_79a1a2fa_Tx: ComSignalType=UINT8
            DET_RANGE_VELOCITY_ERR_400_oRDR_DETECTION_397_400_oPCAN_RADAR_d67f800c_Tx: ComSignalType=UINT8
            DET_RCS_397_oRDR_DETECTION_397_400_oPCAN_RADAR_48fa28c0_Tx: ComSignalType=UINT8
            DET_RCS_398_oRDR_DETECTION_397_400_oPCAN_RADAR_64eaba87_Tx: ComSignalType=UINT8
            DET_RCS_399_oRDR_DETECTION_397_400_oPCAN_RADAR_f19a6e12_Tx: ComSignalType=UINT8
            DET_RCS_400_oRDR_DETECTION_397_400_oPCAN_RADAR_5e444ce4_Tx: ComSignalType=UINT8
            DET_SNR_397_oRDR_DETECTION_397_400_oPCAN_RADAR_95547cc2_Tx: ComSignalType=UINT8
            DET_SNR_398_oRDR_DETECTION_397_400_oPCAN_RADAR_b944ee85_Tx: ComSignalType=UINT8
            DET_SNR_399_oRDR_DETECTION_397_400_oPCAN_RADAR_2c343a10_Tx: ComSignalType=UINT8
            DET_SNR_400_oRDR_DETECTION_397_400_oPCAN_RADAR_83ea18e6_Tx: ComSignalType=UINT8
            DET_SUPER_RES_TARGET_397_oRDR_DETECTION_397_400_oPCAN_RADAR_a4cd54a7_Tx: ComSignalType=BOOLEAN
            DET_SUPER_RES_TARGET_398_oRDR_DETECTION_397_400_oPCAN_RADAR_88ddc6e0_Tx: ComSignalType=BOOLEAN
            DET_SUPER_RES_TARGET_399_oRDR_DETECTION_397_400_oPCAN_RADAR_1dad1275_Tx: ComSignalType=BOOLEAN
            DET_SUPER_RES_TARGET_400_oRDR_DETECTION_397_400_oPCAN_RADAR_b2733083_Tx: ComSignalType=BOOLEAN
        SG_ETC2_00_oETC2_00_oVCAN_RADAR_efbda90a_Rx
          TransCurrentGear_00_oETC2_00_oVCAN_RADAR_3087ec57_Rx (ComGroupSignal): ComSignalType=UINT8
        SG_ETC2_03_oETC2_03_oVCAN_RADAR_6b0f6884_Rx
          TransCurrentGear_03_oETC2_03_oVCAN_RADAR_b4352dd9_Rx (ComGroupSignal): ComSignalType=UINT8
        SG_Fusion_AlignmentStatus1_oRDR_FUSION_ALIGNMENT_STATUS_001_oPCAN_RADAR_2e5fc362_Rx
          42 x ComGroupSignal:
            AL_STS_001_CYCLE_COUNTER_Rx_oRDR_FUSION_ALIGNMENT_STATUS_001_oPCAN_RADAR_c4e7857e_Rx: ComSignalType=UINT8
            AL_STS_001_MH_CRC16_Rx_oRDR_FUSION_ALIGNMENT_STATUS_001_oPCAN_RADAR_c23d08ad_Rx: ComSignalType=UINT16
            STS_AAAzimuthStd_Rx_oRDR_FUSION_ALIGNMENT_STATUS_001_oPCAN_RADAR_e0014852_Rx: ComSignalType=UINT16
            STS_AACurrentAzimuth_Rx_oRDR_FUSION_ALIGNMENT_STATUS_001_oPCAN_RADAR_3a00fa82_Rx: ComSignalType=UINT16
            STS_AACurrentElevation_Rx_oRDR_FUSION_ALIGNMENT_STATUS_001_oPCAN_RADAR_7298a7ea_Rx: ComSignalType=UINT16
            STS_AACurrentRoll_Rx_oRDR_FUSION_ALIGNMENT_STATUS_001_oPCAN_RADAR_590d7e8e_Rx: ComSignalType=SINT16
            STS_AAElevationStd_Rx_oRDR_FUSION_ALIGNMENT_STATUS_001_oPCAN_RADAR_2f821d5a_Rx: ComSignalType=UINT16
            STS_AARoll_Std_Rx_oRDR_FUSION_ALIGNMENT_STATUS_001_oPCAN_RADAR_c2a8bede_Rx: ComSignalType=UINT16
            STS_AlignmentAutoStatus_Rx_oRDR_FUSION_ALIGNMENT_STATUS_001_oPCAN_RADAR_83b4b0f6_Rx: ComSignalType=UINT8
            STS_AlignmentAzimuth_Rx_oRDR_FUSION_ALIGNMENT_STATUS_001_oPCAN_RADAR_92f72180_Rx: ComSignalType=UINT16
            STS_AlignmentElevation_Rx_oRDR_FUSION_ALIGNMENT_STATUS_001_oPCAN_RADAR_51af66c3_Rx: ComSignalType=UINT16
            STS_AlignmentError_Rx_oRDR_FUSION_ALIGNMENT_STATUS_001_oPCAN_RADAR_c93c23de_Rx: ComSignalType=UINT8
            STS_AlignmentModeIn_Rx_oRDR_FUSION_ALIGNMENT_STATUS_001_oPCAN_RADAR_817bfc0d_Rx: ComSignalType=UINT8
            STS_AlignmentModeOut_Rx_oRDR_FUSION_ALIGNMENT_STATUS_001_oPCAN_RADAR_515d8cc1_Rx: ComSignalType=UINT8
            STS_AutoAlignmentFailRootCause_Rx_oRDR_FUSION_ALIGNMENT_STATUS_001_oPCAN_RADAR_9bc9d16b_Rx: ComSignalType=UINT8
            STS_AzimuthErrorNegative_Rx_oRDR_FUSION_ALIGNMENT_STATUS_001_oPCAN_RADAR_03e79242_Rx: ComSignalType=SINT16
            STS_AzimuthErrorPositive_Rx_oRDR_FUSION_ALIGNMENT_STATUS_001_oPCAN_RADAR_739114ea_Rx: ComSignalType=SINT16
            STS_AzimuthStd_Rx_oRDR_FUSION_ALIGNMENT_STATUS_001_oPCAN_RADAR_3a37c4c6_Rx: ComSignalType=UINT16
            STS_AzimuthUpdates_Rx_oRDR_FUSION_ALIGNMENT_STATUS_001_oPCAN_RADAR_26fb55fe_Rx: ComSignalType=UINT32
            STS_CalDisplay_Rx_oRDR_FUSION_ALIGNMENT_STATUS_001_oPCAN_RADAR_989af3fe_Rx: ComSignalType=BOOLEAN
            STS_CalTime_Rx_oRDR_FUSION_ALIGNMENT_STATUS_001_oPCAN_RADAR_7a04fce5_Rx: ComSignalType=UINT16
            STS_CoordinateSystemInput_Rx_oRDR_FUSION_ALIGNMENT_STATUS_001_oPCAN_RADAR_148acc89_Rx: ComSignalType=UINT8
            STS_ElevationErrorNegative_Rx_oRDR_FUSION_ALIGNMENT_STATUS_001_oPCAN_RADAR_3dc2410e_Rx: ComSignalType=SINT16
            STS_ElevationErrorPositive_Rx_oRDR_FUSION_ALIGNMENT_STATUS_001_oPCAN_RADAR_4db4c7a6_Rx: ComSignalType=SINT16
            STS_ElevationStd_Rx_oRDR_FUSION_ALIGNMENT_STATUS_001_oPCAN_RADAR_dea14779_Rx: ComSignalType=UINT16
            STS_ElevationUpdates_Rx_oRDR_FUSION_ALIGNMENT_STATUS_001_oPCAN_RADAR_00e5a516_Rx: ComSignalType=UINT32
            STS_HostSpdCompensationFactorQF_Rx_oRDR_FUSION_ALIGNMENT_STATUS_001_oPCAN_RADAR_fe70a223_Rx: ComSignalType=UINT8
            STS_HostSpeedCompensationFactor_Rx_oRDR_FUSION_ALIGNMENT_STATUS_001_oPCAN_RADAR_6d203191_Rx: ComSignalType=UINT8
            STS_InitAlignResultAzimuthUpdate_Rx_oRDR_FUSION_ALIGNMENT_STATUS_001_oPCAN_RADAR_cb93d2df_Rx: ComSignalType=UINT16
            STS_InitAlignRsltElevationUpdate_Rx_oRDR_FUSION_ALIGNMENT_STATUS_001_oPCAN_RADAR_a120152f_Rx: ComSignalType=UINT16
            STS_InitAlignRsltHostSpdCompFac_Rx_oRDR_FUSION_ALIGNMENT_STATUS_001_oPCAN_RADAR_9cd6c2f3_Rx: ComSignalType=UINT8
            STS_InitAlignmentResultAzimuth_Rx_oRDR_FUSION_ALIGNMENT_STATUS_001_oPCAN_RADAR_d3cdcc54_Rx: ComSignalType=SINT16
            STS_InitAlignmentResultElevation_Rx_oRDR_FUSION_ALIGNMENT_STATUS_001_oPCAN_RADAR_6a40b927_Rx: ComSignalType=SINT16
            STS_InitLastSuccessfulAlignMode_Rx_oRDR_FUSION_ALIGNMENT_STATUS_001_oPCAN_RADAR_527c92a9_Rx: ComSignalType=UINT8
            STS_ProgressPercent_Rx_oRDR_FUSION_ALIGNMENT_STATUS_001_oPCAN_RADAR_e195d140_Rx: ComSignalType=UINT8
            STS_RadarTypeInput_Rx_oRDR_FUSION_ALIGNMENT_STATUS_001_oPCAN_RADAR_294e7a2f_Rx: ComSignalType=UINT8
            STS_RollErrorNegative_Rx_oRDR_FUSION_ALIGNMENT_STATUS_001_oPCAN_RADAR_fe114bd3_Rx: ComSignalType=SINT16
            STS_RollErrorPositive_Rx_oRDR_FUSION_ALIGNMENT_STATUS_001_oPCAN_RADAR_8e67cd7b_Rx: ComSignalType=SINT16
            STS_Roll_Updates_Rx_oRDR_FUSION_ALIGNMENT_STATUS_001_oPCAN_RADAR_5eac71d0_Rx: ComSignalType=UINT32
            STS_StartAzimuth_Rx_oRDR_FUSION_ALIGNMENT_STATUS_001_oPCAN_RADAR_3b77c56a_Rx: ComSignalType=SINT16
            STS_StartElevation_Rx_oRDR_FUSION_ALIGNMENT_STATUS_001_oPCAN_RADAR_5259f244_Rx: ComSignalType=SINT16
            STS_StartRoll_Rx_oRDR_FUSION_ALIGNMENT_STATUS_001_oPCAN_RADAR_2c0c1bdd_Rx: ComSignalType=SINT16
        SG_Fusion_AlignmentStatus2_oRDR_FUSION_ALIGNMENT_STATUS_002_oPCAN_RADAR_13cf0319_Rx
          19 x ComGroupSignal:
            AL_STS_002_CYCLE_COUNTER_Rx_oRDR_FUSION_ALIGNMENT_STATUS_002_oPCAN_RADAR_88f856d4_Rx: ComSignalType=UINT8
            AL_STS_002_MH_CRC16_Rx_oRDR_FUSION_ALIGNMENT_STATUS_002_oPCAN_RADAR_a0be74d6_Rx: ComSignalType=UINT16
            STS_AlignmentServiceStatus_Rx_oRDR_FUSION_ALIGNMENT_STATUS_002_oPCAN_RADAR_96feaa0c_Rx: ComSignalType=UINT8
            STS_AlignmentShortTrackStatus_Rx_oRDR_FUSION_ALIGNMENT_STATUS_002_oPCAN_RADAR_4b78fe49_Rx: ComSignalType=UINT8
            STS_AlignmentStaticStatus_Rx_oRDR_FUSION_ALIGNMENT_STATUS_002_oPCAN_RADAR_bcc15f29_Rx: ComSignalType=UINT8
            STS_AverageNumberOfDetections_Rx_oRDR_FUSION_ALIGNMENT_STATUS_002_oPCAN_RADAR_87939da8_Rx: ComSignalType=UINT32
            STS_AverageSpeed_Rx_oRDR_FUSION_ALIGNMENT_STATUS_002_oPCAN_RADAR_b3b0e615_Rx: ComSignalType=UINT32
            STS_DistanceAbsolute_Rx_oRDR_FUSION_ALIGNMENT_STATUS_002_oPCAN_RADAR_2fe90afa_Rx: ComSignalType=UINT32
            STS_DistanceEffective_Rx_oRDR_FUSION_ALIGNMENT_STATUS_002_oPCAN_RADAR_5ee1b0ad_Rx: ComSignalType=UINT32
            STS_DurationAbsolute_Rx_oRDR_FUSION_ALIGNMENT_STATUS_002_oPCAN_RADAR_ad18ccaf_Rx: ComSignalType=UINT32
            STS_DurationEffective_Rx_oRDR_FUSION_ALIGNMENT_STATUS_002_oPCAN_RADAR_4562e410_Rx: ComSignalType=UINT32
            STS_ImpactByInterference_Rx_oRDR_FUSION_ALIGNMENT_STATUS_002_oPCAN_RADAR_dbc02f0e_Rx: ComSignalType=BOOLEAN
            STS_MeasuredAmpSTD_Rx_oRDR_FUSION_ALIGNMENT_STATUS_002_oPCAN_RADAR_93fa8c9f_Rx: ComSignalType=UINT16
            STS_MeasuredRangeRateStd_Rx_oRDR_FUSION_ALIGNMENT_STATUS_002_oPCAN_RADAR_7ea372f0_Rx: ComSignalType=SINT16
            STS_MeasuredRangeRate_Rx_oRDR_FUSION_ALIGNMENT_STATUS_002_oPCAN_RADAR_62640a65_Rx: ComSignalType=SINT32
            STS_MeasuredRangeStd_Rx_oRDR_FUSION_ALIGNMENT_STATUS_002_oPCAN_RADAR_79b75936_Rx: ComSignalType=UINT16
            STS_MeasuredRawAmplitude_Rx_oRDR_FUSION_ALIGNMENT_STATUS_002_oPCAN_RADAR_37a2fd07_Rx: ComSignalType=SINT16
            STS_Measured_Range_Rx_oRDR_FUSION_ALIGNMENT_STATUS_002_oPCAN_RADAR_b763ef82_Rx: ComSignalType=UINT16
            STS_VehicleCondition_Rx_oRDR_FUSION_ALIGNMENT_STATUS_002_oPCAN_RADAR_4c9d97f7_Rx: ComSignalType=UINT8
        SG_Fusion_Detections_001_004_oRDR_FUSION_DET_001_004_oPCAN_RADAR_4a788d9f_Rx
          83 x ComGroupSignal:
            DET_AZIMUTH_001_Rx_oRDR_FUSION_DET_001_004_oPCAN_RADAR_5993bb11_Rx: ComSignalType=UINT16
            DET_AZIMUTH_002_Rx_oRDR_FUSION_DET_001_004_oPCAN_RADAR_732f0b99_Rx: ComSignalType=UINT16
            DET_AZIMUTH_003_Rx_oRDR_FUSION_DET_001_004_oPCAN_RADAR_dc6b99de_Rx: ComSignalType=UINT16
            DET_AZIMUTH_004_Rx_oRDR_FUSION_DET_001_004_oPCAN_RADAR_26566a89_Rx: ComSignalType=UINT16
            DET_AZIMUTH_ERR_001_Rx_oRDR_FUSION_DET_001_004_oPCAN_RADAR_5bfa1a93_Rx: ComSignalType=UINT8
            DET_AZIMUTH_ERR_002_Rx_oRDR_FUSION_DET_001_004_oPCAN_RADAR_7146aa1b_Rx: ComSignalType=UINT8
            DET_AZIMUTH_ERR_003_Rx_oRDR_FUSION_DET_001_004_oPCAN_RADAR_de02385c_Rx: ComSignalType=UINT8
            DET_AZIMUTH_ERR_004_Rx_oRDR_FUSION_DET_001_004_oPCAN_RADAR_243fcb0b_Rx: ComSignalType=UINT8
            DET_BELOW_RAIN_THOLD_001_Rx_oRDR_FUSION_DET_001_004_oPCAN_RADAR_3f2944a4_Rx: ComSignalType=BOOLEAN
            DET_BELOW_RAIN_THOLD_002_Rx_oRDR_FUSION_DET_001_004_oPCAN_RADAR_1595f42c_Rx: ComSignalType=BOOLEAN
            DET_BELOW_RAIN_THOLD_003_Rx_oRDR_FUSION_DET_001_004_oPCAN_RADAR_bad1666b_Rx: ComSignalType=BOOLEAN
            DET_BELOW_RAIN_THOLD_004_Rx_oRDR_FUSION_DET_001_004_oPCAN_RADAR_40ec953c_Rx: ComSignalType=BOOLEAN
            DET_BI_STATIC_FLAG_001_Rx_oRDR_FUSION_DET_001_004_oPCAN_RADAR_48b7efb7_Rx: ComSignalType=BOOLEAN
            DET_BI_STATIC_FLAG_002_Rx_oRDR_FUSION_DET_001_004_oPCAN_RADAR_620b5f3f_Rx: ComSignalType=BOOLEAN
            DET_BI_STATIC_FLAG_003_Rx_oRDR_FUSION_DET_001_004_oPCAN_RADAR_cd4fcd78_Rx: ComSignalType=BOOLEAN
            DET_BI_STATIC_FLAG_004_Rx_oRDR_FUSION_DET_001_004_oPCAN_RADAR_37723e2f_Rx: ComSignalType=BOOLEAN
            DET_CONFD_AZIMUTH_001_Rx_oRDR_FUSION_DET_001_004_oPCAN_RADAR_abde05e3_Rx: ComSignalType=UINT8
            DET_CONFD_AZIMUTH_002_Rx_oRDR_FUSION_DET_001_004_oPCAN_RADAR_8162b56b_Rx: ComSignalType=UINT8
            DET_CONFD_AZIMUTH_003_Rx_oRDR_FUSION_DET_001_004_oPCAN_RADAR_2e26272c_Rx: ComSignalType=UINT8
            DET_CONFD_AZIMUTH_004_Rx_oRDR_FUSION_DET_001_004_oPCAN_RADAR_d41bd47b_Rx: ComSignalType=UINT8
            DET_CONFD_ELEVATION_001_Rx_oRDR_FUSION_DET_001_004_oPCAN_RADAR_a1ff8664_Rx: ComSignalType=UINT8
            DET_CONFD_ELEVATION_002_Rx_oRDR_FUSION_DET_001_004_oPCAN_RADAR_8b4336ec_Rx: ComSignalType=UINT8
            DET_CONFD_ELEVATION_003_Rx_oRDR_FUSION_DET_001_004_oPCAN_RADAR_2407a4ab_Rx: ComSignalType=UINT8
            DET_CONFD_ELEVATION_004_Rx_oRDR_FUSION_DET_001_004_oPCAN_RADAR_de3a57fc_Rx: ComSignalType=UINT8
            DET_ELEVATION_001_Rx_oRDR_FUSION_DET_001_004_oPCAN_RADAR_abac699d_Rx: ComSignalType=UINT8
            DET_ELEVATION_002_Rx_oRDR_FUSION_DET_001_004_oPCAN_RADAR_8110d915_Rx: ComSignalType=UINT8
            DET_ELEVATION_003_Rx_oRDR_FUSION_DET_001_004_oPCAN_RADAR_2e544b52_Rx: ComSignalType=UINT8
            DET_ELEVATION_004_Rx_oRDR_FUSION_DET_001_004_oPCAN_RADAR_d469b805_Rx: ComSignalType=UINT8
            DET_ELEVATION_ERR_001_Rx_oRDR_FUSION_DET_001_004_oPCAN_RADAR_79154b42_Rx: ComSignalType=UINT8
            DET_ELEVATION_ERR_002_Rx_oRDR_FUSION_DET_001_004_oPCAN_RADAR_53a9fbca_Rx: ComSignalType=UINT8
            DET_ELEVATION_ERR_003_Rx_oRDR_FUSION_DET_001_004_oPCAN_RADAR_fced698d_Rx: ComSignalType=UINT8
            DET_ELEVATION_ERR_004_Rx_oRDR_FUSION_DET_001_004_oPCAN_RADAR_06d09ada_Rx: ComSignalType=UINT8
            DET_EXISTENCE_PROB_001_Rx_oRDR_FUSION_DET_001_004_oPCAN_RADAR_8e0d33d7_Rx: ComSignalType=UINT8
            DET_EXISTENCE_PROB_002_Rx_oRDR_FUSION_DET_001_004_oPCAN_RADAR_a4b1835f_Rx: ComSignalType=UINT8
            DET_EXISTENCE_PROB_003_Rx_oRDR_FUSION_DET_001_004_oPCAN_RADAR_0bf51118_Rx: ComSignalType=UINT8
            DET_EXISTENCE_PROB_004_Rx_oRDR_FUSION_DET_001_004_oPCAN_RADAR_f1c8e24f_Rx: ComSignalType=UINT8
            DET_HVC_FLAG_001_Rx_oRDR_FUSION_DET_001_004_oPCAN_RADAR_53d3de98_Rx: ComSignalType=BOOLEAN
            DET_HVC_FLAG_002_Rx_oRDR_FUSION_DET_001_004_oPCAN_RADAR_796f6e10_Rx: ComSignalType=BOOLEAN
            DET_HVC_FLAG_003_Rx_oRDR_FUSION_DET_001_004_oPCAN_RADAR_d62bfc57_Rx: ComSignalType=BOOLEAN
            DET_HVC_FLAG_004_Rx_oRDR_FUSION_DET_001_004_oPCAN_RADAR_2c160f00_Rx: ComSignalType=BOOLEAN
            DET_IDM_001_Rx_oRDR_FUSION_DET_001_004_oPCAN_RADAR_661227d0_Rx: ComSignalType=BOOLEAN
            DET_IDM_002_Rx_oRDR_FUSION_DET_001_004_oPCAN_RADAR_4cae9758_Rx: ComSignalType=BOOLEAN
            DET_IDM_003_Rx_oRDR_FUSION_DET_001_004_oPCAN_RADAR_e3ea051f_Rx: ComSignalType=BOOLEAN
            DET_IDM_004_Rx_oRDR_FUSION_DET_001_004_oPCAN_RADAR_19d7f648_Rx: ComSignalType=BOOLEAN
            DET_MH_CRC16_001_004_Rx_oRDR_FUSION_DET_001_004_oPCAN_RADAR_7ff0d781_Rx: ComSignalType=UINT16
            DET_MH_CYCLE_COUNTER_001_004_Rx_oRDR_FUSION_DET_001_004_oPCAN_RADAR_722bea44_Rx: ComSignalType=UINT8
            DET_MH_SCAN_INDEX_4LSB_001_004_Rx_oRDR_FUSION_DET_001_004_oPCAN_RADAR_169b257f_Rx: ComSignalType=UINT8
            DET_MTD_001_Rx_oRDR_FUSION_DET_001_004_oPCAN_RADAR_db9111a0_Rx: ComSignalType=BOOLEAN
            DET_MTD_002_Rx_oRDR_FUSION_DET_001_004_oPCAN_RADAR_f12da128_Rx: ComSignalType=BOOLEAN
            DET_MTD_003_Rx_oRDR_FUSION_DET_001_004_oPCAN_RADAR_5e69336f_Rx: ComSignalType=BOOLEAN
            DET_MTD_004_Rx_oRDR_FUSION_DET_001_004_oPCAN_RADAR_a454c038_Rx: ComSignalType=BOOLEAN
            DET_PROB_1STAZHYPO_001_Rx_oRDR_FUSION_DET_001_004_oPCAN_RADAR_11e80f21_Rx: ComSignalType=BOOLEAN
            DET_PROB_1STAZHYPO_002_Rx_oRDR_FUSION_DET_001_004_oPCAN_RADAR_3b54bfa9_Rx: ComSignalType=BOOLEAN
            DET_PROB_1STAZHYPO_003_Rx_oRDR_FUSION_DET_001_004_oPCAN_RADAR_94102dee_Rx: ComSignalType=BOOLEAN
            DET_PROB_1STAZHYPO_004_Rx_oRDR_FUSION_DET_001_004_oPCAN_RADAR_6e2ddeb9_Rx: ComSignalType=BOOLEAN
            DET_RANGE_001_Rx_oRDR_FUSION_DET_001_004_oPCAN_RADAR_4a55e736_Rx: ComSignalType=UINT16
            DET_RANGE_002_Rx_oRDR_FUSION_DET_001_004_oPCAN_RADAR_60e957be_Rx: ComSignalType=UINT16
            DET_RANGE_003_Rx_oRDR_FUSION_DET_001_004_oPCAN_RADAR_cfadc5f9_Rx: ComSignalType=UINT16
            DET_RANGE_004_Rx_oRDR_FUSION_DET_001_004_oPCAN_RADAR_359036ae_Rx: ComSignalType=UINT16
            DET_RANGE_ERR_001_Rx_oRDR_FUSION_DET_001_004_oPCAN_RADAR_1aa76bd6_Rx: ComSignalType=UINT8
            DET_RANGE_ERR_002_Rx_oRDR_FUSION_DET_001_004_oPCAN_RADAR_301bdb5e_Rx: ComSignalType=UINT8
            DET_RANGE_ERR_003_Rx_oRDR_FUSION_DET_001_004_oPCAN_RADAR_9f5f4919_Rx: ComSignalType=UINT8
            DET_RANGE_ERR_004_Rx_oRDR_FUSION_DET_001_004_oPCAN_RADAR_6562ba4e_Rx: ComSignalType=UINT8
            DET_RANGE_VELOCITY_001_Rx_oRDR_FUSION_DET_001_004_oPCAN_RADAR_97a064c8_Rx: ComSignalType=UINT16
            DET_RANGE_VELOCITY_002_Rx_oRDR_FUSION_DET_001_004_oPCAN_RADAR_bd1cd440_Rx: ComSignalType=UINT16
            DET_RANGE_VELOCITY_003_Rx_oRDR_FUSION_DET_001_004_oPCAN_RADAR_12584607_Rx: ComSignalType=UINT16
            DET_RANGE_VELOCITY_004_Rx_oRDR_FUSION_DET_001_004_oPCAN_RADAR_e865b550_Rx: ComSignalType=UINT16
            DET_RANGE_VELOCITY_ERR_001_Rx_oRDR_FUSION_DET_001_004_oPCAN_RADAR_0ec4140a_Rx: ComSignalType=UINT8
            DET_RANGE_VELOCITY_ERR_002_Rx_oRDR_FUSION_DET_001_004_oPCAN_RADAR_2478a482_Rx: ComSignalType=UINT8
            DET_RANGE_VELOCITY_ERR_003_Rx_oRDR_FUSION_DET_001_004_oPCAN_RADAR_8b3c36c5_Rx: ComSignalType=UINT8
            DET_RANGE_VELOCITY_ERR_004_Rx_oRDR_FUSION_DET_001_004_oPCAN_RADAR_7101c592_Rx: ComSignalType=UINT8
            DET_RCS_001_Rx_oRDR_FUSION_DET_001_004_oPCAN_RADAR_5a6bf6d3_Rx: ComSignalType=UINT8
            DET_RCS_002_Rx_oRDR_FUSION_DET_001_004_oPCAN_RADAR_70d7465b_Rx: ComSignalType=UINT8
            DET_RCS_003_Rx_oRDR_FUSION_DET_001_004_oPCAN_RADAR_df93d41c_Rx: ComSignalType=UINT8
            DET_RCS_004_Rx_oRDR_FUSION_DET_001_004_oPCAN_RADAR_25ae274b_Rx: ComSignalType=UINT8
            DET_SNR_001_Rx_oRDR_FUSION_DET_001_004_oPCAN_RADAR_5331873a_Rx: ComSignalType=UINT8
            DET_SNR_002_Rx_oRDR_FUSION_DET_001_004_oPCAN_RADAR_798d37b2_Rx: ComSignalType=UINT8
            DET_SNR_003_Rx_oRDR_FUSION_DET_001_004_oPCAN_RADAR_d6c9a5f5_Rx: ComSignalType=UINT8
            DET_SNR_004_Rx_oRDR_FUSION_DET_001_004_oPCAN_RADAR_2cf456a2_Rx: ComSignalType=UINT8
            DET_SUPER_RES_TARGET_001_Rx_oRDR_FUSION_DET_001_004_oPCAN_RADAR_98caa63a_Rx: ComSignalType=BOOLEAN
            DET_SUPER_RES_TARGET_002_Rx_oRDR_FUSION_DET_001_004_oPCAN_RADAR_b27616b2_Rx: ComSignalType=BOOLEAN
            DET_SUPER_RES_TARGET_003_Rx_oRDR_FUSION_DET_001_004_oPCAN_RADAR_1d3284f5_Rx: ComSignalType=BOOLEAN
            DET_SUPER_RES_TARGET_004_Rx_oRDR_FUSION_DET_001_004_oPCAN_RADAR_e70f77a2_Rx: ComSignalType=BOOLEAN
        SG_Fusion_Detections_005_008_oRDR_FUSION_DET_005_008_oPCAN_RADAR_0783a66c_Rx
          83 x ComGroupSignal:
            DET_AZIMUTH_005_Rx_oRDR_FUSION_DET_005_008_oPCAN_RADAR_60a066fa_Rx: ComSignalType=UINT16
            DET_AZIMUTH_006_Rx_oRDR_FUSION_DET_005_008_oPCAN_RADAR_4a1cd672_Rx: ComSignalType=UINT16
            DET_AZIMUTH_007_Rx_oRDR_FUSION_DET_005_008_oPCAN_RADAR_e5584435_Rx: ComSignalType=UINT16
            DET_AZIMUTH_008_Rx_oRDR_FUSION_DET_005_008_oPCAN_RADAR_6516369d_Rx: ComSignalType=UINT16
            DET_AZIMUTH_ERR_005_Rx_oRDR_FUSION_DET_005_008_oPCAN_RADAR_62c9c778_Rx: ComSignalType=UINT8
            DET_AZIMUTH_ERR_006_Rx_oRDR_FUSION_DET_005_008_oPCAN_RADAR_487577f0_Rx: ComSignalType=UINT8
            DET_AZIMUTH_ERR_007_Rx_oRDR_FUSION_DET_005_008_oPCAN_RADAR_e731e5b7_Rx: ComSignalType=UINT8
            DET_AZIMUTH_ERR_008_Rx_oRDR_FUSION_DET_005_008_oPCAN_RADAR_677f971f_Rx: ComSignalType=UINT8
            DET_BELOW_RAIN_THOLD_005_Rx_oRDR_FUSION_DET_005_008_oPCAN_RADAR_061a994f_Rx: ComSignalType=BOOLEAN
            DET_BELOW_RAIN_THOLD_006_Rx_oRDR_FUSION_DET_005_008_oPCAN_RADAR_2ca629c7_Rx: ComSignalType=BOOLEAN
            DET_BELOW_RAIN_THOLD_007_Rx_oRDR_FUSION_DET_005_008_oPCAN_RADAR_83e2bb80_Rx: ComSignalType=BOOLEAN
            DET_BELOW_RAIN_THOLD_008_Rx_oRDR_FUSION_DET_005_008_oPCAN_RADAR_03acc928_Rx: ComSignalType=BOOLEAN
            DET_BI_STATIC_FLAG_005_Rx_oRDR_FUSION_DET_005_008_oPCAN_RADAR_7184325c_Rx: ComSignalType=BOOLEAN
            DET_BI_STATIC_FLAG_006_Rx_oRDR_FUSION_DET_005_008_oPCAN_RADAR_5b3882d4_Rx: ComSignalType=BOOLEAN
            DET_BI_STATIC_FLAG_007_Rx_oRDR_FUSION_DET_005_008_oPCAN_RADAR_f47c1093_Rx: ComSignalType=BOOLEAN
            DET_BI_STATIC_FLAG_008_Rx_oRDR_FUSION_DET_005_008_oPCAN_RADAR_7432623b_Rx: ComSignalType=BOOLEAN
            DET_CONFD_AZIMUTH_005_Rx_oRDR_FUSION_DET_005_008_oPCAN_RADAR_92edd808_Rx: ComSignalType=UINT8
            DET_CONFD_AZIMUTH_006_Rx_oRDR_FUSION_DET_005_008_oPCAN_RADAR_b8516880_Rx: ComSignalType=UINT8
            DET_CONFD_AZIMUTH_007_Rx_oRDR_FUSION_DET_005_008_oPCAN_RADAR_1715fac7_Rx: ComSignalType=UINT8
            DET_CONFD_AZIMUTH_008_Rx_oRDR_FUSION_DET_005_008_oPCAN_RADAR_975b886f_Rx: ComSignalType=UINT8
            DET_CONFD_ELEVATION_005_Rx_oRDR_FUSION_DET_005_008_oPCAN_RADAR_98cc5b8f_Rx: ComSignalType=UINT8
            DET_CONFD_ELEVATION_006_Rx_oRDR_FUSION_DET_005_008_oPCAN_RADAR_b270eb07_Rx: ComSignalType=UINT8
            DET_CONFD_ELEVATION_007_Rx_oRDR_FUSION_DET_005_008_oPCAN_RADAR_1d347940_Rx: ComSignalType=UINT8
            DET_CONFD_ELEVATION_008_Rx_oRDR_FUSION_DET_005_008_oPCAN_RADAR_9d7a0be8_Rx: ComSignalType=UINT8
            DET_ELEVATION_005_Rx_oRDR_FUSION_DET_005_008_oPCAN_RADAR_929fb476_Rx: ComSignalType=UINT8
            DET_ELEVATION_006_Rx_oRDR_FUSION_DET_005_008_oPCAN_RADAR_b82304fe_Rx: ComSignalType=UINT8
            DET_ELEVATION_007_Rx_oRDR_FUSION_DET_005_008_oPCAN_RADAR_176796b9_Rx: ComSignalType=UINT8
            DET_ELEVATION_008_Rx_oRDR_FUSION_DET_005_008_oPCAN_RADAR_9729e411_Rx: ComSignalType=UINT8
            DET_ELEVATION_ERR_005_Rx_oRDR_FUSION_DET_005_008_oPCAN_RADAR_402696a9_Rx: ComSignalType=UINT8
            DET_ELEVATION_ERR_006_Rx_oRDR_FUSION_DET_005_008_oPCAN_RADAR_6a9a2621_Rx: ComSignalType=UINT8
            DET_ELEVATION_ERR_007_Rx_oRDR_FUSION_DET_005_008_oPCAN_RADAR_c5deb466_Rx: ComSignalType=UINT8
            DET_ELEVATION_ERR_008_Rx_oRDR_FUSION_DET_005_008_oPCAN_RADAR_4590c6ce_Rx: ComSignalType=UINT8
            DET_EXISTENCE_PROB_005_Rx_oRDR_FUSION_DET_005_008_oPCAN_RADAR_b73eee3c_Rx: ComSignalType=UINT8
            DET_EXISTENCE_PROB_006_Rx_oRDR_FUSION_DET_005_008_oPCAN_RADAR_9d825eb4_Rx: ComSignalType=UINT8
            DET_EXISTENCE_PROB_007_Rx_oRDR_FUSION_DET_005_008_oPCAN_RADAR_32c6ccf3_Rx: ComSignalType=UINT8
            DET_EXISTENCE_PROB_008_Rx_oRDR_FUSION_DET_005_008_oPCAN_RADAR_b288be5b_Rx: ComSignalType=UINT8
            DET_HVC_FLAG_005_Rx_oRDR_FUSION_DET_005_008_oPCAN_RADAR_6ae00373_Rx: ComSignalType=BOOLEAN
            DET_HVC_FLAG_006_Rx_oRDR_FUSION_DET_005_008_oPCAN_RADAR_405cb3fb_Rx: ComSignalType=BOOLEAN
            DET_HVC_FLAG_007_Rx_oRDR_FUSION_DET_005_008_oPCAN_RADAR_ef1821bc_Rx: ComSignalType=BOOLEAN
            DET_HVC_FLAG_008_Rx_oRDR_FUSION_DET_005_008_oPCAN_RADAR_6f565314_Rx: ComSignalType=BOOLEAN
            DET_IDM_005_Rx_oRDR_FUSION_DET_005_008_oPCAN_RADAR_5f21fa3b_Rx: ComSignalType=BOOLEAN
            DET_IDM_006_Rx_oRDR_FUSION_DET_005_008_oPCAN_RADAR_759d4ab3_Rx: ComSignalType=BOOLEAN
            DET_IDM_007_Rx_oRDR_FUSION_DET_005_008_oPCAN_RADAR_dad9d8f4_Rx: ComSignalType=BOOLEAN
            DET_IDM_008_Rx_oRDR_FUSION_DET_005_008_oPCAN_RADAR_5a97aa5c_Rx: ComSignalType=BOOLEAN
            DET_MH_CRC16_005_008_Rx_oRDR_FUSION_DET_005_008_oPCAN_RADAR_94106a1d_Rx: ComSignalType=UINT16
            DET_MH_CYCLE_COUNTER_005_008_Rx_oRDR_FUSION_DET_005_008_oPCAN_RADAR_99cb57d8_Rx: ComSignalType=UINT8
            DET_MH_SCAN_INDEX_4LSB_005_008_Rx_oRDR_FUSION_DET_005_008_oPCAN_RADAR_fd7b98e3_Rx: ComSignalType=UINT8
            DET_MTD_005_Rx_oRDR_FUSION_DET_005_008_oPCAN_RADAR_e2a2cc4b_Rx: ComSignalType=BOOLEAN
            DET_MTD_006_Rx_oRDR_FUSION_DET_005_008_oPCAN_RADAR_c81e7cc3_Rx: ComSignalType=BOOLEAN
            DET_MTD_007_Rx_oRDR_FUSION_DET_005_008_oPCAN_RADAR_675aee84_Rx: ComSignalType=BOOLEAN
            DET_MTD_008_Rx_oRDR_FUSION_DET_005_008_oPCAN_RADAR_e7149c2c_Rx: ComSignalType=BOOLEAN
            DET_PROB_1STAZHYPO_005_Rx_oRDR_FUSION_DET_005_008_oPCAN_RADAR_28dbd2ca_Rx: ComSignalType=BOOLEAN
            DET_PROB_1STAZHYPO_006_Rx_oRDR_FUSION_DET_005_008_oPCAN_RADAR_02676242_Rx: ComSignalType=BOOLEAN
            DET_PROB_1STAZHYPO_007_Rx_oRDR_FUSION_DET_005_008_oPCAN_RADAR_ad23f005_Rx: ComSignalType=BOOLEAN
            DET_PROB_1STAZHYPO_008_Rx_oRDR_FUSION_DET_005_008_oPCAN_RADAR_2d6d82ad_Rx: ComSignalType=BOOLEAN
            DET_RANGE_005_Rx_oRDR_FUSION_DET_005_008_oPCAN_RADAR_73663add_Rx: ComSignalType=UINT16
            DET_RANGE_006_Rx_oRDR_FUSION_DET_005_008_oPCAN_RADAR_59da8a55_Rx: ComSignalType=UINT16
            DET_RANGE_007_Rx_oRDR_FUSION_DET_005_008_oPCAN_RADAR_f69e1812_Rx: ComSignalType=UINT16
            DET_RANGE_008_Rx_oRDR_FUSION_DET_005_008_oPCAN_RADAR_76d06aba_Rx: ComSignalType=UINT16
            DET_RANGE_ERR_005_Rx_oRDR_FUSION_DET_005_008_oPCAN_RADAR_2394b63d_Rx: ComSignalType=UINT8
            DET_RANGE_ERR_006_Rx_oRDR_FUSION_DET_005_008_oPCAN_RADAR_092806b5_Rx: ComSignalType=UINT8
            DET_RANGE_ERR_007_Rx_oRDR_FUSION_DET_005_008_oPCAN_RADAR_a66c94f2_Rx: ComSignalType=UINT8
            DET_RANGE_ERR_008_Rx_oRDR_FUSION_DET_005_008_oPCAN_RADAR_2622e65a_Rx: ComSignalType=UINT8
            DET_RANGE_VELOCITY_005_Rx_oRDR_FUSION_DET_005_008_oPCAN_RADAR_ae93b923_Rx: ComSignalType=UINT16
            DET_RANGE_VELOCITY_006_Rx_oRDR_FUSION_DET_005_008_oPCAN_RADAR_842f09ab_Rx: ComSignalType=UINT16
            DET_RANGE_VELOCITY_007_Rx_oRDR_FUSION_DET_005_008_oPCAN_RADAR_2b6b9bec_Rx: ComSignalType=UINT16
            DET_RANGE_VELOCITY_008_Rx_oRDR_FUSION_DET_005_008_oPCAN_RADAR_ab25e944_Rx: ComSignalType=UINT16
            DET_RANGE_VELOCITY_ERR_005_Rx_oRDR_FUSION_DET_005_008_oPCAN_RADAR_37f7c9e1_Rx: ComSignalType=UINT8
            DET_RANGE_VELOCITY_ERR_006_Rx_oRDR_FUSION_DET_005_008_oPCAN_RADAR_1d4b7969_Rx: ComSignalType=UINT8
            DET_RANGE_VELOCITY_ERR_007_Rx_oRDR_FUSION_DET_005_008_oPCAN_RADAR_b20feb2e_Rx: ComSignalType=UINT8
            DET_RANGE_VELOCITY_ERR_008_Rx_oRDR_FUSION_DET_005_008_oPCAN_RADAR_32419986_Rx: ComSignalType=UINT8
            DET_RCS_005_Rx_oRDR_FUSION_DET_005_008_oPCAN_RADAR_63582b38_Rx: ComSignalType=UINT8
            DET_RCS_006_Rx_oRDR_FUSION_DET_005_008_oPCAN_RADAR_49e49bb0_Rx: ComSignalType=UINT8
            DET_RCS_007_Rx_oRDR_FUSION_DET_005_008_oPCAN_RADAR_e6a009f7_Rx: ComSignalType=UINT8
            DET_RCS_008_Rx_oRDR_FUSION_DET_005_008_oPCAN_RADAR_66ee7b5f_Rx: ComSignalType=UINT8
            DET_SNR_005_Rx_oRDR_FUSION_DET_005_008_oPCAN_RADAR_6a025ad1_Rx: ComSignalType=UINT8
            DET_SNR_006_Rx_oRDR_FUSION_DET_005_008_oPCAN_RADAR_40beea59_Rx: ComSignalType=UINT8
            DET_SNR_007_Rx_oRDR_FUSION_DET_005_008_oPCAN_RADAR_effa781e_Rx: ComSignalType=UINT8
            DET_SNR_008_Rx_oRDR_FUSION_DET_005_008_oPCAN_RADAR_6fb40ab6_Rx: ComSignalType=UINT8
            DET_SUPER_RES_TARGET_005_Rx_oRDR_FUSION_DET_005_008_oPCAN_RADAR_a1f97bd1_Rx: ComSignalType=BOOLEAN
            DET_SUPER_RES_TARGET_006_Rx_oRDR_FUSION_DET_005_008_oPCAN_RADAR_8b45cb59_Rx: ComSignalType=BOOLEAN
            DET_SUPER_RES_TARGET_007_Rx_oRDR_FUSION_DET_005_008_oPCAN_RADAR_2401591e_Rx: ComSignalType=BOOLEAN
            DET_SUPER_RES_TARGET_008_Rx_oRDR_FUSION_DET_005_008_oPCAN_RADAR_a44f2bb6_Rx: ComSignalType=BOOLEAN
        SG_Fusion_Detections_009_012_oRDR_FUSION_DET_009_012_oPCAN_RADAR_85b0e384_Rx
          83 x ComGroupSignal:
            DET_AZIMUTH_009_Rx_oRDR_FUSION_DET_009_012_oPCAN_RADAR_f81a4bdb_Rx: ComSignalType=UINT16
            DET_AZIMUTH_010_Rx_oRDR_FUSION_DET_009_012_oPCAN_RADAR_c53ac8c2_Rx: ComSignalType=UINT16
            DET_AZIMUTH_011_Rx_oRDR_FUSION_DET_009_012_oPCAN_RADAR_6a7e5a85_Rx: ComSignalType=UINT16
            DET_AZIMUTH_012_Rx_oRDR_FUSION_DET_009_012_oPCAN_RADAR_40c2ea0d_Rx: ComSignalType=UINT16
            DET_AZIMUTH_ERR_009_Rx_oRDR_FUSION_DET_009_012_oPCAN_RADAR_fa73ea59_Rx: ComSignalType=UINT8
            DET_AZIMUTH_ERR_010_Rx_oRDR_FUSION_DET_009_012_oPCAN_RADAR_c7536940_Rx: ComSignalType=UINT8
            DET_AZIMUTH_ERR_011_Rx_oRDR_FUSION_DET_009_012_oPCAN_RADAR_6817fb07_Rx: ComSignalType=UINT8
            DET_AZIMUTH_ERR_012_Rx_oRDR_FUSION_DET_009_012_oPCAN_RADAR_42ab4b8f_Rx: ComSignalType=UINT8
            DET_BELOW_RAIN_THOLD_009_Rx_oRDR_FUSION_DET_009_012_oPCAN_RADAR_9ea0b46e_Rx: ComSignalType=BOOLEAN
            DET_BELOW_RAIN_THOLD_010_Rx_oRDR_FUSION_DET_009_012_oPCAN_RADAR_a3803777_Rx: ComSignalType=BOOLEAN
            DET_BELOW_RAIN_THOLD_011_Rx_oRDR_FUSION_DET_009_012_oPCAN_RADAR_0cc4a530_Rx: ComSignalType=BOOLEAN
            DET_BELOW_RAIN_THOLD_012_Rx_oRDR_FUSION_DET_009_012_oPCAN_RADAR_267815b8_Rx: ComSignalType=BOOLEAN
            DET_BI_STATIC_FLAG_009_Rx_oRDR_FUSION_DET_009_012_oPCAN_RADAR_e93e1f7d_Rx: ComSignalType=BOOLEAN
            DET_BI_STATIC_FLAG_010_Rx_oRDR_FUSION_DET_009_012_oPCAN_RADAR_d41e9c64_Rx: ComSignalType=BOOLEAN
            DET_BI_STATIC_FLAG_011_Rx_oRDR_FUSION_DET_009_012_oPCAN_RADAR_7b5a0e23_Rx: ComSignalType=BOOLEAN
            DET_BI_STATIC_FLAG_012_Rx_oRDR_FUSION_DET_009_012_oPCAN_RADAR_51e6beab_Rx: ComSignalType=BOOLEAN
            DET_CONFD_AZIMUTH_009_Rx_oRDR_FUSION_DET_009_012_oPCAN_RADAR_0a57f529_Rx: ComSignalType=UINT8
            DET_CONFD_AZIMUTH_010_Rx_oRDR_FUSION_DET_009_012_oPCAN_RADAR_37777630_Rx: ComSignalType=UINT8
            DET_CONFD_AZIMUTH_011_Rx_oRDR_FUSION_DET_009_012_oPCAN_RADAR_9833e477_Rx: ComSignalType=UINT8
            DET_CONFD_AZIMUTH_012_Rx_oRDR_FUSION_DET_009_012_oPCAN_RADAR_b28f54ff_Rx: ComSignalType=UINT8
            DET_CONFD_ELEVATION_009_Rx_oRDR_FUSION_DET_009_012_oPCAN_RADAR_007676ae_Rx: ComSignalType=UINT8
            DET_CONFD_ELEVATION_010_Rx_oRDR_FUSION_DET_009_012_oPCAN_RADAR_3d56f5b7_Rx: ComSignalType=UINT8
            DET_CONFD_ELEVATION_011_Rx_oRDR_FUSION_DET_009_012_oPCAN_RADAR_921267f0_Rx: ComSignalType=UINT8
            DET_CONFD_ELEVATION_012_Rx_oRDR_FUSION_DET_009_012_oPCAN_RADAR_b8aed778_Rx: ComSignalType=UINT8
            DET_ELEVATION_009_Rx_oRDR_FUSION_DET_009_012_oPCAN_RADAR_0a259957_Rx: ComSignalType=UINT8
            DET_ELEVATION_010_Rx_oRDR_FUSION_DET_009_012_oPCAN_RADAR_37051a4e_Rx: ComSignalType=UINT8
            DET_ELEVATION_011_Rx_oRDR_FUSION_DET_009_012_oPCAN_RADAR_98418809_Rx: ComSignalType=UINT8
            DET_ELEVATION_012_Rx_oRDR_FUSION_DET_009_012_oPCAN_RADAR_b2fd3881_Rx: ComSignalType=UINT8
            DET_ELEVATION_ERR_009_Rx_oRDR_FUSION_DET_009_012_oPCAN_RADAR_d89cbb88_Rx: ComSignalType=UINT8
            DET_ELEVATION_ERR_010_Rx_oRDR_FUSION_DET_009_012_oPCAN_RADAR_e5bc3891_Rx: ComSignalType=UINT8
            DET_ELEVATION_ERR_011_Rx_oRDR_FUSION_DET_009_012_oPCAN_RADAR_4af8aad6_Rx: ComSignalType=UINT8
            DET_ELEVATION_ERR_012_Rx_oRDR_FUSION_DET_009_012_oPCAN_RADAR_60441a5e_Rx: ComSignalType=UINT8
            DET_EXISTENCE_PROB_009_Rx_oRDR_FUSION_DET_009_012_oPCAN_RADAR_2f84c31d_Rx: ComSignalType=UINT8
            DET_EXISTENCE_PROB_010_Rx_oRDR_FUSION_DET_009_012_oPCAN_RADAR_12a44004_Rx: ComSignalType=UINT8
            DET_EXISTENCE_PROB_011_Rx_oRDR_FUSION_DET_009_012_oPCAN_RADAR_bde0d243_Rx: ComSignalType=UINT8
            DET_EXISTENCE_PROB_012_Rx_oRDR_FUSION_DET_009_012_oPCAN_RADAR_975c62cb_Rx: ComSignalType=UINT8
            DET_HVC_FLAG_009_Rx_oRDR_FUSION_DET_009_012_oPCAN_RADAR_f25a2e52_Rx: ComSignalType=BOOLEAN
            DET_HVC_FLAG_010_Rx_oRDR_FUSION_DET_009_012_oPCAN_RADAR_cf7aad4b_Rx: ComSignalType=BOOLEAN
            DET_HVC_FLAG_011_Rx_oRDR_FUSION_DET_009_012_oPCAN_RADAR_603e3f0c_Rx: ComSignalType=BOOLEAN
            DET_HVC_FLAG_012_Rx_oRDR_FUSION_DET_009_012_oPCAN_RADAR_4a828f84_Rx: ComSignalType=BOOLEAN
            DET_IDM_009_Rx_oRDR_FUSION_DET_009_012_oPCAN_RADAR_c79bd71a_Rx: ComSignalType=BOOLEAN
            DET_IDM_010_Rx_oRDR_FUSION_DET_009_012_oPCAN_RADAR_fabb5403_Rx: ComSignalType=BOOLEAN
            DET_IDM_011_Rx_oRDR_FUSION_DET_009_012_oPCAN_RADAR_55ffc644_Rx: ComSignalType=BOOLEAN
            DET_IDM_012_Rx_oRDR_FUSION_DET_009_012_oPCAN_RADAR_7f4376cc_Rx: ComSignalType=BOOLEAN
            DET_MH_CRC16_009_012_Rx_oRDR_FUSION_DET_009_012_oPCAN_RADAR_93549254_Rx: ComSignalType=UINT16
            DET_MH_CYCLE_COUNTER_009_012_Rx_oRDR_FUSION_DET_009_012_oPCAN_RADAR_9e8faf91_Rx: ComSignalType=UINT8
            DET_MH_SCAN_INDEX_4LSB_009_012_Rx_oRDR_FUSION_DET_009_012_oPCAN_RADAR_fa3f60aa_Rx: ComSignalType=UINT8
            DET_MTD_009_Rx_oRDR_FUSION_DET_009_012_oPCAN_RADAR_7a18e16a_Rx: ComSignalType=BOOLEAN
            DET_MTD_010_Rx_oRDR_FUSION_DET_009_012_oPCAN_RADAR_47386273_Rx: ComSignalType=BOOLEAN
            DET_MTD_011_Rx_oRDR_FUSION_DET_009_012_oPCAN_RADAR_e87cf034_Rx: ComSignalType=BOOLEAN
            DET_MTD_012_Rx_oRDR_FUSION_DET_009_012_oPCAN_RADAR_c2c040bc_Rx: ComSignalType=BOOLEAN
            DET_PROB_1STAZHYPO_009_Rx_oRDR_FUSION_DET_009_012_oPCAN_RADAR_b061ffeb_Rx: ComSignalType=BOOLEAN
            DET_PROB_1STAZHYPO_010_Rx_oRDR_FUSION_DET_009_012_oPCAN_RADAR_8d417cf2_Rx: ComSignalType=BOOLEAN
            DET_PROB_1STAZHYPO_011_Rx_oRDR_FUSION_DET_009_012_oPCAN_RADAR_2205eeb5_Rx: ComSignalType=BOOLEAN
            DET_PROB_1STAZHYPO_012_Rx_oRDR_FUSION_DET_009_012_oPCAN_RADAR_08b95e3d_Rx: ComSignalType=BOOLEAN
            DET_RANGE_009_Rx_oRDR_FUSION_DET_009_012_oPCAN_RADAR_ebdc17fc_Rx: ComSignalType=UINT16
            DET_RANGE_010_Rx_oRDR_FUSION_DET_009_012_oPCAN_RADAR_d6fc94e5_Rx: ComSignalType=UINT16
            DET_RANGE_011_Rx_oRDR_FUSION_DET_009_012_oPCAN_RADAR_79b806a2_Rx: ComSignalType=UINT16
            DET_RANGE_012_Rx_oRDR_FUSION_DET_009_012_oPCAN_RADAR_5304b62a_Rx: ComSignalType=UINT16
            DET_RANGE_ERR_009_Rx_oRDR_FUSION_DET_009_012_oPCAN_RADAR_bb2e9b1c_Rx: ComSignalType=UINT8
            DET_RANGE_ERR_010_Rx_oRDR_FUSION_DET_009_012_oPCAN_RADAR_860e1805_Rx: ComSignalType=UINT8
            DET_RANGE_ERR_011_Rx_oRDR_FUSION_DET_009_012_oPCAN_RADAR_294a8a42_Rx: ComSignalType=UINT8
            DET_RANGE_ERR_012_Rx_oRDR_FUSION_DET_009_012_oPCAN_RADAR_03f63aca_Rx: ComSignalType=UINT8
            DET_RANGE_VELOCITY_009_Rx_oRDR_FUSION_DET_009_012_oPCAN_RADAR_36299402_Rx: ComSignalType=UINT16
            DET_RANGE_VELOCITY_010_Rx_oRDR_FUSION_DET_009_012_oPCAN_RADAR_0b09171b_Rx: ComSignalType=UINT16
            DET_RANGE_VELOCITY_011_Rx_oRDR_FUSION_DET_009_012_oPCAN_RADAR_a44d855c_Rx: ComSignalType=UINT16
            DET_RANGE_VELOCITY_012_Rx_oRDR_FUSION_DET_009_012_oPCAN_RADAR_8ef135d4_Rx: ComSignalType=UINT16
            DET_RANGE_VELOCITY_ERR_009_Rx_oRDR_FUSION_DET_009_012_oPCAN_RADAR_af4de4c0_Rx: ComSignalType=UINT8
            DET_RANGE_VELOCITY_ERR_010_Rx_oRDR_FUSION_DET_009_012_oPCAN_RADAR_926d67d9_Rx: ComSignalType=UINT8
            DET_RANGE_VELOCITY_ERR_011_Rx_oRDR_FUSION_DET_009_012_oPCAN_RADAR_3d29f59e_Rx: ComSignalType=UINT8
            DET_RANGE_VELOCITY_ERR_012_Rx_oRDR_FUSION_DET_009_012_oPCAN_RADAR_17954516_Rx: ComSignalType=UINT8
            DET_RCS_009_Rx_oRDR_FUSION_DET_009_012_oPCAN_RADAR_fbe20619_Rx: ComSignalType=UINT8
            DET_RCS_010_Rx_oRDR_FUSION_DET_009_012_oPCAN_RADAR_c6c28500_Rx: ComSignalType=UINT8
            DET_RCS_011_Rx_oRDR_FUSION_DET_009_012_oPCAN_RADAR_69861747_Rx: ComSignalType=UINT8
            DET_RCS_012_Rx_oRDR_FUSION_DET_009_012_oPCAN_RADAR_433aa7cf_Rx: ComSignalType=UINT8
            DET_SNR_009_Rx_oRDR_FUSION_DET_009_012_oPCAN_RADAR_f2b877f0_Rx: ComSignalType=UINT8
            DET_SNR_010_Rx_oRDR_FUSION_DET_009_012_oPCAN_RADAR_cf98f4e9_Rx: ComSignalType=UINT8
            DET_SNR_011_Rx_oRDR_FUSION_DET_009_012_oPCAN_RADAR_60dc66ae_Rx: ComSignalType=UINT8
            DET_SNR_012_Rx_oRDR_FUSION_DET_009_012_oPCAN_RADAR_4a60d626_Rx: ComSignalType=UINT8
            DET_SUPER_RES_TARGET_009_Rx_oRDR_FUSION_DET_009_012_oPCAN_RADAR_394356f0_Rx: ComSignalType=BOOLEAN
            DET_SUPER_RES_TARGET_010_Rx_oRDR_FUSION_DET_009_012_oPCAN_RADAR_0463d5e9_Rx: ComSignalType=BOOLEAN
            DET_SUPER_RES_TARGET_011_Rx_oRDR_FUSION_DET_009_012_oPCAN_RADAR_ab2747ae_Rx: ComSignalType=BOOLEAN
            DET_SUPER_RES_TARGET_012_Rx_oRDR_FUSION_DET_009_012_oPCAN_RADAR_819bf726_Rx: ComSignalType=BOOLEAN
        SG_Fusion_Detections_013_016_oRDR_FUSION_DET_013_016_oPCAN_RADAR_713b89f4_Rx
          83 x ComGroupSignal:
            DET_AZIMUTH_013_Rx_oRDR_FUSION_DET_013_016_oPCAN_RADAR_f2417b64_Rx: ComSignalType=UINT16
            DET_AZIMUTH_014_Rx_oRDR_FUSION_DET_013_016_oPCAN_RADAR_087c8833_Rx: ComSignalType=UINT16
            DET_AZIMUTH_015_Rx_oRDR_FUSION_DET_013_016_oPCAN_RADAR_a7381a74_Rx: ComSignalType=UINT16
            DET_AZIMUTH_016_Rx_oRDR_FUSION_DET_013_016_oPCAN_RADAR_8d84aafc_Rx: ComSignalType=UINT16
            DET_AZIMUTH_ERR_013_Rx_oRDR_FUSION_DET_013_016_oPCAN_RADAR_f028dae6_Rx: ComSignalType=UINT8
            DET_AZIMUTH_ERR_014_Rx_oRDR_FUSION_DET_013_016_oPCAN_RADAR_0a1529b1_Rx: ComSignalType=UINT8
            DET_AZIMUTH_ERR_015_Rx_oRDR_FUSION_DET_013_016_oPCAN_RADAR_a551bbf6_Rx: ComSignalType=UINT8
            DET_AZIMUTH_ERR_016_Rx_oRDR_FUSION_DET_013_016_oPCAN_RADAR_8fed0b7e_Rx: ComSignalType=UINT8
            DET_BELOW_RAIN_THOLD_013_Rx_oRDR_FUSION_DET_013_016_oPCAN_RADAR_94fb84d1_Rx: ComSignalType=BOOLEAN
            DET_BELOW_RAIN_THOLD_014_Rx_oRDR_FUSION_DET_013_016_oPCAN_RADAR_6ec67786_Rx: ComSignalType=BOOLEAN
            DET_BELOW_RAIN_THOLD_015_Rx_oRDR_FUSION_DET_013_016_oPCAN_RADAR_c182e5c1_Rx: ComSignalType=BOOLEAN
            DET_BELOW_RAIN_THOLD_016_Rx_oRDR_FUSION_DET_013_016_oPCAN_RADAR_eb3e5549_Rx: ComSignalType=BOOLEAN
            DET_BI_STATIC_FLAG_013_Rx_oRDR_FUSION_DET_013_016_oPCAN_RADAR_e3652fc2_Rx: ComSignalType=BOOLEAN
            DET_BI_STATIC_FLAG_014_Rx_oRDR_FUSION_DET_013_016_oPCAN_RADAR_1958dc95_Rx: ComSignalType=BOOLEAN
            DET_BI_STATIC_FLAG_015_Rx_oRDR_FUSION_DET_013_016_oPCAN_RADAR_b61c4ed2_Rx: ComSignalType=BOOLEAN
            DET_BI_STATIC_FLAG_016_Rx_oRDR_FUSION_DET_013_016_oPCAN_RADAR_9ca0fe5a_Rx: ComSignalType=BOOLEAN
            DET_CONFD_AZIMUTH_013_Rx_oRDR_FUSION_DET_013_016_oPCAN_RADAR_000cc596_Rx: ComSignalType=UINT8
            DET_CONFD_AZIMUTH_014_Rx_oRDR_FUSION_DET_013_016_oPCAN_RADAR_fa3136c1_Rx: ComSignalType=UINT8
            DET_CONFD_AZIMUTH_015_Rx_oRDR_FUSION_DET_013_016_oPCAN_RADAR_5575a486_Rx: ComSignalType=UINT8
            DET_CONFD_AZIMUTH_016_Rx_oRDR_FUSION_DET_013_016_oPCAN_RADAR_7fc9140e_Rx: ComSignalType=UINT8
            DET_CONFD_ELEVATION_013_Rx_oRDR_FUSION_DET_013_016_oPCAN_RADAR_0a2d4611_Rx: ComSignalType=UINT8
            DET_CONFD_ELEVATION_014_Rx_oRDR_FUSION_DET_013_016_oPCAN_RADAR_f010b546_Rx: ComSignalType=UINT8
            DET_CONFD_ELEVATION_015_Rx_oRDR_FUSION_DET_013_016_oPCAN_RADAR_5f542701_Rx: ComSignalType=UINT8
            DET_CONFD_ELEVATION_016_Rx_oRDR_FUSION_DET_013_016_oPCAN_RADAR_75e89789_Rx: ComSignalType=UINT8
            DET_ELEVATION_013_Rx_oRDR_FUSION_DET_013_016_oPCAN_RADAR_007ea9e8_Rx: ComSignalType=UINT8
            DET_ELEVATION_014_Rx_oRDR_FUSION_DET_013_016_oPCAN_RADAR_fa435abf_Rx: ComSignalType=UINT8
            DET_ELEVATION_015_Rx_oRDR_FUSION_DET_013_016_oPCAN_RADAR_5507c8f8_Rx: ComSignalType=UINT8
            DET_ELEVATION_016_Rx_oRDR_FUSION_DET_013_016_oPCAN_RADAR_7fbb7870_Rx: ComSignalType=UINT8
            DET_ELEVATION_ERR_013_Rx_oRDR_FUSION_DET_013_016_oPCAN_RADAR_d2c78b37_Rx: ComSignalType=UINT8
            DET_ELEVATION_ERR_014_Rx_oRDR_FUSION_DET_013_016_oPCAN_RADAR_28fa7860_Rx: ComSignalType=UINT8
            DET_ELEVATION_ERR_015_Rx_oRDR_FUSION_DET_013_016_oPCAN_RADAR_87beea27_Rx: ComSignalType=UINT8
            DET_ELEVATION_ERR_016_Rx_oRDR_FUSION_DET_013_016_oPCAN_RADAR_ad025aaf_Rx: ComSignalType=UINT8
            DET_EXISTENCE_PROB_013_Rx_oRDR_FUSION_DET_013_016_oPCAN_RADAR_25dff3a2_Rx: ComSignalType=UINT8
            DET_EXISTENCE_PROB_014_Rx_oRDR_FUSION_DET_013_016_oPCAN_RADAR_dfe200f5_Rx: ComSignalType=UINT8
            DET_EXISTENCE_PROB_015_Rx_oRDR_FUSION_DET_013_016_oPCAN_RADAR_70a692b2_Rx: ComSignalType=UINT8
            DET_EXISTENCE_PROB_016_Rx_oRDR_FUSION_DET_013_016_oPCAN_RADAR_5a1a223a_Rx: ComSignalType=UINT8
            DET_HVC_FLAG_013_Rx_oRDR_FUSION_DET_013_016_oPCAN_RADAR_f8011eed_Rx: ComSignalType=BOOLEAN
            DET_HVC_FLAG_014_Rx_oRDR_FUSION_DET_013_016_oPCAN_RADAR_023cedba_Rx: ComSignalType=BOOLEAN
            DET_HVC_FLAG_015_Rx_oRDR_FUSION_DET_013_016_oPCAN_RADAR_ad787ffd_Rx: ComSignalType=BOOLEAN
            DET_HVC_FLAG_016_Rx_oRDR_FUSION_DET_013_016_oPCAN_RADAR_87c4cf75_Rx: ComSignalType=BOOLEAN
            DET_IDM_013_Rx_oRDR_FUSION_DET_013_016_oPCAN_RADAR_cdc0e7a5_Rx: ComSignalType=BOOLEAN
            DET_IDM_014_Rx_oRDR_FUSION_DET_013_016_oPCAN_RADAR_37fd14f2_Rx: ComSignalType=BOOLEAN
            DET_IDM_015_Rx_oRDR_FUSION_DET_013_016_oPCAN_RADAR_98b986b5_Rx: ComSignalType=BOOLEAN
            DET_IDM_016_Rx_oRDR_FUSION_DET_013_016_oPCAN_RADAR_b205363d_Rx: ComSignalType=BOOLEAN
            DET_MH_CRC16_013_016_Rx_oRDR_FUSION_DET_013_016_oPCAN_RADAR_23e44f7c_Rx: ComSignalType=UINT16
            DET_MH_CYCLE_COUNTER_013_016_Rx_oRDR_FUSION_DET_013_016_oPCAN_RADAR_2e3f72b9_Rx: ComSignalType=UINT8
            DET_MH_SCAN_INDEX_4LSB_013_016_Rx_oRDR_FUSION_DET_013_016_oPCAN_RADAR_4a8fbd82_Rx: ComSignalType=UINT8
            DET_MTD_013_Rx_oRDR_FUSION_DET_013_016_oPCAN_RADAR_7043d1d5_Rx: ComSignalType=BOOLEAN
            DET_MTD_014_Rx_oRDR_FUSION_DET_013_016_oPCAN_RADAR_8a7e2282_Rx: ComSignalType=BOOLEAN
            DET_MTD_015_Rx_oRDR_FUSION_DET_013_016_oPCAN_RADAR_253ab0c5_Rx: ComSignalType=BOOLEAN
            DET_MTD_016_Rx_oRDR_FUSION_DET_013_016_oPCAN_RADAR_0f86004d_Rx: ComSignalType=BOOLEAN
            DET_PROB_1STAZHYPO_013_Rx_oRDR_FUSION_DET_013_016_oPCAN_RADAR_ba3acf54_Rx: ComSignalType=BOOLEAN
            DET_PROB_1STAZHYPO_014_Rx_oRDR_FUSION_DET_013_016_oPCAN_RADAR_40073c03_Rx: ComSignalType=BOOLEAN
            DET_PROB_1STAZHYPO_015_Rx_oRDR_FUSION_DET_013_016_oPCAN_RADAR_ef43ae44_Rx: ComSignalType=BOOLEAN
            DET_PROB_1STAZHYPO_016_Rx_oRDR_FUSION_DET_013_016_oPCAN_RADAR_c5ff1ecc_Rx: ComSignalType=BOOLEAN
            DET_RANGE_013_Rx_oRDR_FUSION_DET_013_016_oPCAN_RADAR_e1872743_Rx: ComSignalType=UINT16
            DET_RANGE_014_Rx_oRDR_FUSION_DET_013_016_oPCAN_RADAR_1bbad414_Rx: ComSignalType=UINT16
            DET_RANGE_015_Rx_oRDR_FUSION_DET_013_016_oPCAN_RADAR_b4fe4653_Rx: ComSignalType=UINT16
            DET_RANGE_016_Rx_oRDR_FUSION_DET_013_016_oPCAN_RADAR_9e42f6db_Rx: ComSignalType=UINT16
            DET_RANGE_ERR_013_Rx_oRDR_FUSION_DET_013_016_oPCAN_RADAR_b175aba3_Rx: ComSignalType=UINT8
            DET_RANGE_ERR_014_Rx_oRDR_FUSION_DET_013_016_oPCAN_RADAR_4b4858f4_Rx: ComSignalType=UINT8
            DET_RANGE_ERR_015_Rx_oRDR_FUSION_DET_013_016_oPCAN_RADAR_e40ccab3_Rx: ComSignalType=UINT8
            DET_RANGE_ERR_016_Rx_oRDR_FUSION_DET_013_016_oPCAN_RADAR_ceb07a3b_Rx: ComSignalType=UINT8
            DET_RANGE_VELOCITY_013_Rx_oRDR_FUSION_DET_013_016_oPCAN_RADAR_3c72a4bd_Rx: ComSignalType=UINT16
            DET_RANGE_VELOCITY_014_Rx_oRDR_FUSION_DET_013_016_oPCAN_RADAR_c64f57ea_Rx: ComSignalType=UINT16
            DET_RANGE_VELOCITY_015_Rx_oRDR_FUSION_DET_013_016_oPCAN_RADAR_690bc5ad_Rx: ComSignalType=UINT16
            DET_RANGE_VELOCITY_016_Rx_oRDR_FUSION_DET_013_016_oPCAN_RADAR_43b77525_Rx: ComSignalType=UINT16
            DET_RANGE_VELOCITY_ERR_013_Rx_oRDR_FUSION_DET_013_016_oPCAN_RADAR_a516d47f_Rx: ComSignalType=UINT8
            DET_RANGE_VELOCITY_ERR_014_Rx_oRDR_FUSION_DET_013_016_oPCAN_RADAR_5f2b2728_Rx: ComSignalType=UINT8
            DET_RANGE_VELOCITY_ERR_015_Rx_oRDR_FUSION_DET_013_016_oPCAN_RADAR_f06fb56f_Rx: ComSignalType=UINT8
            DET_RANGE_VELOCITY_ERR_016_Rx_oRDR_FUSION_DET_013_016_oPCAN_RADAR_dad305e7_Rx: ComSignalType=UINT8
            DET_RCS_013_Rx_oRDR_FUSION_DET_013_016_oPCAN_RADAR_f1b936a6_Rx: ComSignalType=UINT8
            DET_RCS_014_Rx_oRDR_FUSION_DET_013_016_oPCAN_RADAR_0b84c5f1_Rx: ComSignalType=UINT8
            DET_RCS_015_Rx_oRDR_FUSION_DET_013_016_oPCAN_RADAR_a4c057b6_Rx: ComSignalType=UINT8
            DET_RCS_016_Rx_oRDR_FUSION_DET_013_016_oPCAN_RADAR_8e7ce73e_Rx: ComSignalType=UINT8
            DET_SNR_013_Rx_oRDR_FUSION_DET_013_016_oPCAN_RADAR_f8e3474f_Rx: ComSignalType=UINT8
            DET_SNR_014_Rx_oRDR_FUSION_DET_013_016_oPCAN_RADAR_02deb418_Rx: ComSignalType=UINT8
            DET_SNR_015_Rx_oRDR_FUSION_DET_013_016_oPCAN_RADAR_ad9a265f_Rx: ComSignalType=UINT8
            DET_SNR_016_Rx_oRDR_FUSION_DET_013_016_oPCAN_RADAR_872696d7_Rx: ComSignalType=UINT8
            DET_SUPER_RES_TARGET_013_Rx_oRDR_FUSION_DET_013_016_oPCAN_RADAR_3318664f_Rx: ComSignalType=BOOLEAN
            DET_SUPER_RES_TARGET_014_Rx_oRDR_FUSION_DET_013_016_oPCAN_RADAR_c9259518_Rx: ComSignalType=BOOLEAN
            DET_SUPER_RES_TARGET_015_Rx_oRDR_FUSION_DET_013_016_oPCAN_RADAR_6661075f_Rx: ComSignalType=BOOLEAN
            DET_SUPER_RES_TARGET_016_Rx_oRDR_FUSION_DET_013_016_oPCAN_RADAR_4cddb7d7_Rx: ComSignalType=BOOLEAN
        SG_Fusion_Detections_017_020_oRDR_FUSION_DET_017_020_oPCAN_RADAR_3121649c_Rx
          83 x ComGroupSignal:
            DET_AZIMUTH_017_Rx_oRDR_FUSION_DET_017_020_oPCAN_RADAR_8d4ce572_Rx: ComSignalType=UINT16
            DET_AZIMUTH_018_Rx_oRDR_FUSION_DET_017_020_oPCAN_RADAR_0d0297da_Rx: ComSignalType=UINT16
            DET_AZIMUTH_019_Rx_oRDR_FUSION_DET_017_020_oPCAN_RADAR_a246059d_Rx: ComSignalType=UINT16
            DET_AZIMUTH_020_Rx_oRDR_FUSION_DET_017_020_oPCAN_RADAR_9438a187_Rx: ComSignalType=UINT16
            DET_AZIMUTH_ERR_017_Rx_oRDR_FUSION_DET_017_020_oPCAN_RADAR_8f2544f0_Rx: ComSignalType=UINT8
            DET_AZIMUTH_ERR_018_Rx_oRDR_FUSION_DET_017_020_oPCAN_RADAR_0f6b3658_Rx: ComSignalType=UINT8
            DET_AZIMUTH_ERR_019_Rx_oRDR_FUSION_DET_017_020_oPCAN_RADAR_a02fa41f_Rx: ComSignalType=UINT8
            DET_AZIMUTH_ERR_020_Rx_oRDR_FUSION_DET_017_020_oPCAN_RADAR_96510005_Rx: ComSignalType=UINT8
            DET_BELOW_RAIN_THOLD_017_Rx_oRDR_FUSION_DET_017_020_oPCAN_RADAR_ebf61ac7_Rx: ComSignalType=BOOLEAN
            DET_BELOW_RAIN_THOLD_018_Rx_oRDR_FUSION_DET_017_020_oPCAN_RADAR_6bb8686f_Rx: ComSignalType=BOOLEAN
            DET_BELOW_RAIN_THOLD_019_Rx_oRDR_FUSION_DET_017_020_oPCAN_RADAR_c4fcfa28_Rx: ComSignalType=BOOLEAN
            DET_BELOW_RAIN_THOLD_020_Rx_oRDR_FUSION_DET_017_020_oPCAN_RADAR_f2825e32_Rx: ComSignalType=BOOLEAN
            DET_BI_STATIC_FLAG_017_Rx_oRDR_FUSION_DET_017_020_oPCAN_RADAR_9c68b1d4_Rx: ComSignalType=BOOLEAN
            DET_BI_STATIC_FLAG_018_Rx_oRDR_FUSION_DET_017_020_oPCAN_RADAR_1c26c37c_Rx: ComSignalType=BOOLEAN
            DET_BI_STATIC_FLAG_019_Rx_oRDR_FUSION_DET_017_020_oPCAN_RADAR_b362513b_Rx: ComSignalType=BOOLEAN
            DET_BI_STATIC_FLAG_020_Rx_oRDR_FUSION_DET_017_020_oPCAN_RADAR_851cf521_Rx: ComSignalType=BOOLEAN
            DET_CONFD_AZIMUTH_017_Rx_oRDR_FUSION_DET_017_020_oPCAN_RADAR_7f015b80_Rx: ComSignalType=UINT8
            DET_CONFD_AZIMUTH_018_Rx_oRDR_FUSION_DET_017_020_oPCAN_RADAR_ff4f2928_Rx: ComSignalType=UINT8
            DET_CONFD_AZIMUTH_019_Rx_oRDR_FUSION_DET_017_020_oPCAN_RADAR_500bbb6f_Rx: ComSignalType=UINT8
            DET_CONFD_AZIMUTH_020_Rx_oRDR_FUSION_DET_017_020_oPCAN_RADAR_66751f75_Rx: ComSignalType=UINT8
            DET_CONFD_ELEVATION_017_Rx_oRDR_FUSION_DET_017_020_oPCAN_RADAR_7520d807_Rx: ComSignalType=UINT8
            DET_CONFD_ELEVATION_018_Rx_oRDR_FUSION_DET_017_020_oPCAN_RADAR_f56eaaaf_Rx: ComSignalType=UINT8
            DET_CONFD_ELEVATION_019_Rx_oRDR_FUSION_DET_017_020_oPCAN_RADAR_5a2a38e8_Rx: ComSignalType=UINT8
            DET_CONFD_ELEVATION_020_Rx_oRDR_FUSION_DET_017_020_oPCAN_RADAR_6c549cf2_Rx: ComSignalType=UINT8
            DET_ELEVATION_017_Rx_oRDR_FUSION_DET_017_020_oPCAN_RADAR_7f7337fe_Rx: ComSignalType=UINT8
            DET_ELEVATION_018_Rx_oRDR_FUSION_DET_017_020_oPCAN_RADAR_ff3d4556_Rx: ComSignalType=UINT8
            DET_ELEVATION_019_Rx_oRDR_FUSION_DET_017_020_oPCAN_RADAR_5079d711_Rx: ComSignalType=UINT8
            DET_ELEVATION_020_Rx_oRDR_FUSION_DET_017_020_oPCAN_RADAR_6607730b_Rx: ComSignalType=UINT8
            DET_ELEVATION_ERR_017_Rx_oRDR_FUSION_DET_017_020_oPCAN_RADAR_adca1521_Rx: ComSignalType=UINT8
            DET_ELEVATION_ERR_018_Rx_oRDR_FUSION_DET_017_020_oPCAN_RADAR_2d846789_Rx: ComSignalType=UINT8
            DET_ELEVATION_ERR_019_Rx_oRDR_FUSION_DET_017_020_oPCAN_RADAR_82c0f5ce_Rx: ComSignalType=UINT8
            DET_ELEVATION_ERR_020_Rx_oRDR_FUSION_DET_017_020_oPCAN_RADAR_b4be51d4_Rx: ComSignalType=UINT8
            DET_EXISTENCE_PROB_017_Rx_oRDR_FUSION_DET_017_020_oPCAN_RADAR_5ad26db4_Rx: ComSignalType=UINT8
            DET_EXISTENCE_PROB_018_Rx_oRDR_FUSION_DET_017_020_oPCAN_RADAR_da9c1f1c_Rx: ComSignalType=UINT8
            DET_EXISTENCE_PROB_019_Rx_oRDR_FUSION_DET_017_020_oPCAN_RADAR_75d88d5b_Rx: ComSignalType=UINT8
            DET_EXISTENCE_PROB_020_Rx_oRDR_FUSION_DET_017_020_oPCAN_RADAR_43a62941_Rx: ComSignalType=UINT8
            DET_HVC_FLAG_017_Rx_oRDR_FUSION_DET_017_020_oPCAN_RADAR_870c80fb_Rx: ComSignalType=BOOLEAN
            DET_HVC_FLAG_018_Rx_oRDR_FUSION_DET_017_020_oPCAN_RADAR_0742f253_Rx: ComSignalType=BOOLEAN
            DET_HVC_FLAG_019_Rx_oRDR_FUSION_DET_017_020_oPCAN_RADAR_a8066014_Rx: ComSignalType=BOOLEAN
            DET_HVC_FLAG_020_Rx_oRDR_FUSION_DET_017_020_oPCAN_RADAR_9e78c40e_Rx: ComSignalType=BOOLEAN
            DET_IDM_017_Rx_oRDR_FUSION_DET_017_020_oPCAN_RADAR_b2cd79b3_Rx: ComSignalType=BOOLEAN
            DET_IDM_018_Rx_oRDR_FUSION_DET_017_020_oPCAN_RADAR_32830b1b_Rx: ComSignalType=BOOLEAN
            DET_IDM_019_Rx_oRDR_FUSION_DET_017_020_oPCAN_RADAR_9dc7995c_Rx: ComSignalType=BOOLEAN
            DET_IDM_020_Rx_oRDR_FUSION_DET_017_020_oPCAN_RADAR_abb93d46_Rx: ComSignalType=BOOLEAN
            DET_MH_CRC16_017_020_Rx_oRDR_FUSION_DET_017_020_oPCAN_RADAR_92f8a58f_Rx: ComSignalType=UINT16
            DET_MH_CYCLE_COUNTER_017_020_Rx_oRDR_FUSION_DET_017_020_oPCAN_RADAR_9f23984a_Rx: ComSignalType=UINT8
            DET_MH_SCAN_INDEX_4LSB_017_020_Rx_oRDR_FUSION_DET_017_020_oPCAN_RADAR_fb935771_Rx: ComSignalType=UINT8
            DET_MTD_017_Rx_oRDR_FUSION_DET_017_020_oPCAN_RADAR_0f4e4fc3_Rx: ComSignalType=BOOLEAN
            DET_MTD_018_Rx_oRDR_FUSION_DET_017_020_oPCAN_RADAR_8f003d6b_Rx: ComSignalType=BOOLEAN
            DET_MTD_019_Rx_oRDR_FUSION_DET_017_020_oPCAN_RADAR_2044af2c_Rx: ComSignalType=BOOLEAN
            DET_MTD_020_Rx_oRDR_FUSION_DET_017_020_oPCAN_RADAR_163a0b36_Rx: ComSignalType=BOOLEAN
            DET_PROB_1STAZHYPO_017_Rx_oRDR_FUSION_DET_017_020_oPCAN_RADAR_c5375142_Rx: ComSignalType=BOOLEAN
            DET_PROB_1STAZHYPO_018_Rx_oRDR_FUSION_DET_017_020_oPCAN_RADAR_457923ea_Rx: ComSignalType=BOOLEAN
            DET_PROB_1STAZHYPO_019_Rx_oRDR_FUSION_DET_017_020_oPCAN_RADAR_ea3db1ad_Rx: ComSignalType=BOOLEAN
            DET_PROB_1STAZHYPO_020_Rx_oRDR_FUSION_DET_017_020_oPCAN_RADAR_dc4315b7_Rx: ComSignalType=BOOLEAN
            DET_RANGE_017_Rx_oRDR_FUSION_DET_017_020_oPCAN_RADAR_9e8ab955_Rx: ComSignalType=UINT16
            DET_RANGE_018_Rx_oRDR_FUSION_DET_017_020_oPCAN_RADAR_1ec4cbfd_Rx: ComSignalType=UINT16
            DET_RANGE_019_Rx_oRDR_FUSION_DET_017_020_oPCAN_RADAR_b18059ba_Rx: ComSignalType=UINT16
            DET_RANGE_020_Rx_oRDR_FUSION_DET_017_020_oPCAN_RADAR_87fefda0_Rx: ComSignalType=UINT16
            DET_RANGE_ERR_017_Rx_oRDR_FUSION_DET_017_020_oPCAN_RADAR_ce7835b5_Rx: ComSignalType=UINT8
            DET_RANGE_ERR_018_Rx_oRDR_FUSION_DET_017_020_oPCAN_RADAR_4e36471d_Rx: ComSignalType=UINT8
            DET_RANGE_ERR_019_Rx_oRDR_FUSION_DET_017_020_oPCAN_RADAR_e172d55a_Rx: ComSignalType=UINT8
            DET_RANGE_ERR_020_Rx_oRDR_FUSION_DET_017_020_oPCAN_RADAR_d70c7140_Rx: ComSignalType=UINT8
            DET_RANGE_VELOCITY_017_Rx_oRDR_FUSION_DET_017_020_oPCAN_RADAR_437f3aab_Rx: ComSignalType=UINT16
            DET_RANGE_VELOCITY_018_Rx_oRDR_FUSION_DET_017_020_oPCAN_RADAR_c3314803_Rx: ComSignalType=UINT16
            DET_RANGE_VELOCITY_019_Rx_oRDR_FUSION_DET_017_020_oPCAN_RADAR_6c75da44_Rx: ComSignalType=UINT16
            DET_RANGE_VELOCITY_020_Rx_oRDR_FUSION_DET_017_020_oPCAN_RADAR_5a0b7e5e_Rx: ComSignalType=UINT16
            DET_RANGE_VELOCITY_ERR_017_Rx_oRDR_FUSION_DET_017_020_oPCAN_RADAR_da1b4a69_Rx: ComSignalType=UINT8
            DET_RANGE_VELOCITY_ERR_018_Rx_oRDR_FUSION_DET_017_020_oPCAN_RADAR_5a5538c1_Rx: ComSignalType=UINT8
            DET_RANGE_VELOCITY_ERR_019_Rx_oRDR_FUSION_DET_017_020_oPCAN_RADAR_f511aa86_Rx: ComSignalType=UINT8
            DET_RANGE_VELOCITY_ERR_020_Rx_oRDR_FUSION_DET_017_020_oPCAN_RADAR_c36f0e9c_Rx: ComSignalType=UINT8
            DET_RCS_017_Rx_oRDR_FUSION_DET_017_020_oPCAN_RADAR_8eb4a8b0_Rx: ComSignalType=UINT8
            DET_RCS_018_Rx_oRDR_FUSION_DET_017_020_oPCAN_RADAR_0efada18_Rx: ComSignalType=UINT8
            DET_RCS_019_Rx_oRDR_FUSION_DET_017_020_oPCAN_RADAR_a1be485f_Rx: ComSignalType=UINT8
            DET_RCS_020_Rx_oRDR_FUSION_DET_017_020_oPCAN_RADAR_97c0ec45_Rx: ComSignalType=UINT8
            DET_SNR_017_Rx_oRDR_FUSION_DET_017_020_oPCAN_RADAR_87eed959_Rx: ComSignalType=UINT8
            DET_SNR_018_Rx_oRDR_FUSION_DET_017_020_oPCAN_RADAR_07a0abf1_Rx: ComSignalType=UINT8
            DET_SNR_019_Rx_oRDR_FUSION_DET_017_020_oPCAN_RADAR_a8e439b6_Rx: ComSignalType=UINT8
            DET_SNR_020_Rx_oRDR_FUSION_DET_017_020_oPCAN_RADAR_9e9a9dac_Rx: ComSignalType=UINT8
            DET_SUPER_RES_TARGET_017_Rx_oRDR_FUSION_DET_017_020_oPCAN_RADAR_4c15f859_Rx: ComSignalType=BOOLEAN
            DET_SUPER_RES_TARGET_018_Rx_oRDR_FUSION_DET_017_020_oPCAN_RADAR_cc5b8af1_Rx: ComSignalType=BOOLEAN
            DET_SUPER_RES_TARGET_019_Rx_oRDR_FUSION_DET_017_020_oPCAN_RADAR_631f18b6_Rx: ComSignalType=BOOLEAN
            DET_SUPER_RES_TARGET_020_Rx_oRDR_FUSION_DET_017_020_oPCAN_RADAR_5561bcac_Rx: ComSignalType=BOOLEAN
        SG_Fusion_Detections_021_024_oRDR_FUSION_DET_021_024_oPCAN_RADAR_f7a0d0a9_Rx
          83 x ComGroupSignal:
            DET_AZIMUTH_021_Rx_oRDR_FUSION_DET_021_024_oPCAN_RADAR_b677333c_Rx: ComSignalType=UINT16
            DET_AZIMUTH_022_Rx_oRDR_FUSION_DET_021_024_oPCAN_RADAR_9ccb83b4_Rx: ComSignalType=UINT16
            DET_AZIMUTH_023_Rx_oRDR_FUSION_DET_021_024_oPCAN_RADAR_338f11f3_Rx: ComSignalType=UINT16
            DET_AZIMUTH_024_Rx_oRDR_FUSION_DET_021_024_oPCAN_RADAR_c9b2e2a4_Rx: ComSignalType=UINT16
            DET_AZIMUTH_ERR_021_Rx_oRDR_FUSION_DET_021_024_oPCAN_RADAR_b41e92be_Rx: ComSignalType=UINT8
            DET_AZIMUTH_ERR_022_Rx_oRDR_FUSION_DET_021_024_oPCAN_RADAR_9ea22236_Rx: ComSignalType=UINT8
            DET_AZIMUTH_ERR_023_Rx_oRDR_FUSION_DET_021_024_oPCAN_RADAR_31e6b071_Rx: ComSignalType=UINT8
            DET_AZIMUTH_ERR_024_Rx_oRDR_FUSION_DET_021_024_oPCAN_RADAR_cbdb4326_Rx: ComSignalType=UINT8
            DET_BELOW_RAIN_THOLD_021_Rx_oRDR_FUSION_DET_021_024_oPCAN_RADAR_d0cdcc89_Rx: ComSignalType=BOOLEAN
            DET_BELOW_RAIN_THOLD_022_Rx_oRDR_FUSION_DET_021_024_oPCAN_RADAR_fa717c01_Rx: ComSignalType=BOOLEAN
            DET_BELOW_RAIN_THOLD_023_Rx_oRDR_FUSION_DET_021_024_oPCAN_RADAR_5535ee46_Rx: ComSignalType=BOOLEAN
            DET_BELOW_RAIN_THOLD_024_Rx_oRDR_FUSION_DET_021_024_oPCAN_RADAR_af081d11_Rx: ComSignalType=BOOLEAN
            DET_BI_STATIC_FLAG_021_Rx_oRDR_FUSION_DET_021_024_oPCAN_RADAR_a753679a_Rx: ComSignalType=BOOLEAN
            DET_BI_STATIC_FLAG_022_Rx_oRDR_FUSION_DET_021_024_oPCAN_RADAR_8defd712_Rx: ComSignalType=BOOLEAN
            DET_BI_STATIC_FLAG_023_Rx_oRDR_FUSION_DET_021_024_oPCAN_RADAR_22ab4555_Rx: ComSignalType=BOOLEAN
            DET_BI_STATIC_FLAG_024_Rx_oRDR_FUSION_DET_021_024_oPCAN_RADAR_d896b602_Rx: ComSignalType=BOOLEAN
            DET_CONFD_AZIMUTH_021_Rx_oRDR_FUSION_DET_021_024_oPCAN_RADAR_443a8dce_Rx: ComSignalType=UINT8
            DET_CONFD_AZIMUTH_022_Rx_oRDR_FUSION_DET_021_024_oPCAN_RADAR_6e863d46_Rx: ComSignalType=UINT8
            DET_CONFD_AZIMUTH_023_Rx_oRDR_FUSION_DET_021_024_oPCAN_RADAR_c1c2af01_Rx: ComSignalType=UINT8
            DET_CONFD_AZIMUTH_024_Rx_oRDR_FUSION_DET_021_024_oPCAN_RADAR_3bff5c56_Rx: ComSignalType=UINT8
            DET_CONFD_ELEVATION_021_Rx_oRDR_FUSION_DET_021_024_oPCAN_RADAR_4e1b0e49_Rx: ComSignalType=UINT8
            DET_CONFD_ELEVATION_022_Rx_oRDR_FUSION_DET_021_024_oPCAN_RADAR_64a7bec1_Rx: ComSignalType=UINT8
            DET_CONFD_ELEVATION_023_Rx_oRDR_FUSION_DET_021_024_oPCAN_RADAR_cbe32c86_Rx: ComSignalType=UINT8
            DET_CONFD_ELEVATION_024_Rx_oRDR_FUSION_DET_021_024_oPCAN_RADAR_31dedfd1_Rx: ComSignalType=UINT8
            DET_ELEVATION_021_Rx_oRDR_FUSION_DET_021_024_oPCAN_RADAR_4448e1b0_Rx: ComSignalType=UINT8
            DET_ELEVATION_022_Rx_oRDR_FUSION_DET_021_024_oPCAN_RADAR_6ef45138_Rx: ComSignalType=UINT8
            DET_ELEVATION_023_Rx_oRDR_FUSION_DET_021_024_oPCAN_RADAR_c1b0c37f_Rx: ComSignalType=UINT8
            DET_ELEVATION_024_Rx_oRDR_FUSION_DET_021_024_oPCAN_RADAR_3b8d3028_Rx: ComSignalType=UINT8
            DET_ELEVATION_ERR_021_Rx_oRDR_FUSION_DET_021_024_oPCAN_RADAR_96f1c36f_Rx: ComSignalType=UINT8
            DET_ELEVATION_ERR_022_Rx_oRDR_FUSION_DET_021_024_oPCAN_RADAR_bc4d73e7_Rx: ComSignalType=UINT8
            DET_ELEVATION_ERR_023_Rx_oRDR_FUSION_DET_021_024_oPCAN_RADAR_1309e1a0_Rx: ComSignalType=UINT8
            DET_ELEVATION_ERR_024_Rx_oRDR_FUSION_DET_021_024_oPCAN_RADAR_e93412f7_Rx: ComSignalType=UINT8
            DET_EXISTENCE_PROB_021_Rx_oRDR_FUSION_DET_021_024_oPCAN_RADAR_61e9bbfa_Rx: ComSignalType=UINT8
            DET_EXISTENCE_PROB_022_Rx_oRDR_FUSION_DET_021_024_oPCAN_RADAR_4b550b72_Rx: ComSignalType=UINT8
            DET_EXISTENCE_PROB_023_Rx_oRDR_FUSION_DET_021_024_oPCAN_RADAR_e4119935_Rx: ComSignalType=UINT8
            DET_EXISTENCE_PROB_024_Rx_oRDR_FUSION_DET_021_024_oPCAN_RADAR_1e2c6a62_Rx: ComSignalType=UINT8
            DET_HVC_FLAG_021_Rx_oRDR_FUSION_DET_021_024_oPCAN_RADAR_bc3756b5_Rx: ComSignalType=BOOLEAN
            DET_HVC_FLAG_022_Rx_oRDR_FUSION_DET_021_024_oPCAN_RADAR_968be63d_Rx: ComSignalType=BOOLEAN
            DET_HVC_FLAG_023_Rx_oRDR_FUSION_DET_021_024_oPCAN_RADAR_39cf747a_Rx: ComSignalType=BOOLEAN
            DET_HVC_FLAG_024_Rx_oRDR_FUSION_DET_021_024_oPCAN_RADAR_c3f2872d_Rx: ComSignalType=BOOLEAN
            DET_IDM_021_Rx_oRDR_FUSION_DET_021_024_oPCAN_RADAR_89f6affd_Rx: ComSignalType=BOOLEAN
            DET_IDM_022_Rx_oRDR_FUSION_DET_021_024_oPCAN_RADAR_a34a1f75_Rx: ComSignalType=BOOLEAN
            DET_IDM_023_Rx_oRDR_FUSION_DET_021_024_oPCAN_RADAR_0c0e8d32_Rx: ComSignalType=BOOLEAN
            DET_IDM_024_Rx_oRDR_FUSION_DET_021_024_oPCAN_RADAR_f6337e65_Rx: ComSignalType=BOOLEAN
            DET_MH_CRC16_021_024_Rx_oRDR_FUSION_DET_021_024_oPCAN_RADAR_0c490975_Rx: ComSignalType=UINT16
            DET_MH_CYCLE_COUNTER_021_024_Rx_oRDR_FUSION_DET_021_024_oPCAN_RADAR_019234b0_Rx: ComSignalType=UINT8
            DET_MH_SCAN_INDEX_4LSB_021_024_Rx_oRDR_FUSION_DET_021_024_oPCAN_RADAR_6522fb8b_Rx: ComSignalType=UINT8
            DET_MTD_021_Rx_oRDR_FUSION_DET_021_024_oPCAN_RADAR_3475998d_Rx: ComSignalType=BOOLEAN
            DET_MTD_022_Rx_oRDR_FUSION_DET_021_024_oPCAN_RADAR_1ec92905_Rx: ComSignalType=BOOLEAN
            DET_MTD_023_Rx_oRDR_FUSION_DET_021_024_oPCAN_RADAR_b18dbb42_Rx: ComSignalType=BOOLEAN
            DET_MTD_024_Rx_oRDR_FUSION_DET_021_024_oPCAN_RADAR_4bb04815_Rx: ComSignalType=BOOLEAN
            DET_PROB_1STAZHYPO_021_Rx_oRDR_FUSION_DET_021_024_oPCAN_RADAR_fe0c870c_Rx: ComSignalType=BOOLEAN
            DET_PROB_1STAZHYPO_022_Rx_oRDR_FUSION_DET_021_024_oPCAN_RADAR_d4b03784_Rx: ComSignalType=BOOLEAN
            DET_PROB_1STAZHYPO_023_Rx_oRDR_FUSION_DET_021_024_oPCAN_RADAR_7bf4a5c3_Rx: ComSignalType=BOOLEAN
            DET_PROB_1STAZHYPO_024_Rx_oRDR_FUSION_DET_021_024_oPCAN_RADAR_81c95694_Rx: ComSignalType=BOOLEAN
            DET_RANGE_021_Rx_oRDR_FUSION_DET_021_024_oPCAN_RADAR_a5b16f1b_Rx: ComSignalType=UINT16
            DET_RANGE_022_Rx_oRDR_FUSION_DET_021_024_oPCAN_RADAR_8f0ddf93_Rx: ComSignalType=UINT16
            DET_RANGE_023_Rx_oRDR_FUSION_DET_021_024_oPCAN_RADAR_20494dd4_Rx: ComSignalType=UINT16
            DET_RANGE_024_Rx_oRDR_FUSION_DET_021_024_oPCAN_RADAR_da74be83_Rx: ComSignalType=UINT16
            DET_RANGE_ERR_021_Rx_oRDR_FUSION_DET_021_024_oPCAN_RADAR_f543e3fb_Rx: ComSignalType=UINT8
            DET_RANGE_ERR_022_Rx_oRDR_FUSION_DET_021_024_oPCAN_RADAR_dfff5373_Rx: ComSignalType=UINT8
            DET_RANGE_ERR_023_Rx_oRDR_FUSION_DET_021_024_oPCAN_RADAR_70bbc134_Rx: ComSignalType=UINT8
            DET_RANGE_ERR_024_Rx_oRDR_FUSION_DET_021_024_oPCAN_RADAR_8a863263_Rx: ComSignalType=UINT8
            DET_RANGE_VELOCITY_021_Rx_oRDR_FUSION_DET_021_024_oPCAN_RADAR_7844ece5_Rx: ComSignalType=UINT16
            DET_RANGE_VELOCITY_022_Rx_oRDR_FUSION_DET_021_024_oPCAN_RADAR_52f85c6d_Rx: ComSignalType=UINT16
            DET_RANGE_VELOCITY_023_Rx_oRDR_FUSION_DET_021_024_oPCAN_RADAR_fdbcce2a_Rx: ComSignalType=UINT16
            DET_RANGE_VELOCITY_024_Rx_oRDR_FUSION_DET_021_024_oPCAN_RADAR_07813d7d_Rx: ComSignalType=UINT16
            DET_RANGE_VELOCITY_ERR_021_Rx_oRDR_FUSION_DET_021_024_oPCAN_RADAR_e1209c27_Rx: ComSignalType=UINT8
            DET_RANGE_VELOCITY_ERR_022_Rx_oRDR_FUSION_DET_021_024_oPCAN_RADAR_cb9c2caf_Rx: ComSignalType=UINT8
            DET_RANGE_VELOCITY_ERR_023_Rx_oRDR_FUSION_DET_021_024_oPCAN_RADAR_64d8bee8_Rx: ComSignalType=UINT8
            DET_RANGE_VELOCITY_ERR_024_Rx_oRDR_FUSION_DET_021_024_oPCAN_RADAR_9ee54dbf_Rx: ComSignalType=UINT8
            DET_RCS_021_Rx_oRDR_FUSION_DET_021_024_oPCAN_RADAR_b58f7efe_Rx: ComSignalType=UINT8
            DET_RCS_022_Rx_oRDR_FUSION_DET_021_024_oPCAN_RADAR_9f33ce76_Rx: ComSignalType=UINT8
            DET_RCS_023_Rx_oRDR_FUSION_DET_021_024_oPCAN_RADAR_30775c31_Rx: ComSignalType=UINT8
            DET_RCS_024_Rx_oRDR_FUSION_DET_021_024_oPCAN_RADAR_ca4aaf66_Rx: ComSignalType=UINT8
            DET_SNR_021_Rx_oRDR_FUSION_DET_021_024_oPCAN_RADAR_bcd50f17_Rx: ComSignalType=UINT8
            DET_SNR_022_Rx_oRDR_FUSION_DET_021_024_oPCAN_RADAR_9669bf9f_Rx: ComSignalType=UINT8
            DET_SNR_023_Rx_oRDR_FUSION_DET_021_024_oPCAN_RADAR_392d2dd8_Rx: ComSignalType=UINT8
            DET_SNR_024_Rx_oRDR_FUSION_DET_021_024_oPCAN_RADAR_c310de8f_Rx: ComSignalType=UINT8
            DET_SUPER_RES_TARGET_021_Rx_oRDR_FUSION_DET_021_024_oPCAN_RADAR_772e2e17_Rx: ComSignalType=BOOLEAN
            DET_SUPER_RES_TARGET_022_Rx_oRDR_FUSION_DET_021_024_oPCAN_RADAR_5d929e9f_Rx: ComSignalType=BOOLEAN
            DET_SUPER_RES_TARGET_023_Rx_oRDR_FUSION_DET_021_024_oPCAN_RADAR_f2d60cd8_Rx: ComSignalType=BOOLEAN
            DET_SUPER_RES_TARGET_024_Rx_oRDR_FUSION_DET_021_024_oPCAN_RADAR_08ebff8f_Rx: ComSignalType=BOOLEAN
        SG_Fusion_Detections_025_028_oRDR_FUSION_DET_025_028_oPCAN_RADAR_ba5bfb5a_Rx
          83 x ComGroupSignal:
            DET_AZIMUTH_025_Rx_oRDR_FUSION_DET_025_028_oPCAN_RADAR_8f44eed7_Rx: ComSignalType=UINT16
            DET_AZIMUTH_026_Rx_oRDR_FUSION_DET_025_028_oPCAN_RADAR_a5f85e5f_Rx: ComSignalType=UINT16
            DET_AZIMUTH_027_Rx_oRDR_FUSION_DET_025_028_oPCAN_RADAR_0abccc18_Rx: ComSignalType=UINT16
            DET_AZIMUTH_028_Rx_oRDR_FUSION_DET_025_028_oPCAN_RADAR_8af2beb0_Rx: ComSignalType=UINT16
            DET_AZIMUTH_ERR_025_Rx_oRDR_FUSION_DET_025_028_oPCAN_RADAR_8d2d4f55_Rx: ComSignalType=UINT8
            DET_AZIMUTH_ERR_026_Rx_oRDR_FUSION_DET_025_028_oPCAN_RADAR_a791ffdd_Rx: ComSignalType=UINT8
            DET_AZIMUTH_ERR_027_Rx_oRDR_FUSION_DET_025_028_oPCAN_RADAR_08d56d9a_Rx: ComSignalType=UINT8
            DET_AZIMUTH_ERR_028_Rx_oRDR_FUSION_DET_025_028_oPCAN_RADAR_889b1f32_Rx: ComSignalType=UINT8
            DET_BELOW_RAIN_THOLD_025_Rx_oRDR_FUSION_DET_025_028_oPCAN_RADAR_e9fe1162_Rx: ComSignalType=BOOLEAN
            DET_BELOW_RAIN_THOLD_026_Rx_oRDR_FUSION_DET_025_028_oPCAN_RADAR_c342a1ea_Rx: ComSignalType=BOOLEAN
            DET_BELOW_RAIN_THOLD_027_Rx_oRDR_FUSION_DET_025_028_oPCAN_RADAR_6c0633ad_Rx: ComSignalType=BOOLEAN
            DET_BELOW_RAIN_THOLD_028_Rx_oRDR_FUSION_DET_025_028_oPCAN_RADAR_ec484105_Rx: ComSignalType=BOOLEAN
            DET_BI_STATIC_FLAG_025_Rx_oRDR_FUSION_DET_025_028_oPCAN_RADAR_9e60ba71_Rx: ComSignalType=BOOLEAN
            DET_BI_STATIC_FLAG_026_Rx_oRDR_FUSION_DET_025_028_oPCAN_RADAR_b4dc0af9_Rx: ComSignalType=BOOLEAN
            DET_BI_STATIC_FLAG_027_Rx_oRDR_FUSION_DET_025_028_oPCAN_RADAR_1b9898be_Rx: ComSignalType=BOOLEAN
            DET_BI_STATIC_FLAG_028_Rx_oRDR_FUSION_DET_025_028_oPCAN_RADAR_9bd6ea16_Rx: ComSignalType=BOOLEAN
            DET_CONFD_AZIMUTH_025_Rx_oRDR_FUSION_DET_025_028_oPCAN_RADAR_7d095025_Rx: ComSignalType=UINT8
            DET_CONFD_AZIMUTH_026_Rx_oRDR_FUSION_DET_025_028_oPCAN_RADAR_57b5e0ad_Rx: ComSignalType=UINT8
            DET_CONFD_AZIMUTH_027_Rx_oRDR_FUSION_DET_025_028_oPCAN_RADAR_f8f172ea_Rx: ComSignalType=UINT8
            DET_CONFD_AZIMUTH_028_Rx_oRDR_FUSION_DET_025_028_oPCAN_RADAR_78bf0042_Rx: ComSignalType=UINT8
            DET_CONFD_ELEVATION_025_Rx_oRDR_FUSION_DET_025_028_oPCAN_RADAR_7728d3a2_Rx: ComSignalType=UINT8
            DET_CONFD_ELEVATION_026_Rx_oRDR_FUSION_DET_025_028_oPCAN_RADAR_5d94632a_Rx: ComSignalType=UINT8
            DET_CONFD_ELEVATION_027_Rx_oRDR_FUSION_DET_025_028_oPCAN_RADAR_f2d0f16d_Rx: ComSignalType=UINT8
            DET_CONFD_ELEVATION_028_Rx_oRDR_FUSION_DET_025_028_oPCAN_RADAR_729e83c5_Rx: ComSignalType=UINT8
            DET_ELEVATION_025_Rx_oRDR_FUSION_DET_025_028_oPCAN_RADAR_7d7b3c5b_Rx: ComSignalType=UINT8
            DET_ELEVATION_026_Rx_oRDR_FUSION_DET_025_028_oPCAN_RADAR_57c78cd3_Rx: ComSignalType=UINT8
            DET_ELEVATION_027_Rx_oRDR_FUSION_DET_025_028_oPCAN_RADAR_f8831e94_Rx: ComSignalType=UINT8
            DET_ELEVATION_028_Rx_oRDR_FUSION_DET_025_028_oPCAN_RADAR_78cd6c3c_Rx: ComSignalType=UINT8
            DET_ELEVATION_ERR_025_Rx_oRDR_FUSION_DET_025_028_oPCAN_RADAR_afc21e84_Rx: ComSignalType=UINT8
            DET_ELEVATION_ERR_026_Rx_oRDR_FUSION_DET_025_028_oPCAN_RADAR_857eae0c_Rx: ComSignalType=UINT8
            DET_ELEVATION_ERR_027_Rx_oRDR_FUSION_DET_025_028_oPCAN_RADAR_2a3a3c4b_Rx: ComSignalType=UINT8
            DET_ELEVATION_ERR_028_Rx_oRDR_FUSION_DET_025_028_oPCAN_RADAR_aa744ee3_Rx: ComSignalType=UINT8
            DET_EXISTENCE_PROB_025_Rx_oRDR_FUSION_DET_025_028_oPCAN_RADAR_58da6611_Rx: ComSignalType=UINT8
            DET_EXISTENCE_PROB_026_Rx_oRDR_FUSION_DET_025_028_oPCAN_RADAR_7266d699_Rx: ComSignalType=UINT8
            DET_EXISTENCE_PROB_027_Rx_oRDR_FUSION_DET_025_028_oPCAN_RADAR_dd2244de_Rx: ComSignalType=UINT8
            DET_EXISTENCE_PROB_028_Rx_oRDR_FUSION_DET_025_028_oPCAN_RADAR_5d6c3676_Rx: ComSignalType=UINT8
            DET_HVC_FLAG_025_Rx_oRDR_FUSION_DET_025_028_oPCAN_RADAR_85048b5e_Rx: ComSignalType=BOOLEAN
            DET_HVC_FLAG_026_Rx_oRDR_FUSION_DET_025_028_oPCAN_RADAR_afb83bd6_Rx: ComSignalType=BOOLEAN
            DET_HVC_FLAG_027_Rx_oRDR_FUSION_DET_025_028_oPCAN_RADAR_00fca991_Rx: ComSignalType=BOOLEAN
            DET_HVC_FLAG_028_Rx_oRDR_FUSION_DET_025_028_oPCAN_RADAR_80b2db39_Rx: ComSignalType=BOOLEAN
            DET_IDM_025_Rx_oRDR_FUSION_DET_025_028_oPCAN_RADAR_b0c57216_Rx: ComSignalType=BOOLEAN
            DET_IDM_026_Rx_oRDR_FUSION_DET_025_028_oPCAN_RADAR_9a79c29e_Rx: ComSignalType=BOOLEAN
            DET_IDM_027_Rx_oRDR_FUSION_DET_025_028_oPCAN_RADAR_353d50d9_Rx: ComSignalType=BOOLEAN
            DET_IDM_028_Rx_oRDR_FUSION_DET_025_028_oPCAN_RADAR_b5732271_Rx: ComSignalType=BOOLEAN
            DET_MH_CRC16_025_028_Rx_oRDR_FUSION_DET_025_028_oPCAN_RADAR_e7a9b4e9_Rx: ComSignalType=UINT16
            DET_MH_CYCLE_COUNTER_025_028_Rx_oRDR_FUSION_DET_025_028_oPCAN_RADAR_ea72892c_Rx: ComSignalType=UINT8
            DET_MH_SCAN_INDEX_4LSB_025_028_Rx_oRDR_FUSION_DET_025_028_oPCAN_RADAR_8ec24617_Rx: ComSignalType=UINT8
            DET_MTD_025_Rx_oRDR_FUSION_DET_025_028_oPCAN_RADAR_0d464466_Rx: ComSignalType=BOOLEAN
            DET_MTD_026_Rx_oRDR_FUSION_DET_025_028_oPCAN_RADAR_27faf4ee_Rx: ComSignalType=BOOLEAN
            DET_MTD_027_Rx_oRDR_FUSION_DET_025_028_oPCAN_RADAR_88be66a9_Rx: ComSignalType=BOOLEAN
            DET_MTD_028_Rx_oRDR_FUSION_DET_025_028_oPCAN_RADAR_08f01401_Rx: ComSignalType=BOOLEAN
            DET_PROB_1STAZHYPO_025_Rx_oRDR_FUSION_DET_025_028_oPCAN_RADAR_c73f5ae7_Rx: ComSignalType=BOOLEAN
            DET_PROB_1STAZHYPO_026_Rx_oRDR_FUSION_DET_025_028_oPCAN_RADAR_ed83ea6f_Rx: ComSignalType=BOOLEAN
            DET_PROB_1STAZHYPO_027_Rx_oRDR_FUSION_DET_025_028_oPCAN_RADAR_42c77828_Rx: ComSignalType=BOOLEAN
            DET_PROB_1STAZHYPO_028_Rx_oRDR_FUSION_DET_025_028_oPCAN_RADAR_c2890a80_Rx: ComSignalType=BOOLEAN
            DET_RANGE_025_Rx_oRDR_FUSION_DET_025_028_oPCAN_RADAR_9c82b2f0_Rx: ComSignalType=UINT16
            DET_RANGE_026_Rx_oRDR_FUSION_DET_025_028_oPCAN_RADAR_b63e0278_Rx: ComSignalType=UINT16
            DET_RANGE_027_Rx_oRDR_FUSION_DET_025_028_oPCAN_RADAR_197a903f_Rx: ComSignalType=UINT16
            DET_RANGE_028_Rx_oRDR_FUSION_DET_025_028_oPCAN_RADAR_9934e297_Rx: ComSignalType=UINT16
            DET_RANGE_ERR_025_Rx_oRDR_FUSION_DET_025_028_oPCAN_RADAR_cc703e10_Rx: ComSignalType=UINT8
            DET_RANGE_ERR_026_Rx_oRDR_FUSION_DET_025_028_oPCAN_RADAR_e6cc8e98_Rx: ComSignalType=UINT8
            DET_RANGE_ERR_027_Rx_oRDR_FUSION_DET_025_028_oPCAN_RADAR_49881cdf_Rx: ComSignalType=UINT8
            DET_RANGE_ERR_028_Rx_oRDR_FUSION_DET_025_028_oPCAN_RADAR_c9c66e77_Rx: ComSignalType=UINT8
            DET_RANGE_VELOCITY_025_Rx_oRDR_FUSION_DET_025_028_oPCAN_RADAR_4177310e_Rx: ComSignalType=UINT16
            DET_RANGE_VELOCITY_026_Rx_oRDR_FUSION_DET_025_028_oPCAN_RADAR_6bcb8186_Rx: ComSignalType=UINT16
            DET_RANGE_VELOCITY_027_Rx_oRDR_FUSION_DET_025_028_oPCAN_RADAR_c48f13c1_Rx: ComSignalType=UINT16
            DET_RANGE_VELOCITY_028_Rx_oRDR_FUSION_DET_025_028_oPCAN_RADAR_44c16169_Rx: ComSignalType=UINT16
            DET_RANGE_VELOCITY_ERR_025_Rx_oRDR_FUSION_DET_025_028_oPCAN_RADAR_d81341cc_Rx: ComSignalType=UINT8
            DET_RANGE_VELOCITY_ERR_026_Rx_oRDR_FUSION_DET_025_028_oPCAN_RADAR_f2aff144_Rx: ComSignalType=UINT8
            DET_RANGE_VELOCITY_ERR_027_Rx_oRDR_FUSION_DET_025_028_oPCAN_RADAR_5deb6303_Rx: ComSignalType=UINT8
            DET_RANGE_VELOCITY_ERR_028_Rx_oRDR_FUSION_DET_025_028_oPCAN_RADAR_dda511ab_Rx: ComSignalType=UINT8
            DET_RCS_025_Rx_oRDR_FUSION_DET_025_028_oPCAN_RADAR_8cbca315_Rx: ComSignalType=UINT8
            DET_RCS_026_Rx_oRDR_FUSION_DET_025_028_oPCAN_RADAR_a600139d_Rx: ComSignalType=UINT8
            DET_RCS_027_Rx_oRDR_FUSION_DET_025_028_oPCAN_RADAR_094481da_Rx: ComSignalType=UINT8
            DET_RCS_028_Rx_oRDR_FUSION_DET_025_028_oPCAN_RADAR_890af372_Rx: ComSignalType=UINT8
            DET_SNR_025_Rx_oRDR_FUSION_DET_025_028_oPCAN_RADAR_85e6d2fc_Rx: ComSignalType=UINT8
            DET_SNR_026_Rx_oRDR_FUSION_DET_025_028_oPCAN_RADAR_af5a6274_Rx: ComSignalType=UINT8
            DET_SNR_027_Rx_oRDR_FUSION_DET_025_028_oPCAN_RADAR_001ef033_Rx: ComSignalType=UINT8
            DET_SNR_028_Rx_oRDR_FUSION_DET_025_028_oPCAN_RADAR_8050829b_Rx: ComSignalType=UINT8
            DET_SUPER_RES_TARGET_025_Rx_oRDR_FUSION_DET_025_028_oPCAN_RADAR_4e1df3fc_Rx: ComSignalType=BOOLEAN
            DET_SUPER_RES_TARGET_026_Rx_oRDR_FUSION_DET_025_028_oPCAN_RADAR_64a14374_Rx: ComSignalType=BOOLEAN
            DET_SUPER_RES_TARGET_027_Rx_oRDR_FUSION_DET_025_028_oPCAN_RADAR_cbe5d133_Rx: ComSignalType=BOOLEAN
            DET_SUPER_RES_TARGET_028_Rx_oRDR_FUSION_DET_025_028_oPCAN_RADAR_4baba39b_Rx: ComSignalType=BOOLEAN
        SG_Fusion_Detections_029_032_oRDR_FUSION_DET_029_032_oPCAN_RADAR_3868beb2_Rx
          83 x ComGroupSignal:
            DET_AZIMUTH_029_Rx_oRDR_FUSION_DET_029_032_oPCAN_RADAR_17fec3f6_Rx: ComSignalType=UINT16
            DET_AZIMUTH_030_Rx_oRDR_FUSION_DET_029_032_oPCAN_RADAR_2ade40ef_Rx: ComSignalType=UINT16
            DET_AZIMUTH_031_Rx_oRDR_FUSION_DET_029_032_oPCAN_RADAR_859ad2a8_Rx: ComSignalType=UINT16
            DET_AZIMUTH_032_Rx_oRDR_FUSION_DET_029_032_oPCAN_RADAR_af266220_Rx: ComSignalType=UINT16
            DET_AZIMUTH_ERR_029_Rx_oRDR_FUSION_DET_029_032_oPCAN_RADAR_15976274_Rx: ComSignalType=UINT8
            DET_AZIMUTH_ERR_030_Rx_oRDR_FUSION_DET_029_032_oPCAN_RADAR_28b7e16d_Rx: ComSignalType=UINT8
            DET_AZIMUTH_ERR_031_Rx_oRDR_FUSION_DET_029_032_oPCAN_RADAR_87f3732a_Rx: ComSignalType=UINT8
            DET_AZIMUTH_ERR_032_Rx_oRDR_FUSION_DET_029_032_oPCAN_RADAR_ad4fc3a2_Rx: ComSignalType=UINT8
            DET_BELOW_RAIN_THOLD_029_Rx_oRDR_FUSION_DET_029_032_oPCAN_RADAR_71443c43_Rx: ComSignalType=BOOLEAN
            DET_BELOW_RAIN_THOLD_030_Rx_oRDR_FUSION_DET_029_032_oPCAN_RADAR_4c64bf5a_Rx: ComSignalType=BOOLEAN
            DET_BELOW_RAIN_THOLD_031_Rx_oRDR_FUSION_DET_029_032_oPCAN_RADAR_e3202d1d_Rx: ComSignalType=BOOLEAN
            DET_BELOW_RAIN_THOLD_032_Rx_oRDR_FUSION_DET_029_032_oPCAN_RADAR_c99c9d95_Rx: ComSignalType=BOOLEAN
            DET_BI_STATIC_FLAG_029_Rx_oRDR_FUSION_DET_029_032_oPCAN_RADAR_06da9750_Rx: ComSignalType=BOOLEAN
            DET_BI_STATIC_FLAG_030_Rx_oRDR_FUSION_DET_029_032_oPCAN_RADAR_3bfa1449_Rx: ComSignalType=BOOLEAN
            DET_BI_STATIC_FLAG_031_Rx_oRDR_FUSION_DET_029_032_oPCAN_RADAR_94be860e_Rx: ComSignalType=BOOLEAN
            DET_BI_STATIC_FLAG_032_Rx_oRDR_FUSION_DET_029_032_oPCAN_RADAR_be023686_Rx: ComSignalType=BOOLEAN
            DET_CONFD_AZIMUTH_029_Rx_oRDR_FUSION_DET_029_032_oPCAN_RADAR_e5b37d04_Rx: ComSignalType=UINT8
            DET_CONFD_AZIMUTH_030_Rx_oRDR_FUSION_DET_029_032_oPCAN_RADAR_d893fe1d_Rx: ComSignalType=UINT8
            DET_CONFD_AZIMUTH_031_Rx_oRDR_FUSION_DET_029_032_oPCAN_RADAR_77d76c5a_Rx: ComSignalType=UINT8
            DET_CONFD_AZIMUTH_032_Rx_oRDR_FUSION_DET_029_032_oPCAN_RADAR_5d6bdcd2_Rx: ComSignalType=UINT8
            DET_CONFD_ELEVATION_029_Rx_oRDR_FUSION_DET_029_032_oPCAN_RADAR_ef92fe83_Rx: ComSignalType=UINT8
            DET_CONFD_ELEVATION_030_Rx_oRDR_FUSION_DET_029_032_oPCAN_RADAR_d2b27d9a_Rx: ComSignalType=UINT8
            DET_CONFD_ELEVATION_031_Rx_oRDR_FUSION_DET_029_032_oPCAN_RADAR_7df6efdd_Rx: ComSignalType=UINT8
            DET_CONFD_ELEVATION_032_Rx_oRDR_FUSION_DET_029_032_oPCAN_RADAR_574a5f55_Rx: ComSignalType=UINT8
            DET_ELEVATION_029_Rx_oRDR_FUSION_DET_029_032_oPCAN_RADAR_e5c1117a_Rx: ComSignalType=UINT8
            DET_ELEVATION_030_Rx_oRDR_FUSION_DET_029_032_oPCAN_RADAR_d8e19263_Rx: ComSignalType=UINT8
            DET_ELEVATION_031_Rx_oRDR_FUSION_DET_029_032_oPCAN_RADAR_77a50024_Rx: ComSignalType=UINT8
            DET_ELEVATION_032_Rx_oRDR_FUSION_DET_029_032_oPCAN_RADAR_5d19b0ac_Rx: ComSignalType=UINT8
            DET_ELEVATION_ERR_029_Rx_oRDR_FUSION_DET_029_032_oPCAN_RADAR_377833a5_Rx: ComSignalType=UINT8
            DET_ELEVATION_ERR_030_Rx_oRDR_FUSION_DET_029_032_oPCAN_RADAR_0a58b0bc_Rx: ComSignalType=UINT8
            DET_ELEVATION_ERR_031_Rx_oRDR_FUSION_DET_029_032_oPCAN_RADAR_a51c22fb_Rx: ComSignalType=UINT8
            DET_ELEVATION_ERR_032_Rx_oRDR_FUSION_DET_029_032_oPCAN_RADAR_8fa09273_Rx: ComSignalType=UINT8
            DET_EXISTENCE_PROB_029_Rx_oRDR_FUSION_DET_029_032_oPCAN_RADAR_c0604b30_Rx: ComSignalType=UINT8
            DET_EXISTENCE_PROB_030_Rx_oRDR_FUSION_DET_029_032_oPCAN_RADAR_fd40c829_Rx: ComSignalType=UINT8
            DET_EXISTENCE_PROB_031_Rx_oRDR_FUSION_DET_029_032_oPCAN_RADAR_52045a6e_Rx: ComSignalType=UINT8
            DET_EXISTENCE_PROB_032_Rx_oRDR_FUSION_DET_029_032_oPCAN_RADAR_78b8eae6_Rx: ComSignalType=UINT8
            DET_HVC_FLAG_029_Rx_oRDR_FUSION_DET_029_032_oPCAN_RADAR_1dbea67f_Rx: ComSignalType=BOOLEAN
            DET_HVC_FLAG_030_Rx_oRDR_FUSION_DET_029_032_oPCAN_RADAR_209e2566_Rx: ComSignalType=BOOLEAN
            DET_HVC_FLAG_031_Rx_oRDR_FUSION_DET_029_032_oPCAN_RADAR_8fdab721_Rx: ComSignalType=BOOLEAN
            DET_HVC_FLAG_032_Rx_oRDR_FUSION_DET_029_032_oPCAN_RADAR_a56607a9_Rx: ComSignalType=BOOLEAN
            DET_IDM_029_Rx_oRDR_FUSION_DET_029_032_oPCAN_RADAR_287f5f37_Rx: ComSignalType=BOOLEAN
            DET_IDM_030_Rx_oRDR_FUSION_DET_029_032_oPCAN_RADAR_155fdc2e_Rx: ComSignalType=BOOLEAN
            DET_IDM_031_Rx_oRDR_FUSION_DET_029_032_oPCAN_RADAR_ba1b4e69_Rx: ComSignalType=BOOLEAN
            DET_IDM_032_Rx_oRDR_FUSION_DET_029_032_oPCAN_RADAR_90a7fee1_Rx: ComSignalType=BOOLEAN
            DET_MH_CRC16_029_032_Rx_oRDR_FUSION_DET_029_032_oPCAN_RADAR_e0ed4ca0_Rx: ComSignalType=UINT16
            DET_MH_CYCLE_COUNTER_029_032_Rx_oRDR_FUSION_DET_029_032_oPCAN_RADAR_ed367165_Rx: ComSignalType=UINT8
            DET_MH_SCAN_INDEX_4LSB_029_032_Rx_oRDR_FUSION_DET_029_032_oPCAN_RADAR_8986be5e_Rx: ComSignalType=UINT8
            DET_MTD_029_Rx_oRDR_FUSION_DET_029_032_oPCAN_RADAR_95fc6947_Rx: ComSignalType=BOOLEAN
            DET_MTD_030_Rx_oRDR_FUSION_DET_029_032_oPCAN_RADAR_a8dcea5e_Rx: ComSignalType=BOOLEAN
            DET_MTD_031_Rx_oRDR_FUSION_DET_029_032_oPCAN_RADAR_07987819_Rx: ComSignalType=BOOLEAN
            DET_MTD_032_Rx_oRDR_FUSION_DET_029_032_oPCAN_RADAR_2d24c891_Rx: ComSignalType=BOOLEAN
            DET_PROB_1STAZHYPO_029_Rx_oRDR_FUSION_DET_029_032_oPCAN_RADAR_5f8577c6_Rx: ComSignalType=BOOLEAN
            DET_PROB_1STAZHYPO_030_Rx_oRDR_FUSION_DET_029_032_oPCAN_RADAR_62a5f4df_Rx: ComSignalType=BOOLEAN
            DET_PROB_1STAZHYPO_031_Rx_oRDR_FUSION_DET_029_032_oPCAN_RADAR_cde16698_Rx: ComSignalType=BOOLEAN
            DET_PROB_1STAZHYPO_032_Rx_oRDR_FUSION_DET_029_032_oPCAN_RADAR_e75dd610_Rx: ComSignalType=BOOLEAN
            DET_RANGE_029_Rx_oRDR_FUSION_DET_029_032_oPCAN_RADAR_04389fd1_Rx: ComSignalType=UINT16
            DET_RANGE_030_Rx_oRDR_FUSION_DET_029_032_oPCAN_RADAR_39181cc8_Rx: ComSignalType=UINT16
            DET_RANGE_031_Rx_oRDR_FUSION_DET_029_032_oPCAN_RADAR_965c8e8f_Rx: ComSignalType=UINT16
            DET_RANGE_032_Rx_oRDR_FUSION_DET_029_032_oPCAN_RADAR_bce03e07_Rx: ComSignalType=UINT16
            DET_RANGE_ERR_029_Rx_oRDR_FUSION_DET_029_032_oPCAN_RADAR_54ca1331_Rx: ComSignalType=UINT8
            DET_RANGE_ERR_030_Rx_oRDR_FUSION_DET_029_032_oPCAN_RADAR_69ea9028_Rx: ComSignalType=UINT8
            DET_RANGE_ERR_031_Rx_oRDR_FUSION_DET_029_032_oPCAN_RADAR_c6ae026f_Rx: ComSignalType=UINT8
            DET_RANGE_ERR_032_Rx_oRDR_FUSION_DET_029_032_oPCAN_RADAR_ec12b2e7_Rx: ComSignalType=UINT8
            DET_RANGE_VELOCITY_029_Rx_oRDR_FUSION_DET_029_032_oPCAN_RADAR_d9cd1c2f_Rx: ComSignalType=UINT16
            DET_RANGE_VELOCITY_030_Rx_oRDR_FUSION_DET_029_032_oPCAN_RADAR_e4ed9f36_Rx: ComSignalType=UINT16
            DET_RANGE_VELOCITY_031_Rx_oRDR_FUSION_DET_029_032_oPCAN_RADAR_4ba90d71_Rx: ComSignalType=UINT16
            DET_RANGE_VELOCITY_032_Rx_oRDR_FUSION_DET_029_032_oPCAN_RADAR_6115bdf9_Rx: ComSignalType=UINT16
            DET_RANGE_VELOCITY_ERR_029_Rx_oRDR_FUSION_DET_029_032_oPCAN_RADAR_40a96ced_Rx: ComSignalType=UINT8
            DET_RANGE_VELOCITY_ERR_030_Rx_oRDR_FUSION_DET_029_032_oPCAN_RADAR_7d89eff4_Rx: ComSignalType=UINT8
            DET_RANGE_VELOCITY_ERR_031_Rx_oRDR_FUSION_DET_029_032_oPCAN_RADAR_d2cd7db3_Rx: ComSignalType=UINT8
            DET_RANGE_VELOCITY_ERR_032_Rx_oRDR_FUSION_DET_029_032_oPCAN_RADAR_f871cd3b_Rx: ComSignalType=UINT8
            DET_RCS_029_Rx_oRDR_FUSION_DET_029_032_oPCAN_RADAR_14068e34_Rx: ComSignalType=UINT8
            DET_RCS_030_Rx_oRDR_FUSION_DET_029_032_oPCAN_RADAR_29260d2d_Rx: ComSignalType=UINT8
            DET_RCS_031_Rx_oRDR_FUSION_DET_029_032_oPCAN_RADAR_86629f6a_Rx: ComSignalType=UINT8
            DET_RCS_032_Rx_oRDR_FUSION_DET_029_032_oPCAN_RADAR_acde2fe2_Rx: ComSignalType=UINT8
            DET_SNR_029_Rx_oRDR_FUSION_DET_029_032_oPCAN_RADAR_1d5cffdd_Rx: ComSignalType=UINT8
            DET_SNR_030_Rx_oRDR_FUSION_DET_029_032_oPCAN_RADAR_207c7cc4_Rx: ComSignalType=UINT8
            DET_SNR_031_Rx_oRDR_FUSION_DET_029_032_oPCAN_RADAR_8f38ee83_Rx: ComSignalType=UINT8
            DET_SNR_032_Rx_oRDR_FUSION_DET_029_032_oPCAN_RADAR_a5845e0b_Rx: ComSignalType=UINT8
            DET_SUPER_RES_TARGET_029_Rx_oRDR_FUSION_DET_029_032_oPCAN_RADAR_d6a7dedd_Rx: ComSignalType=BOOLEAN
            DET_SUPER_RES_TARGET_030_Rx_oRDR_FUSION_DET_029_032_oPCAN_RADAR_eb875dc4_Rx: ComSignalType=BOOLEAN
            DET_SUPER_RES_TARGET_031_Rx_oRDR_FUSION_DET_029_032_oPCAN_RADAR_44c3cf83_Rx: ComSignalType=BOOLEAN
            DET_SUPER_RES_TARGET_032_Rx_oRDR_FUSION_DET_029_032_oPCAN_RADAR_6e7f7f0b_Rx: ComSignalType=BOOLEAN
        SG_Fusion_Detections_033_036_oRDR_FUSION_DET_033_036_oPCAN_RADAR_cce3d4c2_Rx
          83 x ComGroupSignal:
            DET_AZIMUTH_033_Rx_oRDR_FUSION_DET_033_036_oPCAN_RADAR_1da5f349_Rx: ComSignalType=UINT16
            DET_AZIMUTH_034_Rx_oRDR_FUSION_DET_033_036_oPCAN_RADAR_e798001e_Rx: ComSignalType=UINT16
            DET_AZIMUTH_035_Rx_oRDR_FUSION_DET_033_036_oPCAN_RADAR_48dc9259_Rx: ComSignalType=UINT16
            DET_AZIMUTH_036_Rx_oRDR_FUSION_DET_033_036_oPCAN_RADAR_626022d1_Rx: ComSignalType=UINT16
            DET_AZIMUTH_ERR_033_Rx_oRDR_FUSION_DET_033_036_oPCAN_RADAR_1fcc52cb_Rx: ComSignalType=UINT8
            DET_AZIMUTH_ERR_034_Rx_oRDR_FUSION_DET_033_036_oPCAN_RADAR_e5f1a19c_Rx: ComSignalType=UINT8
            DET_AZIMUTH_ERR_035_Rx_oRDR_FUSION_DET_033_036_oPCAN_RADAR_4ab533db_Rx: ComSignalType=UINT8
            DET_AZIMUTH_ERR_036_Rx_oRDR_FUSION_DET_033_036_oPCAN_RADAR_60098353_Rx: ComSignalType=UINT8
            DET_BELOW_RAIN_THOLD_033_Rx_oRDR_FUSION_DET_033_036_oPCAN_RADAR_7b1f0cfc_Rx: ComSignalType=BOOLEAN
            DET_BELOW_RAIN_THOLD_034_Rx_oRDR_FUSION_DET_033_036_oPCAN_RADAR_8122ffab_Rx: ComSignalType=BOOLEAN
            DET_BELOW_RAIN_THOLD_035_Rx_oRDR_FUSION_DET_033_036_oPCAN_RADAR_2e666dec_Rx: ComSignalType=BOOLEAN
            DET_BELOW_RAIN_THOLD_036_Rx_oRDR_FUSION_DET_033_036_oPCAN_RADAR_04dadd64_Rx: ComSignalType=BOOLEAN
            DET_BI_STATIC_FLAG_033_Rx_oRDR_FUSION_DET_033_036_oPCAN_RADAR_0c81a7ef_Rx: ComSignalType=BOOLEAN
            DET_BI_STATIC_FLAG_034_Rx_oRDR_FUSION_DET_033_036_oPCAN_RADAR_f6bc54b8_Rx: ComSignalType=BOOLEAN
            DET_BI_STATIC_FLAG_035_Rx_oRDR_FUSION_DET_033_036_oPCAN_RADAR_59f8c6ff_Rx: ComSignalType=BOOLEAN
            DET_BI_STATIC_FLAG_036_Rx_oRDR_FUSION_DET_033_036_oPCAN_RADAR_73447677_Rx: ComSignalType=BOOLEAN
            DET_CONFD_AZIMUTH_033_Rx_oRDR_FUSION_DET_033_036_oPCAN_RADAR_efe84dbb_Rx: ComSignalType=UINT8
            DET_CONFD_AZIMUTH_034_Rx_oRDR_FUSION_DET_033_036_oPCAN_RADAR_15d5beec_Rx: ComSignalType=UINT8
            DET_CONFD_AZIMUTH_035_Rx_oRDR_FUSION_DET_033_036_oPCAN_RADAR_ba912cab_Rx: ComSignalType=UINT8
            DET_CONFD_AZIMUTH_036_Rx_oRDR_FUSION_DET_033_036_oPCAN_RADAR_902d9c23_Rx: ComSignalType=UINT8
            DET_CONFD_ELEVATION_033_Rx_oRDR_FUSION_DET_033_036_oPCAN_RADAR_e5c9ce3c_Rx: ComSignalType=UINT8
            DET_CONFD_ELEVATION_034_Rx_oRDR_FUSION_DET_033_036_oPCAN_RADAR_1ff43d6b_Rx: ComSignalType=UINT8
            DET_CONFD_ELEVATION_035_Rx_oRDR_FUSION_DET_033_036_oPCAN_RADAR_b0b0af2c_Rx: ComSignalType=UINT8
            DET_CONFD_ELEVATION_036_Rx_oRDR_FUSION_DET_033_036_oPCAN_RADAR_9a0c1fa4_Rx: ComSignalType=UINT8
            DET_ELEVATION_033_Rx_oRDR_FUSION_DET_033_036_oPCAN_RADAR_ef9a21c5_Rx: ComSignalType=UINT8
            DET_ELEVATION_034_Rx_oRDR_FUSION_DET_033_036_oPCAN_RADAR_15a7d292_Rx: ComSignalType=UINT8
            DET_ELEVATION_035_Rx_oRDR_FUSION_DET_033_036_oPCAN_RADAR_bae340d5_Rx: ComSignalType=UINT8
            DET_ELEVATION_036_Rx_oRDR_FUSION_DET_033_036_oPCAN_RADAR_905ff05d_Rx: ComSignalType=UINT8
            DET_ELEVATION_ERR_033_Rx_oRDR_FUSION_DET_033_036_oPCAN_RADAR_3d23031a_Rx: ComSignalType=UINT8
            DET_ELEVATION_ERR_034_Rx_oRDR_FUSION_DET_033_036_oPCAN_RADAR_c71ef04d_Rx: ComSignalType=UINT8
            DET_ELEVATION_ERR_035_Rx_oRDR_FUSION_DET_033_036_oPCAN_RADAR_685a620a_Rx: ComSignalType=UINT8
            DET_ELEVATION_ERR_036_Rx_oRDR_FUSION_DET_033_036_oPCAN_RADAR_42e6d282_Rx: ComSignalType=UINT8
            DET_EXISTENCE_PROB_033_Rx_oRDR_FUSION_DET_033_036_oPCAN_RADAR_ca3b7b8f_Rx: ComSignalType=UINT8
            DET_EXISTENCE_PROB_034_Rx_oRDR_FUSION_DET_033_036_oPCAN_RADAR_300688d8_Rx: ComSignalType=UINT8
            DET_EXISTENCE_PROB_035_Rx_oRDR_FUSION_DET_033_036_oPCAN_RADAR_9f421a9f_Rx: ComSignalType=UINT8
            DET_EXISTENCE_PROB_036_Rx_oRDR_FUSION_DET_033_036_oPCAN_RADAR_b5feaa17_Rx: ComSignalType=UINT8
            DET_HVC_FLAG_033_Rx_oRDR_FUSION_DET_033_036_oPCAN_RADAR_17e596c0_Rx: ComSignalType=BOOLEAN
            DET_HVC_FLAG_034_Rx_oRDR_FUSION_DET_033_036_oPCAN_RADAR_edd86597_Rx: ComSignalType=BOOLEAN
            DET_HVC_FLAG_035_Rx_oRDR_FUSION_DET_033_036_oPCAN_RADAR_429cf7d0_Rx: ComSignalType=BOOLEAN
            DET_HVC_FLAG_036_Rx_oRDR_FUSION_DET_033_036_oPCAN_RADAR_68204758_Rx: ComSignalType=BOOLEAN
            DET_IDM_033_Rx_oRDR_FUSION_DET_033_036_oPCAN_RADAR_22246f88_Rx: ComSignalType=BOOLEAN
            DET_IDM_034_Rx_oRDR_FUSION_DET_033_036_oPCAN_RADAR_d8199cdf_Rx: ComSignalType=BOOLEAN
            DET_IDM_035_Rx_oRDR_FUSION_DET_033_036_oPCAN_RADAR_775d0e98_Rx: ComSignalType=BOOLEAN
            DET_IDM_036_Rx_oRDR_FUSION_DET_033_036_oPCAN_RADAR_5de1be10_Rx: ComSignalType=BOOLEAN
            DET_MH_CRC16_033_036_Rx_oRDR_FUSION_DET_033_036_oPCAN_RADAR_505d9188_Rx: ComSignalType=UINT16
            DET_MH_CYCLE_COUNTER_033_036_Rx_oRDR_FUSION_DET_033_036_oPCAN_RADAR_5d86ac4d_Rx: ComSignalType=UINT8
            DET_MH_SCAN_INDEX_4LSB_033_036_Rx_oRDR_FUSION_DET_033_036_oPCAN_RADAR_39366376_Rx: ComSignalType=UINT8
            DET_MTD_033_Rx_oRDR_FUSION_DET_033_036_oPCAN_RADAR_9fa759f8_Rx: ComSignalType=BOOLEAN
            DET_MTD_034_Rx_oRDR_FUSION_DET_033_036_oPCAN_RADAR_659aaaaf_Rx: ComSignalType=BOOLEAN
            DET_MTD_035_Rx_oRDR_FUSION_DET_033_036_oPCAN_RADAR_cade38e8_Rx: ComSignalType=BOOLEAN
            DET_MTD_036_Rx_oRDR_FUSION_DET_033_036_oPCAN_RADAR_e0628860_Rx: ComSignalType=BOOLEAN
            DET_PROB_1STAZHYPO_033_Rx_oRDR_FUSION_DET_033_036_oPCAN_RADAR_55de4779_Rx: ComSignalType=BOOLEAN
            DET_PROB_1STAZHYPO_034_Rx_oRDR_FUSION_DET_033_036_oPCAN_RADAR_afe3b42e_Rx: ComSignalType=BOOLEAN
            DET_PROB_1STAZHYPO_035_Rx_oRDR_FUSION_DET_033_036_oPCAN_RADAR_00a72669_Rx: ComSignalType=BOOLEAN
            DET_PROB_1STAZHYPO_036_Rx_oRDR_FUSION_DET_033_036_oPCAN_RADAR_2a1b96e1_Rx: ComSignalType=BOOLEAN
            DET_RANGE_033_Rx_oRDR_FUSION_DET_033_036_oPCAN_RADAR_0e63af6e_Rx: ComSignalType=UINT16
            DET_RANGE_034_Rx_oRDR_FUSION_DET_033_036_oPCAN_RADAR_f45e5c39_Rx: ComSignalType=UINT16
            DET_RANGE_035_Rx_oRDR_FUSION_DET_033_036_oPCAN_RADAR_5b1ace7e_Rx: ComSignalType=UINT16
            DET_RANGE_036_Rx_oRDR_FUSION_DET_033_036_oPCAN_RADAR_71a67ef6_Rx: ComSignalType=UINT16
            DET_RANGE_ERR_033_Rx_oRDR_FUSION_DET_033_036_oPCAN_RADAR_5e91238e_Rx: ComSignalType=UINT8
            DET_RANGE_ERR_034_Rx_oRDR_FUSION_DET_033_036_oPCAN_RADAR_a4acd0d9_Rx: ComSignalType=UINT8
            DET_RANGE_ERR_035_Rx_oRDR_FUSION_DET_033_036_oPCAN_RADAR_0be8429e_Rx: ComSignalType=UINT8
            DET_RANGE_ERR_036_Rx_oRDR_FUSION_DET_033_036_oPCAN_RADAR_2154f216_Rx: ComSignalType=UINT8
            DET_RANGE_VELOCITY_033_Rx_oRDR_FUSION_DET_033_036_oPCAN_RADAR_d3962c90_Rx: ComSignalType=UINT16
            DET_RANGE_VELOCITY_034_Rx_oRDR_FUSION_DET_033_036_oPCAN_RADAR_29abdfc7_Rx: ComSignalType=UINT16
            DET_RANGE_VELOCITY_035_Rx_oRDR_FUSION_DET_033_036_oPCAN_RADAR_86ef4d80_Rx: ComSignalType=UINT16
            DET_RANGE_VELOCITY_036_Rx_oRDR_FUSION_DET_033_036_oPCAN_RADAR_ac53fd08_Rx: ComSignalType=UINT16
            DET_RANGE_VELOCITY_ERR_033_Rx_oRDR_FUSION_DET_033_036_oPCAN_RADAR_4af25c52_Rx: ComSignalType=UINT8
            DET_RANGE_VELOCITY_ERR_034_Rx_oRDR_FUSION_DET_033_036_oPCAN_RADAR_b0cfaf05_Rx: ComSignalType=UINT8
            DET_RANGE_VELOCITY_ERR_035_Rx_oRDR_FUSION_DET_033_036_oPCAN_RADAR_1f8b3d42_Rx: ComSignalType=UINT8
            DET_RANGE_VELOCITY_ERR_036_Rx_oRDR_FUSION_DET_033_036_oPCAN_RADAR_35378dca_Rx: ComSignalType=UINT8
            DET_RCS_033_Rx_oRDR_FUSION_DET_033_036_oPCAN_RADAR_1e5dbe8b_Rx: ComSignalType=UINT8
            DET_RCS_034_Rx_oRDR_FUSION_DET_033_036_oPCAN_RADAR_e4604ddc_Rx: ComSignalType=UINT8
            DET_RCS_035_Rx_oRDR_FUSION_DET_033_036_oPCAN_RADAR_4b24df9b_Rx: ComSignalType=UINT8
            DET_RCS_036_Rx_oRDR_FUSION_DET_033_036_oPCAN_RADAR_61986f13_Rx: ComSignalType=UINT8
            DET_SNR_033_Rx_oRDR_FUSION_DET_033_036_oPCAN_RADAR_1707cf62_Rx: ComSignalType=UINT8
            DET_SNR_034_Rx_oRDR_FUSION_DET_033_036_oPCAN_RADAR_ed3a3c35_Rx: ComSignalType=UINT8
            DET_SNR_035_Rx_oRDR_FUSION_DET_033_036_oPCAN_RADAR_427eae72_Rx: ComSignalType=UINT8
            DET_SNR_036_Rx_oRDR_FUSION_DET_033_036_oPCAN_RADAR_68c21efa_Rx: ComSignalType=UINT8
            DET_SUPER_RES_TARGET_033_Rx_oRDR_FUSION_DET_033_036_oPCAN_RADAR_dcfcee62_Rx: ComSignalType=BOOLEAN
            DET_SUPER_RES_TARGET_034_Rx_oRDR_FUSION_DET_033_036_oPCAN_RADAR_26c11d35_Rx: ComSignalType=BOOLEAN
            DET_SUPER_RES_TARGET_035_Rx_oRDR_FUSION_DET_033_036_oPCAN_RADAR_89858f72_Rx: ComSignalType=BOOLEAN
            DET_SUPER_RES_TARGET_036_Rx_oRDR_FUSION_DET_033_036_oPCAN_RADAR_a3393ffa_Rx: ComSignalType=BOOLEAN
        SG_Fusion_Detections_037_040_oRDR_FUSION_DET_037_040_oPCAN_RADAR_cee54bfa_Rx
          83 x ComGroupSignal:
            DET_AZIMUTH_037_Rx_oRDR_FUSION_DET_037_040_oPCAN_RADAR_7b04e244_Rx: ComSignalType=UINT16
            DET_AZIMUTH_038_Rx_oRDR_FUSION_DET_037_040_oPCAN_RADAR_fb4a90ec_Rx: ComSignalType=UINT16
            DET_AZIMUTH_039_Rx_oRDR_FUSION_DET_037_040_oPCAN_RADAR_540e02ab_Rx: ComSignalType=UINT16
            DET_AZIMUTH_040_Rx_oRDR_FUSION_DET_037_040_oPCAN_RADAR_74cce8b7_Rx: ComSignalType=UINT16
            DET_AZIMUTH_ERR_037_Rx_oRDR_FUSION_DET_037_040_oPCAN_RADAR_796d43c6_Rx: ComSignalType=UINT8
            DET_AZIMUTH_ERR_038_Rx_oRDR_FUSION_DET_037_040_oPCAN_RADAR_f923316e_Rx: ComSignalType=UINT8
            DET_AZIMUTH_ERR_039_Rx_oRDR_FUSION_DET_037_040_oPCAN_RADAR_5667a329_Rx: ComSignalType=UINT8
            DET_AZIMUTH_ERR_040_Rx_oRDR_FUSION_DET_037_040_oPCAN_RADAR_76a54935_Rx: ComSignalType=UINT8
            DET_BELOW_RAIN_THOLD_037_Rx_oRDR_FUSION_DET_037_040_oPCAN_RADAR_1dbe1df1_Rx: ComSignalType=BOOLEAN
            DET_BELOW_RAIN_THOLD_038_Rx_oRDR_FUSION_DET_037_040_oPCAN_RADAR_9df06f59_Rx: ComSignalType=BOOLEAN
            DET_BELOW_RAIN_THOLD_039_Rx_oRDR_FUSION_DET_037_040_oPCAN_RADAR_32b4fd1e_Rx: ComSignalType=BOOLEAN
            DET_BELOW_RAIN_THOLD_040_Rx_oRDR_FUSION_DET_037_040_oPCAN_RADAR_12761702_Rx: ComSignalType=BOOLEAN
            DET_BI_STATIC_FLAG_037_Rx_oRDR_FUSION_DET_037_040_oPCAN_RADAR_6a20b6e2_Rx: ComSignalType=BOOLEAN
            DET_BI_STATIC_FLAG_038_Rx_oRDR_FUSION_DET_037_040_oPCAN_RADAR_ea6ec44a_Rx: ComSignalType=BOOLEAN
            DET_BI_STATIC_FLAG_039_Rx_oRDR_FUSION_DET_037_040_oPCAN_RADAR_452a560d_Rx: ComSignalType=BOOLEAN
            DET_BI_STATIC_FLAG_040_Rx_oRDR_FUSION_DET_037_040_oPCAN_RADAR_65e8bc11_Rx: ComSignalType=BOOLEAN
            DET_CONFD_AZIMUTH_037_Rx_oRDR_FUSION_DET_037_040_oPCAN_RADAR_89495cb6_Rx: ComSignalType=UINT8
            DET_CONFD_AZIMUTH_038_Rx_oRDR_FUSION_DET_037_040_oPCAN_RADAR_09072e1e_Rx: ComSignalType=UINT8
            DET_CONFD_AZIMUTH_039_Rx_oRDR_FUSION_DET_037_040_oPCAN_RADAR_a643bc59_Rx: ComSignalType=UINT8
            DET_CONFD_AZIMUTH_040_Rx_oRDR_FUSION_DET_037_040_oPCAN_RADAR_86815645_Rx: ComSignalType=UINT8
            DET_CONFD_ELEVATION_037_Rx_oRDR_FUSION_DET_037_040_oPCAN_RADAR_8368df31_Rx: ComSignalType=UINT8
            DET_CONFD_ELEVATION_038_Rx_oRDR_FUSION_DET_037_040_oPCAN_RADAR_0326ad99_Rx: ComSignalType=UINT8
            DET_CONFD_ELEVATION_039_Rx_oRDR_FUSION_DET_037_040_oPCAN_RADAR_ac623fde_Rx: ComSignalType=UINT8
            DET_CONFD_ELEVATION_040_Rx_oRDR_FUSION_DET_037_040_oPCAN_RADAR_8ca0d5c2_Rx: ComSignalType=UINT8
            DET_ELEVATION_037_Rx_oRDR_FUSION_DET_037_040_oPCAN_RADAR_893b30c8_Rx: ComSignalType=UINT8
            DET_ELEVATION_038_Rx_oRDR_FUSION_DET_037_040_oPCAN_RADAR_09754260_Rx: ComSignalType=UINT8
            DET_ELEVATION_039_Rx_oRDR_FUSION_DET_037_040_oPCAN_RADAR_a631d027_Rx: ComSignalType=UINT8
            DET_ELEVATION_040_Rx_oRDR_FUSION_DET_037_040_oPCAN_RADAR_86f33a3b_Rx: ComSignalType=UINT8
            DET_ELEVATION_ERR_037_Rx_oRDR_FUSION_DET_037_040_oPCAN_RADAR_5b821217_Rx: ComSignalType=UINT8
            DET_ELEVATION_ERR_038_Rx_oRDR_FUSION_DET_037_040_oPCAN_RADAR_dbcc60bf_Rx: ComSignalType=UINT8
            DET_ELEVATION_ERR_039_Rx_oRDR_FUSION_DET_037_040_oPCAN_RADAR_7488f2f8_Rx: ComSignalType=UINT8
            DET_ELEVATION_ERR_040_Rx_oRDR_FUSION_DET_037_040_oPCAN_RADAR_544a18e4_Rx: ComSignalType=UINT8
            DET_EXISTENCE_PROB_037_Rx_oRDR_FUSION_DET_037_040_oPCAN_RADAR_ac9a6a82_Rx: ComSignalType=UINT8
            DET_EXISTENCE_PROB_038_Rx_oRDR_FUSION_DET_037_040_oPCAN_RADAR_2cd4182a_Rx: ComSignalType=UINT8
            DET_EXISTENCE_PROB_039_Rx_oRDR_FUSION_DET_037_040_oPCAN_RADAR_83908a6d_Rx: ComSignalType=UINT8
            DET_EXISTENCE_PROB_040_Rx_oRDR_FUSION_DET_037_040_oPCAN_RADAR_a3526071_Rx: ComSignalType=UINT8
            DET_HVC_FLAG_037_Rx_oRDR_FUSION_DET_037_040_oPCAN_RADAR_714487cd_Rx: ComSignalType=BOOLEAN
            DET_HVC_FLAG_038_Rx_oRDR_FUSION_DET_037_040_oPCAN_RADAR_f10af565_Rx: ComSignalType=BOOLEAN
            DET_HVC_FLAG_039_Rx_oRDR_FUSION_DET_037_040_oPCAN_RADAR_5e4e6722_Rx: ComSignalType=BOOLEAN
            DET_HVC_FLAG_040_Rx_oRDR_FUSION_DET_037_040_oPCAN_RADAR_7e8c8d3e_Rx: ComSignalType=BOOLEAN
            DET_IDM_037_Rx_oRDR_FUSION_DET_037_040_oPCAN_RADAR_44857e85_Rx: ComSignalType=BOOLEAN
            DET_IDM_038_Rx_oRDR_FUSION_DET_037_040_oPCAN_RADAR_c4cb0c2d_Rx: ComSignalType=BOOLEAN
            DET_IDM_039_Rx_oRDR_FUSION_DET_037_040_oPCAN_RADAR_6b8f9e6a_Rx: ComSignalType=BOOLEAN
            DET_IDM_040_Rx_oRDR_FUSION_DET_037_040_oPCAN_RADAR_4b4d7476_Rx: ComSignalType=BOOLEAN
            DET_MH_CRC16_037_040_Rx_oRDR_FUSION_DET_037_040_oPCAN_RADAR_ee51ba66_Rx: ComSignalType=UINT16
            DET_MH_CYCLE_COUNTER_037_040_Rx_oRDR_FUSION_DET_037_040_oPCAN_RADAR_e38a87a3_Rx: ComSignalType=UINT8
            DET_MH_SCAN_INDEX_4LSB_037_040_Rx_oRDR_FUSION_DET_037_040_oPCAN_RADAR_873a4898_Rx: ComSignalType=UINT8
            DET_MTD_037_Rx_oRDR_FUSION_DET_037_040_oPCAN_RADAR_f90648f5_Rx: ComSignalType=BOOLEAN
            DET_MTD_038_Rx_oRDR_FUSION_DET_037_040_oPCAN_RADAR_79483a5d_Rx: ComSignalType=BOOLEAN
            DET_MTD_039_Rx_oRDR_FUSION_DET_037_040_oPCAN_RADAR_d60ca81a_Rx: ComSignalType=BOOLEAN
            DET_MTD_040_Rx_oRDR_FUSION_DET_037_040_oPCAN_RADAR_f6ce4206_Rx: ComSignalType=BOOLEAN
            DET_PROB_1STAZHYPO_037_Rx_oRDR_FUSION_DET_037_040_oPCAN_RADAR_337f5674_Rx: ComSignalType=BOOLEAN
            DET_PROB_1STAZHYPO_038_Rx_oRDR_FUSION_DET_037_040_oPCAN_RADAR_b33124dc_Rx: ComSignalType=BOOLEAN
            DET_PROB_1STAZHYPO_039_Rx_oRDR_FUSION_DET_037_040_oPCAN_RADAR_1c75b69b_Rx: ComSignalType=BOOLEAN
            DET_PROB_1STAZHYPO_040_Rx_oRDR_FUSION_DET_037_040_oPCAN_RADAR_3cb75c87_Rx: ComSignalType=BOOLEAN
            DET_RANGE_037_Rx_oRDR_FUSION_DET_037_040_oPCAN_RADAR_68c2be63_Rx: ComSignalType=UINT16
            DET_RANGE_038_Rx_oRDR_FUSION_DET_037_040_oPCAN_RADAR_e88ccccb_Rx: ComSignalType=UINT16
            DET_RANGE_039_Rx_oRDR_FUSION_DET_037_040_oPCAN_RADAR_47c85e8c_Rx: ComSignalType=UINT16
            DET_RANGE_040_Rx_oRDR_FUSION_DET_037_040_oPCAN_RADAR_670ab490_Rx: ComSignalType=UINT16
            DET_RANGE_ERR_037_Rx_oRDR_FUSION_DET_037_040_oPCAN_RADAR_38303283_Rx: ComSignalType=UINT8
            DET_RANGE_ERR_038_Rx_oRDR_FUSION_DET_037_040_oPCAN_RADAR_b87e402b_Rx: ComSignalType=UINT8
            DET_RANGE_ERR_039_Rx_oRDR_FUSION_DET_037_040_oPCAN_RADAR_173ad26c_Rx: ComSignalType=UINT8
            DET_RANGE_ERR_040_Rx_oRDR_FUSION_DET_037_040_oPCAN_RADAR_37f83870_Rx: ComSignalType=UINT8
            DET_RANGE_VELOCITY_037_Rx_oRDR_FUSION_DET_037_040_oPCAN_RADAR_b5373d9d_Rx: ComSignalType=UINT16
            DET_RANGE_VELOCITY_038_Rx_oRDR_FUSION_DET_037_040_oPCAN_RADAR_35794f35_Rx: ComSignalType=UINT16
            DET_RANGE_VELOCITY_039_Rx_oRDR_FUSION_DET_037_040_oPCAN_RADAR_9a3ddd72_Rx: ComSignalType=UINT16
            DET_RANGE_VELOCITY_040_Rx_oRDR_FUSION_DET_037_040_oPCAN_RADAR_baff376e_Rx: ComSignalType=UINT16
            DET_RANGE_VELOCITY_ERR_037_Rx_oRDR_FUSION_DET_037_040_oPCAN_RADAR_2c534d5f_Rx: ComSignalType=UINT8
            DET_RANGE_VELOCITY_ERR_038_Rx_oRDR_FUSION_DET_037_040_oPCAN_RADAR_ac1d3ff7_Rx: ComSignalType=UINT8
            DET_RANGE_VELOCITY_ERR_039_Rx_oRDR_FUSION_DET_037_040_oPCAN_RADAR_0359adb0_Rx: ComSignalType=UINT8
            DET_RANGE_VELOCITY_ERR_040_Rx_oRDR_FUSION_DET_037_040_oPCAN_RADAR_239b47ac_Rx: ComSignalType=UINT8
            DET_RCS_037_Rx_oRDR_FUSION_DET_037_040_oPCAN_RADAR_78fcaf86_Rx: ComSignalType=UINT8
            DET_RCS_038_Rx_oRDR_FUSION_DET_037_040_oPCAN_RADAR_f8b2dd2e_Rx: ComSignalType=UINT8
            DET_RCS_039_Rx_oRDR_FUSION_DET_037_040_oPCAN_RADAR_57f64f69_Rx: ComSignalType=UINT8
            DET_RCS_040_Rx_oRDR_FUSION_DET_037_040_oPCAN_RADAR_7734a575_Rx: ComSignalType=UINT8
            DET_SNR_037_Rx_oRDR_FUSION_DET_037_040_oPCAN_RADAR_71a6de6f_Rx: ComSignalType=UINT8
            DET_SNR_038_Rx_oRDR_FUSION_DET_037_040_oPCAN_RADAR_f1e8acc7_Rx: ComSignalType=UINT8
            DET_SNR_039_Rx_oRDR_FUSION_DET_037_040_oPCAN_RADAR_5eac3e80_Rx: ComSignalType=UINT8
            DET_SNR_040_Rx_oRDR_FUSION_DET_037_040_oPCAN_RADAR_7e6ed49c_Rx: ComSignalType=UINT8
            DET_SUPER_RES_TARGET_037_Rx_oRDR_FUSION_DET_037_040_oPCAN_RADAR_ba5dff6f_Rx: ComSignalType=BOOLEAN
            DET_SUPER_RES_TARGET_038_Rx_oRDR_FUSION_DET_037_040_oPCAN_RADAR_3a138dc7_Rx: ComSignalType=BOOLEAN
            DET_SUPER_RES_TARGET_039_Rx_oRDR_FUSION_DET_037_040_oPCAN_RADAR_95571f80_Rx: ComSignalType=BOOLEAN
            DET_SUPER_RES_TARGET_040_Rx_oRDR_FUSION_DET_037_040_oPCAN_RADAR_b595f59c_Rx: ComSignalType=BOOLEAN
        SG_Fusion_Detections_041_044_oRDR_FUSION_DET_041_044_oPCAN_RADAR_eab931b2_Rx
          83 x ComGroupSignal:
            DET_AZIMUTH_041_Rx_oRDR_FUSION_DET_041_044_oPCAN_RADAR_5d2bad0a_Rx: ComSignalType=UINT16
            DET_AZIMUTH_042_Rx_oRDR_FUSION_DET_041_044_oPCAN_RADAR_77971d82_Rx: ComSignalType=UINT16
            DET_AZIMUTH_043_Rx_oRDR_FUSION_DET_041_044_oPCAN_RADAR_d8d38fc5_Rx: ComSignalType=UINT16
            DET_AZIMUTH_044_Rx_oRDR_FUSION_DET_041_044_oPCAN_RADAR_22ee7c92_Rx: ComSignalType=UINT16
            DET_AZIMUTH_ERR_041_Rx_oRDR_FUSION_DET_041_044_oPCAN_RADAR_5f420c88_Rx: ComSignalType=UINT8
            DET_AZIMUTH_ERR_042_Rx_oRDR_FUSION_DET_041_044_oPCAN_RADAR_75febc00_Rx: ComSignalType=UINT8
            DET_AZIMUTH_ERR_043_Rx_oRDR_FUSION_DET_041_044_oPCAN_RADAR_daba2e47_Rx: ComSignalType=UINT8
            DET_AZIMUTH_ERR_044_Rx_oRDR_FUSION_DET_041_044_oPCAN_RADAR_2087dd10_Rx: ComSignalType=UINT8
            DET_BELOW_RAIN_THOLD_041_Rx_oRDR_FUSION_DET_041_044_oPCAN_RADAR_3b9152bf_Rx: ComSignalType=BOOLEAN
            DET_BELOW_RAIN_THOLD_042_Rx_oRDR_FUSION_DET_041_044_oPCAN_RADAR_112de237_Rx: ComSignalType=BOOLEAN
            DET_BELOW_RAIN_THOLD_043_Rx_oRDR_FUSION_DET_041_044_oPCAN_RADAR_be697070_Rx: ComSignalType=BOOLEAN
            DET_BELOW_RAIN_THOLD_044_Rx_oRDR_FUSION_DET_041_044_oPCAN_RADAR_44548327_Rx: ComSignalType=BOOLEAN
            DET_BI_STATIC_FLAG_041_Rx_oRDR_FUSION_DET_041_044_oPCAN_RADAR_4c0ff9ac_Rx: ComSignalType=BOOLEAN
            DET_BI_STATIC_FLAG_042_Rx_oRDR_FUSION_DET_041_044_oPCAN_RADAR_66b34924_Rx: ComSignalType=BOOLEAN
            DET_BI_STATIC_FLAG_043_Rx_oRDR_FUSION_DET_041_044_oPCAN_RADAR_c9f7db63_Rx: ComSignalType=BOOLEAN
            DET_BI_STATIC_FLAG_044_Rx_oRDR_FUSION_DET_041_044_oPCAN_RADAR_33ca2834_Rx: ComSignalType=BOOLEAN
            DET_CONFD_AZIMUTH_041_Rx_oRDR_FUSION_DET_041_044_oPCAN_RADAR_af6613f8_Rx: ComSignalType=UINT8
            DET_CONFD_AZIMUTH_042_Rx_oRDR_FUSION_DET_041_044_oPCAN_RADAR_85daa370_Rx: ComSignalType=UINT8
            DET_CONFD_AZIMUTH_043_Rx_oRDR_FUSION_DET_041_044_oPCAN_RADAR_2a9e3137_Rx: ComSignalType=UINT8
            DET_CONFD_AZIMUTH_044_Rx_oRDR_FUSION_DET_041_044_oPCAN_RADAR_d0a3c260_Rx: ComSignalType=UINT8
            DET_CONFD_ELEVATION_041_Rx_oRDR_FUSION_DET_041_044_oPCAN_RADAR_a547907f_Rx: ComSignalType=UINT8
            DET_CONFD_ELEVATION_042_Rx_oRDR_FUSION_DET_041_044_oPCAN_RADAR_8ffb20f7_Rx: ComSignalType=UINT8
            DET_CONFD_ELEVATION_043_Rx_oRDR_FUSION_DET_041_044_oPCAN_RADAR_20bfb2b0_Rx: ComSignalType=UINT8
            DET_CONFD_ELEVATION_044_Rx_oRDR_FUSION_DET_041_044_oPCAN_RADAR_da8241e7_Rx: ComSignalType=UINT8
            DET_ELEVATION_041_Rx_oRDR_FUSION_DET_041_044_oPCAN_RADAR_af147f86_Rx: ComSignalType=UINT8
            DET_ELEVATION_042_Rx_oRDR_FUSION_DET_041_044_oPCAN_RADAR_85a8cf0e_Rx: ComSignalType=UINT8
            DET_ELEVATION_043_Rx_oRDR_FUSION_DET_041_044_oPCAN_RADAR_2aec5d49_Rx: ComSignalType=UINT8
            DET_ELEVATION_044_Rx_oRDR_FUSION_DET_041_044_oPCAN_RADAR_d0d1ae1e_Rx: ComSignalType=UINT8
            DET_ELEVATION_ERR_041_Rx_oRDR_FUSION_DET_041_044_oPCAN_RADAR_7dad5d59_Rx: ComSignalType=UINT8
            DET_ELEVATION_ERR_042_Rx_oRDR_FUSION_DET_041_044_oPCAN_RADAR_5711edd1_Rx: ComSignalType=UINT8
            DET_ELEVATION_ERR_043_Rx_oRDR_FUSION_DET_041_044_oPCAN_RADAR_f8557f96_Rx: ComSignalType=UINT8
            DET_ELEVATION_ERR_044_Rx_oRDR_FUSION_DET_041_044_oPCAN_RADAR_02688cc1_Rx: ComSignalType=UINT8
            DET_EXISTENCE_PROB_041_Rx_oRDR_FUSION_DET_041_044_oPCAN_RADAR_8ab525cc_Rx: ComSignalType=UINT8
            DET_EXISTENCE_PROB_042_Rx_oRDR_FUSION_DET_041_044_oPCAN_RADAR_a0099544_Rx: ComSignalType=UINT8
            DET_EXISTENCE_PROB_043_Rx_oRDR_FUSION_DET_041_044_oPCAN_RADAR_0f4d0703_Rx: ComSignalType=UINT8
            DET_EXISTENCE_PROB_044_Rx_oRDR_FUSION_DET_041_044_oPCAN_RADAR_f570f454_Rx: ComSignalType=UINT8
            DET_HVC_FLAG_041_Rx_oRDR_FUSION_DET_041_044_oPCAN_RADAR_576bc883_Rx: ComSignalType=BOOLEAN
            DET_HVC_FLAG_042_Rx_oRDR_FUSION_DET_041_044_oPCAN_RADAR_7dd7780b_Rx: ComSignalType=BOOLEAN
            DET_HVC_FLAG_043_Rx_oRDR_FUSION_DET_041_044_oPCAN_RADAR_d293ea4c_Rx: ComSignalType=BOOLEAN
            DET_HVC_FLAG_044_Rx_oRDR_FUSION_DET_041_044_oPCAN_RADAR_28ae191b_Rx: ComSignalType=BOOLEAN
            DET_IDM_041_Rx_oRDR_FUSION_DET_041_044_oPCAN_RADAR_62aa31cb_Rx: ComSignalType=BOOLEAN
            DET_IDM_042_Rx_oRDR_FUSION_DET_041_044_oPCAN_RADAR_48168143_Rx: ComSignalType=BOOLEAN
            DET_IDM_043_Rx_oRDR_FUSION_DET_041_044_oPCAN_RADAR_e7521304_Rx: ComSignalType=BOOLEAN
            DET_IDM_044_Rx_oRDR_FUSION_DET_041_044_oPCAN_RADAR_1d6fe053_Rx: ComSignalType=BOOLEAN
            DET_MH_CRC16_041_044_Rx_oRDR_FUSION_DET_041_044_oPCAN_RADAR_98836a69_Rx: ComSignalType=UINT16
            DET_MH_CYCLE_COUNTER_041_044_Rx_oRDR_FUSION_DET_041_044_oPCAN_RADAR_955857ac_Rx: ComSignalType=UINT8
            DET_MH_SCAN_INDEX_4LSB_041_044_Rx_oRDR_FUSION_DET_041_044_oPCAN_RADAR_f1e89897_Rx: ComSignalType=UINT8
            DET_MTD_041_Rx_oRDR_FUSION_DET_041_044_oPCAN_RADAR_df2907bb_Rx: ComSignalType=BOOLEAN
            DET_MTD_042_Rx_oRDR_FUSION_DET_041_044_oPCAN_RADAR_f595b733_Rx: ComSignalType=BOOLEAN
            DET_MTD_043_Rx_oRDR_FUSION_DET_041_044_oPCAN_RADAR_5ad12574_Rx: ComSignalType=BOOLEAN
            DET_MTD_044_Rx_oRDR_FUSION_DET_041_044_oPCAN_RADAR_a0ecd623_Rx: ComSignalType=BOOLEAN
            DET_PROB_1STAZHYPO_041_Rx_oRDR_FUSION_DET_041_044_oPCAN_RADAR_1550193a_Rx: ComSignalType=BOOLEAN
            DET_PROB_1STAZHYPO_042_Rx_oRDR_FUSION_DET_041_044_oPCAN_RADAR_3feca9b2_Rx: ComSignalType=BOOLEAN
            DET_PROB_1STAZHYPO_043_Rx_oRDR_FUSION_DET_041_044_oPCAN_RADAR_90a83bf5_Rx: ComSignalType=BOOLEAN
            DET_PROB_1STAZHYPO_044_Rx_oRDR_FUSION_DET_041_044_oPCAN_RADAR_6a95c8a2_Rx: ComSignalType=BOOLEAN
            DET_RANGE_041_Rx_oRDR_FUSION_DET_041_044_oPCAN_RADAR_4eedf12d_Rx: ComSignalType=UINT16
            DET_RANGE_042_Rx_oRDR_FUSION_DET_041_044_oPCAN_RADAR_645141a5_Rx: ComSignalType=UINT16
            DET_RANGE_043_Rx_oRDR_FUSION_DET_041_044_oPCAN_RADAR_cb15d3e2_Rx: ComSignalType=UINT16
            DET_RANGE_044_Rx_oRDR_FUSION_DET_041_044_oPCAN_RADAR_312820b5_Rx: ComSignalType=UINT16
            DET_RANGE_ERR_041_Rx_oRDR_FUSION_DET_041_044_oPCAN_RADAR_1e1f7dcd_Rx: ComSignalType=UINT8
            DET_RANGE_ERR_042_Rx_oRDR_FUSION_DET_041_044_oPCAN_RADAR_34a3cd45_Rx: ComSignalType=UINT8
            DET_RANGE_ERR_043_Rx_oRDR_FUSION_DET_041_044_oPCAN_RADAR_9be75f02_Rx: ComSignalType=UINT8
            DET_RANGE_ERR_044_Rx_oRDR_FUSION_DET_041_044_oPCAN_RADAR_61daac55_Rx: ComSignalType=UINT8
            DET_RANGE_VELOCITY_041_Rx_oRDR_FUSION_DET_041_044_oPCAN_RADAR_931872d3_Rx: ComSignalType=UINT16
            DET_RANGE_VELOCITY_042_Rx_oRDR_FUSION_DET_041_044_oPCAN_RADAR_b9a4c25b_Rx: ComSignalType=UINT16
            DET_RANGE_VELOCITY_043_Rx_oRDR_FUSION_DET_041_044_oPCAN_RADAR_16e0501c_Rx: ComSignalType=UINT16
            DET_RANGE_VELOCITY_044_Rx_oRDR_FUSION_DET_041_044_oPCAN_RADAR_ecdda34b_Rx: ComSignalType=UINT16
            DET_RANGE_VELOCITY_ERR_041_Rx_oRDR_FUSION_DET_041_044_oPCAN_RADAR_0a7c0211_Rx: ComSignalType=UINT8
            DET_RANGE_VELOCITY_ERR_042_Rx_oRDR_FUSION_DET_041_044_oPCAN_RADAR_20c0b299_Rx: ComSignalType=UINT8
            DET_RANGE_VELOCITY_ERR_043_Rx_oRDR_FUSION_DET_041_044_oPCAN_RADAR_8f8420de_Rx: ComSignalType=UINT8
            DET_RANGE_VELOCITY_ERR_044_Rx_oRDR_FUSION_DET_041_044_oPCAN_RADAR_75b9d389_Rx: ComSignalType=UINT8
            DET_RCS_041_Rx_oRDR_FUSION_DET_041_044_oPCAN_RADAR_5ed3e0c8_Rx: ComSignalType=UINT8
            DET_RCS_042_Rx_oRDR_FUSION_DET_041_044_oPCAN_RADAR_746f5040_Rx: ComSignalType=UINT8
            DET_RCS_043_Rx_oRDR_FUSION_DET_041_044_oPCAN_RADAR_db2bc207_Rx: ComSignalType=UINT8
            DET_RCS_044_Rx_oRDR_FUSION_DET_041_044_oPCAN_RADAR_21163150_Rx: ComSignalType=UINT8
            DET_SNR_041_Rx_oRDR_FUSION_DET_041_044_oPCAN_RADAR_57899121_Rx: ComSignalType=UINT8
            DET_SNR_042_Rx_oRDR_FUSION_DET_041_044_oPCAN_RADAR_7d3521a9_Rx: ComSignalType=UINT8
            DET_SNR_043_Rx_oRDR_FUSION_DET_041_044_oPCAN_RADAR_d271b3ee_Rx: ComSignalType=UINT8
            DET_SNR_044_Rx_oRDR_FUSION_DET_041_044_oPCAN_RADAR_284c40b9_Rx: ComSignalType=UINT8
            DET_SUPER_RES_TARGET_041_Rx_oRDR_FUSION_DET_041_044_oPCAN_RADAR_9c72b021_Rx: ComSignalType=BOOLEAN
            DET_SUPER_RES_TARGET_042_Rx_oRDR_FUSION_DET_041_044_oPCAN_RADAR_b6ce00a9_Rx: ComSignalType=BOOLEAN
            DET_SUPER_RES_TARGET_043_Rx_oRDR_FUSION_DET_041_044_oPCAN_RADAR_198a92ee_Rx: ComSignalType=BOOLEAN
            DET_SUPER_RES_TARGET_044_Rx_oRDR_FUSION_DET_041_044_oPCAN_RADAR_e3b761b9_Rx: ComSignalType=BOOLEAN
        SG_Fusion_Detections_045_048_oRDR_FUSION_DET_045_048_oPCAN_RADAR_a7421a41_Rx
          83 x ComGroupSignal:
            DET_AZIMUTH_045_Rx_oRDR_FUSION_DET_045_048_oPCAN_RADAR_641870e1_Rx: ComSignalType=UINT16
            DET_AZIMUTH_046_Rx_oRDR_FUSION_DET_045_048_oPCAN_RADAR_4ea4c069_Rx: ComSignalType=UINT16
            DET_AZIMUTH_047_Rx_oRDR_FUSION_DET_045_048_oPCAN_RADAR_e1e0522e_Rx: ComSignalType=UINT16
            DET_AZIMUTH_048_Rx_oRDR_FUSION_DET_045_048_oPCAN_RADAR_61ae2086_Rx: ComSignalType=UINT16
            DET_AZIMUTH_ERR_045_Rx_oRDR_FUSION_DET_045_048_oPCAN_RADAR_6671d163_Rx: ComSignalType=UINT8
            DET_AZIMUTH_ERR_046_Rx_oRDR_FUSION_DET_045_048_oPCAN_RADAR_4ccd61eb_Rx: ComSignalType=UINT8
            DET_AZIMUTH_ERR_047_Rx_oRDR_FUSION_DET_045_048_oPCAN_RADAR_e389f3ac_Rx: ComSignalType=UINT8
            DET_AZIMUTH_ERR_048_Rx_oRDR_FUSION_DET_045_048_oPCAN_RADAR_63c78104_Rx: ComSignalType=UINT8
            DET_BELOW_RAIN_THOLD_045_Rx_oRDR_FUSION_DET_045_048_oPCAN_RADAR_02a28f54_Rx: ComSignalType=BOOLEAN
            DET_BELOW_RAIN_THOLD_046_Rx_oRDR_FUSION_DET_045_048_oPCAN_RADAR_281e3fdc_Rx: ComSignalType=BOOLEAN
            DET_BELOW_RAIN_THOLD_047_Rx_oRDR_FUSION_DET_045_048_oPCAN_RADAR_875aad9b_Rx: ComSignalType=BOOLEAN
            DET_BELOW_RAIN_THOLD_048_Rx_oRDR_FUSION_DET_045_048_oPCAN_RADAR_0714df33_Rx: ComSignalType=BOOLEAN
            DET_BI_STATIC_FLAG_045_Rx_oRDR_FUSION_DET_045_048_oPCAN_RADAR_753c2447_Rx: ComSignalType=BOOLEAN
            DET_BI_STATIC_FLAG_046_Rx_oRDR_FUSION_DET_045_048_oPCAN_RADAR_5f8094cf_Rx: ComSignalType=BOOLEAN
            DET_BI_STATIC_FLAG_047_Rx_oRDR_FUSION_DET_045_048_oPCAN_RADAR_f0c40688_Rx: ComSignalType=BOOLEAN
            DET_BI_STATIC_FLAG_048_Rx_oRDR_FUSION_DET_045_048_oPCAN_RADAR_708a7420_Rx: ComSignalType=BOOLEAN
            DET_CONFD_AZIMUTH_045_Rx_oRDR_FUSION_DET_045_048_oPCAN_RADAR_9655ce13_Rx: ComSignalType=UINT8
            DET_CONFD_AZIMUTH_046_Rx_oRDR_FUSION_DET_045_048_oPCAN_RADAR_bce97e9b_Rx: ComSignalType=UINT8
            DET_CONFD_AZIMUTH_047_Rx_oRDR_FUSION_DET_045_048_oPCAN_RADAR_13adecdc_Rx: ComSignalType=UINT8
            DET_CONFD_AZIMUTH_048_Rx_oRDR_FUSION_DET_045_048_oPCAN_RADAR_93e39e74_Rx: ComSignalType=UINT8
            DET_CONFD_ELEVATION_045_Rx_oRDR_FUSION_DET_045_048_oPCAN_RADAR_9c744d94_Rx: ComSignalType=UINT8
            DET_CONFD_ELEVATION_046_Rx_oRDR_FUSION_DET_045_048_oPCAN_RADAR_b6c8fd1c_Rx: ComSignalType=UINT8
            DET_CONFD_ELEVATION_047_Rx_oRDR_FUSION_DET_045_048_oPCAN_RADAR_198c6f5b_Rx: ComSignalType=UINT8
            DET_CONFD_ELEVATION_048_Rx_oRDR_FUSION_DET_045_048_oPCAN_RADAR_99c21df3_Rx: ComSignalType=UINT8
            DET_ELEVATION_045_Rx_oRDR_FUSION_DET_045_048_oPCAN_RADAR_9627a26d_Rx: ComSignalType=UINT8
            DET_ELEVATION_046_Rx_oRDR_FUSION_DET_045_048_oPCAN_RADAR_bc9b12e5_Rx: ComSignalType=UINT8
            DET_ELEVATION_047_Rx_oRDR_FUSION_DET_045_048_oPCAN_RADAR_13df80a2_Rx: ComSignalType=UINT8
            DET_ELEVATION_048_Rx_oRDR_FUSION_DET_045_048_oPCAN_RADAR_9391f20a_Rx: ComSignalType=UINT8
            DET_ELEVATION_ERR_045_Rx_oRDR_FUSION_DET_045_048_oPCAN_RADAR_449e80b2_Rx: ComSignalType=UINT8
            DET_ELEVATION_ERR_046_Rx_oRDR_FUSION_DET_045_048_oPCAN_RADAR_6e22303a_Rx: ComSignalType=UINT8
            DET_ELEVATION_ERR_047_Rx_oRDR_FUSION_DET_045_048_oPCAN_RADAR_c166a27d_Rx: ComSignalType=UINT8
            DET_ELEVATION_ERR_048_Rx_oRDR_FUSION_DET_045_048_oPCAN_RADAR_4128d0d5_Rx: ComSignalType=UINT8
            DET_EXISTENCE_PROB_045_Rx_oRDR_FUSION_DET_045_048_oPCAN_RADAR_b386f827_Rx: ComSignalType=UINT8
            DET_EXISTENCE_PROB_046_Rx_oRDR_FUSION_DET_045_048_oPCAN_RADAR_993a48af_Rx: ComSignalType=UINT8
            DET_EXISTENCE_PROB_047_Rx_oRDR_FUSION_DET_045_048_oPCAN_RADAR_367edae8_Rx: ComSignalType=UINT8
            DET_EXISTENCE_PROB_048_Rx_oRDR_FUSION_DET_045_048_oPCAN_RADAR_b630a840_Rx: ComSignalType=UINT8
            DET_HVC_FLAG_045_Rx_oRDR_FUSION_DET_045_048_oPCAN_RADAR_6e581568_Rx: ComSignalType=BOOLEAN
            DET_HVC_FLAG_046_Rx_oRDR_FUSION_DET_045_048_oPCAN_RADAR_44e4a5e0_Rx: ComSignalType=BOOLEAN
            DET_HVC_FLAG_047_Rx_oRDR_FUSION_DET_045_048_oPCAN_RADAR_eba037a7_Rx: ComSignalType=BOOLEAN
            DET_HVC_FLAG_048_Rx_oRDR_FUSION_DET_045_048_oPCAN_RADAR_6bee450f_Rx: ComSignalType=BOOLEAN
            DET_IDM_045_Rx_oRDR_FUSION_DET_045_048_oPCAN_RADAR_5b99ec20_Rx: ComSignalType=BOOLEAN
            DET_IDM_046_Rx_oRDR_FUSION_DET_045_048_oPCAN_RADAR_71255ca8_Rx: ComSignalType=BOOLEAN
            DET_IDM_047_Rx_oRDR_FUSION_DET_045_048_oPCAN_RADAR_de61ceef_Rx: ComSignalType=BOOLEAN
            DET_IDM_048_Rx_oRDR_FUSION_DET_045_048_oPCAN_RADAR_5e2fbc47_Rx: ComSignalType=BOOLEAN
            DET_MH_CRC16_045_048_Rx_oRDR_FUSION_DET_045_048_oPCAN_RADAR_7363d7f5_Rx: ComSignalType=UINT16
            DET_MH_CYCLE_COUNTER_045_048_Rx_oRDR_FUSION_DET_045_048_oPCAN_RADAR_7eb8ea30_Rx: ComSignalType=UINT8
            DET_MH_SCAN_INDEX_4LSB_045_048_Rx_oRDR_FUSION_DET_045_048_oPCAN_RADAR_1a08250b_Rx: ComSignalType=UINT8
            DET_MTD_045_Rx_oRDR_FUSION_DET_045_048_oPCAN_RADAR_e61ada50_Rx: ComSignalType=BOOLEAN
            DET_MTD_046_Rx_oRDR_FUSION_DET_045_048_oPCAN_RADAR_cca66ad8_Rx: ComSignalType=BOOLEAN
            DET_MTD_047_Rx_oRDR_FUSION_DET_045_048_oPCAN_RADAR_63e2f89f_Rx: ComSignalType=BOOLEAN
            DET_MTD_048_Rx_oRDR_FUSION_DET_045_048_oPCAN_RADAR_e3ac8a37_Rx: ComSignalType=BOOLEAN
            DET_PROB_1STAZHYPO_045_Rx_oRDR_FUSION_DET_045_048_oPCAN_RADAR_2c63c4d1_Rx: ComSignalType=BOOLEAN
            DET_PROB_1STAZHYPO_046_Rx_oRDR_FUSION_DET_045_048_oPCAN_RADAR_06df7459_Rx: ComSignalType=BOOLEAN
            DET_PROB_1STAZHYPO_047_Rx_oRDR_FUSION_DET_045_048_oPCAN_RADAR_a99be61e_Rx: ComSignalType=BOOLEAN
            DET_PROB_1STAZHYPO_048_Rx_oRDR_FUSION_DET_045_048_oPCAN_RADAR_29d594b6_Rx: ComSignalType=BOOLEAN
            DET_RANGE_045_Rx_oRDR_FUSION_DET_045_048_oPCAN_RADAR_77de2cc6_Rx: ComSignalType=UINT16
            DET_RANGE_046_Rx_oRDR_FUSION_DET_045_048_oPCAN_RADAR_5d629c4e_Rx: ComSignalType=UINT16
            DET_RANGE_047_Rx_oRDR_FUSION_DET_045_048_oPCAN_RADAR_f2260e09_Rx: ComSignalType=UINT16
            DET_RANGE_048_Rx_oRDR_FUSION_DET_045_048_oPCAN_RADAR_72687ca1_Rx: ComSignalType=UINT16
            DET_RANGE_ERR_045_Rx_oRDR_FUSION_DET_045_048_oPCAN_RADAR_272ca026_Rx: ComSignalType=UINT8
            DET_RANGE_ERR_046_Rx_oRDR_FUSION_DET_045_048_oPCAN_RADAR_0d9010ae_Rx: ComSignalType=UINT8
            DET_RANGE_ERR_047_Rx_oRDR_FUSION_DET_045_048_oPCAN_RADAR_a2d482e9_Rx: ComSignalType=UINT8
            DET_RANGE_ERR_048_Rx_oRDR_FUSION_DET_045_048_oPCAN_RADAR_229af041_Rx: ComSignalType=UINT8
            DET_RANGE_VELOCITY_045_Rx_oRDR_FUSION_DET_045_048_oPCAN_RADAR_aa2baf38_Rx: ComSignalType=UINT16
            DET_RANGE_VELOCITY_046_Rx_oRDR_FUSION_DET_045_048_oPCAN_RADAR_80971fb0_Rx: ComSignalType=UINT16
            DET_RANGE_VELOCITY_047_Rx_oRDR_FUSION_DET_045_048_oPCAN_RADAR_2fd38df7_Rx: ComSignalType=UINT16
            DET_RANGE_VELOCITY_048_Rx_oRDR_FUSION_DET_045_048_oPCAN_RADAR_af9dff5f_Rx: ComSignalType=UINT16
            DET_RANGE_VELOCITY_ERR_045_Rx_oRDR_FUSION_DET_045_048_oPCAN_RADAR_334fdffa_Rx: ComSignalType=UINT8
            DET_RANGE_VELOCITY_ERR_046_Rx_oRDR_FUSION_DET_045_048_oPCAN_RADAR_19f36f72_Rx: ComSignalType=UINT8
            DET_RANGE_VELOCITY_ERR_047_Rx_oRDR_FUSION_DET_045_048_oPCAN_RADAR_b6b7fd35_Rx: ComSignalType=UINT8
            DET_RANGE_VELOCITY_ERR_048_Rx_oRDR_FUSION_DET_045_048_oPCAN_RADAR_36f98f9d_Rx: ComSignalType=UINT8
            DET_RCS_045_Rx_oRDR_FUSION_DET_045_048_oPCAN_RADAR_67e03d23_Rx: ComSignalType=UINT8
            DET_RCS_046_Rx_oRDR_FUSION_DET_045_048_oPCAN_RADAR_4d5c8dab_Rx: ComSignalType=UINT8
            DET_RCS_047_Rx_oRDR_FUSION_DET_045_048_oPCAN_RADAR_e2181fec_Rx: ComSignalType=UINT8
            DET_RCS_048_Rx_oRDR_FUSION_DET_045_048_oPCAN_RADAR_62566d44_Rx: ComSignalType=UINT8
            DET_SNR_045_Rx_oRDR_FUSION_DET_045_048_oPCAN_RADAR_6eba4cca_Rx: ComSignalType=UINT8
            DET_SNR_046_Rx_oRDR_FUSION_DET_045_048_oPCAN_RADAR_4406fc42_Rx: ComSignalType=UINT8
            DET_SNR_047_Rx_oRDR_FUSION_DET_045_048_oPCAN_RADAR_eb426e05_Rx: ComSignalType=UINT8
            DET_SNR_048_Rx_oRDR_FUSION_DET_045_048_oPCAN_RADAR_6b0c1cad_Rx: ComSignalType=UINT8
            DET_SUPER_RES_TARGET_045_Rx_oRDR_FUSION_DET_045_048_oPCAN_RADAR_a5416dca_Rx: ComSignalType=BOOLEAN
            DET_SUPER_RES_TARGET_046_Rx_oRDR_FUSION_DET_045_048_oPCAN_RADAR_8ffddd42_Rx: ComSignalType=BOOLEAN
            DET_SUPER_RES_TARGET_047_Rx_oRDR_FUSION_DET_045_048_oPCAN_RADAR_20b94f05_Rx: ComSignalType=BOOLEAN
            DET_SUPER_RES_TARGET_048_Rx_oRDR_FUSION_DET_045_048_oPCAN_RADAR_a0f73dad_Rx: ComSignalType=BOOLEAN
