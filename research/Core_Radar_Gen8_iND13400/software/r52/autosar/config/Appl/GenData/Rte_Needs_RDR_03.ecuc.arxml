[part 2 of 8: package /DaVinci_Project]
AUTOSAR XML (schema 4-0-3)
package /DaVinci_Project  (continued)
  module config Com  (continued)
    ComConfig  (continued)
      239 x ComSignalGroup:  (continued)
        SG_Detections_089_092_oRDR_DETECTION_089_092_oPCAN_RADAR_e22704c4_Tx
          83 x ComGroupSignal:
            DET_AZIMUTH_089_oRDR_DETECTION_089_092_oPCAN_RADAR_97691818_Tx: ComSignalType=UINT16
            DET_AZIMUTH_090_oRDR_DETECTION_089_092_oPCAN_RADAR_f2496abc_Tx: ComSignalType=UINT16
            DET_AZIMUTH_091_oRDR_DETECTION_089_092_oPCAN_RADAR_6739be29_Tx: ComSignalType=UINT16
            DET_AZIMUTH_092_oRDR_DETECTION_089_092_oPCAN_RADAR_03d9c5d7_Tx: ComSignalType=UINT16
            DET_AZIMUTH_ERR_089_oRDR_DETECTION_089_092_oPCAN_RADAR_33dc8ded_Tx: ComSignalType=UINT8
            DET_AZIMUTH_ERR_090_oRDR_DETECTION_089_092_oPCAN_RADAR_56fcff49_Tx: ComSignalType=UINT8
            DET_AZIMUTH_ERR_091_oRDR_DETECTION_089_092_oPCAN_RADAR_c38c2bdc_Tx: ComSignalType=UINT8
            DET_AZIMUTH_ERR_092_oRDR_DETECTION_089_092_oPCAN_RADAR_a76c5022_Tx: ComSignalType=UINT8
            DET_BELOW_RAIN_THOLD_089_oRDR_DETECTION_089_092_oPCAN_RADAR_42688bd8_Tx: ComSignalType=UINT8
            DET_BELOW_RAIN_THOLD_090_oRDR_DETECTION_089_092_oPCAN_RADAR_2748f97c_Tx: ComSignalType=UINT8
            DET_BELOW_RAIN_THOLD_091_oRDR_DETECTION_089_092_oPCAN_RADAR_b2382de9_Tx: ComSignalType=UINT8
            DET_BELOW_RAIN_THOLD_092_oRDR_DETECTION_089_092_oPCAN_RADAR_d6d85617_Tx: ComSignalType=UINT8
            DET_BI_STATIC_FLAG_089_oRDR_DETECTION_089_092_oPCAN_RADAR_c145589d_Tx: ComSignalType=BOOLEAN
            DET_BI_STATIC_FLAG_090_oRDR_DETECTION_089_092_oPCAN_RADAR_a4652a39_Tx: ComSignalType=BOOLEAN
            DET_BI_STATIC_FLAG_091_oRDR_DETECTION_089_092_oPCAN_RADAR_3115feac_Tx: ComSignalType=BOOLEAN
            DET_BI_STATIC_FLAG_092_oRDR_DETECTION_089_092_oPCAN_RADAR_55f58552_Tx: ComSignalType=BOOLEAN
            DET_CONFD_AZIMUTH_089_oRDR_DETECTION_089_092_oPCAN_RADAR_958f12d2_Tx: ComSignalType=UINT8
            DET_CONFD_AZIMUTH_090_oRDR_DETECTION_089_092_oPCAN_RADAR_f0af6076_Tx: ComSignalType=UINT8
            DET_CONFD_AZIMUTH_091_oRDR_DETECTION_089_092_oPCAN_RADAR_65dfb4e3_Tx: ComSignalType=UINT8
            DET_CONFD_AZIMUTH_092_oRDR_DETECTION_089_092_oPCAN_RADAR_013fcf1d_Tx: ComSignalType=UINT8
            DET_CONFD_ELEVATION_089_oRDR_DETECTION_089_092_oPCAN_RADAR_971a1328_Tx: ComSignalType=UINT8
            DET_CONFD_ELEVATION_090_oRDR_DETECTION_089_092_oPCAN_RADAR_f23a618c_Tx: ComSignalType=UINT8
            DET_CONFD_ELEVATION_091_oRDR_DETECTION_089_092_oPCAN_RADAR_674ab519_Tx: ComSignalType=UINT8
            DET_CONFD_ELEVATION_092_oRDR_DETECTION_089_092_oPCAN_RADAR_03aacee7_Tx: ComSignalType=UINT8
            DET_ELEVATION_089_oRDR_DETECTION_089_092_oPCAN_RADAR_46dac714_Tx: ComSignalType=UINT8
            DET_ELEVATION_090_oRDR_DETECTION_089_092_oPCAN_RADAR_23fab5b0_Tx: ComSignalType=UINT8
            DET_ELEVATION_091_oRDR_DETECTION_089_092_oPCAN_RADAR_b68a6125_Tx: ComSignalType=UINT8
            DET_ELEVATION_092_oRDR_DETECTION_089_092_oPCAN_RADAR_d26a1adb_Tx: ComSignalType=UINT8
            DET_ELEVATION_ERR_089_oRDR_DETECTION_089_092_oPCAN_RADAR_c1e35f61_Tx: ComSignalType=UINT8
            DET_ELEVATION_ERR_090_oRDR_DETECTION_089_092_oPCAN_RADAR_a4c32dc5_Tx: ComSignalType=UINT8
            DET_ELEVATION_ERR_091_oRDR_DETECTION_089_092_oPCAN_RADAR_31b3f950_Tx: ComSignalType=UINT8
            DET_ELEVATION_ERR_092_oRDR_DETECTION_089_092_oPCAN_RADAR_555382ae_Tx: ComSignalType=UINT8
            DET_EXISTENCE_PROB_089_oRDR_DETECTION_089_092_oPCAN_RADAR_137c2a01_Tx: ComSignalType=UINT8
            DET_EXISTENCE_PROB_090_oRDR_DETECTION_089_092_oPCAN_RADAR_765c58a5_Tx: ComSignalType=UINT8
            DET_EXISTENCE_PROB_091_oRDR_DETECTION_089_092_oPCAN_RADAR_e32c8c30_Tx: ComSignalType=UINT8
            DET_EXISTENCE_PROB_092_oRDR_DETECTION_089_092_oPCAN_RADAR_87ccf7ce_Tx: ComSignalType=UINT8
            DET_HVC_FLAG_089_oRDR_DETECTION_089_092_oPCAN_RADAR_f208697e_Tx: ComSignalType=BOOLEAN
            DET_HVC_FLAG_090_oRDR_DETECTION_089_092_oPCAN_RADAR_97281bda_Tx: ComSignalType=BOOLEAN
            DET_HVC_FLAG_091_oRDR_DETECTION_089_092_oPCAN_RADAR_0258cf4f_Tx: ComSignalType=BOOLEAN
            DET_HVC_FLAG_092_oRDR_DETECTION_089_092_oPCAN_RADAR_66b8b4b1_Tx: ComSignalType=BOOLEAN
            DET_IDM_089_oRDR_DETECTION_089_092_oPCAN_RADAR_795a52c3_Tx: ComSignalType=UINT8
            DET_IDM_090_oRDR_DETECTION_089_092_oPCAN_RADAR_1c7a2067_Tx: ComSignalType=UINT8
            DET_IDM_091_oRDR_DETECTION_089_092_oPCAN_RADAR_890af4f2_Tx: ComSignalType=UINT8
            DET_IDM_092_oRDR_DETECTION_089_092_oPCAN_RADAR_edea8f0c_Tx: ComSignalType=UINT8
            DET_MH_CRC16_089_092_oRDR_DETECTION_089_092_oPCAN_RADAR_66afd6cf_Tx: ComSignalType=UINT16
            DET_MH_CYCLE_COUNTER_089_092_oRDR_DETECTION_089_092_oPCAN_RADAR_e2da77f8_Tx: ComSignalType=UINT8
            DET_MH_SCAN_INDEX_4LSB_089_092_oRDR_DETECTION_089_092_oPCAN_RADAR_2ef05274_Tx: ComSignalType=UINT8
            DET_MTD_089_oRDR_DETECTION_089_092_oPCAN_RADAR_1fe96018_Tx: ComSignalType=UINT8
            DET_MTD_090_oRDR_DETECTION_089_092_oPCAN_RADAR_7ac912bc_Tx: ComSignalType=UINT8
            DET_MTD_091_oRDR_DETECTION_089_092_oPCAN_RADAR_efb9c629_Tx: ComSignalType=UINT8
            DET_MTD_092_oRDR_DETECTION_089_092_oPCAN_RADAR_8b59bdd7_Tx: ComSignalType=UINT8
            DET_PROB_1STAZHYPO_089_oRDR_DETECTION_089_092_oPCAN_RADAR_8c5d88d5_Tx: ComSignalType=BOOLEAN
            DET_PROB_1STAZHYPO_090_oRDR_DETECTION_089_092_oPCAN_RADAR_e97dfa71_Tx: ComSignalType=BOOLEAN
            DET_PROB_1STAZHYPO_091_oRDR_DETECTION_089_092_oPCAN_RADAR_7c0d2ee4_Tx: ComSignalType=BOOLEAN
            DET_PROB_1STAZHYPO_092_oRDR_DETECTION_089_092_oPCAN_RADAR_18ed551a_Tx: ComSignalType=BOOLEAN
            DET_RANGE_089_oRDR_DETECTION_089_092_oPCAN_RADAR_87f26ba3_Tx: ComSignalType=UINT16
            DET_RANGE_090_oRDR_DETECTION_089_092_oPCAN_RADAR_e2d21907_Tx: ComSignalType=UINT16
            DET_RANGE_091_oRDR_DETECTION_089_092_oPCAN_RADAR_77a2cd92_Tx: ComSignalType=UINT16
            DET_RANGE_092_oRDR_DETECTION_089_092_oPCAN_RADAR_1342b66c_Tx: ComSignalType=UINT16
            DET_RANGE_ERR_089_oRDR_DETECTION_089_092_oPCAN_RADAR_201ad1ca_Tx: ComSignalType=UINT8
            DET_RANGE_ERR_090_oRDR_DETECTION_089_092_oPCAN_RADAR_453aa36e_Tx: ComSignalType=UINT8
            DET_RANGE_ERR_091_oRDR_DETECTION_089_092_oPCAN_RADAR_d04a77fb_Tx: ComSignalType=UINT8
            DET_RANGE_ERR_092_oRDR_DETECTION_089_092_oPCAN_RADAR_b4aa0c05_Tx: ComSignalType=UINT8
            DET_RANGE_VELOCITY_089_oRDR_DETECTION_089_092_oPCAN_RADAR_f254a986_Tx: ComSignalType=UINT16
            DET_RANGE_VELOCITY_090_oRDR_DETECTION_089_092_oPCAN_RADAR_9774db22_Tx: ComSignalType=UINT16
            DET_RANGE_VELOCITY_091_oRDR_DETECTION_089_092_oPCAN_RADAR_02040fb7_Tx: ComSignalType=UINT16
            DET_RANGE_VELOCITY_092_oRDR_DETECTION_089_092_oPCAN_RADAR_66e47449_Tx: ComSignalType=UINT16
            DET_RANGE_VELOCITY_ERR_089_oRDR_DETECTION_089_092_oPCAN_RADAR_fdef5234_Tx: ComSignalType=UINT8
            DET_RANGE_VELOCITY_ERR_090_oRDR_DETECTION_089_092_oPCAN_RADAR_98cf2090_Tx: ComSignalType=UINT8
            DET_RANGE_VELOCITY_ERR_091_oRDR_DETECTION_089_092_oPCAN_RADAR_0dbff405_Tx: ComSignalType=UINT8
            DET_RANGE_VELOCITY_ERR_092_oRDR_DETECTION_089_092_oPCAN_RADAR_695f8ffb_Tx: ComSignalType=UINT8
            DET_RCS_089_oRDR_DETECTION_089_092_oPCAN_RADAR_75d49edc_Tx: ComSignalType=UINT8
            DET_RCS_090_oRDR_DETECTION_089_092_oPCAN_RADAR_10f4ec78_Tx: ComSignalType=UINT8
            DET_RCS_091_oRDR_DETECTION_089_092_oPCAN_RADAR_858438ed_Tx: ComSignalType=UINT8
            DET_RCS_092_oRDR_DETECTION_089_092_oPCAN_RADAR_e1644313_Tx: ComSignalType=UINT8
            DET_SNR_089_oRDR_DETECTION_089_092_oPCAN_RADAR_a87acade_Tx: ComSignalType=UINT8
            DET_SNR_090_oRDR_DETECTION_089_092_oPCAN_RADAR_cd5ab87a_Tx: ComSignalType=UINT8
            DET_SNR_091_oRDR_DETECTION_089_092_oPCAN_RADAR_582a6cef_Tx: ComSignalType=UINT8
            DET_SNR_092_oRDR_DETECTION_089_092_oPCAN_RADAR_3cca1711_Tx: ComSignalType=UINT8
            DET_SUPER_RES_TARGET_089_oRDR_DETECTION_089_092_oPCAN_RADAR_99e3e2bb_Tx: ComSignalType=BOOLEAN
            DET_SUPER_RES_TARGET_090_oRDR_DETECTION_089_092_oPCAN_RADAR_fcc3901f_Tx: ComSignalType=BOOLEAN
            DET_SUPER_RES_TARGET_091_oRDR_DETECTION_089_092_oPCAN_RADAR_69b3448a_Tx: ComSignalType=BOOLEAN
            DET_SUPER_RES_TARGET_092_oRDR_DETECTION_089_092_oPCAN_RADAR_0d533f74_Tx: ComSignalType=BOOLEAN
        SG_Detections_093_096_oRDR_DETECTION_093_096_oPCAN_RADAR_d02c6cec_Tx
          83 x ComGroupSignal:
            DET_AZIMUTH_093_oRDR_DETECTION_093_096_oPCAN_RADAR_8b6e126c_Tx: ComSignalType=UINT16
            DET_AZIMUTH_094_oRDR_DETECTION_093_096_oPCAN_RADAR_d7de3105_Tx: ComSignalType=UINT16
            DET_AZIMUTH_095_oRDR_DETECTION_093_096_oPCAN_RADAR_42aee590_Tx: ComSignalType=UINT16
            DET_AZIMUTH_096_oRDR_DETECTION_093_096_oPCAN_RADAR_264e9e6e_Tx: ComSignalType=UINT16
            DET_AZIMUTH_ERR_093_oRDR_DETECTION_093_096_oPCAN_RADAR_2fdb8799_Tx: ComSignalType=UINT8
            DET_AZIMUTH_ERR_094_oRDR_DETECTION_093_096_oPCAN_RADAR_736ba4f0_Tx: ComSignalType=UINT8
            DET_AZIMUTH_ERR_095_oRDR_DETECTION_093_096_oPCAN_RADAR_e61b7065_Tx: ComSignalType=UINT8
            DET_AZIMUTH_ERR_096_oRDR_DETECTION_093_096_oPCAN_RADAR_82fb0b9b_Tx: ComSignalType=UINT8
            DET_BELOW_RAIN_THOLD_093_oRDR_DETECTION_093_096_oPCAN_RADAR_5e6f81ac_Tx: ComSignalType=UINT8
            DET_BELOW_RAIN_THOLD_094_oRDR_DETECTION_093_096_oPCAN_RADAR_02dfa2c5_Tx: ComSignalType=UINT8
            DET_BELOW_RAIN_THOLD_095_oRDR_DETECTION_093_096_oPCAN_RADAR_97af7650_Tx: ComSignalType=UINT8
            DET_BELOW_RAIN_THOLD_096_oRDR_DETECTION_093_096_oPCAN_RADAR_f34f0dae_Tx: ComSignalType=UINT8
            DET_BI_STATIC_FLAG_093_oRDR_DETECTION_093_096_oPCAN_RADAR_dd4252e9_Tx: ComSignalType=BOOLEAN
            DET_BI_STATIC_FLAG_094_oRDR_DETECTION_093_096_oPCAN_RADAR_81f27180_Tx: ComSignalType=BOOLEAN
            DET_BI_STATIC_FLAG_095_oRDR_DETECTION_093_096_oPCAN_RADAR_1482a515_Tx: ComSignalType=BOOLEAN
            DET_BI_STATIC_FLAG_096_oRDR_DETECTION_093_096_oPCAN_RADAR_7062deeb_Tx: ComSignalType=BOOLEAN
            DET_CONFD_AZIMUTH_093_oRDR_DETECTION_093_096_oPCAN_RADAR_898818a6_Tx: ComSignalType=UINT8
            DET_CONFD_AZIMUTH_094_oRDR_DETECTION_093_096_oPCAN_RADAR_d5383bcf_Tx: ComSignalType=UINT8
            DET_CONFD_AZIMUTH_095_oRDR_DETECTION_093_096_oPCAN_RADAR_4048ef5a_Tx: ComSignalType=UINT8
            DET_CONFD_AZIMUTH_096_oRDR_DETECTION_093_096_oPCAN_RADAR_24a894a4_Tx: ComSignalType=UINT8
            DET_CONFD_ELEVATION_093_oRDR_DETECTION_093_096_oPCAN_RADAR_8b1d195c_Tx: ComSignalType=UINT8
            DET_CONFD_ELEVATION_094_oRDR_DETECTION_093_096_oPCAN_RADAR_d7ad3a35_Tx: ComSignalType=UINT8
            DET_CONFD_ELEVATION_095_oRDR_DETECTION_093_096_oPCAN_RADAR_42ddeea0_Tx: ComSignalType=UINT8
            DET_CONFD_ELEVATION_096_oRDR_DETECTION_093_096_oPCAN_RADAR_263d955e_Tx: ComSignalType=UINT8
            DET_ELEVATION_093_oRDR_DETECTION_093_096_oPCAN_RADAR_5addcd60_Tx: ComSignalType=UINT8
            DET_ELEVATION_094_oRDR_DETECTION_093_096_oPCAN_RADAR_066dee09_Tx: ComSignalType=UINT8
            DET_ELEVATION_095_oRDR_DETECTION_093_096_oPCAN_RADAR_931d3a9c_Tx: ComSignalType=UINT8
            DET_ELEVATION_096_oRDR_DETECTION_093_096_oPCAN_RADAR_f7fd4162_Tx: ComSignalType=UINT8
            DET_ELEVATION_ERR_093_oRDR_DETECTION_093_096_oPCAN_RADAR_dde45515_Tx: ComSignalType=UINT8
            DET_ELEVATION_ERR_094_oRDR_DETECTION_093_096_oPCAN_RADAR_8154767c_Tx: ComSignalType=UINT8
            DET_ELEVATION_ERR_095_oRDR_DETECTION_093_096_oPCAN_RADAR_1424a2e9_Tx: ComSignalType=UINT8
            DET_ELEVATION_ERR_096_oRDR_DETECTION_093_096_oPCAN_RADAR_70c4d917_Tx: ComSignalType=UINT8
            DET_EXISTENCE_PROB_093_oRDR_DETECTION_093_096_oPCAN_RADAR_0f7b2075_Tx: ComSignalType=UINT8
            DET_EXISTENCE_PROB_094_oRDR_DETECTION_093_096_oPCAN_RADAR_53cb031c_Tx: ComSignalType=UINT8
            DET_EXISTENCE_PROB_095_oRDR_DETECTION_093_096_oPCAN_RADAR_c6bbd789_Tx: ComSignalType=UINT8
            DET_EXISTENCE_PROB_096_oRDR_DETECTION_093_096_oPCAN_RADAR_a25bac77_Tx: ComSignalType=UINT8
            DET_HVC_FLAG_093_oRDR_DETECTION_093_096_oPCAN_RADAR_ee0f630a_Tx: ComSignalType=BOOLEAN
            DET_HVC_FLAG_094_oRDR_DETECTION_093_096_oPCAN_RADAR_b2bf4063_Tx: ComSignalType=BOOLEAN
            DET_HVC_FLAG_095_oRDR_DETECTION_093_096_oPCAN_RADAR_27cf94f6_Tx: ComSignalType=BOOLEAN
            DET_HVC_FLAG_096_oRDR_DETECTION_093_096_oPCAN_RADAR_432fef08_Tx: ComSignalType=BOOLEAN
            DET_IDM_093_oRDR_DETECTION_093_096_oPCAN_RADAR_655d58b7_Tx: ComSignalType=UINT8
            DET_IDM_094_oRDR_DETECTION_093_096_oPCAN_RADAR_39ed7bde_Tx: ComSignalType=UINT8
            DET_IDM_095_oRDR_DETECTION_093_096_oPCAN_RADAR_ac9daf4b_Tx: ComSignalType=UINT8
            DET_IDM_096_oRDR_DETECTION_093_096_oPCAN_RADAR_c87dd4b5_Tx: ComSignalType=UINT8
            DET_MH_CRC16_093_096_oRDR_DETECTION_093_096_oPCAN_RADAR_54a4bee7_Tx: ComSignalType=UINT16
            DET_MH_CYCLE_COUNTER_093_096_oRDR_DETECTION_093_096_oPCAN_RADAR_d0d11fd0_Tx: ComSignalType=UINT8
            DET_MH_SCAN_INDEX_4LSB_093_096_oRDR_DETECTION_093_096_oPCAN_RADAR_1cfb3a5c_Tx: ComSignalType=UINT8
            DET_MTD_093_oRDR_DETECTION_093_096_oPCAN_RADAR_03ee6a6c_Tx: ComSignalType=UINT8
            DET_MTD_094_oRDR_DETECTION_093_096_oPCAN_RADAR_5f5e4905_Tx: ComSignalType=UINT8
            DET_MTD_095_oRDR_DETECTION_093_096_oPCAN_RADAR_ca2e9d90_Tx: ComSignalType=UINT8
            DET_MTD_096_oRDR_DETECTION_093_096_oPCAN_RADAR_aecee66e_Tx: ComSignalType=UINT8
            DET_PROB_1STAZHYPO_093_oRDR_DETECTION_093_096_oPCAN_RADAR_905a82a1_Tx: ComSignalType=BOOLEAN
            DET_PROB_1STAZHYPO_094_oRDR_DETECTION_093_096_oPCAN_RADAR_cceaa1c8_Tx: ComSignalType=BOOLEAN
            DET_PROB_1STAZHYPO_095_oRDR_DETECTION_093_096_oPCAN_RADAR_599a755d_Tx: ComSignalType=BOOLEAN
            DET_PROB_1STAZHYPO_096_oRDR_DETECTION_093_096_oPCAN_RADAR_3d7a0ea3_Tx: ComSignalType=BOOLEAN
            DET_RANGE_093_oRDR_DETECTION_093_096_oPCAN_RADAR_9bf561d7_Tx: ComSignalType=UINT16
            DET_RANGE_094_oRDR_DETECTION_093_096_oPCAN_RADAR_c74542be_Tx: ComSignalType=UINT16
            DET_RANGE_095_oRDR_DETECTION_093_096_oPCAN_RADAR_5235962b_Tx: ComSignalType=UINT16
            DET_RANGE_096_oRDR_DETECTION_093_096_oPCAN_RADAR_36d5edd5_Tx: ComSignalType=UINT16
            DET_RANGE_ERR_093_oRDR_DETECTION_093_096_oPCAN_RADAR_3c1ddbbe_Tx: ComSignalType=UINT8
            DET_RANGE_ERR_094_oRDR_DETECTION_093_096_oPCAN_RADAR_60adf8d7_Tx: ComSignalType=UINT8
            DET_RANGE_ERR_095_oRDR_DETECTION_093_096_oPCAN_RADAR_f5dd2c42_Tx: ComSignalType=UINT8
            DET_RANGE_ERR_096_oRDR_DETECTION_093_096_oPCAN_RADAR_913d57bc_Tx: ComSignalType=UINT8
            DET_RANGE_VELOCITY_093_oRDR_DETECTION_093_096_oPCAN_RADAR_ee53a3f2_Tx: ComSignalType=UINT16
            DET_RANGE_VELOCITY_094_oRDR_DETECTION_093_096_oPCAN_RADAR_b2e3809b_Tx: ComSignalType=UINT16
            DET_RANGE_VELOCITY_095_oRDR_DETECTION_093_096_oPCAN_RADAR_2793540e_Tx: ComSignalType=UINT16
            DET_RANGE_VELOCITY_096_oRDR_DETECTION_093_096_oPCAN_RADAR_43732ff0_Tx: ComSignalType=UINT16
            DET_RANGE_VELOCITY_ERR_093_oRDR_DETECTION_093_096_oPCAN_RADAR_e1e85840_Tx: ComSignalType=UINT8
            DET_RANGE_VELOCITY_ERR_094_oRDR_DETECTION_093_096_oPCAN_RADAR_bd587b29_Tx: ComSignalType=UINT8
            DET_RANGE_VELOCITY_ERR_095_oRDR_DETECTION_093_096_oPCAN_RADAR_2828afbc_Tx: ComSignalType=UINT8
            DET_RANGE_VELOCITY_ERR_096_oRDR_DETECTION_093_096_oPCAN_RADAR_4cc8d442_Tx: ComSignalType=UINT8
            DET_RCS_093_oRDR_DETECTION_093_096_oPCAN_RADAR_69d394a8_Tx: ComSignalType=UINT8
            DET_RCS_094_oRDR_DETECTION_093_096_oPCAN_RADAR_3563b7c1_Tx: ComSignalType=UINT8
            DET_RCS_095_oRDR_DETECTION_093_096_oPCAN_RADAR_a0136354_Tx: ComSignalType=UINT8
            DET_RCS_096_oRDR_DETECTION_093_096_oPCAN_RADAR_c4f318aa_Tx: ComSignalType=UINT8
            DET_SNR_093_oRDR_DETECTION_093_096_oPCAN_RADAR_b47dc0aa_Tx: ComSignalType=UINT8
            DET_SNR_094_oRDR_DETECTION_093_096_oPCAN_RADAR_e8cde3c3_Tx: ComSignalType=UINT8
            DET_SNR_095_oRDR_DETECTION_093_096_oPCAN_RADAR_7dbd3756_Tx: ComSignalType=UINT8
            DET_SNR_096_oRDR_DETECTION_093_096_oPCAN_RADAR_195d4ca8_Tx: ComSignalType=UINT8
            DET_SUPER_RES_TARGET_093_oRDR_DETECTION_093_096_oPCAN_RADAR_85e4e8cf_Tx: ComSignalType=BOOLEAN
            DET_SUPER_RES_TARGET_094_oRDR_DETECTION_093_096_oPCAN_RADAR_d954cba6_Tx: ComSignalType=BOOLEAN
            DET_SUPER_RES_TARGET_095_oRDR_DETECTION_093_096_oPCAN_RADAR_4c241f33_Tx: ComSignalType=BOOLEAN
            DET_SUPER_RES_TARGET_096_oRDR_DETECTION_093_096_oPCAN_RADAR_28c464cd_Tx: ComSignalType=BOOLEAN
        SG_Detections_097_100_oRDR_DETECTION_097_100_oPCAN_RADAR_dcf343f6_Tx
          83 x ComGroupSignal:
            DET_AZIMUTH_097_oRDR_DETECTION_097_100_oPCAN_RADAR_777e9641_Tx: ComSignalType=UINT16
            DET_AZIMUTH_098_oRDR_DETECTION_097_100_oPCAN_RADAR_5b6e0406_Tx: ComSignalType=UINT16
            DET_AZIMUTH_099_oRDR_DETECTION_097_100_oPCAN_RADAR_ce1ed093_Tx: ComSignalType=UINT16
            DET_AZIMUTH_100_oRDR_DETECTION_097_100_oPCAN_RADAR_fa10f2ab_Tx: ComSignalType=UINT16
            DET_AZIMUTH_ERR_097_oRDR_DETECTION_097_100_oPCAN_RADAR_d3cb03b4_Tx: ComSignalType=UINT8
            DET_AZIMUTH_ERR_098_oRDR_DETECTION_097_100_oPCAN_RADAR_ffdb91f3_Tx: ComSignalType=UINT8
            DET_AZIMUTH_ERR_099_oRDR_DETECTION_097_100_oPCAN_RADAR_6aab4566_Tx: ComSignalType=UINT8
            DET_AZIMUTH_ERR_100_oRDR_DETECTION_097_100_oPCAN_RADAR_5ea5675e_Tx: ComSignalType=UINT8
            DET_BELOW_RAIN_THOLD_097_oRDR_DETECTION_097_100_oPCAN_RADAR_a27f0581_Tx: ComSignalType=UINT8
            DET_BELOW_RAIN_THOLD_098_oRDR_DETECTION_097_100_oPCAN_RADAR_8e6f97c6_Tx: ComSignalType=UINT8
            DET_BELOW_RAIN_THOLD_099_oRDR_DETECTION_097_100_oPCAN_RADAR_1b1f4353_Tx: ComSignalType=UINT8
            DET_BELOW_RAIN_THOLD_100_oRDR_DETECTION_097_100_oPCAN_RADAR_2f11616b_Tx: ComSignalType=UINT8
            DET_BI_STATIC_FLAG_097_oRDR_DETECTION_097_100_oPCAN_RADAR_2152d6c4_Tx: ComSignalType=BOOLEAN
            DET_BI_STATIC_FLAG_098_oRDR_DETECTION_097_100_oPCAN_RADAR_0d424483_Tx: ComSignalType=BOOLEAN
            DET_BI_STATIC_FLAG_099_oRDR_DETECTION_097_100_oPCAN_RADAR_98329016_Tx: ComSignalType=BOOLEAN
            DET_BI_STATIC_FLAG_100_oRDR_DETECTION_097_100_oPCAN_RADAR_ac3cb22e_Tx: ComSignalType=BOOLEAN
            DET_CONFD_AZIMUTH_097_oRDR_DETECTION_097_100_oPCAN_RADAR_75989c8b_Tx: ComSignalType=UINT8
            DET_CONFD_AZIMUTH_098_oRDR_DETECTION_097_100_oPCAN_RADAR_59880ecc_Tx: ComSignalType=UINT8
            DET_CONFD_AZIMUTH_099_oRDR_DETECTION_097_100_oPCAN_RADAR_ccf8da59_Tx: ComSignalType=UINT8
            DET_CONFD_AZIMUTH_100_oRDR_DETECTION_097_100_oPCAN_RADAR_f8f6f861_Tx: ComSignalType=UINT8
            DET_CONFD_ELEVATION_097_oRDR_DETECTION_097_100_oPCAN_RADAR_770d9d71_Tx: ComSignalType=UINT8
            DET_CONFD_ELEVATION_098_oRDR_DETECTION_097_100_oPCAN_RADAR_5b1d0f36_Tx: ComSignalType=UINT8
            DET_CONFD_ELEVATION_099_oRDR_DETECTION_097_100_oPCAN_RADAR_ce6ddba3_Tx: ComSignalType=UINT8
            DET_CONFD_ELEVATION_100_oRDR_DETECTION_097_100_oPCAN_RADAR_fa63f99b_Tx: ComSignalType=UINT8
            DET_ELEVATION_097_oRDR_DETECTION_097_100_oPCAN_RADAR_a6cd494d_Tx: ComSignalType=UINT8
            DET_ELEVATION_098_oRDR_DETECTION_097_100_oPCAN_RADAR_8adddb0a_Tx: ComSignalType=UINT8
            DET_ELEVATION_099_oRDR_DETECTION_097_100_oPCAN_RADAR_1fad0f9f_Tx: ComSignalType=UINT8
            DET_ELEVATION_100_oRDR_DETECTION_097_100_oPCAN_RADAR_2ba32da7_Tx: ComSignalType=UINT8
            DET_ELEVATION_ERR_097_oRDR_DETECTION_097_100_oPCAN_RADAR_21f4d138_Tx: ComSignalType=UINT8
            DET_ELEVATION_ERR_098_oRDR_DETECTION_097_100_oPCAN_RADAR_0de4437f_Tx: ComSignalType=UINT8
            DET_ELEVATION_ERR_099_oRDR_DETECTION_097_100_oPCAN_RADAR_989497ea_Tx: ComSignalType=UINT8
            DET_ELEVATION_ERR_100_oRDR_DETECTION_097_100_oPCAN_RADAR_ac9ab5d2_Tx: ComSignalType=UINT8
            DET_EXISTENCE_PROB_097_oRDR_DETECTION_097_100_oPCAN_RADAR_f36ba458_Tx: ComSignalType=UINT8
            DET_EXISTENCE_PROB_098_oRDR_DETECTION_097_100_oPCAN_RADAR_df7b361f_Tx: ComSignalType=UINT8
            DET_EXISTENCE_PROB_099_oRDR_DETECTION_097_100_oPCAN_RADAR_4a0be28a_Tx: ComSignalType=UINT8
            DET_EXISTENCE_PROB_100_oRDR_DETECTION_097_100_oPCAN_RADAR_7e05c0b2_Tx: ComSignalType=UINT8
            DET_HVC_FLAG_097_oRDR_DETECTION_097_100_oPCAN_RADAR_121fe727_Tx: ComSignalType=BOOLEAN
            DET_HVC_FLAG_098_oRDR_DETECTION_097_100_oPCAN_RADAR_3e0f7560_Tx: ComSignalType=BOOLEAN
            DET_HVC_FLAG_099_oRDR_DETECTION_097_100_oPCAN_RADAR_ab7fa1f5_Tx: ComSignalType=BOOLEAN
            DET_HVC_FLAG_100_oRDR_DETECTION_097_100_oPCAN_RADAR_9f7183cd_Tx: ComSignalType=BOOLEAN
            DET_IDM_097_oRDR_DETECTION_097_100_oPCAN_RADAR_994ddc9a_Tx: ComSignalType=UINT8
            DET_IDM_098_oRDR_DETECTION_097_100_oPCAN_RADAR_b55d4edd_Tx: ComSignalType=UINT8
            DET_IDM_099_oRDR_DETECTION_097_100_oPCAN_RADAR_202d9a48_Tx: ComSignalType=UINT8
            DET_IDM_100_oRDR_DETECTION_097_100_oPCAN_RADAR_1423b870_Tx: ComSignalType=UINT8
            DET_MH_CRC16_097_100_oRDR_DETECTION_097_100_oPCAN_RADAR_587b91fd_Tx: ComSignalType=UINT16
            DET_MH_CYCLE_COUNTER_097_100_oRDR_DETECTION_097_100_oPCAN_RADAR_dc0e30ca_Tx: ComSignalType=UINT8
            DET_MH_SCAN_INDEX_4LSB_097_100_oRDR_DETECTION_097_100_oPCAN_RADAR_10241546_Tx: ComSignalType=UINT8
            DET_MTD_097_oRDR_DETECTION_097_100_oPCAN_RADAR_fffeee41_Tx: ComSignalType=UINT8
            DET_MTD_098_oRDR_DETECTION_097_100_oPCAN_RADAR_d3ee7c06_Tx: ComSignalType=UINT8
            DET_MTD_099_oRDR_DETECTION_097_100_oPCAN_RADAR_469ea893_Tx: ComSignalType=UINT8
            DET_MTD_100_oRDR_DETECTION_097_100_oPCAN_RADAR_72908aab_Tx: ComSignalType=UINT8
            DET_PROB_1STAZHYPO_097_oRDR_DETECTION_097_100_oPCAN_RADAR_6c4a068c_Tx: ComSignalType=BOOLEAN
            DET_PROB_1STAZHYPO_098_oRDR_DETECTION_097_100_oPCAN_RADAR_405a94cb_Tx: ComSignalType=BOOLEAN
            DET_PROB_1STAZHYPO_099_oRDR_DETECTION_097_100_oPCAN_RADAR_d52a405e_Tx: ComSignalType=BOOLEAN
            DET_PROB_1STAZHYPO_100_oRDR_DETECTION_097_100_oPCAN_RADAR_e1246266_Tx: ComSignalType=BOOLEAN
            DET_RANGE_097_oRDR_DETECTION_097_100_oPCAN_RADAR_67e5e5fa_Tx: ComSignalType=UINT16
            DET_RANGE_098_oRDR_DETECTION_097_100_oPCAN_RADAR_4bf577bd_Tx: ComSignalType=UINT16
            DET_RANGE_099_oRDR_DETECTION_097_100_oPCAN_RADAR_de85a328_Tx: ComSignalType=UINT16
            DET_RANGE_100_oRDR_DETECTION_097_100_oPCAN_RADAR_ea8b8110_Tx: ComSignalType=UINT16
            DET_RANGE_ERR_097_oRDR_DETECTION_097_100_oPCAN_RADAR_c00d5f93_Tx: ComSignalType=UINT8
            DET_RANGE_ERR_098_oRDR_DETECTION_097_100_oPCAN_RADAR_ec1dcdd4_Tx: ComSignalType=UINT8
            DET_RANGE_ERR_099_oRDR_DETECTION_097_100_oPCAN_RADAR_796d1941_Tx: ComSignalType=UINT8
            DET_RANGE_ERR_100_oRDR_DETECTION_097_100_oPCAN_RADAR_4d633b79_Tx: ComSignalType=UINT8
            DET_RANGE_VELOCITY_097_oRDR_DETECTION_097_100_oPCAN_RADAR_124327df_Tx: ComSignalType=UINT16
            DET_RANGE_VELOCITY_098_oRDR_DETECTION_097_100_oPCAN_RADAR_3e53b598_Tx: ComSignalType=UINT16
            DET_RANGE_VELOCITY_099_oRDR_DETECTION_097_100_oPCAN_RADAR_ab23610d_Tx: ComSignalType=UINT16
            DET_RANGE_VELOCITY_100_oRDR_DETECTION_097_100_oPCAN_RADAR_9f2d4335_Tx: ComSignalType=UINT16
            DET_RANGE_VELOCITY_ERR_097_oRDR_DETECTION_097_100_oPCAN_RADAR_1df8dc6d_Tx: ComSignalType=UINT8
            DET_RANGE_VELOCITY_ERR_098_oRDR_DETECTION_097_100_oPCAN_RADAR_31e84e2a_Tx: ComSignalType=UINT8
            DET_RANGE_VELOCITY_ERR_099_oRDR_DETECTION_097_100_oPCAN_RADAR_a4989abf_Tx: ComSignalType=UINT8
            DET_RANGE_VELOCITY_ERR_100_oRDR_DETECTION_097_100_oPCAN_RADAR_9096b887_Tx: ComSignalType=UINT8
            DET_RCS_097_oRDR_DETECTION_097_100_oPCAN_RADAR_95c31085_Tx: ComSignalType=UINT8
            DET_RCS_098_oRDR_DETECTION_097_100_oPCAN_RADAR_b9d382c2_Tx: ComSignalType=UINT8
            DET_RCS_099_oRDR_DETECTION_097_100_oPCAN_RADAR_2ca35657_Tx: ComSignalType=UINT8
            DET_RCS_100_oRDR_DETECTION_097_100_oPCAN_RADAR_18ad746f_Tx: ComSignalType=UINT8
            DET_SNR_097_oRDR_DETECTION_097_100_oPCAN_RADAR_486d4487_Tx: ComSignalType=UINT8
            DET_SNR_098_oRDR_DETECTION_097_100_oPCAN_RADAR_647dd6c0_Tx: ComSignalType=UINT8
            DET_SNR_099_oRDR_DETECTION_097_100_oPCAN_RADAR_f10d0255_Tx: ComSignalType=UINT8
            DET_SNR_100_oRDR_DETECTION_097_100_oPCAN_RADAR_c503206d_Tx: ComSignalType=UINT8
            DET_SUPER_RES_TARGET_097_oRDR_DETECTION_097_100_oPCAN_RADAR_79f46ce2_Tx: ComSignalType=BOOLEAN
            DET_SUPER_RES_TARGET_098_oRDR_DETECTION_097_100_oPCAN_RADAR_55e4fea5_Tx: ComSignalType=BOOLEAN
            DET_SUPER_RES_TARGET_099_oRDR_DETECTION_097_100_oPCAN_RADAR_c0942a30_Tx: ComSignalType=BOOLEAN
            DET_SUPER_RES_TARGET_100_oRDR_DETECTION_097_100_oPCAN_RADAR_f49a0808_Tx: ComSignalType=BOOLEAN
        SG_Detections_101_104_oRDR_DETECTION_101_104_oPCAN_RADAR_9de0b719_Tx
          83 x ComGroupSignal:
            DET_AZIMUTH_101_oRDR_DETECTION_101_104_oPCAN_RADAR_270c6315_Tx: ComSignalType=UINT16
            DET_AZIMUTH_102_oRDR_DETECTION_101_104_oPCAN_RADAR_43ec18eb_Tx: ComSignalType=UINT16
            DET_AZIMUTH_103_oRDR_DETECTION_101_104_oPCAN_RADAR_d69ccc7e_Tx: ComSignalType=UINT16
            DET_AZIMUTH_104_oRDR_DETECTION_101_104_oPCAN_RADAR_8a2cef17_Tx: ComSignalType=UINT16
            DET_AZIMUTH_ERR_101_oRDR_DETECTION_101_104_oPCAN_RADAR_83b9f6e0_Tx: ComSignalType=UINT8
            DET_AZIMUTH_ERR_102_oRDR_DETECTION_101_104_oPCAN_RADAR_e7598d1e_Tx: ComSignalType=UINT8
            DET_AZIMUTH_ERR_103_oRDR_DETECTION_101_104_oPCAN_RADAR_7229598b_Tx: ComSignalType=UINT8
            DET_AZIMUTH_ERR_104_oRDR_DETECTION_101_104_oPCAN_RADAR_2e997ae2_Tx: ComSignalType=UINT8
            DET_BELOW_RAIN_THOLD_101_oRDR_DETECTION_101_104_oPCAN_RADAR_f20df0d5_Tx: ComSignalType=UINT8
            DET_BELOW_RAIN_THOLD_102_oRDR_DETECTION_101_104_oPCAN_RADAR_96ed8b2b_Tx: ComSignalType=UINT8
            DET_BELOW_RAIN_THOLD_103_oRDR_DETECTION_101_104_oPCAN_RADAR_039d5fbe_Tx: ComSignalType=UINT8
            DET_BELOW_RAIN_THOLD_104_oRDR_DETECTION_101_104_oPCAN_RADAR_5f2d7cd7_Tx: ComSignalType=UINT8
            DET_BI_STATIC_FLAG_101_oRDR_DETECTION_101_104_oPCAN_RADAR_71202390_Tx: ComSignalType=BOOLEAN
            DET_BI_STATIC_FLAG_102_oRDR_DETECTION_101_104_oPCAN_RADAR_15c0586e_Tx: ComSignalType=BOOLEAN
            DET_BI_STATIC_FLAG_103_oRDR_DETECTION_101_104_oPCAN_RADAR_80b08cfb_Tx: ComSignalType=BOOLEAN
            DET_BI_STATIC_FLAG_104_oRDR_DETECTION_101_104_oPCAN_RADAR_dc00af92_Tx: ComSignalType=BOOLEAN
            DET_CONFD_AZIMUTH_101_oRDR_DETECTION_101_104_oPCAN_RADAR_25ea69df_Tx: ComSignalType=UINT8
            DET_CONFD_AZIMUTH_102_oRDR_DETECTION_101_104_oPCAN_RADAR_410a1221_Tx: ComSignalType=UINT8
            DET_CONFD_AZIMUTH_103_oRDR_DETECTION_101_104_oPCAN_RADAR_d47ac6b4_Tx: ComSignalType=UINT8
            DET_CONFD_AZIMUTH_104_oRDR_DETECTION_101_104_oPCAN_RADAR_88cae5dd_Tx: ComSignalType=UINT8
            DET_CONFD_ELEVATION_101_oRDR_DETECTION_101_104_oPCAN_RADAR_277f6825_Tx: ComSignalType=UINT8
            DET_CONFD_ELEVATION_102_oRDR_DETECTION_101_104_oPCAN_RADAR_439f13db_Tx: ComSignalType=UINT8
            DET_CONFD_ELEVATION_103_oRDR_DETECTION_101_104_oPCAN_RADAR_d6efc74e_Tx: ComSignalType=UINT8
            DET_CONFD_ELEVATION_104_oRDR_DETECTION_101_104_oPCAN_RADAR_8a5fe427_Tx: ComSignalType=UINT8
            DET_ELEVATION_101_oRDR_DETECTION_101_104_oPCAN_RADAR_f6bfbc19_Tx: ComSignalType=UINT8
            DET_ELEVATION_102_oRDR_DETECTION_101_104_oPCAN_RADAR_925fc7e7_Tx: ComSignalType=UINT8
            DET_ELEVATION_103_oRDR_DETECTION_101_104_oPCAN_RADAR_072f1372_Tx: ComSignalType=UINT8
            DET_ELEVATION_104_oRDR_DETECTION_101_104_oPCAN_RADAR_5b9f301b_Tx: ComSignalType=UINT8
            DET_ELEVATION_ERR_101_oRDR_DETECTION_101_104_oPCAN_RADAR_7186246c_Tx: ComSignalType=UINT8
            DET_ELEVATION_ERR_102_oRDR_DETECTION_101_104_oPCAN_RADAR_15665f92_Tx: ComSignalType=UINT8
            DET_ELEVATION_ERR_103_oRDR_DETECTION_101_104_oPCAN_RADAR_80168b07_Tx: ComSignalType=UINT8
            DET_ELEVATION_ERR_104_oRDR_DETECTION_101_104_oPCAN_RADAR_dca6a86e_Tx: ComSignalType=UINT8
            DET_EXISTENCE_PROB_101_oRDR_DETECTION_101_104_oPCAN_RADAR_a319510c_Tx: ComSignalType=UINT8
            DET_EXISTENCE_PROB_102_oRDR_DETECTION_101_104_oPCAN_RADAR_c7f92af2_Tx: ComSignalType=UINT8
            DET_EXISTENCE_PROB_103_oRDR_DETECTION_101_104_oPCAN_RADAR_5289fe67_Tx: ComSignalType=UINT8
            DET_EXISTENCE_PROB_104_oRDR_DETECTION_101_104_oPCAN_RADAR_0e39dd0e_Tx: ComSignalType=UINT8
            DET_HVC_FLAG_101_oRDR_DETECTION_101_104_oPCAN_RADAR_426d1273_Tx: ComSignalType=BOOLEAN
            DET_HVC_FLAG_102_oRDR_DETECTION_101_104_oPCAN_RADAR_268d698d_Tx: ComSignalType=BOOLEAN
            DET_HVC_FLAG_103_oRDR_DETECTION_101_104_oPCAN_RADAR_b3fdbd18_Tx: ComSignalType=BOOLEAN
            DET_HVC_FLAG_104_oRDR_DETECTION_101_104_oPCAN_RADAR_ef4d9e71_Tx: ComSignalType=BOOLEAN
            DET_IDM_101_oRDR_DETECTION_101_104_oPCAN_RADAR_c93f29ce_Tx: ComSignalType=UINT8
            DET_IDM_102_oRDR_DETECTION_101_104_oPCAN_RADAR_addf5230_Tx: ComSignalType=UINT8
            DET_IDM_103_oRDR_DETECTION_101_104_oPCAN_RADAR_38af86a5_Tx: ComSignalType=UINT8
            DET_IDM_104_oRDR_DETECTION_101_104_oPCAN_RADAR_641fa5cc_Tx: ComSignalType=UINT8
            DET_MH_CRC16_101_104_oRDR_DETECTION_101_104_oPCAN_RADAR_19686512_Tx: ComSignalType=UINT16
            DET_MH_CYCLE_COUNTER_101_104_oRDR_DETECTION_101_104_oPCAN_RADAR_9d1dc425_Tx: ComSignalType=UINT8
            DET_MH_SCAN_INDEX_4LSB_101_104_oRDR_DETECTION_101_104_oPCAN_RADAR_5137e1a9_Tx: ComSignalType=UINT8
            DET_MTD_101_oRDR_DETECTION_101_104_oPCAN_RADAR_af8c1b15_Tx: ComSignalType=UINT8
            DET_MTD_102_oRDR_DETECTION_101_104_oPCAN_RADAR_cb6c60eb_Tx: ComSignalType=UINT8
            DET_MTD_103_oRDR_DETECTION_101_104_oPCAN_RADAR_5e1cb47e_Tx: ComSignalType=UINT8
            DET_MTD_104_oRDR_DETECTION_101_104_oPCAN_RADAR_02ac9717_Tx: ComSignalType=UINT8
            DET_PROB_1STAZHYPO_101_oRDR_DETECTION_101_104_oPCAN_RADAR_3c38f3d8_Tx: ComSignalType=BOOLEAN
            DET_PROB_1STAZHYPO_102_oRDR_DETECTION_101_104_oPCAN_RADAR_58d88826_Tx: ComSignalType=BOOLEAN
            DET_PROB_1STAZHYPO_103_oRDR_DETECTION_101_104_oPCAN_RADAR_cda85cb3_Tx: ComSignalType=BOOLEAN
            DET_PROB_1STAZHYPO_104_oRDR_DETECTION_101_104_oPCAN_RADAR_91187fda_Tx: ComSignalType=BOOLEAN
            DET_RANGE_101_oRDR_DETECTION_101_104_oPCAN_RADAR_379710ae_Tx: ComSignalType=UINT16
            DET_RANGE_102_oRDR_DETECTION_101_104_oPCAN_RADAR_53776b50_Tx: ComSignalType=UINT16
            DET_RANGE_103_oRDR_DETECTION_101_104_oPCAN_RADAR_c607bfc5_Tx: ComSignalType=UINT16
            DET_RANGE_104_oRDR_DETECTION_101_104_oPCAN_RADAR_9ab79cac_Tx: ComSignalType=UINT16
            DET_RANGE_ERR_101_oRDR_DETECTION_101_104_oPCAN_RADAR_907faac7_Tx: ComSignalType=UINT8
            DET_RANGE_ERR_102_oRDR_DETECTION_101_104_oPCAN_RADAR_f49fd139_Tx: ComSignalType=UINT8
            DET_RANGE_ERR_103_oRDR_DETECTION_101_104_oPCAN_RADAR_61ef05ac_Tx: ComSignalType=UINT8
            DET_RANGE_ERR_104_oRDR_DETECTION_101_104_oPCAN_RADAR_3d5f26c5_Tx: ComSignalType=UINT8
            DET_RANGE_VELOCITY_101_oRDR_DETECTION_101_104_oPCAN_RADAR_4231d28b_Tx: ComSignalType=UINT16
            DET_RANGE_VELOCITY_102_oRDR_DETECTION_101_104_oPCAN_RADAR_26d1a975_Tx: ComSignalType=UINT16
            DET_RANGE_VELOCITY_103_oRDR_DETECTION_101_104_oPCAN_RADAR_b3a17de0_Tx: ComSignalType=UINT16
            DET_RANGE_VELOCITY_104_oRDR_DETECTION_101_104_oPCAN_RADAR_ef115e89_Tx: ComSignalType=UINT16
            DET_RANGE_VELOCITY_ERR_101_oRDR_DETECTION_101_104_oPCAN_RADAR_4d8a2939_Tx: ComSignalType=UINT8
            DET_RANGE_VELOCITY_ERR_102_oRDR_DETECTION_101_104_oPCAN_RADAR_296a52c7_Tx: ComSignalType=UINT8
            DET_RANGE_VELOCITY_ERR_103_oRDR_DETECTION_101_104_oPCAN_RADAR_bc1a8652_Tx: ComSignalType=UINT8
            DET_RANGE_VELOCITY_ERR_104_oRDR_DETECTION_101_104_oPCAN_RADAR_e0aaa53b_Tx: ComSignalType=UINT8
            DET_RCS_101_oRDR_DETECTION_101_104_oPCAN_RADAR_c5b1e5d1_Tx: ComSignalType=UINT8
            DET_RCS_102_oRDR_DETECTION_101_104_oPCAN_RADAR_a1519e2f_Tx: ComSignalType=UINT8
            DET_RCS_103_oRDR_DETECTION_101_104_oPCAN_RADAR_34214aba_Tx: ComSignalType=UINT8
            DET_RCS_104_oRDR_DETECTION_101_104_oPCAN_RADAR_689169d3_Tx: ComSignalType=UINT8
            DET_SNR_101_oRDR_DETECTION_101_104_oPCAN_RADAR_181fb1d3_Tx: ComSignalType=UINT8
            DET_SNR_102_oRDR_DETECTION_101_104_oPCAN_RADAR_7cffca2d_Tx: ComSignalType=UINT8
            DET_SNR_103_oRDR_DETECTION_101_104_oPCAN_RADAR_e98f1eb8_Tx: ComSignalType=UINT8
            DET_SNR_104_oRDR_DETECTION_101_104_oPCAN_RADAR_b53f3dd1_Tx: ComSignalType=UINT8
            DET_SUPER_RES_TARGET_101_oRDR_DETECTION_101_104_oPCAN_RADAR_298699b6_Tx: ComSignalType=BOOLEAN
            DET_SUPER_RES_TARGET_102_oRDR_DETECTION_101_104_oPCAN_RADAR_4d66e248_Tx: ComSignalType=BOOLEAN
            DET_SUPER_RES_TARGET_103_oRDR_DETECTION_101_104_oPCAN_RADAR_d81636dd_Tx: ComSignalType=BOOLEAN
            DET_SUPER_RES_TARGET_104_oRDR_DETECTION_101_104_oPCAN_RADAR_84a615b4_Tx: ComSignalType=BOOLEAN
        SG_Detections_105_108_oRDR_DETECTION_105_108_oPCAN_RADAR_ec23834b_Tx
          83 x ComGroupSignal:
            DET_AZIMUTH_105_oRDR_DETECTION_105_108_oPCAN_RADAR_f6eea5b6_Tx: ComSignalType=UINT16
            DET_AZIMUTH_106_oRDR_DETECTION_105_108_oPCAN_RADAR_920ede48_Tx: ComSignalType=UINT16
            DET_AZIMUTH_107_oRDR_DETECTION_105_108_oPCAN_RADAR_077e0add_Tx: ComSignalType=UINT16
            DET_AZIMUTH_108_oRDR_DETECTION_105_108_oPCAN_RADAR_2b6e989a_Tx: ComSignalType=UINT16
            DET_AZIMUTH_ERR_105_oRDR_DETECTION_105_108_oPCAN_RADAR_525b3043_Tx: ComSignalType=UINT8
            DET_AZIMUTH_ERR_106_oRDR_DETECTION_105_108_oPCAN_RADAR_36bb4bbd_Tx: ComSignalType=UINT8
            DET_AZIMUTH_ERR_107_oRDR_DETECTION_105_108_oPCAN_RADAR_a3cb9f28_Tx: ComSignalType=UINT8
            DET_AZIMUTH_ERR_108_oRDR_DETECTION_105_108_oPCAN_RADAR_8fdb0d6f_Tx: ComSignalType=UINT8
            DET_BELOW_RAIN_THOLD_105_oRDR_DETECTION_105_108_oPCAN_RADAR_23ef3676_Tx: ComSignalType=UINT8
            DET_BELOW_RAIN_THOLD_106_oRDR_DETECTION_105_108_oPCAN_RADAR_470f4d88_Tx: ComSignalType=UINT8
            DET_BELOW_RAIN_THOLD_107_oRDR_DETECTION_105_108_oPCAN_RADAR_d27f991d_Tx: ComSignalType=UINT8
            DET_BELOW_RAIN_THOLD_108_oRDR_DETECTION_105_108_oPCAN_RADAR_fe6f0b5a_Tx: ComSignalType=UINT8
            DET_BI_STATIC_FLAG_105_oRDR_DETECTION_105_108_oPCAN_RADAR_a0c2e533_Tx: ComSignalType=BOOLEAN
            DET_BI_STATIC_FLAG_106_oRDR_DETECTION_105_108_oPCAN_RADAR_c4229ecd_Tx: ComSignalType=BOOLEAN
            DET_BI_STATIC_FLAG_107_oRDR_DETECTION_105_108_oPCAN_RADAR_51524a58_Tx: ComSignalType=BOOLEAN
            DET_BI_STATIC_FLAG_108_oRDR_DETECTION_105_108_oPCAN_RADAR_7d42d81f_Tx: ComSignalType=BOOLEAN
            DET_CONFD_AZIMUTH_105_oRDR_DETECTION_105_108_oPCAN_RADAR_f408af7c_Tx: ComSignalType=UINT8
            DET_CONFD_AZIMUTH_106_oRDR_DETECTION_105_108_oPCAN_RADAR_90e8d482_Tx: ComSignalType=UINT8
            DET_CONFD_AZIMUTH_107_oRDR_DETECTION_105_108_oPCAN_RADAR_05980017_Tx: ComSignalType=UINT8
            DET_CONFD_AZIMUTH_108_oRDR_DETECTION_105_108_oPCAN_RADAR_29889250_Tx: ComSignalType=UINT8
            DET_CONFD_ELEVATION_105_oRDR_DETECTION_105_108_oPCAN_RADAR_f69dae86_Tx: ComSignalType=UINT8
            DET_CONFD_ELEVATION_106_oRDR_DETECTION_105_108_oPCAN_RADAR_927dd578_Tx: ComSignalType=UINT8
            DET_CONFD_ELEVATION_107_oRDR_DETECTION_105_108_oPCAN_RADAR_070d01ed_Tx: ComSignalType=UINT8
            DET_CONFD_ELEVATION_108_oRDR_DETECTION_105_108_oPCAN_RADAR_2b1d93aa_Tx: ComSignalType=UINT8
            DET_ELEVATION_105_oRDR_DETECTION_105_108_oPCAN_RADAR_275d7aba_Tx: ComSignalType=UINT8
            DET_ELEVATION_106_oRDR_DETECTION_105_108_oPCAN_RADAR_43bd0144_Tx: ComSignalType=UINT8
            DET_ELEVATION_107_oRDR_DETECTION_105_108_oPCAN_RADAR_d6cdd5d1_Tx: ComSignalType=UINT8
            DET_ELEVATION_108_oRDR_DETECTION_105_108_oPCAN_RADAR_fadd4796_Tx: ComSignalType=UINT8
            DET_ELEVATION_ERR_105_oRDR_DETECTION_105_108_oPCAN_RADAR_a064e2cf_Tx: ComSignalType=UINT8
            DET_ELEVATION_ERR_106_oRDR_DETECTION_105_108_oPCAN_RADAR_c4849931_Tx: ComSignalType=UINT8
            DET_ELEVATION_ERR_107_oRDR_DETECTION_105_108_oPCAN_RADAR_51f44da4_Tx: ComSignalType=UINT8
            DET_ELEVATION_ERR_108_oRDR_DETECTION_105_108_oPCAN_RADAR_7de4dfe3_Tx: ComSignalType=UINT8
            DET_EXISTENCE_PROB_105_oRDR_DETECTION_105_108_oPCAN_RADAR_72fb97af_Tx: ComSignalType=UINT8
            DET_EXISTENCE_PROB_106_oRDR_DETECTION_105_108_oPCAN_RADAR_161bec51_Tx: ComSignalType=UINT8
            DET_EXISTENCE_PROB_107_oRDR_DETECTION_105_108_oPCAN_RADAR_836b38c4_Tx: ComSignalType=UINT8
            DET_EXISTENCE_PROB_108_oRDR_DETECTION_105_108_oPCAN_RADAR_af7baa83_Tx: ComSignalType=UINT8
            DET_HVC_FLAG_105_oRDR_DETECTION_105_108_oPCAN_RADAR_938fd4d0_Tx: ComSignalType=BOOLEAN
            DET_HVC_FLAG_106_oRDR_DETECTION_105_108_oPCAN_RADAR_f76faf2e_Tx: ComSignalType=BOOLEAN
            DET_HVC_FLAG_107_oRDR_DETECTION_105_108_oPCAN_RADAR_621f7bbb_Tx: ComSignalType=BOOLEAN
            DET_HVC_FLAG_108_oRDR_DETECTION_105_108_oPCAN_RADAR_4e0fe9fc_Tx: ComSignalType=BOOLEAN
            DET_IDM_105_oRDR_DETECTION_105_108_oPCAN_RADAR_18ddef6d_Tx: ComSignalType=UINT8
            DET_IDM_106_oRDR_DETECTION_105_108_oPCAN_RADAR_7c3d9493_Tx: ComSignalType=UINT8
            DET_IDM_107_oRDR_DETECTION_105_108_oPCAN_RADAR_e94d4006_Tx: ComSignalType=UINT8
            DET_IDM_108_oRDR_DETECTION_105_108_oPCAN_RADAR_c55dd241_Tx: ComSignalType=UINT8
            DET_MH_CRC16_105_108_oRDR_DETECTION_105_108_oPCAN_RADAR_68ab5140_Tx: ComSignalType=UINT16
            DET_MH_CYCLE_COUNTER_105_108_oRDR_DETECTION_105_108_oPCAN_RADAR_ecdef077_Tx: ComSignalType=UINT8
            DET_MH_SCAN_INDEX_4LSB_105_108_oRDR_DETECTION_105_108_oPCAN_RADAR_20f4d5fb_Tx: ComSignalType=UINT8
            DET_MTD_105_oRDR_DETECTION_105_108_oPCAN_RADAR_7e6eddb6_Tx: ComSignalType=UINT8
            DET_MTD_106_oRDR_DETECTION_105_108_oPCAN_RADAR_1a8ea648_Tx: ComSignalType=UINT8
            DET_MTD_107_oRDR_DETECTION_105_108_oPCAN_RADAR_8ffe72dd_Tx: ComSignalType=UINT8
            DET_MTD_108_oRDR_DETECTION_105_108_oPCAN_RADAR_a3eee09a_Tx: ComSignalType=UINT8
            DET_PROB_1STAZHYPO_105_oRDR_DETECTION_105_108_oPCAN_RADAR_edda357b_Tx: ComSignalType=BOOLEAN
            DET_PROB_1STAZHYPO_106_oRDR_DETECTION_105_108_oPCAN_RADAR_893a4e85_Tx: ComSignalType=BOOLEAN
            DET_PROB_1STAZHYPO_107_oRDR_DETECTION_105_108_oPCAN_RADAR_1c4a9a10_Tx: ComSignalType=BOOLEAN
            DET_PROB_1STAZHYPO_108_oRDR_DETECTION_105_108_oPCAN_RADAR_305a0857_Tx: ComSignalType=BOOLEAN
            DET_RANGE_105_oRDR_DETECTION_105_108_oPCAN_RADAR_e675d60d_Tx: ComSignalType=UINT16
            DET_RANGE_106_oRDR_DETECTION_105_108_oPCAN_RADAR_8295adf3_Tx: ComSignalType=UINT16
            DET_RANGE_107_oRDR_DETECTION_105_108_oPCAN_RADAR_17e57966_Tx: ComSignalType=UINT16
            DET_RANGE_108_oRDR_DETECTION_105_108_oPCAN_RADAR_3bf5eb21_Tx: ComSignalType=UINT16
            DET_RANGE_ERR_105_oRDR_DETECTION_105_108_oPCAN_RADAR_419d6c64_Tx: ComSignalType=UINT8
            DET_RANGE_ERR_106_oRDR_DETECTION_105_108_oPCAN_RADAR_257d179a_Tx: ComSignalType=UINT8
            DET_RANGE_ERR_107_oRDR_DETECTION_105_108_oPCAN_RADAR_b00dc30f_Tx: ComSignalType=UINT8
            DET_RANGE_ERR_108_oRDR_DETECTION_105_108_oPCAN_RADAR_9c1d5148_Tx: ComSignalType=UINT8
            DET_RANGE_VELOCITY_105_oRDR_DETECTION_105_108_oPCAN_RADAR_93d31428_Tx: ComSignalType=UINT16
            DET_RANGE_VELOCITY_106_oRDR_DETECTION_105_108_oPCAN_RADAR_f7336fd6_Tx: ComSignalType=UINT16
            DET_RANGE_VELOCITY_107_oRDR_DETECTION_105_108_oPCAN_RADAR_6243bb43_Tx: ComSignalType=UINT16
            DET_RANGE_VELOCITY_108_oRDR_DETECTION_105_108_oPCAN_RADAR_4e532904_Tx: ComSignalType=UINT16
            DET_RANGE_VELOCITY_ERR_105_oRDR_DETECTION_105_108_oPCAN_RADAR_9c68ef9a_Tx: ComSignalType=UINT8
            DET_RANGE_VELOCITY_ERR_106_oRDR_DETECTION_105_108_oPCAN_RADAR_f8889464_Tx: ComSignalType=UINT8
            DET_RANGE_VELOCITY_ERR_107_oRDR_DETECTION_105_108_oPCAN_RADAR_6df840f1_Tx: ComSignalType=UINT8
            DET_RANGE_VELOCITY_ERR_108_oRDR_DETECTION_105_108_oPCAN_RADAR_41e8d2b6_Tx: ComSignalType=UINT8
            DET_RCS_105_oRDR_DETECTION_105_108_oPCAN_RADAR_14532372_Tx: ComSignalType=UINT8
            DET_RCS_106_oRDR_DETECTION_105_108_oPCAN_RADAR_70b3588c_Tx: ComSignalType=UINT8
            DET_RCS_107_oRDR_DETECTION_105_108_oPCAN_RADAR_e5c38c19_Tx: ComSignalType=UINT8
            DET_RCS_108_oRDR_DETECTION_105_108_oPCAN_RADAR_c9d31e5e_Tx: ComSignalType=UINT8
            DET_SNR_105_oRDR_DETECTION_105_108_oPCAN_RADAR_c9fd7770_Tx: ComSignalType=UINT8
            DET_SNR_106_oRDR_DETECTION_105_108_oPCAN_RADAR_ad1d0c8e_Tx: ComSignalType=UINT8
            DET_SNR_107_oRDR_DETECTION_105_108_oPCAN_RADAR_386dd81b_Tx: ComSignalType=UINT8
            DET_SNR_108_oRDR_DETECTION_105_108_oPCAN_RADAR_147d4a5c_Tx: ComSignalType=UINT8
            DET_SUPER_RES_TARGET_105_oRDR_DETECTION_105_108_oPCAN_RADAR_f8645f15_Tx: ComSignalType=BOOLEAN
            DET_SUPER_RES_TARGET_106_oRDR_DETECTION_105_108_oPCAN_RADAR_9c8424eb_Tx: ComSignalType=BOOLEAN
            DET_SUPER_RES_TARGET_107_oRDR_DETECTION_105_108_oPCAN_RADAR_09f4f07e_Tx: ComSignalType=BOOLEAN
            DET_SUPER_RES_TARGET_108_oRDR_DETECTION_105_108_oPCAN_RADAR_25e46239_Tx: ComSignalType=BOOLEAN
        SG_Detections_109_112_oRDR_DETECTION_109_112_oPCAN_RADAR_7559a730_Tx
          83 x ComGroupSignal:
            DET_AZIMUTH_109_oRDR_DETECTION_109_112_oPCAN_RADAR_8c56a30e_Tx: ComSignalType=UINT16
            DET_AZIMUTH_110_oRDR_DETECTION_109_112_oPCAN_RADAR_e976d1aa_Tx: ComSignalType=UINT16
            DET_AZIMUTH_111_oRDR_DETECTION_109_112_oPCAN_RADAR_7c06053f_Tx: ComSignalType=UINT16
            DET_AZIMUTH_112_oRDR_DETECTION_109_112_oPCAN_RADAR_18e67ec1_Tx: ComSignalType=UINT16
            DET_AZIMUTH_ERR_109_oRDR_DETECTION_109_112_oPCAN_RADAR_28e336fb_Tx: ComSignalType=UINT8
            DET_AZIMUTH_ERR_110_oRDR_DETECTION_109_112_oPCAN_RADAR_4dc3445f_Tx: ComSignalType=UINT8
            DET_AZIMUTH_ERR_111_oRDR_DETECTION_109_112_oPCAN_RADAR_d8b390ca_Tx: ComSignalType=UINT8
            DET_AZIMUTH_ERR_112_oRDR_DETECTION_109_112_oPCAN_RADAR_bc53eb34_Tx: ComSignalType=UINT8
            DET_BELOW_RAIN_THOLD_109_oRDR_DETECTION_109_112_oPCAN_RADAR_595730ce_Tx: ComSignalType=UINT8
            DET_BELOW_RAIN_THOLD_110_oRDR_DETECTION_109_112_oPCAN_RADAR_3c77426a_Tx: ComSignalType=UINT8
            DET_BELOW_RAIN_THOLD_111_oRDR_DETECTION_109_112_oPCAN_RADAR_a90796ff_Tx: ComSignalType=UINT8
            DET_BELOW_RAIN_THOLD_112_oRDR_DETECTION_109_112_oPCAN_RADAR_cde7ed01_Tx: ComSignalType=UINT8
            DET_BI_STATIC_FLAG_109_oRDR_DETECTION_109_112_oPCAN_RADAR_da7ae38b_Tx: ComSignalType=BOOLEAN
            DET_BI_STATIC_FLAG_110_oRDR_DETECTION_109_112_oPCAN_RADAR_bf5a912f_Tx: ComSignalType=BOOLEAN
            DET_BI_STATIC_FLAG_111_oRDR_DETECTION_109_112_oPCAN_RADAR_2a2a45ba_Tx: ComSignalType=BOOLEAN
            DET_BI_STATIC_FLAG_112_oRDR_DETECTION_109_112_oPCAN_RADAR_4eca3e44_Tx: ComSignalType=BOOLEAN
            DET_CONFD_AZIMUTH_109_oRDR_DETECTION_109_112_oPCAN_RADAR_8eb0a9c4_Tx: ComSignalType=UINT8
            DET_CONFD_AZIMUTH_110_oRDR_DETECTION_109_112_oPCAN_RADAR_eb90db60_Tx: ComSignalType=UINT8
            DET_CONFD_AZIMUTH_111_oRDR_DETECTION_109_112_oPCAN_RADAR_7ee00ff5_Tx: ComSignalType=UINT8
            DET_CONFD_AZIMUTH_112_oRDR_DETECTION_109_112_oPCAN_RADAR_1a00740b_Tx: ComSignalType=UINT8
            DET_CONFD_ELEVATION_109_oRDR_DETECTION_109_112_oPCAN_RADAR_8c25a83e_Tx: ComSignalType=UINT8
            DET_CONFD_ELEVATION_110_oRDR_DETECTION_109_112_oPCAN_RADAR_e905da9a_Tx: ComSignalType=UINT8
            DET_CONFD_ELEVATION_111_oRDR_DETECTION_109_112_oPCAN_RADAR_7c750e0f_Tx: ComSignalType=UINT8
            DET_CONFD_ELEVATION_112_oRDR_DETECTION_109_112_oPCAN_RADAR_189575f1_Tx: ComSignalType=UINT8
            DET_ELEVATION_109_oRDR_DETECTION_109_112_oPCAN_RADAR_5de57c02_Tx: ComSignalType=UINT8
            DET_ELEVATION_110_oRDR_DETECTION_109_112_oPCAN_RADAR_38c50ea6_Tx: ComSignalType=UINT8
            DET_ELEVATION_111_oRDR_DETECTION_109_112_oPCAN_RADAR_adb5da33_Tx: ComSignalType=UINT8
            DET_ELEVATION_112_oRDR_DETECTION_109_112_oPCAN_RADAR_c955a1cd_Tx: ComSignalType=UINT8
            DET_ELEVATION_ERR_109_oRDR_DETECTION_109_112_oPCAN_RADAR_dadce477_Tx: ComSignalType=UINT8
            DET_ELEVATION_ERR_110_oRDR_DETECTION_109_112_oPCAN_RADAR_bffc96d3_Tx: ComSignalType=UINT8
            DET_ELEVATION_ERR_111_oRDR_DETECTION_109_112_oPCAN_RADAR_2a8c4246_Tx: ComSignalType=UINT8
            DET_ELEVATION_ERR_112_oRDR_DETECTION_109_112_oPCAN_RADAR_4e6c39b8_Tx: ComSignalType=UINT8
            DET_EXISTENCE_PROB_109_oRDR_DETECTION_109_112_oPCAN_RADAR_08439117_Tx: ComSignalType=UINT8
            DET_EXISTENCE_PROB_110_oRDR_DETECTION_109_112_oPCAN_RADAR_6d63e3b3_Tx: ComSignalType=UINT8
            DET_EXISTENCE_PROB_111_oRDR_DETECTION_109_112_oPCAN_RADAR_f8133726_Tx: ComSignalType=UINT8
            DET_EXISTENCE_PROB_112_oRDR_DETECTION_109_112_oPCAN_RADAR_9cf34cd8_Tx: ComSignalType=UINT8
            DET_HVC_FLAG_109_oRDR_DETECTION_109_112_oPCAN_RADAR_e937d268_Tx: ComSignalType=BOOLEAN
            DET_HVC_FLAG_110_oRDR_DETECTION_109_112_oPCAN_RADAR_8c17a0cc_Tx: ComSignalType=BOOLEAN
            DET_HVC_FLAG_111_oRDR_DETECTION_109_112_oPCAN_RADAR_19677459_Tx: ComSignalType=BOOLEAN
            DET_HVC_FLAG_112_oRDR_DETECTION_109_112_oPCAN_RADAR_7d870fa7_Tx: ComSignalType=BOOLEAN
            DET_IDM_109_oRDR_DETECTION_109_112_oPCAN_RADAR_6265e9d5_Tx: ComSignalType=UINT8
            DET_IDM_110_oRDR_DETECTION_109_112_oPCAN_RADAR_07459b71_Tx: ComSignalType=UINT8
            DET_IDM_111_oRDR_DETECTION_109_112_oPCAN_RADAR_92354fe4_Tx: ComSignalType=UINT8
            DET_IDM_112_oRDR_DETECTION_109_112_oPCAN_RADAR_f6d5341a_Tx: ComSignalType=UINT8
            DET_MH_CRC16_109_112_oRDR_DETECTION_109_112_oPCAN_RADAR_f1d1753b_Tx: ComSignalType=UINT16
            DET_MH_CYCLE_COUNTER_109_112_oRDR_DETECTION_109_112_oPCAN_RADAR_75a4d40c_Tx: ComSignalType=UINT8
            DET_MH_SCAN_INDEX_4LSB_109_112_oRDR_DETECTION_109_112_oPCAN_RADAR_b98ef180_Tx: ComSignalType=UINT8
            DET_MTD_109_oRDR_DETECTION_109_112_oPCAN_RADAR_04d6db0e_Tx: ComSignalType=UINT8
            DET_MTD_110_oRDR_DETECTION_109_112_oPCAN_RADAR_61f6a9aa_Tx: ComSignalType=UINT8
            DET_MTD_111_oRDR_DETECTION_109_112_oPCAN_RADAR_f4867d3f_Tx: ComSignalType=UINT8
            DET_MTD_112_oRDR_DETECTION_109_112_oPCAN_RADAR_906606c1_Tx: ComSignalType=UINT8
            DET_PROB_1STAZHYPO_109_oRDR_DETECTION_109_112_oPCAN_RADAR_976233c3_Tx: ComSignalType=BOOLEAN
            DET_PROB_1STAZHYPO_110_oRDR_DETECTION_109_112_oPCAN_RADAR_f2424167_Tx: ComSignalType=BOOLEAN
            DET_PROB_1STAZHYPO_111_oRDR_DETECTION_109_112_oPCAN_RADAR_673295f2_Tx: ComSignalType=BOOLEAN
            DET_PROB_1STAZHYPO_112_oRDR_DETECTION_109_112_oPCAN_RADAR_03d2ee0c_Tx: ComSignalType=BOOLEAN
            DET_RANGE_109_oRDR_DETECTION_109_112_oPCAN_RADAR_9ccdd0b5_Tx: ComSignalType=UINT16
            DET_RANGE_110_oRDR_DETECTION_109_112_oPCAN_RADAR_f9eda211_Tx: ComSignalType=UINT16
            DET_RANGE_111_oRDR_DETECTION_109_112_oPCAN_RADAR_6c9d7684_Tx: ComSignalType=UINT16
            DET_RANGE_112_oRDR_DETECTION_109_112_oPCAN_RADAR_087d0d7a_Tx: ComSignalType=UINT16
            DET_RANGE_ERR_109_oRDR_DETECTION_109_112_oPCAN_RADAR_3b256adc_Tx: ComSignalType=UINT8
            DET_RANGE_ERR_110_oRDR_DETECTION_109_112_oPCAN_RADAR_5e051878_Tx: ComSignalType=UINT8
            DET_RANGE_ERR_111_oRDR_DETECTION_109_112_oPCAN_RADAR_cb75cced_Tx: ComSignalType=UINT8
            DET_RANGE_ERR_112_oRDR_DETECTION_109_112_oPCAN_RADAR_af95b713_Tx: ComSignalType=UINT8
            DET_RANGE_VELOCITY_109_oRDR_DETECTION_109_112_oPCAN_RADAR_e96b1290_Tx: ComSignalType=UINT16
            DET_RANGE_VELOCITY_110_oRDR_DETECTION_109_112_oPCAN_RADAR_8c4b6034_Tx: ComSignalType=UINT16
            DET_RANGE_VELOCITY_111_oRDR_DETECTION_109_112_oPCAN_RADAR_193bb4a1_Tx: ComSignalType=UINT16
            DET_RANGE_VELOCITY_112_oRDR_DETECTION_109_112_oPCAN_RADAR_7ddbcf5f_Tx: ComSignalType=UINT16
            DET_RANGE_VELOCITY_ERR_109_oRDR_DETECTION_109_112_oPCAN_RADAR_e6d0e922_Tx: ComSignalType=UINT8
            DET_RANGE_VELOCITY_ERR_110_oRDR_DETECTION_109_112_oPCAN_RADAR_83f09b86_Tx: ComSignalType=UINT8
            DET_RANGE_VELOCITY_ERR_111_oRDR_DETECTION_109_112_oPCAN_RADAR_16804f13_Tx: ComSignalType=UINT8
            DET_RANGE_VELOCITY_ERR_112_oRDR_DETECTION_109_112_oPCAN_RADAR_726034ed_Tx: ComSignalType=UINT8
            DET_RCS_109_oRDR_DETECTION_109_112_oPCAN_RADAR_6eeb25ca_Tx: ComSignalType=UINT8
            DET_RCS_110_oRDR_DETECTION_109_112_oPCAN_RADAR_0bcb576e_Tx: ComSignalType=UINT8
            DET_RCS_111_oRDR_DETECTION_109_112_oPCAN_RADAR_9ebb83fb_Tx: ComSignalType=UINT8
            DET_RCS_112_oRDR_DETECTION_109_112_oPCAN_RADAR_fa5bf805_Tx: ComSignalType=UINT8
            DET_SNR_109_oRDR_DETECTION_109_112_oPCAN_RADAR_b34571c8_Tx: ComSignalType=UINT8
            DET_SNR_110_oRDR_DETECTION_109_112_oPCAN_RADAR_d665036c_Tx: ComSignalType=UINT8
            DET_SNR_111_oRDR_DETECTION_109_112_oPCAN_RADAR_4315d7f9_Tx: ComSignalType=UINT8
            DET_SNR_112_oRDR_DETECTION_109_112_oPCAN_RADAR_27f5ac07_Tx: ComSignalType=UINT8
            DET_SUPER_RES_TARGET_109_oRDR_DETECTION_109_112_oPCAN_RADAR_82dc59ad_Tx: ComSignalType=BOOLEAN
            DET_SUPER_RES_TARGET_110_oRDR_DETECTION_109_112_oPCAN_RADAR_e7fc2b09_Tx: ComSignalType=BOOLEAN
            DET_SUPER_RES_TARGET_111_oRDR_DETECTION_109_112_oPCAN_RADAR_728cff9c_Tx: ComSignalType=BOOLEAN
            DET_SUPER_RES_TARGET_112_oRDR_DETECTION_109_112_oPCAN_RADAR_166c8462_Tx: ComSignalType=BOOLEAN
        SG_Detections_113_116_oRDR_DETECTION_113_116_oPCAN_RADAR_4752cf18_Tx
          83 x ComGroupSignal:
            DET_AZIMUTH_113_oRDR_DETECTION_113_116_oPCAN_RADAR_9051a97a_Tx: ComSignalType=UINT16
            DET_AZIMUTH_114_oRDR_DETECTION_113_116_oPCAN_RADAR_cce18a13_Tx: ComSignalType=UINT16
            DET_AZIMUTH_115_oRDR_DETECTION_113_116_oPCAN_RADAR_59915e86_Tx: ComSignalType=UINT16
            DET_AZIMUTH_116_oRDR_DETECTION_113_116_oPCAN_RADAR_3d712578_Tx: ComSignalType=UINT16
            DET_AZIMUTH_ERR_113_oRDR_DETECTION_113_116_oPCAN_RADAR_34e43c8f_Tx: ComSignalType=UINT8
            DET_AZIMUTH_ERR_114_oRDR_DETECTION_113_116_oPCAN_RADAR_68541fe6_Tx: ComSignalType=UINT8
            DET_AZIMUTH_ERR_115_oRDR_DETECTION_113_116_oPCAN_RADAR_fd24cb73_Tx: ComSignalType=UINT8
            DET_AZIMUTH_ERR_116_oRDR_DETECTION_113_116_oPCAN_RADAR_99c4b08d_Tx: ComSignalType=UINT8
            DET_BELOW_RAIN_THOLD_113_oRDR_DETECTION_113_116_oPCAN_RADAR_45503aba_Tx: ComSignalType=UINT8
            DET_BELOW_RAIN_THOLD_114_oRDR_DETECTION_113_116_oPCAN_RADAR_19e019d3_Tx: ComSignalType=UINT8
            DET_BELOW_RAIN_THOLD_115_oRDR_DETECTION_113_116_oPCAN_RADAR_8c90cd46_Tx: ComSignalType=UINT8
            DET_BELOW_RAIN_THOLD_116_oRDR_DETECTION_113_116_oPCAN_RADAR_e870b6b8_Tx: ComSignalType=UINT8
            DET_BI_STATIC_FLAG_113_oRDR_DETECTION_113_116_oPCAN_RADAR_c67de9ff_Tx: ComSignalType=BOOLEAN
            DET_BI_STATIC_FLAG_114_oRDR_DETECTION_113_116_oPCAN_RADAR_9acdca96_Tx: ComSignalType=BOOLEAN
            DET_BI_STATIC_FLAG_115_oRDR_DETECTION_113_116_oPCAN_RADAR_0fbd1e03_Tx: ComSignalType=BOOLEAN
            DET_BI_STATIC_FLAG_116_oRDR_DETECTION_113_116_oPCAN_RADAR_6b5d65fd_Tx: ComSignalType=BOOLEAN
            DET_CONFD_AZIMUTH_113_oRDR_DETECTION_113_116_oPCAN_RADAR_92b7a3b0_Tx: ComSignalType=UINT8
            DET_CONFD_AZIMUTH_114_oRDR_DETECTION_113_116_oPCAN_RADAR_ce0780d9_Tx: ComSignalType=UINT8
            DET_CONFD_AZIMUTH_115_oRDR_DETECTION_113_116_oPCAN_RADAR_5b77544c_Tx: ComSignalType=UINT8
            DET_CONFD_AZIMUTH_116_oRDR_DETECTION_113_116_oPCAN_RADAR_3f972fb2_Tx: ComSignalType=UINT8
            DET_CONFD_ELEVATION_113_oRDR_DETECTION_113_116_oPCAN_RADAR_9022a24a_Tx: ComSignalType=UINT8
            DET_CONFD_ELEVATION_114_oRDR_DETECTION_113_116_oPCAN_RADAR_cc928123_Tx: ComSignalType=UINT8
            DET_CONFD_ELEVATION_115_oRDR_DETECTION_113_116_oPCAN_RADAR_59e255b6_Tx: ComSignalType=UINT8
            DET_CONFD_ELEVATION_116_oRDR_DETECTION_113_116_oPCAN_RADAR_3d022e48_Tx: ComSignalType=UINT8
            DET_ELEVATION_113_oRDR_DETECTION_113_116_oPCAN_RADAR_41e27676_Tx: ComSignalType=UINT8
            DET_ELEVATION_114_oRDR_DETECTION_113_116_oPCAN_RADAR_1d52551f_Tx: ComSignalType=UINT8
            DET_ELEVATION_115_oRDR_DETECTION_113_116_oPCAN_RADAR_8822818a_Tx: ComSignalType=UINT8
            DET_ELEVATION_116_oRDR_DETECTION_113_116_oPCAN_RADAR_ecc2fa74_Tx: ComSignalType=UINT8
            DET_ELEVATION_ERR_113_oRDR_DETECTION_113_116_oPCAN_RADAR_c6dbee03_Tx: ComSignalType=UINT8
            DET_ELEVATION_ERR_114_oRDR_DETECTION_113_116_oPCAN_RADAR_9a6bcd6a_Tx: ComSignalType=UINT8
            DET_ELEVATION_ERR_115_oRDR_DETECTION_113_116_oPCAN_RADAR_0f1b19ff_Tx: ComSignalType=UINT8
            DET_ELEVATION_ERR_116_oRDR_DETECTION_113_116_oPCAN_RADAR_6bfb6201_Tx: ComSignalType=UINT8
            DET_EXISTENCE_PROB_113_oRDR_DETECTION_113_116_oPCAN_RADAR_14449b63_Tx: ComSignalType=UINT8
            DET_EXISTENCE_PROB_114_oRDR_DETECTION_113_116_oPCAN_RADAR_48f4b80a_Tx: ComSignalType=UINT8
            DET_EXISTENCE_PROB_115_oRDR_DETECTION_113_116_oPCAN_RADAR_dd846c9f_Tx: ComSignalType=UINT8
            DET_EXISTENCE_PROB_116_oRDR_DETECTION_113_116_oPCAN_RADAR_b9641761_Tx: ComSignalType=UINT8
            DET_HVC_FLAG_113_oRDR_DETECTION_113_116_oPCAN_RADAR_f530d81c_Tx: ComSignalType=BOOLEAN
            DET_HVC_FLAG_114_oRDR_DETECTION_113_116_oPCAN_RADAR_a980fb75_Tx: ComSignalType=BOOLEAN
            DET_HVC_FLAG_115_oRDR_DETECTION_113_116_oPCAN_RADAR_3cf02fe0_Tx: ComSignalType=BOOLEAN
            DET_HVC_FLAG_116_oRDR_DETECTION_113_116_oPCAN_RADAR_5810541e_Tx: ComSignalType=BOOLEAN
            DET_IDM_113_oRDR_DETECTION_113_116_oPCAN_RADAR_7e62e3a1_Tx: ComSignalType=UINT8
            DET_IDM_114_oRDR_DETECTION_113_116_oPCAN_RADAR_22d2c0c8_Tx: ComSignalType=UINT8
            DET_IDM_115_oRDR_DETECTION_113_116_oPCAN_RADAR_b7a2145d_Tx: ComSignalType=UINT8
            DET_IDM_116_oRDR_DETECTION_113_116_oPCAN_RADAR_d3426fa3_Tx: ComSignalType=UINT8
            DET_MH_CRC16_113_116_oRDR_DETECTION_113_116_oPCAN_RADAR_c3da1d13_Tx: ComSignalType=UINT16
            DET_MH_CYCLE_COUNTER_113_116_oRDR_DETECTION_113_116_oPCAN_RADAR_47afbc24_Tx: ComSignalType=UINT8
            DET_MH_SCAN_INDEX_4LSB_113_116_oRDR_DETECTION_113_116_oPCAN_RADAR_8b8599a8_Tx: ComSignalType=UINT8
            DET_MTD_113_oRDR_DETECTION_113_116_oPCAN_RADAR_18d1d17a_Tx: ComSignalType=UINT8
            DET_MTD_114_oRDR_DETECTION_113_116_oPCAN_RADAR_4461f213_Tx: ComSignalType=UINT8
            DET_MTD_115_oRDR_DETECTION_113_116_oPCAN_RADAR_d1112686_Tx: ComSignalType=UINT8
            DET_MTD_116_oRDR_DETECTION_113_116_oPCAN_RADAR_b5f15d78_Tx: ComSignalType=UINT8
            DET_PROB_1STAZHYPO_113_oRDR_DETECTION_113_116_oPCAN_RADAR_8b6539b7_Tx: ComSignalType=BOOLEAN
            DET_PROB_1STAZHYPO_114_oRDR_DETECTION_113_116_oPCAN_RADAR_d7d51ade_Tx: ComSignalType=BOOLEAN
            DET_PROB_1STAZHYPO_115_oRDR_DETECTION_113_116_oPCAN_RADAR_42a5ce4b_Tx: ComSignalType=BOOLEAN
            DET_PROB_1STAZHYPO_116_oRDR_DETECTION_113_116_oPCAN_RADAR_2645b5b5_Tx: ComSignalType=BOOLEAN
            DET_RANGE_113_oRDR_DETECTION_113_116_oPCAN_RADAR_80cadac1_Tx: ComSignalType=UINT16
            DET_RANGE_114_oRDR_DETECTION_113_116_oPCAN_RADAR_dc7af9a8_Tx: ComSignalType=UINT16
            DET_RANGE_115_oRDR_DETECTION_113_116_oPCAN_RADAR_490a2d3d_Tx: ComSignalType=UINT16
            DET_RANGE_116_oRDR_DETECTION_113_116_oPCAN_RADAR_2dea56c3_Tx: ComSignalType=UINT16
            DET_RANGE_ERR_113_oRDR_DETECTION_113_116_oPCAN_RADAR_272260a8_Tx: ComSignalType=UINT8
            DET_RANGE_ERR_114_oRDR_DETECTION_113_116_oPCAN_RADAR_7b9243c1_Tx: ComSignalType=UINT8
            DET_RANGE_ERR_115_oRDR_DETECTION_113_116_oPCAN_RADAR_eee29754_Tx: ComSignalType=UINT8
            DET_RANGE_ERR_116_oRDR_DETECTION_113_116_oPCAN_RADAR_8a02ecaa_Tx: ComSignalType=UINT8
            DET_RANGE_VELOCITY_113_oRDR_DETECTION_113_116_oPCAN_RADAR_f56c18e4_Tx: ComSignalType=UINT16
            DET_RANGE_VELOCITY_114_oRDR_DETECTION_113_116_oPCAN_RADAR_a9dc3b8d_Tx: ComSignalType=UINT16
            DET_RANGE_VELOCITY_115_oRDR_DETECTION_113_116_oPCAN_RADAR_3cacef18_Tx: ComSignalType=UINT16
            DET_RANGE_VELOCITY_116_oRDR_DETECTION_113_116_oPCAN_RADAR_584c94e6_Tx: ComSignalType=UINT16
            DET_RANGE_VELOCITY_ERR_113_oRDR_DETECTION_113_116_oPCAN_RADAR_fad7e356_Tx: ComSignalType=UINT8
            DET_RANGE_VELOCITY_ERR_114_oRDR_DETECTION_113_116_oPCAN_RADAR_a667c03f_Tx: ComSignalType=UINT8
            DET_RANGE_VELOCITY_ERR_115_oRDR_DETECTION_113_116_oPCAN_RADAR_331714aa_Tx: ComSignalType=UINT8
            DET_RANGE_VELOCITY_ERR_116_oRDR_DETECTION_113_116_oPCAN_RADAR_57f76f54_Tx: ComSignalType=UINT8
            DET_RCS_113_oRDR_DETECTION_113_116_oPCAN_RADAR_72ec2fbe_Tx: ComSignalType=UINT8
            DET_RCS_114_oRDR_DETECTION_113_116_oPCAN_RADAR_2e5c0cd7_Tx: ComSignalType=UINT8
            DET_RCS_115_oRDR_DETECTION_113_116_oPCAN_RADAR_bb2cd842_Tx: ComSignalType=UINT8
            DET_RCS_116_oRDR_DETECTION_113_116_oPCAN_RADAR_dfcca3bc_Tx: ComSignalType=UINT8
            DET_SNR_113_oRDR_DETECTION_113_116_oPCAN_RADAR_af427bbc_Tx: ComSignalType=UINT8
            DET_SNR_114_oRDR_DETECTION_113_116_oPCAN_RADAR_f3f258d5_Tx: ComSignalType=UINT8
            DET_SNR_115_oRDR_DETECTION_113_116_oPCAN_RADAR_66828c40_Tx: ComSignalType=UINT8
            DET_SNR_116_oRDR_DETECTION_113_116_oPCAN_RADAR_0262f7be_Tx: ComSignalType=UINT8
            DET_SUPER_RES_TARGET_113_oRDR_DETECTION_113_116_oPCAN_RADAR_9edb53d9_Tx: ComSignalType=BOOLEAN
            DET_SUPER_RES_TARGET_114_oRDR_DETECTION_113_116_oPCAN_RADAR_c26b70b0_Tx: ComSignalType=BOOLEAN
            DET_SUPER_RES_TARGET_115_oRDR_DETECTION_113_116_oPCAN_RADAR_571ba425_Tx: ComSignalType=BOOLEAN
            DET_SUPER_RES_TARGET_116_oRDR_DETECTION_113_116_oPCAN_RADAR_33fbdfdb_Tx: ComSignalType=BOOLEAN
        SG_Detections_117_120_oRDR_DETECTION_117_120_oPCAN_RADAR_abfe9992_Tx
          83 x ComGroupSignal:
            DET_AZIMUTH_117_oRDR_DETECTION_117_120_oPCAN_RADAR_078d2c24_Tx: ComSignalType=UINT16
            DET_AZIMUTH_118_oRDR_DETECTION_117_120_oPCAN_RADAR_2b9dbe63_Tx: ComSignalType=UINT16
            DET_AZIMUTH_119_oRDR_DETECTION_117_120_oPCAN_RADAR_beed6af6_Tx: ComSignalType=UINT16
            DET_AZIMUTH_120_oRDR_DETECTION_117_120_oPCAN_RADAR_015c302d_Tx: ComSignalType=UINT16
            DET_AZIMUTH_ERR_117_oRDR_DETECTION_117_120_oPCAN_RADAR_a338b9d1_Tx: ComSignalType=UINT8
            DET_AZIMUTH_ERR_118_oRDR_DETECTION_117_120_oPCAN_RADAR_8f282b96_Tx: ComSignalType=UINT8
            DET_AZIMUTH_ERR_119_oRDR_DETECTION_117_120_oPCAN_RADAR_1a58ff03_Tx: ComSignalType=UINT8
            DET_AZIMUTH_ERR_120_oRDR_DETECTION_117_120_oPCAN_RADAR_a5e9a5d8_Tx: ComSignalType=UINT8
            DET_BELOW_RAIN_THOLD_117_oRDR_DETECTION_117_120_oPCAN_RADAR_d28cbfe4_Tx: ComSignalType=UINT8
            DET_BELOW_RAIN_THOLD_118_oRDR_DETECTION_117_120_oPCAN_RADAR_fe9c2da3_Tx: ComSignalType=UINT8
            DET_BELOW_RAIN_THOLD_119_oRDR_DETECTION_117_120_oPCAN_RADAR_6becf936_Tx: ComSignalType=UINT8
            DET_BELOW_RAIN_THOLD_120_oRDR_DETECTION_117_120_oPCAN_RADAR_d45da3ed_Tx: ComSignalType=UINT8
            DET_BI_STATIC_FLAG_117_oRDR_DETECTION_117_120_oPCAN_RADAR_51a16ca1_Tx: ComSignalType=BOOLEAN
            DET_BI_STATIC_FLAG_118_oRDR_DETECTION_117_120_oPCAN_RADAR_7db1fee6_Tx: ComSignalType=BOOLEAN
            DET_BI_STATIC_FLAG_119_oRDR_DETECTION_117_120_oPCAN_RADAR_e8c12a73_Tx: ComSignalType=BOOLEAN
            DET_BI_STATIC_FLAG_120_oRDR_DETECTION_117_120_oPCAN_RADAR_577070a8_Tx: ComSignalType=BOOLEAN
            DET_CONFD_AZIMUTH_117_oRDR_DETECTION_117_120_oPCAN_RADAR_056b26ee_Tx: ComSignalType=UINT8
            DET_CONFD_AZIMUTH_118_oRDR_DETECTION_117_120_oPCAN_RADAR_297bb4a9_Tx: ComSignalType=UINT8
            DET_CONFD_AZIMUTH_119_oRDR_DETECTION_117_120_oPCAN_RADAR_bc0b603c_Tx: ComSignalType=UINT8
            DET_CONFD_AZIMUTH_120_oRDR_DETECTION_117_120_oPCAN_RADAR_03ba3ae7_Tx: ComSignalType=UINT8
            DET_CONFD_ELEVATION_117_oRDR_DETECTION_117_120_oPCAN_RADAR_07fe2714_Tx: ComSignalType=UINT8
            DET_CONFD_ELEVATION_118_oRDR_DETECTION_117_120_oPCAN_RADAR_2beeb553_Tx: ComSignalType=UINT8
            DET_CONFD_ELEVATION_119_oRDR_DETECTION_117_120_oPCAN_RADAR_be9e61c6_Tx: ComSignalType=UINT8
            DET_CONFD_ELEVATION_120_oRDR_DETECTION_117_120_oPCAN_RADAR_012f3b1d_Tx: ComSignalType=UINT8
            DET_ELEVATION_117_oRDR_DETECTION_117_120_oPCAN_RADAR_d63ef328_Tx: ComSignalType=UINT8
            DET_ELEVATION_118_oRDR_DETECTION_117_120_oPCAN_RADAR_fa2e616f_Tx: ComSignalType=UINT8
            DET_ELEVATION_119_oRDR_DETECTION_117_120_oPCAN_RADAR_6f5eb5fa_Tx: ComSignalType=UINT8
            DET_ELEVATION_120_oRDR_DETECTION_117_120_oPCAN_RADAR_d0efef21_Tx: ComSignalType=UINT8
            DET_ELEVATION_ERR_117_oRDR_DETECTION_117_120_oPCAN_RADAR_51076b5d_Tx: ComSignalType=UINT8
            DET_ELEVATION_ERR_118_oRDR_DETECTION_117_120_oPCAN_RADAR_7d17f91a_Tx: ComSignalType=UINT8
            DET_ELEVATION_ERR_119_oRDR_DETECTION_117_120_oPCAN_RADAR_e8672d8f_Tx: ComSignalType=UINT8
            DET_ELEVATION_ERR_120_oRDR_DETECTION_117_120_oPCAN_RADAR_57d67754_Tx: ComSignalType=UINT8
            DET_EXISTENCE_PROB_117_oRDR_DETECTION_117_120_oPCAN_RADAR_83981e3d_Tx: ComSignalType=UINT8
            DET_EXISTENCE_PROB_118_oRDR_DETECTION_117_120_oPCAN_RADAR_af888c7a_Tx: ComSignalType=UINT8
            DET_EXISTENCE_PROB_119_oRDR_DETECTION_117_120_oPCAN_RADAR_3af858ef_Tx: ComSignalType=UINT8
            DET_EXISTENCE_PROB_120_oRDR_DETECTION_117_120_oPCAN_RADAR_85490234_Tx: ComSignalType=UINT8
            DET_HVC_FLAG_117_oRDR_DETECTION_117_120_oPCAN_RADAR_62ec5d42_Tx: ComSignalType=BOOLEAN
            DET_HVC_FLAG_118_oRDR_DETECTION_117_120_oPCAN_RADAR_4efccf05_Tx: ComSignalType=BOOLEAN
            DET_HVC_FLAG_119_oRDR_DETECTION_117_120_oPCAN_RADAR_db8c1b90_Tx: ComSignalType=BOOLEAN
            DET_HVC_FLAG_120_oRDR_DETECTION_117_120_oPCAN_RADAR_643d414b_Tx: ComSignalType=BOOLEAN
            DET_IDM_117_oRDR_DETECTION_117_120_oPCAN_RADAR_e9be66ff_Tx: ComSignalType=UINT8
            DET_IDM_118_oRDR_DETECTION_117_120_oPCAN_RADAR_c5aef4b8_Tx: ComSignalType=UINT8
            DET_IDM_119_oRDR_DETECTION_117_120_oPCAN_RADAR_50de202d_Tx: ComSignalType=UINT8
            DET_IDM_120_oRDR_DETECTION_117_120_oPCAN_RADAR_ef6f7af6_Tx: ComSignalType=UINT8
            DET_MH_CRC16_117_120_oRDR_DETECTION_117_120_oPCAN_RADAR_2f764b99_Tx: ComSignalType=UINT16
            DET_MH_CYCLE_COUNTER_117_120_oRDR_DETECTION_117_120_oPCAN_RADAR_ab03eaae_Tx: ComSignalType=UINT8
            DET_MH_SCAN_INDEX_4LSB_117_120_oRDR_DETECTION_117_120_oPCAN_RADAR_6729cf22_Tx: ComSignalType=UINT8
            DET_MTD_117_oRDR_DETECTION_117_120_oPCAN_RADAR_8f0d5424_Tx: ComSignalType=UINT8
            DET_MTD_118_oRDR_DETECTION_117_120_oPCAN_RADAR_a31dc663_Tx: ComSignalType=UINT8
            DET_MTD_119_oRDR_DETECTION_117_120_oPCAN_RADAR_366d12f6_Tx: ComSignalType=UINT8
            DET_MTD_120_oRDR_DETECTION_117_120_oPCAN_RADAR_89dc482d_Tx: ComSignalType=UINT8
            DET_PROB_1STAZHYPO_117_oRDR_DETECTION_117_120_oPCAN_RADAR_1cb9bce9_Tx: ComSignalType=BOOLEAN
            DET_PROB_1STAZHYPO_118_oRDR_DETECTION_117_120_oPCAN_RADAR_30a92eae_Tx: ComSignalType=BOOLEAN
            DET_PROB_1STAZHYPO_119_oRDR_DETECTION_117_120_oPCAN_RADAR_a5d9fa3b_Tx: ComSignalType=BOOLEAN
            DET_PROB_1STAZHYPO_120_oRDR_DETECTION_117_120_oPCAN_RADAR_1a68a0e0_Tx: ComSignalType=BOOLEAN
            DET_RANGE_117_oRDR_DETECTION_117_120_oPCAN_RADAR_17165f9f_Tx: ComSignalType=UINT16
            DET_RANGE_118_oRDR_DETECTION_117_120_oPCAN_RADAR_3b06cdd8_Tx: ComSignalType=UINT16
            DET_RANGE_119_oRDR_DETECTION_117_120_oPCAN_RADAR_ae76194d_Tx: ComSignalType=UINT16
            DET_RANGE_120_oRDR_DETECTION_117_120_oPCAN_RADAR_11c74396_Tx: ComSignalType=UINT16
            DET_RANGE_ERR_117_oRDR_DETECTION_117_120_oPCAN_RADAR_b0fee5f6_Tx: ComSignalType=UINT8
            DET_RANGE_ERR_118_oRDR_DETECTION_117_120_oPCAN_RADAR_9cee77b1_Tx: ComSignalType=UINT8
            DET_RANGE_ERR_119_oRDR_DETECTION_117_120_oPCAN_RADAR_099ea324_Tx: ComSignalType=UINT8
            DET_RANGE_ERR_120_oRDR_DETECTION_117_120_oPCAN_RADAR_b62ff9ff_Tx: ComSignalType=UINT8
            DET_RANGE_VELOCITY_117_oRDR_DETECTION_117_120_oPCAN_RADAR_62b09dba_Tx: ComSignalType=UINT16
            DET_RANGE_VELOCITY_118_oRDR_DETECTION_117_120_oPCAN_RADAR_4ea00ffd_Tx: ComSignalType=UINT16
            DET_RANGE_VELOCITY_119_oRDR_DETECTION_117_120_oPCAN_RADAR_dbd0db68_Tx: ComSignalType=UINT16
            DET_RANGE_VELOCITY_120_oRDR_DETECTION_117_120_oPCAN_RADAR_646181b3_Tx: ComSignalType=UINT16
            DET_RANGE_VELOCITY_ERR_117_oRDR_DETECTION_117_120_oPCAN_RADAR_6d0b6608_Tx: ComSignalType=UINT8
            DET_RANGE_VELOCITY_ERR_118_oRDR_DETECTION_117_120_oPCAN_RADAR_411bf44f_Tx: ComSignalType=UINT8
            DET_RANGE_VELOCITY_ERR_119_oRDR_DETECTION_117_120_oPCAN_RADAR_d46b20da_Tx: ComSignalType=UINT8
            DET_RANGE_VELOCITY_ERR_120_oRDR_DETECTION_117_120_oPCAN_RADAR_6bda7a01_Tx: ComSignalType=UINT8
            DET_RCS_117_oRDR_DETECTION_117_120_oPCAN_RADAR_e530aae0_Tx: ComSignalType=UINT8
            DET_RCS_118_oRDR_DETECTION_117_120_oPCAN_RADAR_c92038a7_Tx: ComSignalType=UINT8
            DET_RCS_119_oRDR_DETECTION_117_120_oPCAN_RADAR_5c50ec32_Tx: ComSignalType=UINT8
            DET_RCS_120_oRDR_DETECTION_117_120_oPCAN_RADAR_e3e1b6e9_Tx: ComSignalType=UINT8
            DET_SNR_117_oRDR_DETECTION_117_120_oPCAN_RADAR_389efee2_Tx: ComSignalType=UINT8
            DET_SNR_118_oRDR_DETECTION_117_120_oPCAN_RADAR_148e6ca5_Tx: ComSignalType=UINT8
            DET_SNR_119_oRDR_DETECTION_117_120_oPCAN_RADAR_81feb830_Tx: ComSignalType=UINT8
            DET_SNR_120_oRDR_DETECTION_117_120_oPCAN_RADAR_3e4fe2eb_Tx: ComSignalType=UINT8
            DET_SUPER_RES_TARGET_117_oRDR_DETECTION_117_120_oPCAN_RADAR_0907d687_Tx: ComSignalType=BOOLEAN
            DET_SUPER_RES_TARGET_118_oRDR_DETECTION_117_120_oPCAN_RADAR_251744c0_Tx: ComSignalType=BOOLEAN
            DET_SUPER_RES_TARGET_119_oRDR_DETECTION_117_120_oPCAN_RADAR_b0679055_Tx: ComSignalType=BOOLEAN
            DET_SUPER_RES_TARGET_120_oRDR_DETECTION_117_120_oPCAN_RADAR_0fd6ca8e_Tx: ComSignalType=BOOLEAN
        SG_Detections_121_124_oRDR_DETECTION_121_124_oPCAN_RADAR_a895174b_Tx
          83 x ComGroupSignal:
            DET_AZIMUTH_121_oRDR_DETECTION_121_124_oPCAN_RADAR_1927e444_Tx: ComSignalType=UINT16
            DET_AZIMUTH_122_oRDR_DETECTION_121_124_oPCAN_RADAR_7dc79fba_Tx: ComSignalType=UINT16
            DET_AZIMUTH_123_oRDR_DETECTION_121_124_oPCAN_RADAR_e8b74b2f_Tx: ComSignalType=UINT16
            DET_AZIMUTH_124_oRDR_DETECTION_121_124_oPCAN_RADAR_b4076846_Tx: ComSignalType=UINT16
            DET_AZIMUTH_ERR_121_oRDR_DETECTION_121_124_oPCAN_RADAR_bd9271b1_Tx: ComSignalType=UINT8
            DET_AZIMUTH_ERR_122_oRDR_DETECTION_121_124_oPCAN_RADAR_d9720a4f_Tx: ComSignalType=UINT8
            DET_AZIMUTH_ERR_123_oRDR_DETECTION_121_124_oPCAN_RADAR_4c02deda_Tx: ComSignalType=UINT8
            DET_AZIMUTH_ERR_124_oRDR_DETECTION_121_124_oPCAN_RADAR_10b2fdb3_Tx: ComSignalType=UINT8
            DET_BELOW_RAIN_THOLD_121_oRDR_DETECTION_121_124_oPCAN_RADAR_cc267784_Tx: ComSignalType=UINT8
            DET_BELOW_RAIN_THOLD_122_oRDR_DETECTION_121_124_oPCAN_RADAR_a8c60c7a_Tx: ComSignalType=UINT8
            DET_BELOW_RAIN_THOLD_123_oRDR_DETECTION_121_124_oPCAN_RADAR_3db6d8ef_Tx: ComSignalType=UINT8
            DET_BELOW_RAIN_THOLD_124_oRDR_DETECTION_121_124_oPCAN_RADAR_6106fb86_Tx: ComSignalType=UINT8
            DET_BI_STATIC_FLAG_121_oRDR_DETECTION_121_124_oPCAN_RADAR_4f0ba4c1_Tx: ComSignalType=BOOLEAN
            DET_BI_STATIC_FLAG_122_oRDR_DETECTION_121_124_oPCAN_RADAR_2bebdf3f_Tx: ComSignalType=BOOLEAN
            DET_BI_STATIC_FLAG_123_oRDR_DETECTION_121_124_oPCAN_RADAR_be9b0baa_Tx: ComSignalType=BOOLEAN
            DET_BI_STATIC_FLAG_124_oRDR_DETECTION_121_124_oPCAN_RADAR_e22b28c3_Tx: ComSignalType=BOOLEAN
            DET_CONFD_AZIMUTH_121_oRDR_DETECTION_121_124_oPCAN_RADAR_1bc1ee8e_Tx: ComSignalType=UINT8
            DET_CONFD_AZIMUTH_122_oRDR_DETECTION_121_124_oPCAN_RADAR_7f219570_Tx: ComSignalType=UINT8
            DET_CONFD_AZIMUTH_123_oRDR_DETECTION_121_124_oPCAN_RADAR_ea5141e5_Tx: ComSignalType=UINT8
            DET_CONFD_AZIMUTH_124_oRDR_DETECTION_121_124_oPCAN_RADAR_b6e1628c_Tx: ComSignalType=UINT8
            DET_CONFD_ELEVATION_121_oRDR_DETECTION_121_124_oPCAN_RADAR_1954ef74_Tx: ComSignalType=UINT8
            DET_CONFD_ELEVATION_122_oRDR_DETECTION_121_124_oPCAN_RADAR_7db4948a_Tx: ComSignalType=UINT8
            DET_CONFD_ELEVATION_123_oRDR_DETECTION_121_124_oPCAN_RADAR_e8c4401f_Tx: ComSignalType=UINT8
            DET_CONFD_ELEVATION_124_oRDR_DETECTION_121_124_oPCAN_RADAR_b4746376_Tx: ComSignalType=UINT8
            DET_ELEVATION_121_oRDR_DETECTION_121_124_oPCAN_RADAR_c8943b48_Tx: ComSignalType=UINT8
            DET_ELEVATION_122_oRDR_DETECTION_121_124_oPCAN_RADAR_ac7440b6_Tx: ComSignalType=UINT8
            DET_ELEVATION_123_oRDR_DETECTION_121_124_oPCAN_RADAR_39049423_Tx: ComSignalType=UINT8
            DET_ELEVATION_124_oRDR_DETECTION_121_124_oPCAN_RADAR_65b4b74a_Tx: ComSignalType=UINT8
            DET_ELEVATION_ERR_121_oRDR_DETECTION_121_124_oPCAN_RADAR_4fada33d_Tx: ComSignalType=UINT8
            DET_ELEVATION_ERR_122_oRDR_DETECTION_121_124_oPCAN_RADAR_2b4dd8c3_Tx: ComSignalType=UINT8
            DET_ELEVATION_ERR_123_oRDR_DETECTION_121_124_oPCAN_RADAR_be3d0c56_Tx: ComSignalType=UINT8
            DET_ELEVATION_ERR_124_oRDR_DETECTION_121_124_oPCAN_RADAR_e28d2f3f_Tx: ComSignalType=UINT8
            DET_EXISTENCE_PROB_121_oRDR_DETECTION_121_124_oPCAN_RADAR_9d32d65d_Tx: ComSignalType=UINT8
            DET_EXISTENCE_PROB_122_oRDR_DETECTION_121_124_oPCAN_RADAR_f9d2ada3_Tx: ComSignalType=UINT8
            DET_EXISTENCE_PROB_123_oRDR_DETECTION_121_124_oPCAN_RADAR_6ca27936_Tx: ComSignalType=UINT8
            DET_EXISTENCE_PROB_124_oRDR_DETECTION_121_124_oPCAN_RADAR_30125a5f_Tx: ComSignalType=UINT8
            DET_HVC_FLAG_121_oRDR_DETECTION_121_124_oPCAN_RADAR_7c469522_Tx: ComSignalType=BOOLEAN
            DET_HVC_FLAG_122_oRDR_DETECTION_121_124_oPCAN_RADAR_18a6eedc_Tx: ComSignalType=BOOLEAN
            DET_HVC_FLAG_123_oRDR_DETECTION_121_124_oPCAN_RADAR_8dd63a49_Tx: ComSignalType=BOOLEAN
            DET_HVC_FLAG_124_oRDR_DETECTION_121_124_oPCAN_RADAR_d1661920_Tx: ComSignalType=BOOLEAN
            DET_IDM_121_oRDR_DETECTION_121_124_oPCAN_RADAR_f714ae9f_Tx: ComSignalType=UINT8
            DET_IDM_122_oRDR_DETECTION_121_124_oPCAN_RADAR_93f4d561_Tx: ComSignalType=UINT8
            DET_IDM_123_oRDR_DETECTION_121_124_oPCAN_RADAR_068401f4_Tx: ComSignalType=UINT8
            DET_IDM_124_oRDR_DETECTION_121_124_oPCAN_RADAR_5a34229d_Tx: ComSignalType=UINT8
            DET_MH_CRC16_121_124_oRDR_DETECTION_121_124_oPCAN_RADAR_2c1dc540_Tx: ComSignalType=UINT16
            DET_MH_CYCLE_COUNTER_121_124_oRDR_DETECTION_121_124_oPCAN_RADAR_a8686477_Tx: ComSignalType=UINT8
            DET_MH_SCAN_INDEX_4LSB_121_124_oRDR_DETECTION_121_124_oPCAN_RADAR_644241fb_Tx: ComSignalType=UINT8
            DET_MTD_121_oRDR_DETECTION_121_124_oPCAN_RADAR_91a79c44_Tx: ComSignalType=UINT8
            DET_MTD_122_oRDR_DETECTION_121_124_oPCAN_RADAR_f547e7ba_Tx: ComSignalType=UINT8
            DET_MTD_123_oRDR_DETECTION_121_124_oPCAN_RADAR_6037332f_Tx: ComSignalType=UINT8
            DET_MTD_124_oRDR_DETECTION_121_124_oPCAN_RADAR_3c871046_Tx: ComSignalType=UINT8
            DET_PROB_1STAZHYPO_121_oRDR_DETECTION_121_124_oPCAN_RADAR_02137489_Tx: ComSignalType=BOOLEAN
            DET_PROB_1STAZHYPO_122_oRDR_DETECTION_121_124_oPCAN_RADAR_66f30f77_Tx: ComSignalType=BOOLEAN
            DET_PROB_1STAZHYPO_123_oRDR_DETECTION_121_124_oPCAN_RADAR_f383dbe2_Tx: ComSignalType=BOOLEAN
            DET_PROB_1STAZHYPO_124_oRDR_DETECTION_121_124_oPCAN_RADAR_af33f88b_Tx: ComSignalType=BOOLEAN
            DET_RANGE_121_oRDR_DETECTION_121_124_oPCAN_RADAR_09bc97ff_Tx: ComSignalType=UINT16
            DET_RANGE_122_oRDR_DETECTION_121_124_oPCAN_RADAR_6d5cec01_Tx: ComSignalType=UINT16
            DET_RANGE_123_oRDR_DETECTION_121_124_oPCAN_RADAR_f82c3894_Tx: ComSignalType=UINT16
            DET_RANGE_124_oRDR_DETECTION_121_124_oPCAN_RADAR_a49c1bfd_Tx: ComSignalType=UINT16
            DET_RANGE_ERR_121_oRDR_DETECTION_121_124_oPCAN_RADAR_ae542d96_Tx: ComSignalType=UINT8
            DET_RANGE_ERR_122_oRDR_DETECTION_121_124_oPCAN_RADAR_cab45668_Tx: ComSignalType=UINT8
            DET_RANGE_ERR_123_oRDR_DETECTION_121_124_oPCAN_RADAR_5fc482fd_Tx: ComSignalType=UINT8
            DET_RANGE_ERR_124_oRDR_DETECTION_121_124_oPCAN_RADAR_0374a194_Tx: ComSignalType=UINT8
            DET_RANGE_VELOCITY_121_oRDR_DETECTION_121_124_oPCAN_RADAR_7c1a55da_Tx: ComSignalType=UINT16
            DET_RANGE_VELOCITY_122_oRDR_DETECTION_121_124_oPCAN_RADAR_18fa2e24_Tx: ComSignalType=UINT16
            DET_RANGE_VELOCITY_123_oRDR_DETECTION_121_124_oPCAN_RADAR_8d8afab1_Tx: ComSignalType=UINT16
            DET_RANGE_VELOCITY_124_oRDR_DETECTION_121_124_oPCAN_RADAR_d13ad9d8_Tx: ComSignalType=UINT16
            DET_RANGE_VELOCITY_ERR_121_oRDR_DETECTION_121_124_oPCAN_RADAR_73a1ae68_Tx: ComSignalType=UINT8
            DET_RANGE_VELOCITY_ERR_122_oRDR_DETECTION_121_124_oPCAN_RADAR_1741d596_Tx: ComSignalType=UINT8
            DET_RANGE_VELOCITY_ERR_123_oRDR_DETECTION_121_124_oPCAN_RADAR_82310103_Tx: ComSignalType=UINT8
            DET_RANGE_VELOCITY_ERR_124_oRDR_DETECTION_121_124_oPCAN_RADAR_de81226a_Tx: ComSignalType=UINT8
            DET_RCS_121_oRDR_DETECTION_121_124_oPCAN_RADAR_fb9a6280_Tx: ComSignalType=UINT8
            DET_RCS_122_oRDR_DETECTION_121_124_oPCAN_RADAR_9f7a197e_Tx: ComSignalType=UINT8
            DET_RCS_123_oRDR_DETECTION_121_124_oPCAN_RADAR_0a0acdeb_Tx: ComSignalType=UINT8
            DET_RCS_124_oRDR_DETECTION_121_124_oPCAN_RADAR_56baee82_Tx: ComSignalType=UINT8
            DET_SNR_121_oRDR_DETECTION_121_124_oPCAN_RADAR_26343682_Tx: ComSignalType=UINT8
            DET_SNR_122_oRDR_DETECTION_121_124_oPCAN_RADAR_42d44d7c_Tx: ComSignalType=UINT8
            DET_SNR_123_oRDR_DETECTION_121_124_oPCAN_RADAR_d7a499e9_Tx: ComSignalType=UINT8
            DET_SNR_124_oRDR_DETECTION_121_124_oPCAN_RADAR_8b14ba80_Tx: ComSignalType=UINT8
            DET_SUPER_RES_TARGET_121_oRDR_DETECTION_121_124_oPCAN_RADAR_17ad1ee7_Tx: ComSignalType=BOOLEAN
            DET_SUPER_RES_TARGET_122_oRDR_DETECTION_121_124_oPCAN_RADAR_734d6519_Tx: ComSignalType=BOOLEAN
            DET_SUPER_RES_TARGET_123_oRDR_DETECTION_121_124_oPCAN_RADAR_e63db18c_Tx: ComSignalType=BOOLEAN
            DET_SUPER_RES_TARGET_124_oRDR_DETECTION_121_124_oPCAN_RADAR_ba8d92e5_Tx: ComSignalType=BOOLEAN
        SG_Detections_125_128_oRDR_DETECTION_125_128_oPCAN_RADAR_d9562319_Tx
          83 x ComGroupSignal:
            DET_AZIMUTH_125_oRDR_DETECTION_125_128_oPCAN_RADAR_c8c522e7_Tx: ComSignalType=UINT16
            DET_AZIMUTH_126_oRDR_DETECTION_125_128_oPCAN_RADAR_ac255919_Tx: ComSignalType=UINT16
            DET_AZIMUTH_127_oRDR_DETECTION_125_128_oPCAN_RADAR_39558d8c_Tx: ComSignalType=UINT16
            DET_AZIMUTH_128_oRDR_DETECTION_125_128_oPCAN_RADAR_15451fcb_Tx: ComSignalType=UINT16
            DET_AZIMUTH_ERR_125_oRDR_DETECTION_125_128_oPCAN_RADAR_6c70b712_Tx: ComSignalType=UINT8
            DET_AZIMUTH_ERR_126_oRDR_DETECTION_125_128_oPCAN_RADAR_0890ccec_Tx: ComSignalType=UINT8
            DET_AZIMUTH_ERR_127_oRDR_DETECTION_125_128_oPCAN_RADAR_9de01879_Tx: ComSignalType=UINT8
            DET_AZIMUTH_ERR_128_oRDR_DETECTION_125_128_oPCAN_RADAR_b1f08a3e_Tx: ComSignalType=UINT8
            DET_BELOW_RAIN_THOLD_125_oRDR_DETECTION_125_128_oPCAN_RADAR_1dc4b127_Tx: ComSignalType=UINT8
            DET_BELOW_RAIN_THOLD_126_oRDR_DETECTION_125_128_oPCAN_RADAR_7924cad9_Tx: ComSignalType=UINT8
            DET_BELOW_RAIN_THOLD_127_oRDR_DETECTION_125_128_oPCAN_RADAR_ec541e4c_Tx: ComSignalType=UINT8
            DET_BELOW_RAIN_THOLD_128_oRDR_DETECTION_125_128_oPCAN_RADAR_c0448c0b_Tx: ComSignalType=UINT8
            DET_BI_STATIC_FLAG_125_oRDR_DETECTION_125_128_oPCAN_RADAR_9ee96262_Tx: ComSignalType=BOOLEAN
            DET_BI_STATIC_FLAG_126_oRDR_DETECTION_125_128_oPCAN_RADAR_fa09199c_Tx: ComSignalType=BOOLEAN
            DET_BI_STATIC_FLAG_127_oRDR_DETECTION_125_128_oPCAN_RADAR_6f79cd09_Tx: ComSignalType=BOOLEAN
            DET_BI_STATIC_FLAG_128_oRDR_DETECTION_125_128_oPCAN_RADAR_43695f4e_Tx: ComSignalType=BOOLEAN
            DET_CONFD_AZIMUTH_125_oRDR_DETECTION_125_128_oPCAN_RADAR_ca23282d_Tx: ComSignalType=UINT8
            DET_CONFD_AZIMUTH_126_oRDR_DETECTION_125_128_oPCAN_RADAR_aec353d3_Tx: ComSignalType=UINT8
            DET_CONFD_AZIMUTH_127_oRDR_DETECTION_125_128_oPCAN_RADAR_3bb38746_Tx: ComSignalType=UINT8
            DET_CONFD_AZIMUTH_128_oRDR_DETECTION_125_128_oPCAN_RADAR_17a31501_Tx: ComSignalType=UINT8
            DET_CONFD_ELEVATION_125_oRDR_DETECTION_125_128_oPCAN_RADAR_c8b629d7_Tx: ComSignalType=UINT8
            DET_CONFD_ELEVATION_126_oRDR_DETECTION_125_128_oPCAN_RADAR_ac565229_Tx: ComSignalType=UINT8
            DET_CONFD_ELEVATION_127_oRDR_DETECTION_125_128_oPCAN_RADAR_392686bc_Tx: ComSignalType=UINT8
            DET_CONFD_ELEVATION_128_oRDR_DETECTION_125_128_oPCAN_RADAR_153614fb_Tx: ComSignalType=UINT8
            DET_ELEVATION_125_oRDR_DETECTION_125_128_oPCAN_RADAR_1976fdeb_Tx: ComSignalType=UINT8
            DET_ELEVATION_126_oRDR_DETECTION_125_128_oPCAN_RADAR_7d968615_Tx: ComSignalType=UINT8
            DET_ELEVATION_127_oRDR_DETECTION_125_128_oPCAN_RADAR_e8e65280_Tx: ComSignalType=UINT8
            DET_ELEVATION_128_oRDR_DETECTION_125_128_oPCAN_RADAR_c4f6c0c7_Tx: ComSignalType=UINT8
            DET_ELEVATION_ERR_125_oRDR_DETECTION_125_128_oPCAN_RADAR_9e4f659e_Tx: ComSignalType=UINT8
            DET_ELEVATION_ERR_126_oRDR_DETECTION_125_128_oPCAN_RADAR_faaf1e60_Tx: ComSignalType=UINT8
            DET_ELEVATION_ERR_127_oRDR_DETECTION_125_128_oPCAN_RADAR_6fdfcaf5_Tx: ComSignalType=UINT8
            DET_ELEVATION_ERR_128_oRDR_DETECTION_125_128_oPCAN_RADAR_43cf58b2_Tx: ComSignalType=UINT8
            DET_EXISTENCE_PROB_125_oRDR_DETECTION_125_128_oPCAN_RADAR_4cd010fe_Tx: ComSignalType=UINT8
            DET_EXISTENCE_PROB_126_oRDR_DETECTION_125_128_oPCAN_RADAR_28306b00_Tx: ComSignalType=UINT8
            DET_EXISTENCE_PROB_127_oRDR_DETECTION_125_128_oPCAN_RADAR_bd40bf95_Tx: ComSignalType=UINT8
            DET_EXISTENCE_PROB_128_oRDR_DETECTION_125_128_oPCAN_RADAR_91502dd2_Tx: ComSignalType=UINT8
            DET_HVC_FLAG_125_oRDR_DETECTION_125_128_oPCAN_RADAR_ada45381_Tx: ComSignalType=BOOLEAN
            DET_HVC_FLAG_126_oRDR_DETECTION_125_128_oPCAN_RADAR_c944287f_Tx: ComSignalType=BOOLEAN
            DET_HVC_FLAG_127_oRDR_DETECTION_125_128_oPCAN_RADAR_5c34fcea_Tx: ComSignalType=BOOLEAN
            DET_HVC_FLAG_128_oRDR_DETECTION_125_128_oPCAN_RADAR_70246ead_Tx: ComSignalType=BOOLEAN
            DET_IDM_125_oRDR_DETECTION_125_128_oPCAN_RADAR_26f6683c_Tx: ComSignalType=UINT8
            DET_IDM_126_oRDR_DETECTION_125_128_oPCAN_RADAR_421613c2_Tx: ComSignalType=UINT8
            DET_IDM_127_oRDR_DETECTION_125_128_oPCAN_RADAR_d766c757_Tx: ComSignalType=UINT8
            DET_IDM_128_oRDR_DETECTION_125_128_oPCAN_RADAR_fb765510_Tx: ComSignalType=UINT8
            DET_MH_CRC16_125_128_oRDR_DETECTION_125_128_oPCAN_RADAR_5ddef112_Tx: ComSignalType=UINT16
            DET_MH_CYCLE_COUNTER_125_128_oRDR_DETECTION_125_128_oPCAN_RADAR_d9ab5025_Tx: ComSignalType=UINT8
            DET_MH_SCAN_INDEX_4LSB_125_128_oRDR_DETECTION_125_128_oPCAN_RADAR_158175a9_Tx: ComSignalType=UINT8
            DET_MTD_125_oRDR_DETECTION_125_128_oPCAN_RADAR_40455ae7_Tx: ComSignalType=UINT8
            DET_MTD_126_oRDR_DETECTION_125_128_oPCAN_RADAR_24a52119_Tx: ComSignalType=UINT8
            DET_MTD_127_oRDR_DETECTION_125_128_oPCAN_RADAR_b1d5f58c_Tx: ComSignalType=UINT8
            DET_MTD_128_oRDR_DETECTION_125_128_oPCAN_RADAR_9dc567cb_Tx: ComSignalType=UINT8
            DET_PROB_1STAZHYPO_125_oRDR_DETECTION_125_128_oPCAN_RADAR_d3f1b22a_Tx: ComSignalType=BOOLEAN
            DET_PROB_1STAZHYPO_126_oRDR_DETECTION_125_128_oPCAN_RADAR_b711c9d4_Tx: ComSignalType=BOOLEAN
            DET_PROB_1STAZHYPO_127_oRDR_DETECTION_125_128_oPCAN_RADAR_22611d41_Tx: ComSignalType=BOOLEAN
            DET_PROB_1STAZHYPO_128_oRDR_DETECTION_125_128_oPCAN_RADAR_0e718f06_Tx: ComSignalType=BOOLEAN
            DET_RANGE_125_oRDR_DETECTION_125_128_oPCAN_RADAR_d85e515c_Tx: ComSignalType=UINT16
            DET_RANGE_126_oRDR_DETECTION_125_128_oPCAN_RADAR_bcbe2aa2_Tx: ComSignalType=UINT16
            DET_RANGE_127_oRDR_DETECTION_125_128_oPCAN_RADAR_29cefe37_Tx: ComSignalType=UINT16
            DET_RANGE_128_oRDR_DETECTION_125_128_oPCAN_RADAR_05de6c70_Tx: ComSignalType=UINT16
            DET_RANGE_ERR_125_oRDR_DETECTION_125_128_oPCAN_RADAR_7fb6eb35_Tx: ComSignalType=UINT8
            DET_RANGE_ERR_126_oRDR_DETECTION_125_128_oPCAN_RADAR_1b5690cb_Tx: ComSignalType=UINT8
            DET_RANGE_ERR_127_oRDR_DETECTION_125_128_oPCAN_RADAR_8e26445e_Tx: ComSignalType=UINT8
            DET_RANGE_ERR_128_oRDR_DETECTION_125_128_oPCAN_RADAR_a236d619_Tx: ComSignalType=UINT8
            DET_RANGE_VELOCITY_125_oRDR_DETECTION_125_128_oPCAN_RADAR_adf89379_Tx: ComSignalType=UINT16
            DET_RANGE_VELOCITY_126_oRDR_DETECTION_125_128_oPCAN_RADAR_c918e887_Tx: ComSignalType=UINT16
            DET_RANGE_VELOCITY_127_oRDR_DETECTION_125_128_oPCAN_RADAR_5c683c12_Tx: ComSignalType=UINT16
            DET_RANGE_VELOCITY_128_oRDR_DETECTION_125_128_oPCAN_RADAR_7078ae55_Tx: ComSignalType=UINT16
            DET_RANGE_VELOCITY_ERR_125_oRDR_DETECTION_125_128_oPCAN_RADAR_a24368cb_Tx: ComSignalType=UINT8
            DET_RANGE_VELOCITY_ERR_126_oRDR_DETECTION_125_128_oPCAN_RADAR_c6a31335_Tx: ComSignalType=UINT8
            DET_RANGE_VELOCITY_ERR_127_oRDR_DETECTION_125_128_oPCAN_RADAR_53d3c7a0_Tx: ComSignalType=UINT8
            DET_RANGE_VELOCITY_ERR_128_oRDR_DETECTION_125_128_oPCAN_RADAR_7fc355e7_Tx: ComSignalType=UINT8
            DET_RCS_125_oRDR_DETECTION_125_128_oPCAN_RADAR_2a78a423_Tx: ComSignalType=UINT8
            DET_RCS_126_oRDR_DETECTION_125_128_oPCAN_RADAR_4e98dfdd_Tx: ComSignalType=UINT8
            DET_RCS_127_oRDR_DETECTION_125_128_oPCAN_RADAR_dbe80b48_Tx: ComSignalType=UINT8
            DET_RCS_128_oRDR_DETECTION_125_128_oPCAN_RADAR_f7f8990f_Tx: ComSignalType=UINT8
            DET_SNR_125_oRDR_DETECTION_125_128_oPCAN_RADAR_f7d6f021_Tx: ComSignalType=UINT8
            DET_SNR_126_oRDR_DETECTION_125_128_oPCAN_RADAR_93368bdf_Tx: ComSignalType=UINT8
            DET_SNR_127_oRDR_DETECTION_125_128_oPCAN_RADAR_06465f4a_Tx: ComSignalType=UINT8
            DET_SNR_128_oRDR_DETECTION_125_128_oPCAN_RADAR_2a56cd0d_Tx: ComSignalType=UINT8
            DET_SUPER_RES_TARGET_125_oRDR_DETECTION_125_128_oPCAN_RADAR_c64fd844_Tx: ComSignalType=BOOLEAN
            DET_SUPER_RES_TARGET_126_oRDR_DETECTION_125_128_oPCAN_RADAR_a2afa3ba_Tx: ComSignalType=BOOLEAN
            DET_SUPER_RES_TARGET_127_oRDR_DETECTION_125_128_oPCAN_RADAR_37df772f_Tx: ComSignalType=BOOLEAN
            DET_SUPER_RES_TARGET_128_oRDR_DETECTION_125_128_oPCAN_RADAR_1bcfe568_Tx: ComSignalType=BOOLEAN
        SG_Detections_129_132_oRDR_DETECTION_129_132_oPCAN_RADAR_402c0762_Tx
          83 x ComGroupSignal:
            DET_AZIMUTH_129_oRDR_DETECTION_129_132_oPCAN_RADAR_b27d245f_Tx: ComSignalType=UINT16
            DET_AZIMUTH_130_oRDR_DETECTION_129_132_oPCAN_RADAR_d75d56fb_Tx: ComSignalType=UINT16
            DET_AZIMUTH_131_oRDR_DETECTION_129_132_oPCAN_RADAR_422d826e_Tx: ComSignalType=UINT16
            DET_AZIMUTH_132_oRDR_DETECTION_129_132_oPCAN_RADAR_26cdf990_Tx: ComSignalType=UINT16
            DET_AZIMUTH_ERR_129_oRDR_DETECTION_129_132_oPCAN_RADAR_16c8b1aa_Tx: ComSignalType=UINT8
            DET_AZIMUTH_ERR_130_oRDR_DETECTION_129_132_oPCAN_RADAR_73e8c30e_Tx: ComSignalType=UINT8
            DET_AZIMUTH_ERR_131_oRDR_DETECTION_129_132_oPCAN_RADAR_e698179b_Tx: ComSignalType=UINT8
            DET_AZIMUTH_ERR_132_oRDR_DETECTION_129_132_oPCAN_RADAR_82786c65_Tx: ComSignalType=UINT8
            DET_BELOW_RAIN_THOLD_129_oRDR_DETECTION_129_132_oPCAN_RADAR_677cb79f_Tx: ComSignalType=UINT8
            DET_BELOW_RAIN_THOLD_130_oRDR_DETECTION_129_132_oPCAN_RADAR_025cc53b_Tx: ComSignalType=UINT8
            DET_BELOW_RAIN_THOLD_131_oRDR_DETECTION_129_132_oPCAN_RADAR_972c11ae_Tx: ComSignalType=UINT8
            DET_BELOW_RAIN_THOLD_132_oRDR_DETECTION_129_132_oPCAN_RADAR_f3cc6a50_Tx: ComSignalType=UINT8
            DET_BI_STATIC_FLAG_129_oRDR_DETECTION_129_132_oPCAN_RADAR_e45164da_Tx: ComSignalType=BOOLEAN
            DET_BI_STATIC_FLAG_130_oRDR_DETECTION_129_132_oPCAN_RADAR_8171167e_Tx: ComSignalType=BOOLEAN
            DET_BI_STATIC_FLAG_131_oRDR_DETECTION_129_132_oPCAN_RADAR_1401c2eb_Tx: ComSignalType=BOOLEAN
            DET_BI_STATIC_FLAG_132_oRDR_DETECTION_129_132_oPCAN_RADAR_70e1b915_Tx: ComSignalType=BOOLEAN
            DET_CONFD_AZIMUTH_129_oRDR_DETECTION_129_132_oPCAN_RADAR_b09b2e95_Tx: ComSignalType=UINT8
            DET_CONFD_AZIMUTH_130_oRDR_DETECTION_129_132_oPCAN_RADAR_d5bb5c31_Tx: ComSignalType=UINT8
            DET_CONFD_AZIMUTH_131_oRDR_DETECTION_129_132_oPCAN_RADAR_40cb88a4_Tx: ComSignalType=UINT8
            DET_CONFD_AZIMUTH_132_oRDR_DETECTION_129_132_oPCAN_RADAR_242bf35a_Tx: ComSignalType=UINT8
            DET_CONFD_ELEVATION_129_oRDR_DETECTION_129_132_oPCAN_RADAR_b20e2f6f_Tx: ComSignalType=UINT8
            DET_CONFD_ELEVATION_130_oRDR_DETECTION_129_132_oPCAN_RADAR_d72e5dcb_Tx: ComSignalType=UINT8
            DET_CONFD_ELEVATION_131_oRDR_DETECTION_129_132_oPCAN_RADAR_425e895e_Tx: ComSignalType=UINT8
            DET_CONFD_ELEVATION_132_oRDR_DETECTION_129_132_oPCAN_RADAR_26bef2a0_Tx: ComSignalType=UINT8
            DET_ELEVATION_129_oRDR_DETECTION_129_132_oPCAN_RADAR_63cefb53_Tx: ComSignalType=UINT8
            DET_ELEVATION_130_oRDR_DETECTION_129_132_oPCAN_RADAR_06ee89f7_Tx: ComSignalType=UINT8
            DET_ELEVATION_131_oRDR_DETECTION_129_132_oPCAN_RADAR_939e5d62_Tx: ComSignalType=UINT8
            DET_ELEVATION_132_oRDR_DETECTION_129_132_oPCAN_RADAR_f77e269c_Tx: ComSignalType=UINT8
            DET_ELEVATION_ERR_129_oRDR_DETECTION_129_132_oPCAN_RADAR_e4f76326_Tx: ComSignalType=UINT8
            DET_ELEVATION_ERR_130_oRDR_DETECTION_129_132_oPCAN_RADAR_81d71182_Tx: ComSignalType=UINT8
            DET_ELEVATION_ERR_131_oRDR_DETECTION_129_132_oPCAN_RADAR_14a7c517_Tx: ComSignalType=UINT8
            DET_ELEVATION_ERR_132_oRDR_DETECTION_129_132_oPCAN_RADAR_7047bee9_Tx: ComSignalType=UINT8
            DET_EXISTENCE_PROB_129_oRDR_DETECTION_129_132_oPCAN_RADAR_36681646_Tx: ComSignalType=UINT8
            DET_EXISTENCE_PROB_130_oRDR_DETECTION_129_132_oPCAN_RADAR_534864e2_Tx: ComSignalType=UINT8
            DET_EXISTENCE_PROB_131_oRDR_DETECTION_129_132_oPCAN_RADAR_c638b077_Tx: ComSignalType=UINT8
            DET_EXISTENCE_PROB_132_oRDR_DETECTION_129_132_oPCAN_RADAR_a2d8cb89_Tx: ComSignalType=UINT8
            DET_HVC_FLAG_129_oRDR_DETECTION_129_132_oPCAN_RADAR_d71c5539_Tx: ComSignalType=BOOLEAN
            DET_HVC_FLAG_130_oRDR_DETECTION_129_132_oPCAN_RADAR_b23c279d_Tx: ComSignalType=BOOLEAN
            DET_HVC_FLAG_131_oRDR_DETECTION_129_132_oPCAN_RADAR_274cf308_Tx: ComSignalType=BOOLEAN
            DET_HVC_FLAG_132_oRDR_DETECTION_129_132_oPCAN_RADAR_43ac88f6_Tx: ComSignalType=BOOLEAN
            DET_IDM_129_oRDR_DETECTION_129_132_oPCAN_RADAR_5c4e6e84_Tx: ComSignalType=UINT8
            DET_IDM_130_oRDR_DETECTION_129_132_oPCAN_RADAR_396e1c20_Tx: ComSignalType=UINT8
            DET_IDM_131_oRDR_DETECTION_129_132_oPCAN_RADAR_ac1ec8b5_Tx: ComSignalType=UINT8
            DET_IDM_132_oRDR_DETECTION_129_132_oPCAN_RADAR_c8feb34b_Tx: ComSignalType=UINT8
            DET_MH_CRC16_129_132_oRDR_DETECTION_129_132_oPCAN_RADAR_c4a4d569_Tx: ComSignalType=UINT16
            DET_MH_CYCLE_COUNTER_129_132_oRDR_DETECTION_129_132_oPCAN_RADAR_40d1745e_Tx: ComSignalType=UINT8
            DET_MH_SCAN_INDEX_4LSB_129_132_oRDR_DETECTION_129_132_oPCAN_RADAR_8cfb51d2_Tx: ComSignalType=UINT8
            DET_MTD_129_oRDR_DETECTION_129_132_oPCAN_RADAR_3afd5c5f_Tx: ComSignalType=UINT8
            DET_MTD_130_oRDR_DETECTION_129_132_oPCAN_RADAR_5fdd2efb_Tx: ComSignalType=UINT8
            DET_MTD_131_oRDR_DETECTION_129_132_oPCAN_RADAR_caadfa6e_Tx: ComSignalType=UINT8
            DET_MTD_132_oRDR_DETECTION_129_132_oPCAN_RADAR_ae4d8190_Tx: ComSignalType=UINT8
            DET_PROB_1STAZHYPO_129_oRDR_DETECTION_129_132_oPCAN_RADAR_a949b492_Tx: ComSignalType=BOOLEAN
            DET_PROB_1STAZHYPO_130_oRDR_DETECTION_129_132_oPCAN_RADAR_cc69c636_Tx: ComSignalType=BOOLEAN
            DET_PROB_1STAZHYPO_131_oRDR_DETECTION_129_132_oPCAN_RADAR_591912a3_Tx: ComSignalType=BOOLEAN
            DET_PROB_1STAZHYPO_132_oRDR_DETECTION_129_132_oPCAN_RADAR_3df9695d_Tx: ComSignalType=BOOLEAN
            DET_RANGE_129_oRDR_DETECTION_129_132_oPCAN_RADAR_a2e657e4_Tx: ComSignalType=UINT16
            DET_RANGE_130_oRDR_DETECTION_129_132_oPCAN_RADAR_c7c62540_Tx: ComSignalType=UINT16
            DET_RANGE_131_oRDR_DETECTION_129_132_oPCAN_RADAR_52b6f1d5_Tx: ComSignalType=UINT16
            DET_RANGE_132_oRDR_DETECTION_129_132_oPCAN_RADAR_36568a2b_Tx: ComSignalType=UINT16
            DET_RANGE_ERR_129_oRDR_DETECTION_129_132_oPCAN_RADAR_050eed8d_Tx: ComSignalType=UINT8
            DET_RANGE_ERR_130_oRDR_DETECTION_129_132_oPCAN_RADAR_602e9f29_Tx: ComSignalType=UINT8
            DET_RANGE_ERR_131_oRDR_DETECTION_129_132_oPCAN_RADAR_f55e4bbc_Tx: ComSignalType=UINT8
            DET_RANGE_ERR_132_oRDR_DETECTION_129_132_oPCAN_RADAR_91be3042_Tx: ComSignalType=UINT8
            DET_RANGE_VELOCITY_129_oRDR_DETECTION_129_132_oPCAN_RADAR_d74095c1_Tx: ComSignalType=UINT16
            DET_RANGE_VELOCITY_130_oRDR_DETECTION_129_132_oPCAN_RADAR_b260e765_Tx: ComSignalType=UINT16
            DET_RANGE_VELOCITY_131_oRDR_DETECTION_129_132_oPCAN_RADAR_271033f0_Tx: ComSignalType=UINT16
            DET_RANGE_VELOCITY_132_oRDR_DETECTION_129_132_oPCAN_RADAR_43f0480e_Tx: ComSignalType=UINT16
            DET_RANGE_VELOCITY_ERR_129_oRDR_DETECTION_129_132_oPCAN_RADAR_d8fb6e73_Tx: ComSignalType=UINT8
            DET_RANGE_VELOCITY_ERR_130_oRDR_DETECTION_129_132_oPCAN_RADAR_bddb1cd7_Tx: ComSignalType=UINT8
            DET_RANGE_VELOCITY_ERR_131_oRDR_DETECTION_129_132_oPCAN_RADAR_28abc842_Tx: ComSignalType=UINT8
            DET_RANGE_VELOCITY_ERR_132_oRDR_DETECTION_129_132_oPCAN_RADAR_4c4bb3bc_Tx: ComSignalType=UINT8
            DET_RCS_129_oRDR_DETECTION_129_132_oPCAN_RADAR_50c0a29b_Tx: ComSignalType=UINT8
            DET_RCS_130_oRDR_DETECTION_129_132_oPCAN_RADAR_35e0d03f_Tx: ComSignalType=UINT8
            DET_RCS_131_oRDR_DETECTION_129_132_oPCAN_RADAR_a09004aa_Tx: ComSignalType=UINT8
            DET_RCS_132_oRDR_DETECTION_129_132_oPCAN_RADAR_c4707f54_Tx: ComSignalType=UINT8
            DET_SNR_129_oRDR_DETECTION_129_132_oPCAN_RADAR_8d6ef699_Tx: ComSignalType=UINT8
            DET_SNR_130_oRDR_DETECTION_129_132_oPCAN_RADAR_e84e843d_Tx: ComSignalType=UINT8
            DET_SNR_131_oRDR_DETECTION_129_132_oPCAN_RADAR_7d3e50a8_Tx: ComSignalType=UINT8
            DET_SNR_132_oRDR_DETECTION_129_132_oPCAN_RADAR_19de2b56_Tx: ComSignalType=UINT8
            DET_SUPER_RES_TARGET_129_oRDR_DETECTION_129_132_oPCAN_RADAR_bcf7defc_Tx: ComSignalType=BOOLEAN
            DET_SUPER_RES_TARGET_130_oRDR_DETECTION_129_132_oPCAN_RADAR_d9d7ac58_Tx: ComSignalType=BOOLEAN
            DET_SUPER_RES_TARGET_131_oRDR_DETECTION_129_132_oPCAN_RADAR_4ca778cd_Tx: ComSignalType=BOOLEAN
            DET_SUPER_RES_TARGET_132_oRDR_DETECTION_129_132_oPCAN_RADAR_28470333_Tx: ComSignalType=BOOLEAN
        SG_Detections_133_136_oRDR_DETECTION_133_136_oPCAN_RADAR_72276f4a_Tx
          83 x ComGroupSignal:
            DET_AZIMUTH_133_oRDR_DETECTION_133_136_oPCAN_RADAR_ae7a2e2b_Tx: ComSignalType=UINT16
            DET_AZIMUTH_134_oRDR_DETECTION_133_136_oPCAN_RADAR_f2ca0d42_Tx: ComSignalType=UINT16
            DET_AZIMUTH_135_oRDR_DETECTION_133_136_oPCAN_RADAR_67bad9d7_Tx: ComSignalType=UINT16
            DET_AZIMUTH_136_oRDR_DETECTION_133_136_oPCAN_RADAR_035aa229_Tx: ComSignalType=UINT16
            DET_AZIMUTH_ERR_133_oRDR_DETECTION_133_136_oPCAN_RADAR_0acfbbde_Tx: ComSignalType=UINT8
            DET_AZIMUTH_ERR_134_oRDR_DETECTION_133_136_oPCAN_RADAR_567f98b7_Tx: ComSignalType=UINT8
            DET_AZIMUTH_ERR_135_oRDR_DETECTION_133_136_oPCAN_RADAR_c30f4c22_Tx: ComSignalType=UINT8
            DET_AZIMUTH_ERR_136_oRDR_DETECTION_133_136_oPCAN_RADAR_a7ef37dc_Tx: ComSignalType=UINT8
            DET_BELOW_RAIN_THOLD_133_oRDR_DETECTION_133_136_oPCAN_RADAR_7b7bbdeb_Tx: ComSignalType=UINT8
            DET_BELOW_RAIN_THOLD_134_oRDR_DETECTION_133_136_oPCAN_RADAR_27cb9e82_Tx: ComSignalType=UINT8
            DET_BELOW_RAIN_THOLD_135_oRDR_DETECTION_133_136_oPCAN_RADAR_b2bb4a17_Tx: ComSignalType=UINT8
            DET_BELOW_RAIN_THOLD_136_oRDR_DETECTION_133_136_oPCAN_RADAR_d65b31e9_Tx: ComSignalType=UINT8
            DET_BI_STATIC_FLAG_133_oRDR_DETECTION_133_136_oPCAN_RADAR_f8566eae_Tx: ComSignalType=BOOLEAN
            DET_BI_STATIC_FLAG_134_oRDR_DETECTION_133_136_oPCAN_RADAR_a4e64dc7_Tx: ComSignalType=BOOLEAN
            DET_BI_STATIC_FLAG_135_oRDR_DETECTION_133_136_oPCAN_RADAR_31969952_Tx: ComSignalType=BOOLEAN
            DET_BI_STATIC_FLAG_136_oRDR_DETECTION_133_136_oPCAN_RADAR_5576e2ac_Tx: ComSignalType=BOOLEAN
            DET_CONFD_AZIMUTH_133_oRDR_DETECTION_133_136_oPCAN_RADAR_ac9c24e1_Tx: ComSignalType=UINT8
            DET_CONFD_AZIMUTH_134_oRDR_DETECTION_133_136_oPCAN_RADAR_f02c0788_Tx: ComSignalType=UINT8
            DET_CONFD_AZIMUTH_135_oRDR_DETECTION_133_136_oPCAN_RADAR_655cd31d_Tx: ComSignalType=UINT8
            DET_CONFD_AZIMUTH_136_oRDR_DETECTION_133_136_oPCAN_RADAR_01bca8e3_Tx: ComSignalType=UINT8
            DET_CONFD_ELEVATION_133_oRDR_DETECTION_133_136_oPCAN_RADAR_ae09251b_Tx: ComSignalType=UINT8
            DET_CONFD_ELEVATION_134_oRDR_DETECTION_133_136_oPCAN_RADAR_f2b90672_Tx: ComSignalType=UINT8
            DET_CONFD_ELEVATION_135_oRDR_DETECTION_133_136_oPCAN_RADAR_67c9d2e7_Tx: ComSignalType=UINT8
            DET_CONFD_ELEVATION_136_oRDR_DETECTION_133_136_oPCAN_RADAR_0329a919_Tx: ComSignalType=UINT8
            DET_ELEVATION_133_oRDR_DETECTION_133_136_oPCAN_RADAR_7fc9f127_Tx: ComSignalType=UINT8
            DET_ELEVATION_134_oRDR_DETECTION_133_136_oPCAN_RADAR_2379d24e_Tx: ComSignalType=UINT8
            DET_ELEVATION_135_oRDR_DETECTION_133_136_oPCAN_RADAR_b60906db_Tx: ComSignalType=UINT8
            DET_ELEVATION_136_oRDR_DETECTION_133_136_oPCAN_RADAR_d2e97d25_Tx: ComSignalType=UINT8
            DET_ELEVATION_ERR_133_oRDR_DETECTION_133_136_oPCAN_RADAR_f8f06952_Tx: ComSignalType=UINT8
            DET_ELEVATION_ERR_134_oRDR_DETECTION_133_136_oPCAN_RADAR_a4404a3b_Tx: ComSignalType=UINT8
            DET_ELEVATION_ERR_135_oRDR_DETECTION_133_136_oPCAN_RADAR_31309eae_Tx: ComSignalType=UINT8
            DET_ELEVATION_ERR_136_oRDR_DETECTION_133_136_oPCAN_RADAR_55d0e550_Tx: ComSignalType=UINT8
            DET_EXISTENCE_PROB_133_oRDR_DETECTION_133_136_oPCAN_RADAR_2a6f1c32_Tx: ComSignalType=UINT8
            DET_EXISTENCE_PROB_134_oRDR_DETECTION_133_136_oPCAN_RADAR_76df3f5b_Tx: ComSignalType=UINT8
            DET_EXISTENCE_PROB_135_oRDR_DETECTION_133_136_oPCAN_RADAR_e3afebce_Tx: ComSignalType=UINT8
            DET_EXISTENCE_PROB_136_oRDR_DETECTION_133_136_oPCAN_RADAR_874f9030_Tx: ComSignalType=UINT8
            DET_HVC_FLAG_133_oRDR_DETECTION_133_136_oPCAN_RADAR_cb1b5f4d_Tx: ComSignalType=BOOLEAN
            DET_HVC_FLAG_134_oRDR_DETECTION_133_136_oPCAN_RADAR_97ab7c24_Tx: ComSignalType=BOOLEAN
            DET_HVC_FLAG_135_oRDR_DETECTION_133_136_oPCAN_RADAR_02dba8b1_Tx: ComSignalType=BOOLEAN
            DET_HVC_FLAG_136_oRDR_DETECTION_133_136_oPCAN_RADAR_663bd34f_Tx: ComSignalType=BOOLEAN
            DET_IDM_133_oRDR_DETECTION_133_136_oPCAN_RADAR_404964f0_Tx: ComSignalType=UINT8
            DET_IDM_134_oRDR_DETECTION_133_136_oPCAN_RADAR_1cf94799_Tx: ComSignalType=UINT8
            DET_IDM_135_oRDR_DETECTION_133_136_oPCAN_RADAR_8989930c_Tx: ComSignalType=UINT8
            DET_IDM_136_oRDR_DETECTION_133_136_oPCAN_RADAR_ed69e8f2_Tx: ComSignalType=UINT8
            DET_MH_CRC16_133_136_oRDR_DETECTION_133_136_oPCAN_RADAR_f6afbd41_Tx: ComSignalType=UINT16
            DET_MH_CYCLE_COUNTER_133_136_oRDR_DETECTION_133_136_oPCAN_RADAR_72da1c76_Tx: ComSignalType=UINT8
            DET_MH_SCAN_INDEX_4LSB_133_136_oRDR_DETECTION_133_136_oPCAN_RADAR_bef039fa_Tx: ComSignalType=UINT8
            DET_MTD_133_oRDR_DETECTION_133_136_oPCAN_RADAR_26fa562b_Tx: ComSignalType=UINT8
            DET_MTD_134_oRDR_DETECTION_133_136_oPCAN_RADAR_7a4a7542_Tx: ComSignalType=UINT8
            DET_MTD_135_oRDR_DETECTION_133_136_oPCAN_RADAR_ef3aa1d7_Tx: ComSignalType=UINT8
            DET_MTD_136_oRDR_DETECTION_133_136_oPCAN_RADAR_8bdada29_Tx: ComSignalType=UINT8
            DET_PROB_1STAZHYPO_133_oRDR_DETECTION_133_136_oPCAN_RADAR_b54ebee6_Tx: ComSignalType=BOOLEAN
            DET_PROB_1STAZHYPO_134_oRDR_DETECTION_133_136_oPCAN_RADAR_e9fe9d8f_Tx: ComSignalType=BOOLEAN
            DET_PROB_1STAZHYPO_135_oRDR_DETECTION_133_136_oPCAN_RADAR_7c8e491a_Tx: ComSignalType=BOOLEAN
            DET_PROB_1STAZHYPO_136_oRDR_DETECTION_133_136_oPCAN_RADAR_186e32e4_Tx: ComSignalType=BOOLEAN
            DET_RANGE_133_oRDR_DETECTION_133_136_oPCAN_RADAR_bee15d90_Tx: ComSignalType=UINT16
            DET_RANGE_134_oRDR_DETECTION_133_136_oPCAN_RADAR_e2517ef9_Tx: ComSignalType=UINT16
            DET_RANGE_135_oRDR_DETECTION_133_136_oPCAN_RADAR_7721aa6c_Tx: ComSignalType=UINT16
            DET_RANGE_136_oRDR_DETECTION_133_136_oPCAN_RADAR_13c1d192_Tx: ComSignalType=UINT16
            DET_RANGE_ERR_133_oRDR_DETECTION_133_136_oPCAN_RADAR_1909e7f9_Tx: ComSignalType=UINT8
            DET_RANGE_ERR_134_oRDR_DETECTION_133_136_oPCAN_RADAR_45b9c490_Tx: ComSignalType=UINT8
            DET_RANGE_ERR_135_oRDR_DETECTION_133_136_oPCAN_RADAR_d0c91005_Tx: ComSignalType=UINT8
            DET_RANGE_ERR_136_oRDR_DETECTION_133_136_oPCAN_RADAR_b4296bfb_Tx: ComSignalType=UINT8
            DET_RANGE_VELOCITY_133_oRDR_DETECTION_133_136_oPCAN_RADAR_cb479fb5_Tx: ComSignalType=UINT16
            DET_RANGE_VELOCITY_134_oRDR_DETECTION_133_136_oPCAN_RADAR_97f7bcdc_Tx: ComSignalType=UINT16
            DET_RANGE_VELOCITY_135_oRDR_DETECTION_133_136_oPCAN_RADAR_02876849_Tx: ComSignalType=UINT16
            DET_RANGE_VELOCITY_136_oRDR_DETECTION_133_136_oPCAN_RADAR_666713b7_Tx: ComSignalType=UINT16
            DET_RANGE_VELOCITY_ERR_133_oRDR_DETECTION_133_136_oPCAN_RADAR_c4fc6407_Tx: ComSignalType=UINT8
            DET_RANGE_VELOCITY_ERR_134_oRDR_DETECTION_133_136_oPCAN_RADAR_984c476e_Tx: ComSignalType=UINT8
            DET_RANGE_VELOCITY_ERR_135_oRDR_DETECTION_133_136_oPCAN_RADAR_0d3c93fb_Tx: ComSignalType=UINT8
            DET_RANGE_VELOCITY_ERR_136_oRDR_DETECTION_133_136_oPCAN_RADAR_69dce805_Tx: ComSignalType=UINT8
            DET_RCS_133_oRDR_DETECTION_133_136_oPCAN_RADAR_4cc7a8ef_Tx: ComSignalType=UINT8
            DET_RCS_134_oRDR_DETECTION_133_136_oPCAN_RADAR_10778b86_Tx: ComSignalType=UINT8
            DET_RCS_135_oRDR_DETECTION_133_136_oPCAN_RADAR_85075f13_Tx: ComSignalType=UINT8
            DET_RCS_136_oRDR_DETECTION_133_136_oPCAN_RADAR_e1e724ed_Tx: ComSignalType=UINT8
            DET_SNR_133_oRDR_DETECTION_133_136_oPCAN_RADAR_9169fced_Tx: ComSignalType=UINT8
            DET_SNR_134_oRDR_DETECTION_133_136_oPCAN_RADAR_cdd9df84_Tx: ComSignalType=UINT8
            DET_SNR_135_oRDR_DETECTION_133_136_oPCAN_RADAR_58a90b11_Tx: ComSignalType=UINT8
            DET_SNR_136_oRDR_DETECTION_133_136_oPCAN_RADAR_3c4970ef_Tx: ComSignalType=UINT8
            DET_SUPER_RES_TARGET_133_oRDR_DETECTION_133_136_oPCAN_RADAR_a0f0d488_Tx: ComSignalType=BOOLEAN
            DET_SUPER_RES_TARGET_134_oRDR_DETECTION_133_136_oPCAN_RADAR_fc40f7e1_Tx: ComSignalType=BOOLEAN
            DET_SUPER_RES_TARGET_135_oRDR_DETECTION_133_136_oPCAN_RADAR_69302374_Tx: ComSignalType=BOOLEAN
            DET_SUPER_RES_TARGET_136_oRDR_DETECTION_133_136_oPCAN_RADAR_0dd0588a_Tx: ComSignalType=BOOLEAN
        SG_Detections_137_140_oRDR_DETECTION_137_140_oPCAN_RADAR_e974e064_Tx
          83 x ComGroupSignal:
            DET_AZIMUTH_137_oRDR_DETECTION_137_140_oPCAN_RADAR_200a246e_Tx: ComSignalType=UINT16
            DET_AZIMUTH_138_oRDR_DETECTION_137_140_oPCAN_RADAR_0c1ab629_Tx: ComSignalType=UINT16
            DET_AZIMUTH_139_oRDR_DETECTION_137_140_oPCAN_RADAR_996a62bc_Tx: ComSignalType=UINT16
            DET_AZIMUTH_140_oRDR_DETECTION_137_140_oPCAN_RADAR_48886ed8_Tx: ComSignalType=UINT16
            DET_AZIMUTH_ERR_137_oRDR_DETECTION_137_140_oPCAN_RADAR_84bfb19b_Tx: ComSignalType=UINT8
            DET_AZIMUTH_ERR_138_oRDR_DETECTION_137_140_oPCAN_RADAR_a8af23dc_Tx: ComSignalType=UINT8
            DET_AZIMUTH_ERR_139_oRDR_DETECTION_137_140_oPCAN_RADAR_3ddff749_Tx: ComSignalType=UINT8
            DET_AZIMUTH_ERR_140_oRDR_DETECTION_137_140_oPCAN_RADAR_ec3dfb2d_Tx: ComSignalType=UINT8
            DET_BELOW_RAIN_THOLD_137_oRDR_DETECTION_137_140_oPCAN_RADAR_f50bb7ae_Tx: ComSignalType=UINT8
            DET_BELOW_RAIN_THOLD_138_oRDR_DETECTION_137_140_oPCAN_RADAR_d91b25e9_Tx: ComSignalType=UINT8
            DET_BELOW_RAIN_THOLD_139_oRDR_DETECTION_137_140_oPCAN_RADAR_4c6bf17c_Tx: ComSignalType=UINT8
            DET_BELOW_RAIN_THOLD_140_oRDR_DETECTION_137_140_oPCAN_RADAR_9d89fd18_Tx: ComSignalType=UINT8
            DET_BI_STATIC_FLAG_137_oRDR_DETECTION_137_140_oPCAN_RADAR_762664eb_Tx: ComSignalType=BOOLEAN
            DET_BI_STATIC_FLAG_138_oRDR_DETECTION_137_140_oPCAN_RADAR_5a36f6ac_Tx: ComSignalType=BOOLEAN
            DET_BI_STATIC_FLAG_139_oRDR_DETECTION_137_140_oPCAN_RADAR_cf462239_Tx: ComSignalType=BOOLEAN
            DET_BI_STATIC_FLAG_140_oRDR_DETECTION_137_140_oPCAN_RADAR_1ea42e5d_Tx: ComSignalType=BOOLEAN
            DET_CONFD_AZIMUTH_137_oRDR_DETECTION_137_140_oPCAN_RADAR_22ec2ea4_Tx: ComSignalType=UINT8
            DET_CONFD_AZIMUTH_138_oRDR_DETECTION_137_140_oPCAN_RADAR_0efcbce3_Tx: ComSignalType=UINT8
            DET_CONFD_AZIMUTH_139_oRDR_DETECTION_137_140_oPCAN_RADAR_9b8c6876_Tx: ComSignalType=UINT8
            DET_CONFD_AZIMUTH_140_oRDR_DETECTION_137_140_oPCAN_RADAR_4a6e6412_Tx: ComSignalType=UINT8
            DET_CONFD_ELEVATION_137_oRDR_DETECTION_137_140_oPCAN_RADAR_20792f5e_Tx: ComSignalType=UINT8
            DET_CONFD_ELEVATION_138_oRDR_DETECTION_137_140_oPCAN_RADAR_0c69bd19_Tx: ComSignalType=UINT8
            DET_CONFD_ELEVATION_139_oRDR_DETECTION_137_140_oPCAN_RADAR_9919698c_Tx: ComSignalType=UINT8
            DET_CONFD_ELEVATION_140_oRDR_DETECTION_137_140_oPCAN_RADAR_48fb65e8_Tx: ComSignalType=UINT8
            DET_ELEVATION_137_oRDR_DETECTION_137_140_oPCAN_RADAR_f1b9fb62_Tx: ComSignalType=UINT8
            DET_ELEVATION_138_oRDR_DETECTION_137_140_oPCAN_RADAR_dda96925_Tx: ComSignalType=UINT8
            DET_ELEVATION_139_oRDR_DETECTION_137_140_oPCAN_RADAR_48d9bdb0_Tx: ComSignalType=UINT8
            DET_ELEVATION_140_oRDR_DETECTION_137_140_oPCAN_RADAR_993bb1d4_Tx: ComSignalType=UINT8
            DET_ELEVATION_ERR_137_oRDR_DETECTION_137_140_oPCAN_RADAR_76806317_Tx: ComSignalType=UINT8
            DET_ELEVATION_ERR_138_oRDR_DETECTION_137_140_oPCAN_RADAR_5a90f150_Tx: ComSignalType=UINT8
            DET_ELEVATION_ERR_139_oRDR_DETECTION_137_140_oPCAN_RADAR_cfe025c5_Tx: ComSignalType=UINT8
            DET_ELEVATION_ERR_140_oRDR_DETECTION_137_140_oPCAN_RADAR_1e0229a1_Tx: ComSignalType=UINT8
            DET_EXISTENCE_PROB_137_oRDR_DETECTION_137_140_oPCAN_RADAR_a41f1677_Tx: ComSignalType=UINT8
            DET_EXISTENCE_PROB_138_oRDR_DETECTION_137_140_oPCAN_RADAR_880f8430_Tx: ComSignalType=UINT8
            DET_EXISTENCE_PROB_139_oRDR_DETECTION_137_140_oPCAN_RADAR_1d7f50a5_Tx: ComSignalType=UINT8
            DET_EXISTENCE_PROB_140_oRDR_DETECTION_137_140_oPCAN_RADAR_cc9d5cc1_Tx: ComSignalType=UINT8
            DET_HVC_FLAG_137_oRDR_DETECTION_137_140_oPCAN_RADAR_456b5508_Tx: ComSignalType=BOOLEAN
            DET_HVC_FLAG_138_oRDR_DETECTION_137_140_oPCAN_RADAR_697bc74f_Tx: ComSignalType=BOOLEAN
            DET_HVC_FLAG_139_oRDR_DETECTION_137_140_oPCAN_RADAR_fc0b13da_Tx: ComSignalType=BOOLEAN
            DET_HVC_FLAG_140_oRDR_DETECTION_137_140_oPCAN_RADAR_2de91fbe_Tx: ComSignalType=BOOLEAN
            DET_IDM_137_oRDR_DETECTION_137_140_oPCAN_RADAR_ce396eb5_Tx: ComSignalType=UINT8
            DET_IDM_138_oRDR_DETECTION_137_140_oPCAN_RADAR_e229fcf2_Tx: ComSignalType=UINT8
            DET_IDM_139_oRDR_DETECTION_137_140_oPCAN_RADAR_77592867_Tx: ComSignalType=UINT8
            DET_IDM_140_oRDR_DETECTION_137_140_oPCAN_RADAR_a6bb2403_Tx: ComSignalType=UINT8
            DET_MH_CRC16_137_140_oRDR_DETECTION_137_140_oPCAN_RADAR_6dfc326f_Tx: ComSignalType=UINT16
            DET_MH_CYCLE_COUNTER_137_140_oRDR_DETECTION_137_140_oPCAN_RADAR_e9899358_Tx: ComSignalType=UINT8
            DET_MH_SCAN_INDEX_4LSB_137_140_oRDR_DETECTION_137_140_oPCAN_RADAR_25a3b6d4_Tx: ComSignalType=UINT8
            DET_MTD_137_oRDR_DETECTION_137_140_oPCAN_RADAR_a88a5c6e_Tx: ComSignalType=UINT8
            DET_MTD_138_oRDR_DETECTION_137_140_oPCAN_RADAR_849ace29_Tx: ComSignalType=UINT8
            DET_MTD_139_oRDR_DETECTION_137_140_oPCAN_RADAR_11ea1abc_Tx: ComSignalType=UINT8
            DET_MTD_140_oRDR_DETECTION_137_140_oPCAN_RADAR_c00816d8_Tx: ComSignalType=UINT8
            DET_PROB_1STAZHYPO_137_oRDR_DETECTION_137_140_oPCAN_RADAR_3b3eb4a3_Tx: ComSignalType=BOOLEAN
            DET_PROB_1STAZHYPO_138_oRDR_DETECTION_137_140_oPCAN_RADAR_172e26e4_Tx: ComSignalType=BOOLEAN
            DET_PROB_1STAZHYPO_139_oRDR_DETECTION_137_140_oPCAN_RADAR_825ef271_Tx: ComSignalType=BOOLEAN
            DET_PROB_1STAZHYPO_140_oRDR_DETECTION_137_140_oPCAN_RADAR_53bcfe15_Tx: ComSignalType=BOOLEAN
            DET_RANGE_137_oRDR_DETECTION_137_140_oPCAN_RADAR_309157d5_Tx: ComSignalType=UINT16
            DET_RANGE_138_oRDR_DETECTION_137_140_oPCAN_RADAR_1c81c592_Tx: ComSignalType=UINT16
            DET_RANGE_139_oRDR_DETECTION_137_140_oPCAN_RADAR_89f11107_Tx: ComSignalType=UINT16
            DET_RANGE_140_oRDR_DETECTION_137_140_oPCAN_RADAR_58131d63_Tx: ComSignalType=UINT16
            DET_RANGE_ERR_137_oRDR_DETECTION_137_140_oPCAN_RADAR_9779edbc_Tx: ComSignalType=UINT8
            DET_RANGE_ERR_138_oRDR_DETECTION_137_140_oPCAN_RADAR_bb697ffb_Tx: ComSignalType=UINT8
            DET_RANGE_ERR_139_oRDR_DETECTION_137_140_oPCAN_RADAR_2e19ab6e_Tx: ComSignalType=UINT8
            DET_RANGE_ERR_140_oRDR_DETECTION_137_140_oPCAN_RADAR_fffba70a_Tx: ComSignalType=UINT8
            DET_RANGE_VELOCITY_137_oRDR_DETECTION_137_140_oPCAN_RADAR_453795f0_Tx: ComSignalType=UINT16
            DET_RANGE_VELOCITY_138_oRDR_DETECTION_137_140_oPCAN_RADAR_692707b7_Tx: ComSignalType=UINT16
            DET_RANGE_VELOCITY_139_oRDR_DETECTION_137_140_oPCAN_RADAR_fc57d322_Tx: ComSignalType=UINT16
            DET_RANGE_VELOCITY_140_oRDR_DETECTION_137_140_oPCAN_RADAR_2db5df46_Tx: ComSignalType=UINT16
            DET_RANGE_VELOCITY_ERR_137_oRDR_DETECTION_137_140_oPCAN_RADAR_4a8c6e42_Tx: ComSignalType=UINT8
            DET_RANGE_VELOCITY_ERR_138_oRDR_DETECTION_137_140_oPCAN_RADAR_669cfc05_Tx: ComSignalType=UINT8
            DET_RANGE_VELOCITY_ERR_139_oRDR_DETECTION_137_140_oPCAN_RADAR_f3ec2890_Tx: ComSignalType=UINT8
            DET_RANGE_VELOCITY_ERR_140_oRDR_DETECTION_137_140_oPCAN_RADAR_220e24f4_Tx: ComSignalType=UINT8
            DET_RCS_137_oRDR_DETECTION_137_140_oPCAN_RADAR_c2b7a2aa_Tx: ComSignalType=UINT8
            DET_RCS_138_oRDR_DETECTION_137_140_oPCAN_RADAR_eea730ed_Tx: ComSignalType=UINT8
            DET_RCS_139_oRDR_DETECTION_137_140_oPCAN_RADAR_7bd7e478_Tx: ComSignalType=UINT8
            DET_RCS_140_oRDR_DETECTION_137_140_oPCAN_RADAR_aa35e81c_Tx: ComSignalType=UINT8
            DET_SNR_137_oRDR_DETECTION_137_140_oPCAN_RADAR_1f19f6a8_Tx: ComSignalType=UINT8
            DET_SNR_138_oRDR_DETECTION_137_140_oPCAN_RADAR_330964ef_Tx: ComSignalType=UINT8
            DET_SNR_139_oRDR_DETECTION_137_140_oPCAN_RADAR_a679b07a_Tx: ComSignalType=UINT8
            DET_SNR_140_oRDR_DETECTION_137_140_oPCAN_RADAR_779bbc1e_Tx: ComSignalType=UINT8
            DET_SUPER_RES_TARGET_137_oRDR_DETECTION_137_140_oPCAN_RADAR_2e80decd_Tx: ComSignalType=BOOLEAN
            DET_SUPER_RES_TARGET_138_oRDR_DETECTION_137_140_oPCAN_RADAR_02904c8a_Tx: ComSignalType=BOOLEAN
            DET_SUPER_RES_TARGET_139_oRDR_DETECTION_137_140_oPCAN_RADAR_97e0981f_Tx: ComSignalType=BOOLEAN
            DET_SUPER_RES_TARGET_140_oRDR_DETECTION_137_140_oPCAN_RADAR_4602947b_Tx: ComSignalType=BOOLEAN
        SG_Detections_141_144_oRDR_DETECTION_141_144_oPCAN_RADAR_f70bf7bd_Tx
          83 x ComGroupSignal:
            DET_AZIMUTH_141_oRDR_DETECTION_141_144_oPCAN_RADAR_5b5b6db7_Tx: ComSignalType=UINT16
            DET_AZIMUTH_142_oRDR_DETECTION_141_144_oPCAN_RADAR_3fbb1649_Tx: ComSignalType=UINT16
            DET_AZIMUTH_143_oRDR_DETECTION_141_144_oPCAN_RADAR_aacbc2dc_Tx: ComSignalType=UINT16
            DET_AZIMUTH_144_oRDR_DETECTION_141_144_oPCAN_RADAR_f67be1b5_Tx: ComSignalType=UINT16
            DET_AZIMUTH_ERR_141_oRDR_DETECTION_141_144_oPCAN_RADAR_ffeef842_Tx: ComSignalType=UINT8
            DET_AZIMUTH_ERR_142_oRDR_DETECTION_141_144_oPCAN_RADAR_9b0e83bc_Tx: ComSignalType=UINT8
            DET_AZIMUTH_ERR_143_oRDR_DETECTION_141_144_oPCAN_RADAR_0e7e5729_Tx: ComSignalType=UINT8
            DET_AZIMUTH_ERR_144_oRDR_DETECTION_141_144_oPCAN_RADAR_52ce7440_Tx: ComSignalType=UINT8
            DET_BELOW_RAIN_THOLD_141_oRDR_DETECTION_141_144_oPCAN_RADAR_8e5afe77_Tx: ComSignalType=UINT8
            DET_BELOW_RAIN_THOLD_142_oRDR_DETECTION_141_144_oPCAN_RADAR_eaba8589_Tx: ComSignalType=UINT8
            DET_BELOW_RAIN_THOLD_143_oRDR_DETECTION_141_144_oPCAN_RADAR_7fca511c_Tx: ComSignalType=UINT8
            DET_BELOW_RAIN_THOLD_144_oRDR_DETECTION_141_144_oPCAN_RADAR_237a7275_Tx: ComSignalType=UINT8
            DET_BI_STATIC_FLAG_141_oRDR_DETECTION_141_144_oPCAN_RADAR_0d772d32_Tx: ComSignalType=BOOLEAN
            DET_BI_STATIC_FLAG_142_oRDR_DETECTION_141_144_oPCAN_RADAR_699756cc_Tx: ComSignalType=BOOLEAN
            DET_BI_STATIC_FLAG_143_oRDR_DETECTION_141_144_oPCAN_RADAR_fce78259_Tx: ComSignalType=BOOLEAN
            DET_BI_STATIC_FLAG_144_oRDR_DETECTION_141_144_oPCAN_RADAR_a057a130_Tx: ComSignalType=BOOLEAN
            DET_CONFD_AZIMUTH_141_oRDR_DETECTION_141_144_oPCAN_RADAR_59bd677d_Tx: ComSignalType=UINT8
            DET_CONFD_AZIMUTH_142_oRDR_DETECTION_141_144_oPCAN_RADAR_3d5d1c83_Tx: ComSignalType=UINT8
            DET_CONFD_AZIMUTH_143_oRDR_DETECTION_141_144_oPCAN_RADAR_a82dc816_Tx: ComSignalType=UINT8
            DET_CONFD_AZIMUTH_144_oRDR_DETECTION_141_144_oPCAN_RADAR_f49deb7f_Tx: ComSignalType=UINT8
            DET_CONFD_ELEVATION_141_oRDR_DETECTION_141_144_oPCAN_RADAR_5b286687_Tx: ComSignalType=UINT8
            DET_CONFD_ELEVATION_142_oRDR_DETECTION_141_144_oPCAN_RADAR_3fc81d79_Tx: ComSignalType=UINT8
            DET_CONFD_ELEVATION_143_oRDR_DETECTION_141_144_oPCAN_RADAR_aab8c9ec_Tx: ComSignalType=UINT8
            DET_CONFD_ELEVATION_144_oRDR_DETECTION_141_144_oPCAN_RADAR_f608ea85_Tx: ComSignalType=UINT8
            DET_ELEVATION_141_oRDR_DETECTION_141_144_oPCAN_RADAR_8ae8b2bb_Tx: ComSignalType=UINT8
            DET_ELEVATION_142_oRDR_DETECTION_141_144_oPCAN_RADAR_ee08c945_Tx: ComSignalType=UINT8
            DET_ELEVATION_143_oRDR_DETECTION_141_144_oPCAN_RADAR_7b781dd0_Tx: ComSignalType=UINT8
            DET_ELEVATION_144_oRDR_DETECTION_141_144_oPCAN_RADAR_27c83eb9_Tx: ComSignalType=UINT8
            DET_ELEVATION_ERR_141_oRDR_DETECTION_141_144_oPCAN_RADAR_0dd12ace_Tx: ComSignalType=UINT8
            DET_ELEVATION_ERR_142_oRDR_DETECTION_141_144_oPCAN_RADAR_69315130_Tx: ComSignalType=UINT8
            DET_ELEVATION_ERR_143_oRDR_DETECTION_141_144_oPCAN_RADAR_fc4185a5_Tx: ComSignalType=UINT8
            DET_ELEVATION_ERR_144_oRDR_DETECTION_141_144_oPCAN_RADAR_a0f1a6cc_Tx: ComSignalType=UINT8
            DET_EXISTENCE_PROB_141_oRDR_DETECTION_141_144_oPCAN_RADAR_df4e5fae_Tx: ComSignalType=UINT8
            DET_EXISTENCE_PROB_142_oRDR_DETECTION_141_144_oPCAN_RADAR_bbae2450_Tx: ComSignalType=UINT8
            DET_EXISTENCE_PROB_143_oRDR_DETECTION_141_144_oPCAN_RADAR_2edef0c5_Tx: ComSignalType=UINT8
            DET_EXISTENCE_PROB_144_oRDR_DETECTION_141_144_oPCAN_RADAR_726ed3ac_Tx: ComSignalType=UINT8
            DET_HVC_FLAG_141_oRDR_DETECTION_141_144_oPCAN_RADAR_3e3a1cd1_Tx: ComSignalType=BOOLEAN
            DET_HVC_FLAG_142_oRDR_DETECTION_141_144_oPCAN_RADAR_5ada672f_Tx: ComSignalType=BOOLEAN
            DET_HVC_FLAG_143_oRDR_DETECTION_141_144_oPCAN_RADAR_cfaab3ba_Tx: ComSignalType=BOOLEAN
            DET_HVC_FLAG_144_oRDR_DETECTION_141_144_oPCAN_RADAR_931a90d3_Tx: ComSignalType=BOOLEAN
            DET_IDM_141_oRDR_DETECTION_141_144_oPCAN_RADAR_b568276c_Tx: ComSignalType=UINT8
            DET_IDM_142_oRDR_DETECTION_141_144_oPCAN_RADAR_d1885c92_Tx: ComSignalType=UINT8
            DET_IDM_143_oRDR_DETECTION_141_144_oPCAN_RADAR_44f88807_Tx: ComSignalType=UINT8
            DET_IDM_144_oRDR_DETECTION_141_144_oPCAN_RADAR_1848ab6e_Tx: ComSignalType=UINT8
            DET_MH_CRC16_141_144_oRDR_DETECTION_141_144_oPCAN_RADAR_738325b6_Tx: ComSignalType=UINT16
            DET_MH_CYCLE_COUNTER_141_144_oRDR_DETECTION_141_144_oPCAN_RADAR_f7f68481_Tx: ComSignalType=UINT8
            DET_MH_SCAN_INDEX_4LSB_141_144_oRDR_DETECTION_141_144_oPCAN_RADAR_3bdca10d_Tx: ComSignalType=UINT8
            DET_MTD_141_oRDR_DETECTION_141_144_oPCAN_RADAR_d3db15b7_Tx: ComSignalType=UINT8
            DET_MTD_142_oRDR_DETECTION_141_144_oPCAN_RADAR_b73b6e49_Tx: ComSignalType=UINT8
            DET_MTD_143_oRDR_DETECTION_141_144_oPCAN_RADAR_224bbadc_Tx: ComSignalType=UINT8
            DET_MTD_144_oRDR_DETECTION_141_144_oPCAN_RADAR_7efb99b5_Tx: ComSignalType=UINT8
            DET_PROB_1STAZHYPO_141_oRDR_DETECTION_141_144_oPCAN_RADAR_406ffd7a_Tx: ComSignalType=BOOLEAN
            DET_PROB_1STAZHYPO_142_oRDR_DETECTION_141_144_oPCAN_RADAR_248f8684_Tx: ComSignalType=BOOLEAN
            DET_PROB_1STAZHYPO_143_oRDR_DETECTION_141_144_oPCAN_RADAR_b1ff5211_Tx: ComSignalType=BOOLEAN
            DET_PROB_1STAZHYPO_144_oRDR_DETECTION_141_144_oPCAN_RADAR_ed4f7178_Tx: ComSignalType=BOOLEAN
            DET_RANGE_141_oRDR_DETECTION_141_144_oPCAN_RADAR_4bc01e0c_Tx: ComSignalType=UINT16
            DET_RANGE_142_oRDR_DETECTION_141_144_oPCAN_RADAR_2f2065f2_Tx: ComSignalType=UINT16
            DET_RANGE_143_oRDR_DETECTION_141_144_oPCAN_RADAR_ba50b167_Tx: ComSignalType=UINT16
            DET_RANGE_144_oRDR_DETECTION_141_144_oPCAN_RADAR_e6e0920e_Tx: ComSignalType=UINT16
            DET_RANGE_ERR_141_oRDR_DETECTION_141_144_oPCAN_RADAR_ec28a465_Tx: ComSignalType=UINT8
            DET_RANGE_ERR_142_oRDR_DETECTION_141_144_oPCAN_RADAR_88c8df9b_Tx: ComSignalType=UINT8
            DET_RANGE_ERR_143_oRDR_DETECTION_141_144_oPCAN_RADAR_1db80b0e_Tx: ComSignalType=UINT8
            DET_RANGE_ERR_144_oRDR_DETECTION_141_144_oPCAN_RADAR_41082867_Tx: ComSignalType=UINT8
            DET_RANGE_VELOCITY_141_oRDR_DETECTION_141_144_oPCAN_RADAR_3e66dc29_Tx: ComSignalType=UINT16
            DET_RANGE_VELOCITY_142_oRDR_DETECTION_141_144_oPCAN_RADAR_5a86a7d7_Tx: ComSignalType=UINT16
            DET_RANGE_VELOCITY_143_oRDR_DETECTION_141_144_oPCAN_RADAR_cff67342_Tx: ComSignalType=UINT16
            DET_RANGE_VELOCITY_144_oRDR_DETECTION_141_144_oPCAN_RADAR_9346502b_Tx: ComSignalType=UINT16
            DET_RANGE_VELOCITY_ERR_141_oRDR_DETECTION_141_144_oPCAN_RADAR_31dd279b_Tx: ComSignalType=UINT8
            DET_RANGE_VELOCITY_ERR_142_oRDR_DETECTION_141_144_oPCAN_RADAR_553d5c65_Tx: ComSignalType=UINT8
            DET_RANGE_VELOCITY_ERR_143_oRDR_DETECTION_141_144_oPCAN_RADAR_c04d88f0_Tx: ComSignalType=UINT8
            DET_RANGE_VELOCITY_ERR_144_oRDR_DETECTION_141_144_oPCAN_RADAR_9cfdab99_Tx: ComSignalType=UINT8
            DET_RCS_141_oRDR_DETECTION_141_144_oPCAN_RADAR_b9e6eb73_Tx: ComSignalType=UINT8
            DET_RCS_142_oRDR_DETECTION_141_144_oPCAN_RADAR_dd06908d_Tx: ComSignalType=UINT8
            DET_RCS_143_oRDR_DETECTION_141_144_oPCAN_RADAR_48764418_Tx: ComSignalType=UINT8
            DET_RCS_144_oRDR_DETECTION_141_144_oPCAN_RADAR_14c66771_Tx: ComSignalType=UINT8
            DET_SNR_141_oRDR_DETECTION_141_144_oPCAN_RADAR_6448bf71_Tx: ComSignalType=UINT8
            DET_SNR_142_oRDR_DETECTION_141_144_oPCAN_RADAR_00a8c48f_Tx: ComSignalType=UINT8
            DET_SNR_143_oRDR_DETECTION_141_144_oPCAN_RADAR_95d8101a_Tx: ComSignalType=UINT8
            DET_SNR_144_oRDR_DETECTION_141_144_oPCAN_RADAR_c9683373_Tx: ComSignalType=UINT8
            DET_SUPER_RES_TARGET_141_oRDR_DETECTION_141_144_oPCAN_RADAR_55d19714_Tx: ComSignalType=BOOLEAN
            DET_SUPER_RES_TARGET_142_oRDR_DETECTION_141_144_oPCAN_RADAR_3131ecea_Tx: ComSignalType=BOOLEAN
            DET_SUPER_RES_TARGET_143_oRDR_DETECTION_141_144_oPCAN_RADAR_a441387f_Tx: ComSignalType=BOOLEAN
            DET_SUPER_RES_TARGET_144_oRDR_DETECTION_141_144_oPCAN_RADAR_f8f11b16_Tx: ComSignalType=BOOLEAN
        SG_Detections_145_148_oRDR_DETECTION_145_148_oPCAN_RADAR_86c8c3ef_Tx
          83 x ComGroupSignal:
            DET_AZIMUTH_145_oRDR_DETECTION_145_148_oPCAN_RADAR_8ab9ab14_Tx: ComSignalType=UINT16
            DET_AZIMUTH_146_oRDR_DETECTION_145_148_oPCAN_RADAR_ee59d0ea_Tx: ComSignalType=UINT16
            DET_AZIMUTH_147_oRDR_DETECTION_145_148_oPCAN_RADAR_7b29047f_Tx: ComSignalType=UINT16
            DET_AZIMUTH_148_oRDR_DETECTION_145_148_oPCAN_RADAR_57399638_Tx: ComSignalType=UINT16
            DET_AZIMUTH_ERR_145_oRDR_DETECTION_145_148_oPCAN_RADAR_2e0c3ee1_Tx: ComSignalType=UINT8
            DET_AZIMUTH_ERR_146_oRDR_DETECTION_145_148_oPCAN_RADAR_4aec451f_Tx: ComSignalType=UINT8
            DET_AZIMUTH_ERR_147_oRDR_DETECTION_145_148_oPCAN_RADAR_df9c918a_Tx: ComSignalType=UINT8
            DET_AZIMUTH_ERR_148_oRDR_DETECTION_145_148_oPCAN_RADAR_f38c03cd_Tx: ComSignalType=UINT8
            DET_BELOW_RAIN_THOLD_145_oRDR_DETECTION_145_148_oPCAN_RADAR_5fb838d4_Tx: ComSignalType=UINT8
            DET_BELOW_RAIN_THOLD_146_oRDR_DETECTION_145_148_oPCAN_RADAR_3b58432a_Tx: ComSignalType=UINT8
            DET_BELOW_RAIN_THOLD_147_oRDR_DETECTION_145_148_oPCAN_RADAR_ae2897bf_Tx: ComSignalType=UINT8
            DET_BELOW_RAIN_THOLD_148_oRDR_DETECTION_145_148_oPCAN_RADAR_823805f8_Tx: ComSignalType=UINT8
            DET_BI_STATIC_FLAG_145_oRDR_DETECTION_145_148_oPCAN_RADAR_dc95eb91_Tx: ComSignalType=BOOLEAN
            DET_BI_STATIC_FLAG_146_oRDR_DETECTION_145_148_oPCAN_RADAR_b875906f_Tx: ComSignalType=BOOLEAN
            DET_BI_STATIC_FLAG_147_oRDR_DETECTION_145_148_oPCAN_RADAR_2d0544fa_Tx: ComSignalType=BOOLEAN
            DET_BI_STATIC_FLAG_148_oRDR_DETECTION_145_148_oPCAN_RADAR_0115d6bd_Tx: ComSignalType=BOOLEAN
            DET_CONFD_AZIMUTH_145_oRDR_DETECTION_145_148_oPCAN_RADAR_885fa1de_Tx: ComSignalType=UINT8
            DET_CONFD_AZIMUTH_146_oRDR_DETECTION_145_148_oPCAN_RADAR_ecbfda20_Tx: ComSignalType=UINT8
            DET_CONFD_AZIMUTH_147_oRDR_DETECTION_145_148_oPCAN_RADAR_79cf0eb5_Tx: ComSignalType=UINT8
            DET_CONFD_AZIMUTH_148_oRDR_DETECTION_145_148_oPCAN_RADAR_55df9cf2_Tx: ComSignalType=UINT8
            DET_CONFD_ELEVATION_145_oRDR_DETECTION_145_148_oPCAN_RADAR_8acaa024_Tx: ComSignalType=UINT8
            DET_CONFD_ELEVATION_146_oRDR_DETECTION_145_148_oPCAN_RADAR_ee2adbda_Tx: ComSignalType=UINT8
            DET_CONFD_ELEVATION_147_oRDR_DETECTION_145_148_oPCAN_RADAR_7b5a0f4f_Tx: ComSignalType=UINT8
            DET_CONFD_ELEVATION_148_oRDR_DETECTION_145_148_oPCAN_RADAR_574a9d08_Tx: ComSignalType=UINT8
            DET_ELEVATION_145_oRDR_DETECTION_145_148_oPCAN_RADAR_5b0a7418_Tx: ComSignalType=UINT8
            DET_ELEVATION_146_oRDR_DETECTION_145_148_oPCAN_RADAR_3fea0fe6_Tx: ComSignalType=UINT8
            DET_ELEVATION_147_oRDR_DETECTION_145_148_oPCAN_RADAR_aa9adb73_Tx: ComSignalType=UINT8
            DET_ELEVATION_148_oRDR_DETECTION_145_148_oPCAN_RADAR_868a4934_Tx: ComSignalType=UINT8
            DET_ELEVATION_ERR_145_oRDR_DETECTION_145_148_oPCAN_RADAR_dc33ec6d_Tx: ComSignalType=UINT8
            DET_ELEVATION_ERR_146_oRDR_DETECTION_145_148_oPCAN_RADAR_b8d39793_Tx: ComSignalType=UINT8
            DET_ELEVATION_ERR_147_oRDR_DETECTION_145_148_oPCAN_RADAR_2da34306_Tx: ComSignalType=UINT8
            DET_ELEVATION_ERR_148_oRDR_DETECTION_145_148_oPCAN_RADAR_01b3d141_Tx: ComSignalType=UINT8
            DET_EXISTENCE_PROB_145_oRDR_DETECTION_145_148_oPCAN_RADAR_0eac990d_Tx: ComSignalType=UINT8
            DET_EXISTENCE_PROB_146_oRDR_DETECTION_145_148_oPCAN_RADAR_6a4ce2f3_Tx: ComSignalType=UINT8
            DET_EXISTENCE_PROB_147_oRDR_DETECTION_145_148_oPCAN_RADAR_ff3c3666_Tx: ComSignalType=UINT8
            DET_EXISTENCE_PROB_148_oRDR_DETECTION_145_148_oPCAN_RADAR_d32ca421_Tx: ComSignalType=UINT8
            DET_HVC_FLAG_145_oRDR_DETECTION_145_148_oPCAN_RADAR_efd8da72_Tx: ComSignalType=BOOLEAN
            DET_HVC_FLAG_146_oRDR_DETECTION_145_148_oPCAN_RADAR_8b38a18c_Tx: ComSignalType=BOOLEAN
            DET_HVC_FLAG_147_oRDR_DETECTION_145_148_oPCAN_RADAR_1e487519_Tx: ComSignalType=BOOLEAN
            DET_HVC_FLAG_148_oRDR_DETECTION_145_148_oPCAN_RADAR_3258e75e_Tx: ComSignalType=BOOLEAN
            DET_IDM_145_oRDR_DETECTION_145_148_oPCAN_RADAR_648ae1cf_Tx: ComSignalType=UINT8
            DET_IDM_146_oRDR_DETECTION_145_148_oPCAN_RADAR_006a9a31_Tx: ComSignalType=UINT8
            DET_IDM_147_oRDR_DETECTION_145_148_oPCAN_RADAR_951a4ea4_Tx: ComSignalType=UINT8
            DET_IDM_148_oRDR_DETECTION_145_148_oPCAN_RADAR_b90adce3_Tx: ComSignalType=UINT8
            DET_MH_CRC16_145_148_oRDR_DETECTION_145_148_oPCAN_RADAR_024011e4_Tx: ComSignalType=UINT16
            DET_MH_CYCLE_COUNTER_145_148_oRDR_DETECTION_145_148_oPCAN_RADAR_8635b0d3_Tx: ComSignalType=UINT8
            DET_MH_SCAN_INDEX_4LSB_145_148_oRDR_DETECTION_145_148_oPCAN_RADAR_4a1f955f_Tx: ComSignalType=UINT8
            DET_MTD_145_oRDR_DETECTION_145_148_oPCAN_RADAR_0239d314_Tx: ComSignalType=UINT8
            DET_MTD_146_oRDR_DETECTION_145_148_oPCAN_RADAR_66d9a8ea_Tx: ComSignalType=UINT8
            DET_MTD_147_oRDR_DETECTION_145_148_oPCAN_RADAR_f3a97c7f_Tx: ComSignalType=UINT8
            DET_MTD_148_oRDR_DETECTION_145_148_oPCAN_RADAR_dfb9ee38_Tx: ComSignalType=UINT8
            DET_PROB_1STAZHYPO_145_oRDR_DETECTION_145_148_oPCAN_RADAR_918d3bd9_Tx: ComSignalType=BOOLEAN
            DET_PROB_1STAZHYPO_146_oRDR_DETECTION_145_148_oPCAN_RADAR_f56d4027_Tx: ComSignalType=BOOLEAN
            DET_PROB_1STAZHYPO_147_oRDR_DETECTION_145_148_oPCAN_RADAR_601d94b2_Tx: ComSignalType=BOOLEAN
            DET_PROB_1STAZHYPO_148_oRDR_DETECTION_145_148_oPCAN_RADAR_4c0d06f5_Tx: ComSignalType=BOOLEAN
            DET_RANGE_145_oRDR_DETECTION_145_148_oPCAN_RADAR_9a22d8af_Tx: ComSignalType=UINT16
            DET_RANGE_146_oRDR_DETECTION_145_148_oPCAN_RADAR_fec2a351_Tx: ComSignalType=UINT16
            DET_RANGE_147_oRDR_DETECTION_145_148_oPCAN_RADAR_6bb277c4_Tx: ComSignalType=UINT16
            DET_RANGE_148_oRDR_DETECTION_145_148_oPCAN_RADAR_47a2e583_Tx: ComSignalType=UINT16
            DET_RANGE_ERR_145_oRDR_DETECTION_145_148_oPCAN_RADAR_3dca62c6_Tx: ComSignalType=UINT8
            DET_RANGE_ERR_146_oRDR_DETECTION_145_148_oPCAN_RADAR_592a1938_Tx: ComSignalType=UINT8
            DET_RANGE_ERR_147_oRDR_DETECTION_145_148_oPCAN_RADAR_cc5acdad_Tx: ComSignalType=UINT8
            DET_RANGE_ERR_148_oRDR_DETECTION_145_148_oPCAN_RADAR_e04a5fea_Tx: ComSignalType=UINT8
            DET_RANGE_VELOCITY_145_oRDR_DETECTION_145_148_oPCAN_RADAR_ef841a8a_Tx: ComSignalType=UINT16
            DET_RANGE_VELOCITY_146_oRDR_DETECTION_145_148_oPCAN_RADAR_8b646174_Tx: ComSignalType=UINT16
            DET_RANGE_VELOCITY_147_oRDR_DETECTION_145_148_oPCAN_RADAR_1e14b5e1_Tx: ComSignalType=UINT16
            DET_RANGE_VELOCITY_148_oRDR_DETECTION_145_148_oPCAN_RADAR_320427a6_Tx: ComSignalType=UINT16
            DET_RANGE_VELOCITY_ERR_145_oRDR_DETECTION_145_148_oPCAN_RADAR_e03fe138_Tx: ComSignalType=UINT8
            DET_RANGE_VELOCITY_ERR_146_oRDR_DETECTION_145_148_oPCAN_RADAR_84df9ac6_Tx: ComSignalType=UINT8
            DET_RANGE_VELOCITY_ERR_147_oRDR_DETECTION_145_148_oPCAN_RADAR_11af4e53_Tx: ComSignalType=UINT8
            DET_RANGE_VELOCITY_ERR_148_oRDR_DETECTION_145_148_oPCAN_RADAR_3dbfdc14_Tx: ComSignalType=UINT8
            DET_RCS_145_oRDR_DETECTION_145_148_oPCAN_RADAR_68042dd0_Tx: ComSignalType=UINT8
            DET_RCS_146_oRDR_DETECTION_145_148_oPCAN_RADAR_0ce4562e_Tx: ComSignalType=UINT8
            DET_RCS_147_oRDR_DETECTION_145_148_oPCAN_RADAR_999482bb_Tx: ComSignalType=UINT8
            DET_RCS_148_oRDR_DETECTION_145_148_oPCAN_RADAR_b58410fc_Tx: ComSignalType=UINT8
            DET_SNR_145_oRDR_DETECTION_145_148_oPCAN_RADAR_b5aa79d2_Tx: ComSignalType=UINT8
            DET_SNR_146_oRDR_DETECTION_145_148_oPCAN_RADAR_d14a022c_Tx: ComSignalType=UINT8
            DET_SNR_147_oRDR_DETECTION_145_148_oPCAN_RADAR_443ad6b9_Tx: ComSignalType=UINT8
            DET_SNR_148_oRDR_DETECTION_145_148_oPCAN_RADAR_682a44fe_Tx: ComSignalType=UINT8
            DET_SUPER_RES_TARGET_145_oRDR_DETECTION_145_148_oPCAN_RADAR_843351b7_Tx: ComSignalType=BOOLEAN
            DET_SUPER_RES_TARGET_146_oRDR_DETECTION_145_148_oPCAN_RADAR_e0d32a49_Tx: ComSignalType=BOOLEAN
            DET_SUPER_RES_TARGET_147_oRDR_DETECTION_145_148_oPCAN_RADAR_75a3fedc_Tx: ComSignalType=BOOLEAN
            DET_SUPER_RES_TARGET_148_oRDR_DETECTION_145_148_oPCAN_RADAR_59b36c9b_Tx: ComSignalType=BOOLEAN
        SG_Detections_149_152_oRDR_DETECTION_149_152_oPCAN_RADAR_1fb2e794_Tx
          83 x ComGroupSignal:
            DET_AZIMUTH_149_oRDR_DETECTION_149_152_oPCAN_RADAR_f001adac_Tx: ComSignalType=UINT16
            DET_AZIMUTH_150_oRDR_DETECTION_149_152_oPCAN_RADAR_9521df08_Tx: ComSignalType=UINT16
            DET_AZIMUTH_151_oRDR_DETECTION_149_152_oPCAN_RADAR_00510b9d_Tx: ComSignalType=UINT16
            DET_AZIMUTH_152_oRDR_DETECTION_149_152_oPCAN_RADAR_64b17063_Tx: ComSignalType=UINT16
            DET_AZIMUTH_ERR_149_oRDR_DETECTION_149_152_oPCAN_RADAR_54b43859_Tx: ComSignalType=UINT8
            DET_AZIMUTH_ERR_150_oRDR_DETECTION_149_152_oPCAN_RADAR_31944afd_Tx: ComSignalType=UINT8
            DET_AZIMUTH_ERR_151_oRDR_DETECTION_149_152_oPCAN_RADAR_a4e49e68_Tx: ComSignalType=UINT8
            DET_AZIMUTH_ERR_152_oRDR_DETECTION_149_152_oPCAN_RADAR_c004e596_Tx: ComSignalType=UINT8
            DET_BELOW_RAIN_THOLD_149_oRDR_DETECTION_149_152_oPCAN_RADAR_25003e6c_Tx: ComSignalType=UINT8
            DET_BELOW_RAIN_THOLD_150_oRDR_DETECTION_149_152_oPCAN_RADAR_40204cc8_Tx: ComSignalType=UINT8
            DET_BELOW_RAIN_THOLD_151_oRDR_DETECTION_149_152_oPCAN_RADAR_d550985d_Tx: ComSignalType=UINT8
            DET_BELOW_RAIN_THOLD_152_oRDR_DETECTION_149_152_oPCAN_RADAR_b1b0e3a3_Tx: ComSignalType=UINT8
            DET_BI_STATIC_FLAG_149_oRDR_DETECTION_149_152_oPCAN_RADAR_a62ded29_Tx: ComSignalType=BOOLEAN
            DET_BI_STATIC_FLAG_150_oRDR_DETECTION_149_152_oPCAN_RADAR_c30d9f8d_Tx: ComSignalType=BOOLEAN
            DET_BI_STATIC_FLAG_151_oRDR_DETECTION_149_152_oPCAN_RADAR_567d4b18_Tx: ComSignalType=BOOLEAN
            DET_BI_STATIC_FLAG_152_oRDR_DETECTION_149_152_oPCAN_RADAR_329d30e6_Tx: ComSignalType=BOOLEAN
            DET_CONFD_AZIMUTH_149_oRDR_DETECTION_149_152_oPCAN_RADAR_f2e7a766_Tx: ComSignalType=UINT8
            DET_CONFD_AZIMUTH_150_oRDR_DETECTION_149_152_oPCAN_RADAR_97c7d5c2_Tx: ComSignalType=UINT8
            DET_CONFD_AZIMUTH_151_oRDR_DETECTION_149_152_oPCAN_RADAR_02b70157_Tx: ComSignalType=UINT8
            DET_CONFD_AZIMUTH_152_oRDR_DETECTION_149_152_oPCAN_RADAR_66577aa9_Tx: ComSignalType=UINT8
            DET_CONFD_ELEVATION_149_oRDR_DETECTION_149_152_oPCAN_RADAR_f072a69c_Tx: ComSignalType=UINT8
            DET_CONFD_ELEVATION_150_oRDR_DETECTION_149_152_oPCAN_RADAR_9552d438_Tx: ComSignalType=UINT8
            DET_CONFD_ELEVATION_151_oRDR_DETECTION_149_152_oPCAN_RADAR_002200ad_Tx: ComSignalType=UINT8
            DET_CONFD_ELEVATION_152_oRDR_DETECTION_149_152_oPCAN_RADAR_64c27b53_Tx: ComSignalType=UINT8
            DET_ELEVATION_149_oRDR_DETECTION_149_152_oPCAN_RADAR_21b272a0_Tx: ComSignalType=UINT8
            DET_ELEVATION_150_oRDR_DETECTION_149_152_oPCAN_RADAR_44920004_Tx: ComSignalType=UINT8
            DET_ELEVATION_151_oRDR_DETECTION_149_152_oPCAN_RADAR_d1e2d491_Tx: ComSignalType=UINT8
            DET_ELEVATION_152_oRDR_DETECTION_149_152_oPCAN_RADAR_b502af6f_Tx: ComSignalType=UINT8
            DET_ELEVATION_ERR_149_oRDR_DETECTION_149_152_oPCAN_RADAR_a68bead5_Tx: ComSignalType=UINT8
            DET_ELEVATION_ERR_150_oRDR_DETECTION_149_152_oPCAN_RADAR_c3ab9871_Tx: ComSignalType=UINT8
            DET_ELEVATION_ERR_151_oRDR_DETECTION_149_152_oPCAN_RADAR_56db4ce4_Tx: ComSignalType=UINT8
            DET_ELEVATION_ERR_152_oRDR_DETECTION_149_152_oPCAN_RADAR_323b371a_Tx: ComSignalType=UINT8
            DET_EXISTENCE_PROB_149_oRDR_DETECTION_149_152_oPCAN_RADAR_74149fb5_Tx: ComSignalType=UINT8
            DET_EXISTENCE_PROB_150_oRDR_DETECTION_149_152_oPCAN_RADAR_1134ed11_Tx: ComSignalType=UINT8
            DET_EXISTENCE_PROB_151_oRDR_DETECTION_149_152_oPCAN_RADAR_84443984_Tx: ComSignalType=UINT8
            DET_EXISTENCE_PROB_152_oRDR_DETECTION_149_152_oPCAN_RADAR_e0a4427a_Tx: ComSignalType=UINT8
            DET_HVC_FLAG_149_oRDR_DETECTION_149_152_oPCAN_RADAR_9560dcca_Tx: ComSignalType=BOOLEAN
            DET_HVC_FLAG_150_oRDR_DETECTION_149_152_oPCAN_RADAR_f040ae6e_Tx: ComSignalType=BOOLEAN
            DET_HVC_FLAG_151_oRDR_DETECTION_149_152_oPCAN_RADAR_65307afb_Tx: ComSignalType=BOOLEAN
            DET_HVC_FLAG_152_oRDR_DETECTION_149_152_oPCAN_RADAR_01d00105_Tx: ComSignalType=BOOLEAN
            DET_IDM_149_oRDR_DETECTION_149_152_oPCAN_RADAR_1e32e777_Tx: ComSignalType=UINT8
            DET_IDM_150_oRDR_DETECTION_149_152_oPCAN_RADAR_7b1295d3_Tx: ComSignalType=UINT8
            DET_IDM_151_oRDR_DETECTION_149_152_oPCAN_RADAR_ee624146_Tx: ComSignalType=UINT8
            DET_IDM_152_oRDR_DETECTION_149_152_oPCAN_RADAR_8a823ab8_Tx: ComSignalType=UINT8
            DET_MH_CRC16_149_152_oRDR_DETECTION_149_152_oPCAN_RADAR_9b3a359f_Tx: ComSignalType=UINT16
            DET_MH_CYCLE_COUNTER_149_152_oRDR_DETECTION_149_152_oPCAN_RADAR_1f4f94a8_Tx: ComSignalType=UINT8
            DET_MH_SCAN_INDEX_4LSB_149_152_oRDR_DETECTION_149_152_oPCAN_RADAR_d365b124_Tx: ComSignalType=UINT8
            DET_MTD_149_oRDR_DETECTION_149_152_oPCAN_RADAR_7881d5ac_Tx: ComSignalType=UINT8
            DET_MTD_150_oRDR_DETECTION_149_152_oPCAN_RADAR_1da1a708_Tx: ComSignalType=UINT8
            DET_MTD_151_oRDR_DETECTION_149_152_oPCAN_RADAR_88d1739d_Tx: ComSignalType=UINT8
            DET_MTD_152_oRDR_DETECTION_149_152_oPCAN_RADAR_ec310863_Tx: ComSignalType=UINT8
            DET_PROB_1STAZHYPO_149_oRDR_DETECTION_149_152_oPCAN_RADAR_eb353d61_Tx: ComSignalType=BOOLEAN
            DET_PROB_1STAZHYPO_150_oRDR_DETECTION_149_152_oPCAN_RADAR_8e154fc5_Tx: ComSignalType=BOOLEAN
            DET_PROB_1STAZHYPO_151_oRDR_DETECTION_149_152_oPCAN_RADAR_1b659b50_Tx: ComSignalType=BOOLEAN
            DET_PROB_1STAZHYPO_152_oRDR_DETECTION_149_152_oPCAN_RADAR_7f85e0ae_Tx: ComSignalType=BOOLEAN
            DET_RANGE_149_oRDR_DETECTION_149_152_oPCAN_RADAR_e09ade17_Tx: ComSignalType=UINT16
            DET_RANGE_150_oRDR_DETECTION_149_152_oPCAN_RADAR_85baacb3_Tx: ComSignalType=UINT16
            DET_RANGE_151_oRDR_DETECTION_149_152_oPCAN_RADAR_10ca7826_Tx: ComSignalType=UINT16
            DET_RANGE_152_oRDR_DETECTION_149_152_oPCAN_RADAR_742a03d8_Tx: ComSignalType=UINT16
            DET_RANGE_ERR_149_oRDR_DETECTION_149_152_oPCAN_RADAR_4772647e_Tx: ComSignalType=UINT8
            DET_RANGE_ERR_150_oRDR_DETECTION_149_152_oPCAN_RADAR_225216da_Tx: ComSignalType=UINT8
            DET_RANGE_ERR_151_oRDR_DETECTION_149_152_oPCAN_RADAR_b722c24f_Tx: ComSignalType=UINT8
            DET_RANGE_ERR_152_oRDR_DETECTION_149_152_oPCAN_RADAR_d3c2b9b1_Tx: ComSignalType=UINT8
            DET_RANGE_VELOCITY_149_oRDR_DETECTION_149_152_oPCAN_RADAR_953c1c32_Tx: ComSignalType=UINT16
            DET_RANGE_VELOCITY_150_oRDR_DETECTION_149_152_oPCAN_RADAR_f01c6e96_Tx: ComSignalType=UINT16
            DET_RANGE_VELOCITY_151_oRDR_DETECTION_149_152_oPCAN_RADAR_656cba03_Tx: ComSignalType=UINT16
            DET_RANGE_VELOCITY_152_oRDR_DETECTION_149_152_oPCAN_RADAR_018cc1fd_Tx: ComSignalType=UINT16
            DET_RANGE_VELOCITY_ERR_149_oRDR_DETECTION_149_152_oPCAN_RADAR_9a87e780_Tx: ComSignalType=UINT8
            DET_RANGE_VELOCITY_ERR_150_oRDR_DETECTION_149_152_oPCAN_RADAR_ffa79524_Tx: ComSignalType=UINT8
            DET_RANGE_VELOCITY_ERR_151_oRDR_DETECTION_149_152_oPCAN_RADAR_6ad741b1_Tx: ComSignalType=UINT8
            DET_RANGE_VELOCITY_ERR_152_oRDR_DETECTION_149_152_oPCAN_RADAR_0e373a4f_Tx: ComSignalType=UINT8
            DET_RCS_149_oRDR_DETECTION_149_152_oPCAN_RADAR_12bc2b68_Tx: ComSignalType=UINT8
            DET_RCS_150_oRDR_DETECTION_149_152_oPCAN_RADAR_779c59cc_Tx: ComSignalType=UINT8
            DET_RCS_151_oRDR_DETECTION_149_152_oPCAN_RADAR_e2ec8d59_Tx: ComSignalType=UINT8
            DET_RCS_152_oRDR_DETECTION_149_152_oPCAN_RADAR_860cf6a7_Tx: ComSignalType=UINT8
            DET_SNR_149_oRDR_DETECTION_149_152_oPCAN_RADAR_cf127f6a_Tx: ComSignalType=UINT8
            DET_SNR_150_oRDR_DETECTION_149_152_oPCAN_RADAR_aa320dce_Tx: ComSignalType=UINT8
            DET_SNR_151_oRDR_DETECTION_149_152_oPCAN_RADAR_3f42d95b_Tx: ComSignalType=UINT8
            DET_SNR_152_oRDR_DETECTION_149_152_oPCAN_RADAR_5ba2a2a5_Tx: ComSignalType=UINT8
            DET_SUPER_RES_TARGET_149_oRDR_DETECTION_149_152_oPCAN_RADAR_fe8b570f_Tx: ComSignalType=BOOLEAN
            DET_SUPER_RES_TARGET_150_oRDR_DETECTION_149_152_oPCAN_RADAR_9bab25ab_Tx: ComSignalType=BOOLEAN
            DET_SUPER_RES_TARGET_151_oRDR_DETECTION_149_152_oPCAN_RADAR_0edbf13e_Tx: ComSignalType=BOOLEAN
            DET_SUPER_RES_TARGET_152_oRDR_DETECTION_149_152_oPCAN_RADAR_6a3b8ac0_Tx: ComSignalType=BOOLEAN
        SG_Detections_153_156_oRDR_DETECTION_153_156_oPCAN_RADAR_2db98fbc_Tx
          83 x ComGroupSignal:
            DET_AZIMUTH_153_oRDR_DETECTION_153_156_oPCAN_RADAR_ec06a7d8_Tx: ComSignalType=UINT16
            DET_AZIMUTH_154_oRDR_DETECTION_153_156_oPCAN_RADAR_b0b684b1_Tx: ComSignalType=UINT16
            DET_AZIMUTH_155_oRDR_DETECTION_153_156_oPCAN_RADAR_25c65024_Tx: ComSignalType=UINT16
            DET_AZIMUTH_156_oRDR_DETECTION_153_156_oPCAN_RADAR_41262bda_Tx: ComSignalType=UINT16
            DET_AZIMUTH_ERR_153_oRDR_DETECTION_153_156_oPCAN_RADAR_48b3322d_Tx: ComSignalType=UINT8
            DET_AZIMUTH_ERR_154_oRDR_DETECTION_153_156_oPCAN_RADAR_14031144_Tx: ComSignalType=UINT8
            DET_AZIMUTH_ERR_155_oRDR_DETECTION_153_156_oPCAN_RADAR_8173c5d1_Tx: ComSignalType=UINT8
            DET_AZIMUTH_ERR_156_oRDR_DETECTION_153_156_oPCAN_RADAR_e593be2f_Tx: ComSignalType=UINT8
            DET_BELOW_RAIN_THOLD_153_oRDR_DETECTION_153_156_oPCAN_RADAR_39073418_Tx: ComSignalType=UINT8
            DET_BELOW_RAIN_THOLD_154_oRDR_DETECTION_153_156_oPCAN_RADAR_65b71771_Tx: ComSignalType=UINT8
            DET_BELOW_RAIN_THOLD_155_oRDR_DETECTION_153_156_oPCAN_RADAR_f0c7c3e4_Tx: ComSignalType=UINT8
            DET_BELOW_RAIN_THOLD_156_oRDR_DETECTION_153_156_oPCAN_RADAR_9427b81a_Tx: ComSignalType=UINT8
            DET_BI_STATIC_FLAG_153_oRDR_DETECTION_153_156_oPCAN_RADAR_ba2ae75d_Tx: ComSignalType=BOOLEAN
            DET_BI_STATIC_FLAG_154_oRDR_DETECTION_153_156_oPCAN_RADAR_e69ac434_Tx: ComSignalType=BOOLEAN
            DET_BI_STATIC_FLAG_155_oRDR_DETECTION_153_156_oPCAN_RADAR_73ea10a1_Tx: ComSignalType=BOOLEAN
            DET_BI_STATIC_FLAG_156_oRDR_DETECTION_153_156_oPCAN_RADAR_170a6b5f_Tx: ComSignalType=BOOLEAN
            DET_CONFD_AZIMUTH_153_oRDR_DETECTION_153_156_oPCAN_RADAR_eee0ad12_Tx: ComSignalType=UINT8
            DET_CONFD_AZIMUTH_154_oRDR_DETECTION_153_156_oPCAN_RADAR_b2508e7b_Tx: ComSignalType=UINT8
            DET_CONFD_AZIMUTH_155_oRDR_DETECTION_153_156_oPCAN_RADAR_27205aee_Tx: ComSignalType=UINT8
            DET_CONFD_AZIMUTH_156_oRDR_DETECTION_153_156_oPCAN_RADAR_43c02110_Tx: ComSignalType=UINT8
            DET_CONFD_ELEVATION_153_oRDR_DETECTION_153_156_oPCAN_RADAR_ec75ace8_Tx: ComSignalType=UINT8
            DET_CONFD_ELEVATION_154_oRDR_DETECTION_153_156_oPCAN_RADAR_b0c58f81_Tx: ComSignalType=UINT8
            DET_CONFD_ELEVATION_155_oRDR_DETECTION_153_156_oPCAN_RADAR_25b55b14_Tx: ComSignalType=UINT8
            DET_CONFD_ELEVATION_156_oRDR_DETECTION_153_156_oPCAN_RADAR_415520ea_Tx: ComSignalType=UINT8
            DET_ELEVATION_153_oRDR_DETECTION_153_156_oPCAN_RADAR_3db578d4_Tx: ComSignalType=UINT8
            DET_ELEVATION_154_oRDR_DETECTION_153_156_oPCAN_RADAR_61055bbd_Tx: ComSignalType=UINT8
            DET_ELEVATION_155_oRDR_DETECTION_153_156_oPCAN_RADAR_f4758f28_Tx: ComSignalType=UINT8
            DET_ELEVATION_156_oRDR_DETECTION_153_156_oPCAN_RADAR_9095f4d6_Tx: ComSignalType=UINT8
            DET_ELEVATION_ERR_153_oRDR_DETECTION_153_156_oPCAN_RADAR_ba8ce0a1_Tx: ComSignalType=UINT8
            DET_ELEVATION_ERR_154_oRDR_DETECTION_153_156_oPCAN_RADAR_e63cc3c8_Tx: ComSignalType=UINT8
            DET_ELEVATION_ERR_155_oRDR_DETECTION_153_156_oPCAN_RADAR_734c175d_Tx: ComSignalType=UINT8
            DET_ELEVATION_ERR_156_oRDR_DETECTION_153_156_oPCAN_RADAR_17ac6ca3_Tx: ComSignalType=UINT8
            DET_EXISTENCE_PROB_153_oRDR_DETECTION_153_156_oPCAN_RADAR_681395c1_Tx: ComSignalType=UINT8
            DET_EXISTENCE_PROB_154_oRDR_DETECTION_153_156_oPCAN_RADAR_34a3b6a8_Tx: ComSignalType=UINT8
            DET_EXISTENCE_PROB_155_oRDR_DETECTION_153_156_oPCAN_RADAR_a1d3623d_Tx: ComSignalType=UINT8
            DET_EXISTENCE_PROB_156_oRDR_DETECTION_153_156_oPCAN_RADAR_c53319c3_Tx: ComSignalType=UINT8
            DET_HVC_FLAG_153_oRDR_DETECTION_153_156_oPCAN_RADAR_8967d6be_Tx: ComSignalType=BOOLEAN
            DET_HVC_FLAG_154_oRDR_DETECTION_153_156_oPCAN_RADAR_d5d7f5d7_Tx: ComSignalType=BOOLEAN
            DET_HVC_FLAG_155_oRDR_DETECTION_153_156_oPCAN_RADAR_40a72142_Tx: ComSignalType=BOOLEAN
            DET_HVC_FLAG_156_oRDR_DETECTION_153_156_oPCAN_RADAR_24475abc_Tx: ComSignalType=BOOLEAN
            DET_IDM_153_oRDR_DETECTION_153_156_oPCAN_RADAR_0235ed03_Tx: ComSignalType=UINT8
            DET_IDM_154_oRDR_DETECTION_153_156_oPCAN_RADAR_5e85ce6a_Tx: ComSignalType=UINT8
            DET_IDM_155_oRDR_DETECTION_153_156_oPCAN_RADAR_cbf51aff_Tx: ComSignalType=UINT8
            DET_IDM_156_oRDR_DETECTION_153_156_oPCAN_RADAR_af156101_Tx: ComSignalType=UINT8
            DET_MH_CRC16_153_156_oRDR_DETECTION_153_156_oPCAN_RADAR_a9315db7_Tx: ComSignalType=UINT16
            DET_MH_CYCLE_COUNTER_153_156_oRDR_DETECTION_153_156_oPCAN_RADAR_2d44fc80_Tx: ComSignalType=UINT8
            DET_MH_SCAN_INDEX_4LSB_153_156_oRDR_DETECTION_153_156_oPCAN_RADAR_e16ed90c_Tx: ComSignalType=UINT8
            DET_MTD_153_oRDR_DETECTION_153_156_oPCAN_RADAR_6486dfd8_Tx: ComSignalType=UINT8
            DET_MTD_154_oRDR_DETECTION_153_156_oPCAN_RADAR_3836fcb1_Tx: ComSignalType=UINT8
            DET_MTD_155_oRDR_DETECTION_153_156_oPCAN_RADAR_ad462824_Tx: ComSignalType=UINT8
            DET_MTD_156_oRDR_DETECTION_153_156_oPCAN_RADAR_c9a653da_Tx: ComSignalType=UINT8
            DET_PROB_1STAZHYPO_153_oRDR_DETECTION_153_156_oPCAN_RADAR_f7323715_Tx: ComSignalType=BOOLEAN
            DET_PROB_1STAZHYPO_154_oRDR_DETECTION_153_156_oPCAN_RADAR_ab82147c_Tx: ComSignalType=BOOLEAN
            DET_PROB_1STAZHYPO_155_oRDR_DETECTION_153_156_oPCAN_RADAR_3ef2c0e9_Tx: ComSignalType=BOOLEAN
            DET_PROB_1STAZHYPO_156_oRDR_DETECTION_153_156_oPCAN_RADAR_5a12bb17_Tx: ComSignalType=BOOLEAN
            DET_RANGE_153_oRDR_DETECTION_153_156_oPCAN_RADAR_fc9dd463_Tx: ComSignalType=UINT16
            DET_RANGE_154_oRDR_DETECTION_153_156_oPCAN_RADAR_a02df70a_Tx: ComSignalType=UINT16
            DET_RANGE_155_oRDR_DETECTION_153_156_oPCAN_RADAR_355d239f_Tx: ComSignalType=UINT16
            DET_RANGE_156_oRDR_DETECTION_153_156_oPCAN_RADAR_51bd5861_Tx: ComSignalType=UINT16
            DET_RANGE_ERR_153_oRDR_DETECTION_153_156_oPCAN_RADAR_5b756e0a_Tx: ComSignalType=UINT8
            DET_RANGE_ERR_154_oRDR_DETECTION_153_156_oPCAN_RADAR_07c54d63_Tx: ComSignalType=UINT8
            DET_RANGE_ERR_155_oRDR_DETECTION_153_156_oPCAN_RADAR_92b599f6_Tx: ComSignalType=UINT8
            DET_RANGE_ERR_156_oRDR_DETECTION_153_156_oPCAN_RADAR_f655e208_Tx: ComSignalType=UINT8
            DET_RANGE_VELOCITY_153_oRDR_DETECTION_153_156_oPCAN_RADAR_893b1646_Tx: ComSignalType=UINT16
            DET_RANGE_VELOCITY_154_oRDR_DETECTION_153_156_oPCAN_RADAR_d58b352f_Tx: ComSignalType=UINT16
            DET_RANGE_VELOCITY_155_oRDR_DETECTION_153_156_oPCAN_RADAR_40fbe1ba_Tx: ComSignalType=UINT16
            DET_RANGE_VELOCITY_156_oRDR_DETECTION_153_156_oPCAN_RADAR_241b9a44_Tx: ComSignalType=UINT16
            DET_RANGE_VELOCITY_ERR_153_oRDR_DETECTION_153_156_oPCAN_RADAR_8680edf4_Tx: ComSignalType=UINT8
            DET_RANGE_VELOCITY_ERR_154_oRDR_DETECTION_153_156_oPCAN_RADAR_da30ce9d_Tx: ComSignalType=UINT8
            DET_RANGE_VELOCITY_ERR_155_oRDR_DETECTION_153_156_oPCAN_RADAR_4f401a08_Tx: ComSignalType=UINT8
            DET_RANGE_VELOCITY_ERR_156_oRDR_DETECTION_153_156_oPCAN_RADAR_2ba061f6_Tx: ComSignalType=UINT8
            DET_RCS_153_oRDR_DETECTION_153_156_oPCAN_RADAR_0ebb211c_Tx: ComSignalType=UINT8
            DET_RCS_154_oRDR_DETECTION_153_156_oPCAN_RADAR_520b0275_Tx: ComSignalType=UINT8
            DET_RCS_155_oRDR_DETECTION_153_156_oPCAN_RADAR_c77bd6e0_Tx: ComSignalType=UINT8
            DET_RCS_156_oRDR_DETECTION_153_156_oPCAN_RADAR_a39bad1e_Tx: ComSignalType=UINT8
            DET_SNR_153_oRDR_DETECTION_153_156_oPCAN_RADAR_d315751e_Tx: ComSignalType=UINT8
            DET_SNR_154_oRDR_DETECTION_153_156_oPCAN_RADAR_8fa55677_Tx: ComSignalType=UINT8
            DET_SNR_155_oRDR_DETECTION_153_156_oPCAN_RADAR_1ad582e2_Tx: ComSignalType=UINT8
            DET_SNR_156_oRDR_DETECTION_153_156_oPCAN_RADAR_7e35f91c_Tx: ComSignalType=UINT8
            DET_SUPER_RES_TARGET_153_oRDR_DETECTION_153_156_oPCAN_RADAR_e28c5d7b_Tx: ComSignalType=BOOLEAN
            DET_SUPER_RES_TARGET_154_oRDR_DETECTION_153_156_oPCAN_RADAR_be3c7e12_Tx: ComSignalType=BOOLEAN
            DET_SUPER_RES_TARGET_155_oRDR_DETECTION_153_156_oPCAN_RADAR_2b4caa87_Tx: ComSignalType=BOOLEAN
            DET_SUPER_RES_TARGET_156_oRDR_DETECTION_153_156_oPCAN_RADAR_4facd179_Tx: ComSignalType=BOOLEAN
        SG_Detections_157_160_oRDR_DETECTION_157_160_oPCAN_RADAR_c115d936_Tx
          83 x ComGroupSignal:
            DET_AZIMUTH_157_oRDR_DETECTION_157_160_oPCAN_RADAR_7bda2286_Tx: ComSignalType=UINT16
            DET_AZIMUTH_158_oRDR_DETECTION_157_160_oPCAN_RADAR_57cab0c1_Tx: ComSignalType=UINT16
            DET_AZIMUTH_159_oRDR_DETECTION_157_160_oPCAN_RADAR_c2ba6454_Tx: ComSignalType=UINT16
            DET_AZIMUTH_160_oRDR_DETECTION_157_160_oPCAN_RADAR_7d0b3e8f_Tx: ComSignalType=UINT16
            DET_AZIMUTH_ERR_157_oRDR_DETECTION_157_160_oPCAN_RADAR_df6fb773_Tx: ComSignalType=UINT8
            DET_AZIMUTH_ERR_158_oRDR_DETECTION_157_160_oPCAN_RADAR_f37f2534_Tx: ComSignalType=UINT8
            DET_AZIMUTH_ERR_159_oRDR_DETECTION_157_160_oPCAN_RADAR_660ff1a1_Tx: ComSignalType=UINT8
            DET_AZIMUTH_ERR_160_oRDR_DETECTION_157_160_oPCAN_RADAR_d9beab7a_Tx: ComSignalType=UINT8
            DET_BELOW_RAIN_THOLD_157_oRDR_DETECTION_157_160_oPCAN_RADAR_aedbb146_Tx: ComSignalType=UINT8
            DET_BELOW_RAIN_THOLD_158_oRDR_DETECTION_157_160_oPCAN_RADAR_82cb2301_Tx: ComSignalType=UINT8
            DET_BELOW_RAIN_THOLD_159_oRDR_DETECTION_157_160_oPCAN_RADAR_17bbf794_Tx: ComSignalType=UINT8
            DET_BELOW_RAIN_THOLD_160_oRDR_DETECTION_157_160_oPCAN_RADAR_a80aad4f_Tx: ComSignalType=UINT8
            DET_BI_STATIC_FLAG_157_oRDR_DETECTION_157_160_oPCAN_RADAR_2df66203_Tx: ComSignalType=BOOLEAN
            DET_BI_STATIC_FLAG_158_oRDR_DETECTION_157_160_oPCAN_RADAR_01e6f044_Tx: ComSignalType=BOOLEAN
            DET_BI_STATIC_FLAG_159_oRDR_DETECTION_157_160_oPCAN_RADAR_949624d1_Tx: ComSignalType=BOOLEAN
            DET_BI_STATIC_FLAG_160_oRDR_DETECTION_157_160_oPCAN_RADAR_2b277e0a_Tx: ComSignalType=BOOLEAN
            DET_CONFD_AZIMUTH_157_oRDR_DETECTION_157_160_oPCAN_RADAR_793c284c_Tx: ComSignalType=UINT8
            DET_CONFD_AZIMUTH_158_oRDR_DETECTION_157_160_oPCAN_RADAR_552cba0b_Tx: ComSignalType=UINT8
            DET_CONFD_AZIMUTH_159_oRDR_DETECTION_157_160_oPCAN_RADAR_c05c6e9e_Tx: ComSignalType=UINT8
            DET_CONFD_AZIMUTH_160_oRDR_DETECTION_157_160_oPCAN_RADAR_7fed3445_Tx: ComSignalType=UINT8
            DET_CONFD_ELEVATION_157_oRDR_DETECTION_157_160_oPCAN_RADAR_7ba929b6_Tx: ComSignalType=UINT8
            DET_CONFD_ELEVATION_158_oRDR_DETECTION_157_160_oPCAN_RADAR_57b9bbf1_Tx: ComSignalType=UINT8
            DET_CONFD_ELEVATION_159_oRDR_DETECTION_157_160_oPCAN_RADAR_c2c96f64_Tx: ComSignalType=UINT8
            DET_CONFD_ELEVATION_160_oRDR_DETECTION_157_160_oPCAN_RADAR_7d7835bf_Tx: ComSignalType=UINT8
            DET_ELEVATION_157_oRDR_DETECTION_157_160_oPCAN_RADAR_aa69fd8a_Tx: ComSignalType=UINT8
            DET_ELEVATION_158_oRDR_DETECTION_157_160_oPCAN_RADAR_86796fcd_Tx: ComSignalType=UINT8
            DET_ELEVATION_159_oRDR_DETECTION_157_160_oPCAN_RADAR_1309bb58_Tx: ComSignalType=UINT8
            DET_ELEVATION_160_oRDR_DETECTION_157_160_oPCAN_RADAR_acb8e183_Tx: ComSignalType=UINT8
            DET_ELEVATION_ERR_157_oRDR_DETECTION_157_160_oPCAN_RADAR_2d5065ff_Tx: ComSignalType=UINT8
            DET_ELEVATION_ERR_158_oRDR_DETECTION_157_160_oPCAN_RADAR_0140f7b8_Tx: ComSignalType=UINT8
            DET_ELEVATION_ERR_159_oRDR_DETECTION_157_160_oPCAN_RADAR_9430232d_Tx: ComSignalType=UINT8
            DET_ELEVATION_ERR_160_oRDR_DETECTION_157_160_oPCAN_RADAR_2b8179f6_Tx: ComSignalType=UINT8
            DET_EXISTENCE_PROB_157_oRDR_DETECTION_157_160_oPCAN_RADAR_ffcf109f_Tx: ComSignalType=UINT8
            DET_EXISTENCE_PROB_158_oRDR_DETECTION_157_160_oPCAN_RADAR_d3df82d8_Tx: ComSignalType=UINT8
            DET_EXISTENCE_PROB_159_oRDR_DETECTION_157_160_oPCAN_RADAR_46af564d_Tx: ComSignalType=UINT8
            DET_EXISTENCE_PROB_160_oRDR_DETECTION_157_160_oPCAN_RADAR_f91e0c96_Tx: ComSignalType=UINT8
            DET_HVC_FLAG_157_oRDR_DETECTION_157_160_oPCAN_RADAR_1ebb53e0_Tx: ComSignalType=BOOLEAN
            DET_HVC_FLAG_158_oRDR_DETECTION_157_160_oPCAN_RADAR_32abc1a7_Tx: ComSignalType=BOOLEAN
            DET_HVC_FLAG_159_oRDR_DETECTION_157_160_oPCAN_RADAR_a7db1532_Tx: ComSignalType=BOOLEAN
            DET_HVC_FLAG_160_oRDR_DETECTION_157_160_oPCAN_RADAR_186a4fe9_Tx: ComSignalType=BOOLEAN
            DET_IDM_157_oRDR_DETECTION_157_160_oPCAN_RADAR_95e9685d_Tx: ComSignalType=UINT8
            DET_IDM_158_oRDR_DETECTION_157_160_oPCAN_RADAR_b9f9fa1a_Tx: ComSignalType=UINT8
            DET_IDM_159_oRDR_DETECTION_157_160_oPCAN_RADAR_2c892e8f_Tx: ComSignalType=UINT8
            DET_IDM_160_oRDR_DETECTION_157_160_oPCAN_RADAR_93387454_Tx: ComSignalType=UINT8
            DET_MH_CRC16_157_160_oRDR_DETECTION_157_160_oPCAN_RADAR_459d0b3d_Tx: ComSignalType=UINT16
            DET_MH_CYCLE_COUNTER_157_160_oRDR_DETECTION_157_160_oPCAN_RADAR_c1e8aa0a_Tx: ComSignalType=UINT8
            DET_MH_SCAN_INDEX_4LSB_157_160_oRDR_DETECTION_157_160_oPCAN_RADAR_0dc28f86_Tx: ComSignalType=UINT8
            DET_MTD_157_oRDR_DETECTION_157_160_oPCAN_RADAR_f35a5a86_Tx: ComSignalType=UINT8
            DET_MTD_158_oRDR_DETECTION_157_160_oPCAN_RADAR_df4ac8c1_Tx: ComSignalType=UINT8
            DET_MTD_159_oRDR_DETECTION_157_160_oPCAN_RADAR_4a3a1c54_Tx: ComSignalType=UINT8
            DET_MTD_160_oRDR_DETECTION_157_160_oPCAN_RADAR_f58b468f_Tx: ComSignalType=UINT8
            DET_PROB_1STAZHYPO_157_oRDR_DETECTION_157_160_oPCAN_RADAR_60eeb24b_Tx: ComSignalType=BOOLEAN
            DET_PROB_1STAZHYPO_158_oRDR_DETECTION_157_160_oPCAN_RADAR_4cfe200c_Tx: ComSignalType=BOOLEAN
            DET_PROB_1STAZHYPO_159_oRDR_DETECTION_157_160_oPCAN_RADAR_d98ef499_Tx: ComSignalType=BOOLEAN
            DET_PROB_1STAZHYPO_160_oRDR_DETECTION_157_160_oPCAN_RADAR_663fae42_Tx: ComSignalType=BOOLEAN
            DET_RANGE_157_oRDR_DETECTION_157_160_oPCAN_RADAR_6b41513d_Tx: ComSignalType=UINT16
            DET_RANGE_158_oRDR_DETECTION_157_160_oPCAN_RADAR_4751c37a_Tx: ComSignalType=UINT16
            DET_RANGE_159_oRDR_DETECTION_157_160_oPCAN_RADAR_d22117ef_Tx: ComSignalType=UINT16
            DET_RANGE_160_oRDR_DETECTION_157_160_oPCAN_RADAR_6d904d34_Tx: ComSignalType=UINT16
            DET_RANGE_ERR_157_oRDR_DETECTION_157_160_oPCAN_RADAR_cca9eb54_Tx: ComSignalType=UINT8
            DET_RANGE_ERR_158_oRDR_DETECTION_157_160_oPCAN_RADAR_e0b97913_Tx: ComSignalType=UINT8
            DET_RANGE_ERR_159_oRDR_DETECTION_157_160_oPCAN_RADAR_75c9ad86_Tx: ComSignalType=UINT8
            DET_RANGE_ERR_160_oRDR_DETECTION_157_160_oPCAN_RADAR_ca78f75d_Tx: ComSignalType=UINT8
            DET_RANGE_VELOCITY_157_oRDR_DETECTION_157_160_oPCAN_RADAR_1ee79318_Tx: ComSignalType=UINT16
            DET_RANGE_VELOCITY_158_oRDR_DETECTION_157_160_oPCAN_RADAR_32f7015f_Tx: ComSignalType=UINT16
            DET_RANGE_VELOCITY_159_oRDR_DETECTION_157_160_oPCAN_RADAR_a787d5ca_Tx: ComSignalType=UINT16
            DET_RANGE_VELOCITY_160_oRDR_DETECTION_157_160_oPCAN_RADAR_18368f11_Tx: ComSignalType=UINT16
            DET_RANGE_VELOCITY_ERR_157_oRDR_DETECTION_157_160_oPCAN_RADAR_115c68aa_Tx: ComSignalType=UINT8
            DET_RANGE_VELOCITY_ERR_158_oRDR_DETECTION_157_160_oPCAN_RADAR_3d4cfaed_Tx: ComSignalType=UINT8
            DET_RANGE_VELOCITY_ERR_159_oRDR_DETECTION_157_160_oPCAN_RADAR_a83c2e78_Tx: ComSignalType=UINT8
            DET_RANGE_VELOCITY_ERR_160_oRDR_DETECTION_157_160_oPCAN_RADAR_178d74a3_Tx: ComSignalType=UINT8
            DET_RCS_157_oRDR_DETECTION_157_160_oPCAN_RADAR_9967a442_Tx: ComSignalType=UINT8
            DET_RCS_158_oRDR_DETECTION_157_160_oPCAN_RADAR_b5773605_Tx: ComSignalType=UINT8
            DET_RCS_159_oRDR_DETECTION_157_160_oPCAN_RADAR_2007e290_Tx: ComSignalType=UINT8
            DET_RCS_160_oRDR_DETECTION_157_160_oPCAN_RADAR_9fb6b84b_Tx: ComSignalType=UINT8
            DET_SNR_157_oRDR_DETECTION_157_160_oPCAN_RADAR_44c9f040_Tx: ComSignalType=UINT8
            DET_SNR_158_oRDR_DETECTION_157_160_oPCAN_RADAR_68d96207_Tx: ComSignalType=UINT8
            DET_SNR_159_oRDR_DETECTION_157_160_oPCAN_RADAR_fda9b692_Tx: ComSignalType=UINT8
            DET_SNR_160_oRDR_DETECTION_157_160_oPCAN_RADAR_4218ec49_Tx: ComSignalType=UINT8
            DET_SUPER_RES_TARGET_157_oRDR_DETECTION_157_160_oPCAN_RADAR_7550d825_Tx: ComSignalType=BOOLEAN
            DET_SUPER_RES_TARGET_158_oRDR_DETECTION_157_160_oPCAN_RADAR_59404a62_Tx: ComSignalType=BOOLEAN
            DET_SUPER_RES_TARGET_159_oRDR_DETECTION_157_160_oPCAN_RADAR_cc309ef7_Tx: ComSignalType=BOOLEAN
            DET_SUPER_RES_TARGET_160_oRDR_DETECTION_157_160_oPCAN_RADAR_7381c42c_Tx: ComSignalType=BOOLEAN
        SG_Detections_161_164_oRDR_DETECTION_161_164_oPCAN_RADAR_c27e57ef_Tx
          83 x ComGroupSignal:
            DET_AZIMUTH_161_oRDR_DETECTION_161_164_oPCAN_RADAR_6570eae6_Tx: ComSignalType=UINT16
            DET_AZIMUTH_162_oRDR_DETECTION_161_164_oPCAN_RADAR_01909118_Tx: ComSignalType=UINT16
            DET_AZIMUTH_163_oRDR_DETECTION_161_164_oPCAN_RADAR_94e0458d_Tx: ComSignalType=UINT16
            DET_AZIMUTH_164_oRDR_DETECTION_161_164_oPCAN_RADAR_c85066e4_Tx: ComSignalType=UINT16
            DET_AZIMUTH_ERR_161_oRDR_DETECTION_161_164_oPCAN_RADAR_c1c57f13_Tx: ComSignalType=UINT8
            DET_AZIMUTH_ERR_162_oRDR_DETECTION_161_164_oPCAN_RADAR_a52504ed_Tx: ComSignalType=UINT8
            DET_AZIMUTH_ERR_163_oRDR_DETECTION_161_164_oPCAN_RADAR_3055d078_Tx: ComSignalType=UINT8
            DET_AZIMUTH_ERR_164_oRDR_DETECTION_161_164_oPCAN_RADAR_6ce5f311_Tx: ComSignalType=UINT8
            DET_BELOW_RAIN_THOLD_161_oRDR_DETECTION_161_164_oPCAN_RADAR_b0717926_Tx: ComSignalType=UINT8
            DET_BELOW_RAIN_THOLD_162_oRDR_DETECTION_161_164_oPCAN_RADAR_d49102d8_Tx: ComSignalType=UINT8
            DET_BELOW_RAIN_THOLD_163_oRDR_DETECTION_161_164_oPCAN_RADAR_41e1d64d_Tx: ComSignalType=UINT8
            DET_BELOW_RAIN_THOLD_164_oRDR_DETECTION_161_164_oPCAN_RADAR_1d51f524_Tx: ComSignalType=UINT8
            DET_BI_STATIC_FLAG_161_oRDR_DETECTION_161_164_oPCAN_RADAR_335caa63_Tx: ComSignalType=BOOLEAN
            DET_BI_STATIC_FLAG_162_oRDR_DETECTION_161_164_oPCAN_RADAR_57bcd19d_Tx: ComSignalType=BOOLEAN
            DET_BI_STATIC_FLAG_163_oRDR_DETECTION_161_164_oPCAN_RADAR_c2cc0508_Tx: ComSignalType=BOOLEAN
            DET_BI_STATIC_FLAG_164_oRDR_DETECTION_161_164_oPCAN_RADAR_9e7c2661_Tx: ComSignalType=BOOLEAN
            DET_CONFD_AZIMUTH_161_oRDR_DETECTION_161_164_oPCAN_RADAR_6796e02c_Tx: ComSignalType=UINT8
            DET_CONFD_AZIMUTH_162_oRDR_DETECTION_161_164_oPCAN_RADAR_03769bd2_Tx: ComSignalType=UINT8
            DET_CONFD_AZIMUTH_163_oRDR_DETECTION_161_164_oPCAN_RADAR_96064f47_Tx: ComSignalType=UINT8
            DET_CONFD_AZIMUTH_164_oRDR_DETECTION_161_164_oPCAN_RADAR_cab66c2e_Tx: ComSignalType=UINT8
            DET_CONFD_ELEVATION_161_oRDR_DETECTION_161_164_oPCAN_RADAR_6503e1d6_Tx: ComSignalType=UINT8
            DET_CONFD_ELEVATION_162_oRDR_DETECTION_161_164_oPCAN_RADAR_01e39a28_Tx: ComSignalType=UINT8
            DET_CONFD_ELEVATION_163_oRDR_DETECTION_161_164_oPCAN_RADAR_94934ebd_Tx: ComSignalType=UINT8
            DET_CONFD_ELEVATION_164_oRDR_DETECTION_161_164_oPCAN_RADAR_c8236dd4_Tx: ComSignalType=UINT8
            DET_ELEVATION_161_oRDR_DETECTION_161_164_oPCAN_RADAR_b4c335ea_Tx: ComSignalType=UINT8
            DET_ELEVATION_162_oRDR_DETECTION_161_164_oPCAN_RADAR_d0234e14_Tx: ComSignalType=UINT8
            DET_ELEVATION_163_oRDR_DETECTION_161_164_oPCAN_RADAR_45539a81_Tx: ComSignalType=UINT8
            DET_ELEVATION_164_oRDR_DETECTION_161_164_oPCAN_RADAR_19e3b9e8_Tx: ComSignalType=UINT8
            DET_ELEVATION_ERR_161_oRDR_DETECTION_161_164_oPCAN_RADAR_33faad9f_Tx: ComSignalType=UINT8
            DET_ELEVATION_ERR_162_oRDR_DETECTION_161_164_oPCAN_RADAR_571ad661_Tx: ComSignalType=UINT8
            DET_ELEVATION_ERR_163_oRDR_DETECTION_161_164_oPCAN_RADAR_c26a02f4_Tx: ComSignalType=UINT8
            DET_ELEVATION_ERR_164_oRDR_DETECTION_161_164_oPCAN_RADAR_9eda219d_Tx: ComSignalType=UINT8
            DET_EXISTENCE_PROB_161_oRDR_DETECTION_161_164_oPCAN_RADAR_e165d8ff_Tx: ComSignalType=UINT8
            DET_EXISTENCE_PROB_162_oRDR_DETECTION_161_164_oPCAN_RADAR_8585a301_Tx: ComSignalType=UINT8
            DET_EXISTENCE_PROB_163_oRDR_DETECTION_161_164_oPCAN_RADAR_10f57794_Tx: ComSignalType=UINT8
            DET_EXISTENCE_PROB_164_oRDR_DETECTION_161_164_oPCAN_RADAR_4c4554fd_Tx: ComSignalType=UINT8
            DET_HVC_FLAG_161_oRDR_DETECTION_161_164_oPCAN_RADAR_00119b80_Tx: ComSignalType=BOOLEAN
            DET_HVC_FLAG_162_oRDR_DETECTION_161_164_oPCAN_RADAR_64f1e07e_Tx: ComSignalType=BOOLEAN
            DET_HVC_FLAG_163_oRDR_DETECTION_161_164_oPCAN_RADAR_f18134eb_Tx: ComSignalType=BOOLEAN
            DET_HVC_FLAG_164_oRDR_DETECTION_161_164_oPCAN_RADAR_ad311782_Tx: ComSignalType=BOOLEAN
            DET_IDM_161_oRDR_DETECTION_161_164_oPCAN_RADAR_8b43a03d_Tx: ComSignalType=UINT8
            DET_IDM_162_oRDR_DETECTION_161_164_oPCAN_RADAR_efa3dbc3_Tx: ComSignalType=UINT8
            DET_IDM_163_oRDR_DETECTION_161_164_oPCAN_RADAR_7ad30f56_Tx: ComSignalType=UINT8
            DET_IDM_164_oRDR_DETECTION_161_164_oPCAN_RADAR_26632c3f_Tx: ComSignalType=UINT8
            DET_MH_CRC16_161_164_oRDR_DETECTION_161_164_oPCAN_RADAR_46f685e4_Tx: ComSignalType=UINT16
            DET_MH_CYCLE_COUNTER_161_164_oRDR_DETECTION_161_164_oPCAN_RADAR_c28324d3_Tx: ComSignalType=UINT8
            DET_MH_SCAN_INDEX_4LSB_161_164_oRDR_DETECTION_161_164_oPCAN_RADAR_0ea9015f_Tx: ComSignalType=UINT8
            DET_MTD_161_oRDR_DETECTION_161_164_oPCAN_RADAR_edf092e6_Tx: ComSignalType=UINT8
            DET_MTD_162_oRDR_DETECTION_161_164_oPCAN_RADAR_8910e918_Tx: ComSignalType=UINT8
            DET_MTD_163_oRDR_DETECTION_161_164_oPCAN_RADAR_1c603d8d_Tx: ComSignalType=UINT8
            DET_MTD_164_oRDR_DETECTION_161_164_oPCAN_RADAR_40d01ee4_Tx: ComSignalType=UINT8
            DET_PROB_1STAZHYPO_161_oRDR_DETECTION_161_164_oPCAN_RADAR_7e447a2b_Tx: ComSignalType=BOOLEAN
            DET_PROB_1STAZHYPO_162_oRDR_DETECTION_161_164_oPCAN_RADAR_1aa401d5_Tx: ComSignalType=BOOLEAN
            DET_PROB_1STAZHYPO_163_oRDR_DETECTION_161_164_oPCAN_RADAR_8fd4d540_Tx: ComSignalType=BOOLEAN
            DET_PROB_1STAZHYPO_164_oRDR_DETECTION_161_164_oPCAN_RADAR_d364f629_Tx: ComSignalType=BOOLEAN
            DET_RANGE_161_oRDR_DETECTION_161_164_oPCAN_RADAR_75eb995d_Tx: ComSignalType=UINT16
            DET_RANGE_162_oRDR_DETECTION_161_164_oPCAN_RADAR_110be2a3_Tx: ComSignalType=UINT16
            DET_RANGE_163_oRDR_DETECTION_161_164_oPCAN_RADAR_847b3636_Tx: ComSignalType=UINT16
            DET_RANGE_164_oRDR_DETECTION_161_164_oPCAN_RADAR_d8cb155f_Tx: ComSignalType=UINT16
            DET_RANGE_ERR_161_oRDR_DETECTION_161_164_oPCAN_RADAR_d2032334_Tx: ComSignalType=UINT8
            DET_RANGE_ERR_162_oRDR_DETECTION_161_164_oPCAN_RADAR_b6e358ca_Tx: ComSignalType=UINT8
            DET_RANGE_ERR_163_oRDR_DETECTION_161_164_oPCAN_RADAR_23938c5f_Tx: ComSignalType=UINT8
            DET_RANGE_ERR_164_oRDR_DETECTION_161_164_oPCAN_RADAR_7f23af36_Tx: ComSignalType=UINT8
            DET_RANGE_VELOCITY_161_oRDR_DETECTION_161_164_oPCAN_RADAR_004d5b78_Tx: ComSignalType=UINT16
            DET_RANGE_VELOCITY_162_oRDR_DETECTION_161_164_oPCAN_RADAR_64ad2086_Tx: ComSignalType=UINT16
            DET_RANGE_VELOCITY_163_oRDR_DETECTION_161_164_oPCAN_RADAR_f1ddf413_Tx: ComSignalType=UINT16
            DET_RANGE_VELOCITY_164_oRDR_DETECTION_161_164_oPCAN_RADAR_ad6dd77a_Tx: ComSignalType=UINT16
            DET_RANGE_VELOCITY_ERR_161_oRDR_DETECTION_161_164_oPCAN_RADAR_0ff6a0ca_Tx: ComSignalType=UINT8
            DET_RANGE_VELOCITY_ERR_162_oRDR_DETECTION_161_164_oPCAN_RADAR_6b16db34_Tx: ComSignalType=UINT8
            DET_RANGE_VELOCITY_ERR_163_oRDR_DETECTION_161_164_oPCAN_RADAR_fe660fa1_Tx: ComSignalType=UINT8
            DET_RANGE_VELOCITY_ERR_164_oRDR_DETECTION_161_164_oPCAN_RADAR_a2d62cc8_Tx: ComSignalType=UINT8
            DET_RCS_161_oRDR_DETECTION_161_164_oPCAN_RADAR_87cd6c22_Tx: ComSignalType=UINT8
            DET_RCS_162_oRDR_DETECTION_161_164_oPCAN_RADAR_e32d17dc_Tx: ComSignalType=UINT8
            DET_RCS_163_oRDR_DETECTION_161_164_oPCAN_RADAR_765dc349_Tx: ComSignalType=UINT8
            DET_RCS_164_oRDR_DETECTION_161_164_oPCAN_RADAR_2aede020_Tx: ComSignalType=UINT8
            DET_SNR_161_oRDR_DETECTION_161_164_oPCAN_RADAR_5a633820_Tx: ComSignalType=UINT8
            DET_SNR_162_oRDR_DETECTION_161_164_oPCAN_RADAR_3e8343de_Tx: ComSignalType=UINT8
            DET_SNR_163_oRDR_DETECTION_161_164_oPCAN_RADAR_abf3974b_Tx: ComSignalType=UINT8
            DET_SNR_164_oRDR_DETECTION_161_164_oPCAN_RADAR_f743b422_Tx: ComSignalType=UINT8
            DET_SUPER_RES_TARGET_161_oRDR_DETECTION_161_164_oPCAN_RADAR_6bfa1045_Tx: ComSignalType=BOOLEAN
            DET_SUPER_RES_TARGET_162_oRDR_DETECTION_161_164_oPCAN_RADAR_0f1a6bbb_Tx: ComSignalType=BOOLEAN
            DET_SUPER_RES_TARGET_163_oRDR_DETECTION_161_164_oPCAN_RADAR_9a6abf2e_Tx: ComSignalType=BOOLEAN
            DET_SUPER_RES_TARGET_164_oRDR_DETECTION_161_164_oPCAN_RADAR_c6da9c47_Tx: ComSignalType=BOOLEAN
        SG_Detections_165_168_oRDR_DETECTION_165_168_oPCAN_RADAR_b3bd63bd_Tx
          83 x ComGroupSignal:
            DET_AZIMUTH_165_oRDR_DETECTION_165_168_oPCAN_RADAR_b4922c45_Tx: ComSignalType=UINT16
            DET_AZIMUTH_166_oRDR_DETECTION_165_168_oPCAN_RADAR_d07257bb_Tx: ComSignalType=UINT16
            DET_AZIMUTH_167_oRDR_DETECTION_165_168_oPCAN_RADAR_4502832e_Tx: ComSignalType=UINT16
            DET_AZIMUTH_168_oRDR_DETECTION_165_168_oPCAN_RADAR_69121169_Tx: ComSignalType=UINT16
            DET_AZIMUTH_ERR_165_oRDR_DETECTION_165_168_oPCAN_RADAR_1027b9b0_Tx: ComSignalType=UINT8
            DET_AZIMUTH_ERR_166_oRDR_DETECTION_165_168_oPCAN_RADAR_74c7c24e_Tx: ComSignalType=UINT8
            DET_AZIMUTH_ERR_167_oRDR_DETECTION_165_168_oPCAN_RADAR_e1b716db_Tx: ComSignalType=UINT8
            DET_AZIMUTH_ERR_168_oRDR_DETECTION_165_168_oPCAN_RADAR_cda7849c_Tx: ComSignalType=UINT8
            DET_BELOW_RAIN_THOLD_165_oRDR_DETECTION_165_168_oPCAN_RADAR_6193bf85_Tx: ComSignalType=UINT8
            DET_BELOW_RAIN_THOLD_166_oRDR_DETECTION_165_168_oPCAN_RADAR_0573c47b_Tx: ComSignalType=UINT8
            DET_BELOW_RAIN_THOLD_167_oRDR_DETECTION_165_168_oPCAN_RADAR_900310ee_Tx: ComSignalType=UINT8
            DET_BELOW_RAIN_THOLD_168_oRDR_DETECTION_165_168_oPCAN_RADAR_bc1382a9_Tx: ComSignalType=UINT8
            DET_BI_STATIC_FLAG_165_oRDR_DETECTION_165_168_oPCAN_RADAR_e2be6cc0_Tx: ComSignalType=BOOLEAN
            DET_BI_STATIC_FLAG_166_oRDR_DETECTION_165_168_oPCAN_RADAR_865e173e_Tx: ComSignalType=BOOLEAN
            DET_BI_STATIC_FLAG_167_oRDR_DETECTION_165_168_oPCAN_RADAR_132ec3ab_Tx: ComSignalType=BOOLEAN
            DET_BI_STATIC_FLAG_168_oRDR_DETECTION_165_168_oPCAN_RADAR_3f3e51ec_Tx: ComSignalType=BOOLEAN
            DET_CONFD_AZIMUTH_165_oRDR_DETECTION_165_168_oPCAN_RADAR_b674268f_Tx: ComSignalType=UINT8
            DET_CONFD_AZIMUTH_166_oRDR_DETECTION_165_168_oPCAN_RADAR_d2945d71_Tx: ComSignalType=UINT8
            DET_CONFD_AZIMUTH_167_oRDR_DETECTION_165_168_oPCAN_RADAR_47e489e4_Tx: ComSignalType=UINT8
            DET_CONFD_AZIMUTH_168_oRDR_DETECTION_165_168_oPCAN_RADAR_6bf41ba3_Tx: ComSignalType=UINT8
            DET_CONFD_ELEVATION_165_oRDR_DETECTION_165_168_oPCAN_RADAR_b4e12775_Tx: ComSignalType=UINT8
            DET_CONFD_ELEVATION_166_oRDR_DETECTION_165_168_oPCAN_RADAR_d0015c8b_Tx: ComSignalType=UINT8
            DET_CONFD_ELEVATION_167_oRDR_DETECTION_165_168_oPCAN_RADAR_4571881e_Tx: ComSignalType=UINT8
            DET_CONFD_ELEVATION_168_oRDR_DETECTION_165_168_oPCAN_RADAR_69611a59_Tx: ComSignalType=UINT8
            DET_ELEVATION_165_oRDR_DETECTION_165_168_oPCAN_RADAR_6521f349_Tx: ComSignalType=UINT8
            DET_ELEVATION_166_oRDR_DETECTION_165_168_oPCAN_RADAR_01c188b7_Tx: ComSignalType=UINT8
            DET_ELEVATION_167_oRDR_DETECTION_165_168_oPCAN_RADAR_94b15c22_Tx: ComSignalType=UINT8
            DET_ELEVATION_168_oRDR_DETECTION_165_168_oPCAN_RADAR_b8a1ce65_Tx: ComSignalType=UINT8
            DET_ELEVATION_ERR_165_oRDR_DETECTION_165_168_oPCAN_RADAR_e2186b3c_Tx: ComSignalType=UINT8
            DET_ELEVATION_ERR_166_oRDR_DETECTION_165_168_oPCAN_RADAR_86f810c2_Tx: ComSignalType=UINT8
            DET_ELEVATION_ERR_167_oRDR_DETECTION_165_168_oPCAN_RADAR_1388c457_Tx: ComSignalType=UINT8
            DET_ELEVATION_ERR_168_oRDR_DETECTION_165_168_oPCAN_RADAR_3f985610_Tx: ComSignalType=UINT8
            DET_EXISTENCE_PROB_165_oRDR_DETECTION_165_168_oPCAN_RADAR_30871e5c_Tx: ComSignalType=UINT8
            DET_EXISTENCE_PROB_166_oRDR_DETECTION_165_168_oPCAN_RADAR_546765a2_Tx: ComSignalType=UINT8
            DET_EXISTENCE_PROB_167_oRDR_DETECTION_165_168_oPCAN_RADAR_c117b137_Tx: ComSignalType=UINT8
            DET_EXISTENCE_PROB_168_oRDR_DETECTION_165_168_oPCAN_RADAR_ed072370_Tx: ComSignalType=UINT8
            DET_HVC_FLAG_165_oRDR_DETECTION_165_168_oPCAN_RADAR_d1f35d23_Tx: ComSignalType=BOOLEAN
            DET_HVC_FLAG_166_oRDR_DETECTION_165_168_oPCAN_RADAR_b51326dd_Tx: ComSignalType=BOOLEAN
            DET_HVC_FLAG_167_oRDR_DETECTION_165_168_oPCAN_RADAR_2063f248_Tx: ComSignalType=BOOLEAN
            DET_HVC_FLAG_168_oRDR_DETECTION_165_168_oPCAN_RADAR_0c73600f_Tx: ComSignalType=BOOLEAN
            DET_IDM_165_oRDR_DETECTION_165_168_oPCAN_RADAR_5aa1669e_Tx: ComSignalType=UINT8
            DET_IDM_166_oRDR_DETECTION_165_168_oPCAN_RADAR_3e411d60_Tx: ComSignalType=UINT8
            DET_IDM_167_oRDR_DETECTION_165_168_oPCAN_RADAR_ab31c9f5_Tx: ComSignalType=UINT8
            DET_IDM_168_oRDR_DETECTION_165_168_oPCAN_RADAR_87215bb2_Tx: ComSignalType=UINT8
            DET_MH_CRC16_165_168_oRDR_DETECTION_165_168_oPCAN_RADAR_3735b1b6_Tx: ComSignalType=UINT16
            DET_MH_CYCLE_COUNTER_165_168_oRDR_DETECTION_165_168_oPCAN_RADAR_b3401081_Tx: ComSignalType=UINT8
            DET_MH_SCAN_INDEX_4LSB_165_168_oRDR_DETECTION_165_168_oPCAN_RADAR_7f6a350d_Tx: ComSignalType=UINT8
            DET_MTD_165_oRDR_DETECTION_165_168_oPCAN_RADAR_3c125445_Tx: ComSignalType=UINT8
            DET_MTD_166_oRDR_DETECTION_165_168_oPCAN_RADAR_58f22fbb_Tx: ComSignalType=UINT8
            DET_MTD_167_oRDR_DETECTION_165_168_oPCAN_RADAR_cd82fb2e_Tx: ComSignalType=UINT8
            DET_MTD_168_oRDR_DETECTION_165_168_oPCAN_RADAR_e1926969_Tx: ComSignalType=UINT8
            DET_PROB_1STAZHYPO_165_oRDR_DETECTION_165_168_oPCAN_RADAR_afa6bc88_Tx: ComSignalType=BOOLEAN
            DET_PROB_1STAZHYPO_166_oRDR_DETECTION_165_168_oPCAN_RADAR_cb46c776_Tx: ComSignalType=BOOLEAN
            DET_PROB_1STAZHYPO_167_oRDR_DETECTION_165_168_oPCAN_RADAR_5e3613e3_Tx: ComSignalType=BOOLEAN
            DET_PROB_1STAZHYPO_168_oRDR_DETECTION_165_168_oPCAN_RADAR_722681a4_Tx: ComSignalType=BOOLEAN
            DET_RANGE_165_oRDR_DETECTION_165_168_oPCAN_RADAR_a4095ffe_Tx: ComSignalType=UINT16
            DET_RANGE_166_oRDR_DETECTION_165_168_oPCAN_RADAR_c0e92400_Tx: ComSignalType=UINT16
            DET_RANGE_167_oRDR_DETECTION_165_168_oPCAN_RADAR_5599f095_Tx: ComSignalType=UINT16
            DET_RANGE_168_oRDR_DETECTION_165_168_oPCAN_RADAR_798962d2_Tx: ComSignalType=UINT16
            DET_RANGE_ERR_165_oRDR_DETECTION_165_168_oPCAN_RADAR_03e1e597_Tx: ComSignalType=UINT8
            DET_RANGE_ERR_166_oRDR_DETECTION_165_168_oPCAN_RADAR_67019e69_Tx: ComSignalType=UINT8
            DET_RANGE_ERR_167_oRDR_DETECTION_165_168_oPCAN_RADAR_f2714afc_Tx: ComSignalType=UINT8
            DET_RANGE_ERR_168_oRDR_DETECTION_165_168_oPCAN_RADAR_de61d8bb_Tx: ComSignalType=UINT8
            DET_RANGE_VELOCITY_165_oRDR_DETECTION_165_168_oPCAN_RADAR_d1af9ddb_Tx: ComSignalType=UINT16
            DET_RANGE_VELOCITY_166_oRDR_DETECTION_165_168_oPCAN_RADAR_b54fe625_Tx: ComSignalType=UINT16
            DET_RANGE_VELOCITY_167_oRDR_DETECTION_165_168_oPCAN_RADAR_203f32b0_Tx: ComSignalType=UINT16
            DET_RANGE_VELOCITY_168_oRDR_DETECTION_165_168_oPCAN_RADAR_0c2fa0f7_Tx: ComSignalType=UINT16
            DET_RANGE_VELOCITY_ERR_165_oRDR_DETECTION_165_168_oPCAN_RADAR_de146669_Tx: ComSignalType=UINT8
            DET_RANGE_VELOCITY_ERR_166_oRDR_DETECTION_165_168_oPCAN_RADAR_baf41d97_Tx: ComSignalType=UINT8
            DET_RANGE_VELOCITY_ERR_167_oRDR_DETECTION_165_168_oPCAN_RADAR_2f84c902_Tx: ComSignalType=UINT8
            DET_RANGE_VELOCITY_ERR_168_oRDR_DETECTION_165_168_oPCAN_RADAR_03945b45_Tx: ComSignalType=UINT8
            DET_RCS_165_oRDR_DETECTION_165_168_oPCAN_RADAR_562faa81_Tx: ComSignalType=UINT8
            DET_RCS_166_oRDR_DETECTION_165_168_oPCAN_RADAR_32cfd17f_Tx: ComSignalType=UINT8
            DET_RCS_167_oRDR_DETECTION_165_168_oPCAN_RADAR_a7bf05ea_Tx: ComSignalType=UINT8
            DET_RCS_168_oRDR_DETECTION_165_168_oPCAN_RADAR_8baf97ad_Tx: ComSignalType=UINT8
            DET_SNR_165_oRDR_DETECTION_165_168_oPCAN_RADAR_8b81fe83_Tx: ComSignalType=UINT8
            DET_SNR_166_oRDR_DETECTION_165_168_oPCAN_RADAR_ef61857d_Tx: ComSignalType=UINT8
            DET_SNR_167_oRDR_DETECTION_165_168_oPCAN_RADAR_7a1151e8_Tx: ComSignalType=UINT8
            DET_SNR_168_oRDR_DETECTION_165_168_oPCAN_RADAR_5601c3af_Tx: ComSignalType=UINT8
            DET_SUPER_RES_TARGET_165_oRDR_DETECTION_165_168_oPCAN_RADAR_ba18d6e6_Tx: ComSignalType=BOOLEAN
            DET_SUPER_RES_TARGET_166_oRDR_DETECTION_165_168_oPCAN_RADAR_def8ad18_Tx: ComSignalType=BOOLEAN
            DET_SUPER_RES_TARGET_167_oRDR_DETECTION_165_168_oPCAN_RADAR_4b88798d_Tx: ComSignalType=BOOLEAN
            DET_SUPER_RES_TARGET_168_oRDR_DETECTION_165_168_oPCAN_RADAR_6798ebca_Tx: ComSignalType=BOOLEAN
        SG_Detections_169_172_oRDR_DETECTION_169_172_oPCAN_RADAR_2ac747c6_Tx
          83 x ComGroupSignal:
            DET_AZIMUTH_169_oRDR_DETECTION_169_172_oPCAN_RADAR_ce2a2afd_Tx: ComSignalType=UINT16
            DET_AZIMUTH_170_oRDR_DETECTION_169_172_oPCAN_RADAR_ab0a5859_Tx: ComSignalType=UINT16
            DET_AZIMUTH_171_oRDR_DETECTION_169_172_oPCAN_RADAR_3e7a8ccc_Tx: ComSignalType=UINT16
            DET_AZIMUTH_172_oRDR_DETECTION_169_172_oPCAN_RADAR_5a9af732_Tx: ComSignalType=UINT16
            DET_AZIMUTH_ERR_169_oRDR_DETECTION_169_172_oPCAN_RADAR_6a9fbf08_Tx: ComSignalType=UINT8
            DET_AZIMUTH_ERR_170_oRDR_DETECTION_169_172_oPCAN_RADAR_0fbfcdac_Tx: ComSignalType=UINT8
            DET_AZIMUTH_ERR_171_oRDR_DETECTION_169_172_oPCAN_RADAR_9acf1939_Tx: ComSignalType=UINT8
            DET_AZIMUTH_ERR_172_oRDR_DETECTION_169_172_oPCAN_RADAR_fe2f62c7_Tx: ComSignalType=UINT8
            DET_BELOW_RAIN_THOLD_169_oRDR_DETECTION_169_172_oPCAN_RADAR_1b2bb93d_Tx: ComSignalType=UINT8
            DET_BELOW_RAIN_THOLD_170_oRDR_DETECTION_169_172_oPCAN_RADAR_7e0bcb99_Tx: ComSignalType=UINT8
            DET_BELOW_RAIN_THOLD_171_oRDR_DETECTION_169_172_oPCAN_RADAR_eb7b1f0c_Tx: ComSignalType=UINT8
            DET_BELOW_RAIN_THOLD_172_oRDR_DETECTION_169_172_oPCAN_RADAR_8f9b64f2_Tx: ComSignalType=UINT8
            DET_BI_STATIC_FLAG_169_oRDR_DETECTION_169_172_oPCAN_RADAR_98066a78_Tx: ComSignalType=BOOLEAN
            DET_BI_STATIC_FLAG_170_oRDR_DETECTION_169_172_oPCAN_RADAR_fd2618dc_Tx: ComSignalType=BOOLEAN
            DET_BI_STATIC_FLAG_171_oRDR_DETECTION_169_172_oPCAN_RADAR_6856cc49_Tx: ComSignalType=BOOLEAN
            DET_BI_STATIC_FLAG_172_oRDR_DETECTION_169_172_oPCAN_RADAR_0cb6b7b7_Tx: ComSignalType=BOOLEAN
            DET_CONFD_AZIMUTH_169_oRDR_DETECTION_169_172_oPCAN_RADAR_cccc2037_Tx: ComSignalType=UINT8
            DET_CONFD_AZIMUTH_170_oRDR_DETECTION_169_172_oPCAN_RADAR_a9ec5293_Tx: ComSignalType=UINT8
            DET_CONFD_AZIMUTH_171_oRDR_DETECTION_169_172_oPCAN_RADAR_3c9c8606_Tx: ComSignalType=UINT8
            DET_CONFD_AZIMUTH_172_oRDR_DETECTION_169_172_oPCAN_RADAR_587cfdf8_Tx: ComSignalType=UINT8
            DET_CONFD_ELEVATION_169_oRDR_DETECTION_169_172_oPCAN_RADAR_ce5921cd_Tx: ComSignalType=UINT8
            DET_CONFD_ELEVATION_170_oRDR_DETECTION_169_172_oPCAN_RADAR_ab795369_Tx: ComSignalType=UINT8
            DET_CONFD_ELEVATION_171_oRDR_DETECTION_169_172_oPCAN_RADAR_3e0987fc_Tx: ComSignalType=UINT8
            DET_CONFD_ELEVATION_172_oRDR_DETECTION_169_172_oPCAN_RADAR_5ae9fc02_Tx: ComSignalType=UINT8
            DET_ELEVATION_169_oRDR_DETECTION_169_172_oPCAN_RADAR_1f99f5f1_Tx: ComSignalType=UINT8
            DET_ELEVATION_170_oRDR_DETECTION_169_172_oPCAN_RADAR_7ab98755_Tx: ComSignalType=UINT8
            DET_ELEVATION_171_oRDR_DETECTION_169_172_oPCAN_RADAR_efc953c0_Tx: ComSignalType=UINT8
            DET_ELEVATION_172_oRDR_DETECTION_169_172_oPCAN_RADAR_8b29283e_Tx: ComSignalType=UINT8
            DET_ELEVATION_ERR_169_oRDR_DETECTION_169_172_oPCAN_RADAR_98a06d84_Tx: ComSignalType=UINT8
            DET_ELEVATION_ERR_170_oRDR_DETECTION_169_172_oPCAN_RADAR_fd801f20_Tx: ComSignalType=UINT8
            DET_ELEVATION_ERR_171_oRDR_DETECTION_169_172_oPCAN_RADAR_68f0cbb5_Tx: ComSignalType=UINT8
            DET_ELEVATION_ERR_172_oRDR_DETECTION_169_172_oPCAN_RADAR_0c10b04b_Tx: ComSignalType=UINT8
            DET_EXISTENCE_PROB_169_oRDR_DETECTION_169_172_oPCAN_RADAR_4a3f18e4_Tx: ComSignalType=UINT8
            DET_EXISTENCE_PROB_170_oRDR_DETECTION_169_172_oPCAN_RADAR_2f1f6a40_Tx: ComSignalType=UINT8
            DET_EXISTENCE_PROB_171_oRDR_DETECTION_169_172_oPCAN_RADAR_ba6fbed5_Tx: ComSignalType=UINT8
            DET_EXISTENCE_PROB_172_oRDR_DETECTION_169_172_oPCAN_RADAR_de8fc52b_Tx: ComSignalType=UINT8
            DET_HVC_FLAG_169_oRDR_DETECTION_169_172_oPCAN_RADAR_ab4b5b9b_Tx: ComSignalType=BOOLEAN
            DET_HVC_FLAG_170_oRDR_DETECTION_169_172_oPCAN_RADAR_ce6b293f_Tx: ComSignalType=BOOLEAN
            DET_HVC_FLAG_171_oRDR_DETECTION_169_172_oPCAN_RADAR_5b1bfdaa_Tx: ComSignalType=BOOLEAN
            DET_HVC_FLAG_172_oRDR_DETECTION_169_172_oPCAN_RADAR_3ffb8654_Tx: ComSignalType=BOOLEAN
            DET_IDM_169_oRDR_DETECTION_169_172_oPCAN_RADAR_20196026_Tx: ComSignalType=UINT8
            DET_IDM_170_oRDR_DETECTION_169_172_oPCAN_RADAR_45391282_Tx: ComSignalType=UINT8
            DET_IDM_171_oRDR_DETECTION_169_172_oPCAN_RADAR_d049c617_Tx: ComSignalType=UINT8
            DET_IDM_172_oRDR_DETECTION_169_172_oPCAN_RADAR_b4a9bde9_Tx: ComSignalType=UINT8
            DET_MH_CRC16_169_172_oRDR_DETECTION_169_172_oPCAN_RADAR_ae4f95cd_Tx: ComSignalType=UINT16
            DET_MH_CYCLE_COUNTER_169_172_oRDR_DETECTION_169_172_oPCAN_RADAR_2a3a34fa_Tx: ComSignalType=UINT8
            DET_MH_SCAN_INDEX_4LSB_169_172_oRDR_DETECTION_169_172_oPCAN_RADAR_e6101176_Tx: ComSignalType=UINT8
            DET_MTD_169_oRDR_DETECTION_169_172_oPCAN_RADAR_46aa52fd_Tx: ComSignalType=UINT8
            DET_MTD_170_oRDR_DETECTION_169_172_oPCAN_RADAR_238a2059_Tx: ComSignalType=UINT8
            DET_MTD_171_oRDR_DETECTION_169_172_oPCAN_RADAR_b6faf4cc_Tx: ComSignalType=UINT8
            DET_MTD_172_oRDR_DETECTION_169_172_oPCAN_RADAR_d21a8f32_Tx: ComSignalType=UINT8
            DET_PROB_1STAZHYPO_169_oRDR_DETECTION_169_172_oPCAN_RADAR_d51eba30_Tx: ComSignalType=BOOLEAN
            DET_PROB_1STAZHYPO_170_oRDR_DETECTION_169_172_oPCAN_RADAR_b03ec894_Tx: ComSignalType=BOOLEAN
            DET_PROB_1STAZHYPO_171_oRDR_DETECTION_169_172_oPCAN_RADAR_254e1c01_Tx: ComSignalType=BOOLEAN
            DET_PROB_1STAZHYPO_172_oRDR_DETECTION_169_172_oPCAN_RADAR_41ae67ff_Tx: ComSignalType=BOOLEAN
            DET_RANGE_169_oRDR_DETECTION_169_172_oPCAN_RADAR_deb15946_Tx: ComSignalType=UINT16
            DET_RANGE_170_oRDR_DETECTION_169_172_oPCAN_RADAR_bb912be2_Tx: ComSignalType=UINT16
            DET_RANGE_171_oRDR_DETECTION_169_172_oPCAN_RADAR_2ee1ff77_Tx: ComSignalType=UINT16
            DET_RANGE_172_oRDR_DETECTION_169_172_oPCAN_RADAR_4a018489_Tx: ComSignalType=UINT16
            DET_RANGE_ERR_169_oRDR_DETECTION_169_172_oPCAN_RADAR_7959e32f_Tx: ComSignalType=UINT8
            DET_RANGE_ERR_170_oRDR_DETECTION_169_172_oPCAN_RADAR_1c79918b_Tx: ComSignalType=UINT8
            DET_RANGE_ERR_171_oRDR_DETECTION_169_172_oPCAN_RADAR_8909451e_Tx: ComSignalType=UINT8
            DET_RANGE_ERR_172_oRDR_DETECTION_169_172_oPCAN_RADAR_ede93ee0_Tx: ComSignalType=UINT8
            DET_RANGE_VELOCITY_169_oRDR_DETECTION_169_172_oPCAN_RADAR_ab179b63_Tx: ComSignalType=UINT16
            DET_RANGE_VELOCITY_170_oRDR_DETECTION_169_172_oPCAN_RADAR_ce37e9c7_Tx: ComSignalType=UINT16
            DET_RANGE_VELOCITY_171_oRDR_DETECTION_169_172_oPCAN_RADAR_5b473d52_Tx: ComSignalType=UINT16
            DET_RANGE_VELOCITY_172_oRDR_DETECTION_169_172_oPCAN_RADAR_3fa746ac_Tx: ComSignalType=UINT16
            DET_RANGE_VELOCITY_ERR_169_oRDR_DETECTION_169_172_oPCAN_RADAR_a4ac60d1_Tx: ComSignalType=UINT8
            DET_RANGE_VELOCITY_ERR_170_oRDR_DETECTION_169_172_oPCAN_RADAR_c18c1275_Tx: ComSignalType=UINT8
            DET_RANGE_VELOCITY_ERR_171_oRDR_DETECTION_169_172_oPCAN_RADAR_54fcc6e0_Tx: ComSignalType=UINT8
            DET_RANGE_VELOCITY_ERR_172_oRDR_DETECTION_169_172_oPCAN_RADAR_301cbd1e_Tx: ComSignalType=UINT8
            DET_RCS_169_oRDR_DETECTION_169_172_oPCAN_RADAR_2c97ac39_Tx: ComSignalType=UINT8
            DET_RCS_170_oRDR_DETECTION_169_172_oPCAN_RADAR_49b7de9d_Tx: ComSignalType=UINT8
            DET_RCS_171_oRDR_DETECTION_169_172_oPCAN_RADAR_dcc70a08_Tx: ComSignalType=UINT8
            DET_RCS_172_oRDR_DETECTION_169_172_oPCAN_RADAR_b82771f6_Tx: ComSignalType=UINT8
            DET_SNR_169_oRDR_DETECTION_169_172_oPCAN_RADAR_f139f83b_Tx: ComSignalType=UINT8
            DET_SNR_170_oRDR_DETECTION_169_172_oPCAN_RADAR_94198a9f_Tx: ComSignalType=UINT8
            DET_SNR_171_oRDR_DETECTION_169_172_oPCAN_RADAR_01695e0a_Tx: ComSignalType=UINT8
            DET_SNR_172_oRDR_DETECTION_169_172_oPCAN_RADAR_658925f4_Tx: ComSignalType=UINT8
            DET_SUPER_RES_TARGET_169_oRDR_DETECTION_169_172_oPCAN_RADAR_c0a0d05e_Tx: ComSignalType=BOOLEAN
            DET_SUPER_RES_TARGET_170_oRDR_DETECTION_169_172_oPCAN_RADAR_a580a2fa_Tx: ComSignalType=BOOLEAN
            DET_SUPER_RES_TARGET_171_oRDR_DETECTION_169_172_oPCAN_RADAR_30f0766f_Tx: ComSignalType=BOOLEAN
            DET_SUPER_RES_TARGET_172_oRDR_DETECTION_169_172_oPCAN_RADAR_54100d91_Tx: ComSignalType=BOOLEAN
        SG_Detections_173_176_oRDR_DETECTION_173_176_oPCAN_RADAR_18cc2fee_Tx
          83 x ComGroupSignal:
            DET_AZIMUTH_173_oRDR_DETECTION_173_176_oPCAN_RADAR_d22d2089_Tx: ComSignalType=UINT16
            DET_AZIMUTH_174_oRDR_DETECTION_173_176_oPCAN_RADAR_8e9d03e0_Tx: ComSignalType=UINT16
            DET_AZIMUTH_175_oRDR_DETECTION_173_176_oPCAN_RADAR_1bedd775_Tx: ComSignalType=UINT16
            DET_AZIMUTH_176_oRDR_DETECTION_173_176_oPCAN_RADAR_7f0dac8b_Tx: ComSignalType=UINT16
            DET_AZIMUTH_ERR_173_oRDR_DETECTION_173_176_oPCAN_RADAR_7698b57c_Tx: ComSignalType=UINT8
            DET_AZIMUTH_ERR_174_oRDR_DETECTION_173_176_oPCAN_RADAR_2a289615_Tx: ComSignalType=UINT8
            DET_AZIMUTH_ERR_175_oRDR_DETECTION_173_176_oPCAN_RADAR_bf584280_Tx: ComSignalType=UINT8
            DET_AZIMUTH_ERR_176_oRDR_DETECTION_173_176_oPCAN_RADAR_dbb8397e_Tx: ComSignalType=UINT8
            DET_BELOW_RAIN_THOLD_173_oRDR_DETECTION_173_176_oPCAN_RADAR_072cb349_Tx: ComSignalType=UINT8
            DET_BELOW_RAIN_THOLD_174_oRDR_DETECTION_173_176_oPCAN_RADAR_5b9c9020_Tx: ComSignalType=UINT8
            DET_BELOW_RAIN_THOLD_175_oRDR_DETECTION_173_176_oPCAN_RADAR_ceec44b5_Tx: ComSignalType=UINT8
            DET_BELOW_RAIN_THOLD_176_oRDR_DETECTION_173_176_oPCAN_RADAR_aa0c3f4b_Tx: ComSignalType=UINT8
            DET_BI_STATIC_FLAG_173_oRDR_DETECTION_173_176_oPCAN_RADAR_8401600c_Tx: ComSignalType=BOOLEAN
            DET_BI_STATIC_FLAG_174_oRDR_DETECTION_173_176_oPCAN_RADAR_d8b14365_Tx: ComSignalType=BOOLEAN
            DET_BI_STATIC_FLAG_175_oRDR_DETECTION_173_176_oPCAN_RADAR_4dc197f0_Tx: ComSignalType=BOOLEAN
            DET_BI_STATIC_FLAG_176_oRDR_DETECTION_173_176_oPCAN_RADAR_2921ec0e_Tx: ComSignalType=BOOLEAN
            DET_CONFD_AZIMUTH_173_oRDR_DETECTION_173_176_oPCAN_RADAR_d0cb2a43_Tx: ComSignalType=UINT8
            DET_CONFD_AZIMUTH_174_oRDR_DETECTION_173_176_oPCAN_RADAR_8c7b092a_Tx: ComSignalType=UINT8
            DET_CONFD_AZIMUTH_175_oRDR_DETECTION_173_176_oPCAN_RADAR_190bddbf_Tx: ComSignalType=UINT8
            DET_CONFD_AZIMUTH_176_oRDR_DETECTION_173_176_oPCAN_RADAR_7deba641_Tx: ComSignalType=UINT8
            DET_CONFD_ELEVATION_173_oRDR_DETECTION_173_176_oPCAN_RADAR_d25e2bb9_Tx: ComSignalType=UINT8
            DET_CONFD_ELEVATION_174_oRDR_DETECTION_173_176_oPCAN_RADAR_8eee08d0_Tx: ComSignalType=UINT8
            DET_CONFD_ELEVATION_175_oRDR_DETECTION_173_176_oPCAN_RADAR_1b9edc45_Tx: ComSignalType=UINT8
            DET_CONFD_ELEVATION_176_oRDR_DETECTION_173_176_oPCAN_RADAR_7f7ea7bb_Tx: ComSignalType=UINT8
            DET_ELEVATION_173_oRDR_DETECTION_173_176_oPCAN_RADAR_039eff85_Tx: ComSignalType=UINT8
            DET_ELEVATION_174_oRDR_DETECTION_173_176_oPCAN_RADAR_5f2edcec_Tx: ComSignalType=UINT8
            DET_ELEVATION_175_oRDR_DETECTION_173_176_oPCAN_RADAR_ca5e0879_Tx: ComSignalType=UINT8
            DET_ELEVATION_176_oRDR_DETECTION_173_176_oPCAN_RADAR_aebe7387_Tx: ComSignalType=UINT8
            DET_ELEVATION_ERR_173_oRDR_DETECTION_173_176_oPCAN_RADAR_84a767f0_Tx: ComSignalType=UINT8
            DET_ELEVATION_ERR_174_oRDR_DETECTION_173_176_oPCAN_RADAR_d8174499_Tx: ComSignalType=UINT8
            DET_ELEVATION_ERR_175_oRDR_DETECTION_173_176_oPCAN_RADAR_4d67900c_Tx: ComSignalType=UINT8
            DET_ELEVATION_ERR_176_oRDR_DETECTION_173_176_oPCAN_RADAR_2987ebf2_Tx: ComSignalType=UINT8
            DET_EXISTENCE_PROB_173_oRDR_DETECTION_173_176_oPCAN_RADAR_56381290_Tx: ComSignalType=UINT8
            DET_EXISTENCE_PROB_174_oRDR_DETECTION_173_176_oPCAN_RADAR_0a8831f9_Tx: ComSignalType=UINT8
            DET_EXISTENCE_PROB_175_oRDR_DETECTION_173_176_oPCAN_RADAR_9ff8e56c_Tx: ComSignalType=UINT8
            DET_EXISTENCE_PROB_176_oRDR_DETECTION_173_176_oPCAN_RADAR_fb189e92_Tx: ComSignalType=UINT8
            DET_HVC_FLAG_173_oRDR_DETECTION_173_176_oPCAN_RADAR_b74c51ef_Tx: ComSignalType=BOOLEAN
            DET_HVC_FLAG_174_oRDR_DETECTION_173_176_oPCAN_RADAR_ebfc7286_Tx: ComSignalType=BOOLEAN
            DET_HVC_FLAG_175_oRDR_DETECTION_173_176_oPCAN_RADAR_7e8ca613_Tx: ComSignalType=BOOLEAN
            DET_HVC_FLAG_176_oRDR_DETECTION_173_176_oPCAN_RADAR_1a6cdded_Tx: ComSignalType=BOOLEAN
            DET_IDM_173_oRDR_DETECTION_173_176_oPCAN_RADAR_3c1e6a52_Tx: ComSignalType=UINT8
            DET_IDM_174_oRDR_DETECTION_173_176_oPCAN_RADAR_60ae493b_Tx: ComSignalType=UINT8
            DET_IDM_175_oRDR_DETECTION_173_176_oPCAN_RADAR_f5de9dae_Tx: ComSignalType=UINT8
            DET_IDM_176_oRDR_DETECTION_173_176_oPCAN_RADAR_913ee650_Tx: ComSignalType=UINT8
            DET_MH_CRC16_173_176_oRDR_DETECTION_173_176_oPCAN_RADAR_9c44fde5_Tx: ComSignalType=UINT16
            DET_MH_CYCLE_COUNTER_173_176_oRDR_DETECTION_173_176_oPCAN_RADAR_18315cd2_Tx: ComSignalType=UINT8
            DET_MH_SCAN_INDEX_4LSB_173_176_oRDR_DETECTION_173_176_oPCAN_RADAR_d41b795e_Tx: ComSignalType=UINT8
            DET_MTD_173_oRDR_DETECTION_173_176_oPCAN_RADAR_5aad5889_Tx: ComSignalType=UINT8
            DET_MTD_174_oRDR_DETECTION_173_176_oPCAN_RADAR_061d7be0_Tx: ComSignalType=UINT8
            DET_MTD_175_oRDR_DETECTION_173_176_oPCAN_RADAR_936daf75_Tx: ComSignalType=UINT8
            DET_MTD_176_oRDR_DETECTION_173_176_oPCAN_RADAR_f78dd48b_Tx: ComSignalType=UINT8
            DET_PROB_1STAZHYPO_173_oRDR_DETECTION_173_176_oPCAN_RADAR_c919b044_Tx: ComSignalType=BOOLEAN
            DET_PROB_1STAZHYPO_174_oRDR_DETECTION_173_176_oPCAN_RADAR_95a9932d_Tx: ComSignalType=BOOLEAN
            DET_PROB_1STAZHYPO_175_oRDR_DETECTION_173_176_oPCAN_RADAR_00d947b8_Tx: ComSignalType=BOOLEAN
            DET_PROB_1STAZHYPO_176_oRDR_DETECTION_173_176_oPCAN_RADAR_64393c46_Tx: ComSignalType=BOOLEAN
            DET_RANGE_173_oRDR_DETECTION_173_176_oPCAN_RADAR_c2b65332_Tx: ComSignalType=UINT16
            DET_RANGE_174_oRDR_DETECTION_173_176_oPCAN_RADAR_9e06705b_Tx: ComSignalType=UINT16
            DET_RANGE_175_oRDR_DETECTION_173_176_oPCAN_RADAR_0b76a4ce_Tx: ComSignalType=UINT16
            DET_RANGE_176_oRDR_DETECTION_173_176_oPCAN_RADAR_6f96df30_Tx: ComSignalType=UINT16
            DET_RANGE_ERR_173_oRDR_DETECTION_173_176_oPCAN_RADAR_655ee95b_Tx: ComSignalType=UINT8
            DET_RANGE_ERR_174_oRDR_DETECTION_173_176_oPCAN_RADAR_39eeca32_Tx: ComSignalType=UINT8
            DET_RANGE_ERR_175_oRDR_DETECTION_173_176_oPCAN_RADAR_ac9e1ea7_Tx: ComSignalType=UINT8
            DET_RANGE_ERR_176_oRDR_DETECTION_173_176_oPCAN_RADAR_c87e6559_Tx: ComSignalType=UINT8
            DET_RANGE_VELOCITY_173_oRDR_DETECTION_173_176_oPCAN_RADAR_b7109117_Tx: ComSignalType=UINT16
            DET_RANGE_VELOCITY_174_oRDR_DETECTION_173_176_oPCAN_RADAR_eba0b27e_Tx: ComSignalType=UINT16
            DET_RANGE_VELOCITY_175_oRDR_DETECTION_173_176_oPCAN_RADAR_7ed066eb_Tx: ComSignalType=UINT16
            DET_RANGE_VELOCITY_176_oRDR_DETECTION_173_176_oPCAN_RADAR_1a301d15_Tx: ComSignalType=UINT16
            DET_RANGE_VELOCITY_ERR_173_oRDR_DETECTION_173_176_oPCAN_RADAR_b8ab6aa5_Tx: ComSignalType=UINT8
            DET_RANGE_VELOCITY_ERR_174_oRDR_DETECTION_173_176_oPCAN_RADAR_e41b49cc_Tx: ComSignalType=UINT8
            DET_RANGE_VELOCITY_ERR_175_oRDR_DETECTION_173_176_oPCAN_RADAR_716b9d59_Tx: ComSignalType=UINT8
            DET_RANGE_VELOCITY_ERR_176_oRDR_DETECTION_173_176_oPCAN_RADAR_158be6a7_Tx: ComSignalType=UINT8
            DET_RCS_173_oRDR_DETECTION_173_176_oPCAN_RADAR_3090a64d_Tx: ComSignalType=UINT8
            DET_RCS_174_oRDR_DETECTION_173_176_oPCAN_RADAR_6c208524_Tx: ComSignalType=UINT8
            DET_RCS_175_oRDR_DETECTION_173_176_oPCAN_RADAR_f95051b1_Tx: ComSignalType=UINT8
            DET_RCS_176_oRDR_DETECTION_173_176_oPCAN_RADAR_9db02a4f_Tx: ComSignalType=UINT8
            DET_SNR_173_oRDR_DETECTION_173_176_oPCAN_RADAR_ed3ef24f_Tx: ComSignalType=UINT8
            DET_SNR_174_oRDR_DETECTION_173_176_oPCAN_RADAR_b18ed126_Tx: ComSignalType=UINT8
            DET_SNR_175_oRDR_DETECTION_173_176_oPCAN_RADAR_24fe05b3_Tx: ComSignalType=UINT8
            DET_SNR_176_oRDR_DETECTION_173_176_oPCAN_RADAR_401e7e4d_Tx: ComSignalType=UINT8
            DET_SUPER_RES_TARGET_173_oRDR_DETECTION_173_176_oPCAN_RADAR_dca7da2a_Tx: ComSignalType=BOOLEAN
            DET_SUPER_RES_TARGET_174_oRDR_DETECTION_173_176_oPCAN_RADAR_8017f943_Tx: ComSignalType=BOOLEAN
            DET_SUPER_RES_TARGET_175_oRDR_DETECTION_173_176_oPCAN_RADAR_15672dd6_Tx: ComSignalType=BOOLEAN
            DET_SUPER_RES_TARGET_176_oRDR_DETECTION_173_176_oPCAN_RADAR_71875628_Tx: ComSignalType=BOOLEAN
        SG_Detections_177_180_oRDR_DETECTION_177_180_oPCAN_RADAR_6c601388_Tx
          83 x ComGroupSignal:
            DET_AZIMUTH_177_oRDR_DETECTION_177_180_oPCAN_RADAR_6f0434fa_Tx: ComSignalType=UINT16
            DET_AZIMUTH_178_oRDR_DETECTION_177_180_oPCAN_RADAR_4314a6bd_Tx: ComSignalType=UINT16
            DET_AZIMUTH_179_oRDR_DETECTION_177_180_oPCAN_RADAR_d6647228_Tx: ComSignalType=UINT16
            DET_AZIMUTH_180_oRDR_DETECTION_177_180_oPCAN_RADAR_db20d332_Tx: ComSignalType=UINT16
            DET_AZIMUTH_ERR_177_oRDR_DETECTION_177_180_oPCAN_RADAR_cbb1a10f_Tx: ComSignalType=UINT8
            DET_AZIMUTH_ERR_178_oRDR_DETECTION_177_180_oPCAN_RADAR_e7a13348_Tx: ComSignalType=UINT8
            DET_AZIMUTH_ERR_179_oRDR_DETECTION_177_180_oPCAN_RADAR_72d1e7dd_Tx: ComSignalType=UINT8
            DET_AZIMUTH_ERR_180_oRDR_DETECTION_177_180_oPCAN_RADAR_7f9546c7_Tx: ComSignalType=UINT8
            DET_BELOW_RAIN_THOLD_177_oRDR_DETECTION_177_180_oPCAN_RADAR_ba05a73a_Tx: ComSignalType=UINT8
            DET_BELOW_RAIN_THOLD_178_oRDR_DETECTION_177_180_oPCAN_RADAR_9615357d_Tx: ComSignalType=UINT8
            DET_BELOW_RAIN_THOLD_179_oRDR_DETECTION_177_180_oPCAN_RADAR_0365e1e8_Tx: ComSignalType=UINT8
            DET_BELOW_RAIN_THOLD_180_oRDR_DETECTION_177_180_oPCAN_RADAR_0e2140f2_Tx: ComSignalType=UINT8
            DET_BI_STATIC_FLAG_177_oRDR_DETECTION_177_180_oPCAN_RADAR_3928747f_Tx: ComSignalType=BOOLEAN
            DET_BI_STATIC_FLAG_178_oRDR_DETECTION_177_180_oPCAN_RADAR_1538e638_Tx: ComSignalType=BOOLEAN
            DET_BI_STATIC_FLAG_179_oRDR_DETECTION_177_180_oPCAN_RADAR_804832ad_Tx: ComSignalType=BOOLEAN
            DET_BI_STATIC_FLAG_180_oRDR_DETECTION_177_180_oPCAN_RADAR_8d0c93b7_Tx: ComSignalType=BOOLEAN
            DET_CONFD_AZIMUTH_177_oRDR_DETECTION_177_180_oPCAN_RADAR_6de23e30_Tx: ComSignalType=UINT8
            DET_CONFD_AZIMUTH_178_oRDR_DETECTION_177_180_oPCAN_RADAR_41f2ac77_Tx: ComSignalType=UINT8
            DET_CONFD_AZIMUTH_179_oRDR_DETECTION_177_180_oPCAN_RADAR_d48278e2_Tx: ComSignalType=UINT8
            DET_CONFD_AZIMUTH_180_oRDR_DETECTION_177_180_oPCAN_RADAR_d9c6d9f8_Tx: ComSignalType=UINT8
            DET_CONFD_ELEVATION_177_oRDR_DETECTION_177_180_oPCAN_RADAR_6f773fca_Tx: ComSignalType=UINT8
            DET_CONFD_ELEVATION_178_oRDR_DETECTION_177_180_oPCAN_RADAR_4367ad8d_Tx: ComSignalType=UINT8
            DET_CONFD_ELEVATION_179_oRDR_DETECTION_177_180_oPCAN_RADAR_d6177918_Tx: ComSignalType=UINT8
            DET_CONFD_ELEVATION_180_oRDR_DETECTION_177_180_oPCAN_RADAR_db53d802_Tx: ComSignalType=UINT8
            DET_ELEVATION_177_oRDR_DETECTION_177_180_oPCAN_RADAR_beb7ebf6_Tx: ComSignalType=UINT8
            DET_ELEVATION_178_oRDR_DETECTION_177_180_oPCAN_RADAR_92a779b1_Tx: ComSignalType=UINT8
            DET_ELEVATION_179_oRDR_DETECTION_177_180_oPCAN_RADAR_07d7ad24_Tx: ComSignalType=UINT8
            DET_ELEVATION_180_oRDR_DETECTION_177_180_oPCAN_RADAR_0a930c3e_Tx: ComSignalType=UINT8
            DET_ELEVATION_ERR_177_oRDR_DETECTION_177_180_oPCAN_RADAR_398e7383_Tx: ComSignalType=UINT8
            DET_ELEVATION_ERR_178_oRDR_DETECTION_177_180_oPCAN_RADAR_159ee1c4_Tx: ComSignalType=UINT8
            DET_ELEVATION_ERR_179_oRDR_DETECTION_177_180_oPCAN_RADAR_80ee3551_Tx: ComSignalType=UINT8
            DET_ELEVATION_ERR_180_oRDR_DETECTION_177_180_oPCAN_RADAR_8daa944b_Tx: ComSignalType=UINT8
            DET_EXISTENCE_PROB_177_oRDR_DETECTION_177_180_oPCAN_RADAR_eb1106e3_Tx: ComSignalType=UINT8
            DET_EXISTENCE_PROB_178_oRDR_DETECTION_177_180_oPCAN_RADAR_c70194a4_Tx: ComSignalType=UINT8
            DET_EXISTENCE_PROB_179_oRDR_DETECTION_177_180_oPCAN_RADAR_52714031_Tx: ComSignalType=UINT8
            DET_EXISTENCE_PROB_180_oRDR_DETECTION_177_180_oPCAN_RADAR_5f35e12b_Tx: ComSignalType=UINT8
            DET_HVC_FLAG_177_oRDR_DETECTION_177_180_oPCAN_RADAR_0a65459c_Tx: ComSignalType=BOOLEAN
            DET_HVC_FLAG_178_oRDR_DETECTION_177_180_oPCAN_RADAR_2675d7db_Tx: ComSignalType=BOOLEAN
            DET_HVC_FLAG_179_oRDR_DETECTION_177_180_oPCAN_RADAR_b305034e_Tx: ComSignalType=BOOLEAN
            DET_HVC_FLAG_180_oRDR_DETECTION_177_180_oPCAN_RADAR_be41a254_Tx: ComSignalType=BOOLEAN
            DET_IDM_177_oRDR_DETECTION_177_180_oPCAN_RADAR_81377e21_Tx: ComSignalType=UINT8
            DET_IDM_178_oRDR_DETECTION_177_180_oPCAN_RADAR_ad27ec66_Tx: ComSignalType=UINT8
            DET_IDM_179_oRDR_DETECTION_177_180_oPCAN_RADAR_385738f3_Tx: ComSignalType=UINT8
            DET_IDM_180_oRDR_DETECTION_177_180_oPCAN_RADAR_351399e9_Tx: ComSignalType=UINT8
            DET_MH_CRC16_177_180_oRDR_DETECTION_177_180_oPCAN_RADAR_e8e8c183_Tx: ComSignalType=UINT16
            DET_MH_CYCLE_COUNTER_177_180_oRDR_DETECTION_177_180_oPCAN_RADAR_6c9d60b4_Tx: ComSignalType=UINT8
            DET_MH_SCAN_INDEX_4LSB_177_180_oRDR_DETECTION_177_180_oPCAN_RADAR_a0b74538_Tx: ComSignalType=UINT8
            DET_MTD_177_oRDR_DETECTION_177_180_oPCAN_RADAR_e7844cfa_Tx: ComSignalType=UINT8
            DET_MTD_178_oRDR_DETECTION_177_180_oPCAN_RADAR_cb94debd_Tx: ComSignalType=UINT8
            DET_MTD_179_oRDR_DETECTION_177_180_oPCAN_RADAR_5ee40a28_Tx: ComSignalType=UINT8
            DET_MTD_180_oRDR_DETECTION_177_180_oPCAN_RADAR_53a0ab32_Tx: ComSignalType=UINT8
            DET_PROB_1STAZHYPO_177_oRDR_DETECTION_177_180_oPCAN_RADAR_7430a437_Tx: ComSignalType=BOOLEAN
            DET_PROB_1STAZHYPO_178_oRDR_DETECTION_177_180_oPCAN_RADAR_58203670_Tx: ComSignalType=BOOLEAN
            DET_PROB_1STAZHYPO_179_oRDR_DETECTION_177_180_oPCAN_RADAR_cd50e2e5_Tx: ComSignalType=BOOLEAN
            DET_PROB_1STAZHYPO_180_oRDR_DETECTION_177_180_oPCAN_RADAR_c01443ff_Tx: ComSignalType=BOOLEAN
            DET_RANGE_177_oRDR_DETECTION_177_180_oPCAN_RADAR_7f9f4741_Tx: ComSignalType=UINT16
            DET_RANGE_178_oRDR_DETECTION_177_180_oPCAN_RADAR_538fd506_Tx: ComSignalType=UINT16
            DET_RANGE_179_oRDR_DETECTION_177_180_oPCAN_RADAR_c6ff0193_Tx: ComSignalType=UINT16
            DET_RANGE_180_oRDR_DETECTION_177_180_oPCAN_RADAR_cbbba089_Tx: ComSignalType=UINT16
            DET_RANGE_ERR_177_oRDR_DETECTION_177_180_oPCAN_RADAR_d877fd28_Tx: ComSignalType=UINT8
            DET_RANGE_ERR_178_oRDR_DETECTION_177_180_oPCAN_RADAR_f4676f6f_Tx: ComSignalType=UINT8
            DET_RANGE_ERR_179_oRDR_DETECTION_177_180_oPCAN_RADAR_6117bbfa_Tx: ComSignalType=UINT8
            DET_RANGE_ERR_180_oRDR_DETECTION_177_180_oPCAN_RADAR_6c531ae0_Tx: ComSignalType=UINT8
            DET_RANGE_VELOCITY_177_oRDR_DETECTION_177_180_oPCAN_RADAR_0a398564_Tx: ComSignalType=UINT16
            DET_RANGE_VELOCITY_178_oRDR_DETECTION_177_180_oPCAN_RADAR_26291723_Tx: ComSignalType=UINT16
            DET_RANGE_VELOCITY_179_oRDR_DETECTION_177_180_oPCAN_RADAR_b359c3b6_Tx: ComSignalType=UINT16
            DET_RANGE_VELOCITY_180_oRDR_DETECTION_177_180_oPCAN_RADAR_be1d62ac_Tx: ComSignalType=UINT16
            DET_RANGE_VELOCITY_ERR_177_oRDR_DETECTION_177_180_oPCAN_RADAR_05827ed6_Tx: ComSignalType=UINT8
            DET_RANGE_VELOCITY_ERR_178_oRDR_DETECTION_177_180_oPCAN_RADAR_2992ec91_Tx: ComSignalType=UINT8
            DET_RANGE_VELOCITY_ERR_179_oRDR_DETECTION_177_180_oPCAN_RADAR_bce23804_Tx: ComSignalType=UINT8
            DET_RANGE_VELOCITY_ERR_180_oRDR_DETECTION_177_180_oPCAN_RADAR_b1a6991e_Tx: ComSignalType=UINT8
            DET_RCS_177_oRDR_DETECTION_177_180_oPCAN_RADAR_8db9b23e_Tx: ComSignalType=UINT8
            DET_RCS_178_oRDR_DETECTION_177_180_oPCAN_RADAR_a1a92079_Tx: ComSignalType=UINT8
            DET_RCS_179_oRDR_DETECTION_177_180_oPCAN_RADAR_34d9f4ec_Tx: ComSignalType=UINT8
            DET_RCS_180_oRDR_DETECTION_177_180_oPCAN_RADAR_399d55f6_Tx: ComSignalType=UINT8
            DET_SNR_177_oRDR_DETECTION_177_180_oPCAN_RADAR_5017e63c_Tx: ComSignalType=UINT8
            DET_SNR_178_oRDR_DETECTION_177_180_oPCAN_RADAR_7c07747b_Tx: ComSignalType=UINT8
            DET_SNR_179_oRDR_DETECTION_177_180_oPCAN_RADAR_e977a0ee_Tx: ComSignalType=UINT8
            DET_SNR_180_oRDR_DETECTION_177_180_oPCAN_RADAR_e43301f4_Tx: ComSignalType=UINT8
            DET_SUPER_RES_TARGET_177_oRDR_DETECTION_177_180_oPCAN_RADAR_618ece59_Tx: ComSignalType=BOOLEAN
            DET_SUPER_RES_TARGET_178_oRDR_DETECTION_177_180_oPCAN_RADAR_4d9e5c1e_Tx: ComSignalType=BOOLEAN
            DET_SUPER_RES_TARGET_179_oRDR_DETECTION_177_180_oPCAN_RADAR_d8ee888b_Tx: ComSignalType=BOOLEAN
            DET_SUPER_RES_TARGET_180_oRDR_DETECTION_177_180_oPCAN_RADAR_d5aa2991_Tx: ComSignalType=BOOLEAN
