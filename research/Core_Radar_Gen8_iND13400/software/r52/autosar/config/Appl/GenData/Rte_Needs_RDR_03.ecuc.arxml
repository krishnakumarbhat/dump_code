[part 3 of 8: package /DaVinci_Project]
AUTOSAR XML (schema 4-0-3)
package /DaVinci_Project  (continued)
  module config Com  (continued)
    ComConfig  (continued)
      239 x ComSignalGroup:  (continued)
        SG_Detections_181_184_oRDR_DETECTION_181_184_oPCAN_RADAR_48363651_Tx
          83 x ComGroupSignal:
            DET_AZIMUTH_181_oRDR_DETECTION_181_184_oPCAN_RADAR_dfa27e51_Tx: ComSignalType=UINT16
            DET_AZIMUTH_182_oRDR_DETECTION_181_184_oPCAN_RADAR_bb4205af_Tx: ComSignalType=UINT16
            DET_AZIMUTH_183_oRDR_DETECTION_181_184_oPCAN_RADAR_2e32d13a_Tx: ComSignalType=UINT16
            DET_AZIMUTH_184_oRDR_DETECTION_181_184_oPCAN_RADAR_7282f253_Tx: ComSignalType=UINT16
            DET_AZIMUTH_ERR_181_oRDR_DETECTION_181_184_oPCAN_RADAR_7b17eba4_Tx: ComSignalType=UINT8
            DET_AZIMUTH_ERR_182_oRDR_DETECTION_181_184_oPCAN_RADAR_1ff7905a_Tx: ComSignalType=UINT8
            DET_AZIMUTH_ERR_183_oRDR_DETECTION_181_184_oPCAN_RADAR_8a8744cf_Tx: ComSignalType=UINT8
            DET_AZIMUTH_ERR_184_oRDR_DETECTION_181_184_oPCAN_RADAR_d63767a6_Tx: ComSignalType=UINT8
            DET_BELOW_RAIN_THOLD_181_oRDR_DETECTION_181_184_oPCAN_RADAR_0aa3ed91_Tx: ComSignalType=UINT8
            DET_BELOW_RAIN_THOLD_182_oRDR_DETECTION_181_184_oPCAN_RADAR_6e43966f_Tx: ComSignalType=UINT8
            DET_BELOW_RAIN_THOLD_183_oRDR_DETECTION_181_184_oPCAN_RADAR_fb3342fa_Tx: ComSignalType=UINT8
            DET_BELOW_RAIN_THOLD_184_oRDR_DETECTION_181_184_oPCAN_RADAR_a7836193_Tx: ComSignalType=UINT8
            DET_BI_STATIC_FLAG_181_oRDR_DETECTION_181_184_oPCAN_RADAR_898e3ed4_Tx: ComSignalType=BOOLEAN
            DET_BI_STATIC_FLAG_182_oRDR_DETECTION_181_184_oPCAN_RADAR_ed6e452a_Tx: ComSignalType=BOOLEAN
            DET_BI_STATIC_FLAG_183_oRDR_DETECTION_181_184_oPCAN_RADAR_781e91bf_Tx: ComSignalType=BOOLEAN
            DET_BI_STATIC_FLAG_184_oRDR_DETECTION_181_184_oPCAN_RADAR_24aeb2d6_Tx: ComSignalType=BOOLEAN
            DET_CONFD_AZIMUTH_181_oRDR_DETECTION_181_184_oPCAN_RADAR_dd44749b_Tx: ComSignalType=UINT8
            DET_CONFD_AZIMUTH_182_oRDR_DETECTION_181_184_oPCAN_RADAR_b9a40f65_Tx: ComSignalType=UINT8
            DET_CONFD_AZIMUTH_183_oRDR_DETECTION_181_184_oPCAN_RADAR_2cd4dbf0_Tx: ComSignalType=UINT8
            DET_CONFD_AZIMUTH_184_oRDR_DETECTION_181_184_oPCAN_RADAR_7064f899_Tx: ComSignalType=UINT8
            DET_CONFD_ELEVATION_181_oRDR_DETECTION_181_184_oPCAN_RADAR_dfd17561_Tx: ComSignalType=UINT8
            DET_CONFD_ELEVATION_182_oRDR_DETECTION_181_184_oPCAN_RADAR_bb310e9f_Tx: ComSignalType=UINT8
            DET_CONFD_ELEVATION_183_oRDR_DETECTION_181_184_oPCAN_RADAR_2e41da0a_Tx: ComSignalType=UINT8
            DET_CONFD_ELEVATION_184_oRDR_DETECTION_181_184_oPCAN_RADAR_72f1f963_Tx: ComSignalType=UINT8
            DET_ELEVATION_181_oRDR_DETECTION_181_184_oPCAN_RADAR_0e11a15d_Tx: ComSignalType=UINT8
            DET_ELEVATION_182_oRDR_DETECTION_181_184_oPCAN_RADAR_6af1daa3_Tx: ComSignalType=UINT8
            DET_ELEVATION_183_oRDR_DETECTION_181_184_oPCAN_RADAR_ff810e36_Tx: ComSignalType=UINT8
            DET_ELEVATION_184_oRDR_DETECTION_181_184_oPCAN_RADAR_a3312d5f_Tx: ComSignalType=UINT8
            DET_ELEVATION_ERR_181_oRDR_DETECTION_181_184_oPCAN_RADAR_89283928_Tx: ComSignalType=UINT8
            DET_ELEVATION_ERR_182_oRDR_DETECTION_181_184_oPCAN_RADAR_edc842d6_Tx: ComSignalType=UINT8
            DET_ELEVATION_ERR_183_oRDR_DETECTION_181_184_oPCAN_RADAR_78b89643_Tx: ComSignalType=UINT8
            DET_ELEVATION_ERR_184_oRDR_DETECTION_181_184_oPCAN_RADAR_2408b52a_Tx: ComSignalType=UINT8
            DET_EXISTENCE_PROB_181_oRDR_DETECTION_181_184_oPCAN_RADAR_5bb74c48_Tx: ComSignalType=UINT8
            DET_EXISTENCE_PROB_182_oRDR_DETECTION_181_184_oPCAN_RADAR_3f5737b6_Tx: ComSignalType=UINT8
            DET_EXISTENCE_PROB_183_oRDR_DETECTION_181_184_oPCAN_RADAR_aa27e323_Tx: ComSignalType=UINT8
            DET_EXISTENCE_PROB_184_oRDR_DETECTION_181_184_oPCAN_RADAR_f697c04a_Tx: ComSignalType=UINT8
            DET_HVC_FLAG_181_oRDR_DETECTION_181_184_oPCAN_RADAR_bac30f37_Tx: ComSignalType=BOOLEAN
            DET_HVC_FLAG_182_oRDR_DETECTION_181_184_oPCAN_RADAR_de2374c9_Tx: ComSignalType=BOOLEAN
            DET_HVC_FLAG_183_oRDR_DETECTION_181_184_oPCAN_RADAR_4b53a05c_Tx: ComSignalType=BOOLEAN
            DET_HVC_FLAG_184_oRDR_DETECTION_181_184_oPCAN_RADAR_17e38335_Tx: ComSignalType=BOOLEAN
            DET_IDM_181_oRDR_DETECTION_181_184_oPCAN_RADAR_3191348a_Tx: ComSignalType=UINT8
            DET_IDM_182_oRDR_DETECTION_181_184_oPCAN_RADAR_55714f74_Tx: ComSignalType=UINT8
            DET_IDM_183_oRDR_DETECTION_181_184_oPCAN_RADAR_c0019be1_Tx: ComSignalType=UINT8
            DET_IDM_184_oRDR_DETECTION_181_184_oPCAN_RADAR_9cb1b888_Tx: ComSignalType=UINT8
            DET_MH_CRC16_181_184_oRDR_DETECTION_181_184_oPCAN_RADAR_ccbee45a_Tx: ComSignalType=UINT16
            DET_MH_CYCLE_COUNTER_181_184_oRDR_DETECTION_181_184_oPCAN_RADAR_48cb456d_Tx: ComSignalType=UINT8
            DET_MH_SCAN_INDEX_4LSB_181_184_oRDR_DETECTION_181_184_oPCAN_RADAR_84e160e1_Tx: ComSignalType=UINT8
            DET_MTD_181_oRDR_DETECTION_181_184_oPCAN_RADAR_57220651_Tx: ComSignalType=UINT8
            DET_MTD_182_oRDR_DETECTION_181_184_oPCAN_RADAR_33c27daf_Tx: ComSignalType=UINT8
            DET_MTD_183_oRDR_DETECTION_181_184_oPCAN_RADAR_a6b2a93a_Tx: ComSignalType=UINT8
            DET_MTD_184_oRDR_DETECTION_181_184_oPCAN_RADAR_fa028a53_Tx: ComSignalType=UINT8
            DET_PROB_1STAZHYPO_181_oRDR_DETECTION_181_184_oPCAN_RADAR_c496ee9c_Tx: ComSignalType=BOOLEAN
            DET_PROB_1STAZHYPO_182_oRDR_DETECTION_181_184_oPCAN_RADAR_a0769562_Tx: ComSignalType=BOOLEAN
            DET_PROB_1STAZHYPO_183_oRDR_DETECTION_181_184_oPCAN_RADAR_350641f7_Tx: ComSignalType=BOOLEAN
            DET_PROB_1STAZHYPO_184_oRDR_DETECTION_181_184_oPCAN_RADAR_69b6629e_Tx: ComSignalType=BOOLEAN
            DET_RANGE_181_oRDR_DETECTION_181_184_oPCAN_RADAR_cf390dea_Tx: ComSignalType=UINT16
            DET_RANGE_182_oRDR_DETECTION_181_184_oPCAN_RADAR_abd97614_Tx: ComSignalType=UINT16
            DET_RANGE_183_oRDR_DETECTION_181_184_oPCAN_RADAR_3ea9a281_Tx: ComSignalType=UINT16
            DET_RANGE_184_oRDR_DETECTION_181_184_oPCAN_RADAR_621981e8_Tx: ComSignalType=UINT16
            DET_RANGE_ERR_181_oRDR_DETECTION_181_184_oPCAN_RADAR_68d1b783_Tx: ComSignalType=UINT8
            DET_RANGE_ERR_182_oRDR_DETECTION_181_184_oPCAN_RADAR_0c31cc7d_Tx: ComSignalType=UINT8
            DET_RANGE_ERR_183_oRDR_DETECTION_181_184_oPCAN_RADAR_994118e8_Tx: ComSignalType=UINT8
            DET_RANGE_ERR_184_oRDR_DETECTION_181_184_oPCAN_RADAR_c5f13b81_Tx: ComSignalType=UINT8
            DET_RANGE_VELOCITY_181_oRDR_DETECTION_181_184_oPCAN_RADAR_ba9fcfcf_Tx: ComSignalType=UINT16
            DET_RANGE_VELOCITY_182_oRDR_DETECTION_181_184_oPCAN_RADAR_de7fb431_Tx: ComSignalType=UINT16
            DET_RANGE_VELOCITY_183_oRDR_DETECTION_181_184_oPCAN_RADAR_4b0f60a4_Tx: ComSignalType=UINT16
            DET_RANGE_VELOCITY_184_oRDR_DETECTION_181_184_oPCAN_RADAR_17bf43cd_Tx: ComSignalType=UINT16
            DET_RANGE_VELOCITY_ERR_181_oRDR_DETECTION_181_184_oPCAN_RADAR_b524347d_Tx: ComSignalType=UINT8
            DET_RANGE_VELOCITY_ERR_182_oRDR_DETECTION_181_184_oPCAN_RADAR_d1c44f83_Tx: ComSignalType=UINT8
            DET_RANGE_VELOCITY_ERR_183_oRDR_DETECTION_181_184_oPCAN_RADAR_44b49b16_Tx: ComSignalType=UINT8
            DET_RANGE_VELOCITY_ERR_184_oRDR_DETECTION_181_184_oPCAN_RADAR_1804b87f_Tx: ComSignalType=UINT8
            DET_RCS_181_oRDR_DETECTION_181_184_oPCAN_RADAR_3d1ff895_Tx: ComSignalType=UINT8
            DET_RCS_182_oRDR_DETECTION_181_184_oPCAN_RADAR_59ff836b_Tx: ComSignalType=UINT8
            DET_RCS_183_oRDR_DETECTION_181_184_oPCAN_RADAR_cc8f57fe_Tx: ComSignalType=UINT8
            DET_RCS_184_oRDR_DETECTION_181_184_oPCAN_RADAR_903f7497_Tx: ComSignalType=UINT8
            DET_SNR_181_oRDR_DETECTION_181_184_oPCAN_RADAR_e0b1ac97_Tx: ComSignalType=UINT8
            DET_SNR_182_oRDR_DETECTION_181_184_oPCAN_RADAR_8451d769_Tx: ComSignalType=UINT8
            DET_SNR_183_oRDR_DETECTION_181_184_oPCAN_RADAR_112103fc_Tx: ComSignalType=UINT8
            DET_SNR_184_oRDR_DETECTION_181_184_oPCAN_RADAR_4d912095_Tx: ComSignalType=UINT8
            DET_SUPER_RES_TARGET_181_oRDR_DETECTION_181_184_oPCAN_RADAR_d12884f2_Tx: ComSignalType=BOOLEAN
            DET_SUPER_RES_TARGET_182_oRDR_DETECTION_181_184_oPCAN_RADAR_b5c8ff0c_Tx: ComSignalType=BOOLEAN
            DET_SUPER_RES_TARGET_183_oRDR_DETECTION_181_184_oPCAN_RADAR_20b82b99_Tx: ComSignalType=BOOLEAN
            DET_SUPER_RES_TARGET_184_oRDR_DETECTION_181_184_oPCAN_RADAR_7c0808f0_Tx: ComSignalType=BOOLEAN
        SG_Detections_185_188_oRDR_DETECTION_185_188_oPCAN_RADAR_39f50203_Tx
          83 x ComGroupSignal:
            DET_AZIMUTH_185_oRDR_DETECTION_185_188_oPCAN_RADAR_0e40b8f2_Tx: ComSignalType=UINT16
            DET_AZIMUTH_186_oRDR_DETECTION_185_188_oPCAN_RADAR_6aa0c30c_Tx: ComSignalType=UINT16
            DET_AZIMUTH_187_oRDR_DETECTION_185_188_oPCAN_RADAR_ffd01799_Tx: ComSignalType=UINT16
            DET_AZIMUTH_188_oRDR_DETECTION_185_188_oPCAN_RADAR_d3c085de_Tx: ComSignalType=UINT16
            DET_AZIMUTH_ERR_185_oRDR_DETECTION_185_188_oPCAN_RADAR_aaf52d07_Tx: ComSignalType=UINT8
            DET_AZIMUTH_ERR_186_oRDR_DETECTION_185_188_oPCAN_RADAR_ce1556f9_Tx: ComSignalType=UINT8
            DET_AZIMUTH_ERR_187_oRDR_DETECTION_185_188_oPCAN_RADAR_5b65826c_Tx: ComSignalType=UINT8
            DET_AZIMUTH_ERR_188_oRDR_DETECTION_185_188_oPCAN_RADAR_7775102b_Tx: ComSignalType=UINT8
            DET_BELOW_RAIN_THOLD_185_oRDR_DETECTION_185_188_oPCAN_RADAR_db412b32_Tx: ComSignalType=UINT8
            DET_BELOW_RAIN_THOLD_186_oRDR_DETECTION_185_188_oPCAN_RADAR_bfa150cc_Tx: ComSignalType=UINT8
            DET_BELOW_RAIN_THOLD_187_oRDR_DETECTION_185_188_oPCAN_RADAR_2ad18459_Tx: ComSignalType=UINT8
            DET_BELOW_RAIN_THOLD_188_oRDR_DETECTION_185_188_oPCAN_RADAR_06c1161e_Tx: ComSignalType=UINT8
            DET_BI_STATIC_FLAG_185_oRDR_DETECTION_185_188_oPCAN_RADAR_586cf877_Tx: ComSignalType=BOOLEAN
            DET_BI_STATIC_FLAG_186_oRDR_DETECTION_185_188_oPCAN_RADAR_3c8c8389_Tx: ComSignalType=BOOLEAN
            DET_BI_STATIC_FLAG_187_oRDR_DETECTION_185_188_oPCAN_RADAR_a9fc571c_Tx: ComSignalType=BOOLEAN
            DET_BI_STATIC_FLAG_188_oRDR_DETECTION_185_188_oPCAN_RADAR_85ecc55b_Tx: ComSignalType=BOOLEAN
            DET_CONFD_AZIMUTH_185_oRDR_DETECTION_185_188_oPCAN_RADAR_0ca6b238_Tx: ComSignalType=UINT8
            DET_CONFD_AZIMUTH_186_oRDR_DETECTION_185_188_oPCAN_RADAR_6846c9c6_Tx: ComSignalType=UINT8
            DET_CONFD_AZIMUTH_187_oRDR_DETECTION_185_188_oPCAN_RADAR_fd361d53_Tx: ComSignalType=UINT8
            DET_CONFD_AZIMUTH_188_oRDR_DETECTION_185_188_oPCAN_RADAR_d1268f14_Tx: ComSignalType=UINT8
            DET_CONFD_ELEVATION_185_oRDR_DETECTION_185_188_oPCAN_RADAR_0e33b3c2_Tx: ComSignalType=UINT8
            DET_CONFD_ELEVATION_186_oRDR_DETECTION_185_188_oPCAN_RADAR_6ad3c83c_Tx: ComSignalType=UINT8
            DET_CONFD_ELEVATION_187_oRDR_DETECTION_185_188_oPCAN_RADAR_ffa31ca9_Tx: ComSignalType=UINT8
            DET_CONFD_ELEVATION_188_oRDR_DETECTION_185_188_oPCAN_RADAR_d3b38eee_Tx: ComSignalType=UINT8
            DET_ELEVATION_185_oRDR_DETECTION_185_188_oPCAN_RADAR_dff367fe_Tx: ComSignalType=UINT8
            DET_ELEVATION_186_oRDR_DETECTION_185_188_oPCAN_RADAR_bb131c00_Tx: ComSignalType=UINT8
            DET_ELEVATION_187_oRDR_DETECTION_185_188_oPCAN_RADAR_2e63c895_Tx: ComSignalType=UINT8
            DET_ELEVATION_188_oRDR_DETECTION_185_188_oPCAN_RADAR_02735ad2_Tx: ComSignalType=UINT8
            DET_ELEVATION_ERR_185_oRDR_DETECTION_185_188_oPCAN_RADAR_58caff8b_Tx: ComSignalType=UINT8
            DET_ELEVATION_ERR_186_oRDR_DETECTION_185_188_oPCAN_RADAR_3c2a8475_Tx: ComSignalType=UINT8
            DET_ELEVATION_ERR_187_oRDR_DETECTION_185_188_oPCAN_RADAR_a95a50e0_Tx: ComSignalType=UINT8
            DET_ELEVATION_ERR_188_oRDR_DETECTION_185_188_oPCAN_RADAR_854ac2a7_Tx: ComSignalType=UINT8
            DET_EXISTENCE_PROB_185_oRDR_DETECTION_185_188_oPCAN_RADAR_8a558aeb_Tx: ComSignalType=UINT8
            DET_EXISTENCE_PROB_186_oRDR_DETECTION_185_188_oPCAN_RADAR_eeb5f115_Tx: ComSignalType=UINT8
            DET_EXISTENCE_PROB_187_oRDR_DETECTION_185_188_oPCAN_RADAR_7bc52580_Tx: ComSignalType=UINT8
            DET_EXISTENCE_PROB_188_oRDR_DETECTION_185_188_oPCAN_RADAR_57d5b7c7_Tx: ComSignalType=UINT8
            DET_HVC_FLAG_185_oRDR_DETECTION_185_188_oPCAN_RADAR_6b21c994_Tx: ComSignalType=BOOLEAN
            DET_HVC_FLAG_186_oRDR_DETECTION_185_188_oPCAN_RADAR_0fc1b26a_Tx: ComSignalType=BOOLEAN
            DET_HVC_FLAG_187_oRDR_DETECTION_185_188_oPCAN_RADAR_9ab166ff_Tx: ComSignalType=BOOLEAN
            DET_HVC_FLAG_188_oRDR_DETECTION_185_188_oPCAN_RADAR_b6a1f4b8_Tx: ComSignalType=BOOLEAN
            DET_IDM_185_oRDR_DETECTION_185_188_oPCAN_RADAR_e073f229_Tx: ComSignalType=UINT8
            DET_IDM_186_oRDR_DETECTION_185_188_oPCAN_RADAR_849389d7_Tx: ComSignalType=UINT8
            DET_IDM_187_oRDR_DETECTION_185_188_oPCAN_RADAR_11e35d42_Tx: ComSignalType=UINT8
            DET_IDM_188_oRDR_DETECTION_185_188_oPCAN_RADAR_3df3cf05_Tx: ComSignalType=UINT8
            DET_MH_CRC16_185_188_oRDR_DETECTION_185_188_oPCAN_RADAR_bd7dd008_Tx: ComSignalType=UINT16
            DET_MH_CYCLE_COUNTER_185_188_oRDR_DETECTION_185_188_oPCAN_RADAR_3908713f_Tx: ComSignalType=UINT8
            DET_MH_SCAN_INDEX_4LSB_185_188_oRDR_DETECTION_185_188_oPCAN_RADAR_f52254b3_Tx: ComSignalType=UINT8
            DET_MTD_185_oRDR_DETECTION_185_188_oPCAN_RADAR_86c0c0f2_Tx: ComSignalType=UINT8
            DET_MTD_186_oRDR_DETECTION_185_188_oPCAN_RADAR_e220bb0c_Tx: ComSignalType=UINT8
            DET_MTD_187_oRDR_DETECTION_185_188_oPCAN_RADAR_77506f99_Tx: ComSignalType=UINT8
            DET_MTD_188_oRDR_DETECTION_185_188_oPCAN_RADAR_5b40fdde_Tx: ComSignalType=UINT8
            DET_PROB_1STAZHYPO_185_oRDR_DETECTION_185_188_oPCAN_RADAR_1574283f_Tx: ComSignalType=BOOLEAN
            DET_PROB_1STAZHYPO_186_oRDR_DETECTION_185_188_oPCAN_RADAR_719453c1_Tx: ComSignalType=BOOLEAN
            DET_PROB_1STAZHYPO_187_oRDR_DETECTION_185_188_oPCAN_RADAR_e4e48754_Tx: ComSignalType=BOOLEAN
            DET_PROB_1STAZHYPO_188_oRDR_DETECTION_185_188_oPCAN_RADAR_c8f41513_Tx: ComSignalType=BOOLEAN
            DET_RANGE_185_oRDR_DETECTION_185_188_oPCAN_RADAR_1edbcb49_Tx: ComSignalType=UINT16
            DET_RANGE_186_oRDR_DETECTION_185_188_oPCAN_RADAR_7a3bb0b7_Tx: ComSignalType=UINT16
            DET_RANGE_187_oRDR_DETECTION_185_188_oPCAN_RADAR_ef4b6422_Tx: ComSignalType=UINT16
            DET_RANGE_188_oRDR_DETECTION_185_188_oPCAN_RADAR_c35bf665_Tx: ComSignalType=UINT16
            DET_RANGE_ERR_185_oRDR_DETECTION_185_188_oPCAN_RADAR_b9337120_Tx: ComSignalType=UINT8
            DET_RANGE_ERR_186_oRDR_DETECTION_185_188_oPCAN_RADAR_ddd30ade_Tx: ComSignalType=UINT8
            DET_RANGE_ERR_187_oRDR_DETECTION_185_188_oPCAN_RADAR_48a3de4b_Tx: ComSignalType=UINT8
            DET_RANGE_ERR_188_oRDR_DETECTION_185_188_oPCAN_RADAR_64b34c0c_Tx: ComSignalType=UINT8
            DET_RANGE_VELOCITY_185_oRDR_DETECTION_185_188_oPCAN_RADAR_6b7d096c_Tx: ComSignalType=UINT16
            DET_RANGE_VELOCITY_186_oRDR_DETECTION_185_188_oPCAN_RADAR_0f9d7292_Tx: ComSignalType=UINT16
            DET_RANGE_VELOCITY_187_oRDR_DETECTION_185_188_oPCAN_RADAR_9aeda607_Tx: ComSignalType=UINT16
            DET_RANGE_VELOCITY_188_oRDR_DETECTION_185_188_oPCAN_RADAR_b6fd3440_Tx: ComSignalType=UINT16
            DET_RANGE_VELOCITY_ERR_185_oRDR_DETECTION_185_188_oPCAN_RADAR_64c6f2de_Tx: ComSignalType=UINT8
            DET_RANGE_VELOCITY_ERR_186_oRDR_DETECTION_185_188_oPCAN_RADAR_00268920_Tx: ComSignalType=UINT8
            DET_RANGE_VELOCITY_ERR_187_oRDR_DETECTION_185_188_oPCAN_RADAR_95565db5_Tx: ComSignalType=UINT8
            DET_RANGE_VELOCITY_ERR_188_oRDR_DETECTION_185_188_oPCAN_RADAR_b946cff2_Tx: ComSignalType=UINT8
            DET_RCS_185_oRDR_DETECTION_185_188_oPCAN_RADAR_ecfd3e36_Tx: ComSignalType=UINT8
            DET_RCS_186_oRDR_DETECTION_185_188_oPCAN_RADAR_881d45c8_Tx: ComSignalType=UINT8
            DET_RCS_187_oRDR_DETECTION_185_188_oPCAN_RADAR_1d6d915d_Tx: ComSignalType=UINT8
            DET_RCS_188_oRDR_DETECTION_185_188_oPCAN_RADAR_317d031a_Tx: ComSignalType=UINT8
            DET_SNR_185_oRDR_DETECTION_185_188_oPCAN_RADAR_31536a34_Tx: ComSignalType=UINT8
            DET_SNR_186_oRDR_DETECTION_185_188_oPCAN_RADAR_55b311ca_Tx: ComSignalType=UINT8
            DET_SNR_187_oRDR_DETECTION_185_188_oPCAN_RADAR_c0c3c55f_Tx: ComSignalType=UINT8
            DET_SNR_188_oRDR_DETECTION_185_188_oPCAN_RADAR_ecd35718_Tx: ComSignalType=UINT8
            DET_SUPER_RES_TARGET_185_oRDR_DETECTION_185_188_oPCAN_RADAR_00ca4251_Tx: ComSignalType=BOOLEAN
            DET_SUPER_RES_TARGET_186_oRDR_DETECTION_185_188_oPCAN_RADAR_642a39af_Tx: ComSignalType=BOOLEAN
            DET_SUPER_RES_TARGET_187_oRDR_DETECTION_185_188_oPCAN_RADAR_f15aed3a_Tx: ComSignalType=BOOLEAN
            DET_SUPER_RES_TARGET_188_oRDR_DETECTION_185_188_oPCAN_RADAR_dd4a7f7d_Tx: ComSignalType=BOOLEAN
        SG_Detections_189_192_oRDR_DETECTION_189_192_oPCAN_RADAR_a08f2678_Tx
          83 x ComGroupSignal:
            DET_AZIMUTH_189_oRDR_DETECTION_189_192_oPCAN_RADAR_74f8be4a_Tx: ComSignalType=UINT16
            DET_AZIMUTH_190_oRDR_DETECTION_189_192_oPCAN_RADAR_11d8ccee_Tx: ComSignalType=UINT16
            DET_AZIMUTH_191_oRDR_DETECTION_189_192_oPCAN_RADAR_84a8187b_Tx: ComSignalType=UINT16
            DET_AZIMUTH_192_oRDR_DETECTION_189_192_oPCAN_RADAR_e0486385_Tx: ComSignalType=UINT16
            DET_AZIMUTH_ERR_189_oRDR_DETECTION_189_192_oPCAN_RADAR_d04d2bbf_Tx: ComSignalType=UINT8
            DET_AZIMUTH_ERR_190_oRDR_DETECTION_189_192_oPCAN_RADAR_b56d591b_Tx: ComSignalType=UINT8
            DET_AZIMUTH_ERR_191_oRDR_DETECTION_189_192_oPCAN_RADAR_201d8d8e_Tx: ComSignalType=UINT8
            DET_AZIMUTH_ERR_192_oRDR_DETECTION_189_192_oPCAN_RADAR_44fdf670_Tx: ComSignalType=UINT8
            DET_BELOW_RAIN_THOLD_189_oRDR_DETECTION_189_192_oPCAN_RADAR_a1f92d8a_Tx: ComSignalType=UINT8
            DET_BELOW_RAIN_THOLD_190_oRDR_DETECTION_189_192_oPCAN_RADAR_c4d95f2e_Tx: ComSignalType=UINT8
            DET_BELOW_RAIN_THOLD_191_oRDR_DETECTION_189_192_oPCAN_RADAR_51a98bbb_Tx: ComSignalType=UINT8
            DET_BELOW_RAIN_THOLD_192_oRDR_DETECTION_189_192_oPCAN_RADAR_3549f045_Tx: ComSignalType=UINT8
            DET_BI_STATIC_FLAG_189_oRDR_DETECTION_189_192_oPCAN_RADAR_22d4fecf_Tx: ComSignalType=BOOLEAN
            DET_BI_STATIC_FLAG_190_oRDR_DETECTION_189_192_oPCAN_RADAR_47f48c6b_Tx: ComSignalType=BOOLEAN
            DET_BI_STATIC_FLAG_191_oRDR_DETECTION_189_192_oPCAN_RADAR_d28458fe_Tx: ComSignalType=BOOLEAN
            DET_BI_STATIC_FLAG_192_oRDR_DETECTION_189_192_oPCAN_RADAR_b6642300_Tx: ComSignalType=BOOLEAN
            DET_CONFD_AZIMUTH_189_oRDR_DETECTION_189_192_oPCAN_RADAR_761eb480_Tx: ComSignalType=UINT8
            DET_CONFD_AZIMUTH_190_oRDR_DETECTION_189_192_oPCAN_RADAR_133ec624_Tx: ComSignalType=UINT8
            DET_CONFD_AZIMUTH_191_oRDR_DETECTION_189_192_oPCAN_RADAR_864e12b1_Tx: ComSignalType=UINT8
            DET_CONFD_AZIMUTH_192_oRDR_DETECTION_189_192_oPCAN_RADAR_e2ae694f_Tx: ComSignalType=UINT8
            DET_CONFD_ELEVATION_189_oRDR_DETECTION_189_192_oPCAN_RADAR_748bb57a_Tx: ComSignalType=UINT8
            DET_CONFD_ELEVATION_190_oRDR_DETECTION_189_192_oPCAN_RADAR_11abc7de_Tx: ComSignalType=UINT8
            DET_CONFD_ELEVATION_191_oRDR_DETECTION_189_192_oPCAN_RADAR_84db134b_Tx: ComSignalType=UINT8
            DET_CONFD_ELEVATION_192_oRDR_DETECTION_189_192_oPCAN_RADAR_e03b68b5_Tx: ComSignalType=UINT8
            DET_ELEVATION_189_oRDR_DETECTION_189_192_oPCAN_RADAR_a54b6146_Tx: ComSignalType=UINT8
            DET_ELEVATION_190_oRDR_DETECTION_189_192_oPCAN_RADAR_c06b13e2_Tx: ComSignalType=UINT8
            DET_ELEVATION_191_oRDR_DETECTION_189_192_oPCAN_RADAR_551bc777_Tx: ComSignalType=UINT8
            DET_ELEVATION_192_oRDR_DETECTION_189_192_oPCAN_RADAR_31fbbc89_Tx: ComSignalType=UINT8
            DET_ELEVATION_ERR_189_oRDR_DETECTION_189_192_oPCAN_RADAR_2272f933_Tx: ComSignalType=UINT8
            DET_ELEVATION_ERR_190_oRDR_DETECTION_189_192_oPCAN_RADAR_47528b97_Tx: ComSignalType=UINT8
            DET_ELEVATION_ERR_191_oRDR_DETECTION_189_192_oPCAN_RADAR_d2225f02_Tx: ComSignalType=UINT8
            DET_ELEVATION_ERR_192_oRDR_DETECTION_189_192_oPCAN_RADAR_b6c224fc_Tx: ComSignalType=UINT8
            DET_EXISTENCE_PROB_189_oRDR_DETECTION_189_192_oPCAN_RADAR_f0ed8c53_Tx: ComSignalType=UINT8
            DET_EXISTENCE_PROB_190_oRDR_DETECTION_189_192_oPCAN_RADAR_95cdfef7_Tx: ComSignalType=UINT8
            DET_EXISTENCE_PROB_191_oRDR_DETECTION_189_192_oPCAN_RADAR_00bd2a62_Tx: ComSignalType=UINT8
            DET_EXISTENCE_PROB_192_oRDR_DETECTION_189_192_oPCAN_RADAR_645d519c_Tx: ComSignalType=UINT8
            DET_HVC_FLAG_189_oRDR_DETECTION_189_192_oPCAN_RADAR_1199cf2c_Tx: ComSignalType=BOOLEAN
            DET_HVC_FLAG_190_oRDR_DETECTION_189_192_oPCAN_RADAR_74b9bd88_Tx: ComSignalType=BOOLEAN
            DET_HVC_FLAG_191_oRDR_DETECTION_189_192_oPCAN_RADAR_e1c9691d_Tx: ComSignalType=BOOLEAN
            DET_HVC_FLAG_192_oRDR_DETECTION_189_192_oPCAN_RADAR_852912e3_Tx: ComSignalType=BOOLEAN
            DET_IDM_189_oRDR_DETECTION_189_192_oPCAN_RADAR_9acbf491_Tx: ComSignalType=UINT8
            DET_IDM_190_oRDR_DETECTION_189_192_oPCAN_RADAR_ffeb8635_Tx: ComSignalType=UINT8
            DET_IDM_191_oRDR_DETECTION_189_192_oPCAN_RADAR_6a9b52a0_Tx: ComSignalType=UINT8
            DET_IDM_192_oRDR_DETECTION_189_192_oPCAN_RADAR_0e7b295e_Tx: ComSignalType=UINT8
            DET_MH_CRC16_189_192_oRDR_DETECTION_189_192_oPCAN_RADAR_2407f473_Tx: ComSignalType=UINT16
            DET_MH_CYCLE_COUNTER_189_192_oRDR_DETECTION_189_192_oPCAN_RADAR_a0725544_Tx: ComSignalType=UINT8
            DET_MH_SCAN_INDEX_4LSB_189_192_oRDR_DETECTION_189_192_oPCAN_RADAR_6c5870c8_Tx: ComSignalType=UINT8
            DET_MTD_189_oRDR_DETECTION_189_192_oPCAN_RADAR_fc78c64a_Tx: ComSignalType=UINT8
            DET_MTD_190_oRDR_DETECTION_189_192_oPCAN_RADAR_9958b4ee_Tx: ComSignalType=UINT8
            DET_MTD_191_oRDR_DETECTION_189_192_oPCAN_RADAR_0c28607b_Tx: ComSignalType=UINT8
            DET_MTD_192_oRDR_DETECTION_189_192_oPCAN_RADAR_68c81b85_Tx: ComSignalType=UINT8
            DET_PROB_1STAZHYPO_189_oRDR_DETECTION_189_192_oPCAN_RADAR_6fcc2e87_Tx: ComSignalType=BOOLEAN
            DET_PROB_1STAZHYPO_190_oRDR_DETECTION_189_192_oPCAN_RADAR_0aec5c23_Tx: ComSignalType=BOOLEAN
            DET_PROB_1STAZHYPO_191_oRDR_DETECTION_189_192_oPCAN_RADAR_9f9c88b6_Tx: ComSignalType=BOOLEAN
            DET_PROB_1STAZHYPO_192_oRDR_DETECTION_189_192_oPCAN_RADAR_fb7cf348_Tx: ComSignalType=BOOLEAN
            DET_RANGE_189_oRDR_DETECTION_189_192_oPCAN_RADAR_6463cdf1_Tx: ComSignalType=UINT16
            DET_RANGE_190_oRDR_DETECTION_189_192_oPCAN_RADAR_0143bf55_Tx: ComSignalType=UINT16
            DET_RANGE_191_oRDR_DETECTION_189_192_oPCAN_RADAR_94336bc0_Tx: ComSignalType=UINT16
            DET_RANGE_192_oRDR_DETECTION_189_192_oPCAN_RADAR_f0d3103e_Tx: ComSignalType=UINT16
            DET_RANGE_ERR_189_oRDR_DETECTION_189_192_oPCAN_RADAR_c38b7798_Tx: ComSignalType=UINT8
            DET_RANGE_ERR_190_oRDR_DETECTION_189_192_oPCAN_RADAR_a6ab053c_Tx: ComSignalType=UINT8
            DET_RANGE_ERR_191_oRDR_DETECTION_189_192_oPCAN_RADAR_33dbd1a9_Tx: ComSignalType=UINT8
            DET_RANGE_ERR_192_oRDR_DETECTION_189_192_oPCAN_RADAR_573baa57_Tx: ComSignalType=UINT8
            DET_RANGE_VELOCITY_189_oRDR_DETECTION_189_192_oPCAN_RADAR_11c50fd4_Tx: ComSignalType=UINT16
            DET_RANGE_VELOCITY_190_oRDR_DETECTION_189_192_oPCAN_RADAR_74e57d70_Tx: ComSignalType=UINT16
            DET_RANGE_VELOCITY_191_oRDR_DETECTION_189_192_oPCAN_RADAR_e195a9e5_Tx: ComSignalType=UINT16
            DET_RANGE_VELOCITY_192_oRDR_DETECTION_189_192_oPCAN_RADAR_8575d21b_Tx: ComSignalType=UINT16
            DET_RANGE_VELOCITY_ERR_189_oRDR_DETECTION_189_192_oPCAN_RADAR_1e7ef466_Tx: ComSignalType=UINT8
            DET_RANGE_VELOCITY_ERR_190_oRDR_DETECTION_189_192_oPCAN_RADAR_7b5e86c2_Tx: ComSignalType=UINT8
            DET_RANGE_VELOCITY_ERR_191_oRDR_DETECTION_189_192_oPCAN_RADAR_ee2e5257_Tx: ComSignalType=UINT8
            DET_RANGE_VELOCITY_ERR_192_oRDR_DETECTION_189_192_oPCAN_RADAR_8ace29a9_Tx: ComSignalType=UINT8
            DET_RCS_189_oRDR_DETECTION_189_192_oPCAN_RADAR_9645388e_Tx: ComSignalType=UINT8
            DET_RCS_190_oRDR_DETECTION_189_192_oPCAN_RADAR_f3654a2a_Tx: ComSignalType=UINT8
            DET_RCS_191_oRDR_DETECTION_189_192_oPCAN_RADAR_66159ebf_Tx: ComSignalType=UINT8
            DET_RCS_192_oRDR_DETECTION_189_192_oPCAN_RADAR_02f5e541_Tx: ComSignalType=UINT8
            DET_SNR_189_oRDR_DETECTION_189_192_oPCAN_RADAR_4beb6c8c_Tx: ComSignalType=UINT8
            DET_SNR_190_oRDR_DETECTION_189_192_oPCAN_RADAR_2ecb1e28_Tx: ComSignalType=UINT8
            DET_SNR_191_oRDR_DETECTION_189_192_oPCAN_RADAR_bbbbcabd_Tx: ComSignalType=UINT8
            DET_SNR_192_oRDR_DETECTION_189_192_oPCAN_RADAR_df5bb143_Tx: ComSignalType=UINT8
            DET_SUPER_RES_TARGET_189_oRDR_DETECTION_189_192_oPCAN_RADAR_7a7244e9_Tx: ComSignalType=BOOLEAN
            DET_SUPER_RES_TARGET_190_oRDR_DETECTION_189_192_oPCAN_RADAR_1f52364d_Tx: ComSignalType=BOOLEAN
            DET_SUPER_RES_TARGET_191_oRDR_DETECTION_189_192_oPCAN_RADAR_8a22e2d8_Tx: ComSignalType=BOOLEAN
            DET_SUPER_RES_TARGET_192_oRDR_DETECTION_189_192_oPCAN_RADAR_eec29926_Tx: ComSignalType=BOOLEAN
        SG_Detections_193_196_oRDR_DETECTION_193_196_oPCAN_RADAR_92844e50_Tx
          83 x ComGroupSignal:
            DET_AZIMUTH_193_oRDR_DETECTION_193_196_oPCAN_RADAR_68ffb43e_Tx: ComSignalType=UINT16
            DET_AZIMUTH_194_oRDR_DETECTION_193_196_oPCAN_RADAR_344f9757_Tx: ComSignalType=UINT16
            DET_AZIMUTH_195_oRDR_DETECTION_193_196_oPCAN_RADAR_a13f43c2_Tx: ComSignalType=UINT16
            DET_AZIMUTH_196_oRDR_DETECTION_193_196_oPCAN_RADAR_c5df383c_Tx: ComSignalType=UINT16
            DET_AZIMUTH_ERR_193_oRDR_DETECTION_193_196_oPCAN_RADAR_cc4a21cb_Tx: ComSignalType=UINT8
            DET_AZIMUTH_ERR_194_oRDR_DETECTION_193_196_oPCAN_RADAR_90fa02a2_Tx: ComSignalType=UINT8
            DET_AZIMUTH_ERR_195_oRDR_DETECTION_193_196_oPCAN_RADAR_058ad637_Tx: ComSignalType=UINT8
            DET_AZIMUTH_ERR_196_oRDR_DETECTION_193_196_oPCAN_RADAR_616aadc9_Tx: ComSignalType=UINT8
            DET_BELOW_RAIN_THOLD_193_oRDR_DETECTION_193_196_oPCAN_RADAR_bdfe27fe_Tx: ComSignalType=UINT8
            DET_BELOW_RAIN_THOLD_194_oRDR_DETECTION_193_196_oPCAN_RADAR_e14e0497_Tx: ComSignalType=UINT8
            DET_BELOW_RAIN_THOLD_195_oRDR_DETECTION_193_196_oPCAN_RADAR_743ed002_Tx: ComSignalType=UINT8
            DET_BELOW_RAIN_THOLD_196_oRDR_DETECTION_193_196_oPCAN_RADAR_10deabfc_Tx: ComSignalType=UINT8
            DET_BI_STATIC_FLAG_193_oRDR_DETECTION_193_196_oPCAN_RADAR_3ed3f4bb_Tx: ComSignalType=BOOLEAN
            DET_BI_STATIC_FLAG_194_oRDR_DETECTION_193_196_oPCAN_RADAR_6263d7d2_Tx: ComSignalType=BOOLEAN
            DET_BI_STATIC_FLAG_195_oRDR_DETECTION_193_196_oPCAN_RADAR_f7130347_Tx: ComSignalType=BOOLEAN
            DET_BI_STATIC_FLAG_196_oRDR_DETECTION_193_196_oPCAN_RADAR_93f378b9_Tx: ComSignalType=BOOLEAN
            DET_CONFD_AZIMUTH_193_oRDR_DETECTION_193_196_oPCAN_RADAR_6a19bef4_Tx: ComSignalType=UINT8
            DET_CONFD_AZIMUTH_194_oRDR_DETECTION_193_196_oPCAN_RADAR_36a99d9d_Tx: ComSignalType=UINT8
            DET_CONFD_AZIMUTH_195_oRDR_DETECTION_193_196_oPCAN_RADAR_a3d94908_Tx: ComSignalType=UINT8
            DET_CONFD_AZIMUTH_196_oRDR_DETECTION_193_196_oPCAN_RADAR_c73932f6_Tx: ComSignalType=UINT8
            DET_CONFD_ELEVATION_193_oRDR_DETECTION_193_196_oPCAN_RADAR_688cbf0e_Tx: ComSignalType=UINT8
            DET_CONFD_ELEVATION_194_oRDR_DETECTION_193_196_oPCAN_RADAR_343c9c67_Tx: ComSignalType=UINT8
            DET_CONFD_ELEVATION_195_oRDR_DETECTION_193_196_oPCAN_RADAR_a14c48f2_Tx: ComSignalType=UINT8
            DET_CONFD_ELEVATION_196_oRDR_DETECTION_193_196_oPCAN_RADAR_c5ac330c_Tx: ComSignalType=UINT8
            DET_ELEVATION_193_oRDR_DETECTION_193_196_oPCAN_RADAR_b94c6b32_Tx: ComSignalType=UINT8
            DET_ELEVATION_194_oRDR_DETECTION_193_196_oPCAN_RADAR_e5fc485b_Tx: ComSignalType=UINT8
            DET_ELEVATION_195_oRDR_DETECTION_193_196_oPCAN_RADAR_708c9cce_Tx: ComSignalType=UINT8
            DET_ELEVATION_196_oRDR_DETECTION_193_196_oPCAN_RADAR_146ce730_Tx: ComSignalType=UINT8
            DET_ELEVATION_ERR_193_oRDR_DETECTION_193_196_oPCAN_RADAR_3e75f347_Tx: ComSignalType=UINT8
            DET_ELEVATION_ERR_194_oRDR_DETECTION_193_196_oPCAN_RADAR_62c5d02e_Tx: ComSignalType=UINT8
            DET_ELEVATION_ERR_195_oRDR_DETECTION_193_196_oPCAN_RADAR_f7b504bb_Tx: ComSignalType=UINT8
            DET_ELEVATION_ERR_196_oRDR_DETECTION_193_196_oPCAN_RADAR_93557f45_Tx: ComSignalType=UINT8
            DET_EXISTENCE_PROB_193_oRDR_DETECTION_193_196_oPCAN_RADAR_ecea8627_Tx: ComSignalType=UINT8
            DET_EXISTENCE_PROB_194_oRDR_DETECTION_193_196_oPCAN_RADAR_b05aa54e_Tx: ComSignalType=UINT8
            DET_EXISTENCE_PROB_195_oRDR_DETECTION_193_196_oPCAN_RADAR_252a71db_Tx: ComSignalType=UINT8
            DET_EXISTENCE_PROB_196_oRDR_DETECTION_193_196_oPCAN_RADAR_41ca0a25_Tx: ComSignalType=UINT8
            DET_HVC_FLAG_193_oRDR_DETECTION_193_196_oPCAN_RADAR_0d9ec558_Tx: ComSignalType=BOOLEAN
            DET_HVC_FLAG_194_oRDR_DETECTION_193_196_oPCAN_RADAR_512ee631_Tx: ComSignalType=BOOLEAN
            DET_HVC_FLAG_195_oRDR_DETECTION_193_196_oPCAN_RADAR_c45e32a4_Tx: ComSignalType=BOOLEAN
            DET_HVC_FLAG_196_oRDR_DETECTION_193_196_oPCAN_RADAR_a0be495a_Tx: ComSignalType=BOOLEAN
            DET_IDM_193_oRDR_DETECTION_193_196_oPCAN_RADAR_86ccfee5_Tx: ComSignalType=UINT8
            DET_IDM_194_oRDR_DETECTION_193_196_oPCAN_RADAR_da7cdd8c_Tx: ComSignalType=UINT8
            DET_IDM_195_oRDR_DETECTION_193_196_oPCAN_RADAR_4f0c0919_Tx: ComSignalType=UINT8
            DET_IDM_196_oRDR_DETECTION_193_196_oPCAN_RADAR_2bec72e7_Tx: ComSignalType=UINT8
            DET_MH_CRC16_193_196_oRDR_DETECTION_193_196_oPCAN_RADAR_160c9c5b_Tx: ComSignalType=UINT16
            DET_MH_CYCLE_COUNTER_193_196_oRDR_DETECTION_193_196_oPCAN_RADAR_92793d6c_Tx: ComSignalType=UINT8
            DET_MH_SCAN_INDEX_4LSB_193_196_oRDR_DETECTION_193_196_oPCAN_RADAR_5e5318e0_Tx: ComSignalType=UINT8
            DET_MTD_193_oRDR_DETECTION_193_196_oPCAN_RADAR_e07fcc3e_Tx: ComSignalType=UINT8
            DET_MTD_194_oRDR_DETECTION_193_196_oPCAN_RADAR_bccfef57_Tx: ComSignalType=UINT8
            DET_MTD_195_oRDR_DETECTION_193_196_oPCAN_RADAR_29bf3bc2_Tx: ComSignalType=UINT8
            DET_MTD_196_oRDR_DETECTION_193_196_oPCAN_RADAR_4d5f403c_Tx: ComSignalType=UINT8
            DET_PROB_1STAZHYPO_193_oRDR_DETECTION_193_196_oPCAN_RADAR_73cb24f3_Tx: ComSignalType=BOOLEAN
            DET_PROB_1STAZHYPO_194_oRDR_DETECTION_193_196_oPCAN_RADAR_2f7b079a_Tx: ComSignalType=BOOLEAN
            DET_PROB_1STAZHYPO_195_oRDR_DETECTION_193_196_oPCAN_RADAR_ba0bd30f_Tx: ComSignalType=BOOLEAN
            DET_PROB_1STAZHYPO_196_oRDR_DETECTION_193_196_oPCAN_RADAR_deeba8f1_Tx: ComSignalType=BOOLEAN
            DET_RANGE_193_oRDR_DETECTION_193_196_oPCAN_RADAR_7864c785_Tx: ComSignalType=UINT16
            DET_RANGE_194_oRDR_DETECTION_193_196_oPCAN_RADAR_24d4e4ec_Tx: ComSignalType=UINT16
            DET_RANGE_195_oRDR_DETECTION_193_196_oPCAN_RADAR_b1a43079_Tx: ComSignalType=UINT16
            DET_RANGE_196_oRDR_DETECTION_193_196_oPCAN_RADAR_d5444b87_Tx: ComSignalType=UINT16
            DET_RANGE_ERR_193_oRDR_DETECTION_193_196_oPCAN_RADAR_df8c7dec_Tx: ComSignalType=UINT8
            DET_RANGE_ERR_194_oRDR_DETECTION_193_196_oPCAN_RADAR_833c5e85_Tx: ComSignalType=UINT8
            DET_RANGE_ERR_195_oRDR_DETECTION_193_196_oPCAN_RADAR_164c8a10_Tx: ComSignalType=UINT8
            DET_RANGE_ERR_196_oRDR_DETECTION_193_196_oPCAN_RADAR_72acf1ee_Tx: ComSignalType=UINT8
            DET_RANGE_VELOCITY_193_oRDR_DETECTION_193_196_oPCAN_RADAR_0dc205a0_Tx: ComSignalType=UINT16
            DET_RANGE_VELOCITY_194_oRDR_DETECTION_193_196_oPCAN_RADAR_517226c9_Tx: ComSignalType=UINT16
            DET_RANGE_VELOCITY_195_oRDR_DETECTION_193_196_oPCAN_RADAR_c402f25c_Tx: ComSignalType=UINT16
            DET_RANGE_VELOCITY_196_oRDR_DETECTION_193_196_oPCAN_RADAR_a0e289a2_Tx: ComSignalType=UINT16
            DET_RANGE_VELOCITY_ERR_193_oRDR_DETECTION_193_196_oPCAN_RADAR_0279fe12_Tx: ComSignalType=UINT8
            DET_RANGE_VELOCITY_ERR_194_oRDR_DETECTION_193_196_oPCAN_RADAR_5ec9dd7b_Tx: ComSignalType=UINT8
            DET_RANGE_VELOCITY_ERR_195_oRDR_DETECTION_193_196_oPCAN_RADAR_cbb909ee_Tx: ComSignalType=UINT8
            DET_RANGE_VELOCITY_ERR_196_oRDR_DETECTION_193_196_oPCAN_RADAR_af597210_Tx: ComSignalType=UINT8
            DET_RCS_193_oRDR_DETECTION_193_196_oPCAN_RADAR_8a4232fa_Tx: ComSignalType=UINT8
            DET_RCS_194_oRDR_DETECTION_193_196_oPCAN_RADAR_d6f21193_Tx: ComSignalType=UINT8
            DET_RCS_195_oRDR_DETECTION_193_196_oPCAN_RADAR_4382c506_Tx: ComSignalType=UINT8
            DET_RCS_196_oRDR_DETECTION_193_196_oPCAN_RADAR_2762bef8_Tx: ComSignalType=UINT8
            DET_SNR_193_oRDR_DETECTION_193_196_oPCAN_RADAR_57ec66f8_Tx: ComSignalType=UINT8
            DET_SNR_194_oRDR_DETECTION_193_196_oPCAN_RADAR_0b5c4591_Tx: ComSignalType=UINT8
            DET_SNR_195_oRDR_DETECTION_193_196_oPCAN_RADAR_9e2c9104_Tx: ComSignalType=UINT8
            DET_SNR_196_oRDR_DETECTION_193_196_oPCAN_RADAR_facceafa_Tx: ComSignalType=UINT8
            DET_SUPER_RES_TARGET_193_oRDR_DETECTION_193_196_oPCAN_RADAR_66754e9d_Tx: ComSignalType=BOOLEAN
            DET_SUPER_RES_TARGET_194_oRDR_DETECTION_193_196_oPCAN_RADAR_3ac56df4_Tx: ComSignalType=BOOLEAN
            DET_SUPER_RES_TARGET_195_oRDR_DETECTION_193_196_oPCAN_RADAR_afb5b961_Tx: ComSignalType=BOOLEAN
            DET_SUPER_RES_TARGET_196_oRDR_DETECTION_193_196_oPCAN_RADAR_cb55c29f_Tx: ComSignalType=BOOLEAN
        SG_Detections_197_200_oRDR_DETECTION_197_200_oPCAN_RADAR_f6bd2d5e_Tx
          83 x ComGroupSignal:
            DET_AZIMUTH_197_oRDR_DETECTION_197_200_oPCAN_RADAR_3c698182_Tx: ComSignalType=UINT16
            DET_AZIMUTH_198_oRDR_DETECTION_197_200_oPCAN_RADAR_107913c5_Tx: ComSignalType=UINT16
            DET_AZIMUTH_199_oRDR_DETECTION_197_200_oPCAN_RADAR_8509c750_Tx: ComSignalType=UINT16
            DET_AZIMUTH_200_oRDR_DETECTION_197_200_oPCAN_RADAR_716718ed_Tx: ComSignalType=UINT16
            DET_AZIMUTH_ERR_197_oRDR_DETECTION_197_200_oPCAN_RADAR_98dc1477_Tx: ComSignalType=UINT8
            DET_AZIMUTH_ERR_198_oRDR_DETECTION_197_200_oPCAN_RADAR_b4cc8630_Tx: ComSignalType=UINT8
            DET_AZIMUTH_ERR_199_oRDR_DETECTION_197_200_oPCAN_RADAR_21bc52a5_Tx: ComSignalType=UINT8
            DET_AZIMUTH_ERR_200_oRDR_DETECTION_197_200_oPCAN_RADAR_d5d28d18_Tx: ComSignalType=UINT8
            DET_BELOW_RAIN_THOLD_197_oRDR_DETECTION_197_200_oPCAN_RADAR_e9681242_Tx: ComSignalType=UINT8
            DET_BELOW_RAIN_THOLD_198_oRDR_DETECTION_197_200_oPCAN_RADAR_c5788005_Tx: ComSignalType=UINT8
            DET_BELOW_RAIN_THOLD_199_oRDR_DETECTION_197_200_oPCAN_RADAR_50085490_Tx: ComSignalType=UINT8
            DET_BELOW_RAIN_THOLD_200_oRDR_DETECTION_197_200_oPCAN_RADAR_a4668b2d_Tx: ComSignalType=UINT8
            DET_BI_STATIC_FLAG_197_oRDR_DETECTION_197_200_oPCAN_RADAR_6a45c107_Tx: ComSignalType=BOOLEAN
            DET_BI_STATIC_FLAG_198_oRDR_DETECTION_197_200_oPCAN_RADAR_46555340_Tx: ComSignalType=BOOLEAN
            DET_BI_STATIC_FLAG_199_oRDR_DETECTION_197_200_oPCAN_RADAR_d32587d5_Tx: ComSignalType=BOOLEAN
            DET_BI_STATIC_FLAG_200_oRDR_DETECTION_197_200_oPCAN_RADAR_274b5868_Tx: ComSignalType=BOOLEAN
            DET_CONFD_AZIMUTH_197_oRDR_DETECTION_197_200_oPCAN_RADAR_3e8f8b48_Tx: ComSignalType=UINT8
            DET_CONFD_AZIMUTH_198_oRDR_DETECTION_197_200_oPCAN_RADAR_129f190f_Tx: ComSignalType=UINT8
            DET_CONFD_AZIMUTH_199_oRDR_DETECTION_197_200_oPCAN_RADAR_87efcd9a_Tx: ComSignalType=UINT8
            DET_CONFD_AZIMUTH_200_oRDR_DETECTION_197_200_oPCAN_RADAR_73811227_Tx: ComSignalType=UINT8
            DET_CONFD_ELEVATION_197_oRDR_DETECTION_197_200_oPCAN_RADAR_3c1a8ab2_Tx: ComSignalType=UINT8
            DET_CONFD_ELEVATION_198_oRDR_DETECTION_197_200_oPCAN_RADAR_100a18f5_Tx: ComSignalType=UINT8
            DET_CONFD_ELEVATION_199_oRDR_DETECTION_197_200_oPCAN_RADAR_857acc60_Tx: ComSignalType=UINT8
            DET_CONFD_ELEVATION_200_oRDR_DETECTION_197_200_oPCAN_RADAR_711413dd_Tx: ComSignalType=UINT8
            DET_ELEVATION_197_oRDR_DETECTION_197_200_oPCAN_RADAR_edda5e8e_Tx: ComSignalType=UINT8
            DET_ELEVATION_198_oRDR_DETECTION_197_200_oPCAN_RADAR_c1caccc9_Tx: ComSignalType=UINT8
            DET_ELEVATION_199_oRDR_DETECTION_197_200_oPCAN_RADAR_54ba185c_Tx: ComSignalType=UINT8
            DET_ELEVATION_200_oRDR_DETECTION_197_200_oPCAN_RADAR_a0d4c7e1_Tx: ComSignalType=UINT8
            DET_ELEVATION_ERR_197_oRDR_DETECTION_197_200_oPCAN_RADAR_6ae3c6fb_Tx: ComSignalType=UINT8
            DET_ELEVATION_ERR_198_oRDR_DETECTION_197_200_oPCAN_RADAR_46f354bc_Tx: ComSignalType=UINT8
            DET_ELEVATION_ERR_199_oRDR_DETECTION_197_200_oPCAN_RADAR_d3838029_Tx: ComSignalType=UINT8
            DET_ELEVATION_ERR_200_oRDR_DETECTION_197_200_oPCAN_RADAR_27ed5f94_Tx: ComSignalType=UINT8
            DET_EXISTENCE_PROB_197_oRDR_DETECTION_197_200_oPCAN_RADAR_b87cb39b_Tx: ComSignalType=UINT8
            DET_EXISTENCE_PROB_198_oRDR_DETECTION_197_200_oPCAN_RADAR_946c21dc_Tx: ComSignalType=UINT8
            DET_EXISTENCE_PROB_199_oRDR_DETECTION_197_200_oPCAN_RADAR_011cf549_Tx: ComSignalType=UINT8
            DET_EXISTENCE_PROB_200_oRDR_DETECTION_197_200_oPCAN_RADAR_f5722af4_Tx: ComSignalType=UINT8
            DET_HVC_FLAG_197_oRDR_DETECTION_197_200_oPCAN_RADAR_5908f0e4_Tx: ComSignalType=BOOLEAN
            DET_HVC_FLAG_198_oRDR_DETECTION_197_200_oPCAN_RADAR_751862a3_Tx: ComSignalType=BOOLEAN
            DET_HVC_FLAG_199_oRDR_DETECTION_197_200_oPCAN_RADAR_e068b636_Tx: ComSignalType=BOOLEAN
            DET_HVC_FLAG_200_oRDR_DETECTION_197_200_oPCAN_RADAR_1406698b_Tx: ComSignalType=BOOLEAN
            DET_IDM_197_oRDR_DETECTION_197_200_oPCAN_RADAR_d25acb59_Tx: ComSignalType=UINT8
            DET_IDM_198_oRDR_DETECTION_197_200_oPCAN_RADAR_fe4a591e_Tx: ComSignalType=UINT8
            DET_IDM_199_oRDR_DETECTION_197_200_oPCAN_RADAR_6b3a8d8b_Tx: ComSignalType=UINT8
            DET_IDM_200_oRDR_DETECTION_197_200_oPCAN_RADAR_9f545236_Tx: ComSignalType=UINT8
            DET_MH_CRC16_197_200_oRDR_DETECTION_197_200_oPCAN_RADAR_7235ff55_Tx: ComSignalType=UINT16
            DET_MH_CYCLE_COUNTER_197_200_oRDR_DETECTION_197_200_oPCAN_RADAR_f6405e62_Tx: ComSignalType=UINT8
            DET_MH_SCAN_INDEX_4LSB_197_200_oRDR_DETECTION_197_200_oPCAN_RADAR_3a6a7bee_Tx: ComSignalType=UINT8
            DET_MTD_197_oRDR_DETECTION_197_200_oPCAN_RADAR_b4e9f982_Tx: ComSignalType=UINT8
            DET_MTD_198_oRDR_DETECTION_197_200_oPCAN_RADAR_98f96bc5_Tx: ComSignalType=UINT8
            DET_MTD_199_oRDR_DETECTION_197_200_oPCAN_RADAR_0d89bf50_Tx: ComSignalType=UINT8
            DET_MTD_200_oRDR_DETECTION_197_200_oPCAN_RADAR_f9e760ed_Tx: ComSignalType=UINT8
            DET_PROB_1STAZHYPO_197_oRDR_DETECTION_197_200_oPCAN_RADAR_275d114f_Tx: ComSignalType=BOOLEAN
            DET_PROB_1STAZHYPO_198_oRDR_DETECTION_197_200_oPCAN_RADAR_0b4d8308_Tx: ComSignalType=BOOLEAN
            DET_PROB_1STAZHYPO_199_oRDR_DETECTION_197_200_oPCAN_RADAR_9e3d579d_Tx: ComSignalType=BOOLEAN
            DET_PROB_1STAZHYPO_200_oRDR_DETECTION_197_200_oPCAN_RADAR_6a538820_Tx: ComSignalType=BOOLEAN
            DET_RANGE_197_oRDR_DETECTION_197_200_oPCAN_RADAR_2cf2f239_Tx: ComSignalType=UINT16
            DET_RANGE_198_oRDR_DETECTION_197_200_oPCAN_RADAR_00e2607e_Tx: ComSignalType=UINT16
            DET_RANGE_199_oRDR_DETECTION_197_200_oPCAN_RADAR_9592b4eb_Tx: ComSignalType=UINT16
            DET_RANGE_200_oRDR_DETECTION_197_200_oPCAN_RADAR_61fc6b56_Tx: ComSignalType=UINT16
            DET_RANGE_ERR_197_oRDR_DETECTION_197_200_oPCAN_RADAR_8b1a4850_Tx: ComSignalType=UINT8
            DET_RANGE_ERR_198_oRDR_DETECTION_197_200_oPCAN_RADAR_a70ada17_Tx: ComSignalType=UINT8
            DET_RANGE_ERR_199_oRDR_DETECTION_197_200_oPCAN_RADAR_327a0e82_Tx: ComSignalType=UINT8
            DET_RANGE_ERR_200_oRDR_DETECTION_197_200_oPCAN_RADAR_c614d13f_Tx: ComSignalType=UINT8
            DET_RANGE_VELOCITY_197_oRDR_DETECTION_197_200_oPCAN_RADAR_5954301c_Tx: ComSignalType=UINT16
            DET_RANGE_VELOCITY_198_oRDR_DETECTION_197_200_oPCAN_RADAR_7544a25b_Tx: ComSignalType=UINT16
            DET_RANGE_VELOCITY_199_oRDR_DETECTION_197_200_oPCAN_RADAR_e03476ce_Tx: ComSignalType=UINT16
            DET_RANGE_VELOCITY_200_oRDR_DETECTION_197_200_oPCAN_RADAR_145aa973_Tx: ComSignalType=UINT16
            DET_RANGE_VELOCITY_ERR_197_oRDR_DETECTION_197_200_oPCAN_RADAR_56efcbae_Tx: ComSignalType=UINT8
            DET_RANGE_VELOCITY_ERR_198_oRDR_DETECTION_197_200_oPCAN_RADAR_7aff59e9_Tx: ComSignalType=UINT8
            DET_RANGE_VELOCITY_ERR_199_oRDR_DETECTION_197_200_oPCAN_RADAR_ef8f8d7c_Tx: ComSignalType=UINT8
            DET_RANGE_VELOCITY_ERR_200_oRDR_DETECTION_197_200_oPCAN_RADAR_1be152c1_Tx: ComSignalType=UINT8
            DET_RCS_197_oRDR_DETECTION_197_200_oPCAN_RADAR_ded40746_Tx: ComSignalType=UINT8
            DET_RCS_198_oRDR_DETECTION_197_200_oPCAN_RADAR_f2c49501_Tx: ComSignalType=UINT8
            DET_RCS_199_oRDR_DETECTION_197_200_oPCAN_RADAR_67b44194_Tx: ComSignalType=UINT8
            DET_RCS_200_oRDR_DETECTION_197_200_oPCAN_RADAR_93da9e29_Tx: ComSignalType=UINT8
            DET_SNR_197_oRDR_DETECTION_197_200_oPCAN_RADAR_037a5344_Tx: ComSignalType=UINT8
            DET_SNR_198_oRDR_DETECTION_197_200_oPCAN_RADAR_2f6ac103_Tx: ComSignalType=UINT8
            DET_SNR_199_oRDR_DETECTION_197_200_oPCAN_RADAR_ba1a1596_Tx: ComSignalType=UINT8
            DET_SNR_200_oRDR_DETECTION_197_200_oPCAN_RADAR_4e74ca2b_Tx: ComSignalType=UINT8
            DET_SUPER_RES_TARGET_197_oRDR_DETECTION_197_200_oPCAN_RADAR_32e37b21_Tx: ComSignalType=BOOLEAN
            DET_SUPER_RES_TARGET_198_oRDR_DETECTION_197_200_oPCAN_RADAR_1ef3e966_Tx: ComSignalType=BOOLEAN
            DET_SUPER_RES_TARGET_199_oRDR_DETECTION_197_200_oPCAN_RADAR_8b833df3_Tx: ComSignalType=BOOLEAN
            DET_SUPER_RES_TARGET_200_oRDR_DETECTION_197_200_oPCAN_RADAR_7fede24e_Tx: ComSignalType=BOOLEAN
        SG_Detections_201_204_oRDR_DETECTION_201_204_oPCAN_RADAR_5a18d0dd_Tx
          83 x ComGroupSignal:
            DET_AZIMUTH_201_oRDR_DETECTION_201_204_oPCAN_RADAR_d8cf8fa2_Tx: ComSignalType=UINT16
            DET_AZIMUTH_202_oRDR_DETECTION_201_204_oPCAN_RADAR_bc2ff45c_Tx: ComSignalType=UINT16
            DET_AZIMUTH_203_oRDR_DETECTION_201_204_oPCAN_RADAR_295f20c9_Tx: ComSignalType=UINT16
            DET_AZIMUTH_204_oRDR_DETECTION_201_204_oPCAN_RADAR_75ef03a0_Tx: ComSignalType=UINT16
            DET_AZIMUTH_ERR_201_oRDR_DETECTION_201_204_oPCAN_RADAR_7c7a1a57_Tx: ComSignalType=UINT8
            DET_AZIMUTH_ERR_202_oRDR_DETECTION_201_204_oPCAN_RADAR_189a61a9_Tx: ComSignalType=UINT8
            DET_AZIMUTH_ERR_203_oRDR_DETECTION_201_204_oPCAN_RADAR_8deab53c_Tx: ComSignalType=UINT8
            DET_AZIMUTH_ERR_204_oRDR_DETECTION_201_204_oPCAN_RADAR_d15a9655_Tx: ComSignalType=UINT8
            DET_BELOW_RAIN_THOLD_201_oRDR_DETECTION_201_204_oPCAN_RADAR_0dce1c62_Tx: ComSignalType=UINT8
            DET_BELOW_RAIN_THOLD_202_oRDR_DETECTION_201_204_oPCAN_RADAR_692e679c_Tx: ComSignalType=UINT8
            DET_BELOW_RAIN_THOLD_203_oRDR_DETECTION_201_204_oPCAN_RADAR_fc5eb309_Tx: ComSignalType=UINT8
            DET_BELOW_RAIN_THOLD_204_oRDR_DETECTION_201_204_oPCAN_RADAR_a0ee9060_Tx: ComSignalType=UINT8
            DET_BI_STATIC_FLAG_201_oRDR_DETECTION_201_204_oPCAN_RADAR_8ee3cf27_Tx: ComSignalType=BOOLEAN
            DET_BI_STATIC_FLAG_202_oRDR_DETECTION_201_204_oPCAN_RADAR_ea03b4d9_Tx: ComSignalType=BOOLEAN
            DET_BI_STATIC_FLAG_203_oRDR_DETECTION_201_204_oPCAN_RADAR_7f73604c_Tx: ComSignalType=BOOLEAN
            DET_BI_STATIC_FLAG_204_oRDR_DETECTION_201_204_oPCAN_RADAR_23c34325_Tx: ComSignalType=BOOLEAN
            DET_CONFD_AZIMUTH_201_oRDR_DETECTION_201_204_oPCAN_RADAR_da298568_Tx: ComSignalType=UINT8
            DET_CONFD_AZIMUTH_202_oRDR_DETECTION_201_204_oPCAN_RADAR_bec9fe96_Tx: ComSignalType=UINT8
            DET_CONFD_AZIMUTH_203_oRDR_DETECTION_201_204_oPCAN_RADAR_2bb92a03_Tx: ComSignalType=UINT8
            DET_CONFD_AZIMUTH_204_oRDR_DETECTION_201_204_oPCAN_RADAR_7709096a_Tx: ComSignalType=UINT8
            DET_CONFD_ELEVATION_201_oRDR_DETECTION_201_204_oPCAN_RADAR_d8bc8492_Tx: ComSignalType=UINT8
            DET_CONFD_ELEVATION_202_oRDR_DETECTION_201_204_oPCAN_RADAR_bc5cff6c_Tx: ComSignalType=UINT8
            DET_CONFD_ELEVATION_203_oRDR_DETECTION_201_204_oPCAN_RADAR_292c2bf9_Tx: ComSignalType=UINT8
            DET_CONFD_ELEVATION_204_oRDR_DETECTION_201_204_oPCAN_RADAR_759c0890_Tx: ComSignalType=UINT8
            DET_ELEVATION_201_oRDR_DETECTION_201_204_oPCAN_RADAR_097c50ae_Tx: ComSignalType=UINT8
            DET_ELEVATION_202_oRDR_DETECTION_201_204_oPCAN_RADAR_6d9c2b50_Tx: ComSignalType=UINT8
            DET_ELEVATION_203_oRDR_DETECTION_201_204_oPCAN_RADAR_f8ecffc5_Tx: ComSignalType=UINT8
            DET_ELEVATION_204_oRDR_DETECTION_201_204_oPCAN_RADAR_a45cdcac_Tx: ComSignalType=UINT8
            DET_ELEVATION_ERR_201_oRDR_DETECTION_201_204_oPCAN_RADAR_8e45c8db_Tx: ComSignalType=UINT8
            DET_ELEVATION_ERR_202_oRDR_DETECTION_201_204_oPCAN_RADAR_eaa5b325_Tx: ComSignalType=UINT8
            DET_ELEVATION_ERR_203_oRDR_DETECTION_201_204_oPCAN_RADAR_7fd567b0_Tx: ComSignalType=UINT8
            DET_ELEVATION_ERR_204_oRDR_DETECTION_201_204_oPCAN_RADAR_236544d9_Tx: ComSignalType=UINT8
            DET_EXISTENCE_PROB_201_oRDR_DETECTION_201_204_oPCAN_RADAR_5cdabdbb_Tx: ComSignalType=UINT8
            DET_EXISTENCE_PROB_202_oRDR_DETECTION_201_204_oPCAN_RADAR_383ac645_Tx: ComSignalType=UINT8
            DET_EXISTENCE_PROB_203_oRDR_DETECTION_201_204_oPCAN_RADAR_ad4a12d0_Tx: ComSignalType=UINT8
            DET_EXISTENCE_PROB_204_oRDR_DETECTION_201_204_oPCAN_RADAR_f1fa31b9_Tx: ComSignalType=UINT8
            DET_HVC_FLAG_201_oRDR_DETECTION_201_204_oPCAN_RADAR_bdaefec4_Tx: ComSignalType=BOOLEAN
            DET_HVC_FLAG_202_oRDR_DETECTION_201_204_oPCAN_RADAR_d94e853a_Tx: ComSignalType=BOOLEAN
            DET_HVC_FLAG_203_oRDR_DETECTION_201_204_oPCAN_RADAR_4c3e51af_Tx: ComSignalType=BOOLEAN
            DET_HVC_FLAG_204_oRDR_DETECTION_201_204_oPCAN_RADAR_108e72c6_Tx: ComSignalType=BOOLEAN
            DET_IDM_201_oRDR_DETECTION_201_204_oPCAN_RADAR_36fcc579_Tx: ComSignalType=UINT8
            DET_IDM_202_oRDR_DETECTION_201_204_oPCAN_RADAR_521cbe87_Tx: ComSignalType=UINT8
            DET_IDM_203_oRDR_DETECTION_201_204_oPCAN_RADAR_c76c6a12_Tx: ComSignalType=UINT8
            DET_IDM_204_oRDR_DETECTION_201_204_oPCAN_RADAR_9bdc497b_Tx: ComSignalType=UINT8
            DET_MH_CRC16_201_204_oRDR_DETECTION_201_204_oPCAN_RADAR_de9002d6_Tx: ComSignalType=UINT16
            DET_MH_CYCLE_COUNTER_201_204_oRDR_DETECTION_201_204_oPCAN_RADAR_5ae5a3e1_Tx: ComSignalType=UINT8
            DET_MH_SCAN_INDEX_4LSB_201_204_oRDR_DETECTION_201_204_oPCAN_RADAR_96cf866d_Tx: ComSignalType=UINT8
            DET_MTD_201_oRDR_DETECTION_201_204_oPCAN_RADAR_504ff7a2_Tx: ComSignalType=UINT8
            DET_MTD_202_oRDR_DETECTION_201_204_oPCAN_RADAR_34af8c5c_Tx: ComSignalType=UINT8
            DET_MTD_203_oRDR_DETECTION_201_204_oPCAN_RADAR_a1df58c9_Tx: ComSignalType=UINT8
            DET_MTD_204_oRDR_DETECTION_201_204_oPCAN_RADAR_fd6f7ba0_Tx: ComSignalType=UINT8
            DET_PROB_1STAZHYPO_201_oRDR_DETECTION_201_204_oPCAN_RADAR_c3fb1f6f_Tx: ComSignalType=BOOLEAN
            DET_PROB_1STAZHYPO_202_oRDR_DETECTION_201_204_oPCAN_RADAR_a71b6491_Tx: ComSignalType=BOOLEAN
            DET_PROB_1STAZHYPO_203_oRDR_DETECTION_201_204_oPCAN_RADAR_326bb004_Tx: ComSignalType=BOOLEAN
            DET_PROB_1STAZHYPO_204_oRDR_DETECTION_201_204_oPCAN_RADAR_6edb936d_Tx: ComSignalType=BOOLEAN
            DET_RANGE_201_oRDR_DETECTION_201_204_oPCAN_RADAR_c854fc19_Tx: ComSignalType=UINT16
            DET_RANGE_202_oRDR_DETECTION_201_204_oPCAN_RADAR_acb487e7_Tx: ComSignalType=UINT16
            DET_RANGE_203_oRDR_DETECTION_201_204_oPCAN_RADAR_39c45372_Tx: ComSignalType=UINT16
            DET_RANGE_204_oRDR_DETECTION_201_204_oPCAN_RADAR_6574701b_Tx: ComSignalType=UINT16
            DET_RANGE_ERR_201_oRDR_DETECTION_201_204_oPCAN_RADAR_6fbc4670_Tx: ComSignalType=UINT8
            DET_RANGE_ERR_202_oRDR_DETECTION_201_204_oPCAN_RADAR_0b5c3d8e_Tx: ComSignalType=UINT8
            DET_RANGE_ERR_203_oRDR_DETECTION_201_204_oPCAN_RADAR_9e2ce91b_Tx: ComSignalType=UINT8
            DET_RANGE_ERR_204_oRDR_DETECTION_201_204_oPCAN_RADAR_c29cca72_Tx: ComSignalType=UINT8
            DET_RANGE_VELOCITY_201_oRDR_DETECTION_201_204_oPCAN_RADAR_bdf23e3c_Tx: ComSignalType=UINT16
            DET_RANGE_VELOCITY_202_oRDR_DETECTION_201_204_oPCAN_RADAR_d91245c2_Tx: ComSignalType=UINT16
            DET_RANGE_VELOCITY_203_oRDR_DETECTION_201_204_oPCAN_RADAR_4c629157_Tx: ComSignalType=UINT16
            DET_RANGE_VELOCITY_204_oRDR_DETECTION_201_204_oPCAN_RADAR_10d2b23e_Tx: ComSignalType=UINT16
            DET_RANGE_VELOCITY_ERR_201_oRDR_DETECTION_201_204_oPCAN_RADAR_b249c58e_Tx: ComSignalType=UINT8
            DET_RANGE_VELOCITY_ERR_202_oRDR_DETECTION_201_204_oPCAN_RADAR_d6a9be70_Tx: ComSignalType=UINT8
            DET_RANGE_VELOCITY_ERR_203_oRDR_DETECTION_201_204_oPCAN_RADAR_43d96ae5_Tx: ComSignalType=UINT8
            DET_RANGE_VELOCITY_ERR_204_oRDR_DETECTION_201_204_oPCAN_RADAR_1f69498c_Tx: ComSignalType=UINT8
            DET_RCS_201_oRDR_DETECTION_201_204_oPCAN_RADAR_3a720966_Tx: ComSignalType=UINT8
            DET_RCS_202_oRDR_DETECTION_201_204_oPCAN_RADAR_5e927298_Tx: ComSignalType=UINT8
            DET_RCS_203_oRDR_DETECTION_201_204_oPCAN_RADAR_cbe2a60d_Tx: ComSignalType=UINT8
            DET_RCS_204_oRDR_DETECTION_201_204_oPCAN_RADAR_97528564_Tx: ComSignalType=UINT8
            DET_SNR_201_oRDR_DETECTION_201_204_oPCAN_RADAR_e7dc5d64_Tx: ComSignalType=UINT8
            DET_SNR_202_oRDR_DETECTION_201_204_oPCAN_RADAR_833c269a_Tx: ComSignalType=UINT8
            DET_SNR_203_oRDR_DETECTION_201_204_oPCAN_RADAR_164cf20f_Tx: ComSignalType=UINT8
            DET_SNR_204_oRDR_DETECTION_201_204_oPCAN_RADAR_4afcd166_Tx: ComSignalType=UINT8
            DET_SUPER_RES_TARGET_201_oRDR_DETECTION_201_204_oPCAN_RADAR_d6457501_Tx: ComSignalType=BOOLEAN
            DET_SUPER_RES_TARGET_202_oRDR_DETECTION_201_204_oPCAN_RADAR_b2a50eff_Tx: ComSignalType=BOOLEAN
            DET_SUPER_RES_TARGET_203_oRDR_DETECTION_201_204_oPCAN_RADAR_27d5da6a_Tx: ComSignalType=BOOLEAN
            DET_SUPER_RES_TARGET_204_oRDR_DETECTION_201_204_oPCAN_RADAR_7b65f903_Tx: ComSignalType=BOOLEAN
        SG_Detections_205_208_oRDR_DETECTION_205_208_oPCAN_RADAR_2bdbe48f_Tx
          83 x ComGroupSignal:
            DET_AZIMUTH_205_oRDR_DETECTION_205_208_oPCAN_RADAR_092d4901_Tx: ComSignalType=UINT16
            DET_AZIMUTH_206_oRDR_DETECTION_205_208_oPCAN_RADAR_6dcd32ff_Tx: ComSignalType=UINT16
            DET_AZIMUTH_207_oRDR_DETECTION_205_208_oPCAN_RADAR_f8bde66a_Tx: ComSignalType=UINT16
            DET_AZIMUTH_208_oRDR_DETECTION_205_208_oPCAN_RADAR_d4ad742d_Tx: ComSignalType=UINT16
            DET_AZIMUTH_ERR_205_oRDR_DETECTION_205_208_oPCAN_RADAR_ad98dcf4_Tx: ComSignalType=UINT8
            DET_AZIMUTH_ERR_206_oRDR_DETECTION_205_208_oPCAN_RADAR_c978a70a_Tx: ComSignalType=UINT8
            DET_AZIMUTH_ERR_207_oRDR_DETECTION_205_208_oPCAN_RADAR_5c08739f_Tx: ComSignalType=UINT8
            DET_AZIMUTH_ERR_208_oRDR_DETECTION_205_208_oPCAN_RADAR_7018e1d8_Tx: ComSignalType=UINT8
            DET_BELOW_RAIN_THOLD_205_oRDR_DETECTION_205_208_oPCAN_RADAR_dc2cdac1_Tx: ComSignalType=UINT8
            DET_BELOW_RAIN_THOLD_206_oRDR_DETECTION_205_208_oPCAN_RADAR_b8cca13f_Tx: ComSignalType=UINT8
            DET_BELOW_RAIN_THOLD_207_oRDR_DETECTION_205_208_oPCAN_RADAR_2dbc75aa_Tx: ComSignalType=UINT8
            DET_BELOW_RAIN_THOLD_208_oRDR_DETECTION_205_208_oPCAN_RADAR_01ace7ed_Tx: ComSignalType=UINT8
            DET_BI_STATIC_FLAG_205_oRDR_DETECTION_205_208_oPCAN_RADAR_5f010984_Tx: ComSignalType=BOOLEAN
            DET_BI_STATIC_FLAG_206_oRDR_DETECTION_205_208_oPCAN_RADAR_3be1727a_Tx: ComSignalType=BOOLEAN
            DET_BI_STATIC_FLAG_207_oRDR_DETECTION_205_208_oPCAN_RADAR_ae91a6ef_Tx: ComSignalType=BOOLEAN
            DET_BI_STATIC_FLAG_208_oRDR_DETECTION_205_208_oPCAN_RADAR_828134a8_Tx: ComSignalType=BOOLEAN
            DET_CONFD_AZIMUTH_205_oRDR_DETECTION_205_208_oPCAN_RADAR_0bcb43cb_Tx: ComSignalType=UINT8
            DET_CONFD_AZIMUTH_206_oRDR_DETECTION_205_208_oPCAN_RADAR_6f2b3835_Tx: ComSignalType=UINT8
            DET_CONFD_AZIMUTH_207_oRDR_DETECTION_205_208_oPCAN_RADAR_fa5beca0_Tx: ComSignalType=UINT8
            DET_CONFD_AZIMUTH_208_oRDR_DETECTION_205_208_oPCAN_RADAR_d64b7ee7_Tx: ComSignalType=UINT8
            DET_CONFD_ELEVATION_205_oRDR_DETECTION_205_208_oPCAN_RADAR_095e4231_Tx: ComSignalType=UINT8
            DET_CONFD_ELEVATION_206_oRDR_DETECTION_205_208_oPCAN_RADAR_6dbe39cf_Tx: ComSignalType=UINT8
            DET_CONFD_ELEVATION_207_oRDR_DETECTION_205_208_oPCAN_RADAR_f8ceed5a_Tx: ComSignalType=UINT8
            DET_CONFD_ELEVATION_208_oRDR_DETECTION_205_208_oPCAN_RADAR_d4de7f1d_Tx: ComSignalType=UINT8
            DET_ELEVATION_205_oRDR_DETECTION_205_208_oPCAN_RADAR_d89e960d_Tx: ComSignalType=UINT8
            DET_ELEVATION_206_oRDR_DETECTION_205_208_oPCAN_RADAR_bc7eedf3_Tx: ComSignalType=UINT8
            DET_ELEVATION_207_oRDR_DETECTION_205_208_oPCAN_RADAR_290e3966_Tx: ComSignalType=UINT8
            DET_ELEVATION_208_oRDR_DETECTION_205_208_oPCAN_RADAR_051eab21_Tx: ComSignalType=UINT8
            DET_ELEVATION_ERR_205_oRDR_DETECTION_205_208_oPCAN_RADAR_5fa70e78_Tx: ComSignalType=UINT8
            DET_ELEVATION_ERR_206_oRDR_DETECTION_205_208_oPCAN_RADAR_3b477586_Tx: ComSignalType=UINT8
            DET_ELEVATION_ERR_207_oRDR_DETECTION_205_208_oPCAN_RADAR_ae37a113_Tx: ComSignalType=UINT8
            DET_ELEVATION_ERR_208_oRDR_DETECTION_205_208_oPCAN_RADAR_82273354_Tx: ComSignalType=UINT8
            DET_EXISTENCE_PROB_205_oRDR_DETECTION_205_208_oPCAN_RADAR_8d387b18_Tx: ComSignalType=UINT8
            DET_EXISTENCE_PROB_206_oRDR_DETECTION_205_208_oPCAN_RADAR_e9d800e6_Tx: ComSignalType=UINT8
            DET_EXISTENCE_PROB_207_oRDR_DETECTION_205_208_oPCAN_RADAR_7ca8d473_Tx: ComSignalType=UINT8
            DET_EXISTENCE_PROB_208_oRDR_DETECTION_205_208_oPCAN_RADAR_50b84634_Tx: ComSignalType=UINT8
            DET_HVC_FLAG_205_oRDR_DETECTION_205_208_oPCAN_RADAR_6c4c3867_Tx: ComSignalType=BOOLEAN
            DET_HVC_FLAG_206_oRDR_DETECTION_205_208_oPCAN_RADAR_08ac4399_Tx: ComSignalType=BOOLEAN
            DET_HVC_FLAG_207_oRDR_DETECTION_205_208_oPCAN_RADAR_9ddc970c_Tx: ComSignalType=BOOLEAN
            DET_HVC_FLAG_208_oRDR_DETECTION_205_208_oPCAN_RADAR_b1cc054b_Tx: ComSignalType=BOOLEAN
            DET_IDM_205_oRDR_DETECTION_205_208_oPCAN_RADAR_e71e03da_Tx: ComSignalType=UINT8
            DET_IDM_206_oRDR_DETECTION_205_208_oPCAN_RADAR_83fe7824_Tx: ComSignalType=UINT8
            DET_IDM_207_oRDR_DETECTION_205_208_oPCAN_RADAR_168eacb1_Tx: ComSignalType=UINT8
            DET_IDM_208_oRDR_DETECTION_205_208_oPCAN_RADAR_3a9e3ef6_Tx: ComSignalType=UINT8
            DET_MH_CRC16_205_208_oRDR_DETECTION_205_208_oPCAN_RADAR_af533684_Tx: ComSignalType=UINT16
            DET_MH_CYCLE_COUNTER_205_208_oRDR_DETECTION_205_208_oPCAN_RADAR_2b2697b3_Tx: ComSignalType=UINT8
            DET_MH_SCAN_INDEX_4LSB_205_208_oRDR_DETECTION_205_208_oPCAN_RADAR_e70cb23f_Tx: ComSignalType=UINT8
            DET_MTD_205_oRDR_DETECTION_205_208_oPCAN_RADAR_81ad3101_Tx: ComSignalType=UINT8
            DET_MTD_206_oRDR_DETECTION_205_208_oPCAN_RADAR_e54d4aff_Tx: ComSignalType=UINT8
            DET_MTD_207_oRDR_DETECTION_205_208_oPCAN_RADAR_703d9e6a_Tx: ComSignalType=UINT8
            DET_MTD_208_oRDR_DETECTION_205_208_oPCAN_RADAR_5c2d0c2d_Tx: ComSignalType=UINT8
            DET_PROB_1STAZHYPO_205_oRDR_DETECTION_205_208_oPCAN_RADAR_1219d9cc_Tx: ComSignalType=BOOLEAN
            DET_PROB_1STAZHYPO_206_oRDR_DETECTION_205_208_oPCAN_RADAR_76f9a232_Tx: ComSignalType=BOOLEAN
            DET_PROB_1STAZHYPO_207_oRDR_DETECTION_205_208_oPCAN_RADAR_e38976a7_Tx: ComSignalType=BOOLEAN
            DET_PROB_1STAZHYPO_208_oRDR_DETECTION_205_208_oPCAN_RADAR_cf99e4e0_Tx: ComSignalType=BOOLEAN
            DET_RANGE_205_oRDR_DETECTION_205_208_oPCAN_RADAR_19b63aba_Tx: ComSignalType=UINT16
            DET_RANGE_206_oRDR_DETECTION_205_208_oPCAN_RADAR_7d564144_Tx: ComSignalType=UINT16
            DET_RANGE_207_oRDR_DETECTION_205_208_oPCAN_RADAR_e82695d1_Tx: ComSignalType=UINT16
            DET_RANGE_208_oRDR_DETECTION_205_208_oPCAN_RADAR_c4360796_Tx: ComSignalType=UINT16
            DET_RANGE_ERR_205_oRDR_DETECTION_205_208_oPCAN_RADAR_be5e80d3_Tx: ComSignalType=UINT8
            DET_RANGE_ERR_206_oRDR_DETECTION_205_208_oPCAN_RADAR_dabefb2d_Tx: ComSignalType=UINT8
            DET_RANGE_ERR_207_oRDR_DETECTION_205_208_oPCAN_RADAR_4fce2fb8_Tx: ComSignalType=UINT8
            DET_RANGE_ERR_208_oRDR_DETECTION_205_208_oPCAN_RADAR_63debdff_Tx: ComSignalType=UINT8
            DET_RANGE_VELOCITY_205_oRDR_DETECTION_205_208_oPCAN_RADAR_6c10f89f_Tx: ComSignalType=UINT16
            DET_RANGE_VELOCITY_206_oRDR_DETECTION_205_208_oPCAN_RADAR_08f08361_Tx: ComSignalType=UINT16
            DET_RANGE_VELOCITY_207_oRDR_DETECTION_205_208_oPCAN_RADAR_9d8057f4_Tx: ComSignalType=UINT16
            DET_RANGE_VELOCITY_208_oRDR_DETECTION_205_208_oPCAN_RADAR_b190c5b3_Tx: ComSignalType=UINT16
            DET_RANGE_VELOCITY_ERR_205_oRDR_DETECTION_205_208_oPCAN_RADAR_63ab032d_Tx: ComSignalType=UINT8
            DET_RANGE_VELOCITY_ERR_206_oRDR_DETECTION_205_208_oPCAN_RADAR_074b78d3_Tx: ComSignalType=UINT8
            DET_RANGE_VELOCITY_ERR_207_oRDR_DETECTION_205_208_oPCAN_RADAR_923bac46_Tx: ComSignalType=UINT8
            DET_RANGE_VELOCITY_ERR_208_oRDR_DETECTION_205_208_oPCAN_RADAR_be2b3e01_Tx: ComSignalType=UINT8
            DET_RCS_205_oRDR_DETECTION_205_208_oPCAN_RADAR_eb90cfc5_Tx: ComSignalType=UINT8
            DET_RCS_206_oRDR_DETECTION_205_208_oPCAN_RADAR_8f70b43b_Tx: ComSignalType=UINT8
            DET_RCS_207_oRDR_DETECTION_205_208_oPCAN_RADAR_1a0060ae_Tx: ComSignalType=UINT8
            DET_RCS_208_oRDR_DETECTION_205_208_oPCAN_RADAR_3610f2e9_Tx: ComSignalType=UINT8
            DET_SNR_205_oRDR_DETECTION_205_208_oPCAN_RADAR_363e9bc7_Tx: ComSignalType=UINT8
            DET_SNR_206_oRDR_DETECTION_205_208_oPCAN_RADAR_52dee039_Tx: ComSignalType=UINT8
            DET_SNR_207_oRDR_DETECTION_205_208_oPCAN_RADAR_c7ae34ac_Tx: ComSignalType=UINT8
            DET_SNR_208_oRDR_DETECTION_205_208_oPCAN_RADAR_ebbea6eb_Tx: ComSignalType=UINT8
            DET_SUPER_RES_TARGET_205_oRDR_DETECTION_205_208_oPCAN_RADAR_07a7b3a2_Tx: ComSignalType=BOOLEAN
            DET_SUPER_RES_TARGET_206_oRDR_DETECTION_205_208_oPCAN_RADAR_6347c85c_Tx: ComSignalType=BOOLEAN
            DET_SUPER_RES_TARGET_207_oRDR_DETECTION_205_208_oPCAN_RADAR_f6371cc9_Tx: ComSignalType=BOOLEAN
            DET_SUPER_RES_TARGET_208_oRDR_DETECTION_205_208_oPCAN_RADAR_da278e8e_Tx: ComSignalType=BOOLEAN
        SG_Detections_209_212_oRDR_DETECTION_209_212_oPCAN_RADAR_b2a1c0f4_Tx
          83 x ComGroupSignal:
            DET_AZIMUTH_209_oRDR_DETECTION_209_212_oPCAN_RADAR_73954fb9_Tx: ComSignalType=UINT16
            DET_AZIMUTH_210_oRDR_DETECTION_209_212_oPCAN_RADAR_16b53d1d_Tx: ComSignalType=UINT16
            DET_AZIMUTH_211_oRDR_DETECTION_209_212_oPCAN_RADAR_83c5e988_Tx: ComSignalType=UINT16
            DET_AZIMUTH_212_oRDR_DETECTION_209_212_oPCAN_RADAR_e7259276_Tx: ComSignalType=UINT16
            DET_AZIMUTH_ERR_209_oRDR_DETECTION_209_212_oPCAN_RADAR_d720da4c_Tx: ComSignalType=UINT8
            DET_AZIMUTH_ERR_210_oRDR_DETECTION_209_212_oPCAN_RADAR_b200a8e8_Tx: ComSignalType=UINT8
            DET_AZIMUTH_ERR_211_oRDR_DETECTION_209_212_oPCAN_RADAR_27707c7d_Tx: ComSignalType=UINT8
            DET_AZIMUTH_ERR_212_oRDR_DETECTION_209_212_oPCAN_RADAR_43900783_Tx: ComSignalType=UINT8
            DET_BELOW_RAIN_THOLD_209_oRDR_DETECTION_209_212_oPCAN_RADAR_a694dc79_Tx: ComSignalType=UINT8
            DET_BELOW_RAIN_THOLD_210_oRDR_DETECTION_209_212_oPCAN_RADAR_c3b4aedd_Tx: ComSignalType=UINT8
            DET_BELOW_RAIN_THOLD_211_oRDR_DETECTION_209_212_oPCAN_RADAR_56c47a48_Tx: ComSignalType=UINT8
            DET_BELOW_RAIN_THOLD_212_oRDR_DETECTION_209_212_oPCAN_RADAR_322401b6_Tx: ComSignalType=UINT8
            DET_BI_STATIC_FLAG_209_oRDR_DETECTION_209_212_oPCAN_RADAR_25b90f3c_Tx: ComSignalType=BOOLEAN
            DET_BI_STATIC_FLAG_210_oRDR_DETECTION_209_212_oPCAN_RADAR_40997d98_Tx: ComSignalType=BOOLEAN
            DET_BI_STATIC_FLAG_211_oRDR_DETECTION_209_212_oPCAN_RADAR_d5e9a90d_Tx: ComSignalType=BOOLEAN
            DET_BI_STATIC_FLAG_212_oRDR_DETECTION_209_212_oPCAN_RADAR_b109d2f3_Tx: ComSignalType=BOOLEAN
            DET_CONFD_AZIMUTH_209_oRDR_DETECTION_209_212_oPCAN_RADAR_71734573_Tx: ComSignalType=UINT8
            DET_CONFD_AZIMUTH_210_oRDR_DETECTION_209_212_oPCAN_RADAR_145337d7_Tx: ComSignalType=UINT8
            DET_CONFD_AZIMUTH_211_oRDR_DETECTION_209_212_oPCAN_RADAR_8123e342_Tx: ComSignalType=UINT8
            DET_CONFD_AZIMUTH_212_oRDR_DETECTION_209_212_oPCAN_RADAR_e5c398bc_Tx: ComSignalType=UINT8
            DET_CONFD_ELEVATION_209_oRDR_DETECTION_209_212_oPCAN_RADAR_73e64489_Tx: ComSignalType=UINT8
            DET_CONFD_ELEVATION_210_oRDR_DETECTION_209_212_oPCAN_RADAR_16c6362d_Tx: ComSignalType=UINT8
            DET_CONFD_ELEVATION_211_oRDR_DETECTION_209_212_oPCAN_RADAR_83b6e2b8_Tx: ComSignalType=UINT8
            DET_CONFD_ELEVATION_212_oRDR_DETECTION_209_212_oPCAN_RADAR_e7569946_Tx: ComSignalType=UINT8
            DET_ELEVATION_209_oRDR_DETECTION_209_212_oPCAN_RADAR_a22690b5_Tx: ComSignalType=UINT8
            DET_ELEVATION_210_oRDR_DETECTION_209_212_oPCAN_RADAR_c706e211_Tx: ComSignalType=UINT8
            DET_ELEVATION_211_oRDR_DETECTION_209_212_oPCAN_RADAR_52763684_Tx: ComSignalType=UINT8
            DET_ELEVATION_212_oRDR_DETECTION_209_212_oPCAN_RADAR_36964d7a_Tx: ComSignalType=UINT8
            DET_ELEVATION_ERR_209_oRDR_DETECTION_209_212_oPCAN_RADAR_251f08c0_Tx: ComSignalType=UINT8
            DET_ELEVATION_ERR_210_oRDR_DETECTION_209_212_oPCAN_RADAR_403f7a64_Tx: ComSignalType=UINT8
            DET_ELEVATION_ERR_211_oRDR_DETECTION_209_212_oPCAN_RADAR_d54faef1_Tx: ComSignalType=UINT8
            DET_ELEVATION_ERR_212_oRDR_DETECTION_209_212_oPCAN_RADAR_b1afd50f_Tx: ComSignalType=UINT8
            DET_EXISTENCE_PROB_209_oRDR_DETECTION_209_212_oPCAN_RADAR_f7807da0_Tx: ComSignalType=UINT8
            DET_EXISTENCE_PROB_210_oRDR_DETECTION_209_212_oPCAN_RADAR_92a00f04_Tx: ComSignalType=UINT8
            DET_EXISTENCE_PROB_211_oRDR_DETECTION_209_212_oPCAN_RADAR_07d0db91_Tx: ComSignalType=UINT8
            DET_EXISTENCE_PROB_212_oRDR_DETECTION_209_212_oPCAN_RADAR_6330a06f_Tx: ComSignalType=UINT8
            DET_HVC_FLAG_209_oRDR_DETECTION_209_212_oPCAN_RADAR_16f43edf_Tx: ComSignalType=BOOLEAN
            DET_HVC_FLAG_210_oRDR_DETECTION_209_212_oPCAN_RADAR_73d44c7b_Tx: ComSignalType=BOOLEAN
            DET_HVC_FLAG_211_oRDR_DETECTION_209_212_oPCAN_RADAR_e6a498ee_Tx: ComSignalType=BOOLEAN
            DET_HVC_FLAG_212_oRDR_DETECTION_209_212_oPCAN_RADAR_8244e310_Tx: ComSignalType=BOOLEAN
            DET_IDM_209_oRDR_DETECTION_209_212_oPCAN_RADAR_9da60562_Tx: ComSignalType=UINT8
            DET_IDM_210_oRDR_DETECTION_209_212_oPCAN_RADAR_f88677c6_Tx: ComSignalType=UINT8
            DET_IDM_211_oRDR_DETECTION_209_212_oPCAN_RADAR_6df6a353_Tx: ComSignalType=UINT8
            DET_IDM_212_oRDR_DETECTION_209_212_oPCAN_RADAR_0916d8ad_Tx: ComSignalType=UINT8
            DET_MH_CRC16_209_212_oRDR_DETECTION_209_212_oPCAN_RADAR_362912ff_Tx: ComSignalType=UINT16
            DET_MH_CYCLE_COUNTER_209_212_oRDR_DETECTION_209_212_oPCAN_RADAR_b25cb3c8_Tx: ComSignalType=UINT8
            DET_MH_SCAN_INDEX_4LSB_209_212_oRDR_DETECTION_209_212_oPCAN_RADAR_7e769644_Tx: ComSignalType=UINT8
            DET_MTD_209_oRDR_DETECTION_209_212_oPCAN_RADAR_fb1537b9_Tx: ComSignalType=UINT8
            DET_MTD_210_oRDR_DETECTION_209_212_oPCAN_RADAR_9e35451d_Tx: ComSignalType=UINT8
            DET_MTD_211_oRDR_DETECTION_209_212_oPCAN_RADAR_0b459188_Tx: ComSignalType=UINT8
            DET_MTD_212_oRDR_DETECTION_209_212_oPCAN_RADAR_6fa5ea76_Tx: ComSignalType=UINT8
            DET_PROB_1STAZHYPO_209_oRDR_DETECTION_209_212_oPCAN_RADAR_68a1df74_Tx: ComSignalType=BOOLEAN
            DET_PROB_1STAZHYPO_210_oRDR_DETECTION_209_212_oPCAN_RADAR_0d81add0_Tx: ComSignalType=BOOLEAN
            DET_PROB_1STAZHYPO_211_oRDR_DETECTION_209_212_oPCAN_RADAR_98f17945_Tx: ComSignalType=BOOLEAN
            DET_PROB_1STAZHYPO_212_oRDR_DETECTION_209_212_oPCAN_RADAR_fc1102bb_Tx: ComSignalType=BOOLEAN
            DET_RANGE_209_oRDR_DETECTION_209_212_oPCAN_RADAR_630e3c02_Tx: ComSignalType=UINT16
            DET_RANGE_210_oRDR_DETECTION_209_212_oPCAN_RADAR_062e4ea6_Tx: ComSignalType=UINT16
            DET_RANGE_211_oRDR_DETECTION_209_212_oPCAN_RADAR_935e9a33_Tx: ComSignalType=UINT16
            DET_RANGE_212_oRDR_DETECTION_209_212_oPCAN_RADAR_f7bee1cd_Tx: ComSignalType=UINT16
            DET_RANGE_ERR_209_oRDR_DETECTION_209_212_oPCAN_RADAR_c4e6866b_Tx: ComSignalType=UINT8
            DET_RANGE_ERR_210_oRDR_DETECTION_209_212_oPCAN_RADAR_a1c6f4cf_Tx: ComSignalType=UINT8
            DET_RANGE_ERR_211_oRDR_DETECTION_209_212_oPCAN_RADAR_34b6205a_Tx: ComSignalType=UINT8
            DET_RANGE_ERR_212_oRDR_DETECTION_209_212_oPCAN_RADAR_50565ba4_Tx: ComSignalType=UINT8
            DET_RANGE_VELOCITY_209_oRDR_DETECTION_209_212_oPCAN_RADAR_16a8fe27_Tx: ComSignalType=UINT16
            DET_RANGE_VELOCITY_210_oRDR_DETECTION_209_212_oPCAN_RADAR_73888c83_Tx: ComSignalType=UINT16
            DET_RANGE_VELOCITY_211_oRDR_DETECTION_209_212_oPCAN_RADAR_e6f85816_Tx: ComSignalType=UINT16
            DET_RANGE_VELOCITY_212_oRDR_DETECTION_209_212_oPCAN_RADAR_821823e8_Tx: ComSignalType=UINT16
            DET_RANGE_VELOCITY_ERR_209_oRDR_DETECTION_209_212_oPCAN_RADAR_19130595_Tx: ComSignalType=UINT8
            DET_RANGE_VELOCITY_ERR_210_oRDR_DETECTION_209_212_oPCAN_RADAR_7c337731_Tx: ComSignalType=UINT8
            DET_RANGE_VELOCITY_ERR_211_oRDR_DETECTION_209_212_oPCAN_RADAR_e943a3a4_Tx: ComSignalType=UINT8
            DET_RANGE_VELOCITY_ERR_212_oRDR_DETECTION_209_212_oPCAN_RADAR_8da3d85a_Tx: ComSignalType=UINT8
            DET_RCS_209_oRDR_DETECTION_209_212_oPCAN_RADAR_9128c97d_Tx: ComSignalType=UINT8
            DET_RCS_210_oRDR_DETECTION_209_212_oPCAN_RADAR_f408bbd9_Tx: ComSignalType=UINT8
            DET_RCS_211_oRDR_DETECTION_209_212_oPCAN_RADAR_61786f4c_Tx: ComSignalType=UINT8
            DET_RCS_212_oRDR_DETECTION_209_212_oPCAN_RADAR_059814b2_Tx: ComSignalType=UINT8
            DET_SNR_209_oRDR_DETECTION_209_212_oPCAN_RADAR_4c869d7f_Tx: ComSignalType=UINT8
            DET_SNR_210_oRDR_DETECTION_209_212_oPCAN_RADAR_29a6efdb_Tx: ComSignalType=UINT8
            DET_SNR_211_oRDR_DETECTION_209_212_oPCAN_RADAR_bcd63b4e_Tx: ComSignalType=UINT8
            DET_SNR_212_oRDR_DETECTION_209_212_oPCAN_RADAR_d83640b0_Tx: ComSignalType=UINT8
            DET_SUPER_RES_TARGET_209_oRDR_DETECTION_209_212_oPCAN_RADAR_7d1fb51a_Tx: ComSignalType=BOOLEAN
            DET_SUPER_RES_TARGET_210_oRDR_DETECTION_209_212_oPCAN_RADAR_183fc7be_Tx: ComSignalType=BOOLEAN
            DET_SUPER_RES_TARGET_211_oRDR_DETECTION_209_212_oPCAN_RADAR_8d4f132b_Tx: ComSignalType=BOOLEAN
            DET_SUPER_RES_TARGET_212_oRDR_DETECTION_209_212_oPCAN_RADAR_e9af68d5_Tx: ComSignalType=BOOLEAN
        SG_Detections_213_216_oRDR_DETECTION_213_216_oPCAN_RADAR_80aaa8dc_Tx
          83 x ComGroupSignal:
            DET_AZIMUTH_213_oRDR_DETECTION_213_216_oPCAN_RADAR_6f9245cd_Tx: ComSignalType=UINT16
            DET_AZIMUTH_214_oRDR_DETECTION_213_216_oPCAN_RADAR_332266a4_Tx: ComSignalType=UINT16
            DET_AZIMUTH_215_oRDR_DETECTION_213_216_oPCAN_RADAR_a652b231_Tx: ComSignalType=UINT16
            DET_AZIMUTH_216_oRDR_DETECTION_213_216_oPCAN_RADAR_c2b2c9cf_Tx: ComSignalType=UINT16
            DET_AZIMUTH_ERR_213_oRDR_DETECTION_213_216_oPCAN_RADAR_cb27d038_Tx: ComSignalType=UINT8
            DET_AZIMUTH_ERR_214_oRDR_DETECTION_213_216_oPCAN_RADAR_9797f351_Tx: ComSignalType=UINT8
            DET_AZIMUTH_ERR_215_oRDR_DETECTION_213_216_oPCAN_RADAR_02e727c4_Tx: ComSignalType=UINT8
            DET_AZIMUTH_ERR_216_oRDR_DETECTION_213_216_oPCAN_RADAR_66075c3a_Tx: ComSignalType=UINT8
            DET_BELOW_RAIN_THOLD_213_oRDR_DETECTION_213_216_oPCAN_RADAR_ba93d60d_Tx: ComSignalType=UINT8
            DET_BELOW_RAIN_THOLD_214_oRDR_DETECTION_213_216_oPCAN_RADAR_e623f564_Tx: ComSignalType=UINT8
            DET_BELOW_RAIN_THOLD_215_oRDR_DETECTION_213_216_oPCAN_RADAR_735321f1_Tx: ComSignalType=UINT8
            DET_BELOW_RAIN_THOLD_216_oRDR_DETECTION_213_216_oPCAN_RADAR_17b35a0f_Tx: ComSignalType=UINT8
            DET_BI_STATIC_FLAG_213_oRDR_DETECTION_213_216_oPCAN_RADAR_39be0548_Tx: ComSignalType=BOOLEAN
            DET_BI_STATIC_FLAG_214_oRDR_DETECTION_213_216_oPCAN_RADAR_650e2621_Tx: ComSignalType=BOOLEAN
            DET_BI_STATIC_FLAG_215_oRDR_DETECTION_213_216_oPCAN_RADAR_f07ef2b4_Tx: ComSignalType=BOOLEAN
            DET_BI_STATIC_FLAG_216_oRDR_DETECTION_213_216_oPCAN_RADAR_949e894a_Tx: ComSignalType=BOOLEAN
            DET_CONFD_AZIMUTH_213_oRDR_DETECTION_213_216_oPCAN_RADAR_6d744f07_Tx: ComSignalType=UINT8
            DET_CONFD_AZIMUTH_214_oRDR_DETECTION_213_216_oPCAN_RADAR_31c46c6e_Tx: ComSignalType=UINT8
            DET_CONFD_AZIMUTH_215_oRDR_DETECTION_213_216_oPCAN_RADAR_a4b4b8fb_Tx: ComSignalType=UINT8
            DET_CONFD_AZIMUTH_216_oRDR_DETECTION_213_216_oPCAN_RADAR_c054c305_Tx: ComSignalType=UINT8
            DET_CONFD_ELEVATION_213_oRDR_DETECTION_213_216_oPCAN_RADAR_6fe14efd_Tx: ComSignalType=UINT8
            DET_CONFD_ELEVATION_214_oRDR_DETECTION_213_216_oPCAN_RADAR_33516d94_Tx: ComSignalType=UINT8
            DET_CONFD_ELEVATION_215_oRDR_DETECTION_213_216_oPCAN_RADAR_a621b901_Tx: ComSignalType=UINT8
            DET_CONFD_ELEVATION_216_oRDR_DETECTION_213_216_oPCAN_RADAR_c2c1c2ff_Tx: ComSignalType=UINT8
            DET_ELEVATION_213_oRDR_DETECTION_213_216_oPCAN_RADAR_be219ac1_Tx: ComSignalType=UINT8
            DET_ELEVATION_214_oRDR_DETECTION_213_216_oPCAN_RADAR_e291b9a8_Tx: ComSignalType=UINT8
            DET_ELEVATION_215_oRDR_DETECTION_213_216_oPCAN_RADAR_77e16d3d_Tx: ComSignalType=UINT8
            DET_ELEVATION_216_oRDR_DETECTION_213_216_oPCAN_RADAR_130116c3_Tx: ComSignalType=UINT8
            DET_ELEVATION_ERR_213_oRDR_DETECTION_213_216_oPCAN_RADAR_391802b4_Tx: ComSignalType=UINT8
            DET_ELEVATION_ERR_214_oRDR_DETECTION_213_216_oPCAN_RADAR_65a821dd_Tx: ComSignalType=UINT8
            DET_ELEVATION_ERR_215_oRDR_DETECTION_213_216_oPCAN_RADAR_f0d8f548_Tx: ComSignalType=UINT8
            DET_ELEVATION_ERR_216_oRDR_DETECTION_213_216_oPCAN_RADAR_94388eb6_Tx: ComSignalType=UINT8
            DET_EXISTENCE_PROB_213_oRDR_DETECTION_213_216_oPCAN_RADAR_eb8777d4_Tx: ComSignalType=UINT8
            DET_EXISTENCE_PROB_214_oRDR_DETECTION_213_216_oPCAN_RADAR_b73754bd_Tx: ComSignalType=UINT8
            DET_EXISTENCE_PROB_215_oRDR_DETECTION_213_216_oPCAN_RADAR_22478028_Tx: ComSignalType=UINT8
            DET_EXISTENCE_PROB_216_oRDR_DETECTION_213_216_oPCAN_RADAR_46a7fbd6_Tx: ComSignalType=UINT8
            DET_HVC_FLAG_213_oRDR_DETECTION_213_216_oPCAN_RADAR_0af334ab_Tx: ComSignalType=BOOLEAN
            DET_HVC_FLAG_214_oRDR_DETECTION_213_216_oPCAN_RADAR_564317c2_Tx: ComSignalType=BOOLEAN
            DET_HVC_FLAG_215_oRDR_DETECTION_213_216_oPCAN_RADAR_c333c357_Tx: ComSignalType=BOOLEAN
            DET_HVC_FLAG_216_oRDR_DETECTION_213_216_oPCAN_RADAR_a7d3b8a9_Tx: ComSignalType=BOOLEAN
            DET_IDM_213_oRDR_DETECTION_213_216_oPCAN_RADAR_81a10f16_Tx: ComSignalType=UINT8
            DET_IDM_214_oRDR_DETECTION_213_216_oPCAN_RADAR_dd112c7f_Tx: ComSignalType=UINT8
            DET_IDM_215_oRDR_DETECTION_213_216_oPCAN_RADAR_4861f8ea_Tx: ComSignalType=UINT8
            DET_IDM_216_oRDR_DETECTION_213_216_oPCAN_RADAR_2c818314_Tx: ComSignalType=UINT8
            DET_MH_CRC16_213_216_oRDR_DETECTION_213_216_oPCAN_RADAR_04227ad7_Tx: ComSignalType=UINT16
            DET_MH_CYCLE_COUNTER_213_216_oRDR_DETECTION_213_216_oPCAN_RADAR_8057dbe0_Tx: ComSignalType=UINT8
            DET_MH_SCAN_INDEX_4LSB_213_216_oRDR_DETECTION_213_216_oPCAN_RADAR_4c7dfe6c_Tx: ComSignalType=UINT8
            DET_MTD_213_oRDR_DETECTION_213_216_oPCAN_RADAR_e7123dcd_Tx: ComSignalType=UINT8
            DET_MTD_214_oRDR_DETECTION_213_216_oPCAN_RADAR_bba21ea4_Tx: ComSignalType=UINT8
            DET_MTD_215_oRDR_DETECTION_213_216_oPCAN_RADAR_2ed2ca31_Tx: ComSignalType=UINT8
            DET_MTD_216_oRDR_DETECTION_213_216_oPCAN_RADAR_4a32b1cf_Tx: ComSignalType=UINT8
            DET_PROB_1STAZHYPO_213_oRDR_DETECTION_213_216_oPCAN_RADAR_74a6d500_Tx: ComSignalType=BOOLEAN
            DET_PROB_1STAZHYPO_214_oRDR_DETECTION_213_216_oPCAN_RADAR_2816f669_Tx: ComSignalType=BOOLEAN
            DET_PROB_1STAZHYPO_215_oRDR_DETECTION_213_216_oPCAN_RADAR_bd6622fc_Tx: ComSignalType=BOOLEAN
            DET_PROB_1STAZHYPO_216_oRDR_DETECTION_213_216_oPCAN_RADAR_d9865902_Tx: ComSignalType=BOOLEAN
            DET_RANGE_213_oRDR_DETECTION_213_216_oPCAN_RADAR_7f093676_Tx: ComSignalType=UINT16
            DET_RANGE_214_oRDR_DETECTION_213_216_oPCAN_RADAR_23b9151f_Tx: ComSignalType=UINT16
            DET_RANGE_215_oRDR_DETECTION_213_216_oPCAN_RADAR_b6c9c18a_Tx: ComSignalType=UINT16
            DET_RANGE_216_oRDR_DETECTION_213_216_oPCAN_RADAR_d229ba74_Tx: ComSignalType=UINT16
            DET_RANGE_ERR_213_oRDR_DETECTION_213_216_oPCAN_RADAR_d8e18c1f_Tx: ComSignalType=UINT8
            DET_RANGE_ERR_214_oRDR_DETECTION_213_216_oPCAN_RADAR_8451af76_Tx: ComSignalType=UINT8
            DET_RANGE_ERR_215_oRDR_DETECTION_213_216_oPCAN_RADAR_11217be3_Tx: ComSignalType=UINT8
            DET_RANGE_ERR_216_oRDR_DETECTION_213_216_oPCAN_RADAR_75c1001d_Tx: ComSignalType=UINT8
            DET_RANGE_VELOCITY_213_oRDR_DETECTION_213_216_oPCAN_RADAR_0aaff453_Tx: ComSignalType=UINT16
            DET_RANGE_VELOCITY_214_oRDR_DETECTION_213_216_oPCAN_RADAR_561fd73a_Tx: ComSignalType=UINT16
            DET_RANGE_VELOCITY_215_oRDR_DETECTION_213_216_oPCAN_RADAR_c36f03af_Tx: ComSignalType=UINT16
            DET_RANGE_VELOCITY_216_oRDR_DETECTION_213_216_oPCAN_RADAR_a78f7851_Tx: ComSignalType=UINT16
            DET_RANGE_VELOCITY_ERR_213_oRDR_DETECTION_213_216_oPCAN_RADAR_05140fe1_Tx: ComSignalType=UINT8
            DET_RANGE_VELOCITY_ERR_214_oRDR_DETECTION_213_216_oPCAN_RADAR_59a42c88_Tx: ComSignalType=UINT8
            DET_RANGE_VELOCITY_ERR_215_oRDR_DETECTION_213_216_oPCAN_RADAR_ccd4f81d_Tx: ComSignalType=UINT8
            DET_RANGE_VELOCITY_ERR_216_oRDR_DETECTION_213_216_oPCAN_RADAR_a83483e3_Tx: ComSignalType=UINT8
            DET_RCS_213_oRDR_DETECTION_213_216_oPCAN_RADAR_8d2fc309_Tx: ComSignalType=UINT8
            DET_RCS_214_oRDR_DETECTION_213_216_oPCAN_RADAR_d19fe060_Tx: ComSignalType=UINT8
            DET_RCS_215_oRDR_DETECTION_213_216_oPCAN_RADAR_44ef34f5_Tx: ComSignalType=UINT8
            DET_RCS_216_oRDR_DETECTION_213_216_oPCAN_RADAR_200f4f0b_Tx: ComSignalType=UINT8
            DET_SNR_213_oRDR_DETECTION_213_216_oPCAN_RADAR_5081970b_Tx: ComSignalType=UINT8
            DET_SNR_214_oRDR_DETECTION_213_216_oPCAN_RADAR_0c31b462_Tx: ComSignalType=UINT8
            DET_SNR_215_oRDR_DETECTION_213_216_oPCAN_RADAR_994160f7_Tx: ComSignalType=UINT8
            DET_SNR_216_oRDR_DETECTION_213_216_oPCAN_RADAR_fda11b09_Tx: ComSignalType=UINT8
            DET_SUPER_RES_TARGET_213_oRDR_DETECTION_213_216_oPCAN_RADAR_6118bf6e_Tx: ComSignalType=BOOLEAN
            DET_SUPER_RES_TARGET_214_oRDR_DETECTION_213_216_oPCAN_RADAR_3da89c07_Tx: ComSignalType=BOOLEAN
            DET_SUPER_RES_TARGET_215_oRDR_DETECTION_213_216_oPCAN_RADAR_a8d84892_Tx: ComSignalType=BOOLEAN
            DET_SUPER_RES_TARGET_216_oRDR_DETECTION_213_216_oPCAN_RADAR_cc38336c_Tx: ComSignalType=BOOLEAN
        SG_Detections_217_220_oRDR_DETECTION_217_220_oPCAN_RADAR_6c06fe56_Tx
          83 x ComGroupSignal:
            DET_AZIMUTH_217_oRDR_DETECTION_217_220_oPCAN_RADAR_f84ec093_Tx: ComSignalType=UINT16
            DET_AZIMUTH_218_oRDR_DETECTION_217_220_oPCAN_RADAR_d45e52d4_Tx: ComSignalType=UINT16
            DET_AZIMUTH_219_oRDR_DETECTION_217_220_oPCAN_RADAR_412e8641_Tx: ComSignalType=UINT16
            DET_AZIMUTH_220_oRDR_DETECTION_217_220_oPCAN_RADAR_fe9fdc9a_Tx: ComSignalType=UINT16
            DET_AZIMUTH_ERR_217_oRDR_DETECTION_217_220_oPCAN_RADAR_5cfb5566_Tx: ComSignalType=UINT8
            DET_AZIMUTH_ERR_218_oRDR_DETECTION_217_220_oPCAN_RADAR_70ebc721_Tx: ComSignalType=UINT8
            DET_AZIMUTH_ERR_219_oRDR_DETECTION_217_220_oPCAN_RADAR_e59b13b4_Tx: ComSignalType=UINT8
            DET_AZIMUTH_ERR_220_oRDR_DETECTION_217_220_oPCAN_RADAR_5a2a496f_Tx: ComSignalType=UINT8
            DET_BELOW_RAIN_THOLD_217_oRDR_DETECTION_217_220_oPCAN_RADAR_2d4f5353_Tx: ComSignalType=UINT8
            DET_BELOW_RAIN_THOLD_218_oRDR_DETECTION_217_220_oPCAN_RADAR_015fc114_Tx: ComSignalType=UINT8
            DET_BELOW_RAIN_THOLD_219_oRDR_DETECTION_217_220_oPCAN_RADAR_942f1581_Tx: ComSignalType=UINT8
            DET_BELOW_RAIN_THOLD_220_oRDR_DETECTION_217_220_oPCAN_RADAR_2b9e4f5a_Tx: ComSignalType=UINT8
            DET_BI_STATIC_FLAG_217_oRDR_DETECTION_217_220_oPCAN_RADAR_ae628016_Tx: ComSignalType=BOOLEAN
            DET_BI_STATIC_FLAG_218_oRDR_DETECTION_217_220_oPCAN_RADAR_82721251_Tx: ComSignalType=BOOLEAN
            DET_BI_STATIC_FLAG_219_oRDR_DETECTION_217_220_oPCAN_RADAR_1702c6c4_Tx: ComSignalType=BOOLEAN
            DET_BI_STATIC_FLAG_220_oRDR_DETECTION_217_220_oPCAN_RADAR_a8b39c1f_Tx: ComSignalType=BOOLEAN
            DET_CONFD_AZIMUTH_217_oRDR_DETECTION_217_220_oPCAN_RADAR_faa8ca59_Tx: ComSignalType=UINT8
            DET_CONFD_AZIMUTH_218_oRDR_DETECTION_217_220_oPCAN_RADAR_d6b8581e_Tx: ComSignalType=UINT8
            DET_CONFD_AZIMUTH_219_oRDR_DETECTION_217_220_oPCAN_RADAR_43c88c8b_Tx: ComSignalType=UINT8
            DET_CONFD_AZIMUTH_220_oRDR_DETECTION_217_220_oPCAN_RADAR_fc79d650_Tx: ComSignalType=UINT8
            DET_CONFD_ELEVATION_217_oRDR_DETECTION_217_220_oPCAN_RADAR_f83dcba3_Tx: ComSignalType=UINT8
            DET_CONFD_ELEVATION_218_oRDR_DETECTION_217_220_oPCAN_RADAR_d42d59e4_Tx: ComSignalType=UINT8
            DET_CONFD_ELEVATION_219_oRDR_DETECTION_217_220_oPCAN_RADAR_415d8d71_Tx: ComSignalType=UINT8
            DET_CONFD_ELEVATION_220_oRDR_DETECTION_217_220_oPCAN_RADAR_feecd7aa_Tx: ComSignalType=UINT8
            DET_ELEVATION_217_oRDR_DETECTION_217_220_oPCAN_RADAR_29fd1f9f_Tx: ComSignalType=UINT8
            DET_ELEVATION_218_oRDR_DETECTION_217_220_oPCAN_RADAR_05ed8dd8_Tx: ComSignalType=UINT8
            DET_ELEVATION_219_oRDR_DETECTION_217_220_oPCAN_RADAR_909d594d_Tx: ComSignalType=UINT8
            DET_ELEVATION_220_oRDR_DETECTION_217_220_oPCAN_RADAR_2f2c0396_Tx: ComSignalType=UINT8
            DET_ELEVATION_ERR_217_oRDR_DETECTION_217_220_oPCAN_RADAR_aec487ea_Tx: ComSignalType=UINT8
            DET_ELEVATION_ERR_218_oRDR_DETECTION_217_220_oPCAN_RADAR_82d415ad_Tx: ComSignalType=UINT8
            DET_ELEVATION_ERR_219_oRDR_DETECTION_217_220_oPCAN_RADAR_17a4c138_Tx: ComSignalType=UINT8
            DET_ELEVATION_ERR_220_oRDR_DETECTION_217_220_oPCAN_RADAR_a8159be3_Tx: ComSignalType=UINT8
            DET_EXISTENCE_PROB_217_oRDR_DETECTION_217_220_oPCAN_RADAR_7c5bf28a_Tx: ComSignalType=UINT8
            DET_EXISTENCE_PROB_218_oRDR_DETECTION_217_220_oPCAN_RADAR_504b60cd_Tx: ComSignalType=UINT8
            DET_EXISTENCE_PROB_219_oRDR_DETECTION_217_220_oPCAN_RADAR_c53bb458_Tx: ComSignalType=UINT8
            DET_EXISTENCE_PROB_220_oRDR_DETECTION_217_220_oPCAN_RADAR_7a8aee83_Tx: ComSignalType=UINT8
            DET_HVC_FLAG_217_oRDR_DETECTION_217_220_oPCAN_RADAR_9d2fb1f5_Tx: ComSignalType=BOOLEAN
            DET_HVC_FLAG_218_oRDR_DETECTION_217_220_oPCAN_RADAR_b13f23b2_Tx: ComSignalType=BOOLEAN
            DET_HVC_FLAG_219_oRDR_DETECTION_217_220_oPCAN_RADAR_244ff727_Tx: ComSignalType=BOOLEAN
            DET_HVC_FLAG_220_oRDR_DETECTION_217_220_oPCAN_RADAR_9bfeadfc_Tx: ComSignalType=BOOLEAN
            DET_IDM_217_oRDR_DETECTION_217_220_oPCAN_RADAR_167d8a48_Tx: ComSignalType=UINT8
            DET_IDM_218_oRDR_DETECTION_217_220_oPCAN_RADAR_3a6d180f_Tx: ComSignalType=UINT8
            DET_IDM_219_oRDR_DETECTION_217_220_oPCAN_RADAR_af1dcc9a_Tx: ComSignalType=UINT8
            DET_IDM_220_oRDR_DETECTION_217_220_oPCAN_RADAR_10ac9641_Tx: ComSignalType=UINT8
            DET_MH_CRC16_217_220_oRDR_DETECTION_217_220_oPCAN_RADAR_e88e2c5d_Tx: ComSignalType=UINT16
            DET_MH_CYCLE_COUNTER_217_220_oRDR_DETECTION_217_220_oPCAN_RADAR_6cfb8d6a_Tx: ComSignalType=UINT8
            DET_MH_SCAN_INDEX_4LSB_217_220_oRDR_DETECTION_217_220_oPCAN_RADAR_a0d1a8e6_Tx: ComSignalType=UINT8
            DET_MTD_217_oRDR_DETECTION_217_220_oPCAN_RADAR_70ceb893_Tx: ComSignalType=UINT8
            DET_MTD_218_oRDR_DETECTION_217_220_oPCAN_RADAR_5cde2ad4_Tx: ComSignalType=UINT8
            DET_MTD_219_oRDR_DETECTION_217_220_oPCAN_RADAR_c9aefe41_Tx: ComSignalType=UINT8
            DET_MTD_220_oRDR_DETECTION_217_220_oPCAN_RADAR_761fa49a_Tx: ComSignalType=UINT8
            DET_PROB_1STAZHYPO_217_oRDR_DETECTION_217_220_oPCAN_RADAR_e37a505e_Tx: ComSignalType=BOOLEAN
            DET_PROB_1STAZHYPO_218_oRDR_DETECTION_217_220_oPCAN_RADAR_cf6ac219_Tx: ComSignalType=BOOLEAN
            DET_PROB_1STAZHYPO_219_oRDR_DETECTION_217_220_oPCAN_RADAR_5a1a168c_Tx: ComSignalType=BOOLEAN
            DET_PROB_1STAZHYPO_220_oRDR_DETECTION_217_220_oPCAN_RADAR_e5ab4c57_Tx: ComSignalType=BOOLEAN
            DET_RANGE_217_oRDR_DETECTION_217_220_oPCAN_RADAR_e8d5b328_Tx: ComSignalType=UINT16
            DET_RANGE_218_oRDR_DETECTION_217_220_oPCAN_RADAR_c4c5216f_Tx: ComSignalType=UINT16
            DET_RANGE_219_oRDR_DETECTION_217_220_oPCAN_RADAR_51b5f5fa_Tx: ComSignalType=UINT16
            DET_RANGE_220_oRDR_DETECTION_217_220_oPCAN_RADAR_ee04af21_Tx: ComSignalType=UINT16
            DET_RANGE_ERR_217_oRDR_DETECTION_217_220_oPCAN_RADAR_4f3d0941_Tx: ComSignalType=UINT8
            DET_RANGE_ERR_218_oRDR_DETECTION_217_220_oPCAN_RADAR_632d9b06_Tx: ComSignalType=UINT8
            DET_RANGE_ERR_219_oRDR_DETECTION_217_220_oPCAN_RADAR_f65d4f93_Tx: ComSignalType=UINT8
            DET_RANGE_ERR_220_oRDR_DETECTION_217_220_oPCAN_RADAR_49ec1548_Tx: ComSignalType=UINT8
            DET_RANGE_VELOCITY_217_oRDR_DETECTION_217_220_oPCAN_RADAR_9d73710d_Tx: ComSignalType=UINT16
            DET_RANGE_VELOCITY_218_oRDR_DETECTION_217_220_oPCAN_RADAR_b163e34a_Tx: ComSignalType=UINT16
            DET_RANGE_VELOCITY_219_oRDR_DETECTION_217_220_oPCAN_RADAR_241337df_Tx: ComSignalType=UINT16
            DET_RANGE_VELOCITY_220_oRDR_DETECTION_217_220_oPCAN_RADAR_9ba26d04_Tx: ComSignalType=UINT16
            DET_RANGE_VELOCITY_ERR_217_oRDR_DETECTION_217_220_oPCAN_RADAR_92c88abf_Tx: ComSignalType=UINT8
            DET_RANGE_VELOCITY_ERR_218_oRDR_DETECTION_217_220_oPCAN_RADAR_bed818f8_Tx: ComSignalType=UINT8
            DET_RANGE_VELOCITY_ERR_219_oRDR_DETECTION_217_220_oPCAN_RADAR_2ba8cc6d_Tx: ComSignalType=UINT8
            DET_RANGE_VELOCITY_ERR_220_oRDR_DETECTION_217_220_oPCAN_RADAR_941996b6_Tx: ComSignalType=UINT8
            DET_RCS_217_oRDR_DETECTION_217_220_oPCAN_RADAR_1af34657_Tx: ComSignalType=UINT8
            DET_RCS_218_oRDR_DETECTION_217_220_oPCAN_RADAR_36e3d410_Tx: ComSignalType=UINT8
            DET_RCS_219_oRDR_DETECTION_217_220_oPCAN_RADAR_a3930085_Tx: ComSignalType=UINT8
            DET_RCS_220_oRDR_DETECTION_217_220_oPCAN_RADAR_1c225a5e_Tx: ComSignalType=UINT8
            DET_SNR_217_oRDR_DETECTION_217_220_oPCAN_RADAR_c75d1255_Tx: ComSignalType=UINT8
            DET_SNR_218_oRDR_DETECTION_217_220_oPCAN_RADAR_eb4d8012_Tx: ComSignalType=UINT8
            DET_SNR_219_oRDR_DETECTION_217_220_oPCAN_RADAR_7e3d5487_Tx: ComSignalType=UINT8
            DET_SNR_220_oRDR_DETECTION_217_220_oPCAN_RADAR_c18c0e5c_Tx: ComSignalType=UINT8
            DET_SUPER_RES_TARGET_217_oRDR_DETECTION_217_220_oPCAN_RADAR_f6c43a30_Tx: ComSignalType=BOOLEAN
            DET_SUPER_RES_TARGET_218_oRDR_DETECTION_217_220_oPCAN_RADAR_dad4a877_Tx: ComSignalType=BOOLEAN
            DET_SUPER_RES_TARGET_219_oRDR_DETECTION_217_220_oPCAN_RADAR_4fa47ce2_Tx: ComSignalType=BOOLEAN
            DET_SUPER_RES_TARGET_220_oRDR_DETECTION_217_220_oPCAN_RADAR_f0152639_Tx: ComSignalType=BOOLEAN
        SG_Detections_221_224_oRDR_DETECTION_221_224_oPCAN_RADAR_6f6d708f_Tx
          83 x ComGroupSignal:
            DET_AZIMUTH_221_oRDR_DETECTION_221_224_oPCAN_RADAR_e6e408f3_Tx: ComSignalType=UINT16
            DET_AZIMUTH_222_oRDR_DETECTION_221_224_oPCAN_RADAR_8204730d_Tx: ComSignalType=UINT16
            DET_AZIMUTH_223_oRDR_DETECTION_221_224_oPCAN_RADAR_1774a798_Tx: ComSignalType=UINT16
            DET_AZIMUTH_224_oRDR_DETECTION_221_224_oPCAN_RADAR_4bc484f1_Tx: ComSignalType=UINT16
            DET_AZIMUTH_ERR_221_oRDR_DETECTION_221_224_oPCAN_RADAR_42519d06_Tx: ComSignalType=UINT8
            DET_AZIMUTH_ERR_222_oRDR_DETECTION_221_224_oPCAN_RADAR_26b1e6f8_Tx: ComSignalType=UINT8
            DET_AZIMUTH_ERR_223_oRDR_DETECTION_221_224_oPCAN_RADAR_b3c1326d_Tx: ComSignalType=UINT8
            DET_AZIMUTH_ERR_224_oRDR_DETECTION_221_224_oPCAN_RADAR_ef711104_Tx: ComSignalType=UINT8
            DET_BELOW_RAIN_THOLD_221_oRDR_DETECTION_221_224_oPCAN_RADAR_33e59b33_Tx: ComSignalType=UINT8
            DET_BELOW_RAIN_THOLD_222_oRDR_DETECTION_221_224_oPCAN_RADAR_5705e0cd_Tx: ComSignalType=UINT8
            DET_BELOW_RAIN_THOLD_223_oRDR_DETECTION_221_224_oPCAN_RADAR_c2753458_Tx: ComSignalType=UINT8
            DET_BELOW_RAIN_THOLD_224_oRDR_DETECTION_221_224_oPCAN_RADAR_9ec51731_Tx: ComSignalType=UINT8
            DET_BI_STATIC_FLAG_221_oRDR_DETECTION_221_224_oPCAN_RADAR_b0c84876_Tx: ComSignalType=BOOLEAN
            DET_BI_STATIC_FLAG_222_oRDR_DETECTION_221_224_oPCAN_RADAR_d4283388_Tx: ComSignalType=BOOLEAN
            DET_BI_STATIC_FLAG_223_oRDR_DETECTION_221_224_oPCAN_RADAR_4158e71d_Tx: ComSignalType=BOOLEAN
            DET_BI_STATIC_FLAG_224_oRDR_DETECTION_221_224_oPCAN_RADAR_1de8c474_Tx: ComSignalType=BOOLEAN
            DET_CONFD_AZIMUTH_221_oRDR_DETECTION_221_224_oPCAN_RADAR_e4020239_Tx: ComSignalType=UINT8
            DET_CONFD_AZIMUTH_222_oRDR_DETECTION_221_224_oPCAN_RADAR_80e279c7_Tx: ComSignalType=UINT8
            DET_CONFD_AZIMUTH_223_oRDR_DETECTION_221_224_oPCAN_RADAR_1592ad52_Tx: ComSignalType=UINT8
            DET_CONFD_AZIMUTH_224_oRDR_DETECTION_221_224_oPCAN_RADAR_49228e3b_Tx: ComSignalType=UINT8
            DET_CONFD_ELEVATION_221_oRDR_DETECTION_221_224_oPCAN_RADAR_e69703c3_Tx: ComSignalType=UINT8
            DET_CONFD_ELEVATION_222_oRDR_DETECTION_221_224_oPCAN_RADAR_8277783d_Tx: ComSignalType=UINT8
            DET_CONFD_ELEVATION_223_oRDR_DETECTION_221_224_oPCAN_RADAR_1707aca8_Tx: ComSignalType=UINT8
            DET_CONFD_ELEVATION_224_oRDR_DETECTION_221_224_oPCAN_RADAR_4bb78fc1_Tx: ComSignalType=UINT8
            DET_ELEVATION_221_oRDR_DETECTION_221_224_oPCAN_RADAR_3757d7ff_Tx: ComSignalType=UINT8
            DET_ELEVATION_222_oRDR_DETECTION_221_224_oPCAN_RADAR_53b7ac01_Tx: ComSignalType=UINT8
            DET_ELEVATION_223_oRDR_DETECTION_221_224_oPCAN_RADAR_c6c77894_Tx: ComSignalType=UINT8
            DET_ELEVATION_224_oRDR_DETECTION_221_224_oPCAN_RADAR_9a775bfd_Tx: ComSignalType=UINT8
            DET_ELEVATION_ERR_221_oRDR_DETECTION_221_224_oPCAN_RADAR_b06e4f8a_Tx: ComSignalType=UINT8
            DET_ELEVATION_ERR_222_oRDR_DETECTION_221_224_oPCAN_RADAR_d48e3474_Tx: ComSignalType=UINT8
            DET_ELEVATION_ERR_223_oRDR_DETECTION_221_224_oPCAN_RADAR_41fee0e1_Tx: ComSignalType=UINT8
            DET_ELEVATION_ERR_224_oRDR_DETECTION_221_224_oPCAN_RADAR_1d4ec388_Tx: ComSignalType=UINT8
            DET_EXISTENCE_PROB_221_oRDR_DETECTION_221_224_oPCAN_RADAR_62f13aea_Tx: ComSignalType=UINT8
            DET_EXISTENCE_PROB_222_oRDR_DETECTION_221_224_oPCAN_RADAR_06114114_Tx: ComSignalType=UINT8
            DET_EXISTENCE_PROB_223_oRDR_DETECTION_221_224_oPCAN_RADAR_93619581_Tx: ComSignalType=UINT8
            DET_EXISTENCE_PROB_224_oRDR_DETECTION_221_224_oPCAN_RADAR_cfd1b6e8_Tx: ComSignalType=UINT8
            DET_HVC_FLAG_221_oRDR_DETECTION_221_224_oPCAN_RADAR_83857995_Tx: ComSignalType=BOOLEAN
            DET_HVC_FLAG_222_oRDR_DETECTION_221_224_oPCAN_RADAR_e765026b_Tx: ComSignalType=BOOLEAN
            DET_HVC_FLAG_223_oRDR_DETECTION_221_224_oPCAN_RADAR_7215d6fe_Tx: ComSignalType=BOOLEAN
            DET_HVC_FLAG_224_oRDR_DETECTION_221_224_oPCAN_RADAR_2ea5f597_Tx: ComSignalType=BOOLEAN
            DET_IDM_221_oRDR_DETECTION_221_224_oPCAN_RADAR_08d74228_Tx: ComSignalType=UINT8
            DET_IDM_222_oRDR_DETECTION_221_224_oPCAN_RADAR_6c3739d6_Tx: ComSignalType=UINT8
            DET_IDM_223_oRDR_DETECTION_221_224_oPCAN_RADAR_f947ed43_Tx: ComSignalType=UINT8
            DET_IDM_224_oRDR_DETECTION_221_224_oPCAN_RADAR_a5f7ce2a_Tx: ComSignalType=UINT8
            DET_MH_CRC16_221_224_oRDR_DETECTION_221_224_oPCAN_RADAR_ebe5a284_Tx: ComSignalType=UINT16
            DET_MH_CYCLE_COUNTER_221_224_oRDR_DETECTION_221_224_oPCAN_RADAR_6f9003b3_Tx: ComSignalType=UINT8
            DET_MH_SCAN_INDEX_4LSB_221_224_oRDR_DETECTION_221_224_oPCAN_RADAR_a3ba263f_Tx: ComSignalType=UINT8
            DET_MTD_221_oRDR_DETECTION_221_224_oPCAN_RADAR_6e6470f3_Tx: ComSignalType=UINT8
            DET_MTD_222_oRDR_DETECTION_221_224_oPCAN_RADAR_0a840b0d_Tx: ComSignalType=UINT8
            DET_MTD_223_oRDR_DETECTION_221_224_oPCAN_RADAR_9ff4df98_Tx: ComSignalType=UINT8
            DET_MTD_224_oRDR_DETECTION_221_224_oPCAN_RADAR_c344fcf1_Tx: ComSignalType=UINT8
            DET_PROB_1STAZHYPO_221_oRDR_DETECTION_221_224_oPCAN_RADAR_fdd0983e_Tx: ComSignalType=BOOLEAN
            DET_PROB_1STAZHYPO_222_oRDR_DETECTION_221_224_oPCAN_RADAR_9930e3c0_Tx: ComSignalType=BOOLEAN
            DET_PROB_1STAZHYPO_223_oRDR_DETECTION_221_224_oPCAN_RADAR_0c403755_Tx: ComSignalType=BOOLEAN
            DET_PROB_1STAZHYPO_224_oRDR_DETECTION_221_224_oPCAN_RADAR_50f0143c_Tx: ComSignalType=BOOLEAN
            DET_RANGE_221_oRDR_DETECTION_221_224_oPCAN_RADAR_f67f7b48_Tx: ComSignalType=UINT16
            DET_RANGE_222_oRDR_DETECTION_221_224_oPCAN_RADAR_929f00b6_Tx: ComSignalType=UINT16
            DET_RANGE_223_oRDR_DETECTION_221_224_oPCAN_RADAR_07efd423_Tx: ComSignalType=UINT16
            DET_RANGE_224_oRDR_DETECTION_221_224_oPCAN_RADAR_5b5ff74a_Tx: ComSignalType=UINT16
            DET_RANGE_ERR_221_oRDR_DETECTION_221_224_oPCAN_RADAR_5197c121_Tx: ComSignalType=UINT8
            DET_RANGE_ERR_222_oRDR_DETECTION_221_224_oPCAN_RADAR_3577badf_Tx: ComSignalType=UINT8
            DET_RANGE_ERR_223_oRDR_DETECTION_221_224_oPCAN_RADAR_a0076e4a_Tx: ComSignalType=UINT8
            DET_RANGE_ERR_224_oRDR_DETECTION_221_224_oPCAN_RADAR_fcb74d23_Tx: ComSignalType=UINT8
            DET_RANGE_VELOCITY_221_oRDR_DETECTION_221_224_oPCAN_RADAR_83d9b96d_Tx: ComSignalType=UINT16
            DET_RANGE_VELOCITY_222_oRDR_DETECTION_221_224_oPCAN_RADAR_e739c293_Tx: ComSignalType=UINT16
            DET_RANGE_VELOCITY_223_oRDR_DETECTION_221_224_oPCAN_RADAR_72491606_Tx: ComSignalType=UINT16
            DET_RANGE_VELOCITY_224_oRDR_DETECTION_221_224_oPCAN_RADAR_2ef9356f_Tx: ComSignalType=UINT16
            DET_RANGE_VELOCITY_ERR_221_oRDR_DETECTION_221_224_oPCAN_RADAR_8c6242df_Tx: ComSignalType=UINT8
            DET_RANGE_VELOCITY_ERR_222_oRDR_DETECTION_221_224_oPCAN_RADAR_e8823921_Tx: ComSignalType=UINT8
            DET_RANGE_VELOCITY_ERR_223_oRDR_DETECTION_221_224_oPCAN_RADAR_7df2edb4_Tx: ComSignalType=UINT8
            DET_RANGE_VELOCITY_ERR_224_oRDR_DETECTION_221_224_oPCAN_RADAR_2142cedd_Tx: ComSignalType=UINT8
            DET_RCS_221_oRDR_DETECTION_221_224_oPCAN_RADAR_04598e37_Tx: ComSignalType=UINT8
            DET_RCS_222_oRDR_DETECTION_221_224_oPCAN_RADAR_60b9f5c9_Tx: ComSignalType=UINT8
            DET_RCS_223_oRDR_DETECTION_221_224_oPCAN_RADAR_f5c9215c_Tx: ComSignalType=UINT8
            DET_RCS_224_oRDR_DETECTION_221_224_oPCAN_RADAR_a9790235_Tx: ComSignalType=UINT8
            DET_SNR_221_oRDR_DETECTION_221_224_oPCAN_RADAR_d9f7da35_Tx: ComSignalType=UINT8
            DET_SNR_222_oRDR_DETECTION_221_224_oPCAN_RADAR_bd17a1cb_Tx: ComSignalType=UINT8
            DET_SNR_223_oRDR_DETECTION_221_224_oPCAN_RADAR_2867755e_Tx: ComSignalType=UINT8
            DET_SNR_224_oRDR_DETECTION_221_224_oPCAN_RADAR_74d75637_Tx: ComSignalType=UINT8
            DET_SUPER_RES_TARGET_221_oRDR_DETECTION_221_224_oPCAN_RADAR_e86ef250_Tx: ComSignalType=BOOLEAN
            DET_SUPER_RES_TARGET_222_oRDR_DETECTION_221_224_oPCAN_RADAR_8c8e89ae_Tx: ComSignalType=BOOLEAN
            DET_SUPER_RES_TARGET_223_oRDR_DETECTION_221_224_oPCAN_RADAR_19fe5d3b_Tx: ComSignalType=BOOLEAN
            DET_SUPER_RES_TARGET_224_oRDR_DETECTION_221_224_oPCAN_RADAR_454e7e52_Tx: ComSignalType=BOOLEAN
        SG_Detections_225_228_oRDR_DETECTION_225_228_oPCAN_RADAR_1eae44dd_Tx
          83 x ComGroupSignal:
            DET_AZIMUTH_225_oRDR_DETECTION_225_228_oPCAN_RADAR_3706ce50_Tx: ComSignalType=UINT16
            DET_AZIMUTH_226_oRDR_DETECTION_225_228_oPCAN_RADAR_53e6b5ae_Tx: ComSignalType=UINT16
            DET_AZIMUTH_227_oRDR_DETECTION_225_228_oPCAN_RADAR_c696613b_Tx: ComSignalType=UINT16
            DET_AZIMUTH_228_oRDR_DETECTION_225_228_oPCAN_RADAR_ea86f37c_Tx: ComSignalType=UINT16
            DET_AZIMUTH_ERR_225_oRDR_DETECTION_225_228_oPCAN_RADAR_93b35ba5_Tx: ComSignalType=UINT8
            DET_AZIMUTH_ERR_226_oRDR_DETECTION_225_228_oPCAN_RADAR_f753205b_Tx: ComSignalType=UINT8
            DET_AZIMUTH_ERR_227_oRDR_DETECTION_225_228_oPCAN_RADAR_6223f4ce_Tx: ComSignalType=UINT8
            DET_AZIMUTH_ERR_228_oRDR_DETECTION_225_228_oPCAN_RADAR_4e336689_Tx: ComSignalType=UINT8
            DET_BELOW_RAIN_THOLD_225_oRDR_DETECTION_225_228_oPCAN_RADAR_e2075d90_Tx: ComSignalType=UINT8
            DET_BELOW_RAIN_THOLD_226_oRDR_DETECTION_225_228_oPCAN_RADAR_86e7266e_Tx: ComSignalType=UINT8
            DET_BELOW_RAIN_THOLD_227_oRDR_DETECTION_225_228_oPCAN_RADAR_1397f2fb_Tx: ComSignalType=UINT8
            DET_BELOW_RAIN_THOLD_228_oRDR_DETECTION_225_228_oPCAN_RADAR_3f8760bc_Tx: ComSignalType=UINT8
            DET_BI_STATIC_FLAG_225_oRDR_DETECTION_225_228_oPCAN_RADAR_612a8ed5_Tx: ComSignalType=BOOLEAN
            DET_BI_STATIC_FLAG_226_oRDR_DETECTION_225_228_oPCAN_RADAR_05caf52b_Tx: ComSignalType=BOOLEAN
            DET_BI_STATIC_FLAG_227_oRDR_DETECTION_225_228_oPCAN_RADAR_90ba21be_Tx: ComSignalType=BOOLEAN
            DET_BI_STATIC_FLAG_228_oRDR_DETECTION_225_228_oPCAN_RADAR_bcaab3f9_Tx: ComSignalType=BOOLEAN
            DET_CONFD_AZIMUTH_225_oRDR_DETECTION_225_228_oPCAN_RADAR_35e0c49a_Tx: ComSignalType=UINT8
            DET_CONFD_AZIMUTH_226_oRDR_DETECTION_225_228_oPCAN_RADAR_5100bf64_Tx: ComSignalType=UINT8
            DET_CONFD_AZIMUTH_227_oRDR_DETECTION_225_228_oPCAN_RADAR_c4706bf1_Tx: ComSignalType=UINT8
            DET_CONFD_AZIMUTH_228_oRDR_DETECTION_225_228_oPCAN_RADAR_e860f9b6_Tx: ComSignalType=UINT8
            DET_CONFD_ELEVATION_225_oRDR_DETECTION_225_228_oPCAN_RADAR_3775c560_Tx: ComSignalType=UINT8
            DET_CONFD_ELEVATION_226_oRDR_DETECTION_225_228_oPCAN_RADAR_5395be9e_Tx: ComSignalType=UINT8
            DET_CONFD_ELEVATION_227_oRDR_DETECTION_225_228_oPCAN_RADAR_c6e56a0b_Tx: ComSignalType=UINT8
            DET_CONFD_ELEVATION_228_oRDR_DETECTION_225_228_oPCAN_RADAR_eaf5f84c_Tx: ComSignalType=UINT8
            DET_ELEVATION_225_oRDR_DETECTION_225_228_oPCAN_RADAR_e6b5115c_Tx: ComSignalType=UINT8
            DET_ELEVATION_226_oRDR_DETECTION_225_228_oPCAN_RADAR_82556aa2_Tx: ComSignalType=UINT8
            DET_ELEVATION_227_oRDR_DETECTION_225_228_oPCAN_RADAR_1725be37_Tx: ComSignalType=UINT8
            DET_ELEVATION_228_oRDR_DETECTION_225_228_oPCAN_RADAR_3b352c70_Tx: ComSignalType=UINT8
            DET_ELEVATION_ERR_225_oRDR_DETECTION_225_228_oPCAN_RADAR_618c8929_Tx: ComSignalType=UINT8
            DET_ELEVATION_ERR_226_oRDR_DETECTION_225_228_oPCAN_RADAR_056cf2d7_Tx: ComSignalType=UINT8
            DET_ELEVATION_ERR_227_oRDR_DETECTION_225_228_oPCAN_RADAR_901c2642_Tx: ComSignalType=UINT8
            DET_ELEVATION_ERR_228_oRDR_DETECTION_225_228_oPCAN_RADAR_bc0cb405_Tx: ComSignalType=UINT8
            DET_EXISTENCE_PROB_225_oRDR_DETECTION_225_228_oPCAN_RADAR_b313fc49_Tx: ComSignalType=UINT8
            DET_EXISTENCE_PROB_226_oRDR_DETECTION_225_228_oPCAN_RADAR_d7f387b7_Tx: ComSignalType=UINT8
            DET_EXISTENCE_PROB_227_oRDR_DETECTION_225_228_oPCAN_RADAR_42835322_Tx: ComSignalType=UINT8
            DET_EXISTENCE_PROB_228_oRDR_DETECTION_225_228_oPCAN_RADAR_6e93c165_Tx: ComSignalType=UINT8
            DET_HVC_FLAG_225_oRDR_DETECTION_225_228_oPCAN_RADAR_5267bf36_Tx: ComSignalType=BOOLEAN
            DET_HVC_FLAG_226_oRDR_DETECTION_225_228_oPCAN_RADAR_3687c4c8_Tx: ComSignalType=BOOLEAN
            DET_HVC_FLAG_227_oRDR_DETECTION_225_228_oPCAN_RADAR_a3f7105d_Tx: ComSignalType=BOOLEAN
            DET_HVC_FLAG_228_oRDR_DETECTION_225_228_oPCAN_RADAR_8fe7821a_Tx: ComSignalType=BOOLEAN
            DET_IDM_225_oRDR_DETECTION_225_228_oPCAN_RADAR_d935848b_Tx: ComSignalType=UINT8
            DET_IDM_226_oRDR_DETECTION_225_228_oPCAN_RADAR_bdd5ff75_Tx: ComSignalType=UINT8
            DET_IDM_227_oRDR_DETECTION_225_228_oPCAN_RADAR_28a52be0_Tx: ComSignalType=UINT8
            DET_IDM_228_oRDR_DETECTION_225_228_oPCAN_RADAR_04b5b9a7_Tx: ComSignalType=UINT8
            DET_MH_CRC16_225_228_oRDR_DETECTION_225_228_oPCAN_RADAR_9a2696d6_Tx: ComSignalType=UINT16
            DET_MH_CYCLE_COUNTER_225_228_oRDR_DETECTION_225_228_oPCAN_RADAR_1e5337e1_Tx: ComSignalType=UINT8
            DET_MH_SCAN_INDEX_4LSB_225_228_oRDR_DETECTION_225_228_oPCAN_RADAR_d279126d_Tx: ComSignalType=UINT8
            DET_MTD_225_oRDR_DETECTION_225_228_oPCAN_RADAR_bf86b650_Tx: ComSignalType=UINT8
            DET_MTD_226_oRDR_DETECTION_225_228_oPCAN_RADAR_db66cdae_Tx: ComSignalType=UINT8
            DET_MTD_227_oRDR_DETECTION_225_228_oPCAN_RADAR_4e16193b_Tx: ComSignalType=UINT8
            DET_MTD_228_oRDR_DETECTION_225_228_oPCAN_RADAR_62068b7c_Tx: ComSignalType=UINT8
            DET_PROB_1STAZHYPO_225_oRDR_DETECTION_225_228_oPCAN_RADAR_2c325e9d_Tx: ComSignalType=BOOLEAN
            DET_PROB_1STAZHYPO_226_oRDR_DETECTION_225_228_oPCAN_RADAR_48d22563_Tx: ComSignalType=BOOLEAN
            DET_PROB_1STAZHYPO_227_oRDR_DETECTION_225_228_oPCAN_RADAR_dda2f1f6_Tx: ComSignalType=BOOLEAN
            DET_PROB_1STAZHYPO_228_oRDR_DETECTION_225_228_oPCAN_RADAR_f1b263b1_Tx: ComSignalType=BOOLEAN
            DET_RANGE_225_oRDR_DETECTION_225_228_oPCAN_RADAR_279dbdeb_Tx: ComSignalType=UINT16
            DET_RANGE_226_oRDR_DETECTION_225_228_oPCAN_RADAR_437dc615_Tx: ComSignalType=UINT16
            DET_RANGE_227_oRDR_DETECTION_225_228_oPCAN_RADAR_d60d1280_Tx: ComSignalType=UINT16
            DET_RANGE_228_oRDR_DETECTION_225_228_oPCAN_RADAR_fa1d80c7_Tx: ComSignalType=UINT16
            DET_RANGE_ERR_225_oRDR_DETECTION_225_228_oPCAN_RADAR_80750782_Tx: ComSignalType=UINT8
            DET_RANGE_ERR_226_oRDR_DETECTION_225_228_oPCAN_RADAR_e4957c7c_Tx: ComSignalType=UINT8
            DET_RANGE_ERR_227_oRDR_DETECTION_225_228_oPCAN_RADAR_71e5a8e9_Tx: ComSignalType=UINT8
            DET_RANGE_ERR_228_oRDR_DETECTION_225_228_oPCAN_RADAR_5df53aae_Tx: ComSignalType=UINT8
            DET_RANGE_VELOCITY_225_oRDR_DETECTION_225_228_oPCAN_RADAR_523b7fce_Tx: ComSignalType=UINT16
            DET_RANGE_VELOCITY_226_oRDR_DETECTION_225_228_oPCAN_RADAR_36db0430_Tx: ComSignalType=UINT16
            DET_RANGE_VELOCITY_227_oRDR_DETECTION_225_228_oPCAN_RADAR_a3abd0a5_Tx: ComSignalType=UINT16
            DET_RANGE_VELOCITY_228_oRDR_DETECTION_225_228_oPCAN_RADAR_8fbb42e2_Tx: ComSignalType=UINT16
            DET_RANGE_VELOCITY_ERR_225_oRDR_DETECTION_225_228_oPCAN_RADAR_5d80847c_Tx: ComSignalType=UINT8
            DET_RANGE_VELOCITY_ERR_226_oRDR_DETECTION_225_228_oPCAN_RADAR_3960ff82_Tx: ComSignalType=UINT8
            DET_RANGE_VELOCITY_ERR_227_oRDR_DETECTION_225_228_oPCAN_RADAR_ac102b17_Tx: ComSignalType=UINT8
            DET_RANGE_VELOCITY_ERR_228_oRDR_DETECTION_225_228_oPCAN_RADAR_8000b950_Tx: ComSignalType=UINT8
            DET_RCS_225_oRDR_DETECTION_225_228_oPCAN_RADAR_d5bb4894_Tx: ComSignalType=UINT8
            DET_RCS_226_oRDR_DETECTION_225_228_oPCAN_RADAR_b15b336a_Tx: ComSignalType=UINT8
            DET_RCS_227_oRDR_DETECTION_225_228_oPCAN_RADAR_242be7ff_Tx: ComSignalType=UINT8
            DET_RCS_228_oRDR_DETECTION_225_228_oPCAN_RADAR_083b75b8_Tx: ComSignalType=UINT8
            DET_SNR_225_oRDR_DETECTION_225_228_oPCAN_RADAR_08151c96_Tx: ComSignalType=UINT8
            DET_SNR_226_oRDR_DETECTION_225_228_oPCAN_RADAR_6cf56768_Tx: ComSignalType=UINT8
            DET_SNR_227_oRDR_DETECTION_225_228_oPCAN_RADAR_f985b3fd_Tx: ComSignalType=UINT8
            DET_SNR_228_oRDR_DETECTION_225_228_oPCAN_RADAR_d59521ba_Tx: ComSignalType=UINT8
            DET_SUPER_RES_TARGET_225_oRDR_DETECTION_225_228_oPCAN_RADAR_398c34f3_Tx: ComSignalType=BOOLEAN
            DET_SUPER_RES_TARGET_226_oRDR_DETECTION_225_228_oPCAN_RADAR_5d6c4f0d_Tx: ComSignalType=BOOLEAN
            DET_SUPER_RES_TARGET_227_oRDR_DETECTION_225_228_oPCAN_RADAR_c81c9b98_Tx: ComSignalType=BOOLEAN
            DET_SUPER_RES_TARGET_228_oRDR_DETECTION_225_228_oPCAN_RADAR_e40c09df_Tx: ComSignalType=BOOLEAN
        SG_Detections_229_232_oRDR_DETECTION_229_232_oPCAN_RADAR_87d460a6_Tx
          83 x ComGroupSignal:
            DET_AZIMUTH_229_oRDR_DETECTION_229_232_oPCAN_RADAR_4dbec8e8_Tx: ComSignalType=UINT16
            DET_AZIMUTH_230_oRDR_DETECTION_229_232_oPCAN_RADAR_289eba4c_Tx: ComSignalType=UINT16
            DET_AZIMUTH_231_oRDR_DETECTION_229_232_oPCAN_RADAR_bdee6ed9_Tx: ComSignalType=UINT16
            DET_AZIMUTH_232_oRDR_DETECTION_229_232_oPCAN_RADAR_d90e1527_Tx: ComSignalType=UINT16
            DET_AZIMUTH_ERR_229_oRDR_DETECTION_229_232_oPCAN_RADAR_e90b5d1d_Tx: ComSignalType=UINT8
            DET_AZIMUTH_ERR_230_oRDR_DETECTION_229_232_oPCAN_RADAR_8c2b2fb9_Tx: ComSignalType=UINT8
            DET_AZIMUTH_ERR_231_oRDR_DETECTION_229_232_oPCAN_RADAR_195bfb2c_Tx: ComSignalType=UINT8
            DET_AZIMUTH_ERR_232_oRDR_DETECTION_229_232_oPCAN_RADAR_7dbb80d2_Tx: ComSignalType=UINT8
            DET_BELOW_RAIN_THOLD_229_oRDR_DETECTION_229_232_oPCAN_RADAR_98bf5b28_Tx: ComSignalType=UINT8
            DET_BELOW_RAIN_THOLD_230_oRDR_DETECTION_229_232_oPCAN_RADAR_fd9f298c_Tx: ComSignalType=UINT8
            DET_BELOW_RAIN_THOLD_231_oRDR_DETECTION_229_232_oPCAN_RADAR_68effd19_Tx: ComSignalType=UINT8
            DET_BELOW_RAIN_THOLD_232_oRDR_DETECTION_229_232_oPCAN_RADAR_0c0f86e7_Tx: ComSignalType=UINT8
            DET_BI_STATIC_FLAG_229_oRDR_DETECTION_229_232_oPCAN_RADAR_1b92886d_Tx: ComSignalType=BOOLEAN
            DET_BI_STATIC_FLAG_230_oRDR_DETECTION_229_232_oPCAN_RADAR_7eb2fac9_Tx: ComSignalType=BOOLEAN
            DET_BI_STATIC_FLAG_231_oRDR_DETECTION_229_232_oPCAN_RADAR_ebc22e5c_Tx: ComSignalType=BOOLEAN
            DET_BI_STATIC_FLAG_232_oRDR_DETECTION_229_232_oPCAN_RADAR_8f2255a2_Tx: ComSignalType=BOOLEAN
            DET_CONFD_AZIMUTH_229_oRDR_DETECTION_229_232_oPCAN_RADAR_4f58c222_Tx: ComSignalType=UINT8
            DET_CONFD_AZIMUTH_230_oRDR_DETECTION_229_232_oPCAN_RADAR_2a78b086_Tx: ComSignalType=UINT8
            DET_CONFD_AZIMUTH_231_oRDR_DETECTION_229_232_oPCAN_RADAR_bf086413_Tx: ComSignalType=UINT8
            DET_CONFD_AZIMUTH_232_oRDR_DETECTION_229_232_oPCAN_RADAR_dbe81fed_Tx: ComSignalType=UINT8
            DET_CONFD_ELEVATION_229_oRDR_DETECTION_229_232_oPCAN_RADAR_4dcdc3d8_Tx: ComSignalType=UINT8
            DET_CONFD_ELEVATION_230_oRDR_DETECTION_229_232_oPCAN_RADAR_28edb17c_Tx: ComSignalType=UINT8
            DET_CONFD_ELEVATION_231_oRDR_DETECTION_229_232_oPCAN_RADAR_bd9d65e9_Tx: ComSignalType=UINT8
            DET_CONFD_ELEVATION_232_oRDR_DETECTION_229_232_oPCAN_RADAR_d97d1e17_Tx: ComSignalType=UINT8
            DET_ELEVATION_229_oRDR_DETECTION_229_232_oPCAN_RADAR_9c0d17e4_Tx: ComSignalType=UINT8
            DET_ELEVATION_230_oRDR_DETECTION_229_232_oPCAN_RADAR_f92d6540_Tx: ComSignalType=UINT8
            DET_ELEVATION_231_oRDR_DETECTION_229_232_oPCAN_RADAR_6c5db1d5_Tx: ComSignalType=UINT8
            DET_ELEVATION_232_oRDR_DETECTION_229_232_oPCAN_RADAR_08bdca2b_Tx: ComSignalType=UINT8
            DET_ELEVATION_ERR_229_oRDR_DETECTION_229_232_oPCAN_RADAR_1b348f91_Tx: ComSignalType=UINT8
            DET_ELEVATION_ERR_230_oRDR_DETECTION_229_232_oPCAN_RADAR_7e14fd35_Tx: ComSignalType=UINT8
            DET_ELEVATION_ERR_231_oRDR_DETECTION_229_232_oPCAN_RADAR_eb6429a0_Tx: ComSignalType=UINT8
            DET_ELEVATION_ERR_232_oRDR_DETECTION_229_232_oPCAN_RADAR_8f84525e_Tx: ComSignalType=UINT8
            DET_EXISTENCE_PROB_229_oRDR_DETECTION_229_232_oPCAN_RADAR_c9abfaf1_Tx: ComSignalType=UINT8
            DET_EXISTENCE_PROB_230_oRDR_DETECTION_229_232_oPCAN_RADAR_ac8b8855_Tx: ComSignalType=UINT8
            DET_EXISTENCE_PROB_231_oRDR_DETECTION_229_232_oPCAN_RADAR_39fb5cc0_Tx: ComSignalType=UINT8
            DET_EXISTENCE_PROB_232_oRDR_DETECTION_229_232_oPCAN_RADAR_5d1b273e_Tx: ComSignalType=UINT8
            DET_HVC_FLAG_229_oRDR_DETECTION_229_232_oPCAN_RADAR_28dfb98e_Tx: ComSignalType=BOOLEAN
            DET_HVC_FLAG_230_oRDR_DETECTION_229_232_oPCAN_RADAR_4dffcb2a_Tx: ComSignalType=BOOLEAN
            DET_HVC_FLAG_231_oRDR_DETECTION_229_232_oPCAN_RADAR_d88f1fbf_Tx: ComSignalType=BOOLEAN
            DET_HVC_FLAG_232_oRDR_DETECTION_229_232_oPCAN_RADAR_bc6f6441_Tx: ComSignalType=BOOLEAN
            DET_IDM_229_oRDR_DETECTION_229_232_oPCAN_RADAR_a38d8233_Tx: ComSignalType=UINT8
            DET_IDM_230_oRDR_DETECTION_229_232_oPCAN_RADAR_c6adf097_Tx: ComSignalType=UINT8
            DET_IDM_231_oRDR_DETECTION_229_232_oPCAN_RADAR_53dd2402_Tx: ComSignalType=UINT8
            DET_IDM_232_oRDR_DETECTION_229_232_oPCAN_RADAR_373d5ffc_Tx: ComSignalType=UINT8
            DET_MH_CRC16_229_232_oRDR_DETECTION_229_232_oPCAN_RADAR_035cb2ad_Tx: ComSignalType=UINT16
            DET_MH_CYCLE_COUNTER_229_232_oRDR_DETECTION_229_232_oPCAN_RADAR_8729139a_Tx: ComSignalType=UINT8
            DET_MH_SCAN_INDEX_4LSB_229_232_oRDR_DETECTION_229_232_oPCAN_RADAR_4b033616_Tx: ComSignalType=UINT8
            DET_MTD_229_oRDR_DETECTION_229_232_oPCAN_RADAR_c53eb0e8_Tx: ComSignalType=UINT8
            DET_MTD_230_oRDR_DETECTION_229_232_oPCAN_RADAR_a01ec24c_Tx: ComSignalType=UINT8
            DET_MTD_231_oRDR_DETECTION_229_232_oPCAN_RADAR_356e16d9_Tx: ComSignalType=UINT8
            DET_MTD_232_oRDR_DETECTION_229_232_oPCAN_RADAR_518e6d27_Tx: ComSignalType=UINT8
            DET_PROB_1STAZHYPO_229_oRDR_DETECTION_229_232_oPCAN_RADAR_568a5825_Tx: ComSignalType=BOOLEAN
            DET_PROB_1STAZHYPO_230_oRDR_DETECTION_229_232_oPCAN_RADAR_33aa2a81_Tx: ComSignalType=BOOLEAN
            DET_PROB_1STAZHYPO_231_oRDR_DETECTION_229_232_oPCAN_RADAR_a6dafe14_Tx: ComSignalType=BOOLEAN
            DET_PROB_1STAZHYPO_232_oRDR_DETECTION_229_232_oPCAN_RADAR_c23a85ea_Tx: ComSignalType=BOOLEAN
            DET_RANGE_229_oRDR_DETECTION_229_232_oPCAN_RADAR_5d25bb53_Tx: ComSignalType=UINT16
            DET_RANGE_230_oRDR_DETECTION_229_232_oPCAN_RADAR_3805c9f7_Tx: ComSignalType=UINT16
            DET_RANGE_231_oRDR_DETECTION_229_232_oPCAN_RADAR_ad751d62_Tx: ComSignalType=UINT16
            DET_RANGE_232_oRDR_DETECTION_229_232_oPCAN_RADAR_c995669c_Tx: ComSignalType=UINT16
            DET_RANGE_ERR_229_oRDR_DETECTION_229_232_oPCAN_RADAR_facd013a_Tx: ComSignalType=UINT8
            DET_RANGE_ERR_230_oRDR_DETECTION_229_232_oPCAN_RADAR_9fed739e_Tx: ComSignalType=UINT8
            DET_RANGE_ERR_231_oRDR_DETECTION_229_232_oPCAN_RADAR_0a9da70b_Tx: ComSignalType=UINT8
            DET_RANGE_ERR_232_oRDR_DETECTION_229_232_oPCAN_RADAR_6e7ddcf5_Tx: ComSignalType=UINT8
            DET_RANGE_VELOCITY_229_oRDR_DETECTION_229_232_oPCAN_RADAR_28837976_Tx: ComSignalType=UINT16
            DET_RANGE_VELOCITY_230_oRDR_DETECTION_229_232_oPCAN_RADAR_4da30bd2_Tx: ComSignalType=UINT16
            DET_RANGE_VELOCITY_231_oRDR_DETECTION_229_232_oPCAN_RADAR_d8d3df47_Tx: ComSignalType=UINT16
            DET_RANGE_VELOCITY_232_oRDR_DETECTION_229_232_oPCAN_RADAR_bc33a4b9_Tx: ComSignalType=UINT16
            DET_RANGE_VELOCITY_ERR_229_oRDR_DETECTION_229_232_oPCAN_RADAR_273882c4_Tx: ComSignalType=UINT8
            DET_RANGE_VELOCITY_ERR_230_oRDR_DETECTION_229_232_oPCAN_RADAR_4218f060_Tx: ComSignalType=UINT8
            DET_RANGE_VELOCITY_ERR_231_oRDR_DETECTION_229_232_oPCAN_RADAR_d76824f5_Tx: ComSignalType=UINT8
            DET_RANGE_VELOCITY_ERR_232_oRDR_DETECTION_229_232_oPCAN_RADAR_b3885f0b_Tx: ComSignalType=UINT8
            DET_RCS_229_oRDR_DETECTION_229_232_oPCAN_RADAR_af034e2c_Tx: ComSignalType=UINT8
            DET_RCS_230_oRDR_DETECTION_229_232_oPCAN_RADAR_ca233c88_Tx: ComSignalType=UINT8
            DET_RCS_231_oRDR_DETECTION_229_232_oPCAN_RADAR_5f53e81d_Tx: ComSignalType=UINT8
            DET_RCS_232_oRDR_DETECTION_229_232_oPCAN_RADAR_3bb393e3_Tx: ComSignalType=UINT8
            DET_SNR_229_oRDR_DETECTION_229_232_oPCAN_RADAR_72ad1a2e_Tx: ComSignalType=UINT8
            DET_SNR_230_oRDR_DETECTION_229_232_oPCAN_RADAR_178d688a_Tx: ComSignalType=UINT8
            DET_SNR_231_oRDR_DETECTION_229_232_oPCAN_RADAR_82fdbc1f_Tx: ComSignalType=UINT8
            DET_SNR_232_oRDR_DETECTION_229_232_oPCAN_RADAR_e61dc7e1_Tx: ComSignalType=UINT8
            DET_SUPER_RES_TARGET_229_oRDR_DETECTION_229_232_oPCAN_RADAR_4334324b_Tx: ComSignalType=BOOLEAN
            DET_SUPER_RES_TARGET_230_oRDR_DETECTION_229_232_oPCAN_RADAR_261440ef_Tx: ComSignalType=BOOLEAN
            DET_SUPER_RES_TARGET_231_oRDR_DETECTION_229_232_oPCAN_RADAR_b364947a_Tx: ComSignalType=BOOLEAN
            DET_SUPER_RES_TARGET_232_oRDR_DETECTION_229_232_oPCAN_RADAR_d784ef84_Tx: ComSignalType=BOOLEAN
        SG_Detections_233_236_oRDR_DETECTION_233_236_oPCAN_RADAR_b5df088e_Tx
          83 x ComGroupSignal:
            DET_AZIMUTH_233_oRDR_DETECTION_233_236_oPCAN_RADAR_51b9c29c_Tx: ComSignalType=UINT16
            DET_AZIMUTH_234_oRDR_DETECTION_233_236_oPCAN_RADAR_0d09e1f5_Tx: ComSignalType=UINT16
            DET_AZIMUTH_235_oRDR_DETECTION_233_236_oPCAN_RADAR_98793560_Tx: ComSignalType=UINT16
            DET_AZIMUTH_236_oRDR_DETECTION_233_236_oPCAN_RADAR_fc994e9e_Tx: ComSignalType=UINT16
            DET_AZIMUTH_ERR_233_oRDR_DETECTION_233_236_oPCAN_RADAR_f50c5769_Tx: ComSignalType=UINT8
            DET_AZIMUTH_ERR_234_oRDR_DETECTION_233_236_oPCAN_RADAR_a9bc7400_Tx: ComSignalType=UINT8
            DET_AZIMUTH_ERR_235_oRDR_DETECTION_233_236_oPCAN_RADAR_3ccca095_Tx: ComSignalType=UINT8
            DET_AZIMUTH_ERR_236_oRDR_DETECTION_233_236_oPCAN_RADAR_582cdb6b_Tx: ComSignalType=UINT8
            DET_BELOW_RAIN_THOLD_233_oRDR_DETECTION_233_236_oPCAN_RADAR_84b8515c_Tx: ComSignalType=UINT8
            DET_BELOW_RAIN_THOLD_234_oRDR_DETECTION_233_236_oPCAN_RADAR_d8087235_Tx: ComSignalType=UINT8
            DET_BELOW_RAIN_THOLD_235_oRDR_DETECTION_233_236_oPCAN_RADAR_4d78a6a0_Tx: ComSignalType=UINT8
            DET_BELOW_RAIN_THOLD_236_oRDR_DETECTION_233_236_oPCAN_RADAR_2998dd5e_Tx: ComSignalType=UINT8
            DET_BI_STATIC_FLAG_233_oRDR_DETECTION_233_236_oPCAN_RADAR_07958219_Tx: ComSignalType=BOOLEAN
            DET_BI_STATIC_FLAG_234_oRDR_DETECTION_233_236_oPCAN_RADAR_5b25a170_Tx: ComSignalType=BOOLEAN
            DET_BI_STATIC_FLAG_235_oRDR_DETECTION_233_236_oPCAN_RADAR_ce5575e5_Tx: ComSignalType=BOOLEAN
            DET_BI_STATIC_FLAG_236_oRDR_DETECTION_233_236_oPCAN_RADAR_aab50e1b_Tx: ComSignalType=BOOLEAN
            DET_CONFD_AZIMUTH_233_oRDR_DETECTION_233_236_oPCAN_RADAR_535fc856_Tx: ComSignalType=UINT8
            DET_CONFD_AZIMUTH_234_oRDR_DETECTION_233_236_oPCAN_RADAR_0fefeb3f_Tx: ComSignalType=UINT8
            DET_CONFD_AZIMUTH_235_oRDR_DETECTION_233_236_oPCAN_RADAR_9a9f3faa_Tx: ComSignalType=UINT8
            DET_CONFD_AZIMUTH_236_oRDR_DETECTION_233_236_oPCAN_RADAR_fe7f4454_Tx: ComSignalType=UINT8
            DET_CONFD_ELEVATION_233_oRDR_DETECTION_233_236_oPCAN_RADAR_51cac9ac_Tx: ComSignalType=UINT8
            DET_CONFD_ELEVATION_234_oRDR_DETECTION_233_236_oPCAN_RADAR_0d7aeac5_Tx: ComSignalType=UINT8
            DET_CONFD_ELEVATION_235_oRDR_DETECTION_233_236_oPCAN_RADAR_980a3e50_Tx: ComSignalType=UINT8
            DET_CONFD_ELEVATION_236_oRDR_DETECTION_233_236_oPCAN_RADAR_fcea45ae_Tx: ComSignalType=UINT8
            DET_ELEVATION_233_oRDR_DETECTION_233_236_oPCAN_RADAR_800a1d90_Tx: ComSignalType=UINT8
            DET_ELEVATION_234_oRDR_DETECTION_233_236_oPCAN_RADAR_dcba3ef9_Tx: ComSignalType=UINT8
            DET_ELEVATION_235_oRDR_DETECTION_233_236_oPCAN_RADAR_49caea6c_Tx: ComSignalType=UINT8
            DET_ELEVATION_236_oRDR_DETECTION_233_236_oPCAN_RADAR_2d2a9192_Tx: ComSignalType=UINT8
            DET_ELEVATION_ERR_233_oRDR_DETECTION_233_236_oPCAN_RADAR_073385e5_Tx: ComSignalType=UINT8
            DET_ELEVATION_ERR_234_oRDR_DETECTION_233_236_oPCAN_RADAR_5b83a68c_Tx: ComSignalType=UINT8
            DET_ELEVATION_ERR_235_oRDR_DETECTION_233_236_oPCAN_RADAR_cef37219_Tx: ComSignalType=UINT8
            DET_ELEVATION_ERR_236_oRDR_DETECTION_233_236_oPCAN_RADAR_aa1309e7_Tx: ComSignalType=UINT8
            DET_EXISTENCE_PROB_233_oRDR_DETECTION_233_236_oPCAN_RADAR_d5acf085_Tx: ComSignalType=UINT8
            DET_EXISTENCE_PROB_234_oRDR_DETECTION_233_236_oPCAN_RADAR_891cd3ec_Tx: ComSignalType=UINT8
            DET_EXISTENCE_PROB_235_oRDR_DETECTION_233_236_oPCAN_RADAR_1c6c0779_Tx: ComSignalType=UINT8
            DET_EXISTENCE_PROB_236_oRDR_DETECTION_233_236_oPCAN_RADAR_788c7c87_Tx: ComSignalType=UINT8
            DET_HVC_FLAG_233_oRDR_DETECTION_233_236_oPCAN_RADAR_34d8b3fa_Tx: ComSignalType=BOOLEAN
            DET_HVC_FLAG_234_oRDR_DETECTION_233_236_oPCAN_RADAR_68689093_Tx: ComSignalType=BOOLEAN
            DET_HVC_FLAG_235_oRDR_DETECTION_233_236_oPCAN_RADAR_fd184406_Tx: ComSignalType=BOOLEAN
            DET_HVC_FLAG_236_oRDR_DETECTION_233_236_oPCAN_RADAR_99f83ff8_Tx: ComSignalType=BOOLEAN
            DET_IDM_233_oRDR_DETECTION_233_236_oPCAN_RADAR_bf8a8847_Tx: ComSignalType=UINT8
            DET_IDM_234_oRDR_DETECTION_233_236_oPCAN_RADAR_e33aab2e_Tx: ComSignalType=UINT8
            DET_IDM_235_oRDR_DETECTION_233_236_oPCAN_RADAR_764a7fbb_Tx: ComSignalType=UINT8
            DET_IDM_236_oRDR_DETECTION_233_236_oPCAN_RADAR_12aa0445_Tx: ComSignalType=UINT8
            DET_MH_CRC16_233_236_oRDR_DETECTION_233_236_oPCAN_RADAR_3157da85_Tx: ComSignalType=UINT16
            DET_MH_CYCLE_COUNTER_233_236_oRDR_DETECTION_233_236_oPCAN_RADAR_b5227bb2_Tx: ComSignalType=UINT8
            DET_MH_SCAN_INDEX_4LSB_233_236_oRDR_DETECTION_233_236_oPCAN_RADAR_79085e3e_Tx: ComSignalType=UINT8
            DET_MTD_233_oRDR_DETECTION_233_236_oPCAN_RADAR_d939ba9c_Tx: ComSignalType=UINT8
            DET_MTD_234_oRDR_DETECTION_233_236_oPCAN_RADAR_858999f5_Tx: ComSignalType=UINT8
            DET_MTD_235_oRDR_DETECTION_233_236_oPCAN_RADAR_10f94d60_Tx: ComSignalType=UINT8
            DET_MTD_236_oRDR_DETECTION_233_236_oPCAN_RADAR_7419369e_Tx: ComSignalType=UINT8
            DET_PROB_1STAZHYPO_233_oRDR_DETECTION_233_236_oPCAN_RADAR_4a8d5251_Tx: ComSignalType=BOOLEAN
            DET_PROB_1STAZHYPO_234_oRDR_DETECTION_233_236_oPCAN_RADAR_163d7138_Tx: ComSignalType=BOOLEAN
            DET_PROB_1STAZHYPO_235_oRDR_DETECTION_233_236_oPCAN_RADAR_834da5ad_Tx: ComSignalType=BOOLEAN
            DET_PROB_1STAZHYPO_236_oRDR_DETECTION_233_236_oPCAN_RADAR_e7adde53_Tx: ComSignalType=BOOLEAN
            DET_RANGE_233_oRDR_DETECTION_233_236_oPCAN_RADAR_4122b127_Tx: ComSignalType=UINT16
            DET_RANGE_234_oRDR_DETECTION_233_236_oPCAN_RADAR_1d92924e_Tx: ComSignalType=UINT16
            DET_RANGE_235_oRDR_DETECTION_233_236_oPCAN_RADAR_88e246db_Tx: ComSignalType=UINT16
            DET_RANGE_236_oRDR_DETECTION_233_236_oPCAN_RADAR_ec023d25_Tx: ComSignalType=UINT16
            DET_RANGE_ERR_233_oRDR_DETECTION_233_236_oPCAN_RADAR_e6ca0b4e_Tx: ComSignalType=UINT8
            DET_RANGE_ERR_234_oRDR_DETECTION_233_236_oPCAN_RADAR_ba7a2827_Tx: ComSignalType=UINT8
            DET_RANGE_ERR_235_oRDR_DETECTION_233_236_oPCAN_RADAR_2f0afcb2_Tx: ComSignalType=UINT8
            DET_RANGE_ERR_236_oRDR_DETECTION_233_236_oPCAN_RADAR_4bea874c_Tx: ComSignalType=UINT8
            DET_RANGE_VELOCITY_233_oRDR_DETECTION_233_236_oPCAN_RADAR_34847302_Tx: ComSignalType=UINT16
            DET_RANGE_VELOCITY_234_oRDR_DETECTION_233_236_oPCAN_RADAR_6834506b_Tx: ComSignalType=UINT16
            DET_RANGE_VELOCITY_235_oRDR_DETECTION_233_236_oPCAN_RADAR_fd4484fe_Tx: ComSignalType=UINT16
            DET_RANGE_VELOCITY_236_oRDR_DETECTION_233_236_oPCAN_RADAR_99a4ff00_Tx: ComSignalType=UINT16
            DET_RANGE_VELOCITY_ERR_233_oRDR_DETECTION_233_236_oPCAN_RADAR_3b3f88b0_Tx: ComSignalType=UINT8
            DET_RANGE_VELOCITY_ERR_234_oRDR_DETECTION_233_236_oPCAN_RADAR_678fabd9_Tx: ComSignalType=UINT8
            DET_RANGE_VELOCITY_ERR_235_oRDR_DETECTION_233_236_oPCAN_RADAR_f2ff7f4c_Tx: ComSignalType=UINT8
            DET_RANGE_VELOCITY_ERR_236_oRDR_DETECTION_233_236_oPCAN_RADAR_961f04b2_Tx: ComSignalType=UINT8
            DET_RCS_233_oRDR_DETECTION_233_236_oPCAN_RADAR_b3044458_Tx: ComSignalType=UINT8
            DET_RCS_234_oRDR_DETECTION_233_236_oPCAN_RADAR_efb46731_Tx: ComSignalType=UINT8
            DET_RCS_235_oRDR_DETECTION_233_236_oPCAN_RADAR_7ac4b3a4_Tx: ComSignalType=UINT8
            DET_RCS_236_oRDR_DETECTION_233_236_oPCAN_RADAR_1e24c85a_Tx: ComSignalType=UINT8
            DET_SNR_233_oRDR_DETECTION_233_236_oPCAN_RADAR_6eaa105a_Tx: ComSignalType=UINT8
            DET_SNR_234_oRDR_DETECTION_233_236_oPCAN_RADAR_321a3333_Tx: ComSignalType=UINT8
            DET_SNR_235_oRDR_DETECTION_233_236_oPCAN_RADAR_a76ae7a6_Tx: ComSignalType=UINT8
            DET_SNR_236_oRDR_DETECTION_233_236_oPCAN_RADAR_c38a9c58_Tx: ComSignalType=UINT8
            DET_SUPER_RES_TARGET_233_oRDR_DETECTION_233_236_oPCAN_RADAR_5f33383f_Tx: ComSignalType=BOOLEAN
            DET_SUPER_RES_TARGET_234_oRDR_DETECTION_233_236_oPCAN_RADAR_03831b56_Tx: ComSignalType=BOOLEAN
            DET_SUPER_RES_TARGET_235_oRDR_DETECTION_233_236_oPCAN_RADAR_96f3cfc3_Tx: ComSignalType=BOOLEAN
            DET_SUPER_RES_TARGET_236_oRDR_DETECTION_233_236_oPCAN_RADAR_f213b43d_Tx: ComSignalType=BOOLEAN
        SG_Detections_237_240_oRDR_DETECTION_237_240_oPCAN_RADAR_2e8c87a0_Tx
          83 x ComGroupSignal:
            DET_AZIMUTH_237_oRDR_DETECTION_237_240_oPCAN_RADAR_dfc9c8d9_Tx: ComSignalType=UINT16
            DET_AZIMUTH_238_oRDR_DETECTION_237_240_oPCAN_RADAR_f3d95a9e_Tx: ComSignalType=UINT16
            DET_AZIMUTH_239_oRDR_DETECTION_237_240_oPCAN_RADAR_66a98e0b_Tx: ComSignalType=UINT16
            DET_AZIMUTH_240_oRDR_DETECTION_237_240_oPCAN_RADAR_b74b826f_Tx: ComSignalType=UINT16
            DET_AZIMUTH_ERR_237_oRDR_DETECTION_237_240_oPCAN_RADAR_7b7c5d2c_Tx: ComSignalType=UINT8
            DET_AZIMUTH_ERR_238_oRDR_DETECTION_237_240_oPCAN_RADAR_576ccf6b_Tx: ComSignalType=UINT8
            DET_AZIMUTH_ERR_239_oRDR_DETECTION_237_240_oPCAN_RADAR_c21c1bfe_Tx: ComSignalType=UINT8
            DET_AZIMUTH_ERR_240_oRDR_DETECTION_237_240_oPCAN_RADAR_13fe179a_Tx: ComSignalType=UINT8
            DET_BELOW_RAIN_THOLD_237_oRDR_DETECTION_237_240_oPCAN_RADAR_0ac85b19_Tx: ComSignalType=UINT8
            DET_BELOW_RAIN_THOLD_238_oRDR_DETECTION_237_240_oPCAN_RADAR_26d8c95e_Tx: ComSignalType=UINT8
            DET_BELOW_RAIN_THOLD_239_oRDR_DETECTION_237_240_oPCAN_RADAR_b3a81dcb_Tx: ComSignalType=UINT8
            DET_BELOW_RAIN_THOLD_240_oRDR_DETECTION_237_240_oPCAN_RADAR_624a11af_Tx: ComSignalType=UINT8
            DET_BI_STATIC_FLAG_237_oRDR_DETECTION_237_240_oPCAN_RADAR_89e5885c_Tx: ComSignalType=BOOLEAN
            DET_BI_STATIC_FLAG_238_oRDR_DETECTION_237_240_oPCAN_RADAR_a5f51a1b_Tx: ComSignalType=BOOLEAN
            DET_BI_STATIC_FLAG_239_oRDR_DETECTION_237_240_oPCAN_RADAR_3085ce8e_Tx: ComSignalType=BOOLEAN
            DET_BI_STATIC_FLAG_240_oRDR_DETECTION_237_240_oPCAN_RADAR_e167c2ea_Tx: ComSignalType=BOOLEAN
            DET_CONFD_AZIMUTH_237_oRDR_DETECTION_237_240_oPCAN_RADAR_dd2fc213_Tx: ComSignalType=UINT8
            DET_CONFD_AZIMUTH_238_oRDR_DETECTION_237_240_oPCAN_RADAR_f13f5054_Tx: ComSignalType=UINT8
            DET_CONFD_AZIMUTH_239_oRDR_DETECTION_237_240_oPCAN_RADAR_644f84c1_Tx: ComSignalType=UINT8
            DET_CONFD_AZIMUTH_240_oRDR_DETECTION_237_240_oPCAN_RADAR_b5ad88a5_Tx: ComSignalType=UINT8
            DET_CONFD_ELEVATION_237_oRDR_DETECTION_237_240_oPCAN_RADAR_dfbac3e9_Tx: ComSignalType=UINT8
            DET_CONFD_ELEVATION_238_oRDR_DETECTION_237_240_oPCAN_RADAR_f3aa51ae_Tx: ComSignalType=UINT8
            DET_CONFD_ELEVATION_239_oRDR_DETECTION_237_240_oPCAN_RADAR_66da853b_Tx: ComSignalType=UINT8
            DET_CONFD_ELEVATION_240_oRDR_DETECTION_237_240_oPCAN_RADAR_b738895f_Tx: ComSignalType=UINT8
            DET_ELEVATION_237_oRDR_DETECTION_237_240_oPCAN_RADAR_0e7a17d5_Tx: ComSignalType=UINT8
            DET_ELEVATION_238_oRDR_DETECTION_237_240_oPCAN_RADAR_226a8592_Tx: ComSignalType=UINT8
            DET_ELEVATION_239_oRDR_DETECTION_237_240_oPCAN_RADAR_b71a5107_Tx: ComSignalType=UINT8
            DET_ELEVATION_240_oRDR_DETECTION_237_240_oPCAN_RADAR_66f85d63_Tx: ComSignalType=UINT8
            DET_ELEVATION_ERR_237_oRDR_DETECTION_237_240_oPCAN_RADAR_89438fa0_Tx: ComSignalType=UINT8
            DET_ELEVATION_ERR_238_oRDR_DETECTION_237_240_oPCAN_RADAR_a5531de7_Tx: ComSignalType=UINT8
            DET_ELEVATION_ERR_239_oRDR_DETECTION_237_240_oPCAN_RADAR_3023c972_Tx: ComSignalType=UINT8
            DET_ELEVATION_ERR_240_oRDR_DETECTION_237_240_oPCAN_RADAR_e1c1c516_Tx: ComSignalType=UINT8
            DET_EXISTENCE_PROB_237_oRDR_DETECTION_237_240_oPCAN_RADAR_5bdcfac0_Tx: ComSignalType=UINT8
            DET_EXISTENCE_PROB_238_oRDR_DETECTION_237_240_oPCAN_RADAR_77cc6887_Tx: ComSignalType=UINT8
            DET_EXISTENCE_PROB_239_oRDR_DETECTION_237_240_oPCAN_RADAR_e2bcbc12_Tx: ComSignalType=UINT8
            DET_EXISTENCE_PROB_240_oRDR_DETECTION_237_240_oPCAN_RADAR_335eb076_Tx: ComSignalType=UINT8
            DET_HVC_FLAG_237_oRDR_DETECTION_237_240_oPCAN_RADAR_baa8b9bf_Tx: ComSignalType=BOOLEAN
            DET_HVC_FLAG_238_oRDR_DETECTION_237_240_oPCAN_RADAR_96b82bf8_Tx: ComSignalType=BOOLEAN
            DET_HVC_FLAG_239_oRDR_DETECTION_237_240_oPCAN_RADAR_03c8ff6d_Tx: ComSignalType=BOOLEAN
            DET_HVC_FLAG_240_oRDR_DETECTION_237_240_oPCAN_RADAR_d22af309_Tx: ComSignalType=BOOLEAN
            DET_IDM_237_oRDR_DETECTION_237_240_oPCAN_RADAR_31fa8202_Tx: ComSignalType=UINT8
            DET_IDM_238_oRDR_DETECTION_237_240_oPCAN_RADAR_1dea1045_Tx: ComSignalType=UINT8
            DET_IDM_239_oRDR_DETECTION_237_240_oPCAN_RADAR_889ac4d0_Tx: ComSignalType=UINT8
            DET_IDM_240_oRDR_DETECTION_237_240_oPCAN_RADAR_5978c8b4_Tx: ComSignalType=UINT8
            DET_MH_CRC16_237_240_oRDR_DETECTION_237_240_oPCAN_RADAR_aa0455ab_Tx: ComSignalType=UINT16
            DET_MH_CYCLE_COUNTER_237_240_oRDR_DETECTION_237_240_oPCAN_RADAR_2e71f49c_Tx: ComSignalType=UINT8
            DET_MH_SCAN_INDEX_4LSB_237_240_oRDR_DETECTION_237_240_oPCAN_RADAR_e25bd110_Tx: ComSignalType=UINT8
            DET_MTD_237_oRDR_DETECTION_237_240_oPCAN_RADAR_5749b0d9_Tx: ComSignalType=UINT8
            DET_MTD_238_oRDR_DETECTION_237_240_oPCAN_RADAR_7b59229e_Tx: ComSignalType=UINT8
            DET_MTD_239_oRDR_DETECTION_237_240_oPCAN_RADAR_ee29f60b_Tx: ComSignalType=UINT8
            DET_MTD_240_oRDR_DETECTION_237_240_oPCAN_RADAR_3fcbfa6f_Tx: ComSignalType=UINT8
            DET_PROB_1STAZHYPO_237_oRDR_DETECTION_237_240_oPCAN_RADAR_c4fd5814_Tx: ComSignalType=BOOLEAN
            DET_PROB_1STAZHYPO_238_oRDR_DETECTION_237_240_oPCAN_RADAR_e8edca53_Tx: ComSignalType=BOOLEAN
            DET_PROB_1STAZHYPO_239_oRDR_DETECTION_237_240_oPCAN_RADAR_7d9d1ec6_Tx: ComSignalType=BOOLEAN
            DET_PROB_1STAZHYPO_240_oRDR_DETECTION_237_240_oPCAN_RADAR_ac7f12a2_Tx: ComSignalType=BOOLEAN
            DET_RANGE_237_oRDR_DETECTION_237_240_oPCAN_RADAR_cf52bb62_Tx: ComSignalType=UINT16
            DET_RANGE_238_oRDR_DETECTION_237_240_oPCAN_RADAR_e3422925_Tx: ComSignalType=UINT16
            DET_RANGE_239_oRDR_DETECTION_237_240_oPCAN_RADAR_7632fdb0_Tx: ComSignalType=UINT16
            DET_RANGE_240_oRDR_DETECTION_237_240_oPCAN_RADAR_a7d0f1d4_Tx: ComSignalType=UINT16
            DET_RANGE_ERR_237_oRDR_DETECTION_237_240_oPCAN_RADAR_68ba010b_Tx: ComSignalType=UINT8
            DET_RANGE_ERR_238_oRDR_DETECTION_237_240_oPCAN_RADAR_44aa934c_Tx: ComSignalType=UINT8
            DET_RANGE_ERR_239_oRDR_DETECTION_237_240_oPCAN_RADAR_d1da47d9_Tx: ComSignalType=UINT8
            DET_RANGE_ERR_240_oRDR_DETECTION_237_240_oPCAN_RADAR_00384bbd_Tx: ComSignalType=UINT8
            DET_RANGE_VELOCITY_237_oRDR_DETECTION_237_240_oPCAN_RADAR_baf47947_Tx: ComSignalType=UINT16
            DET_RANGE_VELOCITY_238_oRDR_DETECTION_237_240_oPCAN_RADAR_96e4eb00_Tx: ComSignalType=UINT16
            DET_RANGE_VELOCITY_239_oRDR_DETECTION_237_240_oPCAN_RADAR_03943f95_Tx: ComSignalType=UINT16
            DET_RANGE_VELOCITY_240_oRDR_DETECTION_237_240_oPCAN_RADAR_d27633f1_Tx: ComSignalType=UINT16
            DET_RANGE_VELOCITY_ERR_237_oRDR_DETECTION_237_240_oPCAN_RADAR_b54f82f5_Tx: ComSignalType=UINT8
            DET_RANGE_VELOCITY_ERR_238_oRDR_DETECTION_237_240_oPCAN_RADAR_995f10b2_Tx: ComSignalType=UINT8
            DET_RANGE_VELOCITY_ERR_239_oRDR_DETECTION_237_240_oPCAN_RADAR_0c2fc427_Tx: ComSignalType=UINT8
            DET_RANGE_VELOCITY_ERR_240_oRDR_DETECTION_237_240_oPCAN_RADAR_ddcdc843_Tx: ComSignalType=UINT8
            DET_RCS_237_oRDR_DETECTION_237_240_oPCAN_RADAR_3d744e1d_Tx: ComSignalType=UINT8
            DET_RCS_238_oRDR_DETECTION_237_240_oPCAN_RADAR_1164dc5a_Tx: ComSignalType=UINT8
            DET_RCS_239_oRDR_DETECTION_237_240_oPCAN_RADAR_841408cf_Tx: ComSignalType=UINT8
            DET_RCS_240_oRDR_DETECTION_237_240_oPCAN_RADAR_55f604ab_Tx: ComSignalType=UINT8
            DET_SNR_237_oRDR_DETECTION_237_240_oPCAN_RADAR_e0da1a1f_Tx: ComSignalType=UINT8
            DET_SNR_238_oRDR_DETECTION_237_240_oPCAN_RADAR_ccca8858_Tx: ComSignalType=UINT8
            DET_SNR_239_oRDR_DETECTION_237_240_oPCAN_RADAR_59ba5ccd_Tx: ComSignalType=UINT8
            DET_SNR_240_oRDR_DETECTION_237_240_oPCAN_RADAR_885850a9_Tx: ComSignalType=UINT8
            DET_SUPER_RES_TARGET_237_oRDR_DETECTION_237_240_oPCAN_RADAR_d143327a_Tx: ComSignalType=BOOLEAN
            DET_SUPER_RES_TARGET_238_oRDR_DETECTION_237_240_oPCAN_RADAR_fd53a03d_Tx: ComSignalType=BOOLEAN
            DET_SUPER_RES_TARGET_239_oRDR_DETECTION_237_240_oPCAN_RADAR_682374a8_Tx: ComSignalType=BOOLEAN
            DET_SUPER_RES_TARGET_240_oRDR_DETECTION_237_240_oPCAN_RADAR_b9c178cc_Tx: ComSignalType=BOOLEAN
        SG_Detections_241_244_oRDR_DETECTION_241_244_oPCAN_RADAR_30f39079_Tx
          83 x ComGroupSignal:
            DET_AZIMUTH_241_oRDR_DETECTION_241_244_oPCAN_RADAR_a4988100_Tx: ComSignalType=UINT16
            DET_AZIMUTH_242_oRDR_DETECTION_241_244_oPCAN_RADAR_c078fafe_Tx: ComSignalType=UINT16
            DET_AZIMUTH_243_oRDR_DETECTION_241_244_oPCAN_RADAR_55082e6b_Tx: ComSignalType=UINT16
            DET_AZIMUTH_244_oRDR_DETECTION_241_244_oPCAN_RADAR_09b80d02_Tx: ComSignalType=UINT16
            DET_AZIMUTH_ERR_241_oRDR_DETECTION_241_244_oPCAN_RADAR_002d14f5_Tx: ComSignalType=UINT8
            DET_AZIMUTH_ERR_242_oRDR_DETECTION_241_244_oPCAN_RADAR_64cd6f0b_Tx: ComSignalType=UINT8
            DET_AZIMUTH_ERR_243_oRDR_DETECTION_241_244_oPCAN_RADAR_f1bdbb9e_Tx: ComSignalType=UINT8
            DET_AZIMUTH_ERR_244_oRDR_DETECTION_241_244_oPCAN_RADAR_ad0d98f7_Tx: ComSignalType=UINT8
            DET_BELOW_RAIN_THOLD_241_oRDR_DETECTION_241_244_oPCAN_RADAR_719912c0_Tx: ComSignalType=UINT8
            DET_BELOW_RAIN_THOLD_242_oRDR_DETECTION_241_244_oPCAN_RADAR_1579693e_Tx: ComSignalType=UINT8
            DET_BELOW_RAIN_THOLD_243_oRDR_DETECTION_241_244_oPCAN_RADAR_8009bdab_Tx: ComSignalType=UINT8
            DET_BELOW_RAIN_THOLD_244_oRDR_DETECTION_241_244_oPCAN_RADAR_dcb99ec2_Tx: ComSignalType=UINT8
            DET_BI_STATIC_FLAG_241_oRDR_DETECTION_241_244_oPCAN_RADAR_f2b4c185_Tx: ComSignalType=BOOLEAN
            DET_BI_STATIC_FLAG_242_oRDR_DETECTION_241_244_oPCAN_RADAR_9654ba7b_Tx: ComSignalType=BOOLEAN
            DET_BI_STATIC_FLAG_243_oRDR_DETECTION_241_244_oPCAN_RADAR_03246eee_Tx: ComSignalType=BOOLEAN
            DET_BI_STATIC_FLAG_244_oRDR_DETECTION_241_244_oPCAN_RADAR_5f944d87_Tx: ComSignalType=BOOLEAN
            DET_CONFD_AZIMUTH_241_oRDR_DETECTION_241_244_oPCAN_RADAR_a67e8bca_Tx: ComSignalType=UINT8
            DET_CONFD_AZIMUTH_242_oRDR_DETECTION_241_244_oPCAN_RADAR_c29ef034_Tx: ComSignalType=UINT8
            DET_CONFD_AZIMUTH_243_oRDR_DETECTION_241_244_oPCAN_RADAR_57ee24a1_Tx: ComSignalType=UINT8
            DET_CONFD_AZIMUTH_244_oRDR_DETECTION_241_244_oPCAN_RADAR_0b5e07c8_Tx: ComSignalType=UINT8
            DET_CONFD_ELEVATION_241_oRDR_DETECTION_241_244_oPCAN_RADAR_a4eb8a30_Tx: ComSignalType=UINT8
            DET_CONFD_ELEVATION_242_oRDR_DETECTION_241_244_oPCAN_RADAR_c00bf1ce_Tx: ComSignalType=UINT8
            DET_CONFD_ELEVATION_243_oRDR_DETECTION_241_244_oPCAN_RADAR_557b255b_Tx: ComSignalType=UINT8
            DET_CONFD_ELEVATION_244_oRDR_DETECTION_241_244_oPCAN_RADAR_09cb0632_Tx: ComSignalType=UINT8
            DET_ELEVATION_241_oRDR_DETECTION_241_244_oPCAN_RADAR_752b5e0c_Tx: ComSignalType=UINT8
            DET_ELEVATION_242_oRDR_DETECTION_241_244_oPCAN_RADAR_11cb25f2_Tx: ComSignalType=UINT8
            DET_ELEVATION_243_oRDR_DETECTION_241_244_oPCAN_RADAR_84bbf167_Tx: ComSignalType=UINT8
            DET_ELEVATION_244_oRDR_DETECTION_241_244_oPCAN_RADAR_d80bd20e_Tx: ComSignalType=UINT8
            DET_ELEVATION_ERR_241_oRDR_DETECTION_241_244_oPCAN_RADAR_f212c679_Tx: ComSignalType=UINT8
            DET_ELEVATION_ERR_242_oRDR_DETECTION_241_244_oPCAN_RADAR_96f2bd87_Tx: ComSignalType=UINT8
            DET_ELEVATION_ERR_243_oRDR_DETECTION_241_244_oPCAN_RADAR_03826912_Tx: ComSignalType=UINT8
            DET_ELEVATION_ERR_244_oRDR_DETECTION_241_244_oPCAN_RADAR_5f324a7b_Tx: ComSignalType=UINT8
            DET_EXISTENCE_PROB_241_oRDR_DETECTION_241_244_oPCAN_RADAR_208db319_Tx: ComSignalType=UINT8
            DET_EXISTENCE_PROB_242_oRDR_DETECTION_241_244_oPCAN_RADAR_446dc8e7_Tx: ComSignalType=UINT8
            DET_EXISTENCE_PROB_243_oRDR_DETECTION_241_244_oPCAN_RADAR_d11d1c72_Tx: ComSignalType=UINT8
            DET_EXISTENCE_PROB_244_oRDR_DETECTION_241_244_oPCAN_RADAR_8dad3f1b_Tx: ComSignalType=UINT8
            DET_HVC_FLAG_241_oRDR_DETECTION_241_244_oPCAN_RADAR_c1f9f066_Tx: ComSignalType=BOOLEAN
            DET_HVC_FLAG_242_oRDR_DETECTION_241_244_oPCAN_RADAR_a5198b98_Tx: ComSignalType=BOOLEAN
            DET_HVC_FLAG_243_oRDR_DETECTION_241_244_oPCAN_RADAR_30695f0d_Tx: ComSignalType=BOOLEAN
            DET_HVC_FLAG_244_oRDR_DETECTION_241_244_oPCAN_RADAR_6cd97c64_Tx: ComSignalType=BOOLEAN
            DET_IDM_241_oRDR_DETECTION_241_244_oPCAN_RADAR_4aabcbdb_Tx: ComSignalType=UINT8
            DET_IDM_242_oRDR_DETECTION_241_244_oPCAN_RADAR_2e4bb025_Tx: ComSignalType=UINT8
            DET_IDM_243_oRDR_DETECTION_241_244_oPCAN_RADAR_bb3b64b0_Tx: ComSignalType=UINT8
            DET_IDM_244_oRDR_DETECTION_241_244_oPCAN_RADAR_e78b47d9_Tx: ComSignalType=UINT8
            DET_MH_CRC16_241_244_oRDR_DETECTION_241_244_oPCAN_RADAR_b47b4272_Tx: ComSignalType=UINT16
            DET_MH_CYCLE_COUNTER_241_244_oRDR_DETECTION_241_244_oPCAN_RADAR_300ee345_Tx: ComSignalType=UINT8
            DET_MH_SCAN_INDEX_4LSB_241_244_oRDR_DETECTION_241_244_oPCAN_RADAR_fc24c6c9_Tx: ComSignalType=UINT8
            DET_MTD_241_oRDR_DETECTION_241_244_oPCAN_RADAR_2c18f900_Tx: ComSignalType=UINT8
            DET_MTD_242_oRDR_DETECTION_241_244_oPCAN_RADAR_48f882fe_Tx: ComSignalType=UINT8
            DET_MTD_243_oRDR_DETECTION_241_244_oPCAN_RADAR_dd88566b_Tx: ComSignalType=UINT8
            DET_MTD_244_oRDR_DETECTION_241_244_oPCAN_RADAR_81387502_Tx: ComSignalType=UINT8
            DET_PROB_1STAZHYPO_241_oRDR_DETECTION_241_244_oPCAN_RADAR_bfac11cd_Tx: ComSignalType=BOOLEAN
            DET_PROB_1STAZHYPO_242_oRDR_DETECTION_241_244_oPCAN_RADAR_db4c6a33_Tx: ComSignalType=BOOLEAN
            DET_PROB_1STAZHYPO_243_oRDR_DETECTION_241_244_oPCAN_RADAR_4e3cbea6_Tx: ComSignalType=BOOLEAN
            DET_PROB_1STAZHYPO_244_oRDR_DETECTION_241_244_oPCAN_RADAR_128c9dcf_Tx: ComSignalType=BOOLEAN
            DET_RANGE_241_oRDR_DETECTION_241_244_oPCAN_RADAR_b403f2bb_Tx: ComSignalType=UINT16
            DET_RANGE_242_oRDR_DETECTION_241_244_oPCAN_RADAR_d0e38945_Tx: ComSignalType=UINT16
            DET_RANGE_243_oRDR_DETECTION_241_244_oPCAN_RADAR_45935dd0_Tx: ComSignalType=UINT16
            DET_RANGE_244_oRDR_DETECTION_241_244_oPCAN_RADAR_19237eb9_Tx: ComSignalType=UINT16
            DET_RANGE_ERR_241_oRDR_DETECTION_241_244_oPCAN_RADAR_13eb48d2_Tx: ComSignalType=UINT8
            DET_RANGE_ERR_242_oRDR_DETECTION_241_244_oPCAN_RADAR_770b332c_Tx: ComSignalType=UINT8
            DET_RANGE_ERR_243_oRDR_DETECTION_241_244_oPCAN_RADAR_e27be7b9_Tx: ComSignalType=UINT8
            DET_RANGE_ERR_244_oRDR_DETECTION_241_244_oPCAN_RADAR_becbc4d0_Tx: ComSignalType=UINT8
            DET_RANGE_VELOCITY_241_oRDR_DETECTION_241_244_oPCAN_RADAR_c1a5309e_Tx: ComSignalType=UINT16
            DET_RANGE_VELOCITY_242_oRDR_DETECTION_241_244_oPCAN_RADAR_a5454b60_Tx: ComSignalType=UINT16
            DET_RANGE_VELOCITY_243_oRDR_DETECTION_241_244_oPCAN_RADAR_30359ff5_Tx: ComSignalType=UINT16
            DET_RANGE_VELOCITY_244_oRDR_DETECTION_241_244_oPCAN_RADAR_6c85bc9c_Tx: ComSignalType=UINT16
            DET_RANGE_VELOCITY_ERR_241_oRDR_DETECTION_241_244_oPCAN_RADAR_ce1ecb2c_Tx: ComSignalType=UINT8
            DET_RANGE_VELOCITY_ERR_242_oRDR_DETECTION_241_244_oPCAN_RADAR_aafeb0d2_Tx: ComSignalType=UINT8
            DET_RANGE_VELOCITY_ERR_243_oRDR_DETECTION_241_244_oPCAN_RADAR_3f8e6447_Tx: ComSignalType=UINT8
            DET_RANGE_VELOCITY_ERR_244_oRDR_DETECTION_241_244_oPCAN_RADAR_633e472e_Tx: ComSignalType=UINT8
            DET_RCS_241_oRDR_DETECTION_241_244_oPCAN_RADAR_462507c4_Tx: ComSignalType=UINT8
            DET_RCS_242_oRDR_DETECTION_241_244_oPCAN_RADAR_22c57c3a_Tx: ComSignalType=UINT8
            DET_RCS_243_oRDR_DETECTION_241_244_oPCAN_RADAR_b7b5a8af_Tx: ComSignalType=UINT8
            DET_RCS_244_oRDR_DETECTION_241_244_oPCAN_RADAR_eb058bc6_Tx: ComSignalType=UINT8
            DET_SNR_241_oRDR_DETECTION_241_244_oPCAN_RADAR_9b8b53c6_Tx: ComSignalType=UINT8
            DET_SNR_242_oRDR_DETECTION_241_244_oPCAN_RADAR_ff6b2838_Tx: ComSignalType=UINT8
            DET_SNR_243_oRDR_DETECTION_241_244_oPCAN_RADAR_6a1bfcad_Tx: ComSignalType=UINT8
            DET_SNR_244_oRDR_DETECTION_241_244_oPCAN_RADAR_36abdfc4_Tx: ComSignalType=UINT8
            DET_SUPER_RES_TARGET_241_oRDR_DETECTION_241_244_oPCAN_RADAR_aa127ba3_Tx: ComSignalType=BOOLEAN
            DET_SUPER_RES_TARGET_242_oRDR_DETECTION_241_244_oPCAN_RADAR_cef2005d_Tx: ComSignalType=BOOLEAN
            DET_SUPER_RES_TARGET_243_oRDR_DETECTION_241_244_oPCAN_RADAR_5b82d4c8_Tx: ComSignalType=BOOLEAN
            DET_SUPER_RES_TARGET_244_oRDR_DETECTION_241_244_oPCAN_RADAR_0732f7a1_Tx: ComSignalType=BOOLEAN
        SG_Detections_245_248_oRDR_DETECTION_245_248_oPCAN_RADAR_4130a42b_Tx
          83 x ComGroupSignal:
            DET_AZIMUTH_245_oRDR_DETECTION_245_248_oPCAN_RADAR_757a47a3_Tx: ComSignalType=UINT16
            DET_AZIMUTH_246_oRDR_DETECTION_245_248_oPCAN_RADAR_119a3c5d_Tx: ComSignalType=UINT16
            DET_AZIMUTH_247_oRDR_DETECTION_245_248_oPCAN_RADAR_84eae8c8_Tx: ComSignalType=UINT16
            DET_AZIMUTH_248_oRDR_DETECTION_245_248_oPCAN_RADAR_a8fa7a8f_Tx: ComSignalType=UINT16
            DET_AZIMUTH_ERR_245_oRDR_DETECTION_245_248_oPCAN_RADAR_d1cfd256_Tx: ComSignalType=UINT8
            DET_AZIMUTH_ERR_246_oRDR_DETECTION_245_248_oPCAN_RADAR_b52fa9a8_Tx: ComSignalType=UINT8
            DET_AZIMUTH_ERR_247_oRDR_DETECTION_245_248_oPCAN_RADAR_205f7d3d_Tx: ComSignalType=UINT8
            DET_AZIMUTH_ERR_248_oRDR_DETECTION_245_248_oPCAN_RADAR_0c4fef7a_Tx: ComSignalType=UINT8
            DET_BELOW_RAIN_THOLD_245_oRDR_DETECTION_245_248_oPCAN_RADAR_a07bd463_Tx: ComSignalType=UINT8
            DET_BELOW_RAIN_THOLD_246_oRDR_DETECTION_245_248_oPCAN_RADAR_c49baf9d_Tx: ComSignalType=UINT8
            DET_BELOW_RAIN_THOLD_247_oRDR_DETECTION_245_248_oPCAN_RADAR_51eb7b08_Tx: ComSignalType=UINT8
            DET_BELOW_RAIN_THOLD_248_oRDR_DETECTION_245_248_oPCAN_RADAR_7dfbe94f_Tx: ComSignalType=UINT8
            DET_BI_STATIC_FLAG_245_oRDR_DETECTION_245_248_oPCAN_RADAR_23560726_Tx: ComSignalType=BOOLEAN
            DET_BI_STATIC_FLAG_246_oRDR_DETECTION_245_248_oPCAN_RADAR_47b67cd8_Tx: ComSignalType=BOOLEAN
            DET_BI_STATIC_FLAG_247_oRDR_DETECTION_245_248_oPCAN_RADAR_d2c6a84d_Tx: ComSignalType=BOOLEAN
            DET_BI_STATIC_FLAG_248_oRDR_DETECTION_245_248_oPCAN_RADAR_fed63a0a_Tx: ComSignalType=BOOLEAN
            DET_CONFD_AZIMUTH_245_oRDR_DETECTION_245_248_oPCAN_RADAR_779c4d69_Tx: ComSignalType=UINT8
            DET_CONFD_AZIMUTH_246_oRDR_DETECTION_245_248_oPCAN_RADAR_137c3697_Tx: ComSignalType=UINT8
            DET_CONFD_AZIMUTH_247_oRDR_DETECTION_245_248_oPCAN_RADAR_860ce202_Tx: ComSignalType=UINT8
            DET_CONFD_AZIMUTH_248_oRDR_DETECTION_245_248_oPCAN_RADAR_aa1c7045_Tx: ComSignalType=UINT8
            DET_CONFD_ELEVATION_245_oRDR_DETECTION_245_248_oPCAN_RADAR_75094c93_Tx: ComSignalType=UINT8
            DET_CONFD_ELEVATION_246_oRDR_DETECTION_245_248_oPCAN_RADAR_11e9376d_Tx: ComSignalType=UINT8
            DET_CONFD_ELEVATION_247_oRDR_DETECTION_245_248_oPCAN_RADAR_8499e3f8_Tx: ComSignalType=UINT8
            DET_CONFD_ELEVATION_248_oRDR_DETECTION_245_248_oPCAN_RADAR_a88971bf_Tx: ComSignalType=UINT8
            DET_ELEVATION_245_oRDR_DETECTION_245_248_oPCAN_RADAR_a4c998af_Tx: ComSignalType=UINT8
            DET_ELEVATION_246_oRDR_DETECTION_245_248_oPCAN_RADAR_c029e351_Tx: ComSignalType=UINT8
            DET_ELEVATION_247_oRDR_DETECTION_245_248_oPCAN_RADAR_555937c4_Tx: ComSignalType=UINT8
            DET_ELEVATION_248_oRDR_DETECTION_245_248_oPCAN_RADAR_7949a583_Tx: ComSignalType=UINT8
            DET_ELEVATION_ERR_245_oRDR_DETECTION_245_248_oPCAN_RADAR_23f000da_Tx: ComSignalType=UINT8
            DET_ELEVATION_ERR_246_oRDR_DETECTION_245_248_oPCAN_RADAR_47107b24_Tx: ComSignalType=UINT8
            DET_ELEVATION_ERR_247_oRDR_DETECTION_245_248_oPCAN_RADAR_d260afb1_Tx: ComSignalType=UINT8
            DET_ELEVATION_ERR_248_oRDR_DETECTION_245_248_oPCAN_RADAR_fe703df6_Tx: ComSignalType=UINT8
            DET_EXISTENCE_PROB_245_oRDR_DETECTION_245_248_oPCAN_RADAR_f16f75ba_Tx: ComSignalType=UINT8
            DET_EXISTENCE_PROB_246_oRDR_DETECTION_245_248_oPCAN_RADAR_958f0e44_Tx: ComSignalType=UINT8
            DET_EXISTENCE_PROB_247_oRDR_DETECTION_245_248_oPCAN_RADAR_00ffdad1_Tx: ComSignalType=UINT8
            DET_EXISTENCE_PROB_248_oRDR_DETECTION_245_248_oPCAN_RADAR_2cef4896_Tx: ComSignalType=UINT8
            DET_HVC_FLAG_245_oRDR_DETECTION_245_248_oPCAN_RADAR_101b36c5_Tx: ComSignalType=BOOLEAN
            DET_HVC_FLAG_246_oRDR_DETECTION_245_248_oPCAN_RADAR_74fb4d3b_Tx: ComSignalType=BOOLEAN
            DET_HVC_FLAG_247_oRDR_DETECTION_245_248_oPCAN_RADAR_e18b99ae_Tx: ComSignalType=BOOLEAN
            DET_HVC_FLAG_248_oRDR_DETECTION_245_248_oPCAN_RADAR_cd9b0be9_Tx: ComSignalType=BOOLEAN
            DET_IDM_245_oRDR_DETECTION_245_248_oPCAN_RADAR_9b490d78_Tx: ComSignalType=UINT8
            DET_IDM_246_oRDR_DETECTION_245_248_oPCAN_RADAR_ffa97686_Tx: ComSignalType=UINT8
            DET_IDM_247_oRDR_DETECTION_245_248_oPCAN_RADAR_6ad9a213_Tx: ComSignalType=UINT8
            DET_IDM_248_oRDR_DETECTION_245_248_oPCAN_RADAR_46c93054_Tx: ComSignalType=UINT8
            DET_MH_CRC16_245_248_oRDR_DETECTION_245_248_oPCAN_RADAR_c5b87620_Tx: ComSignalType=UINT16
            DET_MH_CYCLE_COUNTER_245_248_oRDR_DETECTION_245_248_oPCAN_RADAR_41cdd717_Tx: ComSignalType=UINT8
            DET_MH_SCAN_INDEX_4LSB_245_248_oRDR_DETECTION_245_248_oPCAN_RADAR_8de7f29b_Tx: ComSignalType=UINT8
            DET_MTD_245_oRDR_DETECTION_245_248_oPCAN_RADAR_fdfa3fa3_Tx: ComSignalType=UINT8
            DET_MTD_246_oRDR_DETECTION_245_248_oPCAN_RADAR_991a445d_Tx: ComSignalType=UINT8
            DET_MTD_247_oRDR_DETECTION_245_248_oPCAN_RADAR_0c6a90c8_Tx: ComSignalType=UINT8
            DET_MTD_248_oRDR_DETECTION_245_248_oPCAN_RADAR_207a028f_Tx: ComSignalType=UINT8
            DET_PROB_1STAZHYPO_245_oRDR_DETECTION_245_248_oPCAN_RADAR_6e4ed76e_Tx: ComSignalType=BOOLEAN
            DET_PROB_1STAZHYPO_246_oRDR_DETECTION_245_248_oPCAN_RADAR_0aaeac90_Tx: ComSignalType=BOOLEAN
            DET_PROB_1STAZHYPO_247_oRDR_DETECTION_245_248_oPCAN_RADAR_9fde7805_Tx: ComSignalType=BOOLEAN
            DET_PROB_1STAZHYPO_248_oRDR_DETECTION_245_248_oPCAN_RADAR_b3ceea42_Tx: ComSignalType=BOOLEAN
            DET_RANGE_245_oRDR_DETECTION_245_248_oPCAN_RADAR_65e13418_Tx: ComSignalType=UINT16
            DET_RANGE_246_oRDR_DETECTION_245_248_oPCAN_RADAR_01014fe6_Tx: ComSignalType=UINT16
            DET_RANGE_247_oRDR_DETECTION_245_248_oPCAN_RADAR_94719b73_Tx: ComSignalType=UINT16
            DET_RANGE_248_oRDR_DETECTION_245_248_oPCAN_RADAR_b8610934_Tx: ComSignalType=UINT16
            DET_RANGE_ERR_245_oRDR_DETECTION_245_248_oPCAN_RADAR_c2098e71_Tx: ComSignalType=UINT8
            DET_RANGE_ERR_246_oRDR_DETECTION_245_248_oPCAN_RADAR_a6e9f58f_Tx: ComSignalType=UINT8
            DET_RANGE_ERR_247_oRDR_DETECTION_245_248_oPCAN_RADAR_3399211a_Tx: ComSignalType=UINT8
            DET_RANGE_ERR_248_oRDR_DETECTION_245_248_oPCAN_RADAR_1f89b35d_Tx: ComSignalType=UINT8
            DET_RANGE_VELOCITY_245_oRDR_DETECTION_245_248_oPCAN_RADAR_1047f63d_Tx: ComSignalType=UINT16
            DET_RANGE_VELOCITY_246_oRDR_DETECTION_245_248_oPCAN_RADAR_74a78dc3_Tx: ComSignalType=UINT16
            DET_RANGE_VELOCITY_247_oRDR_DETECTION_245_248_oPCAN_RADAR_e1d75956_Tx: ComSignalType=UINT16
            DET_RANGE_VELOCITY_248_oRDR_DETECTION_245_248_oPCAN_RADAR_cdc7cb11_Tx: ComSignalType=UINT16
            DET_RANGE_VELOCITY_ERR_245_oRDR_DETECTION_245_248_oPCAN_RADAR_1ffc0d8f_Tx: ComSignalType=UINT8
            DET_RANGE_VELOCITY_ERR_246_oRDR_DETECTION_245_248_oPCAN_RADAR_7b1c7671_Tx: ComSignalType=UINT8
            DET_RANGE_VELOCITY_ERR_247_oRDR_DETECTION_245_248_oPCAN_RADAR_ee6ca2e4_Tx: ComSignalType=UINT8
            DET_RANGE_VELOCITY_ERR_248_oRDR_DETECTION_245_248_oPCAN_RADAR_c27c30a3_Tx: ComSignalType=UINT8
            DET_RCS_245_oRDR_DETECTION_245_248_oPCAN_RADAR_97c7c167_Tx: ComSignalType=UINT8
            DET_RCS_246_oRDR_DETECTION_245_248_oPCAN_RADAR_f327ba99_Tx: ComSignalType=UINT8
            DET_RCS_247_oRDR_DETECTION_245_248_oPCAN_RADAR_66576e0c_Tx: ComSignalType=UINT8
            DET_RCS_248_oRDR_DETECTION_245_248_oPCAN_RADAR_4a47fc4b_Tx: ComSignalType=UINT8
            DET_SNR_245_oRDR_DETECTION_245_248_oPCAN_RADAR_4a699565_Tx: ComSignalType=UINT8
            DET_SNR_246_oRDR_DETECTION_245_248_oPCAN_RADAR_2e89ee9b_Tx: ComSignalType=UINT8
            DET_SNR_247_oRDR_DETECTION_245_248_oPCAN_RADAR_bbf93a0e_Tx: ComSignalType=UINT8
            DET_SNR_248_oRDR_DETECTION_245_248_oPCAN_RADAR_97e9a849_Tx: ComSignalType=UINT8
            DET_SUPER_RES_TARGET_245_oRDR_DETECTION_245_248_oPCAN_RADAR_7bf0bd00_Tx: ComSignalType=BOOLEAN
            DET_SUPER_RES_TARGET_246_oRDR_DETECTION_245_248_oPCAN_RADAR_1f10c6fe_Tx: ComSignalType=BOOLEAN
            DET_SUPER_RES_TARGET_247_oRDR_DETECTION_245_248_oPCAN_RADAR_8a60126b_Tx: ComSignalType=BOOLEAN
            DET_SUPER_RES_TARGET_248_oRDR_DETECTION_245_248_oPCAN_RADAR_a670802c_Tx: ComSignalType=BOOLEAN
        SG_Detections_249_252_oRDR_DETECTION_249_252_oPCAN_RADAR_d84a8050_Tx
          83 x ComGroupSignal:
            DET_AZIMUTH_249_oRDR_DETECTION_249_252_oPCAN_RADAR_0fc2411b_Tx: ComSignalType=UINT16
            DET_AZIMUTH_250_oRDR_DETECTION_249_252_oPCAN_RADAR_6ae233bf_Tx: ComSignalType=UINT16
            DET_AZIMUTH_251_oRDR_DETECTION_249_252_oPCAN_RADAR_ff92e72a_Tx: ComSignalType=UINT16
            DET_AZIMUTH_252_oRDR_DETECTION_249_252_oPCAN_RADAR_9b729cd4_Tx: ComSignalType=UINT16
            DET_AZIMUTH_ERR_249_oRDR_DETECTION_249_252_oPCAN_RADAR_ab77d4ee_Tx: ComSignalType=UINT8
            DET_AZIMUTH_ERR_250_oRDR_DETECTION_249_252_oPCAN_RADAR_ce57a64a_Tx: ComSignalType=UINT8
            DET_AZIMUTH_ERR_251_oRDR_DETECTION_249_252_oPCAN_RADAR_5b2772df_Tx: ComSignalType=UINT8
            DET_AZIMUTH_ERR_252_oRDR_DETECTION_249_252_oPCAN_RADAR_3fc70921_Tx: ComSignalType=UINT8
            DET_BELOW_RAIN_THOLD_249_oRDR_DETECTION_249_252_oPCAN_RADAR_dac3d2db_Tx: ComSignalType=UINT8
            DET_BELOW_RAIN_THOLD_250_oRDR_DETECTION_249_252_oPCAN_RADAR_bfe3a07f_Tx: ComSignalType=UINT8
            DET_BELOW_RAIN_THOLD_251_oRDR_DETECTION_249_252_oPCAN_RADAR_2a9374ea_Tx: ComSignalType=UINT8
            DET_BELOW_RAIN_THOLD_252_oRDR_DETECTION_249_252_oPCAN_RADAR_4e730f14_Tx: ComSignalType=UINT8
            DET_BI_STATIC_FLAG_249_oRDR_DETECTION_249_252_oPCAN_RADAR_59ee019e_Tx: ComSignalType=BOOLEAN
            DET_BI_STATIC_FLAG_250_oRDR_DETECTION_249_252_oPCAN_RADAR_3cce733a_Tx: ComSignalType=BOOLEAN
            DET_BI_STATIC_FLAG_251_oRDR_DETECTION_249_252_oPCAN_RADAR_a9bea7af_Tx: ComSignalType=BOOLEAN
            DET_BI_STATIC_FLAG_252_oRDR_DETECTION_249_252_oPCAN_RADAR_cd5edc51_Tx: ComSignalType=BOOLEAN
            DET_CONFD_AZIMUTH_249_oRDR_DETECTION_249_252_oPCAN_RADAR_0d244bd1_Tx: ComSignalType=UINT8
            DET_CONFD_AZIMUTH_250_oRDR_DETECTION_249_252_oPCAN_RADAR_68043975_Tx: ComSignalType=UINT8
            DET_CONFD_AZIMUTH_251_oRDR_DETECTION_249_252_oPCAN_RADAR_fd74ede0_Tx: ComSignalType=UINT8
            DET_CONFD_AZIMUTH_252_oRDR_DETECTION_249_252_oPCAN_RADAR_9994961e_Tx: ComSignalType=UINT8
            DET_CONFD_ELEVATION_249_oRDR_DETECTION_249_252_oPCAN_RADAR_0fb14a2b_Tx: ComSignalType=UINT8
            DET_CONFD_ELEVATION_250_oRDR_DETECTION_249_252_oPCAN_RADAR_6a91388f_Tx: ComSignalType=UINT8
            DET_CONFD_ELEVATION_251_oRDR_DETECTION_249_252_oPCAN_RADAR_ffe1ec1a_Tx: ComSignalType=UINT8
            DET_CONFD_ELEVATION_252_oRDR_DETECTION_249_252_oPCAN_RADAR_9b0197e4_Tx: ComSignalType=UINT8
            DET_ELEVATION_249_oRDR_DETECTION_249_252_oPCAN_RADAR_de719e17_Tx: ComSignalType=UINT8
            DET_ELEVATION_250_oRDR_DETECTION_249_252_oPCAN_RADAR_bb51ecb3_Tx: ComSignalType=UINT8
            DET_ELEVATION_251_oRDR_DETECTION_249_252_oPCAN_RADAR_2e213826_Tx: ComSignalType=UINT8
            DET_ELEVATION_252_oRDR_DETECTION_249_252_oPCAN_RADAR_4ac143d8_Tx: ComSignalType=UINT8
            DET_ELEVATION_ERR_249_oRDR_DETECTION_249_252_oPCAN_RADAR_59480662_Tx: ComSignalType=UINT8
            DET_ELEVATION_ERR_250_oRDR_DETECTION_249_252_oPCAN_RADAR_3c6874c6_Tx: ComSignalType=UINT8
            DET_ELEVATION_ERR_251_oRDR_DETECTION_249_252_oPCAN_RADAR_a918a053_Tx: ComSignalType=UINT8
            DET_ELEVATION_ERR_252_oRDR_DETECTION_249_252_oPCAN_RADAR_cdf8dbad_Tx: ComSignalType=UINT8
            DET_EXISTENCE_PROB_249_oRDR_DETECTION_249_252_oPCAN_RADAR_8bd77302_Tx: ComSignalType=UINT8
            DET_EXISTENCE_PROB_250_oRDR_DETECTION_249_252_oPCAN_RADAR_eef701a6_Tx: ComSignalType=UINT8
            DET_EXISTENCE_PROB_251_oRDR_DETECTION_249_252_oPCAN_RADAR_7b87d533_Tx: ComSignalType=UINT8
            DET_EXISTENCE_PROB_252_oRDR_DETECTION_249_252_oPCAN_RADAR_1f67aecd_Tx: ComSignalType=UINT8
            DET_HVC_FLAG_249_oRDR_DETECTION_249_252_oPCAN_RADAR_6aa3307d_Tx: ComSignalType=BOOLEAN
            DET_HVC_FLAG_250_oRDR_DETECTION_249_252_oPCAN_RADAR_0f8342d9_Tx: ComSignalType=BOOLEAN
            DET_HVC_FLAG_251_oRDR_DETECTION_249_252_oPCAN_RADAR_9af3964c_Tx: ComSignalType=BOOLEAN
            DET_HVC_FLAG_252_oRDR_DETECTION_249_252_oPCAN_RADAR_fe13edb2_Tx: ComSignalType=BOOLEAN
            DET_IDM_249_oRDR_DETECTION_249_252_oPCAN_RADAR_e1f10bc0_Tx: ComSignalType=UINT8
            DET_IDM_250_oRDR_DETECTION_249_252_oPCAN_RADAR_84d17964_Tx: ComSignalType=UINT8
            DET_IDM_251_oRDR_DETECTION_249_252_oPCAN_RADAR_11a1adf1_Tx: ComSignalType=UINT8
            DET_IDM_252_oRDR_DETECTION_249_252_oPCAN_RADAR_7541d60f_Tx: ComSignalType=UINT8
            DET_MH_CRC16_249_252_oRDR_DETECTION_249_252_oPCAN_RADAR_5cc2525b_Tx: ComSignalType=UINT16
            DET_MH_CYCLE_COUNTER_249_252_oRDR_DETECTION_249_252_oPCAN_RADAR_d8b7f36c_Tx: ComSignalType=UINT8
            DET_MH_SCAN_INDEX_4LSB_249_252_oRDR_DETECTION_249_252_oPCAN_RADAR_149dd6e0_Tx: ComSignalType=UINT8
            DET_MTD_249_oRDR_DETECTION_249_252_oPCAN_RADAR_8742391b_Tx: ComSignalType=UINT8
            DET_MTD_250_oRDR_DETECTION_249_252_oPCAN_RADAR_e2624bbf_Tx: ComSignalType=UINT8
            DET_MTD_251_oRDR_DETECTION_249_252_oPCAN_RADAR_77129f2a_Tx: ComSignalType=UINT8
            DET_MTD_252_oRDR_DETECTION_249_252_oPCAN_RADAR_13f2e4d4_Tx: ComSignalType=UINT8
            DET_PROB_1STAZHYPO_249_oRDR_DETECTION_249_252_oPCAN_RADAR_14f6d1d6_Tx: ComSignalType=BOOLEAN
            DET_PROB_1STAZHYPO_250_oRDR_DETECTION_249_252_oPCAN_RADAR_71d6a372_Tx: ComSignalType=BOOLEAN
            DET_PROB_1STAZHYPO_251_oRDR_DETECTION_249_252_oPCAN_RADAR_e4a677e7_Tx: ComSignalType=BOOLEAN
            DET_PROB_1STAZHYPO_252_oRDR_DETECTION_249_252_oPCAN_RADAR_80460c19_Tx: ComSignalType=BOOLEAN
            DET_RANGE_249_oRDR_DETECTION_249_252_oPCAN_RADAR_1f5932a0_Tx: ComSignalType=UINT16
            DET_RANGE_250_oRDR_DETECTION_249_252_oPCAN_RADAR_7a794004_Tx: ComSignalType=UINT16
            DET_RANGE_251_oRDR_DETECTION_249_252_oPCAN_RADAR_ef099491_Tx: ComSignalType=UINT16
            DET_RANGE_252_oRDR_DETECTION_249_252_oPCAN_RADAR_8be9ef6f_Tx: ComSignalType=UINT16
            DET_RANGE_ERR_249_oRDR_DETECTION_249_252_oPCAN_RADAR_b8b188c9_Tx: ComSignalType=UINT8
            DET_RANGE_ERR_250_oRDR_DETECTION_249_252_oPCAN_RADAR_dd91fa6d_Tx: ComSignalType=UINT8
            DET_RANGE_ERR_251_oRDR_DETECTION_249_252_oPCAN_RADAR_48e12ef8_Tx: ComSignalType=UINT8
            DET_RANGE_ERR_252_oRDR_DETECTION_249_252_oPCAN_RADAR_2c015506_Tx: ComSignalType=UINT8
            DET_RANGE_VELOCITY_249_oRDR_DETECTION_249_252_oPCAN_RADAR_6afff085_Tx: ComSignalType=UINT16
            DET_RANGE_VELOCITY_250_oRDR_DETECTION_249_252_oPCAN_RADAR_0fdf8221_Tx: ComSignalType=UINT16
            DET_RANGE_VELOCITY_251_oRDR_DETECTION_249_252_oPCAN_RADAR_9aaf56b4_Tx: ComSignalType=UINT16
            DET_RANGE_VELOCITY_252_oRDR_DETECTION_249_252_oPCAN_RADAR_fe4f2d4a_Tx: ComSignalType=UINT16
            DET_RANGE_VELOCITY_ERR_249_oRDR_DETECTION_249_252_oPCAN_RADAR_65440b37_Tx: ComSignalType=UINT8
            DET_RANGE_VELOCITY_ERR_250_oRDR_DETECTION_249_252_oPCAN_RADAR_00647993_Tx: ComSignalType=UINT8
            DET_RANGE_VELOCITY_ERR_251_oRDR_DETECTION_249_252_oPCAN_RADAR_9514ad06_Tx: ComSignalType=UINT8
            DET_RANGE_VELOCITY_ERR_252_oRDR_DETECTION_249_252_oPCAN_RADAR_f1f4d6f8_Tx: ComSignalType=UINT8
            DET_RCS_249_oRDR_DETECTION_249_252_oPCAN_RADAR_ed7fc7df_Tx: ComSignalType=UINT8
            DET_RCS_250_oRDR_DETECTION_249_252_oPCAN_RADAR_885fb57b_Tx: ComSignalType=UINT8
            DET_RCS_251_oRDR_DETECTION_249_252_oPCAN_RADAR_1d2f61ee_Tx: ComSignalType=UINT8
            DET_RCS_252_oRDR_DETECTION_249_252_oPCAN_RADAR_79cf1a10_Tx: ComSignalType=UINT8
            DET_SNR_249_oRDR_DETECTION_249_252_oPCAN_RADAR_30d193dd_Tx: ComSignalType=UINT8
            DET_SNR_250_oRDR_DETECTION_249_252_oPCAN_RADAR_55f1e179_Tx: ComSignalType=UINT8
            DET_SNR_251_oRDR_DETECTION_249_252_oPCAN_RADAR_c08135ec_Tx: ComSignalType=UINT8
            DET_SNR_252_oRDR_DETECTION_249_252_oPCAN_RADAR_a4614e12_Tx: ComSignalType=UINT8
            DET_SUPER_RES_TARGET_249_oRDR_DETECTION_249_252_oPCAN_RADAR_0148bbb8_Tx: ComSignalType=BOOLEAN
            DET_SUPER_RES_TARGET_250_oRDR_DETECTION_249_252_oPCAN_RADAR_6468c91c_Tx: ComSignalType=BOOLEAN
            DET_SUPER_RES_TARGET_251_oRDR_DETECTION_249_252_oPCAN_RADAR_f1181d89_Tx: ComSignalType=BOOLEAN
            DET_SUPER_RES_TARGET_252_oRDR_DETECTION_249_252_oPCAN_RADAR_95f86677_Tx: ComSignalType=BOOLEAN
        SG_Detections_253_256_oRDR_DETECTION_253_256_oPCAN_RADAR_ea41e878_Tx
          83 x ComGroupSignal:
            DET_AZIMUTH_253_oRDR_DETECTION_253_256_oPCAN_RADAR_13c54b6f_Tx: ComSignalType=UINT16
            DET_AZIMUTH_254_oRDR_DETECTION_253_256_oPCAN_RADAR_4f756806_Tx: ComSignalType=UINT16
            DET_AZIMUTH_255_oRDR_DETECTION_253_256_oPCAN_RADAR_da05bc93_Tx: ComSignalType=UINT16
            DET_AZIMUTH_256_oRDR_DETECTION_253_256_oPCAN_RADAR_bee5c76d_Tx: ComSignalType=UINT16
            DET_AZIMUTH_ERR_253_oRDR_DETECTION_253_256_oPCAN_RADAR_b770de9a_Tx: ComSignalType=UINT8
            DET_AZIMUTH_ERR_254_oRDR_DETECTION_253_256_oPCAN_RADAR_ebc0fdf3_Tx: ComSignalType=UINT8
            DET_AZIMUTH_ERR_255_oRDR_DETECTION_253_256_oPCAN_RADAR_7eb02966_Tx: ComSignalType=UINT8
            DET_AZIMUTH_ERR_256_oRDR_DETECTION_253_256_oPCAN_RADAR_1a505298_Tx: ComSignalType=UINT8
            DET_BELOW_RAIN_THOLD_253_oRDR_DETECTION_253_256_oPCAN_RADAR_c6c4d8af_Tx: ComSignalType=UINT8
            DET_BELOW_RAIN_THOLD_254_oRDR_DETECTION_253_256_oPCAN_RADAR_9a74fbc6_Tx: ComSignalType=UINT8
            DET_BELOW_RAIN_THOLD_255_oRDR_DETECTION_253_256_oPCAN_RADAR_0f042f53_Tx: ComSignalType=UINT8
            DET_BELOW_RAIN_THOLD_256_oRDR_DETECTION_253_256_oPCAN_RADAR_6be454ad_Tx: ComSignalType=UINT8
            DET_BI_STATIC_FLAG_253_oRDR_DETECTION_253_256_oPCAN_RADAR_45e90bea_Tx: ComSignalType=BOOLEAN
            DET_BI_STATIC_FLAG_254_oRDR_DETECTION_253_256_oPCAN_RADAR_19592883_Tx: ComSignalType=BOOLEAN
            DET_BI_STATIC_FLAG_255_oRDR_DETECTION_253_256_oPCAN_RADAR_8c29fc16_Tx: ComSignalType=BOOLEAN
            DET_BI_STATIC_FLAG_256_oRDR_DETECTION_253_256_oPCAN_RADAR_e8c987e8_Tx: ComSignalType=BOOLEAN
            DET_CONFD_AZIMUTH_253_oRDR_DETECTION_253_256_oPCAN_RADAR_112341a5_Tx: ComSignalType=UINT8
            DET_CONFD_AZIMUTH_254_oRDR_DETECTION_253_256_oPCAN_RADAR_4d9362cc_Tx: ComSignalType=UINT8
            DET_CONFD_AZIMUTH_255_oRDR_DETECTION_253_256_oPCAN_RADAR_d8e3b659_Tx: ComSignalType=UINT8
            DET_CONFD_AZIMUTH_256_oRDR_DETECTION_253_256_oPCAN_RADAR_bc03cda7_Tx: ComSignalType=UINT8
            DET_CONFD_ELEVATION_253_oRDR_DETECTION_253_256_oPCAN_RADAR_13b6405f_Tx: ComSignalType=UINT8
            DET_CONFD_ELEVATION_254_oRDR_DETECTION_253_256_oPCAN_RADAR_4f066336_Tx: ComSignalType=UINT8
            DET_CONFD_ELEVATION_255_oRDR_DETECTION_253_256_oPCAN_RADAR_da76b7a3_Tx: ComSignalType=UINT8
            DET_CONFD_ELEVATION_256_oRDR_DETECTION_253_256_oPCAN_RADAR_be96cc5d_Tx: ComSignalType=UINT8
            DET_ELEVATION_253_oRDR_DETECTION_253_256_oPCAN_RADAR_c2769463_Tx: ComSignalType=UINT8
            DET_ELEVATION_254_oRDR_DETECTION_253_256_oPCAN_RADAR_9ec6b70a_Tx: ComSignalType=UINT8
            DET_ELEVATION_255_oRDR_DETECTION_253_256_oPCAN_RADAR_0bb6639f_Tx: ComSignalType=UINT8
            DET_ELEVATION_256_oRDR_DETECTION_253_256_oPCAN_RADAR_6f561861_Tx: ComSignalType=UINT8
            DET_ELEVATION_ERR_253_oRDR_DETECTION_253_256_oPCAN_RADAR_454f0c16_Tx: ComSignalType=UINT8
            DET_ELEVATION_ERR_254_oRDR_DETECTION_253_256_oPCAN_RADAR_19ff2f7f_Tx: ComSignalType=UINT8
            DET_ELEVATION_ERR_255_oRDR_DETECTION_253_256_oPCAN_RADAR_8c8ffbea_Tx: ComSignalType=UINT8
            DET_ELEVATION_ERR_256_oRDR_DETECTION_253_256_oPCAN_RADAR_e86f8014_Tx: ComSignalType=UINT8
            DET_EXISTENCE_PROB_253_oRDR_DETECTION_253_256_oPCAN_RADAR_97d07976_Tx: ComSignalType=UINT8
            DET_EXISTENCE_PROB_254_oRDR_DETECTION_253_256_oPCAN_RADAR_cb605a1f_Tx: ComSignalType=UINT8
            DET_EXISTENCE_PROB_255_oRDR_DETECTION_253_256_oPCAN_RADAR_5e108e8a_Tx: ComSignalType=UINT8
            DET_EXISTENCE_PROB_256_oRDR_DETECTION_253_256_oPCAN_RADAR_3af0f574_Tx: ComSignalType=UINT8
            DET_HVC_FLAG_253_oRDR_DETECTION_253_256_oPCAN_RADAR_76a43a09_Tx: ComSignalType=BOOLEAN
            DET_HVC_FLAG_254_oRDR_DETECTION_253_256_oPCAN_RADAR_2a141960_Tx: ComSignalType=BOOLEAN
            DET_HVC_FLAG_255_oRDR_DETECTION_253_256_oPCAN_RADAR_bf64cdf5_Tx: ComSignalType=BOOLEAN
            DET_HVC_FLAG_256_oRDR_DETECTION_253_256_oPCAN_RADAR_db84b60b_Tx: ComSignalType=BOOLEAN
            DET_IDM_253_oRDR_DETECTION_253_256_oPCAN_RADAR_fdf601b4_Tx: ComSignalType=UINT8
            DET_IDM_254_oRDR_DETECTION_253_256_oPCAN_RADAR_a14622dd_Tx: ComSignalType=UINT8
            DET_IDM_255_oRDR_DETECTION_253_256_oPCAN_RADAR_3436f648_Tx: ComSignalType=UINT8
            DET_IDM_256_oRDR_DETECTION_253_256_oPCAN_RADAR_50d68db6_Tx: ComSignalType=UINT8
            DET_MH_CRC16_253_256_oRDR_DETECTION_253_256_oPCAN_RADAR_6ec93a73_Tx: ComSignalType=UINT16
            DET_MH_CYCLE_COUNTER_253_256_oRDR_DETECTION_253_256_oPCAN_RADAR_eabc9b44_Tx: ComSignalType=UINT8
            DET_MH_SCAN_INDEX_4LSB_253_256_oRDR_DETECTION_253_256_oPCAN_RADAR_2696bec8_Tx: ComSignalType=UINT8
            DET_MTD_253_oRDR_DETECTION_253_256_oPCAN_RADAR_9b45336f_Tx: ComSignalType=UINT8
            DET_MTD_254_oRDR_DETECTION_253_256_oPCAN_RADAR_c7f51006_Tx: ComSignalType=UINT8
            DET_MTD_255_oRDR_DETECTION_253_256_oPCAN_RADAR_5285c493_Tx: ComSignalType=UINT8
            DET_MTD_256_oRDR_DETECTION_253_256_oPCAN_RADAR_3665bf6d_Tx: ComSignalType=UINT8
            DET_PROB_1STAZHYPO_253_oRDR_DETECTION_253_256_oPCAN_RADAR_08f1dba2_Tx: ComSignalType=BOOLEAN
            DET_PROB_1STAZHYPO_254_oRDR_DETECTION_253_256_oPCAN_RADAR_5441f8cb_Tx: ComSignalType=BOOLEAN
            DET_PROB_1STAZHYPO_255_oRDR_DETECTION_253_256_oPCAN_RADAR_c1312c5e_Tx: ComSignalType=BOOLEAN
            DET_PROB_1STAZHYPO_256_oRDR_DETECTION_253_256_oPCAN_RADAR_a5d157a0_Tx: ComSignalType=BOOLEAN
            DET_RANGE_253_oRDR_DETECTION_253_256_oPCAN_RADAR_035e38d4_Tx: ComSignalType=UINT16
            DET_RANGE_254_oRDR_DETECTION_253_256_oPCAN_RADAR_5fee1bbd_Tx: ComSignalType=UINT16
            DET_RANGE_255_oRDR_DETECTION_253_256_oPCAN_RADAR_ca9ecf28_Tx: ComSignalType=UINT16
            DET_RANGE_256_oRDR_DETECTION_253_256_oPCAN_RADAR_ae7eb4d6_Tx: ComSignalType=UINT16
            DET_RANGE_ERR_253_oRDR_DETECTION_253_256_oPCAN_RADAR_a4b682bd_Tx: ComSignalType=UINT8
            DET_RANGE_ERR_254_oRDR_DETECTION_253_256_oPCAN_RADAR_f806a1d4_Tx: ComSignalType=UINT8
            DET_RANGE_ERR_255_oRDR_DETECTION_253_256_oPCAN_RADAR_6d767541_Tx: ComSignalType=UINT8
            DET_RANGE_ERR_256_oRDR_DETECTION_253_256_oPCAN_RADAR_09960ebf_Tx: ComSignalType=UINT8
            DET_RANGE_VELOCITY_253_oRDR_DETECTION_253_256_oPCAN_RADAR_76f8faf1_Tx: ComSignalType=UINT16
            DET_RANGE_VELOCITY_254_oRDR_DETECTION_253_256_oPCAN_RADAR_2a48d998_Tx: ComSignalType=UINT16
            DET_RANGE_VELOCITY_255_oRDR_DETECTION_253_256_oPCAN_RADAR_bf380d0d_Tx: ComSignalType=UINT16
            DET_RANGE_VELOCITY_256_oRDR_DETECTION_253_256_oPCAN_RADAR_dbd876f3_Tx: ComSignalType=UINT16
            DET_RANGE_VELOCITY_ERR_253_oRDR_DETECTION_253_256_oPCAN_RADAR_79430143_Tx: ComSignalType=UINT8
            DET_RANGE_VELOCITY_ERR_254_oRDR_DETECTION_253_256_oPCAN_RADAR_25f3222a_Tx: ComSignalType=UINT8
            DET_RANGE_VELOCITY_ERR_255_oRDR_DETECTION_253_256_oPCAN_RADAR_b083f6bf_Tx: ComSignalType=UINT8
            DET_RANGE_VELOCITY_ERR_256_oRDR_DETECTION_253_256_oPCAN_RADAR_d4638d41_Tx: ComSignalType=UINT8
            DET_RCS_253_oRDR_DETECTION_253_256_oPCAN_RADAR_f178cdab_Tx: ComSignalType=UINT8
            DET_RCS_254_oRDR_DETECTION_253_256_oPCAN_RADAR_adc8eec2_Tx: ComSignalType=UINT8
            DET_RCS_255_oRDR_DETECTION_253_256_oPCAN_RADAR_38b83a57_Tx: ComSignalType=UINT8
            DET_RCS_256_oRDR_DETECTION_253_256_oPCAN_RADAR_5c5841a9_Tx: ComSignalType=UINT8
            DET_SNR_253_oRDR_DETECTION_253_256_oPCAN_RADAR_2cd699a9_Tx: ComSignalType=UINT8
            DET_SNR_254_oRDR_DETECTION_253_256_oPCAN_RADAR_7066bac0_Tx: ComSignalType=UINT8
            DET_SNR_255_oRDR_DETECTION_253_256_oPCAN_RADAR_e5166e55_Tx: ComSignalType=UINT8
            DET_SNR_256_oRDR_DETECTION_253_256_oPCAN_RADAR_81f615ab_Tx: ComSignalType=UINT8
            DET_SUPER_RES_TARGET_253_oRDR_DETECTION_253_256_oPCAN_RADAR_1d4fb1cc_Tx: ComSignalType=BOOLEAN
            DET_SUPER_RES_TARGET_254_oRDR_DETECTION_253_256_oPCAN_RADAR_41ff92a5_Tx: ComSignalType=BOOLEAN
            DET_SUPER_RES_TARGET_255_oRDR_DETECTION_253_256_oPCAN_RADAR_d48f4630_Tx: ComSignalType=BOOLEAN
            DET_SUPER_RES_TARGET_256_oRDR_DETECTION_253_256_oPCAN_RADAR_b06f3dce_Tx: ComSignalType=BOOLEAN
        SG_Detections_257_260_oRDR_DETECTION_257_260_oPCAN_RADAR_06edbef2_Tx
          83 x ComGroupSignal:
            DET_AZIMUTH_257_oRDR_DETECTION_257_260_oPCAN_RADAR_8419ce31_Tx: ComSignalType=UINT16
            DET_AZIMUTH_258_oRDR_DETECTION_257_260_oPCAN_RADAR_a8095c76_Tx: ComSignalType=UINT16
            DET_AZIMUTH_259_oRDR_DETECTION_257_260_oPCAN_RADAR_3d7988e3_Tx: ComSignalType=UINT16
            DET_AZIMUTH_260_oRDR_DETECTION_257_260_oPCAN_RADAR_82c8d238_Tx: ComSignalType=UINT16
            DET_AZIMUTH_ERR_257_oRDR_DETECTION_257_260_oPCAN_RADAR_20ac5bc4_Tx: ComSignalType=UINT8
            DET_AZIMUTH_ERR_258_oRDR_DETECTION_257_260_oPCAN_RADAR_0cbcc983_Tx: ComSignalType=UINT8
            DET_AZIMUTH_ERR_259_oRDR_DETECTION_257_260_oPCAN_RADAR_99cc1d16_Tx: ComSignalType=UINT8
            DET_AZIMUTH_ERR_260_oRDR_DETECTION_257_260_oPCAN_RADAR_267d47cd_Tx: ComSignalType=UINT8
            DET_BELOW_RAIN_THOLD_257_oRDR_DETECTION_257_260_oPCAN_RADAR_51185df1_Tx: ComSignalType=UINT8
            DET_BELOW_RAIN_THOLD_258_oRDR_DETECTION_257_260_oPCAN_RADAR_7d08cfb6_Tx: ComSignalType=UINT8
            DET_BELOW_RAIN_THOLD_259_oRDR_DETECTION_257_260_oPCAN_RADAR_e8781b23_Tx: ComSignalType=UINT8
            DET_BELOW_RAIN_THOLD_260_oRDR_DETECTION_257_260_oPCAN_RADAR_57c941f8_Tx: ComSignalType=UINT8
            DET_BI_STATIC_FLAG_257_oRDR_DETECTION_257_260_oPCAN_RADAR_d2358eb4_Tx: ComSignalType=BOOLEAN
            DET_BI_STATIC_FLAG_258_oRDR_DETECTION_257_260_oPCAN_RADAR_fe251cf3_Tx: ComSignalType=BOOLEAN
            DET_BI_STATIC_FLAG_259_oRDR_DETECTION_257_260_oPCAN_RADAR_6b55c866_Tx: ComSignalType=BOOLEAN
            DET_BI_STATIC_FLAG_260_oRDR_DETECTION_257_260_oPCAN_RADAR_d4e492bd_Tx: ComSignalType=BOOLEAN
            DET_CONFD_AZIMUTH_257_oRDR_DETECTION_257_260_oPCAN_RADAR_86ffc4fb_Tx: ComSignalType=UINT8
            DET_CONFD_AZIMUTH_258_oRDR_DETECTION_257_260_oPCAN_RADAR_aaef56bc_Tx: ComSignalType=UINT8
            DET_CONFD_AZIMUTH_259_oRDR_DETECTION_257_260_oPCAN_RADAR_3f9f8229_Tx: ComSignalType=UINT8
            DET_CONFD_AZIMUTH_260_oRDR_DETECTION_257_260_oPCAN_RADAR_802ed8f2_Tx: ComSignalType=UINT8
            DET_CONFD_ELEVATION_257_oRDR_DETECTION_257_260_oPCAN_RADAR_846ac501_Tx: ComSignalType=UINT8
            DET_CONFD_ELEVATION_258_oRDR_DETECTION_257_260_oPCAN_RADAR_a87a5746_Tx: ComSignalType=UINT8
            DET_CONFD_ELEVATION_259_oRDR_DETECTION_257_260_oPCAN_RADAR_3d0a83d3_Tx: ComSignalType=UINT8
            DET_CONFD_ELEVATION_260_oRDR_DETECTION_257_260_oPCAN_RADAR_82bbd908_Tx: ComSignalType=UINT8
            DET_ELEVATION_257_oRDR_DETECTION_257_260_oPCAN_RADAR_55aa113d_Tx: ComSignalType=UINT8
            DET_ELEVATION_258_oRDR_DETECTION_257_260_oPCAN_RADAR_79ba837a_Tx: ComSignalType=UINT8
            DET_ELEVATION_259_oRDR_DETECTION_257_260_oPCAN_RADAR_ecca57ef_Tx: ComSignalType=UINT8
            DET_ELEVATION_260_oRDR_DETECTION_257_260_oPCAN_RADAR_537b0d34_Tx: ComSignalType=UINT8
            DET_ELEVATION_ERR_257_oRDR_DETECTION_257_260_oPCAN_RADAR_d2938948_Tx: ComSignalType=UINT8
            DET_ELEVATION_ERR_258_oRDR_DETECTION_257_260_oPCAN_RADAR_fe831b0f_Tx: ComSignalType=UINT8
            DET_ELEVATION_ERR_259_oRDR_DETECTION_257_260_oPCAN_RADAR_6bf3cf9a_Tx: ComSignalType=UINT8
            DET_ELEVATION_ERR_260_oRDR_DETECTION_257_260_oPCAN_RADAR_d4429541_Tx: ComSignalType=UINT8
            DET_EXISTENCE_PROB_257_oRDR_DETECTION_257_260_oPCAN_RADAR_000cfc28_Tx: ComSignalType=UINT8
            DET_EXISTENCE_PROB_258_oRDR_DETECTION_257_260_oPCAN_RADAR_2c1c6e6f_Tx: ComSignalType=UINT8
            DET_EXISTENCE_PROB_259_oRDR_DETECTION_257_260_oPCAN_RADAR_b96cbafa_Tx: ComSignalType=UINT8
            DET_EXISTENCE_PROB_260_oRDR_DETECTION_257_260_oPCAN_RADAR_06dde021_Tx: ComSignalType=UINT8
            DET_HVC_FLAG_257_oRDR_DETECTION_257_260_oPCAN_RADAR_e178bf57_Tx: ComSignalType=BOOLEAN
            DET_HVC_FLAG_258_oRDR_DETECTION_257_260_oPCAN_RADAR_cd682d10_Tx: ComSignalType=BOOLEAN
            DET_HVC_FLAG_259_oRDR_DETECTION_257_260_oPCAN_RADAR_5818f985_Tx: ComSignalType=BOOLEAN
            DET_HVC_FLAG_260_oRDR_DETECTION_257_260_oPCAN_RADAR_e7a9a35e_Tx: ComSignalType=BOOLEAN
            DET_IDM_257_oRDR_DETECTION_257_260_oPCAN_RADAR_6a2a84ea_Tx: ComSignalType=UINT8
            DET_IDM_258_oRDR_DETECTION_257_260_oPCAN_RADAR_463a16ad_Tx: ComSignalType=UINT8
            DET_IDM_259_oRDR_DETECTION_257_260_oPCAN_RADAR_d34ac238_Tx: ComSignalType=UINT8
            DET_IDM_260_oRDR_DETECTION_257_260_oPCAN_RADAR_6cfb98e3_Tx: ComSignalType=UINT8
            DET_MH_CRC16_257_260_oRDR_DETECTION_257_260_oPCAN_RADAR_82656cf9_Tx: ComSignalType=UINT16
            DET_MH_CYCLE_COUNTER_257_260_oRDR_DETECTION_257_260_oPCAN_RADAR_0610cdce_Tx: ComSignalType=UINT8
            DET_MH_SCAN_INDEX_4LSB_257_260_oRDR_DETECTION_257_260_oPCAN_RADAR_ca3ae842_Tx: ComSignalType=UINT8
            DET_MTD_257_oRDR_DETECTION_257_260_oPCAN_RADAR_0c99b631_Tx: ComSignalType=UINT8
            DET_MTD_258_oRDR_DETECTION_257_260_oPCAN_RADAR_20892476_Tx: ComSignalType=UINT8
            DET_MTD_259_oRDR_DETECTION_257_260_oPCAN_RADAR_b5f9f0e3_Tx: ComSignalType=UINT8
            DET_MTD_260_oRDR_DETECTION_257_260_oPCAN_RADAR_0a48aa38_Tx: ComSignalType=UINT8
            DET_PROB_1STAZHYPO_257_oRDR_DETECTION_257_260_oPCAN_RADAR_9f2d5efc_Tx: ComSignalType=BOOLEAN
            DET_PROB_1STAZHYPO_258_oRDR_DETECTION_257_260_oPCAN_RADAR_b33dccbb_Tx: ComSignalType=BOOLEAN
            DET_PROB_1STAZHYPO_259_oRDR_DETECTION_257_260_oPCAN_RADAR_264d182e_Tx: ComSignalType=BOOLEAN
            DET_PROB_1STAZHYPO_260_oRDR_DETECTION_257_260_oPCAN_RADAR_99fc42f5_Tx: ComSignalType=BOOLEAN
            DET_RANGE_257_oRDR_DETECTION_257_260_oPCAN_RADAR_9482bd8a_Tx: ComSignalType=UINT16
            DET_RANGE_258_oRDR_DETECTION_257_260_oPCAN_RADAR_b8922fcd_Tx: ComSignalType=UINT16
            DET_RANGE_259_oRDR_DETECTION_257_260_oPCAN_RADAR_2de2fb58_Tx: ComSignalType=UINT16
            DET_RANGE_260_oRDR_DETECTION_257_260_oPCAN_RADAR_9253a183_Tx: ComSignalType=UINT16
            DET_RANGE_ERR_257_oRDR_DETECTION_257_260_oPCAN_RADAR_336a07e3_Tx: ComSignalType=UINT8
            DET_RANGE_ERR_258_oRDR_DETECTION_257_260_oPCAN_RADAR_1f7a95a4_Tx: ComSignalType=UINT8
            DET_RANGE_ERR_259_oRDR_DETECTION_257_260_oPCAN_RADAR_8a0a4131_Tx: ComSignalType=UINT8
            DET_RANGE_ERR_260_oRDR_DETECTION_257_260_oPCAN_RADAR_35bb1bea_Tx: ComSignalType=UINT8
            DET_RANGE_VELOCITY_257_oRDR_DETECTION_257_260_oPCAN_RADAR_e1247faf_Tx: ComSignalType=UINT16
            DET_RANGE_VELOCITY_258_oRDR_DETECTION_257_260_oPCAN_RADAR_cd34ede8_Tx: ComSignalType=UINT16
            DET_RANGE_VELOCITY_259_oRDR_DETECTION_257_260_oPCAN_RADAR_5844397d_Tx: ComSignalType=UINT16
            DET_RANGE_VELOCITY_260_oRDR_DETECTION_257_260_oPCAN_RADAR_e7f563a6_Tx: ComSignalType=UINT16
            DET_RANGE_VELOCITY_ERR_257_oRDR_DETECTION_257_260_oPCAN_RADAR_ee9f841d_Tx: ComSignalType=UINT8
            DET_RANGE_VELOCITY_ERR_258_oRDR_DETECTION_257_260_oPCAN_RADAR_c28f165a_Tx: ComSignalType=UINT8
            DET_RANGE_VELOCITY_ERR_259_oRDR_DETECTION_257_260_oPCAN_RADAR_57ffc2cf_Tx: ComSignalType=UINT8
            DET_RANGE_VELOCITY_ERR_260_oRDR_DETECTION_257_260_oPCAN_RADAR_e84e9814_Tx: ComSignalType=UINT8
            DET_RCS_257_oRDR_DETECTION_257_260_oPCAN_RADAR_66a448f5_Tx: ComSignalType=UINT8
            DET_RCS_258_oRDR_DETECTION_257_260_oPCAN_RADAR_4ab4dab2_Tx: ComSignalType=UINT8
            DET_RCS_259_oRDR_DETECTION_257_260_oPCAN_RADAR_dfc40e27_Tx: ComSignalType=UINT8
            DET_RCS_260_oRDR_DETECTION_257_260_oPCAN_RADAR_607554fc_Tx: ComSignalType=UINT8
            DET_SNR_257_oRDR_DETECTION_257_260_oPCAN_RADAR_bb0a1cf7_Tx: ComSignalType=UINT8
            DET_SNR_258_oRDR_DETECTION_257_260_oPCAN_RADAR_971a8eb0_Tx: ComSignalType=UINT8
            DET_SNR_259_oRDR_DETECTION_257_260_oPCAN_RADAR_026a5a25_Tx: ComSignalType=UINT8
            DET_SNR_260_oRDR_DETECTION_257_260_oPCAN_RADAR_bddb00fe_Tx: ComSignalType=UINT8
            DET_SUPER_RES_TARGET_257_oRDR_DETECTION_257_260_oPCAN_RADAR_8a933492_Tx: ComSignalType=BOOLEAN
            DET_SUPER_RES_TARGET_258_oRDR_DETECTION_257_260_oPCAN_RADAR_a683a6d5_Tx: ComSignalType=BOOLEAN
            DET_SUPER_RES_TARGET_259_oRDR_DETECTION_257_260_oPCAN_RADAR_33f37240_Tx: ComSignalType=BOOLEAN
            DET_SUPER_RES_TARGET_260_oRDR_DETECTION_257_260_oPCAN_RADAR_8c42289b_Tx: ComSignalType=BOOLEAN
        SG_Detections_261_264_oRDR_DETECTION_261_264_oPCAN_RADAR_0586302b_Tx
          83 x ComGroupSignal:
            DET_AZIMUTH_261_oRDR_DETECTION_261_264_oPCAN_RADAR_9ab30651_Tx: ComSignalType=UINT16
            DET_AZIMUTH_262_oRDR_DETECTION_261_264_oPCAN_RADAR_fe537daf_Tx: ComSignalType=UINT16
            DET_AZIMUTH_263_oRDR_DETECTION_261_264_oPCAN_RADAR_6b23a93a_Tx: ComSignalType=UINT16
            DET_AZIMUTH_264_oRDR_DETECTION_261_264_oPCAN_RADAR_37938a53_Tx: ComSignalType=UINT16
            DET_AZIMUTH_ERR_261_oRDR_DETECTION_261_264_oPCAN_RADAR_3e0693a4_Tx: ComSignalType=UINT8
            DET_AZIMUTH_ERR_262_oRDR_DETECTION_261_264_oPCAN_RADAR_5ae6e85a_Tx: ComSignalType=UINT8
            DET_AZIMUTH_ERR_263_oRDR_DETECTION_261_264_oPCAN_RADAR_cf963ccf_Tx: ComSignalType=UINT8
            DET_AZIMUTH_ERR_264_oRDR_DETECTION_261_264_oPCAN_RADAR_93261fa6_Tx: ComSignalType=UINT8
            DET_BELOW_RAIN_THOLD_261_oRDR_DETECTION_261_264_oPCAN_RADAR_4fb29591_Tx: ComSignalType=UINT8
            DET_BELOW_RAIN_THOLD_262_oRDR_DETECTION_261_264_oPCAN_RADAR_2b52ee6f_Tx: ComSignalType=UINT8
            DET_BELOW_RAIN_THOLD_263_oRDR_DETECTION_261_264_oPCAN_RADAR_be223afa_Tx: ComSignalType=UINT8
            DET_BELOW_RAIN_THOLD_264_oRDR_DETECTION_261_264_oPCAN_RADAR_e2921993_Tx: ComSignalType=UINT8
            DET_BI_STATIC_FLAG_261_oRDR_DETECTION_261_264_oPCAN_RADAR_cc9f46d4_Tx: ComSignalType=BOOLEAN
            DET_BI_STATIC_FLAG_262_oRDR_DETECTION_261_264_oPCAN_RADAR_a87f3d2a_Tx: ComSignalType=BOOLEAN
            DET_BI_STATIC_FLAG_263_oRDR_DETECTION_261_264_oPCAN_RADAR_3d0fe9bf_Tx: ComSignalType=BOOLEAN
            DET_BI_STATIC_FLAG_264_oRDR_DETECTION_261_264_oPCAN_RADAR_61bfcad6_Tx: ComSignalType=BOOLEAN
            DET_CONFD_AZIMUTH_261_oRDR_DETECTION_261_264_oPCAN_RADAR_98550c9b_Tx: ComSignalType=UINT8
            DET_CONFD_AZIMUTH_262_oRDR_DETECTION_261_264_oPCAN_RADAR_fcb57765_Tx: ComSignalType=UINT8
            DET_CONFD_AZIMUTH_263_oRDR_DETECTION_261_264_oPCAN_RADAR_69c5a3f0_Tx: ComSignalType=UINT8
            DET_CONFD_AZIMUTH_264_oRDR_DETECTION_261_264_oPCAN_RADAR_35758099_Tx: ComSignalType=UINT8
            DET_CONFD_ELEVATION_261_oRDR_DETECTION_261_264_oPCAN_RADAR_9ac00d61_Tx: ComSignalType=UINT8
            DET_CONFD_ELEVATION_262_oRDR_DETECTION_261_264_oPCAN_RADAR_fe20769f_Tx: ComSignalType=UINT8
            DET_CONFD_ELEVATION_263_oRDR_DETECTION_261_264_oPCAN_RADAR_6b50a20a_Tx: ComSignalType=UINT8
            DET_CONFD_ELEVATION_264_oRDR_DETECTION_261_264_oPCAN_RADAR_37e08163_Tx: ComSignalType=UINT8
            DET_ELEVATION_261_oRDR_DETECTION_261_264_oPCAN_RADAR_4b00d95d_Tx: ComSignalType=UINT8
            DET_ELEVATION_262_oRDR_DETECTION_261_264_oPCAN_RADAR_2fe0a2a3_Tx: ComSignalType=UINT8
            DET_ELEVATION_263_oRDR_DETECTION_261_264_oPCAN_RADAR_ba907636_Tx: ComSignalType=UINT8
            DET_ELEVATION_264_oRDR_DETECTION_261_264_oPCAN_RADAR_e620555f_Tx: ComSignalType=UINT8
            DET_ELEVATION_ERR_261_oRDR_DETECTION_261_264_oPCAN_RADAR_cc394128_Tx: ComSignalType=UINT8
            DET_ELEVATION_ERR_262_oRDR_DETECTION_261_264_oPCAN_RADAR_a8d93ad6_Tx: ComSignalType=UINT8
            DET_ELEVATION_ERR_263_oRDR_DETECTION_261_264_oPCAN_RADAR_3da9ee43_Tx: ComSignalType=UINT8
            DET_ELEVATION_ERR_264_oRDR_DETECTION_261_264_oPCAN_RADAR_6119cd2a_Tx: ComSignalType=UINT8
            DET_EXISTENCE_PROB_261_oRDR_DETECTION_261_264_oPCAN_RADAR_1ea63448_Tx: ComSignalType=UINT8
            DET_EXISTENCE_PROB_262_oRDR_DETECTION_261_264_oPCAN_RADAR_7a464fb6_Tx: ComSignalType=UINT8
            DET_EXISTENCE_PROB_263_oRDR_DETECTION_261_264_oPCAN_RADAR_ef369b23_Tx: ComSignalType=UINT8
            DET_EXISTENCE_PROB_264_oRDR_DETECTION_261_264_oPCAN_RADAR_b386b84a_Tx: ComSignalType=UINT8
            DET_HVC_FLAG_261_oRDR_DETECTION_261_264_oPCAN_RADAR_ffd27737_Tx: ComSignalType=BOOLEAN
            DET_HVC_FLAG_262_oRDR_DETECTION_261_264_oPCAN_RADAR_9b320cc9_Tx: ComSignalType=BOOLEAN
            DET_HVC_FLAG_263_oRDR_DETECTION_261_264_oPCAN_RADAR_0e42d85c_Tx: ComSignalType=BOOLEAN
            DET_HVC_FLAG_264_oRDR_DETECTION_261_264_oPCAN_RADAR_52f2fb35_Tx: ComSignalType=BOOLEAN
            DET_IDM_261_oRDR_DETECTION_261_264_oPCAN_RADAR_74804c8a_Tx: ComSignalType=UINT8
            DET_IDM_262_oRDR_DETECTION_261_264_oPCAN_RADAR_10603774_Tx: ComSignalType=UINT8
            DET_IDM_263_oRDR_DETECTION_261_264_oPCAN_RADAR_8510e3e1_Tx: ComSignalType=UINT8
            DET_IDM_264_oRDR_DETECTION_261_264_oPCAN_RADAR_d9a0c088_Tx: ComSignalType=UINT8
            DET_MH_CRC16_261_264_oRDR_DETECTION_261_264_oPCAN_RADAR_810ee220_Tx: ComSignalType=UINT16
            DET_MH_CYCLE_COUNTER_261_264_oRDR_DETECTION_261_264_oPCAN_RADAR_057b4317_Tx: ComSignalType=UINT8
            DET_MH_SCAN_INDEX_4LSB_261_264_oRDR_DETECTION_261_264_oPCAN_RADAR_c951669b_Tx: ComSignalType=UINT8
            DET_MTD_261_oRDR_DETECTION_261_264_oPCAN_RADAR_12337e51_Tx: ComSignalType=UINT8
            DET_MTD_262_oRDR_DETECTION_261_264_oPCAN_RADAR_76d305af_Tx: ComSignalType=UINT8
            DET_MTD_263_oRDR_DETECTION_261_264_oPCAN_RADAR_e3a3d13a_Tx: ComSignalType=UINT8
            DET_MTD_264_oRDR_DETECTION_261_264_oPCAN_RADAR_bf13f253_Tx: ComSignalType=UINT8
            DET_PROB_1STAZHYPO_261_oRDR_DETECTION_261_264_oPCAN_RADAR_8187969c_Tx: ComSignalType=BOOLEAN
            DET_PROB_1STAZHYPO_262_oRDR_DETECTION_261_264_oPCAN_RADAR_e567ed62_Tx: ComSignalType=BOOLEAN
            DET_PROB_1STAZHYPO_263_oRDR_DETECTION_261_264_oPCAN_RADAR_701739f7_Tx: ComSignalType=BOOLEAN
            DET_PROB_1STAZHYPO_264_oRDR_DETECTION_261_264_oPCAN_RADAR_2ca71a9e_Tx: ComSignalType=BOOLEAN
            DET_RANGE_261_oRDR_DETECTION_261_264_oPCAN_RADAR_8a2875ea_Tx: ComSignalType=UINT16
            DET_RANGE_262_oRDR_DETECTION_261_264_oPCAN_RADAR_eec80e14_Tx: ComSignalType=UINT16
            DET_RANGE_263_oRDR_DETECTION_261_264_oPCAN_RADAR_7bb8da81_Tx: ComSignalType=UINT16
            DET_RANGE_264_oRDR_DETECTION_261_264_oPCAN_RADAR_2708f9e8_Tx: ComSignalType=UINT16
            DET_RANGE_ERR_261_oRDR_DETECTION_261_264_oPCAN_RADAR_2dc0cf83_Tx: ComSignalType=UINT8
            DET_RANGE_ERR_262_oRDR_DETECTION_261_264_oPCAN_RADAR_4920b47d_Tx: ComSignalType=UINT8
            DET_RANGE_ERR_263_oRDR_DETECTION_261_264_oPCAN_RADAR_dc5060e8_Tx: ComSignalType=UINT8
            DET_RANGE_ERR_264_oRDR_DETECTION_261_264_oPCAN_RADAR_80e04381_Tx: ComSignalType=UINT8
            DET_RANGE_VELOCITY_261_oRDR_DETECTION_261_264_oPCAN_RADAR_ff8eb7cf_Tx: ComSignalType=UINT16
            DET_RANGE_VELOCITY_262_oRDR_DETECTION_261_264_oPCAN_RADAR_9b6ecc31_Tx: ComSignalType=UINT16
            DET_RANGE_VELOCITY_263_oRDR_DETECTION_261_264_oPCAN_RADAR_0e1e18a4_Tx: ComSignalType=UINT16
            DET_RANGE_VELOCITY_264_oRDR_DETECTION_261_264_oPCAN_RADAR_52ae3bcd_Tx: ComSignalType=UINT16
            DET_RANGE_VELOCITY_ERR_261_oRDR_DETECTION_261_264_oPCAN_RADAR_f0354c7d_Tx: ComSignalType=UINT8
            DET_RANGE_VELOCITY_ERR_262_oRDR_DETECTION_261_264_oPCAN_RADAR_94d53783_Tx: ComSignalType=UINT8
            DET_RANGE_VELOCITY_ERR_263_oRDR_DETECTION_261_264_oPCAN_RADAR_01a5e316_Tx: ComSignalType=UINT8
            DET_RANGE_VELOCITY_ERR_264_oRDR_DETECTION_261_264_oPCAN_RADAR_5d15c07f_Tx: ComSignalType=UINT8
            DET_RCS_261_oRDR_DETECTION_261_264_oPCAN_RADAR_780e8095_Tx: ComSignalType=UINT8
            DET_RCS_262_oRDR_DETECTION_261_264_oPCAN_RADAR_1ceefb6b_Tx: ComSignalType=UINT8
            DET_RCS_263_oRDR_DETECTION_261_264_oPCAN_RADAR_899e2ffe_Tx: ComSignalType=UINT8
            DET_RCS_264_oRDR_DETECTION_261_264_oPCAN_RADAR_d52e0c97_Tx: ComSignalType=UINT8
            DET_SNR_261_oRDR_DETECTION_261_264_oPCAN_RADAR_a5a0d497_Tx: ComSignalType=UINT8
            DET_SNR_262_oRDR_DETECTION_261_264_oPCAN_RADAR_c140af69_Tx: ComSignalType=UINT8
            DET_SNR_263_oRDR_DETECTION_261_264_oPCAN_RADAR_54307bfc_Tx: ComSignalType=UINT8
            DET_SNR_264_oRDR_DETECTION_261_264_oPCAN_RADAR_08805895_Tx: ComSignalType=UINT8
            DET_SUPER_RES_TARGET_261_oRDR_DETECTION_261_264_oPCAN_RADAR_9439fcf2_Tx: ComSignalType=BOOLEAN
            DET_SUPER_RES_TARGET_262_oRDR_DETECTION_261_264_oPCAN_RADAR_f0d9870c_Tx: ComSignalType=BOOLEAN
            DET_SUPER_RES_TARGET_263_oRDR_DETECTION_261_264_oPCAN_RADAR_65a95399_Tx: ComSignalType=BOOLEAN
            DET_SUPER_RES_TARGET_264_oRDR_DETECTION_261_264_oPCAN_RADAR_391970f0_Tx: ComSignalType=BOOLEAN
        SG_Detections_265_268_oRDR_DETECTION_265_268_oPCAN_RADAR_74450479_Tx
          83 x ComGroupSignal:
            DET_AZIMUTH_265_oRDR_DETECTION_265_268_oPCAN_RADAR_4b51c0f2_Tx: ComSignalType=UINT16
            DET_AZIMUTH_266_oRDR_DETECTION_265_268_oPCAN_RADAR_2fb1bb0c_Tx: ComSignalType=UINT16
            DET_AZIMUTH_267_oRDR_DETECTION_265_268_oPCAN_RADAR_bac16f99_Tx: ComSignalType=UINT16
            DET_AZIMUTH_268_oRDR_DETECTION_265_268_oPCAN_RADAR_96d1fdde_Tx: ComSignalType=UINT16
            DET_AZIMUTH_ERR_265_oRDR_DETECTION_265_268_oPCAN_RADAR_efe45507_Tx: ComSignalType=UINT8
            DET_AZIMUTH_ERR_266_oRDR_DETECTION_265_268_oPCAN_RADAR_8b042ef9_Tx: ComSignalType=UINT8
            DET_AZIMUTH_ERR_267_oRDR_DETECTION_265_268_oPCAN_RADAR_1e74fa6c_Tx: ComSignalType=UINT8
            DET_AZIMUTH_ERR_268_oRDR_DETECTION_265_268_oPCAN_RADAR_3264682b_Tx: ComSignalType=UINT8
            DET_BELOW_RAIN_THOLD_265_oRDR_DETECTION_265_268_oPCAN_RADAR_9e505332_Tx: ComSignalType=UINT8
            DET_BELOW_RAIN_THOLD_266_oRDR_DETECTION_265_268_oPCAN_RADAR_fab028cc_Tx: ComSignalType=UINT8
            DET_BELOW_RAIN_THOLD_267_oRDR_DETECTION_265_268_oPCAN_RADAR_6fc0fc59_Tx: ComSignalType=UINT8
            DET_BELOW_RAIN_THOLD_268_oRDR_DETECTION_265_268_oPCAN_RADAR_43d06e1e_Tx: ComSignalType=UINT8
            DET_BI_STATIC_FLAG_265_oRDR_DETECTION_265_268_oPCAN_RADAR_1d7d8077_Tx: ComSignalType=BOOLEAN
            DET_BI_STATIC_FLAG_266_oRDR_DETECTION_265_268_oPCAN_RADAR_799dfb89_Tx: ComSignalType=BOOLEAN
            DET_BI_STATIC_FLAG_267_oRDR_DETECTION_265_268_oPCAN_RADAR_eced2f1c_Tx: ComSignalType=BOOLEAN
            DET_BI_STATIC_FLAG_268_oRDR_DETECTION_265_268_oPCAN_RADAR_c0fdbd5b_Tx: ComSignalType=BOOLEAN
            DET_CONFD_AZIMUTH_265_oRDR_DETECTION_265_268_oPCAN_RADAR_49b7ca38_Tx: ComSignalType=UINT8
            DET_CONFD_AZIMUTH_266_oRDR_DETECTION_265_268_oPCAN_RADAR_2d57b1c6_Tx: ComSignalType=UINT8
            DET_CONFD_AZIMUTH_267_oRDR_DETECTION_265_268_oPCAN_RADAR_b8276553_Tx: ComSignalType=UINT8
            DET_CONFD_AZIMUTH_268_oRDR_DETECTION_265_268_oPCAN_RADAR_9437f714_Tx: ComSignalType=UINT8
            DET_CONFD_ELEVATION_265_oRDR_DETECTION_265_268_oPCAN_RADAR_4b22cbc2_Tx: ComSignalType=UINT8
            DET_CONFD_ELEVATION_266_oRDR_DETECTION_265_268_oPCAN_RADAR_2fc2b03c_Tx: ComSignalType=UINT8
            DET_CONFD_ELEVATION_267_oRDR_DETECTION_265_268_oPCAN_RADAR_bab264a9_Tx: ComSignalType=UINT8
            DET_CONFD_ELEVATION_268_oRDR_DETECTION_265_268_oPCAN_RADAR_96a2f6ee_Tx: ComSignalType=UINT8
            DET_ELEVATION_265_oRDR_DETECTION_265_268_oPCAN_RADAR_9ae21ffe_Tx: ComSignalType=UINT8
            DET_ELEVATION_266_oRDR_DETECTION_265_268_oPCAN_RADAR_fe026400_Tx: ComSignalType=UINT8
            DET_ELEVATION_267_oRDR_DETECTION_265_268_oPCAN_RADAR_6b72b095_Tx: ComSignalType=UINT8
            DET_ELEVATION_268_oRDR_DETECTION_265_268_oPCAN_RADAR_476222d2_Tx: ComSignalType=UINT8
            DET_ELEVATION_ERR_265_oRDR_DETECTION_265_268_oPCAN_RADAR_1ddb878b_Tx: ComSignalType=UINT8
            DET_ELEVATION_ERR_266_oRDR_DETECTION_265_268_oPCAN_RADAR_793bfc75_Tx: ComSignalType=UINT8
            DET_ELEVATION_ERR_267_oRDR_DETECTION_265_268_oPCAN_RADAR_ec4b28e0_Tx: ComSignalType=UINT8
            DET_ELEVATION_ERR_268_oRDR_DETECTION_265_268_oPCAN_RADAR_c05bbaa7_Tx: ComSignalType=UINT8
            DET_EXISTENCE_PROB_265_oRDR_DETECTION_265_268_oPCAN_RADAR_cf44f2eb_Tx: ComSignalType=UINT8
            DET_EXISTENCE_PROB_266_oRDR_DETECTION_265_268_oPCAN_RADAR_aba48915_Tx: ComSignalType=UINT8
            DET_EXISTENCE_PROB_267_oRDR_DETECTION_265_268_oPCAN_RADAR_3ed45d80_Tx: ComSignalType=UINT8
            DET_EXISTENCE_PROB_268_oRDR_DETECTION_265_268_oPCAN_RADAR_12c4cfc7_Tx: ComSignalType=UINT8
            DET_HVC_FLAG_265_oRDR_DETECTION_265_268_oPCAN_RADAR_2e30b194_Tx: ComSignalType=BOOLEAN
            DET_HVC_FLAG_266_oRDR_DETECTION_265_268_oPCAN_RADAR_4ad0ca6a_Tx: ComSignalType=BOOLEAN
            DET_HVC_FLAG_267_oRDR_DETECTION_265_268_oPCAN_RADAR_dfa01eff_Tx: ComSignalType=BOOLEAN
            DET_HVC_FLAG_268_oRDR_DETECTION_265_268_oPCAN_RADAR_f3b08cb8_Tx: ComSignalType=BOOLEAN
            DET_IDM_265_oRDR_DETECTION_265_268_oPCAN_RADAR_a5628a29_Tx: ComSignalType=UINT8
            DET_IDM_266_oRDR_DETECTION_265_268_oPCAN_RADAR_c182f1d7_Tx: ComSignalType=UINT8
            DET_IDM_267_oRDR_DETECTION_265_268_oPCAN_RADAR_54f22542_Tx: ComSignalType=UINT8
            DET_IDM_268_oRDR_DETECTION_265_268_oPCAN_RADAR_78e2b705_Tx: ComSignalType=UINT8
            DET_MH_CRC16_265_268_oRDR_DETECTION_265_268_oPCAN_RADAR_f0cdd672_Tx: ComSignalType=UINT16
            DET_MH_CYCLE_COUNTER_265_268_oRDR_DETECTION_265_268_oPCAN_RADAR_74b87745_Tx: ComSignalType=UINT8
            DET_MH_SCAN_INDEX_4LSB_265_268_oRDR_DETECTION_265_268_oPCAN_RADAR_b89252c9_Tx: ComSignalType=UINT8
            DET_MTD_265_oRDR_DETECTION_265_268_oPCAN_RADAR_c3d1b8f2_Tx: ComSignalType=UINT8
            DET_MTD_266_oRDR_DETECTION_265_268_oPCAN_RADAR_a731c30c_Tx: ComSignalType=UINT8
            DET_MTD_267_oRDR_DETECTION_265_268_oPCAN_RADAR_32411799_Tx: ComSignalType=UINT8
            DET_MTD_268_oRDR_DETECTION_265_268_oPCAN_RADAR_1e5185de_Tx: ComSignalType=UINT8
            DET_PROB_1STAZHYPO_265_oRDR_DETECTION_265_268_oPCAN_RADAR_5065503f_Tx: ComSignalType=BOOLEAN
            DET_PROB_1STAZHYPO_266_oRDR_DETECTION_265_268_oPCAN_RADAR_34852bc1_Tx: ComSignalType=BOOLEAN
            DET_PROB_1STAZHYPO_267_oRDR_DETECTION_265_268_oPCAN_RADAR_a1f5ff54_Tx: ComSignalType=BOOLEAN
            DET_PROB_1STAZHYPO_268_oRDR_DETECTION_265_268_oPCAN_RADAR_8de56d13_Tx: ComSignalType=BOOLEAN
            DET_RANGE_265_oRDR_DETECTION_265_268_oPCAN_RADAR_5bcab349_Tx: ComSignalType=UINT16
            DET_RANGE_266_oRDR_DETECTION_265_268_oPCAN_RADAR_3f2ac8b7_Tx: ComSignalType=UINT16
            DET_RANGE_267_oRDR_DETECTION_265_268_oPCAN_RADAR_aa5a1c22_Tx: ComSignalType=UINT16
            DET_RANGE_268_oRDR_DETECTION_265_268_oPCAN_RADAR_864a8e65_Tx: ComSignalType=UINT16
            DET_RANGE_ERR_265_oRDR_DETECTION_265_268_oPCAN_RADAR_fc220920_Tx: ComSignalType=UINT8
            DET_RANGE_ERR_266_oRDR_DETECTION_265_268_oPCAN_RADAR_98c272de_Tx: ComSignalType=UINT8
            DET_RANGE_ERR_267_oRDR_DETECTION_265_268_oPCAN_RADAR_0db2a64b_Tx: ComSignalType=UINT8
            DET_RANGE_ERR_268_oRDR_DETECTION_265_268_oPCAN_RADAR_21a2340c_Tx: ComSignalType=UINT8
            DET_RANGE_VELOCITY_265_oRDR_DETECTION_265_268_oPCAN_RADAR_2e6c716c_Tx: ComSignalType=UINT16
            DET_RANGE_VELOCITY_266_oRDR_DETECTION_265_268_oPCAN_RADAR_4a8c0a92_Tx: ComSignalType=UINT16
            DET_RANGE_VELOCITY_267_oRDR_DETECTION_265_268_oPCAN_RADAR_dffcde07_Tx: ComSignalType=UINT16
            DET_RANGE_VELOCITY_268_oRDR_DETECTION_265_268_oPCAN_RADAR_f3ec4c40_Tx: ComSignalType=UINT16
            DET_RANGE_VELOCITY_ERR_265_oRDR_DETECTION_265_268_oPCAN_RADAR_21d78ade_Tx: ComSignalType=UINT8
            DET_RANGE_VELOCITY_ERR_266_oRDR_DETECTION_265_268_oPCAN_RADAR_4537f120_Tx: ComSignalType=UINT8
            DET_RANGE_VELOCITY_ERR_267_oRDR_DETECTION_265_268_oPCAN_RADAR_d04725b5_Tx: ComSignalType=UINT8
            DET_RANGE_VELOCITY_ERR_268_oRDR_DETECTION_265_268_oPCAN_RADAR_fc57b7f2_Tx: ComSignalType=UINT8
            DET_RCS_265_oRDR_DETECTION_265_268_oPCAN_RADAR_a9ec4636_Tx: ComSignalType=UINT8
            DET_RCS_266_oRDR_DETECTION_265_268_oPCAN_RADAR_cd0c3dc8_Tx: ComSignalType=UINT8
            DET_RCS_267_oRDR_DETECTION_265_268_oPCAN_RADAR_587ce95d_Tx: ComSignalType=UINT8
            DET_RCS_268_oRDR_DETECTION_265_268_oPCAN_RADAR_746c7b1a_Tx: ComSignalType=UINT8
            DET_SNR_265_oRDR_DETECTION_265_268_oPCAN_RADAR_74421234_Tx: ComSignalType=UINT8
            DET_SNR_266_oRDR_DETECTION_265_268_oPCAN_RADAR_10a269ca_Tx: ComSignalType=UINT8
            DET_SNR_267_oRDR_DETECTION_265_268_oPCAN_RADAR_85d2bd5f_Tx: ComSignalType=UINT8
            DET_SNR_268_oRDR_DETECTION_265_268_oPCAN_RADAR_a9c22f18_Tx: ComSignalType=UINT8
            DET_SUPER_RES_TARGET_265_oRDR_DETECTION_265_268_oPCAN_RADAR_45db3a51_Tx: ComSignalType=BOOLEAN
            DET_SUPER_RES_TARGET_266_oRDR_DETECTION_265_268_oPCAN_RADAR_213b41af_Tx: ComSignalType=BOOLEAN
            DET_SUPER_RES_TARGET_267_oRDR_DETECTION_265_268_oPCAN_RADAR_b44b953a_Tx: ComSignalType=BOOLEAN
            DET_SUPER_RES_TARGET_268_oRDR_DETECTION_265_268_oPCAN_RADAR_985b077d_Tx: ComSignalType=BOOLEAN
        SG_Detections_269_272_oRDR_DETECTION_269_272_oPCAN_RADAR_ed3f2002_Tx
          83 x ComGroupSignal:
            DET_AZIMUTH_269_oRDR_DETECTION_269_272_oPCAN_RADAR_31e9c64a_Tx: ComSignalType=UINT16
            DET_AZIMUTH_270_oRDR_DETECTION_269_272_oPCAN_RADAR_54c9b4ee_Tx: ComSignalType=UINT16
            DET_AZIMUTH_271_oRDR_DETECTION_269_272_oPCAN_RADAR_c1b9607b_Tx: ComSignalType=UINT16
            DET_AZIMUTH_272_oRDR_DETECTION_269_272_oPCAN_RADAR_a5591b85_Tx: ComSignalType=UINT16
            DET_AZIMUTH_ERR_269_oRDR_DETECTION_269_272_oPCAN_RADAR_955c53bf_Tx: ComSignalType=UINT8
            DET_AZIMUTH_ERR_270_oRDR_DETECTION_269_272_oPCAN_RADAR_f07c211b_Tx: ComSignalType=UINT8
            DET_AZIMUTH_ERR_271_oRDR_DETECTION_269_272_oPCAN_RADAR_650cf58e_Tx: ComSignalType=UINT8
            DET_AZIMUTH_ERR_272_oRDR_DETECTION_269_272_oPCAN_RADAR_01ec8e70_Tx: ComSignalType=UINT8
            DET_BELOW_RAIN_THOLD_269_oRDR_DETECTION_269_272_oPCAN_RADAR_e4e8558a_Tx: ComSignalType=UINT8
            DET_BELOW_RAIN_THOLD_270_oRDR_DETECTION_269_272_oPCAN_RADAR_81c8272e_Tx: ComSignalType=UINT8
            DET_BELOW_RAIN_THOLD_271_oRDR_DETECTION_269_272_oPCAN_RADAR_14b8f3bb_Tx: ComSignalType=UINT8
            DET_BELOW_RAIN_THOLD_272_oRDR_DETECTION_269_272_oPCAN_RADAR_70588845_Tx: ComSignalType=UINT8
            DET_BI_STATIC_FLAG_269_oRDR_DETECTION_269_272_oPCAN_RADAR_67c586cf_Tx: ComSignalType=BOOLEAN
            DET_BI_STATIC_FLAG_270_oRDR_DETECTION_269_272_oPCAN_RADAR_02e5f46b_Tx: ComSignalType=BOOLEAN
            DET_BI_STATIC_FLAG_271_oRDR_DETECTION_269_272_oPCAN_RADAR_979520fe_Tx: ComSignalType=BOOLEAN
            DET_BI_STATIC_FLAG_272_oRDR_DETECTION_269_272_oPCAN_RADAR_f3755b00_Tx: ComSignalType=BOOLEAN
            DET_CONFD_AZIMUTH_269_oRDR_DETECTION_269_272_oPCAN_RADAR_330fcc80_Tx: ComSignalType=UINT8
            DET_CONFD_AZIMUTH_270_oRDR_DETECTION_269_272_oPCAN_RADAR_562fbe24_Tx: ComSignalType=UINT8
            DET_CONFD_AZIMUTH_271_oRDR_DETECTION_269_272_oPCAN_RADAR_c35f6ab1_Tx: ComSignalType=UINT8
            DET_CONFD_AZIMUTH_272_oRDR_DETECTION_269_272_oPCAN_RADAR_a7bf114f_Tx: ComSignalType=UINT8
            DET_CONFD_ELEVATION_269_oRDR_DETECTION_269_272_oPCAN_RADAR_319acd7a_Tx: ComSignalType=UINT8
            DET_CONFD_ELEVATION_270_oRDR_DETECTION_269_272_oPCAN_RADAR_54babfde_Tx: ComSignalType=UINT8
            DET_CONFD_ELEVATION_271_oRDR_DETECTION_269_272_oPCAN_RADAR_c1ca6b4b_Tx: ComSignalType=UINT8
            DET_CONFD_ELEVATION_272_oRDR_DETECTION_269_272_oPCAN_RADAR_a52a10b5_Tx: ComSignalType=UINT8
            DET_ELEVATION_269_oRDR_DETECTION_269_272_oPCAN_RADAR_e05a1946_Tx: ComSignalType=UINT8
            DET_ELEVATION_270_oRDR_DETECTION_269_272_oPCAN_RADAR_857a6be2_Tx: ComSignalType=UINT8
            DET_ELEVATION_271_oRDR_DETECTION_269_272_oPCAN_RADAR_100abf77_Tx: ComSignalType=UINT8
            DET_ELEVATION_272_oRDR_DETECTION_269_272_oPCAN_RADAR_74eac489_Tx: ComSignalType=UINT8
            DET_ELEVATION_ERR_269_oRDR_DETECTION_269_272_oPCAN_RADAR_67638133_Tx: ComSignalType=UINT8
            DET_ELEVATION_ERR_270_oRDR_DETECTION_269_272_oPCAN_RADAR_0243f397_Tx: ComSignalType=UINT8
            DET_ELEVATION_ERR_271_oRDR_DETECTION_269_272_oPCAN_RADAR_97332702_Tx: ComSignalType=UINT8
            DET_ELEVATION_ERR_272_oRDR_DETECTION_269_272_oPCAN_RADAR_f3d35cfc_Tx: ComSignalType=UINT8
            DET_EXISTENCE_PROB_269_oRDR_DETECTION_269_272_oPCAN_RADAR_b5fcf453_Tx: ComSignalType=UINT8
            DET_EXISTENCE_PROB_270_oRDR_DETECTION_269_272_oPCAN_RADAR_d0dc86f7_Tx: ComSignalType=UINT8
            DET_EXISTENCE_PROB_271_oRDR_DETECTION_269_272_oPCAN_RADAR_45ac5262_Tx: ComSignalType=UINT8
            DET_EXISTENCE_PROB_272_oRDR_DETECTION_269_272_oPCAN_RADAR_214c299c_Tx: ComSignalType=UINT8
            DET_HVC_FLAG_269_oRDR_DETECTION_269_272_oPCAN_RADAR_5488b72c_Tx: ComSignalType=BOOLEAN
            DET_HVC_FLAG_270_oRDR_DETECTION_269_272_oPCAN_RADAR_31a8c588_Tx: ComSignalType=BOOLEAN
            DET_HVC_FLAG_271_oRDR_DETECTION_269_272_oPCAN_RADAR_a4d8111d_Tx: ComSignalType=BOOLEAN
            DET_HVC_FLAG_272_oRDR_DETECTION_269_272_oPCAN_RADAR_c0386ae3_Tx: ComSignalType=BOOLEAN
            DET_IDM_269_oRDR_DETECTION_269_272_oPCAN_RADAR_dfda8c91_Tx: ComSignalType=UINT8
            DET_IDM_270_oRDR_DETECTION_269_272_oPCAN_RADAR_bafafe35_Tx: ComSignalType=UINT8
            DET_IDM_271_oRDR_DETECTION_269_272_oPCAN_RADAR_2f8a2aa0_Tx: ComSignalType=UINT8
            DET_IDM_272_oRDR_DETECTION_269_272_oPCAN_RADAR_4b6a515e_Tx: ComSignalType=UINT8
            DET_MH_CRC16_269_272_oRDR_DETECTION_269_272_oPCAN_RADAR_69b7f209_Tx: ComSignalType=UINT16
            DET_MH_CYCLE_COUNTER_269_272_oRDR_DETECTION_269_272_oPCAN_RADAR_edc2533e_Tx: ComSignalType=UINT8
            DET_MH_SCAN_INDEX_4LSB_269_272_oRDR_DETECTION_269_272_oPCAN_RADAR_21e876b2_Tx: ComSignalType=UINT8
            DET_MTD_269_oRDR_DETECTION_269_272_oPCAN_RADAR_b969be4a_Tx: ComSignalType=UINT8
            DET_MTD_270_oRDR_DETECTION_269_272_oPCAN_RADAR_dc49ccee_Tx: ComSignalType=UINT8
            DET_MTD_271_oRDR_DETECTION_269_272_oPCAN_RADAR_4939187b_Tx: ComSignalType=UINT8
            DET_MTD_272_oRDR_DETECTION_269_272_oPCAN_RADAR_2dd96385_Tx: ComSignalType=UINT8
            DET_PROB_1STAZHYPO_269_oRDR_DETECTION_269_272_oPCAN_RADAR_2add5687_Tx: ComSignalType=BOOLEAN
            DET_PROB_1STAZHYPO_270_oRDR_DETECTION_269_272_oPCAN_RADAR_4ffd2423_Tx: ComSignalType=BOOLEAN
            DET_PROB_1STAZHYPO_271_oRDR_DETECTION_269_272_oPCAN_RADAR_da8df0b6_Tx: ComSignalType=BOOLEAN
            DET_PROB_1STAZHYPO_272_oRDR_DETECTION_269_272_oPCAN_RADAR_be6d8b48_Tx: ComSignalType=BOOLEAN
            DET_RANGE_269_oRDR_DETECTION_269_272_oPCAN_RADAR_2172b5f1_Tx: ComSignalType=UINT16
            DET_RANGE_270_oRDR_DETECTION_269_272_oPCAN_RADAR_4452c755_Tx: ComSignalType=UINT16
            DET_RANGE_271_oRDR_DETECTION_269_272_oPCAN_RADAR_d12213c0_Tx: ComSignalType=UINT16
            DET_RANGE_272_oRDR_DETECTION_269_272_oPCAN_RADAR_b5c2683e_Tx: ComSignalType=UINT16
            DET_RANGE_ERR_269_oRDR_DETECTION_269_272_oPCAN_RADAR_869a0f98_Tx: ComSignalType=UINT8
            DET_RANGE_ERR_270_oRDR_DETECTION_269_272_oPCAN_RADAR_e3ba7d3c_Tx: ComSignalType=UINT8
            DET_RANGE_ERR_271_oRDR_DETECTION_269_272_oPCAN_RADAR_76caa9a9_Tx: ComSignalType=UINT8
            DET_RANGE_ERR_272_oRDR_DETECTION_269_272_oPCAN_RADAR_122ad257_Tx: ComSignalType=UINT8
            DET_RANGE_VELOCITY_269_oRDR_DETECTION_269_272_oPCAN_RADAR_54d477d4_Tx: ComSignalType=UINT16
            DET_RANGE_VELOCITY_270_oRDR_DETECTION_269_272_oPCAN_RADAR_31f40570_Tx: ComSignalType=UINT16
            DET_RANGE_VELOCITY_271_oRDR_DETECTION_269_272_oPCAN_RADAR_a484d1e5_Tx: ComSignalType=UINT16
            DET_RANGE_VELOCITY_272_oRDR_DETECTION_269_272_oPCAN_RADAR_c064aa1b_Tx: ComSignalType=UINT16
            DET_RANGE_VELOCITY_ERR_269_oRDR_DETECTION_269_272_oPCAN_RADAR_5b6f8c66_Tx: ComSignalType=UINT8
            DET_RANGE_VELOCITY_ERR_270_oRDR_DETECTION_269_272_oPCAN_RADAR_3e4ffec2_Tx: ComSignalType=UINT8
            DET_RANGE_VELOCITY_ERR_271_oRDR_DETECTION_269_272_oPCAN_RADAR_ab3f2a57_Tx: ComSignalType=UINT8
            DET_RANGE_VELOCITY_ERR_272_oRDR_DETECTION_269_272_oPCAN_RADAR_cfdf51a9_Tx: ComSignalType=UINT8
            DET_RCS_269_oRDR_DETECTION_269_272_oPCAN_RADAR_d354408e_Tx: ComSignalType=UINT8
            DET_RCS_270_oRDR_DETECTION_269_272_oPCAN_RADAR_b674322a_Tx: ComSignalType=UINT8
            DET_RCS_271_oRDR_DETECTION_269_272_oPCAN_RADAR_2304e6bf_Tx: ComSignalType=UINT8
            DET_RCS_272_oRDR_DETECTION_269_272_oPCAN_RADAR_47e49d41_Tx: ComSignalType=UINT8
            DET_SNR_269_oRDR_DETECTION_269_272_oPCAN_RADAR_0efa148c_Tx: ComSignalType=UINT8
            DET_SNR_270_oRDR_DETECTION_269_272_oPCAN_RADAR_6bda6628_Tx: ComSignalType=UINT8
            DET_SNR_271_oRDR_DETECTION_269_272_oPCAN_RADAR_feaab2bd_Tx: ComSignalType=UINT8
            DET_SNR_272_oRDR_DETECTION_269_272_oPCAN_RADAR_9a4ac943_Tx: ComSignalType=UINT8
            DET_SUPER_RES_TARGET_269_oRDR_DETECTION_269_272_oPCAN_RADAR_3f633ce9_Tx: ComSignalType=BOOLEAN
            DET_SUPER_RES_TARGET_270_oRDR_DETECTION_269_272_oPCAN_RADAR_5a434e4d_Tx: ComSignalType=BOOLEAN
            DET_SUPER_RES_TARGET_271_oRDR_DETECTION_269_272_oPCAN_RADAR_cf339ad8_Tx: ComSignalType=BOOLEAN
            DET_SUPER_RES_TARGET_272_oRDR_DETECTION_269_272_oPCAN_RADAR_abd3e126_Tx: ComSignalType=BOOLEAN
