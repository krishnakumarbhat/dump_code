[part 6 of 8: package /DaVinci_Project]
AUTOSAR XML (schema 4-0-3)
package /DaVinci_Project  (continued)
  module config Com  (continued)
    ComConfig  (continued)
      239 x ComSignalGroup:  (continued)
        SG_Fusion_Detections_049_052_oRDR_FUSION_DET_049_052_oPCAN_RADAR_25715fa9_Rx
          83 x ComGroupSignal:
            DET_AZIMUTH_049_Rx_oRDR_FUSION_DET_049_052_oPCAN_RADAR_fca25dc0_Rx: ComSignalType=UINT16
            DET_AZIMUTH_050_Rx_oRDR_FUSION_DET_049_052_oPCAN_RADAR_c182ded9_Rx: ComSignalType=UINT16
            DET_AZIMUTH_051_Rx_oRDR_FUSION_DET_049_052_oPCAN_RADAR_6ec64c9e_Rx: ComSignalType=UINT16
            DET_AZIMUTH_052_Rx_oRDR_FUSION_DET_049_052_oPCAN_RADAR_447afc16_Rx: ComSignalType=UINT16
            DET_AZIMUTH_ERR_049_Rx_oRDR_FUSION_DET_049_052_oPCAN_RADAR_fecbfc42_Rx: ComSignalType=UINT8
            DET_AZIMUTH_ERR_050_Rx_oRDR_FUSION_DET_049_052_oPCAN_RADAR_c3eb7f5b_Rx: ComSignalType=UINT8
            DET_AZIMUTH_ERR_051_Rx_oRDR_FUSION_DET_049_052_oPCAN_RADAR_6cafed1c_Rx: ComSignalType=UINT8
            DET_AZIMUTH_ERR_052_Rx_oRDR_FUSION_DET_049_052_oPCAN_RADAR_46135d94_Rx: ComSignalType=UINT8
            DET_BELOW_RAIN_THOLD_049_Rx_oRDR_FUSION_DET_049_052_oPCAN_RADAR_9a18a275_Rx: ComSignalType=BOOLEAN
            DET_BELOW_RAIN_THOLD_050_Rx_oRDR_FUSION_DET_049_052_oPCAN_RADAR_a738216c_Rx: ComSignalType=BOOLEAN
            DET_BELOW_RAIN_THOLD_051_Rx_oRDR_FUSION_DET_049_052_oPCAN_RADAR_087cb32b_Rx: ComSignalType=BOOLEAN
            DET_BELOW_RAIN_THOLD_052_Rx_oRDR_FUSION_DET_049_052_oPCAN_RADAR_22c003a3_Rx: ComSignalType=BOOLEAN
            DET_BI_STATIC_FLAG_049_Rx_oRDR_FUSION_DET_049_052_oPCAN_RADAR_ed860966_Rx: ComSignalType=BOOLEAN
            DET_BI_STATIC_FLAG_050_Rx_oRDR_FUSION_DET_049_052_oPCAN_RADAR_d0a68a7f_Rx: ComSignalType=BOOLEAN
            DET_BI_STATIC_FLAG_051_Rx_oRDR_FUSION_DET_049_052_oPCAN_RADAR_7fe21838_Rx: ComSignalType=BOOLEAN
            DET_BI_STATIC_FLAG_052_Rx_oRDR_FUSION_DET_049_052_oPCAN_RADAR_555ea8b0_Rx: ComSignalType=BOOLEAN
            DET_CONFD_AZIMUTH_049_Rx_oRDR_FUSION_DET_049_052_oPCAN_RADAR_0eefe332_Rx: ComSignalType=UINT8
            DET_CONFD_AZIMUTH_050_Rx_oRDR_FUSION_DET_049_052_oPCAN_RADAR_33cf602b_Rx: ComSignalType=UINT8
            DET_CONFD_AZIMUTH_051_Rx_oRDR_FUSION_DET_049_052_oPCAN_RADAR_9c8bf26c_Rx: ComSignalType=UINT8
            DET_CONFD_AZIMUTH_052_Rx_oRDR_FUSION_DET_049_052_oPCAN_RADAR_b63742e4_Rx: ComSignalType=UINT8
            DET_CONFD_ELEVATION_049_Rx_oRDR_FUSION_DET_049_052_oPCAN_RADAR_04ce60b5_Rx: ComSignalType=UINT8
            DET_CONFD_ELEVATION_050_Rx_oRDR_FUSION_DET_049_052_oPCAN_RADAR_39eee3ac_Rx: ComSignalType=UINT8
            DET_CONFD_ELEVATION_051_Rx_oRDR_FUSION_DET_049_052_oPCAN_RADAR_96aa71eb_Rx: ComSignalType=UINT8
            DET_CONFD_ELEVATION_052_Rx_oRDR_FUSION_DET_049_052_oPCAN_RADAR_bc16c163_Rx: ComSignalType=UINT8
            DET_ELEVATION_049_Rx_oRDR_FUSION_DET_049_052_oPCAN_RADAR_0e9d8f4c_Rx: ComSignalType=UINT8
            DET_ELEVATION_050_Rx_oRDR_FUSION_DET_049_052_oPCAN_RADAR_33bd0c55_Rx: ComSignalType=UINT8
            DET_ELEVATION_051_Rx_oRDR_FUSION_DET_049_052_oPCAN_RADAR_9cf99e12_Rx: ComSignalType=UINT8
            DET_ELEVATION_052_Rx_oRDR_FUSION_DET_049_052_oPCAN_RADAR_b6452e9a_Rx: ComSignalType=UINT8
            DET_ELEVATION_ERR_049_Rx_oRDR_FUSION_DET_049_052_oPCAN_RADAR_dc24ad93_Rx: ComSignalType=UINT8
            DET_ELEVATION_ERR_050_Rx_oRDR_FUSION_DET_049_052_oPCAN_RADAR_e1042e8a_Rx: ComSignalType=UINT8
            DET_ELEVATION_ERR_051_Rx_oRDR_FUSION_DET_049_052_oPCAN_RADAR_4e40bccd_Rx: ComSignalType=UINT8
            DET_ELEVATION_ERR_052_Rx_oRDR_FUSION_DET_049_052_oPCAN_RADAR_64fc0c45_Rx: ComSignalType=UINT8
            DET_EXISTENCE_PROB_049_Rx_oRDR_FUSION_DET_049_052_oPCAN_RADAR_2b3cd506_Rx: ComSignalType=UINT8
            DET_EXISTENCE_PROB_050_Rx_oRDR_FUSION_DET_049_052_oPCAN_RADAR_161c561f_Rx: ComSignalType=UINT8
            DET_EXISTENCE_PROB_051_Rx_oRDR_FUSION_DET_049_052_oPCAN_RADAR_b958c458_Rx: ComSignalType=UINT8
            DET_EXISTENCE_PROB_052_Rx_oRDR_FUSION_DET_049_052_oPCAN_RADAR_93e474d0_Rx: ComSignalType=UINT8
            DET_HVC_FLAG_049_Rx_oRDR_FUSION_DET_049_052_oPCAN_RADAR_f6e23849_Rx: ComSignalType=BOOLEAN
            DET_HVC_FLAG_050_Rx_oRDR_FUSION_DET_049_052_oPCAN_RADAR_cbc2bb50_Rx: ComSignalType=BOOLEAN
            DET_HVC_FLAG_051_Rx_oRDR_FUSION_DET_049_052_oPCAN_RADAR_64862917_Rx: ComSignalType=BOOLEAN
            DET_HVC_FLAG_052_Rx_oRDR_FUSION_DET_049_052_oPCAN_RADAR_4e3a999f_Rx: ComSignalType=BOOLEAN
            DET_IDM_049_Rx_oRDR_FUSION_DET_049_052_oPCAN_RADAR_c323c101_Rx: ComSignalType=BOOLEAN
            DET_IDM_050_Rx_oRDR_FUSION_DET_049_052_oPCAN_RADAR_fe034218_Rx: ComSignalType=BOOLEAN
            DET_IDM_051_Rx_oRDR_FUSION_DET_049_052_oPCAN_RADAR_5147d05f_Rx: ComSignalType=BOOLEAN
            DET_IDM_052_Rx_oRDR_FUSION_DET_049_052_oPCAN_RADAR_7bfb60d7_Rx: ComSignalType=BOOLEAN
            DET_MH_CRC16_049_052_Rx_oRDR_FUSION_DET_049_052_oPCAN_RADAR_74272fbc_Rx: ComSignalType=UINT16
            DET_MH_CYCLE_COUNTER_049_052_Rx_oRDR_FUSION_DET_049_052_oPCAN_RADAR_79fc1279_Rx: ComSignalType=UINT8
            DET_MH_SCAN_INDEX_4LSB_049_052_Rx_oRDR_FUSION_DET_049_052_oPCAN_RADAR_1d4cdd42_Rx: ComSignalType=UINT8
            DET_MTD_049_Rx_oRDR_FUSION_DET_049_052_oPCAN_RADAR_7ea0f771_Rx: ComSignalType=BOOLEAN
            DET_MTD_050_Rx_oRDR_FUSION_DET_049_052_oPCAN_RADAR_43807468_Rx: ComSignalType=BOOLEAN
            DET_MTD_051_Rx_oRDR_FUSION_DET_049_052_oPCAN_RADAR_ecc4e62f_Rx: ComSignalType=BOOLEAN
            DET_MTD_052_Rx_oRDR_FUSION_DET_049_052_oPCAN_RADAR_c67856a7_Rx: ComSignalType=BOOLEAN
            DET_PROB_1STAZHYPO_049_Rx_oRDR_FUSION_DET_049_052_oPCAN_RADAR_b4d9e9f0_Rx: ComSignalType=BOOLEAN
            DET_PROB_1STAZHYPO_050_Rx_oRDR_FUSION_DET_049_052_oPCAN_RADAR_89f96ae9_Rx: ComSignalType=BOOLEAN
            DET_PROB_1STAZHYPO_051_Rx_oRDR_FUSION_DET_049_052_oPCAN_RADAR_26bdf8ae_Rx: ComSignalType=BOOLEAN
            DET_PROB_1STAZHYPO_052_Rx_oRDR_FUSION_DET_049_052_oPCAN_RADAR_0c014826_Rx: ComSignalType=BOOLEAN
            DET_RANGE_049_Rx_oRDR_FUSION_DET_049_052_oPCAN_RADAR_ef6401e7_Rx: ComSignalType=UINT16
            DET_RANGE_050_Rx_oRDR_FUSION_DET_049_052_oPCAN_RADAR_d24482fe_Rx: ComSignalType=UINT16
            DET_RANGE_051_Rx_oRDR_FUSION_DET_049_052_oPCAN_RADAR_7d0010b9_Rx: ComSignalType=UINT16
            DET_RANGE_052_Rx_oRDR_FUSION_DET_049_052_oPCAN_RADAR_57bca031_Rx: ComSignalType=UINT16
            DET_RANGE_ERR_049_Rx_oRDR_FUSION_DET_049_052_oPCAN_RADAR_bf968d07_Rx: ComSignalType=UINT8
            DET_RANGE_ERR_050_Rx_oRDR_FUSION_DET_049_052_oPCAN_RADAR_82b60e1e_Rx: ComSignalType=UINT8
            DET_RANGE_ERR_051_Rx_oRDR_FUSION_DET_049_052_oPCAN_RADAR_2df29c59_Rx: ComSignalType=UINT8
            DET_RANGE_ERR_052_Rx_oRDR_FUSION_DET_049_052_oPCAN_RADAR_074e2cd1_Rx: ComSignalType=UINT8
            DET_RANGE_VELOCITY_049_Rx_oRDR_FUSION_DET_049_052_oPCAN_RADAR_32918219_Rx: ComSignalType=UINT16
            DET_RANGE_VELOCITY_050_Rx_oRDR_FUSION_DET_049_052_oPCAN_RADAR_0fb10100_Rx: ComSignalType=UINT16
            DET_RANGE_VELOCITY_051_Rx_oRDR_FUSION_DET_049_052_oPCAN_RADAR_a0f59347_Rx: ComSignalType=UINT16
            DET_RANGE_VELOCITY_052_Rx_oRDR_FUSION_DET_049_052_oPCAN_RADAR_8a4923cf_Rx: ComSignalType=UINT16
            DET_RANGE_VELOCITY_ERR_049_Rx_oRDR_FUSION_DET_049_052_oPCAN_RADAR_abf5f2db_Rx: ComSignalType=UINT8
            DET_RANGE_VELOCITY_ERR_050_Rx_oRDR_FUSION_DET_049_052_oPCAN_RADAR_96d571c2_Rx: ComSignalType=UINT8
            DET_RANGE_VELOCITY_ERR_051_Rx_oRDR_FUSION_DET_049_052_oPCAN_RADAR_3991e385_Rx: ComSignalType=UINT8
            DET_RANGE_VELOCITY_ERR_052_Rx_oRDR_FUSION_DET_049_052_oPCAN_RADAR_132d530d_Rx: ComSignalType=UINT8
            DET_RCS_049_Rx_oRDR_FUSION_DET_049_052_oPCAN_RADAR_ff5a1002_Rx: ComSignalType=UINT8
            DET_RCS_050_Rx_oRDR_FUSION_DET_049_052_oPCAN_RADAR_c27a931b_Rx: ComSignalType=UINT8
            DET_RCS_051_Rx_oRDR_FUSION_DET_049_052_oPCAN_RADAR_6d3e015c_Rx: ComSignalType=UINT8
            DET_RCS_052_Rx_oRDR_FUSION_DET_049_052_oPCAN_RADAR_4782b1d4_Rx: ComSignalType=UINT8
            DET_SNR_049_Rx_oRDR_FUSION_DET_049_052_oPCAN_RADAR_f60061eb_Rx: ComSignalType=UINT8
            DET_SNR_050_Rx_oRDR_FUSION_DET_049_052_oPCAN_RADAR_cb20e2f2_Rx: ComSignalType=UINT8
            DET_SNR_051_Rx_oRDR_FUSION_DET_049_052_oPCAN_RADAR_646470b5_Rx: ComSignalType=UINT8
            DET_SNR_052_Rx_oRDR_FUSION_DET_049_052_oPCAN_RADAR_4ed8c03d_Rx: ComSignalType=UINT8
            DET_SUPER_RES_TARGET_049_Rx_oRDR_FUSION_DET_049_052_oPCAN_RADAR_3dfb40eb_Rx: ComSignalType=BOOLEAN
            DET_SUPER_RES_TARGET_050_Rx_oRDR_FUSION_DET_049_052_oPCAN_RADAR_00dbc3f2_Rx: ComSignalType=BOOLEAN
            DET_SUPER_RES_TARGET_051_Rx_oRDR_FUSION_DET_049_052_oPCAN_RADAR_af9f51b5_Rx: ComSignalType=BOOLEAN
            DET_SUPER_RES_TARGET_052_Rx_oRDR_FUSION_DET_049_052_oPCAN_RADAR_8523e13d_Rx: ComSignalType=BOOLEAN
        SG_Fusion_Detections_053_056_oRDR_FUSION_DET_053_056_oPCAN_RADAR_d1fa35d9_Rx
          83 x ComGroupSignal:
            DET_AZIMUTH_053_Rx_oRDR_FUSION_DET_053_056_oPCAN_RADAR_f6f96d7f_Rx: ComSignalType=UINT16
            DET_AZIMUTH_054_Rx_oRDR_FUSION_DET_053_056_oPCAN_RADAR_0cc49e28_Rx: ComSignalType=UINT16
            DET_AZIMUTH_055_Rx_oRDR_FUSION_DET_053_056_oPCAN_RADAR_a3800c6f_Rx: ComSignalType=UINT16
            DET_AZIMUTH_056_Rx_oRDR_FUSION_DET_053_056_oPCAN_RADAR_893cbce7_Rx: ComSignalType=UINT16
            DET_AZIMUTH_ERR_053_Rx_oRDR_FUSION_DET_053_056_oPCAN_RADAR_f490ccfd_Rx: ComSignalType=UINT8
            DET_AZIMUTH_ERR_054_Rx_oRDR_FUSION_DET_053_056_oPCAN_RADAR_0ead3faa_Rx: ComSignalType=UINT8
            DET_AZIMUTH_ERR_055_Rx_oRDR_FUSION_DET_053_056_oPCAN_RADAR_a1e9aded_Rx: ComSignalType=UINT8
            DET_AZIMUTH_ERR_056_Rx_oRDR_FUSION_DET_053_056_oPCAN_RADAR_8b551d65_Rx: ComSignalType=UINT8
            DET_BELOW_RAIN_THOLD_053_Rx_oRDR_FUSION_DET_053_056_oPCAN_RADAR_904392ca_Rx: ComSignalType=BOOLEAN
            DET_BELOW_RAIN_THOLD_054_Rx_oRDR_FUSION_DET_053_056_oPCAN_RADAR_6a7e619d_Rx: ComSignalType=BOOLEAN
            DET_BELOW_RAIN_THOLD_055_Rx_oRDR_FUSION_DET_053_056_oPCAN_RADAR_c53af3da_Rx: ComSignalType=BOOLEAN
            DET_BELOW_RAIN_THOLD_056_Rx_oRDR_FUSION_DET_053_056_oPCAN_RADAR_ef864352_Rx: ComSignalType=BOOLEAN
            DET_BI_STATIC_FLAG_053_Rx_oRDR_FUSION_DET_053_056_oPCAN_RADAR_e7dd39d9_Rx: ComSignalType=BOOLEAN
            DET_BI_STATIC_FLAG_054_Rx_oRDR_FUSION_DET_053_056_oPCAN_RADAR_1de0ca8e_Rx: ComSignalType=BOOLEAN
            DET_BI_STATIC_FLAG_055_Rx_oRDR_FUSION_DET_053_056_oPCAN_RADAR_b2a458c9_Rx: ComSignalType=BOOLEAN
            DET_BI_STATIC_FLAG_056_Rx_oRDR_FUSION_DET_053_056_oPCAN_RADAR_9818e841_Rx: ComSignalType=BOOLEAN
            DET_CONFD_AZIMUTH_053_Rx_oRDR_FUSION_DET_053_056_oPCAN_RADAR_04b4d38d_Rx: ComSignalType=UINT8
            DET_CONFD_AZIMUTH_054_Rx_oRDR_FUSION_DET_053_056_oPCAN_RADAR_fe8920da_Rx: ComSignalType=UINT8
            DET_CONFD_AZIMUTH_055_Rx_oRDR_FUSION_DET_053_056_oPCAN_RADAR_51cdb29d_Rx: ComSignalType=UINT8
            DET_CONFD_AZIMUTH_056_Rx_oRDR_FUSION_DET_053_056_oPCAN_RADAR_7b710215_Rx: ComSignalType=UINT8
            DET_CONFD_ELEVATION_053_Rx_oRDR_FUSION_DET_053_056_oPCAN_RADAR_0e95500a_Rx: ComSignalType=UINT8
            DET_CONFD_ELEVATION_054_Rx_oRDR_FUSION_DET_053_056_oPCAN_RADAR_f4a8a35d_Rx: ComSignalType=UINT8
            DET_CONFD_ELEVATION_055_Rx_oRDR_FUSION_DET_053_056_oPCAN_RADAR_5bec311a_Rx: ComSignalType=UINT8
            DET_CONFD_ELEVATION_056_Rx_oRDR_FUSION_DET_053_056_oPCAN_RADAR_71508192_Rx: ComSignalType=UINT8
            DET_ELEVATION_053_Rx_oRDR_FUSION_DET_053_056_oPCAN_RADAR_04c6bff3_Rx: ComSignalType=UINT8
            DET_ELEVATION_054_Rx_oRDR_FUSION_DET_053_056_oPCAN_RADAR_fefb4ca4_Rx: ComSignalType=UINT8
            DET_ELEVATION_055_Rx_oRDR_FUSION_DET_053_056_oPCAN_RADAR_51bfdee3_Rx: ComSignalType=UINT8
            DET_ELEVATION_056_Rx_oRDR_FUSION_DET_053_056_oPCAN_RADAR_7b036e6b_Rx: ComSignalType=UINT8
            DET_ELEVATION_ERR_053_Rx_oRDR_FUSION_DET_053_056_oPCAN_RADAR_d67f9d2c_Rx: ComSignalType=UINT8
            DET_ELEVATION_ERR_054_Rx_oRDR_FUSION_DET_053_056_oPCAN_RADAR_2c426e7b_Rx: ComSignalType=UINT8
            DET_ELEVATION_ERR_055_Rx_oRDR_FUSION_DET_053_056_oPCAN_RADAR_8306fc3c_Rx: ComSignalType=UINT8
            DET_ELEVATION_ERR_056_Rx_oRDR_FUSION_DET_053_056_oPCAN_RADAR_a9ba4cb4_Rx: ComSignalType=UINT8
            DET_EXISTENCE_PROB_053_Rx_oRDR_FUSION_DET_053_056_oPCAN_RADAR_2167e5b9_Rx: ComSignalType=UINT8
            DET_EXISTENCE_PROB_054_Rx_oRDR_FUSION_DET_053_056_oPCAN_RADAR_db5a16ee_Rx: ComSignalType=UINT8
            DET_EXISTENCE_PROB_055_Rx_oRDR_FUSION_DET_053_056_oPCAN_RADAR_741e84a9_Rx: ComSignalType=UINT8
            DET_EXISTENCE_PROB_056_Rx_oRDR_FUSION_DET_053_056_oPCAN_RADAR_5ea23421_Rx: ComSignalType=UINT8
            DET_HVC_FLAG_053_Rx_oRDR_FUSION_DET_053_056_oPCAN_RADAR_fcb908f6_Rx: ComSignalType=BOOLEAN
            DET_HVC_FLAG_054_Rx_oRDR_FUSION_DET_053_056_oPCAN_RADAR_0684fba1_Rx: ComSignalType=BOOLEAN
            DET_HVC_FLAG_055_Rx_oRDR_FUSION_DET_053_056_oPCAN_RADAR_a9c069e6_Rx: ComSignalType=BOOLEAN
            DET_HVC_FLAG_056_Rx_oRDR_FUSION_DET_053_056_oPCAN_RADAR_837cd96e_Rx: ComSignalType=BOOLEAN
            DET_IDM_053_Rx_oRDR_FUSION_DET_053_056_oPCAN_RADAR_c978f1be_Rx: ComSignalType=BOOLEAN
            DET_IDM_054_Rx_oRDR_FUSION_DET_053_056_oPCAN_RADAR_334502e9_Rx: ComSignalType=BOOLEAN
            DET_IDM_055_Rx_oRDR_FUSION_DET_053_056_oPCAN_RADAR_9c0190ae_Rx: ComSignalType=BOOLEAN
            DET_IDM_056_Rx_oRDR_FUSION_DET_053_056_oPCAN_RADAR_b6bd2026_Rx: ComSignalType=BOOLEAN
            DET_MH_CRC16_053_056_Rx_oRDR_FUSION_DET_053_056_oPCAN_RADAR_c497f294_Rx: ComSignalType=UINT16
            DET_MH_CYCLE_COUNTER_053_056_Rx_oRDR_FUSION_DET_053_056_oPCAN_RADAR_c94ccf51_Rx: ComSignalType=UINT8
            DET_MH_SCAN_INDEX_4LSB_053_056_Rx_oRDR_FUSION_DET_053_056_oPCAN_RADAR_adfc006a_Rx: ComSignalType=UINT8
            DET_MTD_053_Rx_oRDR_FUSION_DET_053_056_oPCAN_RADAR_74fbc7ce_Rx: ComSignalType=BOOLEAN
            DET_MTD_054_Rx_oRDR_FUSION_DET_053_056_oPCAN_RADAR_8ec63499_Rx: ComSignalType=BOOLEAN
            DET_MTD_055_Rx_oRDR_FUSION_DET_053_056_oPCAN_RADAR_2182a6de_Rx: ComSignalType=BOOLEAN
            DET_MTD_056_Rx_oRDR_FUSION_DET_053_056_oPCAN_RADAR_0b3e1656_Rx: ComSignalType=BOOLEAN
            DET_PROB_1STAZHYPO_053_Rx_oRDR_FUSION_DET_053_056_oPCAN_RADAR_be82d94f_Rx: ComSignalType=BOOLEAN
            DET_PROB_1STAZHYPO_054_Rx_oRDR_FUSION_DET_053_056_oPCAN_RADAR_44bf2a18_Rx: ComSignalType=BOOLEAN
            DET_PROB_1STAZHYPO_055_Rx_oRDR_FUSION_DET_053_056_oPCAN_RADAR_ebfbb85f_Rx: ComSignalType=BOOLEAN
            DET_PROB_1STAZHYPO_056_Rx_oRDR_FUSION_DET_053_056_oPCAN_RADAR_c14708d7_Rx: ComSignalType=BOOLEAN
            DET_RANGE_053_Rx_oRDR_FUSION_DET_053_056_oPCAN_RADAR_e53f3158_Rx: ComSignalType=UINT16
            DET_RANGE_054_Rx_oRDR_FUSION_DET_053_056_oPCAN_RADAR_1f02c20f_Rx: ComSignalType=UINT16
            DET_RANGE_055_Rx_oRDR_FUSION_DET_053_056_oPCAN_RADAR_b0465048_Rx: ComSignalType=UINT16
            DET_RANGE_056_Rx_oRDR_FUSION_DET_053_056_oPCAN_RADAR_9afae0c0_Rx: ComSignalType=UINT16
            DET_RANGE_ERR_053_Rx_oRDR_FUSION_DET_053_056_oPCAN_RADAR_b5cdbdb8_Rx: ComSignalType=UINT8
            DET_RANGE_ERR_054_Rx_oRDR_FUSION_DET_053_056_oPCAN_RADAR_4ff04eef_Rx: ComSignalType=UINT8
            DET_RANGE_ERR_055_Rx_oRDR_FUSION_DET_053_056_oPCAN_RADAR_e0b4dca8_Rx: ComSignalType=UINT8
            DET_RANGE_ERR_056_Rx_oRDR_FUSION_DET_053_056_oPCAN_RADAR_ca086c20_Rx: ComSignalType=UINT8
            DET_RANGE_VELOCITY_053_Rx_oRDR_FUSION_DET_053_056_oPCAN_RADAR_38cab2a6_Rx: ComSignalType=UINT16
            DET_RANGE_VELOCITY_054_Rx_oRDR_FUSION_DET_053_056_oPCAN_RADAR_c2f741f1_Rx: ComSignalType=UINT16
            DET_RANGE_VELOCITY_055_Rx_oRDR_FUSION_DET_053_056_oPCAN_RADAR_6db3d3b6_Rx: ComSignalType=UINT16
            DET_RANGE_VELOCITY_056_Rx_oRDR_FUSION_DET_053_056_oPCAN_RADAR_470f633e_Rx: ComSignalType=UINT16
            DET_RANGE_VELOCITY_ERR_053_Rx_oRDR_FUSION_DET_053_056_oPCAN_RADAR_a1aec264_Rx: ComSignalType=UINT8
            DET_RANGE_VELOCITY_ERR_054_Rx_oRDR_FUSION_DET_053_056_oPCAN_RADAR_5b933133_Rx: ComSignalType=UINT8
            DET_RANGE_VELOCITY_ERR_055_Rx_oRDR_FUSION_DET_053_056_oPCAN_RADAR_f4d7a374_Rx: ComSignalType=UINT8
            DET_RANGE_VELOCITY_ERR_056_Rx_oRDR_FUSION_DET_053_056_oPCAN_RADAR_de6b13fc_Rx: ComSignalType=UINT8
            DET_RCS_053_Rx_oRDR_FUSION_DET_053_056_oPCAN_RADAR_f50120bd_Rx: ComSignalType=UINT8
            DET_RCS_054_Rx_oRDR_FUSION_DET_053_056_oPCAN_RADAR_0f3cd3ea_Rx: ComSignalType=UINT8
            DET_RCS_055_Rx_oRDR_FUSION_DET_053_056_oPCAN_RADAR_a07841ad_Rx: ComSignalType=UINT8
            DET_RCS_056_Rx_oRDR_FUSION_DET_053_056_oPCAN_RADAR_8ac4f125_Rx: ComSignalType=UINT8
            DET_SNR_053_Rx_oRDR_FUSION_DET_053_056_oPCAN_RADAR_fc5b5154_Rx: ComSignalType=UINT8
            DET_SNR_054_Rx_oRDR_FUSION_DET_053_056_oPCAN_RADAR_0666a203_Rx: ComSignalType=UINT8
            DET_SNR_055_Rx_oRDR_FUSION_DET_053_056_oPCAN_RADAR_a9223044_Rx: ComSignalType=UINT8
            DET_SNR_056_Rx_oRDR_FUSION_DET_053_056_oPCAN_RADAR_839e80cc_Rx: ComSignalType=UINT8
            DET_SUPER_RES_TARGET_053_Rx_oRDR_FUSION_DET_053_056_oPCAN_RADAR_37a07054_Rx: ComSignalType=BOOLEAN
            DET_SUPER_RES_TARGET_054_Rx_oRDR_FUSION_DET_053_056_oPCAN_RADAR_cd9d8303_Rx: ComSignalType=BOOLEAN
            DET_SUPER_RES_TARGET_055_Rx_oRDR_FUSION_DET_053_056_oPCAN_RADAR_62d91144_Rx: ComSignalType=BOOLEAN
            DET_SUPER_RES_TARGET_056_Rx_oRDR_FUSION_DET_053_056_oPCAN_RADAR_4865a1cc_Rx: ComSignalType=BOOLEAN
        SG_Fusion_Detections_057_060_oRDR_FUSION_DET_057_060_oPCAN_RADAR_91e0d8b1_Rx
          83 x ComGroupSignal:
            DET_AZIMUTH_057_Rx_oRDR_FUSION_DET_057_060_oPCAN_RADAR_89f4f369_Rx: ComSignalType=UINT16
            DET_AZIMUTH_058_Rx_oRDR_FUSION_DET_057_060_oPCAN_RADAR_09ba81c1_Rx: ComSignalType=UINT16
            DET_AZIMUTH_059_Rx_oRDR_FUSION_DET_057_060_oPCAN_RADAR_a6fe1386_Rx: ComSignalType=UINT16
            DET_AZIMUTH_060_Rx_oRDR_FUSION_DET_057_060_oPCAN_RADAR_9080b79c_Rx: ComSignalType=UINT16
            DET_AZIMUTH_ERR_057_Rx_oRDR_FUSION_DET_057_060_oPCAN_RADAR_8b9d52eb_Rx: ComSignalType=UINT8
            DET_AZIMUTH_ERR_058_Rx_oRDR_FUSION_DET_057_060_oPCAN_RADAR_0bd32043_Rx: ComSignalType=UINT8
            DET_AZIMUTH_ERR_059_Rx_oRDR_FUSION_DET_057_060_oPCAN_RADAR_a497b204_Rx: ComSignalType=UINT8
            DET_AZIMUTH_ERR_060_Rx_oRDR_FUSION_DET_057_060_oPCAN_RADAR_92e9161e_Rx: ComSignalType=UINT8
            DET_BELOW_RAIN_THOLD_057_Rx_oRDR_FUSION_DET_057_060_oPCAN_RADAR_ef4e0cdc_Rx: ComSignalType=BOOLEAN
            DET_BELOW_RAIN_THOLD_058_Rx_oRDR_FUSION_DET_057_060_oPCAN_RADAR_6f007e74_Rx: ComSignalType=BOOLEAN
            DET_BELOW_RAIN_THOLD_059_Rx_oRDR_FUSION_DET_057_060_oPCAN_RADAR_c044ec33_Rx: ComSignalType=BOOLEAN
            DET_BELOW_RAIN_THOLD_060_Rx_oRDR_FUSION_DET_057_060_oPCAN_RADAR_f63a4829_Rx: ComSignalType=BOOLEAN
            DET_BI_STATIC_FLAG_057_Rx_oRDR_FUSION_DET_057_060_oPCAN_RADAR_98d0a7cf_Rx: ComSignalType=BOOLEAN
            DET_BI_STATIC_FLAG_058_Rx_oRDR_FUSION_DET_057_060_oPCAN_RADAR_189ed567_Rx: ComSignalType=BOOLEAN
            DET_BI_STATIC_FLAG_059_Rx_oRDR_FUSION_DET_057_060_oPCAN_RADAR_b7da4720_Rx: ComSignalType=BOOLEAN
            DET_BI_STATIC_FLAG_060_Rx_oRDR_FUSION_DET_057_060_oPCAN_RADAR_81a4e33a_Rx: ComSignalType=BOOLEAN
            DET_CONFD_AZIMUTH_057_Rx_oRDR_FUSION_DET_057_060_oPCAN_RADAR_7bb94d9b_Rx: ComSignalType=UINT8
            DET_CONFD_AZIMUTH_058_Rx_oRDR_FUSION_DET_057_060_oPCAN_RADAR_fbf73f33_Rx: ComSignalType=UINT8
            DET_CONFD_AZIMUTH_059_Rx_oRDR_FUSION_DET_057_060_oPCAN_RADAR_54b3ad74_Rx: ComSignalType=UINT8
            DET_CONFD_AZIMUTH_060_Rx_oRDR_FUSION_DET_057_060_oPCAN_RADAR_62cd096e_Rx: ComSignalType=UINT8
            DET_CONFD_ELEVATION_057_Rx_oRDR_FUSION_DET_057_060_oPCAN_RADAR_7198ce1c_Rx: ComSignalType=UINT8
            DET_CONFD_ELEVATION_058_Rx_oRDR_FUSION_DET_057_060_oPCAN_RADAR_f1d6bcb4_Rx: ComSignalType=UINT8
            DET_CONFD_ELEVATION_059_Rx_oRDR_FUSION_DET_057_060_oPCAN_RADAR_5e922ef3_Rx: ComSignalType=UINT8
            DET_CONFD_ELEVATION_060_Rx_oRDR_FUSION_DET_057_060_oPCAN_RADAR_68ec8ae9_Rx: ComSignalType=UINT8
            DET_ELEVATION_057_Rx_oRDR_FUSION_DET_057_060_oPCAN_RADAR_7bcb21e5_Rx: ComSignalType=UINT8
            DET_ELEVATION_058_Rx_oRDR_FUSION_DET_057_060_oPCAN_RADAR_fb85534d_Rx: ComSignalType=UINT8
            DET_ELEVATION_059_Rx_oRDR_FUSION_DET_057_060_oPCAN_RADAR_54c1c10a_Rx: ComSignalType=UINT8
            DET_ELEVATION_060_Rx_oRDR_FUSION_DET_057_060_oPCAN_RADAR_62bf6510_Rx: ComSignalType=UINT8
            DET_ELEVATION_ERR_057_Rx_oRDR_FUSION_DET_057_060_oPCAN_RADAR_a972033a_Rx: ComSignalType=UINT8
            DET_ELEVATION_ERR_058_Rx_oRDR_FUSION_DET_057_060_oPCAN_RADAR_293c7192_Rx: ComSignalType=UINT8
            DET_ELEVATION_ERR_059_Rx_oRDR_FUSION_DET_057_060_oPCAN_RADAR_8678e3d5_Rx: ComSignalType=UINT8
            DET_ELEVATION_ERR_060_Rx_oRDR_FUSION_DET_057_060_oPCAN_RADAR_b00647cf_Rx: ComSignalType=UINT8
            DET_EXISTENCE_PROB_057_Rx_oRDR_FUSION_DET_057_060_oPCAN_RADAR_5e6a7baf_Rx: ComSignalType=UINT8
            DET_EXISTENCE_PROB_058_Rx_oRDR_FUSION_DET_057_060_oPCAN_RADAR_de240907_Rx: ComSignalType=UINT8
            DET_EXISTENCE_PROB_059_Rx_oRDR_FUSION_DET_057_060_oPCAN_RADAR_71609b40_Rx: ComSignalType=UINT8
            DET_EXISTENCE_PROB_060_Rx_oRDR_FUSION_DET_057_060_oPCAN_RADAR_471e3f5a_Rx: ComSignalType=UINT8
            DET_HVC_FLAG_057_Rx_oRDR_FUSION_DET_057_060_oPCAN_RADAR_83b496e0_Rx: ComSignalType=BOOLEAN
            DET_HVC_FLAG_058_Rx_oRDR_FUSION_DET_057_060_oPCAN_RADAR_03fae448_Rx: ComSignalType=BOOLEAN
            DET_HVC_FLAG_059_Rx_oRDR_FUSION_DET_057_060_oPCAN_RADAR_acbe760f_Rx: ComSignalType=BOOLEAN
            DET_HVC_FLAG_060_Rx_oRDR_FUSION_DET_057_060_oPCAN_RADAR_9ac0d215_Rx: ComSignalType=BOOLEAN
            DET_IDM_057_Rx_oRDR_FUSION_DET_057_060_oPCAN_RADAR_b6756fa8_Rx: ComSignalType=BOOLEAN
            DET_IDM_058_Rx_oRDR_FUSION_DET_057_060_oPCAN_RADAR_363b1d00_Rx: ComSignalType=BOOLEAN
            DET_IDM_059_Rx_oRDR_FUSION_DET_057_060_oPCAN_RADAR_997f8f47_Rx: ComSignalType=BOOLEAN
            DET_IDM_060_Rx_oRDR_FUSION_DET_057_060_oPCAN_RADAR_af012b5d_Rx: ComSignalType=BOOLEAN
            DET_MH_CRC16_057_060_Rx_oRDR_FUSION_DET_057_060_oPCAN_RADAR_758b1867_Rx: ComSignalType=UINT16
            DET_MH_CYCLE_COUNTER_057_060_Rx_oRDR_FUSION_DET_057_060_oPCAN_RADAR_785025a2_Rx: ComSignalType=UINT8
            DET_MH_SCAN_INDEX_4LSB_057_060_Rx_oRDR_FUSION_DET_057_060_oPCAN_RADAR_1ce0ea99_Rx: ComSignalType=UINT8
            DET_MTD_057_Rx_oRDR_FUSION_DET_057_060_oPCAN_RADAR_0bf659d8_Rx: ComSignalType=BOOLEAN
            DET_MTD_058_Rx_oRDR_FUSION_DET_057_060_oPCAN_RADAR_8bb82b70_Rx: ComSignalType=BOOLEAN
            DET_MTD_059_Rx_oRDR_FUSION_DET_057_060_oPCAN_RADAR_24fcb937_Rx: ComSignalType=BOOLEAN
            DET_MTD_060_Rx_oRDR_FUSION_DET_057_060_oPCAN_RADAR_12821d2d_Rx: ComSignalType=BOOLEAN
            DET_PROB_1STAZHYPO_057_Rx_oRDR_FUSION_DET_057_060_oPCAN_RADAR_c18f4759_Rx: ComSignalType=BOOLEAN
            DET_PROB_1STAZHYPO_058_Rx_oRDR_FUSION_DET_057_060_oPCAN_RADAR_41c135f1_Rx: ComSignalType=BOOLEAN
            DET_PROB_1STAZHYPO_059_Rx_oRDR_FUSION_DET_057_060_oPCAN_RADAR_ee85a7b6_Rx: ComSignalType=BOOLEAN
            DET_PROB_1STAZHYPO_060_Rx_oRDR_FUSION_DET_057_060_oPCAN_RADAR_d8fb03ac_Rx: ComSignalType=BOOLEAN
            DET_RANGE_057_Rx_oRDR_FUSION_DET_057_060_oPCAN_RADAR_9a32af4e_Rx: ComSignalType=UINT16
            DET_RANGE_058_Rx_oRDR_FUSION_DET_057_060_oPCAN_RADAR_1a7cdde6_Rx: ComSignalType=UINT16
            DET_RANGE_059_Rx_oRDR_FUSION_DET_057_060_oPCAN_RADAR_b5384fa1_Rx: ComSignalType=UINT16
            DET_RANGE_060_Rx_oRDR_FUSION_DET_057_060_oPCAN_RADAR_8346ebbb_Rx: ComSignalType=UINT16
            DET_RANGE_ERR_057_Rx_oRDR_FUSION_DET_057_060_oPCAN_RADAR_cac023ae_Rx: ComSignalType=UINT8
            DET_RANGE_ERR_058_Rx_oRDR_FUSION_DET_057_060_oPCAN_RADAR_4a8e5106_Rx: ComSignalType=UINT8
            DET_RANGE_ERR_059_Rx_oRDR_FUSION_DET_057_060_oPCAN_RADAR_e5cac341_Rx: ComSignalType=UINT8
            DET_RANGE_ERR_060_Rx_oRDR_FUSION_DET_057_060_oPCAN_RADAR_d3b4675b_Rx: ComSignalType=UINT8
            DET_RANGE_VELOCITY_057_Rx_oRDR_FUSION_DET_057_060_oPCAN_RADAR_47c72cb0_Rx: ComSignalType=UINT16
            DET_RANGE_VELOCITY_058_Rx_oRDR_FUSION_DET_057_060_oPCAN_RADAR_c7895e18_Rx: ComSignalType=UINT16
            DET_RANGE_VELOCITY_059_Rx_oRDR_FUSION_DET_057_060_oPCAN_RADAR_68cdcc5f_Rx: ComSignalType=UINT16
            DET_RANGE_VELOCITY_060_Rx_oRDR_FUSION_DET_057_060_oPCAN_RADAR_5eb36845_Rx: ComSignalType=UINT16
            DET_RANGE_VELOCITY_ERR_057_Rx_oRDR_FUSION_DET_057_060_oPCAN_RADAR_dea35c72_Rx: ComSignalType=UINT8
            DET_RANGE_VELOCITY_ERR_058_Rx_oRDR_FUSION_DET_057_060_oPCAN_RADAR_5eed2eda_Rx: ComSignalType=UINT8
            DET_RANGE_VELOCITY_ERR_059_Rx_oRDR_FUSION_DET_057_060_oPCAN_RADAR_f1a9bc9d_Rx: ComSignalType=UINT8
            DET_RANGE_VELOCITY_ERR_060_Rx_oRDR_FUSION_DET_057_060_oPCAN_RADAR_c7d71887_Rx: ComSignalType=UINT8
            DET_RCS_057_Rx_oRDR_FUSION_DET_057_060_oPCAN_RADAR_8a0cbeab_Rx: ComSignalType=UINT8
            DET_RCS_058_Rx_oRDR_FUSION_DET_057_060_oPCAN_RADAR_0a42cc03_Rx: ComSignalType=UINT8
            DET_RCS_059_Rx_oRDR_FUSION_DET_057_060_oPCAN_RADAR_a5065e44_Rx: ComSignalType=UINT8
            DET_RCS_060_Rx_oRDR_FUSION_DET_057_060_oPCAN_RADAR_9378fa5e_Rx: ComSignalType=UINT8
            DET_SNR_057_Rx_oRDR_FUSION_DET_057_060_oPCAN_RADAR_8356cf42_Rx: ComSignalType=UINT8
            DET_SNR_058_Rx_oRDR_FUSION_DET_057_060_oPCAN_RADAR_0318bdea_Rx: ComSignalType=UINT8
            DET_SNR_059_Rx_oRDR_FUSION_DET_057_060_oPCAN_RADAR_ac5c2fad_Rx: ComSignalType=UINT8
            DET_SNR_060_Rx_oRDR_FUSION_DET_057_060_oPCAN_RADAR_9a228bb7_Rx: ComSignalType=UINT8
            DET_SUPER_RES_TARGET_057_Rx_oRDR_FUSION_DET_057_060_oPCAN_RADAR_48adee42_Rx: ComSignalType=BOOLEAN
            DET_SUPER_RES_TARGET_058_Rx_oRDR_FUSION_DET_057_060_oPCAN_RADAR_c8e39cea_Rx: ComSignalType=BOOLEAN
            DET_SUPER_RES_TARGET_059_Rx_oRDR_FUSION_DET_057_060_oPCAN_RADAR_67a70ead_Rx: ComSignalType=BOOLEAN
            DET_SUPER_RES_TARGET_060_Rx_oRDR_FUSION_DET_057_060_oPCAN_RADAR_51d9aab7_Rx: ComSignalType=BOOLEAN
        SG_Fusion_Detections_061_064_oRDR_FUSION_DET_061_064_oPCAN_RADAR_57616c84_Rx
          83 x ComGroupSignal:
            DET_AZIMUTH_061_Rx_oRDR_FUSION_DET_061_064_oPCAN_RADAR_b2cf2527_Rx: ComSignalType=UINT16
            DET_AZIMUTH_062_Rx_oRDR_FUSION_DET_061_064_oPCAN_RADAR_987395af_Rx: ComSignalType=UINT16
            DET_AZIMUTH_063_Rx_oRDR_FUSION_DET_061_064_oPCAN_RADAR_373707e8_Rx: ComSignalType=UINT16
            DET_AZIMUTH_064_Rx_oRDR_FUSION_DET_061_064_oPCAN_RADAR_cd0af4bf_Rx: ComSignalType=UINT16
            DET_AZIMUTH_ERR_061_Rx_oRDR_FUSION_DET_061_064_oPCAN_RADAR_b0a684a5_Rx: ComSignalType=UINT8
            DET_AZIMUTH_ERR_062_Rx_oRDR_FUSION_DET_061_064_oPCAN_RADAR_9a1a342d_Rx: ComSignalType=UINT8
            DET_AZIMUTH_ERR_063_Rx_oRDR_FUSION_DET_061_064_oPCAN_RADAR_355ea66a_Rx: ComSignalType=UINT8
            DET_AZIMUTH_ERR_064_Rx_oRDR_FUSION_DET_061_064_oPCAN_RADAR_cf63553d_Rx: ComSignalType=UINT8
            DET_BELOW_RAIN_THOLD_061_Rx_oRDR_FUSION_DET_061_064_oPCAN_RADAR_d475da92_Rx: ComSignalType=BOOLEAN
            DET_BELOW_RAIN_THOLD_062_Rx_oRDR_FUSION_DET_061_064_oPCAN_RADAR_fec96a1a_Rx: ComSignalType=BOOLEAN
            DET_BELOW_RAIN_THOLD_063_Rx_oRDR_FUSION_DET_061_064_oPCAN_RADAR_518df85d_Rx: ComSignalType=BOOLEAN
            DET_BELOW_RAIN_THOLD_064_Rx_oRDR_FUSION_DET_061_064_oPCAN_RADAR_abb00b0a_Rx: ComSignalType=BOOLEAN
            DET_BI_STATIC_FLAG_061_Rx_oRDR_FUSION_DET_061_064_oPCAN_RADAR_a3eb7181_Rx: ComSignalType=BOOLEAN
            DET_BI_STATIC_FLAG_062_Rx_oRDR_FUSION_DET_061_064_oPCAN_RADAR_8957c109_Rx: ComSignalType=BOOLEAN
            DET_BI_STATIC_FLAG_063_Rx_oRDR_FUSION_DET_061_064_oPCAN_RADAR_2613534e_Rx: ComSignalType=BOOLEAN
            DET_BI_STATIC_FLAG_064_Rx_oRDR_FUSION_DET_061_064_oPCAN_RADAR_dc2ea019_Rx: ComSignalType=BOOLEAN
            DET_CONFD_AZIMUTH_061_Rx_oRDR_FUSION_DET_061_064_oPCAN_RADAR_40829bd5_Rx: ComSignalType=UINT8
            DET_CONFD_AZIMUTH_062_Rx_oRDR_FUSION_DET_061_064_oPCAN_RADAR_6a3e2b5d_Rx: ComSignalType=UINT8
            DET_CONFD_AZIMUTH_063_Rx_oRDR_FUSION_DET_061_064_oPCAN_RADAR_c57ab91a_Rx: ComSignalType=UINT8
            DET_CONFD_AZIMUTH_064_Rx_oRDR_FUSION_DET_061_064_oPCAN_RADAR_3f474a4d_Rx: ComSignalType=UINT8
            DET_CONFD_ELEVATION_061_Rx_oRDR_FUSION_DET_061_064_oPCAN_RADAR_4aa31852_Rx: ComSignalType=UINT8
            DET_CONFD_ELEVATION_062_Rx_oRDR_FUSION_DET_061_064_oPCAN_RADAR_601fa8da_Rx: ComSignalType=UINT8
            DET_CONFD_ELEVATION_063_Rx_oRDR_FUSION_DET_061_064_oPCAN_RADAR_cf5b3a9d_Rx: ComSignalType=UINT8
            DET_CONFD_ELEVATION_064_Rx_oRDR_FUSION_DET_061_064_oPCAN_RADAR_3566c9ca_Rx: ComSignalType=UINT8
            DET_ELEVATION_061_Rx_oRDR_FUSION_DET_061_064_oPCAN_RADAR_40f0f7ab_Rx: ComSignalType=UINT8
            DET_ELEVATION_062_Rx_oRDR_FUSION_DET_061_064_oPCAN_RADAR_6a4c4723_Rx: ComSignalType=UINT8
            DET_ELEVATION_063_Rx_oRDR_FUSION_DET_061_064_oPCAN_RADAR_c508d564_Rx: ComSignalType=UINT8
            DET_ELEVATION_064_Rx_oRDR_FUSION_DET_061_064_oPCAN_RADAR_3f352633_Rx: ComSignalType=UINT8
            DET_ELEVATION_ERR_061_Rx_oRDR_FUSION_DET_061_064_oPCAN_RADAR_9249d574_Rx: ComSignalType=UINT8
            DET_ELEVATION_ERR_062_Rx_oRDR_FUSION_DET_061_064_oPCAN_RADAR_b8f565fc_Rx: ComSignalType=UINT8
            DET_ELEVATION_ERR_063_Rx_oRDR_FUSION_DET_061_064_oPCAN_RADAR_17b1f7bb_Rx: ComSignalType=UINT8
            DET_ELEVATION_ERR_064_Rx_oRDR_FUSION_DET_061_064_oPCAN_RADAR_ed8c04ec_Rx: ComSignalType=UINT8
            DET_EXISTENCE_PROB_061_Rx_oRDR_FUSION_DET_061_064_oPCAN_RADAR_6551ade1_Rx: ComSignalType=UINT8
            DET_EXISTENCE_PROB_062_Rx_oRDR_FUSION_DET_061_064_oPCAN_RADAR_4fed1d69_Rx: ComSignalType=UINT8
            DET_EXISTENCE_PROB_063_Rx_oRDR_FUSION_DET_061_064_oPCAN_RADAR_e0a98f2e_Rx: ComSignalType=UINT8
            DET_EXISTENCE_PROB_064_Rx_oRDR_FUSION_DET_061_064_oPCAN_RADAR_1a947c79_Rx: ComSignalType=UINT8
            DET_HVC_FLAG_061_Rx_oRDR_FUSION_DET_061_064_oPCAN_RADAR_b88f40ae_Rx: ComSignalType=BOOLEAN
            DET_HVC_FLAG_062_Rx_oRDR_FUSION_DET_061_064_oPCAN_RADAR_9233f026_Rx: ComSignalType=BOOLEAN
            DET_HVC_FLAG_063_Rx_oRDR_FUSION_DET_061_064_oPCAN_RADAR_3d776261_Rx: ComSignalType=BOOLEAN
            DET_HVC_FLAG_064_Rx_oRDR_FUSION_DET_061_064_oPCAN_RADAR_c74a9136_Rx: ComSignalType=BOOLEAN
            DET_IDM_061_Rx_oRDR_FUSION_DET_061_064_oPCAN_RADAR_8d4eb9e6_Rx: ComSignalType=BOOLEAN
            DET_IDM_062_Rx_oRDR_FUSION_DET_061_064_oPCAN_RADAR_a7f2096e_Rx: ComSignalType=BOOLEAN
            DET_IDM_063_Rx_oRDR_FUSION_DET_061_064_oPCAN_RADAR_08b69b29_Rx: ComSignalType=BOOLEAN
            DET_IDM_064_Rx_oRDR_FUSION_DET_061_064_oPCAN_RADAR_f28b687e_Rx: ComSignalType=BOOLEAN
            DET_MH_CRC16_061_064_Rx_oRDR_FUSION_DET_061_064_oPCAN_RADAR_eb3ab49d_Rx: ComSignalType=UINT16
            DET_MH_CYCLE_COUNTER_061_064_Rx_oRDR_FUSION_DET_061_064_oPCAN_RADAR_e6e18958_Rx: ComSignalType=UINT8
            DET_MH_SCAN_INDEX_4LSB_061_064_Rx_oRDR_FUSION_DET_061_064_oPCAN_RADAR_82514663_Rx: ComSignalType=UINT8
            DET_MTD_061_Rx_oRDR_FUSION_DET_061_064_oPCAN_RADAR_30cd8f96_Rx: ComSignalType=BOOLEAN
            DET_MTD_062_Rx_oRDR_FUSION_DET_061_064_oPCAN_RADAR_1a713f1e_Rx: ComSignalType=BOOLEAN
            DET_MTD_063_Rx_oRDR_FUSION_DET_061_064_oPCAN_RADAR_b535ad59_Rx: ComSignalType=BOOLEAN
            DET_MTD_064_Rx_oRDR_FUSION_DET_061_064_oPCAN_RADAR_4f085e0e_Rx: ComSignalType=BOOLEAN
            DET_PROB_1STAZHYPO_061_Rx_oRDR_FUSION_DET_061_064_oPCAN_RADAR_fab49117_Rx: ComSignalType=BOOLEAN
            DET_PROB_1STAZHYPO_062_Rx_oRDR_FUSION_DET_061_064_oPCAN_RADAR_d008219f_Rx: ComSignalType=BOOLEAN
            DET_PROB_1STAZHYPO_063_Rx_oRDR_FUSION_DET_061_064_oPCAN_RADAR_7f4cb3d8_Rx: ComSignalType=BOOLEAN
            DET_PROB_1STAZHYPO_064_Rx_oRDR_FUSION_DET_061_064_oPCAN_RADAR_8571408f_Rx: ComSignalType=BOOLEAN
            DET_RANGE_061_Rx_oRDR_FUSION_DET_061_064_oPCAN_RADAR_a1097900_Rx: ComSignalType=UINT16
            DET_RANGE_062_Rx_oRDR_FUSION_DET_061_064_oPCAN_RADAR_8bb5c988_Rx: ComSignalType=UINT16
            DET_RANGE_063_Rx_oRDR_FUSION_DET_061_064_oPCAN_RADAR_24f15bcf_Rx: ComSignalType=UINT16
            DET_RANGE_064_Rx_oRDR_FUSION_DET_061_064_oPCAN_RADAR_decca898_Rx: ComSignalType=UINT16
            DET_RANGE_ERR_061_Rx_oRDR_FUSION_DET_061_064_oPCAN_RADAR_f1fbf5e0_Rx: ComSignalType=UINT8
            DET_RANGE_ERR_062_Rx_oRDR_FUSION_DET_061_064_oPCAN_RADAR_db474568_Rx: ComSignalType=UINT8
            DET_RANGE_ERR_063_Rx_oRDR_FUSION_DET_061_064_oPCAN_RADAR_7403d72f_Rx: ComSignalType=UINT8
            DET_RANGE_ERR_064_Rx_oRDR_FUSION_DET_061_064_oPCAN_RADAR_8e3e2478_Rx: ComSignalType=UINT8
            DET_RANGE_VELOCITY_061_Rx_oRDR_FUSION_DET_061_064_oPCAN_RADAR_7cfcfafe_Rx: ComSignalType=UINT16
            DET_RANGE_VELOCITY_062_Rx_oRDR_FUSION_DET_061_064_oPCAN_RADAR_56404a76_Rx: ComSignalType=UINT16
            DET_RANGE_VELOCITY_063_Rx_oRDR_FUSION_DET_061_064_oPCAN_RADAR_f904d831_Rx: ComSignalType=UINT16
            DET_RANGE_VELOCITY_064_Rx_oRDR_FUSION_DET_061_064_oPCAN_RADAR_03392b66_Rx: ComSignalType=UINT16
            DET_RANGE_VELOCITY_ERR_061_Rx_oRDR_FUSION_DET_061_064_oPCAN_RADAR_e5988a3c_Rx: ComSignalType=UINT8
            DET_RANGE_VELOCITY_ERR_062_Rx_oRDR_FUSION_DET_061_064_oPCAN_RADAR_cf243ab4_Rx: ComSignalType=UINT8
            DET_RANGE_VELOCITY_ERR_063_Rx_oRDR_FUSION_DET_061_064_oPCAN_RADAR_6060a8f3_Rx: ComSignalType=UINT8
            DET_RANGE_VELOCITY_ERR_064_Rx_oRDR_FUSION_DET_061_064_oPCAN_RADAR_9a5d5ba4_Rx: ComSignalType=UINT8
            DET_RCS_061_Rx_oRDR_FUSION_DET_061_064_oPCAN_RADAR_b13768e5_Rx: ComSignalType=UINT8
            DET_RCS_062_Rx_oRDR_FUSION_DET_061_064_oPCAN_RADAR_9b8bd86d_Rx: ComSignalType=UINT8
            DET_RCS_063_Rx_oRDR_FUSION_DET_061_064_oPCAN_RADAR_34cf4a2a_Rx: ComSignalType=UINT8
            DET_RCS_064_Rx_oRDR_FUSION_DET_061_064_oPCAN_RADAR_cef2b97d_Rx: ComSignalType=UINT8
            DET_SNR_061_Rx_oRDR_FUSION_DET_061_064_oPCAN_RADAR_b86d190c_Rx: ComSignalType=UINT8
            DET_SNR_062_Rx_oRDR_FUSION_DET_061_064_oPCAN_RADAR_92d1a984_Rx: ComSignalType=UINT8
            DET_SNR_063_Rx_oRDR_FUSION_DET_061_064_oPCAN_RADAR_3d953bc3_Rx: ComSignalType=UINT8
            DET_SNR_064_Rx_oRDR_FUSION_DET_061_064_oPCAN_RADAR_c7a8c894_Rx: ComSignalType=UINT8
            DET_SUPER_RES_TARGET_061_Rx_oRDR_FUSION_DET_061_064_oPCAN_RADAR_7396380c_Rx: ComSignalType=BOOLEAN
            DET_SUPER_RES_TARGET_062_Rx_oRDR_FUSION_DET_061_064_oPCAN_RADAR_592a8884_Rx: ComSignalType=BOOLEAN
            DET_SUPER_RES_TARGET_063_Rx_oRDR_FUSION_DET_061_064_oPCAN_RADAR_f66e1ac3_Rx: ComSignalType=BOOLEAN
            DET_SUPER_RES_TARGET_064_Rx_oRDR_FUSION_DET_061_064_oPCAN_RADAR_0c53e994_Rx: ComSignalType=BOOLEAN
        SG_Fusion_Detections_065_068_oRDR_FUSION_DET_065_068_oPCAN_RADAR_1a9a4777_Rx
          83 x ComGroupSignal:
            DET_AZIMUTH_065_Rx_oRDR_FUSION_DET_065_068_oPCAN_RADAR_8bfcf8cc_Rx: ComSignalType=UINT16
            DET_AZIMUTH_066_Rx_oRDR_FUSION_DET_065_068_oPCAN_RADAR_a1404844_Rx: ComSignalType=UINT16
            DET_AZIMUTH_067_Rx_oRDR_FUSION_DET_065_068_oPCAN_RADAR_0e04da03_Rx: ComSignalType=UINT16
            DET_AZIMUTH_068_Rx_oRDR_FUSION_DET_065_068_oPCAN_RADAR_8e4aa8ab_Rx: ComSignalType=UINT16
            DET_AZIMUTH_ERR_065_Rx_oRDR_FUSION_DET_065_068_oPCAN_RADAR_8995594e_Rx: ComSignalType=UINT8
            DET_AZIMUTH_ERR_066_Rx_oRDR_FUSION_DET_065_068_oPCAN_RADAR_a329e9c6_Rx: ComSignalType=UINT8
            DET_AZIMUTH_ERR_067_Rx_oRDR_FUSION_DET_065_068_oPCAN_RADAR_0c6d7b81_Rx: ComSignalType=UINT8
            DET_AZIMUTH_ERR_068_Rx_oRDR_FUSION_DET_065_068_oPCAN_RADAR_8c230929_Rx: ComSignalType=UINT8
            DET_BELOW_RAIN_THOLD_065_Rx_oRDR_FUSION_DET_065_068_oPCAN_RADAR_ed460779_Rx: ComSignalType=BOOLEAN
            DET_BELOW_RAIN_THOLD_066_Rx_oRDR_FUSION_DET_065_068_oPCAN_RADAR_c7fab7f1_Rx: ComSignalType=BOOLEAN
            DET_BELOW_RAIN_THOLD_067_Rx_oRDR_FUSION_DET_065_068_oPCAN_RADAR_68be25b6_Rx: ComSignalType=BOOLEAN
            DET_BELOW_RAIN_THOLD_068_Rx_oRDR_FUSION_DET_065_068_oPCAN_RADAR_e8f0571e_Rx: ComSignalType=BOOLEAN
            DET_BI_STATIC_FLAG_065_Rx_oRDR_FUSION_DET_065_068_oPCAN_RADAR_9ad8ac6a_Rx: ComSignalType=BOOLEAN
            DET_BI_STATIC_FLAG_066_Rx_oRDR_FUSION_DET_065_068_oPCAN_RADAR_b0641ce2_Rx: ComSignalType=BOOLEAN
            DET_BI_STATIC_FLAG_067_Rx_oRDR_FUSION_DET_065_068_oPCAN_RADAR_1f208ea5_Rx: ComSignalType=BOOLEAN
            DET_BI_STATIC_FLAG_068_Rx_oRDR_FUSION_DET_065_068_oPCAN_RADAR_9f6efc0d_Rx: ComSignalType=BOOLEAN
            DET_CONFD_AZIMUTH_065_Rx_oRDR_FUSION_DET_065_068_oPCAN_RADAR_79b1463e_Rx: ComSignalType=UINT8
            DET_CONFD_AZIMUTH_066_Rx_oRDR_FUSION_DET_065_068_oPCAN_RADAR_530df6b6_Rx: ComSignalType=UINT8
            DET_CONFD_AZIMUTH_067_Rx_oRDR_FUSION_DET_065_068_oPCAN_RADAR_fc4964f1_Rx: ComSignalType=UINT8
            DET_CONFD_AZIMUTH_068_Rx_oRDR_FUSION_DET_065_068_oPCAN_RADAR_7c071659_Rx: ComSignalType=UINT8
            DET_CONFD_ELEVATION_065_Rx_oRDR_FUSION_DET_065_068_oPCAN_RADAR_7390c5b9_Rx: ComSignalType=UINT8
            DET_CONFD_ELEVATION_066_Rx_oRDR_FUSION_DET_065_068_oPCAN_RADAR_592c7531_Rx: ComSignalType=UINT8
            DET_CONFD_ELEVATION_067_Rx_oRDR_FUSION_DET_065_068_oPCAN_RADAR_f668e776_Rx: ComSignalType=UINT8
            DET_CONFD_ELEVATION_068_Rx_oRDR_FUSION_DET_065_068_oPCAN_RADAR_762695de_Rx: ComSignalType=UINT8
            DET_ELEVATION_065_Rx_oRDR_FUSION_DET_065_068_oPCAN_RADAR_79c32a40_Rx: ComSignalType=UINT8
            DET_ELEVATION_066_Rx_oRDR_FUSION_DET_065_068_oPCAN_RADAR_537f9ac8_Rx: ComSignalType=UINT8
            DET_ELEVATION_067_Rx_oRDR_FUSION_DET_065_068_oPCAN_RADAR_fc3b088f_Rx: ComSignalType=UINT8
            DET_ELEVATION_068_Rx_oRDR_FUSION_DET_065_068_oPCAN_RADAR_7c757a27_Rx: ComSignalType=UINT8
            DET_ELEVATION_ERR_065_Rx_oRDR_FUSION_DET_065_068_oPCAN_RADAR_ab7a089f_Rx: ComSignalType=UINT8
            DET_ELEVATION_ERR_066_Rx_oRDR_FUSION_DET_065_068_oPCAN_RADAR_81c6b817_Rx: ComSignalType=UINT8
            DET_ELEVATION_ERR_067_Rx_oRDR_FUSION_DET_065_068_oPCAN_RADAR_2e822a50_Rx: ComSignalType=UINT8
            DET_ELEVATION_ERR_068_Rx_oRDR_FUSION_DET_065_068_oPCAN_RADAR_aecc58f8_Rx: ComSignalType=UINT8
            DET_EXISTENCE_PROB_065_Rx_oRDR_FUSION_DET_065_068_oPCAN_RADAR_5c62700a_Rx: ComSignalType=UINT8
            DET_EXISTENCE_PROB_066_Rx_oRDR_FUSION_DET_065_068_oPCAN_RADAR_76dec082_Rx: ComSignalType=UINT8
            DET_EXISTENCE_PROB_067_Rx_oRDR_FUSION_DET_065_068_oPCAN_RADAR_d99a52c5_Rx: ComSignalType=UINT8
            DET_EXISTENCE_PROB_068_Rx_oRDR_FUSION_DET_065_068_oPCAN_RADAR_59d4206d_Rx: ComSignalType=UINT8
            DET_HVC_FLAG_065_Rx_oRDR_FUSION_DET_065_068_oPCAN_RADAR_81bc9d45_Rx: ComSignalType=BOOLEAN
            DET_HVC_FLAG_066_Rx_oRDR_FUSION_DET_065_068_oPCAN_RADAR_ab002dcd_Rx: ComSignalType=BOOLEAN
            DET_HVC_FLAG_067_Rx_oRDR_FUSION_DET_065_068_oPCAN_RADAR_0444bf8a_Rx: ComSignalType=BOOLEAN
            DET_HVC_FLAG_068_Rx_oRDR_FUSION_DET_065_068_oPCAN_RADAR_840acd22_Rx: ComSignalType=BOOLEAN
            DET_IDM_065_Rx_oRDR_FUSION_DET_065_068_oPCAN_RADAR_b47d640d_Rx: ComSignalType=BOOLEAN
            DET_IDM_066_Rx_oRDR_FUSION_DET_065_068_oPCAN_RADAR_9ec1d485_Rx: ComSignalType=BOOLEAN
            DET_IDM_067_Rx_oRDR_FUSION_DET_065_068_oPCAN_RADAR_318546c2_Rx: ComSignalType=BOOLEAN
            DET_IDM_068_Rx_oRDR_FUSION_DET_065_068_oPCAN_RADAR_b1cb346a_Rx: ComSignalType=BOOLEAN
            DET_MH_CRC16_065_068_Rx_oRDR_FUSION_DET_065_068_oPCAN_RADAR_00da0901_Rx: ComSignalType=UINT16
            DET_MH_CYCLE_COUNTER_065_068_Rx_oRDR_FUSION_DET_065_068_oPCAN_RADAR_0d0134c4_Rx: ComSignalType=UINT8
            DET_MH_SCAN_INDEX_4LSB_065_068_Rx_oRDR_FUSION_DET_065_068_oPCAN_RADAR_69b1fbff_Rx: ComSignalType=UINT8
            DET_MTD_065_Rx_oRDR_FUSION_DET_065_068_oPCAN_RADAR_09fe527d_Rx: ComSignalType=BOOLEAN
            DET_MTD_066_Rx_oRDR_FUSION_DET_065_068_oPCAN_RADAR_2342e2f5_Rx: ComSignalType=BOOLEAN
            DET_MTD_067_Rx_oRDR_FUSION_DET_065_068_oPCAN_RADAR_8c0670b2_Rx: ComSignalType=BOOLEAN
            DET_MTD_068_Rx_oRDR_FUSION_DET_065_068_oPCAN_RADAR_0c48021a_Rx: ComSignalType=BOOLEAN
            DET_PROB_1STAZHYPO_065_Rx_oRDR_FUSION_DET_065_068_oPCAN_RADAR_c3874cfc_Rx: ComSignalType=BOOLEAN
            DET_PROB_1STAZHYPO_066_Rx_oRDR_FUSION_DET_065_068_oPCAN_RADAR_e93bfc74_Rx: ComSignalType=BOOLEAN
            DET_PROB_1STAZHYPO_067_Rx_oRDR_FUSION_DET_065_068_oPCAN_RADAR_467f6e33_Rx: ComSignalType=BOOLEAN
            DET_PROB_1STAZHYPO_068_Rx_oRDR_FUSION_DET_065_068_oPCAN_RADAR_c6311c9b_Rx: ComSignalType=BOOLEAN
            DET_RANGE_065_Rx_oRDR_FUSION_DET_065_068_oPCAN_RADAR_983aa4eb_Rx: ComSignalType=UINT16
            DET_RANGE_066_Rx_oRDR_FUSION_DET_065_068_oPCAN_RADAR_b2861463_Rx: ComSignalType=UINT16
            DET_RANGE_067_Rx_oRDR_FUSION_DET_065_068_oPCAN_RADAR_1dc28624_Rx: ComSignalType=UINT16
            DET_RANGE_068_Rx_oRDR_FUSION_DET_065_068_oPCAN_RADAR_9d8cf48c_Rx: ComSignalType=UINT16
            DET_RANGE_ERR_065_Rx_oRDR_FUSION_DET_065_068_oPCAN_RADAR_c8c8280b_Rx: ComSignalType=UINT8
            DET_RANGE_ERR_066_Rx_oRDR_FUSION_DET_065_068_oPCAN_RADAR_e2749883_Rx: ComSignalType=UINT8
            DET_RANGE_ERR_067_Rx_oRDR_FUSION_DET_065_068_oPCAN_RADAR_4d300ac4_Rx: ComSignalType=UINT8
            DET_RANGE_ERR_068_Rx_oRDR_FUSION_DET_065_068_oPCAN_RADAR_cd7e786c_Rx: ComSignalType=UINT8
            DET_RANGE_VELOCITY_065_Rx_oRDR_FUSION_DET_065_068_oPCAN_RADAR_45cf2715_Rx: ComSignalType=UINT16
            DET_RANGE_VELOCITY_066_Rx_oRDR_FUSION_DET_065_068_oPCAN_RADAR_6f73979d_Rx: ComSignalType=UINT16
            DET_RANGE_VELOCITY_067_Rx_oRDR_FUSION_DET_065_068_oPCAN_RADAR_c03705da_Rx: ComSignalType=UINT16
            DET_RANGE_VELOCITY_068_Rx_oRDR_FUSION_DET_065_068_oPCAN_RADAR_40797772_Rx: ComSignalType=UINT16
            DET_RANGE_VELOCITY_ERR_065_Rx_oRDR_FUSION_DET_065_068_oPCAN_RADAR_dcab57d7_Rx: ComSignalType=UINT8
            DET_RANGE_VELOCITY_ERR_066_Rx_oRDR_FUSION_DET_065_068_oPCAN_RADAR_f617e75f_Rx: ComSignalType=UINT8
            DET_RANGE_VELOCITY_ERR_067_Rx_oRDR_FUSION_DET_065_068_oPCAN_RADAR_59537518_Rx: ComSignalType=UINT8
            DET_RANGE_VELOCITY_ERR_068_Rx_oRDR_FUSION_DET_065_068_oPCAN_RADAR_d91d07b0_Rx: ComSignalType=UINT8
            DET_RCS_065_Rx_oRDR_FUSION_DET_065_068_oPCAN_RADAR_8804b50e_Rx: ComSignalType=UINT8
            DET_RCS_066_Rx_oRDR_FUSION_DET_065_068_oPCAN_RADAR_a2b80586_Rx: ComSignalType=UINT8
            DET_RCS_067_Rx_oRDR_FUSION_DET_065_068_oPCAN_RADAR_0dfc97c1_Rx: ComSignalType=UINT8
            DET_RCS_068_Rx_oRDR_FUSION_DET_065_068_oPCAN_RADAR_8db2e569_Rx: ComSignalType=UINT8
            DET_SNR_065_Rx_oRDR_FUSION_DET_065_068_oPCAN_RADAR_815ec4e7_Rx: ComSignalType=UINT8
            DET_SNR_066_Rx_oRDR_FUSION_DET_065_068_oPCAN_RADAR_abe2746f_Rx: ComSignalType=UINT8
            DET_SNR_067_Rx_oRDR_FUSION_DET_065_068_oPCAN_RADAR_04a6e628_Rx: ComSignalType=UINT8
            DET_SNR_068_Rx_oRDR_FUSION_DET_065_068_oPCAN_RADAR_84e89480_Rx: ComSignalType=UINT8
            DET_SUPER_RES_TARGET_065_Rx_oRDR_FUSION_DET_065_068_oPCAN_RADAR_4aa5e5e7_Rx: ComSignalType=BOOLEAN
            DET_SUPER_RES_TARGET_066_Rx_oRDR_FUSION_DET_065_068_oPCAN_RADAR_6019556f_Rx: ComSignalType=BOOLEAN
            DET_SUPER_RES_TARGET_067_Rx_oRDR_FUSION_DET_065_068_oPCAN_RADAR_cf5dc728_Rx: ComSignalType=BOOLEAN
            DET_SUPER_RES_TARGET_068_Rx_oRDR_FUSION_DET_065_068_oPCAN_RADAR_4f13b580_Rx: ComSignalType=BOOLEAN
        SG_Fusion_Detections_069_072_oRDR_FUSION_DET_069_072_oPCAN_RADAR_98a9029f_Rx
          83 x ComGroupSignal:
            DET_AZIMUTH_069_Rx_oRDR_FUSION_DET_069_072_oPCAN_RADAR_1346d5ed_Rx: ComSignalType=UINT16
            DET_AZIMUTH_070_Rx_oRDR_FUSION_DET_069_072_oPCAN_RADAR_2e6656f4_Rx: ComSignalType=UINT16
            DET_AZIMUTH_071_Rx_oRDR_FUSION_DET_069_072_oPCAN_RADAR_8122c4b3_Rx: ComSignalType=UINT16
            DET_AZIMUTH_072_Rx_oRDR_FUSION_DET_069_072_oPCAN_RADAR_ab9e743b_Rx: ComSignalType=UINT16
            DET_AZIMUTH_ERR_069_Rx_oRDR_FUSION_DET_069_072_oPCAN_RADAR_112f746f_Rx: ComSignalType=UINT8
            DET_AZIMUTH_ERR_070_Rx_oRDR_FUSION_DET_069_072_oPCAN_RADAR_2c0ff776_Rx: ComSignalType=UINT8
            DET_AZIMUTH_ERR_071_Rx_oRDR_FUSION_DET_069_072_oPCAN_RADAR_834b6531_Rx: ComSignalType=UINT8
            DET_AZIMUTH_ERR_072_Rx_oRDR_FUSION_DET_069_072_oPCAN_RADAR_a9f7d5b9_Rx: ComSignalType=UINT8
            DET_BELOW_RAIN_THOLD_069_Rx_oRDR_FUSION_DET_069_072_oPCAN_RADAR_75fc2a58_Rx: ComSignalType=BOOLEAN
            DET_BELOW_RAIN_THOLD_070_Rx_oRDR_FUSION_DET_069_072_oPCAN_RADAR_48dca941_Rx: ComSignalType=BOOLEAN
            DET_BELOW_RAIN_THOLD_071_Rx_oRDR_FUSION_DET_069_072_oPCAN_RADAR_e7983b06_Rx: ComSignalType=BOOLEAN
            DET_BELOW_RAIN_THOLD_072_Rx_oRDR_FUSION_DET_069_072_oPCAN_RADAR_cd248b8e_Rx: ComSignalType=BOOLEAN
            DET_BI_STATIC_FLAG_069_Rx_oRDR_FUSION_DET_069_072_oPCAN_RADAR_0262814b_Rx: ComSignalType=BOOLEAN
            DET_BI_STATIC_FLAG_070_Rx_oRDR_FUSION_DET_069_072_oPCAN_RADAR_3f420252_Rx: ComSignalType=BOOLEAN
            DET_BI_STATIC_FLAG_071_Rx_oRDR_FUSION_DET_069_072_oPCAN_RADAR_90069015_Rx: ComSignalType=BOOLEAN
            DET_BI_STATIC_FLAG_072_Rx_oRDR_FUSION_DET_069_072_oPCAN_RADAR_baba209d_Rx: ComSignalType=BOOLEAN
            DET_CONFD_AZIMUTH_069_Rx_oRDR_FUSION_DET_069_072_oPCAN_RADAR_e10b6b1f_Rx: ComSignalType=UINT8
            DET_CONFD_AZIMUTH_070_Rx_oRDR_FUSION_DET_069_072_oPCAN_RADAR_dc2be806_Rx: ComSignalType=UINT8
            DET_CONFD_AZIMUTH_071_Rx_oRDR_FUSION_DET_069_072_oPCAN_RADAR_736f7a41_Rx: ComSignalType=UINT8
            DET_CONFD_AZIMUTH_072_Rx_oRDR_FUSION_DET_069_072_oPCAN_RADAR_59d3cac9_Rx: ComSignalType=UINT8
            DET_CONFD_ELEVATION_069_Rx_oRDR_FUSION_DET_069_072_oPCAN_RADAR_eb2ae898_Rx: ComSignalType=UINT8
            DET_CONFD_ELEVATION_070_Rx_oRDR_FUSION_DET_069_072_oPCAN_RADAR_d60a6b81_Rx: ComSignalType=UINT8
            DET_CONFD_ELEVATION_071_Rx_oRDR_FUSION_DET_069_072_oPCAN_RADAR_794ef9c6_Rx: ComSignalType=UINT8
            DET_CONFD_ELEVATION_072_Rx_oRDR_FUSION_DET_069_072_oPCAN_RADAR_53f2494e_Rx: ComSignalType=UINT8
            DET_ELEVATION_069_Rx_oRDR_FUSION_DET_069_072_oPCAN_RADAR_e1790761_Rx: ComSignalType=UINT8
            DET_ELEVATION_070_Rx_oRDR_FUSION_DET_069_072_oPCAN_RADAR_dc598478_Rx: ComSignalType=UINT8
            DET_ELEVATION_071_Rx_oRDR_FUSION_DET_069_072_oPCAN_RADAR_731d163f_Rx: ComSignalType=UINT8
            DET_ELEVATION_072_Rx_oRDR_FUSION_DET_069_072_oPCAN_RADAR_59a1a6b7_Rx: ComSignalType=UINT8
            DET_ELEVATION_ERR_069_Rx_oRDR_FUSION_DET_069_072_oPCAN_RADAR_33c025be_Rx: ComSignalType=UINT8
            DET_ELEVATION_ERR_070_Rx_oRDR_FUSION_DET_069_072_oPCAN_RADAR_0ee0a6a7_Rx: ComSignalType=UINT8
            DET_ELEVATION_ERR_071_Rx_oRDR_FUSION_DET_069_072_oPCAN_RADAR_a1a434e0_Rx: ComSignalType=UINT8
            DET_ELEVATION_ERR_072_Rx_oRDR_FUSION_DET_069_072_oPCAN_RADAR_8b188468_Rx: ComSignalType=UINT8
            DET_EXISTENCE_PROB_069_Rx_oRDR_FUSION_DET_069_072_oPCAN_RADAR_c4d85d2b_Rx: ComSignalType=UINT8
            DET_EXISTENCE_PROB_070_Rx_oRDR_FUSION_DET_069_072_oPCAN_RADAR_f9f8de32_Rx: ComSignalType=UINT8
            DET_EXISTENCE_PROB_071_Rx_oRDR_FUSION_DET_069_072_oPCAN_RADAR_56bc4c75_Rx: ComSignalType=UINT8
            DET_EXISTENCE_PROB_072_Rx_oRDR_FUSION_DET_069_072_oPCAN_RADAR_7c00fcfd_Rx: ComSignalType=UINT8
            DET_HVC_FLAG_069_Rx_oRDR_FUSION_DET_069_072_oPCAN_RADAR_1906b064_Rx: ComSignalType=BOOLEAN
            DET_HVC_FLAG_070_Rx_oRDR_FUSION_DET_069_072_oPCAN_RADAR_2426337d_Rx: ComSignalType=BOOLEAN
            DET_HVC_FLAG_071_Rx_oRDR_FUSION_DET_069_072_oPCAN_RADAR_8b62a13a_Rx: ComSignalType=BOOLEAN
            DET_HVC_FLAG_072_Rx_oRDR_FUSION_DET_069_072_oPCAN_RADAR_a1de11b2_Rx: ComSignalType=BOOLEAN
            DET_IDM_069_Rx_oRDR_FUSION_DET_069_072_oPCAN_RADAR_2cc7492c_Rx: ComSignalType=BOOLEAN
            DET_IDM_070_Rx_oRDR_FUSION_DET_069_072_oPCAN_RADAR_11e7ca35_Rx: ComSignalType=BOOLEAN
            DET_IDM_071_Rx_oRDR_FUSION_DET_069_072_oPCAN_RADAR_bea35872_Rx: ComSignalType=BOOLEAN
            DET_IDM_072_Rx_oRDR_FUSION_DET_069_072_oPCAN_RADAR_941fe8fa_Rx: ComSignalType=BOOLEAN
            DET_MH_CRC16_069_072_Rx_oRDR_FUSION_DET_069_072_oPCAN_RADAR_079ef148_Rx: ComSignalType=UINT16
            DET_MH_CYCLE_COUNTER_069_072_Rx_oRDR_FUSION_DET_069_072_oPCAN_RADAR_0a45cc8d_Rx: ComSignalType=UINT8
            DET_MH_SCAN_INDEX_4LSB_069_072_Rx_oRDR_FUSION_DET_069_072_oPCAN_RADAR_6ef503b6_Rx: ComSignalType=UINT8
            DET_MTD_069_Rx_oRDR_FUSION_DET_069_072_oPCAN_RADAR_91447f5c_Rx: ComSignalType=BOOLEAN
            DET_MTD_070_Rx_oRDR_FUSION_DET_069_072_oPCAN_RADAR_ac64fc45_Rx: ComSignalType=BOOLEAN
            DET_MTD_071_Rx_oRDR_FUSION_DET_069_072_oPCAN_RADAR_03206e02_Rx: ComSignalType=BOOLEAN
            DET_MTD_072_Rx_oRDR_FUSION_DET_069_072_oPCAN_RADAR_299cde8a_Rx: ComSignalType=BOOLEAN
            DET_PROB_1STAZHYPO_069_Rx_oRDR_FUSION_DET_069_072_oPCAN_RADAR_5b3d61dd_Rx: ComSignalType=BOOLEAN
            DET_PROB_1STAZHYPO_070_Rx_oRDR_FUSION_DET_069_072_oPCAN_RADAR_661de2c4_Rx: ComSignalType=BOOLEAN
            DET_PROB_1STAZHYPO_071_Rx_oRDR_FUSION_DET_069_072_oPCAN_RADAR_c9597083_Rx: ComSignalType=BOOLEAN
            DET_PROB_1STAZHYPO_072_Rx_oRDR_FUSION_DET_069_072_oPCAN_RADAR_e3e5c00b_Rx: ComSignalType=BOOLEAN
            DET_RANGE_069_Rx_oRDR_FUSION_DET_069_072_oPCAN_RADAR_008089ca_Rx: ComSignalType=UINT16
            DET_RANGE_070_Rx_oRDR_FUSION_DET_069_072_oPCAN_RADAR_3da00ad3_Rx: ComSignalType=UINT16
            DET_RANGE_071_Rx_oRDR_FUSION_DET_069_072_oPCAN_RADAR_92e49894_Rx: ComSignalType=UINT16
            DET_RANGE_072_Rx_oRDR_FUSION_DET_069_072_oPCAN_RADAR_b858281c_Rx: ComSignalType=UINT16
            DET_RANGE_ERR_069_Rx_oRDR_FUSION_DET_069_072_oPCAN_RADAR_5072052a_Rx: ComSignalType=UINT8
            DET_RANGE_ERR_070_Rx_oRDR_FUSION_DET_069_072_oPCAN_RADAR_6d528633_Rx: ComSignalType=UINT8
            DET_RANGE_ERR_071_Rx_oRDR_FUSION_DET_069_072_oPCAN_RADAR_c2161474_Rx: ComSignalType=UINT8
            DET_RANGE_ERR_072_Rx_oRDR_FUSION_DET_069_072_oPCAN_RADAR_e8aaa4fc_Rx: ComSignalType=UINT8
            DET_RANGE_VELOCITY_069_Rx_oRDR_FUSION_DET_069_072_oPCAN_RADAR_dd750a34_Rx: ComSignalType=UINT16
            DET_RANGE_VELOCITY_070_Rx_oRDR_FUSION_DET_069_072_oPCAN_RADAR_e055892d_Rx: ComSignalType=UINT16
            DET_RANGE_VELOCITY_071_Rx_oRDR_FUSION_DET_069_072_oPCAN_RADAR_4f111b6a_Rx: ComSignalType=UINT16
            DET_RANGE_VELOCITY_072_Rx_oRDR_FUSION_DET_069_072_oPCAN_RADAR_65adabe2_Rx: ComSignalType=UINT16
            DET_RANGE_VELOCITY_ERR_069_Rx_oRDR_FUSION_DET_069_072_oPCAN_RADAR_44117af6_Rx: ComSignalType=UINT8
            DET_RANGE_VELOCITY_ERR_070_Rx_oRDR_FUSION_DET_069_072_oPCAN_RADAR_7931f9ef_Rx: ComSignalType=UINT8
            DET_RANGE_VELOCITY_ERR_071_Rx_oRDR_FUSION_DET_069_072_oPCAN_RADAR_d6756ba8_Rx: ComSignalType=UINT8
            DET_RANGE_VELOCITY_ERR_072_Rx_oRDR_FUSION_DET_069_072_oPCAN_RADAR_fcc9db20_Rx: ComSignalType=UINT8
            DET_RCS_069_Rx_oRDR_FUSION_DET_069_072_oPCAN_RADAR_10be982f_Rx: ComSignalType=UINT8
            DET_RCS_070_Rx_oRDR_FUSION_DET_069_072_oPCAN_RADAR_2d9e1b36_Rx: ComSignalType=UINT8
            DET_RCS_071_Rx_oRDR_FUSION_DET_069_072_oPCAN_RADAR_82da8971_Rx: ComSignalType=UINT8
            DET_RCS_072_Rx_oRDR_FUSION_DET_069_072_oPCAN_RADAR_a86639f9_Rx: ComSignalType=UINT8
            DET_SNR_069_Rx_oRDR_FUSION_DET_069_072_oPCAN_RADAR_19e4e9c6_Rx: ComSignalType=UINT8
            DET_SNR_070_Rx_oRDR_FUSION_DET_069_072_oPCAN_RADAR_24c46adf_Rx: ComSignalType=UINT8
            DET_SNR_071_Rx_oRDR_FUSION_DET_069_072_oPCAN_RADAR_8b80f898_Rx: ComSignalType=UINT8
            DET_SNR_072_Rx_oRDR_FUSION_DET_069_072_oPCAN_RADAR_a13c4810_Rx: ComSignalType=UINT8
            DET_SUPER_RES_TARGET_069_Rx_oRDR_FUSION_DET_069_072_oPCAN_RADAR_d21fc8c6_Rx: ComSignalType=BOOLEAN
            DET_SUPER_RES_TARGET_070_Rx_oRDR_FUSION_DET_069_072_oPCAN_RADAR_ef3f4bdf_Rx: ComSignalType=BOOLEAN
            DET_SUPER_RES_TARGET_071_Rx_oRDR_FUSION_DET_069_072_oPCAN_RADAR_407bd998_Rx: ComSignalType=BOOLEAN
            DET_SUPER_RES_TARGET_072_Rx_oRDR_FUSION_DET_069_072_oPCAN_RADAR_6ac76910_Rx: ComSignalType=BOOLEAN
        SG_Fusion_Detections_073_076_oRDR_FUSION_DET_073_076_oPCAN_RADAR_6c2268ef_Rx
          83 x ComGroupSignal:
            DET_AZIMUTH_073_Rx_oRDR_FUSION_DET_073_076_oPCAN_RADAR_191de552_Rx: ComSignalType=UINT16
            DET_AZIMUTH_074_Rx_oRDR_FUSION_DET_073_076_oPCAN_RADAR_e3201605_Rx: ComSignalType=UINT16
            DET_AZIMUTH_075_Rx_oRDR_FUSION_DET_073_076_oPCAN_RADAR_4c648442_Rx: ComSignalType=UINT16
            DET_AZIMUTH_076_Rx_oRDR_FUSION_DET_073_076_oPCAN_RADAR_66d834ca_Rx: ComSignalType=UINT16
            DET_AZIMUTH_ERR_073_Rx_oRDR_FUSION_DET_073_076_oPCAN_RADAR_1b7444d0_Rx: ComSignalType=UINT8
            DET_AZIMUTH_ERR_074_Rx_oRDR_FUSION_DET_073_076_oPCAN_RADAR_e149b787_Rx: ComSignalType=UINT8
            DET_AZIMUTH_ERR_075_Rx_oRDR_FUSION_DET_073_076_oPCAN_RADAR_4e0d25c0_Rx: ComSignalType=UINT8
            DET_AZIMUTH_ERR_076_Rx_oRDR_FUSION_DET_073_076_oPCAN_RADAR_64b19548_Rx: ComSignalType=UINT8
            DET_BELOW_RAIN_THOLD_073_Rx_oRDR_FUSION_DET_073_076_oPCAN_RADAR_7fa71ae7_Rx: ComSignalType=BOOLEAN
            DET_BELOW_RAIN_THOLD_074_Rx_oRDR_FUSION_DET_073_076_oPCAN_RADAR_859ae9b0_Rx: ComSignalType=BOOLEAN
            DET_BELOW_RAIN_THOLD_075_Rx_oRDR_FUSION_DET_073_076_oPCAN_RADAR_2ade7bf7_Rx: ComSignalType=BOOLEAN
            DET_BELOW_RAIN_THOLD_076_Rx_oRDR_FUSION_DET_073_076_oPCAN_RADAR_0062cb7f_Rx: ComSignalType=BOOLEAN
            DET_BI_STATIC_FLAG_073_Rx_oRDR_FUSION_DET_073_076_oPCAN_RADAR_0839b1f4_Rx: ComSignalType=BOOLEAN
            DET_BI_STATIC_FLAG_074_Rx_oRDR_FUSION_DET_073_076_oPCAN_RADAR_f20442a3_Rx: ComSignalType=BOOLEAN
            DET_BI_STATIC_FLAG_075_Rx_oRDR_FUSION_DET_073_076_oPCAN_RADAR_5d40d0e4_Rx: ComSignalType=BOOLEAN
            DET_BI_STATIC_FLAG_076_Rx_oRDR_FUSION_DET_073_076_oPCAN_RADAR_77fc606c_Rx: ComSignalType=BOOLEAN
            DET_CONFD_AZIMUTH_073_Rx_oRDR_FUSION_DET_073_076_oPCAN_RADAR_eb505ba0_Rx: ComSignalType=UINT8
            DET_CONFD_AZIMUTH_074_Rx_oRDR_FUSION_DET_073_076_oPCAN_RADAR_116da8f7_Rx: ComSignalType=UINT8
            DET_CONFD_AZIMUTH_075_Rx_oRDR_FUSION_DET_073_076_oPCAN_RADAR_be293ab0_Rx: ComSignalType=UINT8
            DET_CONFD_AZIMUTH_076_Rx_oRDR_FUSION_DET_073_076_oPCAN_RADAR_94958a38_Rx: ComSignalType=UINT8
            DET_CONFD_ELEVATION_073_Rx_oRDR_FUSION_DET_073_076_oPCAN_RADAR_e171d827_Rx: ComSignalType=UINT8
            DET_CONFD_ELEVATION_074_Rx_oRDR_FUSION_DET_073_076_oPCAN_RADAR_1b4c2b70_Rx: ComSignalType=UINT8
            DET_CONFD_ELEVATION_075_Rx_oRDR_FUSION_DET_073_076_oPCAN_RADAR_b408b937_Rx: ComSignalType=UINT8
            DET_CONFD_ELEVATION_076_Rx_oRDR_FUSION_DET_073_076_oPCAN_RADAR_9eb409bf_Rx: ComSignalType=UINT8
            DET_ELEVATION_073_Rx_oRDR_FUSION_DET_073_076_oPCAN_RADAR_eb2237de_Rx: ComSignalType=UINT8
            DET_ELEVATION_074_Rx_oRDR_FUSION_DET_073_076_oPCAN_RADAR_111fc489_Rx: ComSignalType=UINT8
            DET_ELEVATION_075_Rx_oRDR_FUSION_DET_073_076_oPCAN_RADAR_be5b56ce_Rx: ComSignalType=UINT8
            DET_ELEVATION_076_Rx_oRDR_FUSION_DET_073_076_oPCAN_RADAR_94e7e646_Rx: ComSignalType=UINT8
            DET_ELEVATION_ERR_073_Rx_oRDR_FUSION_DET_073_076_oPCAN_RADAR_399b1501_Rx: ComSignalType=UINT8
            DET_ELEVATION_ERR_074_Rx_oRDR_FUSION_DET_073_076_oPCAN_RADAR_c3a6e656_Rx: ComSignalType=UINT8
            DET_ELEVATION_ERR_075_Rx_oRDR_FUSION_DET_073_076_oPCAN_RADAR_6ce27411_Rx: ComSignalType=UINT8
            DET_ELEVATION_ERR_076_Rx_oRDR_FUSION_DET_073_076_oPCAN_RADAR_465ec499_Rx: ComSignalType=UINT8
            DET_EXISTENCE_PROB_073_Rx_oRDR_FUSION_DET_073_076_oPCAN_RADAR_ce836d94_Rx: ComSignalType=UINT8
            DET_EXISTENCE_PROB_074_Rx_oRDR_FUSION_DET_073_076_oPCAN_RADAR_34be9ec3_Rx: ComSignalType=UINT8
            DET_EXISTENCE_PROB_075_Rx_oRDR_FUSION_DET_073_076_oPCAN_RADAR_9bfa0c84_Rx: ComSignalType=UINT8
            DET_EXISTENCE_PROB_076_Rx_oRDR_FUSION_DET_073_076_oPCAN_RADAR_b146bc0c_Rx: ComSignalType=UINT8
            DET_HVC_FLAG_073_Rx_oRDR_FUSION_DET_073_076_oPCAN_RADAR_135d80db_Rx: ComSignalType=BOOLEAN
            DET_HVC_FLAG_074_Rx_oRDR_FUSION_DET_073_076_oPCAN_RADAR_e960738c_Rx: ComSignalType=BOOLEAN
            DET_HVC_FLAG_075_Rx_oRDR_FUSION_DET_073_076_oPCAN_RADAR_4624e1cb_Rx: ComSignalType=BOOLEAN
            DET_HVC_FLAG_076_Rx_oRDR_FUSION_DET_073_076_oPCAN_RADAR_6c985143_Rx: ComSignalType=BOOLEAN
            DET_IDM_073_Rx_oRDR_FUSION_DET_073_076_oPCAN_RADAR_269c7993_Rx: ComSignalType=BOOLEAN
            DET_IDM_074_Rx_oRDR_FUSION_DET_073_076_oPCAN_RADAR_dca18ac4_Rx: ComSignalType=BOOLEAN
            DET_IDM_075_Rx_oRDR_FUSION_DET_073_076_oPCAN_RADAR_73e51883_Rx: ComSignalType=BOOLEAN
            DET_IDM_076_Rx_oRDR_FUSION_DET_073_076_oPCAN_RADAR_5959a80b_Rx: ComSignalType=BOOLEAN
            DET_MH_CRC16_073_076_Rx_oRDR_FUSION_DET_073_076_oPCAN_RADAR_b72e2c60_Rx: ComSignalType=UINT16
            DET_MH_CYCLE_COUNTER_073_076_Rx_oRDR_FUSION_DET_073_076_oPCAN_RADAR_baf511a5_Rx: ComSignalType=UINT8
            DET_MH_SCAN_INDEX_4LSB_073_076_Rx_oRDR_FUSION_DET_073_076_oPCAN_RADAR_de45de9e_Rx: ComSignalType=UINT8
            DET_MTD_073_Rx_oRDR_FUSION_DET_073_076_oPCAN_RADAR_9b1f4fe3_Rx: ComSignalType=BOOLEAN
            DET_MTD_074_Rx_oRDR_FUSION_DET_073_076_oPCAN_RADAR_6122bcb4_Rx: ComSignalType=BOOLEAN
            DET_MTD_075_Rx_oRDR_FUSION_DET_073_076_oPCAN_RADAR_ce662ef3_Rx: ComSignalType=BOOLEAN
            DET_MTD_076_Rx_oRDR_FUSION_DET_073_076_oPCAN_RADAR_e4da9e7b_Rx: ComSignalType=BOOLEAN
            DET_PROB_1STAZHYPO_073_Rx_oRDR_FUSION_DET_073_076_oPCAN_RADAR_51665162_Rx: ComSignalType=BOOLEAN
            DET_PROB_1STAZHYPO_074_Rx_oRDR_FUSION_DET_073_076_oPCAN_RADAR_ab5ba235_Rx: ComSignalType=BOOLEAN
            DET_PROB_1STAZHYPO_075_Rx_oRDR_FUSION_DET_073_076_oPCAN_RADAR_041f3072_Rx: ComSignalType=BOOLEAN
            DET_PROB_1STAZHYPO_076_Rx_oRDR_FUSION_DET_073_076_oPCAN_RADAR_2ea380fa_Rx: ComSignalType=BOOLEAN
            DET_RANGE_073_Rx_oRDR_FUSION_DET_073_076_oPCAN_RADAR_0adbb975_Rx: ComSignalType=UINT16
            DET_RANGE_074_Rx_oRDR_FUSION_DET_073_076_oPCAN_RADAR_f0e64a22_Rx: ComSignalType=UINT16
            DET_RANGE_075_Rx_oRDR_FUSION_DET_073_076_oPCAN_RADAR_5fa2d865_Rx: ComSignalType=UINT16
            DET_RANGE_076_Rx_oRDR_FUSION_DET_073_076_oPCAN_RADAR_751e68ed_Rx: ComSignalType=UINT16
            DET_RANGE_ERR_073_Rx_oRDR_FUSION_DET_073_076_oPCAN_RADAR_5a293595_Rx: ComSignalType=UINT8
            DET_RANGE_ERR_074_Rx_oRDR_FUSION_DET_073_076_oPCAN_RADAR_a014c6c2_Rx: ComSignalType=UINT8
            DET_RANGE_ERR_075_Rx_oRDR_FUSION_DET_073_076_oPCAN_RADAR_0f505485_Rx: ComSignalType=UINT8
            DET_RANGE_ERR_076_Rx_oRDR_FUSION_DET_073_076_oPCAN_RADAR_25ece40d_Rx: ComSignalType=UINT8
            DET_RANGE_VELOCITY_073_Rx_oRDR_FUSION_DET_073_076_oPCAN_RADAR_d72e3a8b_Rx: ComSignalType=UINT16
            DET_RANGE_VELOCITY_074_Rx_oRDR_FUSION_DET_073_076_oPCAN_RADAR_2d13c9dc_Rx: ComSignalType=UINT16
            DET_RANGE_VELOCITY_075_Rx_oRDR_FUSION_DET_073_076_oPCAN_RADAR_82575b9b_Rx: ComSignalType=UINT16
            DET_RANGE_VELOCITY_076_Rx_oRDR_FUSION_DET_073_076_oPCAN_RADAR_a8ebeb13_Rx: ComSignalType=UINT16
            DET_RANGE_VELOCITY_ERR_073_Rx_oRDR_FUSION_DET_073_076_oPCAN_RADAR_4e4a4a49_Rx: ComSignalType=UINT8
            DET_RANGE_VELOCITY_ERR_074_Rx_oRDR_FUSION_DET_073_076_oPCAN_RADAR_b477b91e_Rx: ComSignalType=UINT8
            DET_RANGE_VELOCITY_ERR_075_Rx_oRDR_FUSION_DET_073_076_oPCAN_RADAR_1b332b59_Rx: ComSignalType=UINT8
            DET_RANGE_VELOCITY_ERR_076_Rx_oRDR_FUSION_DET_073_076_oPCAN_RADAR_318f9bd1_Rx: ComSignalType=UINT8
            DET_RCS_073_Rx_oRDR_FUSION_DET_073_076_oPCAN_RADAR_1ae5a890_Rx: ComSignalType=UINT8
            DET_RCS_074_Rx_oRDR_FUSION_DET_073_076_oPCAN_RADAR_e0d85bc7_Rx: ComSignalType=UINT8
            DET_RCS_075_Rx_oRDR_FUSION_DET_073_076_oPCAN_RADAR_4f9cc980_Rx: ComSignalType=UINT8
            DET_RCS_076_Rx_oRDR_FUSION_DET_073_076_oPCAN_RADAR_65207908_Rx: ComSignalType=UINT8
            DET_SNR_073_Rx_oRDR_FUSION_DET_073_076_oPCAN_RADAR_13bfd979_Rx: ComSignalType=UINT8
            DET_SNR_074_Rx_oRDR_FUSION_DET_073_076_oPCAN_RADAR_e9822a2e_Rx: ComSignalType=UINT8
            DET_SNR_075_Rx_oRDR_FUSION_DET_073_076_oPCAN_RADAR_46c6b869_Rx: ComSignalType=UINT8
            DET_SNR_076_Rx_oRDR_FUSION_DET_073_076_oPCAN_RADAR_6c7a08e1_Rx: ComSignalType=UINT8
            DET_SUPER_RES_TARGET_073_Rx_oRDR_FUSION_DET_073_076_oPCAN_RADAR_d844f879_Rx: ComSignalType=BOOLEAN
            DET_SUPER_RES_TARGET_074_Rx_oRDR_FUSION_DET_073_076_oPCAN_RADAR_22790b2e_Rx: ComSignalType=BOOLEAN
            DET_SUPER_RES_TARGET_075_Rx_oRDR_FUSION_DET_073_076_oPCAN_RADAR_8d3d9969_Rx: ComSignalType=BOOLEAN
            DET_SUPER_RES_TARGET_076_Rx_oRDR_FUSION_DET_073_076_oPCAN_RADAR_a78129e1_Rx: ComSignalType=BOOLEAN
        SG_Fusion_Detections_077_080_oRDR_FUSION_DET_077_080_oPCAN_RADAR_ea1c1377_Rx
          83 x ComGroupSignal:
            DET_AZIMUTH_077_Rx_oRDR_FUSION_DET_077_080_oPCAN_RADAR_4ce5ea69_Rx: ComSignalType=UINT16
            DET_AZIMUTH_078_Rx_oRDR_FUSION_DET_077_080_oPCAN_RADAR_ccab98c1_Rx: ComSignalType=UINT16
            DET_AZIMUTH_079_Rx_oRDR_FUSION_DET_077_080_oPCAN_RADAR_63ef0a86_Rx: ComSignalType=UINT16
            DET_AZIMUTH_080_Rx_oRDR_FUSION_DET_077_080_oPCAN_RADAR_6e557c96_Rx: ComSignalType=UINT16
            DET_AZIMUTH_ERR_077_Rx_oRDR_FUSION_DET_077_080_oPCAN_RADAR_4e8c4beb_Rx: ComSignalType=UINT8
            DET_AZIMUTH_ERR_078_Rx_oRDR_FUSION_DET_077_080_oPCAN_RADAR_cec23943_Rx: ComSignalType=UINT8
            DET_AZIMUTH_ERR_079_Rx_oRDR_FUSION_DET_077_080_oPCAN_RADAR_6186ab04_Rx: ComSignalType=UINT8
            DET_AZIMUTH_ERR_080_Rx_oRDR_FUSION_DET_077_080_oPCAN_RADAR_6c3cdd14_Rx: ComSignalType=UINT8
            DET_BELOW_RAIN_THOLD_077_Rx_oRDR_FUSION_DET_077_080_oPCAN_RADAR_2a5f15dc_Rx: ComSignalType=BOOLEAN
            DET_BELOW_RAIN_THOLD_078_Rx_oRDR_FUSION_DET_077_080_oPCAN_RADAR_aa116774_Rx: ComSignalType=BOOLEAN
            DET_BELOW_RAIN_THOLD_079_Rx_oRDR_FUSION_DET_077_080_oPCAN_RADAR_0555f533_Rx: ComSignalType=BOOLEAN
            DET_BELOW_RAIN_THOLD_080_Rx_oRDR_FUSION_DET_077_080_oPCAN_RADAR_08ef8323_Rx: ComSignalType=BOOLEAN
            DET_BI_STATIC_FLAG_077_Rx_oRDR_FUSION_DET_077_080_oPCAN_RADAR_5dc1becf_Rx: ComSignalType=BOOLEAN
            DET_BI_STATIC_FLAG_078_Rx_oRDR_FUSION_DET_077_080_oPCAN_RADAR_dd8fcc67_Rx: ComSignalType=BOOLEAN
            DET_BI_STATIC_FLAG_079_Rx_oRDR_FUSION_DET_077_080_oPCAN_RADAR_72cb5e20_Rx: ComSignalType=BOOLEAN
            DET_BI_STATIC_FLAG_080_Rx_oRDR_FUSION_DET_077_080_oPCAN_RADAR_7f712830_Rx: ComSignalType=BOOLEAN
            DET_CONFD_AZIMUTH_077_Rx_oRDR_FUSION_DET_077_080_oPCAN_RADAR_bea8549b_Rx: ComSignalType=UINT8
            DET_CONFD_AZIMUTH_078_Rx_oRDR_FUSION_DET_077_080_oPCAN_RADAR_3ee62633_Rx: ComSignalType=UINT8
            DET_CONFD_AZIMUTH_079_Rx_oRDR_FUSION_DET_077_080_oPCAN_RADAR_91a2b474_Rx: ComSignalType=UINT8
            DET_CONFD_AZIMUTH_080_Rx_oRDR_FUSION_DET_077_080_oPCAN_RADAR_9c18c264_Rx: ComSignalType=UINT8
            DET_CONFD_ELEVATION_077_Rx_oRDR_FUSION_DET_077_080_oPCAN_RADAR_b489d71c_Rx: ComSignalType=UINT8
            DET_CONFD_ELEVATION_078_Rx_oRDR_FUSION_DET_077_080_oPCAN_RADAR_34c7a5b4_Rx: ComSignalType=UINT8
            DET_CONFD_ELEVATION_079_Rx_oRDR_FUSION_DET_077_080_oPCAN_RADAR_9b8337f3_Rx: ComSignalType=UINT8
            DET_CONFD_ELEVATION_080_Rx_oRDR_FUSION_DET_077_080_oPCAN_RADAR_963941e3_Rx: ComSignalType=UINT8
            DET_ELEVATION_077_Rx_oRDR_FUSION_DET_077_080_oPCAN_RADAR_beda38e5_Rx: ComSignalType=UINT8
            DET_ELEVATION_078_Rx_oRDR_FUSION_DET_077_080_oPCAN_RADAR_3e944a4d_Rx: ComSignalType=UINT8
            DET_ELEVATION_079_Rx_oRDR_FUSION_DET_077_080_oPCAN_RADAR_91d0d80a_Rx: ComSignalType=UINT8
            DET_ELEVATION_080_Rx_oRDR_FUSION_DET_077_080_oPCAN_RADAR_9c6aae1a_Rx: ComSignalType=UINT8
            DET_ELEVATION_ERR_077_Rx_oRDR_FUSION_DET_077_080_oPCAN_RADAR_6c631a3a_Rx: ComSignalType=UINT8
            DET_ELEVATION_ERR_078_Rx_oRDR_FUSION_DET_077_080_oPCAN_RADAR_ec2d6892_Rx: ComSignalType=UINT8
            DET_ELEVATION_ERR_079_Rx_oRDR_FUSION_DET_077_080_oPCAN_RADAR_4369fad5_Rx: ComSignalType=UINT8
            DET_ELEVATION_ERR_080_Rx_oRDR_FUSION_DET_077_080_oPCAN_RADAR_4ed38cc5_Rx: ComSignalType=UINT8
            DET_EXISTENCE_PROB_077_Rx_oRDR_FUSION_DET_077_080_oPCAN_RADAR_9b7b62af_Rx: ComSignalType=UINT8
            DET_EXISTENCE_PROB_078_Rx_oRDR_FUSION_DET_077_080_oPCAN_RADAR_1b351007_Rx: ComSignalType=UINT8
            DET_EXISTENCE_PROB_079_Rx_oRDR_FUSION_DET_077_080_oPCAN_RADAR_b4718240_Rx: ComSignalType=UINT8
            DET_EXISTENCE_PROB_080_Rx_oRDR_FUSION_DET_077_080_oPCAN_RADAR_b9cbf450_Rx: ComSignalType=UINT8
            DET_HVC_FLAG_077_Rx_oRDR_FUSION_DET_077_080_oPCAN_RADAR_46a58fe0_Rx: ComSignalType=BOOLEAN
            DET_HVC_FLAG_078_Rx_oRDR_FUSION_DET_077_080_oPCAN_RADAR_c6ebfd48_Rx: ComSignalType=BOOLEAN
            DET_HVC_FLAG_079_Rx_oRDR_FUSION_DET_077_080_oPCAN_RADAR_69af6f0f_Rx: ComSignalType=BOOLEAN
            DET_HVC_FLAG_080_Rx_oRDR_FUSION_DET_077_080_oPCAN_RADAR_6415191f_Rx: ComSignalType=BOOLEAN
            DET_IDM_077_Rx_oRDR_FUSION_DET_077_080_oPCAN_RADAR_736476a8_Rx: ComSignalType=BOOLEAN
            DET_IDM_078_Rx_oRDR_FUSION_DET_077_080_oPCAN_RADAR_f32a0400_Rx: ComSignalType=BOOLEAN
            DET_IDM_079_Rx_oRDR_FUSION_DET_077_080_oPCAN_RADAR_5c6e9647_Rx: ComSignalType=BOOLEAN
            DET_IDM_080_Rx_oRDR_FUSION_DET_077_080_oPCAN_RADAR_51d4e057_Rx: ComSignalType=BOOLEAN
            DET_MH_CRC16_077_080_Rx_oRDR_FUSION_DET_077_080_oPCAN_RADAR_170385b4_Rx: ComSignalType=UINT16
            DET_MH_CYCLE_COUNTER_077_080_Rx_oRDR_FUSION_DET_077_080_oPCAN_RADAR_1ad8b871_Rx: ComSignalType=UINT8
            DET_MH_SCAN_INDEX_4LSB_077_080_Rx_oRDR_FUSION_DET_077_080_oPCAN_RADAR_7e68774a_Rx: ComSignalType=UINT8
            DET_MTD_077_Rx_oRDR_FUSION_DET_077_080_oPCAN_RADAR_cee740d8_Rx: ComSignalType=BOOLEAN
            DET_MTD_078_Rx_oRDR_FUSION_DET_077_080_oPCAN_RADAR_4ea93270_Rx: ComSignalType=BOOLEAN
            DET_MTD_079_Rx_oRDR_FUSION_DET_077_080_oPCAN_RADAR_e1eda037_Rx: ComSignalType=BOOLEAN
            DET_MTD_080_Rx_oRDR_FUSION_DET_077_080_oPCAN_RADAR_ec57d627_Rx: ComSignalType=BOOLEAN
            DET_PROB_1STAZHYPO_077_Rx_oRDR_FUSION_DET_077_080_oPCAN_RADAR_049e5e59_Rx: ComSignalType=BOOLEAN
            DET_PROB_1STAZHYPO_078_Rx_oRDR_FUSION_DET_077_080_oPCAN_RADAR_84d02cf1_Rx: ComSignalType=BOOLEAN
            DET_PROB_1STAZHYPO_079_Rx_oRDR_FUSION_DET_077_080_oPCAN_RADAR_2b94beb6_Rx: ComSignalType=BOOLEAN
            DET_PROB_1STAZHYPO_080_Rx_oRDR_FUSION_DET_077_080_oPCAN_RADAR_262ec8a6_Rx: ComSignalType=BOOLEAN
            DET_RANGE_077_Rx_oRDR_FUSION_DET_077_080_oPCAN_RADAR_5f23b64e_Rx: ComSignalType=UINT16
            DET_RANGE_078_Rx_oRDR_FUSION_DET_077_080_oPCAN_RADAR_df6dc4e6_Rx: ComSignalType=UINT16
            DET_RANGE_079_Rx_oRDR_FUSION_DET_077_080_oPCAN_RADAR_702956a1_Rx: ComSignalType=UINT16
            DET_RANGE_080_Rx_oRDR_FUSION_DET_077_080_oPCAN_RADAR_7d9320b1_Rx: ComSignalType=UINT16
            DET_RANGE_ERR_077_Rx_oRDR_FUSION_DET_077_080_oPCAN_RADAR_0fd13aae_Rx: ComSignalType=UINT8
            DET_RANGE_ERR_078_Rx_oRDR_FUSION_DET_077_080_oPCAN_RADAR_8f9f4806_Rx: ComSignalType=UINT8
            DET_RANGE_ERR_079_Rx_oRDR_FUSION_DET_077_080_oPCAN_RADAR_20dbda41_Rx: ComSignalType=UINT8
            DET_RANGE_ERR_080_Rx_oRDR_FUSION_DET_077_080_oPCAN_RADAR_2d61ac51_Rx: ComSignalType=UINT8
            DET_RANGE_VELOCITY_077_Rx_oRDR_FUSION_DET_077_080_oPCAN_RADAR_82d635b0_Rx: ComSignalType=UINT16
            DET_RANGE_VELOCITY_078_Rx_oRDR_FUSION_DET_077_080_oPCAN_RADAR_02984718_Rx: ComSignalType=UINT16
            DET_RANGE_VELOCITY_079_Rx_oRDR_FUSION_DET_077_080_oPCAN_RADAR_addcd55f_Rx: ComSignalType=UINT16
            DET_RANGE_VELOCITY_080_Rx_oRDR_FUSION_DET_077_080_oPCAN_RADAR_a066a34f_Rx: ComSignalType=UINT16
            DET_RANGE_VELOCITY_ERR_077_Rx_oRDR_FUSION_DET_077_080_oPCAN_RADAR_1bb24572_Rx: ComSignalType=UINT8
            DET_RANGE_VELOCITY_ERR_078_Rx_oRDR_FUSION_DET_077_080_oPCAN_RADAR_9bfc37da_Rx: ComSignalType=UINT8
            DET_RANGE_VELOCITY_ERR_079_Rx_oRDR_FUSION_DET_077_080_oPCAN_RADAR_34b8a59d_Rx: ComSignalType=UINT8
            DET_RANGE_VELOCITY_ERR_080_Rx_oRDR_FUSION_DET_077_080_oPCAN_RADAR_3902d38d_Rx: ComSignalType=UINT8
            DET_RCS_077_Rx_oRDR_FUSION_DET_077_080_oPCAN_RADAR_4f1da7ab_Rx: ComSignalType=UINT8
            DET_RCS_078_Rx_oRDR_FUSION_DET_077_080_oPCAN_RADAR_cf53d503_Rx: ComSignalType=UINT8
            DET_RCS_079_Rx_oRDR_FUSION_DET_077_080_oPCAN_RADAR_60174744_Rx: ComSignalType=UINT8
            DET_RCS_080_Rx_oRDR_FUSION_DET_077_080_oPCAN_RADAR_6dad3154_Rx: ComSignalType=UINT8
            DET_SNR_077_Rx_oRDR_FUSION_DET_077_080_oPCAN_RADAR_4647d642_Rx: ComSignalType=UINT8
            DET_SNR_078_Rx_oRDR_FUSION_DET_077_080_oPCAN_RADAR_c609a4ea_Rx: ComSignalType=UINT8
            DET_SNR_079_Rx_oRDR_FUSION_DET_077_080_oPCAN_RADAR_694d36ad_Rx: ComSignalType=UINT8
            DET_SNR_080_Rx_oRDR_FUSION_DET_077_080_oPCAN_RADAR_64f740bd_Rx: ComSignalType=UINT8
            DET_SUPER_RES_TARGET_077_Rx_oRDR_FUSION_DET_077_080_oPCAN_RADAR_8dbcf742_Rx: ComSignalType=BOOLEAN
            DET_SUPER_RES_TARGET_078_Rx_oRDR_FUSION_DET_077_080_oPCAN_RADAR_0df285ea_Rx: ComSignalType=BOOLEAN
            DET_SUPER_RES_TARGET_079_Rx_oRDR_FUSION_DET_077_080_oPCAN_RADAR_a2b617ad_Rx: ComSignalType=BOOLEAN
            DET_SUPER_RES_TARGET_080_Rx_oRDR_FUSION_DET_077_080_oPCAN_RADAR_af0c61bd_Rx: ComSignalType=BOOLEAN
        SG_Fusion_Detections_081_084_oRDR_FUSION_DET_081_084_oPCAN_RADAR_d08af384_Rx
          83 x ComGroupSignal:
            DET_AZIMUTH_081_Rx_oRDR_FUSION_DET_081_084_oPCAN_RADAR_50e39727_Rx: ComSignalType=UINT16
            DET_AZIMUTH_082_Rx_oRDR_FUSION_DET_081_084_oPCAN_RADAR_7a5f27af_Rx: ComSignalType=UINT16
            DET_AZIMUTH_083_Rx_oRDR_FUSION_DET_081_084_oPCAN_RADAR_d51bb5e8_Rx: ComSignalType=UINT16
            DET_AZIMUTH_084_Rx_oRDR_FUSION_DET_081_084_oPCAN_RADAR_2f2646bf_Rx: ComSignalType=UINT16
            DET_AZIMUTH_ERR_081_Rx_oRDR_FUSION_DET_081_084_oPCAN_RADAR_528a36a5_Rx: ComSignalType=UINT8
            DET_AZIMUTH_ERR_082_Rx_oRDR_FUSION_DET_081_084_oPCAN_RADAR_7836862d_Rx: ComSignalType=UINT8
            DET_AZIMUTH_ERR_083_Rx_oRDR_FUSION_DET_081_084_oPCAN_RADAR_d772146a_Rx: ComSignalType=UINT8
            DET_AZIMUTH_ERR_084_Rx_oRDR_FUSION_DET_081_084_oPCAN_RADAR_2d4fe73d_Rx: ComSignalType=UINT8
            DET_BELOW_RAIN_THOLD_081_Rx_oRDR_FUSION_DET_081_084_oPCAN_RADAR_36596892_Rx: ComSignalType=BOOLEAN
            DET_BELOW_RAIN_THOLD_082_Rx_oRDR_FUSION_DET_081_084_oPCAN_RADAR_1ce5d81a_Rx: ComSignalType=BOOLEAN
            DET_BELOW_RAIN_THOLD_083_Rx_oRDR_FUSION_DET_081_084_oPCAN_RADAR_b3a14a5d_Rx: ComSignalType=BOOLEAN
            DET_BELOW_RAIN_THOLD_084_Rx_oRDR_FUSION_DET_081_084_oPCAN_RADAR_499cb90a_Rx: ComSignalType=BOOLEAN
            DET_BI_STATIC_FLAG_081_Rx_oRDR_FUSION_DET_081_084_oPCAN_RADAR_41c7c381_Rx: ComSignalType=BOOLEAN
            DET_BI_STATIC_FLAG_082_Rx_oRDR_FUSION_DET_081_084_oPCAN_RADAR_6b7b7309_Rx: ComSignalType=BOOLEAN
            DET_BI_STATIC_FLAG_083_Rx_oRDR_FUSION_DET_081_084_oPCAN_RADAR_c43fe14e_Rx: ComSignalType=BOOLEAN
            DET_BI_STATIC_FLAG_084_Rx_oRDR_FUSION_DET_081_084_oPCAN_RADAR_3e021219_Rx: ComSignalType=BOOLEAN
            DET_CONFD_AZIMUTH_081_Rx_oRDR_FUSION_DET_081_084_oPCAN_RADAR_a2ae29d5_Rx: ComSignalType=UINT8
            DET_CONFD_AZIMUTH_082_Rx_oRDR_FUSION_DET_081_084_oPCAN_RADAR_8812995d_Rx: ComSignalType=UINT8
            DET_CONFD_AZIMUTH_083_Rx_oRDR_FUSION_DET_081_084_oPCAN_RADAR_27560b1a_Rx: ComSignalType=UINT8
            DET_CONFD_AZIMUTH_084_Rx_oRDR_FUSION_DET_081_084_oPCAN_RADAR_dd6bf84d_Rx: ComSignalType=UINT8
            DET_CONFD_ELEVATION_081_Rx_oRDR_FUSION_DET_081_084_oPCAN_RADAR_a88faa52_Rx: ComSignalType=UINT8
            DET_CONFD_ELEVATION_082_Rx_oRDR_FUSION_DET_081_084_oPCAN_RADAR_82331ada_Rx: ComSignalType=UINT8
            DET_CONFD_ELEVATION_083_Rx_oRDR_FUSION_DET_081_084_oPCAN_RADAR_2d77889d_Rx: ComSignalType=UINT8
            DET_CONFD_ELEVATION_084_Rx_oRDR_FUSION_DET_081_084_oPCAN_RADAR_d74a7bca_Rx: ComSignalType=UINT8
            DET_ELEVATION_081_Rx_oRDR_FUSION_DET_081_084_oPCAN_RADAR_a2dc45ab_Rx: ComSignalType=UINT8
            DET_ELEVATION_082_Rx_oRDR_FUSION_DET_081_084_oPCAN_RADAR_8860f523_Rx: ComSignalType=UINT8
            DET_ELEVATION_083_Rx_oRDR_FUSION_DET_081_084_oPCAN_RADAR_27246764_Rx: ComSignalType=UINT8
            DET_ELEVATION_084_Rx_oRDR_FUSION_DET_081_084_oPCAN_RADAR_dd199433_Rx: ComSignalType=UINT8
            DET_ELEVATION_ERR_081_Rx_oRDR_FUSION_DET_081_084_oPCAN_RADAR_70656774_Rx: ComSignalType=UINT8
            DET_ELEVATION_ERR_082_Rx_oRDR_FUSION_DET_081_084_oPCAN_RADAR_5ad9d7fc_Rx: ComSignalType=UINT8
            DET_ELEVATION_ERR_083_Rx_oRDR_FUSION_DET_081_084_oPCAN_RADAR_f59d45bb_Rx: ComSignalType=UINT8
            DET_ELEVATION_ERR_084_Rx_oRDR_FUSION_DET_081_084_oPCAN_RADAR_0fa0b6ec_Rx: ComSignalType=UINT8
            DET_EXISTENCE_PROB_081_Rx_oRDR_FUSION_DET_081_084_oPCAN_RADAR_877d1fe1_Rx: ComSignalType=UINT8
            DET_EXISTENCE_PROB_082_Rx_oRDR_FUSION_DET_081_084_oPCAN_RADAR_adc1af69_Rx: ComSignalType=UINT8
            DET_EXISTENCE_PROB_083_Rx_oRDR_FUSION_DET_081_084_oPCAN_RADAR_02853d2e_Rx: ComSignalType=UINT8
            DET_EXISTENCE_PROB_084_Rx_oRDR_FUSION_DET_081_084_oPCAN_RADAR_f8b8ce79_Rx: ComSignalType=UINT8
            DET_HVC_FLAG_081_Rx_oRDR_FUSION_DET_081_084_oPCAN_RADAR_5aa3f2ae_Rx: ComSignalType=BOOLEAN
            DET_HVC_FLAG_082_Rx_oRDR_FUSION_DET_081_084_oPCAN_RADAR_701f4226_Rx: ComSignalType=BOOLEAN
            DET_HVC_FLAG_083_Rx_oRDR_FUSION_DET_081_084_oPCAN_RADAR_df5bd061_Rx: ComSignalType=BOOLEAN
            DET_HVC_FLAG_084_Rx_oRDR_FUSION_DET_081_084_oPCAN_RADAR_25662336_Rx: ComSignalType=BOOLEAN
            DET_IDM_081_Rx_oRDR_FUSION_DET_081_084_oPCAN_RADAR_6f620be6_Rx: ComSignalType=BOOLEAN
            DET_IDM_082_Rx_oRDR_FUSION_DET_081_084_oPCAN_RADAR_45debb6e_Rx: ComSignalType=BOOLEAN
            DET_IDM_083_Rx_oRDR_FUSION_DET_081_084_oPCAN_RADAR_ea9a2929_Rx: ComSignalType=BOOLEAN
            DET_IDM_084_Rx_oRDR_FUSION_DET_081_084_oPCAN_RADAR_10a7da7e_Rx: ComSignalType=BOOLEAN
            DET_MH_CRC16_081_084_Rx_oRDR_FUSION_DET_081_084_oPCAN_RADAR_6a66aa10_Rx: ComSignalType=UINT16
            DET_MH_CYCLE_COUNTER_081_084_Rx_oRDR_FUSION_DET_081_084_oPCAN_RADAR_67bd97d5_Rx: ComSignalType=UINT8
            DET_MH_SCAN_INDEX_4LSB_081_084_Rx_oRDR_FUSION_DET_081_084_oPCAN_RADAR_030d58ee_Rx: ComSignalType=UINT8
            DET_MTD_081_Rx_oRDR_FUSION_DET_081_084_oPCAN_RADAR_d2e13d96_Rx: ComSignalType=BOOLEAN
            DET_MTD_082_Rx_oRDR_FUSION_DET_081_084_oPCAN_RADAR_f85d8d1e_Rx: ComSignalType=BOOLEAN
            DET_MTD_083_Rx_oRDR_FUSION_DET_081_084_oPCAN_RADAR_57191f59_Rx: ComSignalType=BOOLEAN
            DET_MTD_084_Rx_oRDR_FUSION_DET_081_084_oPCAN_RADAR_ad24ec0e_Rx: ComSignalType=BOOLEAN
            DET_PROB_1STAZHYPO_081_Rx_oRDR_FUSION_DET_081_084_oPCAN_RADAR_18982317_Rx: ComSignalType=BOOLEAN
            DET_PROB_1STAZHYPO_082_Rx_oRDR_FUSION_DET_081_084_oPCAN_RADAR_3224939f_Rx: ComSignalType=BOOLEAN
            DET_PROB_1STAZHYPO_083_Rx_oRDR_FUSION_DET_081_084_oPCAN_RADAR_9d6001d8_Rx: ComSignalType=BOOLEAN
            DET_PROB_1STAZHYPO_084_Rx_oRDR_FUSION_DET_081_084_oPCAN_RADAR_675df28f_Rx: ComSignalType=BOOLEAN
            DET_RANGE_081_Rx_oRDR_FUSION_DET_081_084_oPCAN_RADAR_4325cb00_Rx: ComSignalType=UINT16
            DET_RANGE_082_Rx_oRDR_FUSION_DET_081_084_oPCAN_RADAR_69997b88_Rx: ComSignalType=UINT16
            DET_RANGE_083_Rx_oRDR_FUSION_DET_081_084_oPCAN_RADAR_c6dde9cf_Rx: ComSignalType=UINT16
            DET_RANGE_084_Rx_oRDR_FUSION_DET_081_084_oPCAN_RADAR_3ce01a98_Rx: ComSignalType=UINT16
            DET_RANGE_ERR_081_Rx_oRDR_FUSION_DET_081_084_oPCAN_RADAR_13d747e0_Rx: ComSignalType=UINT8
            DET_RANGE_ERR_082_Rx_oRDR_FUSION_DET_081_084_oPCAN_RADAR_396bf768_Rx: ComSignalType=UINT8
            DET_RANGE_ERR_083_Rx_oRDR_FUSION_DET_081_084_oPCAN_RADAR_962f652f_Rx: ComSignalType=UINT8
            DET_RANGE_ERR_084_Rx_oRDR_FUSION_DET_081_084_oPCAN_RADAR_6c129678_Rx: ComSignalType=UINT8
            DET_RANGE_VELOCITY_081_Rx_oRDR_FUSION_DET_081_084_oPCAN_RADAR_9ed048fe_Rx: ComSignalType=UINT16
            DET_RANGE_VELOCITY_082_Rx_oRDR_FUSION_DET_081_084_oPCAN_RADAR_b46cf876_Rx: ComSignalType=UINT16
            DET_RANGE_VELOCITY_083_Rx_oRDR_FUSION_DET_081_084_oPCAN_RADAR_1b286a31_Rx: ComSignalType=UINT16
            DET_RANGE_VELOCITY_084_Rx_oRDR_FUSION_DET_081_084_oPCAN_RADAR_e1159966_Rx: ComSignalType=UINT16
            DET_RANGE_VELOCITY_ERR_081_Rx_oRDR_FUSION_DET_081_084_oPCAN_RADAR_07b4383c_Rx: ComSignalType=UINT8
            DET_RANGE_VELOCITY_ERR_082_Rx_oRDR_FUSION_DET_081_084_oPCAN_RADAR_2d0888b4_Rx: ComSignalType=UINT8
            DET_RANGE_VELOCITY_ERR_083_Rx_oRDR_FUSION_DET_081_084_oPCAN_RADAR_824c1af3_Rx: ComSignalType=UINT8
            DET_RANGE_VELOCITY_ERR_084_Rx_oRDR_FUSION_DET_081_084_oPCAN_RADAR_7871e9a4_Rx: ComSignalType=UINT8
            DET_RCS_081_Rx_oRDR_FUSION_DET_081_084_oPCAN_RADAR_531bdae5_Rx: ComSignalType=UINT8
            DET_RCS_082_Rx_oRDR_FUSION_DET_081_084_oPCAN_RADAR_79a76a6d_Rx: ComSignalType=UINT8
            DET_RCS_083_Rx_oRDR_FUSION_DET_081_084_oPCAN_RADAR_d6e3f82a_Rx: ComSignalType=UINT8
            DET_RCS_084_Rx_oRDR_FUSION_DET_081_084_oPCAN_RADAR_2cde0b7d_Rx: ComSignalType=UINT8
            DET_SNR_081_Rx_oRDR_FUSION_DET_081_084_oPCAN_RADAR_5a41ab0c_Rx: ComSignalType=UINT8
            DET_SNR_082_Rx_oRDR_FUSION_DET_081_084_oPCAN_RADAR_70fd1b84_Rx: ComSignalType=UINT8
            DET_SNR_083_Rx_oRDR_FUSION_DET_081_084_oPCAN_RADAR_dfb989c3_Rx: ComSignalType=UINT8
            DET_SNR_084_Rx_oRDR_FUSION_DET_081_084_oPCAN_RADAR_25847a94_Rx: ComSignalType=UINT8
            DET_SUPER_RES_TARGET_081_Rx_oRDR_FUSION_DET_081_084_oPCAN_RADAR_91ba8a0c_Rx: ComSignalType=BOOLEAN
            DET_SUPER_RES_TARGET_082_Rx_oRDR_FUSION_DET_081_084_oPCAN_RADAR_bb063a84_Rx: ComSignalType=BOOLEAN
            DET_SUPER_RES_TARGET_083_Rx_oRDR_FUSION_DET_081_084_oPCAN_RADAR_1442a8c3_Rx: ComSignalType=BOOLEAN
            DET_SUPER_RES_TARGET_084_Rx_oRDR_FUSION_DET_081_084_oPCAN_RADAR_ee7f5b94_Rx: ComSignalType=BOOLEAN
        SG_Fusion_Detections_085_088_oRDR_FUSION_DET_085_088_oPCAN_RADAR_9d71d877_Rx
          83 x ComGroupSignal:
            DET_AZIMUTH_085_Rx_oRDR_FUSION_DET_085_088_oPCAN_RADAR_69d04acc_Rx: ComSignalType=UINT16
            DET_AZIMUTH_086_Rx_oRDR_FUSION_DET_085_088_oPCAN_RADAR_436cfa44_Rx: ComSignalType=UINT16
            DET_AZIMUTH_087_Rx_oRDR_FUSION_DET_085_088_oPCAN_RADAR_ec286803_Rx: ComSignalType=UINT16
            DET_AZIMUTH_088_Rx_oRDR_FUSION_DET_085_088_oPCAN_RADAR_6c661aab_Rx: ComSignalType=UINT16
            DET_AZIMUTH_ERR_085_Rx_oRDR_FUSION_DET_085_088_oPCAN_RADAR_6bb9eb4e_Rx: ComSignalType=UINT8
            DET_AZIMUTH_ERR_086_Rx_oRDR_FUSION_DET_085_088_oPCAN_RADAR_41055bc6_Rx: ComSignalType=UINT8
            DET_AZIMUTH_ERR_087_Rx_oRDR_FUSION_DET_085_088_oPCAN_RADAR_ee41c981_Rx: ComSignalType=UINT8
            DET_AZIMUTH_ERR_088_Rx_oRDR_FUSION_DET_085_088_oPCAN_RADAR_6e0fbb29_Rx: ComSignalType=UINT8
            DET_BELOW_RAIN_THOLD_085_Rx_oRDR_FUSION_DET_085_088_oPCAN_RADAR_0f6ab579_Rx: ComSignalType=BOOLEAN
            DET_BELOW_RAIN_THOLD_086_Rx_oRDR_FUSION_DET_085_088_oPCAN_RADAR_25d605f1_Rx: ComSignalType=BOOLEAN
            DET_BELOW_RAIN_THOLD_087_Rx_oRDR_FUSION_DET_085_088_oPCAN_RADAR_8a9297b6_Rx: ComSignalType=BOOLEAN
            DET_BELOW_RAIN_THOLD_088_Rx_oRDR_FUSION_DET_085_088_oPCAN_RADAR_0adce51e_Rx: ComSignalType=BOOLEAN
            DET_BI_STATIC_FLAG_085_Rx_oRDR_FUSION_DET_085_088_oPCAN_RADAR_78f41e6a_Rx: ComSignalType=BOOLEAN
            DET_BI_STATIC_FLAG_086_Rx_oRDR_FUSION_DET_085_088_oPCAN_RADAR_5248aee2_Rx: ComSignalType=BOOLEAN
            DET_BI_STATIC_FLAG_087_Rx_oRDR_FUSION_DET_085_088_oPCAN_RADAR_fd0c3ca5_Rx: ComSignalType=BOOLEAN
            DET_BI_STATIC_FLAG_088_Rx_oRDR_FUSION_DET_085_088_oPCAN_RADAR_7d424e0d_Rx: ComSignalType=BOOLEAN
            DET_CONFD_AZIMUTH_085_Rx_oRDR_FUSION_DET_085_088_oPCAN_RADAR_9b9df43e_Rx: ComSignalType=UINT8
            DET_CONFD_AZIMUTH_086_Rx_oRDR_FUSION_DET_085_088_oPCAN_RADAR_b12144b6_Rx: ComSignalType=UINT8
            DET_CONFD_AZIMUTH_087_Rx_oRDR_FUSION_DET_085_088_oPCAN_RADAR_1e65d6f1_Rx: ComSignalType=UINT8
            DET_CONFD_AZIMUTH_088_Rx_oRDR_FUSION_DET_085_088_oPCAN_RADAR_9e2ba459_Rx: ComSignalType=UINT8
            DET_CONFD_ELEVATION_085_Rx_oRDR_FUSION_DET_085_088_oPCAN_RADAR_91bc77b9_Rx: ComSignalType=UINT8
            DET_CONFD_ELEVATION_086_Rx_oRDR_FUSION_DET_085_088_oPCAN_RADAR_bb00c731_Rx: ComSignalType=UINT8
            DET_CONFD_ELEVATION_087_Rx_oRDR_FUSION_DET_085_088_oPCAN_RADAR_14445576_Rx: ComSignalType=UINT8
            DET_CONFD_ELEVATION_088_Rx_oRDR_FUSION_DET_085_088_oPCAN_RADAR_940a27de_Rx: ComSignalType=UINT8
            DET_ELEVATION_085_Rx_oRDR_FUSION_DET_085_088_oPCAN_RADAR_9bef9840_Rx: ComSignalType=UINT8
            DET_ELEVATION_086_Rx_oRDR_FUSION_DET_085_088_oPCAN_RADAR_b15328c8_Rx: ComSignalType=UINT8
            DET_ELEVATION_087_Rx_oRDR_FUSION_DET_085_088_oPCAN_RADAR_1e17ba8f_Rx: ComSignalType=UINT8
            DET_ELEVATION_088_Rx_oRDR_FUSION_DET_085_088_oPCAN_RADAR_9e59c827_Rx: ComSignalType=UINT8
            DET_ELEVATION_ERR_085_Rx_oRDR_FUSION_DET_085_088_oPCAN_RADAR_4956ba9f_Rx: ComSignalType=UINT8
            DET_ELEVATION_ERR_086_Rx_oRDR_FUSION_DET_085_088_oPCAN_RADAR_63ea0a17_Rx: ComSignalType=UINT8
            DET_ELEVATION_ERR_087_Rx_oRDR_FUSION_DET_085_088_oPCAN_RADAR_ccae9850_Rx: ComSignalType=UINT8
            DET_ELEVATION_ERR_088_Rx_oRDR_FUSION_DET_085_088_oPCAN_RADAR_4ce0eaf8_Rx: ComSignalType=UINT8
            DET_EXISTENCE_PROB_085_Rx_oRDR_FUSION_DET_085_088_oPCAN_RADAR_be4ec20a_Rx: ComSignalType=UINT8
            DET_EXISTENCE_PROB_086_Rx_oRDR_FUSION_DET_085_088_oPCAN_RADAR_94f27282_Rx: ComSignalType=UINT8
            DET_EXISTENCE_PROB_087_Rx_oRDR_FUSION_DET_085_088_oPCAN_RADAR_3bb6e0c5_Rx: ComSignalType=UINT8
            DET_EXISTENCE_PROB_088_Rx_oRDR_FUSION_DET_085_088_oPCAN_RADAR_bbf8926d_Rx: ComSignalType=UINT8
            DET_HVC_FLAG_085_Rx_oRDR_FUSION_DET_085_088_oPCAN_RADAR_63902f45_Rx: ComSignalType=BOOLEAN
            DET_HVC_FLAG_086_Rx_oRDR_FUSION_DET_085_088_oPCAN_RADAR_492c9fcd_Rx: ComSignalType=BOOLEAN
            DET_HVC_FLAG_087_Rx_oRDR_FUSION_DET_085_088_oPCAN_RADAR_e6680d8a_Rx: ComSignalType=BOOLEAN
            DET_HVC_FLAG_088_Rx_oRDR_FUSION_DET_085_088_oPCAN_RADAR_66267f22_Rx: ComSignalType=BOOLEAN
            DET_IDM_085_Rx_oRDR_FUSION_DET_085_088_oPCAN_RADAR_5651d60d_Rx: ComSignalType=BOOLEAN
            DET_IDM_086_Rx_oRDR_FUSION_DET_085_088_oPCAN_RADAR_7ced6685_Rx: ComSignalType=BOOLEAN
            DET_IDM_087_Rx_oRDR_FUSION_DET_085_088_oPCAN_RADAR_d3a9f4c2_Rx: ComSignalType=BOOLEAN
            DET_IDM_088_Rx_oRDR_FUSION_DET_085_088_oPCAN_RADAR_53e7866a_Rx: ComSignalType=BOOLEAN
            DET_MH_CRC16_085_088_Rx_oRDR_FUSION_DET_085_088_oPCAN_RADAR_8186178c_Rx: ComSignalType=UINT16
            DET_MH_CYCLE_COUNTER_085_088_Rx_oRDR_FUSION_DET_085_088_oPCAN_RADAR_8c5d2a49_Rx: ComSignalType=UINT8
            DET_MH_SCAN_INDEX_4LSB_085_088_Rx_oRDR_FUSION_DET_085_088_oPCAN_RADAR_e8ede572_Rx: ComSignalType=UINT8
            DET_MTD_085_Rx_oRDR_FUSION_DET_085_088_oPCAN_RADAR_ebd2e07d_Rx: ComSignalType=BOOLEAN
            DET_MTD_086_Rx_oRDR_FUSION_DET_085_088_oPCAN_RADAR_c16e50f5_Rx: ComSignalType=BOOLEAN
            DET_MTD_087_Rx_oRDR_FUSION_DET_085_088_oPCAN_RADAR_6e2ac2b2_Rx: ComSignalType=BOOLEAN
            DET_MTD_088_Rx_oRDR_FUSION_DET_085_088_oPCAN_RADAR_ee64b01a_Rx: ComSignalType=BOOLEAN
            DET_PROB_1STAZHYPO_085_Rx_oRDR_FUSION_DET_085_088_oPCAN_RADAR_21abfefc_Rx: ComSignalType=BOOLEAN
            DET_PROB_1STAZHYPO_086_Rx_oRDR_FUSION_DET_085_088_oPCAN_RADAR_0b174e74_Rx: ComSignalType=BOOLEAN
            DET_PROB_1STAZHYPO_087_Rx_oRDR_FUSION_DET_085_088_oPCAN_RADAR_a453dc33_Rx: ComSignalType=BOOLEAN
            DET_PROB_1STAZHYPO_088_Rx_oRDR_FUSION_DET_085_088_oPCAN_RADAR_241dae9b_Rx: ComSignalType=BOOLEAN
            DET_RANGE_085_Rx_oRDR_FUSION_DET_085_088_oPCAN_RADAR_7a1616eb_Rx: ComSignalType=UINT16
            DET_RANGE_086_Rx_oRDR_FUSION_DET_085_088_oPCAN_RADAR_50aaa663_Rx: ComSignalType=UINT16
            DET_RANGE_087_Rx_oRDR_FUSION_DET_085_088_oPCAN_RADAR_ffee3424_Rx: ComSignalType=UINT16
            DET_RANGE_088_Rx_oRDR_FUSION_DET_085_088_oPCAN_RADAR_7fa0468c_Rx: ComSignalType=UINT16
            DET_RANGE_ERR_085_Rx_oRDR_FUSION_DET_085_088_oPCAN_RADAR_2ae49a0b_Rx: ComSignalType=UINT8
            DET_RANGE_ERR_086_Rx_oRDR_FUSION_DET_085_088_oPCAN_RADAR_00582a83_Rx: ComSignalType=UINT8
            DET_RANGE_ERR_087_Rx_oRDR_FUSION_DET_085_088_oPCAN_RADAR_af1cb8c4_Rx: ComSignalType=UINT8
            DET_RANGE_ERR_088_Rx_oRDR_FUSION_DET_085_088_oPCAN_RADAR_2f52ca6c_Rx: ComSignalType=UINT8
            DET_RANGE_VELOCITY_085_Rx_oRDR_FUSION_DET_085_088_oPCAN_RADAR_a7e39515_Rx: ComSignalType=UINT16
            DET_RANGE_VELOCITY_086_Rx_oRDR_FUSION_DET_085_088_oPCAN_RADAR_8d5f259d_Rx: ComSignalType=UINT16
            DET_RANGE_VELOCITY_087_Rx_oRDR_FUSION_DET_085_088_oPCAN_RADAR_221bb7da_Rx: ComSignalType=UINT16
            DET_RANGE_VELOCITY_088_Rx_oRDR_FUSION_DET_085_088_oPCAN_RADAR_a255c572_Rx: ComSignalType=UINT16
            DET_RANGE_VELOCITY_ERR_085_Rx_oRDR_FUSION_DET_085_088_oPCAN_RADAR_3e87e5d7_Rx: ComSignalType=UINT8
            DET_RANGE_VELOCITY_ERR_086_Rx_oRDR_FUSION_DET_085_088_oPCAN_RADAR_143b555f_Rx: ComSignalType=UINT8
            DET_RANGE_VELOCITY_ERR_087_Rx_oRDR_FUSION_DET_085_088_oPCAN_RADAR_bb7fc718_Rx: ComSignalType=UINT8
            DET_RANGE_VELOCITY_ERR_088_Rx_oRDR_FUSION_DET_085_088_oPCAN_RADAR_3b31b5b0_Rx: ComSignalType=UINT8
            DET_RCS_085_Rx_oRDR_FUSION_DET_085_088_oPCAN_RADAR_6a28070e_Rx: ComSignalType=UINT8
            DET_RCS_086_Rx_oRDR_FUSION_DET_085_088_oPCAN_RADAR_4094b786_Rx: ComSignalType=UINT8
            DET_RCS_087_Rx_oRDR_FUSION_DET_085_088_oPCAN_RADAR_efd025c1_Rx: ComSignalType=UINT8
            DET_RCS_088_Rx_oRDR_FUSION_DET_085_088_oPCAN_RADAR_6f9e5769_Rx: ComSignalType=UINT8
            DET_SNR_085_Rx_oRDR_FUSION_DET_085_088_oPCAN_RADAR_637276e7_Rx: ComSignalType=UINT8
            DET_SNR_086_Rx_oRDR_FUSION_DET_085_088_oPCAN_RADAR_49cec66f_Rx: ComSignalType=UINT8
            DET_SNR_087_Rx_oRDR_FUSION_DET_085_088_oPCAN_RADAR_e68a5428_Rx: ComSignalType=UINT8
            DET_SNR_088_Rx_oRDR_FUSION_DET_085_088_oPCAN_RADAR_66c42680_Rx: ComSignalType=UINT8
            DET_SUPER_RES_TARGET_085_Rx_oRDR_FUSION_DET_085_088_oPCAN_RADAR_a88957e7_Rx: ComSignalType=BOOLEAN
            DET_SUPER_RES_TARGET_086_Rx_oRDR_FUSION_DET_085_088_oPCAN_RADAR_8235e76f_Rx: ComSignalType=BOOLEAN
            DET_SUPER_RES_TARGET_087_Rx_oRDR_FUSION_DET_085_088_oPCAN_RADAR_2d717528_Rx: ComSignalType=BOOLEAN
            DET_SUPER_RES_TARGET_088_Rx_oRDR_FUSION_DET_085_088_oPCAN_RADAR_ad3f0780_Rx: ComSignalType=BOOLEAN
        SG_Fusion_Detections_089_092_oRDR_FUSION_DET_089_092_oPCAN_RADAR_1f429d9f_Rx
          83 x ComGroupSignal:
            DET_AZIMUTH_089_Rx_oRDR_FUSION_DET_089_092_oPCAN_RADAR_f16a67ed_Rx: ComSignalType=UINT16
            DET_AZIMUTH_090_Rx_oRDR_FUSION_DET_089_092_oPCAN_RADAR_cc4ae4f4_Rx: ComSignalType=UINT16
            DET_AZIMUTH_091_Rx_oRDR_FUSION_DET_089_092_oPCAN_RADAR_630e76b3_Rx: ComSignalType=UINT16
            DET_AZIMUTH_092_Rx_oRDR_FUSION_DET_089_092_oPCAN_RADAR_49b2c63b_Rx: ComSignalType=UINT16
            DET_AZIMUTH_ERR_089_Rx_oRDR_FUSION_DET_089_092_oPCAN_RADAR_f303c66f_Rx: ComSignalType=UINT8
            DET_AZIMUTH_ERR_090_Rx_oRDR_FUSION_DET_089_092_oPCAN_RADAR_ce234576_Rx: ComSignalType=UINT8
            DET_AZIMUTH_ERR_091_Rx_oRDR_FUSION_DET_089_092_oPCAN_RADAR_6167d731_Rx: ComSignalType=UINT8
            DET_AZIMUTH_ERR_092_Rx_oRDR_FUSION_DET_089_092_oPCAN_RADAR_4bdb67b9_Rx: ComSignalType=UINT8
            DET_BELOW_RAIN_THOLD_089_Rx_oRDR_FUSION_DET_089_092_oPCAN_RADAR_97d09858_Rx: ComSignalType=BOOLEAN
            DET_BELOW_RAIN_THOLD_090_Rx_oRDR_FUSION_DET_089_092_oPCAN_RADAR_aaf01b41_Rx: ComSignalType=BOOLEAN
            DET_BELOW_RAIN_THOLD_091_Rx_oRDR_FUSION_DET_089_092_oPCAN_RADAR_05b48906_Rx: ComSignalType=BOOLEAN
            DET_BELOW_RAIN_THOLD_092_Rx_oRDR_FUSION_DET_089_092_oPCAN_RADAR_2f08398e_Rx: ComSignalType=BOOLEAN
            DET_BI_STATIC_FLAG_089_Rx_oRDR_FUSION_DET_089_092_oPCAN_RADAR_e04e334b_Rx: ComSignalType=BOOLEAN
            DET_BI_STATIC_FLAG_090_Rx_oRDR_FUSION_DET_089_092_oPCAN_RADAR_dd6eb052_Rx: ComSignalType=BOOLEAN
            DET_BI_STATIC_FLAG_091_Rx_oRDR_FUSION_DET_089_092_oPCAN_RADAR_722a2215_Rx: ComSignalType=BOOLEAN
            DET_BI_STATIC_FLAG_092_Rx_oRDR_FUSION_DET_089_092_oPCAN_RADAR_5896929d_Rx: ComSignalType=BOOLEAN
            DET_CONFD_AZIMUTH_089_Rx_oRDR_FUSION_DET_089_092_oPCAN_RADAR_0327d91f_Rx: ComSignalType=UINT8
            DET_CONFD_AZIMUTH_090_Rx_oRDR_FUSION_DET_089_092_oPCAN_RADAR_3e075a06_Rx: ComSignalType=UINT8
            DET_CONFD_AZIMUTH_091_Rx_oRDR_FUSION_DET_089_092_oPCAN_RADAR_9143c841_Rx: ComSignalType=UINT8
            DET_CONFD_AZIMUTH_092_Rx_oRDR_FUSION_DET_089_092_oPCAN_RADAR_bbff78c9_Rx: ComSignalType=UINT8
            DET_CONFD_ELEVATION_089_Rx_oRDR_FUSION_DET_089_092_oPCAN_RADAR_09065a98_Rx: ComSignalType=UINT8
            DET_CONFD_ELEVATION_090_Rx_oRDR_FUSION_DET_089_092_oPCAN_RADAR_3426d981_Rx: ComSignalType=UINT8
            DET_CONFD_ELEVATION_091_Rx_oRDR_FUSION_DET_089_092_oPCAN_RADAR_9b624bc6_Rx: ComSignalType=UINT8
            DET_CONFD_ELEVATION_092_Rx_oRDR_FUSION_DET_089_092_oPCAN_RADAR_b1defb4e_Rx: ComSignalType=UINT8
            DET_ELEVATION_089_Rx_oRDR_FUSION_DET_089_092_oPCAN_RADAR_0355b561_Rx: ComSignalType=UINT8
            DET_ELEVATION_090_Rx_oRDR_FUSION_DET_089_092_oPCAN_RADAR_3e753678_Rx: ComSignalType=UINT8
            DET_ELEVATION_091_Rx_oRDR_FUSION_DET_089_092_oPCAN_RADAR_9131a43f_Rx: ComSignalType=UINT8
            DET_ELEVATION_092_Rx_oRDR_FUSION_DET_089_092_oPCAN_RADAR_bb8d14b7_Rx: ComSignalType=UINT8
            DET_ELEVATION_ERR_089_Rx_oRDR_FUSION_DET_089_092_oPCAN_RADAR_d1ec97be_Rx: ComSignalType=UINT8
            DET_ELEVATION_ERR_090_Rx_oRDR_FUSION_DET_089_092_oPCAN_RADAR_eccc14a7_Rx: ComSignalType=UINT8
            DET_ELEVATION_ERR_091_Rx_oRDR_FUSION_DET_089_092_oPCAN_RADAR_438886e0_Rx: ComSignalType=UINT8
            DET_ELEVATION_ERR_092_Rx_oRDR_FUSION_DET_089_092_oPCAN_RADAR_69343668_Rx: ComSignalType=UINT8
            DET_EXISTENCE_PROB_089_Rx_oRDR_FUSION_DET_089_092_oPCAN_RADAR_26f4ef2b_Rx: ComSignalType=UINT8
            DET_EXISTENCE_PROB_090_Rx_oRDR_FUSION_DET_089_092_oPCAN_RADAR_1bd46c32_Rx: ComSignalType=UINT8
            DET_EXISTENCE_PROB_091_Rx_oRDR_FUSION_DET_089_092_oPCAN_RADAR_b490fe75_Rx: ComSignalType=UINT8
            DET_EXISTENCE_PROB_092_Rx_oRDR_FUSION_DET_089_092_oPCAN_RADAR_9e2c4efd_Rx: ComSignalType=UINT8
            DET_HVC_FLAG_089_Rx_oRDR_FUSION_DET_089_092_oPCAN_RADAR_fb2a0264_Rx: ComSignalType=BOOLEAN
            DET_HVC_FLAG_090_Rx_oRDR_FUSION_DET_089_092_oPCAN_RADAR_c60a817d_Rx: ComSignalType=BOOLEAN
            DET_HVC_FLAG_091_Rx_oRDR_FUSION_DET_089_092_oPCAN_RADAR_694e133a_Rx: ComSignalType=BOOLEAN
            DET_HVC_FLAG_092_Rx_oRDR_FUSION_DET_089_092_oPCAN_RADAR_43f2a3b2_Rx: ComSignalType=BOOLEAN
            DET_IDM_089_Rx_oRDR_FUSION_DET_089_092_oPCAN_RADAR_ceebfb2c_Rx: ComSignalType=BOOLEAN
            DET_IDM_090_Rx_oRDR_FUSION_DET_089_092_oPCAN_RADAR_f3cb7835_Rx: ComSignalType=BOOLEAN
            DET_IDM_091_Rx_oRDR_FUSION_DET_089_092_oPCAN_RADAR_5c8fea72_Rx: ComSignalType=BOOLEAN
            DET_IDM_092_Rx_oRDR_FUSION_DET_089_092_oPCAN_RADAR_76335afa_Rx: ComSignalType=BOOLEAN
            DET_MH_CRC16_089_092_Rx_oRDR_FUSION_DET_089_092_oPCAN_RADAR_86c2efc5_Rx: ComSignalType=UINT16
            DET_MH_CYCLE_COUNTER_089_092_Rx_oRDR_FUSION_DET_089_092_oPCAN_RADAR_8b19d200_Rx: ComSignalType=UINT8
            DET_MH_SCAN_INDEX_4LSB_089_092_Rx_oRDR_FUSION_DET_089_092_oPCAN_RADAR_efa91d3b_Rx: ComSignalType=UINT8
            DET_MTD_089_Rx_oRDR_FUSION_DET_089_092_oPCAN_RADAR_7368cd5c_Rx: ComSignalType=BOOLEAN
            DET_MTD_090_Rx_oRDR_FUSION_DET_089_092_oPCAN_RADAR_4e484e45_Rx: ComSignalType=BOOLEAN
            DET_MTD_091_Rx_oRDR_FUSION_DET_089_092_oPCAN_RADAR_e10cdc02_Rx: ComSignalType=BOOLEAN
            DET_MTD_092_Rx_oRDR_FUSION_DET_089_092_oPCAN_RADAR_cbb06c8a_Rx: ComSignalType=BOOLEAN
            DET_PROB_1STAZHYPO_089_Rx_oRDR_FUSION_DET_089_092_oPCAN_RADAR_b911d3dd_Rx: ComSignalType=BOOLEAN
            DET_PROB_1STAZHYPO_090_Rx_oRDR_FUSION_DET_089_092_oPCAN_RADAR_843150c4_Rx: ComSignalType=BOOLEAN
            DET_PROB_1STAZHYPO_091_Rx_oRDR_FUSION_DET_089_092_oPCAN_RADAR_2b75c283_Rx: ComSignalType=BOOLEAN
            DET_PROB_1STAZHYPO_092_Rx_oRDR_FUSION_DET_089_092_oPCAN_RADAR_01c9720b_Rx: ComSignalType=BOOLEAN
            DET_RANGE_089_Rx_oRDR_FUSION_DET_089_092_oPCAN_RADAR_e2ac3bca_Rx: ComSignalType=UINT16
            DET_RANGE_090_Rx_oRDR_FUSION_DET_089_092_oPCAN_RADAR_df8cb8d3_Rx: ComSignalType=UINT16
            DET_RANGE_091_Rx_oRDR_FUSION_DET_089_092_oPCAN_RADAR_70c82a94_Rx: ComSignalType=UINT16
            DET_RANGE_092_Rx_oRDR_FUSION_DET_089_092_oPCAN_RADAR_5a749a1c_Rx: ComSignalType=UINT16
            DET_RANGE_ERR_089_Rx_oRDR_FUSION_DET_089_092_oPCAN_RADAR_b25eb72a_Rx: ComSignalType=UINT8
            DET_RANGE_ERR_090_Rx_oRDR_FUSION_DET_089_092_oPCAN_RADAR_8f7e3433_Rx: ComSignalType=UINT8
            DET_RANGE_ERR_091_Rx_oRDR_FUSION_DET_089_092_oPCAN_RADAR_203aa674_Rx: ComSignalType=UINT8
            DET_RANGE_ERR_092_Rx_oRDR_FUSION_DET_089_092_oPCAN_RADAR_0a8616fc_Rx: ComSignalType=UINT8
            DET_RANGE_VELOCITY_089_Rx_oRDR_FUSION_DET_089_092_oPCAN_RADAR_3f59b834_Rx: ComSignalType=UINT16
            DET_RANGE_VELOCITY_090_Rx_oRDR_FUSION_DET_089_092_oPCAN_RADAR_02793b2d_Rx: ComSignalType=UINT16
            DET_RANGE_VELOCITY_091_Rx_oRDR_FUSION_DET_089_092_oPCAN_RADAR_ad3da96a_Rx: ComSignalType=UINT16
            DET_RANGE_VELOCITY_092_Rx_oRDR_FUSION_DET_089_092_oPCAN_RADAR_878119e2_Rx: ComSignalType=UINT16
            DET_RANGE_VELOCITY_ERR_089_Rx_oRDR_FUSION_DET_089_092_oPCAN_RADAR_a63dc8f6_Rx: ComSignalType=UINT8
            DET_RANGE_VELOCITY_ERR_090_Rx_oRDR_FUSION_DET_089_092_oPCAN_RADAR_9b1d4bef_Rx: ComSignalType=UINT8
            DET_RANGE_VELOCITY_ERR_091_Rx_oRDR_FUSION_DET_089_092_oPCAN_RADAR_3459d9a8_Rx: ComSignalType=UINT8
            DET_RANGE_VELOCITY_ERR_092_Rx_oRDR_FUSION_DET_089_092_oPCAN_RADAR_1ee56920_Rx: ComSignalType=UINT8
            DET_RCS_089_Rx_oRDR_FUSION_DET_089_092_oPCAN_RADAR_f2922a2f_Rx: ComSignalType=UINT8
            DET_RCS_090_Rx_oRDR_FUSION_DET_089_092_oPCAN_RADAR_cfb2a936_Rx: ComSignalType=UINT8
            DET_RCS_091_Rx_oRDR_FUSION_DET_089_092_oPCAN_RADAR_60f63b71_Rx: ComSignalType=UINT8
            DET_RCS_092_Rx_oRDR_FUSION_DET_089_092_oPCAN_RADAR_4a4a8bf9_Rx: ComSignalType=UINT8
            DET_SNR_089_Rx_oRDR_FUSION_DET_089_092_oPCAN_RADAR_fbc85bc6_Rx: ComSignalType=UINT8
            DET_SNR_090_Rx_oRDR_FUSION_DET_089_092_oPCAN_RADAR_c6e8d8df_Rx: ComSignalType=UINT8
            DET_SNR_091_Rx_oRDR_FUSION_DET_089_092_oPCAN_RADAR_69ac4a98_Rx: ComSignalType=UINT8
            DET_SNR_092_Rx_oRDR_FUSION_DET_089_092_oPCAN_RADAR_4310fa10_Rx: ComSignalType=UINT8
            DET_SUPER_RES_TARGET_089_Rx_oRDR_FUSION_DET_089_092_oPCAN_RADAR_30337ac6_Rx: ComSignalType=BOOLEAN
            DET_SUPER_RES_TARGET_090_Rx_oRDR_FUSION_DET_089_092_oPCAN_RADAR_0d13f9df_Rx: ComSignalType=BOOLEAN
            DET_SUPER_RES_TARGET_091_Rx_oRDR_FUSION_DET_089_092_oPCAN_RADAR_a2576b98_Rx: ComSignalType=BOOLEAN
            DET_SUPER_RES_TARGET_092_Rx_oRDR_FUSION_DET_089_092_oPCAN_RADAR_88ebdb10_Rx: ComSignalType=BOOLEAN
        SG_Fusion_Detections_093_096_oRDR_FUSION_DET_093_096_oPCAN_RADAR_ebc9f7ef_Rx
          83 x ComGroupSignal:
            DET_AZIMUTH_093_Rx_oRDR_FUSION_DET_093_096_oPCAN_RADAR_fb315752_Rx: ComSignalType=UINT16
            DET_AZIMUTH_094_Rx_oRDR_FUSION_DET_093_096_oPCAN_RADAR_010ca405_Rx: ComSignalType=UINT16
            DET_AZIMUTH_095_Rx_oRDR_FUSION_DET_093_096_oPCAN_RADAR_ae483642_Rx: ComSignalType=UINT16
            DET_AZIMUTH_096_Rx_oRDR_FUSION_DET_093_096_oPCAN_RADAR_84f486ca_Rx: ComSignalType=UINT16
            DET_AZIMUTH_ERR_093_Rx_oRDR_FUSION_DET_093_096_oPCAN_RADAR_f958f6d0_Rx: ComSignalType=UINT8
            DET_AZIMUTH_ERR_094_Rx_oRDR_FUSION_DET_093_096_oPCAN_RADAR_03650587_Rx: ComSignalType=UINT8
            DET_AZIMUTH_ERR_095_Rx_oRDR_FUSION_DET_093_096_oPCAN_RADAR_ac2197c0_Rx: ComSignalType=UINT8
            DET_AZIMUTH_ERR_096_Rx_oRDR_FUSION_DET_093_096_oPCAN_RADAR_869d2748_Rx: ComSignalType=UINT8
            DET_BELOW_RAIN_THOLD_093_Rx_oRDR_FUSION_DET_093_096_oPCAN_RADAR_9d8ba8e7_Rx: ComSignalType=BOOLEAN
            DET_BELOW_RAIN_THOLD_094_Rx_oRDR_FUSION_DET_093_096_oPCAN_RADAR_67b65bb0_Rx: ComSignalType=BOOLEAN
            DET_BELOW_RAIN_THOLD_095_Rx_oRDR_FUSION_DET_093_096_oPCAN_RADAR_c8f2c9f7_Rx: ComSignalType=BOOLEAN
            DET_BELOW_RAIN_THOLD_096_Rx_oRDR_FUSION_DET_093_096_oPCAN_RADAR_e24e797f_Rx: ComSignalType=BOOLEAN
            DET_BI_STATIC_FLAG_093_Rx_oRDR_FUSION_DET_093_096_oPCAN_RADAR_ea1503f4_Rx: ComSignalType=BOOLEAN
            DET_BI_STATIC_FLAG_094_Rx_oRDR_FUSION_DET_093_096_oPCAN_RADAR_1028f0a3_Rx: ComSignalType=BOOLEAN
            DET_BI_STATIC_FLAG_095_Rx_oRDR_FUSION_DET_093_096_oPCAN_RADAR_bf6c62e4_Rx: ComSignalType=BOOLEAN
            DET_BI_STATIC_FLAG_096_Rx_oRDR_FUSION_DET_093_096_oPCAN_RADAR_95d0d26c_Rx: ComSignalType=BOOLEAN
            DET_CONFD_AZIMUTH_093_Rx_oRDR_FUSION_DET_093_096_oPCAN_RADAR_097ce9a0_Rx: ComSignalType=UINT8
            DET_CONFD_AZIMUTH_094_Rx_oRDR_FUSION_DET_093_096_oPCAN_RADAR_f3411af7_Rx: ComSignalType=UINT8
            DET_CONFD_AZIMUTH_095_Rx_oRDR_FUSION_DET_093_096_oPCAN_RADAR_5c0588b0_Rx: ComSignalType=UINT8
            DET_CONFD_AZIMUTH_096_Rx_oRDR_FUSION_DET_093_096_oPCAN_RADAR_76b93838_Rx: ComSignalType=UINT8
            DET_CONFD_ELEVATION_093_Rx_oRDR_FUSION_DET_093_096_oPCAN_RADAR_035d6a27_Rx: ComSignalType=UINT8
            DET_CONFD_ELEVATION_094_Rx_oRDR_FUSION_DET_093_096_oPCAN_RADAR_f9609970_Rx: ComSignalType=UINT8
            DET_CONFD_ELEVATION_095_Rx_oRDR_FUSION_DET_093_096_oPCAN_RADAR_56240b37_Rx: ComSignalType=UINT8
            DET_CONFD_ELEVATION_096_Rx_oRDR_FUSION_DET_093_096_oPCAN_RADAR_7c98bbbf_Rx: ComSignalType=UINT8
            DET_ELEVATION_093_Rx_oRDR_FUSION_DET_093_096_oPCAN_RADAR_090e85de_Rx: ComSignalType=UINT8
            DET_ELEVATION_094_Rx_oRDR_FUSION_DET_093_096_oPCAN_RADAR_f3337689_Rx: ComSignalType=UINT8
            DET_ELEVATION_095_Rx_oRDR_FUSION_DET_093_096_oPCAN_RADAR_5c77e4ce_Rx: ComSignalType=UINT8
            DET_ELEVATION_096_Rx_oRDR_FUSION_DET_093_096_oPCAN_RADAR_76cb5446_Rx: ComSignalType=UINT8
            DET_ELEVATION_ERR_093_Rx_oRDR_FUSION_DET_093_096_oPCAN_RADAR_dbb7a701_Rx: ComSignalType=UINT8
            DET_ELEVATION_ERR_094_Rx_oRDR_FUSION_DET_093_096_oPCAN_RADAR_218a5456_Rx: ComSignalType=UINT8
            DET_ELEVATION_ERR_095_Rx_oRDR_FUSION_DET_093_096_oPCAN_RADAR_8ecec611_Rx: ComSignalType=UINT8
            DET_ELEVATION_ERR_096_Rx_oRDR_FUSION_DET_093_096_oPCAN_RADAR_a4727699_Rx: ComSignalType=UINT8
            DET_EXISTENCE_PROB_093_Rx_oRDR_FUSION_DET_093_096_oPCAN_RADAR_2cafdf94_Rx: ComSignalType=UINT8
            DET_EXISTENCE_PROB_094_Rx_oRDR_FUSION_DET_093_096_oPCAN_RADAR_d6922cc3_Rx: ComSignalType=UINT8
            DET_EXISTENCE_PROB_095_Rx_oRDR_FUSION_DET_093_096_oPCAN_RADAR_79d6be84_Rx: ComSignalType=UINT8
            DET_EXISTENCE_PROB_096_Rx_oRDR_FUSION_DET_093_096_oPCAN_RADAR_536a0e0c_Rx: ComSignalType=UINT8
            DET_HVC_FLAG_093_Rx_oRDR_FUSION_DET_093_096_oPCAN_RADAR_f17132db_Rx: ComSignalType=BOOLEAN
            DET_HVC_FLAG_094_Rx_oRDR_FUSION_DET_093_096_oPCAN_RADAR_0b4cc18c_Rx: ComSignalType=BOOLEAN
            DET_HVC_FLAG_095_Rx_oRDR_FUSION_DET_093_096_oPCAN_RADAR_a40853cb_Rx: ComSignalType=BOOLEAN
            DET_HVC_FLAG_096_Rx_oRDR_FUSION_DET_093_096_oPCAN_RADAR_8eb4e343_Rx: ComSignalType=BOOLEAN
            DET_IDM_093_Rx_oRDR_FUSION_DET_093_096_oPCAN_RADAR_c4b0cb93_Rx: ComSignalType=BOOLEAN
            DET_IDM_094_Rx_oRDR_FUSION_DET_093_096_oPCAN_RADAR_3e8d38c4_Rx: ComSignalType=BOOLEAN
            DET_IDM_095_Rx_oRDR_FUSION_DET_093_096_oPCAN_RADAR_91c9aa83_Rx: ComSignalType=BOOLEAN
            DET_IDM_096_Rx_oRDR_FUSION_DET_093_096_oPCAN_RADAR_bb751a0b_Rx: ComSignalType=BOOLEAN
            DET_MH_CRC16_093_096_Rx_oRDR_FUSION_DET_093_096_oPCAN_RADAR_367232ed_Rx: ComSignalType=UINT16
            DET_MH_CYCLE_COUNTER_093_096_Rx_oRDR_FUSION_DET_093_096_oPCAN_RADAR_3ba90f28_Rx: ComSignalType=UINT8
            DET_MH_SCAN_INDEX_4LSB_093_096_Rx_oRDR_FUSION_DET_093_096_oPCAN_RADAR_5f19c013_Rx: ComSignalType=UINT8
            DET_MTD_093_Rx_oRDR_FUSION_DET_093_096_oPCAN_RADAR_7933fde3_Rx: ComSignalType=BOOLEAN
            DET_MTD_094_Rx_oRDR_FUSION_DET_093_096_oPCAN_RADAR_830e0eb4_Rx: ComSignalType=BOOLEAN
            DET_MTD_095_Rx_oRDR_FUSION_DET_093_096_oPCAN_RADAR_2c4a9cf3_Rx: ComSignalType=BOOLEAN
            DET_MTD_096_Rx_oRDR_FUSION_DET_093_096_oPCAN_RADAR_06f62c7b_Rx: ComSignalType=BOOLEAN
            DET_PROB_1STAZHYPO_093_Rx_oRDR_FUSION_DET_093_096_oPCAN_RADAR_b34ae362_Rx: ComSignalType=BOOLEAN
            DET_PROB_1STAZHYPO_094_Rx_oRDR_FUSION_DET_093_096_oPCAN_RADAR_49771035_Rx: ComSignalType=BOOLEAN
            DET_PROB_1STAZHYPO_095_Rx_oRDR_FUSION_DET_093_096_oPCAN_RADAR_e6338272_Rx: ComSignalType=BOOLEAN
            DET_PROB_1STAZHYPO_096_Rx_oRDR_FUSION_DET_093_096_oPCAN_RADAR_cc8f32fa_Rx: ComSignalType=BOOLEAN
            DET_RANGE_093_Rx_oRDR_FUSION_DET_093_096_oPCAN_RADAR_e8f70b75_Rx: ComSignalType=UINT16
            DET_RANGE_094_Rx_oRDR_FUSION_DET_093_096_oPCAN_RADAR_12caf822_Rx: ComSignalType=UINT16
            DET_RANGE_095_Rx_oRDR_FUSION_DET_093_096_oPCAN_RADAR_bd8e6a65_Rx: ComSignalType=UINT16
            DET_RANGE_096_Rx_oRDR_FUSION_DET_093_096_oPCAN_RADAR_9732daed_Rx: ComSignalType=UINT16
            DET_RANGE_ERR_093_Rx_oRDR_FUSION_DET_093_096_oPCAN_RADAR_b8058795_Rx: ComSignalType=UINT8
            DET_RANGE_ERR_094_Rx_oRDR_FUSION_DET_093_096_oPCAN_RADAR_423874c2_Rx: ComSignalType=UINT8
            DET_RANGE_ERR_095_Rx_oRDR_FUSION_DET_093_096_oPCAN_RADAR_ed7ce685_Rx: ComSignalType=UINT8
            DET_RANGE_ERR_096_Rx_oRDR_FUSION_DET_093_096_oPCAN_RADAR_c7c0560d_Rx: ComSignalType=UINT8
            DET_RANGE_VELOCITY_093_Rx_oRDR_FUSION_DET_093_096_oPCAN_RADAR_3502888b_Rx: ComSignalType=UINT16
            DET_RANGE_VELOCITY_094_Rx_oRDR_FUSION_DET_093_096_oPCAN_RADAR_cf3f7bdc_Rx: ComSignalType=UINT16
            DET_RANGE_VELOCITY_095_Rx_oRDR_FUSION_DET_093_096_oPCAN_RADAR_607be99b_Rx: ComSignalType=UINT16
            DET_RANGE_VELOCITY_096_Rx_oRDR_FUSION_DET_093_096_oPCAN_RADAR_4ac75913_Rx: ComSignalType=UINT16
            DET_RANGE_VELOCITY_ERR_093_Rx_oRDR_FUSION_DET_093_096_oPCAN_RADAR_ac66f849_Rx: ComSignalType=UINT8
            DET_RANGE_VELOCITY_ERR_094_Rx_oRDR_FUSION_DET_093_096_oPCAN_RADAR_565b0b1e_Rx: ComSignalType=UINT8
            DET_RANGE_VELOCITY_ERR_095_Rx_oRDR_FUSION_DET_093_096_oPCAN_RADAR_f91f9959_Rx: ComSignalType=UINT8
            DET_RANGE_VELOCITY_ERR_096_Rx_oRDR_FUSION_DET_093_096_oPCAN_RADAR_d3a329d1_Rx: ComSignalType=UINT8
            DET_RCS_093_Rx_oRDR_FUSION_DET_093_096_oPCAN_RADAR_f8c91a90_Rx: ComSignalType=UINT8
            DET_RCS_094_Rx_oRDR_FUSION_DET_093_096_oPCAN_RADAR_02f4e9c7_Rx: ComSignalType=UINT8
            DET_RCS_095_Rx_oRDR_FUSION_DET_093_096_oPCAN_RADAR_adb07b80_Rx: ComSignalType=UINT8
            DET_RCS_096_Rx_oRDR_FUSION_DET_093_096_oPCAN_RADAR_870ccb08_Rx: ComSignalType=UINT8
            DET_SNR_093_Rx_oRDR_FUSION_DET_093_096_oPCAN_RADAR_f1936b79_Rx: ComSignalType=UINT8
            DET_SNR_094_Rx_oRDR_FUSION_DET_093_096_oPCAN_RADAR_0bae982e_Rx: ComSignalType=UINT8
            DET_SNR_095_Rx_oRDR_FUSION_DET_093_096_oPCAN_RADAR_a4ea0a69_Rx: ComSignalType=UINT8
            DET_SNR_096_Rx_oRDR_FUSION_DET_093_096_oPCAN_RADAR_8e56bae1_Rx: ComSignalType=UINT8
            DET_SUPER_RES_TARGET_093_Rx_oRDR_FUSION_DET_093_096_oPCAN_RADAR_3a684a79_Rx: ComSignalType=BOOLEAN
            DET_SUPER_RES_TARGET_094_Rx_oRDR_FUSION_DET_093_096_oPCAN_RADAR_c055b92e_Rx: ComSignalType=BOOLEAN
            DET_SUPER_RES_TARGET_095_Rx_oRDR_FUSION_DET_093_096_oPCAN_RADAR_6f112b69_Rx: ComSignalType=BOOLEAN
            DET_SUPER_RES_TARGET_096_Rx_oRDR_FUSION_DET_093_096_oPCAN_RADAR_45ad9be1_Rx: ComSignalType=BOOLEAN
        SG_Fusion_Detections_097_100_oRDR_FUSION_DET_097_100_oPCAN_RADAR_f997174e_Rx
          83 x ComGroupSignal:
            DET_AZIMUTH_097_Rx_oRDR_FUSION_DET_097_100_oPCAN_RADAR_eff0c837_Rx: ComSignalType=UINT16
            DET_AZIMUTH_098_Rx_oRDR_FUSION_DET_097_100_oPCAN_RADAR_6fbeba9f_Rx: ComSignalType=UINT16
            DET_AZIMUTH_099_Rx_oRDR_FUSION_DET_097_100_oPCAN_RADAR_c0fa28d8_Rx: ComSignalType=UINT16
            DET_AZIMUTH_100_Rx_oRDR_FUSION_DET_097_100_oPCAN_RADAR_719bb323_Rx: ComSignalType=UINT16
            DET_AZIMUTH_ERR_097_Rx_oRDR_FUSION_DET_097_100_oPCAN_RADAR_ed9969b5_Rx: ComSignalType=UINT8
            DET_AZIMUTH_ERR_098_Rx_oRDR_FUSION_DET_097_100_oPCAN_RADAR_6dd71b1d_Rx: ComSignalType=UINT8
            DET_AZIMUTH_ERR_099_Rx_oRDR_FUSION_DET_097_100_oPCAN_RADAR_c293895a_Rx: ComSignalType=UINT8
            DET_AZIMUTH_ERR_100_Rx_oRDR_FUSION_DET_097_100_oPCAN_RADAR_73f212a1_Rx: ComSignalType=UINT8
            DET_BELOW_RAIN_THOLD_097_Rx_oRDR_FUSION_DET_097_100_oPCAN_RADAR_894a3782_Rx: ComSignalType=BOOLEAN
            DET_BELOW_RAIN_THOLD_098_Rx_oRDR_FUSION_DET_097_100_oPCAN_RADAR_0904452a_Rx: ComSignalType=BOOLEAN
            DET_BELOW_RAIN_THOLD_099_Rx_oRDR_FUSION_DET_097_100_oPCAN_RADAR_a640d76d_Rx: ComSignalType=BOOLEAN
            DET_BELOW_RAIN_THOLD_100_Rx_oRDR_FUSION_DET_097_100_oPCAN_RADAR_17214c96_Rx: ComSignalType=BOOLEAN
            DET_BI_STATIC_FLAG_097_Rx_oRDR_FUSION_DET_097_100_oPCAN_RADAR_fed49c91_Rx: ComSignalType=BOOLEAN
            DET_BI_STATIC_FLAG_098_Rx_oRDR_FUSION_DET_097_100_oPCAN_RADAR_7e9aee39_Rx: ComSignalType=BOOLEAN
            DET_BI_STATIC_FLAG_099_Rx_oRDR_FUSION_DET_097_100_oPCAN_RADAR_d1de7c7e_Rx: ComSignalType=BOOLEAN
            DET_BI_STATIC_FLAG_100_Rx_oRDR_FUSION_DET_097_100_oPCAN_RADAR_60bfe785_Rx: ComSignalType=BOOLEAN
            DET_CONFD_AZIMUTH_097_Rx_oRDR_FUSION_DET_097_100_oPCAN_RADAR_1dbd76c5_Rx: ComSignalType=UINT8
            DET_CONFD_AZIMUTH_098_Rx_oRDR_FUSION_DET_097_100_oPCAN_RADAR_9df3046d_Rx: ComSignalType=UINT8
            DET_CONFD_AZIMUTH_099_Rx_oRDR_FUSION_DET_097_100_oPCAN_RADAR_32b7962a_Rx: ComSignalType=UINT8
            DET_CONFD_AZIMUTH_100_Rx_oRDR_FUSION_DET_097_100_oPCAN_RADAR_83d60dd1_Rx: ComSignalType=UINT8
            DET_CONFD_ELEVATION_097_Rx_oRDR_FUSION_DET_097_100_oPCAN_RADAR_179cf542_Rx: ComSignalType=UINT8
            DET_CONFD_ELEVATION_098_Rx_oRDR_FUSION_DET_097_100_oPCAN_RADAR_97d287ea_Rx: ComSignalType=UINT8
            DET_CONFD_ELEVATION_099_Rx_oRDR_FUSION_DET_097_100_oPCAN_RADAR_389615ad_Rx: ComSignalType=UINT8
            DET_CONFD_ELEVATION_100_Rx_oRDR_FUSION_DET_097_100_oPCAN_RADAR_89f78e56_Rx: ComSignalType=UINT8
            DET_ELEVATION_097_Rx_oRDR_FUSION_DET_097_100_oPCAN_RADAR_1dcf1abb_Rx: ComSignalType=UINT8
            DET_ELEVATION_098_Rx_oRDR_FUSION_DET_097_100_oPCAN_RADAR_9d816813_Rx: ComSignalType=UINT8
            DET_ELEVATION_099_Rx_oRDR_FUSION_DET_097_100_oPCAN_RADAR_32c5fa54_Rx: ComSignalType=UINT8
            DET_ELEVATION_100_Rx_oRDR_FUSION_DET_097_100_oPCAN_RADAR_83a461af_Rx: ComSignalType=UINT8
            DET_ELEVATION_ERR_097_Rx_oRDR_FUSION_DET_097_100_oPCAN_RADAR_cf763864_Rx: ComSignalType=UINT8
            DET_ELEVATION_ERR_098_Rx_oRDR_FUSION_DET_097_100_oPCAN_RADAR_4f384acc_Rx: ComSignalType=UINT8
            DET_ELEVATION_ERR_099_Rx_oRDR_FUSION_DET_097_100_oPCAN_RADAR_e07cd88b_Rx: ComSignalType=UINT8
            DET_ELEVATION_ERR_100_Rx_oRDR_FUSION_DET_097_100_oPCAN_RADAR_511d4370_Rx: ComSignalType=UINT8
            DET_EXISTENCE_PROB_097_Rx_oRDR_FUSION_DET_097_100_oPCAN_RADAR_386e40f1_Rx: ComSignalType=UINT8
            DET_EXISTENCE_PROB_098_Rx_oRDR_FUSION_DET_097_100_oPCAN_RADAR_b8203259_Rx: ComSignalType=UINT8
            DET_EXISTENCE_PROB_099_Rx_oRDR_FUSION_DET_097_100_oPCAN_RADAR_1764a01e_Rx: ComSignalType=UINT8
            DET_EXISTENCE_PROB_100_Rx_oRDR_FUSION_DET_097_100_oPCAN_RADAR_a6053be5_Rx: ComSignalType=UINT8
            DET_HVC_FLAG_097_Rx_oRDR_FUSION_DET_097_100_oPCAN_RADAR_e5b0adbe_Rx: ComSignalType=BOOLEAN
            DET_HVC_FLAG_098_Rx_oRDR_FUSION_DET_097_100_oPCAN_RADAR_65fedf16_Rx: ComSignalType=BOOLEAN
            DET_HVC_FLAG_099_Rx_oRDR_FUSION_DET_097_100_oPCAN_RADAR_caba4d51_Rx: ComSignalType=BOOLEAN
            DET_HVC_FLAG_100_Rx_oRDR_FUSION_DET_097_100_oPCAN_RADAR_7bdbd6aa_Rx: ComSignalType=BOOLEAN
            DET_IDM_097_Rx_oRDR_FUSION_DET_097_100_oPCAN_RADAR_d07154f6_Rx: ComSignalType=BOOLEAN
            DET_IDM_098_Rx_oRDR_FUSION_DET_097_100_oPCAN_RADAR_503f265e_Rx: ComSignalType=BOOLEAN
            DET_IDM_099_Rx_oRDR_FUSION_DET_097_100_oPCAN_RADAR_ff7bb419_Rx: ComSignalType=BOOLEAN
            DET_IDM_100_Rx_oRDR_FUSION_DET_097_100_oPCAN_RADAR_4e1a2fe2_Rx: ComSignalType=BOOLEAN
            DET_MH_CRC16_097_100_Rx_oRDR_FUSION_DET_097_100_oPCAN_RADAR_6bbde68c_Rx: ComSignalType=UINT16
            DET_MH_CYCLE_COUNTER_097_100_Rx_oRDR_FUSION_DET_097_100_oPCAN_RADAR_6666db49_Rx: ComSignalType=UINT8
            DET_MH_SCAN_INDEX_4LSB_097_100_Rx_oRDR_FUSION_DET_097_100_oPCAN_RADAR_02d61472_Rx: ComSignalType=UINT8
            DET_MTD_097_Rx_oRDR_FUSION_DET_097_100_oPCAN_RADAR_6df26286_Rx: ComSignalType=BOOLEAN
            DET_MTD_098_Rx_oRDR_FUSION_DET_097_100_oPCAN_RADAR_edbc102e_Rx: ComSignalType=BOOLEAN
            DET_MTD_099_Rx_oRDR_FUSION_DET_097_100_oPCAN_RADAR_42f88269_Rx: ComSignalType=BOOLEAN
            DET_MTD_100_Rx_oRDR_FUSION_DET_097_100_oPCAN_RADAR_f3991992_Rx: ComSignalType=BOOLEAN
            DET_PROB_1STAZHYPO_097_Rx_oRDR_FUSION_DET_097_100_oPCAN_RADAR_a78b7c07_Rx: ComSignalType=BOOLEAN
            DET_PROB_1STAZHYPO_098_Rx_oRDR_FUSION_DET_097_100_oPCAN_RADAR_27c50eaf_Rx: ComSignalType=BOOLEAN
            DET_PROB_1STAZHYPO_099_Rx_oRDR_FUSION_DET_097_100_oPCAN_RADAR_88819ce8_Rx: ComSignalType=BOOLEAN
            DET_PROB_1STAZHYPO_100_Rx_oRDR_FUSION_DET_097_100_oPCAN_RADAR_39e00713_Rx: ComSignalType=BOOLEAN
            DET_RANGE_097_Rx_oRDR_FUSION_DET_097_100_oPCAN_RADAR_fc369410_Rx: ComSignalType=UINT16
            DET_RANGE_098_Rx_oRDR_FUSION_DET_097_100_oPCAN_RADAR_7c78e6b8_Rx: ComSignalType=UINT16
            DET_RANGE_099_Rx_oRDR_FUSION_DET_097_100_oPCAN_RADAR_d33c74ff_Rx: ComSignalType=UINT16
            DET_RANGE_100_Rx_oRDR_FUSION_DET_097_100_oPCAN_RADAR_625def04_Rx: ComSignalType=UINT16
            DET_RANGE_ERR_097_Rx_oRDR_FUSION_DET_097_100_oPCAN_RADAR_acc418f0_Rx: ComSignalType=UINT8
            DET_RANGE_ERR_098_Rx_oRDR_FUSION_DET_097_100_oPCAN_RADAR_2c8a6a58_Rx: ComSignalType=UINT8
            DET_RANGE_ERR_099_Rx_oRDR_FUSION_DET_097_100_oPCAN_RADAR_83cef81f_Rx: ComSignalType=UINT8
            DET_RANGE_ERR_100_Rx_oRDR_FUSION_DET_097_100_oPCAN_RADAR_32af63e4_Rx: ComSignalType=UINT8
            DET_RANGE_VELOCITY_097_Rx_oRDR_FUSION_DET_097_100_oPCAN_RADAR_21c317ee_Rx: ComSignalType=UINT16
            DET_RANGE_VELOCITY_098_Rx_oRDR_FUSION_DET_097_100_oPCAN_RADAR_a18d6546_Rx: ComSignalType=UINT16
            DET_RANGE_VELOCITY_099_Rx_oRDR_FUSION_DET_097_100_oPCAN_RADAR_0ec9f701_Rx: ComSignalType=UINT16
            DET_RANGE_VELOCITY_100_Rx_oRDR_FUSION_DET_097_100_oPCAN_RADAR_bfa86cfa_Rx: ComSignalType=UINT16
            DET_RANGE_VELOCITY_ERR_097_Rx_oRDR_FUSION_DET_097_100_oPCAN_RADAR_b8a7672c_Rx: ComSignalType=UINT8
            DET_RANGE_VELOCITY_ERR_098_Rx_oRDR_FUSION_DET_097_100_oPCAN_RADAR_38e91584_Rx: ComSignalType=UINT8
            DET_RANGE_VELOCITY_ERR_099_Rx_oRDR_FUSION_DET_097_100_oPCAN_RADAR_97ad87c3_Rx: ComSignalType=UINT8
            DET_RANGE_VELOCITY_ERR_100_Rx_oRDR_FUSION_DET_097_100_oPCAN_RADAR_26cc1c38_Rx: ComSignalType=UINT8
            DET_RCS_097_Rx_oRDR_FUSION_DET_097_100_oPCAN_RADAR_ec0885f5_Rx: ComSignalType=UINT8
            DET_RCS_098_Rx_oRDR_FUSION_DET_097_100_oPCAN_RADAR_6c46f75d_Rx: ComSignalType=UINT8
            DET_RCS_099_Rx_oRDR_FUSION_DET_097_100_oPCAN_RADAR_c302651a_Rx: ComSignalType=UINT8
            DET_RCS_100_Rx_oRDR_FUSION_DET_097_100_oPCAN_RADAR_7263fee1_Rx: ComSignalType=UINT8
            DET_SNR_097_Rx_oRDR_FUSION_DET_097_100_oPCAN_RADAR_e552f41c_Rx: ComSignalType=UINT8
            DET_SNR_098_Rx_oRDR_FUSION_DET_097_100_oPCAN_RADAR_651c86b4_Rx: ComSignalType=UINT8
            DET_SNR_099_Rx_oRDR_FUSION_DET_097_100_oPCAN_RADAR_ca5814f3_Rx: ComSignalType=UINT8
            DET_SNR_100_Rx_oRDR_FUSION_DET_097_100_oPCAN_RADAR_7b398f08_Rx: ComSignalType=UINT8
            DET_SUPER_RES_TARGET_097_Rx_oRDR_FUSION_DET_097_100_oPCAN_RADAR_2ea9d51c_Rx: ComSignalType=BOOLEAN
            DET_SUPER_RES_TARGET_098_Rx_oRDR_FUSION_DET_097_100_oPCAN_RADAR_aee7a7b4_Rx: ComSignalType=BOOLEAN
            DET_SUPER_RES_TARGET_099_Rx_oRDR_FUSION_DET_097_100_oPCAN_RADAR_01a335f3_Rx: ComSignalType=BOOLEAN
            DET_SUPER_RES_TARGET_100_Rx_oRDR_FUSION_DET_097_100_oPCAN_RADAR_b0c2ae08_Rx: ComSignalType=BOOLEAN
        SG_Fusion_Detections_101_104_oRDR_FUSION_DET_101_104_oPCAN_RADAR_2dfb2b7d_Rx
          83 x ComGroupSignal:
            DET_AZIMUTH_101_Rx_oRDR_FUSION_DET_101_104_oPCAN_RADAR_96b3644f_Rx: ComSignalType=UINT16
            DET_AZIMUTH_102_Rx_oRDR_FUSION_DET_101_104_oPCAN_RADAR_bc0fd4c7_Rx: ComSignalType=UINT16
            DET_AZIMUTH_103_Rx_oRDR_FUSION_DET_101_104_oPCAN_RADAR_134b4680_Rx: ComSignalType=UINT16
            DET_AZIMUTH_104_Rx_oRDR_FUSION_DET_101_104_oPCAN_RADAR_e976b5d7_Rx: ComSignalType=UINT16
            DET_AZIMUTH_ERR_101_Rx_oRDR_FUSION_DET_101_104_oPCAN_RADAR_94dac5cd_Rx: ComSignalType=UINT8
            DET_AZIMUTH_ERR_102_Rx_oRDR_FUSION_DET_101_104_oPCAN_RADAR_be667545_Rx: ComSignalType=UINT8
            DET_AZIMUTH_ERR_103_Rx_oRDR_FUSION_DET_101_104_oPCAN_RADAR_1122e702_Rx: ComSignalType=UINT8
            DET_AZIMUTH_ERR_104_Rx_oRDR_FUSION_DET_101_104_oPCAN_RADAR_eb1f1455_Rx: ComSignalType=UINT8
            DET_BELOW_RAIN_THOLD_101_Rx_oRDR_FUSION_DET_101_104_oPCAN_RADAR_f0099bfa_Rx: ComSignalType=BOOLEAN
            DET_BELOW_RAIN_THOLD_102_Rx_oRDR_FUSION_DET_101_104_oPCAN_RADAR_dab52b72_Rx: ComSignalType=BOOLEAN
            DET_BELOW_RAIN_THOLD_103_Rx_oRDR_FUSION_DET_101_104_oPCAN_RADAR_75f1b935_Rx: ComSignalType=BOOLEAN
            DET_BELOW_RAIN_THOLD_104_Rx_oRDR_FUSION_DET_101_104_oPCAN_RADAR_8fcc4a62_Rx: ComSignalType=BOOLEAN
            DET_BI_STATIC_FLAG_101_Rx_oRDR_FUSION_DET_101_104_oPCAN_RADAR_879730e9_Rx: ComSignalType=BOOLEAN
            DET_BI_STATIC_FLAG_102_Rx_oRDR_FUSION_DET_101_104_oPCAN_RADAR_ad2b8061_Rx: ComSignalType=BOOLEAN
            DET_BI_STATIC_FLAG_103_Rx_oRDR_FUSION_DET_101_104_oPCAN_RADAR_026f1226_Rx: ComSignalType=BOOLEAN
            DET_BI_STATIC_FLAG_104_Rx_oRDR_FUSION_DET_101_104_oPCAN_RADAR_f852e171_Rx: ComSignalType=BOOLEAN
            DET_CONFD_AZIMUTH_101_Rx_oRDR_FUSION_DET_101_104_oPCAN_RADAR_64fedabd_Rx: ComSignalType=UINT8
            DET_CONFD_AZIMUTH_102_Rx_oRDR_FUSION_DET_101_104_oPCAN_RADAR_4e426a35_Rx: ComSignalType=UINT8
            DET_CONFD_AZIMUTH_103_Rx_oRDR_FUSION_DET_101_104_oPCAN_RADAR_e106f872_Rx: ComSignalType=UINT8
            DET_CONFD_AZIMUTH_104_Rx_oRDR_FUSION_DET_101_104_oPCAN_RADAR_1b3b0b25_Rx: ComSignalType=UINT8
            DET_CONFD_ELEVATION_101_Rx_oRDR_FUSION_DET_101_104_oPCAN_RADAR_6edf593a_Rx: ComSignalType=UINT8
            DET_CONFD_ELEVATION_102_Rx_oRDR_FUSION_DET_101_104_oPCAN_RADAR_4463e9b2_Rx: ComSignalType=UINT8
            DET_CONFD_ELEVATION_103_Rx_oRDR_FUSION_DET_101_104_oPCAN_RADAR_eb277bf5_Rx: ComSignalType=UINT8
            DET_CONFD_ELEVATION_104_Rx_oRDR_FUSION_DET_101_104_oPCAN_RADAR_111a88a2_Rx: ComSignalType=UINT8
            DET_ELEVATION_101_Rx_oRDR_FUSION_DET_101_104_oPCAN_RADAR_648cb6c3_Rx: ComSignalType=UINT8
            DET_ELEVATION_102_Rx_oRDR_FUSION_DET_101_104_oPCAN_RADAR_4e30064b_Rx: ComSignalType=UINT8
            DET_ELEVATION_103_Rx_oRDR_FUSION_DET_101_104_oPCAN_RADAR_e174940c_Rx: ComSignalType=UINT8
            DET_ELEVATION_104_Rx_oRDR_FUSION_DET_101_104_oPCAN_RADAR_1b49675b_Rx: ComSignalType=UINT8
            DET_ELEVATION_ERR_101_Rx_oRDR_FUSION_DET_101_104_oPCAN_RADAR_b635941c_Rx: ComSignalType=UINT8
            DET_ELEVATION_ERR_102_Rx_oRDR_FUSION_DET_101_104_oPCAN_RADAR_9c892494_Rx: ComSignalType=UINT8
            DET_ELEVATION_ERR_103_Rx_oRDR_FUSION_DET_101_104_oPCAN_RADAR_33cdb6d3_Rx: ComSignalType=UINT8
            DET_ELEVATION_ERR_104_Rx_oRDR_FUSION_DET_101_104_oPCAN_RADAR_c9f04584_Rx: ComSignalType=UINT8
            DET_EXISTENCE_PROB_101_Rx_oRDR_FUSION_DET_101_104_oPCAN_RADAR_412dec89_Rx: ComSignalType=UINT8
            DET_EXISTENCE_PROB_102_Rx_oRDR_FUSION_DET_101_104_oPCAN_RADAR_6b915c01_Rx: ComSignalType=UINT8
            DET_EXISTENCE_PROB_103_Rx_oRDR_FUSION_DET_101_104_oPCAN_RADAR_c4d5ce46_Rx: ComSignalType=UINT8
            DET_EXISTENCE_PROB_104_Rx_oRDR_FUSION_DET_101_104_oPCAN_RADAR_3ee83d11_Rx: ComSignalType=UINT8
            DET_HVC_FLAG_101_Rx_oRDR_FUSION_DET_101_104_oPCAN_RADAR_9cf301c6_Rx: ComSignalType=BOOLEAN
            DET_HVC_FLAG_102_Rx_oRDR_FUSION_DET_101_104_oPCAN_RADAR_b64fb14e_Rx: ComSignalType=BOOLEAN
            DET_HVC_FLAG_103_Rx_oRDR_FUSION_DET_101_104_oPCAN_RADAR_190b2309_Rx: ComSignalType=BOOLEAN
            DET_HVC_FLAG_104_Rx_oRDR_FUSION_DET_101_104_oPCAN_RADAR_e336d05e_Rx: ComSignalType=BOOLEAN
            DET_IDM_101_Rx_oRDR_FUSION_DET_101_104_oPCAN_RADAR_a932f88e_Rx: ComSignalType=BOOLEAN
            DET_IDM_102_Rx_oRDR_FUSION_DET_101_104_oPCAN_RADAR_838e4806_Rx: ComSignalType=BOOLEAN
            DET_IDM_103_Rx_oRDR_FUSION_DET_101_104_oPCAN_RADAR_2ccada41_Rx: ComSignalType=BOOLEAN
            DET_IDM_104_Rx_oRDR_FUSION_DET_101_104_oPCAN_RADAR_d6f72916_Rx: ComSignalType=BOOLEAN
            DET_MH_CRC16_101_104_Rx_oRDR_FUSION_DET_101_104_oPCAN_RADAR_cf19934c_Rx: ComSignalType=UINT16
            DET_MH_CYCLE_COUNTER_101_104_Rx_oRDR_FUSION_DET_101_104_oPCAN_RADAR_c2c2ae89_Rx: ComSignalType=UINT8
            DET_MH_SCAN_INDEX_4LSB_101_104_Rx_oRDR_FUSION_DET_101_104_oPCAN_RADAR_a67261b2_Rx: ComSignalType=UINT8
            DET_MTD_101_Rx_oRDR_FUSION_DET_101_104_oPCAN_RADAR_14b1cefe_Rx: ComSignalType=BOOLEAN
            DET_MTD_102_Rx_oRDR_FUSION_DET_101_104_oPCAN_RADAR_3e0d7e76_Rx: ComSignalType=BOOLEAN
            DET_MTD_103_Rx_oRDR_FUSION_DET_101_104_oPCAN_RADAR_9149ec31_Rx: ComSignalType=BOOLEAN
            DET_MTD_104_Rx_oRDR_FUSION_DET_101_104_oPCAN_RADAR_6b741f66_Rx: ComSignalType=BOOLEAN
            DET_PROB_1STAZHYPO_101_Rx_oRDR_FUSION_DET_101_104_oPCAN_RADAR_dec8d07f_Rx: ComSignalType=BOOLEAN
            DET_PROB_1STAZHYPO_102_Rx_oRDR_FUSION_DET_101_104_oPCAN_RADAR_f47460f7_Rx: ComSignalType=BOOLEAN
            DET_PROB_1STAZHYPO_103_Rx_oRDR_FUSION_DET_101_104_oPCAN_RADAR_5b30f2b0_Rx: ComSignalType=BOOLEAN
            DET_PROB_1STAZHYPO_104_Rx_oRDR_FUSION_DET_101_104_oPCAN_RADAR_a10d01e7_Rx: ComSignalType=BOOLEAN
            DET_RANGE_101_Rx_oRDR_FUSION_DET_101_104_oPCAN_RADAR_85753868_Rx: ComSignalType=UINT16
            DET_RANGE_102_Rx_oRDR_FUSION_DET_101_104_oPCAN_RADAR_afc988e0_Rx: ComSignalType=UINT16
            DET_RANGE_103_Rx_oRDR_FUSION_DET_101_104_oPCAN_RADAR_008d1aa7_Rx: ComSignalType=UINT16
            DET_RANGE_104_Rx_oRDR_FUSION_DET_101_104_oPCAN_RADAR_fab0e9f0_Rx: ComSignalType=UINT16
            DET_RANGE_ERR_101_Rx_oRDR_FUSION_DET_101_104_oPCAN_RADAR_d587b488_Rx: ComSignalType=UINT8
            DET_RANGE_ERR_102_Rx_oRDR_FUSION_DET_101_104_oPCAN_RADAR_ff3b0400_Rx: ComSignalType=UINT8
            DET_RANGE_ERR_103_Rx_oRDR_FUSION_DET_101_104_oPCAN_RADAR_507f9647_Rx: ComSignalType=UINT8
            DET_RANGE_ERR_104_Rx_oRDR_FUSION_DET_101_104_oPCAN_RADAR_aa426510_Rx: ComSignalType=UINT8
            DET_RANGE_VELOCITY_101_Rx_oRDR_FUSION_DET_101_104_oPCAN_RADAR_5880bb96_Rx: ComSignalType=UINT16
            DET_RANGE_VELOCITY_102_Rx_oRDR_FUSION_DET_101_104_oPCAN_RADAR_723c0b1e_Rx: ComSignalType=UINT16
            DET_RANGE_VELOCITY_103_Rx_oRDR_FUSION_DET_101_104_oPCAN_RADAR_dd789959_Rx: ComSignalType=UINT16
            DET_RANGE_VELOCITY_104_Rx_oRDR_FUSION_DET_101_104_oPCAN_RADAR_27456a0e_Rx: ComSignalType=UINT16
            DET_RANGE_VELOCITY_ERR_101_Rx_oRDR_FUSION_DET_101_104_oPCAN_RADAR_c1e4cb54_Rx: ComSignalType=UINT8
            DET_RANGE_VELOCITY_ERR_102_Rx_oRDR_FUSION_DET_101_104_oPCAN_RADAR_eb587bdc_Rx: ComSignalType=UINT8
            DET_RANGE_VELOCITY_ERR_103_Rx_oRDR_FUSION_DET_101_104_oPCAN_RADAR_441ce99b_Rx: ComSignalType=UINT8
            DET_RANGE_VELOCITY_ERR_104_Rx_oRDR_FUSION_DET_101_104_oPCAN_RADAR_be211acc_Rx: ComSignalType=UINT8
            DET_RCS_101_Rx_oRDR_FUSION_DET_101_104_oPCAN_RADAR_954b298d_Rx: ComSignalType=UINT8
            DET_RCS_102_Rx_oRDR_FUSION_DET_101_104_oPCAN_RADAR_bff79905_Rx: ComSignalType=UINT8
            DET_RCS_103_Rx_oRDR_FUSION_DET_101_104_oPCAN_RADAR_10b30b42_Rx: ComSignalType=UINT8
            DET_RCS_104_Rx_oRDR_FUSION_DET_101_104_oPCAN_RADAR_ea8ef815_Rx: ComSignalType=UINT8
            DET_SNR_101_Rx_oRDR_FUSION_DET_101_104_oPCAN_RADAR_9c115864_Rx: ComSignalType=UINT8
            DET_SNR_102_Rx_oRDR_FUSION_DET_101_104_oPCAN_RADAR_b6ade8ec_Rx: ComSignalType=UINT8
            DET_SNR_103_Rx_oRDR_FUSION_DET_101_104_oPCAN_RADAR_19e97aab_Rx: ComSignalType=UINT8
            DET_SNR_104_Rx_oRDR_FUSION_DET_101_104_oPCAN_RADAR_e3d489fc_Rx: ComSignalType=UINT8
            DET_SUPER_RES_TARGET_101_Rx_oRDR_FUSION_DET_101_104_oPCAN_RADAR_57ea7964_Rx: ComSignalType=BOOLEAN
            DET_SUPER_RES_TARGET_102_Rx_oRDR_FUSION_DET_101_104_oPCAN_RADAR_7d56c9ec_Rx: ComSignalType=BOOLEAN
            DET_SUPER_RES_TARGET_103_Rx_oRDR_FUSION_DET_101_104_oPCAN_RADAR_d2125bab_Rx: ComSignalType=BOOLEAN
            DET_SUPER_RES_TARGET_104_Rx_oRDR_FUSION_DET_101_104_oPCAN_RADAR_282fa8fc_Rx: ComSignalType=BOOLEAN
        SG_Fusion_Detections_105_108_oRDR_FUSION_DET_105_108_oPCAN_RADAR_6000008e_Rx
          83 x ComGroupSignal:
            DET_AZIMUTH_105_Rx_oRDR_FUSION_DET_105_108_oPCAN_RADAR_af80b9a4_Rx: ComSignalType=UINT16
            DET_AZIMUTH_106_Rx_oRDR_FUSION_DET_105_108_oPCAN_RADAR_853c092c_Rx: ComSignalType=UINT16
            DET_AZIMUTH_107_Rx_oRDR_FUSION_DET_105_108_oPCAN_RADAR_2a789b6b_Rx: ComSignalType=UINT16
            DET_AZIMUTH_108_Rx_oRDR_FUSION_DET_105_108_oPCAN_RADAR_aa36e9c3_Rx: ComSignalType=UINT16
            DET_AZIMUTH_ERR_105_Rx_oRDR_FUSION_DET_105_108_oPCAN_RADAR_ade91826_Rx: ComSignalType=UINT8
            DET_AZIMUTH_ERR_106_Rx_oRDR_FUSION_DET_105_108_oPCAN_RADAR_8755a8ae_Rx: ComSignalType=UINT8
            DET_AZIMUTH_ERR_107_Rx_oRDR_FUSION_DET_105_108_oPCAN_RADAR_28113ae9_Rx: ComSignalType=UINT8
            DET_AZIMUTH_ERR_108_Rx_oRDR_FUSION_DET_105_108_oPCAN_RADAR_a85f4841_Rx: ComSignalType=UINT8
            DET_BELOW_RAIN_THOLD_105_Rx_oRDR_FUSION_DET_105_108_oPCAN_RADAR_c93a4611_Rx: ComSignalType=BOOLEAN
            DET_BELOW_RAIN_THOLD_106_Rx_oRDR_FUSION_DET_105_108_oPCAN_RADAR_e386f699_Rx: ComSignalType=BOOLEAN
            DET_BELOW_RAIN_THOLD_107_Rx_oRDR_FUSION_DET_105_108_oPCAN_RADAR_4cc264de_Rx: ComSignalType=BOOLEAN
            DET_BELOW_RAIN_THOLD_108_Rx_oRDR_FUSION_DET_105_108_oPCAN_RADAR_cc8c1676_Rx: ComSignalType=BOOLEAN
            DET_BI_STATIC_FLAG_105_Rx_oRDR_FUSION_DET_105_108_oPCAN_RADAR_bea4ed02_Rx: ComSignalType=BOOLEAN
            DET_BI_STATIC_FLAG_106_Rx_oRDR_FUSION_DET_105_108_oPCAN_RADAR_94185d8a_Rx: ComSignalType=BOOLEAN
            DET_BI_STATIC_FLAG_107_Rx_oRDR_FUSION_DET_105_108_oPCAN_RADAR_3b5ccfcd_Rx: ComSignalType=BOOLEAN
            DET_BI_STATIC_FLAG_108_Rx_oRDR_FUSION_DET_105_108_oPCAN_RADAR_bb12bd65_Rx: ComSignalType=BOOLEAN
            DET_CONFD_AZIMUTH_105_Rx_oRDR_FUSION_DET_105_108_oPCAN_RADAR_5dcd0756_Rx: ComSignalType=UINT8
            DET_CONFD_AZIMUTH_106_Rx_oRDR_FUSION_DET_105_108_oPCAN_RADAR_7771b7de_Rx: ComSignalType=UINT8
            DET_CONFD_AZIMUTH_107_Rx_oRDR_FUSION_DET_105_108_oPCAN_RADAR_d8352599_Rx: ComSignalType=UINT8
            DET_CONFD_AZIMUTH_108_Rx_oRDR_FUSION_DET_105_108_oPCAN_RADAR_587b5731_Rx: ComSignalType=UINT8
            DET_CONFD_ELEVATION_105_Rx_oRDR_FUSION_DET_105_108_oPCAN_RADAR_57ec84d1_Rx: ComSignalType=UINT8
            DET_CONFD_ELEVATION_106_Rx_oRDR_FUSION_DET_105_108_oPCAN_RADAR_7d503459_Rx: ComSignalType=UINT8
            DET_CONFD_ELEVATION_107_Rx_oRDR_FUSION_DET_105_108_oPCAN_RADAR_d214a61e_Rx: ComSignalType=UINT8
            DET_CONFD_ELEVATION_108_Rx_oRDR_FUSION_DET_105_108_oPCAN_RADAR_525ad4b6_Rx: ComSignalType=UINT8
            DET_ELEVATION_105_Rx_oRDR_FUSION_DET_105_108_oPCAN_RADAR_5dbf6b28_Rx: ComSignalType=UINT8
            DET_ELEVATION_106_Rx_oRDR_FUSION_DET_105_108_oPCAN_RADAR_7703dba0_Rx: ComSignalType=UINT8
            DET_ELEVATION_107_Rx_oRDR_FUSION_DET_105_108_oPCAN_RADAR_d84749e7_Rx: ComSignalType=UINT8
            DET_ELEVATION_108_Rx_oRDR_FUSION_DET_105_108_oPCAN_RADAR_58093b4f_Rx: ComSignalType=UINT8
            DET_ELEVATION_ERR_105_Rx_oRDR_FUSION_DET_105_108_oPCAN_RADAR_8f0649f7_Rx: ComSignalType=UINT8
            DET_ELEVATION_ERR_106_Rx_oRDR_FUSION_DET_105_108_oPCAN_RADAR_a5baf97f_Rx: ComSignalType=UINT8
            DET_ELEVATION_ERR_107_Rx_oRDR_FUSION_DET_105_108_oPCAN_RADAR_0afe6b38_Rx: ComSignalType=UINT8
            DET_ELEVATION_ERR_108_Rx_oRDR_FUSION_DET_105_108_oPCAN_RADAR_8ab01990_Rx: ComSignalType=UINT8
            DET_EXISTENCE_PROB_105_Rx_oRDR_FUSION_DET_105_108_oPCAN_RADAR_781e3162_Rx: ComSignalType=UINT8
            DET_EXISTENCE_PROB_106_Rx_oRDR_FUSION_DET_105_108_oPCAN_RADAR_52a281ea_Rx: ComSignalType=UINT8
            DET_EXISTENCE_PROB_107_Rx_oRDR_FUSION_DET_105_108_oPCAN_RADAR_fde613ad_Rx: ComSignalType=UINT8
            DET_EXISTENCE_PROB_108_Rx_oRDR_FUSION_DET_105_108_oPCAN_RADAR_7da86105_Rx: ComSignalType=UINT8
            DET_HVC_FLAG_105_Rx_oRDR_FUSION_DET_105_108_oPCAN_RADAR_a5c0dc2d_Rx: ComSignalType=BOOLEAN
            DET_HVC_FLAG_106_Rx_oRDR_FUSION_DET_105_108_oPCAN_RADAR_8f7c6ca5_Rx: ComSignalType=BOOLEAN
            DET_HVC_FLAG_107_Rx_oRDR_FUSION_DET_105_108_oPCAN_RADAR_2038fee2_Rx: ComSignalType=BOOLEAN
            DET_HVC_FLAG_108_Rx_oRDR_FUSION_DET_105_108_oPCAN_RADAR_a0768c4a_Rx: ComSignalType=BOOLEAN
            DET_IDM_105_Rx_oRDR_FUSION_DET_105_108_oPCAN_RADAR_90012565_Rx: ComSignalType=BOOLEAN
            DET_IDM_106_Rx_oRDR_FUSION_DET_105_108_oPCAN_RADAR_babd95ed_Rx: ComSignalType=BOOLEAN
            DET_IDM_107_Rx_oRDR_FUSION_DET_105_108_oPCAN_RADAR_15f907aa_Rx: ComSignalType=BOOLEAN
            DET_IDM_108_Rx_oRDR_FUSION_DET_105_108_oPCAN_RADAR_95b77502_Rx: ComSignalType=BOOLEAN
            DET_MH_CRC16_105_108_Rx_oRDR_FUSION_DET_105_108_oPCAN_RADAR_24f92ed0_Rx: ComSignalType=UINT16
            DET_MH_CYCLE_COUNTER_105_108_Rx_oRDR_FUSION_DET_105_108_oPCAN_RADAR_29221315_Rx: ComSignalType=UINT8
            DET_MH_SCAN_INDEX_4LSB_105_108_Rx_oRDR_FUSION_DET_105_108_oPCAN_RADAR_4d92dc2e_Rx: ComSignalType=UINT8
            DET_MTD_105_Rx_oRDR_FUSION_DET_105_108_oPCAN_RADAR_2d821315_Rx: ComSignalType=BOOLEAN
            DET_MTD_106_Rx_oRDR_FUSION_DET_105_108_oPCAN_RADAR_073ea39d_Rx: ComSignalType=BOOLEAN
            DET_MTD_107_Rx_oRDR_FUSION_DET_105_108_oPCAN_RADAR_a87a31da_Rx: ComSignalType=BOOLEAN
            DET_MTD_108_Rx_oRDR_FUSION_DET_105_108_oPCAN_RADAR_28344372_Rx: ComSignalType=BOOLEAN
            DET_PROB_1STAZHYPO_105_Rx_oRDR_FUSION_DET_105_108_oPCAN_RADAR_e7fb0d94_Rx: ComSignalType=BOOLEAN
            DET_PROB_1STAZHYPO_106_Rx_oRDR_FUSION_DET_105_108_oPCAN_RADAR_cd47bd1c_Rx: ComSignalType=BOOLEAN
            DET_PROB_1STAZHYPO_107_Rx_oRDR_FUSION_DET_105_108_oPCAN_RADAR_62032f5b_Rx: ComSignalType=BOOLEAN
            DET_PROB_1STAZHYPO_108_Rx_oRDR_FUSION_DET_105_108_oPCAN_RADAR_e24d5df3_Rx: ComSignalType=BOOLEAN
            DET_RANGE_105_Rx_oRDR_FUSION_DET_105_108_oPCAN_RADAR_bc46e583_Rx: ComSignalType=UINT16
            DET_RANGE_106_Rx_oRDR_FUSION_DET_105_108_oPCAN_RADAR_96fa550b_Rx: ComSignalType=UINT16
            DET_RANGE_107_Rx_oRDR_FUSION_DET_105_108_oPCAN_RADAR_39bec74c_Rx: ComSignalType=UINT16
            DET_RANGE_108_Rx_oRDR_FUSION_DET_105_108_oPCAN_RADAR_b9f0b5e4_Rx: ComSignalType=UINT16
            DET_RANGE_ERR_105_Rx_oRDR_FUSION_DET_105_108_oPCAN_RADAR_ecb46963_Rx: ComSignalType=UINT8
            DET_RANGE_ERR_106_Rx_oRDR_FUSION_DET_105_108_oPCAN_RADAR_c608d9eb_Rx: ComSignalType=UINT8
            DET_RANGE_ERR_107_Rx_oRDR_FUSION_DET_105_108_oPCAN_RADAR_694c4bac_Rx: ComSignalType=UINT8
            DET_RANGE_ERR_108_Rx_oRDR_FUSION_DET_105_108_oPCAN_RADAR_e9023904_Rx: ComSignalType=UINT8
            DET_RANGE_VELOCITY_105_Rx_oRDR_FUSION_DET_105_108_oPCAN_RADAR_61b3667d_Rx: ComSignalType=UINT16
            DET_RANGE_VELOCITY_106_Rx_oRDR_FUSION_DET_105_108_oPCAN_RADAR_4b0fd6f5_Rx: ComSignalType=UINT16
            DET_RANGE_VELOCITY_107_Rx_oRDR_FUSION_DET_105_108_oPCAN_RADAR_e44b44b2_Rx: ComSignalType=UINT16
            DET_RANGE_VELOCITY_108_Rx_oRDR_FUSION_DET_105_108_oPCAN_RADAR_6405361a_Rx: ComSignalType=UINT16
            DET_RANGE_VELOCITY_ERR_105_Rx_oRDR_FUSION_DET_105_108_oPCAN_RADAR_f8d716bf_Rx: ComSignalType=UINT8
            DET_RANGE_VELOCITY_ERR_106_Rx_oRDR_FUSION_DET_105_108_oPCAN_RADAR_d26ba637_Rx: ComSignalType=UINT8
            DET_RANGE_VELOCITY_ERR_107_Rx_oRDR_FUSION_DET_105_108_oPCAN_RADAR_7d2f3470_Rx: ComSignalType=UINT8
            DET_RANGE_VELOCITY_ERR_108_Rx_oRDR_FUSION_DET_105_108_oPCAN_RADAR_fd6146d8_Rx: ComSignalType=UINT8
            DET_RCS_105_Rx_oRDR_FUSION_DET_105_108_oPCAN_RADAR_ac78f466_Rx: ComSignalType=UINT8
            DET_RCS_106_Rx_oRDR_FUSION_DET_105_108_oPCAN_RADAR_86c444ee_Rx: ComSignalType=UINT8
            DET_RCS_107_Rx_oRDR_FUSION_DET_105_108_oPCAN_RADAR_2980d6a9_Rx: ComSignalType=UINT8
            DET_RCS_108_Rx_oRDR_FUSION_DET_105_108_oPCAN_RADAR_a9cea401_Rx: ComSignalType=UINT8
            DET_SNR_105_Rx_oRDR_FUSION_DET_105_108_oPCAN_RADAR_a522858f_Rx: ComSignalType=UINT8
            DET_SNR_106_Rx_oRDR_FUSION_DET_105_108_oPCAN_RADAR_8f9e3507_Rx: ComSignalType=UINT8
            DET_SNR_107_Rx_oRDR_FUSION_DET_105_108_oPCAN_RADAR_20daa740_Rx: ComSignalType=UINT8
            DET_SNR_108_Rx_oRDR_FUSION_DET_105_108_oPCAN_RADAR_a094d5e8_Rx: ComSignalType=UINT8
            DET_SUPER_RES_TARGET_105_Rx_oRDR_FUSION_DET_105_108_oPCAN_RADAR_6ed9a48f_Rx: ComSignalType=BOOLEAN
            DET_SUPER_RES_TARGET_106_Rx_oRDR_FUSION_DET_105_108_oPCAN_RADAR_44651407_Rx: ComSignalType=BOOLEAN
            DET_SUPER_RES_TARGET_107_Rx_oRDR_FUSION_DET_105_108_oPCAN_RADAR_eb218640_Rx: ComSignalType=BOOLEAN
            DET_SUPER_RES_TARGET_108_Rx_oRDR_FUSION_DET_105_108_oPCAN_RADAR_6b6ff4e8_Rx: ComSignalType=BOOLEAN
        SG_Fusion_Detections_109_112_oRDR_FUSION_DET_109_112_oPCAN_RADAR_e2334566_Rx
          83 x ComGroupSignal:
            DET_AZIMUTH_109_Rx_oRDR_FUSION_DET_109_112_oPCAN_RADAR_373a9485_Rx: ComSignalType=UINT16
            DET_AZIMUTH_110_Rx_oRDR_FUSION_DET_109_112_oPCAN_RADAR_0a1a179c_Rx: ComSignalType=UINT16
            DET_AZIMUTH_111_Rx_oRDR_FUSION_DET_109_112_oPCAN_RADAR_a55e85db_Rx: ComSignalType=UINT16
            DET_AZIMUTH_112_Rx_oRDR_FUSION_DET_109_112_oPCAN_RADAR_8fe23553_Rx: ComSignalType=UINT16
            DET_AZIMUTH_ERR_109_Rx_oRDR_FUSION_DET_109_112_oPCAN_RADAR_35533507_Rx: ComSignalType=UINT8
            DET_AZIMUTH_ERR_110_Rx_oRDR_FUSION_DET_109_112_oPCAN_RADAR_0873b61e_Rx: ComSignalType=UINT8
            DET_AZIMUTH_ERR_111_Rx_oRDR_FUSION_DET_109_112_oPCAN_RADAR_a7372459_Rx: ComSignalType=UINT8
            DET_AZIMUTH_ERR_112_Rx_oRDR_FUSION_DET_109_112_oPCAN_RADAR_8d8b94d1_Rx: ComSignalType=UINT8
            DET_BELOW_RAIN_THOLD_109_Rx_oRDR_FUSION_DET_109_112_oPCAN_RADAR_51806b30_Rx: ComSignalType=BOOLEAN
            DET_BELOW_RAIN_THOLD_110_Rx_oRDR_FUSION_DET_109_112_oPCAN_RADAR_6ca0e829_Rx: ComSignalType=BOOLEAN
            DET_BELOW_RAIN_THOLD_111_Rx_oRDR_FUSION_DET_109_112_oPCAN_RADAR_c3e47a6e_Rx: ComSignalType=BOOLEAN
            DET_BELOW_RAIN_THOLD_112_Rx_oRDR_FUSION_DET_109_112_oPCAN_RADAR_e958cae6_Rx: ComSignalType=BOOLEAN
            DET_BI_STATIC_FLAG_109_Rx_oRDR_FUSION_DET_109_112_oPCAN_RADAR_261ec023_Rx: ComSignalType=BOOLEAN
            DET_BI_STATIC_FLAG_110_Rx_oRDR_FUSION_DET_109_112_oPCAN_RADAR_1b3e433a_Rx: ComSignalType=BOOLEAN
            DET_BI_STATIC_FLAG_111_Rx_oRDR_FUSION_DET_109_112_oPCAN_RADAR_b47ad17d_Rx: ComSignalType=BOOLEAN
            DET_BI_STATIC_FLAG_112_Rx_oRDR_FUSION_DET_109_112_oPCAN_RADAR_9ec661f5_Rx: ComSignalType=BOOLEAN
            DET_CONFD_AZIMUTH_109_Rx_oRDR_FUSION_DET_109_112_oPCAN_RADAR_c5772a77_Rx: ComSignalType=UINT8
            DET_CONFD_AZIMUTH_110_Rx_oRDR_FUSION_DET_109_112_oPCAN_RADAR_f857a96e_Rx: ComSignalType=UINT8
            DET_CONFD_AZIMUTH_111_Rx_oRDR_FUSION_DET_109_112_oPCAN_RADAR_57133b29_Rx: ComSignalType=UINT8
            DET_CONFD_AZIMUTH_112_Rx_oRDR_FUSION_DET_109_112_oPCAN_RADAR_7daf8ba1_Rx: ComSignalType=UINT8
            DET_CONFD_ELEVATION_109_Rx_oRDR_FUSION_DET_109_112_oPCAN_RADAR_cf56a9f0_Rx: ComSignalType=UINT8
            DET_CONFD_ELEVATION_110_Rx_oRDR_FUSION_DET_109_112_oPCAN_RADAR_f2762ae9_Rx: ComSignalType=UINT8
            DET_CONFD_ELEVATION_111_Rx_oRDR_FUSION_DET_109_112_oPCAN_RADAR_5d32b8ae_Rx: ComSignalType=UINT8
            DET_CONFD_ELEVATION_112_Rx_oRDR_FUSION_DET_109_112_oPCAN_RADAR_778e0826_Rx: ComSignalType=UINT8
            DET_ELEVATION_109_Rx_oRDR_FUSION_DET_109_112_oPCAN_RADAR_c5054609_Rx: ComSignalType=UINT8
            DET_ELEVATION_110_Rx_oRDR_FUSION_DET_109_112_oPCAN_RADAR_f825c510_Rx: ComSignalType=UINT8
            DET_ELEVATION_111_Rx_oRDR_FUSION_DET_109_112_oPCAN_RADAR_57615757_Rx: ComSignalType=UINT8
            DET_ELEVATION_112_Rx_oRDR_FUSION_DET_109_112_oPCAN_RADAR_7ddde7df_Rx: ComSignalType=UINT8
            DET_ELEVATION_ERR_109_Rx_oRDR_FUSION_DET_109_112_oPCAN_RADAR_17bc64d6_Rx: ComSignalType=UINT8
            DET_ELEVATION_ERR_110_Rx_oRDR_FUSION_DET_109_112_oPCAN_RADAR_2a9ce7cf_Rx: ComSignalType=UINT8
            DET_ELEVATION_ERR_111_Rx_oRDR_FUSION_DET_109_112_oPCAN_RADAR_85d87588_Rx: ComSignalType=UINT8
            DET_ELEVATION_ERR_112_Rx_oRDR_FUSION_DET_109_112_oPCAN_RADAR_af64c500_Rx: ComSignalType=UINT8
            DET_EXISTENCE_PROB_109_Rx_oRDR_FUSION_DET_109_112_oPCAN_RADAR_e0a41c43_Rx: ComSignalType=UINT8
            DET_EXISTENCE_PROB_110_Rx_oRDR_FUSION_DET_109_112_oPCAN_RADAR_dd849f5a_Rx: ComSignalType=UINT8
            DET_EXISTENCE_PROB_111_Rx_oRDR_FUSION_DET_109_112_oPCAN_RADAR_72c00d1d_Rx: ComSignalType=UINT8
            DET_EXISTENCE_PROB_112_Rx_oRDR_FUSION_DET_109_112_oPCAN_RADAR_587cbd95_Rx: ComSignalType=UINT8
            DET_HVC_FLAG_109_Rx_oRDR_FUSION_DET_109_112_oPCAN_RADAR_3d7af10c_Rx: ComSignalType=BOOLEAN
            DET_HVC_FLAG_110_Rx_oRDR_FUSION_DET_109_112_oPCAN_RADAR_005a7215_Rx: ComSignalType=BOOLEAN
            DET_HVC_FLAG_111_Rx_oRDR_FUSION_DET_109_112_oPCAN_RADAR_af1ee052_Rx: ComSignalType=BOOLEAN
            DET_HVC_FLAG_112_Rx_oRDR_FUSION_DET_109_112_oPCAN_RADAR_85a250da_Rx: ComSignalType=BOOLEAN
            DET_IDM_109_Rx_oRDR_FUSION_DET_109_112_oPCAN_RADAR_08bb0844_Rx: ComSignalType=BOOLEAN
            DET_IDM_110_Rx_oRDR_FUSION_DET_109_112_oPCAN_RADAR_359b8b5d_Rx: ComSignalType=BOOLEAN
            DET_IDM_111_Rx_oRDR_FUSION_DET_109_112_oPCAN_RADAR_9adf191a_Rx: ComSignalType=BOOLEAN
            DET_IDM_112_Rx_oRDR_FUSION_DET_109_112_oPCAN_RADAR_b063a992_Rx: ComSignalType=BOOLEAN
            DET_MH_CRC16_109_112_Rx_oRDR_FUSION_DET_109_112_oPCAN_RADAR_23bdd699_Rx: ComSignalType=UINT16
            DET_MH_CYCLE_COUNTER_109_112_Rx_oRDR_FUSION_DET_109_112_oPCAN_RADAR_2e66eb5c_Rx: ComSignalType=UINT8
            DET_MH_SCAN_INDEX_4LSB_109_112_Rx_oRDR_FUSION_DET_109_112_oPCAN_RADAR_4ad62467_Rx: ComSignalType=UINT8
            DET_MTD_109_Rx_oRDR_FUSION_DET_109_112_oPCAN_RADAR_b5383e34_Rx: ComSignalType=BOOLEAN
            DET_MTD_110_Rx_oRDR_FUSION_DET_109_112_oPCAN_RADAR_8818bd2d_Rx: ComSignalType=BOOLEAN
            DET_MTD_111_Rx_oRDR_FUSION_DET_109_112_oPCAN_RADAR_275c2f6a_Rx: ComSignalType=BOOLEAN
            DET_MTD_112_Rx_oRDR_FUSION_DET_109_112_oPCAN_RADAR_0de09fe2_Rx: ComSignalType=BOOLEAN
            DET_PROB_1STAZHYPO_109_Rx_oRDR_FUSION_DET_109_112_oPCAN_RADAR_7f4120b5_Rx: ComSignalType=BOOLEAN
            DET_PROB_1STAZHYPO_110_Rx_oRDR_FUSION_DET_109_112_oPCAN_RADAR_4261a3ac_Rx: ComSignalType=BOOLEAN
            DET_PROB_1STAZHYPO_111_Rx_oRDR_FUSION_DET_109_112_oPCAN_RADAR_ed2531eb_Rx: ComSignalType=BOOLEAN
            DET_PROB_1STAZHYPO_112_Rx_oRDR_FUSION_DET_109_112_oPCAN_RADAR_c7998163_Rx: ComSignalType=BOOLEAN
            DET_RANGE_109_Rx_oRDR_FUSION_DET_109_112_oPCAN_RADAR_24fcc8a2_Rx: ComSignalType=UINT16
            DET_RANGE_110_Rx_oRDR_FUSION_DET_109_112_oPCAN_RADAR_19dc4bbb_Rx: ComSignalType=UINT16
            DET_RANGE_111_Rx_oRDR_FUSION_DET_109_112_oPCAN_RADAR_b698d9fc_Rx: ComSignalType=UINT16
            DET_RANGE_112_Rx_oRDR_FUSION_DET_109_112_oPCAN_RADAR_9c246974_Rx: ComSignalType=UINT16
            DET_RANGE_ERR_109_Rx_oRDR_FUSION_DET_109_112_oPCAN_RADAR_740e4442_Rx: ComSignalType=UINT8
            DET_RANGE_ERR_110_Rx_oRDR_FUSION_DET_109_112_oPCAN_RADAR_492ec75b_Rx: ComSignalType=UINT8
            DET_RANGE_ERR_111_Rx_oRDR_FUSION_DET_109_112_oPCAN_RADAR_e66a551c_Rx: ComSignalType=UINT8
            DET_RANGE_ERR_112_Rx_oRDR_FUSION_DET_109_112_oPCAN_RADAR_ccd6e594_Rx: ComSignalType=UINT8
            DET_RANGE_VELOCITY_109_Rx_oRDR_FUSION_DET_109_112_oPCAN_RADAR_f9094b5c_Rx: ComSignalType=UINT16
            DET_RANGE_VELOCITY_110_Rx_oRDR_FUSION_DET_109_112_oPCAN_RADAR_c429c845_Rx: ComSignalType=UINT16
            DET_RANGE_VELOCITY_111_Rx_oRDR_FUSION_DET_109_112_oPCAN_RADAR_6b6d5a02_Rx: ComSignalType=UINT16
            DET_RANGE_VELOCITY_112_Rx_oRDR_FUSION_DET_109_112_oPCAN_RADAR_41d1ea8a_Rx: ComSignalType=UINT16
            DET_RANGE_VELOCITY_ERR_109_Rx_oRDR_FUSION_DET_109_112_oPCAN_RADAR_606d3b9e_Rx: ComSignalType=UINT8
            DET_RANGE_VELOCITY_ERR_110_Rx_oRDR_FUSION_DET_109_112_oPCAN_RADAR_5d4db887_Rx: ComSignalType=UINT8
            DET_RANGE_VELOCITY_ERR_111_Rx_oRDR_FUSION_DET_109_112_oPCAN_RADAR_f2092ac0_Rx: ComSignalType=UINT8
            DET_RANGE_VELOCITY_ERR_112_Rx_oRDR_FUSION_DET_109_112_oPCAN_RADAR_d8b59a48_Rx: ComSignalType=UINT8
            DET_RCS_109_Rx_oRDR_FUSION_DET_109_112_oPCAN_RADAR_34c2d947_Rx: ComSignalType=UINT8
            DET_RCS_110_Rx_oRDR_FUSION_DET_109_112_oPCAN_RADAR_09e25a5e_Rx: ComSignalType=UINT8
            DET_RCS_111_Rx_oRDR_FUSION_DET_109_112_oPCAN_RADAR_a6a6c819_Rx: ComSignalType=UINT8
            DET_RCS_112_Rx_oRDR_FUSION_DET_109_112_oPCAN_RADAR_8c1a7891_Rx: ComSignalType=UINT8
            DET_SNR_109_Rx_oRDR_FUSION_DET_109_112_oPCAN_RADAR_3d98a8ae_Rx: ComSignalType=UINT8
            DET_SNR_110_Rx_oRDR_FUSION_DET_109_112_oPCAN_RADAR_00b82bb7_Rx: ComSignalType=UINT8
            DET_SNR_111_Rx_oRDR_FUSION_DET_109_112_oPCAN_RADAR_affcb9f0_Rx: ComSignalType=UINT8
            DET_SNR_112_Rx_oRDR_FUSION_DET_109_112_oPCAN_RADAR_85400978_Rx: ComSignalType=UINT8
            DET_SUPER_RES_TARGET_109_Rx_oRDR_FUSION_DET_109_112_oPCAN_RADAR_f66389ae_Rx: ComSignalType=BOOLEAN
            DET_SUPER_RES_TARGET_110_Rx_oRDR_FUSION_DET_109_112_oPCAN_RADAR_cb430ab7_Rx: ComSignalType=BOOLEAN
            DET_SUPER_RES_TARGET_111_Rx_oRDR_FUSION_DET_109_112_oPCAN_RADAR_640798f0_Rx: ComSignalType=BOOLEAN
            DET_SUPER_RES_TARGET_112_Rx_oRDR_FUSION_DET_109_112_oPCAN_RADAR_4ebb2878_Rx: ComSignalType=BOOLEAN
        SG_Fusion_Detections_113_116_oRDR_FUSION_DET_113_116_oPCAN_RADAR_16b82f16_Rx
          83 x ComGroupSignal:
            DET_AZIMUTH_113_Rx_oRDR_FUSION_DET_113_116_oPCAN_RADAR_3d61a43a_Rx: ComSignalType=UINT16
            DET_AZIMUTH_114_Rx_oRDR_FUSION_DET_113_116_oPCAN_RADAR_c75c576d_Rx: ComSignalType=UINT16
            DET_AZIMUTH_115_Rx_oRDR_FUSION_DET_113_116_oPCAN_RADAR_6818c52a_Rx: ComSignalType=UINT16
            DET_AZIMUTH_116_Rx_oRDR_FUSION_DET_113_116_oPCAN_RADAR_42a475a2_Rx: ComSignalType=UINT16
            DET_AZIMUTH_ERR_113_Rx_oRDR_FUSION_DET_113_116_oPCAN_RADAR_3f0805b8_Rx: ComSignalType=UINT8
            DET_AZIMUTH_ERR_114_Rx_oRDR_FUSION_DET_113_116_oPCAN_RADAR_c535f6ef_Rx: ComSignalType=UINT8
            DET_AZIMUTH_ERR_115_Rx_oRDR_FUSION_DET_113_116_oPCAN_RADAR_6a7164a8_Rx: ComSignalType=UINT8
            DET_AZIMUTH_ERR_116_Rx_oRDR_FUSION_DET_113_116_oPCAN_RADAR_40cdd420_Rx: ComSignalType=UINT8
            DET_BELOW_RAIN_THOLD_113_Rx_oRDR_FUSION_DET_113_116_oPCAN_RADAR_5bdb5b8f_Rx: ComSignalType=BOOLEAN
            DET_BELOW_RAIN_THOLD_114_Rx_oRDR_FUSION_DET_113_116_oPCAN_RADAR_a1e6a8d8_Rx: ComSignalType=BOOLEAN
            DET_BELOW_RAIN_THOLD_115_Rx_oRDR_FUSION_DET_113_116_oPCAN_RADAR_0ea23a9f_Rx: ComSignalType=BOOLEAN
            DET_BELOW_RAIN_THOLD_116_Rx_oRDR_FUSION_DET_113_116_oPCAN_RADAR_241e8a17_Rx: ComSignalType=BOOLEAN
            DET_BI_STATIC_FLAG_113_Rx_oRDR_FUSION_DET_113_116_oPCAN_RADAR_2c45f09c_Rx: ComSignalType=BOOLEAN
            DET_BI_STATIC_FLAG_114_Rx_oRDR_FUSION_DET_113_116_oPCAN_RADAR_d67803cb_Rx: ComSignalType=BOOLEAN
            DET_BI_STATIC_FLAG_115_Rx_oRDR_FUSION_DET_113_116_oPCAN_RADAR_793c918c_Rx: ComSignalType=BOOLEAN
            DET_BI_STATIC_FLAG_116_Rx_oRDR_FUSION_DET_113_116_oPCAN_RADAR_53802104_Rx: ComSignalType=BOOLEAN
            DET_CONFD_AZIMUTH_113_Rx_oRDR_FUSION_DET_113_116_oPCAN_RADAR_cf2c1ac8_Rx: ComSignalType=UINT8
            DET_CONFD_AZIMUTH_114_Rx_oRDR_FUSION_DET_113_116_oPCAN_RADAR_3511e99f_Rx: ComSignalType=UINT8
            DET_CONFD_AZIMUTH_115_Rx_oRDR_FUSION_DET_113_116_oPCAN_RADAR_9a557bd8_Rx: ComSignalType=UINT8
            DET_CONFD_AZIMUTH_116_Rx_oRDR_FUSION_DET_113_116_oPCAN_RADAR_b0e9cb50_Rx: ComSignalType=UINT8
            DET_CONFD_ELEVATION_113_Rx_oRDR_FUSION_DET_113_116_oPCAN_RADAR_c50d994f_Rx: ComSignalType=UINT8
            DET_CONFD_ELEVATION_114_Rx_oRDR_FUSION_DET_113_116_oPCAN_RADAR_3f306a18_Rx: ComSignalType=UINT8
            DET_CONFD_ELEVATION_115_Rx_oRDR_FUSION_DET_113_116_oPCAN_RADAR_9074f85f_Rx: ComSignalType=UINT8
            DET_CONFD_ELEVATION_116_Rx_oRDR_FUSION_DET_113_116_oPCAN_RADAR_bac848d7_Rx: ComSignalType=UINT8
            DET_ELEVATION_113_Rx_oRDR_FUSION_DET_113_116_oPCAN_RADAR_cf5e76b6_Rx: ComSignalType=UINT8
            DET_ELEVATION_114_Rx_oRDR_FUSION_DET_113_116_oPCAN_RADAR_356385e1_Rx: ComSignalType=UINT8
            DET_ELEVATION_115_Rx_oRDR_FUSION_DET_113_116_oPCAN_RADAR_9a2717a6_Rx: ComSignalType=UINT8
            DET_ELEVATION_116_Rx_oRDR_FUSION_DET_113_116_oPCAN_RADAR_b09ba72e_Rx: ComSignalType=UINT8
            DET_ELEVATION_ERR_113_Rx_oRDR_FUSION_DET_113_116_oPCAN_RADAR_1de75469_Rx: ComSignalType=UINT8
            DET_ELEVATION_ERR_114_Rx_oRDR_FUSION_DET_113_116_oPCAN_RADAR_e7daa73e_Rx: ComSignalType=UINT8
            DET_ELEVATION_ERR_115_Rx_oRDR_FUSION_DET_113_116_oPCAN_RADAR_489e3579_Rx: ComSignalType=UINT8
            DET_ELEVATION_ERR_116_Rx_oRDR_FUSION_DET_113_116_oPCAN_RADAR_622285f1_Rx: ComSignalType=UINT8
            DET_EXISTENCE_PROB_113_Rx_oRDR_FUSION_DET_113_116_oPCAN_RADAR_eaff2cfc_Rx: ComSignalType=UINT8
            DET_EXISTENCE_PROB_114_Rx_oRDR_FUSION_DET_113_116_oPCAN_RADAR_10c2dfab_Rx: ComSignalType=UINT8
            DET_EXISTENCE_PROB_115_Rx_oRDR_FUSION_DET_113_116_oPCAN_RADAR_bf864dec_Rx: ComSignalType=UINT8
            DET_EXISTENCE_PROB_116_Rx_oRDR_FUSION_DET_113_116_oPCAN_RADAR_953afd64_Rx: ComSignalType=UINT8
            DET_HVC_FLAG_113_Rx_oRDR_FUSION_DET_113_116_oPCAN_RADAR_3721c1b3_Rx: ComSignalType=BOOLEAN
            DET_HVC_FLAG_114_Rx_oRDR_FUSION_DET_113_116_oPCAN_RADAR_cd1c32e4_Rx: ComSignalType=BOOLEAN
            DET_HVC_FLAG_115_Rx_oRDR_FUSION_DET_113_116_oPCAN_RADAR_6258a0a3_Rx: ComSignalType=BOOLEAN
            DET_HVC_FLAG_116_Rx_oRDR_FUSION_DET_113_116_oPCAN_RADAR_48e4102b_Rx: ComSignalType=BOOLEAN
            DET_IDM_113_Rx_oRDR_FUSION_DET_113_116_oPCAN_RADAR_02e038fb_Rx: ComSignalType=BOOLEAN
            DET_IDM_114_Rx_oRDR_FUSION_DET_113_116_oPCAN_RADAR_f8ddcbac_Rx: ComSignalType=BOOLEAN
            DET_IDM_115_Rx_oRDR_FUSION_DET_113_116_oPCAN_RADAR_579959eb_Rx: ComSignalType=BOOLEAN
            DET_IDM_116_Rx_oRDR_FUSION_DET_113_116_oPCAN_RADAR_7d25e963_Rx: ComSignalType=BOOLEAN
            DET_MH_CRC16_113_116_Rx_oRDR_FUSION_DET_113_116_oPCAN_RADAR_930d0bb1_Rx: ComSignalType=UINT16
            DET_MH_CYCLE_COUNTER_113_116_Rx_oRDR_FUSION_DET_113_116_oPCAN_RADAR_9ed63674_Rx: ComSignalType=UINT8
            DET_MH_SCAN_INDEX_4LSB_113_116_Rx_oRDR_FUSION_DET_113_116_oPCAN_RADAR_fa66f94f_Rx: ComSignalType=UINT8
            DET_MTD_113_Rx_oRDR_FUSION_DET_113_116_oPCAN_RADAR_bf630e8b_Rx: ComSignalType=BOOLEAN
            DET_MTD_114_Rx_oRDR_FUSION_DET_113_116_oPCAN_RADAR_455efddc_Rx: ComSignalType=BOOLEAN
            DET_MTD_115_Rx_oRDR_FUSION_DET_113_116_oPCAN_RADAR_ea1a6f9b_Rx: ComSignalType=BOOLEAN
            DET_MTD_116_Rx_oRDR_FUSION_DET_113_116_oPCAN_RADAR_c0a6df13_Rx: ComSignalType=BOOLEAN
            DET_PROB_1STAZHYPO_113_Rx_oRDR_FUSION_DET_113_116_oPCAN_RADAR_751a100a_Rx: ComSignalType=BOOLEAN
            DET_PROB_1STAZHYPO_114_Rx_oRDR_FUSION_DET_113_116_oPCAN_RADAR_8f27e35d_Rx: ComSignalType=BOOLEAN
            DET_PROB_1STAZHYPO_115_Rx_oRDR_FUSION_DET_113_116_oPCAN_RADAR_2063711a_Rx: ComSignalType=BOOLEAN
            DET_PROB_1STAZHYPO_116_Rx_oRDR_FUSION_DET_113_116_oPCAN_RADAR_0adfc192_Rx: ComSignalType=BOOLEAN
            DET_RANGE_113_Rx_oRDR_FUSION_DET_113_116_oPCAN_RADAR_2ea7f81d_Rx: ComSignalType=UINT16
            DET_RANGE_114_Rx_oRDR_FUSION_DET_113_116_oPCAN_RADAR_d49a0b4a_Rx: ComSignalType=UINT16
            DET_RANGE_115_Rx_oRDR_FUSION_DET_113_116_oPCAN_RADAR_7bde990d_Rx: ComSignalType=UINT16
            DET_RANGE_116_Rx_oRDR_FUSION_DET_113_116_oPCAN_RADAR_51622985_Rx: ComSignalType=UINT16
            DET_RANGE_ERR_113_Rx_oRDR_FUSION_DET_113_116_oPCAN_RADAR_7e5574fd_Rx: ComSignalType=UINT8
            DET_RANGE_ERR_114_Rx_oRDR_FUSION_DET_113_116_oPCAN_RADAR_846887aa_Rx: ComSignalType=UINT8
            DET_RANGE_ERR_115_Rx_oRDR_FUSION_DET_113_116_oPCAN_RADAR_2b2c15ed_Rx: ComSignalType=UINT8
            DET_RANGE_ERR_116_Rx_oRDR_FUSION_DET_113_116_oPCAN_RADAR_0190a565_Rx: ComSignalType=UINT8
            DET_RANGE_VELOCITY_113_Rx_oRDR_FUSION_DET_113_116_oPCAN_RADAR_f3527be3_Rx: ComSignalType=UINT16
            DET_RANGE_VELOCITY_114_Rx_oRDR_FUSION_DET_113_116_oPCAN_RADAR_096f88b4_Rx: ComSignalType=UINT16
            DET_RANGE_VELOCITY_115_Rx_oRDR_FUSION_DET_113_116_oPCAN_RADAR_a62b1af3_Rx: ComSignalType=UINT16
            DET_RANGE_VELOCITY_116_Rx_oRDR_FUSION_DET_113_116_oPCAN_RADAR_8c97aa7b_Rx: ComSignalType=UINT16
            DET_RANGE_VELOCITY_ERR_113_Rx_oRDR_FUSION_DET_113_116_oPCAN_RADAR_6a360b21_Rx: ComSignalType=UINT8
            DET_RANGE_VELOCITY_ERR_114_Rx_oRDR_FUSION_DET_113_116_oPCAN_RADAR_900bf876_Rx: ComSignalType=UINT8
            DET_RANGE_VELOCITY_ERR_115_Rx_oRDR_FUSION_DET_113_116_oPCAN_RADAR_3f4f6a31_Rx: ComSignalType=UINT8
            DET_RANGE_VELOCITY_ERR_116_Rx_oRDR_FUSION_DET_113_116_oPCAN_RADAR_15f3dab9_Rx: ComSignalType=UINT8
            DET_RCS_113_Rx_oRDR_FUSION_DET_113_116_oPCAN_RADAR_3e99e9f8_Rx: ComSignalType=UINT8
            DET_RCS_114_Rx_oRDR_FUSION_DET_113_116_oPCAN_RADAR_c4a41aaf_Rx: ComSignalType=UINT8
            DET_RCS_115_Rx_oRDR_FUSION_DET_113_116_oPCAN_RADAR_6be088e8_Rx: ComSignalType=UINT8
            DET_RCS_116_Rx_oRDR_FUSION_DET_113_116_oPCAN_RADAR_415c3860_Rx: ComSignalType=UINT8
            DET_SNR_113_Rx_oRDR_FUSION_DET_113_116_oPCAN_RADAR_37c39811_Rx: ComSignalType=UINT8
            DET_SNR_114_Rx_oRDR_FUSION_DET_113_116_oPCAN_RADAR_cdfe6b46_Rx: ComSignalType=UINT8
            DET_SNR_115_Rx_oRDR_FUSION_DET_113_116_oPCAN_RADAR_62baf901_Rx: ComSignalType=UINT8
            DET_SNR_116_Rx_oRDR_FUSION_DET_113_116_oPCAN_RADAR_48064989_Rx: ComSignalType=UINT8
            DET_SUPER_RES_TARGET_113_Rx_oRDR_FUSION_DET_113_116_oPCAN_RADAR_fc38b911_Rx: ComSignalType=BOOLEAN
            DET_SUPER_RES_TARGET_114_Rx_oRDR_FUSION_DET_113_116_oPCAN_RADAR_06054a46_Rx: ComSignalType=BOOLEAN
            DET_SUPER_RES_TARGET_115_Rx_oRDR_FUSION_DET_113_116_oPCAN_RADAR_a941d801_Rx: ComSignalType=BOOLEAN
            DET_SUPER_RES_TARGET_116_Rx_oRDR_FUSION_DET_113_116_oPCAN_RADAR_83fd6889_Rx: ComSignalType=BOOLEAN
        SG_Fusion_Detections_117_120_oRDR_FUSION_DET_117_120_oPCAN_RADAR_56a2c27e_Rx
          83 x ComGroupSignal:
            DET_AZIMUTH_117_Rx_oRDR_FUSION_DET_117_120_oPCAN_RADAR_426c3a2c_Rx: ComSignalType=UINT16
            DET_AZIMUTH_118_Rx_oRDR_FUSION_DET_117_120_oPCAN_RADAR_c2224884_Rx: ComSignalType=UINT16
            DET_AZIMUTH_119_Rx_oRDR_FUSION_DET_117_120_oPCAN_RADAR_6d66dac3_Rx: ComSignalType=UINT16
            DET_AZIMUTH_120_Rx_oRDR_FUSION_DET_117_120_oPCAN_RADAR_5b187ed9_Rx: ComSignalType=UINT16
            DET_AZIMUTH_ERR_117_Rx_oRDR_FUSION_DET_117_120_oPCAN_RADAR_40059bae_Rx: ComSignalType=UINT8
            DET_AZIMUTH_ERR_118_Rx_oRDR_FUSION_DET_117_120_oPCAN_RADAR_c04be906_Rx: ComSignalType=UINT8
            DET_AZIMUTH_ERR_119_Rx_oRDR_FUSION_DET_117_120_oPCAN_RADAR_6f0f7b41_Rx: ComSignalType=UINT8
            DET_AZIMUTH_ERR_120_Rx_oRDR_FUSION_DET_117_120_oPCAN_RADAR_5971df5b_Rx: ComSignalType=UINT8
            DET_BELOW_RAIN_THOLD_117_Rx_oRDR_FUSION_DET_117_120_oPCAN_RADAR_24d6c599_Rx: ComSignalType=BOOLEAN
            DET_BELOW_RAIN_THOLD_118_Rx_oRDR_FUSION_DET_117_120_oPCAN_RADAR_a498b731_Rx: ComSignalType=BOOLEAN
            DET_BELOW_RAIN_THOLD_119_Rx_oRDR_FUSION_DET_117_120_oPCAN_RADAR_0bdc2576_Rx: ComSignalType=BOOLEAN
            DET_BELOW_RAIN_THOLD_120_Rx_oRDR_FUSION_DET_117_120_oPCAN_RADAR_3da2816c_Rx: ComSignalType=BOOLEAN
            DET_BI_STATIC_FLAG_117_Rx_oRDR_FUSION_DET_117_120_oPCAN_RADAR_53486e8a_Rx: ComSignalType=BOOLEAN
            DET_BI_STATIC_FLAG_118_Rx_oRDR_FUSION_DET_117_120_oPCAN_RADAR_d3061c22_Rx: ComSignalType=BOOLEAN
            DET_BI_STATIC_FLAG_119_Rx_oRDR_FUSION_DET_117_120_oPCAN_RADAR_7c428e65_Rx: ComSignalType=BOOLEAN
            DET_BI_STATIC_FLAG_120_Rx_oRDR_FUSION_DET_117_120_oPCAN_RADAR_4a3c2a7f_Rx: ComSignalType=BOOLEAN
            DET_CONFD_AZIMUTH_117_Rx_oRDR_FUSION_DET_117_120_oPCAN_RADAR_b02184de_Rx: ComSignalType=UINT8
            DET_CONFD_AZIMUTH_118_Rx_oRDR_FUSION_DET_117_120_oPCAN_RADAR_306ff676_Rx: ComSignalType=UINT8
            DET_CONFD_AZIMUTH_119_Rx_oRDR_FUSION_DET_117_120_oPCAN_RADAR_9f2b6431_Rx: ComSignalType=UINT8
            DET_CONFD_AZIMUTH_120_Rx_oRDR_FUSION_DET_117_120_oPCAN_RADAR_a955c02b_Rx: ComSignalType=UINT8
            DET_CONFD_ELEVATION_117_Rx_oRDR_FUSION_DET_117_120_oPCAN_RADAR_ba000759_Rx: ComSignalType=UINT8
            DET_CONFD_ELEVATION_118_Rx_oRDR_FUSION_DET_117_120_oPCAN_RADAR_3a4e75f1_Rx: ComSignalType=UINT8
            DET_CONFD_ELEVATION_119_Rx_oRDR_FUSION_DET_117_120_oPCAN_RADAR_950ae7b6_Rx: ComSignalType=UINT8
            DET_CONFD_ELEVATION_120_Rx_oRDR_FUSION_DET_117_120_oPCAN_RADAR_a37443ac_Rx: ComSignalType=UINT8
            DET_ELEVATION_117_Rx_oRDR_FUSION_DET_117_120_oPCAN_RADAR_b053e8a0_Rx: ComSignalType=UINT8
            DET_ELEVATION_118_Rx_oRDR_FUSION_DET_117_120_oPCAN_RADAR_301d9a08_Rx: ComSignalType=UINT8
            DET_ELEVATION_119_Rx_oRDR_FUSION_DET_117_120_oPCAN_RADAR_9f59084f_Rx: ComSignalType=UINT8
            DET_ELEVATION_120_Rx_oRDR_FUSION_DET_117_120_oPCAN_RADAR_a927ac55_Rx: ComSignalType=UINT8
            DET_ELEVATION_ERR_117_Rx_oRDR_FUSION_DET_117_120_oPCAN_RADAR_62eaca7f_Rx: ComSignalType=UINT8
            DET_ELEVATION_ERR_118_Rx_oRDR_FUSION_DET_117_120_oPCAN_RADAR_e2a4b8d7_Rx: ComSignalType=UINT8
            DET_ELEVATION_ERR_119_Rx_oRDR_FUSION_DET_117_120_oPCAN_RADAR_4de02a90_Rx: ComSignalType=UINT8
            DET_ELEVATION_ERR_120_Rx_oRDR_FUSION_DET_117_120_oPCAN_RADAR_7b9e8e8a_Rx: ComSignalType=UINT8
            DET_EXISTENCE_PROB_117_Rx_oRDR_FUSION_DET_117_120_oPCAN_RADAR_95f2b2ea_Rx: ComSignalType=UINT8
            DET_EXISTENCE_PROB_118_Rx_oRDR_FUSION_DET_117_120_oPCAN_RADAR_15bcc042_Rx: ComSignalType=UINT8
            DET_EXISTENCE_PROB_119_Rx_oRDR_FUSION_DET_117_120_oPCAN_RADAR_baf85205_Rx: ComSignalType=UINT8
            DET_EXISTENCE_PROB_120_Rx_oRDR_FUSION_DET_117_120_oPCAN_RADAR_8c86f61f_Rx: ComSignalType=UINT8
            DET_HVC_FLAG_117_Rx_oRDR_FUSION_DET_117_120_oPCAN_RADAR_482c5fa5_Rx: ComSignalType=BOOLEAN
            DET_HVC_FLAG_118_Rx_oRDR_FUSION_DET_117_120_oPCAN_RADAR_c8622d0d_Rx: ComSignalType=BOOLEAN
            DET_HVC_FLAG_119_Rx_oRDR_FUSION_DET_117_120_oPCAN_RADAR_6726bf4a_Rx: ComSignalType=BOOLEAN
            DET_HVC_FLAG_120_Rx_oRDR_FUSION_DET_117_120_oPCAN_RADAR_51581b50_Rx: ComSignalType=BOOLEAN
            DET_IDM_117_Rx_oRDR_FUSION_DET_117_120_oPCAN_RADAR_7deda6ed_Rx: ComSignalType=BOOLEAN
            DET_IDM_118_Rx_oRDR_FUSION_DET_117_120_oPCAN_RADAR_fda3d445_Rx: ComSignalType=BOOLEAN
            DET_IDM_119_Rx_oRDR_FUSION_DET_117_120_oPCAN_RADAR_52e74602_Rx: ComSignalType=BOOLEAN
            DET_IDM_120_Rx_oRDR_FUSION_DET_117_120_oPCAN_RADAR_6499e218_Rx: ComSignalType=BOOLEAN
            DET_MH_CRC16_117_120_Rx_oRDR_FUSION_DET_117_120_oPCAN_RADAR_2211e142_Rx: ComSignalType=UINT16
            DET_MH_CYCLE_COUNTER_117_120_Rx_oRDR_FUSION_DET_117_120_oPCAN_RADAR_2fcadc87_Rx: ComSignalType=UINT8
            DET_MH_SCAN_INDEX_4LSB_117_120_Rx_oRDR_FUSION_DET_117_120_oPCAN_RADAR_4b7a13bc_Rx: ComSignalType=UINT8
            DET_MTD_117_Rx_oRDR_FUSION_DET_117_120_oPCAN_RADAR_c06e909d_Rx: ComSignalType=BOOLEAN
            DET_MTD_118_Rx_oRDR_FUSION_DET_117_120_oPCAN_RADAR_4020e235_Rx: ComSignalType=BOOLEAN
            DET_MTD_119_Rx_oRDR_FUSION_DET_117_120_oPCAN_RADAR_ef647072_Rx: ComSignalType=BOOLEAN
            DET_MTD_120_Rx_oRDR_FUSION_DET_117_120_oPCAN_RADAR_d91ad468_Rx: ComSignalType=BOOLEAN
            DET_PROB_1STAZHYPO_117_Rx_oRDR_FUSION_DET_117_120_oPCAN_RADAR_0a178e1c_Rx: ComSignalType=BOOLEAN
            DET_PROB_1STAZHYPO_118_Rx_oRDR_FUSION_DET_117_120_oPCAN_RADAR_8a59fcb4_Rx: ComSignalType=BOOLEAN
            DET_PROB_1STAZHYPO_119_Rx_oRDR_FUSION_DET_117_120_oPCAN_RADAR_251d6ef3_Rx: ComSignalType=BOOLEAN
            DET_PROB_1STAZHYPO_120_Rx_oRDR_FUSION_DET_117_120_oPCAN_RADAR_1363cae9_Rx: ComSignalType=BOOLEAN
            DET_RANGE_117_Rx_oRDR_FUSION_DET_117_120_oPCAN_RADAR_51aa660b_Rx: ComSignalType=UINT16
            DET_RANGE_118_Rx_oRDR_FUSION_DET_117_120_oPCAN_RADAR_d1e414a3_Rx: ComSignalType=UINT16
            DET_RANGE_119_Rx_oRDR_FUSION_DET_117_120_oPCAN_RADAR_7ea086e4_Rx: ComSignalType=UINT16
            DET_RANGE_120_Rx_oRDR_FUSION_DET_117_120_oPCAN_RADAR_48de22fe_Rx: ComSignalType=UINT16
            DET_RANGE_ERR_117_Rx_oRDR_FUSION_DET_117_120_oPCAN_RADAR_0158eaeb_Rx: ComSignalType=UINT8
            DET_RANGE_ERR_118_Rx_oRDR_FUSION_DET_117_120_oPCAN_RADAR_81169843_Rx: ComSignalType=UINT8
            DET_RANGE_ERR_119_Rx_oRDR_FUSION_DET_117_120_oPCAN_RADAR_2e520a04_Rx: ComSignalType=UINT8
            DET_RANGE_ERR_120_Rx_oRDR_FUSION_DET_117_120_oPCAN_RADAR_182cae1e_Rx: ComSignalType=UINT8
            DET_RANGE_VELOCITY_117_Rx_oRDR_FUSION_DET_117_120_oPCAN_RADAR_8c5fe5f5_Rx: ComSignalType=UINT16
            DET_RANGE_VELOCITY_118_Rx_oRDR_FUSION_DET_117_120_oPCAN_RADAR_0c11975d_Rx: ComSignalType=UINT16
            DET_RANGE_VELOCITY_119_Rx_oRDR_FUSION_DET_117_120_oPCAN_RADAR_a355051a_Rx: ComSignalType=UINT16
            DET_RANGE_VELOCITY_120_Rx_oRDR_FUSION_DET_117_120_oPCAN_RADAR_952ba100_Rx: ComSignalType=UINT16
            DET_RANGE_VELOCITY_ERR_117_Rx_oRDR_FUSION_DET_117_120_oPCAN_RADAR_153b9537_Rx: ComSignalType=UINT8
            DET_RANGE_VELOCITY_ERR_118_Rx_oRDR_FUSION_DET_117_120_oPCAN_RADAR_9575e79f_Rx: ComSignalType=UINT8
            DET_RANGE_VELOCITY_ERR_119_Rx_oRDR_FUSION_DET_117_120_oPCAN_RADAR_3a3175d8_Rx: ComSignalType=UINT8
            DET_RANGE_VELOCITY_ERR_120_Rx_oRDR_FUSION_DET_117_120_oPCAN_RADAR_0c4fd1c2_Rx: ComSignalType=UINT8
            DET_RCS_117_Rx_oRDR_FUSION_DET_117_120_oPCAN_RADAR_419477ee_Rx: ComSignalType=UINT8
            DET_RCS_118_Rx_oRDR_FUSION_DET_117_120_oPCAN_RADAR_c1da0546_Rx: ComSignalType=UINT8
            DET_RCS_119_Rx_oRDR_FUSION_DET_117_120_oPCAN_RADAR_6e9e9701_Rx: ComSignalType=UINT8
            DET_RCS_120_Rx_oRDR_FUSION_DET_117_120_oPCAN_RADAR_58e0331b_Rx: ComSignalType=UINT8
            DET_SNR_117_Rx_oRDR_FUSION_DET_117_120_oPCAN_RADAR_48ce0607_Rx: ComSignalType=UINT8
            DET_SNR_118_Rx_oRDR_FUSION_DET_117_120_oPCAN_RADAR_c88074af_Rx: ComSignalType=UINT8
            DET_SNR_119_Rx_oRDR_FUSION_DET_117_120_oPCAN_RADAR_67c4e6e8_Rx: ComSignalType=UINT8
            DET_SNR_120_Rx_oRDR_FUSION_DET_117_120_oPCAN_RADAR_51ba42f2_Rx: ComSignalType=UINT8
            DET_SUPER_RES_TARGET_117_Rx_oRDR_FUSION_DET_117_120_oPCAN_RADAR_83352707_Rx: ComSignalType=BOOLEAN
            DET_SUPER_RES_TARGET_118_Rx_oRDR_FUSION_DET_117_120_oPCAN_RADAR_037b55af_Rx: ComSignalType=BOOLEAN
            DET_SUPER_RES_TARGET_119_Rx_oRDR_FUSION_DET_117_120_oPCAN_RADAR_ac3fc7e8_Rx: ComSignalType=BOOLEAN
            DET_SUPER_RES_TARGET_120_Rx_oRDR_FUSION_DET_117_120_oPCAN_RADAR_9a4163f2_Rx: ComSignalType=BOOLEAN
        SG_Fusion_Detections_121_124_oRDR_FUSION_DET_121_124_oPCAN_RADAR_9023764b_Rx
          83 x ComGroupSignal:
            DET_AZIMUTH_121_Rx_oRDR_FUSION_DET_121_124_oPCAN_RADAR_7957ec62_Rx: ComSignalType=UINT16
            DET_AZIMUTH_122_Rx_oRDR_FUSION_DET_121_124_oPCAN_RADAR_53eb5cea_Rx: ComSignalType=UINT16
            DET_AZIMUTH_123_Rx_oRDR_FUSION_DET_121_124_oPCAN_RADAR_fcafcead_Rx: ComSignalType=UINT16
            DET_AZIMUTH_124_Rx_oRDR_FUSION_DET_121_124_oPCAN_RADAR_06923dfa_Rx: ComSignalType=UINT16
            DET_AZIMUTH_ERR_121_Rx_oRDR_FUSION_DET_121_124_oPCAN_RADAR_7b3e4de0_Rx: ComSignalType=UINT8
            DET_AZIMUTH_ERR_122_Rx_oRDR_FUSION_DET_121_124_oPCAN_RADAR_5182fd68_Rx: ComSignalType=UINT8
            DET_AZIMUTH_ERR_123_Rx_oRDR_FUSION_DET_121_124_oPCAN_RADAR_fec66f2f_Rx: ComSignalType=UINT8
            DET_AZIMUTH_ERR_124_Rx_oRDR_FUSION_DET_121_124_oPCAN_RADAR_04fb9c78_Rx: ComSignalType=UINT8
            DET_BELOW_RAIN_THOLD_121_Rx_oRDR_FUSION_DET_121_124_oPCAN_RADAR_1fed13d7_Rx: ComSignalType=BOOLEAN
            DET_BELOW_RAIN_THOLD_122_Rx_oRDR_FUSION_DET_121_124_oPCAN_RADAR_3551a35f_Rx: ComSignalType=BOOLEAN
            DET_BELOW_RAIN_THOLD_123_Rx_oRDR_FUSION_DET_121_124_oPCAN_RADAR_9a153118_Rx: ComSignalType=BOOLEAN
            DET_BELOW_RAIN_THOLD_124_Rx_oRDR_FUSION_DET_121_124_oPCAN_RADAR_6028c24f_Rx: ComSignalType=BOOLEAN
            DET_BI_STATIC_FLAG_121_Rx_oRDR_FUSION_DET_121_124_oPCAN_RADAR_6873b8c4_Rx: ComSignalType=BOOLEAN
            DET_BI_STATIC_FLAG_122_Rx_oRDR_FUSION_DET_121_124_oPCAN_RADAR_42cf084c_Rx: ComSignalType=BOOLEAN
            DET_BI_STATIC_FLAG_123_Rx_oRDR_FUSION_DET_121_124_oPCAN_RADAR_ed8b9a0b_Rx: ComSignalType=BOOLEAN
            DET_BI_STATIC_FLAG_124_Rx_oRDR_FUSION_DET_121_124_oPCAN_RADAR_17b6695c_Rx: ComSignalType=BOOLEAN
            DET_CONFD_AZIMUTH_121_Rx_oRDR_FUSION_DET_121_124_oPCAN_RADAR_8b1a5290_Rx: ComSignalType=UINT8
            DET_CONFD_AZIMUTH_122_Rx_oRDR_FUSION_DET_121_124_oPCAN_RADAR_a1a6e218_Rx: ComSignalType=UINT8
            DET_CONFD_AZIMUTH_123_Rx_oRDR_FUSION_DET_121_124_oPCAN_RADAR_0ee2705f_Rx: ComSignalType=UINT8
            DET_CONFD_AZIMUTH_124_Rx_oRDR_FUSION_DET_121_124_oPCAN_RADAR_f4df8308_Rx: ComSignalType=UINT8
            DET_CONFD_ELEVATION_121_Rx_oRDR_FUSION_DET_121_124_oPCAN_RADAR_813bd117_Rx: ComSignalType=UINT8
            DET_CONFD_ELEVATION_122_Rx_oRDR_FUSION_DET_121_124_oPCAN_RADAR_ab87619f_Rx: ComSignalType=UINT8
            DET_CONFD_ELEVATION_123_Rx_oRDR_FUSION_DET_121_124_oPCAN_RADAR_04c3f3d8_Rx: ComSignalType=UINT8
            DET_CONFD_ELEVATION_124_Rx_oRDR_FUSION_DET_121_124_oPCAN_RADAR_fefe008f_Rx: ComSignalType=UINT8
            DET_ELEVATION_121_Rx_oRDR_FUSION_DET_121_124_oPCAN_RADAR_8b683eee_Rx: ComSignalType=UINT8
            DET_ELEVATION_122_Rx_oRDR_FUSION_DET_121_124_oPCAN_RADAR_a1d48e66_Rx: ComSignalType=UINT8
            DET_ELEVATION_123_Rx_oRDR_FUSION_DET_121_124_oPCAN_RADAR_0e901c21_Rx: ComSignalType=UINT8
            DET_ELEVATION_124_Rx_oRDR_FUSION_DET_121_124_oPCAN_RADAR_f4adef76_Rx: ComSignalType=UINT8
            DET_ELEVATION_ERR_121_Rx_oRDR_FUSION_DET_121_124_oPCAN_RADAR_59d11c31_Rx: ComSignalType=UINT8
            DET_ELEVATION_ERR_122_Rx_oRDR_FUSION_DET_121_124_oPCAN_RADAR_736dacb9_Rx: ComSignalType=UINT8
            DET_ELEVATION_ERR_123_Rx_oRDR_FUSION_DET_121_124_oPCAN_RADAR_dc293efe_Rx: ComSignalType=UINT8
            DET_ELEVATION_ERR_124_Rx_oRDR_FUSION_DET_121_124_oPCAN_RADAR_2614cda9_Rx: ComSignalType=UINT8
            DET_EXISTENCE_PROB_121_Rx_oRDR_FUSION_DET_121_124_oPCAN_RADAR_aec964a4_Rx: ComSignalType=UINT8
            DET_EXISTENCE_PROB_122_Rx_oRDR_FUSION_DET_121_124_oPCAN_RADAR_8475d42c_Rx: ComSignalType=UINT8
            DET_EXISTENCE_PROB_123_Rx_oRDR_FUSION_DET_121_124_oPCAN_RADAR_2b31466b_Rx: ComSignalType=UINT8
            DET_EXISTENCE_PROB_124_Rx_oRDR_FUSION_DET_121_124_oPCAN_RADAR_d10cb53c_Rx: ComSignalType=UINT8
            DET_HVC_FLAG_121_Rx_oRDR_FUSION_DET_121_124_oPCAN_RADAR_731789eb_Rx: ComSignalType=BOOLEAN
            DET_HVC_FLAG_122_Rx_oRDR_FUSION_DET_121_124_oPCAN_RADAR_59ab3963_Rx: ComSignalType=BOOLEAN
            DET_HVC_FLAG_123_Rx_oRDR_FUSION_DET_121_124_oPCAN_RADAR_f6efab24_Rx: ComSignalType=BOOLEAN
            DET_HVC_FLAG_124_Rx_oRDR_FUSION_DET_121_124_oPCAN_RADAR_0cd25873_Rx: ComSignalType=BOOLEAN
            DET_IDM_121_Rx_oRDR_FUSION_DET_121_124_oPCAN_RADAR_46d670a3_Rx: ComSignalType=BOOLEAN
            DET_IDM_122_Rx_oRDR_FUSION_DET_121_124_oPCAN_RADAR_6c6ac02b_Rx: ComSignalType=BOOLEAN
            DET_IDM_123_Rx_oRDR_FUSION_DET_121_124_oPCAN_RADAR_c32e526c_Rx: ComSignalType=BOOLEAN
            DET_IDM_124_Rx_oRDR_FUSION_DET_121_124_oPCAN_RADAR_3913a13b_Rx: ComSignalType=BOOLEAN
            DET_MH_CRC16_121_124_Rx_oRDR_FUSION_DET_121_124_oPCAN_RADAR_bca04db8_Rx: ComSignalType=UINT16
            DET_MH_CYCLE_COUNTER_121_124_Rx_oRDR_FUSION_DET_121_124_oPCAN_RADAR_b17b707d_Rx: ComSignalType=UINT8
            DET_MH_SCAN_INDEX_4LSB_121_124_Rx_oRDR_FUSION_DET_121_124_oPCAN_RADAR_d5cbbf46_Rx: ComSignalType=UINT8
            DET_MTD_121_Rx_oRDR_FUSION_DET_121_124_oPCAN_RADAR_fb5546d3_Rx: ComSignalType=BOOLEAN
            DET_MTD_122_Rx_oRDR_FUSION_DET_121_124_oPCAN_RADAR_d1e9f65b_Rx: ComSignalType=BOOLEAN
            DET_MTD_123_Rx_oRDR_FUSION_DET_121_124_oPCAN_RADAR_7ead641c_Rx: ComSignalType=BOOLEAN
            DET_MTD_124_Rx_oRDR_FUSION_DET_121_124_oPCAN_RADAR_8490974b_Rx: ComSignalType=BOOLEAN
            DET_PROB_1STAZHYPO_121_Rx_oRDR_FUSION_DET_121_124_oPCAN_RADAR_312c5852_Rx: ComSignalType=BOOLEAN
            DET_PROB_1STAZHYPO_122_Rx_oRDR_FUSION_DET_121_124_oPCAN_RADAR_1b90e8da_Rx: ComSignalType=BOOLEAN
            DET_PROB_1STAZHYPO_123_Rx_oRDR_FUSION_DET_121_124_oPCAN_RADAR_b4d47a9d_Rx: ComSignalType=BOOLEAN
            DET_PROB_1STAZHYPO_124_Rx_oRDR_FUSION_DET_121_124_oPCAN_RADAR_4ee989ca_Rx: ComSignalType=BOOLEAN
            DET_RANGE_121_Rx_oRDR_FUSION_DET_121_124_oPCAN_RADAR_6a91b045_Rx: ComSignalType=UINT16
            DET_RANGE_122_Rx_oRDR_FUSION_DET_121_124_oPCAN_RADAR_402d00cd_Rx: ComSignalType=UINT16
            DET_RANGE_123_Rx_oRDR_FUSION_DET_121_124_oPCAN_RADAR_ef69928a_Rx: ComSignalType=UINT16
            DET_RANGE_124_Rx_oRDR_FUSION_DET_121_124_oPCAN_RADAR_155461dd_Rx: ComSignalType=UINT16
            DET_RANGE_ERR_121_Rx_oRDR_FUSION_DET_121_124_oPCAN_RADAR_3a633ca5_Rx: ComSignalType=UINT8
            DET_RANGE_ERR_122_Rx_oRDR_FUSION_DET_121_124_oPCAN_RADAR_10df8c2d_Rx: ComSignalType=UINT8
            DET_RANGE_ERR_123_Rx_oRDR_FUSION_DET_121_124_oPCAN_RADAR_bf9b1e6a_Rx: ComSignalType=UINT8
            DET_RANGE_ERR_124_Rx_oRDR_FUSION_DET_121_124_oPCAN_RADAR_45a6ed3d_Rx: ComSignalType=UINT8
            DET_RANGE_VELOCITY_121_Rx_oRDR_FUSION_DET_121_124_oPCAN_RADAR_b76433bb_Rx: ComSignalType=UINT16
            DET_RANGE_VELOCITY_122_Rx_oRDR_FUSION_DET_121_124_oPCAN_RADAR_9dd88333_Rx: ComSignalType=UINT16
            DET_RANGE_VELOCITY_123_Rx_oRDR_FUSION_DET_121_124_oPCAN_RADAR_329c1174_Rx: ComSignalType=UINT16
            DET_RANGE_VELOCITY_124_Rx_oRDR_FUSION_DET_121_124_oPCAN_RADAR_c8a1e223_Rx: ComSignalType=UINT16
            DET_RANGE_VELOCITY_ERR_121_Rx_oRDR_FUSION_DET_121_124_oPCAN_RADAR_2e004379_Rx: ComSignalType=UINT8
            DET_RANGE_VELOCITY_ERR_122_Rx_oRDR_FUSION_DET_121_124_oPCAN_RADAR_04bcf3f1_Rx: ComSignalType=UINT8
            DET_RANGE_VELOCITY_ERR_123_Rx_oRDR_FUSION_DET_121_124_oPCAN_RADAR_abf861b6_Rx: ComSignalType=UINT8
            DET_RANGE_VELOCITY_ERR_124_Rx_oRDR_FUSION_DET_121_124_oPCAN_RADAR_51c592e1_Rx: ComSignalType=UINT8
            DET_RCS_121_Rx_oRDR_FUSION_DET_121_124_oPCAN_RADAR_7aafa1a0_Rx: ComSignalType=UINT8
            DET_RCS_122_Rx_oRDR_FUSION_DET_121_124_oPCAN_RADAR_50131128_Rx: ComSignalType=UINT8
            DET_RCS_123_Rx_oRDR_FUSION_DET_121_124_oPCAN_RADAR_ff57836f_Rx: ComSignalType=UINT8
            DET_RCS_124_Rx_oRDR_FUSION_DET_121_124_oPCAN_RADAR_056a7038_Rx: ComSignalType=UINT8
            DET_SNR_121_Rx_oRDR_FUSION_DET_121_124_oPCAN_RADAR_73f5d049_Rx: ComSignalType=UINT8
            DET_SNR_122_Rx_oRDR_FUSION_DET_121_124_oPCAN_RADAR_594960c1_Rx: ComSignalType=UINT8
            DET_SNR_123_Rx_oRDR_FUSION_DET_121_124_oPCAN_RADAR_f60df286_Rx: ComSignalType=UINT8
            DET_SNR_124_Rx_oRDR_FUSION_DET_121_124_oPCAN_RADAR_0c3001d1_Rx: ComSignalType=UINT8
            DET_SUPER_RES_TARGET_121_Rx_oRDR_FUSION_DET_121_124_oPCAN_RADAR_b80ef149_Rx: ComSignalType=BOOLEAN
            DET_SUPER_RES_TARGET_122_Rx_oRDR_FUSION_DET_121_124_oPCAN_RADAR_92b241c1_Rx: ComSignalType=BOOLEAN
            DET_SUPER_RES_TARGET_123_Rx_oRDR_FUSION_DET_121_124_oPCAN_RADAR_3df6d386_Rx: ComSignalType=BOOLEAN
            DET_SUPER_RES_TARGET_124_Rx_oRDR_FUSION_DET_121_124_oPCAN_RADAR_c7cb20d1_Rx: ComSignalType=BOOLEAN
        SG_Fusion_Detections_125_128_oRDR_FUSION_DET_125_128_oPCAN_RADAR_ddd85db8_Rx
          83 x ComGroupSignal:
            DET_AZIMUTH_125_Rx_oRDR_FUSION_DET_125_128_oPCAN_RADAR_40643189_Rx: ComSignalType=UINT16
            DET_AZIMUTH_126_Rx_oRDR_FUSION_DET_125_128_oPCAN_RADAR_6ad88101_Rx: ComSignalType=UINT16
            DET_AZIMUTH_127_Rx_oRDR_FUSION_DET_125_128_oPCAN_RADAR_c59c1346_Rx: ComSignalType=UINT16
            DET_AZIMUTH_128_Rx_oRDR_FUSION_DET_125_128_oPCAN_RADAR_45d261ee_Rx: ComSignalType=UINT16
            DET_AZIMUTH_ERR_125_Rx_oRDR_FUSION_DET_125_128_oPCAN_RADAR_420d900b_Rx: ComSignalType=UINT8
            DET_AZIMUTH_ERR_126_Rx_oRDR_FUSION_DET_125_128_oPCAN_RADAR_68b12083_Rx: ComSignalType=UINT8
            DET_AZIMUTH_ERR_127_Rx_oRDR_FUSION_DET_125_128_oPCAN_RADAR_c7f5b2c4_Rx: ComSignalType=UINT8
            DET_AZIMUTH_ERR_128_Rx_oRDR_FUSION_DET_125_128_oPCAN_RADAR_47bbc06c_Rx: ComSignalType=UINT8
            DET_BELOW_RAIN_THOLD_125_Rx_oRDR_FUSION_DET_125_128_oPCAN_RADAR_26dece3c_Rx: ComSignalType=BOOLEAN
            DET_BELOW_RAIN_THOLD_126_Rx_oRDR_FUSION_DET_125_128_oPCAN_RADAR_0c627eb4_Rx: ComSignalType=BOOLEAN
            DET_BELOW_RAIN_THOLD_127_Rx_oRDR_FUSION_DET_125_128_oPCAN_RADAR_a326ecf3_Rx: ComSignalType=BOOLEAN
            DET_BELOW_RAIN_THOLD_128_Rx_oRDR_FUSION_DET_125_128_oPCAN_RADAR_23689e5b_Rx: ComSignalType=BOOLEAN
            DET_BI_STATIC_FLAG_125_Rx_oRDR_FUSION_DET_125_128_oPCAN_RADAR_5140652f_Rx: ComSignalType=BOOLEAN
            DET_BI_STATIC_FLAG_126_Rx_oRDR_FUSION_DET_125_128_oPCAN_RADAR_7bfcd5a7_Rx: ComSignalType=BOOLEAN
            DET_BI_STATIC_FLAG_127_Rx_oRDR_FUSION_DET_125_128_oPCAN_RADAR_d4b847e0_Rx: ComSignalType=BOOLEAN
            DET_BI_STATIC_FLAG_128_Rx_oRDR_FUSION_DET_125_128_oPCAN_RADAR_54f63548_Rx: ComSignalType=BOOLEAN
            DET_CONFD_AZIMUTH_125_Rx_oRDR_FUSION_DET_125_128_oPCAN_RADAR_b2298f7b_Rx: ComSignalType=UINT8
            DET_CONFD_AZIMUTH_126_Rx_oRDR_FUSION_DET_125_128_oPCAN_RADAR_98953ff3_Rx: ComSignalType=UINT8
            DET_CONFD_AZIMUTH_127_Rx_oRDR_FUSION_DET_125_128_oPCAN_RADAR_37d1adb4_Rx: ComSignalType=UINT8
            DET_CONFD_AZIMUTH_128_Rx_oRDR_FUSION_DET_125_128_oPCAN_RADAR_b79fdf1c_Rx: ComSignalType=UINT8
            DET_CONFD_ELEVATION_125_Rx_oRDR_FUSION_DET_125_128_oPCAN_RADAR_b8080cfc_Rx: ComSignalType=UINT8
            DET_CONFD_ELEVATION_126_Rx_oRDR_FUSION_DET_125_128_oPCAN_RADAR_92b4bc74_Rx: ComSignalType=UINT8
            DET_CONFD_ELEVATION_127_Rx_oRDR_FUSION_DET_125_128_oPCAN_RADAR_3df02e33_Rx: ComSignalType=UINT8
            DET_CONFD_ELEVATION_128_Rx_oRDR_FUSION_DET_125_128_oPCAN_RADAR_bdbe5c9b_Rx: ComSignalType=UINT8
            DET_ELEVATION_125_Rx_oRDR_FUSION_DET_125_128_oPCAN_RADAR_b25be305_Rx: ComSignalType=UINT8
            DET_ELEVATION_126_Rx_oRDR_FUSION_DET_125_128_oPCAN_RADAR_98e7538d_Rx: ComSignalType=UINT8
            DET_ELEVATION_127_Rx_oRDR_FUSION_DET_125_128_oPCAN_RADAR_37a3c1ca_Rx: ComSignalType=UINT8
            DET_ELEVATION_128_Rx_oRDR_FUSION_DET_125_128_oPCAN_RADAR_b7edb362_Rx: ComSignalType=UINT8
            DET_ELEVATION_ERR_125_Rx_oRDR_FUSION_DET_125_128_oPCAN_RADAR_60e2c1da_Rx: ComSignalType=UINT8
            DET_ELEVATION_ERR_126_Rx_oRDR_FUSION_DET_125_128_oPCAN_RADAR_4a5e7152_Rx: ComSignalType=UINT8
            DET_ELEVATION_ERR_127_Rx_oRDR_FUSION_DET_125_128_oPCAN_RADAR_e51ae315_Rx: ComSignalType=UINT8
            DET_ELEVATION_ERR_128_Rx_oRDR_FUSION_DET_125_128_oPCAN_RADAR_655491bd_Rx: ComSignalType=UINT8
            DET_EXISTENCE_PROB_125_Rx_oRDR_FUSION_DET_125_128_oPCAN_RADAR_97fab94f_Rx: ComSignalType=UINT8
            DET_EXISTENCE_PROB_126_Rx_oRDR_FUSION_DET_125_128_oPCAN_RADAR_bd4609c7_Rx: ComSignalType=UINT8
            DET_EXISTENCE_PROB_127_Rx_oRDR_FUSION_DET_125_128_oPCAN_RADAR_12029b80_Rx: ComSignalType=UINT8
            DET_EXISTENCE_PROB_128_Rx_oRDR_FUSION_DET_125_128_oPCAN_RADAR_924ce928_Rx: ComSignalType=UINT8
            DET_HVC_FLAG_125_Rx_oRDR_FUSION_DET_125_128_oPCAN_RADAR_4a245400_Rx: ComSignalType=BOOLEAN
            DET_HVC_FLAG_126_Rx_oRDR_FUSION_DET_125_128_oPCAN_RADAR_6098e488_Rx: ComSignalType=BOOLEAN
            DET_HVC_FLAG_127_Rx_oRDR_FUSION_DET_125_128_oPCAN_RADAR_cfdc76cf_Rx: ComSignalType=BOOLEAN
            DET_HVC_FLAG_128_Rx_oRDR_FUSION_DET_125_128_oPCAN_RADAR_4f920467_Rx: ComSignalType=BOOLEAN
            DET_IDM_125_Rx_oRDR_FUSION_DET_125_128_oPCAN_RADAR_7fe5ad48_Rx: ComSignalType=BOOLEAN
            DET_IDM_126_Rx_oRDR_FUSION_DET_125_128_oPCAN_RADAR_55591dc0_Rx: ComSignalType=BOOLEAN
            DET_IDM_127_Rx_oRDR_FUSION_DET_125_128_oPCAN_RADAR_fa1d8f87_Rx: ComSignalType=BOOLEAN
            DET_IDM_128_Rx_oRDR_FUSION_DET_125_128_oPCAN_RADAR_7a53fd2f_Rx: ComSignalType=BOOLEAN
            DET_MH_CRC16_125_128_Rx_oRDR_FUSION_DET_125_128_oPCAN_RADAR_5740f024_Rx: ComSignalType=UINT16
            DET_MH_CYCLE_COUNTER_125_128_Rx_oRDR_FUSION_DET_125_128_oPCAN_RADAR_5a9bcde1_Rx: ComSignalType=UINT8
            DET_MH_SCAN_INDEX_4LSB_125_128_Rx_oRDR_FUSION_DET_125_128_oPCAN_RADAR_3e2b02da_Rx: ComSignalType=UINT8
            DET_MTD_125_Rx_oRDR_FUSION_DET_125_128_oPCAN_RADAR_c2669b38_Rx: ComSignalType=BOOLEAN
            DET_MTD_126_Rx_oRDR_FUSION_DET_125_128_oPCAN_RADAR_e8da2bb0_Rx: ComSignalType=BOOLEAN
            DET_MTD_127_Rx_oRDR_FUSION_DET_125_128_oPCAN_RADAR_479eb9f7_Rx: ComSignalType=BOOLEAN
            DET_MTD_128_Rx_oRDR_FUSION_DET_125_128_oPCAN_RADAR_c7d0cb5f_Rx: ComSignalType=BOOLEAN
            DET_PROB_1STAZHYPO_125_Rx_oRDR_FUSION_DET_125_128_oPCAN_RADAR_081f85b9_Rx: ComSignalType=BOOLEAN
            DET_PROB_1STAZHYPO_126_Rx_oRDR_FUSION_DET_125_128_oPCAN_RADAR_22a33531_Rx: ComSignalType=BOOLEAN
            DET_PROB_1STAZHYPO_127_Rx_oRDR_FUSION_DET_125_128_oPCAN_RADAR_8de7a776_Rx: ComSignalType=BOOLEAN
            DET_PROB_1STAZHYPO_128_Rx_oRDR_FUSION_DET_125_128_oPCAN_RADAR_0da9d5de_Rx: ComSignalType=BOOLEAN
            DET_RANGE_125_Rx_oRDR_FUSION_DET_125_128_oPCAN_RADAR_53a26dae_Rx: ComSignalType=UINT16
            DET_RANGE_126_Rx_oRDR_FUSION_DET_125_128_oPCAN_RADAR_791edd26_Rx: ComSignalType=UINT16
            DET_RANGE_127_Rx_oRDR_FUSION_DET_125_128_oPCAN_RADAR_d65a4f61_Rx: ComSignalType=UINT16
            DET_RANGE_128_Rx_oRDR_FUSION_DET_125_128_oPCAN_RADAR_56143dc9_Rx: ComSignalType=UINT16
            DET_RANGE_ERR_125_Rx_oRDR_FUSION_DET_125_128_oPCAN_RADAR_0350e14e_Rx: ComSignalType=UINT8
            DET_RANGE_ERR_126_Rx_oRDR_FUSION_DET_125_128_oPCAN_RADAR_29ec51c6_Rx: ComSignalType=UINT8
            DET_RANGE_ERR_127_Rx_oRDR_FUSION_DET_125_128_oPCAN_RADAR_86a8c381_Rx: ComSignalType=UINT8
            DET_RANGE_ERR_128_Rx_oRDR_FUSION_DET_125_128_oPCAN_RADAR_06e6b129_Rx: ComSignalType=UINT8
            DET_RANGE_VELOCITY_125_Rx_oRDR_FUSION_DET_125_128_oPCAN_RADAR_8e57ee50_Rx: ComSignalType=UINT16
            DET_RANGE_VELOCITY_126_Rx_oRDR_FUSION_DET_125_128_oPCAN_RADAR_a4eb5ed8_Rx: ComSignalType=UINT16
            DET_RANGE_VELOCITY_127_Rx_oRDR_FUSION_DET_125_128_oPCAN_RADAR_0bafcc9f_Rx: ComSignalType=UINT16
            DET_RANGE_VELOCITY_128_Rx_oRDR_FUSION_DET_125_128_oPCAN_RADAR_8be1be37_Rx: ComSignalType=UINT16
            DET_RANGE_VELOCITY_ERR_125_Rx_oRDR_FUSION_DET_125_128_oPCAN_RADAR_17339e92_Rx: ComSignalType=UINT8
            DET_RANGE_VELOCITY_ERR_126_Rx_oRDR_FUSION_DET_125_128_oPCAN_RADAR_3d8f2e1a_Rx: ComSignalType=UINT8
            DET_RANGE_VELOCITY_ERR_127_Rx_oRDR_FUSION_DET_125_128_oPCAN_RADAR_92cbbc5d_Rx: ComSignalType=UINT8
            DET_RANGE_VELOCITY_ERR_128_Rx_oRDR_FUSION_DET_125_128_oPCAN_RADAR_1285cef5_Rx: ComSignalType=UINT8
            DET_RCS_125_Rx_oRDR_FUSION_DET_125_128_oPCAN_RADAR_439c7c4b_Rx: ComSignalType=UINT8
            DET_RCS_126_Rx_oRDR_FUSION_DET_125_128_oPCAN_RADAR_6920ccc3_Rx: ComSignalType=UINT8
            DET_RCS_127_Rx_oRDR_FUSION_DET_125_128_oPCAN_RADAR_c6645e84_Rx: ComSignalType=UINT8
            DET_RCS_128_Rx_oRDR_FUSION_DET_125_128_oPCAN_RADAR_462a2c2c_Rx: ComSignalType=UINT8
            DET_SNR_125_Rx_oRDR_FUSION_DET_125_128_oPCAN_RADAR_4ac60da2_Rx: ComSignalType=UINT8
            DET_SNR_126_Rx_oRDR_FUSION_DET_125_128_oPCAN_RADAR_607abd2a_Rx: ComSignalType=UINT8
            DET_SNR_127_Rx_oRDR_FUSION_DET_125_128_oPCAN_RADAR_cf3e2f6d_Rx: ComSignalType=UINT8
            DET_SNR_128_Rx_oRDR_FUSION_DET_125_128_oPCAN_RADAR_4f705dc5_Rx: ComSignalType=UINT8
            DET_SUPER_RES_TARGET_125_Rx_oRDR_FUSION_DET_125_128_oPCAN_RADAR_813d2ca2_Rx: ComSignalType=BOOLEAN
            DET_SUPER_RES_TARGET_126_Rx_oRDR_FUSION_DET_125_128_oPCAN_RADAR_ab819c2a_Rx: ComSignalType=BOOLEAN
            DET_SUPER_RES_TARGET_127_Rx_oRDR_FUSION_DET_125_128_oPCAN_RADAR_04c50e6d_Rx: ComSignalType=BOOLEAN
            DET_SUPER_RES_TARGET_128_Rx_oRDR_FUSION_DET_125_128_oPCAN_RADAR_848b7cc5_Rx: ComSignalType=BOOLEAN
        SG_Fusion_RadarCapability_oRDR_FUSION_CAPABILITY_oPCAN_RADAR_c3552fd5_Rx
          31 x ComGroupSignal:
            CAP_AngleAzimuthRangeEnd_Rx_oRDR_FUSION_CAPABILITY_oPCAN_RADAR_8071b245_Rx: ComSignalType=SINT16
            CAP_AngleAzimuthRangeStart_Rx_oRDR_FUSION_CAPABILITY_oPCAN_RADAR_b276ba71_Rx: ComSignalType=SINT16
            CAP_BlockageActive_Rx_oRDR_FUSION_CAPABILITY_oPCAN_RADAR_379fa0e4_Rx: ComSignalType=BOOLEAN
            CAP_BlockageProbability_Rx_oRDR_FUSION_CAPABILITY_oPCAN_RADAR_397cd1e8_Rx: ComSignalType=UINT8
            CAP_BlockageSensitivity_Rx_oRDR_FUSION_CAPABILITY_oPCAN_RADAR_8548cf44_Rx: ComSignalType=UINT8
            CAP_BlockageStatus_Rx_oRDR_FUSION_CAPABILITY_oPCAN_RADAR_bfd94e34_Rx: ComSignalType=UINT8
            CAP_BlockageValue_Rx_oRDR_FUSION_CAPABILITY_oPCAN_RADAR_2053f8c3_Rx: ComSignalType=UINT8
            CAP_CYCLE_COUNTER_Rx_oRDR_FUSION_CAPABILITY_oPCAN_RADAR_9144c2b9_Rx: ComSignalType=UINT8
            CAP_DampingActive_Rx_oRDR_FUSION_CAPABILITY_oPCAN_RADAR_e5da1c2d_Rx: ComSignalType=BOOLEAN
            CAP_DampingCurrent_Rx_oRDR_FUSION_CAPABILITY_oPCAN_RADAR_12be9d0c_Rx: ComSignalType=UINT16
            CAP_DampingStandardDeviation_Rx_oRDR_FUSION_CAPABILITY_oPCAN_RADAR_9a983e87_Rx: ComSignalType=UINT8
            CAP_DampingStatus_Rx_oRDR_FUSION_CAPABILITY_oPCAN_RADAR_6d9cf2fd_Rx: ComSignalType=UINT8
            CAP_FreeSightCheckActive_Rx_oRDR_FUSION_CAPABILITY_oPCAN_RADAR_73e0c0e2_Rx: ComSignalType=UINT8
            CAP_FreeSightCheckStatus_Rx_oRDR_FUSION_CAPABILITY_oPCAN_RADAR_fba62e32_Rx: ComSignalType=UINT8
            CAP_MH_CRC16_Rx_oRDR_FUSION_CAPABILITY_oPCAN_RADAR_018c523e_Rx: ComSignalType=UINT16
            CAP_MaxDetRangeMotorbike_0_Rx_oRDR_FUSION_CAPABILITY_oPCAN_RADAR_1fe06f92_Rx: ComSignalType=UINT16
            CAP_MaxDetRangeMotorbike_1_Rx_oRDR_FUSION_CAPABILITY_oPCAN_RADAR_5169643b_Rx: ComSignalType=UINT16
            CAP_MaxDetRangeMotorbike_2_Rx_oRDR_FUSION_CAPABILITY_oPCAN_RADAR_82f278c0_Rx: ComSignalType=UINT16
            CAP_MaxDetRangePedestrian_0_Rx_oRDR_FUSION_CAPABILITY_oPCAN_RADAR_f5a4bfe3_Rx: ComSignalType=UINT16
            CAP_MaxDetRangePedestrian_1_Rx_oRDR_FUSION_CAPABILITY_oPCAN_RADAR_bb2db44a_Rx: ComSignalType=UINT16
            CAP_MaxDetRangePedestrian_2_Rx_oRDR_FUSION_CAPABILITY_oPCAN_RADAR_68b6a8b1_Rx: ComSignalType=UINT16
            CAP_MaxDetectionRangeCar_0_Rx_oRDR_FUSION_CAPABILITY_oPCAN_RADAR_b0ec0cb5_Rx: ComSignalType=UINT16
            CAP_MaxDetectionRangeCar_1_Rx_oRDR_FUSION_CAPABILITY_oPCAN_RADAR_fe65071c_Rx: ComSignalType=UINT16
            CAP_MaxDetectionRangeCar_2_Rx_oRDR_FUSION_CAPABILITY_oPCAN_RADAR_2dfe1be7_Rx: ComSignalType=UINT16
            CAP_RangeEstimationActive_Rx_oRDR_FUSION_CAPABILITY_oPCAN_RADAR_92caa8b4_Rx: ComSignalType=BOOLEAN
            CAP_RangeEstimationStatus_Rx_oRDR_FUSION_CAPABILITY_oPCAN_RADAR_1a8c4664_Rx: ComSignalType=UINT8
            CAP_SLBlockageFilterValue_Rx_oRDR_FUSION_CAPABILITY_oPCAN_RADAR_0444b24e_Rx: ComSignalType=UINT8
            CAP_SLBlockageFlag_Rx_oRDR_FUSION_CAPABILITY_oPCAN_RADAR_21586390_Rx: ComSignalType=BOOLEAN
            CAP_SLLMonitoringActive_Rx_oRDR_FUSION_CAPABILITY_oPCAN_RADAR_f5cab52b_Rx: ComSignalType=BOOLEAN
            CAP_SLLMonitoringStatus_Rx_oRDR_FUSION_CAPABILITY_oPCAN_RADAR_7d8c5bfb_Rx: ComSignalType=UINT8
            CAP_SideLobeLevelBeamformer_Rx_oRDR_FUSION_CAPABILITY_oPCAN_RADAR_bb7efd72_Rx: ComSignalType=UINT8
        SG_Fusion_RadarHeader_oRDR_FUSION_HEADER_001_oPCAN_RADAR_cad756d0_Rx
          36 x ComGroupSignal:
            HED_ALIGN_HOR_REF_Rx_oRDR_FUSION_HEADER_001_oPCAN_RADAR_147e49df_Rx: ComSignalType=UINT16
            HED_ALIGN_VER_REF_Rx_oRDR_FUSION_HEADER_001_oPCAN_RADAR_90a2f389_Rx: ComSignalType=UINT16
            HED_Auth_CRC32_Rx_oRDR_FUSION_HEADER_001_oPCAN_RADAR_70da9fad_Rx: ComSignalType=UINT32
            HED_DATA_QUALIFIER_Rx_oRDR_FUSION_HEADER_001_oPCAN_RADAR_5117e37a_Rx: ComSignalType=UINT8
            HED_DET_BI_STATIC_COUNT_Rx_oRDR_FUSION_HEADER_001_oPCAN_RADAR_29976834_Rx: ComSignalType=UINT8
            HED_DET_NUM_OF_1PASS_Rx_oRDR_FUSION_HEADER_001_oPCAN_RADAR_5e84b070_Rx: ComSignalType=UINT16
            HED_DET_NUM_OF_2PASS_Rx_oRDR_FUSION_HEADER_001_oPCAN_RADAR_97b0ab7d_Rx: ComSignalType=UINT16
            HED_DET_RANGE_MAX_Rx_oRDR_FUSION_HEADER_001_oPCAN_RADAR_76f895a6_Rx: ComSignalType=UINT16
            HED_DET_RANGE_MIN_Rx_oRDR_FUSION_HEADER_001_oPCAN_RADAR_437a84f8_Rx: ComSignalType=UINT16
            HED_DET_SPEED_RANGE_MAX_Rx_oRDR_FUSION_HEADER_001_oPCAN_RADAR_b7cc12b5_Rx: ComSignalType=UINT16
            HED_DET_SPEED_RANGE_MIN_Rx_oRDR_FUSION_HEADER_001_oPCAN_RADAR_824e03eb_Rx: ComSignalType=UINT16
            HED_FOV_HOR_MAX_Rx_oRDR_FUSION_HEADER_001_oPCAN_RADAR_4b891441_Rx: ComSignalType=UINT8
            HED_FOV_HOR_MIN_Rx_oRDR_FUSION_HEADER_001_oPCAN_RADAR_7e0b051f_Rx: ComSignalType=UINT8
            HED_FOV_VER_MAX_Rx_oRDR_FUSION_HEADER_001_oPCAN_RADAR_cf55ae17_Rx: ComSignalType=UINT8
            HED_FOV_VER_MIN_Rx_oRDR_FUSION_HEADER_001_oPCAN_RADAR_fad7bf49_Rx: ComSignalType=UINT8
            HED_LOOK_ID_Rx_oRDR_FUSION_HEADER_001_oPCAN_RADAR_1e55b53b_Rx: ComSignalType=UINT8
            HED_LOOK_INDEX_Rx_oRDR_FUSION_HEADER_001_oPCAN_RADAR_2bf2972b_Rx: ComSignalType=UINT16
            HED_MAX_NUM_OF_DETECTIONS_Rx_oRDR_FUSION_HEADER_001_oPCAN_RADAR_084cd53e_Rx: ComSignalType=UINT16
            HED_MH_CRC16_Rx_oRDR_FUSION_HEADER_001_oPCAN_RADAR_73943b50_Rx: ComSignalType=UINT16
            HED_MH_CYCLE_COUNTER_Rx_oRDR_FUSION_HEADER_001_oPCAN_RADAR_ea0b66ed_Rx: ComSignalType=UINT8
            HED_NUM_OF_RESTBINS_USED_Rx_oRDR_FUSION_HEADER_001_oPCAN_RADAR_627cc09c_Rx: ComSignalType=UINT16
            HED_NUM_OF_VALID_DETECTIONS_Rx_oRDR_FUSION_HEADER_001_oPCAN_RADAR_460781da_Rx: ComSignalType=UINT16
            HED_OPERATION_MODE_Rx_oRDR_FUSION_HEADER_001_oPCAN_RADAR_de864358_Rx: ComSignalType=UINT8
            HED_PROCESSED_RANGE_Rx_oRDR_FUSION_HEADER_001_oPCAN_RADAR_2cda03f8_Rx: ComSignalType=UINT16
            HED_RDR_HEADER_CMAC_Rx_oRDR_FUSION_HEADER_001_oPCAN_RADAR_64fe3bc9_Rx: ComSignalType=UINT8_N
            HED_RDR_HEADER_FV_Rx_oRDR_FUSION_HEADER_001_oPCAN_RADAR_b8f721a0_Rx: ComSignalType=UINT8_N
            HED_R_WRAPPING_Rx_oRDR_FUSION_HEADER_001_oPCAN_RADAR_738d42d6_Rx: ComSignalType=UINT8
            HED_Rain_Level_Rx_oRDR_FUSION_HEADER_001_oPCAN_RADAR_0b0549b9_Rx: ComSignalType=UINT8
            HED_SCAN_INDEX_Rx_oRDR_FUSION_HEADER_001_oPCAN_RADAR_906dc02d_Rx: ComSignalType=UINT16
            HED_SENSOR_TIME_STAMP_NS_Rx_oRDR_FUSION_HEADER_001_oPCAN_RADAR_6308a4c2_Rx: ComSignalType=UINT32
            HED_SENSOR_TIME_STAMP_SEC_Rx_oRDR_FUSION_HEADER_001_oPCAN_RADAR_282ee70b_Rx: ComSignalType=UINT32
            HED_SLOPE_CORR_EXECUTIONFLAG_Rx_oRDR_FUSION_HEADER_001_oPCAN_RADAR_848519d1_Rx: ComSignalType=UINT8
            HED_TIME_SYNC_SRC_MASTER_Rx_oRDR_FUSION_HEADER_001_oPCAN_RADAR_aeef5352_Rx: ComSignalType=BOOLEAN
            HED_TIME_SYNC_VALIDITY_FLAG_Rx_oRDR_FUSION_HEADER_001_oPCAN_RADAR_cf6ff64d_Rx: ComSignalType=UINT8
            HED_TRIGGER_TIME_Rx_oRDR_FUSION_HEADER_001_oPCAN_RADAR_554e6103_Rx: ComSignalType=UINT32
            HED_V_WRAPPING_Rx_oRDR_FUSION_HEADER_001_oPCAN_RADAR_854af1a6_Rx: ComSignalType=UINT16
        SG_Fusion_RadarStatus2_oRDR_FUSION_STATUS_002_oPCAN_RADAR_458079fc_Rx
          38 x ComGroupSignal:
            STS_AF_CORE_THROUGHPUT_Rx_oRDR_FUSION_STATUS_002_oPCAN_RADAR_fca7dcb6_Rx: ComSignalType=UINT8
            STS_BRR_STATUS_Rx_oRDR_FUSION_STATUS_002_oPCAN_RADAR_ab4c702f_Rx: ComSignalType=UINT8
            STS_CAN_NM_State_Rx_oRDR_FUSION_STATUS_002_oPCAN_RADAR_69c86af9_Rx: ComSignalType=UINT8
            STS_CORE_ACTV_FLT_BYTE_0_to_3_Rx_oRDR_FUSION_STATUS_002_oPCAN_RADAR_d8ff22f4_Rx: ComSignalType=UINT32
            STS_CORE_ACTV_FLT_BYTE_11_to_15_Rx_oRDR_FUSION_STATUS_002_oPCAN_RADAR_46956790_Rx: ComSignalType=UINT32
            STS_CORE_ACTV_FLT_BYTE_4_to_7_Rx_oRDR_FUSION_STATUS_002_oPCAN_RADAR_910aeb99_Rx: ComSignalType=UINT32
            STS_CORE_ACTV_FLT_BYTE_8_to_11_Rx_oRDR_FUSION_STATUS_002_oPCAN_RADAR_02a7f53e_Rx: ComSignalType=UINT32
            STS_First_CAN_Det_Inst_Latency_Rx_oRDR_FUSION_STATUS_002_oPCAN_RADAR_97228231_Rx: ComSignalType=UINT16
            STS_Gear_Position_Rx_oRDR_FUSION_STATUS_002_oPCAN_RADAR_6cfac34a_Rx: ComSignalType=UINT8
            STS_INTRFC_VERSION_ID_MAJOR_Rx_oRDR_FUSION_STATUS_002_oPCAN_RADAR_24081e81_Rx: ComSignalType=UINT8
            STS_INTRFC_VERSION_ID_MINOR_Rx_oRDR_FUSION_STATUS_002_oPCAN_RADAR_3b2f6430_Rx: ComSignalType=UINT8
            STS_INTRFC_VERSION_ID_PATCH_Rx_oRDR_FUSION_STATUS_002_oPCAN_RADAR_2cd61204_Rx: ComSignalType=UINT8
            STS_Last_CAN_Det_Inst_Latency_Rx_oRDR_FUSION_STATUS_002_oPCAN_RADAR_383e71e8_Rx: ComSignalType=UINT16
            STS_MCU_TEMP_Rx_oRDR_FUSION_STATUS_002_oPCAN_RADAR_b492ba9b_Rx: ComSignalType=UINT8
            STS_MH_002_CRC16_Rx_oRDR_FUSION_STATUS_002_oPCAN_RADAR_75522b12_Rx: ComSignalType=UINT16
            STS_MH_002_CYCLE_COUNTER_Rx_oRDR_FUSION_STATUS_002_oPCAN_RADAR_97a416ac_Rx: ComSignalType=UINT8
            STS_MMIC_RE_INIT_COUNT_Rx_oRDR_FUSION_STATUS_002_oPCAN_RADAR_1306724b_Rx: ComSignalType=UINT8
            STS_MMIC_TEMP_RX_Rx_oRDR_FUSION_STATUS_002_oPCAN_RADAR_8467dc68_Rx: ComSignalType=UINT8
            STS_MMIC_TEMP_TX0_Rx_oRDR_FUSION_STATUS_002_oPCAN_RADAR_3137a36b_Rx: ComSignalType=UINT8
            STS_MMIC_TEMP_TX1_2_Rx_oRDR_FUSION_STATUS_002_oPCAN_RADAR_8c03a0ef_Rx: ComSignalType=UINT8
            STS_MMIC_TEMP_TX3_4_Rx_oRDR_FUSION_STATUS_002_oPCAN_RADAR_fb1ab85b_Rx: ComSignalType=UINT8
            STS_NO_TSYN_ERROR_Rx_oRDR_FUSION_STATUS_002_oPCAN_RADAR_d3eee9d9_Rx: ComSignalType=BOOLEAN
            STS_POINT_OF_TRIGGER_Rx_oRDR_FUSION_STATUS_002_oPCAN_RADAR_81e821a6_Rx: ComSignalType=UINT16
            STS_RAIN_COUNT_Rx_oRDR_FUSION_STATUS_002_oPCAN_RADAR_1e737e66_Rx: ComSignalType=UINT16
            STS_RDD_CORE_THROUGHPUT_Rx_oRDR_FUSION_STATUS_002_oPCAN_RADAR_e15fe345_Rx: ComSignalType=UINT8
            STS_SCAN_TYPE_Rx_oRDR_FUSION_STATUS_002_oPCAN_RADAR_10a1b094_Rx: ComSignalType=BOOLEAN
            STS_STEERING_ANGLE_Rx_oRDR_FUSION_STATUS_002_oPCAN_RADAR_4b147df6_Rx: ComSignalType=UINT8
            STS_STEERING_ANGLE_SIGN_Rx_oRDR_FUSION_STATUS_002_oPCAN_RADAR_9792032c_Rx: ComSignalType=BOOLEAN
            STS_TIME_SYNC_OFFSET_Rx_oRDR_FUSION_STATUS_002_oPCAN_RADAR_d61087bd_Rx: ComSignalType=SINT16
            STS_TKEY_ACTV_FLT_BYTE_0_to_3_Rx_oRDR_FUSION_STATUS_002_oPCAN_RADAR_73aea715_Rx: ComSignalType=UINT32
            STS_TKEY_ACTV_FLT_BYTE_4_to_5_Rx_oRDR_FUSION_STATUS_002_oPCAN_RADAR_a749792a_Rx: ComSignalType=UINT16
            STS_VEHICLE_SPEED_CALC_Rx_oRDR_FUSION_STATUS_002_oPCAN_RADAR_ac8a2f2e_Rx: ComSignalType=UINT16
            STS_VEHICLE_SUPPLY_VOLTAGE_Rx_oRDR_FUSION_STATUS_002_oPCAN_RADAR_b633ed3e_Rx: ComSignalType=UINT8
            STS_VEH_SPEED_DIRECTION_Rx_oRDR_FUSION_STATUS_002_oPCAN_RADAR_238cca73_Rx: ComSignalType=BOOLEAN
            STS_Vehicle_Speed_Calc_QF_Rx_oRDR_FUSION_STATUS_002_oPCAN_RADAR_cf710cdf_Rx: ComSignalType=UINT8
            STS_XCVR_OPERATIONAL_Rx_oRDR_FUSION_STATUS_002_oPCAN_RADAR_2d179a83_Rx: ComSignalType=BOOLEAN
            STS_YAW_RATE_BIAS_Rx_oRDR_FUSION_STATUS_002_oPCAN_RADAR_d7dadf21_Rx: ComSignalType=UINT8
            STS_Yaw_Rate_Calc_QF_Rx_oRDR_FUSION_STATUS_002_oPCAN_RADAR_ba579c34_Rx: ComSignalType=UINT8
        SG_Fusion_RadarStatus_oRDR_FUSION_STATUS_001_oPCAN_RADAR_00ff53b8_Rx
          46 x ComGroupSignal:
            STS_AF_TIME_INST_Rx_oRDR_FUSION_STATUS_001_oPCAN_RADAR_e7ea07fd_Rx: ComSignalType=UINT8
            STS_AF_TIME_PEAK_Rx_oRDR_FUSION_STATUS_001_oPCAN_RADAR_fbf318d6_Rx: ComSignalType=UINT8
            STS_DET_DBC_BASE_VER_MAJOR_Rx_oRDR_FUSION_STATUS_001_oPCAN_RADAR_da72d0b4_Rx: ComSignalType=UINT8
            STS_DET_DBC_BASE_VER_MINOR_Rx_oRDR_FUSION_STATUS_001_oPCAN_RADAR_c555aa05_Rx: ComSignalType=UINT8
            STS_DIST_FRNT_BMPR_TO_RR_AXL_Rx_oRDR_FUSION_STATUS_001_oPCAN_RADAR_d3356ae9_Rx: ComSignalType=UINT16
            STS_HARDWARE_VERSION_Rx_oRDR_FUSION_STATUS_001_oPCAN_RADAR_eb5d2e7e_Rx: ComSignalType=UINT8
            STS_MAIN_CORE_TIME_INST_Rx_oRDR_FUSION_STATUS_001_oPCAN_RADAR_119502a5_Rx: ComSignalType=UINT8
            STS_MAIN_CORE_TIME_PEAK_Rx_oRDR_FUSION_STATUS_001_oPCAN_RADAR_0d8c1d8e_Rx: ComSignalType=UINT8
            STS_MH_001_CRC16_Rx_oRDR_FUSION_STATUS_001_oPCAN_RADAR_f7533949_Rx: ComSignalType=UINT16
            STS_MH_001_CYCLE_COUNTER_Rx_oRDR_FUSION_STATUS_001_oPCAN_RADAR_a907aaa1_Rx: ComSignalType=UINT8
            STS_PBL_VERSION_FIELD1_Rx_oRDR_FUSION_STATUS_001_oPCAN_RADAR_2fed7e79_Rx: ComSignalType=UINT8
            STS_PBL_VERSION_FIELD2_Rx_oRDR_FUSION_STATUS_001_oPCAN_RADAR_fc766282_Rx: ComSignalType=UINT8
            STS_PBL_VERSION_FIELD3_Rx_oRDR_FUSION_STATUS_001_oPCAN_RADAR_b2ff692b_Rx: ComSignalType=UINT8
            STS_PBL_VERSION_FIELD4_Rx_oRDR_FUSION_STATUS_001_oPCAN_RADAR_80315d35_Rx: ComSignalType=UINT8
            STS_PCAN_PROTOCOL_VER_MAJOR_Rx_oRDR_FUSION_STATUS_001_oPCAN_RADAR_ca576892_Rx: ComSignalType=UINT8
            STS_PCAN_PROTOCOL_VER_MINOR_Rx_oRDR_FUSION_STATUS_001_oPCAN_RADAR_d5701223_Rx: ComSignalType=UINT8
            STS_PLATFORM_VARIANT_Rx_oRDR_FUSION_STATUS_001_oPCAN_RADAR_1ab3f6e1_Rx: ComSignalType=UINT8
            STS_RDD_CORE_TIME_INST_Rx_oRDR_FUSION_STATUS_001_oPCAN_RADAR_b7ed7be5_Rx: ComSignalType=UINT8
            STS_RDD_CORE_TIME_PEAK_Rx_oRDR_FUSION_STATUS_001_oPCAN_RADAR_abf464ce_Rx: ComSignalType=UINT8
            STS_SENSOR_HEIGHT_Rx_oRDR_FUSION_STATUS_001_oPCAN_RADAR_afb05744_Rx: ComSignalType=UINT32
            STS_SENSOR_MOUNT_ORNT_PITCH_Rx_oRDR_FUSION_STATUS_001_oPCAN_RADAR_5d2c301f_Rx: ComSignalType=SINT16
            STS_SENSOR_MOUNT_ORNT_ROLL_Rx_oRDR_FUSION_STATUS_001_oPCAN_RADAR_2eb23309_Rx: ComSignalType=UINT16
            STS_SENSOR_MOUNT_ORNT_YAW_Rx_oRDR_FUSION_STATUS_001_oPCAN_RADAR_0ebbf3ee_Rx: ComSignalType=SINT16
            STS_SENSOR_MOUNT_POS_X_Rx_oRDR_FUSION_STATUS_001_oPCAN_RADAR_a13ba1df_Rx: ComSignalType=UINT16
            STS_SENSOR_MOUNT_POS_Y_Rx_oRDR_FUSION_STATUS_001_oPCAN_RADAR_efb2aa76_Rx: ComSignalType=UINT16
            STS_SENSOR_MOUNT_POS_Z_Rx_oRDR_FUSION_STATUS_001_oPCAN_RADAR_3c29b68d_Rx: ComSignalType=UINT16
            STS_SENSOR_POLARITY_Rx_oRDR_FUSION_STATUS_001_oPCAN_RADAR_cb038873_Rx: ComSignalType=BOOLEAN
            STS_SENSOR_POSITION_Rx_oRDR_FUSION_STATUS_001_oPCAN_RADAR_d8d06a93_Rx: ComSignalType=UINT8
            STS_SERIAL_NUMBER_SEQUENCE_Rx_oRDR_FUSION_STATUS_001_oPCAN_RADAR_18d84c3c_Rx: ComSignalType=UINT16
            STS_SERIAL_NUM_JULIAN_DAY_Rx_oRDR_FUSION_STATUS_001_oPCAN_RADAR_5edc9e7f_Rx: ComSignalType=UINT16
            STS_SERIAL_NUM_JULIAN_YEAR_Rx_oRDR_FUSION_STATUS_001_oPCAN_RADAR_901b4493_Rx: ComSignalType=UINT8
            STS_SMC_CAL_VER_MAJOR_Rx_oRDR_FUSION_STATUS_001_oPCAN_RADAR_d198a980_Rx: ComSignalType=UINT16
            STS_SMC_CAL_VER_MINOR_Rx_oRDR_FUSION_STATUS_001_oPCAN_RADAR_cebfd331_Rx: ComSignalType=UINT16
            STS_SMC_PLATFROM_VERSION_Rx_oRDR_FUSION_STATUS_001_oPCAN_RADAR_22874c18_Rx: ComSignalType=UINT8
            STS_SMC_SECTION_COMPTBLITY_Rx_oRDR_FUSION_STATUS_001_oPCAN_RADAR_09850e5f_Rx: ComSignalType=UINT16
            STS_SP_CORE_TIME_INST_Rx_oRDR_FUSION_STATUS_001_oPCAN_RADAR_eeeadfc2_Rx: ComSignalType=UINT8
            STS_SP_CORE_TIME_PEAK_Rx_oRDR_FUSION_STATUS_001_oPCAN_RADAR_f2f3c0e9_Rx: ComSignalType=UINT8
            STS_SW_VERSION_FIELD1_Rx_oRDR_FUSION_STATUS_001_oPCAN_RADAR_889c4622_Rx: ComSignalType=UINT8
            STS_SW_VERSION_FIELD2_Rx_oRDR_FUSION_STATUS_001_oPCAN_RADAR_5b075ad9_Rx: ComSignalType=UINT8
            STS_SW_VERSION_FIELD3_Rx_oRDR_FUSION_STATUS_001_oPCAN_RADAR_158e5170_Rx: ComSignalType=UINT8
            STS_SW_VERSION_FIELD4_Rx_oRDR_FUSION_STATUS_001_oPCAN_RADAR_2740656e_Rx: ComSignalType=UINT8
            STS_TIME_SINCE_POWER_ON_Rx_oRDR_FUSION_STATUS_001_oPCAN_RADAR_fe979836_Rx: ComSignalType=UINT32
            STS_USC_CAL_VER_MAJOR_Rx_oRDR_FUSION_STATUS_001_oPCAN_RADAR_0f3b2084_Rx: ComSignalType=UINT16
            STS_USC_CAL_VER_MINOR_Rx_oRDR_FUSION_STATUS_001_oPCAN_RADAR_101c5a35_Rx: ComSignalType=UINT16
            STS_USC_SECTION_COMPTBLITY_Rx_oRDR_FUSION_STATUS_001_oPCAN_RADAR_a8d15a86_Rx: ComSignalType=UINT16
            STS_VIN_Status_Rx_oRDR_FUSION_STATUS_001_oPCAN_RADAR_5e829ab0_Rx: ComSignalType=UINT8
        SG_GW_ADAS_FN_Enable_disable_sts_oGW_ADAS_FN_Enable_disable_sts_oPCAN_RADAR_9a8054b4_Rx
          8 x ComGroupSignal, all with ComSignalType=UINT8:
            AEBS_FN_Switch_sts_oGW_ADAS_FN_Enable_disable_sts_oPCAN_RADAR_319f3146_Rx
            BSIS_fn_Switch_Sts_oGW_ADAS_FN_Enable_disable_sts_oPCAN_RADAR_5e1d7109_Rx
            DDAW_fn_switch_sts_oGW_ADAS_FN_Enable_disable_sts_oPCAN_RADAR_a583cbd8_Rx
            DDAW_warning_suppression_oGW_ADAS_FN_Enable_disable_sts_oPCAN_RADAR_e90c956f_Rx
            LDWS_FN_Switch_sts_oGW_ADAS_FN_Enable_disable_sts_oPCAN_RADAR_c735f110_Rx
            MOIS_Fn_Switch_sts_oGW_ADAS_FN_Enable_disable_sts_oPCAN_RADAR_37aa4c7c_Rx
            MessageAliveCounter_oGW_ADAS_FN_Enable_disable_sts_oPCAN_RADAR_4999ad4b_Rx
            MessageCRC_oGW_ADAS_FN_Enable_disable_sts_oPCAN_RADAR_705ba35b_Rx
        SG_GW_CCVS1_oGW_CCVS1_oPCAN_RADAR_70857376_Rx
          3 x ComGroupSignal:
            BrakeSwitch_oGW_CCVS1_oPCAN_RADAR_4705a3bc_Rx: ComSignalType=UINT8
            ParkingBrakeSwitch_oGW_CCVS1_oPCAN_RADAR_4cb3f824_Rx: ComSignalType=UINT8
            WheelBasedVehicleSpeed_oGW_CCVS1_oPCAN_RADAR_96f6cac9_Rx: ComSignalType=UINT16
        SG_GW_CLS_Tx_16_oGW_CLS_Tx_16_oPCAN_RADAR_ecf85999_Rx
          Crawler_confi_status_info_oGW_CLS_Tx_16_oPCAN_RADAR_698927ba_Rx (ComGroupSignal): ComSignalType=BOOLEAN
          Transmission_type_info_oGW_CLS_Tx_16_oPCAN_RADAR_9dcf5c49_Rx (ComGroupSignal): ComSignalType=UINT8
        SG_GW_CLS_Tx_4_oGW_CLS_Tx_4_oPCAN_RADAR_474ec459_Rx
          Ignition_oGW_CLS_Tx_4_oPCAN_RADAR_6b7ac456_Rx (ComGroupSignal): ComSignalType=UINT8
          ReverseSwitchInfo_oGW_CLS_Tx_4_oPCAN_RADAR_82207cae_Rx (ComGroupSignal): ComSignalType=UINT8
        SG_GW_ETC2_03_oGW_ETC2_03_oPCAN_RADAR_04d9a8d8_Rx
          TransCurrentGear_03_oGW_ETC2_03_oPCAN_RADAR_e4621163_Rx (ComGroupSignal): ComSignalType=UINT8
        SG_GW_ETC2_oGW_ETC2_oPCAN_RADAR_d84ef27a_Rx
          TransCurrentGear_00_oGW_ETC2_oPCAN_RADAR_2bdb78e8_Rx (ComGroupSignal): ComSignalType=UINT8
        SG_GW_OEL_oGW_OEL_oPCAN_RADAR_dcaa9b38_Rx
          3 x ComGroupSignal, all with ComSignalType=UINT8:
            HazardLightSwitch_oGW_OEL_oPCAN_RADAR_5efed0a6_Rx
            HighLowBeamSwitch_oGW_OEL_oPCAN_RADAR_5e6caf50_Rx
            TurnSignalSwitch_oGW_OEL_oPCAN_RADAR_ae279c7f_Rx
