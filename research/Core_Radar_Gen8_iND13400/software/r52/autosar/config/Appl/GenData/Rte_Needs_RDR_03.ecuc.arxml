[part 7 of 8: package /DaVinci_Project]
AUTOSAR XML (schema 4-0-3)
package /DaVinci_Project  (continued)
  module config Com  (continued)
    ComConfig  (continued)
      239 x ComSignalGroup:  (continued)
        SG_GW_SAS_oGW_SAS_oPCAN_RADAR_0d213b5c_Rx
          8 x ComGroupSignal:
            MessageChecksum_oGW_SAS_oPCAN_RADAR_87a8a844_Rx: ComSignalType=UINT8
            MessageCounter_oGW_SAS_oPCAN_RADAR_f51168b6_Rx: ComSignalType=UINT8
            SteerAngleSensorActiveMode_oGW_SAS_oPCAN_RADAR_8c83afe6_Rx: ComSignalType=UINT8
            SteerAngleSensorCalibrated_oGW_SAS_oPCAN_RADAR_883db374_Rx: ComSignalType=UINT8
            SteerWheelAngleRangeCounterType_oGW_SAS_oPCAN_RADAR_30be95a7_Rx: ComSignalType=UINT8
            SteerWheelAngleRangeCounter_oGW_SAS_oPCAN_RADAR_e6274286_Rx: ComSignalType=UINT8
            SteerWheelAngleRange_oGW_SAS_oPCAN_RADAR_fe08ddff_Rx: ComSignalType=UINT16
            SteerWheelAngle_oGW_SAS_oPCAN_RADAR_a582dc0a_Rx: ComSignalType=UINT16
        SG_GW_TD_oGW_TD_oPCAN_RADAR_a8a59c34_Rx
          8 x ComGroupSignal, all with ComSignalType=UINT8:
            Day_oGW_TD_oPCAN_RADAR_5e7337eb_Rx
            Hours_oGW_TD_oPCAN_RADAR_70f4ea38_Rx
            LocalHourOffset_oGW_TD_oPCAN_RADAR_ed7302cc_Rx
            LocalMinuteOffset_oGW_TD_oPCAN_RADAR_6576cfca_Rx
            Minutes_oGW_TD_oPCAN_RADAR_f3505ea9_Rx
            Month_oGW_TD_oPCAN_RADAR_9592e5da_Rx
            Seconds_oGW_TD_oPCAN_RADAR_930edb8a_Rx
            Year_oGW_TD_oPCAN_RADAR_0a7d8ada_Rx
        SG_GW_VDC2_oGW_VDC2_oPCAN_RADAR_41520959_Rx
          4 x ComGroupSignal:
            LateralAcceleration_oGW_VDC2_oPCAN_RADAR_d68a0cd8_Rx: ComSignalType=UINT16
            LongitudinalAcceleration_oGW_VDC2_oPCAN_RADAR_c0095fa4_Rx: ComSignalType=UINT8
            SteerWheelAngle_oGW_VDC2_oPCAN_RADAR_4fddc2e4_Rx: ComSignalType=UINT16
            YawRate_oGW_VDC2_oPCAN_RADAR_f47de610_Rx: ComSignalType=UINT16
        SG_GW_VD_oGW_VD_oPCAN_RADAR_ad0f59e4_Rx
          TotalVehicleDistance_oGW_VD_oPCAN_RADAR_55cc86c5_Rx (ComGroupSignal): ComSignalType=UINT32
        SG_GW_VI_oGW_VI_oPCAN_RADAR_5c723f37_Rx
          VehicleIdentification_oGW_VI_oPCAN_RADAR_d901cf94_Rx (ComGroupSignal): ComSignalType=UINT8
        SG_GW_prop_ADAS_BSIS_info_oGW_prop_ADAS_BSIS_info_oPCAN_RADAR_e9da8865_Tx
          BlindSpotCollisionWarningLevel_oGW_prop_ADAS_BSIS_info_oPCAN_RADAR_787ec14f_Tx (ComGroupSignal): ComSignalType=SINT8
          BlindSpotDetectionState_oGW_prop_ADAS_BSIS_info_oPCAN_RADAR_c0a7d424_Tx (ComGroupSignal): ComSignalType=SINT8
        SG_MOIS_oMOIS_oVCAN_RADAR_f9ec408e_Tx
          MOISCollisionWarningLevel_oMOIS_oVCAN_RADAR_c4480988_Tx (ComGroupSignal): ComSignalType=UINT8
          MovingObjectDetectionState_oMOIS_oVCAN_RADAR_133b7455_Tx (ComGroupSignal): ComSignalType=UINT8
        SG_OEL_oOEL_oVCAN_RADAR_400a2f4d_Rx
          3 x ComGroupSignal, all with ComSignalType=UINT8:
            HazardLightSwitch_oOEL_oVCAN_RADAR_6e3514e2_Rx
            HighLowBeamSwitch_oOEL_oVCAN_RADAR_71269e88_Rx
            TurnSignalSwitch_oOEL_oVCAN_RADAR_e6019fee_Rx
        SG_RDR_BSD1_Tx_oRDR_BSD1_Tx_oPCAN_RADAR_bd131ac1_Tx
          BlindSpotCollisionWarningLevel_Tx_oRDR_BSD1_Tx_oPCAN_RADAR_5d3220a5_Tx (ComGroupSignal): ComSignalType=UINT8
          BlindSpotDetectionState_Tx_oRDR_BSD1_Tx_oPCAN_RADAR_edbb925a_Tx (ComGroupSignal): ComSignalType=UINT8
        SG_RadarCapability_oRDR_CAPABILITY_oPCAN_RADAR_be2920f1_Tx
          31 x ComGroupSignal:
            CAP_AngleAzimuthRangeEnd_oRDR_CAPABILITY_oPCAN_RADAR_a9c23dc6_Tx: ComSignalType=SINT16
            CAP_AngleAzimuthRangeStart_oRDR_CAPABILITY_oPCAN_RADAR_2a8ffbb4_Tx: ComSignalType=SINT16
            CAP_BlockageActive_oRDR_CAPABILITY_oPCAN_RADAR_5433d84c_Tx: ComSignalType=UINT8
            CAP_BlockageProbability_oRDR_CAPABILITY_oPCAN_RADAR_75a4bbd9_Tx: ComSignalType=UINT8
            CAP_BlockageSensitivity_oRDR_CAPABILITY_oPCAN_RADAR_0362010f_Tx: ComSignalType=UINT8
            CAP_BlockageStatus_oRDR_CAPABILITY_oPCAN_RADAR_03af1b08_Tx: ComSignalType=UINT8
            CAP_BlockageValue_oRDR_CAPABILITY_oPCAN_RADAR_006198cd_Tx: ComSignalType=UINT8
            CAP_CYCLE_COUNTER_oRDR_CAPABILITY_oPCAN_RADAR_4f1d1582_Tx: ComSignalType=UINT8
            CAP_DampingActive_oRDR_CAPABILITY_oPCAN_RADAR_e25d461d_Tx: ComSignalType=UINT8
            CAP_DampingCurrent_oRDR_CAPABILITY_oPCAN_RADAR_52c5af4f_Tx: ComSignalType=UINT16
            CAP_DampingStandardDeviation_oRDR_CAPABILITY_oPCAN_RADAR_e78ef0d8_Tx: ComSignalType=UINT8
            CAP_DampingStatus_oRDR_CAPABILITY_oPCAN_RADAR_b5c18559_Tx: ComSignalType=UINT8
            CAP_FreeSightCheckActive_oRDR_CAPABILITY_oPCAN_RADAR_703f26f7_Tx: ComSignalType=UINT8
            CAP_FreeSightCheckStatus_oRDR_CAPABILITY_oPCAN_RADAR_27a3e5b3_Tx: ComSignalType=UINT8
            CAP_MH_CRC16_oRDR_CAPABILITY_oPCAN_RADAR_8ad8d6d0_Tx: ComSignalType=UINT16
            CAP_MaxDetRangeMotorbike_0_oRDR_CAPABILITY_oPCAN_RADAR_5af73033_Tx: ComSignalType=UINT16
            CAP_MaxDetRangeMotorbike_1_oRDR_CAPABILITY_oPCAN_RADAR_39f0e917_Tx: ComSignalType=UINT16
            CAP_MaxDetRangeMotorbike_2_oRDR_CAPABILITY_oPCAN_RADAR_9cf8827b_Tx: ComSignalType=UINT16
            CAP_MaxDetRangePedestrian_0_oRDR_CAPABILITY_oPCAN_RADAR_fd5aacf5_Tx: ComSignalType=UINT16
            CAP_MaxDetRangePedestrian_1_oRDR_CAPABILITY_oPCAN_RADAR_9e5d75d1_Tx: ComSignalType=UINT16
            CAP_MaxDetRangePedestrian_2_oRDR_CAPABILITY_oPCAN_RADAR_3b551ebd_Tx: ComSignalType=UINT16
            CAP_MaxDetectionRangeCar_0_oRDR_CAPABILITY_oPCAN_RADAR_8e9eb9bb_Tx: ComSignalType=UINT16
            CAP_MaxDetectionRangeCar_1_oRDR_CAPABILITY_oPCAN_RADAR_ed99609f_Tx: ComSignalType=UINT16
            CAP_MaxDetectionRangeCar_2_oRDR_CAPABILITY_oPCAN_RADAR_48910bf3_Tx: ComSignalType=UINT16
            CAP_RangeEstimationActive_oRDR_CAPABILITY_oPCAN_RADAR_e859e5af_Tx: ComSignalType=UINT8
            CAP_RangeEstimationStatus_oRDR_CAPABILITY_oPCAN_RADAR_bfc526eb_Tx: ComSignalType=UINT8
            CAP_SLBlockageFilterValue_oRDR_CAPABILITY_oPCAN_RADAR_f709e9f9_Tx: ComSignalType=UINT8
            CAP_SLBlockageFlag_oRDR_CAPABILITY_oPCAN_RADAR_01507d8d_Tx: ComSignalType=UINT8
            CAP_SLLMonitoringActive_oRDR_CAPABILITY_oPCAN_RADAR_5e159aec_Tx: ComSignalType=UINT8
            CAP_SLLMonitoringStatus_oRDR_CAPABILITY_oPCAN_RADAR_098959a8_Tx: ComSignalType=UINT8
            CAP_SideLobeLevelBeamformer_oRDR_CAPABILITY_oPCAN_RADAR_df16d7f9_Tx: ComSignalType=UINT8
        SG_RadarHeader_oRDR_HEADER_001_oPCAN_RADAR_48334d97_Tx
          36 x ComGroupSignal:
            HED_ALIGN_HOR_REF_oRDR_HEADER_001_oPCAN_RADAR_1f2e61cb_Tx: ComSignalType=UINT16
            HED_ALIGN_VER_REF_oRDR_HEADER_001_oPCAN_RADAR_e021d36b_Tx: ComSignalType=UINT16
            HED_Auth_CRC32_oRDR_HEADER_001_oPCAN_RADAR_fe7f3dd8_Tx: ComSignalType=UINT32
            HED_DATA_QUALIFIER_oRDR_HEADER_001_oPCAN_RADAR_df26d8e4_Tx: ComSignalType=UINT8
            HED_DET_BI_STATIC_COUNT_oRDR_HEADER_001_oPCAN_RADAR_2c7e7841_Tx: ComSignalType=UINT8
            HED_DET_NUM_OF_1PASS_oRDR_HEADER_001_oPCAN_RADAR_4c4276c1_Tx: ComSignalType=UINT16
            HED_DET_NUM_OF_2PASS_oRDR_HEADER_001_oPCAN_RADAR_1755c7d4_Tx: ComSignalType=UINT16
            HED_DET_RANGE_MAX_oRDR_HEADER_001_oPCAN_RADAR_a89abc54_Tx: ComSignalType=UINT16
            HED_DET_RANGE_MIN_oRDR_HEADER_001_oPCAN_RADAR_8745ffc9_Tx: ComSignalType=UINT16
            HED_DET_SPEED_RANGE_MAX_oRDR_HEADER_001_oPCAN_RADAR_d83b01a3_Tx: ComSignalType=UINT16
            HED_DET_SPEED_RANGE_MIN_oRDR_HEADER_001_oPCAN_RADAR_f7e4423e_Tx: ComSignalType=UINT16
            HED_FOV_HOR_MAX_oRDR_HEADER_001_oPCAN_RADAR_6b8d6a34_Tx: ComSignalType=UINT8
            HED_FOV_HOR_MIN_oRDR_HEADER_001_oPCAN_RADAR_445229a9_Tx: ComSignalType=UINT8
            HED_FOV_VER_MAX_oRDR_HEADER_001_oPCAN_RADAR_9482d894_Tx: ComSignalType=UINT8
            HED_FOV_VER_MIN_oRDR_HEADER_001_oPCAN_RADAR_bb5d9b09_Tx: ComSignalType=UINT8
            HED_LOOK_ID_oRDR_HEADER_001_oPCAN_RADAR_d5499e41_Tx: ComSignalType=UINT8
            HED_LOOK_INDEX_oRDR_HEADER_001_oPCAN_RADAR_a9c5ac4d_Tx: ComSignalType=UINT16
            HED_MAX_NUM_OF_DETECTIONS_oRDR_HEADER_001_oPCAN_RADAR_a13979cd_Tx: ComSignalType=UINT16
            HED_MH_CRC16_oRDR_HEADER_001_oPCAN_RADAR_c11c9aeb_Tx: ComSignalType=UINT16
            HED_MH_CYCLE_COUNTER_oRDR_HEADER_001_oPCAN_RADAR_d6fb5718_Tx: ComSignalType=UINT8
            HED_NUM_OF_RESTBINS_USED_oRDR_HEADER_001_oPCAN_RADAR_accc4f32_Tx: ComSignalType=UINT16
            HED_NUM_OF_VALID_DETECTIONS_oRDR_HEADER_001_oPCAN_RADAR_561f5894_Tx: ComSignalType=UINT16
            HED_OPERATION_MODE_oRDR_HEADER_001_oPCAN_RADAR_5d181f82_Tx: ComSignalType=UINT8
            HED_PROCESSED_RANGE_oRDR_HEADER_001_oPCAN_RADAR_d69f60f9_Tx: ComSignalType=UINT16
            HED_RDR_HEADER_CMAC_oRDR_HEADER_001_oPCAN_RADAR_6d131f27_Tx: ComSignalType=UINT8_N
            HED_RDR_HEADER_FV_oRDR_HEADER_001_oPCAN_RADAR_de313513_Tx: ComSignalType=UINT8_N
            HED_R_WRAPPING_oRDR_HEADER_001_oPCAN_RADAR_58de80d3_Tx: ComSignalType=UINT8
            HED_Rain_Level_oRDR_HEADER_001_oPCAN_RADAR_7b3bcf0b_Tx: ComSignalType=UINT8
            HED_SCAN_INDEX_oRDR_HEADER_001_oPCAN_RADAR_f1dfa1e3_Tx: ComSignalType=UINT16
            HED_SENSOR_TIME_STAMP_NS_oRDR_HEADER_001_oPCAN_RADAR_3b625701_Tx: ComSignalType=UINT32
            HED_SENSOR_TIME_STAMP_SEC_oRDR_HEADER_001_oPCAN_RADAR_6281522c_Tx: ComSignalType=UINT32
            HED_SLOPE_CORR_EXECUTIONFLAG_oRDR_HEADER_001_oPCAN_RADAR_1dd90300_Tx: ComSignalType=UINT8
            HED_TIME_SYNC_SRC_MASTER_oRDR_HEADER_001_oPCAN_RADAR_cf69d55e_Tx: ComSignalType=UINT8
            HED_TIME_SYNC_VALIDITY_FLAG_oRDR_HEADER_001_oPCAN_RADAR_e68b9aad_Tx: ComSignalType=UINT8
            HED_TRIGGER_TIME_oRDR_HEADER_001_oPCAN_RADAR_c994f046_Tx: ComSignalType=UINT32
            HED_V_WRAPPING_oRDR_HEADER_001_oPCAN_RADAR_036e7d98_Tx: ComSignalType=UINT16
        SG_RadarStatus1_oRDR_STATUS_001_oPCAN_RADAR_4935b1b8_Tx
          46 x ComGroupSignal:
            STS_AF_TIME_INST_oRDR_STATUS_001_oPCAN_RADAR_0e5415de_Tx: ComSignalType=UINT8
            STS_AF_TIME_PEAK_oRDR_STATUS_001_oPCAN_RADAR_b78b8e3a_Tx: ComSignalType=UINT8
            STS_DET_DBC_BASE_VER_MAJOR_oRDR_STATUS_001_oPCAN_RADAR_63ce1143_Tx: ComSignalType=UINT8
            STS_DET_DBC_BASE_VER_MINOR_oRDR_STATUS_001_oPCAN_RADAR_bb458653_Tx: ComSignalType=UINT8
            STS_DIST_FRNT_BMPR_TO_RR_AXL_oRDR_STATUS_001_oPCAN_RADAR_c8135b01_Tx: ComSignalType=UINT16
            STS_HARDWARE_VERSION_oRDR_STATUS_001_oPCAN_RADAR_2d912d77_Tx: ComSignalType=UINT8
            STS_MAIN_CORE_TIME_INST_oRDR_STATUS_001_oPCAN_RADAR_471c051a_Tx: ComSignalType=UINT8
            STS_MAIN_CORE_TIME_PEAK_oRDR_STATUS_001_oPCAN_RADAR_fec39efe_Tx: ComSignalType=UINT8
            STS_MH_001_CRC16_oRDR_STATUS_001_oPCAN_RADAR_0ffb3f46_Tx: ComSignalType=UINT16
            STS_MH_001_CYCLE_COUNTER_oRDR_STATUS_001_oPCAN_RADAR_50a8eb37_Tx: ComSignalType=UINT8
            STS_PBL_VERSION_FIELD1_oRDR_STATUS_001_oPCAN_RADAR_41398822_Tx: ComSignalType=UINT8
            STS_PBL_VERSION_FIELD2_oRDR_STATUS_001_oPCAN_RADAR_e431e34e_Tx: ComSignalType=UINT8
            STS_PBL_VERSION_FIELD3_oRDR_STATUS_001_oPCAN_RADAR_87363a6a_Tx: ComSignalType=UINT8
            STS_PBL_VERSION_FIELD4_oRDR_STATUS_001_oPCAN_RADAR_755033d7_Tx: ComSignalType=UINT8
            STS_PCAN_PROTOCOL_VER_MAJOR_oRDR_STATUS_001_oPCAN_RADAR_1a19377a_Tx: ComSignalType=UINT8
            STS_PCAN_PROTOCOL_VER_MINOR_oRDR_STATUS_001_oPCAN_RADAR_c292a06a_Tx: ComSignalType=UINT8
            STS_PLATFORM_VARIANT_oRDR_STATUS_001_oPCAN_RADAR_df303069_Tx: ComSignalType=UINT8
            STS_RDD_CORE_TIME_INST_oRDR_STATUS_001_oPCAN_RADAR_38fa4a94_Tx: ComSignalType=UINT8
            STS_RDD_CORE_TIME_PEAK_oRDR_STATUS_001_oPCAN_RADAR_8125d170_Tx: ComSignalType=UINT8
            STS_SENSOR_HEIGHT_oRDR_STATUS_001_oPCAN_RADAR_d61d9b04_Tx: ComSignalType=UINT32
            STS_SENSOR_MOUNT_ORNT_PITCH_oRDR_STATUS_001_oPCAN_RADAR_ce18ff05_Tx: ComSignalType=SINT16
            STS_SENSOR_MOUNT_ORNT_ROLL_oRDR_STATUS_001_oPCAN_RADAR_c9a4f171_Tx: ComSignalType=UINT16
            STS_SENSOR_MOUNT_ORNT_YAW_oRDR_STATUS_001_oPCAN_RADAR_4c33f1ef_Tx: ComSignalType=SINT16
            STS_SENSOR_MOUNT_POS_X_oRDR_STATUS_001_oPCAN_RADAR_545dac38_Tx: ComSignalType=UINT16
            STS_SENSOR_MOUNT_POS_Y_oRDR_STATUS_001_oPCAN_RADAR_375a751c_Tx: ComSignalType=UINT16
            STS_SENSOR_MOUNT_POS_Z_oRDR_STATUS_001_oPCAN_RADAR_92521e70_Tx: ComSignalType=UINT16
            STS_SENSOR_POLARITY_oRDR_STATUS_001_oPCAN_RADAR_2123e19b_Tx: ComSignalType=BOOLEAN
            STS_SENSOR_POSITION_oRDR_STATUS_001_oPCAN_RADAR_5946d50e_Tx: ComSignalType=UINT8
            STS_SERIAL_NUMBER_SEQUENCE_oRDR_STATUS_001_oPCAN_RADAR_c239676f_Tx: ComSignalType=UINT16
            STS_SERIAL_NUM_JULIAN_DAY_oRDR_STATUS_001_oPCAN_RADAR_1b351b71_Tx: ComSignalType=UINT16
            STS_SERIAL_NUM_JULIAN_YEAR_oRDR_STATUS_001_oPCAN_RADAR_1d761a02_Tx: ComSignalType=UINT8
            STS_SMC_CAL_VER_MAJOR_oRDR_STATUS_001_oPCAN_RADAR_e3a30457_Tx: ComSignalType=UINT16
            STS_SMC_CAL_VER_MINOR_oRDR_STATUS_001_oPCAN_RADAR_3b289347_Tx: ComSignalType=UINT16
            STS_SMC_PLATFROM_VERSION_oRDR_STATUS_001_oPCAN_RADAR_4cdd916f_Tx: ComSignalType=UINT8
            STS_SMC_SECTION_COMPTBLITY_oRDR_STATUS_001_oPCAN_RADAR_735f172e_Tx: ComSignalType=UINT16
            STS_SP_CORE_TIME_INST_oRDR_STATUS_001_oPCAN_RADAR_9eae4180_Tx: ComSignalType=UINT8
            STS_SP_CORE_TIME_PEAK_oRDR_STATUS_001_oPCAN_RADAR_2771da64_Tx: ComSignalType=UINT8
            STS_SW_VERSION_FIELD1_oRDR_STATUS_001_oPCAN_RADAR_3b802545_Tx: ComSignalType=UINT8
            STS_SW_VERSION_FIELD2_oRDR_STATUS_001_oPCAN_RADAR_9e884e29_Tx: ComSignalType=UINT8
            STS_SW_VERSION_FIELD3_oRDR_STATUS_001_oPCAN_RADAR_fd8f970d_Tx: ComSignalType=UINT8
            STS_SW_VERSION_FIELD4_oRDR_STATUS_001_oPCAN_RADAR_0fe99eb0_Tx: ComSignalType=UINT8
            STS_TIME_SINCE_POWER_ON_oRDR_STATUS_001_oPCAN_RADAR_b1d9cbc7_Tx: ComSignalType=UINT32
            STS_USC_CAL_VER_MAJOR_oRDR_STATUS_001_oPCAN_RADAR_25e52183_Tx: ComSignalType=UINT16
            STS_USC_CAL_VER_MINOR_oRDR_STATUS_001_oPCAN_RADAR_fd6eb693_Tx: ComSignalType=UINT16
            STS_USC_SECTION_COMPTBLITY_oRDR_STATUS_001_oPCAN_RADAR_71711001_Tx: ComSignalType=UINT16
            STS_VIN_Status_oRDR_STATUS_001_oPCAN_RADAR_cde190ae_Tx: ComSignalType=UINT8
        SG_RadarStatus2_oRDR_STATUS_002_oPCAN_RADAR_51f7b61a_Tx
          38 x ComGroupSignal:
            STS_AF_CORE_THROUGHPUT_oRDR_STATUS_002_oPCAN_RADAR_176d9e73_Tx: ComSignalType=UINT8
            STS_BRR_STATUS_oRDR_STATUS_002_oPCAN_RADAR_b18213d9_Tx: ComSignalType=UINT8
            STS_CAN_NM_State_oRDR_STATUS_002_oPCAN_RADAR_b965e775_Tx: ComSignalType=UINT8
            STS_CORE_ACTV_FLT_BYTE_0_to_3_oRDR_STATUS_002_oPCAN_RADAR_4eff1249_Tx: ComSignalType=UINT32
            STS_CORE_ACTV_FLT_BYTE_11_to_15_oRDR_STATUS_002_oPCAN_RADAR_f8237490_Tx: ComSignalType=UINT32
            STS_CORE_ACTV_FLT_BYTE_4_to_7_oRDR_STATUS_002_oPCAN_RADAR_8b983440_Tx: ComSignalType=UINT32
            STS_CORE_ACTV_FLT_BYTE_8_to_11_oRDR_STATUS_002_oPCAN_RADAR_4e4fcb1f_Tx: ComSignalType=UINT32
            STS_First_CAN_Det_Inst_Latency_oRDR_STATUS_002_oPCAN_RADAR_1df78923_Tx: ComSignalType=UINT16
            STS_Gear_Position_oRDR_STATUS_002_oPCAN_RADAR_7ad98da4_Tx: ComSignalType=UINT8
            STS_INTRFC_VERSION_ID_MAJOR_oRDR_STATUS_002_oPCAN_RADAR_2dc9e305_Tx: ComSignalType=UINT8
            STS_INTRFC_VERSION_ID_MINOR_oRDR_STATUS_002_oPCAN_RADAR_f5427415_Tx: ComSignalType=UINT8
            STS_INTRFC_VERSION_ID_PATCH_oRDR_STATUS_002_oPCAN_RADAR_ed2063e1_Tx: ComSignalType=UINT8
            STS_Last_CAN_Det_Inst_Latency_oRDR_STATUS_002_oPCAN_RADAR_f3b34cfa_Tx: ComSignalType=UINT16
            STS_MCU_TEMP_oRDR_STATUS_002_oPCAN_RADAR_c6a456e4_Tx: ComSignalType=UINT8
            STS_MH_002_CRC16_oRDR_STATUS_002_oPCAN_RADAR_39e26d91_Tx: ComSignalType=UINT16
            STS_MH_002_CYCLE_COUNTER_oRDR_STATUS_002_oPCAN_RADAR_24569cf4_Tx: ComSignalType=UINT8
            STS_MMIC_RE_INIT_COUNT_oRDR_STATUS_002_oPCAN_RADAR_0f504994_Tx: ComSignalType=UINT8
            STS_MMIC_TEMP_RX_oRDR_STATUS_002_oPCAN_RADAR_57120d5e_Tx: ComSignalType=UINT8
            STS_MMIC_TEMP_TX0_oRDR_STATUS_002_oPCAN_RADAR_3a566f10_Tx: ComSignalType=UINT8
            STS_MMIC_TEMP_TX1_2_oRDR_STATUS_002_oPCAN_RADAR_b5a34e6a_Tx: ComSignalType=UINT8
            STS_MMIC_TEMP_TX3_4_oRDR_STATUS_002_oPCAN_RADAR_390d4f51_Tx: ComSignalType=UINT8
            STS_NO_TSYN_ERROR_oRDR_STATUS_002_oPCAN_RADAR_20da0af2_Tx: ComSignalType=BOOLEAN
            STS_POINT_OF_TRIGGER_oRDR_STATUS_002_oPCAN_RADAR_4dfeaf3a_Tx: ComSignalType=UINT16
            STS_RAIN_COUNT_oRDR_STATUS_002_oPCAN_RADAR_27958738_Tx: ComSignalType=UINT16
            STS_RDD_CORE_THROUGHPUT_oRDR_STATUS_002_oPCAN_RADAR_2585d773_Tx: ComSignalType=UINT8
            STS_SCAN_TYPE_oRDR_STATUS_002_oPCAN_RADAR_e74f40f7_Tx: ComSignalType=UINT8
            STS_STEERING_ANGLE_SIGN_oRDR_STATUS_002_oPCAN_RADAR_d05788d3_Tx: ComSignalType=BOOLEAN
            STS_STEERING_ANGLE_oRDR_STATUS_002_oPCAN_RADAR_23b55571_Tx: ComSignalType=UINT8
            STS_TIME_SYNC_OFFSET_oRDR_STATUS_002_oPCAN_RADAR_0c9d43da_Tx: ComSignalType=SINT16
            STS_TKEY_ACTV_FLT_BYTE_0_to_3_oRDR_STATUS_002_oPCAN_RADAR_b6823a3b_Tx: ComSignalType=UINT32
            STS_TKEY_ACTV_FLT_BYTE_4_to_5_oRDR_STATUS_002_oPCAN_RADAR_b5eaae7a_Tx: ComSignalType=UINT16
            STS_VEHICLE_SPEED_CALC_oRDR_STATUS_002_oPCAN_RADAR_b07702fe_Tx: ComSignalType=UINT16
            STS_VEHICLE_SUPPLY_VOLTAGE_oRDR_STATUS_002_oPCAN_RADAR_2e0227b4_Tx: ComSignalType=UINT8
            STS_VEH_SPEED_DIRECTION_oRDR_STATUS_002_oPCAN_RADAR_ab672289_Tx: ComSignalType=BOOLEAN
            STS_Vehicle_Speed_Calc_QF_oRDR_STATUS_002_oPCAN_RADAR_18f9a51b_Tx: ComSignalType=UINT8
            STS_XCVR_OPERATIONAL_oRDR_STATUS_002_oPCAN_RADAR_0ef02f62_Tx: ComSignalType=BOOLEAN
            STS_YAW_RATE_BIAS_oRDR_STATUS_002_oPCAN_RADAR_9d7c088d_Tx: ComSignalType=UINT8
            STS_Yaw_Rate_Calc_QF_oRDR_STATUS_002_oPCAN_RADAR_cd68faf6_Tx: ComSignalType=UINT8
        SG_SAS_oSAS_oVCAN_RADAR_c902864e_Rx
          8 x ComGroupSignal:
            ActiveMode_oSAS_oVCAN_RADAR_d0796acb_Rx: ComSignalType=UINT8
            Calibrated_oSAS_oVCAN_RADAR_ebf0ded0_Rx: ComSignalType=UINT8
            MessageChecksum_oSAS_oVCAN_RADAR_61fa3dc9_Rx: ComSignalType=UINT8
            MessageCounter_oSAS_oVCAN_RADAR_bad50fe2_Rx: ComSignalType=UINT8
            SteeringWheelAngleRangeCounterType_oSAS_oVCAN_RADAR_7889a4bc_Rx: ComSignalType=UINT8
            SteeringWheelAngleRangeCounter_oSAS_oVCAN_RADAR_5300a9ef_Rx: ComSignalType=UINT8
            SteeringWheelAngleRange_oSAS_oVCAN_RADAR_2ef6c42e_Rx: ComSignalType=UINT16
            SteeringWheelAngle_oSAS_oVCAN_RADAR_17cf9abd_Rx: ComSignalType=UINT16
        SG_TD_oTD_oVCAN_RADAR_c3698ded_Rx
          8 x ComGroupSignal, all with ComSignalType=UINT8:
            Day_oTD_oVCAN_RADAR_d9e1ba53_Rx
            Hours_oTD_oVCAN_RADAR_408d2c34_Rx
            LocalHourOffset_oTD_oVCAN_RADAR_82942db5_Rx
            LocalMinuteOffset_oTD_oVCAN_RADAR_074fc4ab_Rx
            Minutes_oTD_oVCAN_RADAR_2546db9e_Rx
            Month_oTD_oVCAN_RADAR_d8bc3ad5_Rx
            Seconds_oTD_oVCAN_RADAR_b2a2ca59_Rx
            Year_oTD_oVCAN_RADAR_b229b348_Rx
        SG_TrackerHeader_oRDR_OBJ_HEADER_002_oPCAN_RADAR_563ddea3_Tx
          11 x ComGroupSignal:
            HED_MH_002_CRC16_oRDR_OBJ_HEADER_002_oPCAN_RADAR_81f46ac0_Tx: ComSignalType=UINT16
            HED_MH_002_CYCLE_COUNTER_oRDR_OBJ_HEADER_002_oPCAN_RADAR_03c7ff49_Tx: ComSignalType=UINT8
            HED_TRKR_DATA_QUALIFIER_oRDR_OBJ_HEADER_002_oPCAN_RADAR_2d7db6a6_Tx: ComSignalType=UINT8
            HED_TRKR_IDX_oRDR_OBJ_HEADER_002_oPCAN_RADAR_1c8e25ae_Tx: ComSignalType=UINT16
            HED_TRKR_NUM_OF_ACTIV_OBJS_oRDR_OBJ_HEADER_002_oPCAN_RADAR_66219812_Tx: ComSignalType=UINT8
            HED_TRKR_OBJLST_TIME_STAMP_NS_oRDR_OBJ_HEADER_002_oPCAN_RADAR_d5ff88d0_Tx: ComSignalType=UINT32
            HED_TRKR_OBJLST_TIME_STAMP_SC_oRDR_OBJ_HEADER_002_oPCAN_RADAR_606a08de_Tx: ComSignalType=UINT32
            HED_TRKR_TIME_INST_oRDR_OBJ_HEADER_002_oPCAN_RADAR_b8b3e235_Tx: ComSignalType=UINT8
            HED_TRKR_TIME_PEAK_oRDR_OBJ_HEADER_002_oPCAN_RADAR_a4f5b1b3_Tx: ComSignalType=UINT8
            HED_TRKR_VEHICLE_IDX_oRDR_OBJ_HEADER_002_oPCAN_RADAR_90acc389_Tx: ComSignalType=UINT16
            HED_TRKR_VEH_COORD_TYPE_oRDR_OBJ_HEADER_002_oPCAN_RADAR_7d99e32a_Tx: ComSignalType=BOOLEAN
        SG_TrackerObject001_oRDR_TRACKER_OBJ_001_oPCAN_RADAR_a5be7e9d_Tx
          49 x ComGroupSignal:
            OBJ_ACCELERATION_LAT_001_oRDR_TRACKER_OBJ_001_oPCAN_RADAR_ab9a25ea_Tx: ComSignalType=UINT16
            OBJ_ACCELERATION_LAT_ERR_001_oRDR_TRACKER_OBJ_001_oPCAN_RADAR_7e6e1f54_Tx: ComSignalType=UINT8
            OBJ_ACCELERATION_LONG_001_oRDR_TRACKER_OBJ_001_oPCAN_RADAR_d96a7c0a_Tx: ComSignalType=UINT16
            OBJ_ACCELERATION_LONG_ERR_001_oRDR_TRACKER_OBJ_001_oPCAN_RADAR_61cbbafe_Tx: ComSignalType=UINT8
            OBJ_ACCEL_ERR_CRR_COEF_001_oRDR_TRACKER_OBJ_001_oPCAN_RADAR_c1689b98_Tx: ComSignalType=UINT8
            OBJ_ALIVE_TIME_001_oRDR_TRACKER_OBJ_001_oPCAN_RADAR_b90b37b6_Tx: ComSignalType=UINT16
            OBJ_CLS_TYPE1_001_oRDR_TRACKER_OBJ_001_oPCAN_RADAR_2ed0d690_Tx: ComSignalType=UINT8
            OBJ_CLS_TYPE1_PROB_001_oRDR_TRACKER_OBJ_001_oPCAN_RADAR_86880163_Tx: ComSignalType=UINT8
            OBJ_CLS_TYPE2_001_oRDR_TRACKER_OBJ_001_oPCAN_RADAR_6338d6f7_Tx: ComSignalType=UINT8
            OBJ_CLS_TYPE2_PROB_001_oRDR_TRACKER_OBJ_001_oPCAN_RADAR_4fbc1a6e_Tx: ComSignalType=UINT8
            OBJ_CLS_TYPE3_001_oRDR_TRACKER_OBJ_001_oPCAN_RADAR_eeb02b15_Tx: ComSignalType=UINT8
            OBJ_CLS_TYPE3_PROB_001_oRDR_TRACKER_OBJ_001_oPCAN_RADAR_08afec95_Tx: ComSignalType=UINT8
            OBJ_CLS_TYPE4_001_oRDR_TRACKER_OBJ_001_oPCAN_RADAR_f8e8d639_Tx: ComSignalType=UINT8
            OBJ_CLS_TYPE4_PROB_001_oRDR_TRACKER_OBJ_001_oPCAN_RADAR_06a52a35_Tx: ComSignalType=UINT8
            OBJ_CLS_TYPE5_001_oRDR_TRACKER_OBJ_001_oPCAN_RADAR_75602bdb_Tx: ComSignalType=UINT8
            OBJ_CLS_TYPE5_PROB_001_oRDR_TRACKER_OBJ_001_oPCAN_RADAR_41b6dcce_Tx: ComSignalType=UINT8
            OBJ_CLS_TYPE6_001_oRDR_TRACKER_OBJ_001_oPCAN_RADAR_38882bbc_Tx: ComSignalType=UINT8
            OBJ_CLS_TYPE6_PROB_001_oRDR_TRACKER_OBJ_001_oPCAN_RADAR_8882c7c3_Tx: ComSignalType=UINT8
            OBJ_DIMENSION_LENGTH_001_oRDR_TRACKER_OBJ_001_oPCAN_RADAR_6c4e85d4_Tx: ComSignalType=UINT16
            OBJ_DIMENSION_LENGTH_ERR_001_oRDR_TRACKER_OBJ_001_oPCAN_RADAR_57b69aae_Tx: ComSignalType=UINT16
            OBJ_DIMENSION_WIDTH_001_oRDR_TRACKER_OBJ_001_oPCAN_RADAR_4f807279_Tx: ComSignalType=UINT16
            OBJ_DIMENSION_WIDTH_ERR_001_oRDR_TRACKER_OBJ_001_oPCAN_RADAR_af22b591_Tx: ComSignalType=UINT8
            OBJ_EXISTENCE_PROB_001_oRDR_TRACKER_OBJ_001_oPCAN_RADAR_443cf644_Tx: ComSignalType=UINT16
            OBJ_GROUP_ID_001_oRDR_TRACKER_OBJ_001_oPCAN_RADAR_cd4ee2e9_Tx: ComSignalType=UINT8
            OBJ_ID_001_oRDR_TRACKER_OBJ_001_oPCAN_RADAR_3e60c9ee_Tx: ComSignalType=UINT8
            OBJ_MEASUREMENT_STATUS_001_oRDR_TRACKER_OBJ_001_oPCAN_RADAR_41b2bb53_Tx: ComSignalType=UINT8
            OBJ_MH_CRC16_001_oRDR_TRACKER_OBJ_001_oPCAN_RADAR_3dd20c6f_Tx: ComSignalType=UINT16
            OBJ_MH_CYCLE_COUNTER_001_oRDR_TRACKER_OBJ_001_oPCAN_RADAR_4c36568e_Tx: ComSignalType=UINT8
            OBJ_MOVEMENT_STATUS_001_oRDR_TRACKER_OBJ_001_oPCAN_RADAR_6e1c2e1f_Tx: ComSignalType=UINT8
            OBJ_POS_ERR_CRR_COEF_001_oRDR_TRACKER_OBJ_001_oPCAN_RADAR_fe63ee25_Tx: ComSignalType=UINT8
            OBJ_POS_LAT_001_oRDR_TRACKER_OBJ_001_oPCAN_RADAR_1ccc1369_Tx: ComSignalType=UINT16
            OBJ_POS_LAT_ERR_001_oRDR_TRACKER_OBJ_001_oPCAN_RADAR_1880435e_Tx: ComSignalType=UINT8
            OBJ_POS_LONG_001_oRDR_TRACKER_OBJ_001_oPCAN_RADAR_ad6cf8a6_Tx: ComSignalType=UINT16
            OBJ_POS_LONG_ERR_001_oRDR_TRACKER_OBJ_001_oPCAN_RADAR_8178bdbc_Tx: ComSignalType=UINT8
            OBJ_RCS_001_oRDR_TRACKER_OBJ_001_oPCAN_RADAR_3e03456e_Tx: ComSignalType=UINT8
            OBJ_REF_PT_LAT_OFFSET_001_oRDR_TRACKER_OBJ_001_oPCAN_RADAR_cb3e2e1b_Tx: ComSignalType=UINT16
            OBJ_REF_PT_LONG_OFFSET_001_oRDR_TRACKER_OBJ_001_oPCAN_RADAR_846cde18_Tx: ComSignalType=UINT16
            OBJ_TIMESTAMP_OFFSET_001_oRDR_TRACKER_OBJ_001_oPCAN_RADAR_3eaf4538_Tx: ComSignalType=UINT8
            OBJ_TRACK_MOTION_MODEL_001_oRDR_TRACKER_OBJ_001_oPCAN_RADAR_f2ac44e5_Tx: ComSignalType=UINT8
            OBJ_VEH_TRACK_FLAG_001_oRDR_TRACKER_OBJ_001_oPCAN_RADAR_7086b2b8_Tx: ComSignalType=BOOLEAN
            OBJ_VELOCITY_ERR_CRR_COEF_001_oRDR_TRACKER_OBJ_001_oPCAN_RADAR_5719d3c4_Tx: ComSignalType=UINT8
            OBJ_VELOCITY_LAT_001_oRDR_TRACKER_OBJ_001_oPCAN_RADAR_58af564e_Tx: ComSignalType=UINT16
            OBJ_VELOCITY_LAT_ERR_001_oRDR_TRACKER_OBJ_001_oPCAN_RADAR_6c55261f_Tx: ComSignalType=UINT8
            OBJ_VELOCITY_LONG_001_oRDR_TRACKER_OBJ_001_oPCAN_RADAR_08222e88_Tx: ComSignalType=UINT16
            OBJ_VELOCITY_LONG_ERR_001_oRDR_TRACKER_OBJ_001_oPCAN_RADAR_80d719df_Tx: ComSignalType=UINT8
            OBJ_YAW_ANGLE_001_oRDR_TRACKER_OBJ_001_oPCAN_RADAR_b413120e_Tx: ComSignalType=UINT16
            OBJ_YAW_ANGLE_ERR_001_oRDR_TRACKER_OBJ_001_oPCAN_RADAR_611e14d9_Tx: ComSignalType=UINT8
            OBJ_YAW_RATE_001_oRDR_TRACKER_OBJ_001_oPCAN_RADAR_919c3749_Tx: ComSignalType=UINT16
            OBJ_YAW_RATE_ERR_001_oRDR_TRACKER_OBJ_001_oPCAN_RADAR_ae44a095_Tx: ComSignalType=UINT8
        SG_TrackerObject002_oRDR_TRACKER_OBJ_002_oPCAN_RADAR_75f2e109_Tx
          49 x ComGroupSignal:
            OBJ_ACCELERATION_LAT_002_oRDR_TRACKER_OBJ_002_oPCAN_RADAR_7bd6ba7e_Tx: ComSignalType=UINT16
            OBJ_ACCELERATION_LAT_ERR_002_oRDR_TRACKER_OBJ_002_oPCAN_RADAR_ae2280c0_Tx: ComSignalType=UINT8
            OBJ_ACCELERATION_LONG_002_oRDR_TRACKER_OBJ_002_oPCAN_RADAR_0926e39e_Tx: ComSignalType=UINT16
            OBJ_ACCELERATION_LONG_ERR_002_oRDR_TRACKER_OBJ_002_oPCAN_RADAR_b187256a_Tx: ComSignalType=UINT8
            OBJ_ACCEL_ERR_CRR_COEF_002_oRDR_TRACKER_OBJ_002_oPCAN_RADAR_1124040c_Tx: ComSignalType=UINT8
            OBJ_ALIVE_TIME_002_oRDR_TRACKER_OBJ_002_oPCAN_RADAR_6947a822_Tx: ComSignalType=UINT16
            OBJ_CLS_TYPE1_002_oRDR_TRACKER_OBJ_002_oPCAN_RADAR_fe9c4904_Tx: ComSignalType=UINT8
            OBJ_CLS_TYPE1_PROB_002_oRDR_TRACKER_OBJ_002_oPCAN_RADAR_56c49ef7_Tx: ComSignalType=UINT8
            OBJ_CLS_TYPE2_002_oRDR_TRACKER_OBJ_002_oPCAN_RADAR_b3744963_Tx: ComSignalType=UINT8
            OBJ_CLS_TYPE2_PROB_002_oRDR_TRACKER_OBJ_002_oPCAN_RADAR_9ff085fa_Tx: ComSignalType=UINT8
            OBJ_CLS_TYPE3_002_oRDR_TRACKER_OBJ_002_oPCAN_RADAR_3efcb481_Tx: ComSignalType=UINT8
            OBJ_CLS_TYPE3_PROB_002_oRDR_TRACKER_OBJ_002_oPCAN_RADAR_d8e37301_Tx: ComSignalType=UINT8
            OBJ_CLS_TYPE4_002_oRDR_TRACKER_OBJ_002_oPCAN_RADAR_28a449ad_Tx: ComSignalType=UINT8
            OBJ_CLS_TYPE4_PROB_002_oRDR_TRACKER_OBJ_002_oPCAN_RADAR_d6e9b5a1_Tx: ComSignalType=UINT8
            OBJ_CLS_TYPE5_002_oRDR_TRACKER_OBJ_002_oPCAN_RADAR_a52cb44f_Tx: ComSignalType=UINT8
            OBJ_CLS_TYPE5_PROB_002_oRDR_TRACKER_OBJ_002_oPCAN_RADAR_91fa435a_Tx: ComSignalType=UINT8
            OBJ_CLS_TYPE6_002_oRDR_TRACKER_OBJ_002_oPCAN_RADAR_e8c4b428_Tx: ComSignalType=UINT8
            OBJ_CLS_TYPE6_PROB_002_oRDR_TRACKER_OBJ_002_oPCAN_RADAR_58ce5857_Tx: ComSignalType=UINT8
            OBJ_DIMENSION_LENGTH_002_oRDR_TRACKER_OBJ_002_oPCAN_RADAR_bc021a40_Tx: ComSignalType=UINT16
            OBJ_DIMENSION_LENGTH_ERR_002_oRDR_TRACKER_OBJ_002_oPCAN_RADAR_87fa053a_Tx: ComSignalType=UINT16
            OBJ_DIMENSION_WIDTH_002_oRDR_TRACKER_OBJ_002_oPCAN_RADAR_9fcceded_Tx: ComSignalType=UINT16
            OBJ_DIMENSION_WIDTH_ERR_002_oRDR_TRACKER_OBJ_002_oPCAN_RADAR_7f6e2a05_Tx: ComSignalType=UINT8
            OBJ_EXISTENCE_PROB_002_oRDR_TRACKER_OBJ_002_oPCAN_RADAR_947069d0_Tx: ComSignalType=UINT16
            OBJ_GROUP_ID_002_oRDR_TRACKER_OBJ_002_oPCAN_RADAR_1d027d7d_Tx: ComSignalType=UINT8
            OBJ_ID_002_oRDR_TRACKER_OBJ_002_oPCAN_RADAR_ee2c567a_Tx: ComSignalType=UINT8
            OBJ_MEASUREMENT_STATUS_002_oRDR_TRACKER_OBJ_002_oPCAN_RADAR_91fe24c7_Tx: ComSignalType=UINT8
            OBJ_MH_CRC16_002_oRDR_TRACKER_OBJ_002_oPCAN_RADAR_ed9e93fb_Tx: ComSignalType=UINT16
            OBJ_MH_CYCLE_COUNTER_002_oRDR_TRACKER_OBJ_002_oPCAN_RADAR_9c7ac91a_Tx: ComSignalType=UINT8
            OBJ_MOVEMENT_STATUS_002_oRDR_TRACKER_OBJ_002_oPCAN_RADAR_be50b18b_Tx: ComSignalType=UINT8
            OBJ_POS_ERR_CRR_COEF_002_oRDR_TRACKER_OBJ_002_oPCAN_RADAR_2e2f71b1_Tx: ComSignalType=UINT8
            OBJ_POS_LAT_002_oRDR_TRACKER_OBJ_002_oPCAN_RADAR_cc808cfd_Tx: ComSignalType=UINT16
            OBJ_POS_LAT_ERR_002_oRDR_TRACKER_OBJ_002_oPCAN_RADAR_c8ccdcca_Tx: ComSignalType=UINT8
            OBJ_POS_LONG_002_oRDR_TRACKER_OBJ_002_oPCAN_RADAR_7d206732_Tx: ComSignalType=UINT16
            OBJ_POS_LONG_ERR_002_oRDR_TRACKER_OBJ_002_oPCAN_RADAR_51342228_Tx: ComSignalType=UINT8
            OBJ_RCS_002_oRDR_TRACKER_OBJ_002_oPCAN_RADAR_ee4fdafa_Tx: ComSignalType=UINT8
            OBJ_REF_PT_LAT_OFFSET_002_oRDR_TRACKER_OBJ_002_oPCAN_RADAR_1b72b18f_Tx: ComSignalType=UINT16
            OBJ_REF_PT_LONG_OFFSET_002_oRDR_TRACKER_OBJ_002_oPCAN_RADAR_5420418c_Tx: ComSignalType=UINT16
            OBJ_TIMESTAMP_OFFSET_002_oRDR_TRACKER_OBJ_002_oPCAN_RADAR_eee3daac_Tx: ComSignalType=UINT8
            OBJ_TRACK_MOTION_MODEL_002_oRDR_TRACKER_OBJ_002_oPCAN_RADAR_22e0db71_Tx: ComSignalType=UINT8
            OBJ_VEH_TRACK_FLAG_002_oRDR_TRACKER_OBJ_002_oPCAN_RADAR_a0ca2d2c_Tx: ComSignalType=BOOLEAN
            OBJ_VELOCITY_ERR_CRR_COEF_002_oRDR_TRACKER_OBJ_002_oPCAN_RADAR_87554c50_Tx: ComSignalType=UINT8
            OBJ_VELOCITY_LAT_002_oRDR_TRACKER_OBJ_002_oPCAN_RADAR_88e3c9da_Tx: ComSignalType=UINT16
            OBJ_VELOCITY_LAT_ERR_002_oRDR_TRACKER_OBJ_002_oPCAN_RADAR_bc19b98b_Tx: ComSignalType=UINT8
            OBJ_VELOCITY_LONG_002_oRDR_TRACKER_OBJ_002_oPCAN_RADAR_d86eb11c_Tx: ComSignalType=UINT16
            OBJ_VELOCITY_LONG_ERR_002_oRDR_TRACKER_OBJ_002_oPCAN_RADAR_509b864b_Tx: ComSignalType=UINT8
            OBJ_YAW_ANGLE_002_oRDR_TRACKER_OBJ_002_oPCAN_RADAR_645f8d9a_Tx: ComSignalType=UINT16
            OBJ_YAW_ANGLE_ERR_002_oRDR_TRACKER_OBJ_002_oPCAN_RADAR_b1528b4d_Tx: ComSignalType=UINT8
            OBJ_YAW_RATE_002_oRDR_TRACKER_OBJ_002_oPCAN_RADAR_41d0a8dd_Tx: ComSignalType=UINT16
            OBJ_YAW_RATE_ERR_002_oRDR_TRACKER_OBJ_002_oPCAN_RADAR_7e083f01_Tx: ComSignalType=UINT8
        SG_TrackerObject003_oRDR_TRACKER_OBJ_003_oPCAN_RADAR_8ce669ba_Tx
          49 x ComGroupSignal:
            OBJ_ACCELERATION_LAT_003_oRDR_TRACKER_OBJ_003_oPCAN_RADAR_82c232cd_Tx: ComSignalType=UINT16
            OBJ_ACCELERATION_LAT_ERR_003_oRDR_TRACKER_OBJ_003_oPCAN_RADAR_57360873_Tx: ComSignalType=UINT8
            OBJ_ACCELERATION_LONG_003_oRDR_TRACKER_OBJ_003_oPCAN_RADAR_f0326b2d_Tx: ComSignalType=UINT16
            OBJ_ACCELERATION_LONG_ERR_003_oRDR_TRACKER_OBJ_003_oPCAN_RADAR_4893add9_Tx: ComSignalType=UINT8
            OBJ_ACCEL_ERR_CRR_COEF_003_oRDR_TRACKER_OBJ_003_oPCAN_RADAR_e8308cbf_Tx: ComSignalType=UINT8
            OBJ_ALIVE_TIME_003_oRDR_TRACKER_OBJ_003_oPCAN_RADAR_90532091_Tx: ComSignalType=UINT16
            OBJ_CLS_TYPE1_003_oRDR_TRACKER_OBJ_003_oPCAN_RADAR_0788c1b7_Tx: ComSignalType=UINT8
            OBJ_CLS_TYPE1_PROB_003_oRDR_TRACKER_OBJ_003_oPCAN_RADAR_afd01644_Tx: ComSignalType=UINT8
            OBJ_CLS_TYPE2_003_oRDR_TRACKER_OBJ_003_oPCAN_RADAR_4a60c1d0_Tx: ComSignalType=UINT8
            OBJ_CLS_TYPE2_PROB_003_oRDR_TRACKER_OBJ_003_oPCAN_RADAR_66e40d49_Tx: ComSignalType=UINT8
            OBJ_CLS_TYPE3_003_oRDR_TRACKER_OBJ_003_oPCAN_RADAR_c7e83c32_Tx: ComSignalType=UINT8
            OBJ_CLS_TYPE3_PROB_003_oRDR_TRACKER_OBJ_003_oPCAN_RADAR_21f7fbb2_Tx: ComSignalType=UINT8
            OBJ_CLS_TYPE4_003_oRDR_TRACKER_OBJ_003_oPCAN_RADAR_d1b0c11e_Tx: ComSignalType=UINT8
            OBJ_CLS_TYPE4_PROB_003_oRDR_TRACKER_OBJ_003_oPCAN_RADAR_2ffd3d12_Tx: ComSignalType=UINT8
            OBJ_CLS_TYPE5_003_oRDR_TRACKER_OBJ_003_oPCAN_RADAR_5c383cfc_Tx: ComSignalType=UINT8
            OBJ_CLS_TYPE5_PROB_003_oRDR_TRACKER_OBJ_003_oPCAN_RADAR_68eecbe9_Tx: ComSignalType=UINT8
            OBJ_CLS_TYPE6_003_oRDR_TRACKER_OBJ_003_oPCAN_RADAR_11d03c9b_Tx: ComSignalType=UINT8
            OBJ_CLS_TYPE6_PROB_003_oRDR_TRACKER_OBJ_003_oPCAN_RADAR_a1dad0e4_Tx: ComSignalType=UINT8
            OBJ_DIMENSION_LENGTH_003_oRDR_TRACKER_OBJ_003_oPCAN_RADAR_451692f3_Tx: ComSignalType=UINT16
            OBJ_DIMENSION_LENGTH_ERR_003_oRDR_TRACKER_OBJ_003_oPCAN_RADAR_7eee8d89_Tx: ComSignalType=UINT16
            OBJ_DIMENSION_WIDTH_003_oRDR_TRACKER_OBJ_003_oPCAN_RADAR_66d8655e_Tx: ComSignalType=UINT16
            OBJ_DIMENSION_WIDTH_ERR_003_oRDR_TRACKER_OBJ_003_oPCAN_RADAR_867aa2b6_Tx: ComSignalType=UINT8
            OBJ_EXISTENCE_PROB_003_oRDR_TRACKER_OBJ_003_oPCAN_RADAR_6d64e163_Tx: ComSignalType=UINT16
            OBJ_GROUP_ID_003_oRDR_TRACKER_OBJ_003_oPCAN_RADAR_e416f5ce_Tx: ComSignalType=UINT8
            OBJ_ID_003_oRDR_TRACKER_OBJ_003_oPCAN_RADAR_1738dec9_Tx: ComSignalType=UINT8
            OBJ_MEASUREMENT_STATUS_003_oRDR_TRACKER_OBJ_003_oPCAN_RADAR_68eaac74_Tx: ComSignalType=UINT8
            OBJ_MH_CRC16_003_oRDR_TRACKER_OBJ_003_oPCAN_RADAR_148a1b48_Tx: ComSignalType=UINT16
            OBJ_MH_CYCLE_COUNTER_003_oRDR_TRACKER_OBJ_003_oPCAN_RADAR_656e41a9_Tx: ComSignalType=UINT8
            OBJ_MOVEMENT_STATUS_003_oRDR_TRACKER_OBJ_003_oPCAN_RADAR_47443938_Tx: ComSignalType=UINT8
            OBJ_POS_ERR_CRR_COEF_003_oRDR_TRACKER_OBJ_003_oPCAN_RADAR_d73bf902_Tx: ComSignalType=UINT8
            OBJ_POS_LAT_003_oRDR_TRACKER_OBJ_003_oPCAN_RADAR_3594044e_Tx: ComSignalType=UINT16
            OBJ_POS_LAT_ERR_003_oRDR_TRACKER_OBJ_003_oPCAN_RADAR_31d85479_Tx: ComSignalType=UINT8
            OBJ_POS_LONG_003_oRDR_TRACKER_OBJ_003_oPCAN_RADAR_8434ef81_Tx: ComSignalType=UINT16
            OBJ_POS_LONG_ERR_003_oRDR_TRACKER_OBJ_003_oPCAN_RADAR_a820aa9b_Tx: ComSignalType=UINT8
            OBJ_RCS_003_oRDR_TRACKER_OBJ_003_oPCAN_RADAR_175b5249_Tx: ComSignalType=UINT8
            OBJ_REF_PT_LAT_OFFSET_003_oRDR_TRACKER_OBJ_003_oPCAN_RADAR_e266393c_Tx: ComSignalType=UINT16
            OBJ_REF_PT_LONG_OFFSET_003_oRDR_TRACKER_OBJ_003_oPCAN_RADAR_ad34c93f_Tx: ComSignalType=UINT16
            OBJ_TIMESTAMP_OFFSET_003_oRDR_TRACKER_OBJ_003_oPCAN_RADAR_17f7521f_Tx: ComSignalType=UINT8
            OBJ_TRACK_MOTION_MODEL_003_oRDR_TRACKER_OBJ_003_oPCAN_RADAR_dbf453c2_Tx: ComSignalType=UINT8
            OBJ_VEH_TRACK_FLAG_003_oRDR_TRACKER_OBJ_003_oPCAN_RADAR_59dea59f_Tx: ComSignalType=BOOLEAN
            OBJ_VELOCITY_ERR_CRR_COEF_003_oRDR_TRACKER_OBJ_003_oPCAN_RADAR_7e41c4e3_Tx: ComSignalType=UINT8
            OBJ_VELOCITY_LAT_003_oRDR_TRACKER_OBJ_003_oPCAN_RADAR_71f74169_Tx: ComSignalType=UINT16
            OBJ_VELOCITY_LAT_ERR_003_oRDR_TRACKER_OBJ_003_oPCAN_RADAR_450d3138_Tx: ComSignalType=UINT8
            OBJ_VELOCITY_LONG_003_oRDR_TRACKER_OBJ_003_oPCAN_RADAR_217a39af_Tx: ComSignalType=UINT16
            OBJ_VELOCITY_LONG_ERR_003_oRDR_TRACKER_OBJ_003_oPCAN_RADAR_a98f0ef8_Tx: ComSignalType=UINT8
            OBJ_YAW_ANGLE_003_oRDR_TRACKER_OBJ_003_oPCAN_RADAR_9d4b0529_Tx: ComSignalType=UINT16
            OBJ_YAW_ANGLE_ERR_003_oRDR_TRACKER_OBJ_003_oPCAN_RADAR_484603fe_Tx: ComSignalType=UINT8
            OBJ_YAW_RATE_003_oRDR_TRACKER_OBJ_003_oPCAN_RADAR_b8c4206e_Tx: ComSignalType=UINT16
            OBJ_YAW_RATE_ERR_003_oRDR_TRACKER_OBJ_003_oPCAN_RADAR_871cb7b2_Tx: ComSignalType=UINT8
        SG_TrackerObject004_oRDR_TRACKER_OBJ_004_oPCAN_RADAR_0e1ad860_Tx
          49 x ComGroupSignal:
            OBJ_ACCELERATION_LAT_004_oRDR_TRACKER_OBJ_004_oPCAN_RADAR_003e8317_Tx: ComSignalType=UINT16
            OBJ_ACCELERATION_LAT_ERR_004_oRDR_TRACKER_OBJ_004_oPCAN_RADAR_d5cab9a9_Tx: ComSignalType=UINT8
            OBJ_ACCELERATION_LONG_004_oRDR_TRACKER_OBJ_004_oPCAN_RADAR_72cedaf7_Tx: ComSignalType=UINT16
            OBJ_ACCELERATION_LONG_ERR_004_oRDR_TRACKER_OBJ_004_oPCAN_RADAR_ca6f1c03_Tx: ComSignalType=UINT8
            OBJ_ACCEL_ERR_CRR_COEF_004_oRDR_TRACKER_OBJ_004_oPCAN_RADAR_6acc3d65_Tx: ComSignalType=UINT8
            OBJ_ALIVE_TIME_004_oRDR_TRACKER_OBJ_004_oPCAN_RADAR_12af914b_Tx: ComSignalType=UINT16
            OBJ_CLS_TYPE1_004_oRDR_TRACKER_OBJ_004_oPCAN_RADAR_8574706d_Tx: ComSignalType=UINT8
            OBJ_CLS_TYPE1_PROB_004_oRDR_TRACKER_OBJ_004_oPCAN_RADAR_2d2ca79e_Tx: ComSignalType=UINT8
            OBJ_CLS_TYPE2_004_oRDR_TRACKER_OBJ_004_oPCAN_RADAR_c89c700a_Tx: ComSignalType=UINT8
            OBJ_CLS_TYPE2_PROB_004_oRDR_TRACKER_OBJ_004_oPCAN_RADAR_e418bc93_Tx: ComSignalType=UINT8
            OBJ_CLS_TYPE3_004_oRDR_TRACKER_OBJ_004_oPCAN_RADAR_45148de8_Tx: ComSignalType=UINT8
            OBJ_CLS_TYPE3_PROB_004_oRDR_TRACKER_OBJ_004_oPCAN_RADAR_a30b4a68_Tx: ComSignalType=UINT8
            OBJ_CLS_TYPE4_004_oRDR_TRACKER_OBJ_004_oPCAN_RADAR_534c70c4_Tx: ComSignalType=UINT8
            OBJ_CLS_TYPE4_PROB_004_oRDR_TRACKER_OBJ_004_oPCAN_RADAR_ad018cc8_Tx: ComSignalType=UINT8
            OBJ_CLS_TYPE5_004_oRDR_TRACKER_OBJ_004_oPCAN_RADAR_dec48d26_Tx: ComSignalType=UINT8
            OBJ_CLS_TYPE5_PROB_004_oRDR_TRACKER_OBJ_004_oPCAN_RADAR_ea127a33_Tx: ComSignalType=UINT8
            OBJ_CLS_TYPE6_004_oRDR_TRACKER_OBJ_004_oPCAN_RADAR_932c8d41_Tx: ComSignalType=UINT8
            OBJ_CLS_TYPE6_PROB_004_oRDR_TRACKER_OBJ_004_oPCAN_RADAR_2326613e_Tx: ComSignalType=UINT8
            OBJ_DIMENSION_LENGTH_004_oRDR_TRACKER_OBJ_004_oPCAN_RADAR_c7ea2329_Tx: ComSignalType=UINT16
            OBJ_DIMENSION_LENGTH_ERR_004_oRDR_TRACKER_OBJ_004_oPCAN_RADAR_fc123c53_Tx: ComSignalType=UINT16
            OBJ_DIMENSION_WIDTH_004_oRDR_TRACKER_OBJ_004_oPCAN_RADAR_e424d484_Tx: ComSignalType=UINT16
            OBJ_DIMENSION_WIDTH_ERR_004_oRDR_TRACKER_OBJ_004_oPCAN_RADAR_0486136c_Tx: ComSignalType=UINT8
            OBJ_EXISTENCE_PROB_004_oRDR_TRACKER_OBJ_004_oPCAN_RADAR_ef9850b9_Tx: ComSignalType=UINT16
            OBJ_GROUP_ID_004_oRDR_TRACKER_OBJ_004_oPCAN_RADAR_66ea4414_Tx: ComSignalType=UINT8
            OBJ_ID_004_oRDR_TRACKER_OBJ_004_oPCAN_RADAR_95c46f13_Tx: ComSignalType=UINT8
            OBJ_MEASUREMENT_STATUS_004_oRDR_TRACKER_OBJ_004_oPCAN_RADAR_ea161dae_Tx: ComSignalType=UINT8
            OBJ_MH_CRC16_004_oRDR_TRACKER_OBJ_004_oPCAN_RADAR_9676aa92_Tx: ComSignalType=UINT16
            OBJ_MH_CYCLE_COUNTER_004_oRDR_TRACKER_OBJ_004_oPCAN_RADAR_e792f073_Tx: ComSignalType=UINT8
            OBJ_MOVEMENT_STATUS_004_oRDR_TRACKER_OBJ_004_oPCAN_RADAR_c5b888e2_Tx: ComSignalType=UINT8
            OBJ_POS_ERR_CRR_COEF_004_oRDR_TRACKER_OBJ_004_oPCAN_RADAR_55c748d8_Tx: ComSignalType=UINT8
            OBJ_POS_LAT_004_oRDR_TRACKER_OBJ_004_oPCAN_RADAR_b768b594_Tx: ComSignalType=UINT16
            OBJ_POS_LAT_ERR_004_oRDR_TRACKER_OBJ_004_oPCAN_RADAR_b324e5a3_Tx: ComSignalType=UINT8
            OBJ_POS_LONG_004_oRDR_TRACKER_OBJ_004_oPCAN_RADAR_06c85e5b_Tx: ComSignalType=UINT16
            OBJ_POS_LONG_ERR_004_oRDR_TRACKER_OBJ_004_oPCAN_RADAR_2adc1b41_Tx: ComSignalType=UINT8
            OBJ_RCS_004_oRDR_TRACKER_OBJ_004_oPCAN_RADAR_95a7e393_Tx: ComSignalType=UINT8
            OBJ_REF_PT_LAT_OFFSET_004_oRDR_TRACKER_OBJ_004_oPCAN_RADAR_609a88e6_Tx: ComSignalType=UINT16
            OBJ_REF_PT_LONG_OFFSET_004_oRDR_TRACKER_OBJ_004_oPCAN_RADAR_2fc878e5_Tx: ComSignalType=UINT16
            OBJ_TIMESTAMP_OFFSET_004_oRDR_TRACKER_OBJ_004_oPCAN_RADAR_950be3c5_Tx: ComSignalType=UINT8
            OBJ_TRACK_MOTION_MODEL_004_oRDR_TRACKER_OBJ_004_oPCAN_RADAR_5908e218_Tx: ComSignalType=UINT8
            OBJ_VEH_TRACK_FLAG_004_oRDR_TRACKER_OBJ_004_oPCAN_RADAR_db221445_Tx: ComSignalType=BOOLEAN
            OBJ_VELOCITY_ERR_CRR_COEF_004_oRDR_TRACKER_OBJ_004_oPCAN_RADAR_fcbd7539_Tx: ComSignalType=UINT8
            OBJ_VELOCITY_LAT_004_oRDR_TRACKER_OBJ_004_oPCAN_RADAR_f30bf0b3_Tx: ComSignalType=UINT16
            OBJ_VELOCITY_LAT_ERR_004_oRDR_TRACKER_OBJ_004_oPCAN_RADAR_c7f180e2_Tx: ComSignalType=UINT8
            OBJ_VELOCITY_LONG_004_oRDR_TRACKER_OBJ_004_oPCAN_RADAR_a3868875_Tx: ComSignalType=UINT16
            OBJ_VELOCITY_LONG_ERR_004_oRDR_TRACKER_OBJ_004_oPCAN_RADAR_2b73bf22_Tx: ComSignalType=UINT8
            OBJ_YAW_ANGLE_004_oRDR_TRACKER_OBJ_004_oPCAN_RADAR_1fb7b4f3_Tx: ComSignalType=UINT16
            OBJ_YAW_ANGLE_ERR_004_oRDR_TRACKER_OBJ_004_oPCAN_RADAR_cabab224_Tx: ComSignalType=UINT8
            OBJ_YAW_RATE_004_oRDR_TRACKER_OBJ_004_oPCAN_RADAR_3a3891b4_Tx: ComSignalType=UINT16
            OBJ_YAW_RATE_ERR_004_oRDR_TRACKER_OBJ_004_oPCAN_RADAR_05e00668_Tx: ComSignalType=UINT8
        SG_TrackerObject005_oRDR_TRACKER_OBJ_005_oPCAN_RADAR_f70e50d3_Tx
          49 x ComGroupSignal:
            OBJ_ACCELERATION_LAT_005_oRDR_TRACKER_OBJ_005_oPCAN_RADAR_f92a0ba4_Tx: ComSignalType=UINT16
            OBJ_ACCELERATION_LAT_ERR_005_oRDR_TRACKER_OBJ_005_oPCAN_RADAR_2cde311a_Tx: ComSignalType=UINT8
            OBJ_ACCELERATION_LONG_005_oRDR_TRACKER_OBJ_005_oPCAN_RADAR_8bda5244_Tx: ComSignalType=UINT16
            OBJ_ACCELERATION_LONG_ERR_005_oRDR_TRACKER_OBJ_005_oPCAN_RADAR_337b94b0_Tx: ComSignalType=UINT8
            OBJ_ACCEL_ERR_CRR_COEF_005_oRDR_TRACKER_OBJ_005_oPCAN_RADAR_93d8b5d6_Tx: ComSignalType=UINT8
            OBJ_ALIVE_TIME_005_oRDR_TRACKER_OBJ_005_oPCAN_RADAR_ebbb19f8_Tx: ComSignalType=UINT16
            OBJ_CLS_TYPE1_005_oRDR_TRACKER_OBJ_005_oPCAN_RADAR_7c60f8de_Tx: ComSignalType=UINT8
            OBJ_CLS_TYPE1_PROB_005_oRDR_TRACKER_OBJ_005_oPCAN_RADAR_d4382f2d_Tx: ComSignalType=UINT8
            OBJ_CLS_TYPE2_005_oRDR_TRACKER_OBJ_005_oPCAN_RADAR_3188f8b9_Tx: ComSignalType=UINT8
            OBJ_CLS_TYPE2_PROB_005_oRDR_TRACKER_OBJ_005_oPCAN_RADAR_1d0c3420_Tx: ComSignalType=UINT8
            OBJ_CLS_TYPE3_005_oRDR_TRACKER_OBJ_005_oPCAN_RADAR_bc00055b_Tx: ComSignalType=UINT8
            OBJ_CLS_TYPE3_PROB_005_oRDR_TRACKER_OBJ_005_oPCAN_RADAR_5a1fc2db_Tx: ComSignalType=UINT8
            OBJ_CLS_TYPE4_005_oRDR_TRACKER_OBJ_005_oPCAN_RADAR_aa58f877_Tx: ComSignalType=UINT8
            OBJ_CLS_TYPE4_PROB_005_oRDR_TRACKER_OBJ_005_oPCAN_RADAR_5415047b_Tx: ComSignalType=UINT8
            OBJ_CLS_TYPE5_005_oRDR_TRACKER_OBJ_005_oPCAN_RADAR_27d00595_Tx: ComSignalType=UINT8
            OBJ_CLS_TYPE5_PROB_005_oRDR_TRACKER_OBJ_005_oPCAN_RADAR_1306f280_Tx: ComSignalType=UINT8
            OBJ_CLS_TYPE6_005_oRDR_TRACKER_OBJ_005_oPCAN_RADAR_6a3805f2_Tx: ComSignalType=UINT8
            OBJ_CLS_TYPE6_PROB_005_oRDR_TRACKER_OBJ_005_oPCAN_RADAR_da32e98d_Tx: ComSignalType=UINT8
            OBJ_DIMENSION_LENGTH_005_oRDR_TRACKER_OBJ_005_oPCAN_RADAR_3efeab9a_Tx: ComSignalType=UINT16
            OBJ_DIMENSION_LENGTH_ERR_005_oRDR_TRACKER_OBJ_005_oPCAN_RADAR_0506b4e0_Tx: ComSignalType=UINT16
            OBJ_DIMENSION_WIDTH_005_oRDR_TRACKER_OBJ_005_oPCAN_RADAR_1d305c37_Tx: ComSignalType=UINT16
            OBJ_DIMENSION_WIDTH_ERR_005_oRDR_TRACKER_OBJ_005_oPCAN_RADAR_fd929bdf_Tx: ComSignalType=UINT8
            OBJ_EXISTENCE_PROB_005_oRDR_TRACKER_OBJ_005_oPCAN_RADAR_168cd80a_Tx: ComSignalType=UINT16
            OBJ_GROUP_ID_005_oRDR_TRACKER_OBJ_005_oPCAN_RADAR_9ffecca7_Tx: ComSignalType=UINT8
            OBJ_ID_005_oRDR_TRACKER_OBJ_005_oPCAN_RADAR_6cd0e7a0_Tx: ComSignalType=UINT8
            OBJ_MEASUREMENT_STATUS_005_oRDR_TRACKER_OBJ_005_oPCAN_RADAR_1302951d_Tx: ComSignalType=UINT8
            OBJ_MH_CRC16_005_oRDR_TRACKER_OBJ_005_oPCAN_RADAR_6f622221_Tx: ComSignalType=UINT16
            OBJ_MH_CYCLE_COUNTER_005_oRDR_TRACKER_OBJ_005_oPCAN_RADAR_1e8678c0_Tx: ComSignalType=UINT8
            OBJ_MOVEMENT_STATUS_005_oRDR_TRACKER_OBJ_005_oPCAN_RADAR_3cac0051_Tx: ComSignalType=UINT8
            OBJ_POS_ERR_CRR_COEF_005_oRDR_TRACKER_OBJ_005_oPCAN_RADAR_acd3c06b_Tx: ComSignalType=UINT8
            OBJ_POS_LAT_005_oRDR_TRACKER_OBJ_005_oPCAN_RADAR_4e7c3d27_Tx: ComSignalType=UINT16
            OBJ_POS_LAT_ERR_005_oRDR_TRACKER_OBJ_005_oPCAN_RADAR_4a306d10_Tx: ComSignalType=UINT8
            OBJ_POS_LONG_005_oRDR_TRACKER_OBJ_005_oPCAN_RADAR_ffdcd6e8_Tx: ComSignalType=UINT16
            OBJ_POS_LONG_ERR_005_oRDR_TRACKER_OBJ_005_oPCAN_RADAR_d3c893f2_Tx: ComSignalType=UINT8
            OBJ_RCS_005_oRDR_TRACKER_OBJ_005_oPCAN_RADAR_6cb36b20_Tx: ComSignalType=UINT8
            OBJ_REF_PT_LAT_OFFSET_005_oRDR_TRACKER_OBJ_005_oPCAN_RADAR_998e0055_Tx: ComSignalType=UINT16
            OBJ_REF_PT_LONG_OFFSET_005_oRDR_TRACKER_OBJ_005_oPCAN_RADAR_d6dcf056_Tx: ComSignalType=UINT16
            OBJ_TIMESTAMP_OFFSET_005_oRDR_TRACKER_OBJ_005_oPCAN_RADAR_6c1f6b76_Tx: ComSignalType=UINT8
            OBJ_TRACK_MOTION_MODEL_005_oRDR_TRACKER_OBJ_005_oPCAN_RADAR_a01c6aab_Tx: ComSignalType=UINT8
            OBJ_VEH_TRACK_FLAG_005_oRDR_TRACKER_OBJ_005_oPCAN_RADAR_22369cf6_Tx: ComSignalType=BOOLEAN
            OBJ_VELOCITY_ERR_CRR_COEF_005_oRDR_TRACKER_OBJ_005_oPCAN_RADAR_05a9fd8a_Tx: ComSignalType=UINT8
            OBJ_VELOCITY_LAT_005_oRDR_TRACKER_OBJ_005_oPCAN_RADAR_0a1f7800_Tx: ComSignalType=UINT16
            OBJ_VELOCITY_LAT_ERR_005_oRDR_TRACKER_OBJ_005_oPCAN_RADAR_3ee50851_Tx: ComSignalType=UINT8
            OBJ_VELOCITY_LONG_005_oRDR_TRACKER_OBJ_005_oPCAN_RADAR_5a9200c6_Tx: ComSignalType=UINT16
            OBJ_VELOCITY_LONG_ERR_005_oRDR_TRACKER_OBJ_005_oPCAN_RADAR_d2673791_Tx: ComSignalType=UINT8
            OBJ_YAW_ANGLE_005_oRDR_TRACKER_OBJ_005_oPCAN_RADAR_e6a33c40_Tx: ComSignalType=UINT16
            OBJ_YAW_ANGLE_ERR_005_oRDR_TRACKER_OBJ_005_oPCAN_RADAR_33ae3a97_Tx: ComSignalType=UINT8
            OBJ_YAW_RATE_005_oRDR_TRACKER_OBJ_005_oPCAN_RADAR_c32c1907_Tx: ComSignalType=UINT16
            OBJ_YAW_RATE_ERR_005_oRDR_TRACKER_OBJ_005_oPCAN_RADAR_fcf48edb_Tx: ComSignalType=UINT8
        SG_TrackerObject006_oRDR_TRACKER_OBJ_006_oPCAN_RADAR_2742cf47_Tx
          49 x ComGroupSignal:
            OBJ_ACCELERATION_LAT_006_oRDR_TRACKER_OBJ_006_oPCAN_RADAR_29669430_Tx: ComSignalType=UINT16
            OBJ_ACCELERATION_LAT_ERR_006_oRDR_TRACKER_OBJ_006_oPCAN_RADAR_fc92ae8e_Tx: ComSignalType=UINT8
            OBJ_ACCELERATION_LONG_006_oRDR_TRACKER_OBJ_006_oPCAN_RADAR_5b96cdd0_Tx: ComSignalType=UINT16
            OBJ_ACCELERATION_LONG_ERR_006_oRDR_TRACKER_OBJ_006_oPCAN_RADAR_e3370b24_Tx: ComSignalType=UINT8
            OBJ_ACCEL_ERR_CRR_COEF_006_oRDR_TRACKER_OBJ_006_oPCAN_RADAR_43942a42_Tx: ComSignalType=UINT8
            OBJ_ALIVE_TIME_006_oRDR_TRACKER_OBJ_006_oPCAN_RADAR_3bf7866c_Tx: ComSignalType=UINT16
            OBJ_CLS_TYPE1_006_oRDR_TRACKER_OBJ_006_oPCAN_RADAR_ac2c674a_Tx: ComSignalType=UINT8
            OBJ_CLS_TYPE1_PROB_006_oRDR_TRACKER_OBJ_006_oPCAN_RADAR_0474b0b9_Tx: ComSignalType=UINT8
            OBJ_CLS_TYPE2_006_oRDR_TRACKER_OBJ_006_oPCAN_RADAR_e1c4672d_Tx: ComSignalType=UINT8
            OBJ_CLS_TYPE2_PROB_006_oRDR_TRACKER_OBJ_006_oPCAN_RADAR_cd40abb4_Tx: ComSignalType=UINT8
            OBJ_CLS_TYPE3_006_oRDR_TRACKER_OBJ_006_oPCAN_RADAR_6c4c9acf_Tx: ComSignalType=UINT8
            OBJ_CLS_TYPE3_PROB_006_oRDR_TRACKER_OBJ_006_oPCAN_RADAR_8a535d4f_Tx: ComSignalType=UINT8
            OBJ_CLS_TYPE4_006_oRDR_TRACKER_OBJ_006_oPCAN_RADAR_7a1467e3_Tx: ComSignalType=UINT8
            OBJ_CLS_TYPE4_PROB_006_oRDR_TRACKER_OBJ_006_oPCAN_RADAR_84599bef_Tx: ComSignalType=UINT8
            OBJ_CLS_TYPE5_006_oRDR_TRACKER_OBJ_006_oPCAN_RADAR_f79c9a01_Tx: ComSignalType=UINT8
            OBJ_CLS_TYPE5_PROB_006_oRDR_TRACKER_OBJ_006_oPCAN_RADAR_c34a6d14_Tx: ComSignalType=UINT8
            OBJ_CLS_TYPE6_006_oRDR_TRACKER_OBJ_006_oPCAN_RADAR_ba749a66_Tx: ComSignalType=UINT8
            OBJ_CLS_TYPE6_PROB_006_oRDR_TRACKER_OBJ_006_oPCAN_RADAR_0a7e7619_Tx: ComSignalType=UINT8
            OBJ_DIMENSION_LENGTH_006_oRDR_TRACKER_OBJ_006_oPCAN_RADAR_eeb2340e_Tx: ComSignalType=UINT16
            OBJ_DIMENSION_LENGTH_ERR_006_oRDR_TRACKER_OBJ_006_oPCAN_RADAR_d54a2b74_Tx: ComSignalType=UINT16
            OBJ_DIMENSION_WIDTH_006_oRDR_TRACKER_OBJ_006_oPCAN_RADAR_cd7cc3a3_Tx: ComSignalType=UINT16
            OBJ_DIMENSION_WIDTH_ERR_006_oRDR_TRACKER_OBJ_006_oPCAN_RADAR_2dde044b_Tx: ComSignalType=UINT8
            OBJ_EXISTENCE_PROB_006_oRDR_TRACKER_OBJ_006_oPCAN_RADAR_c6c0479e_Tx: ComSignalType=UINT16
            OBJ_GROUP_ID_006_oRDR_TRACKER_OBJ_006_oPCAN_RADAR_4fb25333_Tx: ComSignalType=UINT8
            OBJ_ID_006_oRDR_TRACKER_OBJ_006_oPCAN_RADAR_bc9c7834_Tx: ComSignalType=UINT8
            OBJ_MEASUREMENT_STATUS_006_oRDR_TRACKER_OBJ_006_oPCAN_RADAR_c34e0a89_Tx: ComSignalType=UINT8
            OBJ_MH_CRC16_006_oRDR_TRACKER_OBJ_006_oPCAN_RADAR_bf2ebdb5_Tx: ComSignalType=UINT16
            OBJ_MH_CYCLE_COUNTER_006_oRDR_TRACKER_OBJ_006_oPCAN_RADAR_cecae754_Tx: ComSignalType=UINT8
            OBJ_MOVEMENT_STATUS_006_oRDR_TRACKER_OBJ_006_oPCAN_RADAR_ece09fc5_Tx: ComSignalType=UINT8
            OBJ_POS_ERR_CRR_COEF_006_oRDR_TRACKER_OBJ_006_oPCAN_RADAR_7c9f5fff_Tx: ComSignalType=UINT8
            OBJ_POS_LAT_006_oRDR_TRACKER_OBJ_006_oPCAN_RADAR_9e30a2b3_Tx: ComSignalType=UINT16
            OBJ_POS_LAT_ERR_006_oRDR_TRACKER_OBJ_006_oPCAN_RADAR_9a7cf284_Tx: ComSignalType=UINT8
            OBJ_POS_LONG_006_oRDR_TRACKER_OBJ_006_oPCAN_RADAR_2f90497c_Tx: ComSignalType=UINT16
            OBJ_POS_LONG_ERR_006_oRDR_TRACKER_OBJ_006_oPCAN_RADAR_03840c66_Tx: ComSignalType=UINT8
            OBJ_RCS_006_oRDR_TRACKER_OBJ_006_oPCAN_RADAR_bcfff4b4_Tx: ComSignalType=UINT8
            OBJ_REF_PT_LAT_OFFSET_006_oRDR_TRACKER_OBJ_006_oPCAN_RADAR_49c29fc1_Tx: ComSignalType=UINT16
            OBJ_REF_PT_LONG_OFFSET_006_oRDR_TRACKER_OBJ_006_oPCAN_RADAR_06906fc2_Tx: ComSignalType=UINT16
            OBJ_TIMESTAMP_OFFSET_006_oRDR_TRACKER_OBJ_006_oPCAN_RADAR_bc53f4e2_Tx: ComSignalType=UINT8
            OBJ_TRACK_MOTION_MODEL_006_oRDR_TRACKER_OBJ_006_oPCAN_RADAR_7050f53f_Tx: ComSignalType=UINT8
            OBJ_VEH_TRACK_FLAG_006_oRDR_TRACKER_OBJ_006_oPCAN_RADAR_f27a0362_Tx: ComSignalType=BOOLEAN
            OBJ_VELOCITY_ERR_CRR_COEF_006_oRDR_TRACKER_OBJ_006_oPCAN_RADAR_d5e5621e_Tx: ComSignalType=UINT8
            OBJ_VELOCITY_LAT_006_oRDR_TRACKER_OBJ_006_oPCAN_RADAR_da53e794_Tx: ComSignalType=UINT16
            OBJ_VELOCITY_LAT_ERR_006_oRDR_TRACKER_OBJ_006_oPCAN_RADAR_eea997c5_Tx: ComSignalType=UINT8
            OBJ_VELOCITY_LONG_006_oRDR_TRACKER_OBJ_006_oPCAN_RADAR_8ade9f52_Tx: ComSignalType=UINT16
            OBJ_VELOCITY_LONG_ERR_006_oRDR_TRACKER_OBJ_006_oPCAN_RADAR_022ba805_Tx: ComSignalType=UINT8
            OBJ_YAW_ANGLE_006_oRDR_TRACKER_OBJ_006_oPCAN_RADAR_36efa3d4_Tx: ComSignalType=UINT16
            OBJ_YAW_ANGLE_ERR_006_oRDR_TRACKER_OBJ_006_oPCAN_RADAR_e3e2a503_Tx: ComSignalType=UINT8
            OBJ_YAW_RATE_006_oRDR_TRACKER_OBJ_006_oPCAN_RADAR_13608693_Tx: ComSignalType=UINT16
            OBJ_YAW_RATE_ERR_006_oRDR_TRACKER_OBJ_006_oPCAN_RADAR_2cb8114f_Tx: ComSignalType=UINT8
        SG_TrackerObject007_oRDR_TRACKER_OBJ_007_oPCAN_RADAR_de5647f4_Tx
          49 x ComGroupSignal:
            OBJ_ACCELERATION_LAT_007_oRDR_TRACKER_OBJ_007_oPCAN_RADAR_d0721c83_Tx: ComSignalType=UINT16
            OBJ_ACCELERATION_LAT_ERR_007_oRDR_TRACKER_OBJ_007_oPCAN_RADAR_0586263d_Tx: ComSignalType=UINT8
            OBJ_ACCELERATION_LONG_007_oRDR_TRACKER_OBJ_007_oPCAN_RADAR_a2824563_Tx: ComSignalType=UINT16
            OBJ_ACCELERATION_LONG_ERR_007_oRDR_TRACKER_OBJ_007_oPCAN_RADAR_1a238397_Tx: ComSignalType=UINT8
            OBJ_ACCEL_ERR_CRR_COEF_007_oRDR_TRACKER_OBJ_007_oPCAN_RADAR_ba80a2f1_Tx: ComSignalType=UINT8
            OBJ_ALIVE_TIME_007_oRDR_TRACKER_OBJ_007_oPCAN_RADAR_c2e30edf_Tx: ComSignalType=UINT16
            OBJ_CLS_TYPE1_007_oRDR_TRACKER_OBJ_007_oPCAN_RADAR_5538eff9_Tx: ComSignalType=UINT8
            OBJ_CLS_TYPE1_PROB_007_oRDR_TRACKER_OBJ_007_oPCAN_RADAR_fd60380a_Tx: ComSignalType=UINT8
            OBJ_CLS_TYPE2_007_oRDR_TRACKER_OBJ_007_oPCAN_RADAR_18d0ef9e_Tx: ComSignalType=UINT8
            OBJ_CLS_TYPE2_PROB_007_oRDR_TRACKER_OBJ_007_oPCAN_RADAR_34542307_Tx: ComSignalType=UINT8
            OBJ_CLS_TYPE3_007_oRDR_TRACKER_OBJ_007_oPCAN_RADAR_9558127c_Tx: ComSignalType=UINT8
            OBJ_CLS_TYPE3_PROB_007_oRDR_TRACKER_OBJ_007_oPCAN_RADAR_7347d5fc_Tx: ComSignalType=UINT8
            OBJ_CLS_TYPE4_007_oRDR_TRACKER_OBJ_007_oPCAN_RADAR_8300ef50_Tx: ComSignalType=UINT8
            OBJ_CLS_TYPE4_PROB_007_oRDR_TRACKER_OBJ_007_oPCAN_RADAR_7d4d135c_Tx: ComSignalType=UINT8
            OBJ_CLS_TYPE5_007_oRDR_TRACKER_OBJ_007_oPCAN_RADAR_0e8812b2_Tx: ComSignalType=UINT8
            OBJ_CLS_TYPE5_PROB_007_oRDR_TRACKER_OBJ_007_oPCAN_RADAR_3a5ee5a7_Tx: ComSignalType=UINT8
            OBJ_CLS_TYPE6_007_oRDR_TRACKER_OBJ_007_oPCAN_RADAR_436012d5_Tx: ComSignalType=UINT8
            OBJ_CLS_TYPE6_PROB_007_oRDR_TRACKER_OBJ_007_oPCAN_RADAR_f36afeaa_Tx: ComSignalType=UINT8
            OBJ_DIMENSION_LENGTH_007_oRDR_TRACKER_OBJ_007_oPCAN_RADAR_17a6bcbd_Tx: ComSignalType=UINT16
            OBJ_DIMENSION_LENGTH_ERR_007_oRDR_TRACKER_OBJ_007_oPCAN_RADAR_2c5ea3c7_Tx: ComSignalType=UINT16
            OBJ_DIMENSION_WIDTH_007_oRDR_TRACKER_OBJ_007_oPCAN_RADAR_34684b10_Tx: ComSignalType=UINT16
            OBJ_DIMENSION_WIDTH_ERR_007_oRDR_TRACKER_OBJ_007_oPCAN_RADAR_d4ca8cf8_Tx: ComSignalType=UINT8
            OBJ_EXISTENCE_PROB_007_oRDR_TRACKER_OBJ_007_oPCAN_RADAR_3fd4cf2d_Tx: ComSignalType=UINT16
            OBJ_GROUP_ID_007_oRDR_TRACKER_OBJ_007_oPCAN_RADAR_b6a6db80_Tx: ComSignalType=UINT8
            OBJ_ID_007_oRDR_TRACKER_OBJ_007_oPCAN_RADAR_4588f087_Tx: ComSignalType=UINT8
            OBJ_MEASUREMENT_STATUS_007_oRDR_TRACKER_OBJ_007_oPCAN_RADAR_3a5a823a_Tx: ComSignalType=UINT8
            OBJ_MH_CRC16_007_oRDR_TRACKER_OBJ_007_oPCAN_RADAR_463a3506_Tx: ComSignalType=UINT16
            OBJ_MH_CYCLE_COUNTER_007_oRDR_TRACKER_OBJ_007_oPCAN_RADAR_37de6fe7_Tx: ComSignalType=UINT8
            OBJ_MOVEMENT_STATUS_007_oRDR_TRACKER_OBJ_007_oPCAN_RADAR_15f41776_Tx: ComSignalType=UINT8
            OBJ_POS_ERR_CRR_COEF_007_oRDR_TRACKER_OBJ_007_oPCAN_RADAR_858bd74c_Tx: ComSignalType=UINT8
            OBJ_POS_LAT_007_oRDR_TRACKER_OBJ_007_oPCAN_RADAR_67242a00_Tx: ComSignalType=UINT16
            OBJ_POS_LAT_ERR_007_oRDR_TRACKER_OBJ_007_oPCAN_RADAR_63687a37_Tx: ComSignalType=UINT8
            OBJ_POS_LONG_007_oRDR_TRACKER_OBJ_007_oPCAN_RADAR_d684c1cf_Tx: ComSignalType=UINT16
            OBJ_POS_LONG_ERR_007_oRDR_TRACKER_OBJ_007_oPCAN_RADAR_fa9084d5_Tx: ComSignalType=UINT8
            OBJ_RCS_007_oRDR_TRACKER_OBJ_007_oPCAN_RADAR_45eb7c07_Tx: ComSignalType=UINT8
            OBJ_REF_PT_LAT_OFFSET_007_oRDR_TRACKER_OBJ_007_oPCAN_RADAR_b0d61772_Tx: ComSignalType=UINT16
            OBJ_REF_PT_LONG_OFFSET_007_oRDR_TRACKER_OBJ_007_oPCAN_RADAR_ff84e771_Tx: ComSignalType=UINT16
            OBJ_TIMESTAMP_OFFSET_007_oRDR_TRACKER_OBJ_007_oPCAN_RADAR_45477c51_Tx: ComSignalType=UINT8
            OBJ_TRACK_MOTION_MODEL_007_oRDR_TRACKER_OBJ_007_oPCAN_RADAR_89447d8c_Tx: ComSignalType=UINT8
            OBJ_VEH_TRACK_FLAG_007_oRDR_TRACKER_OBJ_007_oPCAN_RADAR_0b6e8bd1_Tx: ComSignalType=BOOLEAN
            OBJ_VELOCITY_ERR_CRR_COEF_007_oRDR_TRACKER_OBJ_007_oPCAN_RADAR_2cf1eaad_Tx: ComSignalType=UINT8
            OBJ_VELOCITY_LAT_007_oRDR_TRACKER_OBJ_007_oPCAN_RADAR_23476f27_Tx: ComSignalType=UINT16
            OBJ_VELOCITY_LAT_ERR_007_oRDR_TRACKER_OBJ_007_oPCAN_RADAR_17bd1f76_Tx: ComSignalType=UINT8
            OBJ_VELOCITY_LONG_007_oRDR_TRACKER_OBJ_007_oPCAN_RADAR_73ca17e1_Tx: ComSignalType=UINT16
            OBJ_VELOCITY_LONG_ERR_007_oRDR_TRACKER_OBJ_007_oPCAN_RADAR_fb3f20b6_Tx: ComSignalType=UINT8
            OBJ_YAW_ANGLE_007_oRDR_TRACKER_OBJ_007_oPCAN_RADAR_cffb2b67_Tx: ComSignalType=UINT16
            OBJ_YAW_ANGLE_ERR_007_oRDR_TRACKER_OBJ_007_oPCAN_RADAR_1af62db0_Tx: ComSignalType=UINT8
            OBJ_YAW_RATE_007_oRDR_TRACKER_OBJ_007_oPCAN_RADAR_ea740e20_Tx: ComSignalType=UINT16
            OBJ_YAW_RATE_ERR_007_oRDR_TRACKER_OBJ_007_oPCAN_RADAR_d5ac99fc_Tx: ComSignalType=UINT8
        SG_TrackerObject008_oRDR_TRACKER_OBJ_008_oPCAN_RADAR_f9caaab2_Tx
          49 x ComGroupSignal:
            OBJ_ACCELERATION_LAT_008_oRDR_TRACKER_OBJ_008_oPCAN_RADAR_f7eef1c5_Tx: ComSignalType=UINT16
            OBJ_ACCELERATION_LAT_ERR_008_oRDR_TRACKER_OBJ_008_oPCAN_RADAR_221acb7b_Tx: ComSignalType=UINT8
            OBJ_ACCELERATION_LONG_008_oRDR_TRACKER_OBJ_008_oPCAN_RADAR_851ea825_Tx: ComSignalType=UINT16
            OBJ_ACCELERATION_LONG_ERR_008_oRDR_TRACKER_OBJ_008_oPCAN_RADAR_3dbf6ed1_Tx: ComSignalType=UINT8
            OBJ_ACCEL_ERR_CRR_COEF_008_oRDR_TRACKER_OBJ_008_oPCAN_RADAR_9d1c4fb7_Tx: ComSignalType=UINT8
            OBJ_ALIVE_TIME_008_oRDR_TRACKER_OBJ_008_oPCAN_RADAR_e57fe399_Tx: ComSignalType=UINT16
            OBJ_CLS_TYPE1_008_oRDR_TRACKER_OBJ_008_oPCAN_RADAR_72a402bf_Tx: ComSignalType=UINT8
            OBJ_CLS_TYPE1_PROB_008_oRDR_TRACKER_OBJ_008_oPCAN_RADAR_dafcd54c_Tx: ComSignalType=UINT8
            OBJ_CLS_TYPE2_008_oRDR_TRACKER_OBJ_008_oPCAN_RADAR_3f4c02d8_Tx: ComSignalType=UINT8
            OBJ_CLS_TYPE2_PROB_008_oRDR_TRACKER_OBJ_008_oPCAN_RADAR_13c8ce41_Tx: ComSignalType=UINT8
            OBJ_CLS_TYPE3_008_oRDR_TRACKER_OBJ_008_oPCAN_RADAR_b2c4ff3a_Tx: ComSignalType=UINT8
            OBJ_CLS_TYPE3_PROB_008_oRDR_TRACKER_OBJ_008_oPCAN_RADAR_54db38ba_Tx: ComSignalType=UINT8
            OBJ_CLS_TYPE4_008_oRDR_TRACKER_OBJ_008_oPCAN_RADAR_a49c0216_Tx: ComSignalType=UINT8
            OBJ_CLS_TYPE4_PROB_008_oRDR_TRACKER_OBJ_008_oPCAN_RADAR_5ad1fe1a_Tx: ComSignalType=UINT8
            OBJ_CLS_TYPE5_008_oRDR_TRACKER_OBJ_008_oPCAN_RADAR_2914fff4_Tx: ComSignalType=UINT8
            OBJ_CLS_TYPE5_PROB_008_oRDR_TRACKER_OBJ_008_oPCAN_RADAR_1dc208e1_Tx: ComSignalType=UINT8
            OBJ_CLS_TYPE6_008_oRDR_TRACKER_OBJ_008_oPCAN_RADAR_64fcff93_Tx: ComSignalType=UINT8
            OBJ_CLS_TYPE6_PROB_008_oRDR_TRACKER_OBJ_008_oPCAN_RADAR_d4f613ec_Tx: ComSignalType=UINT8
            OBJ_DIMENSION_LENGTH_008_oRDR_TRACKER_OBJ_008_oPCAN_RADAR_303a51fb_Tx: ComSignalType=UINT16
            OBJ_DIMENSION_LENGTH_ERR_008_oRDR_TRACKER_OBJ_008_oPCAN_RADAR_0bc24e81_Tx: ComSignalType=UINT16
            OBJ_DIMENSION_WIDTH_008_oRDR_TRACKER_OBJ_008_oPCAN_RADAR_13f4a656_Tx: ComSignalType=UINT16
            OBJ_DIMENSION_WIDTH_ERR_008_oRDR_TRACKER_OBJ_008_oPCAN_RADAR_f35661be_Tx: ComSignalType=UINT8
            OBJ_EXISTENCE_PROB_008_oRDR_TRACKER_OBJ_008_oPCAN_RADAR_1848226b_Tx: ComSignalType=UINT16
            OBJ_GROUP_ID_008_oRDR_TRACKER_OBJ_008_oPCAN_RADAR_913a36c6_Tx: ComSignalType=UINT8
            OBJ_ID_008_oRDR_TRACKER_OBJ_008_oPCAN_RADAR_62141dc1_Tx: ComSignalType=UINT8
            OBJ_MEASUREMENT_STATUS_008_oRDR_TRACKER_OBJ_008_oPCAN_RADAR_1dc66f7c_Tx: ComSignalType=UINT8
            OBJ_MH_CRC16_008_oRDR_TRACKER_OBJ_008_oPCAN_RADAR_61a6d840_Tx: ComSignalType=UINT16
            OBJ_MH_CYCLE_COUNTER_008_oRDR_TRACKER_OBJ_008_oPCAN_RADAR_104282a1_Tx: ComSignalType=UINT8
            OBJ_MOVEMENT_STATUS_008_oRDR_TRACKER_OBJ_008_oPCAN_RADAR_3268fa30_Tx: ComSignalType=UINT8
            OBJ_POS_ERR_CRR_COEF_008_oRDR_TRACKER_OBJ_008_oPCAN_RADAR_a2173a0a_Tx: ComSignalType=UINT8
            OBJ_POS_LAT_008_oRDR_TRACKER_OBJ_008_oPCAN_RADAR_40b8c746_Tx: ComSignalType=UINT16
            OBJ_POS_LAT_ERR_008_oRDR_TRACKER_OBJ_008_oPCAN_RADAR_44f49771_Tx: ComSignalType=UINT8
            OBJ_POS_LONG_008_oRDR_TRACKER_OBJ_008_oPCAN_RADAR_f1182c89_Tx: ComSignalType=UINT16
            OBJ_POS_LONG_ERR_008_oRDR_TRACKER_OBJ_008_oPCAN_RADAR_dd0c6993_Tx: ComSignalType=UINT8
            OBJ_RCS_008_oRDR_TRACKER_OBJ_008_oPCAN_RADAR_62779141_Tx: ComSignalType=UINT8
            OBJ_REF_PT_LAT_OFFSET_008_oRDR_TRACKER_OBJ_008_oPCAN_RADAR_974afa34_Tx: ComSignalType=UINT16
            OBJ_REF_PT_LONG_OFFSET_008_oRDR_TRACKER_OBJ_008_oPCAN_RADAR_d8180a37_Tx: ComSignalType=UINT16
            OBJ_TIMESTAMP_OFFSET_008_oRDR_TRACKER_OBJ_008_oPCAN_RADAR_62db9117_Tx: ComSignalType=UINT8
            OBJ_TRACK_MOTION_MODEL_008_oRDR_TRACKER_OBJ_008_oPCAN_RADAR_aed890ca_Tx: ComSignalType=UINT8
            OBJ_VEH_TRACK_FLAG_008_oRDR_TRACKER_OBJ_008_oPCAN_RADAR_2cf26697_Tx: ComSignalType=BOOLEAN
            OBJ_VELOCITY_ERR_CRR_COEF_008_oRDR_TRACKER_OBJ_008_oPCAN_RADAR_0b6d07eb_Tx: ComSignalType=UINT8
            OBJ_VELOCITY_LAT_008_oRDR_TRACKER_OBJ_008_oPCAN_RADAR_04db8261_Tx: ComSignalType=UINT16
            OBJ_VELOCITY_LAT_ERR_008_oRDR_TRACKER_OBJ_008_oPCAN_RADAR_3021f230_Tx: ComSignalType=UINT8
            OBJ_VELOCITY_LONG_008_oRDR_TRACKER_OBJ_008_oPCAN_RADAR_5456faa7_Tx: ComSignalType=UINT16
            OBJ_VELOCITY_LONG_ERR_008_oRDR_TRACKER_OBJ_008_oPCAN_RADAR_dca3cdf0_Tx: ComSignalType=UINT8
            OBJ_YAW_ANGLE_008_oRDR_TRACKER_OBJ_008_oPCAN_RADAR_e867c621_Tx: ComSignalType=UINT16
            OBJ_YAW_ANGLE_ERR_008_oRDR_TRACKER_OBJ_008_oPCAN_RADAR_3d6ac0f6_Tx: ComSignalType=UINT8
            OBJ_YAW_RATE_008_oRDR_TRACKER_OBJ_008_oPCAN_RADAR_cde8e366_Tx: ComSignalType=UINT16
            OBJ_YAW_RATE_ERR_008_oRDR_TRACKER_OBJ_008_oPCAN_RADAR_f23074ba_Tx: ComSignalType=UINT8
        SG_TrackerObject009_oRDR_TRACKER_OBJ_009_oPCAN_RADAR_00de2201_Tx
          49 x ComGroupSignal:
            OBJ_ACCELERATION_LAT_009_oRDR_TRACKER_OBJ_009_oPCAN_RADAR_0efa7976_Tx: ComSignalType=UINT16
            OBJ_ACCELERATION_LAT_ERR_009_oRDR_TRACKER_OBJ_009_oPCAN_RADAR_db0e43c8_Tx: ComSignalType=UINT8
            OBJ_ACCELERATION_LONG_009_oRDR_TRACKER_OBJ_009_oPCAN_RADAR_7c0a2096_Tx: ComSignalType=UINT16
            OBJ_ACCELERATION_LONG_ERR_009_oRDR_TRACKER_OBJ_009_oPCAN_RADAR_c4abe662_Tx: ComSignalType=UINT8
            OBJ_ACCEL_ERR_CRR_COEF_009_oRDR_TRACKER_OBJ_009_oPCAN_RADAR_6408c704_Tx: ComSignalType=UINT8
            OBJ_ALIVE_TIME_009_oRDR_TRACKER_OBJ_009_oPCAN_RADAR_1c6b6b2a_Tx: ComSignalType=UINT16
            OBJ_CLS_TYPE1_009_oRDR_TRACKER_OBJ_009_oPCAN_RADAR_8bb08a0c_Tx: ComSignalType=UINT8
            OBJ_CLS_TYPE1_PROB_009_oRDR_TRACKER_OBJ_009_oPCAN_RADAR_23e85dff_Tx: ComSignalType=UINT8
            OBJ_CLS_TYPE2_009_oRDR_TRACKER_OBJ_009_oPCAN_RADAR_c6588a6b_Tx: ComSignalType=UINT8
            OBJ_CLS_TYPE2_PROB_009_oRDR_TRACKER_OBJ_009_oPCAN_RADAR_eadc46f2_Tx: ComSignalType=UINT8
            OBJ_CLS_TYPE3_009_oRDR_TRACKER_OBJ_009_oPCAN_RADAR_4bd07789_Tx: ComSignalType=UINT8
            OBJ_CLS_TYPE3_PROB_009_oRDR_TRACKER_OBJ_009_oPCAN_RADAR_adcfb009_Tx: ComSignalType=UINT8
            OBJ_CLS_TYPE4_009_oRDR_TRACKER_OBJ_009_oPCAN_RADAR_5d888aa5_Tx: ComSignalType=UINT8
            OBJ_CLS_TYPE4_PROB_009_oRDR_TRACKER_OBJ_009_oPCAN_RADAR_a3c576a9_Tx: ComSignalType=UINT8
            OBJ_CLS_TYPE5_009_oRDR_TRACKER_OBJ_009_oPCAN_RADAR_d0007747_Tx: ComSignalType=UINT8
            OBJ_CLS_TYPE5_PROB_009_oRDR_TRACKER_OBJ_009_oPCAN_RADAR_e4d68052_Tx: ComSignalType=UINT8
            OBJ_CLS_TYPE6_009_oRDR_TRACKER_OBJ_009_oPCAN_RADAR_9de87720_Tx: ComSignalType=UINT8
            OBJ_CLS_TYPE6_PROB_009_oRDR_TRACKER_OBJ_009_oPCAN_RADAR_2de29b5f_Tx: ComSignalType=UINT8
            OBJ_DIMENSION_LENGTH_009_oRDR_TRACKER_OBJ_009_oPCAN_RADAR_c92ed948_Tx: ComSignalType=UINT16
            OBJ_DIMENSION_LENGTH_ERR_009_oRDR_TRACKER_OBJ_009_oPCAN_RADAR_f2d6c632_Tx: ComSignalType=UINT16
            OBJ_DIMENSION_WIDTH_009_oRDR_TRACKER_OBJ_009_oPCAN_RADAR_eae02ee5_Tx: ComSignalType=UINT16
            OBJ_DIMENSION_WIDTH_ERR_009_oRDR_TRACKER_OBJ_009_oPCAN_RADAR_0a42e90d_Tx: ComSignalType=UINT8
            OBJ_EXISTENCE_PROB_009_oRDR_TRACKER_OBJ_009_oPCAN_RADAR_e15caad8_Tx: ComSignalType=UINT16
            OBJ_GROUP_ID_009_oRDR_TRACKER_OBJ_009_oPCAN_RADAR_682ebe75_Tx: ComSignalType=UINT8
            OBJ_ID_009_oRDR_TRACKER_OBJ_009_oPCAN_RADAR_9b009572_Tx: ComSignalType=UINT8
            OBJ_MEASUREMENT_STATUS_009_oRDR_TRACKER_OBJ_009_oPCAN_RADAR_e4d2e7cf_Tx: ComSignalType=UINT8
            OBJ_MH_CRC16_009_oRDR_TRACKER_OBJ_009_oPCAN_RADAR_98b250f3_Tx: ComSignalType=UINT16
            OBJ_MH_CYCLE_COUNTER_009_oRDR_TRACKER_OBJ_009_oPCAN_RADAR_e9560a12_Tx: ComSignalType=UINT8
            OBJ_MOVEMENT_STATUS_009_oRDR_TRACKER_OBJ_009_oPCAN_RADAR_cb7c7283_Tx: ComSignalType=UINT8
            OBJ_POS_ERR_CRR_COEF_009_oRDR_TRACKER_OBJ_009_oPCAN_RADAR_5b03b2b9_Tx: ComSignalType=UINT8
            OBJ_POS_LAT_009_oRDR_TRACKER_OBJ_009_oPCAN_RADAR_b9ac4ff5_Tx: ComSignalType=UINT16
            OBJ_POS_LAT_ERR_009_oRDR_TRACKER_OBJ_009_oPCAN_RADAR_bde01fc2_Tx: ComSignalType=UINT8
            OBJ_POS_LONG_009_oRDR_TRACKER_OBJ_009_oPCAN_RADAR_080ca43a_Tx: ComSignalType=UINT16
            OBJ_POS_LONG_ERR_009_oRDR_TRACKER_OBJ_009_oPCAN_RADAR_2418e120_Tx: ComSignalType=UINT8
            OBJ_RCS_009_oRDR_TRACKER_OBJ_009_oPCAN_RADAR_9b6319f2_Tx: ComSignalType=UINT8
            OBJ_REF_PT_LAT_OFFSET_009_oRDR_TRACKER_OBJ_009_oPCAN_RADAR_6e5e7287_Tx: ComSignalType=UINT16
            OBJ_REF_PT_LONG_OFFSET_009_oRDR_TRACKER_OBJ_009_oPCAN_RADAR_210c8284_Tx: ComSignalType=UINT16
            OBJ_TIMESTAMP_OFFSET_009_oRDR_TRACKER_OBJ_009_oPCAN_RADAR_9bcf19a4_Tx: ComSignalType=UINT8
            OBJ_TRACK_MOTION_MODEL_009_oRDR_TRACKER_OBJ_009_oPCAN_RADAR_57cc1879_Tx: ComSignalType=UINT8
            OBJ_VEH_TRACK_FLAG_009_oRDR_TRACKER_OBJ_009_oPCAN_RADAR_d5e6ee24_Tx: ComSignalType=BOOLEAN
            OBJ_VELOCITY_ERR_CRR_COEF_009_oRDR_TRACKER_OBJ_009_oPCAN_RADAR_f2798f58_Tx: ComSignalType=UINT8
            OBJ_VELOCITY_LAT_009_oRDR_TRACKER_OBJ_009_oPCAN_RADAR_fdcf0ad2_Tx: ComSignalType=UINT16
            OBJ_VELOCITY_LAT_ERR_009_oRDR_TRACKER_OBJ_009_oPCAN_RADAR_c9357a83_Tx: ComSignalType=UINT8
            OBJ_VELOCITY_LONG_009_oRDR_TRACKER_OBJ_009_oPCAN_RADAR_ad427214_Tx: ComSignalType=UINT16
            OBJ_VELOCITY_LONG_ERR_009_oRDR_TRACKER_OBJ_009_oPCAN_RADAR_25b74543_Tx: ComSignalType=UINT8
            OBJ_YAW_ANGLE_009_oRDR_TRACKER_OBJ_009_oPCAN_RADAR_11734e92_Tx: ComSignalType=UINT16
            OBJ_YAW_ANGLE_ERR_009_oRDR_TRACKER_OBJ_009_oPCAN_RADAR_c47e4845_Tx: ComSignalType=UINT8
            OBJ_YAW_RATE_009_oRDR_TRACKER_OBJ_009_oPCAN_RADAR_34fc6bd5_Tx: ComSignalType=UINT16
            OBJ_YAW_RATE_ERR_009_oRDR_TRACKER_OBJ_009_oPCAN_RADAR_0b24fc09_Tx: ComSignalType=UINT8
        SG_TrackerObject010_oRDR_TRACKER_OBJ_010_oPCAN_RADAR_0e3b0090_Tx
          49 x ComGroupSignal:
            OBJ_ACCELERATION_LAT_010_oRDR_TRACKER_OBJ_010_oPCAN_RADAR_001f5be7_Tx: ComSignalType=UINT16
            OBJ_ACCELERATION_LAT_ERR_010_oRDR_TRACKER_OBJ_010_oPCAN_RADAR_d5eb6159_Tx: ComSignalType=UINT8
            OBJ_ACCELERATION_LONG_010_oRDR_TRACKER_OBJ_010_oPCAN_RADAR_72ef0207_Tx: ComSignalType=UINT16
            OBJ_ACCELERATION_LONG_ERR_010_oRDR_TRACKER_OBJ_010_oPCAN_RADAR_ca4ec4f3_Tx: ComSignalType=UINT8
            OBJ_ACCEL_ERR_CRR_COEF_010_oRDR_TRACKER_OBJ_010_oPCAN_RADAR_6aede595_Tx: ComSignalType=UINT8
            OBJ_ALIVE_TIME_010_oRDR_TRACKER_OBJ_010_oPCAN_RADAR_128e49bb_Tx: ComSignalType=UINT16
            OBJ_CLS_TYPE1_010_oRDR_TRACKER_OBJ_010_oPCAN_RADAR_8555a89d_Tx: ComSignalType=UINT8
            OBJ_CLS_TYPE1_PROB_010_oRDR_TRACKER_OBJ_010_oPCAN_RADAR_2d0d7f6e_Tx: ComSignalType=UINT8
            OBJ_CLS_TYPE2_010_oRDR_TRACKER_OBJ_010_oPCAN_RADAR_c8bda8fa_Tx: ComSignalType=UINT8
            OBJ_CLS_TYPE2_PROB_010_oRDR_TRACKER_OBJ_010_oPCAN_RADAR_e4396463_Tx: ComSignalType=UINT8
            OBJ_CLS_TYPE3_010_oRDR_TRACKER_OBJ_010_oPCAN_RADAR_45355518_Tx: ComSignalType=UINT8
            OBJ_CLS_TYPE3_PROB_010_oRDR_TRACKER_OBJ_010_oPCAN_RADAR_a32a9298_Tx: ComSignalType=UINT8
            OBJ_CLS_TYPE4_010_oRDR_TRACKER_OBJ_010_oPCAN_RADAR_536da834_Tx: ComSignalType=UINT8
            OBJ_CLS_TYPE4_PROB_010_oRDR_TRACKER_OBJ_010_oPCAN_RADAR_ad205438_Tx: ComSignalType=UINT8
            OBJ_CLS_TYPE5_010_oRDR_TRACKER_OBJ_010_oPCAN_RADAR_dee555d6_Tx: ComSignalType=UINT8
            OBJ_CLS_TYPE5_PROB_010_oRDR_TRACKER_OBJ_010_oPCAN_RADAR_ea33a2c3_Tx: ComSignalType=UINT8
            OBJ_CLS_TYPE6_010_oRDR_TRACKER_OBJ_010_oPCAN_RADAR_930d55b1_Tx: ComSignalType=UINT8
            OBJ_CLS_TYPE6_PROB_010_oRDR_TRACKER_OBJ_010_oPCAN_RADAR_2307b9ce_Tx: ComSignalType=UINT8
            OBJ_DIMENSION_LENGTH_010_oRDR_TRACKER_OBJ_010_oPCAN_RADAR_c7cbfbd9_Tx: ComSignalType=UINT16
            OBJ_DIMENSION_LENGTH_ERR_010_oRDR_TRACKER_OBJ_010_oPCAN_RADAR_fc33e4a3_Tx: ComSignalType=UINT16
            OBJ_DIMENSION_WIDTH_010_oRDR_TRACKER_OBJ_010_oPCAN_RADAR_e4050c74_Tx: ComSignalType=UINT16
            OBJ_DIMENSION_WIDTH_ERR_010_oRDR_TRACKER_OBJ_010_oPCAN_RADAR_04a7cb9c_Tx: ComSignalType=UINT8
            OBJ_EXISTENCE_PROB_010_oRDR_TRACKER_OBJ_010_oPCAN_RADAR_efb98849_Tx: ComSignalType=UINT16
            OBJ_GROUP_ID_010_oRDR_TRACKER_OBJ_010_oPCAN_RADAR_66cb9ce4_Tx: ComSignalType=UINT8
            OBJ_ID_010_oRDR_TRACKER_OBJ_010_oPCAN_RADAR_95e5b7e3_Tx: ComSignalType=UINT8
            OBJ_MEASUREMENT_STATUS_010_oRDR_TRACKER_OBJ_010_oPCAN_RADAR_ea37c55e_Tx: ComSignalType=UINT8
            OBJ_MH_CRC16_010_oRDR_TRACKER_OBJ_010_oPCAN_RADAR_96577262_Tx: ComSignalType=UINT16
            OBJ_MH_CYCLE_COUNTER_010_oRDR_TRACKER_OBJ_010_oPCAN_RADAR_e7b32883_Tx: ComSignalType=UINT8
            OBJ_MOVEMENT_STATUS_010_oRDR_TRACKER_OBJ_010_oPCAN_RADAR_c5995012_Tx: ComSignalType=UINT8
            OBJ_POS_ERR_CRR_COEF_010_oRDR_TRACKER_OBJ_010_oPCAN_RADAR_55e69028_Tx: ComSignalType=UINT8
            OBJ_POS_LAT_010_oRDR_TRACKER_OBJ_010_oPCAN_RADAR_b7496d64_Tx: ComSignalType=UINT16
            OBJ_POS_LAT_ERR_010_oRDR_TRACKER_OBJ_010_oPCAN_RADAR_b3053d53_Tx: ComSignalType=UINT8
            OBJ_POS_LONG_010_oRDR_TRACKER_OBJ_010_oPCAN_RADAR_06e986ab_Tx: ComSignalType=UINT16
            OBJ_POS_LONG_ERR_010_oRDR_TRACKER_OBJ_010_oPCAN_RADAR_2afdc3b1_Tx: ComSignalType=UINT8
            OBJ_RCS_010_oRDR_TRACKER_OBJ_010_oPCAN_RADAR_95863b63_Tx: ComSignalType=UINT8
            OBJ_REF_PT_LAT_OFFSET_010_oRDR_TRACKER_OBJ_010_oPCAN_RADAR_60bb5016_Tx: ComSignalType=UINT16
            OBJ_REF_PT_LONG_OFFSET_010_oRDR_TRACKER_OBJ_010_oPCAN_RADAR_2fe9a015_Tx: ComSignalType=UINT16
            OBJ_TIMESTAMP_OFFSET_010_oRDR_TRACKER_OBJ_010_oPCAN_RADAR_952a3b35_Tx: ComSignalType=UINT8
            OBJ_TRACK_MOTION_MODEL_010_oRDR_TRACKER_OBJ_010_oPCAN_RADAR_59293ae8_Tx: ComSignalType=UINT8
            OBJ_VEH_TRACK_FLAG_010_oRDR_TRACKER_OBJ_010_oPCAN_RADAR_db03ccb5_Tx: ComSignalType=BOOLEAN
            OBJ_VELOCITY_ERR_CRR_COEF_010_oRDR_TRACKER_OBJ_010_oPCAN_RADAR_fc9cadc9_Tx: ComSignalType=UINT8
            OBJ_VELOCITY_LAT_010_oRDR_TRACKER_OBJ_010_oPCAN_RADAR_f32a2843_Tx: ComSignalType=UINT16
            OBJ_VELOCITY_LAT_ERR_010_oRDR_TRACKER_OBJ_010_oPCAN_RADAR_c7d05812_Tx: ComSignalType=UINT8
            OBJ_VELOCITY_LONG_010_oRDR_TRACKER_OBJ_010_oPCAN_RADAR_a3a75085_Tx: ComSignalType=UINT16
            OBJ_VELOCITY_LONG_ERR_010_oRDR_TRACKER_OBJ_010_oPCAN_RADAR_2b5267d2_Tx: ComSignalType=UINT8
            OBJ_YAW_ANGLE_010_oRDR_TRACKER_OBJ_010_oPCAN_RADAR_1f966c03_Tx: ComSignalType=UINT16
            OBJ_YAW_ANGLE_ERR_010_oRDR_TRACKER_OBJ_010_oPCAN_RADAR_ca9b6ad4_Tx: ComSignalType=UINT8
            OBJ_YAW_RATE_010_oRDR_TRACKER_OBJ_010_oPCAN_RADAR_3a194944_Tx: ComSignalType=UINT16
            OBJ_YAW_RATE_ERR_010_oRDR_TRACKER_OBJ_010_oPCAN_RADAR_05c1de98_Tx: ComSignalType=UINT8
        SG_TrackerObject011_oRDR_TRACKER_OBJ_011_oPCAN_RADAR_f72f8823_Tx
          49 x ComGroupSignal:
            OBJ_ACCELERATION_LAT_011_oRDR_TRACKER_OBJ_011_oPCAN_RADAR_f90bd354_Tx: ComSignalType=UINT16
            OBJ_ACCELERATION_LAT_ERR_011_oRDR_TRACKER_OBJ_011_oPCAN_RADAR_2cffe9ea_Tx: ComSignalType=UINT8
            OBJ_ACCELERATION_LONG_011_oRDR_TRACKER_OBJ_011_oPCAN_RADAR_8bfb8ab4_Tx: ComSignalType=UINT16
            OBJ_ACCELERATION_LONG_ERR_011_oRDR_TRACKER_OBJ_011_oPCAN_RADAR_335a4c40_Tx: ComSignalType=UINT8
            OBJ_ACCEL_ERR_CRR_COEF_011_oRDR_TRACKER_OBJ_011_oPCAN_RADAR_93f96d26_Tx: ComSignalType=UINT8
            OBJ_ALIVE_TIME_011_oRDR_TRACKER_OBJ_011_oPCAN_RADAR_eb9ac108_Tx: ComSignalType=UINT16
            OBJ_CLS_TYPE1_011_oRDR_TRACKER_OBJ_011_oPCAN_RADAR_7c41202e_Tx: ComSignalType=UINT8
            OBJ_CLS_TYPE1_PROB_011_oRDR_TRACKER_OBJ_011_oPCAN_RADAR_d419f7dd_Tx: ComSignalType=UINT8
            OBJ_CLS_TYPE2_011_oRDR_TRACKER_OBJ_011_oPCAN_RADAR_31a92049_Tx: ComSignalType=UINT8
            OBJ_CLS_TYPE2_PROB_011_oRDR_TRACKER_OBJ_011_oPCAN_RADAR_1d2decd0_Tx: ComSignalType=UINT8
            OBJ_CLS_TYPE3_011_oRDR_TRACKER_OBJ_011_oPCAN_RADAR_bc21ddab_Tx: ComSignalType=UINT8
            OBJ_CLS_TYPE3_PROB_011_oRDR_TRACKER_OBJ_011_oPCAN_RADAR_5a3e1a2b_Tx: ComSignalType=UINT8
            OBJ_CLS_TYPE4_011_oRDR_TRACKER_OBJ_011_oPCAN_RADAR_aa792087_Tx: ComSignalType=UINT8
            OBJ_CLS_TYPE4_PROB_011_oRDR_TRACKER_OBJ_011_oPCAN_RADAR_5434dc8b_Tx: ComSignalType=UINT8
            OBJ_CLS_TYPE5_011_oRDR_TRACKER_OBJ_011_oPCAN_RADAR_27f1dd65_Tx: ComSignalType=UINT8
            OBJ_CLS_TYPE5_PROB_011_oRDR_TRACKER_OBJ_011_oPCAN_RADAR_13272a70_Tx: ComSignalType=UINT8
            OBJ_CLS_TYPE6_011_oRDR_TRACKER_OBJ_011_oPCAN_RADAR_6a19dd02_Tx: ComSignalType=UINT8
            OBJ_CLS_TYPE6_PROB_011_oRDR_TRACKER_OBJ_011_oPCAN_RADAR_da13317d_Tx: ComSignalType=UINT8
            OBJ_DIMENSION_LENGTH_011_oRDR_TRACKER_OBJ_011_oPCAN_RADAR_3edf736a_Tx: ComSignalType=UINT16
            OBJ_DIMENSION_LENGTH_ERR_011_oRDR_TRACKER_OBJ_011_oPCAN_RADAR_05276c10_Tx: ComSignalType=UINT16
            OBJ_DIMENSION_WIDTH_011_oRDR_TRACKER_OBJ_011_oPCAN_RADAR_1d1184c7_Tx: ComSignalType=UINT16
            OBJ_DIMENSION_WIDTH_ERR_011_oRDR_TRACKER_OBJ_011_oPCAN_RADAR_fdb3432f_Tx: ComSignalType=UINT8
            OBJ_EXISTENCE_PROB_011_oRDR_TRACKER_OBJ_011_oPCAN_RADAR_16ad00fa_Tx: ComSignalType=UINT16
            OBJ_GROUP_ID_011_oRDR_TRACKER_OBJ_011_oPCAN_RADAR_9fdf1457_Tx: ComSignalType=UINT8
            OBJ_ID_011_oRDR_TRACKER_OBJ_011_oPCAN_RADAR_6cf13f50_Tx: ComSignalType=UINT8
            OBJ_MEASUREMENT_STATUS_011_oRDR_TRACKER_OBJ_011_oPCAN_RADAR_13234ded_Tx: ComSignalType=UINT8
            OBJ_MH_CRC16_011_oRDR_TRACKER_OBJ_011_oPCAN_RADAR_6f43fad1_Tx: ComSignalType=UINT16
            OBJ_MH_CYCLE_COUNTER_011_oRDR_TRACKER_OBJ_011_oPCAN_RADAR_1ea7a030_Tx: ComSignalType=UINT8
            OBJ_MOVEMENT_STATUS_011_oRDR_TRACKER_OBJ_011_oPCAN_RADAR_3c8dd8a1_Tx: ComSignalType=UINT8
            OBJ_POS_ERR_CRR_COEF_011_oRDR_TRACKER_OBJ_011_oPCAN_RADAR_acf2189b_Tx: ComSignalType=UINT8
            OBJ_POS_LAT_011_oRDR_TRACKER_OBJ_011_oPCAN_RADAR_4e5de5d7_Tx: ComSignalType=UINT16
            OBJ_POS_LAT_ERR_011_oRDR_TRACKER_OBJ_011_oPCAN_RADAR_4a11b5e0_Tx: ComSignalType=UINT8
            OBJ_POS_LONG_011_oRDR_TRACKER_OBJ_011_oPCAN_RADAR_fffd0e18_Tx: ComSignalType=UINT16
            OBJ_POS_LONG_ERR_011_oRDR_TRACKER_OBJ_011_oPCAN_RADAR_d3e94b02_Tx: ComSignalType=UINT8
            OBJ_RCS_011_oRDR_TRACKER_OBJ_011_oPCAN_RADAR_6c92b3d0_Tx: ComSignalType=UINT8
            OBJ_REF_PT_LAT_OFFSET_011_oRDR_TRACKER_OBJ_011_oPCAN_RADAR_99afd8a5_Tx: ComSignalType=UINT16
            OBJ_REF_PT_LONG_OFFSET_011_oRDR_TRACKER_OBJ_011_oPCAN_RADAR_d6fd28a6_Tx: ComSignalType=UINT16
            OBJ_TIMESTAMP_OFFSET_011_oRDR_TRACKER_OBJ_011_oPCAN_RADAR_6c3eb386_Tx: ComSignalType=UINT8
            OBJ_TRACK_MOTION_MODEL_011_oRDR_TRACKER_OBJ_011_oPCAN_RADAR_a03db25b_Tx: ComSignalType=UINT8
            OBJ_VEH_TRACK_FLAG_011_oRDR_TRACKER_OBJ_011_oPCAN_RADAR_22174406_Tx: ComSignalType=BOOLEAN
            OBJ_VELOCITY_ERR_CRR_COEF_011_oRDR_TRACKER_OBJ_011_oPCAN_RADAR_0588257a_Tx: ComSignalType=UINT8
            OBJ_VELOCITY_LAT_011_oRDR_TRACKER_OBJ_011_oPCAN_RADAR_0a3ea0f0_Tx: ComSignalType=UINT16
            OBJ_VELOCITY_LAT_ERR_011_oRDR_TRACKER_OBJ_011_oPCAN_RADAR_3ec4d0a1_Tx: ComSignalType=UINT8
            OBJ_VELOCITY_LONG_011_oRDR_TRACKER_OBJ_011_oPCAN_RADAR_5ab3d836_Tx: ComSignalType=UINT16
            OBJ_VELOCITY_LONG_ERR_011_oRDR_TRACKER_OBJ_011_oPCAN_RADAR_d246ef61_Tx: ComSignalType=UINT8
            OBJ_YAW_ANGLE_011_oRDR_TRACKER_OBJ_011_oPCAN_RADAR_e682e4b0_Tx: ComSignalType=UINT16
            OBJ_YAW_ANGLE_ERR_011_oRDR_TRACKER_OBJ_011_oPCAN_RADAR_338fe267_Tx: ComSignalType=UINT8
            OBJ_YAW_RATE_011_oRDR_TRACKER_OBJ_011_oPCAN_RADAR_c30dc1f7_Tx: ComSignalType=UINT16
            OBJ_YAW_RATE_ERR_011_oRDR_TRACKER_OBJ_011_oPCAN_RADAR_fcd5562b_Tx: ComSignalType=UINT8
        SG_TrackerObject012_oRDR_TRACKER_OBJ_012_oPCAN_RADAR_276317b7_Tx
          49 x ComGroupSignal:
            OBJ_ACCELERATION_LAT_012_oRDR_TRACKER_OBJ_012_oPCAN_RADAR_29474cc0_Tx: ComSignalType=UINT16
            OBJ_ACCELERATION_LAT_ERR_012_oRDR_TRACKER_OBJ_012_oPCAN_RADAR_fcb3767e_Tx: ComSignalType=UINT8
            OBJ_ACCELERATION_LONG_012_oRDR_TRACKER_OBJ_012_oPCAN_RADAR_5bb71520_Tx: ComSignalType=UINT16
            OBJ_ACCELERATION_LONG_ERR_012_oRDR_TRACKER_OBJ_012_oPCAN_RADAR_e316d3d4_Tx: ComSignalType=UINT8
            OBJ_ACCEL_ERR_CRR_COEF_012_oRDR_TRACKER_OBJ_012_oPCAN_RADAR_43b5f2b2_Tx: ComSignalType=UINT8
            OBJ_ALIVE_TIME_012_oRDR_TRACKER_OBJ_012_oPCAN_RADAR_3bd65e9c_Tx: ComSignalType=UINT16
            OBJ_CLS_TYPE1_012_oRDR_TRACKER_OBJ_012_oPCAN_RADAR_ac0dbfba_Tx: ComSignalType=UINT8
            OBJ_CLS_TYPE1_PROB_012_oRDR_TRACKER_OBJ_012_oPCAN_RADAR_04556849_Tx: ComSignalType=UINT8
            OBJ_CLS_TYPE2_012_oRDR_TRACKER_OBJ_012_oPCAN_RADAR_e1e5bfdd_Tx: ComSignalType=UINT8
            OBJ_CLS_TYPE2_PROB_012_oRDR_TRACKER_OBJ_012_oPCAN_RADAR_cd617344_Tx: ComSignalType=UINT8
            OBJ_CLS_TYPE3_012_oRDR_TRACKER_OBJ_012_oPCAN_RADAR_6c6d423f_Tx: ComSignalType=UINT8
            OBJ_CLS_TYPE3_PROB_012_oRDR_TRACKER_OBJ_012_oPCAN_RADAR_8a7285bf_Tx: ComSignalType=UINT8
            OBJ_CLS_TYPE4_012_oRDR_TRACKER_OBJ_012_oPCAN_RADAR_7a35bf13_Tx: ComSignalType=UINT8
            OBJ_CLS_TYPE4_PROB_012_oRDR_TRACKER_OBJ_012_oPCAN_RADAR_8478431f_Tx: ComSignalType=UINT8
            OBJ_CLS_TYPE5_012_oRDR_TRACKER_OBJ_012_oPCAN_RADAR_f7bd42f1_Tx: ComSignalType=UINT8
            OBJ_CLS_TYPE5_PROB_012_oRDR_TRACKER_OBJ_012_oPCAN_RADAR_c36bb5e4_Tx: ComSignalType=UINT8
            OBJ_CLS_TYPE6_012_oRDR_TRACKER_OBJ_012_oPCAN_RADAR_ba554296_Tx: ComSignalType=UINT8
            OBJ_CLS_TYPE6_PROB_012_oRDR_TRACKER_OBJ_012_oPCAN_RADAR_0a5faee9_Tx: ComSignalType=UINT8
            OBJ_DIMENSION_LENGTH_012_oRDR_TRACKER_OBJ_012_oPCAN_RADAR_ee93ecfe_Tx: ComSignalType=UINT16
            OBJ_DIMENSION_LENGTH_ERR_012_oRDR_TRACKER_OBJ_012_oPCAN_RADAR_d56bf384_Tx: ComSignalType=UINT16
            OBJ_DIMENSION_WIDTH_012_oRDR_TRACKER_OBJ_012_oPCAN_RADAR_cd5d1b53_Tx: ComSignalType=UINT16
            OBJ_DIMENSION_WIDTH_ERR_012_oRDR_TRACKER_OBJ_012_oPCAN_RADAR_2dffdcbb_Tx: ComSignalType=UINT8
            OBJ_EXISTENCE_PROB_012_oRDR_TRACKER_OBJ_012_oPCAN_RADAR_c6e19f6e_Tx: ComSignalType=UINT16
            OBJ_GROUP_ID_012_oRDR_TRACKER_OBJ_012_oPCAN_RADAR_4f938bc3_Tx: ComSignalType=UINT8
            OBJ_ID_012_oRDR_TRACKER_OBJ_012_oPCAN_RADAR_bcbda0c4_Tx: ComSignalType=UINT8
            OBJ_MEASUREMENT_STATUS_012_oRDR_TRACKER_OBJ_012_oPCAN_RADAR_c36fd279_Tx: ComSignalType=UINT8
            OBJ_MH_CRC16_012_oRDR_TRACKER_OBJ_012_oPCAN_RADAR_bf0f6545_Tx: ComSignalType=UINT16
            OBJ_MH_CYCLE_COUNTER_012_oRDR_TRACKER_OBJ_012_oPCAN_RADAR_ceeb3fa4_Tx: ComSignalType=UINT8
            OBJ_MOVEMENT_STATUS_012_oRDR_TRACKER_OBJ_012_oPCAN_RADAR_ecc14735_Tx: ComSignalType=UINT8
            OBJ_POS_ERR_CRR_COEF_012_oRDR_TRACKER_OBJ_012_oPCAN_RADAR_7cbe870f_Tx: ComSignalType=UINT8
            OBJ_POS_LAT_012_oRDR_TRACKER_OBJ_012_oPCAN_RADAR_9e117a43_Tx: ComSignalType=UINT16
            OBJ_POS_LAT_ERR_012_oRDR_TRACKER_OBJ_012_oPCAN_RADAR_9a5d2a74_Tx: ComSignalType=UINT8
            OBJ_POS_LONG_012_oRDR_TRACKER_OBJ_012_oPCAN_RADAR_2fb1918c_Tx: ComSignalType=UINT16
            OBJ_POS_LONG_ERR_012_oRDR_TRACKER_OBJ_012_oPCAN_RADAR_03a5d496_Tx: ComSignalType=UINT8
            OBJ_RCS_012_oRDR_TRACKER_OBJ_012_oPCAN_RADAR_bcde2c44_Tx: ComSignalType=UINT8
            OBJ_REF_PT_LAT_OFFSET_012_oRDR_TRACKER_OBJ_012_oPCAN_RADAR_49e34731_Tx: ComSignalType=UINT16
            OBJ_REF_PT_LONG_OFFSET_012_oRDR_TRACKER_OBJ_012_oPCAN_RADAR_06b1b732_Tx: ComSignalType=UINT16
            OBJ_TIMESTAMP_OFFSET_012_oRDR_TRACKER_OBJ_012_oPCAN_RADAR_bc722c12_Tx: ComSignalType=UINT8
            OBJ_TRACK_MOTION_MODEL_012_oRDR_TRACKER_OBJ_012_oPCAN_RADAR_70712dcf_Tx: ComSignalType=UINT8
            OBJ_VEH_TRACK_FLAG_012_oRDR_TRACKER_OBJ_012_oPCAN_RADAR_f25bdb92_Tx: ComSignalType=BOOLEAN
            OBJ_VELOCITY_ERR_CRR_COEF_012_oRDR_TRACKER_OBJ_012_oPCAN_RADAR_d5c4baee_Tx: ComSignalType=UINT8
            OBJ_VELOCITY_LAT_012_oRDR_TRACKER_OBJ_012_oPCAN_RADAR_da723f64_Tx: ComSignalType=UINT16
            OBJ_VELOCITY_LAT_ERR_012_oRDR_TRACKER_OBJ_012_oPCAN_RADAR_ee884f35_Tx: ComSignalType=UINT8
            OBJ_VELOCITY_LONG_012_oRDR_TRACKER_OBJ_012_oPCAN_RADAR_8aff47a2_Tx: ComSignalType=UINT16
            OBJ_VELOCITY_LONG_ERR_012_oRDR_TRACKER_OBJ_012_oPCAN_RADAR_020a70f5_Tx: ComSignalType=UINT8
            OBJ_YAW_ANGLE_012_oRDR_TRACKER_OBJ_012_oPCAN_RADAR_36ce7b24_Tx: ComSignalType=UINT16
            OBJ_YAW_ANGLE_ERR_012_oRDR_TRACKER_OBJ_012_oPCAN_RADAR_e3c37df3_Tx: ComSignalType=UINT8
            OBJ_YAW_RATE_012_oRDR_TRACKER_OBJ_012_oPCAN_RADAR_13415e63_Tx: ComSignalType=UINT16
            OBJ_YAW_RATE_ERR_012_oRDR_TRACKER_OBJ_012_oPCAN_RADAR_2c99c9bf_Tx: ComSignalType=UINT8
        SG_TrackerObject013_oRDR_TRACKER_OBJ_013_oPCAN_RADAR_de779f04_Tx
          49 x ComGroupSignal:
            OBJ_ACCELERATION_LAT_013_oRDR_TRACKER_OBJ_013_oPCAN_RADAR_d053c473_Tx: ComSignalType=UINT16
            OBJ_ACCELERATION_LAT_ERR_013_oRDR_TRACKER_OBJ_013_oPCAN_RADAR_05a7fecd_Tx: ComSignalType=UINT8
            OBJ_ACCELERATION_LONG_013_oRDR_TRACKER_OBJ_013_oPCAN_RADAR_a2a39d93_Tx: ComSignalType=UINT16
            OBJ_ACCELERATION_LONG_ERR_013_oRDR_TRACKER_OBJ_013_oPCAN_RADAR_1a025b67_Tx: ComSignalType=UINT8
            OBJ_ACCEL_ERR_CRR_COEF_013_oRDR_TRACKER_OBJ_013_oPCAN_RADAR_baa17a01_Tx: ComSignalType=UINT8
            OBJ_ALIVE_TIME_013_oRDR_TRACKER_OBJ_013_oPCAN_RADAR_c2c2d62f_Tx: ComSignalType=UINT16
            OBJ_CLS_TYPE1_013_oRDR_TRACKER_OBJ_013_oPCAN_RADAR_55193709_Tx: ComSignalType=UINT8
            OBJ_CLS_TYPE1_PROB_013_oRDR_TRACKER_OBJ_013_oPCAN_RADAR_fd41e0fa_Tx: ComSignalType=UINT8
            OBJ_CLS_TYPE2_013_oRDR_TRACKER_OBJ_013_oPCAN_RADAR_18f1376e_Tx: ComSignalType=UINT8
            OBJ_CLS_TYPE2_PROB_013_oRDR_TRACKER_OBJ_013_oPCAN_RADAR_3475fbf7_Tx: ComSignalType=UINT8
            OBJ_CLS_TYPE3_013_oRDR_TRACKER_OBJ_013_oPCAN_RADAR_9579ca8c_Tx: ComSignalType=UINT8
            OBJ_CLS_TYPE3_PROB_013_oRDR_TRACKER_OBJ_013_oPCAN_RADAR_73660d0c_Tx: ComSignalType=UINT8
            OBJ_CLS_TYPE4_013_oRDR_TRACKER_OBJ_013_oPCAN_RADAR_832137a0_Tx: ComSignalType=UINT8
            OBJ_CLS_TYPE4_PROB_013_oRDR_TRACKER_OBJ_013_oPCAN_RADAR_7d6ccbac_Tx: ComSignalType=UINT8
            OBJ_CLS_TYPE5_013_oRDR_TRACKER_OBJ_013_oPCAN_RADAR_0ea9ca42_Tx: ComSignalType=UINT8
            OBJ_CLS_TYPE5_PROB_013_oRDR_TRACKER_OBJ_013_oPCAN_RADAR_3a7f3d57_Tx: ComSignalType=UINT8
            OBJ_CLS_TYPE6_013_oRDR_TRACKER_OBJ_013_oPCAN_RADAR_4341ca25_Tx: ComSignalType=UINT8
            OBJ_CLS_TYPE6_PROB_013_oRDR_TRACKER_OBJ_013_oPCAN_RADAR_f34b265a_Tx: ComSignalType=UINT8
            OBJ_DIMENSION_LENGTH_013_oRDR_TRACKER_OBJ_013_oPCAN_RADAR_1787644d_Tx: ComSignalType=UINT16
            OBJ_DIMENSION_LENGTH_ERR_013_oRDR_TRACKER_OBJ_013_oPCAN_RADAR_2c7f7b37_Tx: ComSignalType=UINT16
            OBJ_DIMENSION_WIDTH_013_oRDR_TRACKER_OBJ_013_oPCAN_RADAR_344993e0_Tx: ComSignalType=UINT16
            OBJ_DIMENSION_WIDTH_ERR_013_oRDR_TRACKER_OBJ_013_oPCAN_RADAR_d4eb5408_Tx: ComSignalType=UINT8
            OBJ_EXISTENCE_PROB_013_oRDR_TRACKER_OBJ_013_oPCAN_RADAR_3ff517dd_Tx: ComSignalType=UINT16
            OBJ_GROUP_ID_013_oRDR_TRACKER_OBJ_013_oPCAN_RADAR_b6870370_Tx: ComSignalType=UINT8
            OBJ_ID_013_oRDR_TRACKER_OBJ_013_oPCAN_RADAR_45a92877_Tx: ComSignalType=UINT8
            OBJ_MEASUREMENT_STATUS_013_oRDR_TRACKER_OBJ_013_oPCAN_RADAR_3a7b5aca_Tx: ComSignalType=UINT8
            OBJ_MH_CRC16_013_oRDR_TRACKER_OBJ_013_oPCAN_RADAR_461bedf6_Tx: ComSignalType=UINT16
            OBJ_MH_CYCLE_COUNTER_013_oRDR_TRACKER_OBJ_013_oPCAN_RADAR_37ffb717_Tx: ComSignalType=UINT8
            OBJ_MOVEMENT_STATUS_013_oRDR_TRACKER_OBJ_013_oPCAN_RADAR_15d5cf86_Tx: ComSignalType=UINT8
            OBJ_POS_ERR_CRR_COEF_013_oRDR_TRACKER_OBJ_013_oPCAN_RADAR_85aa0fbc_Tx: ComSignalType=UINT8
            OBJ_POS_LAT_013_oRDR_TRACKER_OBJ_013_oPCAN_RADAR_6705f2f0_Tx: ComSignalType=UINT16
            OBJ_POS_LAT_ERR_013_oRDR_TRACKER_OBJ_013_oPCAN_RADAR_6349a2c7_Tx: ComSignalType=UINT8
            OBJ_POS_LONG_013_oRDR_TRACKER_OBJ_013_oPCAN_RADAR_d6a5193f_Tx: ComSignalType=UINT16
            OBJ_POS_LONG_ERR_013_oRDR_TRACKER_OBJ_013_oPCAN_RADAR_fab15c25_Tx: ComSignalType=UINT8
            OBJ_RCS_013_oRDR_TRACKER_OBJ_013_oPCAN_RADAR_45caa4f7_Tx: ComSignalType=UINT8
            OBJ_REF_PT_LAT_OFFSET_013_oRDR_TRACKER_OBJ_013_oPCAN_RADAR_b0f7cf82_Tx: ComSignalType=UINT16
            OBJ_REF_PT_LONG_OFFSET_013_oRDR_TRACKER_OBJ_013_oPCAN_RADAR_ffa53f81_Tx: ComSignalType=UINT16
            OBJ_TIMESTAMP_OFFSET_013_oRDR_TRACKER_OBJ_013_oPCAN_RADAR_4566a4a1_Tx: ComSignalType=UINT8
            OBJ_TRACK_MOTION_MODEL_013_oRDR_TRACKER_OBJ_013_oPCAN_RADAR_8965a57c_Tx: ComSignalType=UINT8
            OBJ_VEH_TRACK_FLAG_013_oRDR_TRACKER_OBJ_013_oPCAN_RADAR_0b4f5321_Tx: ComSignalType=BOOLEAN
            OBJ_VELOCITY_ERR_CRR_COEF_013_oRDR_TRACKER_OBJ_013_oPCAN_RADAR_2cd0325d_Tx: ComSignalType=UINT8
            OBJ_VELOCITY_LAT_013_oRDR_TRACKER_OBJ_013_oPCAN_RADAR_2366b7d7_Tx: ComSignalType=UINT16
            OBJ_VELOCITY_LAT_ERR_013_oRDR_TRACKER_OBJ_013_oPCAN_RADAR_179cc786_Tx: ComSignalType=UINT8
            OBJ_VELOCITY_LONG_013_oRDR_TRACKER_OBJ_013_oPCAN_RADAR_73ebcf11_Tx: ComSignalType=UINT16
            OBJ_VELOCITY_LONG_ERR_013_oRDR_TRACKER_OBJ_013_oPCAN_RADAR_fb1ef846_Tx: ComSignalType=UINT8
            OBJ_YAW_ANGLE_013_oRDR_TRACKER_OBJ_013_oPCAN_RADAR_cfdaf397_Tx: ComSignalType=UINT16
            OBJ_YAW_ANGLE_ERR_013_oRDR_TRACKER_OBJ_013_oPCAN_RADAR_1ad7f540_Tx: ComSignalType=UINT8
            OBJ_YAW_RATE_013_oRDR_TRACKER_OBJ_013_oPCAN_RADAR_ea55d6d0_Tx: ComSignalType=UINT16
            OBJ_YAW_RATE_ERR_013_oRDR_TRACKER_OBJ_013_oPCAN_RADAR_d58d410c_Tx: ComSignalType=UINT8
        SG_TrackerObject014_oRDR_TRACKER_OBJ_014_oPCAN_RADAR_5c8b2ede_Tx
          49 x ComGroupSignal:
            OBJ_ACCELERATION_LAT_014_oRDR_TRACKER_OBJ_014_oPCAN_RADAR_52af75a9_Tx: ComSignalType=UINT16
            OBJ_ACCELERATION_LAT_ERR_014_oRDR_TRACKER_OBJ_014_oPCAN_RADAR_875b4f17_Tx: ComSignalType=UINT8
            OBJ_ACCELERATION_LONG_014_oRDR_TRACKER_OBJ_014_oPCAN_RADAR_205f2c49_Tx: ComSignalType=UINT16
            OBJ_ACCELERATION_LONG_ERR_014_oRDR_TRACKER_OBJ_014_oPCAN_RADAR_98feeabd_Tx: ComSignalType=UINT8
            OBJ_ACCEL_ERR_CRR_COEF_014_oRDR_TRACKER_OBJ_014_oPCAN_RADAR_385dcbdb_Tx: ComSignalType=UINT8
            OBJ_ALIVE_TIME_014_oRDR_TRACKER_OBJ_014_oPCAN_RADAR_403e67f5_Tx: ComSignalType=UINT16
            OBJ_CLS_TYPE1_014_oRDR_TRACKER_OBJ_014_oPCAN_RADAR_d7e586d3_Tx: ComSignalType=UINT8
            OBJ_CLS_TYPE1_PROB_014_oRDR_TRACKER_OBJ_014_oPCAN_RADAR_7fbd5120_Tx: ComSignalType=UINT8
            OBJ_CLS_TYPE2_014_oRDR_TRACKER_OBJ_014_oPCAN_RADAR_9a0d86b4_Tx: ComSignalType=UINT8
            OBJ_CLS_TYPE2_PROB_014_oRDR_TRACKER_OBJ_014_oPCAN_RADAR_b6894a2d_Tx: ComSignalType=UINT8
            OBJ_CLS_TYPE3_014_oRDR_TRACKER_OBJ_014_oPCAN_RADAR_17857b56_Tx: ComSignalType=UINT8
            OBJ_CLS_TYPE3_PROB_014_oRDR_TRACKER_OBJ_014_oPCAN_RADAR_f19abcd6_Tx: ComSignalType=UINT8
            OBJ_CLS_TYPE4_014_oRDR_TRACKER_OBJ_014_oPCAN_RADAR_01dd867a_Tx: ComSignalType=UINT8
            OBJ_CLS_TYPE4_PROB_014_oRDR_TRACKER_OBJ_014_oPCAN_RADAR_ff907a76_Tx: ComSignalType=UINT8
            OBJ_CLS_TYPE5_014_oRDR_TRACKER_OBJ_014_oPCAN_RADAR_8c557b98_Tx: ComSignalType=UINT8
            OBJ_CLS_TYPE5_PROB_014_oRDR_TRACKER_OBJ_014_oPCAN_RADAR_b8838c8d_Tx: ComSignalType=UINT8
            OBJ_CLS_TYPE6_014_oRDR_TRACKER_OBJ_014_oPCAN_RADAR_c1bd7bff_Tx: ComSignalType=UINT8
            OBJ_CLS_TYPE6_PROB_014_oRDR_TRACKER_OBJ_014_oPCAN_RADAR_71b79780_Tx: ComSignalType=UINT8
            OBJ_DIMENSION_LENGTH_014_oRDR_TRACKER_OBJ_014_oPCAN_RADAR_957bd597_Tx: ComSignalType=UINT16
            OBJ_DIMENSION_LENGTH_ERR_014_oRDR_TRACKER_OBJ_014_oPCAN_RADAR_ae83caed_Tx: ComSignalType=UINT16
            OBJ_DIMENSION_WIDTH_014_oRDR_TRACKER_OBJ_014_oPCAN_RADAR_b6b5223a_Tx: ComSignalType=UINT16
            OBJ_DIMENSION_WIDTH_ERR_014_oRDR_TRACKER_OBJ_014_oPCAN_RADAR_5617e5d2_Tx: ComSignalType=UINT8
            OBJ_EXISTENCE_PROB_014_oRDR_TRACKER_OBJ_014_oPCAN_RADAR_bd09a607_Tx: ComSignalType=UINT16
            OBJ_GROUP_ID_014_oRDR_TRACKER_OBJ_014_oPCAN_RADAR_347bb2aa_Tx: ComSignalType=UINT8
            OBJ_ID_014_oRDR_TRACKER_OBJ_014_oPCAN_RADAR_c75599ad_Tx: ComSignalType=UINT8
            OBJ_MEASUREMENT_STATUS_014_oRDR_TRACKER_OBJ_014_oPCAN_RADAR_b887eb10_Tx: ComSignalType=UINT8
            OBJ_MH_CRC16_014_oRDR_TRACKER_OBJ_014_oPCAN_RADAR_c4e75c2c_Tx: ComSignalType=UINT16
            OBJ_MH_CYCLE_COUNTER_014_oRDR_TRACKER_OBJ_014_oPCAN_RADAR_b50306cd_Tx: ComSignalType=UINT8
            OBJ_MOVEMENT_STATUS_014_oRDR_TRACKER_OBJ_014_oPCAN_RADAR_97297e5c_Tx: ComSignalType=UINT8
            OBJ_POS_ERR_CRR_COEF_014_oRDR_TRACKER_OBJ_014_oPCAN_RADAR_0756be66_Tx: ComSignalType=UINT8
            OBJ_POS_LAT_014_oRDR_TRACKER_OBJ_014_oPCAN_RADAR_e5f9432a_Tx: ComSignalType=UINT16
            OBJ_POS_LAT_ERR_014_oRDR_TRACKER_OBJ_014_oPCAN_RADAR_e1b5131d_Tx: ComSignalType=UINT8
            OBJ_POS_LONG_014_oRDR_TRACKER_OBJ_014_oPCAN_RADAR_5459a8e5_Tx: ComSignalType=UINT16
            OBJ_POS_LONG_ERR_014_oRDR_TRACKER_OBJ_014_oPCAN_RADAR_784dedff_Tx: ComSignalType=UINT8
            OBJ_RCS_014_oRDR_TRACKER_OBJ_014_oPCAN_RADAR_c736152d_Tx: ComSignalType=UINT8
            OBJ_REF_PT_LAT_OFFSET_014_oRDR_TRACKER_OBJ_014_oPCAN_RADAR_320b7e58_Tx: ComSignalType=UINT16
            OBJ_REF_PT_LONG_OFFSET_014_oRDR_TRACKER_OBJ_014_oPCAN_RADAR_7d598e5b_Tx: ComSignalType=UINT16
            OBJ_TIMESTAMP_OFFSET_014_oRDR_TRACKER_OBJ_014_oPCAN_RADAR_c79a157b_Tx: ComSignalType=UINT8
            OBJ_TRACK_MOTION_MODEL_014_oRDR_TRACKER_OBJ_014_oPCAN_RADAR_0b9914a6_Tx: ComSignalType=UINT8
            OBJ_VEH_TRACK_FLAG_014_oRDR_TRACKER_OBJ_014_oPCAN_RADAR_89b3e2fb_Tx: ComSignalType=BOOLEAN
            OBJ_VELOCITY_ERR_CRR_COEF_014_oRDR_TRACKER_OBJ_014_oPCAN_RADAR_ae2c8387_Tx: ComSignalType=UINT8
            OBJ_VELOCITY_LAT_014_oRDR_TRACKER_OBJ_014_oPCAN_RADAR_a19a060d_Tx: ComSignalType=UINT16
            OBJ_VELOCITY_LAT_ERR_014_oRDR_TRACKER_OBJ_014_oPCAN_RADAR_9560765c_Tx: ComSignalType=UINT8
            OBJ_VELOCITY_LONG_014_oRDR_TRACKER_OBJ_014_oPCAN_RADAR_f1177ecb_Tx: ComSignalType=UINT16
            OBJ_VELOCITY_LONG_ERR_014_oRDR_TRACKER_OBJ_014_oPCAN_RADAR_79e2499c_Tx: ComSignalType=UINT8
            OBJ_YAW_ANGLE_014_oRDR_TRACKER_OBJ_014_oPCAN_RADAR_4d26424d_Tx: ComSignalType=UINT16
            OBJ_YAW_ANGLE_ERR_014_oRDR_TRACKER_OBJ_014_oPCAN_RADAR_982b449a_Tx: ComSignalType=UINT8
            OBJ_YAW_RATE_014_oRDR_TRACKER_OBJ_014_oPCAN_RADAR_68a9670a_Tx: ComSignalType=UINT16
            OBJ_YAW_RATE_ERR_014_oRDR_TRACKER_OBJ_014_oPCAN_RADAR_5771f0d6_Tx: ComSignalType=UINT8
        SG_TrackerObject015_oRDR_TRACKER_OBJ_015_oPCAN_RADAR_a59fa66d_Tx
          49 x ComGroupSignal:
            OBJ_ACCELERATION_LAT_015_oRDR_TRACKER_OBJ_015_oPCAN_RADAR_abbbfd1a_Tx: ComSignalType=UINT16
            OBJ_ACCELERATION_LAT_ERR_015_oRDR_TRACKER_OBJ_015_oPCAN_RADAR_7e4fc7a4_Tx: ComSignalType=UINT8
            OBJ_ACCELERATION_LONG_015_oRDR_TRACKER_OBJ_015_oPCAN_RADAR_d94ba4fa_Tx: ComSignalType=UINT16
            OBJ_ACCELERATION_LONG_ERR_015_oRDR_TRACKER_OBJ_015_oPCAN_RADAR_61ea620e_Tx: ComSignalType=UINT8
            OBJ_ACCEL_ERR_CRR_COEF_015_oRDR_TRACKER_OBJ_015_oPCAN_RADAR_c1494368_Tx: ComSignalType=UINT8
            OBJ_ALIVE_TIME_015_oRDR_TRACKER_OBJ_015_oPCAN_RADAR_b92aef46_Tx: ComSignalType=UINT16
            OBJ_CLS_TYPE1_015_oRDR_TRACKER_OBJ_015_oPCAN_RADAR_2ef10e60_Tx: ComSignalType=UINT8
            OBJ_CLS_TYPE1_PROB_015_oRDR_TRACKER_OBJ_015_oPCAN_RADAR_86a9d993_Tx: ComSignalType=UINT8
            OBJ_CLS_TYPE2_015_oRDR_TRACKER_OBJ_015_oPCAN_RADAR_63190e07_Tx: ComSignalType=UINT8
            OBJ_CLS_TYPE2_PROB_015_oRDR_TRACKER_OBJ_015_oPCAN_RADAR_4f9dc29e_Tx: ComSignalType=UINT8
            OBJ_CLS_TYPE3_015_oRDR_TRACKER_OBJ_015_oPCAN_RADAR_ee91f3e5_Tx: ComSignalType=UINT8
            OBJ_CLS_TYPE3_PROB_015_oRDR_TRACKER_OBJ_015_oPCAN_RADAR_088e3465_Tx: ComSignalType=UINT8
            OBJ_CLS_TYPE4_015_oRDR_TRACKER_OBJ_015_oPCAN_RADAR_f8c90ec9_Tx: ComSignalType=UINT8
            OBJ_CLS_TYPE4_PROB_015_oRDR_TRACKER_OBJ_015_oPCAN_RADAR_0684f2c5_Tx: ComSignalType=UINT8
            OBJ_CLS_TYPE5_015_oRDR_TRACKER_OBJ_015_oPCAN_RADAR_7541f32b_Tx: ComSignalType=UINT8
            OBJ_CLS_TYPE5_PROB_015_oRDR_TRACKER_OBJ_015_oPCAN_RADAR_4197043e_Tx: ComSignalType=UINT8
            OBJ_CLS_TYPE6_015_oRDR_TRACKER_OBJ_015_oPCAN_RADAR_38a9f34c_Tx: ComSignalType=UINT8
            OBJ_CLS_TYPE6_PROB_015_oRDR_TRACKER_OBJ_015_oPCAN_RADAR_88a31f33_Tx: ComSignalType=UINT8
            OBJ_DIMENSION_LENGTH_015_oRDR_TRACKER_OBJ_015_oPCAN_RADAR_6c6f5d24_Tx: ComSignalType=UINT16
            OBJ_DIMENSION_LENGTH_ERR_015_oRDR_TRACKER_OBJ_015_oPCAN_RADAR_5797425e_Tx: ComSignalType=UINT16
            OBJ_DIMENSION_WIDTH_015_oRDR_TRACKER_OBJ_015_oPCAN_RADAR_4fa1aa89_Tx: ComSignalType=UINT16
            OBJ_DIMENSION_WIDTH_ERR_015_oRDR_TRACKER_OBJ_015_oPCAN_RADAR_af036d61_Tx: ComSignalType=UINT8
            OBJ_EXISTENCE_PROB_015_oRDR_TRACKER_OBJ_015_oPCAN_RADAR_441d2eb4_Tx: ComSignalType=UINT16
            OBJ_GROUP_ID_015_oRDR_TRACKER_OBJ_015_oPCAN_RADAR_cd6f3a19_Tx: ComSignalType=UINT8
            OBJ_ID_015_oRDR_TRACKER_OBJ_015_oPCAN_RADAR_3e41111e_Tx: ComSignalType=UINT8
            OBJ_MEASUREMENT_STATUS_015_oRDR_TRACKER_OBJ_015_oPCAN_RADAR_419363a3_Tx: ComSignalType=UINT8
            OBJ_MH_CRC16_015_oRDR_TRACKER_OBJ_015_oPCAN_RADAR_3df3d49f_Tx: ComSignalType=UINT16
            OBJ_MH_CYCLE_COUNTER_015_oRDR_TRACKER_OBJ_015_oPCAN_RADAR_4c178e7e_Tx: ComSignalType=UINT8
            OBJ_MOVEMENT_STATUS_015_oRDR_TRACKER_OBJ_015_oPCAN_RADAR_6e3df6ef_Tx: ComSignalType=UINT8
            OBJ_POS_ERR_CRR_COEF_015_oRDR_TRACKER_OBJ_015_oPCAN_RADAR_fe4236d5_Tx: ComSignalType=UINT8
            OBJ_POS_LAT_015_oRDR_TRACKER_OBJ_015_oPCAN_RADAR_1cedcb99_Tx: ComSignalType=UINT16
            OBJ_POS_LAT_ERR_015_oRDR_TRACKER_OBJ_015_oPCAN_RADAR_18a19bae_Tx: ComSignalType=UINT8
            OBJ_POS_LONG_015_oRDR_TRACKER_OBJ_015_oPCAN_RADAR_ad4d2056_Tx: ComSignalType=UINT16
            OBJ_POS_LONG_ERR_015_oRDR_TRACKER_OBJ_015_oPCAN_RADAR_8159654c_Tx: ComSignalType=UINT8
            OBJ_RCS_015_oRDR_TRACKER_OBJ_015_oPCAN_RADAR_3e229d9e_Tx: ComSignalType=UINT8
            OBJ_REF_PT_LAT_OFFSET_015_oRDR_TRACKER_OBJ_015_oPCAN_RADAR_cb1ff6eb_Tx: ComSignalType=UINT16
            OBJ_REF_PT_LONG_OFFSET_015_oRDR_TRACKER_OBJ_015_oPCAN_RADAR_844d06e8_Tx: ComSignalType=UINT16
            OBJ_TIMESTAMP_OFFSET_015_oRDR_TRACKER_OBJ_015_oPCAN_RADAR_3e8e9dc8_Tx: ComSignalType=UINT8
            OBJ_TRACK_MOTION_MODEL_015_oRDR_TRACKER_OBJ_015_oPCAN_RADAR_f28d9c15_Tx: ComSignalType=UINT8
            OBJ_VEH_TRACK_FLAG_015_oRDR_TRACKER_OBJ_015_oPCAN_RADAR_70a76a48_Tx: ComSignalType=BOOLEAN
            OBJ_VELOCITY_ERR_CRR_COEF_015_oRDR_TRACKER_OBJ_015_oPCAN_RADAR_57380b34_Tx: ComSignalType=UINT8
            OBJ_VELOCITY_LAT_015_oRDR_TRACKER_OBJ_015_oPCAN_RADAR_588e8ebe_Tx: ComSignalType=UINT16
            OBJ_VELOCITY_LAT_ERR_015_oRDR_TRACKER_OBJ_015_oPCAN_RADAR_6c74feef_Tx: ComSignalType=UINT8
            OBJ_VELOCITY_LONG_015_oRDR_TRACKER_OBJ_015_oPCAN_RADAR_0803f678_Tx: ComSignalType=UINT16
            OBJ_VELOCITY_LONG_ERR_015_oRDR_TRACKER_OBJ_015_oPCAN_RADAR_80f6c12f_Tx: ComSignalType=UINT8
            OBJ_YAW_ANGLE_015_oRDR_TRACKER_OBJ_015_oPCAN_RADAR_b432cafe_Tx: ComSignalType=UINT16
            OBJ_YAW_ANGLE_ERR_015_oRDR_TRACKER_OBJ_015_oPCAN_RADAR_613fcc29_Tx: ComSignalType=UINT8
            OBJ_YAW_RATE_015_oRDR_TRACKER_OBJ_015_oPCAN_RADAR_91bdefb9_Tx: ComSignalType=UINT16
            OBJ_YAW_RATE_ERR_015_oRDR_TRACKER_OBJ_015_oPCAN_RADAR_ae657865_Tx: ComSignalType=UINT8
        SG_TrackerObject016_oRDR_TRACKER_OBJ_016_oPCAN_RADAR_75d339f9_Tx
          49 x ComGroupSignal:
            OBJ_ACCELERATION_LAT_016_oRDR_TRACKER_OBJ_016_oPCAN_RADAR_7bf7628e_Tx: ComSignalType=UINT16
            OBJ_ACCELERATION_LAT_ERR_016_oRDR_TRACKER_OBJ_016_oPCAN_RADAR_ae035830_Tx: ComSignalType=UINT8
            OBJ_ACCELERATION_LONG_016_oRDR_TRACKER_OBJ_016_oPCAN_RADAR_09073b6e_Tx: ComSignalType=UINT16
            OBJ_ACCELERATION_LONG_ERR_016_oRDR_TRACKER_OBJ_016_oPCAN_RADAR_b1a6fd9a_Tx: ComSignalType=UINT8
            OBJ_ACCEL_ERR_CRR_COEF_016_oRDR_TRACKER_OBJ_016_oPCAN_RADAR_1105dcfc_Tx: ComSignalType=UINT8
            OBJ_ALIVE_TIME_016_oRDR_TRACKER_OBJ_016_oPCAN_RADAR_696670d2_Tx: ComSignalType=UINT16
            OBJ_CLS_TYPE1_016_oRDR_TRACKER_OBJ_016_oPCAN_RADAR_febd91f4_Tx: ComSignalType=UINT8
            OBJ_CLS_TYPE1_PROB_016_oRDR_TRACKER_OBJ_016_oPCAN_RADAR_56e54607_Tx: ComSignalType=UINT8
            OBJ_CLS_TYPE2_016_oRDR_TRACKER_OBJ_016_oPCAN_RADAR_b3559193_Tx: ComSignalType=UINT8
            OBJ_CLS_TYPE2_PROB_016_oRDR_TRACKER_OBJ_016_oPCAN_RADAR_9fd15d0a_Tx: ComSignalType=UINT8
            OBJ_CLS_TYPE3_016_oRDR_TRACKER_OBJ_016_oPCAN_RADAR_3edd6c71_Tx: ComSignalType=UINT8
            OBJ_CLS_TYPE3_PROB_016_oRDR_TRACKER_OBJ_016_oPCAN_RADAR_d8c2abf1_Tx: ComSignalType=UINT8
            OBJ_CLS_TYPE4_016_oRDR_TRACKER_OBJ_016_oPCAN_RADAR_2885915d_Tx: ComSignalType=UINT8
            OBJ_CLS_TYPE4_PROB_016_oRDR_TRACKER_OBJ_016_oPCAN_RADAR_d6c86d51_Tx: ComSignalType=UINT8
            OBJ_CLS_TYPE5_016_oRDR_TRACKER_OBJ_016_oPCAN_RADAR_a50d6cbf_Tx: ComSignalType=UINT8
            OBJ_CLS_TYPE5_PROB_016_oRDR_TRACKER_OBJ_016_oPCAN_RADAR_91db9baa_Tx: ComSignalType=UINT8
            OBJ_CLS_TYPE6_016_oRDR_TRACKER_OBJ_016_oPCAN_RADAR_e8e56cd8_Tx: ComSignalType=UINT8
            OBJ_CLS_TYPE6_PROB_016_oRDR_TRACKER_OBJ_016_oPCAN_RADAR_58ef80a7_Tx: ComSignalType=UINT8
            OBJ_DIMENSION_LENGTH_016_oRDR_TRACKER_OBJ_016_oPCAN_RADAR_bc23c2b0_Tx: ComSignalType=UINT16
            OBJ_DIMENSION_LENGTH_ERR_016_oRDR_TRACKER_OBJ_016_oPCAN_RADAR_87dbddca_Tx: ComSignalType=UINT16
            OBJ_DIMENSION_WIDTH_016_oRDR_TRACKER_OBJ_016_oPCAN_RADAR_9fed351d_Tx: ComSignalType=UINT16
            OBJ_DIMENSION_WIDTH_ERR_016_oRDR_TRACKER_OBJ_016_oPCAN_RADAR_7f4ff2f5_Tx: ComSignalType=UINT8
            OBJ_EXISTENCE_PROB_016_oRDR_TRACKER_OBJ_016_oPCAN_RADAR_9451b120_Tx: ComSignalType=UINT16
            OBJ_GROUP_ID_016_oRDR_TRACKER_OBJ_016_oPCAN_RADAR_1d23a58d_Tx: ComSignalType=UINT8
            OBJ_ID_016_oRDR_TRACKER_OBJ_016_oPCAN_RADAR_ee0d8e8a_Tx: ComSignalType=UINT8
            OBJ_MEASUREMENT_STATUS_016_oRDR_TRACKER_OBJ_016_oPCAN_RADAR_91dffc37_Tx: ComSignalType=UINT8
            OBJ_MH_CRC16_016_oRDR_TRACKER_OBJ_016_oPCAN_RADAR_edbf4b0b_Tx: ComSignalType=UINT16
            OBJ_MH_CYCLE_COUNTER_016_oRDR_TRACKER_OBJ_016_oPCAN_RADAR_9c5b11ea_Tx: ComSignalType=UINT8
            OBJ_MOVEMENT_STATUS_016_oRDR_TRACKER_OBJ_016_oPCAN_RADAR_be71697b_Tx: ComSignalType=UINT8
            OBJ_POS_ERR_CRR_COEF_016_oRDR_TRACKER_OBJ_016_oPCAN_RADAR_2e0ea941_Tx: ComSignalType=UINT8
            OBJ_POS_LAT_016_oRDR_TRACKER_OBJ_016_oPCAN_RADAR_cca1540d_Tx: ComSignalType=UINT16
            OBJ_POS_LAT_ERR_016_oRDR_TRACKER_OBJ_016_oPCAN_RADAR_c8ed043a_Tx: ComSignalType=UINT8
            OBJ_POS_LONG_016_oRDR_TRACKER_OBJ_016_oPCAN_RADAR_7d01bfc2_Tx: ComSignalType=UINT16
            OBJ_POS_LONG_ERR_016_oRDR_TRACKER_OBJ_016_oPCAN_RADAR_5115fad8_Tx: ComSignalType=UINT8
            OBJ_RCS_016_oRDR_TRACKER_OBJ_016_oPCAN_RADAR_ee6e020a_Tx: ComSignalType=UINT8
            OBJ_REF_PT_LAT_OFFSET_016_oRDR_TRACKER_OBJ_016_oPCAN_RADAR_1b53697f_Tx: ComSignalType=UINT16
            OBJ_REF_PT_LONG_OFFSET_016_oRDR_TRACKER_OBJ_016_oPCAN_RADAR_5401997c_Tx: ComSignalType=UINT16
            OBJ_TIMESTAMP_OFFSET_016_oRDR_TRACKER_OBJ_016_oPCAN_RADAR_eec2025c_Tx: ComSignalType=UINT8
            OBJ_TRACK_MOTION_MODEL_016_oRDR_TRACKER_OBJ_016_oPCAN_RADAR_22c10381_Tx: ComSignalType=UINT8
            OBJ_VEH_TRACK_FLAG_016_oRDR_TRACKER_OBJ_016_oPCAN_RADAR_a0ebf5dc_Tx: ComSignalType=BOOLEAN
            OBJ_VELOCITY_ERR_CRR_COEF_016_oRDR_TRACKER_OBJ_016_oPCAN_RADAR_877494a0_Tx: ComSignalType=UINT8
            OBJ_VELOCITY_LAT_016_oRDR_TRACKER_OBJ_016_oPCAN_RADAR_88c2112a_Tx: ComSignalType=UINT16
            OBJ_VELOCITY_LAT_ERR_016_oRDR_TRACKER_OBJ_016_oPCAN_RADAR_bc38617b_Tx: ComSignalType=UINT8
            OBJ_VELOCITY_LONG_016_oRDR_TRACKER_OBJ_016_oPCAN_RADAR_d84f69ec_Tx: ComSignalType=UINT16
            OBJ_VELOCITY_LONG_ERR_016_oRDR_TRACKER_OBJ_016_oPCAN_RADAR_50ba5ebb_Tx: ComSignalType=UINT8
            OBJ_YAW_ANGLE_016_oRDR_TRACKER_OBJ_016_oPCAN_RADAR_647e556a_Tx: ComSignalType=UINT16
            OBJ_YAW_ANGLE_ERR_016_oRDR_TRACKER_OBJ_016_oPCAN_RADAR_b17353bd_Tx: ComSignalType=UINT8
            OBJ_YAW_RATE_016_oRDR_TRACKER_OBJ_016_oPCAN_RADAR_41f1702d_Tx: ComSignalType=UINT16
            OBJ_YAW_RATE_ERR_016_oRDR_TRACKER_OBJ_016_oPCAN_RADAR_7e29e7f1_Tx: ComSignalType=UINT8
        SG_TrackerObject017_oRDR_TRACKER_OBJ_017_oPCAN_RADAR_8cc7b14a_Tx
          49 x ComGroupSignal:
            OBJ_ACCELERATION_LAT_017_oRDR_TRACKER_OBJ_017_oPCAN_RADAR_82e3ea3d_Tx: ComSignalType=UINT16
            OBJ_ACCELERATION_LAT_ERR_017_oRDR_TRACKER_OBJ_017_oPCAN_RADAR_5717d083_Tx: ComSignalType=UINT8
            OBJ_ACCELERATION_LONG_017_oRDR_TRACKER_OBJ_017_oPCAN_RADAR_f013b3dd_Tx: ComSignalType=UINT16
            OBJ_ACCELERATION_LONG_ERR_017_oRDR_TRACKER_OBJ_017_oPCAN_RADAR_48b27529_Tx: ComSignalType=UINT8
            OBJ_ACCEL_ERR_CRR_COEF_017_oRDR_TRACKER_OBJ_017_oPCAN_RADAR_e811544f_Tx: ComSignalType=UINT8
            OBJ_ALIVE_TIME_017_oRDR_TRACKER_OBJ_017_oPCAN_RADAR_9072f861_Tx: ComSignalType=UINT16
            OBJ_CLS_TYPE1_017_oRDR_TRACKER_OBJ_017_oPCAN_RADAR_07a91947_Tx: ComSignalType=UINT8
            OBJ_CLS_TYPE1_PROB_017_oRDR_TRACKER_OBJ_017_oPCAN_RADAR_aff1ceb4_Tx: ComSignalType=UINT8
            OBJ_CLS_TYPE2_017_oRDR_TRACKER_OBJ_017_oPCAN_RADAR_4a411920_Tx: ComSignalType=UINT8
            OBJ_CLS_TYPE2_PROB_017_oRDR_TRACKER_OBJ_017_oPCAN_RADAR_66c5d5b9_Tx: ComSignalType=UINT8
            OBJ_CLS_TYPE3_017_oRDR_TRACKER_OBJ_017_oPCAN_RADAR_c7c9e4c2_Tx: ComSignalType=UINT8
            OBJ_CLS_TYPE3_PROB_017_oRDR_TRACKER_OBJ_017_oPCAN_RADAR_21d62342_Tx: ComSignalType=UINT8
            OBJ_CLS_TYPE4_017_oRDR_TRACKER_OBJ_017_oPCAN_RADAR_d19119ee_Tx: ComSignalType=UINT8
            OBJ_CLS_TYPE4_PROB_017_oRDR_TRACKER_OBJ_017_oPCAN_RADAR_2fdce5e2_Tx: ComSignalType=UINT8
            OBJ_CLS_TYPE5_017_oRDR_TRACKER_OBJ_017_oPCAN_RADAR_5c19e40c_Tx: ComSignalType=UINT8
            OBJ_CLS_TYPE5_PROB_017_oRDR_TRACKER_OBJ_017_oPCAN_RADAR_68cf1319_Tx: ComSignalType=UINT8
            OBJ_CLS_TYPE6_017_oRDR_TRACKER_OBJ_017_oPCAN_RADAR_11f1e46b_Tx: ComSignalType=UINT8
            OBJ_CLS_TYPE6_PROB_017_oRDR_TRACKER_OBJ_017_oPCAN_RADAR_a1fb0814_Tx: ComSignalType=UINT8
            OBJ_DIMENSION_LENGTH_017_oRDR_TRACKER_OBJ_017_oPCAN_RADAR_45374a03_Tx: ComSignalType=UINT16
            OBJ_DIMENSION_LENGTH_ERR_017_oRDR_TRACKER_OBJ_017_oPCAN_RADAR_7ecf5579_Tx: ComSignalType=UINT16
            OBJ_DIMENSION_WIDTH_017_oRDR_TRACKER_OBJ_017_oPCAN_RADAR_66f9bdae_Tx: ComSignalType=UINT16
            OBJ_DIMENSION_WIDTH_ERR_017_oRDR_TRACKER_OBJ_017_oPCAN_RADAR_865b7a46_Tx: ComSignalType=UINT8
            OBJ_EXISTENCE_PROB_017_oRDR_TRACKER_OBJ_017_oPCAN_RADAR_6d453993_Tx: ComSignalType=UINT16
            OBJ_GROUP_ID_017_oRDR_TRACKER_OBJ_017_oPCAN_RADAR_e4372d3e_Tx: ComSignalType=UINT8
            OBJ_ID_017_oRDR_TRACKER_OBJ_017_oPCAN_RADAR_17190639_Tx: ComSignalType=UINT8
            OBJ_MEASUREMENT_STATUS_017_oRDR_TRACKER_OBJ_017_oPCAN_RADAR_68cb7484_Tx: ComSignalType=UINT8
            OBJ_MH_CRC16_017_oRDR_TRACKER_OBJ_017_oPCAN_RADAR_14abc3b8_Tx: ComSignalType=UINT16
            OBJ_MH_CYCLE_COUNTER_017_oRDR_TRACKER_OBJ_017_oPCAN_RADAR_654f9959_Tx: ComSignalType=UINT8
            OBJ_MOVEMENT_STATUS_017_oRDR_TRACKER_OBJ_017_oPCAN_RADAR_4765e1c8_Tx: ComSignalType=UINT8
            OBJ_POS_ERR_CRR_COEF_017_oRDR_TRACKER_OBJ_017_oPCAN_RADAR_d71a21f2_Tx: ComSignalType=UINT8
            OBJ_POS_LAT_017_oRDR_TRACKER_OBJ_017_oPCAN_RADAR_35b5dcbe_Tx: ComSignalType=UINT16
            OBJ_POS_LAT_ERR_017_oRDR_TRACKER_OBJ_017_oPCAN_RADAR_31f98c89_Tx: ComSignalType=UINT8
            OBJ_POS_LONG_017_oRDR_TRACKER_OBJ_017_oPCAN_RADAR_84153771_Tx: ComSignalType=UINT16
            OBJ_POS_LONG_ERR_017_oRDR_TRACKER_OBJ_017_oPCAN_RADAR_a801726b_Tx: ComSignalType=UINT8
            OBJ_RCS_017_oRDR_TRACKER_OBJ_017_oPCAN_RADAR_177a8ab9_Tx: ComSignalType=UINT8
            OBJ_REF_PT_LAT_OFFSET_017_oRDR_TRACKER_OBJ_017_oPCAN_RADAR_e247e1cc_Tx: ComSignalType=UINT16
            OBJ_REF_PT_LONG_OFFSET_017_oRDR_TRACKER_OBJ_017_oPCAN_RADAR_ad1511cf_Tx: ComSignalType=UINT16
            OBJ_TIMESTAMP_OFFSET_017_oRDR_TRACKER_OBJ_017_oPCAN_RADAR_17d68aef_Tx: ComSignalType=UINT8
            OBJ_TRACK_MOTION_MODEL_017_oRDR_TRACKER_OBJ_017_oPCAN_RADAR_dbd58b32_Tx: ComSignalType=UINT8
            OBJ_VEH_TRACK_FLAG_017_oRDR_TRACKER_OBJ_017_oPCAN_RADAR_59ff7d6f_Tx: ComSignalType=BOOLEAN
            OBJ_VELOCITY_ERR_CRR_COEF_017_oRDR_TRACKER_OBJ_017_oPCAN_RADAR_7e601c13_Tx: ComSignalType=UINT8
            OBJ_VELOCITY_LAT_017_oRDR_TRACKER_OBJ_017_oPCAN_RADAR_71d69999_Tx: ComSignalType=UINT16
            OBJ_VELOCITY_LAT_ERR_017_oRDR_TRACKER_OBJ_017_oPCAN_RADAR_452ce9c8_Tx: ComSignalType=UINT8
            OBJ_VELOCITY_LONG_017_oRDR_TRACKER_OBJ_017_oPCAN_RADAR_215be15f_Tx: ComSignalType=UINT16
            OBJ_VELOCITY_LONG_ERR_017_oRDR_TRACKER_OBJ_017_oPCAN_RADAR_a9aed608_Tx: ComSignalType=UINT8
            OBJ_YAW_ANGLE_017_oRDR_TRACKER_OBJ_017_oPCAN_RADAR_9d6addd9_Tx: ComSignalType=UINT16
            OBJ_YAW_ANGLE_ERR_017_oRDR_TRACKER_OBJ_017_oPCAN_RADAR_4867db0e_Tx: ComSignalType=UINT8
            OBJ_YAW_RATE_017_oRDR_TRACKER_OBJ_017_oPCAN_RADAR_b8e5f89e_Tx: ComSignalType=UINT16
            OBJ_YAW_RATE_ERR_017_oRDR_TRACKER_OBJ_017_oPCAN_RADAR_873d6f42_Tx: ComSignalType=UINT8
        SG_TrackerObject018_oRDR_TRACKER_OBJ_018_oPCAN_RADAR_ab5b5c0c_Tx
          49 x ComGroupSignal:
            OBJ_ACCELERATION_LAT_018_oRDR_TRACKER_OBJ_018_oPCAN_RADAR_a57f077b_Tx: ComSignalType=UINT16
            OBJ_ACCELERATION_LAT_ERR_018_oRDR_TRACKER_OBJ_018_oPCAN_RADAR_708b3dc5_Tx: ComSignalType=UINT8
            OBJ_ACCELERATION_LONG_018_oRDR_TRACKER_OBJ_018_oPCAN_RADAR_d78f5e9b_Tx: ComSignalType=UINT16
            OBJ_ACCELERATION_LONG_ERR_018_oRDR_TRACKER_OBJ_018_oPCAN_RADAR_6f2e986f_Tx: ComSignalType=UINT8
            OBJ_ACCEL_ERR_CRR_COEF_018_oRDR_TRACKER_OBJ_018_oPCAN_RADAR_cf8db909_Tx: ComSignalType=UINT8
            OBJ_ALIVE_TIME_018_oRDR_TRACKER_OBJ_018_oPCAN_RADAR_b7ee1527_Tx: ComSignalType=UINT16
            OBJ_CLS_TYPE1_018_oRDR_TRACKER_OBJ_018_oPCAN_RADAR_2035f401_Tx: ComSignalType=UINT8
            OBJ_CLS_TYPE1_PROB_018_oRDR_TRACKER_OBJ_018_oPCAN_RADAR_886d23f2_Tx: ComSignalType=UINT8
            OBJ_CLS_TYPE2_018_oRDR_TRACKER_OBJ_018_oPCAN_RADAR_6dddf466_Tx: ComSignalType=UINT8
            OBJ_CLS_TYPE2_PROB_018_oRDR_TRACKER_OBJ_018_oPCAN_RADAR_415938ff_Tx: ComSignalType=UINT8
            OBJ_CLS_TYPE3_018_oRDR_TRACKER_OBJ_018_oPCAN_RADAR_e0550984_Tx: ComSignalType=UINT8
            OBJ_CLS_TYPE3_PROB_018_oRDR_TRACKER_OBJ_018_oPCAN_RADAR_064ace04_Tx: ComSignalType=UINT8
            OBJ_CLS_TYPE4_018_oRDR_TRACKER_OBJ_018_oPCAN_RADAR_f60df4a8_Tx: ComSignalType=UINT8
            OBJ_CLS_TYPE4_PROB_018_oRDR_TRACKER_OBJ_018_oPCAN_RADAR_084008a4_Tx: ComSignalType=UINT8
            OBJ_CLS_TYPE5_018_oRDR_TRACKER_OBJ_018_oPCAN_RADAR_7b85094a_Tx: ComSignalType=UINT8
            OBJ_CLS_TYPE5_PROB_018_oRDR_TRACKER_OBJ_018_oPCAN_RADAR_4f53fe5f_Tx: ComSignalType=UINT8
            OBJ_CLS_TYPE6_018_oRDR_TRACKER_OBJ_018_oPCAN_RADAR_366d092d_Tx: ComSignalType=UINT8
            OBJ_CLS_TYPE6_PROB_018_oRDR_TRACKER_OBJ_018_oPCAN_RADAR_8667e552_Tx: ComSignalType=UINT8
            OBJ_DIMENSION_LENGTH_018_oRDR_TRACKER_OBJ_018_oPCAN_RADAR_62aba745_Tx: ComSignalType=UINT16
            OBJ_DIMENSION_LENGTH_ERR_018_oRDR_TRACKER_OBJ_018_oPCAN_RADAR_5953b83f_Tx: ComSignalType=UINT16
            OBJ_DIMENSION_WIDTH_018_oRDR_TRACKER_OBJ_018_oPCAN_RADAR_416550e8_Tx: ComSignalType=UINT16
            OBJ_DIMENSION_WIDTH_ERR_018_oRDR_TRACKER_OBJ_018_oPCAN_RADAR_a1c79700_Tx: ComSignalType=UINT8
            OBJ_EXISTENCE_PROB_018_oRDR_TRACKER_OBJ_018_oPCAN_RADAR_4ad9d4d5_Tx: ComSignalType=UINT16
            OBJ_GROUP_ID_018_oRDR_TRACKER_OBJ_018_oPCAN_RADAR_c3abc078_Tx: ComSignalType=UINT8
            OBJ_ID_018_oRDR_TRACKER_OBJ_018_oPCAN_RADAR_3085eb7f_Tx: ComSignalType=UINT8
            OBJ_MEASUREMENT_STATUS_018_oRDR_TRACKER_OBJ_018_oPCAN_RADAR_4f5799c2_Tx: ComSignalType=UINT8
            OBJ_MH_CRC16_018_oRDR_TRACKER_OBJ_018_oPCAN_RADAR_33372efe_Tx: ComSignalType=UINT16
            OBJ_MH_CYCLE_COUNTER_018_oRDR_TRACKER_OBJ_018_oPCAN_RADAR_42d3741f_Tx: ComSignalType=UINT8
            OBJ_MOVEMENT_STATUS_018_oRDR_TRACKER_OBJ_018_oPCAN_RADAR_60f90c8e_Tx: ComSignalType=UINT8
            OBJ_POS_ERR_CRR_COEF_018_oRDR_TRACKER_OBJ_018_oPCAN_RADAR_f086ccb4_Tx: ComSignalType=UINT8
            OBJ_POS_LAT_018_oRDR_TRACKER_OBJ_018_oPCAN_RADAR_122931f8_Tx: ComSignalType=UINT16
            OBJ_POS_LAT_ERR_018_oRDR_TRACKER_OBJ_018_oPCAN_RADAR_166561cf_Tx: ComSignalType=UINT8
            OBJ_POS_LONG_018_oRDR_TRACKER_OBJ_018_oPCAN_RADAR_a389da37_Tx: ComSignalType=UINT16
            OBJ_POS_LONG_ERR_018_oRDR_TRACKER_OBJ_018_oPCAN_RADAR_8f9d9f2d_Tx: ComSignalType=UINT8
            OBJ_RCS_018_oRDR_TRACKER_OBJ_018_oPCAN_RADAR_30e667ff_Tx: ComSignalType=UINT8
            OBJ_REF_PT_LAT_OFFSET_018_oRDR_TRACKER_OBJ_018_oPCAN_RADAR_c5db0c8a_Tx: ComSignalType=UINT16
            OBJ_REF_PT_LONG_OFFSET_018_oRDR_TRACKER_OBJ_018_oPCAN_RADAR_8a89fc89_Tx: ComSignalType=UINT16
            OBJ_TIMESTAMP_OFFSET_018_oRDR_TRACKER_OBJ_018_oPCAN_RADAR_304a67a9_Tx: ComSignalType=UINT8
            OBJ_TRACK_MOTION_MODEL_018_oRDR_TRACKER_OBJ_018_oPCAN_RADAR_fc496674_Tx: ComSignalType=UINT8
            OBJ_VEH_TRACK_FLAG_018_oRDR_TRACKER_OBJ_018_oPCAN_RADAR_7e639029_Tx: ComSignalType=BOOLEAN
            OBJ_VELOCITY_ERR_CRR_COEF_018_oRDR_TRACKER_OBJ_018_oPCAN_RADAR_59fcf155_Tx: ComSignalType=UINT8
            OBJ_VELOCITY_LAT_018_oRDR_TRACKER_OBJ_018_oPCAN_RADAR_564a74df_Tx: ComSignalType=UINT16
            OBJ_VELOCITY_LAT_ERR_018_oRDR_TRACKER_OBJ_018_oPCAN_RADAR_62b0048e_Tx: ComSignalType=UINT8
            OBJ_VELOCITY_LONG_018_oRDR_TRACKER_OBJ_018_oPCAN_RADAR_06c70c19_Tx: ComSignalType=UINT16
            OBJ_VELOCITY_LONG_ERR_018_oRDR_TRACKER_OBJ_018_oPCAN_RADAR_8e323b4e_Tx: ComSignalType=UINT8
            OBJ_YAW_ANGLE_018_oRDR_TRACKER_OBJ_018_oPCAN_RADAR_baf6309f_Tx: ComSignalType=UINT16
            OBJ_YAW_ANGLE_ERR_018_oRDR_TRACKER_OBJ_018_oPCAN_RADAR_6ffb3648_Tx: ComSignalType=UINT8
            OBJ_YAW_RATE_018_oRDR_TRACKER_OBJ_018_oPCAN_RADAR_9f7915d8_Tx: ComSignalType=UINT16
            OBJ_YAW_RATE_ERR_018_oRDR_TRACKER_OBJ_018_oPCAN_RADAR_a0a18204_Tx: ComSignalType=UINT8
        SG_TrackerObject019_oRDR_TRACKER_OBJ_019_oPCAN_RADAR_524fd4bf_Tx
          49 x ComGroupSignal:
            OBJ_ACCELERATION_LAT_019_oRDR_TRACKER_OBJ_019_oPCAN_RADAR_5c6b8fc8_Tx: ComSignalType=UINT16
            OBJ_ACCELERATION_LAT_ERR_019_oRDR_TRACKER_OBJ_019_oPCAN_RADAR_899fb576_Tx: ComSignalType=UINT8
            OBJ_ACCELERATION_LONG_019_oRDR_TRACKER_OBJ_019_oPCAN_RADAR_2e9bd628_Tx: ComSignalType=UINT16
            OBJ_ACCELERATION_LONG_ERR_019_oRDR_TRACKER_OBJ_019_oPCAN_RADAR_963a10dc_Tx: ComSignalType=UINT8
            OBJ_ACCEL_ERR_CRR_COEF_019_oRDR_TRACKER_OBJ_019_oPCAN_RADAR_369931ba_Tx: ComSignalType=UINT8
            OBJ_ALIVE_TIME_019_oRDR_TRACKER_OBJ_019_oPCAN_RADAR_4efa9d94_Tx: ComSignalType=UINT16
            OBJ_CLS_TYPE1_019_oRDR_TRACKER_OBJ_019_oPCAN_RADAR_d9217cb2_Tx: ComSignalType=UINT8
            OBJ_CLS_TYPE1_PROB_019_oRDR_TRACKER_OBJ_019_oPCAN_RADAR_7179ab41_Tx: ComSignalType=UINT8
            OBJ_CLS_TYPE2_019_oRDR_TRACKER_OBJ_019_oPCAN_RADAR_94c97cd5_Tx: ComSignalType=UINT8
            OBJ_CLS_TYPE2_PROB_019_oRDR_TRACKER_OBJ_019_oPCAN_RADAR_b84db04c_Tx: ComSignalType=UINT8
            OBJ_CLS_TYPE3_019_oRDR_TRACKER_OBJ_019_oPCAN_RADAR_19418137_Tx: ComSignalType=UINT8
            OBJ_CLS_TYPE3_PROB_019_oRDR_TRACKER_OBJ_019_oPCAN_RADAR_ff5e46b7_Tx: ComSignalType=UINT8
            OBJ_CLS_TYPE4_019_oRDR_TRACKER_OBJ_019_oPCAN_RADAR_0f197c1b_Tx: ComSignalType=UINT8
            OBJ_CLS_TYPE4_PROB_019_oRDR_TRACKER_OBJ_019_oPCAN_RADAR_f1548017_Tx: ComSignalType=UINT8
            OBJ_CLS_TYPE5_019_oRDR_TRACKER_OBJ_019_oPCAN_RADAR_829181f9_Tx: ComSignalType=UINT8
            OBJ_CLS_TYPE5_PROB_019_oRDR_TRACKER_OBJ_019_oPCAN_RADAR_b64776ec_Tx: ComSignalType=UINT8
            OBJ_CLS_TYPE6_019_oRDR_TRACKER_OBJ_019_oPCAN_RADAR_cf79819e_Tx: ComSignalType=UINT8
            OBJ_CLS_TYPE6_PROB_019_oRDR_TRACKER_OBJ_019_oPCAN_RADAR_7f736de1_Tx: ComSignalType=UINT8
            OBJ_DIMENSION_LENGTH_019_oRDR_TRACKER_OBJ_019_oPCAN_RADAR_9bbf2ff6_Tx: ComSignalType=UINT16
            OBJ_DIMENSION_LENGTH_ERR_019_oRDR_TRACKER_OBJ_019_oPCAN_RADAR_a047308c_Tx: ComSignalType=UINT16
            OBJ_DIMENSION_WIDTH_019_oRDR_TRACKER_OBJ_019_oPCAN_RADAR_b871d85b_Tx: ComSignalType=UINT16
            OBJ_DIMENSION_WIDTH_ERR_019_oRDR_TRACKER_OBJ_019_oPCAN_RADAR_58d31fb3_Tx: ComSignalType=UINT8
            OBJ_EXISTENCE_PROB_019_oRDR_TRACKER_OBJ_019_oPCAN_RADAR_b3cd5c66_Tx: ComSignalType=UINT16
            OBJ_GROUP_ID_019_oRDR_TRACKER_OBJ_019_oPCAN_RADAR_3abf48cb_Tx: ComSignalType=UINT8
            OBJ_ID_019_oRDR_TRACKER_OBJ_019_oPCAN_RADAR_c99163cc_Tx: ComSignalType=UINT8
            OBJ_MEASUREMENT_STATUS_019_oRDR_TRACKER_OBJ_019_oPCAN_RADAR_b6431171_Tx: ComSignalType=UINT8
            OBJ_MH_CRC16_019_oRDR_TRACKER_OBJ_019_oPCAN_RADAR_ca23a64d_Tx: ComSignalType=UINT16
            OBJ_MH_CYCLE_COUNTER_019_oRDR_TRACKER_OBJ_019_oPCAN_RADAR_bbc7fcac_Tx: ComSignalType=UINT8
            OBJ_MOVEMENT_STATUS_019_oRDR_TRACKER_OBJ_019_oPCAN_RADAR_99ed843d_Tx: ComSignalType=UINT8
            OBJ_POS_ERR_CRR_COEF_019_oRDR_TRACKER_OBJ_019_oPCAN_RADAR_09924407_Tx: ComSignalType=UINT8
            OBJ_POS_LAT_019_oRDR_TRACKER_OBJ_019_oPCAN_RADAR_eb3db94b_Tx: ComSignalType=UINT16
            OBJ_POS_LAT_ERR_019_oRDR_TRACKER_OBJ_019_oPCAN_RADAR_ef71e97c_Tx: ComSignalType=UINT8
            OBJ_POS_LONG_019_oRDR_TRACKER_OBJ_019_oPCAN_RADAR_5a9d5284_Tx: ComSignalType=UINT16
            OBJ_POS_LONG_ERR_019_oRDR_TRACKER_OBJ_019_oPCAN_RADAR_7689179e_Tx: ComSignalType=UINT8
            OBJ_RCS_019_oRDR_TRACKER_OBJ_019_oPCAN_RADAR_c9f2ef4c_Tx: ComSignalType=UINT8
            OBJ_REF_PT_LAT_OFFSET_019_oRDR_TRACKER_OBJ_019_oPCAN_RADAR_3ccf8439_Tx: ComSignalType=UINT16
            OBJ_REF_PT_LONG_OFFSET_019_oRDR_TRACKER_OBJ_019_oPCAN_RADAR_739d743a_Tx: ComSignalType=UINT16
            OBJ_TIMESTAMP_OFFSET_019_oRDR_TRACKER_OBJ_019_oPCAN_RADAR_c95eef1a_Tx: ComSignalType=UINT8
            OBJ_TRACK_MOTION_MODEL_019_oRDR_TRACKER_OBJ_019_oPCAN_RADAR_055deec7_Tx: ComSignalType=UINT8
            OBJ_VEH_TRACK_FLAG_019_oRDR_TRACKER_OBJ_019_oPCAN_RADAR_8777189a_Tx: ComSignalType=BOOLEAN
            OBJ_VELOCITY_ERR_CRR_COEF_019_oRDR_TRACKER_OBJ_019_oPCAN_RADAR_a0e879e6_Tx: ComSignalType=UINT8
            OBJ_VELOCITY_LAT_019_oRDR_TRACKER_OBJ_019_oPCAN_RADAR_af5efc6c_Tx: ComSignalType=UINT16
            OBJ_VELOCITY_LAT_ERR_019_oRDR_TRACKER_OBJ_019_oPCAN_RADAR_9ba48c3d_Tx: ComSignalType=UINT8
            OBJ_VELOCITY_LONG_019_oRDR_TRACKER_OBJ_019_oPCAN_RADAR_ffd384aa_Tx: ComSignalType=UINT16
            OBJ_VELOCITY_LONG_ERR_019_oRDR_TRACKER_OBJ_019_oPCAN_RADAR_7726b3fd_Tx: ComSignalType=UINT8
            OBJ_YAW_ANGLE_019_oRDR_TRACKER_OBJ_019_oPCAN_RADAR_43e2b82c_Tx: ComSignalType=UINT16
            OBJ_YAW_ANGLE_ERR_019_oRDR_TRACKER_OBJ_019_oPCAN_RADAR_96efbefb_Tx: ComSignalType=UINT8
            OBJ_YAW_RATE_019_oRDR_TRACKER_OBJ_019_oPCAN_RADAR_666d9d6b_Tx: ComSignalType=UINT16
            OBJ_YAW_RATE_ERR_019_oRDR_TRACKER_OBJ_019_oPCAN_RADAR_59b50ab7_Tx: ComSignalType=UINT8
        SG_TrackerObject020_oRDR_TRACKER_OBJ_020_oPCAN_RADAR_f9891b52_Tx
          49 x ComGroupSignal:
            OBJ_ACCELERATION_LAT_020_oRDR_TRACKER_OBJ_020_oPCAN_RADAR_f7ad4025_Tx: ComSignalType=UINT16
            OBJ_ACCELERATION_LAT_ERR_020_oRDR_TRACKER_OBJ_020_oPCAN_RADAR_22597a9b_Tx: ComSignalType=UINT8
            OBJ_ACCELERATION_LONG_020_oRDR_TRACKER_OBJ_020_oPCAN_RADAR_855d19c5_Tx: ComSignalType=UINT16
            OBJ_ACCELERATION_LONG_ERR_020_oRDR_TRACKER_OBJ_020_oPCAN_RADAR_3dfcdf31_Tx: ComSignalType=UINT8
            OBJ_ACCEL_ERR_CRR_COEF_020_oRDR_TRACKER_OBJ_020_oPCAN_RADAR_9d5ffe57_Tx: ComSignalType=UINT8
            OBJ_ALIVE_TIME_020_oRDR_TRACKER_OBJ_020_oPCAN_RADAR_e53c5279_Tx: ComSignalType=UINT16
            OBJ_CLS_TYPE1_020_oRDR_TRACKER_OBJ_020_oPCAN_RADAR_72e7b35f_Tx: ComSignalType=UINT8
            OBJ_CLS_TYPE1_PROB_020_oRDR_TRACKER_OBJ_020_oPCAN_RADAR_dabf64ac_Tx: ComSignalType=UINT8
            OBJ_CLS_TYPE2_020_oRDR_TRACKER_OBJ_020_oPCAN_RADAR_3f0fb338_Tx: ComSignalType=UINT8
            OBJ_CLS_TYPE2_PROB_020_oRDR_TRACKER_OBJ_020_oPCAN_RADAR_138b7fa1_Tx: ComSignalType=UINT8
            OBJ_CLS_TYPE3_020_oRDR_TRACKER_OBJ_020_oPCAN_RADAR_b2874eda_Tx: ComSignalType=UINT8
            OBJ_CLS_TYPE3_PROB_020_oRDR_TRACKER_OBJ_020_oPCAN_RADAR_5498895a_Tx: ComSignalType=UINT8
            OBJ_CLS_TYPE4_020_oRDR_TRACKER_OBJ_020_oPCAN_RADAR_a4dfb3f6_Tx: ComSignalType=UINT8
            OBJ_CLS_TYPE4_PROB_020_oRDR_TRACKER_OBJ_020_oPCAN_RADAR_5a924ffa_Tx: ComSignalType=UINT8
            OBJ_CLS_TYPE5_020_oRDR_TRACKER_OBJ_020_oPCAN_RADAR_29574e14_Tx: ComSignalType=UINT8
            OBJ_CLS_TYPE5_PROB_020_oRDR_TRACKER_OBJ_020_oPCAN_RADAR_1d81b901_Tx: ComSignalType=UINT8
            OBJ_CLS_TYPE6_020_oRDR_TRACKER_OBJ_020_oPCAN_RADAR_64bf4e73_Tx: ComSignalType=UINT8
            OBJ_CLS_TYPE6_PROB_020_oRDR_TRACKER_OBJ_020_oPCAN_RADAR_d4b5a20c_Tx: ComSignalType=UINT8
            OBJ_DIMENSION_LENGTH_020_oRDR_TRACKER_OBJ_020_oPCAN_RADAR_3079e01b_Tx: ComSignalType=UINT16
            OBJ_DIMENSION_LENGTH_ERR_020_oRDR_TRACKER_OBJ_020_oPCAN_RADAR_0b81ff61_Tx: ComSignalType=UINT16
            OBJ_DIMENSION_WIDTH_020_oRDR_TRACKER_OBJ_020_oPCAN_RADAR_13b717b6_Tx: ComSignalType=UINT16
            OBJ_DIMENSION_WIDTH_ERR_020_oRDR_TRACKER_OBJ_020_oPCAN_RADAR_f315d05e_Tx: ComSignalType=UINT8
            OBJ_EXISTENCE_PROB_020_oRDR_TRACKER_OBJ_020_oPCAN_RADAR_180b938b_Tx: ComSignalType=UINT16
            OBJ_GROUP_ID_020_oRDR_TRACKER_OBJ_020_oPCAN_RADAR_91798726_Tx: ComSignalType=UINT8
            OBJ_ID_020_oRDR_TRACKER_OBJ_020_oPCAN_RADAR_6257ac21_Tx: ComSignalType=UINT8
            OBJ_MEASUREMENT_STATUS_020_oRDR_TRACKER_OBJ_020_oPCAN_RADAR_1d85de9c_Tx: ComSignalType=UINT8
            OBJ_MH_CRC16_020_oRDR_TRACKER_OBJ_020_oPCAN_RADAR_61e569a0_Tx: ComSignalType=UINT16
            OBJ_MH_CYCLE_COUNTER_020_oRDR_TRACKER_OBJ_020_oPCAN_RADAR_10013341_Tx: ComSignalType=UINT8
            OBJ_MOVEMENT_STATUS_020_oRDR_TRACKER_OBJ_020_oPCAN_RADAR_322b4bd0_Tx: ComSignalType=UINT8
            OBJ_POS_ERR_CRR_COEF_020_oRDR_TRACKER_OBJ_020_oPCAN_RADAR_a2548bea_Tx: ComSignalType=UINT8
            OBJ_POS_LAT_020_oRDR_TRACKER_OBJ_020_oPCAN_RADAR_40fb76a6_Tx: ComSignalType=UINT16
            OBJ_POS_LAT_ERR_020_oRDR_TRACKER_OBJ_020_oPCAN_RADAR_44b72691_Tx: ComSignalType=UINT8
            OBJ_POS_LONG_020_oRDR_TRACKER_OBJ_020_oPCAN_RADAR_f15b9d69_Tx: ComSignalType=UINT16
            OBJ_POS_LONG_ERR_020_oRDR_TRACKER_OBJ_020_oPCAN_RADAR_dd4fd873_Tx: ComSignalType=UINT8
            OBJ_RCS_020_oRDR_TRACKER_OBJ_020_oPCAN_RADAR_623420a1_Tx: ComSignalType=UINT8
            OBJ_REF_PT_LAT_OFFSET_020_oRDR_TRACKER_OBJ_020_oPCAN_RADAR_97094bd4_Tx: ComSignalType=UINT16
            OBJ_REF_PT_LONG_OFFSET_020_oRDR_TRACKER_OBJ_020_oPCAN_RADAR_d85bbbd7_Tx: ComSignalType=UINT16
            OBJ_TIMESTAMP_OFFSET_020_oRDR_TRACKER_OBJ_020_oPCAN_RADAR_629820f7_Tx: ComSignalType=UINT8
            OBJ_TRACK_MOTION_MODEL_020_oRDR_TRACKER_OBJ_020_oPCAN_RADAR_ae9b212a_Tx: ComSignalType=UINT8
            OBJ_VEH_TRACK_FLAG_020_oRDR_TRACKER_OBJ_020_oPCAN_RADAR_2cb1d777_Tx: ComSignalType=BOOLEAN
            OBJ_VELOCITY_ERR_CRR_COEF_020_oRDR_TRACKER_OBJ_020_oPCAN_RADAR_0b2eb60b_Tx: ComSignalType=UINT8
            OBJ_VELOCITY_LAT_020_oRDR_TRACKER_OBJ_020_oPCAN_RADAR_04983381_Tx: ComSignalType=UINT16
            OBJ_VELOCITY_LAT_ERR_020_oRDR_TRACKER_OBJ_020_oPCAN_RADAR_306243d0_Tx: ComSignalType=UINT8
            OBJ_VELOCITY_LONG_020_oRDR_TRACKER_OBJ_020_oPCAN_RADAR_54154b47_Tx: ComSignalType=UINT16
            OBJ_VELOCITY_LONG_ERR_020_oRDR_TRACKER_OBJ_020_oPCAN_RADAR_dce07c10_Tx: ComSignalType=UINT8
            OBJ_YAW_ANGLE_020_oRDR_TRACKER_OBJ_020_oPCAN_RADAR_e82477c1_Tx: ComSignalType=UINT16
            OBJ_YAW_ANGLE_ERR_020_oRDR_TRACKER_OBJ_020_oPCAN_RADAR_3d297116_Tx: ComSignalType=UINT8
            OBJ_YAW_RATE_020_oRDR_TRACKER_OBJ_020_oPCAN_RADAR_cdab5286_Tx: ComSignalType=UINT16
            OBJ_YAW_RATE_ERR_020_oRDR_TRACKER_OBJ_020_oPCAN_RADAR_f273c55a_Tx: ComSignalType=UINT8
        SG_TrackerObject021_oRDR_TRACKER_OBJ_021_oPCAN_RADAR_009d93e1_Tx
          49 x ComGroupSignal:
            OBJ_ACCELERATION_LAT_021_oRDR_TRACKER_OBJ_021_oPCAN_RADAR_0eb9c896_Tx: ComSignalType=UINT16
            OBJ_ACCELERATION_LAT_ERR_021_oRDR_TRACKER_OBJ_021_oPCAN_RADAR_db4df228_Tx: ComSignalType=UINT8
            OBJ_ACCELERATION_LONG_021_oRDR_TRACKER_OBJ_021_oPCAN_RADAR_7c499176_Tx: ComSignalType=UINT16
            OBJ_ACCELERATION_LONG_ERR_021_oRDR_TRACKER_OBJ_021_oPCAN_RADAR_c4e85782_Tx: ComSignalType=UINT8
            OBJ_ACCEL_ERR_CRR_COEF_021_oRDR_TRACKER_OBJ_021_oPCAN_RADAR_644b76e4_Tx: ComSignalType=UINT8
            OBJ_ALIVE_TIME_021_oRDR_TRACKER_OBJ_021_oPCAN_RADAR_1c28daca_Tx: ComSignalType=UINT16
            OBJ_CLS_TYPE1_021_oRDR_TRACKER_OBJ_021_oPCAN_RADAR_8bf33bec_Tx: ComSignalType=UINT8
            OBJ_CLS_TYPE1_PROB_021_oRDR_TRACKER_OBJ_021_oPCAN_RADAR_23abec1f_Tx: ComSignalType=UINT8
            OBJ_CLS_TYPE2_021_oRDR_TRACKER_OBJ_021_oPCAN_RADAR_c61b3b8b_Tx: ComSignalType=UINT8
            OBJ_CLS_TYPE2_PROB_021_oRDR_TRACKER_OBJ_021_oPCAN_RADAR_ea9ff712_Tx: ComSignalType=UINT8
            OBJ_CLS_TYPE3_021_oRDR_TRACKER_OBJ_021_oPCAN_RADAR_4b93c669_Tx: ComSignalType=UINT8
            OBJ_CLS_TYPE3_PROB_021_oRDR_TRACKER_OBJ_021_oPCAN_RADAR_ad8c01e9_Tx: ComSignalType=UINT8
            OBJ_CLS_TYPE4_021_oRDR_TRACKER_OBJ_021_oPCAN_RADAR_5dcb3b45_Tx: ComSignalType=UINT8
            OBJ_CLS_TYPE4_PROB_021_oRDR_TRACKER_OBJ_021_oPCAN_RADAR_a386c749_Tx: ComSignalType=UINT8
            OBJ_CLS_TYPE5_021_oRDR_TRACKER_OBJ_021_oPCAN_RADAR_d043c6a7_Tx: ComSignalType=UINT8
            OBJ_CLS_TYPE5_PROB_021_oRDR_TRACKER_OBJ_021_oPCAN_RADAR_e49531b2_Tx: ComSignalType=UINT8
            OBJ_CLS_TYPE6_021_oRDR_TRACKER_OBJ_021_oPCAN_RADAR_9dabc6c0_Tx: ComSignalType=UINT8
            OBJ_CLS_TYPE6_PROB_021_oRDR_TRACKER_OBJ_021_oPCAN_RADAR_2da12abf_Tx: ComSignalType=UINT8
            OBJ_DIMENSION_LENGTH_021_oRDR_TRACKER_OBJ_021_oPCAN_RADAR_c96d68a8_Tx: ComSignalType=UINT16
            OBJ_DIMENSION_LENGTH_ERR_021_oRDR_TRACKER_OBJ_021_oPCAN_RADAR_f29577d2_Tx: ComSignalType=UINT16
            OBJ_DIMENSION_WIDTH_021_oRDR_TRACKER_OBJ_021_oPCAN_RADAR_eaa39f05_Tx: ComSignalType=UINT16
            OBJ_DIMENSION_WIDTH_ERR_021_oRDR_TRACKER_OBJ_021_oPCAN_RADAR_0a0158ed_Tx: ComSignalType=UINT8
            OBJ_EXISTENCE_PROB_021_oRDR_TRACKER_OBJ_021_oPCAN_RADAR_e11f1b38_Tx: ComSignalType=UINT16
            OBJ_GROUP_ID_021_oRDR_TRACKER_OBJ_021_oPCAN_RADAR_686d0f95_Tx: ComSignalType=UINT8
            OBJ_ID_021_oRDR_TRACKER_OBJ_021_oPCAN_RADAR_9b432492_Tx: ComSignalType=UINT8
            OBJ_MEASUREMENT_STATUS_021_oRDR_TRACKER_OBJ_021_oPCAN_RADAR_e491562f_Tx: ComSignalType=UINT8
            OBJ_MH_CRC16_021_oRDR_TRACKER_OBJ_021_oPCAN_RADAR_98f1e113_Tx: ComSignalType=UINT16
            OBJ_MH_CYCLE_COUNTER_021_oRDR_TRACKER_OBJ_021_oPCAN_RADAR_e915bbf2_Tx: ComSignalType=UINT8
            OBJ_MOVEMENT_STATUS_021_oRDR_TRACKER_OBJ_021_oPCAN_RADAR_cb3fc363_Tx: ComSignalType=UINT8
            OBJ_POS_ERR_CRR_COEF_021_oRDR_TRACKER_OBJ_021_oPCAN_RADAR_5b400359_Tx: ComSignalType=UINT8
            OBJ_POS_LAT_021_oRDR_TRACKER_OBJ_021_oPCAN_RADAR_b9effe15_Tx: ComSignalType=UINT16
            OBJ_POS_LAT_ERR_021_oRDR_TRACKER_OBJ_021_oPCAN_RADAR_bda3ae22_Tx: ComSignalType=UINT8
            OBJ_POS_LONG_021_oRDR_TRACKER_OBJ_021_oPCAN_RADAR_084f15da_Tx: ComSignalType=UINT16
            OBJ_POS_LONG_ERR_021_oRDR_TRACKER_OBJ_021_oPCAN_RADAR_245b50c0_Tx: ComSignalType=UINT8
            OBJ_RCS_021_oRDR_TRACKER_OBJ_021_oPCAN_RADAR_9b20a812_Tx: ComSignalType=UINT8
            OBJ_REF_PT_LAT_OFFSET_021_oRDR_TRACKER_OBJ_021_oPCAN_RADAR_6e1dc367_Tx: ComSignalType=UINT16
            OBJ_REF_PT_LONG_OFFSET_021_oRDR_TRACKER_OBJ_021_oPCAN_RADAR_214f3364_Tx: ComSignalType=UINT16
            OBJ_TIMESTAMP_OFFSET_021_oRDR_TRACKER_OBJ_021_oPCAN_RADAR_9b8ca844_Tx: ComSignalType=UINT8
            OBJ_TRACK_MOTION_MODEL_021_oRDR_TRACKER_OBJ_021_oPCAN_RADAR_578fa999_Tx: ComSignalType=UINT8
            OBJ_VEH_TRACK_FLAG_021_oRDR_TRACKER_OBJ_021_oPCAN_RADAR_d5a55fc4_Tx: ComSignalType=BOOLEAN
            OBJ_VELOCITY_ERR_CRR_COEF_021_oRDR_TRACKER_OBJ_021_oPCAN_RADAR_f23a3eb8_Tx: ComSignalType=UINT8
            OBJ_VELOCITY_LAT_021_oRDR_TRACKER_OBJ_021_oPCAN_RADAR_fd8cbb32_Tx: ComSignalType=UINT16
            OBJ_VELOCITY_LAT_ERR_021_oRDR_TRACKER_OBJ_021_oPCAN_RADAR_c976cb63_Tx: ComSignalType=UINT8
            OBJ_VELOCITY_LONG_021_oRDR_TRACKER_OBJ_021_oPCAN_RADAR_ad01c3f4_Tx: ComSignalType=UINT16
            OBJ_VELOCITY_LONG_ERR_021_oRDR_TRACKER_OBJ_021_oPCAN_RADAR_25f4f4a3_Tx: ComSignalType=UINT8
            OBJ_YAW_ANGLE_021_oRDR_TRACKER_OBJ_021_oPCAN_RADAR_1130ff72_Tx: ComSignalType=UINT16
            OBJ_YAW_ANGLE_ERR_021_oRDR_TRACKER_OBJ_021_oPCAN_RADAR_c43df9a5_Tx: ComSignalType=UINT8
            OBJ_YAW_RATE_021_oRDR_TRACKER_OBJ_021_oPCAN_RADAR_34bfda35_Tx: ComSignalType=UINT16
            OBJ_YAW_RATE_ERR_021_oRDR_TRACKER_OBJ_021_oPCAN_RADAR_0b674de9_Tx: ComSignalType=UINT8
        SG_TrackerObject022_oRDR_TRACKER_OBJ_022_oPCAN_RADAR_d0d10c75_Tx
          49 x ComGroupSignal:
            OBJ_ACCELERATION_LAT_022_oRDR_TRACKER_OBJ_022_oPCAN_RADAR_def55702_Tx: ComSignalType=UINT16
            OBJ_ACCELERATION_LAT_ERR_022_oRDR_TRACKER_OBJ_022_oPCAN_RADAR_0b016dbc_Tx: ComSignalType=UINT8
            OBJ_ACCELERATION_LONG_022_oRDR_TRACKER_OBJ_022_oPCAN_RADAR_ac050ee2_Tx: ComSignalType=UINT16
            OBJ_ACCELERATION_LONG_ERR_022_oRDR_TRACKER_OBJ_022_oPCAN_RADAR_14a4c816_Tx: ComSignalType=UINT8
            OBJ_ACCEL_ERR_CRR_COEF_022_oRDR_TRACKER_OBJ_022_oPCAN_RADAR_b407e970_Tx: ComSignalType=UINT8
            OBJ_ALIVE_TIME_022_oRDR_TRACKER_OBJ_022_oPCAN_RADAR_cc64455e_Tx: ComSignalType=UINT16
            OBJ_CLS_TYPE1_022_oRDR_TRACKER_OBJ_022_oPCAN_RADAR_5bbfa478_Tx: ComSignalType=UINT8
            OBJ_CLS_TYPE1_PROB_022_oRDR_TRACKER_OBJ_022_oPCAN_RADAR_f3e7738b_Tx: ComSignalType=UINT8
            OBJ_CLS_TYPE2_022_oRDR_TRACKER_OBJ_022_oPCAN_RADAR_1657a41f_Tx: ComSignalType=UINT8
            OBJ_CLS_TYPE2_PROB_022_oRDR_TRACKER_OBJ_022_oPCAN_RADAR_3ad36886_Tx: ComSignalType=UINT8
            OBJ_CLS_TYPE3_022_oRDR_TRACKER_OBJ_022_oPCAN_RADAR_9bdf59fd_Tx: ComSignalType=UINT8
            OBJ_CLS_TYPE3_PROB_022_oRDR_TRACKER_OBJ_022_oPCAN_RADAR_7dc09e7d_Tx: ComSignalType=UINT8
            OBJ_CLS_TYPE4_022_oRDR_TRACKER_OBJ_022_oPCAN_RADAR_8d87a4d1_Tx: ComSignalType=UINT8
            OBJ_CLS_TYPE4_PROB_022_oRDR_TRACKER_OBJ_022_oPCAN_RADAR_73ca58dd_Tx: ComSignalType=UINT8
            OBJ_CLS_TYPE5_022_oRDR_TRACKER_OBJ_022_oPCAN_RADAR_000f5933_Tx: ComSignalType=UINT8
            OBJ_CLS_TYPE5_PROB_022_oRDR_TRACKER_OBJ_022_oPCAN_RADAR_34d9ae26_Tx: ComSignalType=UINT8
            OBJ_CLS_TYPE6_022_oRDR_TRACKER_OBJ_022_oPCAN_RADAR_4de75954_Tx: ComSignalType=UINT8
            OBJ_CLS_TYPE6_PROB_022_oRDR_TRACKER_OBJ_022_oPCAN_RADAR_fdedb52b_Tx: ComSignalType=UINT8
            OBJ_DIMENSION_LENGTH_022_oRDR_TRACKER_OBJ_022_oPCAN_RADAR_1921f73c_Tx: ComSignalType=UINT16
            OBJ_DIMENSION_LENGTH_ERR_022_oRDR_TRACKER_OBJ_022_oPCAN_RADAR_22d9e846_Tx: ComSignalType=UINT16
            OBJ_DIMENSION_WIDTH_022_oRDR_TRACKER_OBJ_022_oPCAN_RADAR_3aef0091_Tx: ComSignalType=UINT16
            OBJ_DIMENSION_WIDTH_ERR_022_oRDR_TRACKER_OBJ_022_oPCAN_RADAR_da4dc779_Tx: ComSignalType=UINT8
            OBJ_EXISTENCE_PROB_022_oRDR_TRACKER_OBJ_022_oPCAN_RADAR_315384ac_Tx: ComSignalType=UINT16
            OBJ_GROUP_ID_022_oRDR_TRACKER_OBJ_022_oPCAN_RADAR_b8219001_Tx: ComSignalType=UINT8
            OBJ_ID_022_oRDR_TRACKER_OBJ_022_oPCAN_RADAR_4b0fbb06_Tx: ComSignalType=UINT8
            OBJ_MEASUREMENT_STATUS_022_oRDR_TRACKER_OBJ_022_oPCAN_RADAR_34ddc9bb_Tx: ComSignalType=UINT8
            OBJ_MH_CRC16_022_oRDR_TRACKER_OBJ_022_oPCAN_RADAR_48bd7e87_Tx: ComSignalType=UINT16
            OBJ_MH_CYCLE_COUNTER_022_oRDR_TRACKER_OBJ_022_oPCAN_RADAR_39592466_Tx: ComSignalType=UINT8
            OBJ_MOVEMENT_STATUS_022_oRDR_TRACKER_OBJ_022_oPCAN_RADAR_1b735cf7_Tx: ComSignalType=UINT8
            OBJ_POS_ERR_CRR_COEF_022_oRDR_TRACKER_OBJ_022_oPCAN_RADAR_8b0c9ccd_Tx: ComSignalType=UINT8
            OBJ_POS_LAT_022_oRDR_TRACKER_OBJ_022_oPCAN_RADAR_69a36181_Tx: ComSignalType=UINT16
            OBJ_POS_LAT_ERR_022_oRDR_TRACKER_OBJ_022_oPCAN_RADAR_6def31b6_Tx: ComSignalType=UINT8
            OBJ_POS_LONG_022_oRDR_TRACKER_OBJ_022_oPCAN_RADAR_d8038a4e_Tx: ComSignalType=UINT16
            OBJ_POS_LONG_ERR_022_oRDR_TRACKER_OBJ_022_oPCAN_RADAR_f417cf54_Tx: ComSignalType=UINT8
            OBJ_RCS_022_oRDR_TRACKER_OBJ_022_oPCAN_RADAR_4b6c3786_Tx: ComSignalType=UINT8
            OBJ_REF_PT_LAT_OFFSET_022_oRDR_TRACKER_OBJ_022_oPCAN_RADAR_be515cf3_Tx: ComSignalType=UINT16
            OBJ_REF_PT_LONG_OFFSET_022_oRDR_TRACKER_OBJ_022_oPCAN_RADAR_f103acf0_Tx: ComSignalType=UINT16
            OBJ_TIMESTAMP_OFFSET_022_oRDR_TRACKER_OBJ_022_oPCAN_RADAR_4bc037d0_Tx: ComSignalType=UINT8
            OBJ_TRACK_MOTION_MODEL_022_oRDR_TRACKER_OBJ_022_oPCAN_RADAR_87c3360d_Tx: ComSignalType=UINT8
            OBJ_VEH_TRACK_FLAG_022_oRDR_TRACKER_OBJ_022_oPCAN_RADAR_05e9c050_Tx: ComSignalType=BOOLEAN
            OBJ_VELOCITY_ERR_CRR_COEF_022_oRDR_TRACKER_OBJ_022_oPCAN_RADAR_2276a12c_Tx: ComSignalType=UINT8
            OBJ_VELOCITY_LAT_022_oRDR_TRACKER_OBJ_022_oPCAN_RADAR_2dc024a6_Tx: ComSignalType=UINT16
            OBJ_VELOCITY_LAT_ERR_022_oRDR_TRACKER_OBJ_022_oPCAN_RADAR_193a54f7_Tx: ComSignalType=UINT8
            OBJ_VELOCITY_LONG_022_oRDR_TRACKER_OBJ_022_oPCAN_RADAR_7d4d5c60_Tx: ComSignalType=UINT16
            OBJ_VELOCITY_LONG_ERR_022_oRDR_TRACKER_OBJ_022_oPCAN_RADAR_f5b86b37_Tx: ComSignalType=UINT8
            OBJ_YAW_ANGLE_022_oRDR_TRACKER_OBJ_022_oPCAN_RADAR_c17c60e6_Tx: ComSignalType=UINT16
            OBJ_YAW_ANGLE_ERR_022_oRDR_TRACKER_OBJ_022_oPCAN_RADAR_14716631_Tx: ComSignalType=UINT8
            OBJ_YAW_RATE_022_oRDR_TRACKER_OBJ_022_oPCAN_RADAR_e4f345a1_Tx: ComSignalType=UINT16
            OBJ_YAW_RATE_ERR_022_oRDR_TRACKER_OBJ_022_oPCAN_RADAR_db2bd27d_Tx: ComSignalType=UINT8
        SG_TrackerObject023_oRDR_TRACKER_OBJ_023_oPCAN_RADAR_29c584c6_Tx
          49 x ComGroupSignal:
            OBJ_ACCELERATION_LAT_023_oRDR_TRACKER_OBJ_023_oPCAN_RADAR_27e1dfb1_Tx: ComSignalType=UINT16
            OBJ_ACCELERATION_LAT_ERR_023_oRDR_TRACKER_OBJ_023_oPCAN_RADAR_f215e50f_Tx: ComSignalType=UINT8
            OBJ_ACCELERATION_LONG_023_oRDR_TRACKER_OBJ_023_oPCAN_RADAR_55118651_Tx: ComSignalType=UINT16
            OBJ_ACCELERATION_LONG_ERR_023_oRDR_TRACKER_OBJ_023_oPCAN_RADAR_edb040a5_Tx: ComSignalType=UINT8
            OBJ_ACCEL_ERR_CRR_COEF_023_oRDR_TRACKER_OBJ_023_oPCAN_RADAR_4d1361c3_Tx: ComSignalType=UINT8
            OBJ_ALIVE_TIME_023_oRDR_TRACKER_OBJ_023_oPCAN_RADAR_3570cded_Tx: ComSignalType=UINT16
            OBJ_CLS_TYPE1_023_oRDR_TRACKER_OBJ_023_oPCAN_RADAR_a2ab2ccb_Tx: ComSignalType=UINT8
            OBJ_CLS_TYPE1_PROB_023_oRDR_TRACKER_OBJ_023_oPCAN_RADAR_0af3fb38_Tx: ComSignalType=UINT8
            OBJ_CLS_TYPE2_023_oRDR_TRACKER_OBJ_023_oPCAN_RADAR_ef432cac_Tx: ComSignalType=UINT8
            OBJ_CLS_TYPE2_PROB_023_oRDR_TRACKER_OBJ_023_oPCAN_RADAR_c3c7e035_Tx: ComSignalType=UINT8
            OBJ_CLS_TYPE3_023_oRDR_TRACKER_OBJ_023_oPCAN_RADAR_62cbd14e_Tx: ComSignalType=UINT8
            OBJ_CLS_TYPE3_PROB_023_oRDR_TRACKER_OBJ_023_oPCAN_RADAR_84d416ce_Tx: ComSignalType=UINT8
            OBJ_CLS_TYPE4_023_oRDR_TRACKER_OBJ_023_oPCAN_RADAR_74932c62_Tx: ComSignalType=UINT8
            OBJ_CLS_TYPE4_PROB_023_oRDR_TRACKER_OBJ_023_oPCAN_RADAR_8aded06e_Tx: ComSignalType=UINT8
            OBJ_CLS_TYPE5_023_oRDR_TRACKER_OBJ_023_oPCAN_RADAR_f91bd180_Tx: ComSignalType=UINT8
            OBJ_CLS_TYPE5_PROB_023_oRDR_TRACKER_OBJ_023_oPCAN_RADAR_cdcd2695_Tx: ComSignalType=UINT8
            OBJ_CLS_TYPE6_023_oRDR_TRACKER_OBJ_023_oPCAN_RADAR_b4f3d1e7_Tx: ComSignalType=UINT8
            OBJ_CLS_TYPE6_PROB_023_oRDR_TRACKER_OBJ_023_oPCAN_RADAR_04f93d98_Tx: ComSignalType=UINT8
            OBJ_DIMENSION_LENGTH_023_oRDR_TRACKER_OBJ_023_oPCAN_RADAR_e0357f8f_Tx: ComSignalType=UINT16
            OBJ_DIMENSION_LENGTH_ERR_023_oRDR_TRACKER_OBJ_023_oPCAN_RADAR_dbcd60f5_Tx: ComSignalType=UINT16
            OBJ_DIMENSION_WIDTH_023_oRDR_TRACKER_OBJ_023_oPCAN_RADAR_c3fb8822_Tx: ComSignalType=UINT16
            OBJ_DIMENSION_WIDTH_ERR_023_oRDR_TRACKER_OBJ_023_oPCAN_RADAR_23594fca_Tx: ComSignalType=UINT8
            OBJ_EXISTENCE_PROB_023_oRDR_TRACKER_OBJ_023_oPCAN_RADAR_c8470c1f_Tx: ComSignalType=UINT16
            OBJ_GROUP_ID_023_oRDR_TRACKER_OBJ_023_oPCAN_RADAR_413518b2_Tx: ComSignalType=UINT8
            OBJ_ID_023_oRDR_TRACKER_OBJ_023_oPCAN_RADAR_b21b33b5_Tx: ComSignalType=UINT8
            OBJ_MEASUREMENT_STATUS_023_oRDR_TRACKER_OBJ_023_oPCAN_RADAR_cdc94108_Tx: ComSignalType=UINT8
            OBJ_MH_CRC16_023_oRDR_TRACKER_OBJ_023_oPCAN_RADAR_b1a9f634_Tx: ComSignalType=UINT16
            OBJ_MH_CYCLE_COUNTER_023_oRDR_TRACKER_OBJ_023_oPCAN_RADAR_c04dacd5_Tx: ComSignalType=UINT8
            OBJ_MOVEMENT_STATUS_023_oRDR_TRACKER_OBJ_023_oPCAN_RADAR_e267d444_Tx: ComSignalType=UINT8
            OBJ_POS_ERR_CRR_COEF_023_oRDR_TRACKER_OBJ_023_oPCAN_RADAR_7218147e_Tx: ComSignalType=UINT8
            OBJ_POS_LAT_023_oRDR_TRACKER_OBJ_023_oPCAN_RADAR_90b7e932_Tx: ComSignalType=UINT16
            OBJ_POS_LAT_ERR_023_oRDR_TRACKER_OBJ_023_oPCAN_RADAR_94fbb905_Tx: ComSignalType=UINT8
            OBJ_POS_LONG_023_oRDR_TRACKER_OBJ_023_oPCAN_RADAR_211702fd_Tx: ComSignalType=UINT16
            OBJ_POS_LONG_ERR_023_oRDR_TRACKER_OBJ_023_oPCAN_RADAR_0d0347e7_Tx: ComSignalType=UINT8
            OBJ_RCS_023_oRDR_TRACKER_OBJ_023_oPCAN_RADAR_b278bf35_Tx: ComSignalType=UINT8
            OBJ_REF_PT_LAT_OFFSET_023_oRDR_TRACKER_OBJ_023_oPCAN_RADAR_4745d440_Tx: ComSignalType=UINT16
            OBJ_REF_PT_LONG_OFFSET_023_oRDR_TRACKER_OBJ_023_oPCAN_RADAR_08172443_Tx: ComSignalType=UINT16
            OBJ_TIMESTAMP_OFFSET_023_oRDR_TRACKER_OBJ_023_oPCAN_RADAR_b2d4bf63_Tx: ComSignalType=UINT8
            OBJ_TRACK_MOTION_MODEL_023_oRDR_TRACKER_OBJ_023_oPCAN_RADAR_7ed7bebe_Tx: ComSignalType=UINT8
            OBJ_VEH_TRACK_FLAG_023_oRDR_TRACKER_OBJ_023_oPCAN_RADAR_fcfd48e3_Tx: ComSignalType=BOOLEAN
            OBJ_VELOCITY_ERR_CRR_COEF_023_oRDR_TRACKER_OBJ_023_oPCAN_RADAR_db62299f_Tx: ComSignalType=UINT8
            OBJ_VELOCITY_LAT_023_oRDR_TRACKER_OBJ_023_oPCAN_RADAR_d4d4ac15_Tx: ComSignalType=UINT16
            OBJ_VELOCITY_LAT_ERR_023_oRDR_TRACKER_OBJ_023_oPCAN_RADAR_e02edc44_Tx: ComSignalType=UINT8
            OBJ_VELOCITY_LONG_023_oRDR_TRACKER_OBJ_023_oPCAN_RADAR_8459d4d3_Tx: ComSignalType=UINT16
            OBJ_VELOCITY_LONG_ERR_023_oRDR_TRACKER_OBJ_023_oPCAN_RADAR_0cace384_Tx: ComSignalType=UINT8
            OBJ_YAW_ANGLE_023_oRDR_TRACKER_OBJ_023_oPCAN_RADAR_3868e855_Tx: ComSignalType=UINT16
            OBJ_YAW_ANGLE_ERR_023_oRDR_TRACKER_OBJ_023_oPCAN_RADAR_ed65ee82_Tx: ComSignalType=UINT8
            OBJ_YAW_RATE_023_oRDR_TRACKER_OBJ_023_oPCAN_RADAR_1de7cd12_Tx: ComSignalType=UINT16
            OBJ_YAW_RATE_ERR_023_oRDR_TRACKER_OBJ_023_oPCAN_RADAR_223f5ace_Tx: ComSignalType=UINT8
        SG_TrackerObject024_oRDR_TRACKER_OBJ_024_oPCAN_RADAR_ab39351c_Tx
          49 x ComGroupSignal:
            OBJ_ACCELERATION_LAT_024_oRDR_TRACKER_OBJ_024_oPCAN_RADAR_a51d6e6b_Tx: ComSignalType=UINT16
            OBJ_ACCELERATION_LAT_ERR_024_oRDR_TRACKER_OBJ_024_oPCAN_RADAR_70e954d5_Tx: ComSignalType=UINT8
            OBJ_ACCELERATION_LONG_024_oRDR_TRACKER_OBJ_024_oPCAN_RADAR_d7ed378b_Tx: ComSignalType=UINT16
            OBJ_ACCELERATION_LONG_ERR_024_oRDR_TRACKER_OBJ_024_oPCAN_RADAR_6f4cf17f_Tx: ComSignalType=UINT8
            OBJ_ACCEL_ERR_CRR_COEF_024_oRDR_TRACKER_OBJ_024_oPCAN_RADAR_cfefd019_Tx: ComSignalType=UINT8
            OBJ_ALIVE_TIME_024_oRDR_TRACKER_OBJ_024_oPCAN_RADAR_b78c7c37_Tx: ComSignalType=UINT16
            OBJ_CLS_TYPE1_024_oRDR_TRACKER_OBJ_024_oPCAN_RADAR_20579d11_Tx: ComSignalType=UINT8
            OBJ_CLS_TYPE1_PROB_024_oRDR_TRACKER_OBJ_024_oPCAN_RADAR_880f4ae2_Tx: ComSignalType=UINT8
            OBJ_CLS_TYPE2_024_oRDR_TRACKER_OBJ_024_oPCAN_RADAR_6dbf9d76_Tx: ComSignalType=UINT8
            OBJ_CLS_TYPE2_PROB_024_oRDR_TRACKER_OBJ_024_oPCAN_RADAR_413b51ef_Tx: ComSignalType=UINT8
            OBJ_CLS_TYPE3_024_oRDR_TRACKER_OBJ_024_oPCAN_RADAR_e0376094_Tx: ComSignalType=UINT8
            OBJ_CLS_TYPE3_PROB_024_oRDR_TRACKER_OBJ_024_oPCAN_RADAR_0628a714_Tx: ComSignalType=UINT8
            OBJ_CLS_TYPE4_024_oRDR_TRACKER_OBJ_024_oPCAN_RADAR_f66f9db8_Tx: ComSignalType=UINT8
            OBJ_CLS_TYPE4_PROB_024_oRDR_TRACKER_OBJ_024_oPCAN_RADAR_082261b4_Tx: ComSignalType=UINT8
            OBJ_CLS_TYPE5_024_oRDR_TRACKER_OBJ_024_oPCAN_RADAR_7be7605a_Tx: ComSignalType=UINT8
            OBJ_CLS_TYPE5_PROB_024_oRDR_TRACKER_OBJ_024_oPCAN_RADAR_4f31974f_Tx: ComSignalType=UINT8
            OBJ_CLS_TYPE6_024_oRDR_TRACKER_OBJ_024_oPCAN_RADAR_360f603d_Tx: ComSignalType=UINT8
            OBJ_CLS_TYPE6_PROB_024_oRDR_TRACKER_OBJ_024_oPCAN_RADAR_86058c42_Tx: ComSignalType=UINT8
            OBJ_DIMENSION_LENGTH_024_oRDR_TRACKER_OBJ_024_oPCAN_RADAR_62c9ce55_Tx: ComSignalType=UINT16
            OBJ_DIMENSION_LENGTH_ERR_024_oRDR_TRACKER_OBJ_024_oPCAN_RADAR_5931d12f_Tx: ComSignalType=UINT16
            OBJ_DIMENSION_WIDTH_024_oRDR_TRACKER_OBJ_024_oPCAN_RADAR_410739f8_Tx: ComSignalType=UINT16
            OBJ_DIMENSION_WIDTH_ERR_024_oRDR_TRACKER_OBJ_024_oPCAN_RADAR_a1a5fe10_Tx: ComSignalType=UINT8
            OBJ_EXISTENCE_PROB_024_oRDR_TRACKER_OBJ_024_oPCAN_RADAR_4abbbdc5_Tx: ComSignalType=UINT16
            OBJ_GROUP_ID_024_oRDR_TRACKER_OBJ_024_oPCAN_RADAR_c3c9a968_Tx: ComSignalType=UINT8
            OBJ_ID_024_oRDR_TRACKER_OBJ_024_oPCAN_RADAR_30e7826f_Tx: ComSignalType=UINT8
            OBJ_MEASUREMENT_STATUS_024_oRDR_TRACKER_OBJ_024_oPCAN_RADAR_4f35f0d2_Tx: ComSignalType=UINT8
            OBJ_MH_CRC16_024_oRDR_TRACKER_OBJ_024_oPCAN_RADAR_335547ee_Tx: ComSignalType=UINT16
            OBJ_MH_CYCLE_COUNTER_024_oRDR_TRACKER_OBJ_024_oPCAN_RADAR_42b11d0f_Tx: ComSignalType=UINT8
            OBJ_MOVEMENT_STATUS_024_oRDR_TRACKER_OBJ_024_oPCAN_RADAR_609b659e_Tx: ComSignalType=UINT8
            OBJ_POS_ERR_CRR_COEF_024_oRDR_TRACKER_OBJ_024_oPCAN_RADAR_f0e4a5a4_Tx: ComSignalType=UINT8
            OBJ_POS_LAT_024_oRDR_TRACKER_OBJ_024_oPCAN_RADAR_124b58e8_Tx: ComSignalType=UINT16
            OBJ_POS_LAT_ERR_024_oRDR_TRACKER_OBJ_024_oPCAN_RADAR_160708df_Tx: ComSignalType=UINT8
            OBJ_POS_LONG_024_oRDR_TRACKER_OBJ_024_oPCAN_RADAR_a3ebb327_Tx: ComSignalType=UINT16
            OBJ_POS_LONG_ERR_024_oRDR_TRACKER_OBJ_024_oPCAN_RADAR_8ffff63d_Tx: ComSignalType=UINT8
            OBJ_RCS_024_oRDR_TRACKER_OBJ_024_oPCAN_RADAR_30840eef_Tx: ComSignalType=UINT8
            OBJ_REF_PT_LAT_OFFSET_024_oRDR_TRACKER_OBJ_024_oPCAN_RADAR_c5b9659a_Tx: ComSignalType=UINT16
            OBJ_REF_PT_LONG_OFFSET_024_oRDR_TRACKER_OBJ_024_oPCAN_RADAR_8aeb9599_Tx: ComSignalType=UINT16
            OBJ_TIMESTAMP_OFFSET_024_oRDR_TRACKER_OBJ_024_oPCAN_RADAR_30280eb9_Tx: ComSignalType=UINT8
            OBJ_TRACK_MOTION_MODEL_024_oRDR_TRACKER_OBJ_024_oPCAN_RADAR_fc2b0f64_Tx: ComSignalType=UINT8
            OBJ_VEH_TRACK_FLAG_024_oRDR_TRACKER_OBJ_024_oPCAN_RADAR_7e01f939_Tx: ComSignalType=BOOLEAN
            OBJ_VELOCITY_ERR_CRR_COEF_024_oRDR_TRACKER_OBJ_024_oPCAN_RADAR_599e9845_Tx: ComSignalType=UINT8
            OBJ_VELOCITY_LAT_024_oRDR_TRACKER_OBJ_024_oPCAN_RADAR_56281dcf_Tx: ComSignalType=UINT16
            OBJ_VELOCITY_LAT_ERR_024_oRDR_TRACKER_OBJ_024_oPCAN_RADAR_62d26d9e_Tx: ComSignalType=UINT8
            OBJ_VELOCITY_LONG_024_oRDR_TRACKER_OBJ_024_oPCAN_RADAR_06a56509_Tx: ComSignalType=UINT16
            OBJ_VELOCITY_LONG_ERR_024_oRDR_TRACKER_OBJ_024_oPCAN_RADAR_8e50525e_Tx: ComSignalType=UINT8
            OBJ_YAW_ANGLE_024_oRDR_TRACKER_OBJ_024_oPCAN_RADAR_ba94598f_Tx: ComSignalType=UINT16
            OBJ_YAW_ANGLE_ERR_024_oRDR_TRACKER_OBJ_024_oPCAN_RADAR_6f995f58_Tx: ComSignalType=UINT8
            OBJ_YAW_RATE_024_oRDR_TRACKER_OBJ_024_oPCAN_RADAR_9f1b7cc8_Tx: ComSignalType=UINT16
            OBJ_YAW_RATE_ERR_024_oRDR_TRACKER_OBJ_024_oPCAN_RADAR_a0c3eb14_Tx: ComSignalType=UINT8
        SG_TrackerObject025_oRDR_TRACKER_OBJ_025_oPCAN_RADAR_522dbdaf_Tx
          49 x ComGroupSignal:
            OBJ_ACCELERATION_LAT_025_oRDR_TRACKER_OBJ_025_oPCAN_RADAR_5c09e6d8_Tx: ComSignalType=UINT16
            OBJ_ACCELERATION_LAT_ERR_025_oRDR_TRACKER_OBJ_025_oPCAN_RADAR_89fddc66_Tx: ComSignalType=UINT8
            OBJ_ACCELERATION_LONG_025_oRDR_TRACKER_OBJ_025_oPCAN_RADAR_2ef9bf38_Tx: ComSignalType=UINT16
            OBJ_ACCELERATION_LONG_ERR_025_oRDR_TRACKER_OBJ_025_oPCAN_RADAR_965879cc_Tx: ComSignalType=UINT8
            OBJ_ACCEL_ERR_CRR_COEF_025_oRDR_TRACKER_OBJ_025_oPCAN_RADAR_36fb58aa_Tx: ComSignalType=UINT8
            OBJ_ALIVE_TIME_025_oRDR_TRACKER_OBJ_025_oPCAN_RADAR_4e98f484_Tx: ComSignalType=UINT16
            OBJ_CLS_TYPE1_025_oRDR_TRACKER_OBJ_025_oPCAN_RADAR_d94315a2_Tx: ComSignalType=UINT8
            OBJ_CLS_TYPE1_PROB_025_oRDR_TRACKER_OBJ_025_oPCAN_RADAR_711bc251_Tx: ComSignalType=UINT8
            OBJ_CLS_TYPE2_025_oRDR_TRACKER_OBJ_025_oPCAN_RADAR_94ab15c5_Tx: ComSignalType=UINT8
            OBJ_CLS_TYPE2_PROB_025_oRDR_TRACKER_OBJ_025_oPCAN_RADAR_b82fd95c_Tx: ComSignalType=UINT8
            OBJ_CLS_TYPE3_025_oRDR_TRACKER_OBJ_025_oPCAN_RADAR_1923e827_Tx: ComSignalType=UINT8
            OBJ_CLS_TYPE3_PROB_025_oRDR_TRACKER_OBJ_025_oPCAN_RADAR_ff3c2fa7_Tx: ComSignalType=UINT8
            OBJ_CLS_TYPE4_025_oRDR_TRACKER_OBJ_025_oPCAN_RADAR_0f7b150b_Tx: ComSignalType=UINT8
            OBJ_CLS_TYPE4_PROB_025_oRDR_TRACKER_OBJ_025_oPCAN_RADAR_f136e907_Tx: ComSignalType=UINT8
            OBJ_CLS_TYPE5_025_oRDR_TRACKER_OBJ_025_oPCAN_RADAR_82f3e8e9_Tx: ComSignalType=UINT8
            OBJ_CLS_TYPE5_PROB_025_oRDR_TRACKER_OBJ_025_oPCAN_RADAR_b6251ffc_Tx: ComSignalType=UINT8
            OBJ_CLS_TYPE6_025_oRDR_TRACKER_OBJ_025_oPCAN_RADAR_cf1be88e_Tx: ComSignalType=UINT8
            OBJ_CLS_TYPE6_PROB_025_oRDR_TRACKER_OBJ_025_oPCAN_RADAR_7f1104f1_Tx: ComSignalType=UINT8
            OBJ_DIMENSION_LENGTH_025_oRDR_TRACKER_OBJ_025_oPCAN_RADAR_9bdd46e6_Tx: ComSignalType=UINT16
            OBJ_DIMENSION_LENGTH_ERR_025_oRDR_TRACKER_OBJ_025_oPCAN_RADAR_a025599c_Tx: ComSignalType=UINT16
            OBJ_DIMENSION_WIDTH_025_oRDR_TRACKER_OBJ_025_oPCAN_RADAR_b813b14b_Tx: ComSignalType=UINT16
            OBJ_DIMENSION_WIDTH_ERR_025_oRDR_TRACKER_OBJ_025_oPCAN_RADAR_58b176a3_Tx: ComSignalType=UINT8
            OBJ_EXISTENCE_PROB_025_oRDR_TRACKER_OBJ_025_oPCAN_RADAR_b3af3576_Tx: ComSignalType=UINT16
            OBJ_GROUP_ID_025_oRDR_TRACKER_OBJ_025_oPCAN_RADAR_3add21db_Tx: ComSignalType=UINT8
            OBJ_ID_025_oRDR_TRACKER_OBJ_025_oPCAN_RADAR_c9f30adc_Tx: ComSignalType=UINT8
            OBJ_MEASUREMENT_STATUS_025_oRDR_TRACKER_OBJ_025_oPCAN_RADAR_b6217861_Tx: ComSignalType=UINT8
            OBJ_MH_CRC16_025_oRDR_TRACKER_OBJ_025_oPCAN_RADAR_ca41cf5d_Tx: ComSignalType=UINT16
            OBJ_MH_CYCLE_COUNTER_025_oRDR_TRACKER_OBJ_025_oPCAN_RADAR_bba595bc_Tx: ComSignalType=UINT8
            OBJ_MOVEMENT_STATUS_025_oRDR_TRACKER_OBJ_025_oPCAN_RADAR_998fed2d_Tx: ComSignalType=UINT8
            OBJ_POS_ERR_CRR_COEF_025_oRDR_TRACKER_OBJ_025_oPCAN_RADAR_09f02d17_Tx: ComSignalType=UINT8
            OBJ_POS_LAT_025_oRDR_TRACKER_OBJ_025_oPCAN_RADAR_eb5fd05b_Tx: ComSignalType=UINT16
            OBJ_POS_LAT_ERR_025_oRDR_TRACKER_OBJ_025_oPCAN_RADAR_ef13806c_Tx: ComSignalType=UINT8
            OBJ_POS_LONG_025_oRDR_TRACKER_OBJ_025_oPCAN_RADAR_5aff3b94_Tx: ComSignalType=UINT16
            OBJ_POS_LONG_ERR_025_oRDR_TRACKER_OBJ_025_oPCAN_RADAR_76eb7e8e_Tx: ComSignalType=UINT8
            OBJ_RCS_025_oRDR_TRACKER_OBJ_025_oPCAN_RADAR_c990865c_Tx: ComSignalType=UINT8
            OBJ_REF_PT_LAT_OFFSET_025_oRDR_TRACKER_OBJ_025_oPCAN_RADAR_3caded29_Tx: ComSignalType=UINT16
            OBJ_REF_PT_LONG_OFFSET_025_oRDR_TRACKER_OBJ_025_oPCAN_RADAR_73ff1d2a_Tx: ComSignalType=UINT16
            OBJ_TIMESTAMP_OFFSET_025_oRDR_TRACKER_OBJ_025_oPCAN_RADAR_c93c860a_Tx: ComSignalType=UINT8
            OBJ_TRACK_MOTION_MODEL_025_oRDR_TRACKER_OBJ_025_oPCAN_RADAR_053f87d7_Tx: ComSignalType=UINT8
            OBJ_VEH_TRACK_FLAG_025_oRDR_TRACKER_OBJ_025_oPCAN_RADAR_8715718a_Tx: ComSignalType=BOOLEAN
            OBJ_VELOCITY_ERR_CRR_COEF_025_oRDR_TRACKER_OBJ_025_oPCAN_RADAR_a08a10f6_Tx: ComSignalType=UINT8
            OBJ_VELOCITY_LAT_025_oRDR_TRACKER_OBJ_025_oPCAN_RADAR_af3c957c_Tx: ComSignalType=UINT16
            OBJ_VELOCITY_LAT_ERR_025_oRDR_TRACKER_OBJ_025_oPCAN_RADAR_9bc6e52d_Tx: ComSignalType=UINT8
            OBJ_VELOCITY_LONG_025_oRDR_TRACKER_OBJ_025_oPCAN_RADAR_ffb1edba_Tx: ComSignalType=UINT16
            OBJ_VELOCITY_LONG_ERR_025_oRDR_TRACKER_OBJ_025_oPCAN_RADAR_7744daed_Tx: ComSignalType=UINT8
            OBJ_YAW_ANGLE_025_oRDR_TRACKER_OBJ_025_oPCAN_RADAR_4380d13c_Tx: ComSignalType=UINT16
            OBJ_YAW_ANGLE_ERR_025_oRDR_TRACKER_OBJ_025_oPCAN_RADAR_968dd7eb_Tx: ComSignalType=UINT8
            OBJ_YAW_RATE_025_oRDR_TRACKER_OBJ_025_oPCAN_RADAR_660ff47b_Tx: ComSignalType=UINT16
            OBJ_YAW_RATE_ERR_025_oRDR_TRACKER_OBJ_025_oPCAN_RADAR_59d763a7_Tx: ComSignalType=UINT8
        SG_TrackerObject026_oRDR_TRACKER_OBJ_026_oPCAN_RADAR_8261223b_Tx
          49 x ComGroupSignal:
            OBJ_ACCELERATION_LAT_026_oRDR_TRACKER_OBJ_026_oPCAN_RADAR_8c45794c_Tx: ComSignalType=UINT16
            OBJ_ACCELERATION_LAT_ERR_026_oRDR_TRACKER_OBJ_026_oPCAN_RADAR_59b143f2_Tx: ComSignalType=UINT8
            OBJ_ACCELERATION_LONG_026_oRDR_TRACKER_OBJ_026_oPCAN_RADAR_feb520ac_Tx: ComSignalType=UINT16
            OBJ_ACCELERATION_LONG_ERR_026_oRDR_TRACKER_OBJ_026_oPCAN_RADAR_4614e658_Tx: ComSignalType=UINT8
            OBJ_ACCEL_ERR_CRR_COEF_026_oRDR_TRACKER_OBJ_026_oPCAN_RADAR_e6b7c73e_Tx: ComSignalType=UINT8
            OBJ_ALIVE_TIME_026_oRDR_TRACKER_OBJ_026_oPCAN_RADAR_9ed46b10_Tx: ComSignalType=UINT16
            OBJ_CLS_TYPE1_026_oRDR_TRACKER_OBJ_026_oPCAN_RADAR_090f8a36_Tx: ComSignalType=UINT8
            OBJ_CLS_TYPE1_PROB_026_oRDR_TRACKER_OBJ_026_oPCAN_RADAR_a1575dc5_Tx: ComSignalType=UINT8
            OBJ_CLS_TYPE2_026_oRDR_TRACKER_OBJ_026_oPCAN_RADAR_44e78a51_Tx: ComSignalType=UINT8
            OBJ_CLS_TYPE2_PROB_026_oRDR_TRACKER_OBJ_026_oPCAN_RADAR_686346c8_Tx: ComSignalType=UINT8
            OBJ_CLS_TYPE3_026_oRDR_TRACKER_OBJ_026_oPCAN_RADAR_c96f77b3_Tx: ComSignalType=UINT8
            OBJ_CLS_TYPE3_PROB_026_oRDR_TRACKER_OBJ_026_oPCAN_RADAR_2f70b033_Tx: ComSignalType=UINT8
            OBJ_CLS_TYPE4_026_oRDR_TRACKER_OBJ_026_oPCAN_RADAR_df378a9f_Tx: ComSignalType=UINT8
            OBJ_CLS_TYPE4_PROB_026_oRDR_TRACKER_OBJ_026_oPCAN_RADAR_217a7693_Tx: ComSignalType=UINT8
            OBJ_CLS_TYPE5_026_oRDR_TRACKER_OBJ_026_oPCAN_RADAR_52bf777d_Tx: ComSignalType=UINT8
            OBJ_CLS_TYPE5_PROB_026_oRDR_TRACKER_OBJ_026_oPCAN_RADAR_66698068_Tx: ComSignalType=UINT8
            OBJ_CLS_TYPE6_026_oRDR_TRACKER_OBJ_026_oPCAN_RADAR_1f57771a_Tx: ComSignalType=UINT8
            OBJ_CLS_TYPE6_PROB_026_oRDR_TRACKER_OBJ_026_oPCAN_RADAR_af5d9b65_Tx: ComSignalType=UINT8
            OBJ_DIMENSION_LENGTH_026_oRDR_TRACKER_OBJ_026_oPCAN_RADAR_4b91d972_Tx: ComSignalType=UINT16
            OBJ_DIMENSION_LENGTH_ERR_026_oRDR_TRACKER_OBJ_026_oPCAN_RADAR_7069c608_Tx: ComSignalType=UINT16
            OBJ_DIMENSION_WIDTH_026_oRDR_TRACKER_OBJ_026_oPCAN_RADAR_685f2edf_Tx: ComSignalType=UINT16
            OBJ_DIMENSION_WIDTH_ERR_026_oRDR_TRACKER_OBJ_026_oPCAN_RADAR_88fde937_Tx: ComSignalType=UINT8
            OBJ_EXISTENCE_PROB_026_oRDR_TRACKER_OBJ_026_oPCAN_RADAR_63e3aae2_Tx: ComSignalType=UINT16
            OBJ_GROUP_ID_026_oRDR_TRACKER_OBJ_026_oPCAN_RADAR_ea91be4f_Tx: ComSignalType=UINT8
            OBJ_ID_026_oRDR_TRACKER_OBJ_026_oPCAN_RADAR_19bf9548_Tx: ComSignalType=UINT8
            OBJ_MEASUREMENT_STATUS_026_oRDR_TRACKER_OBJ_026_oPCAN_RADAR_666de7f5_Tx: ComSignalType=UINT8
            OBJ_MH_CRC16_026_oRDR_TRACKER_OBJ_026_oPCAN_RADAR_1a0d50c9_Tx: ComSignalType=UINT16
            OBJ_MH_CYCLE_COUNTER_026_oRDR_TRACKER_OBJ_026_oPCAN_RADAR_6be90a28_Tx: ComSignalType=UINT8
            OBJ_MOVEMENT_STATUS_026_oRDR_TRACKER_OBJ_026_oPCAN_RADAR_49c372b9_Tx: ComSignalType=UINT8
            OBJ_POS_ERR_CRR_COEF_026_oRDR_TRACKER_OBJ_026_oPCAN_RADAR_d9bcb283_Tx: ComSignalType=UINT8
            OBJ_POS_LAT_026_oRDR_TRACKER_OBJ_026_oPCAN_RADAR_3b134fcf_Tx: ComSignalType=UINT16
            OBJ_POS_LAT_ERR_026_oRDR_TRACKER_OBJ_026_oPCAN_RADAR_3f5f1ff8_Tx: ComSignalType=UINT8
            OBJ_POS_LONG_026_oRDR_TRACKER_OBJ_026_oPCAN_RADAR_8ab3a400_Tx: ComSignalType=UINT16
            OBJ_POS_LONG_ERR_026_oRDR_TRACKER_OBJ_026_oPCAN_RADAR_a6a7e11a_Tx: ComSignalType=UINT8
            OBJ_RCS_026_oRDR_TRACKER_OBJ_026_oPCAN_RADAR_19dc19c8_Tx: ComSignalType=UINT8
            OBJ_REF_PT_LAT_OFFSET_026_oRDR_TRACKER_OBJ_026_oPCAN_RADAR_ece172bd_Tx: ComSignalType=UINT16
            OBJ_REF_PT_LONG_OFFSET_026_oRDR_TRACKER_OBJ_026_oPCAN_RADAR_a3b382be_Tx: ComSignalType=UINT16
            OBJ_TIMESTAMP_OFFSET_026_oRDR_TRACKER_OBJ_026_oPCAN_RADAR_1970199e_Tx: ComSignalType=UINT8
            OBJ_TRACK_MOTION_MODEL_026_oRDR_TRACKER_OBJ_026_oPCAN_RADAR_d5731843_Tx: ComSignalType=UINT8
            OBJ_VEH_TRACK_FLAG_026_oRDR_TRACKER_OBJ_026_oPCAN_RADAR_5759ee1e_Tx: ComSignalType=BOOLEAN
            OBJ_VELOCITY_ERR_CRR_COEF_026_oRDR_TRACKER_OBJ_026_oPCAN_RADAR_70c68f62_Tx: ComSignalType=UINT8
            OBJ_VELOCITY_LAT_026_oRDR_TRACKER_OBJ_026_oPCAN_RADAR_7f700ae8_Tx: ComSignalType=UINT16
            OBJ_VELOCITY_LAT_ERR_026_oRDR_TRACKER_OBJ_026_oPCAN_RADAR_4b8a7ab9_Tx: ComSignalType=UINT8
            OBJ_VELOCITY_LONG_026_oRDR_TRACKER_OBJ_026_oPCAN_RADAR_2ffd722e_Tx: ComSignalType=UINT16
            OBJ_VELOCITY_LONG_ERR_026_oRDR_TRACKER_OBJ_026_oPCAN_RADAR_a7084579_Tx: ComSignalType=UINT8
            OBJ_YAW_ANGLE_026_oRDR_TRACKER_OBJ_026_oPCAN_RADAR_93cc4ea8_Tx: ComSignalType=UINT16
            OBJ_YAW_ANGLE_ERR_026_oRDR_TRACKER_OBJ_026_oPCAN_RADAR_46c1487f_Tx: ComSignalType=UINT8
            OBJ_YAW_RATE_026_oRDR_TRACKER_OBJ_026_oPCAN_RADAR_b6436bef_Tx: ComSignalType=UINT16
            OBJ_YAW_RATE_ERR_026_oRDR_TRACKER_OBJ_026_oPCAN_RADAR_899bfc33_Tx: ComSignalType=UINT8
        SG_TrackerObject027_oRDR_TRACKER_OBJ_027_oPCAN_RADAR_7b75aa88_Tx
          49 x ComGroupSignal:
            OBJ_ACCELERATION_LAT_027_oRDR_TRACKER_OBJ_027_oPCAN_RADAR_7551f1ff_Tx: ComSignalType=UINT16
            OBJ_ACCELERATION_LAT_ERR_027_oRDR_TRACKER_OBJ_027_oPCAN_RADAR_a0a5cb41_Tx: ComSignalType=UINT8
            OBJ_ACCELERATION_LONG_027_oRDR_TRACKER_OBJ_027_oPCAN_RADAR_07a1a81f_Tx: ComSignalType=UINT16
            OBJ_ACCELERATION_LONG_ERR_027_oRDR_TRACKER_OBJ_027_oPCAN_RADAR_bf006eeb_Tx: ComSignalType=UINT8
            OBJ_ACCEL_ERR_CRR_COEF_027_oRDR_TRACKER_OBJ_027_oPCAN_RADAR_1fa34f8d_Tx: ComSignalType=UINT8
            OBJ_ALIVE_TIME_027_oRDR_TRACKER_OBJ_027_oPCAN_RADAR_67c0e3a3_Tx: ComSignalType=UINT16
            OBJ_CLS_TYPE1_027_oRDR_TRACKER_OBJ_027_oPCAN_RADAR_f01b0285_Tx: ComSignalType=UINT8
            OBJ_CLS_TYPE1_PROB_027_oRDR_TRACKER_OBJ_027_oPCAN_RADAR_5843d576_Tx: ComSignalType=UINT8
            OBJ_CLS_TYPE2_027_oRDR_TRACKER_OBJ_027_oPCAN_RADAR_bdf302e2_Tx: ComSignalType=UINT8
            OBJ_CLS_TYPE2_PROB_027_oRDR_TRACKER_OBJ_027_oPCAN_RADAR_9177ce7b_Tx: ComSignalType=UINT8
            OBJ_CLS_TYPE3_027_oRDR_TRACKER_OBJ_027_oPCAN_RADAR_307bff00_Tx: ComSignalType=UINT8
            OBJ_CLS_TYPE3_PROB_027_oRDR_TRACKER_OBJ_027_oPCAN_RADAR_d6643880_Tx: ComSignalType=UINT8
            OBJ_CLS_TYPE4_027_oRDR_TRACKER_OBJ_027_oPCAN_RADAR_2623022c_Tx: ComSignalType=UINT8
            OBJ_CLS_TYPE4_PROB_027_oRDR_TRACKER_OBJ_027_oPCAN_RADAR_d86efe20_Tx: ComSignalType=UINT8
            OBJ_CLS_TYPE5_027_oRDR_TRACKER_OBJ_027_oPCAN_RADAR_ababffce_Tx: ComSignalType=UINT8
            OBJ_CLS_TYPE5_PROB_027_oRDR_TRACKER_OBJ_027_oPCAN_RADAR_9f7d08db_Tx: ComSignalType=UINT8
            OBJ_CLS_TYPE6_027_oRDR_TRACKER_OBJ_027_oPCAN_RADAR_e643ffa9_Tx: ComSignalType=UINT8
            OBJ_CLS_TYPE6_PROB_027_oRDR_TRACKER_OBJ_027_oPCAN_RADAR_564913d6_Tx: ComSignalType=UINT8
            OBJ_DIMENSION_LENGTH_027_oRDR_TRACKER_OBJ_027_oPCAN_RADAR_b28551c1_Tx: ComSignalType=UINT16
            OBJ_DIMENSION_LENGTH_ERR_027_oRDR_TRACKER_OBJ_027_oPCAN_RADAR_897d4ebb_Tx: ComSignalType=UINT16
            OBJ_DIMENSION_WIDTH_027_oRDR_TRACKER_OBJ_027_oPCAN_RADAR_914ba66c_Tx: ComSignalType=UINT16
            OBJ_DIMENSION_WIDTH_ERR_027_oRDR_TRACKER_OBJ_027_oPCAN_RADAR_71e96184_Tx: ComSignalType=UINT8
            OBJ_EXISTENCE_PROB_027_oRDR_TRACKER_OBJ_027_oPCAN_RADAR_9af72251_Tx: ComSignalType=UINT16
            OBJ_GROUP_ID_027_oRDR_TRACKER_OBJ_027_oPCAN_RADAR_138536fc_Tx: ComSignalType=UINT8
            OBJ_ID_027_oRDR_TRACKER_OBJ_027_oPCAN_RADAR_e0ab1dfb_Tx: ComSignalType=UINT8
            OBJ_MEASUREMENT_STATUS_027_oRDR_TRACKER_OBJ_027_oPCAN_RADAR_9f796f46_Tx: ComSignalType=UINT8
            OBJ_MH_CRC16_027_oRDR_TRACKER_OBJ_027_oPCAN_RADAR_e319d87a_Tx: ComSignalType=UINT16
            OBJ_MH_CYCLE_COUNTER_027_oRDR_TRACKER_OBJ_027_oPCAN_RADAR_92fd829b_Tx: ComSignalType=UINT8
            OBJ_MOVEMENT_STATUS_027_oRDR_TRACKER_OBJ_027_oPCAN_RADAR_b0d7fa0a_Tx: ComSignalType=UINT8
            OBJ_POS_ERR_CRR_COEF_027_oRDR_TRACKER_OBJ_027_oPCAN_RADAR_20a83a30_Tx: ComSignalType=UINT8
            OBJ_POS_LAT_027_oRDR_TRACKER_OBJ_027_oPCAN_RADAR_c207c77c_Tx: ComSignalType=UINT16
            OBJ_POS_LAT_ERR_027_oRDR_TRACKER_OBJ_027_oPCAN_RADAR_c64b974b_Tx: ComSignalType=UINT8
            OBJ_POS_LONG_027_oRDR_TRACKER_OBJ_027_oPCAN_RADAR_73a72cb3_Tx: ComSignalType=UINT16
            OBJ_POS_LONG_ERR_027_oRDR_TRACKER_OBJ_027_oPCAN_RADAR_5fb369a9_Tx: ComSignalType=UINT8
            OBJ_RCS_027_oRDR_TRACKER_OBJ_027_oPCAN_RADAR_e0c8917b_Tx: ComSignalType=UINT8
            OBJ_REF_PT_LAT_OFFSET_027_oRDR_TRACKER_OBJ_027_oPCAN_RADAR_15f5fa0e_Tx: ComSignalType=UINT16
            OBJ_REF_PT_LONG_OFFSET_027_oRDR_TRACKER_OBJ_027_oPCAN_RADAR_5aa70a0d_Tx: ComSignalType=UINT16
            OBJ_TIMESTAMP_OFFSET_027_oRDR_TRACKER_OBJ_027_oPCAN_RADAR_e064912d_Tx: ComSignalType=UINT8
            OBJ_TRACK_MOTION_MODEL_027_oRDR_TRACKER_OBJ_027_oPCAN_RADAR_2c6790f0_Tx: ComSignalType=UINT8
            OBJ_VEH_TRACK_FLAG_027_oRDR_TRACKER_OBJ_027_oPCAN_RADAR_ae4d66ad_Tx: ComSignalType=BOOLEAN
            OBJ_VELOCITY_ERR_CRR_COEF_027_oRDR_TRACKER_OBJ_027_oPCAN_RADAR_89d207d1_Tx: ComSignalType=UINT8
            OBJ_VELOCITY_LAT_027_oRDR_TRACKER_OBJ_027_oPCAN_RADAR_8664825b_Tx: ComSignalType=UINT16
            OBJ_VELOCITY_LAT_ERR_027_oRDR_TRACKER_OBJ_027_oPCAN_RADAR_b29ef20a_Tx: ComSignalType=UINT8
            OBJ_VELOCITY_LONG_027_oRDR_TRACKER_OBJ_027_oPCAN_RADAR_d6e9fa9d_Tx: ComSignalType=UINT16
            OBJ_VELOCITY_LONG_ERR_027_oRDR_TRACKER_OBJ_027_oPCAN_RADAR_5e1ccdca_Tx: ComSignalType=UINT8
            OBJ_YAW_ANGLE_027_oRDR_TRACKER_OBJ_027_oPCAN_RADAR_6ad8c61b_Tx: ComSignalType=UINT16
            OBJ_YAW_ANGLE_ERR_027_oRDR_TRACKER_OBJ_027_oPCAN_RADAR_bfd5c0cc_Tx: ComSignalType=UINT8
            OBJ_YAW_RATE_027_oRDR_TRACKER_OBJ_027_oPCAN_RADAR_4f57e35c_Tx: ComSignalType=UINT16
            OBJ_YAW_RATE_ERR_027_oRDR_TRACKER_OBJ_027_oPCAN_RADAR_708f7480_Tx: ComSignalType=UINT8
        SG_TrackerObject028_oRDR_TRACKER_OBJ_028_oPCAN_RADAR_5ce947ce_Tx
          49 x ComGroupSignal:
            OBJ_ACCELERATION_LAT_028_oRDR_TRACKER_OBJ_028_oPCAN_RADAR_52cd1cb9_Tx: ComSignalType=UINT16
            OBJ_ACCELERATION_LAT_ERR_028_oRDR_TRACKER_OBJ_028_oPCAN_RADAR_87392607_Tx: ComSignalType=UINT8
            OBJ_ACCELERATION_LONG_028_oRDR_TRACKER_OBJ_028_oPCAN_RADAR_203d4559_Tx: ComSignalType=UINT16
            OBJ_ACCELERATION_LONG_ERR_028_oRDR_TRACKER_OBJ_028_oPCAN_RADAR_989c83ad_Tx: ComSignalType=UINT8
            OBJ_ACCEL_ERR_CRR_COEF_028_oRDR_TRACKER_OBJ_028_oPCAN_RADAR_383fa2cb_Tx: ComSignalType=UINT8
            OBJ_ALIVE_TIME_028_oRDR_TRACKER_OBJ_028_oPCAN_RADAR_405c0ee5_Tx: ComSignalType=UINT16
            OBJ_CLS_TYPE1_028_oRDR_TRACKER_OBJ_028_oPCAN_RADAR_d787efc3_Tx: ComSignalType=UINT8
            OBJ_CLS_TYPE1_PROB_028_oRDR_TRACKER_OBJ_028_oPCAN_RADAR_7fdf3830_Tx: ComSignalType=UINT8
            OBJ_CLS_TYPE2_028_oRDR_TRACKER_OBJ_028_oPCAN_RADAR_9a6fefa4_Tx: ComSignalType=UINT8
            OBJ_CLS_TYPE2_PROB_028_oRDR_TRACKER_OBJ_028_oPCAN_RADAR_b6eb233d_Tx: ComSignalType=UINT8
            OBJ_CLS_TYPE3_028_oRDR_TRACKER_OBJ_028_oPCAN_RADAR_17e71246_Tx: ComSignalType=UINT8
            OBJ_CLS_TYPE3_PROB_028_oRDR_TRACKER_OBJ_028_oPCAN_RADAR_f1f8d5c6_Tx: ComSignalType=UINT8
            OBJ_CLS_TYPE4_028_oRDR_TRACKER_OBJ_028_oPCAN_RADAR_01bfef6a_Tx: ComSignalType=UINT8
            OBJ_CLS_TYPE4_PROB_028_oRDR_TRACKER_OBJ_028_oPCAN_RADAR_fff21366_Tx: ComSignalType=UINT8
            OBJ_CLS_TYPE5_028_oRDR_TRACKER_OBJ_028_oPCAN_RADAR_8c371288_Tx: ComSignalType=UINT8
            OBJ_CLS_TYPE5_PROB_028_oRDR_TRACKER_OBJ_028_oPCAN_RADAR_b8e1e59d_Tx: ComSignalType=UINT8
            OBJ_CLS_TYPE6_028_oRDR_TRACKER_OBJ_028_oPCAN_RADAR_c1df12ef_Tx: ComSignalType=UINT8
            OBJ_CLS_TYPE6_PROB_028_oRDR_TRACKER_OBJ_028_oPCAN_RADAR_71d5fe90_Tx: ComSignalType=UINT8
            OBJ_DIMENSION_LENGTH_028_oRDR_TRACKER_OBJ_028_oPCAN_RADAR_9519bc87_Tx: ComSignalType=UINT16
            OBJ_DIMENSION_LENGTH_ERR_028_oRDR_TRACKER_OBJ_028_oPCAN_RADAR_aee1a3fd_Tx: ComSignalType=UINT16
            OBJ_DIMENSION_WIDTH_028_oRDR_TRACKER_OBJ_028_oPCAN_RADAR_b6d74b2a_Tx: ComSignalType=UINT16
            OBJ_DIMENSION_WIDTH_ERR_028_oRDR_TRACKER_OBJ_028_oPCAN_RADAR_56758cc2_Tx: ComSignalType=UINT8
            OBJ_EXISTENCE_PROB_028_oRDR_TRACKER_OBJ_028_oPCAN_RADAR_bd6bcf17_Tx: ComSignalType=UINT16
            OBJ_GROUP_ID_028_oRDR_TRACKER_OBJ_028_oPCAN_RADAR_3419dbba_Tx: ComSignalType=UINT8
            OBJ_ID_028_oRDR_TRACKER_OBJ_028_oPCAN_RADAR_c737f0bd_Tx: ComSignalType=UINT8
            OBJ_MEASUREMENT_STATUS_028_oRDR_TRACKER_OBJ_028_oPCAN_RADAR_b8e58200_Tx: ComSignalType=UINT8
            OBJ_MH_CRC16_028_oRDR_TRACKER_OBJ_028_oPCAN_RADAR_c485353c_Tx: ComSignalType=UINT16
            OBJ_MH_CYCLE_COUNTER_028_oRDR_TRACKER_OBJ_028_oPCAN_RADAR_b5616fdd_Tx: ComSignalType=UINT8
            OBJ_MOVEMENT_STATUS_028_oRDR_TRACKER_OBJ_028_oPCAN_RADAR_974b174c_Tx: ComSignalType=UINT8
            OBJ_POS_ERR_CRR_COEF_028_oRDR_TRACKER_OBJ_028_oPCAN_RADAR_0734d776_Tx: ComSignalType=UINT8
            OBJ_POS_LAT_028_oRDR_TRACKER_OBJ_028_oPCAN_RADAR_e59b2a3a_Tx: ComSignalType=UINT16
            OBJ_POS_LAT_ERR_028_oRDR_TRACKER_OBJ_028_oPCAN_RADAR_e1d77a0d_Tx: ComSignalType=UINT8
            OBJ_POS_LONG_028_oRDR_TRACKER_OBJ_028_oPCAN_RADAR_543bc1f5_Tx: ComSignalType=UINT16
            OBJ_POS_LONG_ERR_028_oRDR_TRACKER_OBJ_028_oPCAN_RADAR_782f84ef_Tx: ComSignalType=UINT8
            OBJ_RCS_028_oRDR_TRACKER_OBJ_028_oPCAN_RADAR_c7547c3d_Tx: ComSignalType=UINT8
            OBJ_REF_PT_LAT_OFFSET_028_oRDR_TRACKER_OBJ_028_oPCAN_RADAR_32691748_Tx: ComSignalType=UINT16
            OBJ_REF_PT_LONG_OFFSET_028_oRDR_TRACKER_OBJ_028_oPCAN_RADAR_7d3be74b_Tx: ComSignalType=UINT16
            OBJ_TIMESTAMP_OFFSET_028_oRDR_TRACKER_OBJ_028_oPCAN_RADAR_c7f87c6b_Tx: ComSignalType=UINT8
            OBJ_TRACK_MOTION_MODEL_028_oRDR_TRACKER_OBJ_028_oPCAN_RADAR_0bfb7db6_Tx: ComSignalType=UINT8
            OBJ_VEH_TRACK_FLAG_028_oRDR_TRACKER_OBJ_028_oPCAN_RADAR_89d18beb_Tx: ComSignalType=BOOLEAN
            OBJ_VELOCITY_ERR_CRR_COEF_028_oRDR_TRACKER_OBJ_028_oPCAN_RADAR_ae4eea97_Tx: ComSignalType=UINT8
            OBJ_VELOCITY_LAT_028_oRDR_TRACKER_OBJ_028_oPCAN_RADAR_a1f86f1d_Tx: ComSignalType=UINT16
            OBJ_VELOCITY_LAT_ERR_028_oRDR_TRACKER_OBJ_028_oPCAN_RADAR_95021f4c_Tx: ComSignalType=UINT8
            OBJ_VELOCITY_LONG_028_oRDR_TRACKER_OBJ_028_oPCAN_RADAR_f17517db_Tx: ComSignalType=UINT16
            OBJ_VELOCITY_LONG_ERR_028_oRDR_TRACKER_OBJ_028_oPCAN_RADAR_7980208c_Tx: ComSignalType=UINT8
            OBJ_YAW_ANGLE_028_oRDR_TRACKER_OBJ_028_oPCAN_RADAR_4d442b5d_Tx: ComSignalType=UINT16
            OBJ_YAW_ANGLE_ERR_028_oRDR_TRACKER_OBJ_028_oPCAN_RADAR_98492d8a_Tx: ComSignalType=UINT8
            OBJ_YAW_RATE_028_oRDR_TRACKER_OBJ_028_oPCAN_RADAR_68cb0e1a_Tx: ComSignalType=UINT16
            OBJ_YAW_RATE_ERR_028_oRDR_TRACKER_OBJ_028_oPCAN_RADAR_571399c6_Tx: ComSignalType=UINT8
        SG_TrackerObject029_oRDR_TRACKER_OBJ_029_oPCAN_RADAR_a5fdcf7d_Tx
          49 x ComGroupSignal:
            OBJ_ACCELERATION_LAT_029_oRDR_TRACKER_OBJ_029_oPCAN_RADAR_abd9940a_Tx: ComSignalType=UINT16
            OBJ_ACCELERATION_LAT_ERR_029_oRDR_TRACKER_OBJ_029_oPCAN_RADAR_7e2daeb4_Tx: ComSignalType=UINT8
            OBJ_ACCELERATION_LONG_029_oRDR_TRACKER_OBJ_029_oPCAN_RADAR_d929cdea_Tx: ComSignalType=UINT16
            OBJ_ACCELERATION_LONG_ERR_029_oRDR_TRACKER_OBJ_029_oPCAN_RADAR_61880b1e_Tx: ComSignalType=UINT8
            OBJ_ACCEL_ERR_CRR_COEF_029_oRDR_TRACKER_OBJ_029_oPCAN_RADAR_c12b2a78_Tx: ComSignalType=UINT8
            OBJ_ALIVE_TIME_029_oRDR_TRACKER_OBJ_029_oPCAN_RADAR_b9488656_Tx: ComSignalType=UINT16
            OBJ_CLS_TYPE1_029_oRDR_TRACKER_OBJ_029_oPCAN_RADAR_2e936770_Tx: ComSignalType=UINT8
            OBJ_CLS_TYPE1_PROB_029_oRDR_TRACKER_OBJ_029_oPCAN_RADAR_86cbb083_Tx: ComSignalType=UINT8
            OBJ_CLS_TYPE2_029_oRDR_TRACKER_OBJ_029_oPCAN_RADAR_637b6717_Tx: ComSignalType=UINT8
            OBJ_CLS_TYPE2_PROB_029_oRDR_TRACKER_OBJ_029_oPCAN_RADAR_4fffab8e_Tx: ComSignalType=UINT8
            OBJ_CLS_TYPE3_029_oRDR_TRACKER_OBJ_029_oPCAN_RADAR_eef39af5_Tx: ComSignalType=UINT8
            OBJ_CLS_TYPE3_PROB_029_oRDR_TRACKER_OBJ_029_oPCAN_RADAR_08ec5d75_Tx: ComSignalType=UINT8
            OBJ_CLS_TYPE4_029_oRDR_TRACKER_OBJ_029_oPCAN_RADAR_f8ab67d9_Tx: ComSignalType=UINT8
            OBJ_CLS_TYPE4_PROB_029_oRDR_TRACKER_OBJ_029_oPCAN_RADAR_06e69bd5_Tx: ComSignalType=UINT8
            OBJ_CLS_TYPE5_029_oRDR_TRACKER_OBJ_029_oPCAN_RADAR_75239a3b_Tx: ComSignalType=UINT8
            OBJ_CLS_TYPE5_PROB_029_oRDR_TRACKER_OBJ_029_oPCAN_RADAR_41f56d2e_Tx: ComSignalType=UINT8
            OBJ_CLS_TYPE6_029_oRDR_TRACKER_OBJ_029_oPCAN_RADAR_38cb9a5c_Tx: ComSignalType=UINT8
            OBJ_CLS_TYPE6_PROB_029_oRDR_TRACKER_OBJ_029_oPCAN_RADAR_88c17623_Tx: ComSignalType=UINT8
            OBJ_DIMENSION_LENGTH_029_oRDR_TRACKER_OBJ_029_oPCAN_RADAR_6c0d3434_Tx: ComSignalType=UINT16
            OBJ_DIMENSION_LENGTH_ERR_029_oRDR_TRACKER_OBJ_029_oPCAN_RADAR_57f52b4e_Tx: ComSignalType=UINT16
            OBJ_DIMENSION_WIDTH_029_oRDR_TRACKER_OBJ_029_oPCAN_RADAR_4fc3c399_Tx: ComSignalType=UINT16
            OBJ_DIMENSION_WIDTH_ERR_029_oRDR_TRACKER_OBJ_029_oPCAN_RADAR_af610471_Tx: ComSignalType=UINT8
            OBJ_EXISTENCE_PROB_029_oRDR_TRACKER_OBJ_029_oPCAN_RADAR_447f47a4_Tx: ComSignalType=UINT16
            OBJ_GROUP_ID_029_oRDR_TRACKER_OBJ_029_oPCAN_RADAR_cd0d5309_Tx: ComSignalType=UINT8
            OBJ_ID_029_oRDR_TRACKER_OBJ_029_oPCAN_RADAR_3e23780e_Tx: ComSignalType=UINT8
            OBJ_MEASUREMENT_STATUS_029_oRDR_TRACKER_OBJ_029_oPCAN_RADAR_41f10ab3_Tx: ComSignalType=UINT8
            OBJ_MH_CRC16_029_oRDR_TRACKER_OBJ_029_oPCAN_RADAR_3d91bd8f_Tx: ComSignalType=UINT16
            OBJ_MH_CYCLE_COUNTER_029_oRDR_TRACKER_OBJ_029_oPCAN_RADAR_4c75e76e_Tx: ComSignalType=UINT8
            OBJ_MOVEMENT_STATUS_029_oRDR_TRACKER_OBJ_029_oPCAN_RADAR_6e5f9fff_Tx: ComSignalType=UINT8
            OBJ_POS_ERR_CRR_COEF_029_oRDR_TRACKER_OBJ_029_oPCAN_RADAR_fe205fc5_Tx: ComSignalType=UINT8
            OBJ_POS_LAT_029_oRDR_TRACKER_OBJ_029_oPCAN_RADAR_1c8fa289_Tx: ComSignalType=UINT16
            OBJ_POS_LAT_ERR_029_oRDR_TRACKER_OBJ_029_oPCAN_RADAR_18c3f2be_Tx: ComSignalType=UINT8
            OBJ_POS_LONG_029_oRDR_TRACKER_OBJ_029_oPCAN_RADAR_ad2f4946_Tx: ComSignalType=UINT16
            OBJ_POS_LONG_ERR_029_oRDR_TRACKER_OBJ_029_oPCAN_RADAR_813b0c5c_Tx: ComSignalType=UINT8
            OBJ_RCS_029_oRDR_TRACKER_OBJ_029_oPCAN_RADAR_3e40f48e_Tx: ComSignalType=UINT8
            OBJ_REF_PT_LAT_OFFSET_029_oRDR_TRACKER_OBJ_029_oPCAN_RADAR_cb7d9ffb_Tx: ComSignalType=UINT16
            OBJ_REF_PT_LONG_OFFSET_029_oRDR_TRACKER_OBJ_029_oPCAN_RADAR_842f6ff8_Tx: ComSignalType=UINT16
            OBJ_TIMESTAMP_OFFSET_029_oRDR_TRACKER_OBJ_029_oPCAN_RADAR_3eecf4d8_Tx: ComSignalType=UINT8
            OBJ_TRACK_MOTION_MODEL_029_oRDR_TRACKER_OBJ_029_oPCAN_RADAR_f2eff505_Tx: ComSignalType=UINT8
            OBJ_VEH_TRACK_FLAG_029_oRDR_TRACKER_OBJ_029_oPCAN_RADAR_70c50358_Tx: ComSignalType=BOOLEAN
            OBJ_VELOCITY_ERR_CRR_COEF_029_oRDR_TRACKER_OBJ_029_oPCAN_RADAR_575a6224_Tx: ComSignalType=UINT8
            OBJ_VELOCITY_LAT_029_oRDR_TRACKER_OBJ_029_oPCAN_RADAR_58ece7ae_Tx: ComSignalType=UINT16
            OBJ_VELOCITY_LAT_ERR_029_oRDR_TRACKER_OBJ_029_oPCAN_RADAR_6c1697ff_Tx: ComSignalType=UINT8
            OBJ_VELOCITY_LONG_029_oRDR_TRACKER_OBJ_029_oPCAN_RADAR_08619f68_Tx: ComSignalType=UINT16
            OBJ_VELOCITY_LONG_ERR_029_oRDR_TRACKER_OBJ_029_oPCAN_RADAR_8094a83f_Tx: ComSignalType=UINT8
            OBJ_YAW_ANGLE_029_oRDR_TRACKER_OBJ_029_oPCAN_RADAR_b450a3ee_Tx: ComSignalType=UINT16
            OBJ_YAW_ANGLE_ERR_029_oRDR_TRACKER_OBJ_029_oPCAN_RADAR_615da539_Tx: ComSignalType=UINT8
            OBJ_YAW_RATE_029_oRDR_TRACKER_OBJ_029_oPCAN_RADAR_91df86a9_Tx: ComSignalType=UINT16
            OBJ_YAW_RATE_ERR_029_oRDR_TRACKER_OBJ_029_oPCAN_RADAR_ae071175_Tx: ComSignalType=UINT8
        SG_TrackerObject030_oRDR_TRACKER_OBJ_030_oPCAN_RADAR_ab18edec_Tx
          49 x ComGroupSignal:
            OBJ_ACCELERATION_LAT_030_oRDR_TRACKER_OBJ_030_oPCAN_RADAR_a53cb69b_Tx: ComSignalType=UINT16
            OBJ_ACCELERATION_LAT_ERR_030_oRDR_TRACKER_OBJ_030_oPCAN_RADAR_70c88c25_Tx: ComSignalType=UINT8
            OBJ_ACCELERATION_LONG_030_oRDR_TRACKER_OBJ_030_oPCAN_RADAR_d7ccef7b_Tx: ComSignalType=UINT16
            OBJ_ACCELERATION_LONG_ERR_030_oRDR_TRACKER_OBJ_030_oPCAN_RADAR_6f6d298f_Tx: ComSignalType=UINT8
            OBJ_ACCEL_ERR_CRR_COEF_030_oRDR_TRACKER_OBJ_030_oPCAN_RADAR_cfce08e9_Tx: ComSignalType=UINT8
            OBJ_ALIVE_TIME_030_oRDR_TRACKER_OBJ_030_oPCAN_RADAR_b7ada4c7_Tx: ComSignalType=UINT16
            OBJ_CLS_TYPE1_030_oRDR_TRACKER_OBJ_030_oPCAN_RADAR_207645e1_Tx: ComSignalType=UINT8
            OBJ_CLS_TYPE1_PROB_030_oRDR_TRACKER_OBJ_030_oPCAN_RADAR_882e9212_Tx: ComSignalType=UINT8
            OBJ_CLS_TYPE2_030_oRDR_TRACKER_OBJ_030_oPCAN_RADAR_6d9e4586_Tx: ComSignalType=UINT8
            OBJ_CLS_TYPE2_PROB_030_oRDR_TRACKER_OBJ_030_oPCAN_RADAR_411a891f_Tx: ComSignalType=UINT8
            OBJ_CLS_TYPE3_030_oRDR_TRACKER_OBJ_030_oPCAN_RADAR_e016b864_Tx: ComSignalType=UINT8
            OBJ_CLS_TYPE3_PROB_030_oRDR_TRACKER_OBJ_030_oPCAN_RADAR_06097fe4_Tx: ComSignalType=UINT8
            OBJ_CLS_TYPE4_030_oRDR_TRACKER_OBJ_030_oPCAN_RADAR_f64e4548_Tx: ComSignalType=UINT8
            OBJ_CLS_TYPE4_PROB_030_oRDR_TRACKER_OBJ_030_oPCAN_RADAR_0803b944_Tx: ComSignalType=UINT8
            OBJ_CLS_TYPE5_030_oRDR_TRACKER_OBJ_030_oPCAN_RADAR_7bc6b8aa_Tx: ComSignalType=UINT8
            OBJ_CLS_TYPE5_PROB_030_oRDR_TRACKER_OBJ_030_oPCAN_RADAR_4f104fbf_Tx: ComSignalType=UINT8
            OBJ_CLS_TYPE6_030_oRDR_TRACKER_OBJ_030_oPCAN_RADAR_362eb8cd_Tx: ComSignalType=UINT8
            OBJ_CLS_TYPE6_PROB_030_oRDR_TRACKER_OBJ_030_oPCAN_RADAR_862454b2_Tx: ComSignalType=UINT8
            OBJ_DIMENSION_LENGTH_030_oRDR_TRACKER_OBJ_030_oPCAN_RADAR_62e816a5_Tx: ComSignalType=UINT16
            OBJ_DIMENSION_LENGTH_ERR_030_oRDR_TRACKER_OBJ_030_oPCAN_RADAR_591009df_Tx: ComSignalType=UINT16
            OBJ_DIMENSION_WIDTH_030_oRDR_TRACKER_OBJ_030_oPCAN_RADAR_4126e108_Tx: ComSignalType=UINT16
            OBJ_DIMENSION_WIDTH_ERR_030_oRDR_TRACKER_OBJ_030_oPCAN_RADAR_a18426e0_Tx: ComSignalType=UINT8
            OBJ_EXISTENCE_PROB_030_oRDR_TRACKER_OBJ_030_oPCAN_RADAR_4a9a6535_Tx: ComSignalType=UINT16
            OBJ_GROUP_ID_030_oRDR_TRACKER_OBJ_030_oPCAN_RADAR_c3e87198_Tx: ComSignalType=UINT8
            OBJ_ID_030_oRDR_TRACKER_OBJ_030_oPCAN_RADAR_30c65a9f_Tx: ComSignalType=UINT8
            OBJ_MEASUREMENT_STATUS_030_oRDR_TRACKER_OBJ_030_oPCAN_RADAR_4f142822_Tx: ComSignalType=UINT8
            OBJ_MH_CRC16_030_oRDR_TRACKER_OBJ_030_oPCAN_RADAR_33749f1e_Tx: ComSignalType=UINT16
            OBJ_MH_CYCLE_COUNTER_030_oRDR_TRACKER_OBJ_030_oPCAN_RADAR_4290c5ff_Tx: ComSignalType=UINT8
            OBJ_MOVEMENT_STATUS_030_oRDR_TRACKER_OBJ_030_oPCAN_RADAR_60babd6e_Tx: ComSignalType=UINT8
            OBJ_POS_ERR_CRR_COEF_030_oRDR_TRACKER_OBJ_030_oPCAN_RADAR_f0c57d54_Tx: ComSignalType=UINT8
            OBJ_POS_LAT_030_oRDR_TRACKER_OBJ_030_oPCAN_RADAR_126a8018_Tx: ComSignalType=UINT16
            OBJ_POS_LAT_ERR_030_oRDR_TRACKER_OBJ_030_oPCAN_RADAR_1626d02f_Tx: ComSignalType=UINT8
            OBJ_POS_LONG_030_oRDR_TRACKER_OBJ_030_oPCAN_RADAR_a3ca6bd7_Tx: ComSignalType=UINT16
            OBJ_POS_LONG_ERR_030_oRDR_TRACKER_OBJ_030_oPCAN_RADAR_8fde2ecd_Tx: ComSignalType=UINT8
            OBJ_RCS_030_oRDR_TRACKER_OBJ_030_oPCAN_RADAR_30a5d61f_Tx: ComSignalType=UINT8
            OBJ_REF_PT_LAT_OFFSET_030_oRDR_TRACKER_OBJ_030_oPCAN_RADAR_c598bd6a_Tx: ComSignalType=UINT16
            OBJ_REF_PT_LONG_OFFSET_030_oRDR_TRACKER_OBJ_030_oPCAN_RADAR_8aca4d69_Tx: ComSignalType=UINT16
            OBJ_TIMESTAMP_OFFSET_030_oRDR_TRACKER_OBJ_030_oPCAN_RADAR_3009d649_Tx: ComSignalType=UINT8
            OBJ_TRACK_MOTION_MODEL_030_oRDR_TRACKER_OBJ_030_oPCAN_RADAR_fc0ad794_Tx: ComSignalType=UINT8
            OBJ_VEH_TRACK_FLAG_030_oRDR_TRACKER_OBJ_030_oPCAN_RADAR_7e2021c9_Tx: ComSignalType=BOOLEAN
            OBJ_VELOCITY_ERR_CRR_COEF_030_oRDR_TRACKER_OBJ_030_oPCAN_RADAR_59bf40b5_Tx: ComSignalType=UINT8
            OBJ_VELOCITY_LAT_030_oRDR_TRACKER_OBJ_030_oPCAN_RADAR_5609c53f_Tx: ComSignalType=UINT16
            OBJ_VELOCITY_LAT_ERR_030_oRDR_TRACKER_OBJ_030_oPCAN_RADAR_62f3b56e_Tx: ComSignalType=UINT8
            OBJ_VELOCITY_LONG_030_oRDR_TRACKER_OBJ_030_oPCAN_RADAR_0684bdf9_Tx: ComSignalType=UINT16
            OBJ_VELOCITY_LONG_ERR_030_oRDR_TRACKER_OBJ_030_oPCAN_RADAR_8e718aae_Tx: ComSignalType=UINT8
            OBJ_YAW_ANGLE_030_oRDR_TRACKER_OBJ_030_oPCAN_RADAR_bab5817f_Tx: ComSignalType=UINT16
            OBJ_YAW_ANGLE_ERR_030_oRDR_TRACKER_OBJ_030_oPCAN_RADAR_6fb887a8_Tx: ComSignalType=UINT8
            OBJ_YAW_RATE_030_oRDR_TRACKER_OBJ_030_oPCAN_RADAR_9f3aa438_Tx: ComSignalType=UINT16
            OBJ_YAW_RATE_ERR_030_oRDR_TRACKER_OBJ_030_oPCAN_RADAR_a0e233e4_Tx: ComSignalType=UINT8
        SG_TrackerObject031_oRDR_TRACKER_OBJ_031_oPCAN_RADAR_520c655f_Tx
          49 x ComGroupSignal:
            OBJ_ACCELERATION_LAT_031_oRDR_TRACKER_OBJ_031_oPCAN_RADAR_5c283e28_Tx: ComSignalType=UINT16
            OBJ_ACCELERATION_LAT_ERR_031_oRDR_TRACKER_OBJ_031_oPCAN_RADAR_89dc0496_Tx: ComSignalType=UINT8
            OBJ_ACCELERATION_LONG_031_oRDR_TRACKER_OBJ_031_oPCAN_RADAR_2ed867c8_Tx: ComSignalType=UINT16
            OBJ_ACCELERATION_LONG_ERR_031_oRDR_TRACKER_OBJ_031_oPCAN_RADAR_9679a13c_Tx: ComSignalType=UINT8
            OBJ_ACCEL_ERR_CRR_COEF_031_oRDR_TRACKER_OBJ_031_oPCAN_RADAR_36da805a_Tx: ComSignalType=UINT8
            OBJ_ALIVE_TIME_031_oRDR_TRACKER_OBJ_031_oPCAN_RADAR_4eb92c74_Tx: ComSignalType=UINT16
            OBJ_CLS_TYPE1_031_oRDR_TRACKER_OBJ_031_oPCAN_RADAR_d962cd52_Tx: ComSignalType=UINT8
            OBJ_CLS_TYPE1_PROB_031_oRDR_TRACKER_OBJ_031_oPCAN_RADAR_713a1aa1_Tx: ComSignalType=UINT8
            OBJ_CLS_TYPE2_031_oRDR_TRACKER_OBJ_031_oPCAN_RADAR_948acd35_Tx: ComSignalType=UINT8
            OBJ_CLS_TYPE2_PROB_031_oRDR_TRACKER_OBJ_031_oPCAN_RADAR_b80e01ac_Tx: ComSignalType=UINT8
            OBJ_CLS_TYPE3_031_oRDR_TRACKER_OBJ_031_oPCAN_RADAR_190230d7_Tx: ComSignalType=UINT8
            OBJ_CLS_TYPE3_PROB_031_oRDR_TRACKER_OBJ_031_oPCAN_RADAR_ff1df757_Tx: ComSignalType=UINT8
            OBJ_CLS_TYPE4_031_oRDR_TRACKER_OBJ_031_oPCAN_RADAR_0f5acdfb_Tx: ComSignalType=UINT8
            OBJ_CLS_TYPE4_PROB_031_oRDR_TRACKER_OBJ_031_oPCAN_RADAR_f11731f7_Tx: ComSignalType=UINT8
            OBJ_CLS_TYPE5_031_oRDR_TRACKER_OBJ_031_oPCAN_RADAR_82d23019_Tx: ComSignalType=UINT8
            OBJ_CLS_TYPE5_PROB_031_oRDR_TRACKER_OBJ_031_oPCAN_RADAR_b604c70c_Tx: ComSignalType=UINT8
            OBJ_CLS_TYPE6_031_oRDR_TRACKER_OBJ_031_oPCAN_RADAR_cf3a307e_Tx: ComSignalType=UINT8
            OBJ_CLS_TYPE6_PROB_031_oRDR_TRACKER_OBJ_031_oPCAN_RADAR_7f30dc01_Tx: ComSignalType=UINT8
            OBJ_DIMENSION_LENGTH_031_oRDR_TRACKER_OBJ_031_oPCAN_RADAR_9bfc9e16_Tx: ComSignalType=UINT16
            OBJ_DIMENSION_LENGTH_ERR_031_oRDR_TRACKER_OBJ_031_oPCAN_RADAR_a004816c_Tx: ComSignalType=UINT16
            OBJ_DIMENSION_WIDTH_031_oRDR_TRACKER_OBJ_031_oPCAN_RADAR_b83269bb_Tx: ComSignalType=UINT16
            OBJ_DIMENSION_WIDTH_ERR_031_oRDR_TRACKER_OBJ_031_oPCAN_RADAR_5890ae53_Tx: ComSignalType=UINT8
            OBJ_EXISTENCE_PROB_031_oRDR_TRACKER_OBJ_031_oPCAN_RADAR_b38eed86_Tx: ComSignalType=UINT16
            OBJ_GROUP_ID_031_oRDR_TRACKER_OBJ_031_oPCAN_RADAR_3afcf92b_Tx: ComSignalType=UINT8
            OBJ_ID_031_oRDR_TRACKER_OBJ_031_oPCAN_RADAR_c9d2d22c_Tx: ComSignalType=UINT8
            OBJ_MEASUREMENT_STATUS_031_oRDR_TRACKER_OBJ_031_oPCAN_RADAR_b600a091_Tx: ComSignalType=UINT8
            OBJ_MH_CRC16_031_oRDR_TRACKER_OBJ_031_oPCAN_RADAR_ca6017ad_Tx: ComSignalType=UINT16
            OBJ_MH_CYCLE_COUNTER_031_oRDR_TRACKER_OBJ_031_oPCAN_RADAR_bb844d4c_Tx: ComSignalType=UINT8
            OBJ_MOVEMENT_STATUS_031_oRDR_TRACKER_OBJ_031_oPCAN_RADAR_99ae35dd_Tx: ComSignalType=UINT8
            OBJ_POS_ERR_CRR_COEF_031_oRDR_TRACKER_OBJ_031_oPCAN_RADAR_09d1f5e7_Tx: ComSignalType=UINT8
            OBJ_POS_LAT_031_oRDR_TRACKER_OBJ_031_oPCAN_RADAR_eb7e08ab_Tx: ComSignalType=UINT16
            OBJ_POS_LAT_ERR_031_oRDR_TRACKER_OBJ_031_oPCAN_RADAR_ef32589c_Tx: ComSignalType=UINT8
            OBJ_POS_LONG_031_oRDR_TRACKER_OBJ_031_oPCAN_RADAR_5adee364_Tx: ComSignalType=UINT16
            OBJ_POS_LONG_ERR_031_oRDR_TRACKER_OBJ_031_oPCAN_RADAR_76caa67e_Tx: ComSignalType=UINT8
            OBJ_RCS_031_oRDR_TRACKER_OBJ_031_oPCAN_RADAR_c9b15eac_Tx: ComSignalType=UINT8
            OBJ_REF_PT_LAT_OFFSET_031_oRDR_TRACKER_OBJ_031_oPCAN_RADAR_3c8c35d9_Tx: ComSignalType=UINT16
            OBJ_REF_PT_LONG_OFFSET_031_oRDR_TRACKER_OBJ_031_oPCAN_RADAR_73dec5da_Tx: ComSignalType=UINT16
            OBJ_TIMESTAMP_OFFSET_031_oRDR_TRACKER_OBJ_031_oPCAN_RADAR_c91d5efa_Tx: ComSignalType=UINT8
            OBJ_TRACK_MOTION_MODEL_031_oRDR_TRACKER_OBJ_031_oPCAN_RADAR_051e5f27_Tx: ComSignalType=UINT8
            OBJ_VEH_TRACK_FLAG_031_oRDR_TRACKER_OBJ_031_oPCAN_RADAR_8734a97a_Tx: ComSignalType=BOOLEAN
            OBJ_VELOCITY_ERR_CRR_COEF_031_oRDR_TRACKER_OBJ_031_oPCAN_RADAR_a0abc806_Tx: ComSignalType=UINT8
            OBJ_VELOCITY_LAT_031_oRDR_TRACKER_OBJ_031_oPCAN_RADAR_af1d4d8c_Tx: ComSignalType=UINT16
            OBJ_VELOCITY_LAT_ERR_031_oRDR_TRACKER_OBJ_031_oPCAN_RADAR_9be73ddd_Tx: ComSignalType=UINT8
            OBJ_VELOCITY_LONG_031_oRDR_TRACKER_OBJ_031_oPCAN_RADAR_ff90354a_Tx: ComSignalType=UINT16
            OBJ_VELOCITY_LONG_ERR_031_oRDR_TRACKER_OBJ_031_oPCAN_RADAR_7765021d_Tx: ComSignalType=UINT8
            OBJ_YAW_ANGLE_031_oRDR_TRACKER_OBJ_031_oPCAN_RADAR_43a109cc_Tx: ComSignalType=UINT16
            OBJ_YAW_ANGLE_ERR_031_oRDR_TRACKER_OBJ_031_oPCAN_RADAR_96ac0f1b_Tx: ComSignalType=UINT8
            OBJ_YAW_RATE_031_oRDR_TRACKER_OBJ_031_oPCAN_RADAR_662e2c8b_Tx: ComSignalType=UINT16
            OBJ_YAW_RATE_ERR_031_oRDR_TRACKER_OBJ_031_oPCAN_RADAR_59f6bb57_Tx: ComSignalType=UINT8
        SG_TrackerObject032_oRDR_TRACKER_OBJ_032_oPCAN_RADAR_8240facb_Tx
          49 x ComGroupSignal:
            OBJ_ACCELERATION_LAT_032_oRDR_TRACKER_OBJ_032_oPCAN_RADAR_8c64a1bc_Tx: ComSignalType=UINT16
            OBJ_ACCELERATION_LAT_ERR_032_oRDR_TRACKER_OBJ_032_oPCAN_RADAR_59909b02_Tx: ComSignalType=UINT8
            OBJ_ACCELERATION_LONG_032_oRDR_TRACKER_OBJ_032_oPCAN_RADAR_fe94f85c_Tx: ComSignalType=UINT16
            OBJ_ACCELERATION_LONG_ERR_032_oRDR_TRACKER_OBJ_032_oPCAN_RADAR_46353ea8_Tx: ComSignalType=UINT8
            OBJ_ACCEL_ERR_CRR_COEF_032_oRDR_TRACKER_OBJ_032_oPCAN_RADAR_e6961fce_Tx: ComSignalType=UINT8
            OBJ_ALIVE_TIME_032_oRDR_TRACKER_OBJ_032_oPCAN_RADAR_9ef5b3e0_Tx: ComSignalType=UINT16
            OBJ_CLS_TYPE1_032_oRDR_TRACKER_OBJ_032_oPCAN_RADAR_092e52c6_Tx: ComSignalType=UINT8
            OBJ_CLS_TYPE1_PROB_032_oRDR_TRACKER_OBJ_032_oPCAN_RADAR_a1768535_Tx: ComSignalType=UINT8
            OBJ_CLS_TYPE2_032_oRDR_TRACKER_OBJ_032_oPCAN_RADAR_44c652a1_Tx: ComSignalType=UINT8
            OBJ_CLS_TYPE2_PROB_032_oRDR_TRACKER_OBJ_032_oPCAN_RADAR_68429e38_Tx: ComSignalType=UINT8
            OBJ_CLS_TYPE3_032_oRDR_TRACKER_OBJ_032_oPCAN_RADAR_c94eaf43_Tx: ComSignalType=UINT8
            OBJ_CLS_TYPE3_PROB_032_oRDR_TRACKER_OBJ_032_oPCAN_RADAR_2f5168c3_Tx: ComSignalType=UINT8
            OBJ_CLS_TYPE4_032_oRDR_TRACKER_OBJ_032_oPCAN_RADAR_df16526f_Tx: ComSignalType=UINT8
            OBJ_CLS_TYPE4_PROB_032_oRDR_TRACKER_OBJ_032_oPCAN_RADAR_215bae63_Tx: ComSignalType=UINT8
            OBJ_CLS_TYPE5_032_oRDR_TRACKER_OBJ_032_oPCAN_RADAR_529eaf8d_Tx: ComSignalType=UINT8
            OBJ_CLS_TYPE5_PROB_032_oRDR_TRACKER_OBJ_032_oPCAN_RADAR_66485898_Tx: ComSignalType=UINT8
            OBJ_CLS_TYPE6_032_oRDR_TRACKER_OBJ_032_oPCAN_RADAR_1f76afea_Tx: ComSignalType=UINT8
            OBJ_CLS_TYPE6_PROB_032_oRDR_TRACKER_OBJ_032_oPCAN_RADAR_af7c4395_Tx: ComSignalType=UINT8
            OBJ_DIMENSION_LENGTH_032_oRDR_TRACKER_OBJ_032_oPCAN_RADAR_4bb00182_Tx: ComSignalType=UINT16
            OBJ_DIMENSION_LENGTH_ERR_032_oRDR_TRACKER_OBJ_032_oPCAN_RADAR_70481ef8_Tx: ComSignalType=UINT16
            OBJ_DIMENSION_WIDTH_032_oRDR_TRACKER_OBJ_032_oPCAN_RADAR_687ef62f_Tx: ComSignalType=UINT16
            OBJ_DIMENSION_WIDTH_ERR_032_oRDR_TRACKER_OBJ_032_oPCAN_RADAR_88dc31c7_Tx: ComSignalType=UINT8
            OBJ_EXISTENCE_PROB_032_oRDR_TRACKER_OBJ_032_oPCAN_RADAR_63c27212_Tx: ComSignalType=UINT16
            OBJ_GROUP_ID_032_oRDR_TRACKER_OBJ_032_oPCAN_RADAR_eab066bf_Tx: ComSignalType=UINT8
            OBJ_ID_032_oRDR_TRACKER_OBJ_032_oPCAN_RADAR_199e4db8_Tx: ComSignalType=UINT8
            OBJ_MEASUREMENT_STATUS_032_oRDR_TRACKER_OBJ_032_oPCAN_RADAR_664c3f05_Tx: ComSignalType=UINT8
            OBJ_MH_CRC16_032_oRDR_TRACKER_OBJ_032_oPCAN_RADAR_1a2c8839_Tx: ComSignalType=UINT16
            OBJ_MH_CYCLE_COUNTER_032_oRDR_TRACKER_OBJ_032_oPCAN_RADAR_6bc8d2d8_Tx: ComSignalType=UINT8
            OBJ_MOVEMENT_STATUS_032_oRDR_TRACKER_OBJ_032_oPCAN_RADAR_49e2aa49_Tx: ComSignalType=UINT8
            OBJ_POS_ERR_CRR_COEF_032_oRDR_TRACKER_OBJ_032_oPCAN_RADAR_d99d6a73_Tx: ComSignalType=UINT8
            OBJ_POS_LAT_032_oRDR_TRACKER_OBJ_032_oPCAN_RADAR_3b32973f_Tx: ComSignalType=UINT16
            OBJ_POS_LAT_ERR_032_oRDR_TRACKER_OBJ_032_oPCAN_RADAR_3f7ec708_Tx: ComSignalType=UINT8
            OBJ_POS_LONG_032_oRDR_TRACKER_OBJ_032_oPCAN_RADAR_8a927cf0_Tx: ComSignalType=UINT16
            OBJ_POS_LONG_ERR_032_oRDR_TRACKER_OBJ_032_oPCAN_RADAR_a68639ea_Tx: ComSignalType=UINT8
            OBJ_RCS_032_oRDR_TRACKER_OBJ_032_oPCAN_RADAR_19fdc138_Tx: ComSignalType=UINT8
            OBJ_REF_PT_LAT_OFFSET_032_oRDR_TRACKER_OBJ_032_oPCAN_RADAR_ecc0aa4d_Tx: ComSignalType=UINT16
            OBJ_REF_PT_LONG_OFFSET_032_oRDR_TRACKER_OBJ_032_oPCAN_RADAR_a3925a4e_Tx: ComSignalType=UINT16
            OBJ_TIMESTAMP_OFFSET_032_oRDR_TRACKER_OBJ_032_oPCAN_RADAR_1951c16e_Tx: ComSignalType=UINT8
            OBJ_TRACK_MOTION_MODEL_032_oRDR_TRACKER_OBJ_032_oPCAN_RADAR_d552c0b3_Tx: ComSignalType=UINT8
            OBJ_VEH_TRACK_FLAG_032_oRDR_TRACKER_OBJ_032_oPCAN_RADAR_577836ee_Tx: ComSignalType=BOOLEAN
            OBJ_VELOCITY_ERR_CRR_COEF_032_oRDR_TRACKER_OBJ_032_oPCAN_RADAR_70e75792_Tx: ComSignalType=UINT8
            OBJ_VELOCITY_LAT_032_oRDR_TRACKER_OBJ_032_oPCAN_RADAR_7f51d218_Tx: ComSignalType=UINT16
            OBJ_VELOCITY_LAT_ERR_032_oRDR_TRACKER_OBJ_032_oPCAN_RADAR_4baba249_Tx: ComSignalType=UINT8
            OBJ_VELOCITY_LONG_032_oRDR_TRACKER_OBJ_032_oPCAN_RADAR_2fdcaade_Tx: ComSignalType=UINT16
            OBJ_VELOCITY_LONG_ERR_032_oRDR_TRACKER_OBJ_032_oPCAN_RADAR_a7299d89_Tx: ComSignalType=UINT8
            OBJ_YAW_ANGLE_032_oRDR_TRACKER_OBJ_032_oPCAN_RADAR_93ed9658_Tx: ComSignalType=UINT16
            OBJ_YAW_ANGLE_ERR_032_oRDR_TRACKER_OBJ_032_oPCAN_RADAR_46e0908f_Tx: ComSignalType=UINT8
            OBJ_YAW_RATE_032_oRDR_TRACKER_OBJ_032_oPCAN_RADAR_b662b31f_Tx: ComSignalType=UINT16
            OBJ_YAW_RATE_ERR_032_oRDR_TRACKER_OBJ_032_oPCAN_RADAR_89ba24c3_Tx: ComSignalType=UINT8
        SG_TrackerObject033_oRDR_TRACKER_OBJ_033_oPCAN_RADAR_7b547278_Tx
          49 x ComGroupSignal:
            OBJ_ACCELERATION_LAT_033_oRDR_TRACKER_OBJ_033_oPCAN_RADAR_7570290f_Tx: ComSignalType=UINT16
            OBJ_ACCELERATION_LAT_ERR_033_oRDR_TRACKER_OBJ_033_oPCAN_RADAR_a08413b1_Tx: ComSignalType=UINT8
            OBJ_ACCELERATION_LONG_033_oRDR_TRACKER_OBJ_033_oPCAN_RADAR_078070ef_Tx: ComSignalType=UINT16
            OBJ_ACCELERATION_LONG_ERR_033_oRDR_TRACKER_OBJ_033_oPCAN_RADAR_bf21b61b_Tx: ComSignalType=UINT8
            OBJ_ACCEL_ERR_CRR_COEF_033_oRDR_TRACKER_OBJ_033_oPCAN_RADAR_1f82977d_Tx: ComSignalType=UINT8
            OBJ_ALIVE_TIME_033_oRDR_TRACKER_OBJ_033_oPCAN_RADAR_67e13b53_Tx: ComSignalType=UINT16
            OBJ_CLS_TYPE1_033_oRDR_TRACKER_OBJ_033_oPCAN_RADAR_f03ada75_Tx: ComSignalType=UINT8
            OBJ_CLS_TYPE1_PROB_033_oRDR_TRACKER_OBJ_033_oPCAN_RADAR_58620d86_Tx: ComSignalType=UINT8
            OBJ_CLS_TYPE2_033_oRDR_TRACKER_OBJ_033_oPCAN_RADAR_bdd2da12_Tx: ComSignalType=UINT8
            OBJ_CLS_TYPE2_PROB_033_oRDR_TRACKER_OBJ_033_oPCAN_RADAR_9156168b_Tx: ComSignalType=UINT8
            OBJ_CLS_TYPE3_033_oRDR_TRACKER_OBJ_033_oPCAN_RADAR_305a27f0_Tx: ComSignalType=UINT8
            OBJ_CLS_TYPE3_PROB_033_oRDR_TRACKER_OBJ_033_oPCAN_RADAR_d645e070_Tx: ComSignalType=UINT8
            OBJ_CLS_TYPE4_033_oRDR_TRACKER_OBJ_033_oPCAN_RADAR_2602dadc_Tx: ComSignalType=UINT8
            OBJ_CLS_TYPE4_PROB_033_oRDR_TRACKER_OBJ_033_oPCAN_RADAR_d84f26d0_Tx: ComSignalType=UINT8
            OBJ_CLS_TYPE5_033_oRDR_TRACKER_OBJ_033_oPCAN_RADAR_ab8a273e_Tx: ComSignalType=UINT8
            OBJ_CLS_TYPE5_PROB_033_oRDR_TRACKER_OBJ_033_oPCAN_RADAR_9f5cd02b_Tx: ComSignalType=UINT8
            OBJ_CLS_TYPE6_033_oRDR_TRACKER_OBJ_033_oPCAN_RADAR_e6622759_Tx: ComSignalType=UINT8
            OBJ_CLS_TYPE6_PROB_033_oRDR_TRACKER_OBJ_033_oPCAN_RADAR_5668cb26_Tx: ComSignalType=UINT8
            OBJ_DIMENSION_LENGTH_033_oRDR_TRACKER_OBJ_033_oPCAN_RADAR_b2a48931_Tx: ComSignalType=UINT16
            OBJ_DIMENSION_LENGTH_ERR_033_oRDR_TRACKER_OBJ_033_oPCAN_RADAR_895c964b_Tx: ComSignalType=UINT16
            OBJ_DIMENSION_WIDTH_033_oRDR_TRACKER_OBJ_033_oPCAN_RADAR_916a7e9c_Tx: ComSignalType=UINT16
            OBJ_DIMENSION_WIDTH_ERR_033_oRDR_TRACKER_OBJ_033_oPCAN_RADAR_71c8b974_Tx: ComSignalType=UINT8
            OBJ_EXISTENCE_PROB_033_oRDR_TRACKER_OBJ_033_oPCAN_RADAR_9ad6faa1_Tx: ComSignalType=UINT16
            OBJ_GROUP_ID_033_oRDR_TRACKER_OBJ_033_oPCAN_RADAR_13a4ee0c_Tx: ComSignalType=UINT8
            OBJ_ID_033_oRDR_TRACKER_OBJ_033_oPCAN_RADAR_e08ac50b_Tx: ComSignalType=UINT8
            OBJ_MEASUREMENT_STATUS_033_oRDR_TRACKER_OBJ_033_oPCAN_RADAR_9f58b7b6_Tx: ComSignalType=UINT8
            OBJ_MH_CRC16_033_oRDR_TRACKER_OBJ_033_oPCAN_RADAR_e338008a_Tx: ComSignalType=UINT16
            OBJ_MH_CYCLE_COUNTER_033_oRDR_TRACKER_OBJ_033_oPCAN_RADAR_92dc5a6b_Tx: ComSignalType=UINT8
            OBJ_MOVEMENT_STATUS_033_oRDR_TRACKER_OBJ_033_oPCAN_RADAR_b0f622fa_Tx: ComSignalType=UINT8
            OBJ_POS_ERR_CRR_COEF_033_oRDR_TRACKER_OBJ_033_oPCAN_RADAR_2089e2c0_Tx: ComSignalType=UINT8
            OBJ_POS_LAT_033_oRDR_TRACKER_OBJ_033_oPCAN_RADAR_c2261f8c_Tx: ComSignalType=UINT16
            OBJ_POS_LAT_ERR_033_oRDR_TRACKER_OBJ_033_oPCAN_RADAR_c66a4fbb_Tx: ComSignalType=UINT8
            OBJ_POS_LONG_033_oRDR_TRACKER_OBJ_033_oPCAN_RADAR_7386f443_Tx: ComSignalType=UINT16
            OBJ_POS_LONG_ERR_033_oRDR_TRACKER_OBJ_033_oPCAN_RADAR_5f92b159_Tx: ComSignalType=UINT8
            OBJ_RCS_033_oRDR_TRACKER_OBJ_033_oPCAN_RADAR_e0e9498b_Tx: ComSignalType=UINT8
            OBJ_REF_PT_LAT_OFFSET_033_oRDR_TRACKER_OBJ_033_oPCAN_RADAR_15d422fe_Tx: ComSignalType=UINT16
            OBJ_REF_PT_LONG_OFFSET_033_oRDR_TRACKER_OBJ_033_oPCAN_RADAR_5a86d2fd_Tx: ComSignalType=UINT16
            OBJ_TIMESTAMP_OFFSET_033_oRDR_TRACKER_OBJ_033_oPCAN_RADAR_e04549dd_Tx: ComSignalType=UINT8
            OBJ_TRACK_MOTION_MODEL_033_oRDR_TRACKER_OBJ_033_oPCAN_RADAR_2c464800_Tx: ComSignalType=UINT8
            OBJ_VEH_TRACK_FLAG_033_oRDR_TRACKER_OBJ_033_oPCAN_RADAR_ae6cbe5d_Tx: ComSignalType=BOOLEAN
            OBJ_VELOCITY_ERR_CRR_COEF_033_oRDR_TRACKER_OBJ_033_oPCAN_RADAR_89f3df21_Tx: ComSignalType=UINT8
            OBJ_VELOCITY_LAT_033_oRDR_TRACKER_OBJ_033_oPCAN_RADAR_86455aab_Tx: ComSignalType=UINT16
            OBJ_VELOCITY_LAT_ERR_033_oRDR_TRACKER_OBJ_033_oPCAN_RADAR_b2bf2afa_Tx: ComSignalType=UINT8
            OBJ_VELOCITY_LONG_033_oRDR_TRACKER_OBJ_033_oPCAN_RADAR_d6c8226d_Tx: ComSignalType=UINT16
            OBJ_VELOCITY_LONG_ERR_033_oRDR_TRACKER_OBJ_033_oPCAN_RADAR_5e3d153a_Tx: ComSignalType=UINT8
            OBJ_YAW_ANGLE_033_oRDR_TRACKER_OBJ_033_oPCAN_RADAR_6af91eeb_Tx: ComSignalType=UINT16
            OBJ_YAW_ANGLE_ERR_033_oRDR_TRACKER_OBJ_033_oPCAN_RADAR_bff4183c_Tx: ComSignalType=UINT8
            OBJ_YAW_RATE_033_oRDR_TRACKER_OBJ_033_oPCAN_RADAR_4f763bac_Tx: ComSignalType=UINT16
            OBJ_YAW_RATE_ERR_033_oRDR_TRACKER_OBJ_033_oPCAN_RADAR_70aeac70_Tx: ComSignalType=UINT8
        SG_TrackerObject034_oRDR_TRACKER_OBJ_034_oPCAN_RADAR_f9a8c3a2_Tx
          49 x ComGroupSignal:
            OBJ_ACCELERATION_LAT_034_oRDR_TRACKER_OBJ_034_oPCAN_RADAR_f78c98d5_Tx: ComSignalType=UINT16
            OBJ_ACCELERATION_LAT_ERR_034_oRDR_TRACKER_OBJ_034_oPCAN_RADAR_2278a26b_Tx: ComSignalType=UINT8
            OBJ_ACCELERATION_LONG_034_oRDR_TRACKER_OBJ_034_oPCAN_RADAR_857cc135_Tx: ComSignalType=UINT16
            OBJ_ACCELERATION_LONG_ERR_034_oRDR_TRACKER_OBJ_034_oPCAN_RADAR_3ddd07c1_Tx: ComSignalType=UINT8
            OBJ_ACCEL_ERR_CRR_COEF_034_oRDR_TRACKER_OBJ_034_oPCAN_RADAR_9d7e26a7_Tx: ComSignalType=UINT8
            OBJ_ALIVE_TIME_034_oRDR_TRACKER_OBJ_034_oPCAN_RADAR_e51d8a89_Tx: ComSignalType=UINT16
            OBJ_CLS_TYPE1_034_oRDR_TRACKER_OBJ_034_oPCAN_RADAR_72c66baf_Tx: ComSignalType=UINT8
            OBJ_CLS_TYPE1_PROB_034_oRDR_TRACKER_OBJ_034_oPCAN_RADAR_da9ebc5c_Tx: ComSignalType=UINT8
            OBJ_CLS_TYPE2_034_oRDR_TRACKER_OBJ_034_oPCAN_RADAR_3f2e6bc8_Tx: ComSignalType=UINT8
            OBJ_CLS_TYPE2_PROB_034_oRDR_TRACKER_OBJ_034_oPCAN_RADAR_13aaa751_Tx: ComSignalType=UINT8
            OBJ_CLS_TYPE3_034_oRDR_TRACKER_OBJ_034_oPCAN_RADAR_b2a6962a_Tx: ComSignalType=UINT8
            OBJ_CLS_TYPE3_PROB_034_oRDR_TRACKER_OBJ_034_oPCAN_RADAR_54b951aa_Tx: ComSignalType=UINT8
            OBJ_CLS_TYPE4_034_oRDR_TRACKER_OBJ_034_oPCAN_RADAR_a4fe6b06_Tx: ComSignalType=UINT8
            OBJ_CLS_TYPE4_PROB_034_oRDR_TRACKER_OBJ_034_oPCAN_RADAR_5ab3970a_Tx: ComSignalType=UINT8
            OBJ_CLS_TYPE5_034_oRDR_TRACKER_OBJ_034_oPCAN_RADAR_297696e4_Tx: ComSignalType=UINT8
            OBJ_CLS_TYPE5_PROB_034_oRDR_TRACKER_OBJ_034_oPCAN_RADAR_1da061f1_Tx: ComSignalType=UINT8
            OBJ_CLS_TYPE6_034_oRDR_TRACKER_OBJ_034_oPCAN_RADAR_649e9683_Tx: ComSignalType=UINT8
            OBJ_CLS_TYPE6_PROB_034_oRDR_TRACKER_OBJ_034_oPCAN_RADAR_d4947afc_Tx: ComSignalType=UINT8
            OBJ_DIMENSION_LENGTH_034_oRDR_TRACKER_OBJ_034_oPCAN_RADAR_305838eb_Tx: ComSignalType=UINT16
            OBJ_DIMENSION_LENGTH_ERR_034_oRDR_TRACKER_OBJ_034_oPCAN_RADAR_0ba02791_Tx: ComSignalType=UINT16
            OBJ_DIMENSION_WIDTH_034_oRDR_TRACKER_OBJ_034_oPCAN_RADAR_1396cf46_Tx: ComSignalType=UINT16
            OBJ_DIMENSION_WIDTH_ERR_034_oRDR_TRACKER_OBJ_034_oPCAN_RADAR_f33408ae_Tx: ComSignalType=UINT8
            OBJ_EXISTENCE_PROB_034_oRDR_TRACKER_OBJ_034_oPCAN_RADAR_182a4b7b_Tx: ComSignalType=UINT16
            OBJ_GROUP_ID_034_oRDR_TRACKER_OBJ_034_oPCAN_RADAR_91585fd6_Tx: ComSignalType=UINT8
            OBJ_ID_034_oRDR_TRACKER_OBJ_034_oPCAN_RADAR_627674d1_Tx: ComSignalType=UINT8
            OBJ_MEASUREMENT_STATUS_034_oRDR_TRACKER_OBJ_034_oPCAN_RADAR_1da4066c_Tx: ComSignalType=UINT8
            OBJ_MH_CRC16_034_oRDR_TRACKER_OBJ_034_oPCAN_RADAR_61c4b150_Tx: ComSignalType=UINT16
            OBJ_MH_CYCLE_COUNTER_034_oRDR_TRACKER_OBJ_034_oPCAN_RADAR_1020ebb1_Tx: ComSignalType=UINT8
            OBJ_MOVEMENT_STATUS_034_oRDR_TRACKER_OBJ_034_oPCAN_RADAR_320a9320_Tx: ComSignalType=UINT8
            OBJ_POS_ERR_CRR_COEF_034_oRDR_TRACKER_OBJ_034_oPCAN_RADAR_a275531a_Tx: ComSignalType=UINT8
            OBJ_POS_LAT_034_oRDR_TRACKER_OBJ_034_oPCAN_RADAR_40daae56_Tx: ComSignalType=UINT16
            OBJ_POS_LAT_ERR_034_oRDR_TRACKER_OBJ_034_oPCAN_RADAR_4496fe61_Tx: ComSignalType=UINT8
            OBJ_POS_LONG_034_oRDR_TRACKER_OBJ_034_oPCAN_RADAR_f17a4599_Tx: ComSignalType=UINT16
            OBJ_POS_LONG_ERR_034_oRDR_TRACKER_OBJ_034_oPCAN_RADAR_dd6e0083_Tx: ComSignalType=UINT8
            OBJ_RCS_034_oRDR_TRACKER_OBJ_034_oPCAN_RADAR_6215f851_Tx: ComSignalType=UINT8
            OBJ_REF_PT_LAT_OFFSET_034_oRDR_TRACKER_OBJ_034_oPCAN_RADAR_97289324_Tx: ComSignalType=UINT16
            OBJ_REF_PT_LONG_OFFSET_034_oRDR_TRACKER_OBJ_034_oPCAN_RADAR_d87a6327_Tx: ComSignalType=UINT16
            OBJ_TIMESTAMP_OFFSET_034_oRDR_TRACKER_OBJ_034_oPCAN_RADAR_62b9f807_Tx: ComSignalType=UINT8
            OBJ_TRACK_MOTION_MODEL_034_oRDR_TRACKER_OBJ_034_oPCAN_RADAR_aebaf9da_Tx: ComSignalType=UINT8
            OBJ_VEH_TRACK_FLAG_034_oRDR_TRACKER_OBJ_034_oPCAN_RADAR_2c900f87_Tx: ComSignalType=BOOLEAN
            OBJ_VELOCITY_ERR_CRR_COEF_034_oRDR_TRACKER_OBJ_034_oPCAN_RADAR_0b0f6efb_Tx: ComSignalType=UINT8
            OBJ_VELOCITY_LAT_034_oRDR_TRACKER_OBJ_034_oPCAN_RADAR_04b9eb71_Tx: ComSignalType=UINT16
            OBJ_VELOCITY_LAT_ERR_034_oRDR_TRACKER_OBJ_034_oPCAN_RADAR_30439b20_Tx: ComSignalType=UINT8
            OBJ_VELOCITY_LONG_034_oRDR_TRACKER_OBJ_034_oPCAN_RADAR_543493b7_Tx: ComSignalType=UINT16
            OBJ_VELOCITY_LONG_ERR_034_oRDR_TRACKER_OBJ_034_oPCAN_RADAR_dcc1a4e0_Tx: ComSignalType=UINT8
            OBJ_YAW_ANGLE_034_oRDR_TRACKER_OBJ_034_oPCAN_RADAR_e805af31_Tx: ComSignalType=UINT16
            OBJ_YAW_ANGLE_ERR_034_oRDR_TRACKER_OBJ_034_oPCAN_RADAR_3d08a9e6_Tx: ComSignalType=UINT8
            OBJ_YAW_RATE_034_oRDR_TRACKER_OBJ_034_oPCAN_RADAR_cd8a8a76_Tx: ComSignalType=UINT16
            OBJ_YAW_RATE_ERR_034_oRDR_TRACKER_OBJ_034_oPCAN_RADAR_f2521daa_Tx: ComSignalType=UINT8
