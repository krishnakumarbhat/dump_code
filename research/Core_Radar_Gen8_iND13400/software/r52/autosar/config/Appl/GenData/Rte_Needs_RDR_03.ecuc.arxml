[part 1 of 8: package /DaVinci_Project]
AUTOSAR XML (schema 4-0-3)
package /DaVinci_Project
  module config Com
    ComConfig
      239 x ComSignalGroup:
        SG_ADAS_FN_Enable_disable_sts_oADAS_FN_Enable_disable_sts_oVCAN_RADAR_46faeb96_Rx
          4 x ComGroupSignal, all with ComSignalType=UINT8:
            BSIS_Fn_Switch_Sts_oADAS_FN_Enable_disable_sts_oVCAN_RADAR_8602f31d_Rx
            MOIS_Fn_Switch_sts_oADAS_FN_Enable_disable_sts_oVCAN_RADAR_ebefa562_Rx
            MessageAliveCounter_oADAS_FN_Enable_disable_sts_oVCAN_RADAR_2a6971aa_Rx
            MessageCRC_oADAS_FN_Enable_disable_sts_oVCAN_RADAR_332c8084_Rx
        SG_AlignmentStatus1_oRDR_ALIGNMENT_STATUS_001_oPCAN_RADAR_7714a623_Tx
          42 x ComGroupSignal:
            AL_STS_001_CYCLE_COUNTER_oRDR_ALIGNMENT_STATUS_001_oPCAN_RADAR_92b2855f_Tx: ComSignalType=UINT8
            AL_STS_001_MH_CRC16_oRDR_ALIGNMENT_STATUS_001_oPCAN_RADAR_065b6dda_Tx: ComSignalType=UINT16
            STS_AAAzimuthStd_oRDR_ALIGNMENT_STATUS_001_oPCAN_RADAR_226582e8_Tx: ComSignalType=UINT16
            STS_AACurrentAzimuth_oRDR_ALIGNMENT_STATUS_001_oPCAN_RADAR_fa4b534a_Tx: ComSignalType=SINT16
            STS_AACurrentElevation_oRDR_ALIGNMENT_STATUS_001_oPCAN_RADAR_68c02683_Tx: ComSignalType=SINT16
            STS_AACurrentRoll_oRDR_ALIGNMENT_STATUS_001_oPCAN_RADAR_4f5a9f3e_Tx: ComSignalType=SINT16
            STS_AAElevationStd_oRDR_ALIGNMENT_STATUS_001_oPCAN_RADAR_36e93c09_Tx: ComSignalType=UINT16
            STS_AARoll_Std_oRDR_ALIGNMENT_STATUS_001_oPCAN_RADAR_d9930952_Tx: ComSignalType=UINT16
            STS_AlignmentAutoStatus_oRDR_ALIGNMENT_STATUS_001_oPCAN_RADAR_3df406fe_Tx: ComSignalType=UINT8
            STS_AlignmentAzimuth_oRDR_ALIGNMENT_STATUS_001_oPCAN_RADAR_90bea827_Tx: ComSignalType=SINT16
            STS_AlignmentElevation_oRDR_ALIGNMENT_STATUS_001_oPCAN_RADAR_92fc7208_Tx: ComSignalType=SINT16
            STS_AlignmentError_oRDR_ALIGNMENT_STATUS_001_oPCAN_RADAR_c2060acd_Tx: ComSignalType=UINT8
            STS_AlignmentModeIn_oRDR_ALIGNMENT_STATUS_001_oPCAN_RADAR_b9199e71_Tx: ComSignalType=UINT8
            STS_AlignmentModeOut_oRDR_ALIGNMENT_STATUS_001_oPCAN_RADAR_53f81498_Tx: ComSignalType=UINT8
            STS_AutoAlignmentFailRootCause_oRDR_ALIGNMENT_STATUS_001_oPCAN_RADAR_e1073ec5_Tx: ComSignalType=UINT8
            STS_AzimuthErrorNegative_oRDR_ALIGNMENT_STATUS_001_oPCAN_RADAR_6e4fe47d_Tx: ComSignalType=SINT16
            STS_AzimuthErrorPositive_oRDR_ALIGNMENT_STATUS_001_oPCAN_RADAR_de7f1c76_Tx: ComSignalType=SINT16
            STS_AzimuthStd_oRDR_ALIGNMENT_STATUS_001_oPCAN_RADAR_b46beb44_Tx: ComSignalType=UINT16
            STS_AzimuthUpdates_oRDR_ALIGNMENT_STATUS_001_oPCAN_RADAR_57325300_Tx: ComSignalType=UINT32
            STS_CalDisplay_oRDR_ALIGNMENT_STATUS_001_oPCAN_RADAR_ffd10a71_Tx: ComSignalType=UINT8
            STS_CalTime_oRDR_ALIGNMENT_STATUS_001_oPCAN_RADAR_429dbd7e_Tx: ComSignalType=UINT16
            STS_CoordinateSystemInput_oRDR_ALIGNMENT_STATUS_001_oPCAN_RADAR_ac54169a_Tx: ComSignalType=UINT8
            STS_ElevationErrorNegative_oRDR_ALIGNMENT_STATUS_001_oPCAN_RADAR_8ad967c2_Tx: ComSignalType=SINT16
            STS_ElevationErrorPositive_oRDR_ALIGNMENT_STATUS_001_oPCAN_RADAR_3ae99fc9_Tx: ComSignalType=SINT16
            STS_ElevationStd_oRDR_ALIGNMENT_STATUS_001_oPCAN_RADAR_0035801e_Tx: ComSignalType=UINT16
            STS_ElevationUpdates_oRDR_ALIGNMENT_STATUS_001_oPCAN_RADAR_5f349f48_Tx: ComSignalType=UINT32
            STS_HostSpdCompensationFactorQF_oRDR_ALIGNMENT_STATUS_001_oPCAN_RADAR_23e2637e_Tx: ComSignalType=UINT8
            STS_HostSpeedCompensationFactor_oRDR_ALIGNMENT_STATUS_001_oPCAN_RADAR_9815558a_Tx: ComSignalType=UINT8
            STS_InitAlignResultAzimuthUpdate_oRDR_ALIGNMENT_STATUS_001_oPCAN_RADAR_450388ed_Tx: ComSignalType=UINT16
            STS_InitAlignRsltElevationUpdate_oRDR_ALIGNMENT_STATUS_001_oPCAN_RADAR_25205dfc_Tx: ComSignalType=UINT16
            STS_InitAlignRsltHostSpdCompFac_oRDR_ALIGNMENT_STATUS_001_oPCAN_RADAR_cdf9488e_Tx: ComSignalType=UINT8
            STS_InitAlignmentResultAzimuth_oRDR_ALIGNMENT_STATUS_001_oPCAN_RADAR_ae7ace17_Tx: ComSignalType=SINT16
            STS_InitAlignmentResultElevation_oRDR_ALIGNMENT_STATUS_001_oPCAN_RADAR_e96bbe52_Tx: ComSignalType=SINT16
            STS_InitLastSuccessfulAlignMode_oRDR_ALIGNMENT_STATUS_001_oPCAN_RADAR_b93d4ccd_Tx: ComSignalType=UINT8
            STS_ProgressPercent_oRDR_ALIGNMENT_STATUS_001_oPCAN_RADAR_357c0985_Tx: ComSignalType=UINT8
            STS_RadarTypeInput_oRDR_ALIGNMENT_STATUS_001_oPCAN_RADAR_72f1a9b3_Tx: ComSignalType=UINT8
            STS_RollErrorNegative_oRDR_ALIGNMENT_STATUS_001_oPCAN_RADAR_86945eda_Tx: ComSignalType=SINT16
            STS_RollErrorPositive_oRDR_ALIGNMENT_STATUS_001_oPCAN_RADAR_36a4a6d1_Tx: ComSignalType=SINT16
            STS_Roll_Updates_oRDR_ALIGNMENT_STATUS_001_oPCAN_RADAR_519c95ca_Tx: ComSignalType=UINT32
            STS_StartAzimuth_oRDR_ALIGNMENT_STATUS_001_oPCAN_RADAR_61586fd0_Tx: ComSignalType=SINT16
            STS_StartElevation_oRDR_ALIGNMENT_STATUS_001_oPCAN_RADAR_cc01a387_Tx: ComSignalType=SINT16
            STS_StartRoll_oRDR_ALIGNMENT_STATUS_001_oPCAN_RADAR_ecd3f1a2_Tx: ComSignalType=SINT16
        SG_AlignmentStatus2_oRDR_ALIGNMENT_STATUS_002_oPCAN_RADAR_1945d616_Tx
          19 x ComGroupSignal:
            AL_STS_002_CYCLE_COUNTER_oRDR_ALIGNMENT_STATUS_002_oPCAN_RADAR_ac113952_Tx: ComSignalType=UINT8
            AL_STS_002_MH_CRC16_oRDR_ALIGNMENT_STATUS_002_oPCAN_RADAR_fd433470_Tx: ComSignalType=UINT16
            STS_AlignmentServiceStatus_oRDR_ALIGNMENT_STATUS_002_oPCAN_RADAR_d03a7577_Tx: ComSignalType=UINT8
            STS_AlignmentShortTrackStatus_oRDR_ALIGNMENT_STATUS_002_oPCAN_RADAR_a985d45d_Tx: ComSignalType=UINT8
            STS_AlignmentStaticStatus_oRDR_ALIGNMENT_STATUS_002_oPCAN_RADAR_ed9fe891_Tx: ComSignalType=UINT8
            STS_AverageNumberOfDetections_oRDR_ALIGNMENT_STATUS_002_oPCAN_RADAR_e5f0325a_Tx: ComSignalType=UINT32
            STS_AverageSpeed_oRDR_ALIGNMENT_STATUS_002_oPCAN_RADAR_12d3a902_Tx: ComSignalType=UINT32
            STS_DistanceAbsolute_oRDR_ALIGNMENT_STATUS_002_oPCAN_RADAR_350fb8c0_Tx: ComSignalType=UINT32
            STS_DistanceEffective_oRDR_ALIGNMENT_STATUS_002_oPCAN_RADAR_ba39d7ae_Tx: ComSignalType=UINT32
            STS_DurationAbsolute_oRDR_ALIGNMENT_STATUS_002_oPCAN_RADAR_b6d3be34_Tx: ComSignalType=UINT32
            STS_DurationEffective_oRDR_ALIGNMENT_STATUS_002_oPCAN_RADAR_006a3dad_Tx: ComSignalType=UINT32
            STS_ImpactByInterference_oRDR_ALIGNMENT_STATUS_002_oPCAN_RADAR_ea495887_Tx: ComSignalType=BOOLEAN
            STS_MeasuredAmpSTD_oRDR_ALIGNMENT_STATUS_002_oPCAN_RADAR_c894f01f_Tx: ComSignalType=UINT16
            STS_MeasuredRangeRateStd_oRDR_ALIGNMENT_STATUS_002_oPCAN_RADAR_f4643d07_Tx: ComSignalType=SINT16
            STS_MeasuredRangeRate_oRDR_ALIGNMENT_STATUS_002_oPCAN_RADAR_d6bd6aa0_Tx: ComSignalType=SINT32
            STS_MeasuredRangeStd_oRDR_ALIGNMENT_STATUS_002_oPCAN_RADAR_9735a635_Tx: ComSignalType=UINT16
            STS_MeasuredRawAmplitude_oRDR_ALIGNMENT_STATUS_002_oPCAN_RADAR_0c70d370_Tx: ComSignalType=SINT16
            STS_Measured_Range_oRDR_ALIGNMENT_STATUS_002_oPCAN_RADAR_44d7db0c_Tx: ComSignalType=UINT16
            STS_VehicleCondition_oRDR_ALIGNMENT_STATUS_002_oPCAN_RADAR_27e73dc1_Tx: ComSignalType=UINT8
        SG_CCVS1_oCCVS1_oVCAN_RADAR_1b2d3da2_Rx
          3 x ComGroupSignal:
            BrakeSwitch_oCCVS1_oVCAN_RADAR_1059096c_Rx: ComSignalType=UINT8
            ParkingBrakeSwitch_oCCVS1_oVCAN_RADAR_fe400b10_Rx: ComSignalType=UINT8
            WheelBasedVehicleSpeed_oCCVS1_oVCAN_RADAR_c435b4dd_Rx: ComSignalType=UINT16
        SG_CLS_Tx_16_oCLS_Tx_16_oVCAN_RADAR_ce7ac5cf_Rx
          Crawler_confi_status_info_oCLS_Tx_16_oVCAN_RADAR_9635d3b9_Rx (ComGroupSignal): ComSignalType=BOOLEAN
          Transmission_type_info_oCLS_Tx_16_oVCAN_RADAR_d6d97de8_Rx (ComGroupSignal): ComSignalType=UINT8
        SG_CLS_Tx_4_oCLS_Tx_4_oVCAN_RADAR_72dadf8e_Rx
          Ignition_oCLS_Tx_4_oVCAN_RADAR_cb871f88_Rx (ComGroupSignal): ComSignalType=UINT8
          ReverseSwitchInfo_oCLS_Tx_4_oVCAN_RADAR_b4b1941a_Rx (ComGroupSignal): ComSignalType=UINT8
        SG_Detections_001_004_oRDR_DETECTION_001_004_oPCAN_RADAR_df4895a5_Tx
          83 x ComGroupSignal:
            DET_AZIMUTH_001_oRDR_DETECTION_001_004_oPCAN_RADAR_c49dc547_Tx: ComSignalType=UINT16
            DET_AZIMUTH_002_oRDR_DETECTION_001_004_oPCAN_RADAR_a07dbeb9_Tx: ComSignalType=UINT16
            DET_AZIMUTH_003_oRDR_DETECTION_001_004_oPCAN_RADAR_350d6a2c_Tx: ComSignalType=UINT16
            DET_AZIMUTH_004_oRDR_DETECTION_001_004_oPCAN_RADAR_69bd4945_Tx: ComSignalType=UINT16
            DET_AZIMUTH_ERR_001_oRDR_DETECTION_001_004_oPCAN_RADAR_602850b2_Tx: ComSignalType=UINT8
            DET_AZIMUTH_ERR_002_oRDR_DETECTION_001_004_oPCAN_RADAR_04c82b4c_Tx: ComSignalType=UINT8
            DET_AZIMUTH_ERR_003_oRDR_DETECTION_001_004_oPCAN_RADAR_91b8ffd9_Tx: ComSignalType=UINT8
            DET_AZIMUTH_ERR_004_oRDR_DETECTION_001_004_oPCAN_RADAR_cd08dcb0_Tx: ComSignalType=UINT8
            DET_BELOW_RAIN_THOLD_001_oRDR_DETECTION_001_004_oPCAN_RADAR_119c5687_Tx: ComSignalType=UINT8
            DET_BELOW_RAIN_THOLD_002_oRDR_DETECTION_001_004_oPCAN_RADAR_757c2d79_Tx: ComSignalType=UINT8
            DET_BELOW_RAIN_THOLD_003_oRDR_DETECTION_001_004_oPCAN_RADAR_e00cf9ec_Tx: ComSignalType=UINT8
            DET_BELOW_RAIN_THOLD_004_oRDR_DETECTION_001_004_oPCAN_RADAR_bcbcda85_Tx: ComSignalType=UINT8
            DET_BI_STATIC_FLAG_001_oRDR_DETECTION_001_004_oPCAN_RADAR_92b185c2_Tx: ComSignalType=BOOLEAN
            DET_BI_STATIC_FLAG_002_oRDR_DETECTION_001_004_oPCAN_RADAR_f651fe3c_Tx: ComSignalType=BOOLEAN
            DET_BI_STATIC_FLAG_003_oRDR_DETECTION_001_004_oPCAN_RADAR_63212aa9_Tx: ComSignalType=BOOLEAN
            DET_BI_STATIC_FLAG_004_oRDR_DETECTION_001_004_oPCAN_RADAR_3f9109c0_Tx: ComSignalType=BOOLEAN
            DET_CONFD_AZIMUTH_001_oRDR_DETECTION_001_004_oPCAN_RADAR_c67bcf8d_Tx: ComSignalType=UINT8
            DET_CONFD_AZIMUTH_002_oRDR_DETECTION_001_004_oPCAN_RADAR_a29bb473_Tx: ComSignalType=UINT8
            DET_CONFD_AZIMUTH_003_oRDR_DETECTION_001_004_oPCAN_RADAR_37eb60e6_Tx: ComSignalType=UINT8
            DET_CONFD_AZIMUTH_004_oRDR_DETECTION_001_004_oPCAN_RADAR_6b5b438f_Tx: ComSignalType=UINT8
            DET_CONFD_ELEVATION_001_oRDR_DETECTION_001_004_oPCAN_RADAR_c4eece77_Tx: ComSignalType=UINT8
            DET_CONFD_ELEVATION_002_oRDR_DETECTION_001_004_oPCAN_RADAR_a00eb589_Tx: ComSignalType=UINT8
            DET_CONFD_ELEVATION_003_oRDR_DETECTION_001_004_oPCAN_RADAR_357e611c_Tx: ComSignalType=UINT8
            DET_CONFD_ELEVATION_004_oRDR_DETECTION_001_004_oPCAN_RADAR_69ce4275_Tx: ComSignalType=UINT8
            DET_ELEVATION_001_oRDR_DETECTION_001_004_oPCAN_RADAR_152e1a4b_Tx: ComSignalType=UINT8
            DET_ELEVATION_002_oRDR_DETECTION_001_004_oPCAN_RADAR_71ce61b5_Tx: ComSignalType=UINT8
            DET_ELEVATION_003_oRDR_DETECTION_001_004_oPCAN_RADAR_e4beb520_Tx: ComSignalType=UINT8
            DET_ELEVATION_004_oRDR_DETECTION_001_004_oPCAN_RADAR_b80e9649_Tx: ComSignalType=UINT8
            DET_ELEVATION_ERR_001_oRDR_DETECTION_001_004_oPCAN_RADAR_9217823e_Tx: ComSignalType=UINT8
            DET_ELEVATION_ERR_002_oRDR_DETECTION_001_004_oPCAN_RADAR_f6f7f9c0_Tx: ComSignalType=UINT8
            DET_ELEVATION_ERR_003_oRDR_DETECTION_001_004_oPCAN_RADAR_63872d55_Tx: ComSignalType=UINT8
            DET_ELEVATION_ERR_004_oRDR_DETECTION_001_004_oPCAN_RADAR_3f370e3c_Tx: ComSignalType=UINT8
            DET_EXISTENCE_PROB_001_oRDR_DETECTION_001_004_oPCAN_RADAR_4088f75e_Tx: ComSignalType=UINT8
            DET_EXISTENCE_PROB_002_oRDR_DETECTION_001_004_oPCAN_RADAR_24688ca0_Tx: ComSignalType=UINT8
            DET_EXISTENCE_PROB_003_oRDR_DETECTION_001_004_oPCAN_RADAR_b1185835_Tx: ComSignalType=UINT8
            DET_EXISTENCE_PROB_004_oRDR_DETECTION_001_004_oPCAN_RADAR_eda87b5c_Tx: ComSignalType=UINT8
            DET_HVC_FLAG_001_oRDR_DETECTION_001_004_oPCAN_RADAR_a1fcb421_Tx: ComSignalType=BOOLEAN
            DET_HVC_FLAG_002_oRDR_DETECTION_001_004_oPCAN_RADAR_c51ccfdf_Tx: ComSignalType=BOOLEAN
            DET_HVC_FLAG_003_oRDR_DETECTION_001_004_oPCAN_RADAR_506c1b4a_Tx: ComSignalType=BOOLEAN
            DET_HVC_FLAG_004_oRDR_DETECTION_001_004_oPCAN_RADAR_0cdc3823_Tx: ComSignalType=BOOLEAN
            DET_IDM_001_oRDR_DETECTION_001_004_oPCAN_RADAR_2aae8f9c_Tx: ComSignalType=UINT8
            DET_IDM_002_oRDR_DETECTION_001_004_oPCAN_RADAR_4e4ef462_Tx: ComSignalType=UINT8
            DET_IDM_003_oRDR_DETECTION_001_004_oPCAN_RADAR_db3e20f7_Tx: ComSignalType=UINT8
            DET_IDM_004_oRDR_DETECTION_001_004_oPCAN_RADAR_878e039e_Tx: ComSignalType=UINT8
            DET_MH_CRC16_001_004_oRDR_DETECTION_001_004_oPCAN_RADAR_5bc047ae_Tx: ComSignalType=UINT16
            DET_MH_CYCLE_COUNTER_001_004_oRDR_DETECTION_001_004_oPCAN_RADAR_dfb5e699_Tx: ComSignalType=UINT8
            DET_MH_SCAN_INDEX_4LSB_001_004_oRDR_DETECTION_001_004_oPCAN_RADAR_139fc315_Tx: ComSignalType=UINT8
            DET_MTD_001_oRDR_DETECTION_001_004_oPCAN_RADAR_4c1dbd47_Tx: ComSignalType=UINT8
            DET_MTD_002_oRDR_DETECTION_001_004_oPCAN_RADAR_28fdc6b9_Tx: ComSignalType=UINT8
            DET_MTD_003_oRDR_DETECTION_001_004_oPCAN_RADAR_bd8d122c_Tx: ComSignalType=UINT8
            DET_MTD_004_oRDR_DETECTION_001_004_oPCAN_RADAR_e13d3145_Tx: ComSignalType=UINT8
            DET_PROB_1STAZHYPO_001_oRDR_DETECTION_001_004_oPCAN_RADAR_dfa9558a_Tx: ComSignalType=BOOLEAN
            DET_PROB_1STAZHYPO_002_oRDR_DETECTION_001_004_oPCAN_RADAR_bb492e74_Tx: ComSignalType=BOOLEAN
            DET_PROB_1STAZHYPO_003_oRDR_DETECTION_001_004_oPCAN_RADAR_2e39fae1_Tx: ComSignalType=BOOLEAN
            DET_PROB_1STAZHYPO_004_oRDR_DETECTION_001_004_oPCAN_RADAR_7289d988_Tx: ComSignalType=BOOLEAN
            DET_RANGE_001_oRDR_DETECTION_001_004_oPCAN_RADAR_d406b6fc_Tx: ComSignalType=UINT16
            DET_RANGE_002_oRDR_DETECTION_001_004_oPCAN_RADAR_b0e6cd02_Tx: ComSignalType=UINT16
            DET_RANGE_003_oRDR_DETECTION_001_004_oPCAN_RADAR_25961997_Tx: ComSignalType=UINT16
            DET_RANGE_004_oRDR_DETECTION_001_004_oPCAN_RADAR_79263afe_Tx: ComSignalType=UINT16
            DET_RANGE_ERR_001_oRDR_DETECTION_001_004_oPCAN_RADAR_73ee0c95_Tx: ComSignalType=UINT8
            DET_RANGE_ERR_002_oRDR_DETECTION_001_004_oPCAN_RADAR_170e776b_Tx: ComSignalType=UINT8
            DET_RANGE_ERR_003_oRDR_DETECTION_001_004_oPCAN_RADAR_827ea3fe_Tx: ComSignalType=UINT8
            DET_RANGE_ERR_004_oRDR_DETECTION_001_004_oPCAN_RADAR_dece8097_Tx: ComSignalType=UINT8
            DET_RANGE_VELOCITY_001_oRDR_DETECTION_001_004_oPCAN_RADAR_a1a074d9_Tx: ComSignalType=UINT16
            DET_RANGE_VELOCITY_002_oRDR_DETECTION_001_004_oPCAN_RADAR_c5400f27_Tx: ComSignalType=UINT16
            DET_RANGE_VELOCITY_003_oRDR_DETECTION_001_004_oPCAN_RADAR_5030dbb2_Tx: ComSignalType=UINT16
            DET_RANGE_VELOCITY_004_oRDR_DETECTION_001_004_oPCAN_RADAR_0c80f8db_Tx: ComSignalType=UINT16
            DET_RANGE_VELOCITY_ERR_001_oRDR_DETECTION_001_004_oPCAN_RADAR_ae1b8f6b_Tx: ComSignalType=UINT8
            DET_RANGE_VELOCITY_ERR_002_oRDR_DETECTION_001_004_oPCAN_RADAR_cafbf495_Tx: ComSignalType=UINT8
            DET_RANGE_VELOCITY_ERR_003_oRDR_DETECTION_001_004_oPCAN_RADAR_5f8b2000_Tx: ComSignalType=UINT8
            DET_RANGE_VELOCITY_ERR_004_oRDR_DETECTION_001_004_oPCAN_RADAR_033b0369_Tx: ComSignalType=UINT8
            DET_RCS_001_oRDR_DETECTION_001_004_oPCAN_RADAR_26204383_Tx: ComSignalType=UINT8
            DET_RCS_002_oRDR_DETECTION_001_004_oPCAN_RADAR_42c0387d_Tx: ComSignalType=UINT8
            DET_RCS_003_oRDR_DETECTION_001_004_oPCAN_RADAR_d7b0ece8_Tx: ComSignalType=UINT8
            DET_RCS_004_oRDR_DETECTION_001_004_oPCAN_RADAR_8b00cf81_Tx: ComSignalType=UINT8
            DET_SNR_001_oRDR_DETECTION_001_004_oPCAN_RADAR_fb8e1781_Tx: ComSignalType=UINT8
            DET_SNR_002_oRDR_DETECTION_001_004_oPCAN_RADAR_9f6e6c7f_Tx: ComSignalType=UINT8
            DET_SNR_003_oRDR_DETECTION_001_004_oPCAN_RADAR_0a1eb8ea_Tx: ComSignalType=UINT8
            DET_SNR_004_oRDR_DETECTION_001_004_oPCAN_RADAR_56ae9b83_Tx: ComSignalType=UINT8
            DET_SUPER_RES_TARGET_001_oRDR_DETECTION_001_004_oPCAN_RADAR_ca173fe4_Tx: ComSignalType=BOOLEAN
            DET_SUPER_RES_TARGET_002_oRDR_DETECTION_001_004_oPCAN_RADAR_aef7441a_Tx: ComSignalType=BOOLEAN
            DET_SUPER_RES_TARGET_003_oRDR_DETECTION_001_004_oPCAN_RADAR_3b87908f_Tx: ComSignalType=BOOLEAN
            DET_SUPER_RES_TARGET_004_oRDR_DETECTION_001_004_oPCAN_RADAR_6737b3e6_Tx: ComSignalType=BOOLEAN
        SG_Detections_005_008_oRDR_DETECTION_005_008_oPCAN_RADAR_ae8ba1f7_Tx
          83 x ComGroupSignal:
            DET_AZIMUTH_005_oRDR_DETECTION_005_008_oPCAN_RADAR_157f03e4_Tx: ComSignalType=UINT16
            DET_AZIMUTH_006_oRDR_DETECTION_005_008_oPCAN_RADAR_719f781a_Tx: ComSignalType=UINT16
            DET_AZIMUTH_007_oRDR_DETECTION_005_008_oPCAN_RADAR_e4efac8f_Tx: ComSignalType=UINT16
            DET_AZIMUTH_008_oRDR_DETECTION_005_008_oPCAN_RADAR_c8ff3ec8_Tx: ComSignalType=UINT16
            DET_AZIMUTH_ERR_005_oRDR_DETECTION_005_008_oPCAN_RADAR_b1ca9611_Tx: ComSignalType=UINT8
            DET_AZIMUTH_ERR_006_oRDR_DETECTION_005_008_oPCAN_RADAR_d52aedef_Tx: ComSignalType=UINT8
            DET_AZIMUTH_ERR_007_oRDR_DETECTION_005_008_oPCAN_RADAR_405a397a_Tx: ComSignalType=UINT8
            DET_AZIMUTH_ERR_008_oRDR_DETECTION_005_008_oPCAN_RADAR_6c4aab3d_Tx: ComSignalType=UINT8
            DET_BELOW_RAIN_THOLD_005_oRDR_DETECTION_005_008_oPCAN_RADAR_c07e9024_Tx: ComSignalType=UINT8
            DET_BELOW_RAIN_THOLD_006_oRDR_DETECTION_005_008_oPCAN_RADAR_a49eebda_Tx: ComSignalType=UINT8
            DET_BELOW_RAIN_THOLD_007_oRDR_DETECTION_005_008_oPCAN_RADAR_31ee3f4f_Tx: ComSignalType=UINT8
            DET_BELOW_RAIN_THOLD_008_oRDR_DETECTION_005_008_oPCAN_RADAR_1dfead08_Tx: ComSignalType=UINT8
            DET_BI_STATIC_FLAG_005_oRDR_DETECTION_005_008_oPCAN_RADAR_43534361_Tx: ComSignalType=BOOLEAN
            DET_BI_STATIC_FLAG_006_oRDR_DETECTION_005_008_oPCAN_RADAR_27b3389f_Tx: ComSignalType=BOOLEAN
            DET_BI_STATIC_FLAG_007_oRDR_DETECTION_005_008_oPCAN_RADAR_b2c3ec0a_Tx: ComSignalType=BOOLEAN
            DET_BI_STATIC_FLAG_008_oRDR_DETECTION_005_008_oPCAN_RADAR_9ed37e4d_Tx: ComSignalType=BOOLEAN
            DET_CONFD_AZIMUTH_005_oRDR_DETECTION_005_008_oPCAN_RADAR_1799092e_Tx: ComSignalType=UINT8
            DET_CONFD_AZIMUTH_006_oRDR_DETECTION_005_008_oPCAN_RADAR_737972d0_Tx: ComSignalType=UINT8
            DET_CONFD_AZIMUTH_007_oRDR_DETECTION_005_008_oPCAN_RADAR_e609a645_Tx: ComSignalType=UINT8
            DET_CONFD_AZIMUTH_008_oRDR_DETECTION_005_008_oPCAN_RADAR_ca193402_Tx: ComSignalType=UINT8
            DET_CONFD_ELEVATION_005_oRDR_DETECTION_005_008_oPCAN_RADAR_150c08d4_Tx: ComSignalType=UINT8
            DET_CONFD_ELEVATION_006_oRDR_DETECTION_005_008_oPCAN_RADAR_71ec732a_Tx: ComSignalType=UINT8
            DET_CONFD_ELEVATION_007_oRDR_DETECTION_005_008_oPCAN_RADAR_e49ca7bf_Tx: ComSignalType=UINT8
            DET_CONFD_ELEVATION_008_oRDR_DETECTION_005_008_oPCAN_RADAR_c88c35f8_Tx: ComSignalType=UINT8
            DET_ELEVATION_005_oRDR_DETECTION_005_008_oPCAN_RADAR_c4ccdce8_Tx: ComSignalType=UINT8
            DET_ELEVATION_006_oRDR_DETECTION_005_008_oPCAN_RADAR_a02ca716_Tx: ComSignalType=UINT8
            DET_ELEVATION_007_oRDR_DETECTION_005_008_oPCAN_RADAR_355c7383_Tx: ComSignalType=UINT8
            DET_ELEVATION_008_oRDR_DETECTION_005_008_oPCAN_RADAR_194ce1c4_Tx: ComSignalType=UINT8
            DET_ELEVATION_ERR_005_oRDR_DETECTION_005_008_oPCAN_RADAR_43f5449d_Tx: ComSignalType=UINT8
            DET_ELEVATION_ERR_006_oRDR_DETECTION_005_008_oPCAN_RADAR_27153f63_Tx: ComSignalType=UINT8
            DET_ELEVATION_ERR_007_oRDR_DETECTION_005_008_oPCAN_RADAR_b265ebf6_Tx: ComSignalType=UINT8
            DET_ELEVATION_ERR_008_oRDR_DETECTION_005_008_oPCAN_RADAR_9e7579b1_Tx: ComSignalType=UINT8
            DET_EXISTENCE_PROB_005_oRDR_DETECTION_005_008_oPCAN_RADAR_916a31fd_Tx: ComSignalType=UINT8
            DET_EXISTENCE_PROB_006_oRDR_DETECTION_005_008_oPCAN_RADAR_f58a4a03_Tx: ComSignalType=UINT8
            DET_EXISTENCE_PROB_007_oRDR_DETECTION_005_008_oPCAN_RADAR_60fa9e96_Tx: ComSignalType=UINT8
            DET_EXISTENCE_PROB_008_oRDR_DETECTION_005_008_oPCAN_RADAR_4cea0cd1_Tx: ComSignalType=UINT8
            DET_HVC_FLAG_005_oRDR_DETECTION_005_008_oPCAN_RADAR_701e7282_Tx: ComSignalType=BOOLEAN
            DET_HVC_FLAG_006_oRDR_DETECTION_005_008_oPCAN_RADAR_14fe097c_Tx: ComSignalType=BOOLEAN
            DET_HVC_FLAG_007_oRDR_DETECTION_005_008_oPCAN_RADAR_818edde9_Tx: ComSignalType=BOOLEAN
            DET_HVC_FLAG_008_oRDR_DETECTION_005_008_oPCAN_RADAR_ad9e4fae_Tx: ComSignalType=BOOLEAN
            DET_IDM_005_oRDR_DETECTION_005_008_oPCAN_RADAR_fb4c493f_Tx: ComSignalType=UINT8
            DET_IDM_006_oRDR_DETECTION_005_008_oPCAN_RADAR_9fac32c1_Tx: ComSignalType=UINT8
            DET_IDM_007_oRDR_DETECTION_005_008_oPCAN_RADAR_0adce654_Tx: ComSignalType=UINT8
            DET_IDM_008_oRDR_DETECTION_005_008_oPCAN_RADAR_26cc7413_Tx: ComSignalType=UINT8
            DET_MH_CRC16_005_008_oRDR_DETECTION_005_008_oPCAN_RADAR_2a0373fc_Tx: ComSignalType=UINT16
            DET_MH_CYCLE_COUNTER_005_008_oRDR_DETECTION_005_008_oPCAN_RADAR_ae76d2cb_Tx: ComSignalType=UINT8
            DET_MH_SCAN_INDEX_4LSB_005_008_oRDR_DETECTION_005_008_oPCAN_RADAR_625cf747_Tx: ComSignalType=UINT8
            DET_MTD_005_oRDR_DETECTION_005_008_oPCAN_RADAR_9dff7be4_Tx: ComSignalType=UINT8
            DET_MTD_006_oRDR_DETECTION_005_008_oPCAN_RADAR_f91f001a_Tx: ComSignalType=UINT8
            DET_MTD_007_oRDR_DETECTION_005_008_oPCAN_RADAR_6c6fd48f_Tx: ComSignalType=UINT8
            DET_MTD_008_oRDR_DETECTION_005_008_oPCAN_RADAR_407f46c8_Tx: ComSignalType=UINT8
            DET_PROB_1STAZHYPO_005_oRDR_DETECTION_005_008_oPCAN_RADAR_0e4b9329_Tx: ComSignalType=BOOLEAN
            DET_PROB_1STAZHYPO_006_oRDR_DETECTION_005_008_oPCAN_RADAR_6aabe8d7_Tx: ComSignalType=BOOLEAN
            DET_PROB_1STAZHYPO_007_oRDR_DETECTION_005_008_oPCAN_RADAR_ffdb3c42_Tx: ComSignalType=BOOLEAN
            DET_PROB_1STAZHYPO_008_oRDR_DETECTION_005_008_oPCAN_RADAR_d3cbae05_Tx: ComSignalType=BOOLEAN
            DET_RANGE_005_oRDR_DETECTION_005_008_oPCAN_RADAR_05e4705f_Tx: ComSignalType=UINT16
            DET_RANGE_006_oRDR_DETECTION_005_008_oPCAN_RADAR_61040ba1_Tx: ComSignalType=UINT16
            DET_RANGE_007_oRDR_DETECTION_005_008_oPCAN_RADAR_f474df34_Tx: ComSignalType=UINT16
            DET_RANGE_008_oRDR_DETECTION_005_008_oPCAN_RADAR_d8644d73_Tx: ComSignalType=UINT16
            DET_RANGE_ERR_005_oRDR_DETECTION_005_008_oPCAN_RADAR_a20cca36_Tx: ComSignalType=UINT8
            DET_RANGE_ERR_006_oRDR_DETECTION_005_008_oPCAN_RADAR_c6ecb1c8_Tx: ComSignalType=UINT8
            DET_RANGE_ERR_007_oRDR_DETECTION_005_008_oPCAN_RADAR_539c655d_Tx: ComSignalType=UINT8
            DET_RANGE_ERR_008_oRDR_DETECTION_005_008_oPCAN_RADAR_7f8cf71a_Tx: ComSignalType=UINT8
            DET_RANGE_VELOCITY_005_oRDR_DETECTION_005_008_oPCAN_RADAR_7042b27a_Tx: ComSignalType=UINT16
            DET_RANGE_VELOCITY_006_oRDR_DETECTION_005_008_oPCAN_RADAR_14a2c984_Tx: ComSignalType=UINT16
            DET_RANGE_VELOCITY_007_oRDR_DETECTION_005_008_oPCAN_RADAR_81d21d11_Tx: ComSignalType=UINT16
            DET_RANGE_VELOCITY_008_oRDR_DETECTION_005_008_oPCAN_RADAR_adc28f56_Tx: ComSignalType=UINT16
            DET_RANGE_VELOCITY_ERR_005_oRDR_DETECTION_005_008_oPCAN_RADAR_7ff949c8_Tx: ComSignalType=UINT8
            DET_RANGE_VELOCITY_ERR_006_oRDR_DETECTION_005_008_oPCAN_RADAR_1b193236_Tx: ComSignalType=UINT8
            DET_RANGE_VELOCITY_ERR_007_oRDR_DETECTION_005_008_oPCAN_RADAR_8e69e6a3_Tx: ComSignalType=UINT8
            DET_RANGE_VELOCITY_ERR_008_oRDR_DETECTION_005_008_oPCAN_RADAR_a27974e4_Tx: ComSignalType=UINT8
            DET_RCS_005_oRDR_DETECTION_005_008_oPCAN_RADAR_f7c28520_Tx: ComSignalType=UINT8
            DET_RCS_006_oRDR_DETECTION_005_008_oPCAN_RADAR_9322fede_Tx: ComSignalType=UINT8
            DET_RCS_007_oRDR_DETECTION_005_008_oPCAN_RADAR_06522a4b_Tx: ComSignalType=UINT8
            DET_RCS_008_oRDR_DETECTION_005_008_oPCAN_RADAR_2a42b80c_Tx: ComSignalType=UINT8
            DET_SNR_005_oRDR_DETECTION_005_008_oPCAN_RADAR_2a6cd122_Tx: ComSignalType=UINT8
            DET_SNR_006_oRDR_DETECTION_005_008_oPCAN_RADAR_4e8caadc_Tx: ComSignalType=UINT8
            DET_SNR_007_oRDR_DETECTION_005_008_oPCAN_RADAR_dbfc7e49_Tx: ComSignalType=UINT8
            DET_SNR_008_oRDR_DETECTION_005_008_oPCAN_RADAR_f7ecec0e_Tx: ComSignalType=UINT8
            DET_SUPER_RES_TARGET_005_oRDR_DETECTION_005_008_oPCAN_RADAR_1bf5f947_Tx: ComSignalType=BOOLEAN
            DET_SUPER_RES_TARGET_006_oRDR_DETECTION_005_008_oPCAN_RADAR_7f1582b9_Tx: ComSignalType=BOOLEAN
            DET_SUPER_RES_TARGET_007_oRDR_DETECTION_005_008_oPCAN_RADAR_ea65562c_Tx: ComSignalType=BOOLEAN
            DET_SUPER_RES_TARGET_008_oRDR_DETECTION_005_008_oPCAN_RADAR_c675c46b_Tx: ComSignalType=BOOLEAN
        SG_Detections_009_012_oRDR_DETECTION_009_012_oPCAN_RADAR_37f1858c_Tx
          83 x ComGroupSignal:
            DET_AZIMUTH_009_oRDR_DETECTION_009_012_oPCAN_RADAR_6fc7055c_Tx: ComSignalType=UINT16
            DET_AZIMUTH_010_oRDR_DETECTION_009_012_oPCAN_RADAR_0ae777f8_Tx: ComSignalType=UINT16
            DET_AZIMUTH_011_oRDR_DETECTION_009_012_oPCAN_RADAR_9f97a36d_Tx: ComSignalType=UINT16
            DET_AZIMUTH_012_oRDR_DETECTION_009_012_oPCAN_RADAR_fb77d893_Tx: ComSignalType=UINT16
            DET_AZIMUTH_ERR_009_oRDR_DETECTION_009_012_oPCAN_RADAR_cb7290a9_Tx: ComSignalType=UINT8
            DET_AZIMUTH_ERR_010_oRDR_DETECTION_009_012_oPCAN_RADAR_ae52e20d_Tx: ComSignalType=UINT8
            DET_AZIMUTH_ERR_011_oRDR_DETECTION_009_012_oPCAN_RADAR_3b223698_Tx: ComSignalType=UINT8
            DET_AZIMUTH_ERR_012_oRDR_DETECTION_009_012_oPCAN_RADAR_5fc24d66_Tx: ComSignalType=UINT8
            DET_BELOW_RAIN_THOLD_009_oRDR_DETECTION_009_012_oPCAN_RADAR_bac6969c_Tx: ComSignalType=UINT8
            DET_BELOW_RAIN_THOLD_010_oRDR_DETECTION_009_012_oPCAN_RADAR_dfe6e438_Tx: ComSignalType=UINT8
            DET_BELOW_RAIN_THOLD_011_oRDR_DETECTION_009_012_oPCAN_RADAR_4a9630ad_Tx: ComSignalType=UINT8
            DET_BELOW_RAIN_THOLD_012_oRDR_DETECTION_009_012_oPCAN_RADAR_2e764b53_Tx: ComSignalType=UINT8
            DET_BI_STATIC_FLAG_009_oRDR_DETECTION_009_012_oPCAN_RADAR_39eb45d9_Tx: ComSignalType=BOOLEAN
            DET_BI_STATIC_FLAG_010_oRDR_DETECTION_009_012_oPCAN_RADAR_5ccb377d_Tx: ComSignalType=BOOLEAN
            DET_BI_STATIC_FLAG_011_oRDR_DETECTION_009_012_oPCAN_RADAR_c9bbe3e8_Tx: ComSignalType=BOOLEAN
            DET_BI_STATIC_FLAG_012_oRDR_DETECTION_009_012_oPCAN_RADAR_ad5b9816_Tx: ComSignalType=BOOLEAN
            DET_CONFD_AZIMUTH_009_oRDR_DETECTION_009_012_oPCAN_RADAR_6d210f96_Tx: ComSignalType=UINT8
            DET_CONFD_AZIMUTH_010_oRDR_DETECTION_009_012_oPCAN_RADAR_08017d32_Tx: ComSignalType=UINT8
            DET_CONFD_AZIMUTH_011_oRDR_DETECTION_009_012_oPCAN_RADAR_9d71a9a7_Tx: ComSignalType=UINT8
            DET_CONFD_AZIMUTH_012_oRDR_DETECTION_009_012_oPCAN_RADAR_f991d259_Tx: ComSignalType=UINT8
            DET_CONFD_ELEVATION_009_oRDR_DETECTION_009_012_oPCAN_RADAR_6fb40e6c_Tx: ComSignalType=UINT8
            DET_CONFD_ELEVATION_010_oRDR_DETECTION_009_012_oPCAN_RADAR_0a947cc8_Tx: ComSignalType=UINT8
            DET_CONFD_ELEVATION_011_oRDR_DETECTION_009_012_oPCAN_RADAR_9fe4a85d_Tx: ComSignalType=UINT8
            DET_CONFD_ELEVATION_012_oRDR_DETECTION_009_012_oPCAN_RADAR_fb04d3a3_Tx: ComSignalType=UINT8
            DET_ELEVATION_009_oRDR_DETECTION_009_012_oPCAN_RADAR_be74da50_Tx: ComSignalType=UINT8
            DET_ELEVATION_010_oRDR_DETECTION_009_012_oPCAN_RADAR_db54a8f4_Tx: ComSignalType=UINT8
            DET_ELEVATION_011_oRDR_DETECTION_009_012_oPCAN_RADAR_4e247c61_Tx: ComSignalType=UINT8
            DET_ELEVATION_012_oRDR_DETECTION_009_012_oPCAN_RADAR_2ac4079f_Tx: ComSignalType=UINT8
            DET_ELEVATION_ERR_009_oRDR_DETECTION_009_012_oPCAN_RADAR_394d4225_Tx: ComSignalType=UINT8
            DET_ELEVATION_ERR_010_oRDR_DETECTION_009_012_oPCAN_RADAR_5c6d3081_Tx: ComSignalType=UINT8
            DET_ELEVATION_ERR_011_oRDR_DETECTION_009_012_oPCAN_RADAR_c91de414_Tx: ComSignalType=UINT8
            DET_ELEVATION_ERR_012_oRDR_DETECTION_009_012_oPCAN_RADAR_adfd9fea_Tx: ComSignalType=UINT8
            DET_EXISTENCE_PROB_009_oRDR_DETECTION_009_012_oPCAN_RADAR_ebd23745_Tx: ComSignalType=UINT8
            DET_EXISTENCE_PROB_010_oRDR_DETECTION_009_012_oPCAN_RADAR_8ef245e1_Tx: ComSignalType=UINT8
            DET_EXISTENCE_PROB_011_oRDR_DETECTION_009_012_oPCAN_RADAR_1b829174_Tx: ComSignalType=UINT8
            DET_EXISTENCE_PROB_012_oRDR_DETECTION_009_012_oPCAN_RADAR_7f62ea8a_Tx: ComSignalType=UINT8
            DET_HVC_FLAG_009_oRDR_DETECTION_009_012_oPCAN_RADAR_0aa6743a_Tx: ComSignalType=BOOLEAN
            DET_HVC_FLAG_010_oRDR_DETECTION_009_012_oPCAN_RADAR_6f86069e_Tx: ComSignalType=BOOLEAN
            DET_HVC_FLAG_011_oRDR_DETECTION_009_012_oPCAN_RADAR_faf6d20b_Tx: ComSignalType=BOOLEAN
            DET_HVC_FLAG_012_oRDR_DETECTION_009_012_oPCAN_RADAR_9e16a9f5_Tx: ComSignalType=BOOLEAN
            DET_IDM_009_oRDR_DETECTION_009_012_oPCAN_RADAR_81f44f87_Tx: ComSignalType=UINT8
            DET_IDM_010_oRDR_DETECTION_009_012_oPCAN_RADAR_e4d43d23_Tx: ComSignalType=UINT8
            DET_IDM_011_oRDR_DETECTION_009_012_oPCAN_RADAR_71a4e9b6_Tx: ComSignalType=UINT8
            DET_IDM_012_oRDR_DETECTION_009_012_oPCAN_RADAR_15449248_Tx: ComSignalType=UINT8
            DET_MH_CRC16_009_012_oRDR_DETECTION_009_012_oPCAN_RADAR_b3795787_Tx: ComSignalType=UINT16
            DET_MH_CYCLE_COUNTER_009_012_oRDR_DETECTION_009_012_oPCAN_RADAR_370cf6b0_Tx: ComSignalType=UINT8
            DET_MH_SCAN_INDEX_4LSB_009_012_oRDR_DETECTION_009_012_oPCAN_RADAR_fb26d33c_Tx: ComSignalType=UINT8
            DET_MTD_009_oRDR_DETECTION_009_012_oPCAN_RADAR_e7477d5c_Tx: ComSignalType=UINT8
            DET_MTD_010_oRDR_DETECTION_009_012_oPCAN_RADAR_82670ff8_Tx: ComSignalType=UINT8
            DET_MTD_011_oRDR_DETECTION_009_012_oPCAN_RADAR_1717db6d_Tx: ComSignalType=UINT8
            DET_MTD_012_oRDR_DETECTION_009_012_oPCAN_RADAR_73f7a093_Tx: ComSignalType=UINT8
            DET_PROB_1STAZHYPO_009_oRDR_DETECTION_009_012_oPCAN_RADAR_74f39591_Tx: ComSignalType=BOOLEAN
            DET_PROB_1STAZHYPO_010_oRDR_DETECTION_009_012_oPCAN_RADAR_11d3e735_Tx: ComSignalType=BOOLEAN
            DET_PROB_1STAZHYPO_011_oRDR_DETECTION_009_012_oPCAN_RADAR_84a333a0_Tx: ComSignalType=BOOLEAN
            DET_PROB_1STAZHYPO_012_oRDR_DETECTION_009_012_oPCAN_RADAR_e043485e_Tx: ComSignalType=BOOLEAN
            DET_RANGE_009_oRDR_DETECTION_009_012_oPCAN_RADAR_7f5c76e7_Tx: ComSignalType=UINT16
            DET_RANGE_010_oRDR_DETECTION_009_012_oPCAN_RADAR_1a7c0443_Tx: ComSignalType=UINT16
            DET_RANGE_011_oRDR_DETECTION_009_012_oPCAN_RADAR_8f0cd0d6_Tx: ComSignalType=UINT16
            DET_RANGE_012_oRDR_DETECTION_009_012_oPCAN_RADAR_ebecab28_Tx: ComSignalType=UINT16
            DET_RANGE_ERR_009_oRDR_DETECTION_009_012_oPCAN_RADAR_d8b4cc8e_Tx: ComSignalType=UINT8
            DET_RANGE_ERR_010_oRDR_DETECTION_009_012_oPCAN_RADAR_bd94be2a_Tx: ComSignalType=UINT8
            DET_RANGE_ERR_011_oRDR_DETECTION_009_012_oPCAN_RADAR_28e46abf_Tx: ComSignalType=UINT8
            DET_RANGE_ERR_012_oRDR_DETECTION_009_012_oPCAN_RADAR_4c041141_Tx: ComSignalType=UINT8
            DET_RANGE_VELOCITY_009_oRDR_DETECTION_009_012_oPCAN_RADAR_0afab4c2_Tx: ComSignalType=UINT16
            DET_RANGE_VELOCITY_010_oRDR_DETECTION_009_012_oPCAN_RADAR_6fdac666_Tx: ComSignalType=UINT16
            DET_RANGE_VELOCITY_011_oRDR_DETECTION_009_012_oPCAN_RADAR_faaa12f3_Tx: ComSignalType=UINT16
            DET_RANGE_VELOCITY_012_oRDR_DETECTION_009_012_oPCAN_RADAR_9e4a690d_Tx: ComSignalType=UINT16
            DET_RANGE_VELOCITY_ERR_009_oRDR_DETECTION_009_012_oPCAN_RADAR_05414f70_Tx: ComSignalType=UINT8
            DET_RANGE_VELOCITY_ERR_010_oRDR_DETECTION_009_012_oPCAN_RADAR_60613dd4_Tx: ComSignalType=UINT8
            DET_RANGE_VELOCITY_ERR_011_oRDR_DETECTION_009_012_oPCAN_RADAR_f511e941_Tx: ComSignalType=UINT8
            DET_RANGE_VELOCITY_ERR_012_oRDR_DETECTION_009_012_oPCAN_RADAR_91f192bf_Tx: ComSignalType=UINT8
            DET_RCS_009_oRDR_DETECTION_009_012_oPCAN_RADAR_8d7a8398_Tx: ComSignalType=UINT8
            DET_RCS_010_oRDR_DETECTION_009_012_oPCAN_RADAR_e85af13c_Tx: ComSignalType=UINT8
            DET_RCS_011_oRDR_DETECTION_009_012_oPCAN_RADAR_7d2a25a9_Tx: ComSignalType=UINT8
            DET_RCS_012_oRDR_DETECTION_009_012_oPCAN_RADAR_19ca5e57_Tx: ComSignalType=UINT8
            DET_SNR_009_oRDR_DETECTION_009_012_oPCAN_RADAR_50d4d79a_Tx: ComSignalType=UINT8
            DET_SNR_010_oRDR_DETECTION_009_012_oPCAN_RADAR_35f4a53e_Tx: ComSignalType=UINT8
            DET_SNR_011_oRDR_DETECTION_009_012_oPCAN_RADAR_a08471ab_Tx: ComSignalType=UINT8
            DET_SNR_012_oRDR_DETECTION_009_012_oPCAN_RADAR_c4640a55_Tx: ComSignalType=UINT8
            DET_SUPER_RES_TARGET_009_oRDR_DETECTION_009_012_oPCAN_RADAR_614dffff_Tx: ComSignalType=BOOLEAN
            DET_SUPER_RES_TARGET_010_oRDR_DETECTION_009_012_oPCAN_RADAR_046d8d5b_Tx: ComSignalType=BOOLEAN
            DET_SUPER_RES_TARGET_011_oRDR_DETECTION_009_012_oPCAN_RADAR_911d59ce_Tx: ComSignalType=BOOLEAN
            DET_SUPER_RES_TARGET_012_oRDR_DETECTION_009_012_oPCAN_RADAR_f5fd2230_Tx: ComSignalType=BOOLEAN
        SG_Detections_013_016_oRDR_DETECTION_013_016_oPCAN_RADAR_05faeda4_Tx
          83 x ComGroupSignal:
            DET_AZIMUTH_013_oRDR_DETECTION_013_016_oPCAN_RADAR_73c00f28_Tx: ComSignalType=UINT16
            DET_AZIMUTH_014_oRDR_DETECTION_013_016_oPCAN_RADAR_2f702c41_Tx: ComSignalType=UINT16
            DET_AZIMUTH_015_oRDR_DETECTION_013_016_oPCAN_RADAR_ba00f8d4_Tx: ComSignalType=UINT16
            DET_AZIMUTH_016_oRDR_DETECTION_013_016_oPCAN_RADAR_dee0832a_Tx: ComSignalType=UINT16
            DET_AZIMUTH_ERR_013_oRDR_DETECTION_013_016_oPCAN_RADAR_d7759add_Tx: ComSignalType=UINT8
            DET_AZIMUTH_ERR_014_oRDR_DETECTION_013_016_oPCAN_RADAR_8bc5b9b4_Tx: ComSignalType=UINT8
            DET_AZIMUTH_ERR_015_oRDR_DETECTION_013_016_oPCAN_RADAR_1eb56d21_Tx: ComSignalType=UINT8
            DET_AZIMUTH_ERR_016_oRDR_DETECTION_013_016_oPCAN_RADAR_7a5516df_Tx: ComSignalType=UINT8
            DET_BELOW_RAIN_THOLD_013_oRDR_DETECTION_013_016_oPCAN_RADAR_a6c19ce8_Tx: ComSignalType=UINT8
            DET_BELOW_RAIN_THOLD_014_oRDR_DETECTION_013_016_oPCAN_RADAR_fa71bf81_Tx: ComSignalType=UINT8
            DET_BELOW_RAIN_THOLD_015_oRDR_DETECTION_013_016_oPCAN_RADAR_6f016b14_Tx: ComSignalType=UINT8
            DET_BELOW_RAIN_THOLD_016_oRDR_DETECTION_013_016_oPCAN_RADAR_0be110ea_Tx: ComSignalType=UINT8
            DET_BI_STATIC_FLAG_013_oRDR_DETECTION_013_016_oPCAN_RADAR_25ec4fad_Tx: ComSignalType=BOOLEAN
            DET_BI_STATIC_FLAG_014_oRDR_DETECTION_013_016_oPCAN_RADAR_795c6cc4_Tx: ComSignalType=BOOLEAN
            DET_BI_STATIC_FLAG_015_oRDR_DETECTION_013_016_oPCAN_RADAR_ec2cb851_Tx: ComSignalType=BOOLEAN
            DET_BI_STATIC_FLAG_016_oRDR_DETECTION_013_016_oPCAN_RADAR_88ccc3af_Tx: ComSignalType=BOOLEAN
            DET_CONFD_AZIMUTH_013_oRDR_DETECTION_013_016_oPCAN_RADAR_712605e2_Tx: ComSignalType=UINT8
            DET_CONFD_AZIMUTH_014_oRDR_DETECTION_013_016_oPCAN_RADAR_2d96268b_Tx: ComSignalType=UINT8
            DET_CONFD_AZIMUTH_015_oRDR_DETECTION_013_016_oPCAN_RADAR_b8e6f21e_Tx: ComSignalType=UINT8
            DET_CONFD_AZIMUTH_016_oRDR_DETECTION_013_016_oPCAN_RADAR_dc0689e0_Tx: ComSignalType=UINT8
            DET_CONFD_ELEVATION_013_oRDR_DETECTION_013_016_oPCAN_RADAR_73b30418_Tx: ComSignalType=UINT8
            DET_CONFD_ELEVATION_014_oRDR_DETECTION_013_016_oPCAN_RADAR_2f032771_Tx: ComSignalType=UINT8
            DET_CONFD_ELEVATION_015_oRDR_DETECTION_013_016_oPCAN_RADAR_ba73f3e4_Tx: ComSignalType=UINT8
            DET_CONFD_ELEVATION_016_oRDR_DETECTION_013_016_oPCAN_RADAR_de93881a_Tx: ComSignalType=UINT8
            DET_ELEVATION_013_oRDR_DETECTION_013_016_oPCAN_RADAR_a273d024_Tx: ComSignalType=UINT8
            DET_ELEVATION_014_oRDR_DETECTION_013_016_oPCAN_RADAR_fec3f34d_Tx: ComSignalType=UINT8
            DET_ELEVATION_015_oRDR_DETECTION_013_016_oPCAN_RADAR_6bb327d8_Tx: ComSignalType=UINT8
            DET_ELEVATION_016_oRDR_DETECTION_013_016_oPCAN_RADAR_0f535c26_Tx: ComSignalType=UINT8
            DET_ELEVATION_ERR_013_oRDR_DETECTION_013_016_oPCAN_RADAR_254a4851_Tx: ComSignalType=UINT8
            DET_ELEVATION_ERR_014_oRDR_DETECTION_013_016_oPCAN_RADAR_79fa6b38_Tx: ComSignalType=UINT8
            DET_ELEVATION_ERR_015_oRDR_DETECTION_013_016_oPCAN_RADAR_ec8abfad_Tx: ComSignalType=UINT8
            DET_ELEVATION_ERR_016_oRDR_DETECTION_013_016_oPCAN_RADAR_886ac453_Tx: ComSignalType=UINT8
            DET_EXISTENCE_PROB_013_oRDR_DETECTION_013_016_oPCAN_RADAR_f7d53d31_Tx: ComSignalType=UINT8
            DET_EXISTENCE_PROB_014_oRDR_DETECTION_013_016_oPCAN_RADAR_ab651e58_Tx: ComSignalType=UINT8
            DET_EXISTENCE_PROB_015_oRDR_DETECTION_013_016_oPCAN_RADAR_3e15cacd_Tx: ComSignalType=UINT8
            DET_EXISTENCE_PROB_016_oRDR_DETECTION_013_016_oPCAN_RADAR_5af5b133_Tx: ComSignalType=UINT8
            DET_HVC_FLAG_013_oRDR_DETECTION_013_016_oPCAN_RADAR_16a17e4e_Tx: ComSignalType=BOOLEAN
            DET_HVC_FLAG_014_oRDR_DETECTION_013_016_oPCAN_RADAR_4a115d27_Tx: ComSignalType=BOOLEAN
            DET_HVC_FLAG_015_oRDR_DETECTION_013_016_oPCAN_RADAR_df6189b2_Tx: ComSignalType=BOOLEAN
            DET_HVC_FLAG_016_oRDR_DETECTION_013_016_oPCAN_RADAR_bb81f24c_Tx: ComSignalType=BOOLEAN
            DET_IDM_013_oRDR_DETECTION_013_016_oPCAN_RADAR_9df345f3_Tx: ComSignalType=UINT8
            DET_IDM_014_oRDR_DETECTION_013_016_oPCAN_RADAR_c143669a_Tx: ComSignalType=UINT8
            DET_IDM_015_oRDR_DETECTION_013_016_oPCAN_RADAR_5433b20f_Tx: ComSignalType=UINT8
            DET_IDM_016_oRDR_DETECTION_013_016_oPCAN_RADAR_30d3c9f1_Tx: ComSignalType=UINT8
            DET_MH_CRC16_013_016_oRDR_DETECTION_013_016_oPCAN_RADAR_81723faf_Tx: ComSignalType=UINT16
            DET_MH_CYCLE_COUNTER_013_016_oRDR_DETECTION_013_016_oPCAN_RADAR_05079e98_Tx: ComSignalType=UINT8
            DET_MH_SCAN_INDEX_4LSB_013_016_oRDR_DETECTION_013_016_oPCAN_RADAR_c92dbb14_Tx: ComSignalType=UINT8
            DET_MTD_013_oRDR_DETECTION_013_016_oPCAN_RADAR_fb407728_Tx: ComSignalType=UINT8
            DET_MTD_014_oRDR_DETECTION_013_016_oPCAN_RADAR_a7f05441_Tx: ComSignalType=UINT8
            DET_MTD_015_oRDR_DETECTION_013_016_oPCAN_RADAR_328080d4_Tx: ComSignalType=UINT8
            DET_MTD_016_oRDR_DETECTION_013_016_oPCAN_RADAR_5660fb2a_Tx: ComSignalType=UINT8
            DET_PROB_1STAZHYPO_013_oRDR_DETECTION_013_016_oPCAN_RADAR_68f49fe5_Tx: ComSignalType=BOOLEAN
            DET_PROB_1STAZHYPO_014_oRDR_DETECTION_013_016_oPCAN_RADAR_3444bc8c_Tx: ComSignalType=BOOLEAN
            DET_PROB_1STAZHYPO_015_oRDR_DETECTION_013_016_oPCAN_RADAR_a1346819_Tx: ComSignalType=BOOLEAN
            DET_PROB_1STAZHYPO_016_oRDR_DETECTION_013_016_oPCAN_RADAR_c5d413e7_Tx: ComSignalType=BOOLEAN
            DET_RANGE_013_oRDR_DETECTION_013_016_oPCAN_RADAR_635b7c93_Tx: ComSignalType=UINT16
            DET_RANGE_014_oRDR_DETECTION_013_016_oPCAN_RADAR_3feb5ffa_Tx: ComSignalType=UINT16
            DET_RANGE_015_oRDR_DETECTION_013_016_oPCAN_RADAR_aa9b8b6f_Tx: ComSignalType=UINT16
            DET_RANGE_016_oRDR_DETECTION_013_016_oPCAN_RADAR_ce7bf091_Tx: ComSignalType=UINT16
            DET_RANGE_ERR_013_oRDR_DETECTION_013_016_oPCAN_RADAR_c4b3c6fa_Tx: ComSignalType=UINT8
            DET_RANGE_ERR_014_oRDR_DETECTION_013_016_oPCAN_RADAR_9803e593_Tx: ComSignalType=UINT8
            DET_RANGE_ERR_015_oRDR_DETECTION_013_016_oPCAN_RADAR_0d733106_Tx: ComSignalType=UINT8
            DET_RANGE_ERR_016_oRDR_DETECTION_013_016_oPCAN_RADAR_69934af8_Tx: ComSignalType=UINT8
            DET_RANGE_VELOCITY_013_oRDR_DETECTION_013_016_oPCAN_RADAR_16fdbeb6_Tx: ComSignalType=UINT16
            DET_RANGE_VELOCITY_014_oRDR_DETECTION_013_016_oPCAN_RADAR_4a4d9ddf_Tx: ComSignalType=UINT16
            DET_RANGE_VELOCITY_015_oRDR_DETECTION_013_016_oPCAN_RADAR_df3d494a_Tx: ComSignalType=UINT16
            DET_RANGE_VELOCITY_016_oRDR_DETECTION_013_016_oPCAN_RADAR_bbdd32b4_Tx: ComSignalType=UINT16
            DET_RANGE_VELOCITY_ERR_013_oRDR_DETECTION_013_016_oPCAN_RADAR_19464504_Tx: ComSignalType=UINT8
            DET_RANGE_VELOCITY_ERR_014_oRDR_DETECTION_013_016_oPCAN_RADAR_45f6666d_Tx: ComSignalType=UINT8
            DET_RANGE_VELOCITY_ERR_015_oRDR_DETECTION_013_016_oPCAN_RADAR_d086b2f8_Tx: ComSignalType=UINT8
            DET_RANGE_VELOCITY_ERR_016_oRDR_DETECTION_013_016_oPCAN_RADAR_b466c906_Tx: ComSignalType=UINT8
            DET_RCS_013_oRDR_DETECTION_013_016_oPCAN_RADAR_917d89ec_Tx: ComSignalType=UINT8
            DET_RCS_014_oRDR_DETECTION_013_016_oPCAN_RADAR_cdcdaa85_Tx: ComSignalType=UINT8
            DET_RCS_015_oRDR_DETECTION_013_016_oPCAN_RADAR_58bd7e10_Tx: ComSignalType=UINT8
            DET_RCS_016_oRDR_DETECTION_013_016_oPCAN_RADAR_3c5d05ee_Tx: ComSignalType=UINT8
            DET_SNR_013_oRDR_DETECTION_013_016_oPCAN_RADAR_4cd3ddee_Tx: ComSignalType=UINT8
            DET_SNR_014_oRDR_DETECTION_013_016_oPCAN_RADAR_1063fe87_Tx: ComSignalType=UINT8
            DET_SNR_015_oRDR_DETECTION_013_016_oPCAN_RADAR_85132a12_Tx: ComSignalType=UINT8
            DET_SNR_016_oRDR_DETECTION_013_016_oPCAN_RADAR_e1f351ec_Tx: ComSignalType=UINT8
            DET_SUPER_RES_TARGET_013_oRDR_DETECTION_013_016_oPCAN_RADAR_7d4af58b_Tx: ComSignalType=BOOLEAN
            DET_SUPER_RES_TARGET_014_oRDR_DETECTION_013_016_oPCAN_RADAR_21fad6e2_Tx: ComSignalType=BOOLEAN
            DET_SUPER_RES_TARGET_015_oRDR_DETECTION_013_016_oPCAN_RADAR_b48a0277_Tx: ComSignalType=BOOLEAN
            DET_SUPER_RES_TARGET_016_oRDR_DETECTION_013_016_oPCAN_RADAR_d06a7989_Tx: ComSignalType=BOOLEAN
        SG_Detections_017_020_oRDR_DETECTION_017_020_oPCAN_RADAR_e956bb2e_Tx
          83 x ComGroupSignal:
            DET_AZIMUTH_017_oRDR_DETECTION_017_020_oPCAN_RADAR_e41c8a76_Tx: ComSignalType=UINT16
            DET_AZIMUTH_018_oRDR_DETECTION_017_020_oPCAN_RADAR_c80c1831_Tx: ComSignalType=UINT16
            DET_AZIMUTH_019_oRDR_DETECTION_017_020_oPCAN_RADAR_5d7ccca4_Tx: ComSignalType=UINT16
            DET_AZIMUTH_020_oRDR_DETECTION_017_020_oPCAN_RADAR_e2cd967f_Tx: ComSignalType=UINT16
            DET_AZIMUTH_ERR_017_oRDR_DETECTION_017_020_oPCAN_RADAR_40a91f83_Tx: ComSignalType=UINT8
            DET_AZIMUTH_ERR_018_oRDR_DETECTION_017_020_oPCAN_RADAR_6cb98dc4_Tx: ComSignalType=UINT8
            DET_AZIMUTH_ERR_019_oRDR_DETECTION_017_020_oPCAN_RADAR_f9c95951_Tx: ComSignalType=UINT8
            DET_AZIMUTH_ERR_020_oRDR_DETECTION_017_020_oPCAN_RADAR_4678038a_Tx: ComSignalType=UINT8
            DET_BELOW_RAIN_THOLD_017_oRDR_DETECTION_017_020_oPCAN_RADAR_311d19b6_Tx: ComSignalType=UINT8
            DET_BELOW_RAIN_THOLD_018_oRDR_DETECTION_017_020_oPCAN_RADAR_1d0d8bf1_Tx: ComSignalType=UINT8
            DET_BELOW_RAIN_THOLD_019_oRDR_DETECTION_017_020_oPCAN_RADAR_887d5f64_Tx: ComSignalType=UINT8
            DET_BELOW_RAIN_THOLD_020_oRDR_DETECTION_017_020_oPCAN_RADAR_37cc05bf_Tx: ComSignalType=UINT8
            DET_BI_STATIC_FLAG_017_oRDR_DETECTION_017_020_oPCAN_RADAR_b230caf3_Tx: ComSignalType=BOOLEAN
            DET_BI_STATIC_FLAG_018_oRDR_DETECTION_017_020_oPCAN_RADAR_9e2058b4_Tx: ComSignalType=BOOLEAN
            DET_BI_STATIC_FLAG_019_oRDR_DETECTION_017_020_oPCAN_RADAR_0b508c21_Tx: ComSignalType=BOOLEAN
            DET_BI_STATIC_FLAG_020_oRDR_DETECTION_017_020_oPCAN_RADAR_b4e1d6fa_Tx: ComSignalType=BOOLEAN
            DET_CONFD_AZIMUTH_017_oRDR_DETECTION_017_020_oPCAN_RADAR_e6fa80bc_Tx: ComSignalType=UINT8
            DET_CONFD_AZIMUTH_018_oRDR_DETECTION_017_020_oPCAN_RADAR_caea12fb_Tx: ComSignalType=UINT8
            DET_CONFD_AZIMUTH_019_oRDR_DETECTION_017_020_oPCAN_RADAR_5f9ac66e_Tx: ComSignalType=UINT8
            DET_CONFD_AZIMUTH_020_oRDR_DETECTION_017_020_oPCAN_RADAR_e02b9cb5_Tx: ComSignalType=UINT8
            DET_CONFD_ELEVATION_017_oRDR_DETECTION_017_020_oPCAN_RADAR_e46f8146_Tx: ComSignalType=UINT8
            DET_CONFD_ELEVATION_018_oRDR_DETECTION_017_020_oPCAN_RADAR_c87f1301_Tx: ComSignalType=UINT8
            DET_CONFD_ELEVATION_019_oRDR_DETECTION_017_020_oPCAN_RADAR_5d0fc794_Tx: ComSignalType=UINT8
            DET_CONFD_ELEVATION_020_oRDR_DETECTION_017_020_oPCAN_RADAR_e2be9d4f_Tx: ComSignalType=UINT8
            DET_ELEVATION_017_oRDR_DETECTION_017_020_oPCAN_RADAR_35af557a_Tx: ComSignalType=UINT8
            DET_ELEVATION_018_oRDR_DETECTION_017_020_oPCAN_RADAR_19bfc73d_Tx: ComSignalType=UINT8
            DET_ELEVATION_019_oRDR_DETECTION_017_020_oPCAN_RADAR_8ccf13a8_Tx: ComSignalType=UINT8
            DET_ELEVATION_020_oRDR_DETECTION_017_020_oPCAN_RADAR_337e4973_Tx: ComSignalType=UINT8
            DET_ELEVATION_ERR_017_oRDR_DETECTION_017_020_oPCAN_RADAR_b296cd0f_Tx: ComSignalType=UINT8
            DET_ELEVATION_ERR_018_oRDR_DETECTION_017_020_oPCAN_RADAR_9e865f48_Tx: ComSignalType=UINT8
            DET_ELEVATION_ERR_019_oRDR_DETECTION_017_020_oPCAN_RADAR_0bf68bdd_Tx: ComSignalType=UINT8
            DET_ELEVATION_ERR_020_oRDR_DETECTION_017_020_oPCAN_RADAR_b447d106_Tx: ComSignalType=UINT8
            DET_EXISTENCE_PROB_017_oRDR_DETECTION_017_020_oPCAN_RADAR_6009b86f_Tx: ComSignalType=UINT8
            DET_EXISTENCE_PROB_018_oRDR_DETECTION_017_020_oPCAN_RADAR_4c192a28_Tx: ComSignalType=UINT8
            DET_EXISTENCE_PROB_019_oRDR_DETECTION_017_020_oPCAN_RADAR_d969febd_Tx: ComSignalType=UINT8
            DET_EXISTENCE_PROB_020_oRDR_DETECTION_017_020_oPCAN_RADAR_66d8a466_Tx: ComSignalType=UINT8
            DET_HVC_FLAG_017_oRDR_DETECTION_017_020_oPCAN_RADAR_817dfb10_Tx: ComSignalType=BOOLEAN
            DET_HVC_FLAG_018_oRDR_DETECTION_017_020_oPCAN_RADAR_ad6d6957_Tx: ComSignalType=BOOLEAN
            DET_HVC_FLAG_019_oRDR_DETECTION_017_020_oPCAN_RADAR_381dbdc2_Tx: ComSignalType=BOOLEAN
            DET_HVC_FLAG_020_oRDR_DETECTION_017_020_oPCAN_RADAR_87ace719_Tx: ComSignalType=BOOLEAN
            DET_IDM_017_oRDR_DETECTION_017_020_oPCAN_RADAR_0a2fc0ad_Tx: ComSignalType=UINT8
            DET_IDM_018_oRDR_DETECTION_017_020_oPCAN_RADAR_263f52ea_Tx: ComSignalType=UINT8
            DET_IDM_019_oRDR_DETECTION_017_020_oPCAN_RADAR_b34f867f_Tx: ComSignalType=UINT8
            DET_IDM_020_oRDR_DETECTION_017_020_oPCAN_RADAR_0cfedca4_Tx: ComSignalType=UINT8
            DET_MH_CRC16_017_020_oRDR_DETECTION_017_020_oPCAN_RADAR_6dde6925_Tx: ComSignalType=UINT16
            DET_MH_CYCLE_COUNTER_017_020_oRDR_DETECTION_017_020_oPCAN_RADAR_e9abc812_Tx: ComSignalType=UINT8
            DET_MH_SCAN_INDEX_4LSB_017_020_oRDR_DETECTION_017_020_oPCAN_RADAR_2581ed9e_Tx: ComSignalType=UINT8
            DET_MTD_017_oRDR_DETECTION_017_020_oPCAN_RADAR_6c9cf276_Tx: ComSignalType=UINT8
            DET_MTD_018_oRDR_DETECTION_017_020_oPCAN_RADAR_408c6031_Tx: ComSignalType=UINT8
            DET_MTD_019_oRDR_DETECTION_017_020_oPCAN_RADAR_d5fcb4a4_Tx: ComSignalType=UINT8
            DET_MTD_020_oRDR_DETECTION_017_020_oPCAN_RADAR_6a4dee7f_Tx: ComSignalType=UINT8
            DET_PROB_1STAZHYPO_017_oRDR_DETECTION_017_020_oPCAN_RADAR_ff281abb_Tx: ComSignalType=BOOLEAN
            DET_PROB_1STAZHYPO_018_oRDR_DETECTION_017_020_oPCAN_RADAR_d33888fc_Tx: ComSignalType=BOOLEAN
            DET_PROB_1STAZHYPO_019_oRDR_DETECTION_017_020_oPCAN_RADAR_46485c69_Tx: ComSignalType=BOOLEAN
            DET_PROB_1STAZHYPO_020_oRDR_DETECTION_017_020_oPCAN_RADAR_f9f906b2_Tx: ComSignalType=BOOLEAN
            DET_RANGE_017_oRDR_DETECTION_017_020_oPCAN_RADAR_f487f9cd_Tx: ComSignalType=UINT16
            DET_RANGE_018_oRDR_DETECTION_017_020_oPCAN_RADAR_d8976b8a_Tx: ComSignalType=UINT16
            DET_RANGE_019_oRDR_DETECTION_017_020_oPCAN_RADAR_4de7bf1f_Tx: ComSignalType=UINT16
            DET_RANGE_020_oRDR_DETECTION_017_020_oPCAN_RADAR_f256e5c4_Tx: ComSignalType=UINT16
            DET_RANGE_ERR_017_oRDR_DETECTION_017_020_oPCAN_RADAR_536f43a4_Tx: ComSignalType=UINT8
            DET_RANGE_ERR_018_oRDR_DETECTION_017_020_oPCAN_RADAR_7f7fd1e3_Tx: ComSignalType=UINT8
            DET_RANGE_ERR_019_oRDR_DETECTION_017_020_oPCAN_RADAR_ea0f0576_Tx: ComSignalType=UINT8
            DET_RANGE_ERR_020_oRDR_DETECTION_017_020_oPCAN_RADAR_55be5fad_Tx: ComSignalType=UINT8
            DET_RANGE_VELOCITY_017_oRDR_DETECTION_017_020_oPCAN_RADAR_81213be8_Tx: ComSignalType=UINT16
            DET_RANGE_VELOCITY_018_oRDR_DETECTION_017_020_oPCAN_RADAR_ad31a9af_Tx: ComSignalType=UINT16
            DET_RANGE_VELOCITY_019_oRDR_DETECTION_017_020_oPCAN_RADAR_38417d3a_Tx: ComSignalType=UINT16
            DET_RANGE_VELOCITY_020_oRDR_DETECTION_017_020_oPCAN_RADAR_87f027e1_Tx: ComSignalType=UINT16
            DET_RANGE_VELOCITY_ERR_017_oRDR_DETECTION_017_020_oPCAN_RADAR_8e9ac05a_Tx: ComSignalType=UINT8
            DET_RANGE_VELOCITY_ERR_018_oRDR_DETECTION_017_020_oPCAN_RADAR_a28a521d_Tx: ComSignalType=UINT8
            DET_RANGE_VELOCITY_ERR_019_oRDR_DETECTION_017_020_oPCAN_RADAR_37fa8688_Tx: ComSignalType=UINT8
            DET_RANGE_VELOCITY_ERR_020_oRDR_DETECTION_017_020_oPCAN_RADAR_884bdc53_Tx: ComSignalType=UINT8
            DET_RCS_017_oRDR_DETECTION_017_020_oPCAN_RADAR_06a10cb2_Tx: ComSignalType=UINT8
            DET_RCS_018_oRDR_DETECTION_017_020_oPCAN_RADAR_2ab19ef5_Tx: ComSignalType=UINT8
            DET_RCS_019_oRDR_DETECTION_017_020_oPCAN_RADAR_bfc14a60_Tx: ComSignalType=UINT8
            DET_RCS_020_oRDR_DETECTION_017_020_oPCAN_RADAR_007010bb_Tx: ComSignalType=UINT8
            DET_SNR_017_oRDR_DETECTION_017_020_oPCAN_RADAR_db0f58b0_Tx: ComSignalType=UINT8
            DET_SNR_018_oRDR_DETECTION_017_020_oPCAN_RADAR_f71fcaf7_Tx: ComSignalType=UINT8
            DET_SNR_019_oRDR_DETECTION_017_020_oPCAN_RADAR_626f1e62_Tx: ComSignalType=UINT8
            DET_SNR_020_oRDR_DETECTION_017_020_oPCAN_RADAR_ddde44b9_Tx: ComSignalType=UINT8
            DET_SUPER_RES_TARGET_017_oRDR_DETECTION_017_020_oPCAN_RADAR_ea9670d5_Tx: ComSignalType=BOOLEAN
            DET_SUPER_RES_TARGET_018_oRDR_DETECTION_017_020_oPCAN_RADAR_c686e292_Tx: ComSignalType=BOOLEAN
            DET_SUPER_RES_TARGET_019_oRDR_DETECTION_017_020_oPCAN_RADAR_53f63607_Tx: ComSignalType=BOOLEAN
            DET_SUPER_RES_TARGET_020_oRDR_DETECTION_017_020_oPCAN_RADAR_ec476cdc_Tx: ComSignalType=BOOLEAN
        SG_Detections_021_024_oRDR_DETECTION_021_024_oPCAN_RADAR_ea3d35f7_Tx
          83 x ComGroupSignal:
            DET_AZIMUTH_021_oRDR_DETECTION_021_024_oPCAN_RADAR_fab64216_Tx: ComSignalType=UINT16
            DET_AZIMUTH_022_oRDR_DETECTION_021_024_oPCAN_RADAR_9e5639e8_Tx: ComSignalType=UINT16
            DET_AZIMUTH_023_oRDR_DETECTION_021_024_oPCAN_RADAR_0b26ed7d_Tx: ComSignalType=UINT16
            DET_AZIMUTH_024_oRDR_DETECTION_021_024_oPCAN_RADAR_5796ce14_Tx: ComSignalType=UINT16
            DET_AZIMUTH_ERR_021_oRDR_DETECTION_021_024_oPCAN_RADAR_5e03d7e3_Tx: ComSignalType=UINT8
            DET_AZIMUTH_ERR_022_oRDR_DETECTION_021_024_oPCAN_RADAR_3ae3ac1d_Tx: ComSignalType=UINT8
            DET_AZIMUTH_ERR_023_oRDR_DETECTION_021_024_oPCAN_RADAR_af937888_Tx: ComSignalType=UINT8
            DET_AZIMUTH_ERR_024_oRDR_DETECTION_021_024_oPCAN_RADAR_f3235be1_Tx: ComSignalType=UINT8
            DET_BELOW_RAIN_THOLD_021_oRDR_DETECTION_021_024_oPCAN_RADAR_2fb7d1d6_Tx: ComSignalType=UINT8
            DET_BELOW_RAIN_THOLD_022_oRDR_DETECTION_021_024_oPCAN_RADAR_4b57aa28_Tx: ComSignalType=UINT8
            DET_BELOW_RAIN_THOLD_023_oRDR_DETECTION_021_024_oPCAN_RADAR_de277ebd_Tx: ComSignalType=UINT8
            DET_BELOW_RAIN_THOLD_024_oRDR_DETECTION_021_024_oPCAN_RADAR_82975dd4_Tx: ComSignalType=UINT8
            DET_BI_STATIC_FLAG_021_oRDR_DETECTION_021_024_oPCAN_RADAR_ac9a0293_Tx: ComSignalType=BOOLEAN
            DET_BI_STATIC_FLAG_022_oRDR_DETECTION_021_024_oPCAN_RADAR_c87a796d_Tx: ComSignalType=BOOLEAN
            DET_BI_STATIC_FLAG_023_oRDR_DETECTION_021_024_oPCAN_RADAR_5d0aadf8_Tx: ComSignalType=BOOLEAN
            DET_BI_STATIC_FLAG_024_oRDR_DETECTION_021_024_oPCAN_RADAR_01ba8e91_Tx: ComSignalType=BOOLEAN
            DET_CONFD_AZIMUTH_021_oRDR_DETECTION_021_024_oPCAN_RADAR_f85048dc_Tx: ComSignalType=UINT8
            DET_CONFD_AZIMUTH_022_oRDR_DETECTION_021_024_oPCAN_RADAR_9cb03322_Tx: ComSignalType=UINT8
            DET_CONFD_AZIMUTH_023_oRDR_DETECTION_021_024_oPCAN_RADAR_09c0e7b7_Tx: ComSignalType=UINT8
            DET_CONFD_AZIMUTH_024_oRDR_DETECTION_021_024_oPCAN_RADAR_5570c4de_Tx: ComSignalType=UINT8
            DET_CONFD_ELEVATION_021_oRDR_DETECTION_021_024_oPCAN_RADAR_fac54926_Tx: ComSignalType=UINT8
            DET_CONFD_ELEVATION_022_oRDR_DETECTION_021_024_oPCAN_RADAR_9e2532d8_Tx: ComSignalType=UINT8
            DET_CONFD_ELEVATION_023_oRDR_DETECTION_021_024_oPCAN_RADAR_0b55e64d_Tx: ComSignalType=UINT8
            DET_CONFD_ELEVATION_024_oRDR_DETECTION_021_024_oPCAN_RADAR_57e5c524_Tx: ComSignalType=UINT8
            DET_ELEVATION_021_oRDR_DETECTION_021_024_oPCAN_RADAR_2b059d1a_Tx: ComSignalType=UINT8
            DET_ELEVATION_022_oRDR_DETECTION_021_024_oPCAN_RADAR_4fe5e6e4_Tx: ComSignalType=UINT8
            DET_ELEVATION_023_oRDR_DETECTION_021_024_oPCAN_RADAR_da953271_Tx: ComSignalType=UINT8
            DET_ELEVATION_024_oRDR_DETECTION_021_024_oPCAN_RADAR_86251118_Tx: ComSignalType=UINT8
            DET_ELEVATION_ERR_021_oRDR_DETECTION_021_024_oPCAN_RADAR_ac3c056f_Tx: ComSignalType=UINT8
            DET_ELEVATION_ERR_022_oRDR_DETECTION_021_024_oPCAN_RADAR_c8dc7e91_Tx: ComSignalType=UINT8
            DET_ELEVATION_ERR_023_oRDR_DETECTION_021_024_oPCAN_RADAR_5dacaa04_Tx: ComSignalType=UINT8
            DET_ELEVATION_ERR_024_oRDR_DETECTION_021_024_oPCAN_RADAR_011c896d_Tx: ComSignalType=UINT8
            DET_EXISTENCE_PROB_021_oRDR_DETECTION_021_024_oPCAN_RADAR_7ea3700f_Tx: ComSignalType=UINT8
            DET_EXISTENCE_PROB_022_oRDR_DETECTION_021_024_oPCAN_RADAR_1a430bf1_Tx: ComSignalType=UINT8
            DET_EXISTENCE_PROB_023_oRDR_DETECTION_021_024_oPCAN_RADAR_8f33df64_Tx: ComSignalType=UINT8
            DET_EXISTENCE_PROB_024_oRDR_DETECTION_021_024_oPCAN_RADAR_d383fc0d_Tx: ComSignalType=UINT8
            DET_HVC_FLAG_021_oRDR_DETECTION_021_024_oPCAN_RADAR_9fd73370_Tx: ComSignalType=BOOLEAN
            DET_HVC_FLAG_022_oRDR_DETECTION_021_024_oPCAN_RADAR_fb37488e_Tx: ComSignalType=BOOLEAN
            DET_HVC_FLAG_023_oRDR_DETECTION_021_024_oPCAN_RADAR_6e479c1b_Tx: ComSignalType=BOOLEAN
            DET_HVC_FLAG_024_oRDR_DETECTION_021_024_oPCAN_RADAR_32f7bf72_Tx: ComSignalType=BOOLEAN
            DET_IDM_021_oRDR_DETECTION_021_024_oPCAN_RADAR_148508cd_Tx: ComSignalType=UINT8
            DET_IDM_022_oRDR_DETECTION_021_024_oPCAN_RADAR_70657333_Tx: ComSignalType=UINT8
            DET_IDM_023_oRDR_DETECTION_021_024_oPCAN_RADAR_e515a7a6_Tx: ComSignalType=UINT8
            DET_IDM_024_oRDR_DETECTION_021_024_oPCAN_RADAR_b9a584cf_Tx: ComSignalType=UINT8
            DET_MH_CRC16_021_024_oRDR_DETECTION_021_024_oPCAN_RADAR_6eb5e7fc_Tx: ComSignalType=UINT16
            DET_MH_CYCLE_COUNTER_021_024_oRDR_DETECTION_021_024_oPCAN_RADAR_eac046cb_Tx: ComSignalType=UINT8
            DET_MH_SCAN_INDEX_4LSB_021_024_oRDR_DETECTION_021_024_oPCAN_RADAR_26ea6347_Tx: ComSignalType=UINT8
            DET_MTD_021_oRDR_DETECTION_021_024_oPCAN_RADAR_72363a16_Tx: ComSignalType=UINT8
            DET_MTD_022_oRDR_DETECTION_021_024_oPCAN_RADAR_16d641e8_Tx: ComSignalType=UINT8
            DET_MTD_023_oRDR_DETECTION_021_024_oPCAN_RADAR_83a6957d_Tx: ComSignalType=UINT8
            DET_MTD_024_oRDR_DETECTION_021_024_oPCAN_RADAR_df16b614_Tx: ComSignalType=UINT8
            DET_PROB_1STAZHYPO_021_oRDR_DETECTION_021_024_oPCAN_RADAR_e182d2db_Tx: ComSignalType=BOOLEAN
            DET_PROB_1STAZHYPO_022_oRDR_DETECTION_021_024_oPCAN_RADAR_8562a925_Tx: ComSignalType=BOOLEAN
            DET_PROB_1STAZHYPO_023_oRDR_DETECTION_021_024_oPCAN_RADAR_10127db0_Tx: ComSignalType=BOOLEAN
            DET_PROB_1STAZHYPO_024_oRDR_DETECTION_021_024_oPCAN_RADAR_4ca25ed9_Tx: ComSignalType=BOOLEAN
            DET_RANGE_021_oRDR_DETECTION_021_024_oPCAN_RADAR_ea2d31ad_Tx: ComSignalType=UINT16
            DET_RANGE_022_oRDR_DETECTION_021_024_oPCAN_RADAR_8ecd4a53_Tx: ComSignalType=UINT16
            DET_RANGE_023_oRDR_DETECTION_021_024_oPCAN_RADAR_1bbd9ec6_Tx: ComSignalType=UINT16
            DET_RANGE_024_oRDR_DETECTION_021_024_oPCAN_RADAR_470dbdaf_Tx: ComSignalType=UINT16
            DET_RANGE_ERR_021_oRDR_DETECTION_021_024_oPCAN_RADAR_4dc58bc4_Tx: ComSignalType=UINT8
            DET_RANGE_ERR_022_oRDR_DETECTION_021_024_oPCAN_RADAR_2925f03a_Tx: ComSignalType=UINT8
            DET_RANGE_ERR_023_oRDR_DETECTION_021_024_oPCAN_RADAR_bc5524af_Tx: ComSignalType=UINT8
            DET_RANGE_ERR_024_oRDR_DETECTION_021_024_oPCAN_RADAR_e0e507c6_Tx: ComSignalType=UINT8
            DET_RANGE_VELOCITY_021_oRDR_DETECTION_021_024_oPCAN_RADAR_9f8bf388_Tx: ComSignalType=UINT16
            DET_RANGE_VELOCITY_022_oRDR_DETECTION_021_024_oPCAN_RADAR_fb6b8876_Tx: ComSignalType=UINT16
            DET_RANGE_VELOCITY_023_oRDR_DETECTION_021_024_oPCAN_RADAR_6e1b5ce3_Tx: ComSignalType=UINT16
            DET_RANGE_VELOCITY_024_oRDR_DETECTION_021_024_oPCAN_RADAR_32ab7f8a_Tx: ComSignalType=UINT16
            DET_RANGE_VELOCITY_ERR_021_oRDR_DETECTION_021_024_oPCAN_RADAR_9030083a_Tx: ComSignalType=UINT8
            DET_RANGE_VELOCITY_ERR_022_oRDR_DETECTION_021_024_oPCAN_RADAR_f4d073c4_Tx: ComSignalType=UINT8
            DET_RANGE_VELOCITY_ERR_023_oRDR_DETECTION_021_024_oPCAN_RADAR_61a0a751_Tx: ComSignalType=UINT8
            DET_RANGE_VELOCITY_ERR_024_oRDR_DETECTION_021_024_oPCAN_RADAR_3d108438_Tx: ComSignalType=UINT8
            DET_RCS_021_oRDR_DETECTION_021_024_oPCAN_RADAR_180bc4d2_Tx: ComSignalType=UINT8
            DET_RCS_022_oRDR_DETECTION_021_024_oPCAN_RADAR_7cebbf2c_Tx: ComSignalType=UINT8
            DET_RCS_023_oRDR_DETECTION_021_024_oPCAN_RADAR_e99b6bb9_Tx: ComSignalType=UINT8
            DET_RCS_024_oRDR_DETECTION_021_024_oPCAN_RADAR_b52b48d0_Tx: ComSignalType=UINT8
            DET_SNR_021_oRDR_DETECTION_021_024_oPCAN_RADAR_c5a590d0_Tx: ComSignalType=UINT8
            DET_SNR_022_oRDR_DETECTION_021_024_oPCAN_RADAR_a145eb2e_Tx: ComSignalType=UINT8
            DET_SNR_023_oRDR_DETECTION_021_024_oPCAN_RADAR_34353fbb_Tx: ComSignalType=UINT8
            DET_SNR_024_oRDR_DETECTION_021_024_oPCAN_RADAR_68851cd2_Tx: ComSignalType=UINT8
            DET_SUPER_RES_TARGET_021_oRDR_DETECTION_021_024_oPCAN_RADAR_f43cb8b5_Tx: ComSignalType=BOOLEAN
            DET_SUPER_RES_TARGET_022_oRDR_DETECTION_021_024_oPCAN_RADAR_90dcc34b_Tx: ComSignalType=BOOLEAN
            DET_SUPER_RES_TARGET_023_oRDR_DETECTION_021_024_oPCAN_RADAR_05ac17de_Tx: ComSignalType=BOOLEAN
            DET_SUPER_RES_TARGET_024_oRDR_DETECTION_021_024_oPCAN_RADAR_591c34b7_Tx: ComSignalType=BOOLEAN
        SG_Detections_025_028_oRDR_DETECTION_025_028_oPCAN_RADAR_9bfe01a5_Tx
          83 x ComGroupSignal:
            DET_AZIMUTH_025_oRDR_DETECTION_025_028_oPCAN_RADAR_2b5484b5_Tx: ComSignalType=UINT16
            DET_AZIMUTH_026_oRDR_DETECTION_025_028_oPCAN_RADAR_4fb4ff4b_Tx: ComSignalType=UINT16
            DET_AZIMUTH_027_oRDR_DETECTION_025_028_oPCAN_RADAR_dac42bde_Tx: ComSignalType=UINT16
            DET_AZIMUTH_028_oRDR_DETECTION_025_028_oPCAN_RADAR_f6d4b999_Tx: ComSignalType=UINT16
            DET_AZIMUTH_ERR_025_oRDR_DETECTION_025_028_oPCAN_RADAR_8fe11140_Tx: ComSignalType=UINT8
            DET_AZIMUTH_ERR_026_oRDR_DETECTION_025_028_oPCAN_RADAR_eb016abe_Tx: ComSignalType=UINT8
            DET_AZIMUTH_ERR_027_oRDR_DETECTION_025_028_oPCAN_RADAR_7e71be2b_Tx: ComSignalType=UINT8
            DET_AZIMUTH_ERR_028_oRDR_DETECTION_025_028_oPCAN_RADAR_52612c6c_Tx: ComSignalType=UINT8
            DET_BELOW_RAIN_THOLD_025_oRDR_DETECTION_025_028_oPCAN_RADAR_fe551775_Tx: ComSignalType=UINT8
            DET_BELOW_RAIN_THOLD_026_oRDR_DETECTION_025_028_oPCAN_RADAR_9ab56c8b_Tx: ComSignalType=UINT8
            DET_BELOW_RAIN_THOLD_027_oRDR_DETECTION_025_028_oPCAN_RADAR_0fc5b81e_Tx: ComSignalType=UINT8
            DET_BELOW_RAIN_THOLD_028_oRDR_DETECTION_025_028_oPCAN_RADAR_23d52a59_Tx: ComSignalType=UINT8
            DET_BI_STATIC_FLAG_025_oRDR_DETECTION_025_028_oPCAN_RADAR_7d78c430_Tx: ComSignalType=BOOLEAN
            DET_BI_STATIC_FLAG_026_oRDR_DETECTION_025_028_oPCAN_RADAR_1998bfce_Tx: ComSignalType=BOOLEAN
            DET_BI_STATIC_FLAG_027_oRDR_DETECTION_025_028_oPCAN_RADAR_8ce86b5b_Tx: ComSignalType=BOOLEAN
            DET_BI_STATIC_FLAG_028_oRDR_DETECTION_025_028_oPCAN_RADAR_a0f8f91c_Tx: ComSignalType=BOOLEAN
            DET_CONFD_AZIMUTH_025_oRDR_DETECTION_025_028_oPCAN_RADAR_29b28e7f_Tx: ComSignalType=UINT8
            DET_CONFD_AZIMUTH_026_oRDR_DETECTION_025_028_oPCAN_RADAR_4d52f581_Tx: ComSignalType=UINT8
            DET_CONFD_AZIMUTH_027_oRDR_DETECTION_025_028_oPCAN_RADAR_d8222114_Tx: ComSignalType=UINT8
            DET_CONFD_AZIMUTH_028_oRDR_DETECTION_025_028_oPCAN_RADAR_f432b353_Tx: ComSignalType=UINT8
            DET_CONFD_ELEVATION_025_oRDR_DETECTION_025_028_oPCAN_RADAR_2b278f85_Tx: ComSignalType=UINT8
            DET_CONFD_ELEVATION_026_oRDR_DETECTION_025_028_oPCAN_RADAR_4fc7f47b_Tx: ComSignalType=UINT8
            DET_CONFD_ELEVATION_027_oRDR_DETECTION_025_028_oPCAN_RADAR_dab720ee_Tx: ComSignalType=UINT8
            DET_CONFD_ELEVATION_028_oRDR_DETECTION_025_028_oPCAN_RADAR_f6a7b2a9_Tx: ComSignalType=UINT8
            DET_ELEVATION_025_oRDR_DETECTION_025_028_oPCAN_RADAR_fae75bb9_Tx: ComSignalType=UINT8
            DET_ELEVATION_026_oRDR_DETECTION_025_028_oPCAN_RADAR_9e072047_Tx: ComSignalType=UINT8
            DET_ELEVATION_027_oRDR_DETECTION_025_028_oPCAN_RADAR_0b77f4d2_Tx: ComSignalType=UINT8
            DET_ELEVATION_028_oRDR_DETECTION_025_028_oPCAN_RADAR_27676695_Tx: ComSignalType=UINT8
            DET_ELEVATION_ERR_025_oRDR_DETECTION_025_028_oPCAN_RADAR_7ddec3cc_Tx: ComSignalType=UINT8
            DET_ELEVATION_ERR_026_oRDR_DETECTION_025_028_oPCAN_RADAR_193eb832_Tx: ComSignalType=UINT8
            DET_ELEVATION_ERR_027_oRDR_DETECTION_025_028_oPCAN_RADAR_8c4e6ca7_Tx: ComSignalType=UINT8
            DET_ELEVATION_ERR_028_oRDR_DETECTION_025_028_oPCAN_RADAR_a05efee0_Tx: ComSignalType=UINT8
            DET_EXISTENCE_PROB_025_oRDR_DETECTION_025_028_oPCAN_RADAR_af41b6ac_Tx: ComSignalType=UINT8
            DET_EXISTENCE_PROB_026_oRDR_DETECTION_025_028_oPCAN_RADAR_cba1cd52_Tx: ComSignalType=UINT8
            DET_EXISTENCE_PROB_027_oRDR_DETECTION_025_028_oPCAN_RADAR_5ed119c7_Tx: ComSignalType=UINT8
            DET_EXISTENCE_PROB_028_oRDR_DETECTION_025_028_oPCAN_RADAR_72c18b80_Tx: ComSignalType=UINT8
            DET_HVC_FLAG_025_oRDR_DETECTION_025_028_oPCAN_RADAR_4e35f5d3_Tx: ComSignalType=BOOLEAN
            DET_HVC_FLAG_026_oRDR_DETECTION_025_028_oPCAN_RADAR_2ad58e2d_Tx: ComSignalType=BOOLEAN
            DET_HVC_FLAG_027_oRDR_DETECTION_025_028_oPCAN_RADAR_bfa55ab8_Tx: ComSignalType=BOOLEAN
            DET_HVC_FLAG_028_oRDR_DETECTION_025_028_oPCAN_RADAR_93b5c8ff_Tx: ComSignalType=BOOLEAN
            DET_IDM_025_oRDR_DETECTION_025_028_oPCAN_RADAR_c567ce6e_Tx: ComSignalType=UINT8
            DET_IDM_026_oRDR_DETECTION_025_028_oPCAN_RADAR_a187b590_Tx: ComSignalType=UINT8
            DET_IDM_027_oRDR_DETECTION_025_028_oPCAN_RADAR_34f76105_Tx: ComSignalType=UINT8
            DET_IDM_028_oRDR_DETECTION_025_028_oPCAN_RADAR_18e7f342_Tx: ComSignalType=UINT8
            DET_MH_CRC16_025_028_oRDR_DETECTION_025_028_oPCAN_RADAR_1f76d3ae_Tx: ComSignalType=UINT16
            DET_MH_CYCLE_COUNTER_025_028_oRDR_DETECTION_025_028_oPCAN_RADAR_9b037299_Tx: ComSignalType=UINT8
            DET_MH_SCAN_INDEX_4LSB_025_028_oRDR_DETECTION_025_028_oPCAN_RADAR_57295715_Tx: ComSignalType=UINT8
            DET_MTD_025_oRDR_DETECTION_025_028_oPCAN_RADAR_a3d4fcb5_Tx: ComSignalType=UINT8
            DET_MTD_026_oRDR_DETECTION_025_028_oPCAN_RADAR_c734874b_Tx: ComSignalType=UINT8
            DET_MTD_027_oRDR_DETECTION_025_028_oPCAN_RADAR_524453de_Tx: ComSignalType=UINT8
            DET_MTD_028_oRDR_DETECTION_025_028_oPCAN_RADAR_7e54c199_Tx: ComSignalType=UINT8
            DET_PROB_1STAZHYPO_025_oRDR_DETECTION_025_028_oPCAN_RADAR_30601478_Tx: ComSignalType=BOOLEAN
            DET_PROB_1STAZHYPO_026_oRDR_DETECTION_025_028_oPCAN_RADAR_54806f86_Tx: ComSignalType=BOOLEAN
            DET_PROB_1STAZHYPO_027_oRDR_DETECTION_025_028_oPCAN_RADAR_c1f0bb13_Tx: ComSignalType=BOOLEAN
            DET_PROB_1STAZHYPO_028_oRDR_DETECTION_025_028_oPCAN_RADAR_ede02954_Tx: ComSignalType=BOOLEAN
            DET_RANGE_025_oRDR_DETECTION_025_028_oPCAN_RADAR_3bcff70e_Tx: ComSignalType=UINT16
            DET_RANGE_026_oRDR_DETECTION_025_028_oPCAN_RADAR_5f2f8cf0_Tx: ComSignalType=UINT16
            DET_RANGE_027_oRDR_DETECTION_025_028_oPCAN_RADAR_ca5f5865_Tx: ComSignalType=UINT16
            DET_RANGE_028_oRDR_DETECTION_025_028_oPCAN_RADAR_e64fca22_Tx: ComSignalType=UINT16
            DET_RANGE_ERR_025_oRDR_DETECTION_025_028_oPCAN_RADAR_9c274d67_Tx: ComSignalType=UINT8
            DET_RANGE_ERR_026_oRDR_DETECTION_025_028_oPCAN_RADAR_f8c73699_Tx: ComSignalType=UINT8
            DET_RANGE_ERR_027_oRDR_DETECTION_025_028_oPCAN_RADAR_6db7e20c_Tx: ComSignalType=UINT8
            DET_RANGE_ERR_028_oRDR_DETECTION_025_028_oPCAN_RADAR_41a7704b_Tx: ComSignalType=UINT8
            DET_RANGE_VELOCITY_025_oRDR_DETECTION_025_028_oPCAN_RADAR_4e69352b_Tx: ComSignalType=UINT16
            DET_RANGE_VELOCITY_026_oRDR_DETECTION_025_028_oPCAN_RADAR_2a894ed5_Tx: ComSignalType=UINT16
            DET_RANGE_VELOCITY_027_oRDR_DETECTION_025_028_oPCAN_RADAR_bff99a40_Tx: ComSignalType=UINT16
            DET_RANGE_VELOCITY_028_oRDR_DETECTION_025_028_oPCAN_RADAR_93e90807_Tx: ComSignalType=UINT16
            DET_RANGE_VELOCITY_ERR_025_oRDR_DETECTION_025_028_oPCAN_RADAR_41d2ce99_Tx: ComSignalType=UINT8
            DET_RANGE_VELOCITY_ERR_026_oRDR_DETECTION_025_028_oPCAN_RADAR_2532b567_Tx: ComSignalType=UINT8
            DET_RANGE_VELOCITY_ERR_027_oRDR_DETECTION_025_028_oPCAN_RADAR_b04261f2_Tx: ComSignalType=UINT8
            DET_RANGE_VELOCITY_ERR_028_oRDR_DETECTION_025_028_oPCAN_RADAR_9c52f3b5_Tx: ComSignalType=UINT8
            DET_RCS_025_oRDR_DETECTION_025_028_oPCAN_RADAR_c9e90271_Tx: ComSignalType=UINT8
            DET_RCS_026_oRDR_DETECTION_025_028_oPCAN_RADAR_ad09798f_Tx: ComSignalType=UINT8
            DET_RCS_027_oRDR_DETECTION_025_028_oPCAN_RADAR_3879ad1a_Tx: ComSignalType=UINT8
            DET_RCS_028_oRDR_DETECTION_025_028_oPCAN_RADAR_14693f5d_Tx: ComSignalType=UINT8
            DET_SNR_025_oRDR_DETECTION_025_028_oPCAN_RADAR_14475673_Tx: ComSignalType=UINT8
            DET_SNR_026_oRDR_DETECTION_025_028_oPCAN_RADAR_70a72d8d_Tx: ComSignalType=UINT8
            DET_SNR_027_oRDR_DETECTION_025_028_oPCAN_RADAR_e5d7f918_Tx: ComSignalType=UINT8
            DET_SNR_028_oRDR_DETECTION_025_028_oPCAN_RADAR_c9c76b5f_Tx: ComSignalType=UINT8
            DET_SUPER_RES_TARGET_025_oRDR_DETECTION_025_028_oPCAN_RADAR_25de7e16_Tx: ComSignalType=BOOLEAN
            DET_SUPER_RES_TARGET_026_oRDR_DETECTION_025_028_oPCAN_RADAR_413e05e8_Tx: ComSignalType=BOOLEAN
            DET_SUPER_RES_TARGET_027_oRDR_DETECTION_025_028_oPCAN_RADAR_d44ed17d_Tx: ComSignalType=BOOLEAN
            DET_SUPER_RES_TARGET_028_oRDR_DETECTION_025_028_oPCAN_RADAR_f85e433a_Tx: ComSignalType=BOOLEAN
        SG_Detections_029_032_oRDR_DETECTION_029_032_oPCAN_RADAR_028425de_Tx
          83 x ComGroupSignal:
            DET_AZIMUTH_029_oRDR_DETECTION_029_032_oPCAN_RADAR_51ec820d_Tx: ComSignalType=UINT16
            DET_AZIMUTH_030_oRDR_DETECTION_029_032_oPCAN_RADAR_34ccf0a9_Tx: ComSignalType=UINT16
            DET_AZIMUTH_031_oRDR_DETECTION_029_032_oPCAN_RADAR_a1bc243c_Tx: ComSignalType=UINT16
            DET_AZIMUTH_032_oRDR_DETECTION_029_032_oPCAN_RADAR_c55c5fc2_Tx: ComSignalType=UINT16
            DET_AZIMUTH_ERR_029_oRDR_DETECTION_029_032_oPCAN_RADAR_f55917f8_Tx: ComSignalType=UINT8
            DET_AZIMUTH_ERR_030_oRDR_DETECTION_029_032_oPCAN_RADAR_9079655c_Tx: ComSignalType=UINT8
            DET_AZIMUTH_ERR_031_oRDR_DETECTION_029_032_oPCAN_RADAR_0509b1c9_Tx: ComSignalType=UINT8
            DET_AZIMUTH_ERR_032_oRDR_DETECTION_029_032_oPCAN_RADAR_61e9ca37_Tx: ComSignalType=UINT8
            DET_BELOW_RAIN_THOLD_029_oRDR_DETECTION_029_032_oPCAN_RADAR_84ed11cd_Tx: ComSignalType=UINT8
            DET_BELOW_RAIN_THOLD_030_oRDR_DETECTION_029_032_oPCAN_RADAR_e1cd6369_Tx: ComSignalType=UINT8
            DET_BELOW_RAIN_THOLD_031_oRDR_DETECTION_029_032_oPCAN_RADAR_74bdb7fc_Tx: ComSignalType=UINT8
            DET_BELOW_RAIN_THOLD_032_oRDR_DETECTION_029_032_oPCAN_RADAR_105dcc02_Tx: ComSignalType=UINT8
            DET_BI_STATIC_FLAG_029_oRDR_DETECTION_029_032_oPCAN_RADAR_07c0c288_Tx: ComSignalType=BOOLEAN
            DET_BI_STATIC_FLAG_030_oRDR_DETECTION_029_032_oPCAN_RADAR_62e0b02c_Tx: ComSignalType=BOOLEAN
            DET_BI_STATIC_FLAG_031_oRDR_DETECTION_029_032_oPCAN_RADAR_f79064b9_Tx: ComSignalType=BOOLEAN
            DET_BI_STATIC_FLAG_032_oRDR_DETECTION_029_032_oPCAN_RADAR_93701f47_Tx: ComSignalType=BOOLEAN
            DET_CONFD_AZIMUTH_029_oRDR_DETECTION_029_032_oPCAN_RADAR_530a88c7_Tx: ComSignalType=UINT8
            DET_CONFD_AZIMUTH_030_oRDR_DETECTION_029_032_oPCAN_RADAR_362afa63_Tx: ComSignalType=UINT8
            DET_CONFD_AZIMUTH_031_oRDR_DETECTION_029_032_oPCAN_RADAR_a35a2ef6_Tx: ComSignalType=UINT8
            DET_CONFD_AZIMUTH_032_oRDR_DETECTION_029_032_oPCAN_RADAR_c7ba5508_Tx: ComSignalType=UINT8
            DET_CONFD_ELEVATION_029_oRDR_DETECTION_029_032_oPCAN_RADAR_519f893d_Tx: ComSignalType=UINT8
            DET_CONFD_ELEVATION_030_oRDR_DETECTION_029_032_oPCAN_RADAR_34bffb99_Tx: ComSignalType=UINT8
            DET_CONFD_ELEVATION_031_oRDR_DETECTION_029_032_oPCAN_RADAR_a1cf2f0c_Tx: ComSignalType=UINT8
            DET_CONFD_ELEVATION_032_oRDR_DETECTION_029_032_oPCAN_RADAR_c52f54f2_Tx: ComSignalType=UINT8
            DET_ELEVATION_029_oRDR_DETECTION_029_032_oPCAN_RADAR_805f5d01_Tx: ComSignalType=UINT8
            DET_ELEVATION_030_oRDR_DETECTION_029_032_oPCAN_RADAR_e57f2fa5_Tx: ComSignalType=UINT8
            DET_ELEVATION_031_oRDR_DETECTION_029_032_oPCAN_RADAR_700ffb30_Tx: ComSignalType=UINT8
            DET_ELEVATION_032_oRDR_DETECTION_029_032_oPCAN_RADAR_14ef80ce_Tx: ComSignalType=UINT8
            DET_ELEVATION_ERR_029_oRDR_DETECTION_029_032_oPCAN_RADAR_0766c574_Tx: ComSignalType=UINT8
            DET_ELEVATION_ERR_030_oRDR_DETECTION_029_032_oPCAN_RADAR_6246b7d0_Tx: ComSignalType=UINT8
            DET_ELEVATION_ERR_031_oRDR_DETECTION_029_032_oPCAN_RADAR_f7366345_Tx: ComSignalType=UINT8
            DET_ELEVATION_ERR_032_oRDR_DETECTION_029_032_oPCAN_RADAR_93d618bb_Tx: ComSignalType=UINT8
            DET_EXISTENCE_PROB_029_oRDR_DETECTION_029_032_oPCAN_RADAR_d5f9b014_Tx: ComSignalType=UINT8
            DET_EXISTENCE_PROB_030_oRDR_DETECTION_029_032_oPCAN_RADAR_b0d9c2b0_Tx: ComSignalType=UINT8
            DET_EXISTENCE_PROB_031_oRDR_DETECTION_029_032_oPCAN_RADAR_25a91625_Tx: ComSignalType=UINT8
            DET_EXISTENCE_PROB_032_oRDR_DETECTION_029_032_oPCAN_RADAR_41496ddb_Tx: ComSignalType=UINT8
            DET_HVC_FLAG_029_oRDR_DETECTION_029_032_oPCAN_RADAR_348df36b_Tx: ComSignalType=BOOLEAN
            DET_HVC_FLAG_030_oRDR_DETECTION_029_032_oPCAN_RADAR_51ad81cf_Tx: ComSignalType=BOOLEAN
            DET_HVC_FLAG_031_oRDR_DETECTION_029_032_oPCAN_RADAR_c4dd555a_Tx: ComSignalType=BOOLEAN
            DET_HVC_FLAG_032_oRDR_DETECTION_029_032_oPCAN_RADAR_a03d2ea4_Tx: ComSignalType=BOOLEAN
            DET_IDM_029_oRDR_DETECTION_029_032_oPCAN_RADAR_bfdfc8d6_Tx: ComSignalType=UINT8
            DET_IDM_030_oRDR_DETECTION_029_032_oPCAN_RADAR_daffba72_Tx: ComSignalType=UINT8
            DET_IDM_031_oRDR_DETECTION_029_032_oPCAN_RADAR_4f8f6ee7_Tx: ComSignalType=UINT8
            DET_IDM_032_oRDR_DETECTION_029_032_oPCAN_RADAR_2b6f1519_Tx: ComSignalType=UINT8
            DET_MH_CRC16_029_032_oRDR_DETECTION_029_032_oPCAN_RADAR_860cf7d5_Tx: ComSignalType=UINT16
            DET_MH_CYCLE_COUNTER_029_032_oRDR_DETECTION_029_032_oPCAN_RADAR_027956e2_Tx: ComSignalType=UINT8
            DET_MH_SCAN_INDEX_4LSB_029_032_oRDR_DETECTION_029_032_oPCAN_RADAR_ce53736e_Tx: ComSignalType=UINT8
            DET_MTD_029_oRDR_DETECTION_029_032_oPCAN_RADAR_d96cfa0d_Tx: ComSignalType=UINT8
            DET_MTD_030_oRDR_DETECTION_029_032_oPCAN_RADAR_bc4c88a9_Tx: ComSignalType=UINT8
            DET_MTD_031_oRDR_DETECTION_029_032_oPCAN_RADAR_293c5c3c_Tx: ComSignalType=UINT8
            DET_MTD_032_oRDR_DETECTION_029_032_oPCAN_RADAR_4ddc27c2_Tx: ComSignalType=UINT8
            DET_PROB_1STAZHYPO_029_oRDR_DETECTION_029_032_oPCAN_RADAR_4ad812c0_Tx: ComSignalType=BOOLEAN
            DET_PROB_1STAZHYPO_030_oRDR_DETECTION_029_032_oPCAN_RADAR_2ff86064_Tx: ComSignalType=BOOLEAN
            DET_PROB_1STAZHYPO_031_oRDR_DETECTION_029_032_oPCAN_RADAR_ba88b4f1_Tx: ComSignalType=BOOLEAN
            DET_PROB_1STAZHYPO_032_oRDR_DETECTION_029_032_oPCAN_RADAR_de68cf0f_Tx: ComSignalType=BOOLEAN
            DET_RANGE_029_oRDR_DETECTION_029_032_oPCAN_RADAR_4177f1b6_Tx: ComSignalType=UINT16
            DET_RANGE_030_oRDR_DETECTION_029_032_oPCAN_RADAR_24578312_Tx: ComSignalType=UINT16
            DET_RANGE_031_oRDR_DETECTION_029_032_oPCAN_RADAR_b1275787_Tx: ComSignalType=UINT16
            DET_RANGE_032_oRDR_DETECTION_029_032_oPCAN_RADAR_d5c72c79_Tx: ComSignalType=UINT16
            DET_RANGE_ERR_029_oRDR_DETECTION_029_032_oPCAN_RADAR_e69f4bdf_Tx: ComSignalType=UINT8
            DET_RANGE_ERR_030_oRDR_DETECTION_029_032_oPCAN_RADAR_83bf397b_Tx: ComSignalType=UINT8
            DET_RANGE_ERR_031_oRDR_DETECTION_029_032_oPCAN_RADAR_16cfedee_Tx: ComSignalType=UINT8
            DET_RANGE_ERR_032_oRDR_DETECTION_029_032_oPCAN_RADAR_722f9610_Tx: ComSignalType=UINT8
            DET_RANGE_VELOCITY_029_oRDR_DETECTION_029_032_oPCAN_RADAR_34d13393_Tx: ComSignalType=UINT16
            DET_RANGE_VELOCITY_030_oRDR_DETECTION_029_032_oPCAN_RADAR_51f14137_Tx: ComSignalType=UINT16
            DET_RANGE_VELOCITY_031_oRDR_DETECTION_029_032_oPCAN_RADAR_c48195a2_Tx: ComSignalType=UINT16
            DET_RANGE_VELOCITY_032_oRDR_DETECTION_029_032_oPCAN_RADAR_a061ee5c_Tx: ComSignalType=UINT16
            DET_RANGE_VELOCITY_ERR_029_oRDR_DETECTION_029_032_oPCAN_RADAR_3b6ac821_Tx: ComSignalType=UINT8
            DET_RANGE_VELOCITY_ERR_030_oRDR_DETECTION_029_032_oPCAN_RADAR_5e4aba85_Tx: ComSignalType=UINT8
            DET_RANGE_VELOCITY_ERR_031_oRDR_DETECTION_029_032_oPCAN_RADAR_cb3a6e10_Tx: ComSignalType=UINT8
            DET_RANGE_VELOCITY_ERR_032_oRDR_DETECTION_029_032_oPCAN_RADAR_afda15ee_Tx: ComSignalType=UINT8
            DET_RCS_029_oRDR_DETECTION_029_032_oPCAN_RADAR_b35104c9_Tx: ComSignalType=UINT8
            DET_RCS_030_oRDR_DETECTION_029_032_oPCAN_RADAR_d671766d_Tx: ComSignalType=UINT8
            DET_RCS_031_oRDR_DETECTION_029_032_oPCAN_RADAR_4301a2f8_Tx: ComSignalType=UINT8
            DET_RCS_032_oRDR_DETECTION_029_032_oPCAN_RADAR_27e1d906_Tx: ComSignalType=UINT8
            DET_SNR_029_oRDR_DETECTION_029_032_oPCAN_RADAR_6eff50cb_Tx: ComSignalType=UINT8
            DET_SNR_030_oRDR_DETECTION_029_032_oPCAN_RADAR_0bdf226f_Tx: ComSignalType=UINT8
            DET_SNR_031_oRDR_DETECTION_029_032_oPCAN_RADAR_9eaff6fa_Tx: ComSignalType=UINT8
            DET_SNR_032_oRDR_DETECTION_029_032_oPCAN_RADAR_fa4f8d04_Tx: ComSignalType=UINT8
            DET_SUPER_RES_TARGET_029_oRDR_DETECTION_029_032_oPCAN_RADAR_5f6678ae_Tx: ComSignalType=BOOLEAN
            DET_SUPER_RES_TARGET_030_oRDR_DETECTION_029_032_oPCAN_RADAR_3a460a0a_Tx: ComSignalType=BOOLEAN
            DET_SUPER_RES_TARGET_031_oRDR_DETECTION_029_032_oPCAN_RADAR_af36de9f_Tx: ComSignalType=BOOLEAN
            DET_SUPER_RES_TARGET_032_oRDR_DETECTION_029_032_oPCAN_RADAR_cbd6a561_Tx: ComSignalType=BOOLEAN
        SG_Detections_033_036_oRDR_DETECTION_033_036_oPCAN_RADAR_308f4df6_Tx
          83 x ComGroupSignal:
            DET_AZIMUTH_033_oRDR_DETECTION_033_036_oPCAN_RADAR_4deb8879_Tx: ComSignalType=UINT16
            DET_AZIMUTH_034_oRDR_DETECTION_033_036_oPCAN_RADAR_115bab10_Tx: ComSignalType=UINT16
            DET_AZIMUTH_035_oRDR_DETECTION_033_036_oPCAN_RADAR_842b7f85_Tx: ComSignalType=UINT16
            DET_AZIMUTH_036_oRDR_DETECTION_033_036_oPCAN_RADAR_e0cb047b_Tx: ComSignalType=UINT16
            DET_AZIMUTH_ERR_033_oRDR_DETECTION_033_036_oPCAN_RADAR_e95e1d8c_Tx: ComSignalType=UINT8
            DET_AZIMUTH_ERR_034_oRDR_DETECTION_033_036_oPCAN_RADAR_b5ee3ee5_Tx: ComSignalType=UINT8
            DET_AZIMUTH_ERR_035_oRDR_DETECTION_033_036_oPCAN_RADAR_209eea70_Tx: ComSignalType=UINT8
            DET_AZIMUTH_ERR_036_oRDR_DETECTION_033_036_oPCAN_RADAR_447e918e_Tx: ComSignalType=UINT8
            DET_BELOW_RAIN_THOLD_033_oRDR_DETECTION_033_036_oPCAN_RADAR_98ea1bb9_Tx: ComSignalType=UINT8
            DET_BELOW_RAIN_THOLD_034_oRDR_DETECTION_033_036_oPCAN_RADAR_c45a38d0_Tx: ComSignalType=UINT8
            DET_BELOW_RAIN_THOLD_035_oRDR_DETECTION_033_036_oPCAN_RADAR_512aec45_Tx: ComSignalType=UINT8
            DET_BELOW_RAIN_THOLD_036_oRDR_DETECTION_033_036_oPCAN_RADAR_35ca97bb_Tx: ComSignalType=UINT8
            DET_BI_STATIC_FLAG_033_oRDR_DETECTION_033_036_oPCAN_RADAR_1bc7c8fc_Tx: ComSignalType=BOOLEAN
            DET_BI_STATIC_FLAG_034_oRDR_DETECTION_033_036_oPCAN_RADAR_4777eb95_Tx: ComSignalType=BOOLEAN
            DET_BI_STATIC_FLAG_035_oRDR_DETECTION_033_036_oPCAN_RADAR_d2073f00_Tx: ComSignalType=BOOLEAN
            DET_BI_STATIC_FLAG_036_oRDR_DETECTION_033_036_oPCAN_RADAR_b6e744fe_Tx: ComSignalType=BOOLEAN
            DET_CONFD_AZIMUTH_033_oRDR_DETECTION_033_036_oPCAN_RADAR_4f0d82b3_Tx: ComSignalType=UINT8
            DET_CONFD_AZIMUTH_034_oRDR_DETECTION_033_036_oPCAN_RADAR_13bda1da_Tx: ComSignalType=UINT8
            DET_CONFD_AZIMUTH_035_oRDR_DETECTION_033_036_oPCAN_RADAR_86cd754f_Tx: ComSignalType=UINT8
            DET_CONFD_AZIMUTH_036_oRDR_DETECTION_033_036_oPCAN_RADAR_e22d0eb1_Tx: ComSignalType=UINT8
            DET_CONFD_ELEVATION_033_oRDR_DETECTION_033_036_oPCAN_RADAR_4d988349_Tx: ComSignalType=UINT8
            DET_CONFD_ELEVATION_034_oRDR_DETECTION_033_036_oPCAN_RADAR_1128a020_Tx: ComSignalType=UINT8
            DET_CONFD_ELEVATION_035_oRDR_DETECTION_033_036_oPCAN_RADAR_845874b5_Tx: ComSignalType=UINT8
            DET_CONFD_ELEVATION_036_oRDR_DETECTION_033_036_oPCAN_RADAR_e0b80f4b_Tx: ComSignalType=UINT8
            DET_ELEVATION_033_oRDR_DETECTION_033_036_oPCAN_RADAR_9c585775_Tx: ComSignalType=UINT8
            DET_ELEVATION_034_oRDR_DETECTION_033_036_oPCAN_RADAR_c0e8741c_Tx: ComSignalType=UINT8
            DET_ELEVATION_035_oRDR_DETECTION_033_036_oPCAN_RADAR_5598a089_Tx: ComSignalType=UINT8
            DET_ELEVATION_036_oRDR_DETECTION_033_036_oPCAN_RADAR_3178db77_Tx: ComSignalType=UINT8
            DET_ELEVATION_ERR_033_oRDR_DETECTION_033_036_oPCAN_RADAR_1b61cf00_Tx: ComSignalType=UINT8
            DET_ELEVATION_ERR_034_oRDR_DETECTION_033_036_oPCAN_RADAR_47d1ec69_Tx: ComSignalType=UINT8
            DET_ELEVATION_ERR_035_oRDR_DETECTION_033_036_oPCAN_RADAR_d2a138fc_Tx: ComSignalType=UINT8
            DET_ELEVATION_ERR_036_oRDR_DETECTION_033_036_oPCAN_RADAR_b6414302_Tx: ComSignalType=UINT8
            DET_EXISTENCE_PROB_033_oRDR_DETECTION_033_036_oPCAN_RADAR_c9feba60_Tx: ComSignalType=UINT8
            DET_EXISTENCE_PROB_034_oRDR_DETECTION_033_036_oPCAN_RADAR_954e9909_Tx: ComSignalType=UINT8
            DET_EXISTENCE_PROB_035_oRDR_DETECTION_033_036_oPCAN_RADAR_003e4d9c_Tx: ComSignalType=UINT8
            DET_EXISTENCE_PROB_036_oRDR_DETECTION_033_036_oPCAN_RADAR_64de3662_Tx: ComSignalType=UINT8
            DET_HVC_FLAG_033_oRDR_DETECTION_033_036_oPCAN_RADAR_288af91f_Tx: ComSignalType=BOOLEAN
            DET_HVC_FLAG_034_oRDR_DETECTION_033_036_oPCAN_RADAR_743ada76_Tx: ComSignalType=BOOLEAN
            DET_HVC_FLAG_035_oRDR_DETECTION_033_036_oPCAN_RADAR_e14a0ee3_Tx: ComSignalType=BOOLEAN
            DET_HVC_FLAG_036_oRDR_DETECTION_033_036_oPCAN_RADAR_85aa751d_Tx: ComSignalType=BOOLEAN
            DET_IDM_033_oRDR_DETECTION_033_036_oPCAN_RADAR_a3d8c2a2_Tx: ComSignalType=UINT8
            DET_IDM_034_oRDR_DETECTION_033_036_oPCAN_RADAR_ff68e1cb_Tx: ComSignalType=UINT8
            DET_IDM_035_oRDR_DETECTION_033_036_oPCAN_RADAR_6a18355e_Tx: ComSignalType=UINT8
            DET_IDM_036_oRDR_DETECTION_033_036_oPCAN_RADAR_0ef84ea0_Tx: ComSignalType=UINT8
            DET_MH_CRC16_033_036_oRDR_DETECTION_033_036_oPCAN_RADAR_b4079ffd_Tx: ComSignalType=UINT16
            DET_MH_CYCLE_COUNTER_033_036_oRDR_DETECTION_033_036_oPCAN_RADAR_30723eca_Tx: ComSignalType=UINT8
            DET_MH_SCAN_INDEX_4LSB_033_036_oRDR_DETECTION_033_036_oPCAN_RADAR_fc581b46_Tx: ComSignalType=UINT8
            DET_MTD_033_oRDR_DETECTION_033_036_oPCAN_RADAR_c56bf079_Tx: ComSignalType=UINT8
            DET_MTD_034_oRDR_DETECTION_033_036_oPCAN_RADAR_99dbd310_Tx: ComSignalType=UINT8
            DET_MTD_035_oRDR_DETECTION_033_036_oPCAN_RADAR_0cab0785_Tx: ComSignalType=UINT8
            DET_MTD_036_oRDR_DETECTION_033_036_oPCAN_RADAR_684b7c7b_Tx: ComSignalType=UINT8
            DET_PROB_1STAZHYPO_033_oRDR_DETECTION_033_036_oPCAN_RADAR_56df18b4_Tx: ComSignalType=BOOLEAN
            DET_PROB_1STAZHYPO_034_oRDR_DETECTION_033_036_oPCAN_RADAR_0a6f3bdd_Tx: ComSignalType=BOOLEAN
            DET_PROB_1STAZHYPO_035_oRDR_DETECTION_033_036_oPCAN_RADAR_9f1fef48_Tx: ComSignalType=BOOLEAN
            DET_PROB_1STAZHYPO_036_oRDR_DETECTION_033_036_oPCAN_RADAR_fbff94b6_Tx: ComSignalType=BOOLEAN
            DET_RANGE_033_oRDR_DETECTION_033_036_oPCAN_RADAR_5d70fbc2_Tx: ComSignalType=UINT16
            DET_RANGE_034_oRDR_DETECTION_033_036_oPCAN_RADAR_01c0d8ab_Tx: ComSignalType=UINT16
            DET_RANGE_035_oRDR_DETECTION_033_036_oPCAN_RADAR_94b00c3e_Tx: ComSignalType=UINT16
            DET_RANGE_036_oRDR_DETECTION_033_036_oPCAN_RADAR_f05077c0_Tx: ComSignalType=UINT16
            DET_RANGE_ERR_033_oRDR_DETECTION_033_036_oPCAN_RADAR_fa9841ab_Tx: ComSignalType=UINT8
            DET_RANGE_ERR_034_oRDR_DETECTION_033_036_oPCAN_RADAR_a62862c2_Tx: ComSignalType=UINT8
            DET_RANGE_ERR_035_oRDR_DETECTION_033_036_oPCAN_RADAR_3358b657_Tx: ComSignalType=UINT8
            DET_RANGE_ERR_036_oRDR_DETECTION_033_036_oPCAN_RADAR_57b8cda9_Tx: ComSignalType=UINT8
            DET_RANGE_VELOCITY_033_oRDR_DETECTION_033_036_oPCAN_RADAR_28d639e7_Tx: ComSignalType=UINT16
            DET_RANGE_VELOCITY_034_oRDR_DETECTION_033_036_oPCAN_RADAR_74661a8e_Tx: ComSignalType=UINT16
            DET_RANGE_VELOCITY_035_oRDR_DETECTION_033_036_oPCAN_RADAR_e116ce1b_Tx: ComSignalType=UINT16
            DET_RANGE_VELOCITY_036_oRDR_DETECTION_033_036_oPCAN_RADAR_85f6b5e5_Tx: ComSignalType=UINT16
            DET_RANGE_VELOCITY_ERR_033_oRDR_DETECTION_033_036_oPCAN_RADAR_276dc255_Tx: ComSignalType=UINT8
            DET_RANGE_VELOCITY_ERR_034_oRDR_DETECTION_033_036_oPCAN_RADAR_7bdde13c_Tx: ComSignalType=UINT8
            DET_RANGE_VELOCITY_ERR_035_oRDR_DETECTION_033_036_oPCAN_RADAR_eead35a9_Tx: ComSignalType=UINT8
            DET_RANGE_VELOCITY_ERR_036_oRDR_DETECTION_033_036_oPCAN_RADAR_8a4d4e57_Tx: ComSignalType=UINT8
            DET_RCS_033_oRDR_DETECTION_033_036_oPCAN_RADAR_af560ebd_Tx: ComSignalType=UINT8
            DET_RCS_034_oRDR_DETECTION_033_036_oPCAN_RADAR_f3e62dd4_Tx: ComSignalType=UINT8
            DET_RCS_035_oRDR_DETECTION_033_036_oPCAN_RADAR_6696f941_Tx: ComSignalType=UINT8
            DET_RCS_036_oRDR_DETECTION_033_036_oPCAN_RADAR_027682bf_Tx: ComSignalType=UINT8
            DET_SNR_033_oRDR_DETECTION_033_036_oPCAN_RADAR_72f85abf_Tx: ComSignalType=UINT8
            DET_SNR_034_oRDR_DETECTION_033_036_oPCAN_RADAR_2e4879d6_Tx: ComSignalType=UINT8
            DET_SNR_035_oRDR_DETECTION_033_036_oPCAN_RADAR_bb38ad43_Tx: ComSignalType=UINT8
            DET_SNR_036_oRDR_DETECTION_033_036_oPCAN_RADAR_dfd8d6bd_Tx: ComSignalType=UINT8
            DET_SUPER_RES_TARGET_033_oRDR_DETECTION_033_036_oPCAN_RADAR_436172da_Tx: ComSignalType=BOOLEAN
            DET_SUPER_RES_TARGET_034_oRDR_DETECTION_033_036_oPCAN_RADAR_1fd151b3_Tx: ComSignalType=BOOLEAN
            DET_SUPER_RES_TARGET_035_oRDR_DETECTION_033_036_oPCAN_RADAR_8aa18526_Tx: ComSignalType=BOOLEAN
            DET_SUPER_RES_TARGET_036_oRDR_DETECTION_033_036_oPCAN_RADAR_ee41fed8_Tx: ComSignalType=BOOLEAN
        SG_Detections_037_040_oRDR_DETECTION_037_040_oPCAN_RADAR_abdcc2d8_Tx
          83 x ComGroupSignal:
            DET_AZIMUTH_037_oRDR_DETECTION_037_040_oPCAN_RADAR_c39b823c_Tx: ComSignalType=UINT16
            DET_AZIMUTH_038_oRDR_DETECTION_037_040_oPCAN_RADAR_ef8b107b_Tx: ComSignalType=UINT16
            DET_AZIMUTH_039_oRDR_DETECTION_037_040_oPCAN_RADAR_7afbc4ee_Tx: ComSignalType=UINT16
            DET_AZIMUTH_040_oRDR_DETECTION_037_040_oPCAN_RADAR_ab19c88a_Tx: ComSignalType=UINT16
            DET_AZIMUTH_ERR_037_oRDR_DETECTION_037_040_oPCAN_RADAR_672e17c9_Tx: ComSignalType=UINT8
            DET_AZIMUTH_ERR_038_oRDR_DETECTION_037_040_oPCAN_RADAR_4b3e858e_Tx: ComSignalType=UINT8
            DET_AZIMUTH_ERR_039_oRDR_DETECTION_037_040_oPCAN_RADAR_de4e511b_Tx: ComSignalType=UINT8
            DET_AZIMUTH_ERR_040_oRDR_DETECTION_037_040_oPCAN_RADAR_0fac5d7f_Tx: ComSignalType=UINT8
            DET_BELOW_RAIN_THOLD_037_oRDR_DETECTION_037_040_oPCAN_RADAR_169a11fc_Tx: ComSignalType=UINT8
            DET_BELOW_RAIN_THOLD_038_oRDR_DETECTION_037_040_oPCAN_RADAR_3a8a83bb_Tx: ComSignalType=UINT8
            DET_BELOW_RAIN_THOLD_039_oRDR_DETECTION_037_040_oPCAN_RADAR_affa572e_Tx: ComSignalType=UINT8
            DET_BELOW_RAIN_THOLD_040_oRDR_DETECTION_037_040_oPCAN_RADAR_7e185b4a_Tx: ComSignalType=UINT8
            DET_BI_STATIC_FLAG_037_oRDR_DETECTION_037_040_oPCAN_RADAR_95b7c2b9_Tx: ComSignalType=BOOLEAN
            DET_BI_STATIC_FLAG_038_oRDR_DETECTION_037_040_oPCAN_RADAR_b9a750fe_Tx: ComSignalType=BOOLEAN
            DET_BI_STATIC_FLAG_039_oRDR_DETECTION_037_040_oPCAN_RADAR_2cd7846b_Tx: ComSignalType=BOOLEAN
            DET_BI_STATIC_FLAG_040_oRDR_DETECTION_037_040_oPCAN_RADAR_fd35880f_Tx: ComSignalType=BOOLEAN
            DET_CONFD_AZIMUTH_037_oRDR_DETECTION_037_040_oPCAN_RADAR_c17d88f6_Tx: ComSignalType=UINT8
            DET_CONFD_AZIMUTH_038_oRDR_DETECTION_037_040_oPCAN_RADAR_ed6d1ab1_Tx: ComSignalType=UINT8
            DET_CONFD_AZIMUTH_039_oRDR_DETECTION_037_040_oPCAN_RADAR_781dce24_Tx: ComSignalType=UINT8
            DET_CONFD_AZIMUTH_040_oRDR_DETECTION_037_040_oPCAN_RADAR_a9ffc240_Tx: ComSignalType=UINT8
            DET_CONFD_ELEVATION_037_oRDR_DETECTION_037_040_oPCAN_RADAR_c3e8890c_Tx: ComSignalType=UINT8
            DET_CONFD_ELEVATION_038_oRDR_DETECTION_037_040_oPCAN_RADAR_eff81b4b_Tx: ComSignalType=UINT8
            DET_CONFD_ELEVATION_039_oRDR_DETECTION_037_040_oPCAN_RADAR_7a88cfde_Tx: ComSignalType=UINT8
            DET_CONFD_ELEVATION_040_oRDR_DETECTION_037_040_oPCAN_RADAR_ab6ac3ba_Tx: ComSignalType=UINT8
            DET_ELEVATION_037_oRDR_DETECTION_037_040_oPCAN_RADAR_12285d30_Tx: ComSignalType=UINT8
            DET_ELEVATION_038_oRDR_DETECTION_037_040_oPCAN_RADAR_3e38cf77_Tx: ComSignalType=UINT8
            DET_ELEVATION_039_oRDR_DETECTION_037_040_oPCAN_RADAR_ab481be2_Tx: ComSignalType=UINT8
            DET_ELEVATION_040_oRDR_DETECTION_037_040_oPCAN_RADAR_7aaa1786_Tx: ComSignalType=UINT8
            DET_ELEVATION_ERR_037_oRDR_DETECTION_037_040_oPCAN_RADAR_9511c545_Tx: ComSignalType=UINT8
            DET_ELEVATION_ERR_038_oRDR_DETECTION_037_040_oPCAN_RADAR_b9015702_Tx: ComSignalType=UINT8
            DET_ELEVATION_ERR_039_oRDR_DETECTION_037_040_oPCAN_RADAR_2c718397_Tx: ComSignalType=UINT8
            DET_ELEVATION_ERR_040_oRDR_DETECTION_037_040_oPCAN_RADAR_fd938ff3_Tx: ComSignalType=UINT8
            DET_EXISTENCE_PROB_037_oRDR_DETECTION_037_040_oPCAN_RADAR_478eb025_Tx: ComSignalType=UINT8
            DET_EXISTENCE_PROB_038_oRDR_DETECTION_037_040_oPCAN_RADAR_6b9e2262_Tx: ComSignalType=UINT8
            DET_EXISTENCE_PROB_039_oRDR_DETECTION_037_040_oPCAN_RADAR_feeef6f7_Tx: ComSignalType=UINT8
            DET_EXISTENCE_PROB_040_oRDR_DETECTION_037_040_oPCAN_RADAR_2f0cfa93_Tx: ComSignalType=UINT8
            DET_HVC_FLAG_037_oRDR_DETECTION_037_040_oPCAN_RADAR_a6faf35a_Tx: ComSignalType=BOOLEAN
            DET_HVC_FLAG_038_oRDR_DETECTION_037_040_oPCAN_RADAR_8aea611d_Tx: ComSignalType=BOOLEAN
            DET_HVC_FLAG_039_oRDR_DETECTION_037_040_oPCAN_RADAR_1f9ab588_Tx: ComSignalType=BOOLEAN
            DET_HVC_FLAG_040_oRDR_DETECTION_037_040_oPCAN_RADAR_ce78b9ec_Tx: ComSignalType=BOOLEAN
            DET_IDM_037_oRDR_DETECTION_037_040_oPCAN_RADAR_2da8c8e7_Tx: ComSignalType=UINT8
            DET_IDM_038_oRDR_DETECTION_037_040_oPCAN_RADAR_01b85aa0_Tx: ComSignalType=UINT8
            DET_IDM_039_oRDR_DETECTION_037_040_oPCAN_RADAR_94c88e35_Tx: ComSignalType=UINT8
            DET_IDM_040_oRDR_DETECTION_037_040_oPCAN_RADAR_452a8251_Tx: ComSignalType=UINT8
            DET_MH_CRC16_037_040_oRDR_DETECTION_037_040_oPCAN_RADAR_2f5410d3_Tx: ComSignalType=UINT16
            DET_MH_CYCLE_COUNTER_037_040_oRDR_DETECTION_037_040_oPCAN_RADAR_ab21b1e4_Tx: ComSignalType=UINT8
            DET_MH_SCAN_INDEX_4LSB_037_040_oRDR_DETECTION_037_040_oPCAN_RADAR_670b9468_Tx: ComSignalType=UINT8
            DET_MTD_037_oRDR_DETECTION_037_040_oPCAN_RADAR_4b1bfa3c_Tx: ComSignalType=UINT8
            DET_MTD_038_oRDR_DETECTION_037_040_oPCAN_RADAR_670b687b_Tx: ComSignalType=UINT8
            DET_MTD_039_oRDR_DETECTION_037_040_oPCAN_RADAR_f27bbcee_Tx: ComSignalType=UINT8
            DET_MTD_040_oRDR_DETECTION_037_040_oPCAN_RADAR_2399b08a_Tx: ComSignalType=UINT8
            DET_PROB_1STAZHYPO_037_oRDR_DETECTION_037_040_oPCAN_RADAR_d8af12f1_Tx: ComSignalType=BOOLEAN
            DET_PROB_1STAZHYPO_038_oRDR_DETECTION_037_040_oPCAN_RADAR_f4bf80b6_Tx: ComSignalType=BOOLEAN
            DET_PROB_1STAZHYPO_039_oRDR_DETECTION_037_040_oPCAN_RADAR_61cf5423_Tx: ComSignalType=BOOLEAN
            DET_PROB_1STAZHYPO_040_oRDR_DETECTION_037_040_oPCAN_RADAR_b02d5847_Tx: ComSignalType=BOOLEAN
            DET_RANGE_037_oRDR_DETECTION_037_040_oPCAN_RADAR_d300f187_Tx: ComSignalType=UINT16
            DET_RANGE_038_oRDR_DETECTION_037_040_oPCAN_RADAR_ff1063c0_Tx: ComSignalType=UINT16
            DET_RANGE_039_oRDR_DETECTION_037_040_oPCAN_RADAR_6a60b755_Tx: ComSignalType=UINT16
            DET_RANGE_040_oRDR_DETECTION_037_040_oPCAN_RADAR_bb82bb31_Tx: ComSignalType=UINT16
            DET_RANGE_ERR_037_oRDR_DETECTION_037_040_oPCAN_RADAR_74e84bee_Tx: ComSignalType=UINT8
            DET_RANGE_ERR_038_oRDR_DETECTION_037_040_oPCAN_RADAR_58f8d9a9_Tx: ComSignalType=UINT8
            DET_RANGE_ERR_039_oRDR_DETECTION_037_040_oPCAN_RADAR_cd880d3c_Tx: ComSignalType=UINT8
            DET_RANGE_ERR_040_oRDR_DETECTION_037_040_oPCAN_RADAR_1c6a0158_Tx: ComSignalType=UINT8
            DET_RANGE_VELOCITY_037_oRDR_DETECTION_037_040_oPCAN_RADAR_a6a633a2_Tx: ComSignalType=UINT16
            DET_RANGE_VELOCITY_038_oRDR_DETECTION_037_040_oPCAN_RADAR_8ab6a1e5_Tx: ComSignalType=UINT16
            DET_RANGE_VELOCITY_039_oRDR_DETECTION_037_040_oPCAN_RADAR_1fc67570_Tx: ComSignalType=UINT16
            DET_RANGE_VELOCITY_040_oRDR_DETECTION_037_040_oPCAN_RADAR_ce247914_Tx: ComSignalType=UINT16
            DET_RANGE_VELOCITY_ERR_037_oRDR_DETECTION_037_040_oPCAN_RADAR_a91dc810_Tx: ComSignalType=UINT8
            DET_RANGE_VELOCITY_ERR_038_oRDR_DETECTION_037_040_oPCAN_RADAR_850d5a57_Tx: ComSignalType=UINT8
            DET_RANGE_VELOCITY_ERR_039_oRDR_DETECTION_037_040_oPCAN_RADAR_107d8ec2_Tx: ComSignalType=UINT8
            DET_RANGE_VELOCITY_ERR_040_oRDR_DETECTION_037_040_oPCAN_RADAR_c19f82a6_Tx: ComSignalType=UINT8
            DET_RCS_037_oRDR_DETECTION_037_040_oPCAN_RADAR_212604f8_Tx: ComSignalType=UINT8
            DET_RCS_038_oRDR_DETECTION_037_040_oPCAN_RADAR_0d3696bf_Tx: ComSignalType=UINT8
            DET_RCS_039_oRDR_DETECTION_037_040_oPCAN_RADAR_9846422a_Tx: ComSignalType=UINT8
            DET_RCS_040_oRDR_DETECTION_037_040_oPCAN_RADAR_49a44e4e_Tx: ComSignalType=UINT8
            DET_SNR_037_oRDR_DETECTION_037_040_oPCAN_RADAR_fc8850fa_Tx: ComSignalType=UINT8
            DET_SNR_038_oRDR_DETECTION_037_040_oPCAN_RADAR_d098c2bd_Tx: ComSignalType=UINT8
            DET_SNR_039_oRDR_DETECTION_037_040_oPCAN_RADAR_45e81628_Tx: ComSignalType=UINT8
            DET_SNR_040_oRDR_DETECTION_037_040_oPCAN_RADAR_940a1a4c_Tx: ComSignalType=UINT8
            DET_SUPER_RES_TARGET_037_oRDR_DETECTION_037_040_oPCAN_RADAR_cd11789f_Tx: ComSignalType=BOOLEAN
            DET_SUPER_RES_TARGET_038_oRDR_DETECTION_037_040_oPCAN_RADAR_e101ead8_Tx: ComSignalType=BOOLEAN
            DET_SUPER_RES_TARGET_039_oRDR_DETECTION_037_040_oPCAN_RADAR_74713e4d_Tx: ComSignalType=BOOLEAN
            DET_SUPER_RES_TARGET_040_oRDR_DETECTION_037_040_oPCAN_RADAR_a5933229_Tx: ComSignalType=BOOLEAN
        SG_Detections_041_044_oRDR_DETECTION_041_044_oPCAN_RADAR_b5a3d501_Tx
          83 x ComGroupSignal:
            DET_AZIMUTH_041_oRDR_DETECTION_041_044_oPCAN_RADAR_b8cacbe5_Tx: ComSignalType=UINT16
            DET_AZIMUTH_042_oRDR_DETECTION_041_044_oPCAN_RADAR_dc2ab01b_Tx: ComSignalType=UINT16
            DET_AZIMUTH_043_oRDR_DETECTION_041_044_oPCAN_RADAR_495a648e_Tx: ComSignalType=UINT16
            DET_AZIMUTH_044_oRDR_DETECTION_041_044_oPCAN_RADAR_15ea47e7_Tx: ComSignalType=UINT16
            DET_AZIMUTH_ERR_041_oRDR_DETECTION_041_044_oPCAN_RADAR_1c7f5e10_Tx: ComSignalType=UINT8
            DET_AZIMUTH_ERR_042_oRDR_DETECTION_041_044_oPCAN_RADAR_789f25ee_Tx: ComSignalType=UINT8
            DET_AZIMUTH_ERR_043_oRDR_DETECTION_041_044_oPCAN_RADAR_edeff17b_Tx: ComSignalType=UINT8
            DET_AZIMUTH_ERR_044_oRDR_DETECTION_041_044_oPCAN_RADAR_b15fd212_Tx: ComSignalType=UINT8
            DET_BELOW_RAIN_THOLD_041_oRDR_DETECTION_041_044_oPCAN_RADAR_6dcb5825_Tx: ComSignalType=UINT8
            DET_BELOW_RAIN_THOLD_042_oRDR_DETECTION_041_044_oPCAN_RADAR_092b23db_Tx: ComSignalType=UINT8
            DET_BELOW_RAIN_THOLD_043_oRDR_DETECTION_041_044_oPCAN_RADAR_9c5bf74e_Tx: ComSignalType=UINT8
            DET_BELOW_RAIN_THOLD_044_oRDR_DETECTION_041_044_oPCAN_RADAR_c0ebd427_Tx: ComSignalType=UINT8
            DET_BI_STATIC_FLAG_041_oRDR_DETECTION_041_044_oPCAN_RADAR_eee68b60_Tx: ComSignalType=BOOLEAN
            DET_BI_STATIC_FLAG_042_oRDR_DETECTION_041_044_oPCAN_RADAR_8a06f09e_Tx: ComSignalType=BOOLEAN
            DET_BI_STATIC_FLAG_043_oRDR_DETECTION_041_044_oPCAN_RADAR_1f76240b_Tx: ComSignalType=BOOLEAN
            DET_BI_STATIC_FLAG_044_oRDR_DETECTION_041_044_oPCAN_RADAR_43c60762_Tx: ComSignalType=BOOLEAN
            DET_CONFD_AZIMUTH_041_oRDR_DETECTION_041_044_oPCAN_RADAR_ba2cc12f_Tx: ComSignalType=UINT8
            DET_CONFD_AZIMUTH_042_oRDR_DETECTION_041_044_oPCAN_RADAR_deccbad1_Tx: ComSignalType=UINT8
            DET_CONFD_AZIMUTH_043_oRDR_DETECTION_041_044_oPCAN_RADAR_4bbc6e44_Tx: ComSignalType=UINT8
            DET_CONFD_AZIMUTH_044_oRDR_DETECTION_041_044_oPCAN_RADAR_170c4d2d_Tx: ComSignalType=UINT8
            DET_CONFD_ELEVATION_041_oRDR_DETECTION_041_044_oPCAN_RADAR_b8b9c0d5_Tx: ComSignalType=UINT8
            DET_CONFD_ELEVATION_042_oRDR_DETECTION_041_044_oPCAN_RADAR_dc59bb2b_Tx: ComSignalType=UINT8
            DET_CONFD_ELEVATION_043_oRDR_DETECTION_041_044_oPCAN_RADAR_49296fbe_Tx: ComSignalType=UINT8
            DET_CONFD_ELEVATION_044_oRDR_DETECTION_041_044_oPCAN_RADAR_15994cd7_Tx: ComSignalType=UINT8
            DET_ELEVATION_041_oRDR_DETECTION_041_044_oPCAN_RADAR_697914e9_Tx: ComSignalType=UINT8
            DET_ELEVATION_042_oRDR_DETECTION_041_044_oPCAN_RADAR_0d996f17_Tx: ComSignalType=UINT8
            DET_ELEVATION_043_oRDR_DETECTION_041_044_oPCAN_RADAR_98e9bb82_Tx: ComSignalType=UINT8
            DET_ELEVATION_044_oRDR_DETECTION_041_044_oPCAN_RADAR_c45998eb_Tx: ComSignalType=UINT8
            DET_ELEVATION_ERR_041_oRDR_DETECTION_041_044_oPCAN_RADAR_ee408c9c_Tx: ComSignalType=UINT8
            DET_ELEVATION_ERR_042_oRDR_DETECTION_041_044_oPCAN_RADAR_8aa0f762_Tx: ComSignalType=UINT8
            DET_ELEVATION_ERR_043_oRDR_DETECTION_041_044_oPCAN_RADAR_1fd023f7_Tx: ComSignalType=UINT8
            DET_ELEVATION_ERR_044_oRDR_DETECTION_041_044_oPCAN_RADAR_4360009e_Tx: ComSignalType=UINT8
            DET_EXISTENCE_PROB_041_oRDR_DETECTION_041_044_oPCAN_RADAR_3cdff9fc_Tx: ComSignalType=UINT8
            DET_EXISTENCE_PROB_042_oRDR_DETECTION_041_044_oPCAN_RADAR_583f8202_Tx: ComSignalType=UINT8
            DET_EXISTENCE_PROB_043_oRDR_DETECTION_041_044_oPCAN_RADAR_cd4f5697_Tx: ComSignalType=UINT8
            DET_EXISTENCE_PROB_044_oRDR_DETECTION_041_044_oPCAN_RADAR_91ff75fe_Tx: ComSignalType=UINT8
            DET_HVC_FLAG_041_oRDR_DETECTION_041_044_oPCAN_RADAR_ddabba83_Tx: ComSignalType=BOOLEAN
            DET_HVC_FLAG_042_oRDR_DETECTION_041_044_oPCAN_RADAR_b94bc17d_Tx: ComSignalType=BOOLEAN
            DET_HVC_FLAG_043_oRDR_DETECTION_041_044_oPCAN_RADAR_2c3b15e8_Tx: ComSignalType=BOOLEAN
            DET_HVC_FLAG_044_oRDR_DETECTION_041_044_oPCAN_RADAR_708b3681_Tx: ComSignalType=BOOLEAN
            DET_IDM_041_oRDR_DETECTION_041_044_oPCAN_RADAR_56f9813e_Tx: ComSignalType=UINT8
            DET_IDM_042_oRDR_DETECTION_041_044_oPCAN_RADAR_3219fac0_Tx: ComSignalType=UINT8
            DET_IDM_043_oRDR_DETECTION_041_044_oPCAN_RADAR_a7692e55_Tx: ComSignalType=UINT8
            DET_IDM_044_oRDR_DETECTION_041_044_oPCAN_RADAR_fbd90d3c_Tx: ComSignalType=UINT8
            DET_MH_CRC16_041_044_oRDR_DETECTION_041_044_oPCAN_RADAR_312b070a_Tx: ComSignalType=UINT16
            DET_MH_CYCLE_COUNTER_041_044_oRDR_DETECTION_041_044_oPCAN_RADAR_b55ea63d_Tx: ComSignalType=UINT8
            DET_MH_SCAN_INDEX_4LSB_041_044_oRDR_DETECTION_041_044_oPCAN_RADAR_797483b1_Tx: ComSignalType=UINT8
            DET_MTD_041_oRDR_DETECTION_041_044_oPCAN_RADAR_304ab3e5_Tx: ComSignalType=UINT8
            DET_MTD_042_oRDR_DETECTION_041_044_oPCAN_RADAR_54aac81b_Tx: ComSignalType=UINT8
            DET_MTD_043_oRDR_DETECTION_041_044_oPCAN_RADAR_c1da1c8e_Tx: ComSignalType=UINT8
            DET_MTD_044_oRDR_DETECTION_041_044_oPCAN_RADAR_9d6a3fe7_Tx: ComSignalType=UINT8
            DET_PROB_1STAZHYPO_041_oRDR_DETECTION_041_044_oPCAN_RADAR_a3fe5b28_Tx: ComSignalType=BOOLEAN
            DET_PROB_1STAZHYPO_042_oRDR_DETECTION_041_044_oPCAN_RADAR_c71e20d6_Tx: ComSignalType=BOOLEAN
            DET_PROB_1STAZHYPO_043_oRDR_DETECTION_041_044_oPCAN_RADAR_526ef443_Tx: ComSignalType=BOOLEAN
            DET_PROB_1STAZHYPO_044_oRDR_DETECTION_041_044_oPCAN_RADAR_0eded72a_Tx: ComSignalType=BOOLEAN
            DET_RANGE_041_oRDR_DETECTION_041_044_oPCAN_RADAR_a851b85e_Tx: ComSignalType=UINT16
            DET_RANGE_042_oRDR_DETECTION_041_044_oPCAN_RADAR_ccb1c3a0_Tx: ComSignalType=UINT16
            DET_RANGE_043_oRDR_DETECTION_041_044_oPCAN_RADAR_59c11735_Tx: ComSignalType=UINT16
            DET_RANGE_044_oRDR_DETECTION_041_044_oPCAN_RADAR_0571345c_Tx: ComSignalType=UINT16
            DET_RANGE_ERR_041_oRDR_DETECTION_041_044_oPCAN_RADAR_0fb90237_Tx: ComSignalType=UINT8
            DET_RANGE_ERR_042_oRDR_DETECTION_041_044_oPCAN_RADAR_6b5979c9_Tx: ComSignalType=UINT8
            DET_RANGE_ERR_043_oRDR_DETECTION_041_044_oPCAN_RADAR_fe29ad5c_Tx: ComSignalType=UINT8
            DET_RANGE_ERR_044_oRDR_DETECTION_041_044_oPCAN_RADAR_a2998e35_Tx: ComSignalType=UINT8
            DET_RANGE_VELOCITY_041_oRDR_DETECTION_041_044_oPCAN_RADAR_ddf77a7b_Tx: ComSignalType=UINT16
            DET_RANGE_VELOCITY_042_oRDR_DETECTION_041_044_oPCAN_RADAR_b9170185_Tx: ComSignalType=UINT16
            DET_RANGE_VELOCITY_043_oRDR_DETECTION_041_044_oPCAN_RADAR_2c67d510_Tx: ComSignalType=UINT16
            DET_RANGE_VELOCITY_044_oRDR_DETECTION_041_044_oPCAN_RADAR_70d7f679_Tx: ComSignalType=UINT16
            DET_RANGE_VELOCITY_ERR_041_oRDR_DETECTION_041_044_oPCAN_RADAR_d24c81c9_Tx: ComSignalType=UINT8
            DET_RANGE_VELOCITY_ERR_042_oRDR_DETECTION_041_044_oPCAN_RADAR_b6acfa37_Tx: ComSignalType=UINT8
            DET_RANGE_VELOCITY_ERR_043_oRDR_DETECTION_041_044_oPCAN_RADAR_23dc2ea2_Tx: ComSignalType=UINT8
            DET_RANGE_VELOCITY_ERR_044_oRDR_DETECTION_041_044_oPCAN_RADAR_7f6c0dcb_Tx: ComSignalType=UINT8
            DET_RCS_041_oRDR_DETECTION_041_044_oPCAN_RADAR_5a774d21_Tx: ComSignalType=UINT8
            DET_RCS_042_oRDR_DETECTION_041_044_oPCAN_RADAR_3e9736df_Tx: ComSignalType=UINT8
            DET_RCS_043_oRDR_DETECTION_041_044_oPCAN_RADAR_abe7e24a_Tx: ComSignalType=UINT8
            DET_RCS_044_oRDR_DETECTION_041_044_oPCAN_RADAR_f757c123_Tx: ComSignalType=UINT8
            DET_SNR_041_oRDR_DETECTION_041_044_oPCAN_RADAR_87d91923_Tx: ComSignalType=UINT8
            DET_SNR_042_oRDR_DETECTION_041_044_oPCAN_RADAR_e33962dd_Tx: ComSignalType=UINT8
            DET_SNR_043_oRDR_DETECTION_041_044_oPCAN_RADAR_7649b648_Tx: ComSignalType=UINT8
            DET_SNR_044_oRDR_DETECTION_041_044_oPCAN_RADAR_2af99521_Tx: ComSignalType=UINT8
            DET_SUPER_RES_TARGET_041_oRDR_DETECTION_041_044_oPCAN_RADAR_b6403146_Tx: ComSignalType=BOOLEAN
            DET_SUPER_RES_TARGET_042_oRDR_DETECTION_041_044_oPCAN_RADAR_d2a04ab8_Tx: ComSignalType=BOOLEAN
            DET_SUPER_RES_TARGET_043_oRDR_DETECTION_041_044_oPCAN_RADAR_47d09e2d_Tx: ComSignalType=BOOLEAN
            DET_SUPER_RES_TARGET_044_oRDR_DETECTION_041_044_oPCAN_RADAR_1b60bd44_Tx: ComSignalType=BOOLEAN
        SG_Detections_045_048_oRDR_DETECTION_045_048_oPCAN_RADAR_c460e153_Tx
          83 x ComGroupSignal:
            DET_AZIMUTH_045_oRDR_DETECTION_045_048_oPCAN_RADAR_69280d46_Tx: ComSignalType=UINT16
            DET_AZIMUTH_046_oRDR_DETECTION_045_048_oPCAN_RADAR_0dc876b8_Tx: ComSignalType=UINT16
            DET_AZIMUTH_047_oRDR_DETECTION_045_048_oPCAN_RADAR_98b8a22d_Tx: ComSignalType=UINT16
            DET_AZIMUTH_048_oRDR_DETECTION_045_048_oPCAN_RADAR_b4a8306a_Tx: ComSignalType=UINT16
            DET_AZIMUTH_ERR_045_oRDR_DETECTION_045_048_oPCAN_RADAR_cd9d98b3_Tx: ComSignalType=UINT8
            DET_AZIMUTH_ERR_046_oRDR_DETECTION_045_048_oPCAN_RADAR_a97de34d_Tx: ComSignalType=UINT8
            DET_AZIMUTH_ERR_047_oRDR_DETECTION_045_048_oPCAN_RADAR_3c0d37d8_Tx: ComSignalType=UINT8
            DET_AZIMUTH_ERR_048_oRDR_DETECTION_045_048_oPCAN_RADAR_101da59f_Tx: ComSignalType=UINT8
            DET_BELOW_RAIN_THOLD_045_oRDR_DETECTION_045_048_oPCAN_RADAR_bc299e86_Tx: ComSignalType=UINT8
            DET_BELOW_RAIN_THOLD_046_oRDR_DETECTION_045_048_oPCAN_RADAR_d8c9e578_Tx: ComSignalType=UINT8
            DET_BELOW_RAIN_THOLD_047_oRDR_DETECTION_045_048_oPCAN_RADAR_4db931ed_Tx: ComSignalType=UINT8
            DET_BELOW_RAIN_THOLD_048_oRDR_DETECTION_045_048_oPCAN_RADAR_61a9a3aa_Tx: ComSignalType=UINT8
            DET_BI_STATIC_FLAG_045_oRDR_DETECTION_045_048_oPCAN_RADAR_3f044dc3_Tx: ComSignalType=BOOLEAN
            DET_BI_STATIC_FLAG_046_oRDR_DETECTION_045_048_oPCAN_RADAR_5be4363d_Tx: ComSignalType=BOOLEAN
            DET_BI_STATIC_FLAG_047_oRDR_DETECTION_045_048_oPCAN_RADAR_ce94e2a8_Tx: ComSignalType=BOOLEAN
            DET_BI_STATIC_FLAG_048_oRDR_DETECTION_045_048_oPCAN_RADAR_e28470ef_Tx: ComSignalType=BOOLEAN
            DET_CONFD_AZIMUTH_045_oRDR_DETECTION_045_048_oPCAN_RADAR_6bce078c_Tx: ComSignalType=UINT8
            DET_CONFD_AZIMUTH_046_oRDR_DETECTION_045_048_oPCAN_RADAR_0f2e7c72_Tx: ComSignalType=UINT8
            DET_CONFD_AZIMUTH_047_oRDR_DETECTION_045_048_oPCAN_RADAR_9a5ea8e7_Tx: ComSignalType=UINT8
            DET_CONFD_AZIMUTH_048_oRDR_DETECTION_045_048_oPCAN_RADAR_b64e3aa0_Tx: ComSignalType=UINT8
            DET_CONFD_ELEVATION_045_oRDR_DETECTION_045_048_oPCAN_RADAR_695b0676_Tx: ComSignalType=UINT8
            DET_CONFD_ELEVATION_046_oRDR_DETECTION_045_048_oPCAN_RADAR_0dbb7d88_Tx: ComSignalType=UINT8
            DET_CONFD_ELEVATION_047_oRDR_DETECTION_045_048_oPCAN_RADAR_98cba91d_Tx: ComSignalType=UINT8
            DET_CONFD_ELEVATION_048_oRDR_DETECTION_045_048_oPCAN_RADAR_b4db3b5a_Tx: ComSignalType=UINT8
            DET_ELEVATION_045_oRDR_DETECTION_045_048_oPCAN_RADAR_b89bd24a_Tx: ComSignalType=UINT8
            DET_ELEVATION_046_oRDR_DETECTION_045_048_oPCAN_RADAR_dc7ba9b4_Tx: ComSignalType=UINT8
            DET_ELEVATION_047_oRDR_DETECTION_045_048_oPCAN_RADAR_490b7d21_Tx: ComSignalType=UINT8
            DET_ELEVATION_048_oRDR_DETECTION_045_048_oPCAN_RADAR_651bef66_Tx: ComSignalType=UINT8
            DET_ELEVATION_ERR_045_oRDR_DETECTION_045_048_oPCAN_RADAR_3fa24a3f_Tx: ComSignalType=UINT8
            DET_ELEVATION_ERR_046_oRDR_DETECTION_045_048_oPCAN_RADAR_5b4231c1_Tx: ComSignalType=UINT8
            DET_ELEVATION_ERR_047_oRDR_DETECTION_045_048_oPCAN_RADAR_ce32e554_Tx: ComSignalType=UINT8
            DET_ELEVATION_ERR_048_oRDR_DETECTION_045_048_oPCAN_RADAR_e2227713_Tx: ComSignalType=UINT8
            DET_EXISTENCE_PROB_045_oRDR_DETECTION_045_048_oPCAN_RADAR_ed3d3f5f_Tx: ComSignalType=UINT8
            DET_EXISTENCE_PROB_046_oRDR_DETECTION_045_048_oPCAN_RADAR_89dd44a1_Tx: ComSignalType=UINT8
            DET_EXISTENCE_PROB_047_oRDR_DETECTION_045_048_oPCAN_RADAR_1cad9034_Tx: ComSignalType=UINT8
            DET_EXISTENCE_PROB_048_oRDR_DETECTION_045_048_oPCAN_RADAR_30bd0273_Tx: ComSignalType=UINT8
            DET_HVC_FLAG_045_oRDR_DETECTION_045_048_oPCAN_RADAR_0c497c20_Tx: ComSignalType=BOOLEAN
            DET_HVC_FLAG_046_oRDR_DETECTION_045_048_oPCAN_RADAR_68a907de_Tx: ComSignalType=BOOLEAN
            DET_HVC_FLAG_047_oRDR_DETECTION_045_048_oPCAN_RADAR_fdd9d34b_Tx: ComSignalType=BOOLEAN
            DET_HVC_FLAG_048_oRDR_DETECTION_045_048_oPCAN_RADAR_d1c9410c_Tx: ComSignalType=BOOLEAN
            DET_IDM_045_oRDR_DETECTION_045_048_oPCAN_RADAR_871b479d_Tx: ComSignalType=UINT8
            DET_IDM_046_oRDR_DETECTION_045_048_oPCAN_RADAR_e3fb3c63_Tx: ComSignalType=UINT8
            DET_IDM_047_oRDR_DETECTION_045_048_oPCAN_RADAR_768be8f6_Tx: ComSignalType=UINT8
            DET_IDM_048_oRDR_DETECTION_045_048_oPCAN_RADAR_5a9b7ab1_Tx: ComSignalType=UINT8
            DET_MH_CRC16_045_048_oRDR_DETECTION_045_048_oPCAN_RADAR_40e83358_Tx: ComSignalType=UINT16
            DET_MH_CYCLE_COUNTER_045_048_oRDR_DETECTION_045_048_oPCAN_RADAR_c49d926f_Tx: ComSignalType=UINT8
            DET_MH_SCAN_INDEX_4LSB_045_048_oRDR_DETECTION_045_048_oPCAN_RADAR_08b7b7e3_Tx: ComSignalType=UINT8
            DET_MTD_045_oRDR_DETECTION_045_048_oPCAN_RADAR_e1a87546_Tx: ComSignalType=UINT8
            DET_MTD_046_oRDR_DETECTION_045_048_oPCAN_RADAR_85480eb8_Tx: ComSignalType=UINT8
            DET_MTD_047_oRDR_DETECTION_045_048_oPCAN_RADAR_1038da2d_Tx: ComSignalType=UINT8
            DET_MTD_048_oRDR_DETECTION_045_048_oPCAN_RADAR_3c28486a_Tx: ComSignalType=UINT8
            DET_PROB_1STAZHYPO_045_oRDR_DETECTION_045_048_oPCAN_RADAR_721c9d8b_Tx: ComSignalType=BOOLEAN
            DET_PROB_1STAZHYPO_046_oRDR_DETECTION_045_048_oPCAN_RADAR_16fce675_Tx: ComSignalType=BOOLEAN
            DET_PROB_1STAZHYPO_047_oRDR_DETECTION_045_048_oPCAN_RADAR_838c32e0_Tx: ComSignalType=BOOLEAN
            DET_PROB_1STAZHYPO_048_oRDR_DETECTION_045_048_oPCAN_RADAR_af9ca0a7_Tx: ComSignalType=BOOLEAN
            DET_RANGE_045_oRDR_DETECTION_045_048_oPCAN_RADAR_79b37efd_Tx: ComSignalType=UINT16
            DET_RANGE_046_oRDR_DETECTION_045_048_oPCAN_RADAR_1d530503_Tx: ComSignalType=UINT16
            DET_RANGE_047_oRDR_DETECTION_045_048_oPCAN_RADAR_8823d196_Tx: ComSignalType=UINT16
            DET_RANGE_048_oRDR_DETECTION_045_048_oPCAN_RADAR_a43343d1_Tx: ComSignalType=UINT16
            DET_RANGE_ERR_045_oRDR_DETECTION_045_048_oPCAN_RADAR_de5bc494_Tx: ComSignalType=UINT8
            DET_RANGE_ERR_046_oRDR_DETECTION_045_048_oPCAN_RADAR_babbbf6a_Tx: ComSignalType=UINT8
            DET_RANGE_ERR_047_oRDR_DETECTION_045_048_oPCAN_RADAR_2fcb6bff_Tx: ComSignalType=UINT8
            DET_RANGE_ERR_048_oRDR_DETECTION_045_048_oPCAN_RADAR_03dbf9b8_Tx: ComSignalType=UINT8
            DET_RANGE_VELOCITY_045_oRDR_DETECTION_045_048_oPCAN_RADAR_0c15bcd8_Tx: ComSignalType=UINT16
            DET_RANGE_VELOCITY_046_oRDR_DETECTION_045_048_oPCAN_RADAR_68f5c726_Tx: ComSignalType=UINT16
            DET_RANGE_VELOCITY_047_oRDR_DETECTION_045_048_oPCAN_RADAR_fd8513b3_Tx: ComSignalType=UINT16
            DET_RANGE_VELOCITY_048_oRDR_DETECTION_045_048_oPCAN_RADAR_d19581f4_Tx: ComSignalType=UINT16
            DET_RANGE_VELOCITY_ERR_045_oRDR_DETECTION_045_048_oPCAN_RADAR_03ae476a_Tx: ComSignalType=UINT8
            DET_RANGE_VELOCITY_ERR_046_oRDR_DETECTION_045_048_oPCAN_RADAR_674e3c94_Tx: ComSignalType=UINT8
            DET_RANGE_VELOCITY_ERR_047_oRDR_DETECTION_045_048_oPCAN_RADAR_f23ee801_Tx: ComSignalType=UINT8
            DET_RANGE_VELOCITY_ERR_048_oRDR_DETECTION_045_048_oPCAN_RADAR_de2e7a46_Tx: ComSignalType=UINT8
            DET_RCS_045_oRDR_DETECTION_045_048_oPCAN_RADAR_8b958b82_Tx: ComSignalType=UINT8
            DET_RCS_046_oRDR_DETECTION_045_048_oPCAN_RADAR_ef75f07c_Tx: ComSignalType=UINT8
            DET_RCS_047_oRDR_DETECTION_045_048_oPCAN_RADAR_7a0524e9_Tx: ComSignalType=UINT8
            DET_RCS_048_oRDR_DETECTION_045_048_oPCAN_RADAR_5615b6ae_Tx: ComSignalType=UINT8
            DET_SNR_045_oRDR_DETECTION_045_048_oPCAN_RADAR_563bdf80_Tx: ComSignalType=UINT8
            DET_SNR_046_oRDR_DETECTION_045_048_oPCAN_RADAR_32dba47e_Tx: ComSignalType=UINT8
            DET_SNR_047_oRDR_DETECTION_045_048_oPCAN_RADAR_a7ab70eb_Tx: ComSignalType=UINT8
            DET_SNR_048_oRDR_DETECTION_045_048_oPCAN_RADAR_8bbbe2ac_Tx: ComSignalType=UINT8
            DET_SUPER_RES_TARGET_045_oRDR_DETECTION_045_048_oPCAN_RADAR_67a2f7e5_Tx: ComSignalType=BOOLEAN
            DET_SUPER_RES_TARGET_046_oRDR_DETECTION_045_048_oPCAN_RADAR_03428c1b_Tx: ComSignalType=BOOLEAN
            DET_SUPER_RES_TARGET_047_oRDR_DETECTION_045_048_oPCAN_RADAR_9632588e_Tx: ComSignalType=BOOLEAN
            DET_SUPER_RES_TARGET_048_oRDR_DETECTION_045_048_oPCAN_RADAR_ba22cac9_Tx: ComSignalType=BOOLEAN
        SG_Detections_049_052_oRDR_DETECTION_049_052_oPCAN_RADAR_5d1ac528_Tx
          83 x ComGroupSignal:
            DET_AZIMUTH_049_oRDR_DETECTION_049_052_oPCAN_RADAR_13900bfe_Tx: ComSignalType=UINT16
            DET_AZIMUTH_050_oRDR_DETECTION_049_052_oPCAN_RADAR_76b0795a_Tx: ComSignalType=UINT16
            DET_AZIMUTH_051_oRDR_DETECTION_049_052_oPCAN_RADAR_e3c0adcf_Tx: ComSignalType=UINT16
            DET_AZIMUTH_052_oRDR_DETECTION_049_052_oPCAN_RADAR_8720d631_Tx: ComSignalType=UINT16
            DET_AZIMUTH_ERR_049_oRDR_DETECTION_049_052_oPCAN_RADAR_b7259e0b_Tx: ComSignalType=UINT8
            DET_AZIMUTH_ERR_050_oRDR_DETECTION_049_052_oPCAN_RADAR_d205ecaf_Tx: ComSignalType=UINT8
            DET_AZIMUTH_ERR_051_oRDR_DETECTION_049_052_oPCAN_RADAR_4775383a_Tx: ComSignalType=UINT8
            DET_AZIMUTH_ERR_052_oRDR_DETECTION_049_052_oPCAN_RADAR_239543c4_Tx: ComSignalType=UINT8
            DET_BELOW_RAIN_THOLD_049_oRDR_DETECTION_049_052_oPCAN_RADAR_c691983e_Tx: ComSignalType=UINT8
            DET_BELOW_RAIN_THOLD_050_oRDR_DETECTION_049_052_oPCAN_RADAR_a3b1ea9a_Tx: ComSignalType=UINT8
            DET_BELOW_RAIN_THOLD_051_oRDR_DETECTION_049_052_oPCAN_RADAR_36c13e0f_Tx: ComSignalType=UINT8
            DET_BELOW_RAIN_THOLD_052_oRDR_DETECTION_049_052_oPCAN_RADAR_522145f1_Tx: ComSignalType=UINT8
            DET_BI_STATIC_FLAG_049_oRDR_DETECTION_049_052_oPCAN_RADAR_45bc4b7b_Tx: ComSignalType=BOOLEAN
            DET_BI_STATIC_FLAG_050_oRDR_DETECTION_049_052_oPCAN_RADAR_209c39df_Tx: ComSignalType=BOOLEAN
            DET_BI_STATIC_FLAG_051_oRDR_DETECTION_049_052_oPCAN_RADAR_b5eced4a_Tx: ComSignalType=BOOLEAN
            DET_BI_STATIC_FLAG_052_oRDR_DETECTION_049_052_oPCAN_RADAR_d10c96b4_Tx: ComSignalType=BOOLEAN
            DET_CONFD_AZIMUTH_049_oRDR_DETECTION_049_052_oPCAN_RADAR_11760134_Tx: ComSignalType=UINT8
            DET_CONFD_AZIMUTH_050_oRDR_DETECTION_049_052_oPCAN_RADAR_74567390_Tx: ComSignalType=UINT8
            DET_CONFD_AZIMUTH_051_oRDR_DETECTION_049_052_oPCAN_RADAR_e126a705_Tx: ComSignalType=UINT8
            DET_CONFD_AZIMUTH_052_oRDR_DETECTION_049_052_oPCAN_RADAR_85c6dcfb_Tx: ComSignalType=UINT8
            DET_CONFD_ELEVATION_049_oRDR_DETECTION_049_052_oPCAN_RADAR_13e300ce_Tx: ComSignalType=UINT8
            DET_CONFD_ELEVATION_050_oRDR_DETECTION_049_052_oPCAN_RADAR_76c3726a_Tx: ComSignalType=UINT8
            DET_CONFD_ELEVATION_051_oRDR_DETECTION_049_052_oPCAN_RADAR_e3b3a6ff_Tx: ComSignalType=UINT8
            DET_CONFD_ELEVATION_052_oRDR_DETECTION_049_052_oPCAN_RADAR_8753dd01_Tx: ComSignalType=UINT8
            DET_ELEVATION_049_oRDR_DETECTION_049_052_oPCAN_RADAR_c223d4f2_Tx: ComSignalType=UINT8
            DET_ELEVATION_050_oRDR_DETECTION_049_052_oPCAN_RADAR_a703a656_Tx: ComSignalType=UINT8
            DET_ELEVATION_051_oRDR_DETECTION_049_052_oPCAN_RADAR_327372c3_Tx: ComSignalType=UINT8
            DET_ELEVATION_052_oRDR_DETECTION_049_052_oPCAN_RADAR_5693093d_Tx: ComSignalType=UINT8
            DET_ELEVATION_ERR_049_oRDR_DETECTION_049_052_oPCAN_RADAR_451a4c87_Tx: ComSignalType=UINT8
            DET_ELEVATION_ERR_050_oRDR_DETECTION_049_052_oPCAN_RADAR_203a3e23_Tx: ComSignalType=UINT8
            DET_ELEVATION_ERR_051_oRDR_DETECTION_049_052_oPCAN_RADAR_b54aeab6_Tx: ComSignalType=UINT8
            DET_ELEVATION_ERR_052_oRDR_DETECTION_049_052_oPCAN_RADAR_d1aa9148_Tx: ComSignalType=UINT8
            DET_EXISTENCE_PROB_049_oRDR_DETECTION_049_052_oPCAN_RADAR_978539e7_Tx: ComSignalType=UINT8
            DET_EXISTENCE_PROB_050_oRDR_DETECTION_049_052_oPCAN_RADAR_f2a54b43_Tx: ComSignalType=UINT8
            DET_EXISTENCE_PROB_051_oRDR_DETECTION_049_052_oPCAN_RADAR_67d59fd6_Tx: ComSignalType=UINT8
            DET_EXISTENCE_PROB_052_oRDR_DETECTION_049_052_oPCAN_RADAR_0335e428_Tx: ComSignalType=UINT8
            DET_HVC_FLAG_049_oRDR_DETECTION_049_052_oPCAN_RADAR_76f17a98_Tx: ComSignalType=BOOLEAN
            DET_HVC_FLAG_050_oRDR_DETECTION_049_052_oPCAN_RADAR_13d1083c_Tx: ComSignalType=BOOLEAN
            DET_HVC_FLAG_051_oRDR_DETECTION_049_052_oPCAN_RADAR_86a1dca9_Tx: ComSignalType=BOOLEAN
            DET_HVC_FLAG_052_oRDR_DETECTION_049_052_oPCAN_RADAR_e241a757_Tx: ComSignalType=BOOLEAN
            DET_IDM_049_oRDR_DETECTION_049_052_oPCAN_RADAR_fda34125_Tx: ComSignalType=UINT8
            DET_IDM_050_oRDR_DETECTION_049_052_oPCAN_RADAR_98833381_Tx: ComSignalType=UINT8
            DET_IDM_051_oRDR_DETECTION_049_052_oPCAN_RADAR_0df3e714_Tx: ComSignalType=UINT8
            DET_IDM_052_oRDR_DETECTION_049_052_oPCAN_RADAR_69139cea_Tx: ComSignalType=UINT8
            DET_MH_CRC16_049_052_oRDR_DETECTION_049_052_oPCAN_RADAR_d9921723_Tx: ComSignalType=UINT16
            DET_MH_CYCLE_COUNTER_049_052_oRDR_DETECTION_049_052_oPCAN_RADAR_5de7b614_Tx: ComSignalType=UINT8
            DET_MH_SCAN_INDEX_4LSB_049_052_oRDR_DETECTION_049_052_oPCAN_RADAR_91cd9398_Tx: ComSignalType=UINT8
            DET_MTD_049_oRDR_DETECTION_049_052_oPCAN_RADAR_9b1073fe_Tx: ComSignalType=UINT8
            DET_MTD_050_oRDR_DETECTION_049_052_oPCAN_RADAR_fe30015a_Tx: ComSignalType=UINT8
            DET_MTD_051_oRDR_DETECTION_049_052_oPCAN_RADAR_6b40d5cf_Tx: ComSignalType=UINT8
            DET_MTD_052_oRDR_DETECTION_049_052_oPCAN_RADAR_0fa0ae31_Tx: ComSignalType=UINT8
            DET_PROB_1STAZHYPO_049_oRDR_DETECTION_049_052_oPCAN_RADAR_08a49b33_Tx: ComSignalType=BOOLEAN
            DET_PROB_1STAZHYPO_050_oRDR_DETECTION_049_052_oPCAN_RADAR_6d84e997_Tx: ComSignalType=BOOLEAN
            DET_PROB_1STAZHYPO_051_oRDR_DETECTION_049_052_oPCAN_RADAR_f8f43d02_Tx: ComSignalType=BOOLEAN
            DET_PROB_1STAZHYPO_052_oRDR_DETECTION_049_052_oPCAN_RADAR_9c1446fc_Tx: ComSignalType=BOOLEAN
            DET_RANGE_049_oRDR_DETECTION_049_052_oPCAN_RADAR_030b7845_Tx: ComSignalType=UINT16
            DET_RANGE_050_oRDR_DETECTION_049_052_oPCAN_RADAR_662b0ae1_Tx: ComSignalType=UINT16
            DET_RANGE_051_oRDR_DETECTION_049_052_oPCAN_RADAR_f35bde74_Tx: ComSignalType=UINT16
            DET_RANGE_052_oRDR_DETECTION_049_052_oPCAN_RADAR_97bba58a_Tx: ComSignalType=UINT16
            DET_RANGE_ERR_049_oRDR_DETECTION_049_052_oPCAN_RADAR_a4e3c22c_Tx: ComSignalType=UINT8
            DET_RANGE_ERR_050_oRDR_DETECTION_049_052_oPCAN_RADAR_c1c3b088_Tx: ComSignalType=UINT8
            DET_RANGE_ERR_051_oRDR_DETECTION_049_052_oPCAN_RADAR_54b3641d_Tx: ComSignalType=UINT8
            DET_RANGE_ERR_052_oRDR_DETECTION_049_052_oPCAN_RADAR_30531fe3_Tx: ComSignalType=UINT8
            DET_RANGE_VELOCITY_049_oRDR_DETECTION_049_052_oPCAN_RADAR_76adba60_Tx: ComSignalType=UINT16
            DET_RANGE_VELOCITY_050_oRDR_DETECTION_049_052_oPCAN_RADAR_138dc8c4_Tx: ComSignalType=UINT16
            DET_RANGE_VELOCITY_051_oRDR_DETECTION_049_052_oPCAN_RADAR_86fd1c51_Tx: ComSignalType=UINT16
            DET_RANGE_VELOCITY_052_oRDR_DETECTION_049_052_oPCAN_RADAR_e21d67af_Tx: ComSignalType=UINT16
            DET_RANGE_VELOCITY_ERR_049_oRDR_DETECTION_049_052_oPCAN_RADAR_791641d2_Tx: ComSignalType=UINT8
            DET_RANGE_VELOCITY_ERR_050_oRDR_DETECTION_049_052_oPCAN_RADAR_1c363376_Tx: ComSignalType=UINT8
            DET_RANGE_VELOCITY_ERR_051_oRDR_DETECTION_049_052_oPCAN_RADAR_8946e7e3_Tx: ComSignalType=UINT8
            DET_RANGE_VELOCITY_ERR_052_oRDR_DETECTION_049_052_oPCAN_RADAR_eda69c1d_Tx: ComSignalType=UINT8
            DET_RCS_049_oRDR_DETECTION_049_052_oPCAN_RADAR_f12d8d3a_Tx: ComSignalType=UINT8
            DET_RCS_050_oRDR_DETECTION_049_052_oPCAN_RADAR_940dff9e_Tx: ComSignalType=UINT8
            DET_RCS_051_oRDR_DETECTION_049_052_oPCAN_RADAR_017d2b0b_Tx: ComSignalType=UINT8
            DET_RCS_052_oRDR_DETECTION_049_052_oPCAN_RADAR_659d50f5_Tx: ComSignalType=UINT8
            DET_SNR_049_oRDR_DETECTION_049_052_oPCAN_RADAR_2c83d938_Tx: ComSignalType=UINT8
            DET_SNR_050_oRDR_DETECTION_049_052_oPCAN_RADAR_49a3ab9c_Tx: ComSignalType=UINT8
            DET_SNR_051_oRDR_DETECTION_049_052_oPCAN_RADAR_dcd37f09_Tx: ComSignalType=UINT8
            DET_SNR_052_oRDR_DETECTION_049_052_oPCAN_RADAR_b83304f7_Tx: ComSignalType=UINT8
            DET_SUPER_RES_TARGET_049_oRDR_DETECTION_049_052_oPCAN_RADAR_1d1af15d_Tx: ComSignalType=BOOLEAN
            DET_SUPER_RES_TARGET_050_oRDR_DETECTION_049_052_oPCAN_RADAR_783a83f9_Tx: ComSignalType=BOOLEAN
            DET_SUPER_RES_TARGET_051_oRDR_DETECTION_049_052_oPCAN_RADAR_ed4a576c_Tx: ComSignalType=BOOLEAN
            DET_SUPER_RES_TARGET_052_oRDR_DETECTION_049_052_oPCAN_RADAR_89aa2c92_Tx: ComSignalType=BOOLEAN
        SG_Detections_053_056_oRDR_DETECTION_053_056_oPCAN_RADAR_6f11ad00_Tx
          83 x ComGroupSignal:
            DET_AZIMUTH_053_oRDR_DETECTION_053_056_oPCAN_RADAR_0f97018a_Tx: ComSignalType=UINT16
            DET_AZIMUTH_054_oRDR_DETECTION_053_056_oPCAN_RADAR_532722e3_Tx: ComSignalType=UINT16
            DET_AZIMUTH_055_oRDR_DETECTION_053_056_oPCAN_RADAR_c657f676_Tx: ComSignalType=UINT16
            DET_AZIMUTH_056_oRDR_DETECTION_053_056_oPCAN_RADAR_a2b78d88_Tx: ComSignalType=UINT16
            DET_AZIMUTH_ERR_053_oRDR_DETECTION_053_056_oPCAN_RADAR_ab22947f_Tx: ComSignalType=UINT8
            DET_AZIMUTH_ERR_054_oRDR_DETECTION_053_056_oPCAN_RADAR_f792b716_Tx: ComSignalType=UINT8
            DET_AZIMUTH_ERR_055_oRDR_DETECTION_053_056_oPCAN_RADAR_62e26383_Tx: ComSignalType=UINT8
            DET_AZIMUTH_ERR_056_oRDR_DETECTION_053_056_oPCAN_RADAR_0602187d_Tx: ComSignalType=UINT8
            DET_BELOW_RAIN_THOLD_053_oRDR_DETECTION_053_056_oPCAN_RADAR_da96924a_Tx: ComSignalType=UINT8
            DET_BELOW_RAIN_THOLD_054_oRDR_DETECTION_053_056_oPCAN_RADAR_8626b123_Tx: ComSignalType=UINT8
            DET_BELOW_RAIN_THOLD_055_oRDR_DETECTION_053_056_oPCAN_RADAR_135665b6_Tx: ComSignalType=UINT8
            DET_BELOW_RAIN_THOLD_056_oRDR_DETECTION_053_056_oPCAN_RADAR_77b61e48_Tx: ComSignalType=UINT8
            DET_BI_STATIC_FLAG_053_oRDR_DETECTION_053_056_oPCAN_RADAR_59bb410f_Tx: ComSignalType=BOOLEAN
            DET_BI_STATIC_FLAG_054_oRDR_DETECTION_053_056_oPCAN_RADAR_050b6266_Tx: ComSignalType=BOOLEAN
            DET_BI_STATIC_FLAG_055_oRDR_DETECTION_053_056_oPCAN_RADAR_907bb6f3_Tx: ComSignalType=BOOLEAN
            DET_BI_STATIC_FLAG_056_oRDR_DETECTION_053_056_oPCAN_RADAR_f49bcd0d_Tx: ComSignalType=BOOLEAN
            DET_CONFD_AZIMUTH_053_oRDR_DETECTION_053_056_oPCAN_RADAR_0d710b40_Tx: ComSignalType=UINT8
            DET_CONFD_AZIMUTH_054_oRDR_DETECTION_053_056_oPCAN_RADAR_51c12829_Tx: ComSignalType=UINT8
            DET_CONFD_AZIMUTH_055_oRDR_DETECTION_053_056_oPCAN_RADAR_c4b1fcbc_Tx: ComSignalType=UINT8
            DET_CONFD_AZIMUTH_056_oRDR_DETECTION_053_056_oPCAN_RADAR_a0518742_Tx: ComSignalType=UINT8
            DET_CONFD_ELEVATION_053_oRDR_DETECTION_053_056_oPCAN_RADAR_0fe40aba_Tx: ComSignalType=UINT8
            DET_CONFD_ELEVATION_054_oRDR_DETECTION_053_056_oPCAN_RADAR_535429d3_Tx: ComSignalType=UINT8
            DET_CONFD_ELEVATION_055_oRDR_DETECTION_053_056_oPCAN_RADAR_c624fd46_Tx: ComSignalType=UINT8
            DET_CONFD_ELEVATION_056_oRDR_DETECTION_053_056_oPCAN_RADAR_a2c486b8_Tx: ComSignalType=UINT8
            DET_ELEVATION_053_oRDR_DETECTION_053_056_oPCAN_RADAR_de24de86_Tx: ComSignalType=UINT8
            DET_ELEVATION_054_oRDR_DETECTION_053_056_oPCAN_RADAR_8294fdef_Tx: ComSignalType=UINT8
            DET_ELEVATION_055_oRDR_DETECTION_053_056_oPCAN_RADAR_17e4297a_Tx: ComSignalType=UINT8
            DET_ELEVATION_056_oRDR_DETECTION_053_056_oPCAN_RADAR_73045284_Tx: ComSignalType=UINT8
            DET_ELEVATION_ERR_053_oRDR_DETECTION_053_056_oPCAN_RADAR_591d46f3_Tx: ComSignalType=UINT8
            DET_ELEVATION_ERR_054_oRDR_DETECTION_053_056_oPCAN_RADAR_05ad659a_Tx: ComSignalType=UINT8
            DET_ELEVATION_ERR_055_oRDR_DETECTION_053_056_oPCAN_RADAR_90ddb10f_Tx: ComSignalType=UINT8
            DET_ELEVATION_ERR_056_oRDR_DETECTION_053_056_oPCAN_RADAR_f43dcaf1_Tx: ComSignalType=UINT8
            DET_EXISTENCE_PROB_053_oRDR_DETECTION_053_056_oPCAN_RADAR_8b823393_Tx: ComSignalType=UINT8
            DET_EXISTENCE_PROB_054_oRDR_DETECTION_053_056_oPCAN_RADAR_d73210fa_Tx: ComSignalType=UINT8
            DET_EXISTENCE_PROB_055_oRDR_DETECTION_053_056_oPCAN_RADAR_4242c46f_Tx: ComSignalType=UINT8
            DET_EXISTENCE_PROB_056_oRDR_DETECTION_053_056_oPCAN_RADAR_26a2bf91_Tx: ComSignalType=UINT8
            DET_HVC_FLAG_053_oRDR_DETECTION_053_056_oPCAN_RADAR_6af670ec_Tx: ComSignalType=BOOLEAN
            DET_HVC_FLAG_054_oRDR_DETECTION_053_056_oPCAN_RADAR_36465385_Tx: ComSignalType=BOOLEAN
            DET_HVC_FLAG_055_oRDR_DETECTION_053_056_oPCAN_RADAR_a3368710_Tx: ComSignalType=BOOLEAN
            DET_HVC_FLAG_056_oRDR_DETECTION_053_056_oPCAN_RADAR_c7d6fcee_Tx: ComSignalType=BOOLEAN
            DET_IDM_053_oRDR_DETECTION_053_056_oPCAN_RADAR_e1a44b51_Tx: ComSignalType=UINT8
            DET_IDM_054_oRDR_DETECTION_053_056_oPCAN_RADAR_bd146838_Tx: ComSignalType=UINT8
            DET_IDM_055_oRDR_DETECTION_053_056_oPCAN_RADAR_2864bcad_Tx: ComSignalType=UINT8
            DET_IDM_056_oRDR_DETECTION_053_056_oPCAN_RADAR_4c84c753_Tx: ComSignalType=UINT8
            DET_MH_CRC16_053_056_oRDR_DETECTION_053_056_oPCAN_RADAR_eb997f0b_Tx: ComSignalType=UINT16
            DET_MH_CYCLE_COUNTER_053_056_oRDR_DETECTION_053_056_oPCAN_RADAR_6fecde3c_Tx: ComSignalType=UINT8
            DET_MH_SCAN_INDEX_4LSB_053_056_oRDR_DETECTION_053_056_oPCAN_RADAR_a3c6fbb0_Tx: ComSignalType=UINT8
            DET_MTD_053_oRDR_DETECTION_053_056_oPCAN_RADAR_8717798a_Tx: ComSignalType=UINT8
            DET_MTD_054_oRDR_DETECTION_053_056_oPCAN_RADAR_dba75ae3_Tx: ComSignalType=UINT8
            DET_MTD_055_oRDR_DETECTION_053_056_oPCAN_RADAR_4ed78e76_Tx: ComSignalType=UINT8
            DET_MTD_056_oRDR_DETECTION_053_056_oPCAN_RADAR_2a37f588_Tx: ComSignalType=UINT8
            DET_PROB_1STAZHYPO_053_oRDR_DETECTION_053_056_oPCAN_RADAR_14a39147_Tx: ComSignalType=BOOLEAN
            DET_PROB_1STAZHYPO_054_oRDR_DETECTION_053_056_oPCAN_RADAR_4813b22e_Tx: ComSignalType=BOOLEAN
            DET_PROB_1STAZHYPO_055_oRDR_DETECTION_053_056_oPCAN_RADAR_dd6366bb_Tx: ComSignalType=BOOLEAN
            DET_PROB_1STAZHYPO_056_oRDR_DETECTION_053_056_oPCAN_RADAR_b9831d45_Tx: ComSignalType=BOOLEAN
            DET_RANGE_053_oRDR_DETECTION_053_056_oPCAN_RADAR_1f0c7231_Tx: ComSignalType=UINT16
            DET_RANGE_054_oRDR_DETECTION_053_056_oPCAN_RADAR_43bc5158_Tx: ComSignalType=UINT16
            DET_RANGE_055_oRDR_DETECTION_053_056_oPCAN_RADAR_d6cc85cd_Tx: ComSignalType=UINT16
            DET_RANGE_056_oRDR_DETECTION_053_056_oPCAN_RADAR_b22cfe33_Tx: ComSignalType=UINT16
            DET_RANGE_ERR_053_oRDR_DETECTION_053_056_oPCAN_RADAR_b8e4c858_Tx: ComSignalType=UINT8
            DET_RANGE_ERR_054_oRDR_DETECTION_053_056_oPCAN_RADAR_e454eb31_Tx: ComSignalType=UINT8
            DET_RANGE_ERR_055_oRDR_DETECTION_053_056_oPCAN_RADAR_71243fa4_Tx: ComSignalType=UINT8
            DET_RANGE_ERR_056_oRDR_DETECTION_053_056_oPCAN_RADAR_15c4445a_Tx: ComSignalType=UINT8
            DET_RANGE_VELOCITY_053_oRDR_DETECTION_053_056_oPCAN_RADAR_6aaab014_Tx: ComSignalType=UINT16
            DET_RANGE_VELOCITY_054_oRDR_DETECTION_053_056_oPCAN_RADAR_361a937d_Tx: ComSignalType=UINT16
            DET_RANGE_VELOCITY_055_oRDR_DETECTION_053_056_oPCAN_RADAR_a36a47e8_Tx: ComSignalType=UINT16
            DET_RANGE_VELOCITY_056_oRDR_DETECTION_053_056_oPCAN_RADAR_c78a3c16_Tx: ComSignalType=UINT16
            DET_RANGE_VELOCITY_ERR_053_oRDR_DETECTION_053_056_oPCAN_RADAR_65114ba6_Tx: ComSignalType=UINT8
            DET_RANGE_VELOCITY_ERR_054_oRDR_DETECTION_053_056_oPCAN_RADAR_39a168cf_Tx: ComSignalType=UINT8
            DET_RANGE_VELOCITY_ERR_055_oRDR_DETECTION_053_056_oPCAN_RADAR_acd1bc5a_Tx: ComSignalType=UINT8
            DET_RANGE_VELOCITY_ERR_056_oRDR_DETECTION_053_056_oPCAN_RADAR_c831c7a4_Tx: ComSignalType=UINT8
            DET_RCS_053_oRDR_DETECTION_053_056_oPCAN_RADAR_ed2a874e_Tx: ComSignalType=UINT8
            DET_RCS_054_oRDR_DETECTION_053_056_oPCAN_RADAR_b19aa427_Tx: ComSignalType=UINT8
            DET_RCS_055_oRDR_DETECTION_053_056_oPCAN_RADAR_24ea70b2_Tx: ComSignalType=UINT8
            DET_RCS_056_oRDR_DETECTION_053_056_oPCAN_RADAR_400a0b4c_Tx: ComSignalType=UINT8
            DET_SNR_053_oRDR_DETECTION_053_056_oPCAN_RADAR_3084d34c_Tx: ComSignalType=UINT8
            DET_SNR_054_oRDR_DETECTION_053_056_oPCAN_RADAR_6c34f025_Tx: ComSignalType=UINT8
            DET_SNR_055_oRDR_DETECTION_053_056_oPCAN_RADAR_f94424b0_Tx: ComSignalType=UINT8
            DET_SNR_056_oRDR_DETECTION_053_056_oPCAN_RADAR_9da45f4e_Tx: ComSignalType=UINT8
            DET_SUPER_RES_TARGET_053_oRDR_DETECTION_053_056_oPCAN_RADAR_011dfb29_Tx: ComSignalType=BOOLEAN
            DET_SUPER_RES_TARGET_054_oRDR_DETECTION_053_056_oPCAN_RADAR_5dadd840_Tx: ComSignalType=BOOLEAN
            DET_SUPER_RES_TARGET_055_oRDR_DETECTION_053_056_oPCAN_RADAR_c8dd0cd5_Tx: ComSignalType=BOOLEAN
            DET_SUPER_RES_TARGET_056_oRDR_DETECTION_053_056_oPCAN_RADAR_ac3d772b_Tx: ComSignalType=BOOLEAN
        SG_Detections_057_060_oRDR_DETECTION_057_060_oPCAN_RADAR_83bdfb8a_Tx
          83 x ComGroupSignal:
            DET_AZIMUTH_057_oRDR_DETECTION_057_060_oPCAN_RADAR_984b84d4_Tx: ComSignalType=UINT16
            DET_AZIMUTH_058_oRDR_DETECTION_057_060_oPCAN_RADAR_b45b1693_Tx: ComSignalType=UINT16
            DET_AZIMUTH_059_oRDR_DETECTION_057_060_oPCAN_RADAR_212bc206_Tx: ComSignalType=UINT16
            DET_AZIMUTH_060_oRDR_DETECTION_057_060_oPCAN_RADAR_9e9a98dd_Tx: ComSignalType=UINT16
            DET_AZIMUTH_ERR_057_oRDR_DETECTION_057_060_oPCAN_RADAR_3cfe1121_Tx: ComSignalType=UINT8
            DET_AZIMUTH_ERR_058_oRDR_DETECTION_057_060_oPCAN_RADAR_10ee8366_Tx: ComSignalType=UINT8
            DET_AZIMUTH_ERR_059_oRDR_DETECTION_057_060_oPCAN_RADAR_859e57f3_Tx: ComSignalType=UINT8
            DET_AZIMUTH_ERR_060_oRDR_DETECTION_057_060_oPCAN_RADAR_3a2f0d28_Tx: ComSignalType=UINT8
            DET_BELOW_RAIN_THOLD_057_oRDR_DETECTION_057_060_oPCAN_RADAR_4d4a1714_Tx: ComSignalType=UINT8
            DET_BELOW_RAIN_THOLD_058_oRDR_DETECTION_057_060_oPCAN_RADAR_615a8553_Tx: ComSignalType=UINT8
            DET_BELOW_RAIN_THOLD_059_oRDR_DETECTION_057_060_oPCAN_RADAR_f42a51c6_Tx: ComSignalType=UINT8
            DET_BELOW_RAIN_THOLD_060_oRDR_DETECTION_057_060_oPCAN_RADAR_4b9b0b1d_Tx: ComSignalType=UINT8
            DET_BI_STATIC_FLAG_057_oRDR_DETECTION_057_060_oPCAN_RADAR_ce67c451_Tx: ComSignalType=BOOLEAN
            DET_BI_STATIC_FLAG_058_oRDR_DETECTION_057_060_oPCAN_RADAR_e2775616_Tx: ComSignalType=BOOLEAN
            DET_BI_STATIC_FLAG_059_oRDR_DETECTION_057_060_oPCAN_RADAR_77078283_Tx: ComSignalType=BOOLEAN
            DET_BI_STATIC_FLAG_060_oRDR_DETECTION_057_060_oPCAN_RADAR_c8b6d858_Tx: ComSignalType=BOOLEAN
            DET_CONFD_AZIMUTH_057_oRDR_DETECTION_057_060_oPCAN_RADAR_9aad8e1e_Tx: ComSignalType=UINT8
            DET_CONFD_AZIMUTH_058_oRDR_DETECTION_057_060_oPCAN_RADAR_b6bd1c59_Tx: ComSignalType=UINT8
            DET_CONFD_AZIMUTH_059_oRDR_DETECTION_057_060_oPCAN_RADAR_23cdc8cc_Tx: ComSignalType=UINT8
            DET_CONFD_AZIMUTH_060_oRDR_DETECTION_057_060_oPCAN_RADAR_9c7c9217_Tx: ComSignalType=UINT8
            DET_CONFD_ELEVATION_057_oRDR_DETECTION_057_060_oPCAN_RADAR_98388fe4_Tx: ComSignalType=UINT8
            DET_CONFD_ELEVATION_058_oRDR_DETECTION_057_060_oPCAN_RADAR_b4281da3_Tx: ComSignalType=UINT8
            DET_CONFD_ELEVATION_059_oRDR_DETECTION_057_060_oPCAN_RADAR_2158c936_Tx: ComSignalType=UINT8
            DET_CONFD_ELEVATION_060_oRDR_DETECTION_057_060_oPCAN_RADAR_9ee993ed_Tx: ComSignalType=UINT8
            DET_ELEVATION_057_oRDR_DETECTION_057_060_oPCAN_RADAR_49f85bd8_Tx: ComSignalType=UINT8
            DET_ELEVATION_058_oRDR_DETECTION_057_060_oPCAN_RADAR_65e8c99f_Tx: ComSignalType=UINT8
            DET_ELEVATION_059_oRDR_DETECTION_057_060_oPCAN_RADAR_f0981d0a_Tx: ComSignalType=UINT8
            DET_ELEVATION_060_oRDR_DETECTION_057_060_oPCAN_RADAR_4f2947d1_Tx: ComSignalType=UINT8
            DET_ELEVATION_ERR_057_oRDR_DETECTION_057_060_oPCAN_RADAR_cec1c3ad_Tx: ComSignalType=UINT8
            DET_ELEVATION_ERR_058_oRDR_DETECTION_057_060_oPCAN_RADAR_e2d151ea_Tx: ComSignalType=UINT8
            DET_ELEVATION_ERR_059_oRDR_DETECTION_057_060_oPCAN_RADAR_77a1857f_Tx: ComSignalType=UINT8
            DET_ELEVATION_ERR_060_oRDR_DETECTION_057_060_oPCAN_RADAR_c810dfa4_Tx: ComSignalType=UINT8
            DET_EXISTENCE_PROB_057_oRDR_DETECTION_057_060_oPCAN_RADAR_1c5eb6cd_Tx: ComSignalType=UINT8
            DET_EXISTENCE_PROB_058_oRDR_DETECTION_057_060_oPCAN_RADAR_304e248a_Tx: ComSignalType=UINT8
            DET_EXISTENCE_PROB_059_oRDR_DETECTION_057_060_oPCAN_RADAR_a53ef01f_Tx: ComSignalType=UINT8
            DET_EXISTENCE_PROB_060_oRDR_DETECTION_057_060_oPCAN_RADAR_1a8faac4_Tx: ComSignalType=UINT8
            DET_HVC_FLAG_057_oRDR_DETECTION_057_060_oPCAN_RADAR_fd2af5b2_Tx: ComSignalType=BOOLEAN
            DET_HVC_FLAG_058_oRDR_DETECTION_057_060_oPCAN_RADAR_d13a67f5_Tx: ComSignalType=BOOLEAN
            DET_HVC_FLAG_059_oRDR_DETECTION_057_060_oPCAN_RADAR_444ab360_Tx: ComSignalType=BOOLEAN
            DET_HVC_FLAG_060_oRDR_DETECTION_057_060_oPCAN_RADAR_fbfbe9bb_Tx: ComSignalType=BOOLEAN
            DET_IDM_057_oRDR_DETECTION_057_060_oPCAN_RADAR_7678ce0f_Tx: ComSignalType=UINT8
            DET_IDM_058_oRDR_DETECTION_057_060_oPCAN_RADAR_5a685c48_Tx: ComSignalType=UINT8
            DET_IDM_059_oRDR_DETECTION_057_060_oPCAN_RADAR_cf1888dd_Tx: ComSignalType=UINT8
            DET_IDM_060_oRDR_DETECTION_057_060_oPCAN_RADAR_70a9d206_Tx: ComSignalType=UINT8
            DET_MH_CRC16_057_060_oRDR_DETECTION_057_060_oPCAN_RADAR_07352981_Tx: ComSignalType=UINT16
            DET_MH_CYCLE_COUNTER_057_060_oRDR_DETECTION_057_060_oPCAN_RADAR_834088b6_Tx: ComSignalType=UINT8
            DET_MH_SCAN_INDEX_4LSB_057_060_oRDR_DETECTION_057_060_oPCAN_RADAR_4f6aad3a_Tx: ComSignalType=UINT8
            DET_MTD_057_oRDR_DETECTION_057_060_oPCAN_RADAR_10cbfcd4_Tx: ComSignalType=UINT8
            DET_MTD_058_oRDR_DETECTION_057_060_oPCAN_RADAR_3cdb6e93_Tx: ComSignalType=UINT8
            DET_MTD_059_oRDR_DETECTION_057_060_oPCAN_RADAR_a9abba06_Tx: ComSignalType=UINT8
            DET_MTD_060_oRDR_DETECTION_057_060_oPCAN_RADAR_161ae0dd_Tx: ComSignalType=UINT8
            DET_PROB_1STAZHYPO_057_oRDR_DETECTION_057_060_oPCAN_RADAR_837f1419_Tx: ComSignalType=BOOLEAN
            DET_PROB_1STAZHYPO_058_oRDR_DETECTION_057_060_oPCAN_RADAR_af6f865e_Tx: ComSignalType=BOOLEAN
            DET_PROB_1STAZHYPO_059_oRDR_DETECTION_057_060_oPCAN_RADAR_3a1f52cb_Tx: ComSignalType=BOOLEAN
            DET_PROB_1STAZHYPO_060_oRDR_DETECTION_057_060_oPCAN_RADAR_85ae0810_Tx: ComSignalType=BOOLEAN
            DET_RANGE_057_oRDR_DETECTION_057_060_oPCAN_RADAR_88d0f76f_Tx: ComSignalType=UINT16
            DET_RANGE_058_oRDR_DETECTION_057_060_oPCAN_RADAR_a4c06528_Tx: ComSignalType=UINT16
            DET_RANGE_059_oRDR_DETECTION_057_060_oPCAN_RADAR_31b0b1bd_Tx: ComSignalType=UINT16
            DET_RANGE_060_oRDR_DETECTION_057_060_oPCAN_RADAR_8e01eb66_Tx: ComSignalType=UINT16
            DET_RANGE_ERR_057_oRDR_DETECTION_057_060_oPCAN_RADAR_2f384d06_Tx: ComSignalType=UINT8
            DET_RANGE_ERR_058_oRDR_DETECTION_057_060_oPCAN_RADAR_0328df41_Tx: ComSignalType=UINT8
            DET_RANGE_ERR_059_oRDR_DETECTION_057_060_oPCAN_RADAR_96580bd4_Tx: ComSignalType=UINT8
            DET_RANGE_ERR_060_oRDR_DETECTION_057_060_oPCAN_RADAR_29e9510f_Tx: ComSignalType=UINT8
            DET_RANGE_VELOCITY_057_oRDR_DETECTION_057_060_oPCAN_RADAR_fd76354a_Tx: ComSignalType=UINT16
            DET_RANGE_VELOCITY_058_oRDR_DETECTION_057_060_oPCAN_RADAR_d166a70d_Tx: ComSignalType=UINT16
            DET_RANGE_VELOCITY_059_oRDR_DETECTION_057_060_oPCAN_RADAR_44167398_Tx: ComSignalType=UINT16
            DET_RANGE_VELOCITY_060_oRDR_DETECTION_057_060_oPCAN_RADAR_fba72943_Tx: ComSignalType=UINT16
            DET_RANGE_VELOCITY_ERR_057_oRDR_DETECTION_057_060_oPCAN_RADAR_f2cdcef8_Tx: ComSignalType=UINT8
            DET_RANGE_VELOCITY_ERR_058_oRDR_DETECTION_057_060_oPCAN_RADAR_dedd5cbf_Tx: ComSignalType=UINT8
            DET_RANGE_VELOCITY_ERR_059_oRDR_DETECTION_057_060_oPCAN_RADAR_4bad882a_Tx: ComSignalType=UINT8
            DET_RANGE_VELOCITY_ERR_060_oRDR_DETECTION_057_060_oPCAN_RADAR_f41cd2f1_Tx: ComSignalType=UINT8
            DET_RCS_057_oRDR_DETECTION_057_060_oPCAN_RADAR_7af60210_Tx: ComSignalType=UINT8
            DET_RCS_058_oRDR_DETECTION_057_060_oPCAN_RADAR_56e69057_Tx: ComSignalType=UINT8
            DET_RCS_059_oRDR_DETECTION_057_060_oPCAN_RADAR_c39644c2_Tx: ComSignalType=UINT8
            DET_RCS_060_oRDR_DETECTION_057_060_oPCAN_RADAR_7c271e19_Tx: ComSignalType=UINT8
            DET_SNR_057_oRDR_DETECTION_057_060_oPCAN_RADAR_a7585612_Tx: ComSignalType=UINT8
            DET_SNR_058_oRDR_DETECTION_057_060_oPCAN_RADAR_8b48c455_Tx: ComSignalType=UINT8
            DET_SNR_059_oRDR_DETECTION_057_060_oPCAN_RADAR_1e3810c0_Tx: ComSignalType=UINT8
            DET_SNR_060_oRDR_DETECTION_057_060_oPCAN_RADAR_a1894a1b_Tx: ComSignalType=UINT8
            DET_SUPER_RES_TARGET_057_oRDR_DETECTION_057_060_oPCAN_RADAR_96c17e77_Tx: ComSignalType=BOOLEAN
            DET_SUPER_RES_TARGET_058_oRDR_DETECTION_057_060_oPCAN_RADAR_bad1ec30_Tx: ComSignalType=BOOLEAN
            DET_SUPER_RES_TARGET_059_oRDR_DETECTION_057_060_oPCAN_RADAR_2fa138a5_Tx: ComSignalType=BOOLEAN
            DET_SUPER_RES_TARGET_060_oRDR_DETECTION_057_060_oPCAN_RADAR_9010627e_Tx: ComSignalType=BOOLEAN
        SG_Detections_061_064_oRDR_DETECTION_061_064_oPCAN_RADAR_80d67553_Tx
          83 x ComGroupSignal:
            DET_AZIMUTH_061_oRDR_DETECTION_061_064_oPCAN_RADAR_86e14cb4_Tx: ComSignalType=UINT16
            DET_AZIMUTH_062_oRDR_DETECTION_061_064_oPCAN_RADAR_e201374a_Tx: ComSignalType=UINT16
            DET_AZIMUTH_063_oRDR_DETECTION_061_064_oPCAN_RADAR_7771e3df_Tx: ComSignalType=UINT16
            DET_AZIMUTH_064_oRDR_DETECTION_061_064_oPCAN_RADAR_2bc1c0b6_Tx: ComSignalType=UINT16
            DET_AZIMUTH_ERR_061_oRDR_DETECTION_061_064_oPCAN_RADAR_2254d941_Tx: ComSignalType=UINT8
            DET_AZIMUTH_ERR_062_oRDR_DETECTION_061_064_oPCAN_RADAR_46b4a2bf_Tx: ComSignalType=UINT8
            DET_AZIMUTH_ERR_063_oRDR_DETECTION_061_064_oPCAN_RADAR_d3c4762a_Tx: ComSignalType=UINT8
            DET_AZIMUTH_ERR_064_oRDR_DETECTION_061_064_oPCAN_RADAR_8f745543_Tx: ComSignalType=UINT8
            DET_BELOW_RAIN_THOLD_061_oRDR_DETECTION_061_064_oPCAN_RADAR_53e0df74_Tx: ComSignalType=UINT8
            DET_BELOW_RAIN_THOLD_062_oRDR_DETECTION_061_064_oPCAN_RADAR_3700a48a_Tx: ComSignalType=UINT8
            DET_BELOW_RAIN_THOLD_063_oRDR_DETECTION_061_064_oPCAN_RADAR_a270701f_Tx: ComSignalType=UINT8
            DET_BELOW_RAIN_THOLD_064_oRDR_DETECTION_061_064_oPCAN_RADAR_fec05376_Tx: ComSignalType=UINT8
            DET_BI_STATIC_FLAG_061_oRDR_DETECTION_061_064_oPCAN_RADAR_d0cd0c31_Tx: ComSignalType=BOOLEAN
            DET_BI_STATIC_FLAG_062_oRDR_DETECTION_061_064_oPCAN_RADAR_b42d77cf_Tx: ComSignalType=BOOLEAN
            DET_BI_STATIC_FLAG_063_oRDR_DETECTION_061_064_oPCAN_RADAR_215da35a_Tx: ComSignalType=BOOLEAN
            DET_BI_STATIC_FLAG_064_oRDR_DETECTION_061_064_oPCAN_RADAR_7ded8033_Tx: ComSignalType=BOOLEAN
            DET_CONFD_AZIMUTH_061_oRDR_DETECTION_061_064_oPCAN_RADAR_8407467e_Tx: ComSignalType=UINT8
            DET_CONFD_AZIMUTH_062_oRDR_DETECTION_061_064_oPCAN_RADAR_e0e73d80_Tx: ComSignalType=UINT8
            DET_CONFD_AZIMUTH_063_oRDR_DETECTION_061_064_oPCAN_RADAR_7597e915_Tx: ComSignalType=UINT8
            DET_CONFD_AZIMUTH_064_oRDR_DETECTION_061_064_oPCAN_RADAR_2927ca7c_Tx: ComSignalType=UINT8
            DET_CONFD_ELEVATION_061_oRDR_DETECTION_061_064_oPCAN_RADAR_86924784_Tx: ComSignalType=UINT8
            DET_CONFD_ELEVATION_062_oRDR_DETECTION_061_064_oPCAN_RADAR_e2723c7a_Tx: ComSignalType=UINT8
            DET_CONFD_ELEVATION_063_oRDR_DETECTION_061_064_oPCAN_RADAR_7702e8ef_Tx: ComSignalType=UINT8
            DET_CONFD_ELEVATION_064_oRDR_DETECTION_061_064_oPCAN_RADAR_2bb2cb86_Tx: ComSignalType=UINT8
            DET_ELEVATION_061_oRDR_DETECTION_061_064_oPCAN_RADAR_575293b8_Tx: ComSignalType=UINT8
            DET_ELEVATION_062_oRDR_DETECTION_061_064_oPCAN_RADAR_33b2e846_Tx: ComSignalType=UINT8
            DET_ELEVATION_063_oRDR_DETECTION_061_064_oPCAN_RADAR_a6c23cd3_Tx: ComSignalType=UINT8
            DET_ELEVATION_064_oRDR_DETECTION_061_064_oPCAN_RADAR_fa721fba_Tx: ComSignalType=UINT8
            DET_ELEVATION_ERR_061_oRDR_DETECTION_061_064_oPCAN_RADAR_d06b0bcd_Tx: ComSignalType=UINT8
            DET_ELEVATION_ERR_062_oRDR_DETECTION_061_064_oPCAN_RADAR_b48b7033_Tx: ComSignalType=UINT8
            DET_ELEVATION_ERR_063_oRDR_DETECTION_061_064_oPCAN_RADAR_21fba4a6_Tx: ComSignalType=UINT8
            DET_ELEVATION_ERR_064_oRDR_DETECTION_061_064_oPCAN_RADAR_7d4b87cf_Tx: ComSignalType=UINT8
            DET_EXISTENCE_PROB_061_oRDR_DETECTION_061_064_oPCAN_RADAR_02f47ead_Tx: ComSignalType=UINT8
            DET_EXISTENCE_PROB_062_oRDR_DETECTION_061_064_oPCAN_RADAR_66140553_Tx: ComSignalType=UINT8
            DET_EXISTENCE_PROB_063_oRDR_DETECTION_061_064_oPCAN_RADAR_f364d1c6_Tx: ComSignalType=UINT8
            DET_EXISTENCE_PROB_064_oRDR_DETECTION_061_064_oPCAN_RADAR_afd4f2af_Tx: ComSignalType=UINT8
            DET_HVC_FLAG_061_oRDR_DETECTION_061_064_oPCAN_RADAR_e3803dd2_Tx: ComSignalType=BOOLEAN
            DET_HVC_FLAG_062_oRDR_DETECTION_061_064_oPCAN_RADAR_8760462c_Tx: ComSignalType=BOOLEAN
            DET_HVC_FLAG_063_oRDR_DETECTION_061_064_oPCAN_RADAR_121092b9_Tx: ComSignalType=BOOLEAN
            DET_HVC_FLAG_064_oRDR_DETECTION_061_064_oPCAN_RADAR_4ea0b1d0_Tx: ComSignalType=BOOLEAN
            DET_IDM_061_oRDR_DETECTION_061_064_oPCAN_RADAR_68d2066f_Tx: ComSignalType=UINT8
            DET_IDM_062_oRDR_DETECTION_061_064_oPCAN_RADAR_0c327d91_Tx: ComSignalType=UINT8
            DET_IDM_063_oRDR_DETECTION_061_064_oPCAN_RADAR_9942a904_Tx: ComSignalType=UINT8
            DET_IDM_064_oRDR_DETECTION_061_064_oPCAN_RADAR_c5f28a6d_Tx: ComSignalType=UINT8
            DET_MH_CRC16_061_064_oRDR_DETECTION_061_064_oPCAN_RADAR_045ea758_Tx: ComSignalType=UINT16
            DET_MH_CYCLE_COUNTER_061_064_oRDR_DETECTION_061_064_oPCAN_RADAR_802b066f_Tx: ComSignalType=UINT8
            DET_MH_SCAN_INDEX_4LSB_061_064_oRDR_DETECTION_061_064_oPCAN_RADAR_4c0123e3_Tx: ComSignalType=UINT8
            DET_MTD_061_oRDR_DETECTION_061_064_oPCAN_RADAR_0e6134b4_Tx: ComSignalType=UINT8
            DET_MTD_062_oRDR_DETECTION_061_064_oPCAN_RADAR_6a814f4a_Tx: ComSignalType=UINT8
            DET_MTD_063_oRDR_DETECTION_061_064_oPCAN_RADAR_fff19bdf_Tx: ComSignalType=UINT8
            DET_MTD_064_oRDR_DETECTION_061_064_oPCAN_RADAR_a341b8b6_Tx: ComSignalType=UINT8
            DET_PROB_1STAZHYPO_061_oRDR_DETECTION_061_064_oPCAN_RADAR_9dd5dc79_Tx: ComSignalType=BOOLEAN
            DET_PROB_1STAZHYPO_062_oRDR_DETECTION_061_064_oPCAN_RADAR_f935a787_Tx: ComSignalType=BOOLEAN
            DET_PROB_1STAZHYPO_063_oRDR_DETECTION_061_064_oPCAN_RADAR_6c457312_Tx: ComSignalType=BOOLEAN
            DET_PROB_1STAZHYPO_064_oRDR_DETECTION_061_064_oPCAN_RADAR_30f5507b_Tx: ComSignalType=BOOLEAN
            DET_RANGE_061_oRDR_DETECTION_061_064_oPCAN_RADAR_967a3f0f_Tx: ComSignalType=UINT16
            DET_RANGE_062_oRDR_DETECTION_061_064_oPCAN_RADAR_f29a44f1_Tx: ComSignalType=UINT16
            DET_RANGE_063_oRDR_DETECTION_061_064_oPCAN_RADAR_67ea9064_Tx: ComSignalType=UINT16
            DET_RANGE_064_oRDR_DETECTION_061_064_oPCAN_RADAR_3b5ab30d_Tx: ComSignalType=UINT16
            DET_RANGE_ERR_061_oRDR_DETECTION_061_064_oPCAN_RADAR_31928566_Tx: ComSignalType=UINT8
            DET_RANGE_ERR_062_oRDR_DETECTION_061_064_oPCAN_RADAR_5572fe98_Tx: ComSignalType=UINT8
            DET_RANGE_ERR_063_oRDR_DETECTION_061_064_oPCAN_RADAR_c0022a0d_Tx: ComSignalType=UINT8
            DET_RANGE_ERR_064_oRDR_DETECTION_061_064_oPCAN_RADAR_9cb20964_Tx: ComSignalType=UINT8
            DET_RANGE_VELOCITY_061_oRDR_DETECTION_061_064_oPCAN_RADAR_e3dcfd2a_Tx: ComSignalType=UINT16
            DET_RANGE_VELOCITY_062_oRDR_DETECTION_061_064_oPCAN_RADAR_873c86d4_Tx: ComSignalType=UINT16
            DET_RANGE_VELOCITY_063_oRDR_DETECTION_061_064_oPCAN_RADAR_124c5241_Tx: ComSignalType=UINT16
            DET_RANGE_VELOCITY_064_oRDR_DETECTION_061_064_oPCAN_RADAR_4efc7128_Tx: ComSignalType=UINT16
            DET_RANGE_VELOCITY_ERR_061_oRDR_DETECTION_061_064_oPCAN_RADAR_ec670698_Tx: ComSignalType=UINT8
            DET_RANGE_VELOCITY_ERR_062_oRDR_DETECTION_061_064_oPCAN_RADAR_88877d66_Tx: ComSignalType=UINT8
            DET_RANGE_VELOCITY_ERR_063_oRDR_DETECTION_061_064_oPCAN_RADAR_1df7a9f3_Tx: ComSignalType=UINT8
            DET_RANGE_VELOCITY_ERR_064_oRDR_DETECTION_061_064_oPCAN_RADAR_41478a9a_Tx: ComSignalType=UINT8
            DET_RCS_061_oRDR_DETECTION_061_064_oPCAN_RADAR_645cca70_Tx: ComSignalType=UINT8
            DET_RCS_062_oRDR_DETECTION_061_064_oPCAN_RADAR_00bcb18e_Tx: ComSignalType=UINT8
            DET_RCS_063_oRDR_DETECTION_061_064_oPCAN_RADAR_95cc651b_Tx: ComSignalType=UINT8
            DET_RCS_064_oRDR_DETECTION_061_064_oPCAN_RADAR_c97c4672_Tx: ComSignalType=UINT8
            DET_SNR_061_oRDR_DETECTION_061_064_oPCAN_RADAR_b9f29e72_Tx: ComSignalType=UINT8
            DET_SNR_062_oRDR_DETECTION_061_064_oPCAN_RADAR_dd12e58c_Tx: ComSignalType=UINT8
            DET_SNR_063_oRDR_DETECTION_061_064_oPCAN_RADAR_48623119_Tx: ComSignalType=UINT8
            DET_SNR_064_oRDR_DETECTION_061_064_oPCAN_RADAR_14d21270_Tx: ComSignalType=UINT8
            DET_SUPER_RES_TARGET_061_oRDR_DETECTION_061_064_oPCAN_RADAR_886bb617_Tx: ComSignalType=BOOLEAN
            DET_SUPER_RES_TARGET_062_oRDR_DETECTION_061_064_oPCAN_RADAR_ec8bcde9_Tx: ComSignalType=BOOLEAN
            DET_SUPER_RES_TARGET_063_oRDR_DETECTION_061_064_oPCAN_RADAR_79fb197c_Tx: ComSignalType=BOOLEAN
            DET_SUPER_RES_TARGET_064_oRDR_DETECTION_061_064_oPCAN_RADAR_254b3a15_Tx: ComSignalType=BOOLEAN
        SG_Detections_065_068_oRDR_DETECTION_065_068_oPCAN_RADAR_f1154101_Tx
          83 x ComGroupSignal:
            DET_AZIMUTH_065_oRDR_DETECTION_065_068_oPCAN_RADAR_57038a17_Tx: ComSignalType=UINT16
            DET_AZIMUTH_066_oRDR_DETECTION_065_068_oPCAN_RADAR_33e3f1e9_Tx: ComSignalType=UINT16
            DET_AZIMUTH_067_oRDR_DETECTION_065_068_oPCAN_RADAR_a693257c_Tx: ComSignalType=UINT16
            DET_AZIMUTH_068_oRDR_DETECTION_065_068_oPCAN_RADAR_8a83b73b_Tx: ComSignalType=UINT16
            DET_AZIMUTH_ERR_065_oRDR_DETECTION_065_068_oPCAN_RADAR_f3b61fe2_Tx: ComSignalType=UINT8
            DET_AZIMUTH_ERR_066_oRDR_DETECTION_065_068_oPCAN_RADAR_9756641c_Tx: ComSignalType=UINT8
            DET_AZIMUTH_ERR_067_oRDR_DETECTION_065_068_oPCAN_RADAR_0226b089_Tx: ComSignalType=UINT8
            DET_AZIMUTH_ERR_068_oRDR_DETECTION_065_068_oPCAN_RADAR_2e3622ce_Tx: ComSignalType=UINT8
            DET_BELOW_RAIN_THOLD_065_oRDR_DETECTION_065_068_oPCAN_RADAR_820219d7_Tx: ComSignalType=UINT8
            DET_BELOW_RAIN_THOLD_066_oRDR_DETECTION_065_068_oPCAN_RADAR_e6e26229_Tx: ComSignalType=UINT8
            DET_BELOW_RAIN_THOLD_067_oRDR_DETECTION_065_068_oPCAN_RADAR_7392b6bc_Tx: ComSignalType=UINT8
            DET_BELOW_RAIN_THOLD_068_oRDR_DETECTION_065_068_oPCAN_RADAR_5f8224fb_Tx: ComSignalType=UINT8
            DET_BI_STATIC_FLAG_065_oRDR_DETECTION_065_068_oPCAN_RADAR_012fca92_Tx: ComSignalType=BOOLEAN
            DET_BI_STATIC_FLAG_066_oRDR_DETECTION_065_068_oPCAN_RADAR_65cfb16c_Tx: ComSignalType=BOOLEAN
            DET_BI_STATIC_FLAG_067_oRDR_DETECTION_065_068_oPCAN_RADAR_f0bf65f9_Tx: ComSignalType=BOOLEAN
            DET_BI_STATIC_FLAG_068_oRDR_DETECTION_065_068_oPCAN_RADAR_dcaff7be_Tx: ComSignalType=BOOLEAN
            DET_CONFD_AZIMUTH_065_oRDR_DETECTION_065_068_oPCAN_RADAR_55e580dd_Tx: ComSignalType=UINT8
            DET_CONFD_AZIMUTH_066_oRDR_DETECTION_065_068_oPCAN_RADAR_3105fb23_Tx: ComSignalType=UINT8
            DET_CONFD_AZIMUTH_067_oRDR_DETECTION_065_068_oPCAN_RADAR_a4752fb6_Tx: ComSignalType=UINT8
            DET_CONFD_AZIMUTH_068_oRDR_DETECTION_065_068_oPCAN_RADAR_8865bdf1_Tx: ComSignalType=UINT8
            DET_CONFD_ELEVATION_065_oRDR_DETECTION_065_068_oPCAN_RADAR_57708127_Tx: ComSignalType=UINT8
            DET_CONFD_ELEVATION_066_oRDR_DETECTION_065_068_oPCAN_RADAR_3390fad9_Tx: ComSignalType=UINT8
            DET_CONFD_ELEVATION_067_oRDR_DETECTION_065_068_oPCAN_RADAR_a6e02e4c_Tx: ComSignalType=UINT8
            DET_CONFD_ELEVATION_068_oRDR_DETECTION_065_068_oPCAN_RADAR_8af0bc0b_Tx: ComSignalType=UINT8
            DET_ELEVATION_065_oRDR_DETECTION_065_068_oPCAN_RADAR_86b0551b_Tx: ComSignalType=UINT8
            DET_ELEVATION_066_oRDR_DETECTION_065_068_oPCAN_RADAR_e2502ee5_Tx: ComSignalType=UINT8
            DET_ELEVATION_067_oRDR_DETECTION_065_068_oPCAN_RADAR_7720fa70_Tx: ComSignalType=UINT8
            DET_ELEVATION_068_oRDR_DETECTION_065_068_oPCAN_RADAR_5b306837_Tx: ComSignalType=UINT8
            DET_ELEVATION_ERR_065_oRDR_DETECTION_065_068_oPCAN_RADAR_0189cd6e_Tx: ComSignalType=UINT8
            DET_ELEVATION_ERR_066_oRDR_DETECTION_065_068_oPCAN_RADAR_6569b690_Tx: ComSignalType=UINT8
            DET_ELEVATION_ERR_067_oRDR_DETECTION_065_068_oPCAN_RADAR_f0196205_Tx: ComSignalType=UINT8
            DET_ELEVATION_ERR_068_oRDR_DETECTION_065_068_oPCAN_RADAR_dc09f042_Tx: ComSignalType=UINT8
            DET_EXISTENCE_PROB_065_oRDR_DETECTION_065_068_oPCAN_RADAR_d316b80e_Tx: ComSignalType=UINT8
            DET_EXISTENCE_PROB_066_oRDR_DETECTION_065_068_oPCAN_RADAR_b7f6c3f0_Tx: ComSignalType=UINT8
            DET_EXISTENCE_PROB_067_oRDR_DETECTION_065_068_oPCAN_RADAR_22861765_Tx: ComSignalType=UINT8
            DET_EXISTENCE_PROB_068_oRDR_DETECTION_065_068_oPCAN_RADAR_0e968522_Tx: ComSignalType=UINT8
            DET_HVC_FLAG_065_oRDR_DETECTION_065_068_oPCAN_RADAR_3262fb71_Tx: ComSignalType=BOOLEAN
            DET_HVC_FLAG_066_oRDR_DETECTION_065_068_oPCAN_RADAR_5682808f_Tx: ComSignalType=BOOLEAN
            DET_HVC_FLAG_067_oRDR_DETECTION_065_068_oPCAN_RADAR_c3f2541a_Tx: ComSignalType=BOOLEAN
            DET_HVC_FLAG_068_oRDR_DETECTION_065_068_oPCAN_RADAR_efe2c65d_Tx: ComSignalType=BOOLEAN
            DET_IDM_065_oRDR_DETECTION_065_068_oPCAN_RADAR_b930c0cc_Tx: ComSignalType=UINT8
            DET_IDM_066_oRDR_DETECTION_065_068_oPCAN_RADAR_ddd0bb32_Tx: ComSignalType=UINT8
            DET_IDM_067_oRDR_DETECTION_065_068_oPCAN_RADAR_48a06fa7_Tx: ComSignalType=UINT8
            DET_IDM_068_oRDR_DETECTION_065_068_oPCAN_RADAR_64b0fde0_Tx: ComSignalType=UINT8
            DET_MH_CRC16_065_068_oRDR_DETECTION_065_068_oPCAN_RADAR_759d930a_Tx: ComSignalType=UINT16
            DET_MH_CYCLE_COUNTER_065_068_oRDR_DETECTION_065_068_oPCAN_RADAR_f1e8323d_Tx: ComSignalType=UINT8
            DET_MH_SCAN_INDEX_4LSB_065_068_oRDR_DETECTION_065_068_oPCAN_RADAR_3dc217b1_Tx: ComSignalType=UINT8
            DET_MTD_065_oRDR_DETECTION_065_068_oPCAN_RADAR_df83f217_Tx: ComSignalType=UINT8
            DET_MTD_066_oRDR_DETECTION_065_068_oPCAN_RADAR_bb6389e9_Tx: ComSignalType=UINT8
            DET_MTD_067_oRDR_DETECTION_065_068_oPCAN_RADAR_2e135d7c_Tx: ComSignalType=UINT8
            DET_MTD_068_oRDR_DETECTION_065_068_oPCAN_RADAR_0203cf3b_Tx: ComSignalType=UINT8
            DET_PROB_1STAZHYPO_065_oRDR_DETECTION_065_068_oPCAN_RADAR_4c371ada_Tx: ComSignalType=BOOLEAN
            DET_PROB_1STAZHYPO_066_oRDR_DETECTION_065_068_oPCAN_RADAR_28d76124_Tx: ComSignalType=BOOLEAN
            DET_PROB_1STAZHYPO_067_oRDR_DETECTION_065_068_oPCAN_RADAR_bda7b5b1_Tx: ComSignalType=BOOLEAN
            DET_PROB_1STAZHYPO_068_oRDR_DETECTION_065_068_oPCAN_RADAR_91b727f6_Tx: ComSignalType=BOOLEAN
            DET_RANGE_065_oRDR_DETECTION_065_068_oPCAN_RADAR_4798f9ac_Tx: ComSignalType=UINT16
            DET_RANGE_066_oRDR_DETECTION_065_068_oPCAN_RADAR_23788252_Tx: ComSignalType=UINT16
            DET_RANGE_067_oRDR_DETECTION_065_068_oPCAN_RADAR_b60856c7_Tx: ComSignalType=UINT16
            DET_RANGE_068_oRDR_DETECTION_065_068_oPCAN_RADAR_9a18c480_Tx: ComSignalType=UINT16
            DET_RANGE_ERR_065_oRDR_DETECTION_065_068_oPCAN_RADAR_e07043c5_Tx: ComSignalType=UINT8
            DET_RANGE_ERR_066_oRDR_DETECTION_065_068_oPCAN_RADAR_8490383b_Tx: ComSignalType=UINT8
            DET_RANGE_ERR_067_oRDR_DETECTION_065_068_oPCAN_RADAR_11e0ecae_Tx: ComSignalType=UINT8
            DET_RANGE_ERR_068_oRDR_DETECTION_065_068_oPCAN_RADAR_3df07ee9_Tx: ComSignalType=UINT8
            DET_RANGE_VELOCITY_065_oRDR_DETECTION_065_068_oPCAN_RADAR_323e3b89_Tx: ComSignalType=UINT16
            DET_RANGE_VELOCITY_066_oRDR_DETECTION_065_068_oPCAN_RADAR_56de4077_Tx: ComSignalType=UINT16
            DET_RANGE_VELOCITY_067_oRDR_DETECTION_065_068_oPCAN_RADAR_c3ae94e2_Tx: ComSignalType=UINT16
            DET_RANGE_VELOCITY_068_oRDR_DETECTION_065_068_oPCAN_RADAR_efbe06a5_Tx: ComSignalType=UINT16
            DET_RANGE_VELOCITY_ERR_065_oRDR_DETECTION_065_068_oPCAN_RADAR_3d85c03b_Tx: ComSignalType=UINT8
            DET_RANGE_VELOCITY_ERR_066_oRDR_DETECTION_065_068_oPCAN_RADAR_5965bbc5_Tx: ComSignalType=UINT8
            DET_RANGE_VELOCITY_ERR_067_oRDR_DETECTION_065_068_oPCAN_RADAR_cc156f50_Tx: ComSignalType=UINT8
            DET_RANGE_VELOCITY_ERR_068_oRDR_DETECTION_065_068_oPCAN_RADAR_e005fd17_Tx: ComSignalType=UINT8
            DET_RCS_065_oRDR_DETECTION_065_068_oPCAN_RADAR_b5be0cd3_Tx: ComSignalType=UINT8
            DET_RCS_066_oRDR_DETECTION_065_068_oPCAN_RADAR_d15e772d_Tx: ComSignalType=UINT8
            DET_RCS_067_oRDR_DETECTION_065_068_oPCAN_RADAR_442ea3b8_Tx: ComSignalType=UINT8
            DET_RCS_068_oRDR_DETECTION_065_068_oPCAN_RADAR_683e31ff_Tx: ComSignalType=UINT8
            DET_SNR_065_oRDR_DETECTION_065_068_oPCAN_RADAR_681058d1_Tx: ComSignalType=UINT8
            DET_SNR_066_oRDR_DETECTION_065_068_oPCAN_RADAR_0cf0232f_Tx: ComSignalType=UINT8
            DET_SNR_067_oRDR_DETECTION_065_068_oPCAN_RADAR_9980f7ba_Tx: ComSignalType=UINT8
            DET_SNR_068_oRDR_DETECTION_065_068_oPCAN_RADAR_b59065fd_Tx: ComSignalType=UINT8
            DET_SUPER_RES_TARGET_065_oRDR_DETECTION_065_068_oPCAN_RADAR_598970b4_Tx: ComSignalType=BOOLEAN
            DET_SUPER_RES_TARGET_066_oRDR_DETECTION_065_068_oPCAN_RADAR_3d690b4a_Tx: ComSignalType=BOOLEAN
            DET_SUPER_RES_TARGET_067_oRDR_DETECTION_065_068_oPCAN_RADAR_a819dfdf_Tx: ComSignalType=BOOLEAN
            DET_SUPER_RES_TARGET_068_oRDR_DETECTION_065_068_oPCAN_RADAR_84094d98_Tx: ComSignalType=BOOLEAN
        SG_Detections_069_072_oRDR_DETECTION_069_072_oPCAN_RADAR_686f657a_Tx
          83 x ComGroupSignal:
            DET_AZIMUTH_069_oRDR_DETECTION_069_072_oPCAN_RADAR_2dbb8caf_Tx: ComSignalType=UINT16
            DET_AZIMUTH_070_oRDR_DETECTION_069_072_oPCAN_RADAR_489bfe0b_Tx: ComSignalType=UINT16
            DET_AZIMUTH_071_oRDR_DETECTION_069_072_oPCAN_RADAR_ddeb2a9e_Tx: ComSignalType=UINT16
            DET_AZIMUTH_072_oRDR_DETECTION_069_072_oPCAN_RADAR_b90b5160_Tx: ComSignalType=UINT16
            DET_AZIMUTH_ERR_069_oRDR_DETECTION_069_072_oPCAN_RADAR_890e195a_Tx: ComSignalType=UINT8
            DET_AZIMUTH_ERR_070_oRDR_DETECTION_069_072_oPCAN_RADAR_ec2e6bfe_Tx: ComSignalType=UINT8
            DET_AZIMUTH_ERR_071_oRDR_DETECTION_069_072_oPCAN_RADAR_795ebf6b_Tx: ComSignalType=UINT8
            DET_AZIMUTH_ERR_072_oRDR_DETECTION_069_072_oPCAN_RADAR_1dbec495_Tx: ComSignalType=UINT8
            DET_BELOW_RAIN_THOLD_069_oRDR_DETECTION_069_072_oPCAN_RADAR_f8ba1f6f_Tx: ComSignalType=UINT8
            DET_BELOW_RAIN_THOLD_070_oRDR_DETECTION_069_072_oPCAN_RADAR_9d9a6dcb_Tx: ComSignalType=UINT8
            DET_BELOW_RAIN_THOLD_071_oRDR_DETECTION_069_072_oPCAN_RADAR_08eab95e_Tx: ComSignalType=UINT8
            DET_BELOW_RAIN_THOLD_072_oRDR_DETECTION_069_072_oPCAN_RADAR_6c0ac2a0_Tx: ComSignalType=UINT8
            DET_BI_STATIC_FLAG_069_oRDR_DETECTION_069_072_oPCAN_RADAR_7b97cc2a_Tx: ComSignalType=BOOLEAN
            DET_BI_STATIC_FLAG_070_oRDR_DETECTION_069_072_oPCAN_RADAR_1eb7be8e_Tx: ComSignalType=BOOLEAN
            DET_BI_STATIC_FLAG_071_oRDR_DETECTION_069_072_oPCAN_RADAR_8bc76a1b_Tx: ComSignalType=BOOLEAN
            DET_BI_STATIC_FLAG_072_oRDR_DETECTION_069_072_oPCAN_RADAR_ef2711e5_Tx: ComSignalType=BOOLEAN
            DET_CONFD_AZIMUTH_069_oRDR_DETECTION_069_072_oPCAN_RADAR_2f5d8665_Tx: ComSignalType=UINT8
            DET_CONFD_AZIMUTH_070_oRDR_DETECTION_069_072_oPCAN_RADAR_4a7df4c1_Tx: ComSignalType=UINT8
            DET_CONFD_AZIMUTH_071_oRDR_DETECTION_069_072_oPCAN_RADAR_df0d2054_Tx: ComSignalType=UINT8
            DET_CONFD_AZIMUTH_072_oRDR_DETECTION_069_072_oPCAN_RADAR_bbed5baa_Tx: ComSignalType=UINT8
            DET_CONFD_ELEVATION_069_oRDR_DETECTION_069_072_oPCAN_RADAR_2dc8879f_Tx: ComSignalType=UINT8
            DET_CONFD_ELEVATION_070_oRDR_DETECTION_069_072_oPCAN_RADAR_48e8f53b_Tx: ComSignalType=UINT8
            DET_CONFD_ELEVATION_071_oRDR_DETECTION_069_072_oPCAN_RADAR_dd9821ae_Tx: ComSignalType=UINT8
            DET_CONFD_ELEVATION_072_oRDR_DETECTION_069_072_oPCAN_RADAR_b9785a50_Tx: ComSignalType=UINT8
            DET_ELEVATION_069_oRDR_DETECTION_069_072_oPCAN_RADAR_fc0853a3_Tx: ComSignalType=UINT8
            DET_ELEVATION_070_oRDR_DETECTION_069_072_oPCAN_RADAR_99282107_Tx: ComSignalType=UINT8
            DET_ELEVATION_071_oRDR_DETECTION_069_072_oPCAN_RADAR_0c58f592_Tx: ComSignalType=UINT8
            DET_ELEVATION_072_oRDR_DETECTION_069_072_oPCAN_RADAR_68b88e6c_Tx: ComSignalType=UINT8
            DET_ELEVATION_ERR_069_oRDR_DETECTION_069_072_oPCAN_RADAR_7b31cbd6_Tx: ComSignalType=UINT8
            DET_ELEVATION_ERR_070_oRDR_DETECTION_069_072_oPCAN_RADAR_1e11b972_Tx: ComSignalType=UINT8
            DET_ELEVATION_ERR_071_oRDR_DETECTION_069_072_oPCAN_RADAR_8b616de7_Tx: ComSignalType=UINT8
            DET_ELEVATION_ERR_072_oRDR_DETECTION_069_072_oPCAN_RADAR_ef811619_Tx: ComSignalType=UINT8
            DET_EXISTENCE_PROB_069_oRDR_DETECTION_069_072_oPCAN_RADAR_a9aebeb6_Tx: ComSignalType=UINT8
            DET_EXISTENCE_PROB_070_oRDR_DETECTION_069_072_oPCAN_RADAR_cc8ecc12_Tx: ComSignalType=UINT8
            DET_EXISTENCE_PROB_071_oRDR_DETECTION_069_072_oPCAN_RADAR_59fe1887_Tx: ComSignalType=UINT8
            DET_EXISTENCE_PROB_072_oRDR_DETECTION_069_072_oPCAN_RADAR_3d1e6379_Tx: ComSignalType=UINT8
            DET_HVC_FLAG_069_oRDR_DETECTION_069_072_oPCAN_RADAR_48dafdc9_Tx: ComSignalType=BOOLEAN
            DET_HVC_FLAG_070_oRDR_DETECTION_069_072_oPCAN_RADAR_2dfa8f6d_Tx: ComSignalType=BOOLEAN
            DET_HVC_FLAG_071_oRDR_DETECTION_069_072_oPCAN_RADAR_b88a5bf8_Tx: ComSignalType=BOOLEAN
            DET_HVC_FLAG_072_oRDR_DETECTION_069_072_oPCAN_RADAR_dc6a2006_Tx: ComSignalType=BOOLEAN
            DET_IDM_069_oRDR_DETECTION_069_072_oPCAN_RADAR_c388c674_Tx: ComSignalType=UINT8
            DET_IDM_070_oRDR_DETECTION_069_072_oPCAN_RADAR_a6a8b4d0_Tx: ComSignalType=UINT8
            DET_IDM_071_oRDR_DETECTION_069_072_oPCAN_RADAR_33d86045_Tx: ComSignalType=UINT8
            DET_IDM_072_oRDR_DETECTION_069_072_oPCAN_RADAR_57381bbb_Tx: ComSignalType=UINT8
            DET_MH_CRC16_069_072_oRDR_DETECTION_069_072_oPCAN_RADAR_ece7b771_Tx: ComSignalType=UINT16
            DET_MH_CYCLE_COUNTER_069_072_oRDR_DETECTION_069_072_oPCAN_RADAR_68921646_Tx: ComSignalType=UINT8
            DET_MH_SCAN_INDEX_4LSB_069_072_oRDR_DETECTION_069_072_oPCAN_RADAR_a4b833ca_Tx: ComSignalType=UINT8
            DET_MTD_069_oRDR_DETECTION_069_072_oPCAN_RADAR_a53bf4af_Tx: ComSignalType=UINT8
            DET_MTD_070_oRDR_DETECTION_069_072_oPCAN_RADAR_c01b860b_Tx: ComSignalType=UINT8
            DET_MTD_071_oRDR_DETECTION_069_072_oPCAN_RADAR_556b529e_Tx: ComSignalType=UINT8
            DET_MTD_072_oRDR_DETECTION_069_072_oPCAN_RADAR_318b2960_Tx: ComSignalType=UINT8
            DET_PROB_1STAZHYPO_069_oRDR_DETECTION_069_072_oPCAN_RADAR_368f1c62_Tx: ComSignalType=BOOLEAN
            DET_PROB_1STAZHYPO_070_oRDR_DETECTION_069_072_oPCAN_RADAR_53af6ec6_Tx: ComSignalType=BOOLEAN
            DET_PROB_1STAZHYPO_071_oRDR_DETECTION_069_072_oPCAN_RADAR_c6dfba53_Tx: ComSignalType=BOOLEAN
            DET_PROB_1STAZHYPO_072_oRDR_DETECTION_069_072_oPCAN_RADAR_a23fc1ad_Tx: ComSignalType=BOOLEAN
            DET_RANGE_069_oRDR_DETECTION_069_072_oPCAN_RADAR_3d20ff14_Tx: ComSignalType=UINT16
            DET_RANGE_070_oRDR_DETECTION_069_072_oPCAN_RADAR_58008db0_Tx: ComSignalType=UINT16
            DET_RANGE_071_oRDR_DETECTION_069_072_oPCAN_RADAR_cd705925_Tx: ComSignalType=UINT16
            DET_RANGE_072_oRDR_DETECTION_069_072_oPCAN_RADAR_a99022db_Tx: ComSignalType=UINT16
            DET_RANGE_ERR_069_oRDR_DETECTION_069_072_oPCAN_RADAR_9ac8457d_Tx: ComSignalType=UINT8
            DET_RANGE_ERR_070_oRDR_DETECTION_069_072_oPCAN_RADAR_ffe837d9_Tx: ComSignalType=UINT8
            DET_RANGE_ERR_071_oRDR_DETECTION_069_072_oPCAN_RADAR_6a98e34c_Tx: ComSignalType=UINT8
            DET_RANGE_ERR_072_oRDR_DETECTION_069_072_oPCAN_RADAR_0e7898b2_Tx: ComSignalType=UINT8
            DET_RANGE_VELOCITY_069_oRDR_DETECTION_069_072_oPCAN_RADAR_48863d31_Tx: ComSignalType=UINT16
            DET_RANGE_VELOCITY_070_oRDR_DETECTION_069_072_oPCAN_RADAR_2da64f95_Tx: ComSignalType=UINT16
            DET_RANGE_VELOCITY_071_oRDR_DETECTION_069_072_oPCAN_RADAR_b8d69b00_Tx: ComSignalType=UINT16
            DET_RANGE_VELOCITY_072_oRDR_DETECTION_069_072_oPCAN_RADAR_dc36e0fe_Tx: ComSignalType=UINT16
            DET_RANGE_VELOCITY_ERR_069_oRDR_DETECTION_069_072_oPCAN_RADAR_473dc683_Tx: ComSignalType=UINT8
            DET_RANGE_VELOCITY_ERR_070_oRDR_DETECTION_069_072_oPCAN_RADAR_221db427_Tx: ComSignalType=UINT8
            DET_RANGE_VELOCITY_ERR_071_oRDR_DETECTION_069_072_oPCAN_RADAR_b76d60b2_Tx: ComSignalType=UINT8
            DET_RANGE_VELOCITY_ERR_072_oRDR_DETECTION_069_072_oPCAN_RADAR_d38d1b4c_Tx: ComSignalType=UINT8
            DET_RCS_069_oRDR_DETECTION_069_072_oPCAN_RADAR_cf060a6b_Tx: ComSignalType=UINT8
            DET_RCS_070_oRDR_DETECTION_069_072_oPCAN_RADAR_aa2678cf_Tx: ComSignalType=UINT8
            DET_RCS_071_oRDR_DETECTION_069_072_oPCAN_RADAR_3f56ac5a_Tx: ComSignalType=UINT8
            DET_RCS_072_oRDR_DETECTION_069_072_oPCAN_RADAR_5bb6d7a4_Tx: ComSignalType=UINT8
            DET_SNR_069_oRDR_DETECTION_069_072_oPCAN_RADAR_12a85e69_Tx: ComSignalType=UINT8
            DET_SNR_070_oRDR_DETECTION_069_072_oPCAN_RADAR_77882ccd_Tx: ComSignalType=UINT8
            DET_SNR_071_oRDR_DETECTION_069_072_oPCAN_RADAR_e2f8f858_Tx: ComSignalType=UINT8
            DET_SNR_072_oRDR_DETECTION_069_072_oPCAN_RADAR_861883a6_Tx: ComSignalType=UINT8
            DET_SUPER_RES_TARGET_069_oRDR_DETECTION_069_072_oPCAN_RADAR_2331760c_Tx: ComSignalType=BOOLEAN
            DET_SUPER_RES_TARGET_070_oRDR_DETECTION_069_072_oPCAN_RADAR_461104a8_Tx: ComSignalType=BOOLEAN
            DET_SUPER_RES_TARGET_071_oRDR_DETECTION_069_072_oPCAN_RADAR_d361d03d_Tx: ComSignalType=BOOLEAN
            DET_SUPER_RES_TARGET_072_oRDR_DETECTION_069_072_oPCAN_RADAR_b781abc3_Tx: ComSignalType=BOOLEAN
        SG_Detections_073_076_oRDR_DETECTION_073_076_oPCAN_RADAR_5a640d52_Tx
          83 x ComGroupSignal:
            DET_AZIMUTH_073_oRDR_DETECTION_073_076_oPCAN_RADAR_31bc86db_Tx: ComSignalType=UINT16
            DET_AZIMUTH_074_oRDR_DETECTION_073_076_oPCAN_RADAR_6d0ca5b2_Tx: ComSignalType=UINT16
            DET_AZIMUTH_075_oRDR_DETECTION_073_076_oPCAN_RADAR_f87c7127_Tx: ComSignalType=UINT16
            DET_AZIMUTH_076_oRDR_DETECTION_073_076_oPCAN_RADAR_9c9c0ad9_Tx: ComSignalType=UINT16
            DET_AZIMUTH_ERR_073_oRDR_DETECTION_073_076_oPCAN_RADAR_9509132e_Tx: ComSignalType=UINT8
            DET_AZIMUTH_ERR_074_oRDR_DETECTION_073_076_oPCAN_RADAR_c9b93047_Tx: ComSignalType=UINT8
            DET_AZIMUTH_ERR_075_oRDR_DETECTION_073_076_oPCAN_RADAR_5cc9e4d2_Tx: ComSignalType=UINT8
            DET_AZIMUTH_ERR_076_oRDR_DETECTION_073_076_oPCAN_RADAR_38299f2c_Tx: ComSignalType=UINT8
            DET_BELOW_RAIN_THOLD_073_oRDR_DETECTION_073_076_oPCAN_RADAR_e4bd151b_Tx: ComSignalType=UINT8
            DET_BELOW_RAIN_THOLD_074_oRDR_DETECTION_073_076_oPCAN_RADAR_b80d3672_Tx: ComSignalType=UINT8
            DET_BELOW_RAIN_THOLD_075_oRDR_DETECTION_073_076_oPCAN_RADAR_2d7de2e7_Tx: ComSignalType=UINT8
            DET_BELOW_RAIN_THOLD_076_oRDR_DETECTION_073_076_oPCAN_RADAR_499d9919_Tx: ComSignalType=UINT8
            DET_BI_STATIC_FLAG_073_oRDR_DETECTION_073_076_oPCAN_RADAR_6790c65e_Tx: ComSignalType=BOOLEAN
            DET_BI_STATIC_FLAG_074_oRDR_DETECTION_073_076_oPCAN_RADAR_3b20e537_Tx: ComSignalType=BOOLEAN
            DET_BI_STATIC_FLAG_075_oRDR_DETECTION_073_076_oPCAN_RADAR_ae5031a2_Tx: ComSignalType=BOOLEAN
            DET_BI_STATIC_FLAG_076_oRDR_DETECTION_073_076_oPCAN_RADAR_cab04a5c_Tx: ComSignalType=BOOLEAN
            DET_CONFD_AZIMUTH_073_oRDR_DETECTION_073_076_oPCAN_RADAR_335a8c11_Tx: ComSignalType=UINT8
            DET_CONFD_AZIMUTH_074_oRDR_DETECTION_073_076_oPCAN_RADAR_6feaaf78_Tx: ComSignalType=UINT8
            DET_CONFD_AZIMUTH_075_oRDR_DETECTION_073_076_oPCAN_RADAR_fa9a7bed_Tx: ComSignalType=UINT8
            DET_CONFD_AZIMUTH_076_oRDR_DETECTION_073_076_oPCAN_RADAR_9e7a0013_Tx: ComSignalType=UINT8
            DET_CONFD_ELEVATION_073_oRDR_DETECTION_073_076_oPCAN_RADAR_31cf8deb_Tx: ComSignalType=UINT8
            DET_CONFD_ELEVATION_074_oRDR_DETECTION_073_076_oPCAN_RADAR_6d7fae82_Tx: ComSignalType=UINT8
            DET_CONFD_ELEVATION_075_oRDR_DETECTION_073_076_oPCAN_RADAR_f80f7a17_Tx: ComSignalType=UINT8
            DET_CONFD_ELEVATION_076_oRDR_DETECTION_073_076_oPCAN_RADAR_9cef01e9_Tx: ComSignalType=UINT8
            DET_ELEVATION_073_oRDR_DETECTION_073_076_oPCAN_RADAR_e00f59d7_Tx: ComSignalType=UINT8
            DET_ELEVATION_074_oRDR_DETECTION_073_076_oPCAN_RADAR_bcbf7abe_Tx: ComSignalType=UINT8
            DET_ELEVATION_075_oRDR_DETECTION_073_076_oPCAN_RADAR_29cfae2b_Tx: ComSignalType=UINT8
            DET_ELEVATION_076_oRDR_DETECTION_073_076_oPCAN_RADAR_4d2fd5d5_Tx: ComSignalType=UINT8
            DET_ELEVATION_ERR_073_oRDR_DETECTION_073_076_oPCAN_RADAR_6736c1a2_Tx: ComSignalType=UINT8
            DET_ELEVATION_ERR_074_oRDR_DETECTION_073_076_oPCAN_RADAR_3b86e2cb_Tx: ComSignalType=UINT8
            DET_ELEVATION_ERR_075_oRDR_DETECTION_073_076_oPCAN_RADAR_aef6365e_Tx: ComSignalType=UINT8
            DET_ELEVATION_ERR_076_oRDR_DETECTION_073_076_oPCAN_RADAR_ca164da0_Tx: ComSignalType=UINT8
            DET_EXISTENCE_PROB_073_oRDR_DETECTION_073_076_oPCAN_RADAR_b5a9b4c2_Tx: ComSignalType=UINT8
            DET_EXISTENCE_PROB_074_oRDR_DETECTION_073_076_oPCAN_RADAR_e91997ab_Tx: ComSignalType=UINT8
            DET_EXISTENCE_PROB_075_oRDR_DETECTION_073_076_oPCAN_RADAR_7c69433e_Tx: ComSignalType=UINT8
            DET_EXISTENCE_PROB_076_oRDR_DETECTION_073_076_oPCAN_RADAR_188938c0_Tx: ComSignalType=UINT8
            DET_HVC_FLAG_073_oRDR_DETECTION_073_076_oPCAN_RADAR_54ddf7bd_Tx: ComSignalType=BOOLEAN
            DET_HVC_FLAG_074_oRDR_DETECTION_073_076_oPCAN_RADAR_086dd4d4_Tx: ComSignalType=BOOLEAN
            DET_HVC_FLAG_075_oRDR_DETECTION_073_076_oPCAN_RADAR_9d1d0041_Tx: ComSignalType=BOOLEAN
            DET_HVC_FLAG_076_oRDR_DETECTION_073_076_oPCAN_RADAR_f9fd7bbf_Tx: ComSignalType=BOOLEAN
            DET_IDM_073_oRDR_DETECTION_073_076_oPCAN_RADAR_df8fcc00_Tx: ComSignalType=UINT8
            DET_IDM_074_oRDR_DETECTION_073_076_oPCAN_RADAR_833fef69_Tx: ComSignalType=UINT8
            DET_IDM_075_oRDR_DETECTION_073_076_oPCAN_RADAR_164f3bfc_Tx: ComSignalType=UINT8
            DET_IDM_076_oRDR_DETECTION_073_076_oPCAN_RADAR_72af4002_Tx: ComSignalType=UINT8
            DET_MH_CRC16_073_076_oRDR_DETECTION_073_076_oPCAN_RADAR_deecdf59_Tx: ComSignalType=UINT16
            DET_MH_CYCLE_COUNTER_073_076_oRDR_DETECTION_073_076_oPCAN_RADAR_5a997e6e_Tx: ComSignalType=UINT8
            DET_MH_SCAN_INDEX_4LSB_073_076_oRDR_DETECTION_073_076_oPCAN_RADAR_96b35be2_Tx: ComSignalType=UINT8
            DET_MTD_073_oRDR_DETECTION_073_076_oPCAN_RADAR_b93cfedb_Tx: ComSignalType=UINT8
            DET_MTD_074_oRDR_DETECTION_073_076_oPCAN_RADAR_e58cddb2_Tx: ComSignalType=UINT8
            DET_MTD_075_oRDR_DETECTION_073_076_oPCAN_RADAR_70fc0927_Tx: ComSignalType=UINT8
            DET_MTD_076_oRDR_DETECTION_073_076_oPCAN_RADAR_141c72d9_Tx: ComSignalType=UINT8
            DET_PROB_1STAZHYPO_073_oRDR_DETECTION_073_076_oPCAN_RADAR_2a881616_Tx: ComSignalType=BOOLEAN
            DET_PROB_1STAZHYPO_074_oRDR_DETECTION_073_076_oPCAN_RADAR_7638357f_Tx: ComSignalType=BOOLEAN
            DET_PROB_1STAZHYPO_075_oRDR_DETECTION_073_076_oPCAN_RADAR_e348e1ea_Tx: ComSignalType=BOOLEAN
            DET_PROB_1STAZHYPO_076_oRDR_DETECTION_073_076_oPCAN_RADAR_87a89a14_Tx: ComSignalType=BOOLEAN
            DET_RANGE_073_oRDR_DETECTION_073_076_oPCAN_RADAR_2127f560_Tx: ComSignalType=UINT16
            DET_RANGE_074_oRDR_DETECTION_073_076_oPCAN_RADAR_7d97d609_Tx: ComSignalType=UINT16
            DET_RANGE_075_oRDR_DETECTION_073_076_oPCAN_RADAR_e8e7029c_Tx: ComSignalType=UINT16
            DET_RANGE_076_oRDR_DETECTION_073_076_oPCAN_RADAR_8c077962_Tx: ComSignalType=UINT16
            DET_RANGE_ERR_073_oRDR_DETECTION_073_076_oPCAN_RADAR_86cf4f09_Tx: ComSignalType=UINT8
            DET_RANGE_ERR_074_oRDR_DETECTION_073_076_oPCAN_RADAR_da7f6c60_Tx: ComSignalType=UINT8
            DET_RANGE_ERR_075_oRDR_DETECTION_073_076_oPCAN_RADAR_4f0fb8f5_Tx: ComSignalType=UINT8
            DET_RANGE_ERR_076_oRDR_DETECTION_073_076_oPCAN_RADAR_2befc30b_Tx: ComSignalType=UINT8
            DET_RANGE_VELOCITY_073_oRDR_DETECTION_073_076_oPCAN_RADAR_54813745_Tx: ComSignalType=UINT16
            DET_RANGE_VELOCITY_074_oRDR_DETECTION_073_076_oPCAN_RADAR_0831142c_Tx: ComSignalType=UINT16
            DET_RANGE_VELOCITY_075_oRDR_DETECTION_073_076_oPCAN_RADAR_9d41c0b9_Tx: ComSignalType=UINT16
            DET_RANGE_VELOCITY_076_oRDR_DETECTION_073_076_oPCAN_RADAR_f9a1bb47_Tx: ComSignalType=UINT16
            DET_RANGE_VELOCITY_ERR_073_oRDR_DETECTION_073_076_oPCAN_RADAR_5b3accf7_Tx: ComSignalType=UINT8
            DET_RANGE_VELOCITY_ERR_074_oRDR_DETECTION_073_076_oPCAN_RADAR_078aef9e_Tx: ComSignalType=UINT8
            DET_RANGE_VELOCITY_ERR_075_oRDR_DETECTION_073_076_oPCAN_RADAR_92fa3b0b_Tx: ComSignalType=UINT8
            DET_RANGE_VELOCITY_ERR_076_oRDR_DETECTION_073_076_oPCAN_RADAR_f61a40f5_Tx: ComSignalType=UINT8
            DET_RCS_073_oRDR_DETECTION_073_076_oPCAN_RADAR_d301001f_Tx: ComSignalType=UINT8
            DET_RCS_074_oRDR_DETECTION_073_076_oPCAN_RADAR_8fb12376_Tx: ComSignalType=UINT8
            DET_RCS_075_oRDR_DETECTION_073_076_oPCAN_RADAR_1ac1f7e3_Tx: ComSignalType=UINT8
            DET_RCS_076_oRDR_DETECTION_073_076_oPCAN_RADAR_7e218c1d_Tx: ComSignalType=UINT8
            DET_SNR_073_oRDR_DETECTION_073_076_oPCAN_RADAR_0eaf541d_Tx: ComSignalType=UINT8
            DET_SNR_074_oRDR_DETECTION_073_076_oPCAN_RADAR_521f7774_Tx: ComSignalType=UINT8
            DET_SNR_075_oRDR_DETECTION_073_076_oPCAN_RADAR_c76fa3e1_Tx: ComSignalType=UINT8
            DET_SNR_076_oRDR_DETECTION_073_076_oPCAN_RADAR_a38fd81f_Tx: ComSignalType=UINT8
            DET_SUPER_RES_TARGET_073_oRDR_DETECTION_073_076_oPCAN_RADAR_3f367c78_Tx: ComSignalType=BOOLEAN
            DET_SUPER_RES_TARGET_074_oRDR_DETECTION_073_076_oPCAN_RADAR_63865f11_Tx: ComSignalType=BOOLEAN
            DET_SUPER_RES_TARGET_075_oRDR_DETECTION_073_076_oPCAN_RADAR_f6f68b84_Tx: ComSignalType=BOOLEAN
            DET_SUPER_RES_TARGET_076_oRDR_DETECTION_073_076_oPCAN_RADAR_9216f07a_Tx: ComSignalType=BOOLEAN
        SG_Detections_077_080_oRDR_DETECTION_077_080_oPCAN_RADAR_2ec83134_Tx
          83 x ComGroupSignal:
            DET_AZIMUTH_077_oRDR_DETECTION_077_080_oPCAN_RADAR_8c9592a8_Tx: ComSignalType=UINT16
            DET_AZIMUTH_078_oRDR_DETECTION_077_080_oPCAN_RADAR_a08500ef_Tx: ComSignalType=UINT16
            DET_AZIMUTH_079_oRDR_DETECTION_077_080_oPCAN_RADAR_35f5d47a_Tx: ComSignalType=UINT16
            DET_AZIMUTH_080_oRDR_DETECTION_077_080_oPCAN_RADAR_38b17560_Tx: ComSignalType=UINT16
            DET_AZIMUTH_ERR_077_oRDR_DETECTION_077_080_oPCAN_RADAR_2820075d_Tx: ComSignalType=UINT8
            DET_AZIMUTH_ERR_078_oRDR_DETECTION_077_080_oPCAN_RADAR_0430951a_Tx: ComSignalType=UINT8
            DET_AZIMUTH_ERR_079_oRDR_DETECTION_077_080_oPCAN_RADAR_9140418f_Tx: ComSignalType=UINT8
            DET_AZIMUTH_ERR_080_oRDR_DETECTION_077_080_oPCAN_RADAR_9c04e095_Tx: ComSignalType=UINT8
            DET_BELOW_RAIN_THOLD_077_oRDR_DETECTION_077_080_oPCAN_RADAR_59940168_Tx: ComSignalType=UINT8
            DET_BELOW_RAIN_THOLD_078_oRDR_DETECTION_077_080_oPCAN_RADAR_7584932f_Tx: ComSignalType=UINT8
            DET_BELOW_RAIN_THOLD_079_oRDR_DETECTION_077_080_oPCAN_RADAR_e0f447ba_Tx: ComSignalType=UINT8
            DET_BELOW_RAIN_THOLD_080_oRDR_DETECTION_077_080_oPCAN_RADAR_edb0e6a0_Tx: ComSignalType=UINT8
            DET_BI_STATIC_FLAG_077_oRDR_DETECTION_077_080_oPCAN_RADAR_dab9d22d_Tx: ComSignalType=BOOLEAN
            DET_BI_STATIC_FLAG_078_oRDR_DETECTION_077_080_oPCAN_RADAR_f6a9406a_Tx: ComSignalType=BOOLEAN
            DET_BI_STATIC_FLAG_079_oRDR_DETECTION_077_080_oPCAN_RADAR_63d994ff_Tx: ComSignalType=BOOLEAN
            DET_BI_STATIC_FLAG_080_oRDR_DETECTION_077_080_oPCAN_RADAR_6e9d35e5_Tx: ComSignalType=BOOLEAN
            DET_CONFD_AZIMUTH_077_oRDR_DETECTION_077_080_oPCAN_RADAR_8e739862_Tx: ComSignalType=UINT8
            DET_CONFD_AZIMUTH_078_oRDR_DETECTION_077_080_oPCAN_RADAR_a2630a25_Tx: ComSignalType=UINT8
            DET_CONFD_AZIMUTH_079_oRDR_DETECTION_077_080_oPCAN_RADAR_3713deb0_Tx: ComSignalType=UINT8
            DET_CONFD_AZIMUTH_080_oRDR_DETECTION_077_080_oPCAN_RADAR_3a577faa_Tx: ComSignalType=UINT8
            DET_CONFD_ELEVATION_077_oRDR_DETECTION_077_080_oPCAN_RADAR_8ce69998_Tx: ComSignalType=UINT8
            DET_CONFD_ELEVATION_078_oRDR_DETECTION_077_080_oPCAN_RADAR_a0f60bdf_Tx: ComSignalType=UINT8
            DET_CONFD_ELEVATION_079_oRDR_DETECTION_077_080_oPCAN_RADAR_3586df4a_Tx: ComSignalType=UINT8
            DET_CONFD_ELEVATION_080_oRDR_DETECTION_077_080_oPCAN_RADAR_38c27e50_Tx: ComSignalType=UINT8
            DET_ELEVATION_077_oRDR_DETECTION_077_080_oPCAN_RADAR_5d264da4_Tx: ComSignalType=UINT8
            DET_ELEVATION_078_oRDR_DETECTION_077_080_oPCAN_RADAR_7136dfe3_Tx: ComSignalType=UINT8
            DET_ELEVATION_079_oRDR_DETECTION_077_080_oPCAN_RADAR_e4460b76_Tx: ComSignalType=UINT8
            DET_ELEVATION_080_oRDR_DETECTION_077_080_oPCAN_RADAR_e902aa6c_Tx: ComSignalType=UINT8
            DET_ELEVATION_ERR_077_oRDR_DETECTION_077_080_oPCAN_RADAR_da1fd5d1_Tx: ComSignalType=UINT8
            DET_ELEVATION_ERR_078_oRDR_DETECTION_077_080_oPCAN_RADAR_f60f4796_Tx: ComSignalType=UINT8
            DET_ELEVATION_ERR_079_oRDR_DETECTION_077_080_oPCAN_RADAR_637f9303_Tx: ComSignalType=UINT8
            DET_ELEVATION_ERR_080_oRDR_DETECTION_077_080_oPCAN_RADAR_6e3b3219_Tx: ComSignalType=UINT8
            DET_EXISTENCE_PROB_077_oRDR_DETECTION_077_080_oPCAN_RADAR_0880a0b1_Tx: ComSignalType=UINT8
            DET_EXISTENCE_PROB_078_oRDR_DETECTION_077_080_oPCAN_RADAR_249032f6_Tx: ComSignalType=UINT8
            DET_EXISTENCE_PROB_079_oRDR_DETECTION_077_080_oPCAN_RADAR_b1e0e663_Tx: ComSignalType=UINT8
            DET_EXISTENCE_PROB_080_oRDR_DETECTION_077_080_oPCAN_RADAR_bca44779_Tx: ComSignalType=UINT8
            DET_HVC_FLAG_077_oRDR_DETECTION_077_080_oPCAN_RADAR_e9f4e3ce_Tx: ComSignalType=BOOLEAN
            DET_HVC_FLAG_078_oRDR_DETECTION_077_080_oPCAN_RADAR_c5e47189_Tx: ComSignalType=BOOLEAN
            DET_HVC_FLAG_079_oRDR_DETECTION_077_080_oPCAN_RADAR_5094a51c_Tx: ComSignalType=BOOLEAN
            DET_HVC_FLAG_080_oRDR_DETECTION_077_080_oPCAN_RADAR_5dd00406_Tx: ComSignalType=BOOLEAN
            DET_IDM_077_oRDR_DETECTION_077_080_oPCAN_RADAR_62a6d873_Tx: ComSignalType=UINT8
            DET_IDM_078_oRDR_DETECTION_077_080_oPCAN_RADAR_4eb64a34_Tx: ComSignalType=UINT8
            DET_IDM_079_oRDR_DETECTION_077_080_oPCAN_RADAR_dbc69ea1_Tx: ComSignalType=UINT8
            DET_IDM_080_oRDR_DETECTION_077_080_oPCAN_RADAR_d6823fbb_Tx: ComSignalType=UINT8
            DET_MH_CRC16_077_080_oRDR_DETECTION_077_080_oPCAN_RADAR_aa40e33f_Tx: ComSignalType=UINT16
            DET_MH_CYCLE_COUNTER_077_080_oRDR_DETECTION_077_080_oPCAN_RADAR_2e354208_Tx: ComSignalType=UINT8
            DET_MH_SCAN_INDEX_4LSB_077_080_oRDR_DETECTION_077_080_oPCAN_RADAR_e21f6784_Tx: ComSignalType=UINT8
            DET_MTD_077_oRDR_DETECTION_077_080_oPCAN_RADAR_0415eaa8_Tx: ComSignalType=UINT8
            DET_MTD_078_oRDR_DETECTION_077_080_oPCAN_RADAR_280578ef_Tx: ComSignalType=UINT8
            DET_MTD_079_oRDR_DETECTION_077_080_oPCAN_RADAR_bd75ac7a_Tx: ComSignalType=UINT8
            DET_MTD_080_oRDR_DETECTION_077_080_oPCAN_RADAR_b0310d60_Tx: ComSignalType=UINT8
            DET_PROB_1STAZHYPO_077_oRDR_DETECTION_077_080_oPCAN_RADAR_97a10265_Tx: ComSignalType=BOOLEAN
            DET_PROB_1STAZHYPO_078_oRDR_DETECTION_077_080_oPCAN_RADAR_bbb19022_Tx: ComSignalType=BOOLEAN
            DET_PROB_1STAZHYPO_079_oRDR_DETECTION_077_080_oPCAN_RADAR_2ec144b7_Tx: ComSignalType=BOOLEAN
            DET_PROB_1STAZHYPO_080_oRDR_DETECTION_077_080_oPCAN_RADAR_2385e5ad_Tx: ComSignalType=BOOLEAN
            DET_RANGE_077_oRDR_DETECTION_077_080_oPCAN_RADAR_9c0ee113_Tx: ComSignalType=UINT16
            DET_RANGE_078_oRDR_DETECTION_077_080_oPCAN_RADAR_b01e7354_Tx: ComSignalType=UINT16
            DET_RANGE_079_oRDR_DETECTION_077_080_oPCAN_RADAR_256ea7c1_Tx: ComSignalType=UINT16
            DET_RANGE_080_oRDR_DETECTION_077_080_oPCAN_RADAR_282a06db_Tx: ComSignalType=UINT16
            DET_RANGE_ERR_077_oRDR_DETECTION_077_080_oPCAN_RADAR_3be65b7a_Tx: ComSignalType=UINT8
            DET_RANGE_ERR_078_oRDR_DETECTION_077_080_oPCAN_RADAR_17f6c93d_Tx: ComSignalType=UINT8
            DET_RANGE_ERR_079_oRDR_DETECTION_077_080_oPCAN_RADAR_82861da8_Tx: ComSignalType=UINT8
            DET_RANGE_ERR_080_oRDR_DETECTION_077_080_oPCAN_RADAR_8fc2bcb2_Tx: ComSignalType=UINT8
            DET_RANGE_VELOCITY_077_oRDR_DETECTION_077_080_oPCAN_RADAR_e9a82336_Tx: ComSignalType=UINT16
            DET_RANGE_VELOCITY_078_oRDR_DETECTION_077_080_oPCAN_RADAR_c5b8b171_Tx: ComSignalType=UINT16
            DET_RANGE_VELOCITY_079_oRDR_DETECTION_077_080_oPCAN_RADAR_50c865e4_Tx: ComSignalType=UINT16
            DET_RANGE_VELOCITY_080_oRDR_DETECTION_077_080_oPCAN_RADAR_5d8cc4fe_Tx: ComSignalType=UINT16
            DET_RANGE_VELOCITY_ERR_077_oRDR_DETECTION_077_080_oPCAN_RADAR_e613d884_Tx: ComSignalType=UINT8
            DET_RANGE_VELOCITY_ERR_078_oRDR_DETECTION_077_080_oPCAN_RADAR_ca034ac3_Tx: ComSignalType=UINT8
            DET_RANGE_VELOCITY_ERR_079_oRDR_DETECTION_077_080_oPCAN_RADAR_5f739e56_Tx: ComSignalType=UINT8
            DET_RANGE_VELOCITY_ERR_080_oRDR_DETECTION_077_080_oPCAN_RADAR_52373f4c_Tx: ComSignalType=UINT8
            DET_RCS_077_oRDR_DETECTION_077_080_oPCAN_RADAR_6e28146c_Tx: ComSignalType=UINT8
            DET_RCS_078_oRDR_DETECTION_077_080_oPCAN_RADAR_4238862b_Tx: ComSignalType=UINT8
            DET_RCS_079_oRDR_DETECTION_077_080_oPCAN_RADAR_d74852be_Tx: ComSignalType=UINT8
            DET_RCS_080_oRDR_DETECTION_077_080_oPCAN_RADAR_da0cf3a4_Tx: ComSignalType=UINT8
            DET_SNR_077_oRDR_DETECTION_077_080_oPCAN_RADAR_b386406e_Tx: ComSignalType=UINT8
            DET_SNR_078_oRDR_DETECTION_077_080_oPCAN_RADAR_9f96d229_Tx: ComSignalType=UINT8
            DET_SNR_079_oRDR_DETECTION_077_080_oPCAN_RADAR_0ae606bc_Tx: ComSignalType=UINT8
            DET_SNR_080_oRDR_DETECTION_077_080_oPCAN_RADAR_07a2a7a6_Tx: ComSignalType=UINT8
            DET_SUPER_RES_TARGET_077_oRDR_DETECTION_077_080_oPCAN_RADAR_821f680b_Tx: ComSignalType=BOOLEAN
            DET_SUPER_RES_TARGET_078_oRDR_DETECTION_077_080_oPCAN_RADAR_ae0ffa4c_Tx: ComSignalType=BOOLEAN
            DET_SUPER_RES_TARGET_079_oRDR_DETECTION_077_080_oPCAN_RADAR_3b7f2ed9_Tx: ComSignalType=BOOLEAN
            DET_SUPER_RES_TARGET_080_oRDR_DETECTION_077_080_oPCAN_RADAR_363b8fc3_Tx: ComSignalType=BOOLEAN
        SG_Detections_081_084_oRDR_DETECTION_081_084_oPCAN_RADAR_0a9e14ed_Tx
          83 x ComGroupSignal:
            DET_AZIMUTH_081_oRDR_DETECTION_081_084_oPCAN_RADAR_3c33d803_Tx: ComSignalType=UINT16
            DET_AZIMUTH_082_oRDR_DETECTION_081_084_oPCAN_RADAR_58d3a3fd_Tx: ComSignalType=UINT16
            DET_AZIMUTH_083_oRDR_DETECTION_081_084_oPCAN_RADAR_cda37768_Tx: ComSignalType=UINT16
            DET_AZIMUTH_084_oRDR_DETECTION_081_084_oPCAN_RADAR_91135401_Tx: ComSignalType=UINT16
            DET_AZIMUTH_ERR_081_oRDR_DETECTION_081_084_oPCAN_RADAR_98864df6_Tx: ComSignalType=UINT8
            DET_AZIMUTH_ERR_082_oRDR_DETECTION_081_084_oPCAN_RADAR_fc663608_Tx: ComSignalType=UINT8
            DET_AZIMUTH_ERR_083_oRDR_DETECTION_081_084_oPCAN_RADAR_6916e29d_Tx: ComSignalType=UINT8
            DET_AZIMUTH_ERR_084_oRDR_DETECTION_081_084_oPCAN_RADAR_35a6c1f4_Tx: ComSignalType=UINT8
            DET_BELOW_RAIN_THOLD_081_oRDR_DETECTION_081_084_oPCAN_RADAR_e9324bc3_Tx: ComSignalType=UINT8
            DET_BELOW_RAIN_THOLD_082_oRDR_DETECTION_081_084_oPCAN_RADAR_8dd2303d_Tx: ComSignalType=UINT8
            DET_BELOW_RAIN_THOLD_083_oRDR_DETECTION_081_084_oPCAN_RADAR_18a2e4a8_Tx: ComSignalType=UINT8
            DET_BELOW_RAIN_THOLD_084_oRDR_DETECTION_081_084_oPCAN_RADAR_4412c7c1_Tx: ComSignalType=UINT8
            DET_BI_STATIC_FLAG_081_oRDR_DETECTION_081_084_oPCAN_RADAR_6a1f9886_Tx: ComSignalType=BOOLEAN
            DET_BI_STATIC_FLAG_082_oRDR_DETECTION_081_084_oPCAN_RADAR_0effe378_Tx: ComSignalType=BOOLEAN
            DET_BI_STATIC_FLAG_083_oRDR_DETECTION_081_084_oPCAN_RADAR_9b8f37ed_Tx: ComSignalType=BOOLEAN
            DET_BI_STATIC_FLAG_084_oRDR_DETECTION_081_084_oPCAN_RADAR_c73f1484_Tx: ComSignalType=BOOLEAN
            DET_CONFD_AZIMUTH_081_oRDR_DETECTION_081_084_oPCAN_RADAR_3ed5d2c9_Tx: ComSignalType=UINT8
            DET_CONFD_AZIMUTH_082_oRDR_DETECTION_081_084_oPCAN_RADAR_5a35a937_Tx: ComSignalType=UINT8
            DET_CONFD_AZIMUTH_083_oRDR_DETECTION_081_084_oPCAN_RADAR_cf457da2_Tx: ComSignalType=UINT8
            DET_CONFD_AZIMUTH_084_oRDR_DETECTION_081_084_oPCAN_RADAR_93f55ecb_Tx: ComSignalType=UINT8
            DET_CONFD_ELEVATION_081_oRDR_DETECTION_081_084_oPCAN_RADAR_3c40d333_Tx: ComSignalType=UINT8
            DET_CONFD_ELEVATION_082_oRDR_DETECTION_081_084_oPCAN_RADAR_58a0a8cd_Tx: ComSignalType=UINT8
            DET_CONFD_ELEVATION_083_oRDR_DETECTION_081_084_oPCAN_RADAR_cdd07c58_Tx: ComSignalType=UINT8
            DET_CONFD_ELEVATION_084_oRDR_DETECTION_081_084_oPCAN_RADAR_91605f31_Tx: ComSignalType=UINT8
            DET_ELEVATION_081_oRDR_DETECTION_081_084_oPCAN_RADAR_ed80070f_Tx: ComSignalType=UINT8
            DET_ELEVATION_082_oRDR_DETECTION_081_084_oPCAN_RADAR_89607cf1_Tx: ComSignalType=UINT8
            DET_ELEVATION_083_oRDR_DETECTION_081_084_oPCAN_RADAR_1c10a864_Tx: ComSignalType=UINT8
            DET_ELEVATION_084_oRDR_DETECTION_081_084_oPCAN_RADAR_40a08b0d_Tx: ComSignalType=UINT8
            DET_ELEVATION_ERR_081_oRDR_DETECTION_081_084_oPCAN_RADAR_6ab99f7a_Tx: ComSignalType=UINT8
            DET_ELEVATION_ERR_082_oRDR_DETECTION_081_084_oPCAN_RADAR_0e59e484_Tx: ComSignalType=UINT8
            DET_ELEVATION_ERR_083_oRDR_DETECTION_081_084_oPCAN_RADAR_9b293011_Tx: ComSignalType=UINT8
            DET_ELEVATION_ERR_084_oRDR_DETECTION_081_084_oPCAN_RADAR_c7991378_Tx: ComSignalType=UINT8
            DET_EXISTENCE_PROB_081_oRDR_DETECTION_081_084_oPCAN_RADAR_b826ea1a_Tx: ComSignalType=UINT8
            DET_EXISTENCE_PROB_082_oRDR_DETECTION_081_084_oPCAN_RADAR_dcc691e4_Tx: ComSignalType=UINT8
            DET_EXISTENCE_PROB_083_oRDR_DETECTION_081_084_oPCAN_RADAR_49b64571_Tx: ComSignalType=UINT8
            DET_EXISTENCE_PROB_084_oRDR_DETECTION_081_084_oPCAN_RADAR_15066618_Tx: ComSignalType=UINT8
            DET_HVC_FLAG_081_oRDR_DETECTION_081_084_oPCAN_RADAR_5952a965_Tx: ComSignalType=BOOLEAN
            DET_HVC_FLAG_082_oRDR_DETECTION_081_084_oPCAN_RADAR_3db2d29b_Tx: ComSignalType=BOOLEAN
            DET_HVC_FLAG_083_oRDR_DETECTION_081_084_oPCAN_RADAR_a8c2060e_Tx: ComSignalType=BOOLEAN
            DET_HVC_FLAG_084_oRDR_DETECTION_081_084_oPCAN_RADAR_f4722567_Tx: ComSignalType=BOOLEAN
            DET_IDM_081_oRDR_DETECTION_081_084_oPCAN_RADAR_d20092d8_Tx: ComSignalType=UINT8
            DET_IDM_082_oRDR_DETECTION_081_084_oPCAN_RADAR_b6e0e926_Tx: ComSignalType=UINT8
            DET_IDM_083_oRDR_DETECTION_081_084_oPCAN_RADAR_23903db3_Tx: ComSignalType=UINT8
            DET_IDM_084_oRDR_DETECTION_081_084_oPCAN_RADAR_7f201eda_Tx: ComSignalType=UINT8
            DET_MH_CRC16_081_084_oRDR_DETECTION_081_084_oPCAN_RADAR_8e16c6e6_Tx: ComSignalType=UINT16
            DET_MH_CYCLE_COUNTER_081_084_oRDR_DETECTION_081_084_oPCAN_RADAR_0a6367d1_Tx: ComSignalType=UINT8
            DET_MH_SCAN_INDEX_4LSB_081_084_oRDR_DETECTION_081_084_oPCAN_RADAR_c649425d_Tx: ComSignalType=UINT8
            DET_MTD_081_oRDR_DETECTION_081_084_oPCAN_RADAR_b4b3a003_Tx: ComSignalType=UINT8
            DET_MTD_082_oRDR_DETECTION_081_084_oPCAN_RADAR_d053dbfd_Tx: ComSignalType=UINT8
            DET_MTD_083_oRDR_DETECTION_081_084_oPCAN_RADAR_45230f68_Tx: ComSignalType=UINT8
            DET_MTD_084_oRDR_DETECTION_081_084_oPCAN_RADAR_19932c01_Tx: ComSignalType=UINT8
            DET_PROB_1STAZHYPO_081_oRDR_DETECTION_081_084_oPCAN_RADAR_270748ce_Tx: ComSignalType=BOOLEAN
            DET_PROB_1STAZHYPO_082_oRDR_DETECTION_081_084_oPCAN_RADAR_43e73330_Tx: ComSignalType=BOOLEAN
            DET_PROB_1STAZHYPO_083_oRDR_DETECTION_081_084_oPCAN_RADAR_d697e7a5_Tx: ComSignalType=BOOLEAN
            DET_PROB_1STAZHYPO_084_oRDR_DETECTION_081_084_oPCAN_RADAR_8a27c4cc_Tx: ComSignalType=BOOLEAN
            DET_RANGE_081_oRDR_DETECTION_081_084_oPCAN_RADAR_2ca8abb8_Tx: ComSignalType=UINT16
            DET_RANGE_082_oRDR_DETECTION_081_084_oPCAN_RADAR_4848d046_Tx: ComSignalType=UINT16
            DET_RANGE_083_oRDR_DETECTION_081_084_oPCAN_RADAR_dd3804d3_Tx: ComSignalType=UINT16
            DET_RANGE_084_oRDR_DETECTION_081_084_oPCAN_RADAR_818827ba_Tx: ComSignalType=UINT16
            DET_RANGE_ERR_081_oRDR_DETECTION_081_084_oPCAN_RADAR_8b4011d1_Tx: ComSignalType=UINT8
            DET_RANGE_ERR_082_oRDR_DETECTION_081_084_oPCAN_RADAR_efa06a2f_Tx: ComSignalType=UINT8
            DET_RANGE_ERR_083_oRDR_DETECTION_081_084_oPCAN_RADAR_7ad0beba_Tx: ComSignalType=UINT8
            DET_RANGE_ERR_084_oRDR_DETECTION_081_084_oPCAN_RADAR_26609dd3_Tx: ComSignalType=UINT8
            DET_RANGE_VELOCITY_081_oRDR_DETECTION_081_084_oPCAN_RADAR_590e699d_Tx: ComSignalType=UINT16
            DET_RANGE_VELOCITY_082_oRDR_DETECTION_081_084_oPCAN_RADAR_3dee1263_Tx: ComSignalType=UINT16
            DET_RANGE_VELOCITY_083_oRDR_DETECTION_081_084_oPCAN_RADAR_a89ec6f6_Tx: ComSignalType=UINT16
            DET_RANGE_VELOCITY_084_oRDR_DETECTION_081_084_oPCAN_RADAR_f42ee59f_Tx: ComSignalType=UINT16
            DET_RANGE_VELOCITY_ERR_081_oRDR_DETECTION_081_084_oPCAN_RADAR_56b5922f_Tx: ComSignalType=UINT8
            DET_RANGE_VELOCITY_ERR_082_oRDR_DETECTION_081_084_oPCAN_RADAR_3255e9d1_Tx: ComSignalType=UINT8
            DET_RANGE_VELOCITY_ERR_083_oRDR_DETECTION_081_084_oPCAN_RADAR_a7253d44_Tx: ComSignalType=UINT8
            DET_RANGE_VELOCITY_ERR_084_oRDR_DETECTION_081_084_oPCAN_RADAR_fb951e2d_Tx: ComSignalType=UINT8
            DET_RCS_081_oRDR_DETECTION_081_084_oPCAN_RADAR_de8e5ec7_Tx: ComSignalType=UINT8
            DET_RCS_082_oRDR_DETECTION_081_084_oPCAN_RADAR_ba6e2539_Tx: ComSignalType=UINT8
            DET_RCS_083_oRDR_DETECTION_081_084_oPCAN_RADAR_2f1ef1ac_Tx: ComSignalType=UINT8
            DET_RCS_084_oRDR_DETECTION_081_084_oPCAN_RADAR_73aed2c5_Tx: ComSignalType=UINT8
            DET_SNR_081_oRDR_DETECTION_081_084_oPCAN_RADAR_03200ac5_Tx: ComSignalType=UINT8
            DET_SNR_082_oRDR_DETECTION_081_084_oPCAN_RADAR_67c0713b_Tx: ComSignalType=UINT8
            DET_SNR_083_oRDR_DETECTION_081_084_oPCAN_RADAR_f2b0a5ae_Tx: ComSignalType=UINT8
            DET_SNR_084_oRDR_DETECTION_081_084_oPCAN_RADAR_ae0086c7_Tx: ComSignalType=UINT8
            DET_SUPER_RES_TARGET_081_oRDR_DETECTION_081_084_oPCAN_RADAR_32b922a0_Tx: ComSignalType=BOOLEAN
            DET_SUPER_RES_TARGET_082_oRDR_DETECTION_081_084_oPCAN_RADAR_5659595e_Tx: ComSignalType=BOOLEAN
            DET_SUPER_RES_TARGET_083_oRDR_DETECTION_081_084_oPCAN_RADAR_c3298dcb_Tx: ComSignalType=BOOLEAN
            DET_SUPER_RES_TARGET_084_oRDR_DETECTION_081_084_oPCAN_RADAR_9f99aea2_Tx: ComSignalType=BOOLEAN
        SG_Detections_085_088_oRDR_DETECTION_085_088_oPCAN_RADAR_7b5d20bf_Tx
          83 x ComGroupSignal:
            DET_AZIMUTH_085_oRDR_DETECTION_085_088_oPCAN_RADAR_edd11ea0_Tx: ComSignalType=UINT16
            DET_AZIMUTH_086_oRDR_DETECTION_085_088_oPCAN_RADAR_8931655e_Tx: ComSignalType=UINT16
            DET_AZIMUTH_087_oRDR_DETECTION_085_088_oPCAN_RADAR_1c41b1cb_Tx: ComSignalType=UINT16
            DET_AZIMUTH_088_oRDR_DETECTION_085_088_oPCAN_RADAR_3051238c_Tx: ComSignalType=UINT16
            DET_AZIMUTH_ERR_085_oRDR_DETECTION_085_088_oPCAN_RADAR_49648b55_Tx: ComSignalType=UINT8
            DET_AZIMUTH_ERR_086_oRDR_DETECTION_085_088_oPCAN_RADAR_2d84f0ab_Tx: ComSignalType=UINT8
            DET_AZIMUTH_ERR_087_oRDR_DETECTION_085_088_oPCAN_RADAR_b8f4243e_Tx: ComSignalType=UINT8
            DET_AZIMUTH_ERR_088_oRDR_DETECTION_085_088_oPCAN_RADAR_94e4b679_Tx: ComSignalType=UINT8
            DET_BELOW_RAIN_THOLD_085_oRDR_DETECTION_085_088_oPCAN_RADAR_38d08d60_Tx: ComSignalType=UINT8
            DET_BELOW_RAIN_THOLD_086_oRDR_DETECTION_085_088_oPCAN_RADAR_5c30f69e_Tx: ComSignalType=UINT8
            DET_BELOW_RAIN_THOLD_087_oRDR_DETECTION_085_088_oPCAN_RADAR_c940220b_Tx: ComSignalType=UINT8
            DET_BELOW_RAIN_THOLD_088_oRDR_DETECTION_085_088_oPCAN_RADAR_e550b04c_Tx: ComSignalType=UINT8
            DET_BI_STATIC_FLAG_085_oRDR_DETECTION_085_088_oPCAN_RADAR_bbfd5e25_Tx: ComSignalType=BOOLEAN
            DET_BI_STATIC_FLAG_086_oRDR_DETECTION_085_088_oPCAN_RADAR_df1d25db_Tx: ComSignalType=BOOLEAN
            DET_BI_STATIC_FLAG_087_oRDR_DETECTION_085_088_oPCAN_RADAR_4a6df14e_Tx: ComSignalType=BOOLEAN
            DET_BI_STATIC_FLAG_088_oRDR_DETECTION_085_088_oPCAN_RADAR_667d6309_Tx: ComSignalType=BOOLEAN
            DET_CONFD_AZIMUTH_085_oRDR_DETECTION_085_088_oPCAN_RADAR_ef37146a_Tx: ComSignalType=UINT8
            DET_CONFD_AZIMUTH_086_oRDR_DETECTION_085_088_oPCAN_RADAR_8bd76f94_Tx: ComSignalType=UINT8
            DET_CONFD_AZIMUTH_087_oRDR_DETECTION_085_088_oPCAN_RADAR_1ea7bb01_Tx: ComSignalType=UINT8
            DET_CONFD_AZIMUTH_088_oRDR_DETECTION_085_088_oPCAN_RADAR_32b72946_Tx: ComSignalType=UINT8
            DET_CONFD_ELEVATION_085_oRDR_DETECTION_085_088_oPCAN_RADAR_eda21590_Tx: ComSignalType=UINT8
            DET_CONFD_ELEVATION_086_oRDR_DETECTION_085_088_oPCAN_RADAR_89426e6e_Tx: ComSignalType=UINT8
            DET_CONFD_ELEVATION_087_oRDR_DETECTION_085_088_oPCAN_RADAR_1c32bafb_Tx: ComSignalType=UINT8
            DET_CONFD_ELEVATION_088_oRDR_DETECTION_085_088_oPCAN_RADAR_302228bc_Tx: ComSignalType=UINT8
            DET_ELEVATION_085_oRDR_DETECTION_085_088_oPCAN_RADAR_3c62c1ac_Tx: ComSignalType=UINT8
            DET_ELEVATION_086_oRDR_DETECTION_085_088_oPCAN_RADAR_5882ba52_Tx: ComSignalType=UINT8
            DET_ELEVATION_087_oRDR_DETECTION_085_088_oPCAN_RADAR_cdf26ec7_Tx: ComSignalType=UINT8
            DET_ELEVATION_088_oRDR_DETECTION_085_088_oPCAN_RADAR_e1e2fc80_Tx: ComSignalType=UINT8
            DET_ELEVATION_ERR_085_oRDR_DETECTION_085_088_oPCAN_RADAR_bb5b59d9_Tx: ComSignalType=UINT8
            DET_ELEVATION_ERR_086_oRDR_DETECTION_085_088_oPCAN_RADAR_dfbb2227_Tx: ComSignalType=UINT8
            DET_ELEVATION_ERR_087_oRDR_DETECTION_085_088_oPCAN_RADAR_4acbf6b2_Tx: ComSignalType=UINT8
            DET_ELEVATION_ERR_088_oRDR_DETECTION_085_088_oPCAN_RADAR_66db64f5_Tx: ComSignalType=UINT8
            DET_EXISTENCE_PROB_085_oRDR_DETECTION_085_088_oPCAN_RADAR_69c42cb9_Tx: ComSignalType=UINT8
            DET_EXISTENCE_PROB_086_oRDR_DETECTION_085_088_oPCAN_RADAR_0d245747_Tx: ComSignalType=UINT8
            DET_EXISTENCE_PROB_087_oRDR_DETECTION_085_088_oPCAN_RADAR_985483d2_Tx: ComSignalType=UINT8
            DET_EXISTENCE_PROB_088_oRDR_DETECTION_085_088_oPCAN_RADAR_b4441195_Tx: ComSignalType=UINT8
            DET_HVC_FLAG_085_oRDR_DETECTION_085_088_oPCAN_RADAR_88b06fc6_Tx: ComSignalType=BOOLEAN
            DET_HVC_FLAG_086_oRDR_DETECTION_085_088_oPCAN_RADAR_ec501438_Tx: ComSignalType=BOOLEAN
            DET_HVC_FLAG_087_oRDR_DETECTION_085_088_oPCAN_RADAR_7920c0ad_Tx: ComSignalType=BOOLEAN
            DET_HVC_FLAG_088_oRDR_DETECTION_085_088_oPCAN_RADAR_553052ea_Tx: ComSignalType=BOOLEAN
            DET_IDM_085_oRDR_DETECTION_085_088_oPCAN_RADAR_03e2547b_Tx: ComSignalType=UINT8
            DET_IDM_086_oRDR_DETECTION_085_088_oPCAN_RADAR_67022f85_Tx: ComSignalType=UINT8
            DET_IDM_087_oRDR_DETECTION_085_088_oPCAN_RADAR_f272fb10_Tx: ComSignalType=UINT8
            DET_IDM_088_oRDR_DETECTION_085_088_oPCAN_RADAR_de626957_Tx: ComSignalType=UINT8
            DET_MH_CRC16_085_088_oRDR_DETECTION_085_088_oPCAN_RADAR_ffd5f2b4_Tx: ComSignalType=UINT16
            DET_MH_CYCLE_COUNTER_085_088_oRDR_DETECTION_085_088_oPCAN_RADAR_7ba05383_Tx: ComSignalType=UINT8
            DET_MH_SCAN_INDEX_4LSB_085_088_oRDR_DETECTION_085_088_oPCAN_RADAR_b78a760f_Tx: ComSignalType=UINT8
            DET_MTD_085_oRDR_DETECTION_085_088_oPCAN_RADAR_655166a0_Tx: ComSignalType=UINT8
            DET_MTD_086_oRDR_DETECTION_085_088_oPCAN_RADAR_01b11d5e_Tx: ComSignalType=UINT8
            DET_MTD_087_oRDR_DETECTION_085_088_oPCAN_RADAR_94c1c9cb_Tx: ComSignalType=UINT8
            DET_MTD_088_oRDR_DETECTION_085_088_oPCAN_RADAR_b8d15b8c_Tx: ComSignalType=UINT8
            DET_PROB_1STAZHYPO_085_oRDR_DETECTION_085_088_oPCAN_RADAR_f6e58e6d_Tx: ComSignalType=BOOLEAN
            DET_PROB_1STAZHYPO_086_oRDR_DETECTION_085_088_oPCAN_RADAR_9205f593_Tx: ComSignalType=BOOLEAN
            DET_PROB_1STAZHYPO_087_oRDR_DETECTION_085_088_oPCAN_RADAR_07752106_Tx: ComSignalType=BOOLEAN
            DET_PROB_1STAZHYPO_088_oRDR_DETECTION_085_088_oPCAN_RADAR_2b65b341_Tx: ComSignalType=BOOLEAN
            DET_RANGE_085_oRDR_DETECTION_085_088_oPCAN_RADAR_fd4a6d1b_Tx: ComSignalType=UINT16
            DET_RANGE_086_oRDR_DETECTION_085_088_oPCAN_RADAR_99aa16e5_Tx: ComSignalType=UINT16
            DET_RANGE_087_oRDR_DETECTION_085_088_oPCAN_RADAR_0cdac270_Tx: ComSignalType=UINT16
            DET_RANGE_088_oRDR_DETECTION_085_088_oPCAN_RADAR_20ca5037_Tx: ComSignalType=UINT16
            DET_RANGE_ERR_085_oRDR_DETECTION_085_088_oPCAN_RADAR_5aa2d772_Tx: ComSignalType=UINT8
            DET_RANGE_ERR_086_oRDR_DETECTION_085_088_oPCAN_RADAR_3e42ac8c_Tx: ComSignalType=UINT8
            DET_RANGE_ERR_087_oRDR_DETECTION_085_088_oPCAN_RADAR_ab327819_Tx: ComSignalType=UINT8
            DET_RANGE_ERR_088_oRDR_DETECTION_085_088_oPCAN_RADAR_8722ea5e_Tx: ComSignalType=UINT8
            DET_RANGE_VELOCITY_085_oRDR_DETECTION_085_088_oPCAN_RADAR_88ecaf3e_Tx: ComSignalType=UINT16
            DET_RANGE_VELOCITY_086_oRDR_DETECTION_085_088_oPCAN_RADAR_ec0cd4c0_Tx: ComSignalType=UINT16
            DET_RANGE_VELOCITY_087_oRDR_DETECTION_085_088_oPCAN_RADAR_797c0055_Tx: ComSignalType=UINT16
            DET_RANGE_VELOCITY_088_oRDR_DETECTION_085_088_oPCAN_RADAR_556c9212_Tx: ComSignalType=UINT16
            DET_RANGE_VELOCITY_ERR_085_oRDR_DETECTION_085_088_oPCAN_RADAR_8757548c_Tx: ComSignalType=UINT8
            DET_RANGE_VELOCITY_ERR_086_oRDR_DETECTION_085_088_oPCAN_RADAR_e3b72f72_Tx: ComSignalType=UINT8
            DET_RANGE_VELOCITY_ERR_087_oRDR_DETECTION_085_088_oPCAN_RADAR_76c7fbe7_Tx: ComSignalType=UINT8
            DET_RANGE_VELOCITY_ERR_088_oRDR_DETECTION_085_088_oPCAN_RADAR_5ad769a0_Tx: ComSignalType=UINT8
            DET_RCS_085_oRDR_DETECTION_085_088_oPCAN_RADAR_0f6c9864_Tx: ComSignalType=UINT8
            DET_RCS_086_oRDR_DETECTION_085_088_oPCAN_RADAR_6b8ce39a_Tx: ComSignalType=UINT8
            DET_RCS_087_oRDR_DETECTION_085_088_oPCAN_RADAR_fefc370f_Tx: ComSignalType=UINT8
            DET_RCS_088_oRDR_DETECTION_085_088_oPCAN_RADAR_d2eca548_Tx: ComSignalType=UINT8
            DET_SNR_085_oRDR_DETECTION_085_088_oPCAN_RADAR_d2c2cc66_Tx: ComSignalType=UINT8
            DET_SNR_086_oRDR_DETECTION_085_088_oPCAN_RADAR_b622b798_Tx: ComSignalType=UINT8
            DET_SNR_087_oRDR_DETECTION_085_088_oPCAN_RADAR_2352630d_Tx: ComSignalType=UINT8
            DET_SNR_088_oRDR_DETECTION_085_088_oPCAN_RADAR_0f42f14a_Tx: ComSignalType=UINT8
            DET_SUPER_RES_TARGET_085_oRDR_DETECTION_085_088_oPCAN_RADAR_e35be403_Tx: ComSignalType=BOOLEAN
            DET_SUPER_RES_TARGET_086_oRDR_DETECTION_085_088_oPCAN_RADAR_87bb9ffd_Tx: ComSignalType=BOOLEAN
            DET_SUPER_RES_TARGET_087_oRDR_DETECTION_085_088_oPCAN_RADAR_12cb4b68_Tx: ComSignalType=BOOLEAN
            DET_SUPER_RES_TARGET_088_oRDR_DETECTION_085_088_oPCAN_RADAR_3edbd92f_Tx: ComSignalType=BOOLEAN
