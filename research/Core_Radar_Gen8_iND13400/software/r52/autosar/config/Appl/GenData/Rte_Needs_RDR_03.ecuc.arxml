[part 4 of 8: package /DaVinci_Project]
AUTOSAR XML (schema 4-0-3)
package /DaVinci_Project  (continued)
  module config Com  (continued)
    ComConfig  (continued)
      239 x ComSignalGroup:  (continued)
        SG_Detections_273_276_oRDR_DETECTION_273_276_oPCAN_RADAR_df34482a_Tx
          83 x ComGroupSignal:
            DET_AZIMUTH_273_oRDR_DETECTION_273_276_oPCAN_RADAR_2deecc3e_Tx: ComSignalType=UINT16
            DET_AZIMUTH_274_oRDR_DETECTION_273_276_oPCAN_RADAR_715eef57_Tx: ComSignalType=UINT16
            DET_AZIMUTH_275_oRDR_DETECTION_273_276_oPCAN_RADAR_e42e3bc2_Tx: ComSignalType=UINT16
            DET_AZIMUTH_276_oRDR_DETECTION_273_276_oPCAN_RADAR_80ce403c_Tx: ComSignalType=UINT16
            DET_AZIMUTH_ERR_273_oRDR_DETECTION_273_276_oPCAN_RADAR_895b59cb_Tx: ComSignalType=UINT8
            DET_AZIMUTH_ERR_274_oRDR_DETECTION_273_276_oPCAN_RADAR_d5eb7aa2_Tx: ComSignalType=UINT8
            DET_AZIMUTH_ERR_275_oRDR_DETECTION_273_276_oPCAN_RADAR_409bae37_Tx: ComSignalType=UINT8
            DET_AZIMUTH_ERR_276_oRDR_DETECTION_273_276_oPCAN_RADAR_247bd5c9_Tx: ComSignalType=UINT8
            DET_BELOW_RAIN_THOLD_273_oRDR_DETECTION_273_276_oPCAN_RADAR_f8ef5ffe_Tx: ComSignalType=UINT8
            DET_BELOW_RAIN_THOLD_274_oRDR_DETECTION_273_276_oPCAN_RADAR_a45f7c97_Tx: ComSignalType=UINT8
            DET_BELOW_RAIN_THOLD_275_oRDR_DETECTION_273_276_oPCAN_RADAR_312fa802_Tx: ComSignalType=UINT8
            DET_BELOW_RAIN_THOLD_276_oRDR_DETECTION_273_276_oPCAN_RADAR_55cfd3fc_Tx: ComSignalType=UINT8
            DET_BI_STATIC_FLAG_273_oRDR_DETECTION_273_276_oPCAN_RADAR_7bc28cbb_Tx: ComSignalType=BOOLEAN
            DET_BI_STATIC_FLAG_274_oRDR_DETECTION_273_276_oPCAN_RADAR_2772afd2_Tx: ComSignalType=BOOLEAN
            DET_BI_STATIC_FLAG_275_oRDR_DETECTION_273_276_oPCAN_RADAR_b2027b47_Tx: ComSignalType=BOOLEAN
            DET_BI_STATIC_FLAG_276_oRDR_DETECTION_273_276_oPCAN_RADAR_d6e200b9_Tx: ComSignalType=BOOLEAN
            DET_CONFD_AZIMUTH_273_oRDR_DETECTION_273_276_oPCAN_RADAR_2f08c6f4_Tx: ComSignalType=UINT8
            DET_CONFD_AZIMUTH_274_oRDR_DETECTION_273_276_oPCAN_RADAR_73b8e59d_Tx: ComSignalType=UINT8
            DET_CONFD_AZIMUTH_275_oRDR_DETECTION_273_276_oPCAN_RADAR_e6c83108_Tx: ComSignalType=UINT8
            DET_CONFD_AZIMUTH_276_oRDR_DETECTION_273_276_oPCAN_RADAR_82284af6_Tx: ComSignalType=UINT8
            DET_CONFD_ELEVATION_273_oRDR_DETECTION_273_276_oPCAN_RADAR_2d9dc70e_Tx: ComSignalType=UINT8
            DET_CONFD_ELEVATION_274_oRDR_DETECTION_273_276_oPCAN_RADAR_712de467_Tx: ComSignalType=UINT8
            DET_CONFD_ELEVATION_275_oRDR_DETECTION_273_276_oPCAN_RADAR_e45d30f2_Tx: ComSignalType=UINT8
            DET_CONFD_ELEVATION_276_oRDR_DETECTION_273_276_oPCAN_RADAR_80bd4b0c_Tx: ComSignalType=UINT8
            DET_ELEVATION_273_oRDR_DETECTION_273_276_oPCAN_RADAR_fc5d1332_Tx: ComSignalType=UINT8
            DET_ELEVATION_274_oRDR_DETECTION_273_276_oPCAN_RADAR_a0ed305b_Tx: ComSignalType=UINT8
            DET_ELEVATION_275_oRDR_DETECTION_273_276_oPCAN_RADAR_359de4ce_Tx: ComSignalType=UINT8
            DET_ELEVATION_276_oRDR_DETECTION_273_276_oPCAN_RADAR_517d9f30_Tx: ComSignalType=UINT8
            DET_ELEVATION_ERR_273_oRDR_DETECTION_273_276_oPCAN_RADAR_7b648b47_Tx: ComSignalType=UINT8
            DET_ELEVATION_ERR_274_oRDR_DETECTION_273_276_oPCAN_RADAR_27d4a82e_Tx: ComSignalType=UINT8
            DET_ELEVATION_ERR_275_oRDR_DETECTION_273_276_oPCAN_RADAR_b2a47cbb_Tx: ComSignalType=UINT8
            DET_ELEVATION_ERR_276_oRDR_DETECTION_273_276_oPCAN_RADAR_d6440745_Tx: ComSignalType=UINT8
            DET_EXISTENCE_PROB_273_oRDR_DETECTION_273_276_oPCAN_RADAR_a9fbfe27_Tx: ComSignalType=UINT8
            DET_EXISTENCE_PROB_274_oRDR_DETECTION_273_276_oPCAN_RADAR_f54bdd4e_Tx: ComSignalType=UINT8
            DET_EXISTENCE_PROB_275_oRDR_DETECTION_273_276_oPCAN_RADAR_603b09db_Tx: ComSignalType=UINT8
            DET_EXISTENCE_PROB_276_oRDR_DETECTION_273_276_oPCAN_RADAR_04db7225_Tx: ComSignalType=UINT8
            DET_HVC_FLAG_273_oRDR_DETECTION_273_276_oPCAN_RADAR_488fbd58_Tx: ComSignalType=BOOLEAN
            DET_HVC_FLAG_274_oRDR_DETECTION_273_276_oPCAN_RADAR_143f9e31_Tx: ComSignalType=BOOLEAN
            DET_HVC_FLAG_275_oRDR_DETECTION_273_276_oPCAN_RADAR_814f4aa4_Tx: ComSignalType=BOOLEAN
            DET_HVC_FLAG_276_oRDR_DETECTION_273_276_oPCAN_RADAR_e5af315a_Tx: ComSignalType=BOOLEAN
            DET_IDM_273_oRDR_DETECTION_273_276_oPCAN_RADAR_c3dd86e5_Tx: ComSignalType=UINT8
            DET_IDM_274_oRDR_DETECTION_273_276_oPCAN_RADAR_9f6da58c_Tx: ComSignalType=UINT8
            DET_IDM_275_oRDR_DETECTION_273_276_oPCAN_RADAR_0a1d7119_Tx: ComSignalType=UINT8
            DET_IDM_276_oRDR_DETECTION_273_276_oPCAN_RADAR_6efd0ae7_Tx: ComSignalType=UINT8
            DET_MH_CRC16_273_276_oRDR_DETECTION_273_276_oPCAN_RADAR_5bbc9a21_Tx: ComSignalType=UINT16
            DET_MH_CYCLE_COUNTER_273_276_oRDR_DETECTION_273_276_oPCAN_RADAR_dfc93b16_Tx: ComSignalType=UINT8
            DET_MH_SCAN_INDEX_4LSB_273_276_oRDR_DETECTION_273_276_oPCAN_RADAR_13e31e9a_Tx: ComSignalType=UINT8
            DET_MTD_273_oRDR_DETECTION_273_276_oPCAN_RADAR_a56eb43e_Tx: ComSignalType=UINT8
            DET_MTD_274_oRDR_DETECTION_273_276_oPCAN_RADAR_f9de9757_Tx: ComSignalType=UINT8
            DET_MTD_275_oRDR_DETECTION_273_276_oPCAN_RADAR_6cae43c2_Tx: ComSignalType=UINT8
            DET_MTD_276_oRDR_DETECTION_273_276_oPCAN_RADAR_084e383c_Tx: ComSignalType=UINT8
            DET_PROB_1STAZHYPO_273_oRDR_DETECTION_273_276_oPCAN_RADAR_36da5cf3_Tx: ComSignalType=BOOLEAN
            DET_PROB_1STAZHYPO_274_oRDR_DETECTION_273_276_oPCAN_RADAR_6a6a7f9a_Tx: ComSignalType=BOOLEAN
            DET_PROB_1STAZHYPO_275_oRDR_DETECTION_273_276_oPCAN_RADAR_ff1aab0f_Tx: ComSignalType=BOOLEAN
            DET_PROB_1STAZHYPO_276_oRDR_DETECTION_273_276_oPCAN_RADAR_9bfad0f1_Tx: ComSignalType=BOOLEAN
            DET_RANGE_273_oRDR_DETECTION_273_276_oPCAN_RADAR_3d75bf85_Tx: ComSignalType=UINT16
            DET_RANGE_274_oRDR_DETECTION_273_276_oPCAN_RADAR_61c59cec_Tx: ComSignalType=UINT16
            DET_RANGE_275_oRDR_DETECTION_273_276_oPCAN_RADAR_f4b54879_Tx: ComSignalType=UINT16
            DET_RANGE_276_oRDR_DETECTION_273_276_oPCAN_RADAR_90553387_Tx: ComSignalType=UINT16
            DET_RANGE_ERR_273_oRDR_DETECTION_273_276_oPCAN_RADAR_9a9d05ec_Tx: ComSignalType=UINT8
            DET_RANGE_ERR_274_oRDR_DETECTION_273_276_oPCAN_RADAR_c62d2685_Tx: ComSignalType=UINT8
            DET_RANGE_ERR_275_oRDR_DETECTION_273_276_oPCAN_RADAR_535df210_Tx: ComSignalType=UINT8
            DET_RANGE_ERR_276_oRDR_DETECTION_273_276_oPCAN_RADAR_37bd89ee_Tx: ComSignalType=UINT8
            DET_RANGE_VELOCITY_273_oRDR_DETECTION_273_276_oPCAN_RADAR_48d37da0_Tx: ComSignalType=UINT16
            DET_RANGE_VELOCITY_274_oRDR_DETECTION_273_276_oPCAN_RADAR_14635ec9_Tx: ComSignalType=UINT16
            DET_RANGE_VELOCITY_275_oRDR_DETECTION_273_276_oPCAN_RADAR_81138a5c_Tx: ComSignalType=UINT16
            DET_RANGE_VELOCITY_276_oRDR_DETECTION_273_276_oPCAN_RADAR_e5f3f1a2_Tx: ComSignalType=UINT16
            DET_RANGE_VELOCITY_ERR_273_oRDR_DETECTION_273_276_oPCAN_RADAR_47688612_Tx: ComSignalType=UINT8
            DET_RANGE_VELOCITY_ERR_274_oRDR_DETECTION_273_276_oPCAN_RADAR_1bd8a57b_Tx: ComSignalType=UINT8
            DET_RANGE_VELOCITY_ERR_275_oRDR_DETECTION_273_276_oPCAN_RADAR_8ea871ee_Tx: ComSignalType=UINT8
            DET_RANGE_VELOCITY_ERR_276_oRDR_DETECTION_273_276_oPCAN_RADAR_ea480a10_Tx: ComSignalType=UINT8
            DET_RCS_273_oRDR_DETECTION_273_276_oPCAN_RADAR_cf534afa_Tx: ComSignalType=UINT8
            DET_RCS_274_oRDR_DETECTION_273_276_oPCAN_RADAR_93e36993_Tx: ComSignalType=UINT8
            DET_RCS_275_oRDR_DETECTION_273_276_oPCAN_RADAR_0693bd06_Tx: ComSignalType=UINT8
            DET_RCS_276_oRDR_DETECTION_273_276_oPCAN_RADAR_6273c6f8_Tx: ComSignalType=UINT8
            DET_SNR_273_oRDR_DETECTION_273_276_oPCAN_RADAR_12fd1ef8_Tx: ComSignalType=UINT8
            DET_SNR_274_oRDR_DETECTION_273_276_oPCAN_RADAR_4e4d3d91_Tx: ComSignalType=UINT8
            DET_SNR_275_oRDR_DETECTION_273_276_oPCAN_RADAR_db3de904_Tx: ComSignalType=UINT8
            DET_SNR_276_oRDR_DETECTION_273_276_oPCAN_RADAR_bfdd92fa_Tx: ComSignalType=UINT8
            DET_SUPER_RES_TARGET_273_oRDR_DETECTION_273_276_oPCAN_RADAR_2364369d_Tx: ComSignalType=BOOLEAN
            DET_SUPER_RES_TARGET_274_oRDR_DETECTION_273_276_oPCAN_RADAR_7fd415f4_Tx: ComSignalType=BOOLEAN
            DET_SUPER_RES_TARGET_275_oRDR_DETECTION_273_276_oPCAN_RADAR_eaa4c161_Tx: ComSignalType=BOOLEAN
            DET_SUPER_RES_TARGET_276_oRDR_DETECTION_273_276_oPCAN_RADAR_8e44ba9f_Tx: ComSignalType=BOOLEAN
        SG_Detections_277_280_oRDR_DETECTION_277_280_oPCAN_RADAR_ab98744c_Tx
          83 x ComGroupSignal:
            DET_AZIMUTH_277_oRDR_DETECTION_277_280_oPCAN_RADAR_90c7d84d_Tx: ComSignalType=UINT16
            DET_AZIMUTH_278_oRDR_DETECTION_277_280_oPCAN_RADAR_bcd74a0a_Tx: ComSignalType=UINT16
            DET_AZIMUTH_279_oRDR_DETECTION_277_280_oPCAN_RADAR_29a79e9f_Tx: ComSignalType=UINT16
            DET_AZIMUTH_280_oRDR_DETECTION_277_280_oPCAN_RADAR_24e33f85_Tx: ComSignalType=UINT16
            DET_AZIMUTH_ERR_277_oRDR_DETECTION_277_280_oPCAN_RADAR_34724db8_Tx: ComSignalType=UINT8
            DET_AZIMUTH_ERR_278_oRDR_DETECTION_277_280_oPCAN_RADAR_1862dfff_Tx: ComSignalType=UINT8
            DET_AZIMUTH_ERR_279_oRDR_DETECTION_277_280_oPCAN_RADAR_8d120b6a_Tx: ComSignalType=UINT8
            DET_AZIMUTH_ERR_280_oRDR_DETECTION_277_280_oPCAN_RADAR_8056aa70_Tx: ComSignalType=UINT8
            DET_BELOW_RAIN_THOLD_277_oRDR_DETECTION_277_280_oPCAN_RADAR_45c64b8d_Tx: ComSignalType=UINT8
            DET_BELOW_RAIN_THOLD_278_oRDR_DETECTION_277_280_oPCAN_RADAR_69d6d9ca_Tx: ComSignalType=UINT8
            DET_BELOW_RAIN_THOLD_279_oRDR_DETECTION_277_280_oPCAN_RADAR_fca60d5f_Tx: ComSignalType=UINT8
            DET_BELOW_RAIN_THOLD_280_oRDR_DETECTION_277_280_oPCAN_RADAR_f1e2ac45_Tx: ComSignalType=UINT8
            DET_BI_STATIC_FLAG_277_oRDR_DETECTION_277_280_oPCAN_RADAR_c6eb98c8_Tx: ComSignalType=BOOLEAN
            DET_BI_STATIC_FLAG_278_oRDR_DETECTION_277_280_oPCAN_RADAR_eafb0a8f_Tx: ComSignalType=BOOLEAN
            DET_BI_STATIC_FLAG_279_oRDR_DETECTION_277_280_oPCAN_RADAR_7f8bde1a_Tx: ComSignalType=BOOLEAN
            DET_BI_STATIC_FLAG_280_oRDR_DETECTION_277_280_oPCAN_RADAR_72cf7f00_Tx: ComSignalType=BOOLEAN
            DET_CONFD_AZIMUTH_277_oRDR_DETECTION_277_280_oPCAN_RADAR_9221d287_Tx: ComSignalType=UINT8
            DET_CONFD_AZIMUTH_278_oRDR_DETECTION_277_280_oPCAN_RADAR_be3140c0_Tx: ComSignalType=UINT8
            DET_CONFD_AZIMUTH_279_oRDR_DETECTION_277_280_oPCAN_RADAR_2b419455_Tx: ComSignalType=UINT8
            DET_CONFD_AZIMUTH_280_oRDR_DETECTION_277_280_oPCAN_RADAR_2605354f_Tx: ComSignalType=UINT8
            DET_CONFD_ELEVATION_277_oRDR_DETECTION_277_280_oPCAN_RADAR_90b4d37d_Tx: ComSignalType=UINT8
            DET_CONFD_ELEVATION_278_oRDR_DETECTION_277_280_oPCAN_RADAR_bca4413a_Tx: ComSignalType=UINT8
            DET_CONFD_ELEVATION_279_oRDR_DETECTION_277_280_oPCAN_RADAR_29d495af_Tx: ComSignalType=UINT8
            DET_CONFD_ELEVATION_280_oRDR_DETECTION_277_280_oPCAN_RADAR_249034b5_Tx: ComSignalType=UINT8
            DET_ELEVATION_277_oRDR_DETECTION_277_280_oPCAN_RADAR_41740741_Tx: ComSignalType=UINT8
            DET_ELEVATION_278_oRDR_DETECTION_277_280_oPCAN_RADAR_6d649506_Tx: ComSignalType=UINT8
            DET_ELEVATION_279_oRDR_DETECTION_277_280_oPCAN_RADAR_f8144193_Tx: ComSignalType=UINT8
            DET_ELEVATION_280_oRDR_DETECTION_277_280_oPCAN_RADAR_f550e089_Tx: ComSignalType=UINT8
            DET_ELEVATION_ERR_277_oRDR_DETECTION_277_280_oPCAN_RADAR_c64d9f34_Tx: ComSignalType=UINT8
            DET_ELEVATION_ERR_278_oRDR_DETECTION_277_280_oPCAN_RADAR_ea5d0d73_Tx: ComSignalType=UINT8
            DET_ELEVATION_ERR_279_oRDR_DETECTION_277_280_oPCAN_RADAR_7f2dd9e6_Tx: ComSignalType=UINT8
            DET_ELEVATION_ERR_280_oRDR_DETECTION_277_280_oPCAN_RADAR_726978fc_Tx: ComSignalType=UINT8
            DET_EXISTENCE_PROB_277_oRDR_DETECTION_277_280_oPCAN_RADAR_14d2ea54_Tx: ComSignalType=UINT8
            DET_EXISTENCE_PROB_278_oRDR_DETECTION_277_280_oPCAN_RADAR_38c27813_Tx: ComSignalType=UINT8
            DET_EXISTENCE_PROB_279_oRDR_DETECTION_277_280_oPCAN_RADAR_adb2ac86_Tx: ComSignalType=UINT8
            DET_EXISTENCE_PROB_280_oRDR_DETECTION_277_280_oPCAN_RADAR_a0f60d9c_Tx: ComSignalType=UINT8
            DET_HVC_FLAG_277_oRDR_DETECTION_277_280_oPCAN_RADAR_f5a6a92b_Tx: ComSignalType=BOOLEAN
            DET_HVC_FLAG_278_oRDR_DETECTION_277_280_oPCAN_RADAR_d9b63b6c_Tx: ComSignalType=BOOLEAN
            DET_HVC_FLAG_279_oRDR_DETECTION_277_280_oPCAN_RADAR_4cc6eff9_Tx: ComSignalType=BOOLEAN
            DET_HVC_FLAG_280_oRDR_DETECTION_277_280_oPCAN_RADAR_41824ee3_Tx: ComSignalType=BOOLEAN
            DET_IDM_277_oRDR_DETECTION_277_280_oPCAN_RADAR_7ef49296_Tx: ComSignalType=UINT8
            DET_IDM_278_oRDR_DETECTION_277_280_oPCAN_RADAR_52e400d1_Tx: ComSignalType=UINT8
            DET_IDM_279_oRDR_DETECTION_277_280_oPCAN_RADAR_c794d444_Tx: ComSignalType=UINT8
            DET_IDM_280_oRDR_DETECTION_277_280_oPCAN_RADAR_cad0755e_Tx: ComSignalType=UINT8
            DET_MH_CRC16_277_280_oRDR_DETECTION_277_280_oPCAN_RADAR_2f10a647_Tx: ComSignalType=UINT16
            DET_MH_CYCLE_COUNTER_277_280_oRDR_DETECTION_277_280_oPCAN_RADAR_ab650770_Tx: ComSignalType=UINT8
            DET_MH_SCAN_INDEX_4LSB_277_280_oRDR_DETECTION_277_280_oPCAN_RADAR_674f22fc_Tx: ComSignalType=UINT8
            DET_MTD_277_oRDR_DETECTION_277_280_oPCAN_RADAR_1847a04d_Tx: ComSignalType=UINT8
            DET_MTD_278_oRDR_DETECTION_277_280_oPCAN_RADAR_3457320a_Tx: ComSignalType=UINT8
            DET_MTD_279_oRDR_DETECTION_277_280_oPCAN_RADAR_a127e69f_Tx: ComSignalType=UINT8
            DET_MTD_280_oRDR_DETECTION_277_280_oPCAN_RADAR_ac634785_Tx: ComSignalType=UINT8
            DET_PROB_1STAZHYPO_277_oRDR_DETECTION_277_280_oPCAN_RADAR_8bf34880_Tx: ComSignalType=BOOLEAN
            DET_PROB_1STAZHYPO_278_oRDR_DETECTION_277_280_oPCAN_RADAR_a7e3dac7_Tx: ComSignalType=BOOLEAN
            DET_PROB_1STAZHYPO_279_oRDR_DETECTION_277_280_oPCAN_RADAR_32930e52_Tx: ComSignalType=BOOLEAN
            DET_PROB_1STAZHYPO_280_oRDR_DETECTION_277_280_oPCAN_RADAR_3fd7af48_Tx: ComSignalType=BOOLEAN
            DET_RANGE_277_oRDR_DETECTION_277_280_oPCAN_RADAR_805cabf6_Tx: ComSignalType=UINT16
            DET_RANGE_278_oRDR_DETECTION_277_280_oPCAN_RADAR_ac4c39b1_Tx: ComSignalType=UINT16
            DET_RANGE_279_oRDR_DETECTION_277_280_oPCAN_RADAR_393ced24_Tx: ComSignalType=UINT16
            DET_RANGE_280_oRDR_DETECTION_277_280_oPCAN_RADAR_34784c3e_Tx: ComSignalType=UINT16
            DET_RANGE_ERR_277_oRDR_DETECTION_277_280_oPCAN_RADAR_27b4119f_Tx: ComSignalType=UINT8
            DET_RANGE_ERR_278_oRDR_DETECTION_277_280_oPCAN_RADAR_0ba483d8_Tx: ComSignalType=UINT8
            DET_RANGE_ERR_279_oRDR_DETECTION_277_280_oPCAN_RADAR_9ed4574d_Tx: ComSignalType=UINT8
            DET_RANGE_ERR_280_oRDR_DETECTION_277_280_oPCAN_RADAR_9390f657_Tx: ComSignalType=UINT8
            DET_RANGE_VELOCITY_277_oRDR_DETECTION_277_280_oPCAN_RADAR_f5fa69d3_Tx: ComSignalType=UINT16
            DET_RANGE_VELOCITY_278_oRDR_DETECTION_277_280_oPCAN_RADAR_d9eafb94_Tx: ComSignalType=UINT16
            DET_RANGE_VELOCITY_279_oRDR_DETECTION_277_280_oPCAN_RADAR_4c9a2f01_Tx: ComSignalType=UINT16
            DET_RANGE_VELOCITY_280_oRDR_DETECTION_277_280_oPCAN_RADAR_41de8e1b_Tx: ComSignalType=UINT16
            DET_RANGE_VELOCITY_ERR_277_oRDR_DETECTION_277_280_oPCAN_RADAR_fa419261_Tx: ComSignalType=UINT8
            DET_RANGE_VELOCITY_ERR_278_oRDR_DETECTION_277_280_oPCAN_RADAR_d6510026_Tx: ComSignalType=UINT8
            DET_RANGE_VELOCITY_ERR_279_oRDR_DETECTION_277_280_oPCAN_RADAR_4321d4b3_Tx: ComSignalType=UINT8
            DET_RANGE_VELOCITY_ERR_280_oRDR_DETECTION_277_280_oPCAN_RADAR_4e6575a9_Tx: ComSignalType=UINT8
            DET_RCS_277_oRDR_DETECTION_277_280_oPCAN_RADAR_727a5e89_Tx: ComSignalType=UINT8
            DET_RCS_278_oRDR_DETECTION_277_280_oPCAN_RADAR_5e6accce_Tx: ComSignalType=UINT8
            DET_RCS_279_oRDR_DETECTION_277_280_oPCAN_RADAR_cb1a185b_Tx: ComSignalType=UINT8
            DET_RCS_280_oRDR_DETECTION_277_280_oPCAN_RADAR_c65eb941_Tx: ComSignalType=UINT8
            DET_SNR_277_oRDR_DETECTION_277_280_oPCAN_RADAR_afd40a8b_Tx: ComSignalType=UINT8
            DET_SNR_278_oRDR_DETECTION_277_280_oPCAN_RADAR_83c498cc_Tx: ComSignalType=UINT8
            DET_SNR_279_oRDR_DETECTION_277_280_oPCAN_RADAR_16b44c59_Tx: ComSignalType=UINT8
            DET_SNR_280_oRDR_DETECTION_277_280_oPCAN_RADAR_1bf0ed43_Tx: ComSignalType=UINT8
            DET_SUPER_RES_TARGET_277_oRDR_DETECTION_277_280_oPCAN_RADAR_9e4d22ee_Tx: ComSignalType=BOOLEAN
            DET_SUPER_RES_TARGET_278_oRDR_DETECTION_277_280_oPCAN_RADAR_b25db0a9_Tx: ComSignalType=BOOLEAN
            DET_SUPER_RES_TARGET_279_oRDR_DETECTION_277_280_oPCAN_RADAR_272d643c_Tx: ComSignalType=BOOLEAN
            DET_SUPER_RES_TARGET_280_oRDR_DETECTION_277_280_oPCAN_RADAR_2a69c526_Tx: ComSignalType=BOOLEAN
        SG_Detections_281_284_oRDR_DETECTION_281_284_oPCAN_RADAR_8fce5195_Tx
          83 x ComGroupSignal:
            DET_AZIMUTH_281_oRDR_DETECTION_281_284_oPCAN_RADAR_206192e6_Tx: ComSignalType=UINT16
            DET_AZIMUTH_282_oRDR_DETECTION_281_284_oPCAN_RADAR_4481e918_Tx: ComSignalType=UINT16
            DET_AZIMUTH_283_oRDR_DETECTION_281_284_oPCAN_RADAR_d1f13d8d_Tx: ComSignalType=UINT16
            DET_AZIMUTH_284_oRDR_DETECTION_281_284_oPCAN_RADAR_8d411ee4_Tx: ComSignalType=UINT16
            DET_AZIMUTH_ERR_281_oRDR_DETECTION_281_284_oPCAN_RADAR_84d40713_Tx: ComSignalType=UINT8
            DET_AZIMUTH_ERR_282_oRDR_DETECTION_281_284_oPCAN_RADAR_e0347ced_Tx: ComSignalType=UINT8
            DET_AZIMUTH_ERR_283_oRDR_DETECTION_281_284_oPCAN_RADAR_7544a878_Tx: ComSignalType=UINT8
            DET_AZIMUTH_ERR_284_oRDR_DETECTION_281_284_oPCAN_RADAR_29f48b11_Tx: ComSignalType=UINT8
            DET_BELOW_RAIN_THOLD_281_oRDR_DETECTION_281_284_oPCAN_RADAR_f5600126_Tx: ComSignalType=UINT8
            DET_BELOW_RAIN_THOLD_282_oRDR_DETECTION_281_284_oPCAN_RADAR_91807ad8_Tx: ComSignalType=UINT8
            DET_BELOW_RAIN_THOLD_283_oRDR_DETECTION_281_284_oPCAN_RADAR_04f0ae4d_Tx: ComSignalType=UINT8
            DET_BELOW_RAIN_THOLD_284_oRDR_DETECTION_281_284_oPCAN_RADAR_58408d24_Tx: ComSignalType=UINT8
            DET_BI_STATIC_FLAG_281_oRDR_DETECTION_281_284_oPCAN_RADAR_764dd263_Tx: ComSignalType=BOOLEAN
            DET_BI_STATIC_FLAG_282_oRDR_DETECTION_281_284_oPCAN_RADAR_12ada99d_Tx: ComSignalType=BOOLEAN
            DET_BI_STATIC_FLAG_283_oRDR_DETECTION_281_284_oPCAN_RADAR_87dd7d08_Tx: ComSignalType=BOOLEAN
            DET_BI_STATIC_FLAG_284_oRDR_DETECTION_281_284_oPCAN_RADAR_db6d5e61_Tx: ComSignalType=BOOLEAN
            DET_CONFD_AZIMUTH_281_oRDR_DETECTION_281_284_oPCAN_RADAR_2287982c_Tx: ComSignalType=UINT8
            DET_CONFD_AZIMUTH_282_oRDR_DETECTION_281_284_oPCAN_RADAR_4667e3d2_Tx: ComSignalType=UINT8
            DET_CONFD_AZIMUTH_283_oRDR_DETECTION_281_284_oPCAN_RADAR_d3173747_Tx: ComSignalType=UINT8
            DET_CONFD_AZIMUTH_284_oRDR_DETECTION_281_284_oPCAN_RADAR_8fa7142e_Tx: ComSignalType=UINT8
            DET_CONFD_ELEVATION_281_oRDR_DETECTION_281_284_oPCAN_RADAR_201299d6_Tx: ComSignalType=UINT8
            DET_CONFD_ELEVATION_282_oRDR_DETECTION_281_284_oPCAN_RADAR_44f2e228_Tx: ComSignalType=UINT8
            DET_CONFD_ELEVATION_283_oRDR_DETECTION_281_284_oPCAN_RADAR_d18236bd_Tx: ComSignalType=UINT8
            DET_CONFD_ELEVATION_284_oRDR_DETECTION_281_284_oPCAN_RADAR_8d3215d4_Tx: ComSignalType=UINT8
            DET_ELEVATION_281_oRDR_DETECTION_281_284_oPCAN_RADAR_f1d24dea_Tx: ComSignalType=UINT8
            DET_ELEVATION_282_oRDR_DETECTION_281_284_oPCAN_RADAR_95323614_Tx: ComSignalType=UINT8
            DET_ELEVATION_283_oRDR_DETECTION_281_284_oPCAN_RADAR_0042e281_Tx: ComSignalType=UINT8
            DET_ELEVATION_284_oRDR_DETECTION_281_284_oPCAN_RADAR_5cf2c1e8_Tx: ComSignalType=UINT8
            DET_ELEVATION_ERR_281_oRDR_DETECTION_281_284_oPCAN_RADAR_76ebd59f_Tx: ComSignalType=UINT8
            DET_ELEVATION_ERR_282_oRDR_DETECTION_281_284_oPCAN_RADAR_120bae61_Tx: ComSignalType=UINT8
            DET_ELEVATION_ERR_283_oRDR_DETECTION_281_284_oPCAN_RADAR_877b7af4_Tx: ComSignalType=UINT8
            DET_ELEVATION_ERR_284_oRDR_DETECTION_281_284_oPCAN_RADAR_dbcb599d_Tx: ComSignalType=UINT8
            DET_EXISTENCE_PROB_281_oRDR_DETECTION_281_284_oPCAN_RADAR_a474a0ff_Tx: ComSignalType=UINT8
            DET_EXISTENCE_PROB_282_oRDR_DETECTION_281_284_oPCAN_RADAR_c094db01_Tx: ComSignalType=UINT8
            DET_EXISTENCE_PROB_283_oRDR_DETECTION_281_284_oPCAN_RADAR_55e40f94_Tx: ComSignalType=UINT8
            DET_EXISTENCE_PROB_284_oRDR_DETECTION_281_284_oPCAN_RADAR_09542cfd_Tx: ComSignalType=UINT8
            DET_HVC_FLAG_281_oRDR_DETECTION_281_284_oPCAN_RADAR_4500e380_Tx: ComSignalType=BOOLEAN
            DET_HVC_FLAG_282_oRDR_DETECTION_281_284_oPCAN_RADAR_21e0987e_Tx: ComSignalType=BOOLEAN
            DET_HVC_FLAG_283_oRDR_DETECTION_281_284_oPCAN_RADAR_b4904ceb_Tx: ComSignalType=BOOLEAN
            DET_HVC_FLAG_284_oRDR_DETECTION_281_284_oPCAN_RADAR_e8206f82_Tx: ComSignalType=BOOLEAN
            DET_IDM_281_oRDR_DETECTION_281_284_oPCAN_RADAR_ce52d83d_Tx: ComSignalType=UINT8
            DET_IDM_282_oRDR_DETECTION_281_284_oPCAN_RADAR_aab2a3c3_Tx: ComSignalType=UINT8
            DET_IDM_283_oRDR_DETECTION_281_284_oPCAN_RADAR_3fc27756_Tx: ComSignalType=UINT8
            DET_IDM_284_oRDR_DETECTION_281_284_oPCAN_RADAR_6372543f_Tx: ComSignalType=UINT8
            DET_MH_CRC16_281_284_oRDR_DETECTION_281_284_oPCAN_RADAR_0b46839e_Tx: ComSignalType=UINT16
            DET_MH_CYCLE_COUNTER_281_284_oRDR_DETECTION_281_284_oPCAN_RADAR_8f3322a9_Tx: ComSignalType=UINT8
            DET_MH_SCAN_INDEX_4LSB_281_284_oRDR_DETECTION_281_284_oPCAN_RADAR_43190725_Tx: ComSignalType=UINT8
            DET_MTD_281_oRDR_DETECTION_281_284_oPCAN_RADAR_a8e1eae6_Tx: ComSignalType=UINT8
            DET_MTD_282_oRDR_DETECTION_281_284_oPCAN_RADAR_cc019118_Tx: ComSignalType=UINT8
            DET_MTD_283_oRDR_DETECTION_281_284_oPCAN_RADAR_5971458d_Tx: ComSignalType=UINT8
            DET_MTD_284_oRDR_DETECTION_281_284_oPCAN_RADAR_05c166e4_Tx: ComSignalType=UINT8
            DET_PROB_1STAZHYPO_281_oRDR_DETECTION_281_284_oPCAN_RADAR_3b55022b_Tx: ComSignalType=BOOLEAN
            DET_PROB_1STAZHYPO_282_oRDR_DETECTION_281_284_oPCAN_RADAR_5fb579d5_Tx: ComSignalType=BOOLEAN
            DET_PROB_1STAZHYPO_283_oRDR_DETECTION_281_284_oPCAN_RADAR_cac5ad40_Tx: ComSignalType=BOOLEAN
            DET_PROB_1STAZHYPO_284_oRDR_DETECTION_281_284_oPCAN_RADAR_96758e29_Tx: ComSignalType=BOOLEAN
            DET_RANGE_281_oRDR_DETECTION_281_284_oPCAN_RADAR_30fae15d_Tx: ComSignalType=UINT16
            DET_RANGE_282_oRDR_DETECTION_281_284_oPCAN_RADAR_541a9aa3_Tx: ComSignalType=UINT16
            DET_RANGE_283_oRDR_DETECTION_281_284_oPCAN_RADAR_c16a4e36_Tx: ComSignalType=UINT16
            DET_RANGE_284_oRDR_DETECTION_281_284_oPCAN_RADAR_9dda6d5f_Tx: ComSignalType=UINT16
            DET_RANGE_ERR_281_oRDR_DETECTION_281_284_oPCAN_RADAR_97125b34_Tx: ComSignalType=UINT8
            DET_RANGE_ERR_282_oRDR_DETECTION_281_284_oPCAN_RADAR_f3f220ca_Tx: ComSignalType=UINT8
            DET_RANGE_ERR_283_oRDR_DETECTION_281_284_oPCAN_RADAR_6682f45f_Tx: ComSignalType=UINT8
            DET_RANGE_ERR_284_oRDR_DETECTION_281_284_oPCAN_RADAR_3a32d736_Tx: ComSignalType=UINT8
            DET_RANGE_VELOCITY_281_oRDR_DETECTION_281_284_oPCAN_RADAR_455c2378_Tx: ComSignalType=UINT16
            DET_RANGE_VELOCITY_282_oRDR_DETECTION_281_284_oPCAN_RADAR_21bc5886_Tx: ComSignalType=UINT16
            DET_RANGE_VELOCITY_283_oRDR_DETECTION_281_284_oPCAN_RADAR_b4cc8c13_Tx: ComSignalType=UINT16
            DET_RANGE_VELOCITY_284_oRDR_DETECTION_281_284_oPCAN_RADAR_e87caf7a_Tx: ComSignalType=UINT16
            DET_RANGE_VELOCITY_ERR_281_oRDR_DETECTION_281_284_oPCAN_RADAR_4ae7d8ca_Tx: ComSignalType=UINT8
            DET_RANGE_VELOCITY_ERR_282_oRDR_DETECTION_281_284_oPCAN_RADAR_2e07a334_Tx: ComSignalType=UINT8
            DET_RANGE_VELOCITY_ERR_283_oRDR_DETECTION_281_284_oPCAN_RADAR_bb7777a1_Tx: ComSignalType=UINT8
            DET_RANGE_VELOCITY_ERR_284_oRDR_DETECTION_281_284_oPCAN_RADAR_e7c754c8_Tx: ComSignalType=UINT8
            DET_RCS_281_oRDR_DETECTION_281_284_oPCAN_RADAR_c2dc1422_Tx: ComSignalType=UINT8
            DET_RCS_282_oRDR_DETECTION_281_284_oPCAN_RADAR_a63c6fdc_Tx: ComSignalType=UINT8
            DET_RCS_283_oRDR_DETECTION_281_284_oPCAN_RADAR_334cbb49_Tx: ComSignalType=UINT8
            DET_RCS_284_oRDR_DETECTION_281_284_oPCAN_RADAR_6ffc9820_Tx: ComSignalType=UINT8
            DET_SNR_281_oRDR_DETECTION_281_284_oPCAN_RADAR_1f724020_Tx: ComSignalType=UINT8
            DET_SNR_282_oRDR_DETECTION_281_284_oPCAN_RADAR_7b923bde_Tx: ComSignalType=UINT8
            DET_SNR_283_oRDR_DETECTION_281_284_oPCAN_RADAR_eee2ef4b_Tx: ComSignalType=UINT8
            DET_SNR_284_oRDR_DETECTION_281_284_oPCAN_RADAR_b252cc22_Tx: ComSignalType=UINT8
            DET_SUPER_RES_TARGET_281_oRDR_DETECTION_281_284_oPCAN_RADAR_2eeb6845_Tx: ComSignalType=BOOLEAN
            DET_SUPER_RES_TARGET_282_oRDR_DETECTION_281_284_oPCAN_RADAR_4a0b13bb_Tx: ComSignalType=BOOLEAN
            DET_SUPER_RES_TARGET_283_oRDR_DETECTION_281_284_oPCAN_RADAR_df7bc72e_Tx: ComSignalType=BOOLEAN
            DET_SUPER_RES_TARGET_284_oRDR_DETECTION_281_284_oPCAN_RADAR_83cbe447_Tx: ComSignalType=BOOLEAN
        SG_Detections_285_288_oRDR_DETECTION_285_288_oPCAN_RADAR_fe0d65c7_Tx
          83 x ComGroupSignal:
            DET_AZIMUTH_285_oRDR_DETECTION_285_288_oPCAN_RADAR_f1835445_Tx: ComSignalType=UINT16
            DET_AZIMUTH_286_oRDR_DETECTION_285_288_oPCAN_RADAR_95632fbb_Tx: ComSignalType=UINT16
            DET_AZIMUTH_287_oRDR_DETECTION_285_288_oPCAN_RADAR_0013fb2e_Tx: ComSignalType=UINT16
            DET_AZIMUTH_288_oRDR_DETECTION_285_288_oPCAN_RADAR_2c036969_Tx: ComSignalType=UINT16
            DET_AZIMUTH_ERR_285_oRDR_DETECTION_285_288_oPCAN_RADAR_5536c1b0_Tx: ComSignalType=UINT8
            DET_AZIMUTH_ERR_286_oRDR_DETECTION_285_288_oPCAN_RADAR_31d6ba4e_Tx: ComSignalType=UINT8
            DET_AZIMUTH_ERR_287_oRDR_DETECTION_285_288_oPCAN_RADAR_a4a66edb_Tx: ComSignalType=UINT8
            DET_AZIMUTH_ERR_288_oRDR_DETECTION_285_288_oPCAN_RADAR_88b6fc9c_Tx: ComSignalType=UINT8
            DET_BELOW_RAIN_THOLD_285_oRDR_DETECTION_285_288_oPCAN_RADAR_2482c785_Tx: ComSignalType=UINT8
            DET_BELOW_RAIN_THOLD_286_oRDR_DETECTION_285_288_oPCAN_RADAR_4062bc7b_Tx: ComSignalType=UINT8
            DET_BELOW_RAIN_THOLD_287_oRDR_DETECTION_285_288_oPCAN_RADAR_d51268ee_Tx: ComSignalType=UINT8
            DET_BELOW_RAIN_THOLD_288_oRDR_DETECTION_285_288_oPCAN_RADAR_f902faa9_Tx: ComSignalType=UINT8
            DET_BI_STATIC_FLAG_285_oRDR_DETECTION_285_288_oPCAN_RADAR_a7af14c0_Tx: ComSignalType=BOOLEAN
            DET_BI_STATIC_FLAG_286_oRDR_DETECTION_285_288_oPCAN_RADAR_c34f6f3e_Tx: ComSignalType=BOOLEAN
            DET_BI_STATIC_FLAG_287_oRDR_DETECTION_285_288_oPCAN_RADAR_563fbbab_Tx: ComSignalType=BOOLEAN
            DET_BI_STATIC_FLAG_288_oRDR_DETECTION_285_288_oPCAN_RADAR_7a2f29ec_Tx: ComSignalType=BOOLEAN
            DET_CONFD_AZIMUTH_285_oRDR_DETECTION_285_288_oPCAN_RADAR_f3655e8f_Tx: ComSignalType=UINT8
            DET_CONFD_AZIMUTH_286_oRDR_DETECTION_285_288_oPCAN_RADAR_97852571_Tx: ComSignalType=UINT8
            DET_CONFD_AZIMUTH_287_oRDR_DETECTION_285_288_oPCAN_RADAR_02f5f1e4_Tx: ComSignalType=UINT8
            DET_CONFD_AZIMUTH_288_oRDR_DETECTION_285_288_oPCAN_RADAR_2ee563a3_Tx: ComSignalType=UINT8
            DET_CONFD_ELEVATION_285_oRDR_DETECTION_285_288_oPCAN_RADAR_f1f05f75_Tx: ComSignalType=UINT8
            DET_CONFD_ELEVATION_286_oRDR_DETECTION_285_288_oPCAN_RADAR_9510248b_Tx: ComSignalType=UINT8
            DET_CONFD_ELEVATION_287_oRDR_DETECTION_285_288_oPCAN_RADAR_0060f01e_Tx: ComSignalType=UINT8
            DET_CONFD_ELEVATION_288_oRDR_DETECTION_285_288_oPCAN_RADAR_2c706259_Tx: ComSignalType=UINT8
            DET_ELEVATION_285_oRDR_DETECTION_285_288_oPCAN_RADAR_20308b49_Tx: ComSignalType=UINT8
            DET_ELEVATION_286_oRDR_DETECTION_285_288_oPCAN_RADAR_44d0f0b7_Tx: ComSignalType=UINT8
            DET_ELEVATION_287_oRDR_DETECTION_285_288_oPCAN_RADAR_d1a02422_Tx: ComSignalType=UINT8
            DET_ELEVATION_288_oRDR_DETECTION_285_288_oPCAN_RADAR_fdb0b665_Tx: ComSignalType=UINT8
            DET_ELEVATION_ERR_285_oRDR_DETECTION_285_288_oPCAN_RADAR_a709133c_Tx: ComSignalType=UINT8
            DET_ELEVATION_ERR_286_oRDR_DETECTION_285_288_oPCAN_RADAR_c3e968c2_Tx: ComSignalType=UINT8
            DET_ELEVATION_ERR_287_oRDR_DETECTION_285_288_oPCAN_RADAR_5699bc57_Tx: ComSignalType=UINT8
            DET_ELEVATION_ERR_288_oRDR_DETECTION_285_288_oPCAN_RADAR_7a892e10_Tx: ComSignalType=UINT8
            DET_EXISTENCE_PROB_285_oRDR_DETECTION_285_288_oPCAN_RADAR_7596665c_Tx: ComSignalType=UINT8
            DET_EXISTENCE_PROB_286_oRDR_DETECTION_285_288_oPCAN_RADAR_11761da2_Tx: ComSignalType=UINT8
            DET_EXISTENCE_PROB_287_oRDR_DETECTION_285_288_oPCAN_RADAR_8406c937_Tx: ComSignalType=UINT8
            DET_EXISTENCE_PROB_288_oRDR_DETECTION_285_288_oPCAN_RADAR_a8165b70_Tx: ComSignalType=UINT8
            DET_HVC_FLAG_285_oRDR_DETECTION_285_288_oPCAN_RADAR_94e22523_Tx: ComSignalType=BOOLEAN
            DET_HVC_FLAG_286_oRDR_DETECTION_285_288_oPCAN_RADAR_f0025edd_Tx: ComSignalType=BOOLEAN
            DET_HVC_FLAG_287_oRDR_DETECTION_285_288_oPCAN_RADAR_65728a48_Tx: ComSignalType=BOOLEAN
            DET_HVC_FLAG_288_oRDR_DETECTION_285_288_oPCAN_RADAR_4962180f_Tx: ComSignalType=BOOLEAN
            DET_IDM_285_oRDR_DETECTION_285_288_oPCAN_RADAR_1fb01e9e_Tx: ComSignalType=UINT8
            DET_IDM_286_oRDR_DETECTION_285_288_oPCAN_RADAR_7b506560_Tx: ComSignalType=UINT8
            DET_IDM_287_oRDR_DETECTION_285_288_oPCAN_RADAR_ee20b1f5_Tx: ComSignalType=UINT8
            DET_IDM_288_oRDR_DETECTION_285_288_oPCAN_RADAR_c23023b2_Tx: ComSignalType=UINT8
            DET_MH_CRC16_285_288_oRDR_DETECTION_285_288_oPCAN_RADAR_7a85b7cc_Tx: ComSignalType=UINT16
            DET_MH_CYCLE_COUNTER_285_288_oRDR_DETECTION_285_288_oPCAN_RADAR_fef016fb_Tx: ComSignalType=UINT8
            DET_MH_SCAN_INDEX_4LSB_285_288_oRDR_DETECTION_285_288_oPCAN_RADAR_32da3377_Tx: ComSignalType=UINT8
            DET_MTD_285_oRDR_DETECTION_285_288_oPCAN_RADAR_79032c45_Tx: ComSignalType=UINT8
            DET_MTD_286_oRDR_DETECTION_285_288_oPCAN_RADAR_1de357bb_Tx: ComSignalType=UINT8
            DET_MTD_287_oRDR_DETECTION_285_288_oPCAN_RADAR_8893832e_Tx: ComSignalType=UINT8
            DET_MTD_288_oRDR_DETECTION_285_288_oPCAN_RADAR_a4831169_Tx: ComSignalType=UINT8
            DET_PROB_1STAZHYPO_285_oRDR_DETECTION_285_288_oPCAN_RADAR_eab7c488_Tx: ComSignalType=BOOLEAN
            DET_PROB_1STAZHYPO_286_oRDR_DETECTION_285_288_oPCAN_RADAR_8e57bf76_Tx: ComSignalType=BOOLEAN
            DET_PROB_1STAZHYPO_287_oRDR_DETECTION_285_288_oPCAN_RADAR_1b276be3_Tx: ComSignalType=BOOLEAN
            DET_PROB_1STAZHYPO_288_oRDR_DETECTION_285_288_oPCAN_RADAR_3737f9a4_Tx: ComSignalType=BOOLEAN
            DET_RANGE_285_oRDR_DETECTION_285_288_oPCAN_RADAR_e11827fe_Tx: ComSignalType=UINT16
            DET_RANGE_286_oRDR_DETECTION_285_288_oPCAN_RADAR_85f85c00_Tx: ComSignalType=UINT16
            DET_RANGE_287_oRDR_DETECTION_285_288_oPCAN_RADAR_10888895_Tx: ComSignalType=UINT16
            DET_RANGE_288_oRDR_DETECTION_285_288_oPCAN_RADAR_3c981ad2_Tx: ComSignalType=UINT16
            DET_RANGE_ERR_285_oRDR_DETECTION_285_288_oPCAN_RADAR_46f09d97_Tx: ComSignalType=UINT8
            DET_RANGE_ERR_286_oRDR_DETECTION_285_288_oPCAN_RADAR_2210e669_Tx: ComSignalType=UINT8
            DET_RANGE_ERR_287_oRDR_DETECTION_285_288_oPCAN_RADAR_b76032fc_Tx: ComSignalType=UINT8
            DET_RANGE_ERR_288_oRDR_DETECTION_285_288_oPCAN_RADAR_9b70a0bb_Tx: ComSignalType=UINT8
            DET_RANGE_VELOCITY_285_oRDR_DETECTION_285_288_oPCAN_RADAR_94bee5db_Tx: ComSignalType=UINT16
            DET_RANGE_VELOCITY_286_oRDR_DETECTION_285_288_oPCAN_RADAR_f05e9e25_Tx: ComSignalType=UINT16
            DET_RANGE_VELOCITY_287_oRDR_DETECTION_285_288_oPCAN_RADAR_652e4ab0_Tx: ComSignalType=UINT16
            DET_RANGE_VELOCITY_288_oRDR_DETECTION_285_288_oPCAN_RADAR_493ed8f7_Tx: ComSignalType=UINT16
            DET_RANGE_VELOCITY_ERR_285_oRDR_DETECTION_285_288_oPCAN_RADAR_9b051e69_Tx: ComSignalType=UINT8
            DET_RANGE_VELOCITY_ERR_286_oRDR_DETECTION_285_288_oPCAN_RADAR_ffe56597_Tx: ComSignalType=UINT8
            DET_RANGE_VELOCITY_ERR_287_oRDR_DETECTION_285_288_oPCAN_RADAR_6a95b102_Tx: ComSignalType=UINT8
            DET_RANGE_VELOCITY_ERR_288_oRDR_DETECTION_285_288_oPCAN_RADAR_46852345_Tx: ComSignalType=UINT8
            DET_RCS_285_oRDR_DETECTION_285_288_oPCAN_RADAR_133ed281_Tx: ComSignalType=UINT8
            DET_RCS_286_oRDR_DETECTION_285_288_oPCAN_RADAR_77dea97f_Tx: ComSignalType=UINT8
            DET_RCS_287_oRDR_DETECTION_285_288_oPCAN_RADAR_e2ae7dea_Tx: ComSignalType=UINT8
            DET_RCS_288_oRDR_DETECTION_285_288_oPCAN_RADAR_cebeefad_Tx: ComSignalType=UINT8
            DET_SNR_285_oRDR_DETECTION_285_288_oPCAN_RADAR_ce908683_Tx: ComSignalType=UINT8
            DET_SNR_286_oRDR_DETECTION_285_288_oPCAN_RADAR_aa70fd7d_Tx: ComSignalType=UINT8
            DET_SNR_287_oRDR_DETECTION_285_288_oPCAN_RADAR_3f0029e8_Tx: ComSignalType=UINT8
            DET_SNR_288_oRDR_DETECTION_285_288_oPCAN_RADAR_1310bbaf_Tx: ComSignalType=UINT8
            DET_SUPER_RES_TARGET_285_oRDR_DETECTION_285_288_oPCAN_RADAR_ff09aee6_Tx: ComSignalType=BOOLEAN
            DET_SUPER_RES_TARGET_286_oRDR_DETECTION_285_288_oPCAN_RADAR_9be9d518_Tx: ComSignalType=BOOLEAN
            DET_SUPER_RES_TARGET_287_oRDR_DETECTION_285_288_oPCAN_RADAR_0e99018d_Tx: ComSignalType=BOOLEAN
            DET_SUPER_RES_TARGET_288_oRDR_DETECTION_285_288_oPCAN_RADAR_228993ca_Tx: ComSignalType=BOOLEAN
        SG_Detections_289_292_oRDR_DETECTION_289_292_oPCAN_RADAR_677741bc_Tx
          83 x ComGroupSignal:
            DET_AZIMUTH_289_oRDR_DETECTION_289_292_oPCAN_RADAR_8b3b52fd_Tx: ComSignalType=UINT16
            DET_AZIMUTH_290_oRDR_DETECTION_289_292_oPCAN_RADAR_ee1b2059_Tx: ComSignalType=UINT16
            DET_AZIMUTH_291_oRDR_DETECTION_289_292_oPCAN_RADAR_7b6bf4cc_Tx: ComSignalType=UINT16
            DET_AZIMUTH_292_oRDR_DETECTION_289_292_oPCAN_RADAR_1f8b8f32_Tx: ComSignalType=UINT16
            DET_AZIMUTH_ERR_289_oRDR_DETECTION_289_292_oPCAN_RADAR_2f8ec708_Tx: ComSignalType=UINT8
            DET_AZIMUTH_ERR_290_oRDR_DETECTION_289_292_oPCAN_RADAR_4aaeb5ac_Tx: ComSignalType=UINT8
            DET_AZIMUTH_ERR_291_oRDR_DETECTION_289_292_oPCAN_RADAR_dfde6139_Tx: ComSignalType=UINT8
            DET_AZIMUTH_ERR_292_oRDR_DETECTION_289_292_oPCAN_RADAR_bb3e1ac7_Tx: ComSignalType=UINT8
            DET_BELOW_RAIN_THOLD_289_oRDR_DETECTION_289_292_oPCAN_RADAR_5e3ac13d_Tx: ComSignalType=UINT8
            DET_BELOW_RAIN_THOLD_290_oRDR_DETECTION_289_292_oPCAN_RADAR_3b1ab399_Tx: ComSignalType=UINT8
            DET_BELOW_RAIN_THOLD_291_oRDR_DETECTION_289_292_oPCAN_RADAR_ae6a670c_Tx: ComSignalType=UINT8
            DET_BELOW_RAIN_THOLD_292_oRDR_DETECTION_289_292_oPCAN_RADAR_ca8a1cf2_Tx: ComSignalType=UINT8
            DET_BI_STATIC_FLAG_289_oRDR_DETECTION_289_292_oPCAN_RADAR_dd171278_Tx: ComSignalType=BOOLEAN
            DET_BI_STATIC_FLAG_290_oRDR_DETECTION_289_292_oPCAN_RADAR_b83760dc_Tx: ComSignalType=BOOLEAN
            DET_BI_STATIC_FLAG_291_oRDR_DETECTION_289_292_oPCAN_RADAR_2d47b449_Tx: ComSignalType=BOOLEAN
            DET_BI_STATIC_FLAG_292_oRDR_DETECTION_289_292_oPCAN_RADAR_49a7cfb7_Tx: ComSignalType=BOOLEAN
            DET_CONFD_AZIMUTH_289_oRDR_DETECTION_289_292_oPCAN_RADAR_89dd5837_Tx: ComSignalType=UINT8
            DET_CONFD_AZIMUTH_290_oRDR_DETECTION_289_292_oPCAN_RADAR_ecfd2a93_Tx: ComSignalType=UINT8
            DET_CONFD_AZIMUTH_291_oRDR_DETECTION_289_292_oPCAN_RADAR_798dfe06_Tx: ComSignalType=UINT8
            DET_CONFD_AZIMUTH_292_oRDR_DETECTION_289_292_oPCAN_RADAR_1d6d85f8_Tx: ComSignalType=UINT8
            DET_CONFD_ELEVATION_289_oRDR_DETECTION_289_292_oPCAN_RADAR_8b4859cd_Tx: ComSignalType=UINT8
            DET_CONFD_ELEVATION_290_oRDR_DETECTION_289_292_oPCAN_RADAR_ee682b69_Tx: ComSignalType=UINT8
            DET_CONFD_ELEVATION_291_oRDR_DETECTION_289_292_oPCAN_RADAR_7b18fffc_Tx: ComSignalType=UINT8
            DET_CONFD_ELEVATION_292_oRDR_DETECTION_289_292_oPCAN_RADAR_1ff88402_Tx: ComSignalType=UINT8
            DET_ELEVATION_289_oRDR_DETECTION_289_292_oPCAN_RADAR_5a888df1_Tx: ComSignalType=UINT8
            DET_ELEVATION_290_oRDR_DETECTION_289_292_oPCAN_RADAR_3fa8ff55_Tx: ComSignalType=UINT8
            DET_ELEVATION_291_oRDR_DETECTION_289_292_oPCAN_RADAR_aad82bc0_Tx: ComSignalType=UINT8
            DET_ELEVATION_292_oRDR_DETECTION_289_292_oPCAN_RADAR_ce38503e_Tx: ComSignalType=UINT8
            DET_ELEVATION_ERR_289_oRDR_DETECTION_289_292_oPCAN_RADAR_ddb11584_Tx: ComSignalType=UINT8
            DET_ELEVATION_ERR_290_oRDR_DETECTION_289_292_oPCAN_RADAR_b8916720_Tx: ComSignalType=UINT8
            DET_ELEVATION_ERR_291_oRDR_DETECTION_289_292_oPCAN_RADAR_2de1b3b5_Tx: ComSignalType=UINT8
            DET_ELEVATION_ERR_292_oRDR_DETECTION_289_292_oPCAN_RADAR_4901c84b_Tx: ComSignalType=UINT8
            DET_EXISTENCE_PROB_289_oRDR_DETECTION_289_292_oPCAN_RADAR_0f2e60e4_Tx: ComSignalType=UINT8
            DET_EXISTENCE_PROB_290_oRDR_DETECTION_289_292_oPCAN_RADAR_6a0e1240_Tx: ComSignalType=UINT8
            DET_EXISTENCE_PROB_291_oRDR_DETECTION_289_292_oPCAN_RADAR_ff7ec6d5_Tx: ComSignalType=UINT8
            DET_EXISTENCE_PROB_292_oRDR_DETECTION_289_292_oPCAN_RADAR_9b9ebd2b_Tx: ComSignalType=UINT8
            DET_HVC_FLAG_289_oRDR_DETECTION_289_292_oPCAN_RADAR_ee5a239b_Tx: ComSignalType=BOOLEAN
            DET_HVC_FLAG_290_oRDR_DETECTION_289_292_oPCAN_RADAR_8b7a513f_Tx: ComSignalType=BOOLEAN
            DET_HVC_FLAG_291_oRDR_DETECTION_289_292_oPCAN_RADAR_1e0a85aa_Tx: ComSignalType=BOOLEAN
            DET_HVC_FLAG_292_oRDR_DETECTION_289_292_oPCAN_RADAR_7aeafe54_Tx: ComSignalType=BOOLEAN
            DET_IDM_289_oRDR_DETECTION_289_292_oPCAN_RADAR_65081826_Tx: ComSignalType=UINT8
            DET_IDM_290_oRDR_DETECTION_289_292_oPCAN_RADAR_00286a82_Tx: ComSignalType=UINT8
            DET_IDM_291_oRDR_DETECTION_289_292_oPCAN_RADAR_9558be17_Tx: ComSignalType=UINT8
            DET_IDM_292_oRDR_DETECTION_289_292_oPCAN_RADAR_f1b8c5e9_Tx: ComSignalType=UINT8
            DET_MH_CRC16_289_292_oRDR_DETECTION_289_292_oPCAN_RADAR_e3ff93b7_Tx: ComSignalType=UINT16
            DET_MH_CYCLE_COUNTER_289_292_oRDR_DETECTION_289_292_oPCAN_RADAR_678a3280_Tx: ComSignalType=UINT8
            DET_MH_SCAN_INDEX_4LSB_289_292_oRDR_DETECTION_289_292_oPCAN_RADAR_aba0170c_Tx: ComSignalType=UINT8
            DET_MTD_289_oRDR_DETECTION_289_292_oPCAN_RADAR_03bb2afd_Tx: ComSignalType=UINT8
            DET_MTD_290_oRDR_DETECTION_289_292_oPCAN_RADAR_669b5859_Tx: ComSignalType=UINT8
            DET_MTD_291_oRDR_DETECTION_289_292_oPCAN_RADAR_f3eb8ccc_Tx: ComSignalType=UINT8
            DET_MTD_292_oRDR_DETECTION_289_292_oPCAN_RADAR_970bf732_Tx: ComSignalType=UINT8
            DET_PROB_1STAZHYPO_289_oRDR_DETECTION_289_292_oPCAN_RADAR_900fc230_Tx: ComSignalType=BOOLEAN
            DET_PROB_1STAZHYPO_290_oRDR_DETECTION_289_292_oPCAN_RADAR_f52fb094_Tx: ComSignalType=BOOLEAN
            DET_PROB_1STAZHYPO_291_oRDR_DETECTION_289_292_oPCAN_RADAR_605f6401_Tx: ComSignalType=BOOLEAN
            DET_PROB_1STAZHYPO_292_oRDR_DETECTION_289_292_oPCAN_RADAR_04bf1fff_Tx: ComSignalType=BOOLEAN
            DET_RANGE_289_oRDR_DETECTION_289_292_oPCAN_RADAR_9ba02146_Tx: ComSignalType=UINT16
            DET_RANGE_290_oRDR_DETECTION_289_292_oPCAN_RADAR_fe8053e2_Tx: ComSignalType=UINT16
            DET_RANGE_291_oRDR_DETECTION_289_292_oPCAN_RADAR_6bf08777_Tx: ComSignalType=UINT16
            DET_RANGE_292_oRDR_DETECTION_289_292_oPCAN_RADAR_0f10fc89_Tx: ComSignalType=UINT16
            DET_RANGE_ERR_289_oRDR_DETECTION_289_292_oPCAN_RADAR_3c489b2f_Tx: ComSignalType=UINT8
            DET_RANGE_ERR_290_oRDR_DETECTION_289_292_oPCAN_RADAR_5968e98b_Tx: ComSignalType=UINT8
            DET_RANGE_ERR_291_oRDR_DETECTION_289_292_oPCAN_RADAR_cc183d1e_Tx: ComSignalType=UINT8
            DET_RANGE_ERR_292_oRDR_DETECTION_289_292_oPCAN_RADAR_a8f846e0_Tx: ComSignalType=UINT8
            DET_RANGE_VELOCITY_289_oRDR_DETECTION_289_292_oPCAN_RADAR_ee06e363_Tx: ComSignalType=UINT16
            DET_RANGE_VELOCITY_290_oRDR_DETECTION_289_292_oPCAN_RADAR_8b2691c7_Tx: ComSignalType=UINT16
            DET_RANGE_VELOCITY_291_oRDR_DETECTION_289_292_oPCAN_RADAR_1e564552_Tx: ComSignalType=UINT16
            DET_RANGE_VELOCITY_292_oRDR_DETECTION_289_292_oPCAN_RADAR_7ab63eac_Tx: ComSignalType=UINT16
            DET_RANGE_VELOCITY_ERR_289_oRDR_DETECTION_289_292_oPCAN_RADAR_e1bd18d1_Tx: ComSignalType=UINT8
            DET_RANGE_VELOCITY_ERR_290_oRDR_DETECTION_289_292_oPCAN_RADAR_849d6a75_Tx: ComSignalType=UINT8
            DET_RANGE_VELOCITY_ERR_291_oRDR_DETECTION_289_292_oPCAN_RADAR_11edbee0_Tx: ComSignalType=UINT8
            DET_RANGE_VELOCITY_ERR_292_oRDR_DETECTION_289_292_oPCAN_RADAR_750dc51e_Tx: ComSignalType=UINT8
            DET_RCS_289_oRDR_DETECTION_289_292_oPCAN_RADAR_6986d439_Tx: ComSignalType=UINT8
            DET_RCS_290_oRDR_DETECTION_289_292_oPCAN_RADAR_0ca6a69d_Tx: ComSignalType=UINT8
            DET_RCS_291_oRDR_DETECTION_289_292_oPCAN_RADAR_99d67208_Tx: ComSignalType=UINT8
            DET_RCS_292_oRDR_DETECTION_289_292_oPCAN_RADAR_fd3609f6_Tx: ComSignalType=UINT8
            DET_SNR_289_oRDR_DETECTION_289_292_oPCAN_RADAR_b428803b_Tx: ComSignalType=UINT8
            DET_SNR_290_oRDR_DETECTION_289_292_oPCAN_RADAR_d108f29f_Tx: ComSignalType=UINT8
            DET_SNR_291_oRDR_DETECTION_289_292_oPCAN_RADAR_4478260a_Tx: ComSignalType=UINT8
            DET_SNR_292_oRDR_DETECTION_289_292_oPCAN_RADAR_20985df4_Tx: ComSignalType=UINT8
            DET_SUPER_RES_TARGET_289_oRDR_DETECTION_289_292_oPCAN_RADAR_85b1a85e_Tx: ComSignalType=BOOLEAN
            DET_SUPER_RES_TARGET_290_oRDR_DETECTION_289_292_oPCAN_RADAR_e091dafa_Tx: ComSignalType=BOOLEAN
            DET_SUPER_RES_TARGET_291_oRDR_DETECTION_289_292_oPCAN_RADAR_75e10e6f_Tx: ComSignalType=BOOLEAN
            DET_SUPER_RES_TARGET_292_oRDR_DETECTION_289_292_oPCAN_RADAR_11017591_Tx: ComSignalType=BOOLEAN
        SG_Detections_293_296_oRDR_DETECTION_293_296_oPCAN_RADAR_557c2994_Tx
          83 x ComGroupSignal:
            DET_AZIMUTH_293_oRDR_DETECTION_293_296_oPCAN_RADAR_973c5889_Tx: ComSignalType=UINT16
            DET_AZIMUTH_294_oRDR_DETECTION_293_296_oPCAN_RADAR_cb8c7be0_Tx: ComSignalType=UINT16
            DET_AZIMUTH_295_oRDR_DETECTION_293_296_oPCAN_RADAR_5efcaf75_Tx: ComSignalType=UINT16
            DET_AZIMUTH_296_oRDR_DETECTION_293_296_oPCAN_RADAR_3a1cd48b_Tx: ComSignalType=UINT16
            DET_AZIMUTH_ERR_293_oRDR_DETECTION_293_296_oPCAN_RADAR_3389cd7c_Tx: ComSignalType=UINT8
            DET_AZIMUTH_ERR_294_oRDR_DETECTION_293_296_oPCAN_RADAR_6f39ee15_Tx: ComSignalType=UINT8
            DET_AZIMUTH_ERR_295_oRDR_DETECTION_293_296_oPCAN_RADAR_fa493a80_Tx: ComSignalType=UINT8
            DET_AZIMUTH_ERR_296_oRDR_DETECTION_293_296_oPCAN_RADAR_9ea9417e_Tx: ComSignalType=UINT8
            DET_BELOW_RAIN_THOLD_293_oRDR_DETECTION_293_296_oPCAN_RADAR_423dcb49_Tx: ComSignalType=UINT8
            DET_BELOW_RAIN_THOLD_294_oRDR_DETECTION_293_296_oPCAN_RADAR_1e8de820_Tx: ComSignalType=UINT8
            DET_BELOW_RAIN_THOLD_295_oRDR_DETECTION_293_296_oPCAN_RADAR_8bfd3cb5_Tx: ComSignalType=UINT8
            DET_BELOW_RAIN_THOLD_296_oRDR_DETECTION_293_296_oPCAN_RADAR_ef1d474b_Tx: ComSignalType=UINT8
            DET_BI_STATIC_FLAG_293_oRDR_DETECTION_293_296_oPCAN_RADAR_c110180c_Tx: ComSignalType=BOOLEAN
            DET_BI_STATIC_FLAG_294_oRDR_DETECTION_293_296_oPCAN_RADAR_9da03b65_Tx: ComSignalType=BOOLEAN
            DET_BI_STATIC_FLAG_295_oRDR_DETECTION_293_296_oPCAN_RADAR_08d0eff0_Tx: ComSignalType=BOOLEAN
            DET_BI_STATIC_FLAG_296_oRDR_DETECTION_293_296_oPCAN_RADAR_6c30940e_Tx: ComSignalType=BOOLEAN
            DET_CONFD_AZIMUTH_293_oRDR_DETECTION_293_296_oPCAN_RADAR_95da5243_Tx: ComSignalType=UINT8
            DET_CONFD_AZIMUTH_294_oRDR_DETECTION_293_296_oPCAN_RADAR_c96a712a_Tx: ComSignalType=UINT8
            DET_CONFD_AZIMUTH_295_oRDR_DETECTION_293_296_oPCAN_RADAR_5c1aa5bf_Tx: ComSignalType=UINT8
            DET_CONFD_AZIMUTH_296_oRDR_DETECTION_293_296_oPCAN_RADAR_38fade41_Tx: ComSignalType=UINT8
            DET_CONFD_ELEVATION_293_oRDR_DETECTION_293_296_oPCAN_RADAR_974f53b9_Tx: ComSignalType=UINT8
            DET_CONFD_ELEVATION_294_oRDR_DETECTION_293_296_oPCAN_RADAR_cbff70d0_Tx: ComSignalType=UINT8
            DET_CONFD_ELEVATION_295_oRDR_DETECTION_293_296_oPCAN_RADAR_5e8fa445_Tx: ComSignalType=UINT8
            DET_CONFD_ELEVATION_296_oRDR_DETECTION_293_296_oPCAN_RADAR_3a6fdfbb_Tx: ComSignalType=UINT8
            DET_ELEVATION_293_oRDR_DETECTION_293_296_oPCAN_RADAR_468f8785_Tx: ComSignalType=UINT8
            DET_ELEVATION_294_oRDR_DETECTION_293_296_oPCAN_RADAR_1a3fa4ec_Tx: ComSignalType=UINT8
            DET_ELEVATION_295_oRDR_DETECTION_293_296_oPCAN_RADAR_8f4f7079_Tx: ComSignalType=UINT8
            DET_ELEVATION_296_oRDR_DETECTION_293_296_oPCAN_RADAR_ebaf0b87_Tx: ComSignalType=UINT8
            DET_ELEVATION_ERR_293_oRDR_DETECTION_293_296_oPCAN_RADAR_c1b61ff0_Tx: ComSignalType=UINT8
            DET_ELEVATION_ERR_294_oRDR_DETECTION_293_296_oPCAN_RADAR_9d063c99_Tx: ComSignalType=UINT8
            DET_ELEVATION_ERR_295_oRDR_DETECTION_293_296_oPCAN_RADAR_0876e80c_Tx: ComSignalType=UINT8
            DET_ELEVATION_ERR_296_oRDR_DETECTION_293_296_oPCAN_RADAR_6c9693f2_Tx: ComSignalType=UINT8
            DET_EXISTENCE_PROB_293_oRDR_DETECTION_293_296_oPCAN_RADAR_13296a90_Tx: ComSignalType=UINT8
            DET_EXISTENCE_PROB_294_oRDR_DETECTION_293_296_oPCAN_RADAR_4f9949f9_Tx: ComSignalType=UINT8
            DET_EXISTENCE_PROB_295_oRDR_DETECTION_293_296_oPCAN_RADAR_dae99d6c_Tx: ComSignalType=UINT8
            DET_EXISTENCE_PROB_296_oRDR_DETECTION_293_296_oPCAN_RADAR_be09e692_Tx: ComSignalType=UINT8
            DET_HVC_FLAG_293_oRDR_DETECTION_293_296_oPCAN_RADAR_f25d29ef_Tx: ComSignalType=BOOLEAN
            DET_HVC_FLAG_294_oRDR_DETECTION_293_296_oPCAN_RADAR_aeed0a86_Tx: ComSignalType=BOOLEAN
            DET_HVC_FLAG_295_oRDR_DETECTION_293_296_oPCAN_RADAR_3b9dde13_Tx: ComSignalType=BOOLEAN
            DET_HVC_FLAG_296_oRDR_DETECTION_293_296_oPCAN_RADAR_5f7da5ed_Tx: ComSignalType=BOOLEAN
            DET_IDM_293_oRDR_DETECTION_293_296_oPCAN_RADAR_790f1252_Tx: ComSignalType=UINT8
            DET_IDM_294_oRDR_DETECTION_293_296_oPCAN_RADAR_25bf313b_Tx: ComSignalType=UINT8
            DET_IDM_295_oRDR_DETECTION_293_296_oPCAN_RADAR_b0cfe5ae_Tx: ComSignalType=UINT8
            DET_IDM_296_oRDR_DETECTION_293_296_oPCAN_RADAR_d42f9e50_Tx: ComSignalType=UINT8
            DET_MH_CRC16_293_296_oRDR_DETECTION_293_296_oPCAN_RADAR_d1f4fb9f_Tx: ComSignalType=UINT16
            DET_MH_CYCLE_COUNTER_293_296_oRDR_DETECTION_293_296_oPCAN_RADAR_55815aa8_Tx: ComSignalType=UINT8
            DET_MH_SCAN_INDEX_4LSB_293_296_oRDR_DETECTION_293_296_oPCAN_RADAR_99ab7f24_Tx: ComSignalType=UINT8
            DET_MTD_293_oRDR_DETECTION_293_296_oPCAN_RADAR_1fbc2089_Tx: ComSignalType=UINT8
            DET_MTD_294_oRDR_DETECTION_293_296_oPCAN_RADAR_430c03e0_Tx: ComSignalType=UINT8
            DET_MTD_295_oRDR_DETECTION_293_296_oPCAN_RADAR_d67cd775_Tx: ComSignalType=UINT8
            DET_MTD_296_oRDR_DETECTION_293_296_oPCAN_RADAR_b29cac8b_Tx: ComSignalType=UINT8
            DET_PROB_1STAZHYPO_293_oRDR_DETECTION_293_296_oPCAN_RADAR_8c08c844_Tx: ComSignalType=BOOLEAN
            DET_PROB_1STAZHYPO_294_oRDR_DETECTION_293_296_oPCAN_RADAR_d0b8eb2d_Tx: ComSignalType=BOOLEAN
            DET_PROB_1STAZHYPO_295_oRDR_DETECTION_293_296_oPCAN_RADAR_45c83fb8_Tx: ComSignalType=BOOLEAN
            DET_PROB_1STAZHYPO_296_oRDR_DETECTION_293_296_oPCAN_RADAR_21284446_Tx: ComSignalType=BOOLEAN
            DET_RANGE_293_oRDR_DETECTION_293_296_oPCAN_RADAR_87a72b32_Tx: ComSignalType=UINT16
            DET_RANGE_294_oRDR_DETECTION_293_296_oPCAN_RADAR_db17085b_Tx: ComSignalType=UINT16
            DET_RANGE_295_oRDR_DETECTION_293_296_oPCAN_RADAR_4e67dcce_Tx: ComSignalType=UINT16
            DET_RANGE_296_oRDR_DETECTION_293_296_oPCAN_RADAR_2a87a730_Tx: ComSignalType=UINT16
            DET_RANGE_ERR_293_oRDR_DETECTION_293_296_oPCAN_RADAR_204f915b_Tx: ComSignalType=UINT8
            DET_RANGE_ERR_294_oRDR_DETECTION_293_296_oPCAN_RADAR_7cffb232_Tx: ComSignalType=UINT8
            DET_RANGE_ERR_295_oRDR_DETECTION_293_296_oPCAN_RADAR_e98f66a7_Tx: ComSignalType=UINT8
            DET_RANGE_ERR_296_oRDR_DETECTION_293_296_oPCAN_RADAR_8d6f1d59_Tx: ComSignalType=UINT8
            DET_RANGE_VELOCITY_293_oRDR_DETECTION_293_296_oPCAN_RADAR_f201e917_Tx: ComSignalType=UINT16
            DET_RANGE_VELOCITY_294_oRDR_DETECTION_293_296_oPCAN_RADAR_aeb1ca7e_Tx: ComSignalType=UINT16
            DET_RANGE_VELOCITY_295_oRDR_DETECTION_293_296_oPCAN_RADAR_3bc11eeb_Tx: ComSignalType=UINT16
            DET_RANGE_VELOCITY_296_oRDR_DETECTION_293_296_oPCAN_RADAR_5f216515_Tx: ComSignalType=UINT16
            DET_RANGE_VELOCITY_ERR_293_oRDR_DETECTION_293_296_oPCAN_RADAR_fdba12a5_Tx: ComSignalType=UINT8
            DET_RANGE_VELOCITY_ERR_294_oRDR_DETECTION_293_296_oPCAN_RADAR_a10a31cc_Tx: ComSignalType=UINT8
            DET_RANGE_VELOCITY_ERR_295_oRDR_DETECTION_293_296_oPCAN_RADAR_347ae559_Tx: ComSignalType=UINT8
            DET_RANGE_VELOCITY_ERR_296_oRDR_DETECTION_293_296_oPCAN_RADAR_509a9ea7_Tx: ComSignalType=UINT8
            DET_RCS_293_oRDR_DETECTION_293_296_oPCAN_RADAR_7581de4d_Tx: ComSignalType=UINT8
            DET_RCS_294_oRDR_DETECTION_293_296_oPCAN_RADAR_2931fd24_Tx: ComSignalType=UINT8
            DET_RCS_295_oRDR_DETECTION_293_296_oPCAN_RADAR_bc4129b1_Tx: ComSignalType=UINT8
            DET_RCS_296_oRDR_DETECTION_293_296_oPCAN_RADAR_d8a1524f_Tx: ComSignalType=UINT8
            DET_SNR_293_oRDR_DETECTION_293_296_oPCAN_RADAR_a82f8a4f_Tx: ComSignalType=UINT8
            DET_SNR_294_oRDR_DETECTION_293_296_oPCAN_RADAR_f49fa926_Tx: ComSignalType=UINT8
            DET_SNR_295_oRDR_DETECTION_293_296_oPCAN_RADAR_61ef7db3_Tx: ComSignalType=UINT8
            DET_SNR_296_oRDR_DETECTION_293_296_oPCAN_RADAR_050f064d_Tx: ComSignalType=UINT8
            DET_SUPER_RES_TARGET_293_oRDR_DETECTION_293_296_oPCAN_RADAR_99b6a22a_Tx: ComSignalType=BOOLEAN
            DET_SUPER_RES_TARGET_294_oRDR_DETECTION_293_296_oPCAN_RADAR_c5068143_Tx: ComSignalType=BOOLEAN
            DET_SUPER_RES_TARGET_295_oRDR_DETECTION_293_296_oPCAN_RADAR_507655d6_Tx: ComSignalType=BOOLEAN
            DET_SUPER_RES_TARGET_296_oRDR_DETECTION_293_296_oPCAN_RADAR_34962e28_Tx: ComSignalType=BOOLEAN
        SG_Detections_297_300_oRDR_DETECTION_297_300_oPCAN_RADAR_59a3068e_Tx
          83 x ComGroupSignal:
            DET_AZIMUTH_297_oRDR_DETECTION_297_300_oPCAN_RADAR_6b2cdca4_Tx: ComSignalType=UINT16
            DET_AZIMUTH_298_oRDR_DETECTION_297_300_oPCAN_RADAR_473c4ee3_Tx: ComSignalType=UINT16
            DET_AZIMUTH_299_oRDR_DETECTION_297_300_oPCAN_RADAR_d24c9a76_Tx: ComSignalType=UINT16
            DET_AZIMUTH_300_oRDR_DETECTION_297_300_oPCAN_RADAR_e642b84e_Tx: ComSignalType=UINT16
            DET_AZIMUTH_ERR_297_oRDR_DETECTION_297_300_oPCAN_RADAR_cf994951_Tx: ComSignalType=UINT8
            DET_AZIMUTH_ERR_298_oRDR_DETECTION_297_300_oPCAN_RADAR_e389db16_Tx: ComSignalType=UINT8
            DET_AZIMUTH_ERR_299_oRDR_DETECTION_297_300_oPCAN_RADAR_76f90f83_Tx: ComSignalType=UINT8
            DET_AZIMUTH_ERR_300_oRDR_DETECTION_297_300_oPCAN_RADAR_42f72dbb_Tx: ComSignalType=UINT8
            DET_BELOW_RAIN_THOLD_297_oRDR_DETECTION_297_300_oPCAN_RADAR_be2d4f64_Tx: ComSignalType=UINT8
            DET_BELOW_RAIN_THOLD_298_oRDR_DETECTION_297_300_oPCAN_RADAR_923ddd23_Tx: ComSignalType=UINT8
            DET_BELOW_RAIN_THOLD_299_oRDR_DETECTION_297_300_oPCAN_RADAR_074d09b6_Tx: ComSignalType=UINT8
            DET_BELOW_RAIN_THOLD_300_oRDR_DETECTION_297_300_oPCAN_RADAR_33432b8e_Tx: ComSignalType=UINT8
            DET_BI_STATIC_FLAG_297_oRDR_DETECTION_297_300_oPCAN_RADAR_3d009c21_Tx: ComSignalType=BOOLEAN
            DET_BI_STATIC_FLAG_298_oRDR_DETECTION_297_300_oPCAN_RADAR_11100e66_Tx: ComSignalType=BOOLEAN
            DET_BI_STATIC_FLAG_299_oRDR_DETECTION_297_300_oPCAN_RADAR_8460daf3_Tx: ComSignalType=BOOLEAN
            DET_BI_STATIC_FLAG_300_oRDR_DETECTION_297_300_oPCAN_RADAR_b06ef8cb_Tx: ComSignalType=BOOLEAN
            DET_CONFD_AZIMUTH_297_oRDR_DETECTION_297_300_oPCAN_RADAR_69cad66e_Tx: ComSignalType=UINT8
            DET_CONFD_AZIMUTH_298_oRDR_DETECTION_297_300_oPCAN_RADAR_45da4429_Tx: ComSignalType=UINT8
            DET_CONFD_AZIMUTH_299_oRDR_DETECTION_297_300_oPCAN_RADAR_d0aa90bc_Tx: ComSignalType=UINT8
            DET_CONFD_AZIMUTH_300_oRDR_DETECTION_297_300_oPCAN_RADAR_e4a4b284_Tx: ComSignalType=UINT8
            DET_CONFD_ELEVATION_297_oRDR_DETECTION_297_300_oPCAN_RADAR_6b5fd794_Tx: ComSignalType=UINT8
            DET_CONFD_ELEVATION_298_oRDR_DETECTION_297_300_oPCAN_RADAR_474f45d3_Tx: ComSignalType=UINT8
            DET_CONFD_ELEVATION_299_oRDR_DETECTION_297_300_oPCAN_RADAR_d23f9146_Tx: ComSignalType=UINT8
            DET_CONFD_ELEVATION_300_oRDR_DETECTION_297_300_oPCAN_RADAR_e631b37e_Tx: ComSignalType=UINT8
            DET_ELEVATION_297_oRDR_DETECTION_297_300_oPCAN_RADAR_ba9f03a8_Tx: ComSignalType=UINT8
            DET_ELEVATION_298_oRDR_DETECTION_297_300_oPCAN_RADAR_968f91ef_Tx: ComSignalType=UINT8
            DET_ELEVATION_299_oRDR_DETECTION_297_300_oPCAN_RADAR_03ff457a_Tx: ComSignalType=UINT8
            DET_ELEVATION_300_oRDR_DETECTION_297_300_oPCAN_RADAR_37f16742_Tx: ComSignalType=UINT8
            DET_ELEVATION_ERR_297_oRDR_DETECTION_297_300_oPCAN_RADAR_3da69bdd_Tx: ComSignalType=UINT8
            DET_ELEVATION_ERR_298_oRDR_DETECTION_297_300_oPCAN_RADAR_11b6099a_Tx: ComSignalType=UINT8
            DET_ELEVATION_ERR_299_oRDR_DETECTION_297_300_oPCAN_RADAR_84c6dd0f_Tx: ComSignalType=UINT8
            DET_ELEVATION_ERR_300_oRDR_DETECTION_297_300_oPCAN_RADAR_b0c8ff37_Tx: ComSignalType=UINT8
            DET_EXISTENCE_PROB_297_oRDR_DETECTION_297_300_oPCAN_RADAR_ef39eebd_Tx: ComSignalType=UINT8
            DET_EXISTENCE_PROB_298_oRDR_DETECTION_297_300_oPCAN_RADAR_c3297cfa_Tx: ComSignalType=UINT8
            DET_EXISTENCE_PROB_299_oRDR_DETECTION_297_300_oPCAN_RADAR_5659a86f_Tx: ComSignalType=UINT8
            DET_EXISTENCE_PROB_300_oRDR_DETECTION_297_300_oPCAN_RADAR_62578a57_Tx: ComSignalType=UINT8
            DET_HVC_FLAG_297_oRDR_DETECTION_297_300_oPCAN_RADAR_0e4dadc2_Tx: ComSignalType=BOOLEAN
            DET_HVC_FLAG_298_oRDR_DETECTION_297_300_oPCAN_RADAR_225d3f85_Tx: ComSignalType=BOOLEAN
            DET_HVC_FLAG_299_oRDR_DETECTION_297_300_oPCAN_RADAR_b72deb10_Tx: ComSignalType=BOOLEAN
            DET_HVC_FLAG_300_oRDR_DETECTION_297_300_oPCAN_RADAR_8323c928_Tx: ComSignalType=BOOLEAN
            DET_IDM_297_oRDR_DETECTION_297_300_oPCAN_RADAR_851f967f_Tx: ComSignalType=UINT8
            DET_IDM_298_oRDR_DETECTION_297_300_oPCAN_RADAR_a90f0438_Tx: ComSignalType=UINT8
            DET_IDM_299_oRDR_DETECTION_297_300_oPCAN_RADAR_3c7fd0ad_Tx: ComSignalType=UINT8
            DET_IDM_300_oRDR_DETECTION_297_300_oPCAN_RADAR_0871f295_Tx: ComSignalType=UINT8
            DET_MH_CRC16_297_300_oRDR_DETECTION_297_300_oPCAN_RADAR_dd2bd485_Tx: ComSignalType=UINT16
            DET_MH_CYCLE_COUNTER_297_300_oRDR_DETECTION_297_300_oPCAN_RADAR_595e75b2_Tx: ComSignalType=UINT8
            DET_MH_SCAN_INDEX_4LSB_297_300_oRDR_DETECTION_297_300_oPCAN_RADAR_9574503e_Tx: ComSignalType=UINT8
            DET_MTD_297_oRDR_DETECTION_297_300_oPCAN_RADAR_e3aca4a4_Tx: ComSignalType=UINT8
            DET_MTD_298_oRDR_DETECTION_297_300_oPCAN_RADAR_cfbc36e3_Tx: ComSignalType=UINT8
            DET_MTD_299_oRDR_DETECTION_297_300_oPCAN_RADAR_5acce276_Tx: ComSignalType=UINT8
            DET_MTD_300_oRDR_DETECTION_297_300_oPCAN_RADAR_6ec2c04e_Tx: ComSignalType=UINT8
            DET_PROB_1STAZHYPO_297_oRDR_DETECTION_297_300_oPCAN_RADAR_70184c69_Tx: ComSignalType=BOOLEAN
            DET_PROB_1STAZHYPO_298_oRDR_DETECTION_297_300_oPCAN_RADAR_5c08de2e_Tx: ComSignalType=BOOLEAN
            DET_PROB_1STAZHYPO_299_oRDR_DETECTION_297_300_oPCAN_RADAR_c9780abb_Tx: ComSignalType=BOOLEAN
            DET_PROB_1STAZHYPO_300_oRDR_DETECTION_297_300_oPCAN_RADAR_fd762883_Tx: ComSignalType=BOOLEAN
            DET_RANGE_297_oRDR_DETECTION_297_300_oPCAN_RADAR_7bb7af1f_Tx: ComSignalType=UINT16
            DET_RANGE_298_oRDR_DETECTION_297_300_oPCAN_RADAR_57a73d58_Tx: ComSignalType=UINT16
            DET_RANGE_299_oRDR_DETECTION_297_300_oPCAN_RADAR_c2d7e9cd_Tx: ComSignalType=UINT16
            DET_RANGE_300_oRDR_DETECTION_297_300_oPCAN_RADAR_f6d9cbf5_Tx: ComSignalType=UINT16
            DET_RANGE_ERR_297_oRDR_DETECTION_297_300_oPCAN_RADAR_dc5f1576_Tx: ComSignalType=UINT8
            DET_RANGE_ERR_298_oRDR_DETECTION_297_300_oPCAN_RADAR_f04f8731_Tx: ComSignalType=UINT8
            DET_RANGE_ERR_299_oRDR_DETECTION_297_300_oPCAN_RADAR_653f53a4_Tx: ComSignalType=UINT8
            DET_RANGE_ERR_300_oRDR_DETECTION_297_300_oPCAN_RADAR_5131719c_Tx: ComSignalType=UINT8
            DET_RANGE_VELOCITY_297_oRDR_DETECTION_297_300_oPCAN_RADAR_0e116d3a_Tx: ComSignalType=UINT16
            DET_RANGE_VELOCITY_298_oRDR_DETECTION_297_300_oPCAN_RADAR_2201ff7d_Tx: ComSignalType=UINT16
            DET_RANGE_VELOCITY_299_oRDR_DETECTION_297_300_oPCAN_RADAR_b7712be8_Tx: ComSignalType=UINT16
            DET_RANGE_VELOCITY_300_oRDR_DETECTION_297_300_oPCAN_RADAR_837f09d0_Tx: ComSignalType=UINT16
            DET_RANGE_VELOCITY_ERR_297_oRDR_DETECTION_297_300_oPCAN_RADAR_01aa9688_Tx: ComSignalType=UINT8
            DET_RANGE_VELOCITY_ERR_298_oRDR_DETECTION_297_300_oPCAN_RADAR_2dba04cf_Tx: ComSignalType=UINT8
            DET_RANGE_VELOCITY_ERR_299_oRDR_DETECTION_297_300_oPCAN_RADAR_b8cad05a_Tx: ComSignalType=UINT8
            DET_RANGE_VELOCITY_ERR_300_oRDR_DETECTION_297_300_oPCAN_RADAR_8cc4f262_Tx: ComSignalType=UINT8
            DET_RCS_297_oRDR_DETECTION_297_300_oPCAN_RADAR_89915a60_Tx: ComSignalType=UINT8
            DET_RCS_298_oRDR_DETECTION_297_300_oPCAN_RADAR_a581c827_Tx: ComSignalType=UINT8
            DET_RCS_299_oRDR_DETECTION_297_300_oPCAN_RADAR_30f11cb2_Tx: ComSignalType=UINT8
            DET_RCS_300_oRDR_DETECTION_297_300_oPCAN_RADAR_04ff3e8a_Tx: ComSignalType=UINT8
            DET_SNR_297_oRDR_DETECTION_297_300_oPCAN_RADAR_543f0e62_Tx: ComSignalType=UINT8
            DET_SNR_298_oRDR_DETECTION_297_300_oPCAN_RADAR_782f9c25_Tx: ComSignalType=UINT8
            DET_SNR_299_oRDR_DETECTION_297_300_oPCAN_RADAR_ed5f48b0_Tx: ComSignalType=UINT8
            DET_SNR_300_oRDR_DETECTION_297_300_oPCAN_RADAR_d9516a88_Tx: ComSignalType=UINT8
            DET_SUPER_RES_TARGET_297_oRDR_DETECTION_297_300_oPCAN_RADAR_65a62607_Tx: ComSignalType=BOOLEAN
            DET_SUPER_RES_TARGET_298_oRDR_DETECTION_297_300_oPCAN_RADAR_49b6b440_Tx: ComSignalType=BOOLEAN
            DET_SUPER_RES_TARGET_299_oRDR_DETECTION_297_300_oPCAN_RADAR_dcc660d5_Tx: ComSignalType=BOOLEAN
            DET_SUPER_RES_TARGET_300_oRDR_DETECTION_297_300_oPCAN_RADAR_e8c842ed_Tx: ComSignalType=BOOLEAN
        SG_Detections_301_304_oRDR_DETECTION_301_304_oPCAN_RADAR_18b0f261_Tx
          83 x ComGroupSignal:
            DET_AZIMUTH_301_oRDR_DETECTION_301_304_oPCAN_RADAR_3b5e29f0_Tx: ComSignalType=UINT16
            DET_AZIMUTH_302_oRDR_DETECTION_301_304_oPCAN_RADAR_5fbe520e_Tx: ComSignalType=UINT16
            DET_AZIMUTH_303_oRDR_DETECTION_301_304_oPCAN_RADAR_cace869b_Tx: ComSignalType=UINT16
            DET_AZIMUTH_304_oRDR_DETECTION_301_304_oPCAN_RADAR_967ea5f2_Tx: ComSignalType=UINT16
            DET_AZIMUTH_ERR_301_oRDR_DETECTION_301_304_oPCAN_RADAR_9febbc05_Tx: ComSignalType=UINT8
            DET_AZIMUTH_ERR_302_oRDR_DETECTION_301_304_oPCAN_RADAR_fb0bc7fb_Tx: ComSignalType=UINT8
            DET_AZIMUTH_ERR_303_oRDR_DETECTION_301_304_oPCAN_RADAR_6e7b136e_Tx: ComSignalType=UINT8
            DET_AZIMUTH_ERR_304_oRDR_DETECTION_301_304_oPCAN_RADAR_32cb3007_Tx: ComSignalType=UINT8
            DET_BELOW_RAIN_THOLD_301_oRDR_DETECTION_301_304_oPCAN_RADAR_ee5fba30_Tx: ComSignalType=UINT8
            DET_BELOW_RAIN_THOLD_302_oRDR_DETECTION_301_304_oPCAN_RADAR_8abfc1ce_Tx: ComSignalType=UINT8
            DET_BELOW_RAIN_THOLD_303_oRDR_DETECTION_301_304_oPCAN_RADAR_1fcf155b_Tx: ComSignalType=UINT8
            DET_BELOW_RAIN_THOLD_304_oRDR_DETECTION_301_304_oPCAN_RADAR_437f3632_Tx: ComSignalType=UINT8
            DET_BI_STATIC_FLAG_301_oRDR_DETECTION_301_304_oPCAN_RADAR_6d726975_Tx: ComSignalType=BOOLEAN
            DET_BI_STATIC_FLAG_302_oRDR_DETECTION_301_304_oPCAN_RADAR_0992128b_Tx: ComSignalType=BOOLEAN
            DET_BI_STATIC_FLAG_303_oRDR_DETECTION_301_304_oPCAN_RADAR_9ce2c61e_Tx: ComSignalType=BOOLEAN
            DET_BI_STATIC_FLAG_304_oRDR_DETECTION_301_304_oPCAN_RADAR_c052e577_Tx: ComSignalType=BOOLEAN
            DET_CONFD_AZIMUTH_301_oRDR_DETECTION_301_304_oPCAN_RADAR_39b8233a_Tx: ComSignalType=UINT8
            DET_CONFD_AZIMUTH_302_oRDR_DETECTION_301_304_oPCAN_RADAR_5d5858c4_Tx: ComSignalType=UINT8
            DET_CONFD_AZIMUTH_303_oRDR_DETECTION_301_304_oPCAN_RADAR_c8288c51_Tx: ComSignalType=UINT8
            DET_CONFD_AZIMUTH_304_oRDR_DETECTION_301_304_oPCAN_RADAR_9498af38_Tx: ComSignalType=UINT8
            DET_CONFD_ELEVATION_301_oRDR_DETECTION_301_304_oPCAN_RADAR_3b2d22c0_Tx: ComSignalType=UINT8
            DET_CONFD_ELEVATION_302_oRDR_DETECTION_301_304_oPCAN_RADAR_5fcd593e_Tx: ComSignalType=UINT8
            DET_CONFD_ELEVATION_303_oRDR_DETECTION_301_304_oPCAN_RADAR_cabd8dab_Tx: ComSignalType=UINT8
            DET_CONFD_ELEVATION_304_oRDR_DETECTION_301_304_oPCAN_RADAR_960daec2_Tx: ComSignalType=UINT8
            DET_ELEVATION_301_oRDR_DETECTION_301_304_oPCAN_RADAR_eaedf6fc_Tx: ComSignalType=UINT8
            DET_ELEVATION_302_oRDR_DETECTION_301_304_oPCAN_RADAR_8e0d8d02_Tx: ComSignalType=UINT8
            DET_ELEVATION_303_oRDR_DETECTION_301_304_oPCAN_RADAR_1b7d5997_Tx: ComSignalType=UINT8
            DET_ELEVATION_304_oRDR_DETECTION_301_304_oPCAN_RADAR_47cd7afe_Tx: ComSignalType=UINT8
            DET_ELEVATION_ERR_301_oRDR_DETECTION_301_304_oPCAN_RADAR_6dd46e89_Tx: ComSignalType=UINT8
            DET_ELEVATION_ERR_302_oRDR_DETECTION_301_304_oPCAN_RADAR_09341577_Tx: ComSignalType=UINT8
            DET_ELEVATION_ERR_303_oRDR_DETECTION_301_304_oPCAN_RADAR_9c44c1e2_Tx: ComSignalType=UINT8
            DET_ELEVATION_ERR_304_oRDR_DETECTION_301_304_oPCAN_RADAR_c0f4e28b_Tx: ComSignalType=UINT8
            DET_EXISTENCE_PROB_301_oRDR_DETECTION_301_304_oPCAN_RADAR_bf4b1be9_Tx: ComSignalType=UINT8
            DET_EXISTENCE_PROB_302_oRDR_DETECTION_301_304_oPCAN_RADAR_dbab6017_Tx: ComSignalType=UINT8
            DET_EXISTENCE_PROB_303_oRDR_DETECTION_301_304_oPCAN_RADAR_4edbb482_Tx: ComSignalType=UINT8
            DET_EXISTENCE_PROB_304_oRDR_DETECTION_301_304_oPCAN_RADAR_126b97eb_Tx: ComSignalType=UINT8
            DET_HVC_FLAG_301_oRDR_DETECTION_301_304_oPCAN_RADAR_5e3f5896_Tx: ComSignalType=BOOLEAN
            DET_HVC_FLAG_302_oRDR_DETECTION_301_304_oPCAN_RADAR_3adf2368_Tx: ComSignalType=BOOLEAN
            DET_HVC_FLAG_303_oRDR_DETECTION_301_304_oPCAN_RADAR_afaff7fd_Tx: ComSignalType=BOOLEAN
            DET_HVC_FLAG_304_oRDR_DETECTION_301_304_oPCAN_RADAR_f31fd494_Tx: ComSignalType=BOOLEAN
            DET_IDM_301_oRDR_DETECTION_301_304_oPCAN_RADAR_d56d632b_Tx: ComSignalType=UINT8
            DET_IDM_302_oRDR_DETECTION_301_304_oPCAN_RADAR_b18d18d5_Tx: ComSignalType=UINT8
            DET_IDM_303_oRDR_DETECTION_301_304_oPCAN_RADAR_24fdcc40_Tx: ComSignalType=UINT8
            DET_IDM_304_oRDR_DETECTION_301_304_oPCAN_RADAR_784def29_Tx: ComSignalType=UINT8
            DET_MH_CRC16_301_304_oRDR_DETECTION_301_304_oPCAN_RADAR_9c38206a_Tx: ComSignalType=UINT16
            DET_MH_CYCLE_COUNTER_301_304_oRDR_DETECTION_301_304_oPCAN_RADAR_184d815d_Tx: ComSignalType=UINT8
            DET_MH_SCAN_INDEX_4LSB_301_304_oRDR_DETECTION_301_304_oPCAN_RADAR_d467a4d1_Tx: ComSignalType=UINT8
            DET_MTD_301_oRDR_DETECTION_301_304_oPCAN_RADAR_b3de51f0_Tx: ComSignalType=UINT8
            DET_MTD_302_oRDR_DETECTION_301_304_oPCAN_RADAR_d73e2a0e_Tx: ComSignalType=UINT8
            DET_MTD_303_oRDR_DETECTION_301_304_oPCAN_RADAR_424efe9b_Tx: ComSignalType=UINT8
            DET_MTD_304_oRDR_DETECTION_301_304_oPCAN_RADAR_1efeddf2_Tx: ComSignalType=UINT8
            DET_PROB_1STAZHYPO_301_oRDR_DETECTION_301_304_oPCAN_RADAR_206ab93d_Tx: ComSignalType=BOOLEAN
            DET_PROB_1STAZHYPO_302_oRDR_DETECTION_301_304_oPCAN_RADAR_448ac2c3_Tx: ComSignalType=BOOLEAN
            DET_PROB_1STAZHYPO_303_oRDR_DETECTION_301_304_oPCAN_RADAR_d1fa1656_Tx: ComSignalType=BOOLEAN
            DET_PROB_1STAZHYPO_304_oRDR_DETECTION_301_304_oPCAN_RADAR_8d4a353f_Tx: ComSignalType=BOOLEAN
            DET_RANGE_301_oRDR_DETECTION_301_304_oPCAN_RADAR_2bc55a4b_Tx: ComSignalType=UINT16
            DET_RANGE_302_oRDR_DETECTION_301_304_oPCAN_RADAR_4f2521b5_Tx: ComSignalType=UINT16
            DET_RANGE_303_oRDR_DETECTION_301_304_oPCAN_RADAR_da55f520_Tx: ComSignalType=UINT16
            DET_RANGE_304_oRDR_DETECTION_301_304_oPCAN_RADAR_86e5d649_Tx: ComSignalType=UINT16
            DET_RANGE_ERR_301_oRDR_DETECTION_301_304_oPCAN_RADAR_8c2de022_Tx: ComSignalType=UINT8
            DET_RANGE_ERR_302_oRDR_DETECTION_301_304_oPCAN_RADAR_e8cd9bdc_Tx: ComSignalType=UINT8
            DET_RANGE_ERR_303_oRDR_DETECTION_301_304_oPCAN_RADAR_7dbd4f49_Tx: ComSignalType=UINT8
            DET_RANGE_ERR_304_oRDR_DETECTION_301_304_oPCAN_RADAR_210d6c20_Tx: ComSignalType=UINT8
            DET_RANGE_VELOCITY_301_oRDR_DETECTION_301_304_oPCAN_RADAR_5e63986e_Tx: ComSignalType=UINT16
            DET_RANGE_VELOCITY_302_oRDR_DETECTION_301_304_oPCAN_RADAR_3a83e390_Tx: ComSignalType=UINT16
            DET_RANGE_VELOCITY_303_oRDR_DETECTION_301_304_oPCAN_RADAR_aff33705_Tx: ComSignalType=UINT16
            DET_RANGE_VELOCITY_304_oRDR_DETECTION_301_304_oPCAN_RADAR_f343146c_Tx: ComSignalType=UINT16
            DET_RANGE_VELOCITY_ERR_301_oRDR_DETECTION_301_304_oPCAN_RADAR_51d863dc_Tx: ComSignalType=UINT8
            DET_RANGE_VELOCITY_ERR_302_oRDR_DETECTION_301_304_oPCAN_RADAR_35381822_Tx: ComSignalType=UINT8
            DET_RANGE_VELOCITY_ERR_303_oRDR_DETECTION_301_304_oPCAN_RADAR_a048ccb7_Tx: ComSignalType=UINT8
            DET_RANGE_VELOCITY_ERR_304_oRDR_DETECTION_301_304_oPCAN_RADAR_fcf8efde_Tx: ComSignalType=UINT8
            DET_RCS_301_oRDR_DETECTION_301_304_oPCAN_RADAR_d9e3af34_Tx: ComSignalType=UINT8
            DET_RCS_302_oRDR_DETECTION_301_304_oPCAN_RADAR_bd03d4ca_Tx: ComSignalType=UINT8
            DET_RCS_303_oRDR_DETECTION_301_304_oPCAN_RADAR_2873005f_Tx: ComSignalType=UINT8
            DET_RCS_304_oRDR_DETECTION_301_304_oPCAN_RADAR_74c32336_Tx: ComSignalType=UINT8
            DET_SNR_301_oRDR_DETECTION_301_304_oPCAN_RADAR_044dfb36_Tx: ComSignalType=UINT8
            DET_SNR_302_oRDR_DETECTION_301_304_oPCAN_RADAR_60ad80c8_Tx: ComSignalType=UINT8
            DET_SNR_303_oRDR_DETECTION_301_304_oPCAN_RADAR_f5dd545d_Tx: ComSignalType=UINT8
            DET_SNR_304_oRDR_DETECTION_301_304_oPCAN_RADAR_a96d7734_Tx: ComSignalType=UINT8
            DET_SUPER_RES_TARGET_301_oRDR_DETECTION_301_304_oPCAN_RADAR_35d4d353_Tx: ComSignalType=BOOLEAN
            DET_SUPER_RES_TARGET_302_oRDR_DETECTION_301_304_oPCAN_RADAR_5134a8ad_Tx: ComSignalType=BOOLEAN
            DET_SUPER_RES_TARGET_303_oRDR_DETECTION_301_304_oPCAN_RADAR_c4447c38_Tx: ComSignalType=BOOLEAN
            DET_SUPER_RES_TARGET_304_oRDR_DETECTION_301_304_oPCAN_RADAR_98f45f51_Tx: ComSignalType=BOOLEAN
        SG_Detections_305_308_oRDR_DETECTION_305_308_oPCAN_RADAR_6973c633_Tx
          83 x ComGroupSignal:
            DET_AZIMUTH_305_oRDR_DETECTION_305_308_oPCAN_RADAR_eabcef53_Tx: ComSignalType=UINT16
            DET_AZIMUTH_306_oRDR_DETECTION_305_308_oPCAN_RADAR_8e5c94ad_Tx: ComSignalType=UINT16
            DET_AZIMUTH_307_oRDR_DETECTION_305_308_oPCAN_RADAR_1b2c4038_Tx: ComSignalType=UINT16
            DET_AZIMUTH_308_oRDR_DETECTION_305_308_oPCAN_RADAR_373cd27f_Tx: ComSignalType=UINT16
            DET_AZIMUTH_ERR_305_oRDR_DETECTION_305_308_oPCAN_RADAR_4e097aa6_Tx: ComSignalType=UINT8
            DET_AZIMUTH_ERR_306_oRDR_DETECTION_305_308_oPCAN_RADAR_2ae90158_Tx: ComSignalType=UINT8
            DET_AZIMUTH_ERR_307_oRDR_DETECTION_305_308_oPCAN_RADAR_bf99d5cd_Tx: ComSignalType=UINT8
            DET_AZIMUTH_ERR_308_oRDR_DETECTION_305_308_oPCAN_RADAR_9389478a_Tx: ComSignalType=UINT8
            DET_BELOW_RAIN_THOLD_305_oRDR_DETECTION_305_308_oPCAN_RADAR_3fbd7c93_Tx: ComSignalType=UINT8
            DET_BELOW_RAIN_THOLD_306_oRDR_DETECTION_305_308_oPCAN_RADAR_5b5d076d_Tx: ComSignalType=UINT8
            DET_BELOW_RAIN_THOLD_307_oRDR_DETECTION_305_308_oPCAN_RADAR_ce2dd3f8_Tx: ComSignalType=UINT8
            DET_BELOW_RAIN_THOLD_308_oRDR_DETECTION_305_308_oPCAN_RADAR_e23d41bf_Tx: ComSignalType=UINT8
            DET_BI_STATIC_FLAG_305_oRDR_DETECTION_305_308_oPCAN_RADAR_bc90afd6_Tx: ComSignalType=BOOLEAN
            DET_BI_STATIC_FLAG_306_oRDR_DETECTION_305_308_oPCAN_RADAR_d870d428_Tx: ComSignalType=BOOLEAN
            DET_BI_STATIC_FLAG_307_oRDR_DETECTION_305_308_oPCAN_RADAR_4d0000bd_Tx: ComSignalType=BOOLEAN
            DET_BI_STATIC_FLAG_308_oRDR_DETECTION_305_308_oPCAN_RADAR_611092fa_Tx: ComSignalType=BOOLEAN
            DET_CONFD_AZIMUTH_305_oRDR_DETECTION_305_308_oPCAN_RADAR_e85ae599_Tx: ComSignalType=UINT8
            DET_CONFD_AZIMUTH_306_oRDR_DETECTION_305_308_oPCAN_RADAR_8cba9e67_Tx: ComSignalType=UINT8
            DET_CONFD_AZIMUTH_307_oRDR_DETECTION_305_308_oPCAN_RADAR_19ca4af2_Tx: ComSignalType=UINT8
            DET_CONFD_AZIMUTH_308_oRDR_DETECTION_305_308_oPCAN_RADAR_35dad8b5_Tx: ComSignalType=UINT8
            DET_CONFD_ELEVATION_305_oRDR_DETECTION_305_308_oPCAN_RADAR_eacfe463_Tx: ComSignalType=UINT8
            DET_CONFD_ELEVATION_306_oRDR_DETECTION_305_308_oPCAN_RADAR_8e2f9f9d_Tx: ComSignalType=UINT8
            DET_CONFD_ELEVATION_307_oRDR_DETECTION_305_308_oPCAN_RADAR_1b5f4b08_Tx: ComSignalType=UINT8
            DET_CONFD_ELEVATION_308_oRDR_DETECTION_305_308_oPCAN_RADAR_374fd94f_Tx: ComSignalType=UINT8
            DET_ELEVATION_305_oRDR_DETECTION_305_308_oPCAN_RADAR_3b0f305f_Tx: ComSignalType=UINT8
            DET_ELEVATION_306_oRDR_DETECTION_305_308_oPCAN_RADAR_5fef4ba1_Tx: ComSignalType=UINT8
            DET_ELEVATION_307_oRDR_DETECTION_305_308_oPCAN_RADAR_ca9f9f34_Tx: ComSignalType=UINT8
            DET_ELEVATION_308_oRDR_DETECTION_305_308_oPCAN_RADAR_e68f0d73_Tx: ComSignalType=UINT8
            DET_ELEVATION_ERR_305_oRDR_DETECTION_305_308_oPCAN_RADAR_bc36a82a_Tx: ComSignalType=UINT8
            DET_ELEVATION_ERR_306_oRDR_DETECTION_305_308_oPCAN_RADAR_d8d6d3d4_Tx: ComSignalType=UINT8
            DET_ELEVATION_ERR_307_oRDR_DETECTION_305_308_oPCAN_RADAR_4da60741_Tx: ComSignalType=UINT8
            DET_ELEVATION_ERR_308_oRDR_DETECTION_305_308_oPCAN_RADAR_61b69506_Tx: ComSignalType=UINT8
            DET_EXISTENCE_PROB_305_oRDR_DETECTION_305_308_oPCAN_RADAR_6ea9dd4a_Tx: ComSignalType=UINT8
            DET_EXISTENCE_PROB_306_oRDR_DETECTION_305_308_oPCAN_RADAR_0a49a6b4_Tx: ComSignalType=UINT8
            DET_EXISTENCE_PROB_307_oRDR_DETECTION_305_308_oPCAN_RADAR_9f397221_Tx: ComSignalType=UINT8
            DET_EXISTENCE_PROB_308_oRDR_DETECTION_305_308_oPCAN_RADAR_b329e066_Tx: ComSignalType=UINT8
            DET_HVC_FLAG_305_oRDR_DETECTION_305_308_oPCAN_RADAR_8fdd9e35_Tx: ComSignalType=BOOLEAN
            DET_HVC_FLAG_306_oRDR_DETECTION_305_308_oPCAN_RADAR_eb3de5cb_Tx: ComSignalType=BOOLEAN
            DET_HVC_FLAG_307_oRDR_DETECTION_305_308_oPCAN_RADAR_7e4d315e_Tx: ComSignalType=BOOLEAN
            DET_HVC_FLAG_308_oRDR_DETECTION_305_308_oPCAN_RADAR_525da319_Tx: ComSignalType=BOOLEAN
            DET_IDM_305_oRDR_DETECTION_305_308_oPCAN_RADAR_048fa588_Tx: ComSignalType=UINT8
            DET_IDM_306_oRDR_DETECTION_305_308_oPCAN_RADAR_606fde76_Tx: ComSignalType=UINT8
            DET_IDM_307_oRDR_DETECTION_305_308_oPCAN_RADAR_f51f0ae3_Tx: ComSignalType=UINT8
            DET_IDM_308_oRDR_DETECTION_305_308_oPCAN_RADAR_d90f98a4_Tx: ComSignalType=UINT8
            DET_MH_CRC16_305_308_oRDR_DETECTION_305_308_oPCAN_RADAR_edfb1438_Tx: ComSignalType=UINT16
            DET_MH_CYCLE_COUNTER_305_308_oRDR_DETECTION_305_308_oPCAN_RADAR_698eb50f_Tx: ComSignalType=UINT8
            DET_MH_SCAN_INDEX_4LSB_305_308_oRDR_DETECTION_305_308_oPCAN_RADAR_a5a49083_Tx: ComSignalType=UINT8
            DET_MTD_305_oRDR_DETECTION_305_308_oPCAN_RADAR_623c9753_Tx: ComSignalType=UINT8
            DET_MTD_306_oRDR_DETECTION_305_308_oPCAN_RADAR_06dcecad_Tx: ComSignalType=UINT8
            DET_MTD_307_oRDR_DETECTION_305_308_oPCAN_RADAR_93ac3838_Tx: ComSignalType=UINT8
            DET_MTD_308_oRDR_DETECTION_305_308_oPCAN_RADAR_bfbcaa7f_Tx: ComSignalType=UINT8
            DET_PROB_1STAZHYPO_305_oRDR_DETECTION_305_308_oPCAN_RADAR_f1887f9e_Tx: ComSignalType=BOOLEAN
            DET_PROB_1STAZHYPO_306_oRDR_DETECTION_305_308_oPCAN_RADAR_95680460_Tx: ComSignalType=BOOLEAN
            DET_PROB_1STAZHYPO_307_oRDR_DETECTION_305_308_oPCAN_RADAR_0018d0f5_Tx: ComSignalType=BOOLEAN
            DET_PROB_1STAZHYPO_308_oRDR_DETECTION_305_308_oPCAN_RADAR_2c0842b2_Tx: ComSignalType=BOOLEAN
            DET_RANGE_305_oRDR_DETECTION_305_308_oPCAN_RADAR_fa279ce8_Tx: ComSignalType=UINT16
            DET_RANGE_306_oRDR_DETECTION_305_308_oPCAN_RADAR_9ec7e716_Tx: ComSignalType=UINT16
            DET_RANGE_307_oRDR_DETECTION_305_308_oPCAN_RADAR_0bb73383_Tx: ComSignalType=UINT16
            DET_RANGE_308_oRDR_DETECTION_305_308_oPCAN_RADAR_27a7a1c4_Tx: ComSignalType=UINT16
            DET_RANGE_ERR_305_oRDR_DETECTION_305_308_oPCAN_RADAR_5dcf2681_Tx: ComSignalType=UINT8
            DET_RANGE_ERR_306_oRDR_DETECTION_305_308_oPCAN_RADAR_392f5d7f_Tx: ComSignalType=UINT8
            DET_RANGE_ERR_307_oRDR_DETECTION_305_308_oPCAN_RADAR_ac5f89ea_Tx: ComSignalType=UINT8
            DET_RANGE_ERR_308_oRDR_DETECTION_305_308_oPCAN_RADAR_804f1bad_Tx: ComSignalType=UINT8
            DET_RANGE_VELOCITY_305_oRDR_DETECTION_305_308_oPCAN_RADAR_8f815ecd_Tx: ComSignalType=UINT16
            DET_RANGE_VELOCITY_306_oRDR_DETECTION_305_308_oPCAN_RADAR_eb612533_Tx: ComSignalType=UINT16
            DET_RANGE_VELOCITY_307_oRDR_DETECTION_305_308_oPCAN_RADAR_7e11f1a6_Tx: ComSignalType=UINT16
            DET_RANGE_VELOCITY_308_oRDR_DETECTION_305_308_oPCAN_RADAR_520163e1_Tx: ComSignalType=UINT16
            DET_RANGE_VELOCITY_ERR_305_oRDR_DETECTION_305_308_oPCAN_RADAR_803aa57f_Tx: ComSignalType=UINT8
            DET_RANGE_VELOCITY_ERR_306_oRDR_DETECTION_305_308_oPCAN_RADAR_e4dade81_Tx: ComSignalType=UINT8
            DET_RANGE_VELOCITY_ERR_307_oRDR_DETECTION_305_308_oPCAN_RADAR_71aa0a14_Tx: ComSignalType=UINT8
            DET_RANGE_VELOCITY_ERR_308_oRDR_DETECTION_305_308_oPCAN_RADAR_5dba9853_Tx: ComSignalType=UINT8
            DET_RCS_305_oRDR_DETECTION_305_308_oPCAN_RADAR_08016997_Tx: ComSignalType=UINT8
            DET_RCS_306_oRDR_DETECTION_305_308_oPCAN_RADAR_6ce11269_Tx: ComSignalType=UINT8
            DET_RCS_307_oRDR_DETECTION_305_308_oPCAN_RADAR_f991c6fc_Tx: ComSignalType=UINT8
            DET_RCS_308_oRDR_DETECTION_305_308_oPCAN_RADAR_d58154bb_Tx: ComSignalType=UINT8
            DET_SNR_305_oRDR_DETECTION_305_308_oPCAN_RADAR_d5af3d95_Tx: ComSignalType=UINT8
            DET_SNR_306_oRDR_DETECTION_305_308_oPCAN_RADAR_b14f466b_Tx: ComSignalType=UINT8
            DET_SNR_307_oRDR_DETECTION_305_308_oPCAN_RADAR_243f92fe_Tx: ComSignalType=UINT8
            DET_SNR_308_oRDR_DETECTION_305_308_oPCAN_RADAR_082f00b9_Tx: ComSignalType=UINT8
            DET_SUPER_RES_TARGET_305_oRDR_DETECTION_305_308_oPCAN_RADAR_e43615f0_Tx: ComSignalType=BOOLEAN
            DET_SUPER_RES_TARGET_306_oRDR_DETECTION_305_308_oPCAN_RADAR_80d66e0e_Tx: ComSignalType=BOOLEAN
            DET_SUPER_RES_TARGET_307_oRDR_DETECTION_305_308_oPCAN_RADAR_15a6ba9b_Tx: ComSignalType=BOOLEAN
            DET_SUPER_RES_TARGET_308_oRDR_DETECTION_305_308_oPCAN_RADAR_39b628dc_Tx: ComSignalType=BOOLEAN
        SG_Detections_309_312_oRDR_DETECTION_309_312_oPCAN_RADAR_f009e248_Tx
          83 x ComGroupSignal:
            DET_AZIMUTH_309_oRDR_DETECTION_309_312_oPCAN_RADAR_9004e9eb_Tx: ComSignalType=UINT16
            DET_AZIMUTH_310_oRDR_DETECTION_309_312_oPCAN_RADAR_f5249b4f_Tx: ComSignalType=UINT16
            DET_AZIMUTH_311_oRDR_DETECTION_309_312_oPCAN_RADAR_60544fda_Tx: ComSignalType=UINT16
            DET_AZIMUTH_312_oRDR_DETECTION_309_312_oPCAN_RADAR_04b43424_Tx: ComSignalType=UINT16
            DET_AZIMUTH_ERR_309_oRDR_DETECTION_309_312_oPCAN_RADAR_34b17c1e_Tx: ComSignalType=UINT8
            DET_AZIMUTH_ERR_310_oRDR_DETECTION_309_312_oPCAN_RADAR_51910eba_Tx: ComSignalType=UINT8
            DET_AZIMUTH_ERR_311_oRDR_DETECTION_309_312_oPCAN_RADAR_c4e1da2f_Tx: ComSignalType=UINT8
            DET_AZIMUTH_ERR_312_oRDR_DETECTION_309_312_oPCAN_RADAR_a001a1d1_Tx: ComSignalType=UINT8
            DET_BELOW_RAIN_THOLD_309_oRDR_DETECTION_309_312_oPCAN_RADAR_45057a2b_Tx: ComSignalType=UINT8
            DET_BELOW_RAIN_THOLD_310_oRDR_DETECTION_309_312_oPCAN_RADAR_2025088f_Tx: ComSignalType=UINT8
            DET_BELOW_RAIN_THOLD_311_oRDR_DETECTION_309_312_oPCAN_RADAR_b555dc1a_Tx: ComSignalType=UINT8
            DET_BELOW_RAIN_THOLD_312_oRDR_DETECTION_309_312_oPCAN_RADAR_d1b5a7e4_Tx: ComSignalType=UINT8
            DET_BI_STATIC_FLAG_309_oRDR_DETECTION_309_312_oPCAN_RADAR_c628a96e_Tx: ComSignalType=BOOLEAN
            DET_BI_STATIC_FLAG_310_oRDR_DETECTION_309_312_oPCAN_RADAR_a308dbca_Tx: ComSignalType=BOOLEAN
            DET_BI_STATIC_FLAG_311_oRDR_DETECTION_309_312_oPCAN_RADAR_36780f5f_Tx: ComSignalType=BOOLEAN
            DET_BI_STATIC_FLAG_312_oRDR_DETECTION_309_312_oPCAN_RADAR_529874a1_Tx: ComSignalType=BOOLEAN
            DET_CONFD_AZIMUTH_309_oRDR_DETECTION_309_312_oPCAN_RADAR_92e2e321_Tx: ComSignalType=UINT8
            DET_CONFD_AZIMUTH_310_oRDR_DETECTION_309_312_oPCAN_RADAR_f7c29185_Tx: ComSignalType=UINT8
            DET_CONFD_AZIMUTH_311_oRDR_DETECTION_309_312_oPCAN_RADAR_62b24510_Tx: ComSignalType=UINT8
            DET_CONFD_AZIMUTH_312_oRDR_DETECTION_309_312_oPCAN_RADAR_06523eee_Tx: ComSignalType=UINT8
            DET_CONFD_ELEVATION_309_oRDR_DETECTION_309_312_oPCAN_RADAR_9077e2db_Tx: ComSignalType=UINT8
            DET_CONFD_ELEVATION_310_oRDR_DETECTION_309_312_oPCAN_RADAR_f557907f_Tx: ComSignalType=UINT8
            DET_CONFD_ELEVATION_311_oRDR_DETECTION_309_312_oPCAN_RADAR_602744ea_Tx: ComSignalType=UINT8
            DET_CONFD_ELEVATION_312_oRDR_DETECTION_309_312_oPCAN_RADAR_04c73f14_Tx: ComSignalType=UINT8
            DET_ELEVATION_309_oRDR_DETECTION_309_312_oPCAN_RADAR_41b736e7_Tx: ComSignalType=UINT8
            DET_ELEVATION_310_oRDR_DETECTION_309_312_oPCAN_RADAR_24974443_Tx: ComSignalType=UINT8
            DET_ELEVATION_311_oRDR_DETECTION_309_312_oPCAN_RADAR_b1e790d6_Tx: ComSignalType=UINT8
            DET_ELEVATION_312_oRDR_DETECTION_309_312_oPCAN_RADAR_d507eb28_Tx: ComSignalType=UINT8
            DET_ELEVATION_ERR_309_oRDR_DETECTION_309_312_oPCAN_RADAR_c68eae92_Tx: ComSignalType=UINT8
            DET_ELEVATION_ERR_310_oRDR_DETECTION_309_312_oPCAN_RADAR_a3aedc36_Tx: ComSignalType=UINT8
            DET_ELEVATION_ERR_311_oRDR_DETECTION_309_312_oPCAN_RADAR_36de08a3_Tx: ComSignalType=UINT8
            DET_ELEVATION_ERR_312_oRDR_DETECTION_309_312_oPCAN_RADAR_523e735d_Tx: ComSignalType=UINT8
            DET_EXISTENCE_PROB_309_oRDR_DETECTION_309_312_oPCAN_RADAR_1411dbf2_Tx: ComSignalType=UINT8
            DET_EXISTENCE_PROB_310_oRDR_DETECTION_309_312_oPCAN_RADAR_7131a956_Tx: ComSignalType=UINT8
            DET_EXISTENCE_PROB_311_oRDR_DETECTION_309_312_oPCAN_RADAR_e4417dc3_Tx: ComSignalType=UINT8
            DET_EXISTENCE_PROB_312_oRDR_DETECTION_309_312_oPCAN_RADAR_80a1063d_Tx: ComSignalType=UINT8
            DET_HVC_FLAG_309_oRDR_DETECTION_309_312_oPCAN_RADAR_f565988d_Tx: ComSignalType=BOOLEAN
            DET_HVC_FLAG_310_oRDR_DETECTION_309_312_oPCAN_RADAR_9045ea29_Tx: ComSignalType=BOOLEAN
            DET_HVC_FLAG_311_oRDR_DETECTION_309_312_oPCAN_RADAR_05353ebc_Tx: ComSignalType=BOOLEAN
            DET_HVC_FLAG_312_oRDR_DETECTION_309_312_oPCAN_RADAR_61d54542_Tx: ComSignalType=BOOLEAN
            DET_IDM_309_oRDR_DETECTION_309_312_oPCAN_RADAR_7e37a330_Tx: ComSignalType=UINT8
            DET_IDM_310_oRDR_DETECTION_309_312_oPCAN_RADAR_1b17d194_Tx: ComSignalType=UINT8
            DET_IDM_311_oRDR_DETECTION_309_312_oPCAN_RADAR_8e670501_Tx: ComSignalType=UINT8
            DET_IDM_312_oRDR_DETECTION_309_312_oPCAN_RADAR_ea877eff_Tx: ComSignalType=UINT8
            DET_MH_CRC16_309_312_oRDR_DETECTION_309_312_oPCAN_RADAR_74813043_Tx: ComSignalType=UINT16
            DET_MH_CYCLE_COUNTER_309_312_oRDR_DETECTION_309_312_oPCAN_RADAR_f0f49174_Tx: ComSignalType=UINT8
            DET_MH_SCAN_INDEX_4LSB_309_312_oRDR_DETECTION_309_312_oPCAN_RADAR_3cdeb4f8_Tx: ComSignalType=UINT8
            DET_MTD_309_oRDR_DETECTION_309_312_oPCAN_RADAR_188491eb_Tx: ComSignalType=UINT8
            DET_MTD_310_oRDR_DETECTION_309_312_oPCAN_RADAR_7da4e34f_Tx: ComSignalType=UINT8
            DET_MTD_311_oRDR_DETECTION_309_312_oPCAN_RADAR_e8d437da_Tx: ComSignalType=UINT8
            DET_MTD_312_oRDR_DETECTION_309_312_oPCAN_RADAR_8c344c24_Tx: ComSignalType=UINT8
            DET_PROB_1STAZHYPO_309_oRDR_DETECTION_309_312_oPCAN_RADAR_8b307926_Tx: ComSignalType=BOOLEAN
            DET_PROB_1STAZHYPO_310_oRDR_DETECTION_309_312_oPCAN_RADAR_ee100b82_Tx: ComSignalType=BOOLEAN
            DET_PROB_1STAZHYPO_311_oRDR_DETECTION_309_312_oPCAN_RADAR_7b60df17_Tx: ComSignalType=BOOLEAN
            DET_PROB_1STAZHYPO_312_oRDR_DETECTION_309_312_oPCAN_RADAR_1f80a4e9_Tx: ComSignalType=BOOLEAN
            DET_RANGE_309_oRDR_DETECTION_309_312_oPCAN_RADAR_809f9a50_Tx: ComSignalType=UINT16
            DET_RANGE_310_oRDR_DETECTION_309_312_oPCAN_RADAR_e5bfe8f4_Tx: ComSignalType=UINT16
            DET_RANGE_311_oRDR_DETECTION_309_312_oPCAN_RADAR_70cf3c61_Tx: ComSignalType=UINT16
            DET_RANGE_312_oRDR_DETECTION_309_312_oPCAN_RADAR_142f479f_Tx: ComSignalType=UINT16
            DET_RANGE_ERR_309_oRDR_DETECTION_309_312_oPCAN_RADAR_27772039_Tx: ComSignalType=UINT8
            DET_RANGE_ERR_310_oRDR_DETECTION_309_312_oPCAN_RADAR_4257529d_Tx: ComSignalType=UINT8
            DET_RANGE_ERR_311_oRDR_DETECTION_309_312_oPCAN_RADAR_d7278608_Tx: ComSignalType=UINT8
            DET_RANGE_ERR_312_oRDR_DETECTION_309_312_oPCAN_RADAR_b3c7fdf6_Tx: ComSignalType=UINT8
            DET_RANGE_VELOCITY_309_oRDR_DETECTION_309_312_oPCAN_RADAR_f5395875_Tx: ComSignalType=UINT16
            DET_RANGE_VELOCITY_310_oRDR_DETECTION_309_312_oPCAN_RADAR_90192ad1_Tx: ComSignalType=UINT16
            DET_RANGE_VELOCITY_311_oRDR_DETECTION_309_312_oPCAN_RADAR_0569fe44_Tx: ComSignalType=UINT16
            DET_RANGE_VELOCITY_312_oRDR_DETECTION_309_312_oPCAN_RADAR_618985ba_Tx: ComSignalType=UINT16
            DET_RANGE_VELOCITY_ERR_309_oRDR_DETECTION_309_312_oPCAN_RADAR_fa82a3c7_Tx: ComSignalType=UINT8
            DET_RANGE_VELOCITY_ERR_310_oRDR_DETECTION_309_312_oPCAN_RADAR_9fa2d163_Tx: ComSignalType=UINT8
            DET_RANGE_VELOCITY_ERR_311_oRDR_DETECTION_309_312_oPCAN_RADAR_0ad205f6_Tx: ComSignalType=UINT8
            DET_RANGE_VELOCITY_ERR_312_oRDR_DETECTION_309_312_oPCAN_RADAR_6e327e08_Tx: ComSignalType=UINT8
            DET_RCS_309_oRDR_DETECTION_309_312_oPCAN_RADAR_72b96f2f_Tx: ComSignalType=UINT8
            DET_RCS_310_oRDR_DETECTION_309_312_oPCAN_RADAR_17991d8b_Tx: ComSignalType=UINT8
            DET_RCS_311_oRDR_DETECTION_309_312_oPCAN_RADAR_82e9c91e_Tx: ComSignalType=UINT8
            DET_RCS_312_oRDR_DETECTION_309_312_oPCAN_RADAR_e609b2e0_Tx: ComSignalType=UINT8
            DET_SNR_309_oRDR_DETECTION_309_312_oPCAN_RADAR_af173b2d_Tx: ComSignalType=UINT8
            DET_SNR_310_oRDR_DETECTION_309_312_oPCAN_RADAR_ca374989_Tx: ComSignalType=UINT8
            DET_SNR_311_oRDR_DETECTION_309_312_oPCAN_RADAR_5f479d1c_Tx: ComSignalType=UINT8
            DET_SNR_312_oRDR_DETECTION_309_312_oPCAN_RADAR_3ba7e6e2_Tx: ComSignalType=UINT8
            DET_SUPER_RES_TARGET_309_oRDR_DETECTION_309_312_oPCAN_RADAR_9e8e1348_Tx: ComSignalType=BOOLEAN
            DET_SUPER_RES_TARGET_310_oRDR_DETECTION_309_312_oPCAN_RADAR_fbae61ec_Tx: ComSignalType=BOOLEAN
            DET_SUPER_RES_TARGET_311_oRDR_DETECTION_309_312_oPCAN_RADAR_6edeb579_Tx: ComSignalType=BOOLEAN
            DET_SUPER_RES_TARGET_312_oRDR_DETECTION_309_312_oPCAN_RADAR_0a3ece87_Tx: ComSignalType=BOOLEAN
        SG_Detections_313_316_oRDR_DETECTION_313_316_oPCAN_RADAR_c2028a60_Tx
          83 x ComGroupSignal:
            DET_AZIMUTH_313_oRDR_DETECTION_313_316_oPCAN_RADAR_8c03e39f_Tx: ComSignalType=UINT16
            DET_AZIMUTH_314_oRDR_DETECTION_313_316_oPCAN_RADAR_d0b3c0f6_Tx: ComSignalType=UINT16
            DET_AZIMUTH_315_oRDR_DETECTION_313_316_oPCAN_RADAR_45c31463_Tx: ComSignalType=UINT16
            DET_AZIMUTH_316_oRDR_DETECTION_313_316_oPCAN_RADAR_21236f9d_Tx: ComSignalType=UINT16
            DET_AZIMUTH_ERR_313_oRDR_DETECTION_313_316_oPCAN_RADAR_28b6766a_Tx: ComSignalType=UINT8
            DET_AZIMUTH_ERR_314_oRDR_DETECTION_313_316_oPCAN_RADAR_74065503_Tx: ComSignalType=UINT8
            DET_AZIMUTH_ERR_315_oRDR_DETECTION_313_316_oPCAN_RADAR_e1768196_Tx: ComSignalType=UINT8
            DET_AZIMUTH_ERR_316_oRDR_DETECTION_313_316_oPCAN_RADAR_8596fa68_Tx: ComSignalType=UINT8
            DET_BELOW_RAIN_THOLD_313_oRDR_DETECTION_313_316_oPCAN_RADAR_5902705f_Tx: ComSignalType=UINT8
            DET_BELOW_RAIN_THOLD_314_oRDR_DETECTION_313_316_oPCAN_RADAR_05b25336_Tx: ComSignalType=UINT8
            DET_BELOW_RAIN_THOLD_315_oRDR_DETECTION_313_316_oPCAN_RADAR_90c287a3_Tx: ComSignalType=UINT8
            DET_BELOW_RAIN_THOLD_316_oRDR_DETECTION_313_316_oPCAN_RADAR_f422fc5d_Tx: ComSignalType=UINT8
            DET_BI_STATIC_FLAG_313_oRDR_DETECTION_313_316_oPCAN_RADAR_da2fa31a_Tx: ComSignalType=BOOLEAN
            DET_BI_STATIC_FLAG_314_oRDR_DETECTION_313_316_oPCAN_RADAR_869f8073_Tx: ComSignalType=BOOLEAN
            DET_BI_STATIC_FLAG_315_oRDR_DETECTION_313_316_oPCAN_RADAR_13ef54e6_Tx: ComSignalType=BOOLEAN
            DET_BI_STATIC_FLAG_316_oRDR_DETECTION_313_316_oPCAN_RADAR_770f2f18_Tx: ComSignalType=BOOLEAN
            DET_CONFD_AZIMUTH_313_oRDR_DETECTION_313_316_oPCAN_RADAR_8ee5e955_Tx: ComSignalType=UINT8
            DET_CONFD_AZIMUTH_314_oRDR_DETECTION_313_316_oPCAN_RADAR_d255ca3c_Tx: ComSignalType=UINT8
            DET_CONFD_AZIMUTH_315_oRDR_DETECTION_313_316_oPCAN_RADAR_47251ea9_Tx: ComSignalType=UINT8
            DET_CONFD_AZIMUTH_316_oRDR_DETECTION_313_316_oPCAN_RADAR_23c56557_Tx: ComSignalType=UINT8
            DET_CONFD_ELEVATION_313_oRDR_DETECTION_313_316_oPCAN_RADAR_8c70e8af_Tx: ComSignalType=UINT8
            DET_CONFD_ELEVATION_314_oRDR_DETECTION_313_316_oPCAN_RADAR_d0c0cbc6_Tx: ComSignalType=UINT8
            DET_CONFD_ELEVATION_315_oRDR_DETECTION_313_316_oPCAN_RADAR_45b01f53_Tx: ComSignalType=UINT8
            DET_CONFD_ELEVATION_316_oRDR_DETECTION_313_316_oPCAN_RADAR_215064ad_Tx: ComSignalType=UINT8
            DET_ELEVATION_313_oRDR_DETECTION_313_316_oPCAN_RADAR_5db03c93_Tx: ComSignalType=UINT8
            DET_ELEVATION_314_oRDR_DETECTION_313_316_oPCAN_RADAR_01001ffa_Tx: ComSignalType=UINT8
            DET_ELEVATION_315_oRDR_DETECTION_313_316_oPCAN_RADAR_9470cb6f_Tx: ComSignalType=UINT8
            DET_ELEVATION_316_oRDR_DETECTION_313_316_oPCAN_RADAR_f090b091_Tx: ComSignalType=UINT8
            DET_ELEVATION_ERR_313_oRDR_DETECTION_313_316_oPCAN_RADAR_da89a4e6_Tx: ComSignalType=UINT8
            DET_ELEVATION_ERR_314_oRDR_DETECTION_313_316_oPCAN_RADAR_8639878f_Tx: ComSignalType=UINT8
            DET_ELEVATION_ERR_315_oRDR_DETECTION_313_316_oPCAN_RADAR_1349531a_Tx: ComSignalType=UINT8
            DET_ELEVATION_ERR_316_oRDR_DETECTION_313_316_oPCAN_RADAR_77a928e4_Tx: ComSignalType=UINT8
            DET_EXISTENCE_PROB_313_oRDR_DETECTION_313_316_oPCAN_RADAR_0816d186_Tx: ComSignalType=UINT8
            DET_EXISTENCE_PROB_314_oRDR_DETECTION_313_316_oPCAN_RADAR_54a6f2ef_Tx: ComSignalType=UINT8
            DET_EXISTENCE_PROB_315_oRDR_DETECTION_313_316_oPCAN_RADAR_c1d6267a_Tx: ComSignalType=UINT8
            DET_EXISTENCE_PROB_316_oRDR_DETECTION_313_316_oPCAN_RADAR_a5365d84_Tx: ComSignalType=UINT8
            DET_HVC_FLAG_313_oRDR_DETECTION_313_316_oPCAN_RADAR_e96292f9_Tx: ComSignalType=BOOLEAN
            DET_HVC_FLAG_314_oRDR_DETECTION_313_316_oPCAN_RADAR_b5d2b190_Tx: ComSignalType=BOOLEAN
            DET_HVC_FLAG_315_oRDR_DETECTION_313_316_oPCAN_RADAR_20a26505_Tx: ComSignalType=BOOLEAN
            DET_HVC_FLAG_316_oRDR_DETECTION_313_316_oPCAN_RADAR_44421efb_Tx: ComSignalType=BOOLEAN
            DET_IDM_313_oRDR_DETECTION_313_316_oPCAN_RADAR_6230a944_Tx: ComSignalType=UINT8
            DET_IDM_314_oRDR_DETECTION_313_316_oPCAN_RADAR_3e808a2d_Tx: ComSignalType=UINT8
            DET_IDM_315_oRDR_DETECTION_313_316_oPCAN_RADAR_abf05eb8_Tx: ComSignalType=UINT8
            DET_IDM_316_oRDR_DETECTION_313_316_oPCAN_RADAR_cf102546_Tx: ComSignalType=UINT8
            DET_MH_CRC16_313_316_oRDR_DETECTION_313_316_oPCAN_RADAR_468a586b_Tx: ComSignalType=UINT16
            DET_MH_CYCLE_COUNTER_313_316_oRDR_DETECTION_313_316_oPCAN_RADAR_c2fff95c_Tx: ComSignalType=UINT8
            DET_MH_SCAN_INDEX_4LSB_313_316_oRDR_DETECTION_313_316_oPCAN_RADAR_0ed5dcd0_Tx: ComSignalType=UINT8
            DET_MTD_313_oRDR_DETECTION_313_316_oPCAN_RADAR_04839b9f_Tx: ComSignalType=UINT8
            DET_MTD_314_oRDR_DETECTION_313_316_oPCAN_RADAR_5833b8f6_Tx: ComSignalType=UINT8
            DET_MTD_315_oRDR_DETECTION_313_316_oPCAN_RADAR_cd436c63_Tx: ComSignalType=UINT8
            DET_MTD_316_oRDR_DETECTION_313_316_oPCAN_RADAR_a9a3179d_Tx: ComSignalType=UINT8
            DET_PROB_1STAZHYPO_313_oRDR_DETECTION_313_316_oPCAN_RADAR_97377352_Tx: ComSignalType=BOOLEAN
            DET_PROB_1STAZHYPO_314_oRDR_DETECTION_313_316_oPCAN_RADAR_cb87503b_Tx: ComSignalType=BOOLEAN
            DET_PROB_1STAZHYPO_315_oRDR_DETECTION_313_316_oPCAN_RADAR_5ef784ae_Tx: ComSignalType=BOOLEAN
            DET_PROB_1STAZHYPO_316_oRDR_DETECTION_313_316_oPCAN_RADAR_3a17ff50_Tx: ComSignalType=BOOLEAN
            DET_RANGE_313_oRDR_DETECTION_313_316_oPCAN_RADAR_9c989024_Tx: ComSignalType=UINT16
            DET_RANGE_314_oRDR_DETECTION_313_316_oPCAN_RADAR_c028b34d_Tx: ComSignalType=UINT16
            DET_RANGE_315_oRDR_DETECTION_313_316_oPCAN_RADAR_555867d8_Tx: ComSignalType=UINT16
            DET_RANGE_316_oRDR_DETECTION_313_316_oPCAN_RADAR_31b81c26_Tx: ComSignalType=UINT16
            DET_RANGE_ERR_313_oRDR_DETECTION_313_316_oPCAN_RADAR_3b702a4d_Tx: ComSignalType=UINT8
            DET_RANGE_ERR_314_oRDR_DETECTION_313_316_oPCAN_RADAR_67c00924_Tx: ComSignalType=UINT8
            DET_RANGE_ERR_315_oRDR_DETECTION_313_316_oPCAN_RADAR_f2b0ddb1_Tx: ComSignalType=UINT8
            DET_RANGE_ERR_316_oRDR_DETECTION_313_316_oPCAN_RADAR_9650a64f_Tx: ComSignalType=UINT8
            DET_RANGE_VELOCITY_313_oRDR_DETECTION_313_316_oPCAN_RADAR_e93e5201_Tx: ComSignalType=UINT16
            DET_RANGE_VELOCITY_314_oRDR_DETECTION_313_316_oPCAN_RADAR_b58e7168_Tx: ComSignalType=UINT16
            DET_RANGE_VELOCITY_315_oRDR_DETECTION_313_316_oPCAN_RADAR_20fea5fd_Tx: ComSignalType=UINT16
            DET_RANGE_VELOCITY_316_oRDR_DETECTION_313_316_oPCAN_RADAR_441ede03_Tx: ComSignalType=UINT16
            DET_RANGE_VELOCITY_ERR_313_oRDR_DETECTION_313_316_oPCAN_RADAR_e685a9b3_Tx: ComSignalType=UINT8
            DET_RANGE_VELOCITY_ERR_314_oRDR_DETECTION_313_316_oPCAN_RADAR_ba358ada_Tx: ComSignalType=UINT8
            DET_RANGE_VELOCITY_ERR_315_oRDR_DETECTION_313_316_oPCAN_RADAR_2f455e4f_Tx: ComSignalType=UINT8
            DET_RANGE_VELOCITY_ERR_316_oRDR_DETECTION_313_316_oPCAN_RADAR_4ba525b1_Tx: ComSignalType=UINT8
            DET_RCS_313_oRDR_DETECTION_313_316_oPCAN_RADAR_6ebe655b_Tx: ComSignalType=UINT8
            DET_RCS_314_oRDR_DETECTION_313_316_oPCAN_RADAR_320e4632_Tx: ComSignalType=UINT8
            DET_RCS_315_oRDR_DETECTION_313_316_oPCAN_RADAR_a77e92a7_Tx: ComSignalType=UINT8
            DET_RCS_316_oRDR_DETECTION_313_316_oPCAN_RADAR_c39ee959_Tx: ComSignalType=UINT8
            DET_SNR_313_oRDR_DETECTION_313_316_oPCAN_RADAR_b3103159_Tx: ComSignalType=UINT8
            DET_SNR_314_oRDR_DETECTION_313_316_oPCAN_RADAR_efa01230_Tx: ComSignalType=UINT8
            DET_SNR_315_oRDR_DETECTION_313_316_oPCAN_RADAR_7ad0c6a5_Tx: ComSignalType=UINT8
            DET_SNR_316_oRDR_DETECTION_313_316_oPCAN_RADAR_1e30bd5b_Tx: ComSignalType=UINT8
            DET_SUPER_RES_TARGET_313_oRDR_DETECTION_313_316_oPCAN_RADAR_8289193c_Tx: ComSignalType=BOOLEAN
            DET_SUPER_RES_TARGET_314_oRDR_DETECTION_313_316_oPCAN_RADAR_de393a55_Tx: ComSignalType=BOOLEAN
            DET_SUPER_RES_TARGET_315_oRDR_DETECTION_313_316_oPCAN_RADAR_4b49eec0_Tx: ComSignalType=BOOLEAN
            DET_SUPER_RES_TARGET_316_oRDR_DETECTION_313_316_oPCAN_RADAR_2fa9953e_Tx: ComSignalType=BOOLEAN
        SG_Detections_317_320_oRDR_DETECTION_317_320_oPCAN_RADAR_2eaedcea_Tx
          83 x ComGroupSignal:
            DET_AZIMUTH_317_oRDR_DETECTION_317_320_oPCAN_RADAR_1bdf66c1_Tx: ComSignalType=UINT16
            DET_AZIMUTH_318_oRDR_DETECTION_317_320_oPCAN_RADAR_37cff486_Tx: ComSignalType=UINT16
            DET_AZIMUTH_319_oRDR_DETECTION_317_320_oPCAN_RADAR_a2bf2013_Tx: ComSignalType=UINT16
            DET_AZIMUTH_320_oRDR_DETECTION_317_320_oPCAN_RADAR_1d0e7ac8_Tx: ComSignalType=UINT16
            DET_AZIMUTH_ERR_317_oRDR_DETECTION_317_320_oPCAN_RADAR_bf6af334_Tx: ComSignalType=UINT8
            DET_AZIMUTH_ERR_318_oRDR_DETECTION_317_320_oPCAN_RADAR_937a6173_Tx: ComSignalType=UINT8
            DET_AZIMUTH_ERR_319_oRDR_DETECTION_317_320_oPCAN_RADAR_060ab5e6_Tx: ComSignalType=UINT8
            DET_AZIMUTH_ERR_320_oRDR_DETECTION_317_320_oPCAN_RADAR_b9bbef3d_Tx: ComSignalType=UINT8
            DET_BELOW_RAIN_THOLD_317_oRDR_DETECTION_317_320_oPCAN_RADAR_cedef501_Tx: ComSignalType=UINT8
            DET_BELOW_RAIN_THOLD_318_oRDR_DETECTION_317_320_oPCAN_RADAR_e2ce6746_Tx: ComSignalType=UINT8
            DET_BELOW_RAIN_THOLD_319_oRDR_DETECTION_317_320_oPCAN_RADAR_77beb3d3_Tx: ComSignalType=UINT8
            DET_BELOW_RAIN_THOLD_320_oRDR_DETECTION_317_320_oPCAN_RADAR_c80fe908_Tx: ComSignalType=UINT8
            DET_BI_STATIC_FLAG_317_oRDR_DETECTION_317_320_oPCAN_RADAR_4df32644_Tx: ComSignalType=BOOLEAN
            DET_BI_STATIC_FLAG_318_oRDR_DETECTION_317_320_oPCAN_RADAR_61e3b403_Tx: ComSignalType=BOOLEAN
            DET_BI_STATIC_FLAG_319_oRDR_DETECTION_317_320_oPCAN_RADAR_f4936096_Tx: ComSignalType=BOOLEAN
            DET_BI_STATIC_FLAG_320_oRDR_DETECTION_317_320_oPCAN_RADAR_4b223a4d_Tx: ComSignalType=BOOLEAN
            DET_CONFD_AZIMUTH_317_oRDR_DETECTION_317_320_oPCAN_RADAR_19396c0b_Tx: ComSignalType=UINT8
            DET_CONFD_AZIMUTH_318_oRDR_DETECTION_317_320_oPCAN_RADAR_3529fe4c_Tx: ComSignalType=UINT8
            DET_CONFD_AZIMUTH_319_oRDR_DETECTION_317_320_oPCAN_RADAR_a0592ad9_Tx: ComSignalType=UINT8
            DET_CONFD_AZIMUTH_320_oRDR_DETECTION_317_320_oPCAN_RADAR_1fe87002_Tx: ComSignalType=UINT8
            DET_CONFD_ELEVATION_317_oRDR_DETECTION_317_320_oPCAN_RADAR_1bac6df1_Tx: ComSignalType=UINT8
            DET_CONFD_ELEVATION_318_oRDR_DETECTION_317_320_oPCAN_RADAR_37bcffb6_Tx: ComSignalType=UINT8
            DET_CONFD_ELEVATION_319_oRDR_DETECTION_317_320_oPCAN_RADAR_a2cc2b23_Tx: ComSignalType=UINT8
            DET_CONFD_ELEVATION_320_oRDR_DETECTION_317_320_oPCAN_RADAR_1d7d71f8_Tx: ComSignalType=UINT8
            DET_ELEVATION_317_oRDR_DETECTION_317_320_oPCAN_RADAR_ca6cb9cd_Tx: ComSignalType=UINT8
            DET_ELEVATION_318_oRDR_DETECTION_317_320_oPCAN_RADAR_e67c2b8a_Tx: ComSignalType=UINT8
            DET_ELEVATION_319_oRDR_DETECTION_317_320_oPCAN_RADAR_730cff1f_Tx: ComSignalType=UINT8
            DET_ELEVATION_320_oRDR_DETECTION_317_320_oPCAN_RADAR_ccbda5c4_Tx: ComSignalType=UINT8
            DET_ELEVATION_ERR_317_oRDR_DETECTION_317_320_oPCAN_RADAR_4d5521b8_Tx: ComSignalType=UINT8
            DET_ELEVATION_ERR_318_oRDR_DETECTION_317_320_oPCAN_RADAR_6145b3ff_Tx: ComSignalType=UINT8
            DET_ELEVATION_ERR_319_oRDR_DETECTION_317_320_oPCAN_RADAR_f435676a_Tx: ComSignalType=UINT8
            DET_ELEVATION_ERR_320_oRDR_DETECTION_317_320_oPCAN_RADAR_4b843db1_Tx: ComSignalType=UINT8
            DET_EXISTENCE_PROB_317_oRDR_DETECTION_317_320_oPCAN_RADAR_9fca54d8_Tx: ComSignalType=UINT8
            DET_EXISTENCE_PROB_318_oRDR_DETECTION_317_320_oPCAN_RADAR_b3dac69f_Tx: ComSignalType=UINT8
            DET_EXISTENCE_PROB_319_oRDR_DETECTION_317_320_oPCAN_RADAR_26aa120a_Tx: ComSignalType=UINT8
            DET_EXISTENCE_PROB_320_oRDR_DETECTION_317_320_oPCAN_RADAR_991b48d1_Tx: ComSignalType=UINT8
            DET_HVC_FLAG_317_oRDR_DETECTION_317_320_oPCAN_RADAR_7ebe17a7_Tx: ComSignalType=BOOLEAN
            DET_HVC_FLAG_318_oRDR_DETECTION_317_320_oPCAN_RADAR_52ae85e0_Tx: ComSignalType=BOOLEAN
            DET_HVC_FLAG_319_oRDR_DETECTION_317_320_oPCAN_RADAR_c7de5175_Tx: ComSignalType=BOOLEAN
            DET_HVC_FLAG_320_oRDR_DETECTION_317_320_oPCAN_RADAR_786f0bae_Tx: ComSignalType=BOOLEAN
            DET_IDM_317_oRDR_DETECTION_317_320_oPCAN_RADAR_f5ec2c1a_Tx: ComSignalType=UINT8
            DET_IDM_318_oRDR_DETECTION_317_320_oPCAN_RADAR_d9fcbe5d_Tx: ComSignalType=UINT8
            DET_IDM_319_oRDR_DETECTION_317_320_oPCAN_RADAR_4c8c6ac8_Tx: ComSignalType=UINT8
            DET_IDM_320_oRDR_DETECTION_317_320_oPCAN_RADAR_f33d3013_Tx: ComSignalType=UINT8
            DET_MH_CRC16_317_320_oRDR_DETECTION_317_320_oPCAN_RADAR_aa260ee1_Tx: ComSignalType=UINT16
            DET_MH_CYCLE_COUNTER_317_320_oRDR_DETECTION_317_320_oPCAN_RADAR_2e53afd6_Tx: ComSignalType=UINT8
            DET_MH_SCAN_INDEX_4LSB_317_320_oRDR_DETECTION_317_320_oPCAN_RADAR_e2798a5a_Tx: ComSignalType=UINT8
            DET_MTD_317_oRDR_DETECTION_317_320_oPCAN_RADAR_935f1ec1_Tx: ComSignalType=UINT8
            DET_MTD_318_oRDR_DETECTION_317_320_oPCAN_RADAR_bf4f8c86_Tx: ComSignalType=UINT8
            DET_MTD_319_oRDR_DETECTION_317_320_oPCAN_RADAR_2a3f5813_Tx: ComSignalType=UINT8
            DET_MTD_320_oRDR_DETECTION_317_320_oPCAN_RADAR_958e02c8_Tx: ComSignalType=UINT8
            DET_PROB_1STAZHYPO_317_oRDR_DETECTION_317_320_oPCAN_RADAR_00ebf60c_Tx: ComSignalType=BOOLEAN
            DET_PROB_1STAZHYPO_318_oRDR_DETECTION_317_320_oPCAN_RADAR_2cfb644b_Tx: ComSignalType=BOOLEAN
            DET_PROB_1STAZHYPO_319_oRDR_DETECTION_317_320_oPCAN_RADAR_b98bb0de_Tx: ComSignalType=BOOLEAN
            DET_PROB_1STAZHYPO_320_oRDR_DETECTION_317_320_oPCAN_RADAR_063aea05_Tx: ComSignalType=BOOLEAN
            DET_RANGE_317_oRDR_DETECTION_317_320_oPCAN_RADAR_0b44157a_Tx: ComSignalType=UINT16
            DET_RANGE_318_oRDR_DETECTION_317_320_oPCAN_RADAR_2754873d_Tx: ComSignalType=UINT16
            DET_RANGE_319_oRDR_DETECTION_317_320_oPCAN_RADAR_b22453a8_Tx: ComSignalType=UINT16
            DET_RANGE_320_oRDR_DETECTION_317_320_oPCAN_RADAR_0d950973_Tx: ComSignalType=UINT16
            DET_RANGE_ERR_317_oRDR_DETECTION_317_320_oPCAN_RADAR_acacaf13_Tx: ComSignalType=UINT8
            DET_RANGE_ERR_318_oRDR_DETECTION_317_320_oPCAN_RADAR_80bc3d54_Tx: ComSignalType=UINT8
            DET_RANGE_ERR_319_oRDR_DETECTION_317_320_oPCAN_RADAR_15cce9c1_Tx: ComSignalType=UINT8
            DET_RANGE_ERR_320_oRDR_DETECTION_317_320_oPCAN_RADAR_aa7db31a_Tx: ComSignalType=UINT8
            DET_RANGE_VELOCITY_317_oRDR_DETECTION_317_320_oPCAN_RADAR_7ee2d75f_Tx: ComSignalType=UINT16
            DET_RANGE_VELOCITY_318_oRDR_DETECTION_317_320_oPCAN_RADAR_52f24518_Tx: ComSignalType=UINT16
            DET_RANGE_VELOCITY_319_oRDR_DETECTION_317_320_oPCAN_RADAR_c782918d_Tx: ComSignalType=UINT16
            DET_RANGE_VELOCITY_320_oRDR_DETECTION_317_320_oPCAN_RADAR_7833cb56_Tx: ComSignalType=UINT16
            DET_RANGE_VELOCITY_ERR_317_oRDR_DETECTION_317_320_oPCAN_RADAR_71592ced_Tx: ComSignalType=UINT8
            DET_RANGE_VELOCITY_ERR_318_oRDR_DETECTION_317_320_oPCAN_RADAR_5d49beaa_Tx: ComSignalType=UINT8
            DET_RANGE_VELOCITY_ERR_319_oRDR_DETECTION_317_320_oPCAN_RADAR_c8396a3f_Tx: ComSignalType=UINT8
            DET_RANGE_VELOCITY_ERR_320_oRDR_DETECTION_317_320_oPCAN_RADAR_778830e4_Tx: ComSignalType=UINT8
            DET_RCS_317_oRDR_DETECTION_317_320_oPCAN_RADAR_f962e005_Tx: ComSignalType=UINT8
            DET_RCS_318_oRDR_DETECTION_317_320_oPCAN_RADAR_d5727242_Tx: ComSignalType=UINT8
            DET_RCS_319_oRDR_DETECTION_317_320_oPCAN_RADAR_4002a6d7_Tx: ComSignalType=UINT8
            DET_RCS_320_oRDR_DETECTION_317_320_oPCAN_RADAR_ffb3fc0c_Tx: ComSignalType=UINT8
            DET_SNR_317_oRDR_DETECTION_317_320_oPCAN_RADAR_24ccb407_Tx: ComSignalType=UINT8
            DET_SNR_318_oRDR_DETECTION_317_320_oPCAN_RADAR_08dc2640_Tx: ComSignalType=UINT8
            DET_SNR_319_oRDR_DETECTION_317_320_oPCAN_RADAR_9dacf2d5_Tx: ComSignalType=UINT8
            DET_SNR_320_oRDR_DETECTION_317_320_oPCAN_RADAR_221da80e_Tx: ComSignalType=UINT8
            DET_SUPER_RES_TARGET_317_oRDR_DETECTION_317_320_oPCAN_RADAR_15559c62_Tx: ComSignalType=BOOLEAN
            DET_SUPER_RES_TARGET_318_oRDR_DETECTION_317_320_oPCAN_RADAR_39450e25_Tx: ComSignalType=BOOLEAN
            DET_SUPER_RES_TARGET_319_oRDR_DETECTION_317_320_oPCAN_RADAR_ac35dab0_Tx: ComSignalType=BOOLEAN
            DET_SUPER_RES_TARGET_320_oRDR_DETECTION_317_320_oPCAN_RADAR_1384806b_Tx: ComSignalType=BOOLEAN
        SG_Detections_321_324_oRDR_DETECTION_321_324_oPCAN_RADAR_2dc55233_Tx
          83 x ComGroupSignal:
            DET_AZIMUTH_321_oRDR_DETECTION_321_324_oPCAN_RADAR_0575aea1_Tx: ComSignalType=UINT16
            DET_AZIMUTH_322_oRDR_DETECTION_321_324_oPCAN_RADAR_6195d55f_Tx: ComSignalType=UINT16
            DET_AZIMUTH_323_oRDR_DETECTION_321_324_oPCAN_RADAR_f4e501ca_Tx: ComSignalType=UINT16
            DET_AZIMUTH_324_oRDR_DETECTION_321_324_oPCAN_RADAR_a85522a3_Tx: ComSignalType=UINT16
            DET_AZIMUTH_ERR_321_oRDR_DETECTION_321_324_oPCAN_RADAR_a1c03b54_Tx: ComSignalType=UINT8
            DET_AZIMUTH_ERR_322_oRDR_DETECTION_321_324_oPCAN_RADAR_c52040aa_Tx: ComSignalType=UINT8
            DET_AZIMUTH_ERR_323_oRDR_DETECTION_321_324_oPCAN_RADAR_5050943f_Tx: ComSignalType=UINT8
            DET_AZIMUTH_ERR_324_oRDR_DETECTION_321_324_oPCAN_RADAR_0ce0b756_Tx: ComSignalType=UINT8
            DET_BELOW_RAIN_THOLD_321_oRDR_DETECTION_321_324_oPCAN_RADAR_d0743d61_Tx: ComSignalType=UINT8
            DET_BELOW_RAIN_THOLD_322_oRDR_DETECTION_321_324_oPCAN_RADAR_b494469f_Tx: ComSignalType=UINT8
            DET_BELOW_RAIN_THOLD_323_oRDR_DETECTION_321_324_oPCAN_RADAR_21e4920a_Tx: ComSignalType=UINT8
            DET_BELOW_RAIN_THOLD_324_oRDR_DETECTION_321_324_oPCAN_RADAR_7d54b163_Tx: ComSignalType=UINT8
            DET_BI_STATIC_FLAG_321_oRDR_DETECTION_321_324_oPCAN_RADAR_5359ee24_Tx: ComSignalType=BOOLEAN
            DET_BI_STATIC_FLAG_322_oRDR_DETECTION_321_324_oPCAN_RADAR_37b995da_Tx: ComSignalType=BOOLEAN
            DET_BI_STATIC_FLAG_323_oRDR_DETECTION_321_324_oPCAN_RADAR_a2c9414f_Tx: ComSignalType=BOOLEAN
            DET_BI_STATIC_FLAG_324_oRDR_DETECTION_321_324_oPCAN_RADAR_fe796226_Tx: ComSignalType=BOOLEAN
            DET_CONFD_AZIMUTH_321_oRDR_DETECTION_321_324_oPCAN_RADAR_0793a46b_Tx: ComSignalType=UINT8
            DET_CONFD_AZIMUTH_322_oRDR_DETECTION_321_324_oPCAN_RADAR_6373df95_Tx: ComSignalType=UINT8
            DET_CONFD_AZIMUTH_323_oRDR_DETECTION_321_324_oPCAN_RADAR_f6030b00_Tx: ComSignalType=UINT8
            DET_CONFD_AZIMUTH_324_oRDR_DETECTION_321_324_oPCAN_RADAR_aab32869_Tx: ComSignalType=UINT8
            DET_CONFD_ELEVATION_321_oRDR_DETECTION_321_324_oPCAN_RADAR_0506a591_Tx: ComSignalType=UINT8
            DET_CONFD_ELEVATION_322_oRDR_DETECTION_321_324_oPCAN_RADAR_61e6de6f_Tx: ComSignalType=UINT8
            DET_CONFD_ELEVATION_323_oRDR_DETECTION_321_324_oPCAN_RADAR_f4960afa_Tx: ComSignalType=UINT8
            DET_CONFD_ELEVATION_324_oRDR_DETECTION_321_324_oPCAN_RADAR_a8262993_Tx: ComSignalType=UINT8
            DET_ELEVATION_321_oRDR_DETECTION_321_324_oPCAN_RADAR_d4c671ad_Tx: ComSignalType=UINT8
            DET_ELEVATION_322_oRDR_DETECTION_321_324_oPCAN_RADAR_b0260a53_Tx: ComSignalType=UINT8
            DET_ELEVATION_323_oRDR_DETECTION_321_324_oPCAN_RADAR_2556dec6_Tx: ComSignalType=UINT8
            DET_ELEVATION_324_oRDR_DETECTION_321_324_oPCAN_RADAR_79e6fdaf_Tx: ComSignalType=UINT8
            DET_ELEVATION_ERR_321_oRDR_DETECTION_321_324_oPCAN_RADAR_53ffe9d8_Tx: ComSignalType=UINT8
            DET_ELEVATION_ERR_322_oRDR_DETECTION_321_324_oPCAN_RADAR_371f9226_Tx: ComSignalType=UINT8
            DET_ELEVATION_ERR_323_oRDR_DETECTION_321_324_oPCAN_RADAR_a26f46b3_Tx: ComSignalType=UINT8
            DET_ELEVATION_ERR_324_oRDR_DETECTION_321_324_oPCAN_RADAR_fedf65da_Tx: ComSignalType=UINT8
            DET_EXISTENCE_PROB_321_oRDR_DETECTION_321_324_oPCAN_RADAR_81609cb8_Tx: ComSignalType=UINT8
            DET_EXISTENCE_PROB_322_oRDR_DETECTION_321_324_oPCAN_RADAR_e580e746_Tx: ComSignalType=UINT8
            DET_EXISTENCE_PROB_323_oRDR_DETECTION_321_324_oPCAN_RADAR_70f033d3_Tx: ComSignalType=UINT8
            DET_EXISTENCE_PROB_324_oRDR_DETECTION_321_324_oPCAN_RADAR_2c4010ba_Tx: ComSignalType=UINT8
            DET_HVC_FLAG_321_oRDR_DETECTION_321_324_oPCAN_RADAR_6014dfc7_Tx: ComSignalType=BOOLEAN
            DET_HVC_FLAG_322_oRDR_DETECTION_321_324_oPCAN_RADAR_04f4a439_Tx: ComSignalType=BOOLEAN
            DET_HVC_FLAG_323_oRDR_DETECTION_321_324_oPCAN_RADAR_918470ac_Tx: ComSignalType=BOOLEAN
            DET_HVC_FLAG_324_oRDR_DETECTION_321_324_oPCAN_RADAR_cd3453c5_Tx: ComSignalType=BOOLEAN
            DET_IDM_321_oRDR_DETECTION_321_324_oPCAN_RADAR_eb46e47a_Tx: ComSignalType=UINT8
            DET_IDM_322_oRDR_DETECTION_321_324_oPCAN_RADAR_8fa69f84_Tx: ComSignalType=UINT8
            DET_IDM_323_oRDR_DETECTION_321_324_oPCAN_RADAR_1ad64b11_Tx: ComSignalType=UINT8
            DET_IDM_324_oRDR_DETECTION_321_324_oPCAN_RADAR_46666878_Tx: ComSignalType=UINT8
            DET_MH_CRC16_321_324_oRDR_DETECTION_321_324_oPCAN_RADAR_a94d8038_Tx: ComSignalType=UINT16
            DET_MH_CYCLE_COUNTER_321_324_oRDR_DETECTION_321_324_oPCAN_RADAR_2d38210f_Tx: ComSignalType=UINT8
            DET_MH_SCAN_INDEX_4LSB_321_324_oRDR_DETECTION_321_324_oPCAN_RADAR_e1120483_Tx: ComSignalType=UINT8
            DET_MTD_321_oRDR_DETECTION_321_324_oPCAN_RADAR_8df5d6a1_Tx: ComSignalType=UINT8
            DET_MTD_322_oRDR_DETECTION_321_324_oPCAN_RADAR_e915ad5f_Tx: ComSignalType=UINT8
            DET_MTD_323_oRDR_DETECTION_321_324_oPCAN_RADAR_7c6579ca_Tx: ComSignalType=UINT8
            DET_MTD_324_oRDR_DETECTION_321_324_oPCAN_RADAR_20d55aa3_Tx: ComSignalType=UINT8
            DET_PROB_1STAZHYPO_321_oRDR_DETECTION_321_324_oPCAN_RADAR_1e413e6c_Tx: ComSignalType=BOOLEAN
            DET_PROB_1STAZHYPO_322_oRDR_DETECTION_321_324_oPCAN_RADAR_7aa14592_Tx: ComSignalType=BOOLEAN
            DET_PROB_1STAZHYPO_323_oRDR_DETECTION_321_324_oPCAN_RADAR_efd19107_Tx: ComSignalType=BOOLEAN
            DET_PROB_1STAZHYPO_324_oRDR_DETECTION_321_324_oPCAN_RADAR_b361b26e_Tx: ComSignalType=BOOLEAN
            DET_RANGE_321_oRDR_DETECTION_321_324_oPCAN_RADAR_15eedd1a_Tx: ComSignalType=UINT16
            DET_RANGE_322_oRDR_DETECTION_321_324_oPCAN_RADAR_710ea6e4_Tx: ComSignalType=UINT16
            DET_RANGE_323_oRDR_DETECTION_321_324_oPCAN_RADAR_e47e7271_Tx: ComSignalType=UINT16
            DET_RANGE_324_oRDR_DETECTION_321_324_oPCAN_RADAR_b8ce5118_Tx: ComSignalType=UINT16
            DET_RANGE_ERR_321_oRDR_DETECTION_321_324_oPCAN_RADAR_b2066773_Tx: ComSignalType=UINT8
            DET_RANGE_ERR_322_oRDR_DETECTION_321_324_oPCAN_RADAR_d6e61c8d_Tx: ComSignalType=UINT8
            DET_RANGE_ERR_323_oRDR_DETECTION_321_324_oPCAN_RADAR_4396c818_Tx: ComSignalType=UINT8
            DET_RANGE_ERR_324_oRDR_DETECTION_321_324_oPCAN_RADAR_1f26eb71_Tx: ComSignalType=UINT8
            DET_RANGE_VELOCITY_321_oRDR_DETECTION_321_324_oPCAN_RADAR_60481f3f_Tx: ComSignalType=UINT16
            DET_RANGE_VELOCITY_322_oRDR_DETECTION_321_324_oPCAN_RADAR_04a864c1_Tx: ComSignalType=UINT16
            DET_RANGE_VELOCITY_323_oRDR_DETECTION_321_324_oPCAN_RADAR_91d8b054_Tx: ComSignalType=UINT16
            DET_RANGE_VELOCITY_324_oRDR_DETECTION_321_324_oPCAN_RADAR_cd68933d_Tx: ComSignalType=UINT16
            DET_RANGE_VELOCITY_ERR_321_oRDR_DETECTION_321_324_oPCAN_RADAR_6ff3e48d_Tx: ComSignalType=UINT8
            DET_RANGE_VELOCITY_ERR_322_oRDR_DETECTION_321_324_oPCAN_RADAR_0b139f73_Tx: ComSignalType=UINT8
            DET_RANGE_VELOCITY_ERR_323_oRDR_DETECTION_321_324_oPCAN_RADAR_9e634be6_Tx: ComSignalType=UINT8
            DET_RANGE_VELOCITY_ERR_324_oRDR_DETECTION_321_324_oPCAN_RADAR_c2d3688f_Tx: ComSignalType=UINT8
            DET_RCS_321_oRDR_DETECTION_321_324_oPCAN_RADAR_e7c82865_Tx: ComSignalType=UINT8
            DET_RCS_322_oRDR_DETECTION_321_324_oPCAN_RADAR_8328539b_Tx: ComSignalType=UINT8
            DET_RCS_323_oRDR_DETECTION_321_324_oPCAN_RADAR_1658870e_Tx: ComSignalType=UINT8
            DET_RCS_324_oRDR_DETECTION_321_324_oPCAN_RADAR_4ae8a467_Tx: ComSignalType=UINT8
            DET_SNR_321_oRDR_DETECTION_321_324_oPCAN_RADAR_3a667c67_Tx: ComSignalType=UINT8
            DET_SNR_322_oRDR_DETECTION_321_324_oPCAN_RADAR_5e860799_Tx: ComSignalType=UINT8
            DET_SNR_323_oRDR_DETECTION_321_324_oPCAN_RADAR_cbf6d30c_Tx: ComSignalType=UINT8
            DET_SNR_324_oRDR_DETECTION_321_324_oPCAN_RADAR_9746f065_Tx: ComSignalType=UINT8
            DET_SUPER_RES_TARGET_321_oRDR_DETECTION_321_324_oPCAN_RADAR_0bff5402_Tx: ComSignalType=BOOLEAN
            DET_SUPER_RES_TARGET_322_oRDR_DETECTION_321_324_oPCAN_RADAR_6f1f2ffc_Tx: ComSignalType=BOOLEAN
            DET_SUPER_RES_TARGET_323_oRDR_DETECTION_321_324_oPCAN_RADAR_fa6ffb69_Tx: ComSignalType=BOOLEAN
            DET_SUPER_RES_TARGET_324_oRDR_DETECTION_321_324_oPCAN_RADAR_a6dfd800_Tx: ComSignalType=BOOLEAN
        SG_Detections_325_328_oRDR_DETECTION_325_328_oPCAN_RADAR_5c066661_Tx
          83 x ComGroupSignal:
            DET_AZIMUTH_325_oRDR_DETECTION_325_328_oPCAN_RADAR_d4976802_Tx: ComSignalType=UINT16
            DET_AZIMUTH_326_oRDR_DETECTION_325_328_oPCAN_RADAR_b07713fc_Tx: ComSignalType=UINT16
            DET_AZIMUTH_327_oRDR_DETECTION_325_328_oPCAN_RADAR_2507c769_Tx: ComSignalType=UINT16
            DET_AZIMUTH_328_oRDR_DETECTION_325_328_oPCAN_RADAR_0917552e_Tx: ComSignalType=UINT16
            DET_AZIMUTH_ERR_325_oRDR_DETECTION_325_328_oPCAN_RADAR_7022fdf7_Tx: ComSignalType=UINT8
            DET_AZIMUTH_ERR_326_oRDR_DETECTION_325_328_oPCAN_RADAR_14c28609_Tx: ComSignalType=UINT8
            DET_AZIMUTH_ERR_327_oRDR_DETECTION_325_328_oPCAN_RADAR_81b2529c_Tx: ComSignalType=UINT8
            DET_AZIMUTH_ERR_328_oRDR_DETECTION_325_328_oPCAN_RADAR_ada2c0db_Tx: ComSignalType=UINT8
            DET_BELOW_RAIN_THOLD_325_oRDR_DETECTION_325_328_oPCAN_RADAR_0196fbc2_Tx: ComSignalType=UINT8
            DET_BELOW_RAIN_THOLD_326_oRDR_DETECTION_325_328_oPCAN_RADAR_6576803c_Tx: ComSignalType=UINT8
            DET_BELOW_RAIN_THOLD_327_oRDR_DETECTION_325_328_oPCAN_RADAR_f00654a9_Tx: ComSignalType=UINT8
            DET_BELOW_RAIN_THOLD_328_oRDR_DETECTION_325_328_oPCAN_RADAR_dc16c6ee_Tx: ComSignalType=UINT8
            DET_BI_STATIC_FLAG_325_oRDR_DETECTION_325_328_oPCAN_RADAR_82bb2887_Tx: ComSignalType=BOOLEAN
            DET_BI_STATIC_FLAG_326_oRDR_DETECTION_325_328_oPCAN_RADAR_e65b5379_Tx: ComSignalType=BOOLEAN
            DET_BI_STATIC_FLAG_327_oRDR_DETECTION_325_328_oPCAN_RADAR_732b87ec_Tx: ComSignalType=BOOLEAN
            DET_BI_STATIC_FLAG_328_oRDR_DETECTION_325_328_oPCAN_RADAR_5f3b15ab_Tx: ComSignalType=BOOLEAN
            DET_CONFD_AZIMUTH_325_oRDR_DETECTION_325_328_oPCAN_RADAR_d67162c8_Tx: ComSignalType=UINT8
            DET_CONFD_AZIMUTH_326_oRDR_DETECTION_325_328_oPCAN_RADAR_b2911936_Tx: ComSignalType=UINT8
            DET_CONFD_AZIMUTH_327_oRDR_DETECTION_325_328_oPCAN_RADAR_27e1cda3_Tx: ComSignalType=UINT8
            DET_CONFD_AZIMUTH_328_oRDR_DETECTION_325_328_oPCAN_RADAR_0bf15fe4_Tx: ComSignalType=UINT8
            DET_CONFD_ELEVATION_325_oRDR_DETECTION_325_328_oPCAN_RADAR_d4e46332_Tx: ComSignalType=UINT8
            DET_CONFD_ELEVATION_326_oRDR_DETECTION_325_328_oPCAN_RADAR_b00418cc_Tx: ComSignalType=UINT8
            DET_CONFD_ELEVATION_327_oRDR_DETECTION_325_328_oPCAN_RADAR_2574cc59_Tx: ComSignalType=UINT8
            DET_CONFD_ELEVATION_328_oRDR_DETECTION_325_328_oPCAN_RADAR_09645e1e_Tx: ComSignalType=UINT8
            DET_ELEVATION_325_oRDR_DETECTION_325_328_oPCAN_RADAR_0524b70e_Tx: ComSignalType=UINT8
            DET_ELEVATION_326_oRDR_DETECTION_325_328_oPCAN_RADAR_61c4ccf0_Tx: ComSignalType=UINT8
            DET_ELEVATION_327_oRDR_DETECTION_325_328_oPCAN_RADAR_f4b41865_Tx: ComSignalType=UINT8
            DET_ELEVATION_328_oRDR_DETECTION_325_328_oPCAN_RADAR_d8a48a22_Tx: ComSignalType=UINT8
            DET_ELEVATION_ERR_325_oRDR_DETECTION_325_328_oPCAN_RADAR_821d2f7b_Tx: ComSignalType=UINT8
            DET_ELEVATION_ERR_326_oRDR_DETECTION_325_328_oPCAN_RADAR_e6fd5485_Tx: ComSignalType=UINT8
            DET_ELEVATION_ERR_327_oRDR_DETECTION_325_328_oPCAN_RADAR_738d8010_Tx: ComSignalType=UINT8
            DET_ELEVATION_ERR_328_oRDR_DETECTION_325_328_oPCAN_RADAR_5f9d1257_Tx: ComSignalType=UINT8
            DET_EXISTENCE_PROB_325_oRDR_DETECTION_325_328_oPCAN_RADAR_50825a1b_Tx: ComSignalType=UINT8
            DET_EXISTENCE_PROB_326_oRDR_DETECTION_325_328_oPCAN_RADAR_346221e5_Tx: ComSignalType=UINT8
            DET_EXISTENCE_PROB_327_oRDR_DETECTION_325_328_oPCAN_RADAR_a112f570_Tx: ComSignalType=UINT8
            DET_EXISTENCE_PROB_328_oRDR_DETECTION_325_328_oPCAN_RADAR_8d026737_Tx: ComSignalType=UINT8
            DET_HVC_FLAG_325_oRDR_DETECTION_325_328_oPCAN_RADAR_b1f61964_Tx: ComSignalType=BOOLEAN
            DET_HVC_FLAG_326_oRDR_DETECTION_325_328_oPCAN_RADAR_d516629a_Tx: ComSignalType=BOOLEAN
            DET_HVC_FLAG_327_oRDR_DETECTION_325_328_oPCAN_RADAR_4066b60f_Tx: ComSignalType=BOOLEAN
            DET_HVC_FLAG_328_oRDR_DETECTION_325_328_oPCAN_RADAR_6c762448_Tx: ComSignalType=BOOLEAN
            DET_IDM_325_oRDR_DETECTION_325_328_oPCAN_RADAR_3aa422d9_Tx: ComSignalType=UINT8
            DET_IDM_326_oRDR_DETECTION_325_328_oPCAN_RADAR_5e445927_Tx: ComSignalType=UINT8
            DET_IDM_327_oRDR_DETECTION_325_328_oPCAN_RADAR_cb348db2_Tx: ComSignalType=UINT8
            DET_IDM_328_oRDR_DETECTION_325_328_oPCAN_RADAR_e7241ff5_Tx: ComSignalType=UINT8
            DET_MH_CRC16_325_328_oRDR_DETECTION_325_328_oPCAN_RADAR_d88eb46a_Tx: ComSignalType=UINT16
            DET_MH_CYCLE_COUNTER_325_328_oRDR_DETECTION_325_328_oPCAN_RADAR_5cfb155d_Tx: ComSignalType=UINT8
            DET_MH_SCAN_INDEX_4LSB_325_328_oRDR_DETECTION_325_328_oPCAN_RADAR_90d130d1_Tx: ComSignalType=UINT8
            DET_MTD_325_oRDR_DETECTION_325_328_oPCAN_RADAR_5c171002_Tx: ComSignalType=UINT8
            DET_MTD_326_oRDR_DETECTION_325_328_oPCAN_RADAR_38f76bfc_Tx: ComSignalType=UINT8
            DET_MTD_327_oRDR_DETECTION_325_328_oPCAN_RADAR_ad87bf69_Tx: ComSignalType=UINT8
            DET_MTD_328_oRDR_DETECTION_325_328_oPCAN_RADAR_81972d2e_Tx: ComSignalType=UINT8
            DET_PROB_1STAZHYPO_325_oRDR_DETECTION_325_328_oPCAN_RADAR_cfa3f8cf_Tx: ComSignalType=BOOLEAN
            DET_PROB_1STAZHYPO_326_oRDR_DETECTION_325_328_oPCAN_RADAR_ab438331_Tx: ComSignalType=BOOLEAN
            DET_PROB_1STAZHYPO_327_oRDR_DETECTION_325_328_oPCAN_RADAR_3e3357a4_Tx: ComSignalType=BOOLEAN
            DET_PROB_1STAZHYPO_328_oRDR_DETECTION_325_328_oPCAN_RADAR_1223c5e3_Tx: ComSignalType=BOOLEAN
            DET_RANGE_325_oRDR_DETECTION_325_328_oPCAN_RADAR_c40c1bb9_Tx: ComSignalType=UINT16
            DET_RANGE_326_oRDR_DETECTION_325_328_oPCAN_RADAR_a0ec6047_Tx: ComSignalType=UINT16
            DET_RANGE_327_oRDR_DETECTION_325_328_oPCAN_RADAR_359cb4d2_Tx: ComSignalType=UINT16
            DET_RANGE_328_oRDR_DETECTION_325_328_oPCAN_RADAR_198c2695_Tx: ComSignalType=UINT16
            DET_RANGE_ERR_325_oRDR_DETECTION_325_328_oPCAN_RADAR_63e4a1d0_Tx: ComSignalType=UINT8
            DET_RANGE_ERR_326_oRDR_DETECTION_325_328_oPCAN_RADAR_0704da2e_Tx: ComSignalType=UINT8
            DET_RANGE_ERR_327_oRDR_DETECTION_325_328_oPCAN_RADAR_92740ebb_Tx: ComSignalType=UINT8
            DET_RANGE_ERR_328_oRDR_DETECTION_325_328_oPCAN_RADAR_be649cfc_Tx: ComSignalType=UINT8
            DET_RANGE_VELOCITY_325_oRDR_DETECTION_325_328_oPCAN_RADAR_b1aad99c_Tx: ComSignalType=UINT16
            DET_RANGE_VELOCITY_326_oRDR_DETECTION_325_328_oPCAN_RADAR_d54aa262_Tx: ComSignalType=UINT16
            DET_RANGE_VELOCITY_327_oRDR_DETECTION_325_328_oPCAN_RADAR_403a76f7_Tx: ComSignalType=UINT16
            DET_RANGE_VELOCITY_328_oRDR_DETECTION_325_328_oPCAN_RADAR_6c2ae4b0_Tx: ComSignalType=UINT16
            DET_RANGE_VELOCITY_ERR_325_oRDR_DETECTION_325_328_oPCAN_RADAR_be11222e_Tx: ComSignalType=UINT8
            DET_RANGE_VELOCITY_ERR_326_oRDR_DETECTION_325_328_oPCAN_RADAR_daf159d0_Tx: ComSignalType=UINT8
            DET_RANGE_VELOCITY_ERR_327_oRDR_DETECTION_325_328_oPCAN_RADAR_4f818d45_Tx: ComSignalType=UINT8
            DET_RANGE_VELOCITY_ERR_328_oRDR_DETECTION_325_328_oPCAN_RADAR_63911f02_Tx: ComSignalType=UINT8
            DET_RCS_325_oRDR_DETECTION_325_328_oPCAN_RADAR_362aeec6_Tx: ComSignalType=UINT8
            DET_RCS_326_oRDR_DETECTION_325_328_oPCAN_RADAR_52ca9538_Tx: ComSignalType=UINT8
            DET_RCS_327_oRDR_DETECTION_325_328_oPCAN_RADAR_c7ba41ad_Tx: ComSignalType=UINT8
            DET_RCS_328_oRDR_DETECTION_325_328_oPCAN_RADAR_ebaad3ea_Tx: ComSignalType=UINT8
            DET_SNR_325_oRDR_DETECTION_325_328_oPCAN_RADAR_eb84bac4_Tx: ComSignalType=UINT8
            DET_SNR_326_oRDR_DETECTION_325_328_oPCAN_RADAR_8f64c13a_Tx: ComSignalType=UINT8
            DET_SNR_327_oRDR_DETECTION_325_328_oPCAN_RADAR_1a1415af_Tx: ComSignalType=UINT8
            DET_SNR_328_oRDR_DETECTION_325_328_oPCAN_RADAR_360487e8_Tx: ComSignalType=UINT8
            DET_SUPER_RES_TARGET_325_oRDR_DETECTION_325_328_oPCAN_RADAR_da1d92a1_Tx: ComSignalType=BOOLEAN
            DET_SUPER_RES_TARGET_326_oRDR_DETECTION_325_328_oPCAN_RADAR_befde95f_Tx: ComSignalType=BOOLEAN
            DET_SUPER_RES_TARGET_327_oRDR_DETECTION_325_328_oPCAN_RADAR_2b8d3dca_Tx: ComSignalType=BOOLEAN
            DET_SUPER_RES_TARGET_328_oRDR_DETECTION_325_328_oPCAN_RADAR_079daf8d_Tx: ComSignalType=BOOLEAN
        SG_Detections_329_332_oRDR_DETECTION_329_332_oPCAN_RADAR_c57c421a_Tx
          83 x ComGroupSignal:
            DET_AZIMUTH_329_oRDR_DETECTION_329_332_oPCAN_RADAR_ae2f6eba_Tx: ComSignalType=UINT16
            DET_AZIMUTH_330_oRDR_DETECTION_329_332_oPCAN_RADAR_cb0f1c1e_Tx: ComSignalType=UINT16
            DET_AZIMUTH_331_oRDR_DETECTION_329_332_oPCAN_RADAR_5e7fc88b_Tx: ComSignalType=UINT16
            DET_AZIMUTH_332_oRDR_DETECTION_329_332_oPCAN_RADAR_3a9fb375_Tx: ComSignalType=UINT16
            DET_AZIMUTH_ERR_329_oRDR_DETECTION_329_332_oPCAN_RADAR_0a9afb4f_Tx: ComSignalType=UINT8
            DET_AZIMUTH_ERR_330_oRDR_DETECTION_329_332_oPCAN_RADAR_6fba89eb_Tx: ComSignalType=UINT8
            DET_AZIMUTH_ERR_331_oRDR_DETECTION_329_332_oPCAN_RADAR_faca5d7e_Tx: ComSignalType=UINT8
            DET_AZIMUTH_ERR_332_oRDR_DETECTION_329_332_oPCAN_RADAR_9e2a2680_Tx: ComSignalType=UINT8
            DET_BELOW_RAIN_THOLD_329_oRDR_DETECTION_329_332_oPCAN_RADAR_7b2efd7a_Tx: ComSignalType=UINT8
            DET_BELOW_RAIN_THOLD_330_oRDR_DETECTION_329_332_oPCAN_RADAR_1e0e8fde_Tx: ComSignalType=UINT8
            DET_BELOW_RAIN_THOLD_331_oRDR_DETECTION_329_332_oPCAN_RADAR_8b7e5b4b_Tx: ComSignalType=UINT8
            DET_BELOW_RAIN_THOLD_332_oRDR_DETECTION_329_332_oPCAN_RADAR_ef9e20b5_Tx: ComSignalType=UINT8
            DET_BI_STATIC_FLAG_329_oRDR_DETECTION_329_332_oPCAN_RADAR_f8032e3f_Tx: ComSignalType=BOOLEAN
            DET_BI_STATIC_FLAG_330_oRDR_DETECTION_329_332_oPCAN_RADAR_9d235c9b_Tx: ComSignalType=BOOLEAN
            DET_BI_STATIC_FLAG_331_oRDR_DETECTION_329_332_oPCAN_RADAR_0853880e_Tx: ComSignalType=BOOLEAN
            DET_BI_STATIC_FLAG_332_oRDR_DETECTION_329_332_oPCAN_RADAR_6cb3f3f0_Tx: ComSignalType=BOOLEAN
            DET_CONFD_AZIMUTH_329_oRDR_DETECTION_329_332_oPCAN_RADAR_acc96470_Tx: ComSignalType=UINT8
            DET_CONFD_AZIMUTH_330_oRDR_DETECTION_329_332_oPCAN_RADAR_c9e916d4_Tx: ComSignalType=UINT8
            DET_CONFD_AZIMUTH_331_oRDR_DETECTION_329_332_oPCAN_RADAR_5c99c241_Tx: ComSignalType=UINT8
            DET_CONFD_AZIMUTH_332_oRDR_DETECTION_329_332_oPCAN_RADAR_3879b9bf_Tx: ComSignalType=UINT8
            DET_CONFD_ELEVATION_329_oRDR_DETECTION_329_332_oPCAN_RADAR_ae5c658a_Tx: ComSignalType=UINT8
            DET_CONFD_ELEVATION_330_oRDR_DETECTION_329_332_oPCAN_RADAR_cb7c172e_Tx: ComSignalType=UINT8
            DET_CONFD_ELEVATION_331_oRDR_DETECTION_329_332_oPCAN_RADAR_5e0cc3bb_Tx: ComSignalType=UINT8
            DET_CONFD_ELEVATION_332_oRDR_DETECTION_329_332_oPCAN_RADAR_3aecb845_Tx: ComSignalType=UINT8
            DET_ELEVATION_329_oRDR_DETECTION_329_332_oPCAN_RADAR_7f9cb1b6_Tx: ComSignalType=UINT8
            DET_ELEVATION_330_oRDR_DETECTION_329_332_oPCAN_RADAR_1abcc312_Tx: ComSignalType=UINT8
            DET_ELEVATION_331_oRDR_DETECTION_329_332_oPCAN_RADAR_8fcc1787_Tx: ComSignalType=UINT8
            DET_ELEVATION_332_oRDR_DETECTION_329_332_oPCAN_RADAR_eb2c6c79_Tx: ComSignalType=UINT8
            DET_ELEVATION_ERR_329_oRDR_DETECTION_329_332_oPCAN_RADAR_f8a529c3_Tx: ComSignalType=UINT8
            DET_ELEVATION_ERR_330_oRDR_DETECTION_329_332_oPCAN_RADAR_9d855b67_Tx: ComSignalType=UINT8
            DET_ELEVATION_ERR_331_oRDR_DETECTION_329_332_oPCAN_RADAR_08f58ff2_Tx: ComSignalType=UINT8
            DET_ELEVATION_ERR_332_oRDR_DETECTION_329_332_oPCAN_RADAR_6c15f40c_Tx: ComSignalType=UINT8
            DET_EXISTENCE_PROB_329_oRDR_DETECTION_329_332_oPCAN_RADAR_2a3a5ca3_Tx: ComSignalType=UINT8
            DET_EXISTENCE_PROB_330_oRDR_DETECTION_329_332_oPCAN_RADAR_4f1a2e07_Tx: ComSignalType=UINT8
            DET_EXISTENCE_PROB_331_oRDR_DETECTION_329_332_oPCAN_RADAR_da6afa92_Tx: ComSignalType=UINT8
            DET_EXISTENCE_PROB_332_oRDR_DETECTION_329_332_oPCAN_RADAR_be8a816c_Tx: ComSignalType=UINT8
            DET_HVC_FLAG_329_oRDR_DETECTION_329_332_oPCAN_RADAR_cb4e1fdc_Tx: ComSignalType=BOOLEAN
            DET_HVC_FLAG_330_oRDR_DETECTION_329_332_oPCAN_RADAR_ae6e6d78_Tx: ComSignalType=BOOLEAN
            DET_HVC_FLAG_331_oRDR_DETECTION_329_332_oPCAN_RADAR_3b1eb9ed_Tx: ComSignalType=BOOLEAN
            DET_HVC_FLAG_332_oRDR_DETECTION_329_332_oPCAN_RADAR_5ffec213_Tx: ComSignalType=BOOLEAN
            DET_IDM_329_oRDR_DETECTION_329_332_oPCAN_RADAR_401c2461_Tx: ComSignalType=UINT8
            DET_IDM_330_oRDR_DETECTION_329_332_oPCAN_RADAR_253c56c5_Tx: ComSignalType=UINT8
            DET_IDM_331_oRDR_DETECTION_329_332_oPCAN_RADAR_b04c8250_Tx: ComSignalType=UINT8
            DET_IDM_332_oRDR_DETECTION_329_332_oPCAN_RADAR_d4acf9ae_Tx: ComSignalType=UINT8
            DET_MH_CRC16_329_332_oRDR_DETECTION_329_332_oPCAN_RADAR_41f49011_Tx: ComSignalType=UINT16
            DET_MH_CYCLE_COUNTER_329_332_oRDR_DETECTION_329_332_oPCAN_RADAR_c5813126_Tx: ComSignalType=UINT8
            DET_MH_SCAN_INDEX_4LSB_329_332_oRDR_DETECTION_329_332_oPCAN_RADAR_09ab14aa_Tx: ComSignalType=UINT8
            DET_MTD_329_oRDR_DETECTION_329_332_oPCAN_RADAR_26af16ba_Tx: ComSignalType=UINT8
            DET_MTD_330_oRDR_DETECTION_329_332_oPCAN_RADAR_438f641e_Tx: ComSignalType=UINT8
            DET_MTD_331_oRDR_DETECTION_329_332_oPCAN_RADAR_d6ffb08b_Tx: ComSignalType=UINT8
            DET_MTD_332_oRDR_DETECTION_329_332_oPCAN_RADAR_b21fcb75_Tx: ComSignalType=UINT8
            DET_PROB_1STAZHYPO_329_oRDR_DETECTION_329_332_oPCAN_RADAR_b51bfe77_Tx: ComSignalType=BOOLEAN
            DET_PROB_1STAZHYPO_330_oRDR_DETECTION_329_332_oPCAN_RADAR_d03b8cd3_Tx: ComSignalType=BOOLEAN
            DET_PROB_1STAZHYPO_331_oRDR_DETECTION_329_332_oPCAN_RADAR_454b5846_Tx: ComSignalType=BOOLEAN
            DET_PROB_1STAZHYPO_332_oRDR_DETECTION_329_332_oPCAN_RADAR_21ab23b8_Tx: ComSignalType=BOOLEAN
            DET_RANGE_329_oRDR_DETECTION_329_332_oPCAN_RADAR_beb41d01_Tx: ComSignalType=UINT16
            DET_RANGE_330_oRDR_DETECTION_329_332_oPCAN_RADAR_db946fa5_Tx: ComSignalType=UINT16
            DET_RANGE_331_oRDR_DETECTION_329_332_oPCAN_RADAR_4ee4bb30_Tx: ComSignalType=UINT16
            DET_RANGE_332_oRDR_DETECTION_329_332_oPCAN_RADAR_2a04c0ce_Tx: ComSignalType=UINT16
            DET_RANGE_ERR_329_oRDR_DETECTION_329_332_oPCAN_RADAR_195ca768_Tx: ComSignalType=UINT8
            DET_RANGE_ERR_330_oRDR_DETECTION_329_332_oPCAN_RADAR_7c7cd5cc_Tx: ComSignalType=UINT8
            DET_RANGE_ERR_331_oRDR_DETECTION_329_332_oPCAN_RADAR_e90c0159_Tx: ComSignalType=UINT8
            DET_RANGE_ERR_332_oRDR_DETECTION_329_332_oPCAN_RADAR_8dec7aa7_Tx: ComSignalType=UINT8
            DET_RANGE_VELOCITY_329_oRDR_DETECTION_329_332_oPCAN_RADAR_cb12df24_Tx: ComSignalType=UINT16
            DET_RANGE_VELOCITY_330_oRDR_DETECTION_329_332_oPCAN_RADAR_ae32ad80_Tx: ComSignalType=UINT16
            DET_RANGE_VELOCITY_331_oRDR_DETECTION_329_332_oPCAN_RADAR_3b427915_Tx: ComSignalType=UINT16
            DET_RANGE_VELOCITY_332_oRDR_DETECTION_329_332_oPCAN_RADAR_5fa202eb_Tx: ComSignalType=UINT16
            DET_RANGE_VELOCITY_ERR_329_oRDR_DETECTION_329_332_oPCAN_RADAR_c4a92496_Tx: ComSignalType=UINT8
            DET_RANGE_VELOCITY_ERR_330_oRDR_DETECTION_329_332_oPCAN_RADAR_a1895632_Tx: ComSignalType=UINT8
            DET_RANGE_VELOCITY_ERR_331_oRDR_DETECTION_329_332_oPCAN_RADAR_34f982a7_Tx: ComSignalType=UINT8
            DET_RANGE_VELOCITY_ERR_332_oRDR_DETECTION_329_332_oPCAN_RADAR_5019f959_Tx: ComSignalType=UINT8
            DET_RCS_329_oRDR_DETECTION_329_332_oPCAN_RADAR_4c92e87e_Tx: ComSignalType=UINT8
            DET_RCS_330_oRDR_DETECTION_329_332_oPCAN_RADAR_29b29ada_Tx: ComSignalType=UINT8
            DET_RCS_331_oRDR_DETECTION_329_332_oPCAN_RADAR_bcc24e4f_Tx: ComSignalType=UINT8
            DET_RCS_332_oRDR_DETECTION_329_332_oPCAN_RADAR_d82235b1_Tx: ComSignalType=UINT8
            DET_SNR_329_oRDR_DETECTION_329_332_oPCAN_RADAR_913cbc7c_Tx: ComSignalType=UINT8
            DET_SNR_330_oRDR_DETECTION_329_332_oPCAN_RADAR_f41cced8_Tx: ComSignalType=UINT8
            DET_SNR_331_oRDR_DETECTION_329_332_oPCAN_RADAR_616c1a4d_Tx: ComSignalType=UINT8
            DET_SNR_332_oRDR_DETECTION_329_332_oPCAN_RADAR_058c61b3_Tx: ComSignalType=UINT8
            DET_SUPER_RES_TARGET_329_oRDR_DETECTION_329_332_oPCAN_RADAR_a0a59419_Tx: ComSignalType=BOOLEAN
            DET_SUPER_RES_TARGET_330_oRDR_DETECTION_329_332_oPCAN_RADAR_c585e6bd_Tx: ComSignalType=BOOLEAN
            DET_SUPER_RES_TARGET_331_oRDR_DETECTION_329_332_oPCAN_RADAR_50f53228_Tx: ComSignalType=BOOLEAN
            DET_SUPER_RES_TARGET_332_oRDR_DETECTION_329_332_oPCAN_RADAR_341549d6_Tx: ComSignalType=BOOLEAN
        SG_Detections_333_336_oRDR_DETECTION_333_336_oPCAN_RADAR_f7772a32_Tx
          83 x ComGroupSignal:
            DET_AZIMUTH_333_oRDR_DETECTION_333_336_oPCAN_RADAR_b22864ce_Tx: ComSignalType=UINT16
            DET_AZIMUTH_334_oRDR_DETECTION_333_336_oPCAN_RADAR_ee9847a7_Tx: ComSignalType=UINT16
            DET_AZIMUTH_335_oRDR_DETECTION_333_336_oPCAN_RADAR_7be89332_Tx: ComSignalType=UINT16
            DET_AZIMUTH_336_oRDR_DETECTION_333_336_oPCAN_RADAR_1f08e8cc_Tx: ComSignalType=UINT16
            DET_AZIMUTH_ERR_333_oRDR_DETECTION_333_336_oPCAN_RADAR_169df13b_Tx: ComSignalType=UINT8
            DET_AZIMUTH_ERR_334_oRDR_DETECTION_333_336_oPCAN_RADAR_4a2dd252_Tx: ComSignalType=UINT8
            DET_AZIMUTH_ERR_335_oRDR_DETECTION_333_336_oPCAN_RADAR_df5d06c7_Tx: ComSignalType=UINT8
            DET_AZIMUTH_ERR_336_oRDR_DETECTION_333_336_oPCAN_RADAR_bbbd7d39_Tx: ComSignalType=UINT8
            DET_BELOW_RAIN_THOLD_333_oRDR_DETECTION_333_336_oPCAN_RADAR_6729f70e_Tx: ComSignalType=UINT8
            DET_BELOW_RAIN_THOLD_334_oRDR_DETECTION_333_336_oPCAN_RADAR_3b99d467_Tx: ComSignalType=UINT8
            DET_BELOW_RAIN_THOLD_335_oRDR_DETECTION_333_336_oPCAN_RADAR_aee900f2_Tx: ComSignalType=UINT8
            DET_BELOW_RAIN_THOLD_336_oRDR_DETECTION_333_336_oPCAN_RADAR_ca097b0c_Tx: ComSignalType=UINT8
            DET_BI_STATIC_FLAG_333_oRDR_DETECTION_333_336_oPCAN_RADAR_e404244b_Tx: ComSignalType=BOOLEAN
            DET_BI_STATIC_FLAG_334_oRDR_DETECTION_333_336_oPCAN_RADAR_b8b40722_Tx: ComSignalType=BOOLEAN
            DET_BI_STATIC_FLAG_335_oRDR_DETECTION_333_336_oPCAN_RADAR_2dc4d3b7_Tx: ComSignalType=BOOLEAN
            DET_BI_STATIC_FLAG_336_oRDR_DETECTION_333_336_oPCAN_RADAR_4924a849_Tx: ComSignalType=BOOLEAN
            DET_CONFD_AZIMUTH_333_oRDR_DETECTION_333_336_oPCAN_RADAR_b0ce6e04_Tx: ComSignalType=UINT8
            DET_CONFD_AZIMUTH_334_oRDR_DETECTION_333_336_oPCAN_RADAR_ec7e4d6d_Tx: ComSignalType=UINT8
            DET_CONFD_AZIMUTH_335_oRDR_DETECTION_333_336_oPCAN_RADAR_790e99f8_Tx: ComSignalType=UINT8
            DET_CONFD_AZIMUTH_336_oRDR_DETECTION_333_336_oPCAN_RADAR_1deee206_Tx: ComSignalType=UINT8
            DET_CONFD_ELEVATION_333_oRDR_DETECTION_333_336_oPCAN_RADAR_b25b6ffe_Tx: ComSignalType=UINT8
            DET_CONFD_ELEVATION_334_oRDR_DETECTION_333_336_oPCAN_RADAR_eeeb4c97_Tx: ComSignalType=UINT8
            DET_CONFD_ELEVATION_335_oRDR_DETECTION_333_336_oPCAN_RADAR_7b9b9802_Tx: ComSignalType=UINT8
            DET_CONFD_ELEVATION_336_oRDR_DETECTION_333_336_oPCAN_RADAR_1f7be3fc_Tx: ComSignalType=UINT8
            DET_ELEVATION_333_oRDR_DETECTION_333_336_oPCAN_RADAR_639bbbc2_Tx: ComSignalType=UINT8
            DET_ELEVATION_334_oRDR_DETECTION_333_336_oPCAN_RADAR_3f2b98ab_Tx: ComSignalType=UINT8
            DET_ELEVATION_335_oRDR_DETECTION_333_336_oPCAN_RADAR_aa5b4c3e_Tx: ComSignalType=UINT8
            DET_ELEVATION_336_oRDR_DETECTION_333_336_oPCAN_RADAR_cebb37c0_Tx: ComSignalType=UINT8
            DET_ELEVATION_ERR_333_oRDR_DETECTION_333_336_oPCAN_RADAR_e4a223b7_Tx: ComSignalType=UINT8
            DET_ELEVATION_ERR_334_oRDR_DETECTION_333_336_oPCAN_RADAR_b81200de_Tx: ComSignalType=UINT8
            DET_ELEVATION_ERR_335_oRDR_DETECTION_333_336_oPCAN_RADAR_2d62d44b_Tx: ComSignalType=UINT8
            DET_ELEVATION_ERR_336_oRDR_DETECTION_333_336_oPCAN_RADAR_4982afb5_Tx: ComSignalType=UINT8
            DET_EXISTENCE_PROB_333_oRDR_DETECTION_333_336_oPCAN_RADAR_363d56d7_Tx: ComSignalType=UINT8
            DET_EXISTENCE_PROB_334_oRDR_DETECTION_333_336_oPCAN_RADAR_6a8d75be_Tx: ComSignalType=UINT8
            DET_EXISTENCE_PROB_335_oRDR_DETECTION_333_336_oPCAN_RADAR_fffda12b_Tx: ComSignalType=UINT8
            DET_EXISTENCE_PROB_336_oRDR_DETECTION_333_336_oPCAN_RADAR_9b1ddad5_Tx: ComSignalType=UINT8
            DET_HVC_FLAG_333_oRDR_DETECTION_333_336_oPCAN_RADAR_d74915a8_Tx: ComSignalType=BOOLEAN
            DET_HVC_FLAG_334_oRDR_DETECTION_333_336_oPCAN_RADAR_8bf936c1_Tx: ComSignalType=BOOLEAN
            DET_HVC_FLAG_335_oRDR_DETECTION_333_336_oPCAN_RADAR_1e89e254_Tx: ComSignalType=BOOLEAN
            DET_HVC_FLAG_336_oRDR_DETECTION_333_336_oPCAN_RADAR_7a6999aa_Tx: ComSignalType=BOOLEAN
            DET_IDM_333_oRDR_DETECTION_333_336_oPCAN_RADAR_5c1b2e15_Tx: ComSignalType=UINT8
            DET_IDM_334_oRDR_DETECTION_333_336_oPCAN_RADAR_00ab0d7c_Tx: ComSignalType=UINT8
            DET_IDM_335_oRDR_DETECTION_333_336_oPCAN_RADAR_95dbd9e9_Tx: ComSignalType=UINT8
            DET_IDM_336_oRDR_DETECTION_333_336_oPCAN_RADAR_f13ba217_Tx: ComSignalType=UINT8
            DET_MH_CRC16_333_336_oRDR_DETECTION_333_336_oPCAN_RADAR_73fff839_Tx: ComSignalType=UINT16
            DET_MH_CYCLE_COUNTER_333_336_oRDR_DETECTION_333_336_oPCAN_RADAR_f78a590e_Tx: ComSignalType=UINT8
            DET_MH_SCAN_INDEX_4LSB_333_336_oRDR_DETECTION_333_336_oPCAN_RADAR_3ba07c82_Tx: ComSignalType=UINT8
            DET_MTD_333_oRDR_DETECTION_333_336_oPCAN_RADAR_3aa81cce_Tx: ComSignalType=UINT8
            DET_MTD_334_oRDR_DETECTION_333_336_oPCAN_RADAR_66183fa7_Tx: ComSignalType=UINT8
            DET_MTD_335_oRDR_DETECTION_333_336_oPCAN_RADAR_f368eb32_Tx: ComSignalType=UINT8
            DET_MTD_336_oRDR_DETECTION_333_336_oPCAN_RADAR_978890cc_Tx: ComSignalType=UINT8
            DET_PROB_1STAZHYPO_333_oRDR_DETECTION_333_336_oPCAN_RADAR_a91cf403_Tx: ComSignalType=BOOLEAN
            DET_PROB_1STAZHYPO_334_oRDR_DETECTION_333_336_oPCAN_RADAR_f5acd76a_Tx: ComSignalType=BOOLEAN
            DET_PROB_1STAZHYPO_335_oRDR_DETECTION_333_336_oPCAN_RADAR_60dc03ff_Tx: ComSignalType=BOOLEAN
            DET_PROB_1STAZHYPO_336_oRDR_DETECTION_333_336_oPCAN_RADAR_043c7801_Tx: ComSignalType=BOOLEAN
            DET_RANGE_333_oRDR_DETECTION_333_336_oPCAN_RADAR_a2b31775_Tx: ComSignalType=UINT16
            DET_RANGE_334_oRDR_DETECTION_333_336_oPCAN_RADAR_fe03341c_Tx: ComSignalType=UINT16
            DET_RANGE_335_oRDR_DETECTION_333_336_oPCAN_RADAR_6b73e089_Tx: ComSignalType=UINT16
            DET_RANGE_336_oRDR_DETECTION_333_336_oPCAN_RADAR_0f939b77_Tx: ComSignalType=UINT16
            DET_RANGE_ERR_333_oRDR_DETECTION_333_336_oPCAN_RADAR_055bad1c_Tx: ComSignalType=UINT8
            DET_RANGE_ERR_334_oRDR_DETECTION_333_336_oPCAN_RADAR_59eb8e75_Tx: ComSignalType=UINT8
            DET_RANGE_ERR_335_oRDR_DETECTION_333_336_oPCAN_RADAR_cc9b5ae0_Tx: ComSignalType=UINT8
            DET_RANGE_ERR_336_oRDR_DETECTION_333_336_oPCAN_RADAR_a87b211e_Tx: ComSignalType=UINT8
            DET_RANGE_VELOCITY_333_oRDR_DETECTION_333_336_oPCAN_RADAR_d715d550_Tx: ComSignalType=UINT16
            DET_RANGE_VELOCITY_334_oRDR_DETECTION_333_336_oPCAN_RADAR_8ba5f639_Tx: ComSignalType=UINT16
            DET_RANGE_VELOCITY_335_oRDR_DETECTION_333_336_oPCAN_RADAR_1ed522ac_Tx: ComSignalType=UINT16
            DET_RANGE_VELOCITY_336_oRDR_DETECTION_333_336_oPCAN_RADAR_7a355952_Tx: ComSignalType=UINT16
            DET_RANGE_VELOCITY_ERR_333_oRDR_DETECTION_333_336_oPCAN_RADAR_d8ae2ee2_Tx: ComSignalType=UINT8
            DET_RANGE_VELOCITY_ERR_334_oRDR_DETECTION_333_336_oPCAN_RADAR_841e0d8b_Tx: ComSignalType=UINT8
            DET_RANGE_VELOCITY_ERR_335_oRDR_DETECTION_333_336_oPCAN_RADAR_116ed91e_Tx: ComSignalType=UINT8
            DET_RANGE_VELOCITY_ERR_336_oRDR_DETECTION_333_336_oPCAN_RADAR_758ea2e0_Tx: ComSignalType=UINT8
            DET_RCS_333_oRDR_DETECTION_333_336_oPCAN_RADAR_5095e20a_Tx: ComSignalType=UINT8
            DET_RCS_334_oRDR_DETECTION_333_336_oPCAN_RADAR_0c25c163_Tx: ComSignalType=UINT8
            DET_RCS_335_oRDR_DETECTION_333_336_oPCAN_RADAR_995515f6_Tx: ComSignalType=UINT8
            DET_RCS_336_oRDR_DETECTION_333_336_oPCAN_RADAR_fdb56e08_Tx: ComSignalType=UINT8
            DET_SNR_333_oRDR_DETECTION_333_336_oPCAN_RADAR_8d3bb608_Tx: ComSignalType=UINT8
            DET_SNR_334_oRDR_DETECTION_333_336_oPCAN_RADAR_d18b9561_Tx: ComSignalType=UINT8
            DET_SNR_335_oRDR_DETECTION_333_336_oPCAN_RADAR_44fb41f4_Tx: ComSignalType=UINT8
            DET_SNR_336_oRDR_DETECTION_333_336_oPCAN_RADAR_201b3a0a_Tx: ComSignalType=UINT8
            DET_SUPER_RES_TARGET_333_oRDR_DETECTION_333_336_oPCAN_RADAR_bca29e6d_Tx: ComSignalType=BOOLEAN
            DET_SUPER_RES_TARGET_334_oRDR_DETECTION_333_336_oPCAN_RADAR_e012bd04_Tx: ComSignalType=BOOLEAN
            DET_SUPER_RES_TARGET_335_oRDR_DETECTION_333_336_oPCAN_RADAR_75626991_Tx: ComSignalType=BOOLEAN
            DET_SUPER_RES_TARGET_336_oRDR_DETECTION_333_336_oPCAN_RADAR_1182126f_Tx: ComSignalType=BOOLEAN
        SG_Detections_337_340_oRDR_DETECTION_337_340_oPCAN_RADAR_6c24a51c_Tx
          83 x ComGroupSignal:
            DET_AZIMUTH_337_oRDR_DETECTION_337_340_oPCAN_RADAR_3c586e8b_Tx: ComSignalType=UINT16
            DET_AZIMUTH_338_oRDR_DETECTION_337_340_oPCAN_RADAR_1048fccc_Tx: ComSignalType=UINT16
            DET_AZIMUTH_339_oRDR_DETECTION_337_340_oPCAN_RADAR_85382859_Tx: ComSignalType=UINT16
            DET_AZIMUTH_340_oRDR_DETECTION_337_340_oPCAN_RADAR_54da243d_Tx: ComSignalType=UINT16
            DET_AZIMUTH_ERR_337_oRDR_DETECTION_337_340_oPCAN_RADAR_98edfb7e_Tx: ComSignalType=UINT8
            DET_AZIMUTH_ERR_338_oRDR_DETECTION_337_340_oPCAN_RADAR_b4fd6939_Tx: ComSignalType=UINT8
            DET_AZIMUTH_ERR_339_oRDR_DETECTION_337_340_oPCAN_RADAR_218dbdac_Tx: ComSignalType=UINT8
            DET_AZIMUTH_ERR_340_oRDR_DETECTION_337_340_oPCAN_RADAR_f06fb1c8_Tx: ComSignalType=UINT8
            DET_BELOW_RAIN_THOLD_337_oRDR_DETECTION_337_340_oPCAN_RADAR_e959fd4b_Tx: ComSignalType=UINT8
            DET_BELOW_RAIN_THOLD_338_oRDR_DETECTION_337_340_oPCAN_RADAR_c5496f0c_Tx: ComSignalType=UINT8
            DET_BELOW_RAIN_THOLD_339_oRDR_DETECTION_337_340_oPCAN_RADAR_5039bb99_Tx: ComSignalType=UINT8
            DET_BELOW_RAIN_THOLD_340_oRDR_DETECTION_337_340_oPCAN_RADAR_81dbb7fd_Tx: ComSignalType=UINT8
            DET_BI_STATIC_FLAG_337_oRDR_DETECTION_337_340_oPCAN_RADAR_6a742e0e_Tx: ComSignalType=BOOLEAN
            DET_BI_STATIC_FLAG_338_oRDR_DETECTION_337_340_oPCAN_RADAR_4664bc49_Tx: ComSignalType=BOOLEAN
            DET_BI_STATIC_FLAG_339_oRDR_DETECTION_337_340_oPCAN_RADAR_d31468dc_Tx: ComSignalType=BOOLEAN
            DET_BI_STATIC_FLAG_340_oRDR_DETECTION_337_340_oPCAN_RADAR_02f664b8_Tx: ComSignalType=BOOLEAN
            DET_CONFD_AZIMUTH_337_oRDR_DETECTION_337_340_oPCAN_RADAR_3ebe6441_Tx: ComSignalType=UINT8
            DET_CONFD_AZIMUTH_338_oRDR_DETECTION_337_340_oPCAN_RADAR_12aef606_Tx: ComSignalType=UINT8
            DET_CONFD_AZIMUTH_339_oRDR_DETECTION_337_340_oPCAN_RADAR_87de2293_Tx: ComSignalType=UINT8
            DET_CONFD_AZIMUTH_340_oRDR_DETECTION_337_340_oPCAN_RADAR_563c2ef7_Tx: ComSignalType=UINT8
            DET_CONFD_ELEVATION_337_oRDR_DETECTION_337_340_oPCAN_RADAR_3c2b65bb_Tx: ComSignalType=UINT8
            DET_CONFD_ELEVATION_338_oRDR_DETECTION_337_340_oPCAN_RADAR_103bf7fc_Tx: ComSignalType=UINT8
            DET_CONFD_ELEVATION_339_oRDR_DETECTION_337_340_oPCAN_RADAR_854b2369_Tx: ComSignalType=UINT8
            DET_CONFD_ELEVATION_340_oRDR_DETECTION_337_340_oPCAN_RADAR_54a92f0d_Tx: ComSignalType=UINT8
            DET_ELEVATION_337_oRDR_DETECTION_337_340_oPCAN_RADAR_edebb187_Tx: ComSignalType=UINT8
            DET_ELEVATION_338_oRDR_DETECTION_337_340_oPCAN_RADAR_c1fb23c0_Tx: ComSignalType=UINT8
            DET_ELEVATION_339_oRDR_DETECTION_337_340_oPCAN_RADAR_548bf755_Tx: ComSignalType=UINT8
            DET_ELEVATION_340_oRDR_DETECTION_337_340_oPCAN_RADAR_8569fb31_Tx: ComSignalType=UINT8
            DET_ELEVATION_ERR_337_oRDR_DETECTION_337_340_oPCAN_RADAR_6ad229f2_Tx: ComSignalType=UINT8
            DET_ELEVATION_ERR_338_oRDR_DETECTION_337_340_oPCAN_RADAR_46c2bbb5_Tx: ComSignalType=UINT8
            DET_ELEVATION_ERR_339_oRDR_DETECTION_337_340_oPCAN_RADAR_d3b26f20_Tx: ComSignalType=UINT8
            DET_ELEVATION_ERR_340_oRDR_DETECTION_337_340_oPCAN_RADAR_02506344_Tx: ComSignalType=UINT8
            DET_EXISTENCE_PROB_337_oRDR_DETECTION_337_340_oPCAN_RADAR_b84d5c92_Tx: ComSignalType=UINT8
            DET_EXISTENCE_PROB_338_oRDR_DETECTION_337_340_oPCAN_RADAR_945dced5_Tx: ComSignalType=UINT8
            DET_EXISTENCE_PROB_339_oRDR_DETECTION_337_340_oPCAN_RADAR_012d1a40_Tx: ComSignalType=UINT8
            DET_EXISTENCE_PROB_340_oRDR_DETECTION_337_340_oPCAN_RADAR_d0cf1624_Tx: ComSignalType=UINT8
            DET_HVC_FLAG_337_oRDR_DETECTION_337_340_oPCAN_RADAR_59391fed_Tx: ComSignalType=BOOLEAN
            DET_HVC_FLAG_338_oRDR_DETECTION_337_340_oPCAN_RADAR_75298daa_Tx: ComSignalType=BOOLEAN
            DET_HVC_FLAG_339_oRDR_DETECTION_337_340_oPCAN_RADAR_e059593f_Tx: ComSignalType=BOOLEAN
            DET_HVC_FLAG_340_oRDR_DETECTION_337_340_oPCAN_RADAR_31bb555b_Tx: ComSignalType=BOOLEAN
            DET_IDM_337_oRDR_DETECTION_337_340_oPCAN_RADAR_d26b2450_Tx: ComSignalType=UINT8
            DET_IDM_338_oRDR_DETECTION_337_340_oPCAN_RADAR_fe7bb617_Tx: ComSignalType=UINT8
            DET_IDM_339_oRDR_DETECTION_337_340_oPCAN_RADAR_6b0b6282_Tx: ComSignalType=UINT8
            DET_IDM_340_oRDR_DETECTION_337_340_oPCAN_RADAR_bae96ee6_Tx: ComSignalType=UINT8
            DET_MH_CRC16_337_340_oRDR_DETECTION_337_340_oPCAN_RADAR_e8ac7717_Tx: ComSignalType=UINT16
            DET_MH_CYCLE_COUNTER_337_340_oRDR_DETECTION_337_340_oPCAN_RADAR_6cd9d620_Tx: ComSignalType=UINT8
            DET_MH_SCAN_INDEX_4LSB_337_340_oRDR_DETECTION_337_340_oPCAN_RADAR_a0f3f3ac_Tx: ComSignalType=UINT8
            DET_MTD_337_oRDR_DETECTION_337_340_oPCAN_RADAR_b4d8168b_Tx: ComSignalType=UINT8
            DET_MTD_338_oRDR_DETECTION_337_340_oPCAN_RADAR_98c884cc_Tx: ComSignalType=UINT8
            DET_MTD_339_oRDR_DETECTION_337_340_oPCAN_RADAR_0db85059_Tx: ComSignalType=UINT8
            DET_MTD_340_oRDR_DETECTION_337_340_oPCAN_RADAR_dc5a5c3d_Tx: ComSignalType=UINT8
            DET_PROB_1STAZHYPO_337_oRDR_DETECTION_337_340_oPCAN_RADAR_276cfe46_Tx: ComSignalType=BOOLEAN
            DET_PROB_1STAZHYPO_338_oRDR_DETECTION_337_340_oPCAN_RADAR_0b7c6c01_Tx: ComSignalType=BOOLEAN
            DET_PROB_1STAZHYPO_339_oRDR_DETECTION_337_340_oPCAN_RADAR_9e0cb894_Tx: ComSignalType=BOOLEAN
            DET_PROB_1STAZHYPO_340_oRDR_DETECTION_337_340_oPCAN_RADAR_4feeb4f0_Tx: ComSignalType=BOOLEAN
            DET_RANGE_337_oRDR_DETECTION_337_340_oPCAN_RADAR_2cc31d30_Tx: ComSignalType=UINT16
            DET_RANGE_338_oRDR_DETECTION_337_340_oPCAN_RADAR_00d38f77_Tx: ComSignalType=UINT16
            DET_RANGE_339_oRDR_DETECTION_337_340_oPCAN_RADAR_95a35be2_Tx: ComSignalType=UINT16
            DET_RANGE_340_oRDR_DETECTION_337_340_oPCAN_RADAR_44415786_Tx: ComSignalType=UINT16
            DET_RANGE_ERR_337_oRDR_DETECTION_337_340_oPCAN_RADAR_8b2ba759_Tx: ComSignalType=UINT8
            DET_RANGE_ERR_338_oRDR_DETECTION_337_340_oPCAN_RADAR_a73b351e_Tx: ComSignalType=UINT8
            DET_RANGE_ERR_339_oRDR_DETECTION_337_340_oPCAN_RADAR_324be18b_Tx: ComSignalType=UINT8
            DET_RANGE_ERR_340_oRDR_DETECTION_337_340_oPCAN_RADAR_e3a9edef_Tx: ComSignalType=UINT8
            DET_RANGE_VELOCITY_337_oRDR_DETECTION_337_340_oPCAN_RADAR_5965df15_Tx: ComSignalType=UINT16
            DET_RANGE_VELOCITY_338_oRDR_DETECTION_337_340_oPCAN_RADAR_75754d52_Tx: ComSignalType=UINT16
            DET_RANGE_VELOCITY_339_oRDR_DETECTION_337_340_oPCAN_RADAR_e00599c7_Tx: ComSignalType=UINT16
            DET_RANGE_VELOCITY_340_oRDR_DETECTION_337_340_oPCAN_RADAR_31e795a3_Tx: ComSignalType=UINT16
            DET_RANGE_VELOCITY_ERR_337_oRDR_DETECTION_337_340_oPCAN_RADAR_56de24a7_Tx: ComSignalType=UINT8
            DET_RANGE_VELOCITY_ERR_338_oRDR_DETECTION_337_340_oPCAN_RADAR_7aceb6e0_Tx: ComSignalType=UINT8
            DET_RANGE_VELOCITY_ERR_339_oRDR_DETECTION_337_340_oPCAN_RADAR_efbe6275_Tx: ComSignalType=UINT8
            DET_RANGE_VELOCITY_ERR_340_oRDR_DETECTION_337_340_oPCAN_RADAR_3e5c6e11_Tx: ComSignalType=UINT8
            DET_RCS_337_oRDR_DETECTION_337_340_oPCAN_RADAR_dee5e84f_Tx: ComSignalType=UINT8
            DET_RCS_338_oRDR_DETECTION_337_340_oPCAN_RADAR_f2f57a08_Tx: ComSignalType=UINT8
            DET_RCS_339_oRDR_DETECTION_337_340_oPCAN_RADAR_6785ae9d_Tx: ComSignalType=UINT8
            DET_RCS_340_oRDR_DETECTION_337_340_oPCAN_RADAR_b667a2f9_Tx: ComSignalType=UINT8
            DET_SNR_337_oRDR_DETECTION_337_340_oPCAN_RADAR_034bbc4d_Tx: ComSignalType=UINT8
            DET_SNR_338_oRDR_DETECTION_337_340_oPCAN_RADAR_2f5b2e0a_Tx: ComSignalType=UINT8
            DET_SNR_339_oRDR_DETECTION_337_340_oPCAN_RADAR_ba2bfa9f_Tx: ComSignalType=UINT8
            DET_SNR_340_oRDR_DETECTION_337_340_oPCAN_RADAR_6bc9f6fb_Tx: ComSignalType=UINT8
            DET_SUPER_RES_TARGET_337_oRDR_DETECTION_337_340_oPCAN_RADAR_32d29428_Tx: ComSignalType=BOOLEAN
            DET_SUPER_RES_TARGET_338_oRDR_DETECTION_337_340_oPCAN_RADAR_1ec2066f_Tx: ComSignalType=BOOLEAN
            DET_SUPER_RES_TARGET_339_oRDR_DETECTION_337_340_oPCAN_RADAR_8bb2d2fa_Tx: ComSignalType=BOOLEAN
            DET_SUPER_RES_TARGET_340_oRDR_DETECTION_337_340_oPCAN_RADAR_5a50de9e_Tx: ComSignalType=BOOLEAN
        SG_Detections_341_344_oRDR_DETECTION_341_344_oPCAN_RADAR_725bb2c5_Tx
          83 x ComGroupSignal:
            DET_AZIMUTH_341_oRDR_DETECTION_341_344_oPCAN_RADAR_47092752_Tx: ComSignalType=UINT16
            DET_AZIMUTH_342_oRDR_DETECTION_341_344_oPCAN_RADAR_23e95cac_Tx: ComSignalType=UINT16
            DET_AZIMUTH_343_oRDR_DETECTION_341_344_oPCAN_RADAR_b6998839_Tx: ComSignalType=UINT16
            DET_AZIMUTH_344_oRDR_DETECTION_341_344_oPCAN_RADAR_ea29ab50_Tx: ComSignalType=UINT16
            DET_AZIMUTH_ERR_341_oRDR_DETECTION_341_344_oPCAN_RADAR_e3bcb2a7_Tx: ComSignalType=UINT8
            DET_AZIMUTH_ERR_342_oRDR_DETECTION_341_344_oPCAN_RADAR_875cc959_Tx: ComSignalType=UINT8
            DET_AZIMUTH_ERR_343_oRDR_DETECTION_341_344_oPCAN_RADAR_122c1dcc_Tx: ComSignalType=UINT8
            DET_AZIMUTH_ERR_344_oRDR_DETECTION_341_344_oPCAN_RADAR_4e9c3ea5_Tx: ComSignalType=UINT8
            DET_BELOW_RAIN_THOLD_341_oRDR_DETECTION_341_344_oPCAN_RADAR_9208b492_Tx: ComSignalType=UINT8
            DET_BELOW_RAIN_THOLD_342_oRDR_DETECTION_341_344_oPCAN_RADAR_f6e8cf6c_Tx: ComSignalType=UINT8
            DET_BELOW_RAIN_THOLD_343_oRDR_DETECTION_341_344_oPCAN_RADAR_63981bf9_Tx: ComSignalType=UINT8
            DET_BELOW_RAIN_THOLD_344_oRDR_DETECTION_341_344_oPCAN_RADAR_3f283890_Tx: ComSignalType=UINT8
            DET_BI_STATIC_FLAG_341_oRDR_DETECTION_341_344_oPCAN_RADAR_112567d7_Tx: ComSignalType=BOOLEAN
            DET_BI_STATIC_FLAG_342_oRDR_DETECTION_341_344_oPCAN_RADAR_75c51c29_Tx: ComSignalType=BOOLEAN
            DET_BI_STATIC_FLAG_343_oRDR_DETECTION_341_344_oPCAN_RADAR_e0b5c8bc_Tx: ComSignalType=BOOLEAN
            DET_BI_STATIC_FLAG_344_oRDR_DETECTION_341_344_oPCAN_RADAR_bc05ebd5_Tx: ComSignalType=BOOLEAN
            DET_CONFD_AZIMUTH_341_oRDR_DETECTION_341_344_oPCAN_RADAR_45ef2d98_Tx: ComSignalType=UINT8
            DET_CONFD_AZIMUTH_342_oRDR_DETECTION_341_344_oPCAN_RADAR_210f5666_Tx: ComSignalType=UINT8
            DET_CONFD_AZIMUTH_343_oRDR_DETECTION_341_344_oPCAN_RADAR_b47f82f3_Tx: ComSignalType=UINT8
            DET_CONFD_AZIMUTH_344_oRDR_DETECTION_341_344_oPCAN_RADAR_e8cfa19a_Tx: ComSignalType=UINT8
            DET_CONFD_ELEVATION_341_oRDR_DETECTION_341_344_oPCAN_RADAR_477a2c62_Tx: ComSignalType=UINT8
            DET_CONFD_ELEVATION_342_oRDR_DETECTION_341_344_oPCAN_RADAR_239a579c_Tx: ComSignalType=UINT8
            DET_CONFD_ELEVATION_343_oRDR_DETECTION_341_344_oPCAN_RADAR_b6ea8309_Tx: ComSignalType=UINT8
            DET_CONFD_ELEVATION_344_oRDR_DETECTION_341_344_oPCAN_RADAR_ea5aa060_Tx: ComSignalType=UINT8
            DET_ELEVATION_341_oRDR_DETECTION_341_344_oPCAN_RADAR_96baf85e_Tx: ComSignalType=UINT8
            DET_ELEVATION_342_oRDR_DETECTION_341_344_oPCAN_RADAR_f25a83a0_Tx: ComSignalType=UINT8
            DET_ELEVATION_343_oRDR_DETECTION_341_344_oPCAN_RADAR_672a5735_Tx: ComSignalType=UINT8
            DET_ELEVATION_344_oRDR_DETECTION_341_344_oPCAN_RADAR_3b9a745c_Tx: ComSignalType=UINT8
            DET_ELEVATION_ERR_341_oRDR_DETECTION_341_344_oPCAN_RADAR_1183602b_Tx: ComSignalType=UINT8
            DET_ELEVATION_ERR_342_oRDR_DETECTION_341_344_oPCAN_RADAR_75631bd5_Tx: ComSignalType=UINT8
            DET_ELEVATION_ERR_343_oRDR_DETECTION_341_344_oPCAN_RADAR_e013cf40_Tx: ComSignalType=UINT8
            DET_ELEVATION_ERR_344_oRDR_DETECTION_341_344_oPCAN_RADAR_bca3ec29_Tx: ComSignalType=UINT8
            DET_EXISTENCE_PROB_341_oRDR_DETECTION_341_344_oPCAN_RADAR_c31c154b_Tx: ComSignalType=UINT8
            DET_EXISTENCE_PROB_342_oRDR_DETECTION_341_344_oPCAN_RADAR_a7fc6eb5_Tx: ComSignalType=UINT8
            DET_EXISTENCE_PROB_343_oRDR_DETECTION_341_344_oPCAN_RADAR_328cba20_Tx: ComSignalType=UINT8
            DET_EXISTENCE_PROB_344_oRDR_DETECTION_341_344_oPCAN_RADAR_6e3c9949_Tx: ComSignalType=UINT8
            DET_HVC_FLAG_341_oRDR_DETECTION_341_344_oPCAN_RADAR_22685634_Tx: ComSignalType=BOOLEAN
            DET_HVC_FLAG_342_oRDR_DETECTION_341_344_oPCAN_RADAR_46882dca_Tx: ComSignalType=BOOLEAN
            DET_HVC_FLAG_343_oRDR_DETECTION_341_344_oPCAN_RADAR_d3f8f95f_Tx: ComSignalType=BOOLEAN
            DET_HVC_FLAG_344_oRDR_DETECTION_341_344_oPCAN_RADAR_8f48da36_Tx: ComSignalType=BOOLEAN
            DET_IDM_341_oRDR_DETECTION_341_344_oPCAN_RADAR_a93a6d89_Tx: ComSignalType=UINT8
            DET_IDM_342_oRDR_DETECTION_341_344_oPCAN_RADAR_cdda1677_Tx: ComSignalType=UINT8
            DET_IDM_343_oRDR_DETECTION_341_344_oPCAN_RADAR_58aac2e2_Tx: ComSignalType=UINT8
            DET_IDM_344_oRDR_DETECTION_341_344_oPCAN_RADAR_041ae18b_Tx: ComSignalType=UINT8
            DET_MH_CRC16_341_344_oRDR_DETECTION_341_344_oPCAN_RADAR_f6d360ce_Tx: ComSignalType=UINT16
            DET_MH_CYCLE_COUNTER_341_344_oRDR_DETECTION_341_344_oPCAN_RADAR_72a6c1f9_Tx: ComSignalType=UINT8
            DET_MH_SCAN_INDEX_4LSB_341_344_oRDR_DETECTION_341_344_oPCAN_RADAR_be8ce475_Tx: ComSignalType=UINT8
            DET_MTD_341_oRDR_DETECTION_341_344_oPCAN_RADAR_cf895f52_Tx: ComSignalType=UINT8
            DET_MTD_342_oRDR_DETECTION_341_344_oPCAN_RADAR_ab6924ac_Tx: ComSignalType=UINT8
            DET_MTD_343_oRDR_DETECTION_341_344_oPCAN_RADAR_3e19f039_Tx: ComSignalType=UINT8
            DET_MTD_344_oRDR_DETECTION_341_344_oPCAN_RADAR_62a9d350_Tx: ComSignalType=UINT8
            DET_PROB_1STAZHYPO_341_oRDR_DETECTION_341_344_oPCAN_RADAR_5c3db79f_Tx: ComSignalType=BOOLEAN
            DET_PROB_1STAZHYPO_342_oRDR_DETECTION_341_344_oPCAN_RADAR_38ddcc61_Tx: ComSignalType=BOOLEAN
            DET_PROB_1STAZHYPO_343_oRDR_DETECTION_341_344_oPCAN_RADAR_adad18f4_Tx: ComSignalType=BOOLEAN
            DET_PROB_1STAZHYPO_344_oRDR_DETECTION_341_344_oPCAN_RADAR_f11d3b9d_Tx: ComSignalType=BOOLEAN
            DET_RANGE_341_oRDR_DETECTION_341_344_oPCAN_RADAR_579254e9_Tx: ComSignalType=UINT16
            DET_RANGE_342_oRDR_DETECTION_341_344_oPCAN_RADAR_33722f17_Tx: ComSignalType=UINT16
            DET_RANGE_343_oRDR_DETECTION_341_344_oPCAN_RADAR_a602fb82_Tx: ComSignalType=UINT16
            DET_RANGE_344_oRDR_DETECTION_341_344_oPCAN_RADAR_fab2d8eb_Tx: ComSignalType=UINT16
            DET_RANGE_ERR_341_oRDR_DETECTION_341_344_oPCAN_RADAR_f07aee80_Tx: ComSignalType=UINT8
            DET_RANGE_ERR_342_oRDR_DETECTION_341_344_oPCAN_RADAR_949a957e_Tx: ComSignalType=UINT8
            DET_RANGE_ERR_343_oRDR_DETECTION_341_344_oPCAN_RADAR_01ea41eb_Tx: ComSignalType=UINT8
            DET_RANGE_ERR_344_oRDR_DETECTION_341_344_oPCAN_RADAR_5d5a6282_Tx: ComSignalType=UINT8
            DET_RANGE_VELOCITY_341_oRDR_DETECTION_341_344_oPCAN_RADAR_223496cc_Tx: ComSignalType=UINT16
            DET_RANGE_VELOCITY_342_oRDR_DETECTION_341_344_oPCAN_RADAR_46d4ed32_Tx: ComSignalType=UINT16
            DET_RANGE_VELOCITY_343_oRDR_DETECTION_341_344_oPCAN_RADAR_d3a439a7_Tx: ComSignalType=UINT16
            DET_RANGE_VELOCITY_344_oRDR_DETECTION_341_344_oPCAN_RADAR_8f141ace_Tx: ComSignalType=UINT16
            DET_RANGE_VELOCITY_ERR_341_oRDR_DETECTION_341_344_oPCAN_RADAR_2d8f6d7e_Tx: ComSignalType=UINT8
            DET_RANGE_VELOCITY_ERR_342_oRDR_DETECTION_341_344_oPCAN_RADAR_496f1680_Tx: ComSignalType=UINT8
            DET_RANGE_VELOCITY_ERR_343_oRDR_DETECTION_341_344_oPCAN_RADAR_dc1fc215_Tx: ComSignalType=UINT8
            DET_RANGE_VELOCITY_ERR_344_oRDR_DETECTION_341_344_oPCAN_RADAR_80afe17c_Tx: ComSignalType=UINT8
            DET_RCS_341_oRDR_DETECTION_341_344_oPCAN_RADAR_a5b4a196_Tx: ComSignalType=UINT8
            DET_RCS_342_oRDR_DETECTION_341_344_oPCAN_RADAR_c154da68_Tx: ComSignalType=UINT8
            DET_RCS_343_oRDR_DETECTION_341_344_oPCAN_RADAR_54240efd_Tx: ComSignalType=UINT8
            DET_RCS_344_oRDR_DETECTION_341_344_oPCAN_RADAR_08942d94_Tx: ComSignalType=UINT8
            DET_SNR_341_oRDR_DETECTION_341_344_oPCAN_RADAR_781af594_Tx: ComSignalType=UINT8
            DET_SNR_342_oRDR_DETECTION_341_344_oPCAN_RADAR_1cfa8e6a_Tx: ComSignalType=UINT8
            DET_SNR_343_oRDR_DETECTION_341_344_oPCAN_RADAR_898a5aff_Tx: ComSignalType=UINT8
            DET_SNR_344_oRDR_DETECTION_341_344_oPCAN_RADAR_d53a7996_Tx: ComSignalType=UINT8
            DET_SUPER_RES_TARGET_341_oRDR_DETECTION_341_344_oPCAN_RADAR_4983ddf1_Tx: ComSignalType=BOOLEAN
            DET_SUPER_RES_TARGET_342_oRDR_DETECTION_341_344_oPCAN_RADAR_2d63a60f_Tx: ComSignalType=BOOLEAN
            DET_SUPER_RES_TARGET_343_oRDR_DETECTION_341_344_oPCAN_RADAR_b813729a_Tx: ComSignalType=BOOLEAN
            DET_SUPER_RES_TARGET_344_oRDR_DETECTION_341_344_oPCAN_RADAR_e4a351f3_Tx: ComSignalType=BOOLEAN
        SG_Detections_345_348_oRDR_DETECTION_345_348_oPCAN_RADAR_03988697_Tx
          83 x ComGroupSignal:
            DET_AZIMUTH_345_oRDR_DETECTION_345_348_oPCAN_RADAR_96ebe1f1_Tx: ComSignalType=UINT16
            DET_AZIMUTH_346_oRDR_DETECTION_345_348_oPCAN_RADAR_f20b9a0f_Tx: ComSignalType=UINT16
            DET_AZIMUTH_347_oRDR_DETECTION_345_348_oPCAN_RADAR_677b4e9a_Tx: ComSignalType=UINT16
            DET_AZIMUTH_348_oRDR_DETECTION_345_348_oPCAN_RADAR_4b6bdcdd_Tx: ComSignalType=UINT16
            DET_AZIMUTH_ERR_345_oRDR_DETECTION_345_348_oPCAN_RADAR_325e7404_Tx: ComSignalType=UINT8
            DET_AZIMUTH_ERR_346_oRDR_DETECTION_345_348_oPCAN_RADAR_56be0ffa_Tx: ComSignalType=UINT8
            DET_AZIMUTH_ERR_347_oRDR_DETECTION_345_348_oPCAN_RADAR_c3cedb6f_Tx: ComSignalType=UINT8
            DET_AZIMUTH_ERR_348_oRDR_DETECTION_345_348_oPCAN_RADAR_efde4928_Tx: ComSignalType=UINT8
            DET_BELOW_RAIN_THOLD_345_oRDR_DETECTION_345_348_oPCAN_RADAR_43ea7231_Tx: ComSignalType=UINT8
            DET_BELOW_RAIN_THOLD_346_oRDR_DETECTION_345_348_oPCAN_RADAR_270a09cf_Tx: ComSignalType=UINT8
            DET_BELOW_RAIN_THOLD_347_oRDR_DETECTION_345_348_oPCAN_RADAR_b27add5a_Tx: ComSignalType=UINT8
            DET_BELOW_RAIN_THOLD_348_oRDR_DETECTION_345_348_oPCAN_RADAR_9e6a4f1d_Tx: ComSignalType=UINT8
            DET_BI_STATIC_FLAG_345_oRDR_DETECTION_345_348_oPCAN_RADAR_c0c7a174_Tx: ComSignalType=BOOLEAN
            DET_BI_STATIC_FLAG_346_oRDR_DETECTION_345_348_oPCAN_RADAR_a427da8a_Tx: ComSignalType=BOOLEAN
            DET_BI_STATIC_FLAG_347_oRDR_DETECTION_345_348_oPCAN_RADAR_31570e1f_Tx: ComSignalType=BOOLEAN
            DET_BI_STATIC_FLAG_348_oRDR_DETECTION_345_348_oPCAN_RADAR_1d479c58_Tx: ComSignalType=BOOLEAN
            DET_CONFD_AZIMUTH_345_oRDR_DETECTION_345_348_oPCAN_RADAR_940deb3b_Tx: ComSignalType=UINT8
            DET_CONFD_AZIMUTH_346_oRDR_DETECTION_345_348_oPCAN_RADAR_f0ed90c5_Tx: ComSignalType=UINT8
            DET_CONFD_AZIMUTH_347_oRDR_DETECTION_345_348_oPCAN_RADAR_659d4450_Tx: ComSignalType=UINT8
            DET_CONFD_AZIMUTH_348_oRDR_DETECTION_345_348_oPCAN_RADAR_498dd617_Tx: ComSignalType=UINT8
            DET_CONFD_ELEVATION_345_oRDR_DETECTION_345_348_oPCAN_RADAR_9698eac1_Tx: ComSignalType=UINT8
            DET_CONFD_ELEVATION_346_oRDR_DETECTION_345_348_oPCAN_RADAR_f278913f_Tx: ComSignalType=UINT8
            DET_CONFD_ELEVATION_347_oRDR_DETECTION_345_348_oPCAN_RADAR_670845aa_Tx: ComSignalType=UINT8
            DET_CONFD_ELEVATION_348_oRDR_DETECTION_345_348_oPCAN_RADAR_4b18d7ed_Tx: ComSignalType=UINT8
            DET_ELEVATION_345_oRDR_DETECTION_345_348_oPCAN_RADAR_47583efd_Tx: ComSignalType=UINT8
            DET_ELEVATION_346_oRDR_DETECTION_345_348_oPCAN_RADAR_23b84503_Tx: ComSignalType=UINT8
            DET_ELEVATION_347_oRDR_DETECTION_345_348_oPCAN_RADAR_b6c89196_Tx: ComSignalType=UINT8
            DET_ELEVATION_348_oRDR_DETECTION_345_348_oPCAN_RADAR_9ad803d1_Tx: ComSignalType=UINT8
            DET_ELEVATION_ERR_345_oRDR_DETECTION_345_348_oPCAN_RADAR_c061a688_Tx: ComSignalType=UINT8
            DET_ELEVATION_ERR_346_oRDR_DETECTION_345_348_oPCAN_RADAR_a481dd76_Tx: ComSignalType=UINT8
            DET_ELEVATION_ERR_347_oRDR_DETECTION_345_348_oPCAN_RADAR_31f109e3_Tx: ComSignalType=UINT8
            DET_ELEVATION_ERR_348_oRDR_DETECTION_345_348_oPCAN_RADAR_1de19ba4_Tx: ComSignalType=UINT8
            DET_EXISTENCE_PROB_345_oRDR_DETECTION_345_348_oPCAN_RADAR_12fed3e8_Tx: ComSignalType=UINT8
            DET_EXISTENCE_PROB_346_oRDR_DETECTION_345_348_oPCAN_RADAR_761ea816_Tx: ComSignalType=UINT8
            DET_EXISTENCE_PROB_347_oRDR_DETECTION_345_348_oPCAN_RADAR_e36e7c83_Tx: ComSignalType=UINT8
            DET_EXISTENCE_PROB_348_oRDR_DETECTION_345_348_oPCAN_RADAR_cf7eeec4_Tx: ComSignalType=UINT8
            DET_HVC_FLAG_345_oRDR_DETECTION_345_348_oPCAN_RADAR_f38a9097_Tx: ComSignalType=BOOLEAN
            DET_HVC_FLAG_346_oRDR_DETECTION_345_348_oPCAN_RADAR_976aeb69_Tx: ComSignalType=BOOLEAN
            DET_HVC_FLAG_347_oRDR_DETECTION_345_348_oPCAN_RADAR_021a3ffc_Tx: ComSignalType=BOOLEAN
            DET_HVC_FLAG_348_oRDR_DETECTION_345_348_oPCAN_RADAR_2e0aadbb_Tx: ComSignalType=BOOLEAN
            DET_IDM_345_oRDR_DETECTION_345_348_oPCAN_RADAR_78d8ab2a_Tx: ComSignalType=UINT8
            DET_IDM_346_oRDR_DETECTION_345_348_oPCAN_RADAR_1c38d0d4_Tx: ComSignalType=UINT8
            DET_IDM_347_oRDR_DETECTION_345_348_oPCAN_RADAR_89480441_Tx: ComSignalType=UINT8
            DET_IDM_348_oRDR_DETECTION_345_348_oPCAN_RADAR_a5589606_Tx: ComSignalType=UINT8
            DET_MH_CRC16_345_348_oRDR_DETECTION_345_348_oPCAN_RADAR_8710549c_Tx: ComSignalType=UINT16
            DET_MH_CYCLE_COUNTER_345_348_oRDR_DETECTION_345_348_oPCAN_RADAR_0365f5ab_Tx: ComSignalType=UINT8
            DET_MH_SCAN_INDEX_4LSB_345_348_oRDR_DETECTION_345_348_oPCAN_RADAR_cf4fd027_Tx: ComSignalType=UINT8
            DET_MTD_345_oRDR_DETECTION_345_348_oPCAN_RADAR_1e6b99f1_Tx: ComSignalType=UINT8
            DET_MTD_346_oRDR_DETECTION_345_348_oPCAN_RADAR_7a8be20f_Tx: ComSignalType=UINT8
            DET_MTD_347_oRDR_DETECTION_345_348_oPCAN_RADAR_effb369a_Tx: ComSignalType=UINT8
            DET_MTD_348_oRDR_DETECTION_345_348_oPCAN_RADAR_c3eba4dd_Tx: ComSignalType=UINT8
            DET_PROB_1STAZHYPO_345_oRDR_DETECTION_345_348_oPCAN_RADAR_8ddf713c_Tx: ComSignalType=BOOLEAN
            DET_PROB_1STAZHYPO_346_oRDR_DETECTION_345_348_oPCAN_RADAR_e93f0ac2_Tx: ComSignalType=BOOLEAN
            DET_PROB_1STAZHYPO_347_oRDR_DETECTION_345_348_oPCAN_RADAR_7c4fde57_Tx: ComSignalType=BOOLEAN
            DET_PROB_1STAZHYPO_348_oRDR_DETECTION_345_348_oPCAN_RADAR_505f4c10_Tx: ComSignalType=BOOLEAN
            DET_RANGE_345_oRDR_DETECTION_345_348_oPCAN_RADAR_8670924a_Tx: ComSignalType=UINT16
            DET_RANGE_346_oRDR_DETECTION_345_348_oPCAN_RADAR_e290e9b4_Tx: ComSignalType=UINT16
            DET_RANGE_347_oRDR_DETECTION_345_348_oPCAN_RADAR_77e03d21_Tx: ComSignalType=UINT16
            DET_RANGE_348_oRDR_DETECTION_345_348_oPCAN_RADAR_5bf0af66_Tx: ComSignalType=UINT16
            DET_RANGE_ERR_345_oRDR_DETECTION_345_348_oPCAN_RADAR_21982823_Tx: ComSignalType=UINT8
            DET_RANGE_ERR_346_oRDR_DETECTION_345_348_oPCAN_RADAR_457853dd_Tx: ComSignalType=UINT8
            DET_RANGE_ERR_347_oRDR_DETECTION_345_348_oPCAN_RADAR_d0088748_Tx: ComSignalType=UINT8
            DET_RANGE_ERR_348_oRDR_DETECTION_345_348_oPCAN_RADAR_fc18150f_Tx: ComSignalType=UINT8
            DET_RANGE_VELOCITY_345_oRDR_DETECTION_345_348_oPCAN_RADAR_f3d6506f_Tx: ComSignalType=UINT16
            DET_RANGE_VELOCITY_346_oRDR_DETECTION_345_348_oPCAN_RADAR_97362b91_Tx: ComSignalType=UINT16
            DET_RANGE_VELOCITY_347_oRDR_DETECTION_345_348_oPCAN_RADAR_0246ff04_Tx: ComSignalType=UINT16
            DET_RANGE_VELOCITY_348_oRDR_DETECTION_345_348_oPCAN_RADAR_2e566d43_Tx: ComSignalType=UINT16
            DET_RANGE_VELOCITY_ERR_345_oRDR_DETECTION_345_348_oPCAN_RADAR_fc6dabdd_Tx: ComSignalType=UINT8
            DET_RANGE_VELOCITY_ERR_346_oRDR_DETECTION_345_348_oPCAN_RADAR_988dd023_Tx: ComSignalType=UINT8
            DET_RANGE_VELOCITY_ERR_347_oRDR_DETECTION_345_348_oPCAN_RADAR_0dfd04b6_Tx: ComSignalType=UINT8
            DET_RANGE_VELOCITY_ERR_348_oRDR_DETECTION_345_348_oPCAN_RADAR_21ed96f1_Tx: ComSignalType=UINT8
            DET_RCS_345_oRDR_DETECTION_345_348_oPCAN_RADAR_74566735_Tx: ComSignalType=UINT8
            DET_RCS_346_oRDR_DETECTION_345_348_oPCAN_RADAR_10b61ccb_Tx: ComSignalType=UINT8
            DET_RCS_347_oRDR_DETECTION_345_348_oPCAN_RADAR_85c6c85e_Tx: ComSignalType=UINT8
            DET_RCS_348_oRDR_DETECTION_345_348_oPCAN_RADAR_a9d65a19_Tx: ComSignalType=UINT8
            DET_SNR_345_oRDR_DETECTION_345_348_oPCAN_RADAR_a9f83337_Tx: ComSignalType=UINT8
            DET_SNR_346_oRDR_DETECTION_345_348_oPCAN_RADAR_cd1848c9_Tx: ComSignalType=UINT8
            DET_SNR_347_oRDR_DETECTION_345_348_oPCAN_RADAR_58689c5c_Tx: ComSignalType=UINT8
            DET_SNR_348_oRDR_DETECTION_345_348_oPCAN_RADAR_74780e1b_Tx: ComSignalType=UINT8
            DET_SUPER_RES_TARGET_345_oRDR_DETECTION_345_348_oPCAN_RADAR_98611b52_Tx: ComSignalType=BOOLEAN
            DET_SUPER_RES_TARGET_346_oRDR_DETECTION_345_348_oPCAN_RADAR_fc8160ac_Tx: ComSignalType=BOOLEAN
            DET_SUPER_RES_TARGET_347_oRDR_DETECTION_345_348_oPCAN_RADAR_69f1b439_Tx: ComSignalType=BOOLEAN
            DET_SUPER_RES_TARGET_348_oRDR_DETECTION_345_348_oPCAN_RADAR_45e1267e_Tx: ComSignalType=BOOLEAN
        SG_Detections_349_352_oRDR_DETECTION_349_352_oPCAN_RADAR_9ae2a2ec_Tx
          83 x ComGroupSignal:
            DET_AZIMUTH_349_oRDR_DETECTION_349_352_oPCAN_RADAR_ec53e749_Tx: ComSignalType=UINT16
            DET_AZIMUTH_350_oRDR_DETECTION_349_352_oPCAN_RADAR_897395ed_Tx: ComSignalType=UINT16
            DET_AZIMUTH_351_oRDR_DETECTION_349_352_oPCAN_RADAR_1c034178_Tx: ComSignalType=UINT16
            DET_AZIMUTH_352_oRDR_DETECTION_349_352_oPCAN_RADAR_78e33a86_Tx: ComSignalType=UINT16
            DET_AZIMUTH_ERR_349_oRDR_DETECTION_349_352_oPCAN_RADAR_48e672bc_Tx: ComSignalType=UINT8
            DET_AZIMUTH_ERR_350_oRDR_DETECTION_349_352_oPCAN_RADAR_2dc60018_Tx: ComSignalType=UINT8
            DET_AZIMUTH_ERR_351_oRDR_DETECTION_349_352_oPCAN_RADAR_b8b6d48d_Tx: ComSignalType=UINT8
            DET_AZIMUTH_ERR_352_oRDR_DETECTION_349_352_oPCAN_RADAR_dc56af73_Tx: ComSignalType=UINT8
            DET_BELOW_RAIN_THOLD_349_oRDR_DETECTION_349_352_oPCAN_RADAR_39527489_Tx: ComSignalType=UINT8
            DET_BELOW_RAIN_THOLD_350_oRDR_DETECTION_349_352_oPCAN_RADAR_5c72062d_Tx: ComSignalType=UINT8
            DET_BELOW_RAIN_THOLD_351_oRDR_DETECTION_349_352_oPCAN_RADAR_c902d2b8_Tx: ComSignalType=UINT8
            DET_BELOW_RAIN_THOLD_352_oRDR_DETECTION_349_352_oPCAN_RADAR_ade2a946_Tx: ComSignalType=UINT8
            DET_BI_STATIC_FLAG_349_oRDR_DETECTION_349_352_oPCAN_RADAR_ba7fa7cc_Tx: ComSignalType=BOOLEAN
            DET_BI_STATIC_FLAG_350_oRDR_DETECTION_349_352_oPCAN_RADAR_df5fd568_Tx: ComSignalType=BOOLEAN
            DET_BI_STATIC_FLAG_351_oRDR_DETECTION_349_352_oPCAN_RADAR_4a2f01fd_Tx: ComSignalType=BOOLEAN
            DET_BI_STATIC_FLAG_352_oRDR_DETECTION_349_352_oPCAN_RADAR_2ecf7a03_Tx: ComSignalType=BOOLEAN
            DET_CONFD_AZIMUTH_349_oRDR_DETECTION_349_352_oPCAN_RADAR_eeb5ed83_Tx: ComSignalType=UINT8
            DET_CONFD_AZIMUTH_350_oRDR_DETECTION_349_352_oPCAN_RADAR_8b959f27_Tx: ComSignalType=UINT8
            DET_CONFD_AZIMUTH_351_oRDR_DETECTION_349_352_oPCAN_RADAR_1ee54bb2_Tx: ComSignalType=UINT8
            DET_CONFD_AZIMUTH_352_oRDR_DETECTION_349_352_oPCAN_RADAR_7a05304c_Tx: ComSignalType=UINT8
            DET_CONFD_ELEVATION_349_oRDR_DETECTION_349_352_oPCAN_RADAR_ec20ec79_Tx: ComSignalType=UINT8
            DET_CONFD_ELEVATION_350_oRDR_DETECTION_349_352_oPCAN_RADAR_89009edd_Tx: ComSignalType=UINT8
            DET_CONFD_ELEVATION_351_oRDR_DETECTION_349_352_oPCAN_RADAR_1c704a48_Tx: ComSignalType=UINT8
            DET_CONFD_ELEVATION_352_oRDR_DETECTION_349_352_oPCAN_RADAR_789031b6_Tx: ComSignalType=UINT8
            DET_ELEVATION_349_oRDR_DETECTION_349_352_oPCAN_RADAR_3de03845_Tx: ComSignalType=UINT8
            DET_ELEVATION_350_oRDR_DETECTION_349_352_oPCAN_RADAR_58c04ae1_Tx: ComSignalType=UINT8
            DET_ELEVATION_351_oRDR_DETECTION_349_352_oPCAN_RADAR_cdb09e74_Tx: ComSignalType=UINT8
            DET_ELEVATION_352_oRDR_DETECTION_349_352_oPCAN_RADAR_a950e58a_Tx: ComSignalType=UINT8
            DET_ELEVATION_ERR_349_oRDR_DETECTION_349_352_oPCAN_RADAR_bad9a030_Tx: ComSignalType=UINT8
            DET_ELEVATION_ERR_350_oRDR_DETECTION_349_352_oPCAN_RADAR_dff9d294_Tx: ComSignalType=UINT8
            DET_ELEVATION_ERR_351_oRDR_DETECTION_349_352_oPCAN_RADAR_4a890601_Tx: ComSignalType=UINT8
            DET_ELEVATION_ERR_352_oRDR_DETECTION_349_352_oPCAN_RADAR_2e697dff_Tx: ComSignalType=UINT8
            DET_EXISTENCE_PROB_349_oRDR_DETECTION_349_352_oPCAN_RADAR_6846d550_Tx: ComSignalType=UINT8
            DET_EXISTENCE_PROB_350_oRDR_DETECTION_349_352_oPCAN_RADAR_0d66a7f4_Tx: ComSignalType=UINT8
            DET_EXISTENCE_PROB_351_oRDR_DETECTION_349_352_oPCAN_RADAR_98167361_Tx: ComSignalType=UINT8
            DET_EXISTENCE_PROB_352_oRDR_DETECTION_349_352_oPCAN_RADAR_fcf6089f_Tx: ComSignalType=UINT8
            DET_HVC_FLAG_349_oRDR_DETECTION_349_352_oPCAN_RADAR_8932962f_Tx: ComSignalType=BOOLEAN
            DET_HVC_FLAG_350_oRDR_DETECTION_349_352_oPCAN_RADAR_ec12e48b_Tx: ComSignalType=BOOLEAN
            DET_HVC_FLAG_351_oRDR_DETECTION_349_352_oPCAN_RADAR_7962301e_Tx: ComSignalType=BOOLEAN
            DET_HVC_FLAG_352_oRDR_DETECTION_349_352_oPCAN_RADAR_1d824be0_Tx: ComSignalType=BOOLEAN
            DET_IDM_349_oRDR_DETECTION_349_352_oPCAN_RADAR_0260ad92_Tx: ComSignalType=UINT8
            DET_IDM_350_oRDR_DETECTION_349_352_oPCAN_RADAR_6740df36_Tx: ComSignalType=UINT8
            DET_IDM_351_oRDR_DETECTION_349_352_oPCAN_RADAR_f2300ba3_Tx: ComSignalType=UINT8
            DET_IDM_352_oRDR_DETECTION_349_352_oPCAN_RADAR_96d0705d_Tx: ComSignalType=UINT8
            DET_MH_CRC16_349_352_oRDR_DETECTION_349_352_oPCAN_RADAR_1e6a70e7_Tx: ComSignalType=UINT16
            DET_MH_CYCLE_COUNTER_349_352_oRDR_DETECTION_349_352_oPCAN_RADAR_9a1fd1d0_Tx: ComSignalType=UINT8
            DET_MH_SCAN_INDEX_4LSB_349_352_oRDR_DETECTION_349_352_oPCAN_RADAR_5635f45c_Tx: ComSignalType=UINT8
            DET_MTD_349_oRDR_DETECTION_349_352_oPCAN_RADAR_64d39f49_Tx: ComSignalType=UINT8
            DET_MTD_350_oRDR_DETECTION_349_352_oPCAN_RADAR_01f3eded_Tx: ComSignalType=UINT8
            DET_MTD_351_oRDR_DETECTION_349_352_oPCAN_RADAR_94833978_Tx: ComSignalType=UINT8
            DET_MTD_352_oRDR_DETECTION_349_352_oPCAN_RADAR_f0634286_Tx: ComSignalType=UINT8
            DET_PROB_1STAZHYPO_349_oRDR_DETECTION_349_352_oPCAN_RADAR_f7677784_Tx: ComSignalType=BOOLEAN
            DET_PROB_1STAZHYPO_350_oRDR_DETECTION_349_352_oPCAN_RADAR_92470520_Tx: ComSignalType=BOOLEAN
            DET_PROB_1STAZHYPO_351_oRDR_DETECTION_349_352_oPCAN_RADAR_0737d1b5_Tx: ComSignalType=BOOLEAN
            DET_PROB_1STAZHYPO_352_oRDR_DETECTION_349_352_oPCAN_RADAR_63d7aa4b_Tx: ComSignalType=BOOLEAN
            DET_RANGE_349_oRDR_DETECTION_349_352_oPCAN_RADAR_fcc894f2_Tx: ComSignalType=UINT16
            DET_RANGE_350_oRDR_DETECTION_349_352_oPCAN_RADAR_99e8e656_Tx: ComSignalType=UINT16
            DET_RANGE_351_oRDR_DETECTION_349_352_oPCAN_RADAR_0c9832c3_Tx: ComSignalType=UINT16
            DET_RANGE_352_oRDR_DETECTION_349_352_oPCAN_RADAR_6878493d_Tx: ComSignalType=UINT16
            DET_RANGE_ERR_349_oRDR_DETECTION_349_352_oPCAN_RADAR_5b202e9b_Tx: ComSignalType=UINT8
            DET_RANGE_ERR_350_oRDR_DETECTION_349_352_oPCAN_RADAR_3e005c3f_Tx: ComSignalType=UINT8
            DET_RANGE_ERR_351_oRDR_DETECTION_349_352_oPCAN_RADAR_ab7088aa_Tx: ComSignalType=UINT8
            DET_RANGE_ERR_352_oRDR_DETECTION_349_352_oPCAN_RADAR_cf90f354_Tx: ComSignalType=UINT8
            DET_RANGE_VELOCITY_349_oRDR_DETECTION_349_352_oPCAN_RADAR_896e56d7_Tx: ComSignalType=UINT16
            DET_RANGE_VELOCITY_350_oRDR_DETECTION_349_352_oPCAN_RADAR_ec4e2473_Tx: ComSignalType=UINT16
            DET_RANGE_VELOCITY_351_oRDR_DETECTION_349_352_oPCAN_RADAR_793ef0e6_Tx: ComSignalType=UINT16
            DET_RANGE_VELOCITY_352_oRDR_DETECTION_349_352_oPCAN_RADAR_1dde8b18_Tx: ComSignalType=UINT16
            DET_RANGE_VELOCITY_ERR_349_oRDR_DETECTION_349_352_oPCAN_RADAR_86d5ad65_Tx: ComSignalType=UINT8
            DET_RANGE_VELOCITY_ERR_350_oRDR_DETECTION_349_352_oPCAN_RADAR_e3f5dfc1_Tx: ComSignalType=UINT8
            DET_RANGE_VELOCITY_ERR_351_oRDR_DETECTION_349_352_oPCAN_RADAR_76850b54_Tx: ComSignalType=UINT8
            DET_RANGE_VELOCITY_ERR_352_oRDR_DETECTION_349_352_oPCAN_RADAR_126570aa_Tx: ComSignalType=UINT8
            DET_RCS_349_oRDR_DETECTION_349_352_oPCAN_RADAR_0eee618d_Tx: ComSignalType=UINT8
            DET_RCS_350_oRDR_DETECTION_349_352_oPCAN_RADAR_6bce1329_Tx: ComSignalType=UINT8
            DET_RCS_351_oRDR_DETECTION_349_352_oPCAN_RADAR_febec7bc_Tx: ComSignalType=UINT8
            DET_RCS_352_oRDR_DETECTION_349_352_oPCAN_RADAR_9a5ebc42_Tx: ComSignalType=UINT8
            DET_SNR_349_oRDR_DETECTION_349_352_oPCAN_RADAR_d340358f_Tx: ComSignalType=UINT8
            DET_SNR_350_oRDR_DETECTION_349_352_oPCAN_RADAR_b660472b_Tx: ComSignalType=UINT8
            DET_SNR_351_oRDR_DETECTION_349_352_oPCAN_RADAR_231093be_Tx: ComSignalType=UINT8
            DET_SNR_352_oRDR_DETECTION_349_352_oPCAN_RADAR_47f0e840_Tx: ComSignalType=UINT8
            DET_SUPER_RES_TARGET_349_oRDR_DETECTION_349_352_oPCAN_RADAR_e2d91dea_Tx: ComSignalType=BOOLEAN
            DET_SUPER_RES_TARGET_350_oRDR_DETECTION_349_352_oPCAN_RADAR_87f96f4e_Tx: ComSignalType=BOOLEAN
            DET_SUPER_RES_TARGET_351_oRDR_DETECTION_349_352_oPCAN_RADAR_1289bbdb_Tx: ComSignalType=BOOLEAN
            DET_SUPER_RES_TARGET_352_oRDR_DETECTION_349_352_oPCAN_RADAR_7669c025_Tx: ComSignalType=BOOLEAN
        SG_Detections_353_356_oRDR_DETECTION_353_356_oPCAN_RADAR_a8e9cac4_Tx
          83 x ComGroupSignal:
            DET_AZIMUTH_353_oRDR_DETECTION_353_356_oPCAN_RADAR_f054ed3d_Tx: ComSignalType=UINT16
            DET_AZIMUTH_354_oRDR_DETECTION_353_356_oPCAN_RADAR_ace4ce54_Tx: ComSignalType=UINT16
            DET_AZIMUTH_355_oRDR_DETECTION_353_356_oPCAN_RADAR_39941ac1_Tx: ComSignalType=UINT16
            DET_AZIMUTH_356_oRDR_DETECTION_353_356_oPCAN_RADAR_5d74613f_Tx: ComSignalType=UINT16
            DET_AZIMUTH_ERR_353_oRDR_DETECTION_353_356_oPCAN_RADAR_54e178c8_Tx: ComSignalType=UINT8
            DET_AZIMUTH_ERR_354_oRDR_DETECTION_353_356_oPCAN_RADAR_08515ba1_Tx: ComSignalType=UINT8
            DET_AZIMUTH_ERR_355_oRDR_DETECTION_353_356_oPCAN_RADAR_9d218f34_Tx: ComSignalType=UINT8
            DET_AZIMUTH_ERR_356_oRDR_DETECTION_353_356_oPCAN_RADAR_f9c1f4ca_Tx: ComSignalType=UINT8
            DET_BELOW_RAIN_THOLD_353_oRDR_DETECTION_353_356_oPCAN_RADAR_25557efd_Tx: ComSignalType=UINT8
            DET_BELOW_RAIN_THOLD_354_oRDR_DETECTION_353_356_oPCAN_RADAR_79e55d94_Tx: ComSignalType=UINT8
            DET_BELOW_RAIN_THOLD_355_oRDR_DETECTION_353_356_oPCAN_RADAR_ec958901_Tx: ComSignalType=UINT8
            DET_BELOW_RAIN_THOLD_356_oRDR_DETECTION_353_356_oPCAN_RADAR_8875f2ff_Tx: ComSignalType=UINT8
            DET_BI_STATIC_FLAG_353_oRDR_DETECTION_353_356_oPCAN_RADAR_a678adb8_Tx: ComSignalType=BOOLEAN
            DET_BI_STATIC_FLAG_354_oRDR_DETECTION_353_356_oPCAN_RADAR_fac88ed1_Tx: ComSignalType=BOOLEAN
            DET_BI_STATIC_FLAG_355_oRDR_DETECTION_353_356_oPCAN_RADAR_6fb85a44_Tx: ComSignalType=BOOLEAN
            DET_BI_STATIC_FLAG_356_oRDR_DETECTION_353_356_oPCAN_RADAR_0b5821ba_Tx: ComSignalType=BOOLEAN
            DET_CONFD_AZIMUTH_353_oRDR_DETECTION_353_356_oPCAN_RADAR_f2b2e7f7_Tx: ComSignalType=UINT8
            DET_CONFD_AZIMUTH_354_oRDR_DETECTION_353_356_oPCAN_RADAR_ae02c49e_Tx: ComSignalType=UINT8
            DET_CONFD_AZIMUTH_355_oRDR_DETECTION_353_356_oPCAN_RADAR_3b72100b_Tx: ComSignalType=UINT8
            DET_CONFD_AZIMUTH_356_oRDR_DETECTION_353_356_oPCAN_RADAR_5f926bf5_Tx: ComSignalType=UINT8
            DET_CONFD_ELEVATION_353_oRDR_DETECTION_353_356_oPCAN_RADAR_f027e60d_Tx: ComSignalType=UINT8
            DET_CONFD_ELEVATION_354_oRDR_DETECTION_353_356_oPCAN_RADAR_ac97c564_Tx: ComSignalType=UINT8
            DET_CONFD_ELEVATION_355_oRDR_DETECTION_353_356_oPCAN_RADAR_39e711f1_Tx: ComSignalType=UINT8
            DET_CONFD_ELEVATION_356_oRDR_DETECTION_353_356_oPCAN_RADAR_5d076a0f_Tx: ComSignalType=UINT8
            DET_ELEVATION_353_oRDR_DETECTION_353_356_oPCAN_RADAR_21e73231_Tx: ComSignalType=UINT8
            DET_ELEVATION_354_oRDR_DETECTION_353_356_oPCAN_RADAR_7d571158_Tx: ComSignalType=UINT8
            DET_ELEVATION_355_oRDR_DETECTION_353_356_oPCAN_RADAR_e827c5cd_Tx: ComSignalType=UINT8
            DET_ELEVATION_356_oRDR_DETECTION_353_356_oPCAN_RADAR_8cc7be33_Tx: ComSignalType=UINT8
            DET_ELEVATION_ERR_353_oRDR_DETECTION_353_356_oPCAN_RADAR_a6deaa44_Tx: ComSignalType=UINT8
            DET_ELEVATION_ERR_354_oRDR_DETECTION_353_356_oPCAN_RADAR_fa6e892d_Tx: ComSignalType=UINT8
            DET_ELEVATION_ERR_355_oRDR_DETECTION_353_356_oPCAN_RADAR_6f1e5db8_Tx: ComSignalType=UINT8
            DET_ELEVATION_ERR_356_oRDR_DETECTION_353_356_oPCAN_RADAR_0bfe2646_Tx: ComSignalType=UINT8
            DET_EXISTENCE_PROB_353_oRDR_DETECTION_353_356_oPCAN_RADAR_7441df24_Tx: ComSignalType=UINT8
            DET_EXISTENCE_PROB_354_oRDR_DETECTION_353_356_oPCAN_RADAR_28f1fc4d_Tx: ComSignalType=UINT8
            DET_EXISTENCE_PROB_355_oRDR_DETECTION_353_356_oPCAN_RADAR_bd8128d8_Tx: ComSignalType=UINT8
            DET_EXISTENCE_PROB_356_oRDR_DETECTION_353_356_oPCAN_RADAR_d9615326_Tx: ComSignalType=UINT8
            DET_HVC_FLAG_353_oRDR_DETECTION_353_356_oPCAN_RADAR_95359c5b_Tx: ComSignalType=BOOLEAN
            DET_HVC_FLAG_354_oRDR_DETECTION_353_356_oPCAN_RADAR_c985bf32_Tx: ComSignalType=BOOLEAN
            DET_HVC_FLAG_355_oRDR_DETECTION_353_356_oPCAN_RADAR_5cf56ba7_Tx: ComSignalType=BOOLEAN
            DET_HVC_FLAG_356_oRDR_DETECTION_353_356_oPCAN_RADAR_38151059_Tx: ComSignalType=BOOLEAN
            DET_IDM_353_oRDR_DETECTION_353_356_oPCAN_RADAR_1e67a7e6_Tx: ComSignalType=UINT8
            DET_IDM_354_oRDR_DETECTION_353_356_oPCAN_RADAR_42d7848f_Tx: ComSignalType=UINT8
            DET_IDM_355_oRDR_DETECTION_353_356_oPCAN_RADAR_d7a7501a_Tx: ComSignalType=UINT8
            DET_IDM_356_oRDR_DETECTION_353_356_oPCAN_RADAR_b3472be4_Tx: ComSignalType=UINT8
            DET_MH_CRC16_353_356_oRDR_DETECTION_353_356_oPCAN_RADAR_2c6118cf_Tx: ComSignalType=UINT16
            DET_MH_CYCLE_COUNTER_353_356_oRDR_DETECTION_353_356_oPCAN_RADAR_a814b9f8_Tx: ComSignalType=UINT8
            DET_MH_SCAN_INDEX_4LSB_353_356_oRDR_DETECTION_353_356_oPCAN_RADAR_643e9c74_Tx: ComSignalType=UINT8
            DET_MTD_353_oRDR_DETECTION_353_356_oPCAN_RADAR_78d4953d_Tx: ComSignalType=UINT8
            DET_MTD_354_oRDR_DETECTION_353_356_oPCAN_RADAR_2464b654_Tx: ComSignalType=UINT8
            DET_MTD_355_oRDR_DETECTION_353_356_oPCAN_RADAR_b11462c1_Tx: ComSignalType=UINT8
            DET_MTD_356_oRDR_DETECTION_353_356_oPCAN_RADAR_d5f4193f_Tx: ComSignalType=UINT8
            DET_PROB_1STAZHYPO_353_oRDR_DETECTION_353_356_oPCAN_RADAR_eb607df0_Tx: ComSignalType=BOOLEAN
            DET_PROB_1STAZHYPO_354_oRDR_DETECTION_353_356_oPCAN_RADAR_b7d05e99_Tx: ComSignalType=BOOLEAN
            DET_PROB_1STAZHYPO_355_oRDR_DETECTION_353_356_oPCAN_RADAR_22a08a0c_Tx: ComSignalType=BOOLEAN
            DET_PROB_1STAZHYPO_356_oRDR_DETECTION_353_356_oPCAN_RADAR_4640f1f2_Tx: ComSignalType=BOOLEAN
            DET_RANGE_353_oRDR_DETECTION_353_356_oPCAN_RADAR_e0cf9e86_Tx: ComSignalType=UINT16
            DET_RANGE_354_oRDR_DETECTION_353_356_oPCAN_RADAR_bc7fbdef_Tx: ComSignalType=UINT16
            DET_RANGE_355_oRDR_DETECTION_353_356_oPCAN_RADAR_290f697a_Tx: ComSignalType=UINT16
            DET_RANGE_356_oRDR_DETECTION_353_356_oPCAN_RADAR_4def1284_Tx: ComSignalType=UINT16
            DET_RANGE_ERR_353_oRDR_DETECTION_353_356_oPCAN_RADAR_472724ef_Tx: ComSignalType=UINT8
            DET_RANGE_ERR_354_oRDR_DETECTION_353_356_oPCAN_RADAR_1b970786_Tx: ComSignalType=UINT8
            DET_RANGE_ERR_355_oRDR_DETECTION_353_356_oPCAN_RADAR_8ee7d313_Tx: ComSignalType=UINT8
            DET_RANGE_ERR_356_oRDR_DETECTION_353_356_oPCAN_RADAR_ea07a8ed_Tx: ComSignalType=UINT8
            DET_RANGE_VELOCITY_353_oRDR_DETECTION_353_356_oPCAN_RADAR_95695ca3_Tx: ComSignalType=UINT16
            DET_RANGE_VELOCITY_354_oRDR_DETECTION_353_356_oPCAN_RADAR_c9d97fca_Tx: ComSignalType=UINT16
            DET_RANGE_VELOCITY_355_oRDR_DETECTION_353_356_oPCAN_RADAR_5ca9ab5f_Tx: ComSignalType=UINT16
            DET_RANGE_VELOCITY_356_oRDR_DETECTION_353_356_oPCAN_RADAR_3849d0a1_Tx: ComSignalType=UINT16
            DET_RANGE_VELOCITY_ERR_353_oRDR_DETECTION_353_356_oPCAN_RADAR_9ad2a711_Tx: ComSignalType=UINT8
            DET_RANGE_VELOCITY_ERR_354_oRDR_DETECTION_353_356_oPCAN_RADAR_c6628478_Tx: ComSignalType=UINT8
            DET_RANGE_VELOCITY_ERR_355_oRDR_DETECTION_353_356_oPCAN_RADAR_531250ed_Tx: ComSignalType=UINT8
            DET_RANGE_VELOCITY_ERR_356_oRDR_DETECTION_353_356_oPCAN_RADAR_37f22b13_Tx: ComSignalType=UINT8
            DET_RCS_353_oRDR_DETECTION_353_356_oPCAN_RADAR_12e96bf9_Tx: ComSignalType=UINT8
            DET_RCS_354_oRDR_DETECTION_353_356_oPCAN_RADAR_4e594890_Tx: ComSignalType=UINT8
            DET_RCS_355_oRDR_DETECTION_353_356_oPCAN_RADAR_db299c05_Tx: ComSignalType=UINT8
            DET_RCS_356_oRDR_DETECTION_353_356_oPCAN_RADAR_bfc9e7fb_Tx: ComSignalType=UINT8
            DET_SNR_353_oRDR_DETECTION_353_356_oPCAN_RADAR_cf473ffb_Tx: ComSignalType=UINT8
            DET_SNR_354_oRDR_DETECTION_353_356_oPCAN_RADAR_93f71c92_Tx: ComSignalType=UINT8
            DET_SNR_355_oRDR_DETECTION_353_356_oPCAN_RADAR_0687c807_Tx: ComSignalType=UINT8
            DET_SNR_356_oRDR_DETECTION_353_356_oPCAN_RADAR_6267b3f9_Tx: ComSignalType=UINT8
            DET_SUPER_RES_TARGET_353_oRDR_DETECTION_353_356_oPCAN_RADAR_fede179e_Tx: ComSignalType=BOOLEAN
            DET_SUPER_RES_TARGET_354_oRDR_DETECTION_353_356_oPCAN_RADAR_a26e34f7_Tx: ComSignalType=BOOLEAN
            DET_SUPER_RES_TARGET_355_oRDR_DETECTION_353_356_oPCAN_RADAR_371ee062_Tx: ComSignalType=BOOLEAN
            DET_SUPER_RES_TARGET_356_oRDR_DETECTION_353_356_oPCAN_RADAR_53fe9b9c_Tx: ComSignalType=BOOLEAN
        SG_Detections_357_360_oRDR_DETECTION_357_360_oPCAN_RADAR_44459c4e_Tx
          83 x ComGroupSignal:
            DET_AZIMUTH_357_oRDR_DETECTION_357_360_oPCAN_RADAR_67886863_Tx: ComSignalType=UINT16
            DET_AZIMUTH_358_oRDR_DETECTION_357_360_oPCAN_RADAR_4b98fa24_Tx: ComSignalType=UINT16
            DET_AZIMUTH_359_oRDR_DETECTION_357_360_oPCAN_RADAR_dee82eb1_Tx: ComSignalType=UINT16
            DET_AZIMUTH_360_oRDR_DETECTION_357_360_oPCAN_RADAR_6159746a_Tx: ComSignalType=UINT16
            DET_AZIMUTH_ERR_357_oRDR_DETECTION_357_360_oPCAN_RADAR_c33dfd96_Tx: ComSignalType=UINT8
            DET_AZIMUTH_ERR_358_oRDR_DETECTION_357_360_oPCAN_RADAR_ef2d6fd1_Tx: ComSignalType=UINT8
            DET_AZIMUTH_ERR_359_oRDR_DETECTION_357_360_oPCAN_RADAR_7a5dbb44_Tx: ComSignalType=UINT8
            DET_AZIMUTH_ERR_360_oRDR_DETECTION_357_360_oPCAN_RADAR_c5ece19f_Tx: ComSignalType=UINT8
            DET_BELOW_RAIN_THOLD_357_oRDR_DETECTION_357_360_oPCAN_RADAR_b289fba3_Tx: ComSignalType=UINT8
            DET_BELOW_RAIN_THOLD_358_oRDR_DETECTION_357_360_oPCAN_RADAR_9e9969e4_Tx: ComSignalType=UINT8
            DET_BELOW_RAIN_THOLD_359_oRDR_DETECTION_357_360_oPCAN_RADAR_0be9bd71_Tx: ComSignalType=UINT8
            DET_BELOW_RAIN_THOLD_360_oRDR_DETECTION_357_360_oPCAN_RADAR_b458e7aa_Tx: ComSignalType=UINT8
            DET_BI_STATIC_FLAG_357_oRDR_DETECTION_357_360_oPCAN_RADAR_31a428e6_Tx: ComSignalType=BOOLEAN
            DET_BI_STATIC_FLAG_358_oRDR_DETECTION_357_360_oPCAN_RADAR_1db4baa1_Tx: ComSignalType=BOOLEAN
            DET_BI_STATIC_FLAG_359_oRDR_DETECTION_357_360_oPCAN_RADAR_88c46e34_Tx: ComSignalType=BOOLEAN
            DET_BI_STATIC_FLAG_360_oRDR_DETECTION_357_360_oPCAN_RADAR_377534ef_Tx: ComSignalType=BOOLEAN
            DET_CONFD_AZIMUTH_357_oRDR_DETECTION_357_360_oPCAN_RADAR_656e62a9_Tx: ComSignalType=UINT8
            DET_CONFD_AZIMUTH_358_oRDR_DETECTION_357_360_oPCAN_RADAR_497ef0ee_Tx: ComSignalType=UINT8
            DET_CONFD_AZIMUTH_359_oRDR_DETECTION_357_360_oPCAN_RADAR_dc0e247b_Tx: ComSignalType=UINT8
            DET_CONFD_AZIMUTH_360_oRDR_DETECTION_357_360_oPCAN_RADAR_63bf7ea0_Tx: ComSignalType=UINT8
            DET_CONFD_ELEVATION_357_oRDR_DETECTION_357_360_oPCAN_RADAR_67fb6353_Tx: ComSignalType=UINT8
            DET_CONFD_ELEVATION_358_oRDR_DETECTION_357_360_oPCAN_RADAR_4bebf114_Tx: ComSignalType=UINT8
            DET_CONFD_ELEVATION_359_oRDR_DETECTION_357_360_oPCAN_RADAR_de9b2581_Tx: ComSignalType=UINT8
            DET_CONFD_ELEVATION_360_oRDR_DETECTION_357_360_oPCAN_RADAR_612a7f5a_Tx: ComSignalType=UINT8
            DET_ELEVATION_357_oRDR_DETECTION_357_360_oPCAN_RADAR_b63bb76f_Tx: ComSignalType=UINT8
            DET_ELEVATION_358_oRDR_DETECTION_357_360_oPCAN_RADAR_9a2b2528_Tx: ComSignalType=UINT8
            DET_ELEVATION_359_oRDR_DETECTION_357_360_oPCAN_RADAR_0f5bf1bd_Tx: ComSignalType=UINT8
            DET_ELEVATION_360_oRDR_DETECTION_357_360_oPCAN_RADAR_b0eaab66_Tx: ComSignalType=UINT8
            DET_ELEVATION_ERR_357_oRDR_DETECTION_357_360_oPCAN_RADAR_31022f1a_Tx: ComSignalType=UINT8
            DET_ELEVATION_ERR_358_oRDR_DETECTION_357_360_oPCAN_RADAR_1d12bd5d_Tx: ComSignalType=UINT8
            DET_ELEVATION_ERR_359_oRDR_DETECTION_357_360_oPCAN_RADAR_886269c8_Tx: ComSignalType=UINT8
            DET_ELEVATION_ERR_360_oRDR_DETECTION_357_360_oPCAN_RADAR_37d33313_Tx: ComSignalType=UINT8
            DET_EXISTENCE_PROB_357_oRDR_DETECTION_357_360_oPCAN_RADAR_e39d5a7a_Tx: ComSignalType=UINT8
            DET_EXISTENCE_PROB_358_oRDR_DETECTION_357_360_oPCAN_RADAR_cf8dc83d_Tx: ComSignalType=UINT8
            DET_EXISTENCE_PROB_359_oRDR_DETECTION_357_360_oPCAN_RADAR_5afd1ca8_Tx: ComSignalType=UINT8
            DET_EXISTENCE_PROB_360_oRDR_DETECTION_357_360_oPCAN_RADAR_e54c4673_Tx: ComSignalType=UINT8
            DET_HVC_FLAG_357_oRDR_DETECTION_357_360_oPCAN_RADAR_02e91905_Tx: ComSignalType=BOOLEAN
            DET_HVC_FLAG_358_oRDR_DETECTION_357_360_oPCAN_RADAR_2ef98b42_Tx: ComSignalType=BOOLEAN
            DET_HVC_FLAG_359_oRDR_DETECTION_357_360_oPCAN_RADAR_bb895fd7_Tx: ComSignalType=BOOLEAN
            DET_HVC_FLAG_360_oRDR_DETECTION_357_360_oPCAN_RADAR_0438050c_Tx: ComSignalType=BOOLEAN
            DET_IDM_357_oRDR_DETECTION_357_360_oPCAN_RADAR_89bb22b8_Tx: ComSignalType=UINT8
            DET_IDM_358_oRDR_DETECTION_357_360_oPCAN_RADAR_a5abb0ff_Tx: ComSignalType=UINT8
            DET_IDM_359_oRDR_DETECTION_357_360_oPCAN_RADAR_30db646a_Tx: ComSignalType=UINT8
            DET_IDM_360_oRDR_DETECTION_357_360_oPCAN_RADAR_8f6a3eb1_Tx: ComSignalType=UINT8
            DET_MH_CRC16_357_360_oRDR_DETECTION_357_360_oPCAN_RADAR_c0cd4e45_Tx: ComSignalType=UINT16
            DET_MH_CYCLE_COUNTER_357_360_oRDR_DETECTION_357_360_oPCAN_RADAR_44b8ef72_Tx: ComSignalType=UINT8
            DET_MH_SCAN_INDEX_4LSB_357_360_oRDR_DETECTION_357_360_oPCAN_RADAR_8892cafe_Tx: ComSignalType=UINT8
            DET_MTD_357_oRDR_DETECTION_357_360_oPCAN_RADAR_ef081063_Tx: ComSignalType=UINT8
            DET_MTD_358_oRDR_DETECTION_357_360_oPCAN_RADAR_c3188224_Tx: ComSignalType=UINT8
            DET_MTD_359_oRDR_DETECTION_357_360_oPCAN_RADAR_566856b1_Tx: ComSignalType=UINT8
            DET_MTD_360_oRDR_DETECTION_357_360_oPCAN_RADAR_e9d90c6a_Tx: ComSignalType=UINT8
            DET_PROB_1STAZHYPO_357_oRDR_DETECTION_357_360_oPCAN_RADAR_7cbcf8ae_Tx: ComSignalType=BOOLEAN
            DET_PROB_1STAZHYPO_358_oRDR_DETECTION_357_360_oPCAN_RADAR_50ac6ae9_Tx: ComSignalType=BOOLEAN
            DET_PROB_1STAZHYPO_359_oRDR_DETECTION_357_360_oPCAN_RADAR_c5dcbe7c_Tx: ComSignalType=BOOLEAN
            DET_PROB_1STAZHYPO_360_oRDR_DETECTION_357_360_oPCAN_RADAR_7a6de4a7_Tx: ComSignalType=BOOLEAN
            DET_RANGE_357_oRDR_DETECTION_357_360_oPCAN_RADAR_77131bd8_Tx: ComSignalType=UINT16
            DET_RANGE_358_oRDR_DETECTION_357_360_oPCAN_RADAR_5b03899f_Tx: ComSignalType=UINT16
            DET_RANGE_359_oRDR_DETECTION_357_360_oPCAN_RADAR_ce735d0a_Tx: ComSignalType=UINT16
            DET_RANGE_360_oRDR_DETECTION_357_360_oPCAN_RADAR_71c207d1_Tx: ComSignalType=UINT16
            DET_RANGE_ERR_357_oRDR_DETECTION_357_360_oPCAN_RADAR_d0fba1b1_Tx: ComSignalType=UINT8
            DET_RANGE_ERR_358_oRDR_DETECTION_357_360_oPCAN_RADAR_fceb33f6_Tx: ComSignalType=UINT8
            DET_RANGE_ERR_359_oRDR_DETECTION_357_360_oPCAN_RADAR_699be763_Tx: ComSignalType=UINT8
            DET_RANGE_ERR_360_oRDR_DETECTION_357_360_oPCAN_RADAR_d62abdb8_Tx: ComSignalType=UINT8
            DET_RANGE_VELOCITY_357_oRDR_DETECTION_357_360_oPCAN_RADAR_02b5d9fd_Tx: ComSignalType=UINT16
            DET_RANGE_VELOCITY_358_oRDR_DETECTION_357_360_oPCAN_RADAR_2ea54bba_Tx: ComSignalType=UINT16
            DET_RANGE_VELOCITY_359_oRDR_DETECTION_357_360_oPCAN_RADAR_bbd59f2f_Tx: ComSignalType=UINT16
            DET_RANGE_VELOCITY_360_oRDR_DETECTION_357_360_oPCAN_RADAR_0464c5f4_Tx: ComSignalType=UINT16
            DET_RANGE_VELOCITY_ERR_357_oRDR_DETECTION_357_360_oPCAN_RADAR_0d0e224f_Tx: ComSignalType=UINT8
            DET_RANGE_VELOCITY_ERR_358_oRDR_DETECTION_357_360_oPCAN_RADAR_211eb008_Tx: ComSignalType=UINT8
            DET_RANGE_VELOCITY_ERR_359_oRDR_DETECTION_357_360_oPCAN_RADAR_b46e649d_Tx: ComSignalType=UINT8
            DET_RANGE_VELOCITY_ERR_360_oRDR_DETECTION_357_360_oPCAN_RADAR_0bdf3e46_Tx: ComSignalType=UINT8
            DET_RCS_357_oRDR_DETECTION_357_360_oPCAN_RADAR_8535eea7_Tx: ComSignalType=UINT8
            DET_RCS_358_oRDR_DETECTION_357_360_oPCAN_RADAR_a9257ce0_Tx: ComSignalType=UINT8
            DET_RCS_359_oRDR_DETECTION_357_360_oPCAN_RADAR_3c55a875_Tx: ComSignalType=UINT8
            DET_RCS_360_oRDR_DETECTION_357_360_oPCAN_RADAR_83e4f2ae_Tx: ComSignalType=UINT8
            DET_SNR_357_oRDR_DETECTION_357_360_oPCAN_RADAR_589bbaa5_Tx: ComSignalType=UINT8
            DET_SNR_358_oRDR_DETECTION_357_360_oPCAN_RADAR_748b28e2_Tx: ComSignalType=UINT8
            DET_SNR_359_oRDR_DETECTION_357_360_oPCAN_RADAR_e1fbfc77_Tx: ComSignalType=UINT8
            DET_SNR_360_oRDR_DETECTION_357_360_oPCAN_RADAR_5e4aa6ac_Tx: ComSignalType=UINT8
            DET_SUPER_RES_TARGET_357_oRDR_DETECTION_357_360_oPCAN_RADAR_690292c0_Tx: ComSignalType=BOOLEAN
            DET_SUPER_RES_TARGET_358_oRDR_DETECTION_357_360_oPCAN_RADAR_45120087_Tx: ComSignalType=BOOLEAN
            DET_SUPER_RES_TARGET_359_oRDR_DETECTION_357_360_oPCAN_RADAR_d062d412_Tx: ComSignalType=BOOLEAN
            DET_SUPER_RES_TARGET_360_oRDR_DETECTION_357_360_oPCAN_RADAR_6fd38ec9_Tx: ComSignalType=BOOLEAN
        SG_Detections_361_364_oRDR_DETECTION_361_364_oPCAN_RADAR_472e1297_Tx
          83 x ComGroupSignal:
            DET_AZIMUTH_361_oRDR_DETECTION_361_364_oPCAN_RADAR_7922a003_Tx: ComSignalType=UINT16
            DET_AZIMUTH_362_oRDR_DETECTION_361_364_oPCAN_RADAR_1dc2dbfd_Tx: ComSignalType=UINT16
            DET_AZIMUTH_363_oRDR_DETECTION_361_364_oPCAN_RADAR_88b20f68_Tx: ComSignalType=UINT16
            DET_AZIMUTH_364_oRDR_DETECTION_361_364_oPCAN_RADAR_d4022c01_Tx: ComSignalType=UINT16
            DET_AZIMUTH_ERR_361_oRDR_DETECTION_361_364_oPCAN_RADAR_dd9735f6_Tx: ComSignalType=UINT8
            DET_AZIMUTH_ERR_362_oRDR_DETECTION_361_364_oPCAN_RADAR_b9774e08_Tx: ComSignalType=UINT8
            DET_AZIMUTH_ERR_363_oRDR_DETECTION_361_364_oPCAN_RADAR_2c079a9d_Tx: ComSignalType=UINT8
            DET_AZIMUTH_ERR_364_oRDR_DETECTION_361_364_oPCAN_RADAR_70b7b9f4_Tx: ComSignalType=UINT8
            DET_BELOW_RAIN_THOLD_361_oRDR_DETECTION_361_364_oPCAN_RADAR_ac2333c3_Tx: ComSignalType=UINT8
            DET_BELOW_RAIN_THOLD_362_oRDR_DETECTION_361_364_oPCAN_RADAR_c8c3483d_Tx: ComSignalType=UINT8
            DET_BELOW_RAIN_THOLD_363_oRDR_DETECTION_361_364_oPCAN_RADAR_5db39ca8_Tx: ComSignalType=UINT8
            DET_BELOW_RAIN_THOLD_364_oRDR_DETECTION_361_364_oPCAN_RADAR_0103bfc1_Tx: ComSignalType=UINT8
            DET_BI_STATIC_FLAG_361_oRDR_DETECTION_361_364_oPCAN_RADAR_2f0ee086_Tx: ComSignalType=BOOLEAN
            DET_BI_STATIC_FLAG_362_oRDR_DETECTION_361_364_oPCAN_RADAR_4bee9b78_Tx: ComSignalType=BOOLEAN
            DET_BI_STATIC_FLAG_363_oRDR_DETECTION_361_364_oPCAN_RADAR_de9e4fed_Tx: ComSignalType=BOOLEAN
            DET_BI_STATIC_FLAG_364_oRDR_DETECTION_361_364_oPCAN_RADAR_822e6c84_Tx: ComSignalType=BOOLEAN
            DET_CONFD_AZIMUTH_361_oRDR_DETECTION_361_364_oPCAN_RADAR_7bc4aac9_Tx: ComSignalType=UINT8
            DET_CONFD_AZIMUTH_362_oRDR_DETECTION_361_364_oPCAN_RADAR_1f24d137_Tx: ComSignalType=UINT8
            DET_CONFD_AZIMUTH_363_oRDR_DETECTION_361_364_oPCAN_RADAR_8a5405a2_Tx: ComSignalType=UINT8
            DET_CONFD_AZIMUTH_364_oRDR_DETECTION_361_364_oPCAN_RADAR_d6e426cb_Tx: ComSignalType=UINT8
            DET_CONFD_ELEVATION_361_oRDR_DETECTION_361_364_oPCAN_RADAR_7951ab33_Tx: ComSignalType=UINT8
            DET_CONFD_ELEVATION_362_oRDR_DETECTION_361_364_oPCAN_RADAR_1db1d0cd_Tx: ComSignalType=UINT8
            DET_CONFD_ELEVATION_363_oRDR_DETECTION_361_364_oPCAN_RADAR_88c10458_Tx: ComSignalType=UINT8
            DET_CONFD_ELEVATION_364_oRDR_DETECTION_361_364_oPCAN_RADAR_d4712731_Tx: ComSignalType=UINT8
            DET_ELEVATION_361_oRDR_DETECTION_361_364_oPCAN_RADAR_a8917f0f_Tx: ComSignalType=UINT8
            DET_ELEVATION_362_oRDR_DETECTION_361_364_oPCAN_RADAR_cc7104f1_Tx: ComSignalType=UINT8
            DET_ELEVATION_363_oRDR_DETECTION_361_364_oPCAN_RADAR_5901d064_Tx: ComSignalType=UINT8
            DET_ELEVATION_364_oRDR_DETECTION_361_364_oPCAN_RADAR_05b1f30d_Tx: ComSignalType=UINT8
            DET_ELEVATION_ERR_361_oRDR_DETECTION_361_364_oPCAN_RADAR_2fa8e77a_Tx: ComSignalType=UINT8
            DET_ELEVATION_ERR_362_oRDR_DETECTION_361_364_oPCAN_RADAR_4b489c84_Tx: ComSignalType=UINT8
            DET_ELEVATION_ERR_363_oRDR_DETECTION_361_364_oPCAN_RADAR_de384811_Tx: ComSignalType=UINT8
            DET_ELEVATION_ERR_364_oRDR_DETECTION_361_364_oPCAN_RADAR_82886b78_Tx: ComSignalType=UINT8
            DET_EXISTENCE_PROB_361_oRDR_DETECTION_361_364_oPCAN_RADAR_fd37921a_Tx: ComSignalType=UINT8
            DET_EXISTENCE_PROB_362_oRDR_DETECTION_361_364_oPCAN_RADAR_99d7e9e4_Tx: ComSignalType=UINT8
            DET_EXISTENCE_PROB_363_oRDR_DETECTION_361_364_oPCAN_RADAR_0ca73d71_Tx: ComSignalType=UINT8
            DET_EXISTENCE_PROB_364_oRDR_DETECTION_361_364_oPCAN_RADAR_50171e18_Tx: ComSignalType=UINT8
            DET_HVC_FLAG_361_oRDR_DETECTION_361_364_oPCAN_RADAR_1c43d165_Tx: ComSignalType=BOOLEAN
            DET_HVC_FLAG_362_oRDR_DETECTION_361_364_oPCAN_RADAR_78a3aa9b_Tx: ComSignalType=BOOLEAN
            DET_HVC_FLAG_363_oRDR_DETECTION_361_364_oPCAN_RADAR_edd37e0e_Tx: ComSignalType=BOOLEAN
            DET_HVC_FLAG_364_oRDR_DETECTION_361_364_oPCAN_RADAR_b1635d67_Tx: ComSignalType=BOOLEAN
            DET_IDM_361_oRDR_DETECTION_361_364_oPCAN_RADAR_9711ead8_Tx: ComSignalType=UINT8
            DET_IDM_362_oRDR_DETECTION_361_364_oPCAN_RADAR_f3f19126_Tx: ComSignalType=UINT8
            DET_IDM_363_oRDR_DETECTION_361_364_oPCAN_RADAR_668145b3_Tx: ComSignalType=UINT8
            DET_IDM_364_oRDR_DETECTION_361_364_oPCAN_RADAR_3a3166da_Tx: ComSignalType=UINT8
            DET_MH_CRC16_361_364_oRDR_DETECTION_361_364_oPCAN_RADAR_c3a6c09c_Tx: ComSignalType=UINT16
            DET_MH_CYCLE_COUNTER_361_364_oRDR_DETECTION_361_364_oPCAN_RADAR_47d361ab_Tx: ComSignalType=UINT8
            DET_MH_SCAN_INDEX_4LSB_361_364_oRDR_DETECTION_361_364_oPCAN_RADAR_8bf94427_Tx: ComSignalType=UINT8
            DET_MTD_361_oRDR_DETECTION_361_364_oPCAN_RADAR_f1a2d803_Tx: ComSignalType=UINT8
            DET_MTD_362_oRDR_DETECTION_361_364_oPCAN_RADAR_9542a3fd_Tx: ComSignalType=UINT8
            DET_MTD_363_oRDR_DETECTION_361_364_oPCAN_RADAR_00327768_Tx: ComSignalType=UINT8
            DET_MTD_364_oRDR_DETECTION_361_364_oPCAN_RADAR_5c825401_Tx: ComSignalType=UINT8
            DET_PROB_1STAZHYPO_361_oRDR_DETECTION_361_364_oPCAN_RADAR_621630ce_Tx: ComSignalType=BOOLEAN
            DET_PROB_1STAZHYPO_362_oRDR_DETECTION_361_364_oPCAN_RADAR_06f64b30_Tx: ComSignalType=BOOLEAN
            DET_PROB_1STAZHYPO_363_oRDR_DETECTION_361_364_oPCAN_RADAR_93869fa5_Tx: ComSignalType=BOOLEAN
            DET_PROB_1STAZHYPO_364_oRDR_DETECTION_361_364_oPCAN_RADAR_cf36bccc_Tx: ComSignalType=BOOLEAN
            DET_RANGE_361_oRDR_DETECTION_361_364_oPCAN_RADAR_69b9d3b8_Tx: ComSignalType=UINT16
            DET_RANGE_362_oRDR_DETECTION_361_364_oPCAN_RADAR_0d59a846_Tx: ComSignalType=UINT16
            DET_RANGE_363_oRDR_DETECTION_361_364_oPCAN_RADAR_98297cd3_Tx: ComSignalType=UINT16
            DET_RANGE_364_oRDR_DETECTION_361_364_oPCAN_RADAR_c4995fba_Tx: ComSignalType=UINT16
            DET_RANGE_ERR_361_oRDR_DETECTION_361_364_oPCAN_RADAR_ce5169d1_Tx: ComSignalType=UINT8
            DET_RANGE_ERR_362_oRDR_DETECTION_361_364_oPCAN_RADAR_aab1122f_Tx: ComSignalType=UINT8
            DET_RANGE_ERR_363_oRDR_DETECTION_361_364_oPCAN_RADAR_3fc1c6ba_Tx: ComSignalType=UINT8
            DET_RANGE_ERR_364_oRDR_DETECTION_361_364_oPCAN_RADAR_6371e5d3_Tx: ComSignalType=UINT8
            DET_RANGE_VELOCITY_361_oRDR_DETECTION_361_364_oPCAN_RADAR_1c1f119d_Tx: ComSignalType=UINT16
            DET_RANGE_VELOCITY_362_oRDR_DETECTION_361_364_oPCAN_RADAR_78ff6a63_Tx: ComSignalType=UINT16
            DET_RANGE_VELOCITY_363_oRDR_DETECTION_361_364_oPCAN_RADAR_ed8fbef6_Tx: ComSignalType=UINT16
            DET_RANGE_VELOCITY_364_oRDR_DETECTION_361_364_oPCAN_RADAR_b13f9d9f_Tx: ComSignalType=UINT16
            DET_RANGE_VELOCITY_ERR_361_oRDR_DETECTION_361_364_oPCAN_RADAR_13a4ea2f_Tx: ComSignalType=UINT8
            DET_RANGE_VELOCITY_ERR_362_oRDR_DETECTION_361_364_oPCAN_RADAR_774491d1_Tx: ComSignalType=UINT8
            DET_RANGE_VELOCITY_ERR_363_oRDR_DETECTION_361_364_oPCAN_RADAR_e2344544_Tx: ComSignalType=UINT8
            DET_RANGE_VELOCITY_ERR_364_oRDR_DETECTION_361_364_oPCAN_RADAR_be84662d_Tx: ComSignalType=UINT8
            DET_RCS_361_oRDR_DETECTION_361_364_oPCAN_RADAR_9b9f26c7_Tx: ComSignalType=UINT8
            DET_RCS_362_oRDR_DETECTION_361_364_oPCAN_RADAR_ff7f5d39_Tx: ComSignalType=UINT8
            DET_RCS_363_oRDR_DETECTION_361_364_oPCAN_RADAR_6a0f89ac_Tx: ComSignalType=UINT8
            DET_RCS_364_oRDR_DETECTION_361_364_oPCAN_RADAR_36bfaac5_Tx: ComSignalType=UINT8
            DET_SNR_361_oRDR_DETECTION_361_364_oPCAN_RADAR_463172c5_Tx: ComSignalType=UINT8
            DET_SNR_362_oRDR_DETECTION_361_364_oPCAN_RADAR_22d1093b_Tx: ComSignalType=UINT8
            DET_SNR_363_oRDR_DETECTION_361_364_oPCAN_RADAR_b7a1ddae_Tx: ComSignalType=UINT8
            DET_SNR_364_oRDR_DETECTION_361_364_oPCAN_RADAR_eb11fec7_Tx: ComSignalType=UINT8
            DET_SUPER_RES_TARGET_361_oRDR_DETECTION_361_364_oPCAN_RADAR_77a85aa0_Tx: ComSignalType=BOOLEAN
            DET_SUPER_RES_TARGET_362_oRDR_DETECTION_361_364_oPCAN_RADAR_1348215e_Tx: ComSignalType=BOOLEAN
            DET_SUPER_RES_TARGET_363_oRDR_DETECTION_361_364_oPCAN_RADAR_8638f5cb_Tx: ComSignalType=BOOLEAN
            DET_SUPER_RES_TARGET_364_oRDR_DETECTION_361_364_oPCAN_RADAR_da88d6a2_Tx: ComSignalType=BOOLEAN
