[part 8 of 8: package /DaVinci_Project]
AUTOSAR XML (schema 4-0-3)
package /DaVinci_Project  (continued)
  module config Com  (continued)
    ComConfig  (continued)
      239 x ComSignalGroup:  (continued)
        SG_TrackerObject035_oRDR_TRACKER_OBJ_035_oPCAN_RADAR_00bc4b11_Tx
          49 x ComGroupSignal:
            OBJ_ACCELERATION_LAT_035_oRDR_TRACKER_OBJ_035_oPCAN_RADAR_0e981066_Tx: ComSignalType=UINT16
            OBJ_ACCELERATION_LAT_ERR_035_oRDR_TRACKER_OBJ_035_oPCAN_RADAR_db6c2ad8_Tx: ComSignalType=UINT8
            OBJ_ACCELERATION_LONG_035_oRDR_TRACKER_OBJ_035_oPCAN_RADAR_7c684986_Tx: ComSignalType=UINT16
            OBJ_ACCELERATION_LONG_ERR_035_oRDR_TRACKER_OBJ_035_oPCAN_RADAR_c4c98f72_Tx: ComSignalType=UINT8
            OBJ_ACCEL_ERR_CRR_COEF_035_oRDR_TRACKER_OBJ_035_oPCAN_RADAR_646aae14_Tx: ComSignalType=UINT8
            OBJ_ALIVE_TIME_035_oRDR_TRACKER_OBJ_035_oPCAN_RADAR_1c09023a_Tx: ComSignalType=UINT16
            OBJ_CLS_TYPE1_035_oRDR_TRACKER_OBJ_035_oPCAN_RADAR_8bd2e31c_Tx: ComSignalType=UINT8
            OBJ_CLS_TYPE1_PROB_035_oRDR_TRACKER_OBJ_035_oPCAN_RADAR_238a34ef_Tx: ComSignalType=UINT8
            OBJ_CLS_TYPE2_035_oRDR_TRACKER_OBJ_035_oPCAN_RADAR_c63ae37b_Tx: ComSignalType=UINT8
            OBJ_CLS_TYPE2_PROB_035_oRDR_TRACKER_OBJ_035_oPCAN_RADAR_eabe2fe2_Tx: ComSignalType=UINT8
            OBJ_CLS_TYPE3_035_oRDR_TRACKER_OBJ_035_oPCAN_RADAR_4bb21e99_Tx: ComSignalType=UINT8
            OBJ_CLS_TYPE3_PROB_035_oRDR_TRACKER_OBJ_035_oPCAN_RADAR_adadd919_Tx: ComSignalType=UINT8
            OBJ_CLS_TYPE4_035_oRDR_TRACKER_OBJ_035_oPCAN_RADAR_5deae3b5_Tx: ComSignalType=UINT8
            OBJ_CLS_TYPE4_PROB_035_oRDR_TRACKER_OBJ_035_oPCAN_RADAR_a3a71fb9_Tx: ComSignalType=UINT8
            OBJ_CLS_TYPE5_035_oRDR_TRACKER_OBJ_035_oPCAN_RADAR_d0621e57_Tx: ComSignalType=UINT8
            OBJ_CLS_TYPE5_PROB_035_oRDR_TRACKER_OBJ_035_oPCAN_RADAR_e4b4e942_Tx: ComSignalType=UINT8
            OBJ_CLS_TYPE6_035_oRDR_TRACKER_OBJ_035_oPCAN_RADAR_9d8a1e30_Tx: ComSignalType=UINT8
            OBJ_CLS_TYPE6_PROB_035_oRDR_TRACKER_OBJ_035_oPCAN_RADAR_2d80f24f_Tx: ComSignalType=UINT8
            OBJ_DIMENSION_LENGTH_035_oRDR_TRACKER_OBJ_035_oPCAN_RADAR_c94cb058_Tx: ComSignalType=UINT16
            OBJ_DIMENSION_LENGTH_ERR_035_oRDR_TRACKER_OBJ_035_oPCAN_RADAR_f2b4af22_Tx: ComSignalType=UINT16
            OBJ_DIMENSION_WIDTH_035_oRDR_TRACKER_OBJ_035_oPCAN_RADAR_ea8247f5_Tx: ComSignalType=UINT16
            OBJ_DIMENSION_WIDTH_ERR_035_oRDR_TRACKER_OBJ_035_oPCAN_RADAR_0a20801d_Tx: ComSignalType=UINT8
            OBJ_EXISTENCE_PROB_035_oRDR_TRACKER_OBJ_035_oPCAN_RADAR_e13ec3c8_Tx: ComSignalType=UINT16
            OBJ_GROUP_ID_035_oRDR_TRACKER_OBJ_035_oPCAN_RADAR_684cd765_Tx: ComSignalType=UINT8
            OBJ_ID_035_oRDR_TRACKER_OBJ_035_oPCAN_RADAR_9b62fc62_Tx: ComSignalType=UINT8
            OBJ_MEASUREMENT_STATUS_035_oRDR_TRACKER_OBJ_035_oPCAN_RADAR_e4b08edf_Tx: ComSignalType=UINT8
            OBJ_MH_CRC16_035_oRDR_TRACKER_OBJ_035_oPCAN_RADAR_98d039e3_Tx: ComSignalType=UINT16
            OBJ_MH_CYCLE_COUNTER_035_oRDR_TRACKER_OBJ_035_oPCAN_RADAR_e9346302_Tx: ComSignalType=UINT8
            OBJ_MOVEMENT_STATUS_035_oRDR_TRACKER_OBJ_035_oPCAN_RADAR_cb1e1b93_Tx: ComSignalType=UINT8
            OBJ_POS_ERR_CRR_COEF_035_oRDR_TRACKER_OBJ_035_oPCAN_RADAR_5b61dba9_Tx: ComSignalType=UINT8
            OBJ_POS_LAT_035_oRDR_TRACKER_OBJ_035_oPCAN_RADAR_b9ce26e5_Tx: ComSignalType=UINT16
            OBJ_POS_LAT_ERR_035_oRDR_TRACKER_OBJ_035_oPCAN_RADAR_bd8276d2_Tx: ComSignalType=UINT8
            OBJ_POS_LONG_035_oRDR_TRACKER_OBJ_035_oPCAN_RADAR_086ecd2a_Tx: ComSignalType=UINT16
            OBJ_POS_LONG_ERR_035_oRDR_TRACKER_OBJ_035_oPCAN_RADAR_247a8830_Tx: ComSignalType=UINT8
            OBJ_RCS_035_oRDR_TRACKER_OBJ_035_oPCAN_RADAR_9b0170e2_Tx: ComSignalType=UINT8
            OBJ_REF_PT_LAT_OFFSET_035_oRDR_TRACKER_OBJ_035_oPCAN_RADAR_6e3c1b97_Tx: ComSignalType=UINT16
            OBJ_REF_PT_LONG_OFFSET_035_oRDR_TRACKER_OBJ_035_oPCAN_RADAR_216eeb94_Tx: ComSignalType=UINT16
            OBJ_TIMESTAMP_OFFSET_035_oRDR_TRACKER_OBJ_035_oPCAN_RADAR_9bad70b4_Tx: ComSignalType=UINT8
            OBJ_TRACK_MOTION_MODEL_035_oRDR_TRACKER_OBJ_035_oPCAN_RADAR_57ae7169_Tx: ComSignalType=UINT8
            OBJ_VEH_TRACK_FLAG_035_oRDR_TRACKER_OBJ_035_oPCAN_RADAR_d5848734_Tx: ComSignalType=BOOLEAN
            OBJ_VELOCITY_ERR_CRR_COEF_035_oRDR_TRACKER_OBJ_035_oPCAN_RADAR_f21be648_Tx: ComSignalType=UINT8
            OBJ_VELOCITY_LAT_035_oRDR_TRACKER_OBJ_035_oPCAN_RADAR_fdad63c2_Tx: ComSignalType=UINT16
            OBJ_VELOCITY_LAT_ERR_035_oRDR_TRACKER_OBJ_035_oPCAN_RADAR_c9571393_Tx: ComSignalType=UINT8
            OBJ_VELOCITY_LONG_035_oRDR_TRACKER_OBJ_035_oPCAN_RADAR_ad201b04_Tx: ComSignalType=UINT16
            OBJ_VELOCITY_LONG_ERR_035_oRDR_TRACKER_OBJ_035_oPCAN_RADAR_25d52c53_Tx: ComSignalType=UINT8
            OBJ_YAW_ANGLE_035_oRDR_TRACKER_OBJ_035_oPCAN_RADAR_11112782_Tx: ComSignalType=UINT16
            OBJ_YAW_ANGLE_ERR_035_oRDR_TRACKER_OBJ_035_oPCAN_RADAR_c41c2155_Tx: ComSignalType=UINT8
            OBJ_YAW_RATE_035_oRDR_TRACKER_OBJ_035_oPCAN_RADAR_349e02c5_Tx: ComSignalType=UINT16
            OBJ_YAW_RATE_ERR_035_oRDR_TRACKER_OBJ_035_oPCAN_RADAR_0b469519_Tx: ComSignalType=UINT8
        SG_TrackerObject036_oRDR_TRACKER_OBJ_036_oPCAN_RADAR_d0f0d485_Tx
          49 x ComGroupSignal:
            OBJ_ACCELERATION_LAT_036_oRDR_TRACKER_OBJ_036_oPCAN_RADAR_ded48ff2_Tx: ComSignalType=UINT16
            OBJ_ACCELERATION_LAT_ERR_036_oRDR_TRACKER_OBJ_036_oPCAN_RADAR_0b20b54c_Tx: ComSignalType=UINT8
            OBJ_ACCELERATION_LONG_036_oRDR_TRACKER_OBJ_036_oPCAN_RADAR_ac24d612_Tx: ComSignalType=UINT16
            OBJ_ACCELERATION_LONG_ERR_036_oRDR_TRACKER_OBJ_036_oPCAN_RADAR_148510e6_Tx: ComSignalType=UINT8
            OBJ_ACCEL_ERR_CRR_COEF_036_oRDR_TRACKER_OBJ_036_oPCAN_RADAR_b4263180_Tx: ComSignalType=UINT8
            OBJ_ALIVE_TIME_036_oRDR_TRACKER_OBJ_036_oPCAN_RADAR_cc459dae_Tx: ComSignalType=UINT16
            OBJ_CLS_TYPE1_036_oRDR_TRACKER_OBJ_036_oPCAN_RADAR_5b9e7c88_Tx: ComSignalType=UINT8
            OBJ_CLS_TYPE1_PROB_036_oRDR_TRACKER_OBJ_036_oPCAN_RADAR_f3c6ab7b_Tx: ComSignalType=UINT8
            OBJ_CLS_TYPE2_036_oRDR_TRACKER_OBJ_036_oPCAN_RADAR_16767cef_Tx: ComSignalType=UINT8
            OBJ_CLS_TYPE2_PROB_036_oRDR_TRACKER_OBJ_036_oPCAN_RADAR_3af2b076_Tx: ComSignalType=UINT8
            OBJ_CLS_TYPE3_036_oRDR_TRACKER_OBJ_036_oPCAN_RADAR_9bfe810d_Tx: ComSignalType=UINT8
            OBJ_CLS_TYPE3_PROB_036_oRDR_TRACKER_OBJ_036_oPCAN_RADAR_7de1468d_Tx: ComSignalType=UINT8
            OBJ_CLS_TYPE4_036_oRDR_TRACKER_OBJ_036_oPCAN_RADAR_8da67c21_Tx: ComSignalType=UINT8
            OBJ_CLS_TYPE4_PROB_036_oRDR_TRACKER_OBJ_036_oPCAN_RADAR_73eb802d_Tx: ComSignalType=UINT8
            OBJ_CLS_TYPE5_036_oRDR_TRACKER_OBJ_036_oPCAN_RADAR_002e81c3_Tx: ComSignalType=UINT8
            OBJ_CLS_TYPE5_PROB_036_oRDR_TRACKER_OBJ_036_oPCAN_RADAR_34f876d6_Tx: ComSignalType=UINT8
            OBJ_CLS_TYPE6_036_oRDR_TRACKER_OBJ_036_oPCAN_RADAR_4dc681a4_Tx: ComSignalType=UINT8
            OBJ_CLS_TYPE6_PROB_036_oRDR_TRACKER_OBJ_036_oPCAN_RADAR_fdcc6ddb_Tx: ComSignalType=UINT8
            OBJ_DIMENSION_LENGTH_036_oRDR_TRACKER_OBJ_036_oPCAN_RADAR_19002fcc_Tx: ComSignalType=UINT16
            OBJ_DIMENSION_LENGTH_ERR_036_oRDR_TRACKER_OBJ_036_oPCAN_RADAR_22f830b6_Tx: ComSignalType=UINT16
            OBJ_DIMENSION_WIDTH_036_oRDR_TRACKER_OBJ_036_oPCAN_RADAR_3aced861_Tx: ComSignalType=UINT16
            OBJ_DIMENSION_WIDTH_ERR_036_oRDR_TRACKER_OBJ_036_oPCAN_RADAR_da6c1f89_Tx: ComSignalType=UINT8
            OBJ_EXISTENCE_PROB_036_oRDR_TRACKER_OBJ_036_oPCAN_RADAR_31725c5c_Tx: ComSignalType=UINT16
            OBJ_GROUP_ID_036_oRDR_TRACKER_OBJ_036_oPCAN_RADAR_b80048f1_Tx: ComSignalType=UINT8
            OBJ_ID_036_oRDR_TRACKER_OBJ_036_oPCAN_RADAR_4b2e63f6_Tx: ComSignalType=UINT8
            OBJ_MEASUREMENT_STATUS_036_oRDR_TRACKER_OBJ_036_oPCAN_RADAR_34fc114b_Tx: ComSignalType=UINT8
            OBJ_MH_CRC16_036_oRDR_TRACKER_OBJ_036_oPCAN_RADAR_489ca677_Tx: ComSignalType=UINT16
            OBJ_MH_CYCLE_COUNTER_036_oRDR_TRACKER_OBJ_036_oPCAN_RADAR_3978fc96_Tx: ComSignalType=UINT8
            OBJ_MOVEMENT_STATUS_036_oRDR_TRACKER_OBJ_036_oPCAN_RADAR_1b528407_Tx: ComSignalType=UINT8
            OBJ_POS_ERR_CRR_COEF_036_oRDR_TRACKER_OBJ_036_oPCAN_RADAR_8b2d443d_Tx: ComSignalType=UINT8
            OBJ_POS_LAT_036_oRDR_TRACKER_OBJ_036_oPCAN_RADAR_6982b971_Tx: ComSignalType=UINT16
            OBJ_POS_LAT_ERR_036_oRDR_TRACKER_OBJ_036_oPCAN_RADAR_6dcee946_Tx: ComSignalType=UINT8
            OBJ_POS_LONG_036_oRDR_TRACKER_OBJ_036_oPCAN_RADAR_d82252be_Tx: ComSignalType=UINT16
            OBJ_POS_LONG_ERR_036_oRDR_TRACKER_OBJ_036_oPCAN_RADAR_f43617a4_Tx: ComSignalType=UINT8
            OBJ_RCS_036_oRDR_TRACKER_OBJ_036_oPCAN_RADAR_4b4def76_Tx: ComSignalType=UINT8
            OBJ_REF_PT_LAT_OFFSET_036_oRDR_TRACKER_OBJ_036_oPCAN_RADAR_be708403_Tx: ComSignalType=UINT16
            OBJ_REF_PT_LONG_OFFSET_036_oRDR_TRACKER_OBJ_036_oPCAN_RADAR_f1227400_Tx: ComSignalType=UINT16
            OBJ_TIMESTAMP_OFFSET_036_oRDR_TRACKER_OBJ_036_oPCAN_RADAR_4be1ef20_Tx: ComSignalType=UINT8
            OBJ_TRACK_MOTION_MODEL_036_oRDR_TRACKER_OBJ_036_oPCAN_RADAR_87e2eefd_Tx: ComSignalType=UINT8
            OBJ_VEH_TRACK_FLAG_036_oRDR_TRACKER_OBJ_036_oPCAN_RADAR_05c818a0_Tx: ComSignalType=BOOLEAN
            OBJ_VELOCITY_ERR_CRR_COEF_036_oRDR_TRACKER_OBJ_036_oPCAN_RADAR_225779dc_Tx: ComSignalType=UINT8
            OBJ_VELOCITY_LAT_036_oRDR_TRACKER_OBJ_036_oPCAN_RADAR_2de1fc56_Tx: ComSignalType=UINT16
            OBJ_VELOCITY_LAT_ERR_036_oRDR_TRACKER_OBJ_036_oPCAN_RADAR_191b8c07_Tx: ComSignalType=UINT8
            OBJ_VELOCITY_LONG_036_oRDR_TRACKER_OBJ_036_oPCAN_RADAR_7d6c8490_Tx: ComSignalType=UINT16
            OBJ_VELOCITY_LONG_ERR_036_oRDR_TRACKER_OBJ_036_oPCAN_RADAR_f599b3c7_Tx: ComSignalType=UINT8
            OBJ_YAW_ANGLE_036_oRDR_TRACKER_OBJ_036_oPCAN_RADAR_c15db816_Tx: ComSignalType=UINT16
            OBJ_YAW_ANGLE_ERR_036_oRDR_TRACKER_OBJ_036_oPCAN_RADAR_1450bec1_Tx: ComSignalType=UINT8
            OBJ_YAW_RATE_036_oRDR_TRACKER_OBJ_036_oPCAN_RADAR_e4d29d51_Tx: ComSignalType=UINT16
            OBJ_YAW_RATE_ERR_036_oRDR_TRACKER_OBJ_036_oPCAN_RADAR_db0a0a8d_Tx: ComSignalType=UINT8
        SG_TrackerObject037_oRDR_TRACKER_OBJ_037_oPCAN_RADAR_29e45c36_Tx
          49 x ComGroupSignal:
            OBJ_ACCELERATION_LAT_037_oRDR_TRACKER_OBJ_037_oPCAN_RADAR_27c00741_Tx: ComSignalType=UINT16
            OBJ_ACCELERATION_LAT_ERR_037_oRDR_TRACKER_OBJ_037_oPCAN_RADAR_f2343dff_Tx: ComSignalType=UINT8
            OBJ_ACCELERATION_LONG_037_oRDR_TRACKER_OBJ_037_oPCAN_RADAR_55305ea1_Tx: ComSignalType=UINT16
            OBJ_ACCELERATION_LONG_ERR_037_oRDR_TRACKER_OBJ_037_oPCAN_RADAR_ed919855_Tx: ComSignalType=UINT8
            OBJ_ACCEL_ERR_CRR_COEF_037_oRDR_TRACKER_OBJ_037_oPCAN_RADAR_4d32b933_Tx: ComSignalType=UINT8
            OBJ_ALIVE_TIME_037_oRDR_TRACKER_OBJ_037_oPCAN_RADAR_3551151d_Tx: ComSignalType=UINT16
            OBJ_CLS_TYPE1_037_oRDR_TRACKER_OBJ_037_oPCAN_RADAR_a28af43b_Tx: ComSignalType=UINT8
            OBJ_CLS_TYPE1_PROB_037_oRDR_TRACKER_OBJ_037_oPCAN_RADAR_0ad223c8_Tx: ComSignalType=UINT8
            OBJ_CLS_TYPE2_037_oRDR_TRACKER_OBJ_037_oPCAN_RADAR_ef62f45c_Tx: ComSignalType=UINT8
            OBJ_CLS_TYPE2_PROB_037_oRDR_TRACKER_OBJ_037_oPCAN_RADAR_c3e638c5_Tx: ComSignalType=UINT8
            OBJ_CLS_TYPE3_037_oRDR_TRACKER_OBJ_037_oPCAN_RADAR_62ea09be_Tx: ComSignalType=UINT8
            OBJ_CLS_TYPE3_PROB_037_oRDR_TRACKER_OBJ_037_oPCAN_RADAR_84f5ce3e_Tx: ComSignalType=UINT8
            OBJ_CLS_TYPE4_037_oRDR_TRACKER_OBJ_037_oPCAN_RADAR_74b2f492_Tx: ComSignalType=UINT8
            OBJ_CLS_TYPE4_PROB_037_oRDR_TRACKER_OBJ_037_oPCAN_RADAR_8aff089e_Tx: ComSignalType=UINT8
            OBJ_CLS_TYPE5_037_oRDR_TRACKER_OBJ_037_oPCAN_RADAR_f93a0970_Tx: ComSignalType=UINT8
            OBJ_CLS_TYPE5_PROB_037_oRDR_TRACKER_OBJ_037_oPCAN_RADAR_cdecfe65_Tx: ComSignalType=UINT8
            OBJ_CLS_TYPE6_037_oRDR_TRACKER_OBJ_037_oPCAN_RADAR_b4d20917_Tx: ComSignalType=UINT8
            OBJ_CLS_TYPE6_PROB_037_oRDR_TRACKER_OBJ_037_oPCAN_RADAR_04d8e568_Tx: ComSignalType=UINT8
            OBJ_DIMENSION_LENGTH_037_oRDR_TRACKER_OBJ_037_oPCAN_RADAR_e014a77f_Tx: ComSignalType=UINT16
            OBJ_DIMENSION_LENGTH_ERR_037_oRDR_TRACKER_OBJ_037_oPCAN_RADAR_dbecb805_Tx: ComSignalType=UINT16
            OBJ_DIMENSION_WIDTH_037_oRDR_TRACKER_OBJ_037_oPCAN_RADAR_c3da50d2_Tx: ComSignalType=UINT16
            OBJ_DIMENSION_WIDTH_ERR_037_oRDR_TRACKER_OBJ_037_oPCAN_RADAR_2378973a_Tx: ComSignalType=UINT8
            OBJ_EXISTENCE_PROB_037_oRDR_TRACKER_OBJ_037_oPCAN_RADAR_c866d4ef_Tx: ComSignalType=UINT16
            OBJ_GROUP_ID_037_oRDR_TRACKER_OBJ_037_oPCAN_RADAR_4114c042_Tx: ComSignalType=UINT8
            OBJ_ID_037_oRDR_TRACKER_OBJ_037_oPCAN_RADAR_b23aeb45_Tx: ComSignalType=UINT8
            OBJ_MEASUREMENT_STATUS_037_oRDR_TRACKER_OBJ_037_oPCAN_RADAR_cde899f8_Tx: ComSignalType=UINT8
            OBJ_MH_CRC16_037_oRDR_TRACKER_OBJ_037_oPCAN_RADAR_b1882ec4_Tx: ComSignalType=UINT16
            OBJ_MH_CYCLE_COUNTER_037_oRDR_TRACKER_OBJ_037_oPCAN_RADAR_c06c7425_Tx: ComSignalType=UINT8
            OBJ_MOVEMENT_STATUS_037_oRDR_TRACKER_OBJ_037_oPCAN_RADAR_e2460cb4_Tx: ComSignalType=UINT8
            OBJ_POS_ERR_CRR_COEF_037_oRDR_TRACKER_OBJ_037_oPCAN_RADAR_7239cc8e_Tx: ComSignalType=UINT8
            OBJ_POS_LAT_037_oRDR_TRACKER_OBJ_037_oPCAN_RADAR_909631c2_Tx: ComSignalType=UINT16
            OBJ_POS_LAT_ERR_037_oRDR_TRACKER_OBJ_037_oPCAN_RADAR_94da61f5_Tx: ComSignalType=UINT8
            OBJ_POS_LONG_037_oRDR_TRACKER_OBJ_037_oPCAN_RADAR_2136da0d_Tx: ComSignalType=UINT16
            OBJ_POS_LONG_ERR_037_oRDR_TRACKER_OBJ_037_oPCAN_RADAR_0d229f17_Tx: ComSignalType=UINT8
            OBJ_RCS_037_oRDR_TRACKER_OBJ_037_oPCAN_RADAR_b25967c5_Tx: ComSignalType=UINT8
            OBJ_REF_PT_LAT_OFFSET_037_oRDR_TRACKER_OBJ_037_oPCAN_RADAR_47640cb0_Tx: ComSignalType=UINT16
            OBJ_REF_PT_LONG_OFFSET_037_oRDR_TRACKER_OBJ_037_oPCAN_RADAR_0836fcb3_Tx: ComSignalType=UINT16
            OBJ_TIMESTAMP_OFFSET_037_oRDR_TRACKER_OBJ_037_oPCAN_RADAR_b2f56793_Tx: ComSignalType=UINT8
            OBJ_TRACK_MOTION_MODEL_037_oRDR_TRACKER_OBJ_037_oPCAN_RADAR_7ef6664e_Tx: ComSignalType=UINT8
            OBJ_VEH_TRACK_FLAG_037_oRDR_TRACKER_OBJ_037_oPCAN_RADAR_fcdc9013_Tx: ComSignalType=BOOLEAN
            OBJ_VELOCITY_ERR_CRR_COEF_037_oRDR_TRACKER_OBJ_037_oPCAN_RADAR_db43f16f_Tx: ComSignalType=UINT8
            OBJ_VELOCITY_LAT_037_oRDR_TRACKER_OBJ_037_oPCAN_RADAR_d4f574e5_Tx: ComSignalType=UINT16
            OBJ_VELOCITY_LAT_ERR_037_oRDR_TRACKER_OBJ_037_oPCAN_RADAR_e00f04b4_Tx: ComSignalType=UINT8
            OBJ_VELOCITY_LONG_037_oRDR_TRACKER_OBJ_037_oPCAN_RADAR_84780c23_Tx: ComSignalType=UINT16
            OBJ_VELOCITY_LONG_ERR_037_oRDR_TRACKER_OBJ_037_oPCAN_RADAR_0c8d3b74_Tx: ComSignalType=UINT8
            OBJ_YAW_ANGLE_037_oRDR_TRACKER_OBJ_037_oPCAN_RADAR_384930a5_Tx: ComSignalType=UINT16
            OBJ_YAW_ANGLE_ERR_037_oRDR_TRACKER_OBJ_037_oPCAN_RADAR_ed443672_Tx: ComSignalType=UINT8
            OBJ_YAW_RATE_037_oRDR_TRACKER_OBJ_037_oPCAN_RADAR_1dc615e2_Tx: ComSignalType=UINT16
            OBJ_YAW_RATE_ERR_037_oRDR_TRACKER_OBJ_037_oPCAN_RADAR_221e823e_Tx: ComSignalType=UINT8
        SG_TrackerObject038_oRDR_TRACKER_OBJ_038_oPCAN_RADAR_0e78b170_Tx
          49 x ComGroupSignal:
            OBJ_ACCELERATION_LAT_038_oRDR_TRACKER_OBJ_038_oPCAN_RADAR_005cea07_Tx: ComSignalType=UINT16
            OBJ_ACCELERATION_LAT_ERR_038_oRDR_TRACKER_OBJ_038_oPCAN_RADAR_d5a8d0b9_Tx: ComSignalType=UINT8
            OBJ_ACCELERATION_LONG_038_oRDR_TRACKER_OBJ_038_oPCAN_RADAR_72acb3e7_Tx: ComSignalType=UINT16
            OBJ_ACCELERATION_LONG_ERR_038_oRDR_TRACKER_OBJ_038_oPCAN_RADAR_ca0d7513_Tx: ComSignalType=UINT8
            OBJ_ACCEL_ERR_CRR_COEF_038_oRDR_TRACKER_OBJ_038_oPCAN_RADAR_6aae5475_Tx: ComSignalType=UINT8
            OBJ_ALIVE_TIME_038_oRDR_TRACKER_OBJ_038_oPCAN_RADAR_12cdf85b_Tx: ComSignalType=UINT16
            OBJ_CLS_TYPE1_038_oRDR_TRACKER_OBJ_038_oPCAN_RADAR_8516197d_Tx: ComSignalType=UINT8
            OBJ_CLS_TYPE1_PROB_038_oRDR_TRACKER_OBJ_038_oPCAN_RADAR_2d4ece8e_Tx: ComSignalType=UINT8
            OBJ_CLS_TYPE2_038_oRDR_TRACKER_OBJ_038_oPCAN_RADAR_c8fe191a_Tx: ComSignalType=UINT8
            OBJ_CLS_TYPE2_PROB_038_oRDR_TRACKER_OBJ_038_oPCAN_RADAR_e47ad583_Tx: ComSignalType=UINT8
            OBJ_CLS_TYPE3_038_oRDR_TRACKER_OBJ_038_oPCAN_RADAR_4576e4f8_Tx: ComSignalType=UINT8
            OBJ_CLS_TYPE3_PROB_038_oRDR_TRACKER_OBJ_038_oPCAN_RADAR_a3692378_Tx: ComSignalType=UINT8
            OBJ_CLS_TYPE4_038_oRDR_TRACKER_OBJ_038_oPCAN_RADAR_532e19d4_Tx: ComSignalType=UINT8
            OBJ_CLS_TYPE4_PROB_038_oRDR_TRACKER_OBJ_038_oPCAN_RADAR_ad63e5d8_Tx: ComSignalType=UINT8
            OBJ_CLS_TYPE5_038_oRDR_TRACKER_OBJ_038_oPCAN_RADAR_dea6e436_Tx: ComSignalType=UINT8
            OBJ_CLS_TYPE5_PROB_038_oRDR_TRACKER_OBJ_038_oPCAN_RADAR_ea701323_Tx: ComSignalType=UINT8
            OBJ_CLS_TYPE6_038_oRDR_TRACKER_OBJ_038_oPCAN_RADAR_934ee451_Tx: ComSignalType=UINT8
            OBJ_CLS_TYPE6_PROB_038_oRDR_TRACKER_OBJ_038_oPCAN_RADAR_2344082e_Tx: ComSignalType=UINT8
            OBJ_DIMENSION_LENGTH_038_oRDR_TRACKER_OBJ_038_oPCAN_RADAR_c7884a39_Tx: ComSignalType=UINT16
            OBJ_DIMENSION_LENGTH_ERR_038_oRDR_TRACKER_OBJ_038_oPCAN_RADAR_fc705543_Tx: ComSignalType=UINT16
            OBJ_DIMENSION_WIDTH_038_oRDR_TRACKER_OBJ_038_oPCAN_RADAR_e446bd94_Tx: ComSignalType=UINT16
            OBJ_DIMENSION_WIDTH_ERR_038_oRDR_TRACKER_OBJ_038_oPCAN_RADAR_04e47a7c_Tx: ComSignalType=UINT8
            OBJ_EXISTENCE_PROB_038_oRDR_TRACKER_OBJ_038_oPCAN_RADAR_effa39a9_Tx: ComSignalType=UINT16
            OBJ_GROUP_ID_038_oRDR_TRACKER_OBJ_038_oPCAN_RADAR_66882d04_Tx: ComSignalType=UINT8
            OBJ_ID_038_oRDR_TRACKER_OBJ_038_oPCAN_RADAR_95a60603_Tx: ComSignalType=UINT8
            OBJ_MEASUREMENT_STATUS_038_oRDR_TRACKER_OBJ_038_oPCAN_RADAR_ea7474be_Tx: ComSignalType=UINT8
            OBJ_MH_CRC16_038_oRDR_TRACKER_OBJ_038_oPCAN_RADAR_9614c382_Tx: ComSignalType=UINT16
            OBJ_MH_CYCLE_COUNTER_038_oRDR_TRACKER_OBJ_038_oPCAN_RADAR_e7f09963_Tx: ComSignalType=UINT8
            OBJ_MOVEMENT_STATUS_038_oRDR_TRACKER_OBJ_038_oPCAN_RADAR_c5dae1f2_Tx: ComSignalType=UINT8
            OBJ_POS_ERR_CRR_COEF_038_oRDR_TRACKER_OBJ_038_oPCAN_RADAR_55a521c8_Tx: ComSignalType=UINT8
            OBJ_POS_LAT_038_oRDR_TRACKER_OBJ_038_oPCAN_RADAR_b70adc84_Tx: ComSignalType=UINT16
            OBJ_POS_LAT_ERR_038_oRDR_TRACKER_OBJ_038_oPCAN_RADAR_b3468cb3_Tx: ComSignalType=UINT8
            OBJ_POS_LONG_038_oRDR_TRACKER_OBJ_038_oPCAN_RADAR_06aa374b_Tx: ComSignalType=UINT16
            OBJ_POS_LONG_ERR_038_oRDR_TRACKER_OBJ_038_oPCAN_RADAR_2abe7251_Tx: ComSignalType=UINT8
            OBJ_RCS_038_oRDR_TRACKER_OBJ_038_oPCAN_RADAR_95c58a83_Tx: ComSignalType=UINT8
            OBJ_REF_PT_LAT_OFFSET_038_oRDR_TRACKER_OBJ_038_oPCAN_RADAR_60f8e1f6_Tx: ComSignalType=UINT16
            OBJ_REF_PT_LONG_OFFSET_038_oRDR_TRACKER_OBJ_038_oPCAN_RADAR_2faa11f5_Tx: ComSignalType=UINT16
            OBJ_TIMESTAMP_OFFSET_038_oRDR_TRACKER_OBJ_038_oPCAN_RADAR_95698ad5_Tx: ComSignalType=UINT8
            OBJ_TRACK_MOTION_MODEL_038_oRDR_TRACKER_OBJ_038_oPCAN_RADAR_596a8b08_Tx: ComSignalType=UINT8
            OBJ_VEH_TRACK_FLAG_038_oRDR_TRACKER_OBJ_038_oPCAN_RADAR_db407d55_Tx: ComSignalType=BOOLEAN
            OBJ_VELOCITY_ERR_CRR_COEF_038_oRDR_TRACKER_OBJ_038_oPCAN_RADAR_fcdf1c29_Tx: ComSignalType=UINT8
            OBJ_VELOCITY_LAT_038_oRDR_TRACKER_OBJ_038_oPCAN_RADAR_f36999a3_Tx: ComSignalType=UINT16
            OBJ_VELOCITY_LAT_ERR_038_oRDR_TRACKER_OBJ_038_oPCAN_RADAR_c793e9f2_Tx: ComSignalType=UINT8
            OBJ_VELOCITY_LONG_038_oRDR_TRACKER_OBJ_038_oPCAN_RADAR_a3e4e165_Tx: ComSignalType=UINT16
            OBJ_VELOCITY_LONG_ERR_038_oRDR_TRACKER_OBJ_038_oPCAN_RADAR_2b11d632_Tx: ComSignalType=UINT8
            OBJ_YAW_ANGLE_038_oRDR_TRACKER_OBJ_038_oPCAN_RADAR_1fd5dde3_Tx: ComSignalType=UINT16
            OBJ_YAW_ANGLE_ERR_038_oRDR_TRACKER_OBJ_038_oPCAN_RADAR_cad8db34_Tx: ComSignalType=UINT8
            OBJ_YAW_RATE_038_oRDR_TRACKER_OBJ_038_oPCAN_RADAR_3a5af8a4_Tx: ComSignalType=UINT16
            OBJ_YAW_RATE_ERR_038_oRDR_TRACKER_OBJ_038_oPCAN_RADAR_05826f78_Tx: ComSignalType=UINT8
        SG_TrackerObject039_oRDR_TRACKER_OBJ_039_oPCAN_RADAR_f76c39c3_Tx
          49 x ComGroupSignal:
            OBJ_ACCELERATION_LAT_039_oRDR_TRACKER_OBJ_039_oPCAN_RADAR_f94862b4_Tx: ComSignalType=UINT16
            OBJ_ACCELERATION_LAT_ERR_039_oRDR_TRACKER_OBJ_039_oPCAN_RADAR_2cbc580a_Tx: ComSignalType=UINT8
            OBJ_ACCELERATION_LONG_039_oRDR_TRACKER_OBJ_039_oPCAN_RADAR_8bb83b54_Tx: ComSignalType=UINT16
            OBJ_ACCELERATION_LONG_ERR_039_oRDR_TRACKER_OBJ_039_oPCAN_RADAR_3319fda0_Tx: ComSignalType=UINT8
            OBJ_ACCEL_ERR_CRR_COEF_039_oRDR_TRACKER_OBJ_039_oPCAN_RADAR_93badcc6_Tx: ComSignalType=UINT8
            OBJ_ALIVE_TIME_039_oRDR_TRACKER_OBJ_039_oPCAN_RADAR_ebd970e8_Tx: ComSignalType=UINT16
            OBJ_CLS_TYPE1_039_oRDR_TRACKER_OBJ_039_oPCAN_RADAR_7c0291ce_Tx: ComSignalType=UINT8
            OBJ_CLS_TYPE1_PROB_039_oRDR_TRACKER_OBJ_039_oPCAN_RADAR_d45a463d_Tx: ComSignalType=UINT8
            OBJ_CLS_TYPE2_039_oRDR_TRACKER_OBJ_039_oPCAN_RADAR_31ea91a9_Tx: ComSignalType=UINT8
            OBJ_CLS_TYPE2_PROB_039_oRDR_TRACKER_OBJ_039_oPCAN_RADAR_1d6e5d30_Tx: ComSignalType=UINT8
            OBJ_CLS_TYPE3_039_oRDR_TRACKER_OBJ_039_oPCAN_RADAR_bc626c4b_Tx: ComSignalType=UINT8
            OBJ_CLS_TYPE3_PROB_039_oRDR_TRACKER_OBJ_039_oPCAN_RADAR_5a7dabcb_Tx: ComSignalType=UINT8
            OBJ_CLS_TYPE4_039_oRDR_TRACKER_OBJ_039_oPCAN_RADAR_aa3a9167_Tx: ComSignalType=UINT8
            OBJ_CLS_TYPE4_PROB_039_oRDR_TRACKER_OBJ_039_oPCAN_RADAR_54776d6b_Tx: ComSignalType=UINT8
            OBJ_CLS_TYPE5_039_oRDR_TRACKER_OBJ_039_oPCAN_RADAR_27b26c85_Tx: ComSignalType=UINT8
            OBJ_CLS_TYPE5_PROB_039_oRDR_TRACKER_OBJ_039_oPCAN_RADAR_13649b90_Tx: ComSignalType=UINT8
            OBJ_CLS_TYPE6_039_oRDR_TRACKER_OBJ_039_oPCAN_RADAR_6a5a6ce2_Tx: ComSignalType=UINT8
            OBJ_CLS_TYPE6_PROB_039_oRDR_TRACKER_OBJ_039_oPCAN_RADAR_da50809d_Tx: ComSignalType=UINT8
            OBJ_DIMENSION_LENGTH_039_oRDR_TRACKER_OBJ_039_oPCAN_RADAR_3e9cc28a_Tx: ComSignalType=UINT16
            OBJ_DIMENSION_LENGTH_ERR_039_oRDR_TRACKER_OBJ_039_oPCAN_RADAR_0564ddf0_Tx: ComSignalType=UINT16
            OBJ_DIMENSION_WIDTH_039_oRDR_TRACKER_OBJ_039_oPCAN_RADAR_1d523527_Tx: ComSignalType=UINT16
            OBJ_DIMENSION_WIDTH_ERR_039_oRDR_TRACKER_OBJ_039_oPCAN_RADAR_fdf0f2cf_Tx: ComSignalType=UINT8
            OBJ_EXISTENCE_PROB_039_oRDR_TRACKER_OBJ_039_oPCAN_RADAR_16eeb11a_Tx: ComSignalType=UINT16
            OBJ_GROUP_ID_039_oRDR_TRACKER_OBJ_039_oPCAN_RADAR_9f9ca5b7_Tx: ComSignalType=UINT8
            OBJ_ID_039_oRDR_TRACKER_OBJ_039_oPCAN_RADAR_6cb28eb0_Tx: ComSignalType=UINT8
            OBJ_MEASUREMENT_STATUS_039_oRDR_TRACKER_OBJ_039_oPCAN_RADAR_1360fc0d_Tx: ComSignalType=UINT8
            OBJ_MH_CRC16_039_oRDR_TRACKER_OBJ_039_oPCAN_RADAR_6f004b31_Tx: ComSignalType=UINT16
            OBJ_MH_CYCLE_COUNTER_039_oRDR_TRACKER_OBJ_039_oPCAN_RADAR_1ee411d0_Tx: ComSignalType=UINT8
            OBJ_MOVEMENT_STATUS_039_oRDR_TRACKER_OBJ_039_oPCAN_RADAR_3cce6941_Tx: ComSignalType=UINT8
            OBJ_POS_ERR_CRR_COEF_039_oRDR_TRACKER_OBJ_039_oPCAN_RADAR_acb1a97b_Tx: ComSignalType=UINT8
            OBJ_POS_LAT_039_oRDR_TRACKER_OBJ_039_oPCAN_RADAR_4e1e5437_Tx: ComSignalType=UINT16
            OBJ_POS_LAT_ERR_039_oRDR_TRACKER_OBJ_039_oPCAN_RADAR_4a520400_Tx: ComSignalType=UINT8
            OBJ_POS_LONG_039_oRDR_TRACKER_OBJ_039_oPCAN_RADAR_ffbebff8_Tx: ComSignalType=UINT16
            OBJ_POS_LONG_ERR_039_oRDR_TRACKER_OBJ_039_oPCAN_RADAR_d3aafae2_Tx: ComSignalType=UINT8
            OBJ_RCS_039_oRDR_TRACKER_OBJ_039_oPCAN_RADAR_6cd10230_Tx: ComSignalType=UINT8
            OBJ_REF_PT_LAT_OFFSET_039_oRDR_TRACKER_OBJ_039_oPCAN_RADAR_99ec6945_Tx: ComSignalType=UINT16
            OBJ_REF_PT_LONG_OFFSET_039_oRDR_TRACKER_OBJ_039_oPCAN_RADAR_d6be9946_Tx: ComSignalType=UINT16
            OBJ_TIMESTAMP_OFFSET_039_oRDR_TRACKER_OBJ_039_oPCAN_RADAR_6c7d0266_Tx: ComSignalType=UINT8
            OBJ_TRACK_MOTION_MODEL_039_oRDR_TRACKER_OBJ_039_oPCAN_RADAR_a07e03bb_Tx: ComSignalType=UINT8
            OBJ_VEH_TRACK_FLAG_039_oRDR_TRACKER_OBJ_039_oPCAN_RADAR_2254f5e6_Tx: ComSignalType=BOOLEAN
            OBJ_VELOCITY_ERR_CRR_COEF_039_oRDR_TRACKER_OBJ_039_oPCAN_RADAR_05cb949a_Tx: ComSignalType=UINT8
            OBJ_VELOCITY_LAT_039_oRDR_TRACKER_OBJ_039_oPCAN_RADAR_0a7d1110_Tx: ComSignalType=UINT16
            OBJ_VELOCITY_LAT_ERR_039_oRDR_TRACKER_OBJ_039_oPCAN_RADAR_3e876141_Tx: ComSignalType=UINT8
            OBJ_VELOCITY_LONG_039_oRDR_TRACKER_OBJ_039_oPCAN_RADAR_5af069d6_Tx: ComSignalType=UINT16
            OBJ_VELOCITY_LONG_ERR_039_oRDR_TRACKER_OBJ_039_oPCAN_RADAR_d2055e81_Tx: ComSignalType=UINT8
            OBJ_YAW_ANGLE_039_oRDR_TRACKER_OBJ_039_oPCAN_RADAR_e6c15550_Tx: ComSignalType=UINT16
            OBJ_YAW_ANGLE_ERR_039_oRDR_TRACKER_OBJ_039_oPCAN_RADAR_33cc5387_Tx: ComSignalType=UINT8
            OBJ_YAW_RATE_039_oRDR_TRACKER_OBJ_039_oPCAN_RADAR_c34e7017_Tx: ComSignalType=UINT16
            OBJ_YAW_RATE_ERR_039_oRDR_TRACKER_OBJ_039_oPCAN_RADAR_fc96e7cb_Tx: ComSignalType=UINT8
        SG_TrackerObject040_oRDR_TRACKER_OBJ_040_oPCAN_RADAR_cd9c2a97_Tx
          49 x ComGroupSignal:
            OBJ_ACCELERATION_LAT_040_oRDR_TRACKER_OBJ_040_oPCAN_RADAR_c3b871e0_Tx: ComSignalType=UINT16
            OBJ_ACCELERATION_LAT_ERR_040_oRDR_TRACKER_OBJ_040_oPCAN_RADAR_164c4b5e_Tx: ComSignalType=UINT8
            OBJ_ACCELERATION_LONG_040_oRDR_TRACKER_OBJ_040_oPCAN_RADAR_b1482800_Tx: ComSignalType=UINT16
            OBJ_ACCELERATION_LONG_ERR_040_oRDR_TRACKER_OBJ_040_oPCAN_RADAR_09e9eef4_Tx: ComSignalType=UINT8
            OBJ_ACCEL_ERR_CRR_COEF_040_oRDR_TRACKER_OBJ_040_oPCAN_RADAR_a94acf92_Tx: ComSignalType=UINT8
            OBJ_ALIVE_TIME_040_oRDR_TRACKER_OBJ_040_oPCAN_RADAR_d12963bc_Tx: ComSignalType=UINT16
            OBJ_CLS_TYPE1_040_oRDR_TRACKER_OBJ_040_oPCAN_RADAR_46f2829a_Tx: ComSignalType=UINT8
            OBJ_CLS_TYPE1_PROB_040_oRDR_TRACKER_OBJ_040_oPCAN_RADAR_eeaa5569_Tx: ComSignalType=UINT8
            OBJ_CLS_TYPE2_040_oRDR_TRACKER_OBJ_040_oPCAN_RADAR_0b1a82fd_Tx: ComSignalType=UINT8
            OBJ_CLS_TYPE2_PROB_040_oRDR_TRACKER_OBJ_040_oPCAN_RADAR_279e4e64_Tx: ComSignalType=UINT8
            OBJ_CLS_TYPE3_040_oRDR_TRACKER_OBJ_040_oPCAN_RADAR_86927f1f_Tx: ComSignalType=UINT8
            OBJ_CLS_TYPE3_PROB_040_oRDR_TRACKER_OBJ_040_oPCAN_RADAR_608db89f_Tx: ComSignalType=UINT8
            OBJ_CLS_TYPE4_040_oRDR_TRACKER_OBJ_040_oPCAN_RADAR_90ca8233_Tx: ComSignalType=UINT8
            OBJ_CLS_TYPE4_PROB_040_oRDR_TRACKER_OBJ_040_oPCAN_RADAR_6e877e3f_Tx: ComSignalType=UINT8
            OBJ_CLS_TYPE5_040_oRDR_TRACKER_OBJ_040_oPCAN_RADAR_1d427fd1_Tx: ComSignalType=UINT8
            OBJ_CLS_TYPE5_PROB_040_oRDR_TRACKER_OBJ_040_oPCAN_RADAR_299488c4_Tx: ComSignalType=UINT8
            OBJ_CLS_TYPE6_040_oRDR_TRACKER_OBJ_040_oPCAN_RADAR_50aa7fb6_Tx: ComSignalType=UINT8
            OBJ_CLS_TYPE6_PROB_040_oRDR_TRACKER_OBJ_040_oPCAN_RADAR_e0a093c9_Tx: ComSignalType=UINT8
            OBJ_DIMENSION_LENGTH_040_oRDR_TRACKER_OBJ_040_oPCAN_RADAR_046cd1de_Tx: ComSignalType=UINT16
            OBJ_DIMENSION_LENGTH_ERR_040_oRDR_TRACKER_OBJ_040_oPCAN_RADAR_3f94cea4_Tx: ComSignalType=UINT16
            OBJ_DIMENSION_WIDTH_040_oRDR_TRACKER_OBJ_040_oPCAN_RADAR_27a22673_Tx: ComSignalType=UINT16
            OBJ_DIMENSION_WIDTH_ERR_040_oRDR_TRACKER_OBJ_040_oPCAN_RADAR_c700e19b_Tx: ComSignalType=UINT8
            OBJ_EXISTENCE_PROB_040_oRDR_TRACKER_OBJ_040_oPCAN_RADAR_2c1ea24e_Tx: ComSignalType=UINT16
            OBJ_GROUP_ID_040_oRDR_TRACKER_OBJ_040_oPCAN_RADAR_a56cb6e3_Tx: ComSignalType=UINT8
            OBJ_ID_040_oRDR_TRACKER_OBJ_040_oPCAN_RADAR_56429de4_Tx: ComSignalType=UINT8
            OBJ_MEASUREMENT_STATUS_040_oRDR_TRACKER_OBJ_040_oPCAN_RADAR_2990ef59_Tx: ComSignalType=UINT8
            OBJ_MH_CRC16_040_oRDR_TRACKER_OBJ_040_oPCAN_RADAR_55f05865_Tx: ComSignalType=UINT16
            OBJ_MH_CYCLE_COUNTER_040_oRDR_TRACKER_OBJ_040_oPCAN_RADAR_24140284_Tx: ComSignalType=UINT8
            OBJ_MOVEMENT_STATUS_040_oRDR_TRACKER_OBJ_040_oPCAN_RADAR_063e7a15_Tx: ComSignalType=UINT8
            OBJ_POS_ERR_CRR_COEF_040_oRDR_TRACKER_OBJ_040_oPCAN_RADAR_9641ba2f_Tx: ComSignalType=UINT8
            OBJ_POS_LAT_040_oRDR_TRACKER_OBJ_040_oPCAN_RADAR_74ee4763_Tx: ComSignalType=UINT16
            OBJ_POS_LAT_ERR_040_oRDR_TRACKER_OBJ_040_oPCAN_RADAR_70a21754_Tx: ComSignalType=UINT8
            OBJ_POS_LONG_040_oRDR_TRACKER_OBJ_040_oPCAN_RADAR_c54eacac_Tx: ComSignalType=UINT16
            OBJ_POS_LONG_ERR_040_oRDR_TRACKER_OBJ_040_oPCAN_RADAR_e95ae9b6_Tx: ComSignalType=UINT8
            OBJ_RCS_040_oRDR_TRACKER_OBJ_040_oPCAN_RADAR_56211164_Tx: ComSignalType=UINT8
            OBJ_REF_PT_LAT_OFFSET_040_oRDR_TRACKER_OBJ_040_oPCAN_RADAR_a31c7a11_Tx: ComSignalType=UINT16
            OBJ_REF_PT_LONG_OFFSET_040_oRDR_TRACKER_OBJ_040_oPCAN_RADAR_ec4e8a12_Tx: ComSignalType=UINT16
            OBJ_TIMESTAMP_OFFSET_040_oRDR_TRACKER_OBJ_040_oPCAN_RADAR_568d1132_Tx: ComSignalType=UINT8
            OBJ_TRACK_MOTION_MODEL_040_oRDR_TRACKER_OBJ_040_oPCAN_RADAR_9a8e10ef_Tx: ComSignalType=UINT8
            OBJ_VEH_TRACK_FLAG_040_oRDR_TRACKER_OBJ_040_oPCAN_RADAR_18a4e6b2_Tx: ComSignalType=BOOLEAN
            OBJ_VELOCITY_ERR_CRR_COEF_040_oRDR_TRACKER_OBJ_040_oPCAN_RADAR_3f3b87ce_Tx: ComSignalType=UINT8
            OBJ_VELOCITY_LAT_040_oRDR_TRACKER_OBJ_040_oPCAN_RADAR_308d0244_Tx: ComSignalType=UINT16
            OBJ_VELOCITY_LAT_ERR_040_oRDR_TRACKER_OBJ_040_oPCAN_RADAR_04777215_Tx: ComSignalType=UINT8
            OBJ_VELOCITY_LONG_040_oRDR_TRACKER_OBJ_040_oPCAN_RADAR_60007a82_Tx: ComSignalType=UINT16
            OBJ_VELOCITY_LONG_ERR_040_oRDR_TRACKER_OBJ_040_oPCAN_RADAR_e8f54dd5_Tx: ComSignalType=UINT8
            OBJ_YAW_ANGLE_040_oRDR_TRACKER_OBJ_040_oPCAN_RADAR_dc314604_Tx: ComSignalType=UINT16
            OBJ_YAW_ANGLE_ERR_040_oRDR_TRACKER_OBJ_040_oPCAN_RADAR_093c40d3_Tx: ComSignalType=UINT8
            OBJ_YAW_RATE_040_oRDR_TRACKER_OBJ_040_oPCAN_RADAR_f9be6343_Tx: ComSignalType=UINT16
            OBJ_YAW_RATE_ERR_040_oRDR_TRACKER_OBJ_040_oPCAN_RADAR_c666f49f_Tx: ComSignalType=UINT8
        SG_TrackerObject041_oRDR_TRACKER_OBJ_041_oPCAN_RADAR_3488a224_Tx
          49 x ComGroupSignal:
            OBJ_ACCELERATION_LAT_041_oRDR_TRACKER_OBJ_041_oPCAN_RADAR_3aacf953_Tx: ComSignalType=UINT16
            OBJ_ACCELERATION_LAT_ERR_041_oRDR_TRACKER_OBJ_041_oPCAN_RADAR_ef58c3ed_Tx: ComSignalType=UINT8
            OBJ_ACCELERATION_LONG_041_oRDR_TRACKER_OBJ_041_oPCAN_RADAR_485ca0b3_Tx: ComSignalType=UINT16
            OBJ_ACCELERATION_LONG_ERR_041_oRDR_TRACKER_OBJ_041_oPCAN_RADAR_f0fd6647_Tx: ComSignalType=UINT8
            OBJ_ACCEL_ERR_CRR_COEF_041_oRDR_TRACKER_OBJ_041_oPCAN_RADAR_505e4721_Tx: ComSignalType=UINT8
            OBJ_ALIVE_TIME_041_oRDR_TRACKER_OBJ_041_oPCAN_RADAR_283deb0f_Tx: ComSignalType=UINT16
            OBJ_CLS_TYPE1_041_oRDR_TRACKER_OBJ_041_oPCAN_RADAR_bfe60a29_Tx: ComSignalType=UINT8
            OBJ_CLS_TYPE1_PROB_041_oRDR_TRACKER_OBJ_041_oPCAN_RADAR_17beddda_Tx: ComSignalType=UINT8
            OBJ_CLS_TYPE2_041_oRDR_TRACKER_OBJ_041_oPCAN_RADAR_f20e0a4e_Tx: ComSignalType=UINT8
            OBJ_CLS_TYPE2_PROB_041_oRDR_TRACKER_OBJ_041_oPCAN_RADAR_de8ac6d7_Tx: ComSignalType=UINT8
            OBJ_CLS_TYPE3_041_oRDR_TRACKER_OBJ_041_oPCAN_RADAR_7f86f7ac_Tx: ComSignalType=UINT8
            OBJ_CLS_TYPE3_PROB_041_oRDR_TRACKER_OBJ_041_oPCAN_RADAR_9999302c_Tx: ComSignalType=UINT8
            OBJ_CLS_TYPE4_041_oRDR_TRACKER_OBJ_041_oPCAN_RADAR_69de0a80_Tx: ComSignalType=UINT8
            OBJ_CLS_TYPE4_PROB_041_oRDR_TRACKER_OBJ_041_oPCAN_RADAR_9793f68c_Tx: ComSignalType=UINT8
            OBJ_CLS_TYPE5_041_oRDR_TRACKER_OBJ_041_oPCAN_RADAR_e456f762_Tx: ComSignalType=UINT8
            OBJ_CLS_TYPE5_PROB_041_oRDR_TRACKER_OBJ_041_oPCAN_RADAR_d0800077_Tx: ComSignalType=UINT8
            OBJ_CLS_TYPE6_041_oRDR_TRACKER_OBJ_041_oPCAN_RADAR_a9bef705_Tx: ComSignalType=UINT8
            OBJ_CLS_TYPE6_PROB_041_oRDR_TRACKER_OBJ_041_oPCAN_RADAR_19b41b7a_Tx: ComSignalType=UINT8
            OBJ_DIMENSION_LENGTH_041_oRDR_TRACKER_OBJ_041_oPCAN_RADAR_fd78596d_Tx: ComSignalType=UINT16
            OBJ_DIMENSION_LENGTH_ERR_041_oRDR_TRACKER_OBJ_041_oPCAN_RADAR_c6804617_Tx: ComSignalType=UINT16
            OBJ_DIMENSION_WIDTH_041_oRDR_TRACKER_OBJ_041_oPCAN_RADAR_deb6aec0_Tx: ComSignalType=UINT16
            OBJ_DIMENSION_WIDTH_ERR_041_oRDR_TRACKER_OBJ_041_oPCAN_RADAR_3e146928_Tx: ComSignalType=UINT8
            OBJ_EXISTENCE_PROB_041_oRDR_TRACKER_OBJ_041_oPCAN_RADAR_d50a2afd_Tx: ComSignalType=UINT16
            OBJ_GROUP_ID_041_oRDR_TRACKER_OBJ_041_oPCAN_RADAR_5c783e50_Tx: ComSignalType=UINT8
            OBJ_ID_041_oRDR_TRACKER_OBJ_041_oPCAN_RADAR_af561557_Tx: ComSignalType=UINT8
            OBJ_MEASUREMENT_STATUS_041_oRDR_TRACKER_OBJ_041_oPCAN_RADAR_d08467ea_Tx: ComSignalType=UINT8
            OBJ_MH_CRC16_041_oRDR_TRACKER_OBJ_041_oPCAN_RADAR_ace4d0d6_Tx: ComSignalType=UINT16
            OBJ_MH_CYCLE_COUNTER_041_oRDR_TRACKER_OBJ_041_oPCAN_RADAR_dd008a37_Tx: ComSignalType=UINT8
            OBJ_MOVEMENT_STATUS_041_oRDR_TRACKER_OBJ_041_oPCAN_RADAR_ff2af2a6_Tx: ComSignalType=UINT8
            OBJ_POS_ERR_CRR_COEF_041_oRDR_TRACKER_OBJ_041_oPCAN_RADAR_6f55329c_Tx: ComSignalType=UINT8
            OBJ_POS_LAT_041_oRDR_TRACKER_OBJ_041_oPCAN_RADAR_8dfacfd0_Tx: ComSignalType=UINT16
            OBJ_POS_LAT_ERR_041_oRDR_TRACKER_OBJ_041_oPCAN_RADAR_89b69fe7_Tx: ComSignalType=UINT8
            OBJ_POS_LONG_041_oRDR_TRACKER_OBJ_041_oPCAN_RADAR_3c5a241f_Tx: ComSignalType=UINT16
            OBJ_POS_LONG_ERR_041_oRDR_TRACKER_OBJ_041_oPCAN_RADAR_104e6105_Tx: ComSignalType=UINT8
            OBJ_RCS_041_oRDR_TRACKER_OBJ_041_oPCAN_RADAR_af3599d7_Tx: ComSignalType=UINT8
            OBJ_REF_PT_LAT_OFFSET_041_oRDR_TRACKER_OBJ_041_oPCAN_RADAR_5a08f2a2_Tx: ComSignalType=UINT16
            OBJ_REF_PT_LONG_OFFSET_041_oRDR_TRACKER_OBJ_041_oPCAN_RADAR_155a02a1_Tx: ComSignalType=UINT16
            OBJ_TIMESTAMP_OFFSET_041_oRDR_TRACKER_OBJ_041_oPCAN_RADAR_af999981_Tx: ComSignalType=UINT8
            OBJ_TRACK_MOTION_MODEL_041_oRDR_TRACKER_OBJ_041_oPCAN_RADAR_639a985c_Tx: ComSignalType=UINT8
            OBJ_VEH_TRACK_FLAG_041_oRDR_TRACKER_OBJ_041_oPCAN_RADAR_e1b06e01_Tx: ComSignalType=BOOLEAN
            OBJ_VELOCITY_ERR_CRR_COEF_041_oRDR_TRACKER_OBJ_041_oPCAN_RADAR_c62f0f7d_Tx: ComSignalType=UINT8
            OBJ_VELOCITY_LAT_041_oRDR_TRACKER_OBJ_041_oPCAN_RADAR_c9998af7_Tx: ComSignalType=UINT16
            OBJ_VELOCITY_LAT_ERR_041_oRDR_TRACKER_OBJ_041_oPCAN_RADAR_fd63faa6_Tx: ComSignalType=UINT8
            OBJ_VELOCITY_LONG_041_oRDR_TRACKER_OBJ_041_oPCAN_RADAR_9914f231_Tx: ComSignalType=UINT16
            OBJ_VELOCITY_LONG_ERR_041_oRDR_TRACKER_OBJ_041_oPCAN_RADAR_11e1c566_Tx: ComSignalType=UINT8
            OBJ_YAW_ANGLE_041_oRDR_TRACKER_OBJ_041_oPCAN_RADAR_2525ceb7_Tx: ComSignalType=UINT16
            OBJ_YAW_ANGLE_ERR_041_oRDR_TRACKER_OBJ_041_oPCAN_RADAR_f028c860_Tx: ComSignalType=UINT8
            OBJ_YAW_RATE_041_oRDR_TRACKER_OBJ_041_oPCAN_RADAR_00aaebf0_Tx: ComSignalType=UINT16
            OBJ_YAW_RATE_ERR_041_oRDR_TRACKER_OBJ_041_oPCAN_RADAR_3f727c2c_Tx: ComSignalType=UINT8
        SG_TrackerObject042_oRDR_TRACKER_OBJ_042_oPCAN_RADAR_e4c43db0_Tx
          49 x ComGroupSignal:
            OBJ_ACCELERATION_LAT_042_oRDR_TRACKER_OBJ_042_oPCAN_RADAR_eae066c7_Tx: ComSignalType=UINT16
            OBJ_ACCELERATION_LAT_ERR_042_oRDR_TRACKER_OBJ_042_oPCAN_RADAR_3f145c79_Tx: ComSignalType=UINT8
            OBJ_ACCELERATION_LONG_042_oRDR_TRACKER_OBJ_042_oPCAN_RADAR_98103f27_Tx: ComSignalType=UINT16
            OBJ_ACCELERATION_LONG_ERR_042_oRDR_TRACKER_OBJ_042_oPCAN_RADAR_20b1f9d3_Tx: ComSignalType=UINT8
            OBJ_ACCEL_ERR_CRR_COEF_042_oRDR_TRACKER_OBJ_042_oPCAN_RADAR_8012d8b5_Tx: ComSignalType=UINT8
            OBJ_ALIVE_TIME_042_oRDR_TRACKER_OBJ_042_oPCAN_RADAR_f871749b_Tx: ComSignalType=UINT16
            OBJ_CLS_TYPE1_042_oRDR_TRACKER_OBJ_042_oPCAN_RADAR_6faa95bd_Tx: ComSignalType=UINT8
            OBJ_CLS_TYPE1_PROB_042_oRDR_TRACKER_OBJ_042_oPCAN_RADAR_c7f2424e_Tx: ComSignalType=UINT8
            OBJ_CLS_TYPE2_042_oRDR_TRACKER_OBJ_042_oPCAN_RADAR_224295da_Tx: ComSignalType=UINT8
            OBJ_CLS_TYPE2_PROB_042_oRDR_TRACKER_OBJ_042_oPCAN_RADAR_0ec65943_Tx: ComSignalType=UINT8
            OBJ_CLS_TYPE3_042_oRDR_TRACKER_OBJ_042_oPCAN_RADAR_afca6838_Tx: ComSignalType=UINT8
            OBJ_CLS_TYPE3_PROB_042_oRDR_TRACKER_OBJ_042_oPCAN_RADAR_49d5afb8_Tx: ComSignalType=UINT8
            OBJ_CLS_TYPE4_042_oRDR_TRACKER_OBJ_042_oPCAN_RADAR_b9929514_Tx: ComSignalType=UINT8
            OBJ_CLS_TYPE4_PROB_042_oRDR_TRACKER_OBJ_042_oPCAN_RADAR_47df6918_Tx: ComSignalType=UINT8
            OBJ_CLS_TYPE5_042_oRDR_TRACKER_OBJ_042_oPCAN_RADAR_341a68f6_Tx: ComSignalType=UINT8
            OBJ_CLS_TYPE5_PROB_042_oRDR_TRACKER_OBJ_042_oPCAN_RADAR_00cc9fe3_Tx: ComSignalType=UINT8
            OBJ_CLS_TYPE6_042_oRDR_TRACKER_OBJ_042_oPCAN_RADAR_79f26891_Tx: ComSignalType=UINT8
            OBJ_CLS_TYPE6_PROB_042_oRDR_TRACKER_OBJ_042_oPCAN_RADAR_c9f884ee_Tx: ComSignalType=UINT8
            OBJ_DIMENSION_LENGTH_042_oRDR_TRACKER_OBJ_042_oPCAN_RADAR_2d34c6f9_Tx: ComSignalType=UINT16
            OBJ_DIMENSION_LENGTH_ERR_042_oRDR_TRACKER_OBJ_042_oPCAN_RADAR_16ccd983_Tx: ComSignalType=UINT16
            OBJ_DIMENSION_WIDTH_042_oRDR_TRACKER_OBJ_042_oPCAN_RADAR_0efa3154_Tx: ComSignalType=UINT16
            OBJ_DIMENSION_WIDTH_ERR_042_oRDR_TRACKER_OBJ_042_oPCAN_RADAR_ee58f6bc_Tx: ComSignalType=UINT8
            OBJ_EXISTENCE_PROB_042_oRDR_TRACKER_OBJ_042_oPCAN_RADAR_0546b569_Tx: ComSignalType=UINT16
            OBJ_GROUP_ID_042_oRDR_TRACKER_OBJ_042_oPCAN_RADAR_8c34a1c4_Tx: ComSignalType=UINT8
            OBJ_ID_042_oRDR_TRACKER_OBJ_042_oPCAN_RADAR_7f1a8ac3_Tx: ComSignalType=UINT8
            OBJ_MEASUREMENT_STATUS_042_oRDR_TRACKER_OBJ_042_oPCAN_RADAR_00c8f87e_Tx: ComSignalType=UINT8
            OBJ_MH_CRC16_042_oRDR_TRACKER_OBJ_042_oPCAN_RADAR_7ca84f42_Tx: ComSignalType=UINT16
            OBJ_MH_CYCLE_COUNTER_042_oRDR_TRACKER_OBJ_042_oPCAN_RADAR_0d4c15a3_Tx: ComSignalType=UINT8
            OBJ_MOVEMENT_STATUS_042_oRDR_TRACKER_OBJ_042_oPCAN_RADAR_2f666d32_Tx: ComSignalType=UINT8
            OBJ_POS_ERR_CRR_COEF_042_oRDR_TRACKER_OBJ_042_oPCAN_RADAR_bf19ad08_Tx: ComSignalType=UINT8
            OBJ_POS_LAT_042_oRDR_TRACKER_OBJ_042_oPCAN_RADAR_5db65044_Tx: ComSignalType=UINT16
            OBJ_POS_LAT_ERR_042_oRDR_TRACKER_OBJ_042_oPCAN_RADAR_59fa0073_Tx: ComSignalType=UINT8
            OBJ_POS_LONG_042_oRDR_TRACKER_OBJ_042_oPCAN_RADAR_ec16bb8b_Tx: ComSignalType=UINT16
            OBJ_POS_LONG_ERR_042_oRDR_TRACKER_OBJ_042_oPCAN_RADAR_c002fe91_Tx: ComSignalType=UINT8
            OBJ_RCS_042_oRDR_TRACKER_OBJ_042_oPCAN_RADAR_7f790643_Tx: ComSignalType=UINT8
            OBJ_REF_PT_LAT_OFFSET_042_oRDR_TRACKER_OBJ_042_oPCAN_RADAR_8a446d36_Tx: ComSignalType=UINT16
            OBJ_REF_PT_LONG_OFFSET_042_oRDR_TRACKER_OBJ_042_oPCAN_RADAR_c5169d35_Tx: ComSignalType=UINT16
            OBJ_TIMESTAMP_OFFSET_042_oRDR_TRACKER_OBJ_042_oPCAN_RADAR_7fd50615_Tx: ComSignalType=UINT8
            OBJ_TRACK_MOTION_MODEL_042_oRDR_TRACKER_OBJ_042_oPCAN_RADAR_b3d607c8_Tx: ComSignalType=UINT8
            OBJ_VEH_TRACK_FLAG_042_oRDR_TRACKER_OBJ_042_oPCAN_RADAR_31fcf195_Tx: ComSignalType=BOOLEAN
            OBJ_VELOCITY_ERR_CRR_COEF_042_oRDR_TRACKER_OBJ_042_oPCAN_RADAR_166390e9_Tx: ComSignalType=UINT8
            OBJ_VELOCITY_LAT_042_oRDR_TRACKER_OBJ_042_oPCAN_RADAR_19d51563_Tx: ComSignalType=UINT16
            OBJ_VELOCITY_LAT_ERR_042_oRDR_TRACKER_OBJ_042_oPCAN_RADAR_2d2f6532_Tx: ComSignalType=UINT8
            OBJ_VELOCITY_LONG_042_oRDR_TRACKER_OBJ_042_oPCAN_RADAR_49586da5_Tx: ComSignalType=UINT16
            OBJ_VELOCITY_LONG_ERR_042_oRDR_TRACKER_OBJ_042_oPCAN_RADAR_c1ad5af2_Tx: ComSignalType=UINT8
            OBJ_YAW_ANGLE_042_oRDR_TRACKER_OBJ_042_oPCAN_RADAR_f5695123_Tx: ComSignalType=UINT16
            OBJ_YAW_ANGLE_ERR_042_oRDR_TRACKER_OBJ_042_oPCAN_RADAR_206457f4_Tx: ComSignalType=UINT8
            OBJ_YAW_RATE_042_oRDR_TRACKER_OBJ_042_oPCAN_RADAR_d0e67464_Tx: ComSignalType=UINT16
            OBJ_YAW_RATE_ERR_042_oRDR_TRACKER_OBJ_042_oPCAN_RADAR_ef3ee3b8_Tx: ComSignalType=UINT8
        SG_TrackerObject043_oRDR_TRACKER_OBJ_043_oPCAN_RADAR_1dd0b503_Tx
          49 x ComGroupSignal:
            OBJ_ACCELERATION_LAT_043_oRDR_TRACKER_OBJ_043_oPCAN_RADAR_13f4ee74_Tx: ComSignalType=UINT16
            OBJ_ACCELERATION_LAT_ERR_043_oRDR_TRACKER_OBJ_043_oPCAN_RADAR_c600d4ca_Tx: ComSignalType=UINT8
            OBJ_ACCELERATION_LONG_043_oRDR_TRACKER_OBJ_043_oPCAN_RADAR_6104b794_Tx: ComSignalType=UINT16
            OBJ_ACCELERATION_LONG_ERR_043_oRDR_TRACKER_OBJ_043_oPCAN_RADAR_d9a57160_Tx: ComSignalType=UINT8
            OBJ_ACCEL_ERR_CRR_COEF_043_oRDR_TRACKER_OBJ_043_oPCAN_RADAR_79065006_Tx: ComSignalType=UINT8
            OBJ_ALIVE_TIME_043_oRDR_TRACKER_OBJ_043_oPCAN_RADAR_0165fc28_Tx: ComSignalType=UINT16
            OBJ_CLS_TYPE1_043_oRDR_TRACKER_OBJ_043_oPCAN_RADAR_96be1d0e_Tx: ComSignalType=UINT8
            OBJ_CLS_TYPE1_PROB_043_oRDR_TRACKER_OBJ_043_oPCAN_RADAR_3ee6cafd_Tx: ComSignalType=UINT8
            OBJ_CLS_TYPE2_043_oRDR_TRACKER_OBJ_043_oPCAN_RADAR_db561d69_Tx: ComSignalType=UINT8
            OBJ_CLS_TYPE2_PROB_043_oRDR_TRACKER_OBJ_043_oPCAN_RADAR_f7d2d1f0_Tx: ComSignalType=UINT8
            OBJ_CLS_TYPE3_043_oRDR_TRACKER_OBJ_043_oPCAN_RADAR_56dee08b_Tx: ComSignalType=UINT8
            OBJ_CLS_TYPE3_PROB_043_oRDR_TRACKER_OBJ_043_oPCAN_RADAR_b0c1270b_Tx: ComSignalType=UINT8
            OBJ_CLS_TYPE4_043_oRDR_TRACKER_OBJ_043_oPCAN_RADAR_40861da7_Tx: ComSignalType=UINT8
            OBJ_CLS_TYPE4_PROB_043_oRDR_TRACKER_OBJ_043_oPCAN_RADAR_becbe1ab_Tx: ComSignalType=UINT8
            OBJ_CLS_TYPE5_043_oRDR_TRACKER_OBJ_043_oPCAN_RADAR_cd0ee045_Tx: ComSignalType=UINT8
            OBJ_CLS_TYPE5_PROB_043_oRDR_TRACKER_OBJ_043_oPCAN_RADAR_f9d81750_Tx: ComSignalType=UINT8
            OBJ_CLS_TYPE6_043_oRDR_TRACKER_OBJ_043_oPCAN_RADAR_80e6e022_Tx: ComSignalType=UINT8
            OBJ_CLS_TYPE6_PROB_043_oRDR_TRACKER_OBJ_043_oPCAN_RADAR_30ec0c5d_Tx: ComSignalType=UINT8
            OBJ_DIMENSION_LENGTH_043_oRDR_TRACKER_OBJ_043_oPCAN_RADAR_d4204e4a_Tx: ComSignalType=UINT16
            OBJ_DIMENSION_LENGTH_ERR_043_oRDR_TRACKER_OBJ_043_oPCAN_RADAR_efd85130_Tx: ComSignalType=UINT16
            OBJ_DIMENSION_WIDTH_043_oRDR_TRACKER_OBJ_043_oPCAN_RADAR_f7eeb9e7_Tx: ComSignalType=UINT16
            OBJ_DIMENSION_WIDTH_ERR_043_oRDR_TRACKER_OBJ_043_oPCAN_RADAR_174c7e0f_Tx: ComSignalType=UINT8
            OBJ_EXISTENCE_PROB_043_oRDR_TRACKER_OBJ_043_oPCAN_RADAR_fc523dda_Tx: ComSignalType=UINT16
            OBJ_GROUP_ID_043_oRDR_TRACKER_OBJ_043_oPCAN_RADAR_75202977_Tx: ComSignalType=UINT8
            OBJ_ID_043_oRDR_TRACKER_OBJ_043_oPCAN_RADAR_860e0270_Tx: ComSignalType=UINT8
            OBJ_MEASUREMENT_STATUS_043_oRDR_TRACKER_OBJ_043_oPCAN_RADAR_f9dc70cd_Tx: ComSignalType=UINT8
            OBJ_MH_CRC16_043_oRDR_TRACKER_OBJ_043_oPCAN_RADAR_85bcc7f1_Tx: ComSignalType=UINT16
            OBJ_MH_CYCLE_COUNTER_043_oRDR_TRACKER_OBJ_043_oPCAN_RADAR_f4589d10_Tx: ComSignalType=UINT8
            OBJ_MOVEMENT_STATUS_043_oRDR_TRACKER_OBJ_043_oPCAN_RADAR_d672e581_Tx: ComSignalType=UINT8
            OBJ_POS_ERR_CRR_COEF_043_oRDR_TRACKER_OBJ_043_oPCAN_RADAR_460d25bb_Tx: ComSignalType=UINT8
            OBJ_POS_LAT_043_oRDR_TRACKER_OBJ_043_oPCAN_RADAR_a4a2d8f7_Tx: ComSignalType=UINT16
            OBJ_POS_LAT_ERR_043_oRDR_TRACKER_OBJ_043_oPCAN_RADAR_a0ee88c0_Tx: ComSignalType=UINT8
            OBJ_POS_LONG_043_oRDR_TRACKER_OBJ_043_oPCAN_RADAR_15023338_Tx: ComSignalType=UINT16
            OBJ_POS_LONG_ERR_043_oRDR_TRACKER_OBJ_043_oPCAN_RADAR_39167622_Tx: ComSignalType=UINT8
            OBJ_RCS_043_oRDR_TRACKER_OBJ_043_oPCAN_RADAR_866d8ef0_Tx: ComSignalType=UINT8
            OBJ_REF_PT_LAT_OFFSET_043_oRDR_TRACKER_OBJ_043_oPCAN_RADAR_7350e585_Tx: ComSignalType=UINT16
            OBJ_REF_PT_LONG_OFFSET_043_oRDR_TRACKER_OBJ_043_oPCAN_RADAR_3c021586_Tx: ComSignalType=UINT16
            OBJ_TIMESTAMP_OFFSET_043_oRDR_TRACKER_OBJ_043_oPCAN_RADAR_86c18ea6_Tx: ComSignalType=UINT8
            OBJ_TRACK_MOTION_MODEL_043_oRDR_TRACKER_OBJ_043_oPCAN_RADAR_4ac28f7b_Tx: ComSignalType=UINT8
            OBJ_VEH_TRACK_FLAG_043_oRDR_TRACKER_OBJ_043_oPCAN_RADAR_c8e87926_Tx: ComSignalType=BOOLEAN
            OBJ_VELOCITY_ERR_CRR_COEF_043_oRDR_TRACKER_OBJ_043_oPCAN_RADAR_ef77185a_Tx: ComSignalType=UINT8
            OBJ_VELOCITY_LAT_043_oRDR_TRACKER_OBJ_043_oPCAN_RADAR_e0c19dd0_Tx: ComSignalType=UINT16
            OBJ_VELOCITY_LAT_ERR_043_oRDR_TRACKER_OBJ_043_oPCAN_RADAR_d43bed81_Tx: ComSignalType=UINT8
            OBJ_VELOCITY_LONG_043_oRDR_TRACKER_OBJ_043_oPCAN_RADAR_b04ce516_Tx: ComSignalType=UINT16
            OBJ_VELOCITY_LONG_ERR_043_oRDR_TRACKER_OBJ_043_oPCAN_RADAR_38b9d241_Tx: ComSignalType=UINT8
            OBJ_YAW_ANGLE_043_oRDR_TRACKER_OBJ_043_oPCAN_RADAR_0c7dd990_Tx: ComSignalType=UINT16
            OBJ_YAW_ANGLE_ERR_043_oRDR_TRACKER_OBJ_043_oPCAN_RADAR_d970df47_Tx: ComSignalType=UINT8
            OBJ_YAW_RATE_043_oRDR_TRACKER_OBJ_043_oPCAN_RADAR_29f2fcd7_Tx: ComSignalType=UINT16
            OBJ_YAW_RATE_ERR_043_oRDR_TRACKER_OBJ_043_oPCAN_RADAR_162a6b0b_Tx: ComSignalType=UINT8
        SG_TrackerObject044_oRDR_TRACKER_OBJ_044_oPCAN_RADAR_9f2c04d9_Tx
          49 x ComGroupSignal:
            OBJ_ACCELERATION_LAT_044_oRDR_TRACKER_OBJ_044_oPCAN_RADAR_91085fae_Tx: ComSignalType=UINT16
            OBJ_ACCELERATION_LAT_ERR_044_oRDR_TRACKER_OBJ_044_oPCAN_RADAR_44fc6510_Tx: ComSignalType=UINT8
            OBJ_ACCELERATION_LONG_044_oRDR_TRACKER_OBJ_044_oPCAN_RADAR_e3f8064e_Tx: ComSignalType=UINT16
            OBJ_ACCELERATION_LONG_ERR_044_oRDR_TRACKER_OBJ_044_oPCAN_RADAR_5b59c0ba_Tx: ComSignalType=UINT8
            OBJ_ACCEL_ERR_CRR_COEF_044_oRDR_TRACKER_OBJ_044_oPCAN_RADAR_fbfae1dc_Tx: ComSignalType=UINT8
            OBJ_ALIVE_TIME_044_oRDR_TRACKER_OBJ_044_oPCAN_RADAR_83994df2_Tx: ComSignalType=UINT16
            OBJ_CLS_TYPE1_044_oRDR_TRACKER_OBJ_044_oPCAN_RADAR_1442acd4_Tx: ComSignalType=UINT8
            OBJ_CLS_TYPE1_PROB_044_oRDR_TRACKER_OBJ_044_oPCAN_RADAR_bc1a7b27_Tx: ComSignalType=UINT8
            OBJ_CLS_TYPE2_044_oRDR_TRACKER_OBJ_044_oPCAN_RADAR_59aaacb3_Tx: ComSignalType=UINT8
            OBJ_CLS_TYPE2_PROB_044_oRDR_TRACKER_OBJ_044_oPCAN_RADAR_752e602a_Tx: ComSignalType=UINT8
            OBJ_CLS_TYPE3_044_oRDR_TRACKER_OBJ_044_oPCAN_RADAR_d4225151_Tx: ComSignalType=UINT8
            OBJ_CLS_TYPE3_PROB_044_oRDR_TRACKER_OBJ_044_oPCAN_RADAR_323d96d1_Tx: ComSignalType=UINT8
            OBJ_CLS_TYPE4_044_oRDR_TRACKER_OBJ_044_oPCAN_RADAR_c27aac7d_Tx: ComSignalType=UINT8
            OBJ_CLS_TYPE4_PROB_044_oRDR_TRACKER_OBJ_044_oPCAN_RADAR_3c375071_Tx: ComSignalType=UINT8
            OBJ_CLS_TYPE5_044_oRDR_TRACKER_OBJ_044_oPCAN_RADAR_4ff2519f_Tx: ComSignalType=UINT8
            OBJ_CLS_TYPE5_PROB_044_oRDR_TRACKER_OBJ_044_oPCAN_RADAR_7b24a68a_Tx: ComSignalType=UINT8
            OBJ_CLS_TYPE6_044_oRDR_TRACKER_OBJ_044_oPCAN_RADAR_021a51f8_Tx: ComSignalType=UINT8
            OBJ_CLS_TYPE6_PROB_044_oRDR_TRACKER_OBJ_044_oPCAN_RADAR_b210bd87_Tx: ComSignalType=UINT8
            OBJ_DIMENSION_LENGTH_044_oRDR_TRACKER_OBJ_044_oPCAN_RADAR_56dcff90_Tx: ComSignalType=UINT16
            OBJ_DIMENSION_LENGTH_ERR_044_oRDR_TRACKER_OBJ_044_oPCAN_RADAR_6d24e0ea_Tx: ComSignalType=UINT16
            OBJ_DIMENSION_WIDTH_044_oRDR_TRACKER_OBJ_044_oPCAN_RADAR_7512083d_Tx: ComSignalType=UINT16
            OBJ_DIMENSION_WIDTH_ERR_044_oRDR_TRACKER_OBJ_044_oPCAN_RADAR_95b0cfd5_Tx: ComSignalType=UINT8
            OBJ_EXISTENCE_PROB_044_oRDR_TRACKER_OBJ_044_oPCAN_RADAR_7eae8c00_Tx: ComSignalType=UINT16
            OBJ_GROUP_ID_044_oRDR_TRACKER_OBJ_044_oPCAN_RADAR_f7dc98ad_Tx: ComSignalType=UINT8
            OBJ_ID_044_oRDR_TRACKER_OBJ_044_oPCAN_RADAR_04f2b3aa_Tx: ComSignalType=UINT8
            OBJ_MEASUREMENT_STATUS_044_oRDR_TRACKER_OBJ_044_oPCAN_RADAR_7b20c117_Tx: ComSignalType=UINT8
            OBJ_MH_CRC16_044_oRDR_TRACKER_OBJ_044_oPCAN_RADAR_0740762b_Tx: ComSignalType=UINT16
            OBJ_MH_CYCLE_COUNTER_044_oRDR_TRACKER_OBJ_044_oPCAN_RADAR_76a42cca_Tx: ComSignalType=UINT8
            OBJ_MOVEMENT_STATUS_044_oRDR_TRACKER_OBJ_044_oPCAN_RADAR_548e545b_Tx: ComSignalType=UINT8
            OBJ_POS_ERR_CRR_COEF_044_oRDR_TRACKER_OBJ_044_oPCAN_RADAR_c4f19461_Tx: ComSignalType=UINT8
            OBJ_POS_LAT_044_oRDR_TRACKER_OBJ_044_oPCAN_RADAR_265e692d_Tx: ComSignalType=UINT16
            OBJ_POS_LAT_ERR_044_oRDR_TRACKER_OBJ_044_oPCAN_RADAR_2212391a_Tx: ComSignalType=UINT8
            OBJ_POS_LONG_044_oRDR_TRACKER_OBJ_044_oPCAN_RADAR_97fe82e2_Tx: ComSignalType=UINT16
            OBJ_POS_LONG_ERR_044_oRDR_TRACKER_OBJ_044_oPCAN_RADAR_bbeac7f8_Tx: ComSignalType=UINT8
            OBJ_RCS_044_oRDR_TRACKER_OBJ_044_oPCAN_RADAR_04913f2a_Tx: ComSignalType=UINT8
            OBJ_REF_PT_LAT_OFFSET_044_oRDR_TRACKER_OBJ_044_oPCAN_RADAR_f1ac545f_Tx: ComSignalType=UINT16
            OBJ_REF_PT_LONG_OFFSET_044_oRDR_TRACKER_OBJ_044_oPCAN_RADAR_befea45c_Tx: ComSignalType=UINT16
            OBJ_TIMESTAMP_OFFSET_044_oRDR_TRACKER_OBJ_044_oPCAN_RADAR_043d3f7c_Tx: ComSignalType=UINT8
            OBJ_TRACK_MOTION_MODEL_044_oRDR_TRACKER_OBJ_044_oPCAN_RADAR_c83e3ea1_Tx: ComSignalType=UINT8
            OBJ_VEH_TRACK_FLAG_044_oRDR_TRACKER_OBJ_044_oPCAN_RADAR_4a14c8fc_Tx: ComSignalType=BOOLEAN
            OBJ_VELOCITY_ERR_CRR_COEF_044_oRDR_TRACKER_OBJ_044_oPCAN_RADAR_6d8ba980_Tx: ComSignalType=UINT8
            OBJ_VELOCITY_LAT_044_oRDR_TRACKER_OBJ_044_oPCAN_RADAR_623d2c0a_Tx: ComSignalType=UINT16
            OBJ_VELOCITY_LAT_ERR_044_oRDR_TRACKER_OBJ_044_oPCAN_RADAR_56c75c5b_Tx: ComSignalType=UINT8
            OBJ_VELOCITY_LONG_044_oRDR_TRACKER_OBJ_044_oPCAN_RADAR_32b054cc_Tx: ComSignalType=UINT16
            OBJ_VELOCITY_LONG_ERR_044_oRDR_TRACKER_OBJ_044_oPCAN_RADAR_ba45639b_Tx: ComSignalType=UINT8
            OBJ_YAW_ANGLE_044_oRDR_TRACKER_OBJ_044_oPCAN_RADAR_8e81684a_Tx: ComSignalType=UINT16
            OBJ_YAW_ANGLE_ERR_044_oRDR_TRACKER_OBJ_044_oPCAN_RADAR_5b8c6e9d_Tx: ComSignalType=UINT8
            OBJ_YAW_RATE_044_oRDR_TRACKER_OBJ_044_oPCAN_RADAR_ab0e4d0d_Tx: ComSignalType=UINT16
            OBJ_YAW_RATE_ERR_044_oRDR_TRACKER_OBJ_044_oPCAN_RADAR_94d6dad1_Tx: ComSignalType=UINT8
        SG_TrackerObject045_oRDR_TRACKER_OBJ_045_oPCAN_RADAR_66388c6a_Tx
          49 x ComGroupSignal:
            OBJ_ACCELERATION_LAT_045_oRDR_TRACKER_OBJ_045_oPCAN_RADAR_681cd71d_Tx: ComSignalType=UINT16
            OBJ_ACCELERATION_LAT_ERR_045_oRDR_TRACKER_OBJ_045_oPCAN_RADAR_bde8eda3_Tx: ComSignalType=UINT8
            OBJ_ACCELERATION_LONG_045_oRDR_TRACKER_OBJ_045_oPCAN_RADAR_1aec8efd_Tx: ComSignalType=UINT16
            OBJ_ACCELERATION_LONG_ERR_045_oRDR_TRACKER_OBJ_045_oPCAN_RADAR_a24d4809_Tx: ComSignalType=UINT8
            OBJ_ACCEL_ERR_CRR_COEF_045_oRDR_TRACKER_OBJ_045_oPCAN_RADAR_02ee696f_Tx: ComSignalType=UINT8
            OBJ_ALIVE_TIME_045_oRDR_TRACKER_OBJ_045_oPCAN_RADAR_7a8dc541_Tx: ComSignalType=UINT16
            OBJ_CLS_TYPE1_045_oRDR_TRACKER_OBJ_045_oPCAN_RADAR_ed562467_Tx: ComSignalType=UINT8
            OBJ_CLS_TYPE1_PROB_045_oRDR_TRACKER_OBJ_045_oPCAN_RADAR_450ef394_Tx: ComSignalType=UINT8
            OBJ_CLS_TYPE2_045_oRDR_TRACKER_OBJ_045_oPCAN_RADAR_a0be2400_Tx: ComSignalType=UINT8
            OBJ_CLS_TYPE2_PROB_045_oRDR_TRACKER_OBJ_045_oPCAN_RADAR_8c3ae899_Tx: ComSignalType=UINT8
            OBJ_CLS_TYPE3_045_oRDR_TRACKER_OBJ_045_oPCAN_RADAR_2d36d9e2_Tx: ComSignalType=UINT8
            OBJ_CLS_TYPE3_PROB_045_oRDR_TRACKER_OBJ_045_oPCAN_RADAR_cb291e62_Tx: ComSignalType=UINT8
            OBJ_CLS_TYPE4_045_oRDR_TRACKER_OBJ_045_oPCAN_RADAR_3b6e24ce_Tx: ComSignalType=UINT8
            OBJ_CLS_TYPE4_PROB_045_oRDR_TRACKER_OBJ_045_oPCAN_RADAR_c523d8c2_Tx: ComSignalType=UINT8
            OBJ_CLS_TYPE5_045_oRDR_TRACKER_OBJ_045_oPCAN_RADAR_b6e6d92c_Tx: ComSignalType=UINT8
            OBJ_CLS_TYPE5_PROB_045_oRDR_TRACKER_OBJ_045_oPCAN_RADAR_82302e39_Tx: ComSignalType=UINT8
            OBJ_CLS_TYPE6_045_oRDR_TRACKER_OBJ_045_oPCAN_RADAR_fb0ed94b_Tx: ComSignalType=UINT8
            OBJ_CLS_TYPE6_PROB_045_oRDR_TRACKER_OBJ_045_oPCAN_RADAR_4b043534_Tx: ComSignalType=UINT8
            OBJ_DIMENSION_LENGTH_045_oRDR_TRACKER_OBJ_045_oPCAN_RADAR_afc87723_Tx: ComSignalType=UINT16
            OBJ_DIMENSION_LENGTH_ERR_045_oRDR_TRACKER_OBJ_045_oPCAN_RADAR_94306859_Tx: ComSignalType=UINT16
            OBJ_DIMENSION_WIDTH_045_oRDR_TRACKER_OBJ_045_oPCAN_RADAR_8c06808e_Tx: ComSignalType=UINT16
            OBJ_DIMENSION_WIDTH_ERR_045_oRDR_TRACKER_OBJ_045_oPCAN_RADAR_6ca44766_Tx: ComSignalType=UINT8
            OBJ_EXISTENCE_PROB_045_oRDR_TRACKER_OBJ_045_oPCAN_RADAR_87ba04b3_Tx: ComSignalType=UINT16
            OBJ_GROUP_ID_045_oRDR_TRACKER_OBJ_045_oPCAN_RADAR_0ec8101e_Tx: ComSignalType=UINT8
            OBJ_ID_045_oRDR_TRACKER_OBJ_045_oPCAN_RADAR_fde63b19_Tx: ComSignalType=UINT8
            OBJ_MEASUREMENT_STATUS_045_oRDR_TRACKER_OBJ_045_oPCAN_RADAR_823449a4_Tx: ComSignalType=UINT8
            OBJ_MH_CRC16_045_oRDR_TRACKER_OBJ_045_oPCAN_RADAR_fe54fe98_Tx: ComSignalType=UINT16
            OBJ_MH_CYCLE_COUNTER_045_oRDR_TRACKER_OBJ_045_oPCAN_RADAR_8fb0a479_Tx: ComSignalType=UINT8
            OBJ_MOVEMENT_STATUS_045_oRDR_TRACKER_OBJ_045_oPCAN_RADAR_ad9adce8_Tx: ComSignalType=UINT8
            OBJ_POS_ERR_CRR_COEF_045_oRDR_TRACKER_OBJ_045_oPCAN_RADAR_3de51cd2_Tx: ComSignalType=UINT8
            OBJ_POS_LAT_045_oRDR_TRACKER_OBJ_045_oPCAN_RADAR_df4ae19e_Tx: ComSignalType=UINT16
            OBJ_POS_LAT_ERR_045_oRDR_TRACKER_OBJ_045_oPCAN_RADAR_db06b1a9_Tx: ComSignalType=UINT8
            OBJ_POS_LONG_045_oRDR_TRACKER_OBJ_045_oPCAN_RADAR_6eea0a51_Tx: ComSignalType=UINT16
            OBJ_POS_LONG_ERR_045_oRDR_TRACKER_OBJ_045_oPCAN_RADAR_42fe4f4b_Tx: ComSignalType=UINT8
            OBJ_RCS_045_oRDR_TRACKER_OBJ_045_oPCAN_RADAR_fd85b799_Tx: ComSignalType=UINT8
            OBJ_REF_PT_LAT_OFFSET_045_oRDR_TRACKER_OBJ_045_oPCAN_RADAR_08b8dcec_Tx: ComSignalType=UINT16
            OBJ_REF_PT_LONG_OFFSET_045_oRDR_TRACKER_OBJ_045_oPCAN_RADAR_47ea2cef_Tx: ComSignalType=UINT16
            OBJ_TIMESTAMP_OFFSET_045_oRDR_TRACKER_OBJ_045_oPCAN_RADAR_fd29b7cf_Tx: ComSignalType=UINT8
            OBJ_TRACK_MOTION_MODEL_045_oRDR_TRACKER_OBJ_045_oPCAN_RADAR_312ab612_Tx: ComSignalType=UINT8
            OBJ_VEH_TRACK_FLAG_045_oRDR_TRACKER_OBJ_045_oPCAN_RADAR_b300404f_Tx: ComSignalType=BOOLEAN
            OBJ_VELOCITY_ERR_CRR_COEF_045_oRDR_TRACKER_OBJ_045_oPCAN_RADAR_949f2133_Tx: ComSignalType=UINT8
            OBJ_VELOCITY_LAT_045_oRDR_TRACKER_OBJ_045_oPCAN_RADAR_9b29a4b9_Tx: ComSignalType=UINT16
            OBJ_VELOCITY_LAT_ERR_045_oRDR_TRACKER_OBJ_045_oPCAN_RADAR_afd3d4e8_Tx: ComSignalType=UINT8
            OBJ_VELOCITY_LONG_045_oRDR_TRACKER_OBJ_045_oPCAN_RADAR_cba4dc7f_Tx: ComSignalType=UINT16
            OBJ_VELOCITY_LONG_ERR_045_oRDR_TRACKER_OBJ_045_oPCAN_RADAR_4351eb28_Tx: ComSignalType=UINT8
            OBJ_YAW_ANGLE_045_oRDR_TRACKER_OBJ_045_oPCAN_RADAR_7795e0f9_Tx: ComSignalType=UINT16
            OBJ_YAW_ANGLE_ERR_045_oRDR_TRACKER_OBJ_045_oPCAN_RADAR_a298e62e_Tx: ComSignalType=UINT8
            OBJ_YAW_RATE_045_oRDR_TRACKER_OBJ_045_oPCAN_RADAR_521ac5be_Tx: ComSignalType=UINT16
            OBJ_YAW_RATE_ERR_045_oRDR_TRACKER_OBJ_045_oPCAN_RADAR_6dc25262_Tx: ComSignalType=UINT8
        SG_TrackerObject046_oRDR_TRACKER_OBJ_046_oPCAN_RADAR_b67413fe_Tx
          49 x ComGroupSignal:
            OBJ_ACCELERATION_LAT_046_oRDR_TRACKER_OBJ_046_oPCAN_RADAR_b8504889_Tx: ComSignalType=UINT16
            OBJ_ACCELERATION_LAT_ERR_046_oRDR_TRACKER_OBJ_046_oPCAN_RADAR_6da47237_Tx: ComSignalType=UINT8
            OBJ_ACCELERATION_LONG_046_oRDR_TRACKER_OBJ_046_oPCAN_RADAR_caa01169_Tx: ComSignalType=UINT16
            OBJ_ACCELERATION_LONG_ERR_046_oRDR_TRACKER_OBJ_046_oPCAN_RADAR_7201d79d_Tx: ComSignalType=UINT8
            OBJ_ACCEL_ERR_CRR_COEF_046_oRDR_TRACKER_OBJ_046_oPCAN_RADAR_d2a2f6fb_Tx: ComSignalType=UINT8
            OBJ_ALIVE_TIME_046_oRDR_TRACKER_OBJ_046_oPCAN_RADAR_aac15ad5_Tx: ComSignalType=UINT16
            OBJ_CLS_TYPE1_046_oRDR_TRACKER_OBJ_046_oPCAN_RADAR_3d1abbf3_Tx: ComSignalType=UINT8
            OBJ_CLS_TYPE1_PROB_046_oRDR_TRACKER_OBJ_046_oPCAN_RADAR_95426c00_Tx: ComSignalType=UINT8
            OBJ_CLS_TYPE2_046_oRDR_TRACKER_OBJ_046_oPCAN_RADAR_70f2bb94_Tx: ComSignalType=UINT8
            OBJ_CLS_TYPE2_PROB_046_oRDR_TRACKER_OBJ_046_oPCAN_RADAR_5c76770d_Tx: ComSignalType=UINT8
            OBJ_CLS_TYPE3_046_oRDR_TRACKER_OBJ_046_oPCAN_RADAR_fd7a4676_Tx: ComSignalType=UINT8
            OBJ_CLS_TYPE3_PROB_046_oRDR_TRACKER_OBJ_046_oPCAN_RADAR_1b6581f6_Tx: ComSignalType=UINT8
            OBJ_CLS_TYPE4_046_oRDR_TRACKER_OBJ_046_oPCAN_RADAR_eb22bb5a_Tx: ComSignalType=UINT8
            OBJ_CLS_TYPE4_PROB_046_oRDR_TRACKER_OBJ_046_oPCAN_RADAR_156f4756_Tx: ComSignalType=UINT8
            OBJ_CLS_TYPE5_046_oRDR_TRACKER_OBJ_046_oPCAN_RADAR_66aa46b8_Tx: ComSignalType=UINT8
            OBJ_CLS_TYPE5_PROB_046_oRDR_TRACKER_OBJ_046_oPCAN_RADAR_527cb1ad_Tx: ComSignalType=UINT8
            OBJ_CLS_TYPE6_046_oRDR_TRACKER_OBJ_046_oPCAN_RADAR_2b4246df_Tx: ComSignalType=UINT8
            OBJ_CLS_TYPE6_PROB_046_oRDR_TRACKER_OBJ_046_oPCAN_RADAR_9b48aaa0_Tx: ComSignalType=UINT8
            OBJ_DIMENSION_LENGTH_046_oRDR_TRACKER_OBJ_046_oPCAN_RADAR_7f84e8b7_Tx: ComSignalType=UINT16
            OBJ_DIMENSION_LENGTH_ERR_046_oRDR_TRACKER_OBJ_046_oPCAN_RADAR_447cf7cd_Tx: ComSignalType=UINT16
            OBJ_DIMENSION_WIDTH_046_oRDR_TRACKER_OBJ_046_oPCAN_RADAR_5c4a1f1a_Tx: ComSignalType=UINT16
            OBJ_DIMENSION_WIDTH_ERR_046_oRDR_TRACKER_OBJ_046_oPCAN_RADAR_bce8d8f2_Tx: ComSignalType=UINT8
            OBJ_EXISTENCE_PROB_046_oRDR_TRACKER_OBJ_046_oPCAN_RADAR_57f69b27_Tx: ComSignalType=UINT16
            OBJ_GROUP_ID_046_oRDR_TRACKER_OBJ_046_oPCAN_RADAR_de848f8a_Tx: ComSignalType=UINT8
            OBJ_ID_046_oRDR_TRACKER_OBJ_046_oPCAN_RADAR_2daaa48d_Tx: ComSignalType=UINT8
            OBJ_MEASUREMENT_STATUS_046_oRDR_TRACKER_OBJ_046_oPCAN_RADAR_5278d630_Tx: ComSignalType=UINT8
            OBJ_MH_CRC16_046_oRDR_TRACKER_OBJ_046_oPCAN_RADAR_2e18610c_Tx: ComSignalType=UINT16
            OBJ_MH_CYCLE_COUNTER_046_oRDR_TRACKER_OBJ_046_oPCAN_RADAR_5ffc3bed_Tx: ComSignalType=UINT8
            OBJ_MOVEMENT_STATUS_046_oRDR_TRACKER_OBJ_046_oPCAN_RADAR_7dd6437c_Tx: ComSignalType=UINT8
            OBJ_POS_ERR_CRR_COEF_046_oRDR_TRACKER_OBJ_046_oPCAN_RADAR_eda98346_Tx: ComSignalType=UINT8
            OBJ_POS_LAT_046_oRDR_TRACKER_OBJ_046_oPCAN_RADAR_0f067e0a_Tx: ComSignalType=UINT16
            OBJ_POS_LAT_ERR_046_oRDR_TRACKER_OBJ_046_oPCAN_RADAR_0b4a2e3d_Tx: ComSignalType=UINT8
            OBJ_POS_LONG_046_oRDR_TRACKER_OBJ_046_oPCAN_RADAR_bea695c5_Tx: ComSignalType=UINT16
            OBJ_POS_LONG_ERR_046_oRDR_TRACKER_OBJ_046_oPCAN_RADAR_92b2d0df_Tx: ComSignalType=UINT8
            OBJ_RCS_046_oRDR_TRACKER_OBJ_046_oPCAN_RADAR_2dc9280d_Tx: ComSignalType=UINT8
            OBJ_REF_PT_LAT_OFFSET_046_oRDR_TRACKER_OBJ_046_oPCAN_RADAR_d8f44378_Tx: ComSignalType=UINT16
            OBJ_REF_PT_LONG_OFFSET_046_oRDR_TRACKER_OBJ_046_oPCAN_RADAR_97a6b37b_Tx: ComSignalType=UINT16
            OBJ_TIMESTAMP_OFFSET_046_oRDR_TRACKER_OBJ_046_oPCAN_RADAR_2d65285b_Tx: ComSignalType=UINT8
            OBJ_TRACK_MOTION_MODEL_046_oRDR_TRACKER_OBJ_046_oPCAN_RADAR_e1662986_Tx: ComSignalType=UINT8
            OBJ_VEH_TRACK_FLAG_046_oRDR_TRACKER_OBJ_046_oPCAN_RADAR_634cdfdb_Tx: ComSignalType=BOOLEAN
            OBJ_VELOCITY_ERR_CRR_COEF_046_oRDR_TRACKER_OBJ_046_oPCAN_RADAR_44d3bea7_Tx: ComSignalType=UINT8
            OBJ_VELOCITY_LAT_046_oRDR_TRACKER_OBJ_046_oPCAN_RADAR_4b653b2d_Tx: ComSignalType=UINT16
            OBJ_VELOCITY_LAT_ERR_046_oRDR_TRACKER_OBJ_046_oPCAN_RADAR_7f9f4b7c_Tx: ComSignalType=UINT8
            OBJ_VELOCITY_LONG_046_oRDR_TRACKER_OBJ_046_oPCAN_RADAR_1be843eb_Tx: ComSignalType=UINT16
            OBJ_VELOCITY_LONG_ERR_046_oRDR_TRACKER_OBJ_046_oPCAN_RADAR_931d74bc_Tx: ComSignalType=UINT8
            OBJ_YAW_ANGLE_046_oRDR_TRACKER_OBJ_046_oPCAN_RADAR_a7d97f6d_Tx: ComSignalType=UINT16
            OBJ_YAW_ANGLE_ERR_046_oRDR_TRACKER_OBJ_046_oPCAN_RADAR_72d479ba_Tx: ComSignalType=UINT8
            OBJ_YAW_RATE_046_oRDR_TRACKER_OBJ_046_oPCAN_RADAR_82565a2a_Tx: ComSignalType=UINT16
            OBJ_YAW_RATE_ERR_046_oRDR_TRACKER_OBJ_046_oPCAN_RADAR_bd8ecdf6_Tx: ComSignalType=UINT8
        SG_TrackerObject047_oRDR_TRACKER_OBJ_047_oPCAN_RADAR_4f609b4d_Tx
          49 x ComGroupSignal:
            OBJ_ACCELERATION_LAT_047_oRDR_TRACKER_OBJ_047_oPCAN_RADAR_4144c03a_Tx: ComSignalType=UINT16
            OBJ_ACCELERATION_LAT_ERR_047_oRDR_TRACKER_OBJ_047_oPCAN_RADAR_94b0fa84_Tx: ComSignalType=UINT8
            OBJ_ACCELERATION_LONG_047_oRDR_TRACKER_OBJ_047_oPCAN_RADAR_33b499da_Tx: ComSignalType=UINT16
            OBJ_ACCELERATION_LONG_ERR_047_oRDR_TRACKER_OBJ_047_oPCAN_RADAR_8b155f2e_Tx: ComSignalType=UINT8
            OBJ_ACCEL_ERR_CRR_COEF_047_oRDR_TRACKER_OBJ_047_oPCAN_RADAR_2bb67e48_Tx: ComSignalType=UINT8
            OBJ_ALIVE_TIME_047_oRDR_TRACKER_OBJ_047_oPCAN_RADAR_53d5d266_Tx: ComSignalType=UINT16
            OBJ_CLS_TYPE1_047_oRDR_TRACKER_OBJ_047_oPCAN_RADAR_c40e3340_Tx: ComSignalType=UINT8
            OBJ_CLS_TYPE1_PROB_047_oRDR_TRACKER_OBJ_047_oPCAN_RADAR_6c56e4b3_Tx: ComSignalType=UINT8
            OBJ_CLS_TYPE2_047_oRDR_TRACKER_OBJ_047_oPCAN_RADAR_89e63327_Tx: ComSignalType=UINT8
            OBJ_CLS_TYPE2_PROB_047_oRDR_TRACKER_OBJ_047_oPCAN_RADAR_a562ffbe_Tx: ComSignalType=UINT8
            OBJ_CLS_TYPE3_047_oRDR_TRACKER_OBJ_047_oPCAN_RADAR_046ecec5_Tx: ComSignalType=UINT8
            OBJ_CLS_TYPE3_PROB_047_oRDR_TRACKER_OBJ_047_oPCAN_RADAR_e2710945_Tx: ComSignalType=UINT8
            OBJ_CLS_TYPE4_047_oRDR_TRACKER_OBJ_047_oPCAN_RADAR_123633e9_Tx: ComSignalType=UINT8
            OBJ_CLS_TYPE4_PROB_047_oRDR_TRACKER_OBJ_047_oPCAN_RADAR_ec7bcfe5_Tx: ComSignalType=UINT8
            OBJ_CLS_TYPE5_047_oRDR_TRACKER_OBJ_047_oPCAN_RADAR_9fbece0b_Tx: ComSignalType=UINT8
            OBJ_CLS_TYPE5_PROB_047_oRDR_TRACKER_OBJ_047_oPCAN_RADAR_ab68391e_Tx: ComSignalType=UINT8
            OBJ_CLS_TYPE6_047_oRDR_TRACKER_OBJ_047_oPCAN_RADAR_d256ce6c_Tx: ComSignalType=UINT8
            OBJ_CLS_TYPE6_PROB_047_oRDR_TRACKER_OBJ_047_oPCAN_RADAR_625c2213_Tx: ComSignalType=UINT8
            OBJ_DIMENSION_LENGTH_047_oRDR_TRACKER_OBJ_047_oPCAN_RADAR_86906004_Tx: ComSignalType=UINT16
            OBJ_DIMENSION_LENGTH_ERR_047_oRDR_TRACKER_OBJ_047_oPCAN_RADAR_bd687f7e_Tx: ComSignalType=UINT16
            OBJ_DIMENSION_WIDTH_047_oRDR_TRACKER_OBJ_047_oPCAN_RADAR_a55e97a9_Tx: ComSignalType=UINT16
            OBJ_DIMENSION_WIDTH_ERR_047_oRDR_TRACKER_OBJ_047_oPCAN_RADAR_45fc5041_Tx: ComSignalType=UINT8
            OBJ_EXISTENCE_PROB_047_oRDR_TRACKER_OBJ_047_oPCAN_RADAR_aee21394_Tx: ComSignalType=UINT16
            OBJ_GROUP_ID_047_oRDR_TRACKER_OBJ_047_oPCAN_RADAR_27900739_Tx: ComSignalType=UINT8
            OBJ_ID_047_oRDR_TRACKER_OBJ_047_oPCAN_RADAR_d4be2c3e_Tx: ComSignalType=UINT8
            OBJ_MEASUREMENT_STATUS_047_oRDR_TRACKER_OBJ_047_oPCAN_RADAR_ab6c5e83_Tx: ComSignalType=UINT8
            OBJ_MH_CRC16_047_oRDR_TRACKER_OBJ_047_oPCAN_RADAR_d70ce9bf_Tx: ComSignalType=UINT16
            OBJ_MH_CYCLE_COUNTER_047_oRDR_TRACKER_OBJ_047_oPCAN_RADAR_a6e8b35e_Tx: ComSignalType=UINT8
            OBJ_MOVEMENT_STATUS_047_oRDR_TRACKER_OBJ_047_oPCAN_RADAR_84c2cbcf_Tx: ComSignalType=UINT8
            OBJ_POS_ERR_CRR_COEF_047_oRDR_TRACKER_OBJ_047_oPCAN_RADAR_14bd0bf5_Tx: ComSignalType=UINT8
            OBJ_POS_LAT_047_oRDR_TRACKER_OBJ_047_oPCAN_RADAR_f612f6b9_Tx: ComSignalType=UINT16
            OBJ_POS_LAT_ERR_047_oRDR_TRACKER_OBJ_047_oPCAN_RADAR_f25ea68e_Tx: ComSignalType=UINT8
            OBJ_POS_LONG_047_oRDR_TRACKER_OBJ_047_oPCAN_RADAR_47b21d76_Tx: ComSignalType=UINT16
            OBJ_POS_LONG_ERR_047_oRDR_TRACKER_OBJ_047_oPCAN_RADAR_6ba6586c_Tx: ComSignalType=UINT8
            OBJ_RCS_047_oRDR_TRACKER_OBJ_047_oPCAN_RADAR_d4dda0be_Tx: ComSignalType=UINT8
            OBJ_REF_PT_LAT_OFFSET_047_oRDR_TRACKER_OBJ_047_oPCAN_RADAR_21e0cbcb_Tx: ComSignalType=UINT16
            OBJ_REF_PT_LONG_OFFSET_047_oRDR_TRACKER_OBJ_047_oPCAN_RADAR_6eb23bc8_Tx: ComSignalType=UINT16
            OBJ_TIMESTAMP_OFFSET_047_oRDR_TRACKER_OBJ_047_oPCAN_RADAR_d471a0e8_Tx: ComSignalType=UINT8
            OBJ_TRACK_MOTION_MODEL_047_oRDR_TRACKER_OBJ_047_oPCAN_RADAR_1872a135_Tx: ComSignalType=UINT8
            OBJ_VEH_TRACK_FLAG_047_oRDR_TRACKER_OBJ_047_oPCAN_RADAR_9a585768_Tx: ComSignalType=BOOLEAN
            OBJ_VELOCITY_ERR_CRR_COEF_047_oRDR_TRACKER_OBJ_047_oPCAN_RADAR_bdc73614_Tx: ComSignalType=UINT8
            OBJ_VELOCITY_LAT_047_oRDR_TRACKER_OBJ_047_oPCAN_RADAR_b271b39e_Tx: ComSignalType=UINT16
            OBJ_VELOCITY_LAT_ERR_047_oRDR_TRACKER_OBJ_047_oPCAN_RADAR_868bc3cf_Tx: ComSignalType=UINT8
            OBJ_VELOCITY_LONG_047_oRDR_TRACKER_OBJ_047_oPCAN_RADAR_e2fccb58_Tx: ComSignalType=UINT16
            OBJ_VELOCITY_LONG_ERR_047_oRDR_TRACKER_OBJ_047_oPCAN_RADAR_6a09fc0f_Tx: ComSignalType=UINT8
            OBJ_YAW_ANGLE_047_oRDR_TRACKER_OBJ_047_oPCAN_RADAR_5ecdf7de_Tx: ComSignalType=UINT16
            OBJ_YAW_ANGLE_ERR_047_oRDR_TRACKER_OBJ_047_oPCAN_RADAR_8bc0f109_Tx: ComSignalType=UINT8
            OBJ_YAW_RATE_047_oRDR_TRACKER_OBJ_047_oPCAN_RADAR_7b42d299_Tx: ComSignalType=UINT16
            OBJ_YAW_RATE_ERR_047_oRDR_TRACKER_OBJ_047_oPCAN_RADAR_449a4545_Tx: ComSignalType=UINT8
        SG_TrackerObject048_oRDR_TRACKER_OBJ_048_oPCAN_RADAR_68fc760b_Tx
          49 x ComGroupSignal:
            OBJ_ACCELERATION_LAT_048_oRDR_TRACKER_OBJ_048_oPCAN_RADAR_66d82d7c_Tx: ComSignalType=UINT16
            OBJ_ACCELERATION_LAT_ERR_048_oRDR_TRACKER_OBJ_048_oPCAN_RADAR_b32c17c2_Tx: ComSignalType=UINT8
            OBJ_ACCELERATION_LONG_048_oRDR_TRACKER_OBJ_048_oPCAN_RADAR_1428749c_Tx: ComSignalType=UINT16
            OBJ_ACCELERATION_LONG_ERR_048_oRDR_TRACKER_OBJ_048_oPCAN_RADAR_ac89b268_Tx: ComSignalType=UINT8
            OBJ_ACCEL_ERR_CRR_COEF_048_oRDR_TRACKER_OBJ_048_oPCAN_RADAR_0c2a930e_Tx: ComSignalType=UINT8
            OBJ_ALIVE_TIME_048_oRDR_TRACKER_OBJ_048_oPCAN_RADAR_74493f20_Tx: ComSignalType=UINT16
            OBJ_CLS_TYPE1_048_oRDR_TRACKER_OBJ_048_oPCAN_RADAR_e392de06_Tx: ComSignalType=UINT8
            OBJ_CLS_TYPE1_PROB_048_oRDR_TRACKER_OBJ_048_oPCAN_RADAR_4bca09f5_Tx: ComSignalType=UINT8
            OBJ_CLS_TYPE2_048_oRDR_TRACKER_OBJ_048_oPCAN_RADAR_ae7ade61_Tx: ComSignalType=UINT8
            OBJ_CLS_TYPE2_PROB_048_oRDR_TRACKER_OBJ_048_oPCAN_RADAR_82fe12f8_Tx: ComSignalType=UINT8
            OBJ_CLS_TYPE3_048_oRDR_TRACKER_OBJ_048_oPCAN_RADAR_23f22383_Tx: ComSignalType=UINT8
            OBJ_CLS_TYPE3_PROB_048_oRDR_TRACKER_OBJ_048_oPCAN_RADAR_c5ede403_Tx: ComSignalType=UINT8
            OBJ_CLS_TYPE4_048_oRDR_TRACKER_OBJ_048_oPCAN_RADAR_35aadeaf_Tx: ComSignalType=UINT8
            OBJ_CLS_TYPE4_PROB_048_oRDR_TRACKER_OBJ_048_oPCAN_RADAR_cbe722a3_Tx: ComSignalType=UINT8
            OBJ_CLS_TYPE5_048_oRDR_TRACKER_OBJ_048_oPCAN_RADAR_b822234d_Tx: ComSignalType=UINT8
            OBJ_CLS_TYPE5_PROB_048_oRDR_TRACKER_OBJ_048_oPCAN_RADAR_8cf4d458_Tx: ComSignalType=UINT8
            OBJ_CLS_TYPE6_048_oRDR_TRACKER_OBJ_048_oPCAN_RADAR_f5ca232a_Tx: ComSignalType=UINT8
            OBJ_CLS_TYPE6_PROB_048_oRDR_TRACKER_OBJ_048_oPCAN_RADAR_45c0cf55_Tx: ComSignalType=UINT8
            OBJ_DIMENSION_LENGTH_048_oRDR_TRACKER_OBJ_048_oPCAN_RADAR_a10c8d42_Tx: ComSignalType=UINT16
            OBJ_DIMENSION_LENGTH_ERR_048_oRDR_TRACKER_OBJ_048_oPCAN_RADAR_9af49238_Tx: ComSignalType=UINT16
            OBJ_DIMENSION_WIDTH_048_oRDR_TRACKER_OBJ_048_oPCAN_RADAR_82c27aef_Tx: ComSignalType=UINT16
            OBJ_DIMENSION_WIDTH_ERR_048_oRDR_TRACKER_OBJ_048_oPCAN_RADAR_6260bd07_Tx: ComSignalType=UINT8
            OBJ_EXISTENCE_PROB_048_oRDR_TRACKER_OBJ_048_oPCAN_RADAR_897efed2_Tx: ComSignalType=UINT16
            OBJ_GROUP_ID_048_oRDR_TRACKER_OBJ_048_oPCAN_RADAR_000cea7f_Tx: ComSignalType=UINT8
            OBJ_ID_048_oRDR_TRACKER_OBJ_048_oPCAN_RADAR_f322c178_Tx: ComSignalType=UINT8
            OBJ_MEASUREMENT_STATUS_048_oRDR_TRACKER_OBJ_048_oPCAN_RADAR_8cf0b3c5_Tx: ComSignalType=UINT8
            OBJ_MH_CRC16_048_oRDR_TRACKER_OBJ_048_oPCAN_RADAR_f09004f9_Tx: ComSignalType=UINT16
            OBJ_MH_CYCLE_COUNTER_048_oRDR_TRACKER_OBJ_048_oPCAN_RADAR_81745e18_Tx: ComSignalType=UINT8
            OBJ_MOVEMENT_STATUS_048_oRDR_TRACKER_OBJ_048_oPCAN_RADAR_a35e2689_Tx: ComSignalType=UINT8
            OBJ_POS_ERR_CRR_COEF_048_oRDR_TRACKER_OBJ_048_oPCAN_RADAR_3321e6b3_Tx: ComSignalType=UINT8
            OBJ_POS_LAT_048_oRDR_TRACKER_OBJ_048_oPCAN_RADAR_d18e1bff_Tx: ComSignalType=UINT16
            OBJ_POS_LAT_ERR_048_oRDR_TRACKER_OBJ_048_oPCAN_RADAR_d5c24bc8_Tx: ComSignalType=UINT8
            OBJ_POS_LONG_048_oRDR_TRACKER_OBJ_048_oPCAN_RADAR_602ef030_Tx: ComSignalType=UINT16
            OBJ_POS_LONG_ERR_048_oRDR_TRACKER_OBJ_048_oPCAN_RADAR_4c3ab52a_Tx: ComSignalType=UINT8
            OBJ_RCS_048_oRDR_TRACKER_OBJ_048_oPCAN_RADAR_f3414df8_Tx: ComSignalType=UINT8
            OBJ_REF_PT_LAT_OFFSET_048_oRDR_TRACKER_OBJ_048_oPCAN_RADAR_067c268d_Tx: ComSignalType=UINT16
            OBJ_REF_PT_LONG_OFFSET_048_oRDR_TRACKER_OBJ_048_oPCAN_RADAR_492ed68e_Tx: ComSignalType=UINT16
            OBJ_TIMESTAMP_OFFSET_048_oRDR_TRACKER_OBJ_048_oPCAN_RADAR_f3ed4dae_Tx: ComSignalType=UINT8
            OBJ_TRACK_MOTION_MODEL_048_oRDR_TRACKER_OBJ_048_oPCAN_RADAR_3fee4c73_Tx: ComSignalType=UINT8
            OBJ_VEH_TRACK_FLAG_048_oRDR_TRACKER_OBJ_048_oPCAN_RADAR_bdc4ba2e_Tx: ComSignalType=BOOLEAN
            OBJ_VELOCITY_ERR_CRR_COEF_048_oRDR_TRACKER_OBJ_048_oPCAN_RADAR_9a5bdb52_Tx: ComSignalType=UINT8
            OBJ_VELOCITY_LAT_048_oRDR_TRACKER_OBJ_048_oPCAN_RADAR_95ed5ed8_Tx: ComSignalType=UINT16
            OBJ_VELOCITY_LAT_ERR_048_oRDR_TRACKER_OBJ_048_oPCAN_RADAR_a1172e89_Tx: ComSignalType=UINT8
            OBJ_VELOCITY_LONG_048_oRDR_TRACKER_OBJ_048_oPCAN_RADAR_c560261e_Tx: ComSignalType=UINT16
            OBJ_VELOCITY_LONG_ERR_048_oRDR_TRACKER_OBJ_048_oPCAN_RADAR_4d951149_Tx: ComSignalType=UINT8
            OBJ_YAW_ANGLE_048_oRDR_TRACKER_OBJ_048_oPCAN_RADAR_79511a98_Tx: ComSignalType=UINT16
            OBJ_YAW_ANGLE_ERR_048_oRDR_TRACKER_OBJ_048_oPCAN_RADAR_ac5c1c4f_Tx: ComSignalType=UINT8
            OBJ_YAW_RATE_048_oRDR_TRACKER_OBJ_048_oPCAN_RADAR_5cde3fdf_Tx: ComSignalType=UINT16
            OBJ_YAW_RATE_ERR_048_oRDR_TRACKER_OBJ_048_oPCAN_RADAR_6306a803_Tx: ComSignalType=UINT8
        SG_TrackerObject049_oRDR_TRACKER_OBJ_049_oPCAN_RADAR_91e8feb8_Tx
          49 x ComGroupSignal:
            OBJ_ACCELERATION_LAT_049_oRDR_TRACKER_OBJ_049_oPCAN_RADAR_9fcca5cf_Tx: ComSignalType=UINT16
            OBJ_ACCELERATION_LAT_ERR_049_oRDR_TRACKER_OBJ_049_oPCAN_RADAR_4a389f71_Tx: ComSignalType=UINT8
            OBJ_ACCELERATION_LONG_049_oRDR_TRACKER_OBJ_049_oPCAN_RADAR_ed3cfc2f_Tx: ComSignalType=UINT16
            OBJ_ACCELERATION_LONG_ERR_049_oRDR_TRACKER_OBJ_049_oPCAN_RADAR_559d3adb_Tx: ComSignalType=UINT8
            OBJ_ACCEL_ERR_CRR_COEF_049_oRDR_TRACKER_OBJ_049_oPCAN_RADAR_f53e1bbd_Tx: ComSignalType=UINT8
            OBJ_ALIVE_TIME_049_oRDR_TRACKER_OBJ_049_oPCAN_RADAR_8d5db793_Tx: ComSignalType=UINT16
            OBJ_CLS_TYPE1_049_oRDR_TRACKER_OBJ_049_oPCAN_RADAR_1a8656b5_Tx: ComSignalType=UINT8
            OBJ_CLS_TYPE1_PROB_049_oRDR_TRACKER_OBJ_049_oPCAN_RADAR_b2de8146_Tx: ComSignalType=UINT8
            OBJ_CLS_TYPE2_049_oRDR_TRACKER_OBJ_049_oPCAN_RADAR_576e56d2_Tx: ComSignalType=UINT8
            OBJ_CLS_TYPE2_PROB_049_oRDR_TRACKER_OBJ_049_oPCAN_RADAR_7bea9a4b_Tx: ComSignalType=UINT8
            OBJ_CLS_TYPE3_049_oRDR_TRACKER_OBJ_049_oPCAN_RADAR_dae6ab30_Tx: ComSignalType=UINT8
            OBJ_CLS_TYPE3_PROB_049_oRDR_TRACKER_OBJ_049_oPCAN_RADAR_3cf96cb0_Tx: ComSignalType=UINT8
            OBJ_CLS_TYPE4_049_oRDR_TRACKER_OBJ_049_oPCAN_RADAR_ccbe561c_Tx: ComSignalType=UINT8
            OBJ_CLS_TYPE4_PROB_049_oRDR_TRACKER_OBJ_049_oPCAN_RADAR_32f3aa10_Tx: ComSignalType=UINT8
            OBJ_CLS_TYPE5_049_oRDR_TRACKER_OBJ_049_oPCAN_RADAR_4136abfe_Tx: ComSignalType=UINT8
            OBJ_CLS_TYPE5_PROB_049_oRDR_TRACKER_OBJ_049_oPCAN_RADAR_75e05ceb_Tx: ComSignalType=UINT8
            OBJ_CLS_TYPE6_049_oRDR_TRACKER_OBJ_049_oPCAN_RADAR_0cdeab99_Tx: ComSignalType=UINT8
            OBJ_CLS_TYPE6_PROB_049_oRDR_TRACKER_OBJ_049_oPCAN_RADAR_bcd447e6_Tx: ComSignalType=UINT8
            OBJ_DIMENSION_LENGTH_049_oRDR_TRACKER_OBJ_049_oPCAN_RADAR_581805f1_Tx: ComSignalType=UINT16
            OBJ_DIMENSION_LENGTH_ERR_049_oRDR_TRACKER_OBJ_049_oPCAN_RADAR_63e01a8b_Tx: ComSignalType=UINT16
            OBJ_DIMENSION_WIDTH_049_oRDR_TRACKER_OBJ_049_oPCAN_RADAR_7bd6f25c_Tx: ComSignalType=UINT16
            OBJ_DIMENSION_WIDTH_ERR_049_oRDR_TRACKER_OBJ_049_oPCAN_RADAR_9b7435b4_Tx: ComSignalType=UINT8
            OBJ_EXISTENCE_PROB_049_oRDR_TRACKER_OBJ_049_oPCAN_RADAR_706a7661_Tx: ComSignalType=UINT16
            OBJ_GROUP_ID_049_oRDR_TRACKER_OBJ_049_oPCAN_RADAR_f91862cc_Tx: ComSignalType=UINT8
            OBJ_ID_049_oRDR_TRACKER_OBJ_049_oPCAN_RADAR_0a3649cb_Tx: ComSignalType=UINT8
            OBJ_MEASUREMENT_STATUS_049_oRDR_TRACKER_OBJ_049_oPCAN_RADAR_75e43b76_Tx: ComSignalType=UINT8
            OBJ_MH_CRC16_049_oRDR_TRACKER_OBJ_049_oPCAN_RADAR_09848c4a_Tx: ComSignalType=UINT16
            OBJ_MH_CYCLE_COUNTER_049_oRDR_TRACKER_OBJ_049_oPCAN_RADAR_7860d6ab_Tx: ComSignalType=UINT8
            OBJ_MOVEMENT_STATUS_049_oRDR_TRACKER_OBJ_049_oPCAN_RADAR_5a4aae3a_Tx: ComSignalType=UINT8
            OBJ_POS_ERR_CRR_COEF_049_oRDR_TRACKER_OBJ_049_oPCAN_RADAR_ca356e00_Tx: ComSignalType=UINT8
            OBJ_POS_LAT_049_oRDR_TRACKER_OBJ_049_oPCAN_RADAR_289a934c_Tx: ComSignalType=UINT16
            OBJ_POS_LAT_ERR_049_oRDR_TRACKER_OBJ_049_oPCAN_RADAR_2cd6c37b_Tx: ComSignalType=UINT8
            OBJ_POS_LONG_049_oRDR_TRACKER_OBJ_049_oPCAN_RADAR_993a7883_Tx: ComSignalType=UINT16
            OBJ_POS_LONG_ERR_049_oRDR_TRACKER_OBJ_049_oPCAN_RADAR_b52e3d99_Tx: ComSignalType=UINT8
            OBJ_RCS_049_oRDR_TRACKER_OBJ_049_oPCAN_RADAR_0a55c54b_Tx: ComSignalType=UINT8
            OBJ_REF_PT_LAT_OFFSET_049_oRDR_TRACKER_OBJ_049_oPCAN_RADAR_ff68ae3e_Tx: ComSignalType=UINT16
            OBJ_REF_PT_LONG_OFFSET_049_oRDR_TRACKER_OBJ_049_oPCAN_RADAR_b03a5e3d_Tx: ComSignalType=UINT16
            OBJ_TIMESTAMP_OFFSET_049_oRDR_TRACKER_OBJ_049_oPCAN_RADAR_0af9c51d_Tx: ComSignalType=UINT8
            OBJ_TRACK_MOTION_MODEL_049_oRDR_TRACKER_OBJ_049_oPCAN_RADAR_c6fac4c0_Tx: ComSignalType=UINT8
            OBJ_VEH_TRACK_FLAG_049_oRDR_TRACKER_OBJ_049_oPCAN_RADAR_44d0329d_Tx: ComSignalType=BOOLEAN
            OBJ_VELOCITY_ERR_CRR_COEF_049_oRDR_TRACKER_OBJ_049_oPCAN_RADAR_634f53e1_Tx: ComSignalType=UINT8
            OBJ_VELOCITY_LAT_049_oRDR_TRACKER_OBJ_049_oPCAN_RADAR_6cf9d66b_Tx: ComSignalType=UINT16
            OBJ_VELOCITY_LAT_ERR_049_oRDR_TRACKER_OBJ_049_oPCAN_RADAR_5803a63a_Tx: ComSignalType=UINT8
            OBJ_VELOCITY_LONG_049_oRDR_TRACKER_OBJ_049_oPCAN_RADAR_3c74aead_Tx: ComSignalType=UINT16
            OBJ_VELOCITY_LONG_ERR_049_oRDR_TRACKER_OBJ_049_oPCAN_RADAR_b48199fa_Tx: ComSignalType=UINT8
            OBJ_YAW_ANGLE_049_oRDR_TRACKER_OBJ_049_oPCAN_RADAR_8045922b_Tx: ComSignalType=UINT16
            OBJ_YAW_ANGLE_ERR_049_oRDR_TRACKER_OBJ_049_oPCAN_RADAR_554894fc_Tx: ComSignalType=UINT8
            OBJ_YAW_RATE_049_oRDR_TRACKER_OBJ_049_oPCAN_RADAR_a5cab76c_Tx: ComSignalType=UINT16
            OBJ_YAW_RATE_ERR_049_oRDR_TRACKER_OBJ_049_oPCAN_RADAR_9a1220b0_Tx: ComSignalType=UINT8
        SG_TrackerObject050_oRDR_TRACKER_OBJ_050_oPCAN_RADAR_9f0ddc29_Tx
          49 x ComGroupSignal:
            OBJ_ACCELERATION_LAT_050_oRDR_TRACKER_OBJ_050_oPCAN_RADAR_9129875e_Tx: ComSignalType=UINT16
            OBJ_ACCELERATION_LAT_ERR_050_oRDR_TRACKER_OBJ_050_oPCAN_RADAR_44ddbde0_Tx: ComSignalType=UINT8
            OBJ_ACCELERATION_LONG_050_oRDR_TRACKER_OBJ_050_oPCAN_RADAR_e3d9debe_Tx: ComSignalType=UINT16
            OBJ_ACCELERATION_LONG_ERR_050_oRDR_TRACKER_OBJ_050_oPCAN_RADAR_5b78184a_Tx: ComSignalType=UINT8
            OBJ_ACCEL_ERR_CRR_COEF_050_oRDR_TRACKER_OBJ_050_oPCAN_RADAR_fbdb392c_Tx: ComSignalType=UINT8
            OBJ_ALIVE_TIME_050_oRDR_TRACKER_OBJ_050_oPCAN_RADAR_83b89502_Tx: ComSignalType=UINT16
            OBJ_CLS_TYPE1_050_oRDR_TRACKER_OBJ_050_oPCAN_RADAR_14637424_Tx: ComSignalType=UINT8
            OBJ_CLS_TYPE1_PROB_050_oRDR_TRACKER_OBJ_050_oPCAN_RADAR_bc3ba3d7_Tx: ComSignalType=UINT8
            OBJ_CLS_TYPE2_050_oRDR_TRACKER_OBJ_050_oPCAN_RADAR_598b7443_Tx: ComSignalType=UINT8
            OBJ_CLS_TYPE2_PROB_050_oRDR_TRACKER_OBJ_050_oPCAN_RADAR_750fb8da_Tx: ComSignalType=UINT8
            OBJ_CLS_TYPE3_050_oRDR_TRACKER_OBJ_050_oPCAN_RADAR_d40389a1_Tx: ComSignalType=UINT8
            OBJ_CLS_TYPE3_PROB_050_oRDR_TRACKER_OBJ_050_oPCAN_RADAR_321c4e21_Tx: ComSignalType=UINT8
            OBJ_CLS_TYPE4_050_oRDR_TRACKER_OBJ_050_oPCAN_RADAR_c25b748d_Tx: ComSignalType=UINT8
            OBJ_CLS_TYPE4_PROB_050_oRDR_TRACKER_OBJ_050_oPCAN_RADAR_3c168881_Tx: ComSignalType=UINT8
            OBJ_CLS_TYPE5_050_oRDR_TRACKER_OBJ_050_oPCAN_RADAR_4fd3896f_Tx: ComSignalType=UINT8
            OBJ_CLS_TYPE5_PROB_050_oRDR_TRACKER_OBJ_050_oPCAN_RADAR_7b057e7a_Tx: ComSignalType=UINT8
            OBJ_CLS_TYPE6_050_oRDR_TRACKER_OBJ_050_oPCAN_RADAR_023b8908_Tx: ComSignalType=UINT8
            OBJ_CLS_TYPE6_PROB_050_oRDR_TRACKER_OBJ_050_oPCAN_RADAR_b2316577_Tx: ComSignalType=UINT8
            OBJ_DIMENSION_LENGTH_050_oRDR_TRACKER_OBJ_050_oPCAN_RADAR_56fd2760_Tx: ComSignalType=UINT16
            OBJ_DIMENSION_LENGTH_ERR_050_oRDR_TRACKER_OBJ_050_oPCAN_RADAR_6d05381a_Tx: ComSignalType=UINT16
            OBJ_DIMENSION_WIDTH_050_oRDR_TRACKER_OBJ_050_oPCAN_RADAR_7533d0cd_Tx: ComSignalType=UINT16
            OBJ_DIMENSION_WIDTH_ERR_050_oRDR_TRACKER_OBJ_050_oPCAN_RADAR_95911725_Tx: ComSignalType=UINT8
            OBJ_EXISTENCE_PROB_050_oRDR_TRACKER_OBJ_050_oPCAN_RADAR_7e8f54f0_Tx: ComSignalType=UINT16
            OBJ_GROUP_ID_050_oRDR_TRACKER_OBJ_050_oPCAN_RADAR_f7fd405d_Tx: ComSignalType=UINT8
            OBJ_ID_050_oRDR_TRACKER_OBJ_050_oPCAN_RADAR_04d36b5a_Tx: ComSignalType=UINT8
            OBJ_MEASUREMENT_STATUS_050_oRDR_TRACKER_OBJ_050_oPCAN_RADAR_7b0119e7_Tx: ComSignalType=UINT8
            OBJ_MH_CRC16_050_oRDR_TRACKER_OBJ_050_oPCAN_RADAR_0761aedb_Tx: ComSignalType=UINT16
            OBJ_MH_CYCLE_COUNTER_050_oRDR_TRACKER_OBJ_050_oPCAN_RADAR_7685f43a_Tx: ComSignalType=UINT8
            OBJ_MOVEMENT_STATUS_050_oRDR_TRACKER_OBJ_050_oPCAN_RADAR_54af8cab_Tx: ComSignalType=UINT8
            OBJ_POS_ERR_CRR_COEF_050_oRDR_TRACKER_OBJ_050_oPCAN_RADAR_c4d04c91_Tx: ComSignalType=UINT8
            OBJ_POS_LAT_050_oRDR_TRACKER_OBJ_050_oPCAN_RADAR_267fb1dd_Tx: ComSignalType=UINT16
            OBJ_POS_LAT_ERR_050_oRDR_TRACKER_OBJ_050_oPCAN_RADAR_2233e1ea_Tx: ComSignalType=UINT8
            OBJ_POS_LONG_050_oRDR_TRACKER_OBJ_050_oPCAN_RADAR_97df5a12_Tx: ComSignalType=UINT16
            OBJ_POS_LONG_ERR_050_oRDR_TRACKER_OBJ_050_oPCAN_RADAR_bbcb1f08_Tx: ComSignalType=UINT8
            OBJ_RCS_050_oRDR_TRACKER_OBJ_050_oPCAN_RADAR_04b0e7da_Tx: ComSignalType=UINT8
            OBJ_REF_PT_LAT_OFFSET_050_oRDR_TRACKER_OBJ_050_oPCAN_RADAR_f18d8caf_Tx: ComSignalType=UINT16
            OBJ_REF_PT_LONG_OFFSET_050_oRDR_TRACKER_OBJ_050_oPCAN_RADAR_bedf7cac_Tx: ComSignalType=UINT16
            OBJ_TIMESTAMP_OFFSET_050_oRDR_TRACKER_OBJ_050_oPCAN_RADAR_041ce78c_Tx: ComSignalType=UINT8
            OBJ_TRACK_MOTION_MODEL_050_oRDR_TRACKER_OBJ_050_oPCAN_RADAR_c81fe651_Tx: ComSignalType=UINT8
            OBJ_VEH_TRACK_FLAG_050_oRDR_TRACKER_OBJ_050_oPCAN_RADAR_4a35100c_Tx: ComSignalType=BOOLEAN
            OBJ_VELOCITY_ERR_CRR_COEF_050_oRDR_TRACKER_OBJ_050_oPCAN_RADAR_6daa7170_Tx: ComSignalType=UINT8
            OBJ_VELOCITY_LAT_050_oRDR_TRACKER_OBJ_050_oPCAN_RADAR_621cf4fa_Tx: ComSignalType=UINT16
            OBJ_VELOCITY_LAT_ERR_050_oRDR_TRACKER_OBJ_050_oPCAN_RADAR_56e684ab_Tx: ComSignalType=UINT8
            OBJ_VELOCITY_LONG_050_oRDR_TRACKER_OBJ_050_oPCAN_RADAR_32918c3c_Tx: ComSignalType=UINT16
            OBJ_VELOCITY_LONG_ERR_050_oRDR_TRACKER_OBJ_050_oPCAN_RADAR_ba64bb6b_Tx: ComSignalType=UINT8
            OBJ_YAW_ANGLE_050_oRDR_TRACKER_OBJ_050_oPCAN_RADAR_8ea0b0ba_Tx: ComSignalType=UINT16
            OBJ_YAW_ANGLE_ERR_050_oRDR_TRACKER_OBJ_050_oPCAN_RADAR_5badb66d_Tx: ComSignalType=UINT8
            OBJ_YAW_RATE_050_oRDR_TRACKER_OBJ_050_oPCAN_RADAR_ab2f95fd_Tx: ComSignalType=UINT16
            OBJ_YAW_RATE_ERR_050_oRDR_TRACKER_OBJ_050_oPCAN_RADAR_94f70221_Tx: ComSignalType=UINT8
        SG_TrackerObject051_oRDR_TRACKER_OBJ_051_oPCAN_RADAR_6619549a_Tx
          49 x ComGroupSignal:
            OBJ_ACCELERATION_LAT_051_oRDR_TRACKER_OBJ_051_oPCAN_RADAR_683d0fed_Tx: ComSignalType=UINT16
            OBJ_ACCELERATION_LAT_ERR_051_oRDR_TRACKER_OBJ_051_oPCAN_RADAR_bdc93553_Tx: ComSignalType=UINT8
            OBJ_ACCELERATION_LONG_051_oRDR_TRACKER_OBJ_051_oPCAN_RADAR_1acd560d_Tx: ComSignalType=UINT16
            OBJ_ACCELERATION_LONG_ERR_051_oRDR_TRACKER_OBJ_051_oPCAN_RADAR_a26c90f9_Tx: ComSignalType=UINT8
            OBJ_ACCEL_ERR_CRR_COEF_051_oRDR_TRACKER_OBJ_051_oPCAN_RADAR_02cfb19f_Tx: ComSignalType=UINT8
            OBJ_ALIVE_TIME_051_oRDR_TRACKER_OBJ_051_oPCAN_RADAR_7aac1db1_Tx: ComSignalType=UINT16
            OBJ_CLS_TYPE1_051_oRDR_TRACKER_OBJ_051_oPCAN_RADAR_ed77fc97_Tx: ComSignalType=UINT8
            OBJ_CLS_TYPE1_PROB_051_oRDR_TRACKER_OBJ_051_oPCAN_RADAR_452f2b64_Tx: ComSignalType=UINT8
            OBJ_CLS_TYPE2_051_oRDR_TRACKER_OBJ_051_oPCAN_RADAR_a09ffcf0_Tx: ComSignalType=UINT8
            OBJ_CLS_TYPE2_PROB_051_oRDR_TRACKER_OBJ_051_oPCAN_RADAR_8c1b3069_Tx: ComSignalType=UINT8
            OBJ_CLS_TYPE3_051_oRDR_TRACKER_OBJ_051_oPCAN_RADAR_2d170112_Tx: ComSignalType=UINT8
            OBJ_CLS_TYPE3_PROB_051_oRDR_TRACKER_OBJ_051_oPCAN_RADAR_cb08c692_Tx: ComSignalType=UINT8
            OBJ_CLS_TYPE4_051_oRDR_TRACKER_OBJ_051_oPCAN_RADAR_3b4ffc3e_Tx: ComSignalType=UINT8
            OBJ_CLS_TYPE4_PROB_051_oRDR_TRACKER_OBJ_051_oPCAN_RADAR_c5020032_Tx: ComSignalType=UINT8
            OBJ_CLS_TYPE5_051_oRDR_TRACKER_OBJ_051_oPCAN_RADAR_b6c701dc_Tx: ComSignalType=UINT8
            OBJ_CLS_TYPE5_PROB_051_oRDR_TRACKER_OBJ_051_oPCAN_RADAR_8211f6c9_Tx: ComSignalType=UINT8
            OBJ_CLS_TYPE6_051_oRDR_TRACKER_OBJ_051_oPCAN_RADAR_fb2f01bb_Tx: ComSignalType=UINT8
            OBJ_CLS_TYPE6_PROB_051_oRDR_TRACKER_OBJ_051_oPCAN_RADAR_4b25edc4_Tx: ComSignalType=UINT8
            OBJ_DIMENSION_LENGTH_051_oRDR_TRACKER_OBJ_051_oPCAN_RADAR_afe9afd3_Tx: ComSignalType=UINT16
            OBJ_DIMENSION_LENGTH_ERR_051_oRDR_TRACKER_OBJ_051_oPCAN_RADAR_9411b0a9_Tx: ComSignalType=UINT16
            OBJ_DIMENSION_WIDTH_051_oRDR_TRACKER_OBJ_051_oPCAN_RADAR_8c27587e_Tx: ComSignalType=UINT16
            OBJ_DIMENSION_WIDTH_ERR_051_oRDR_TRACKER_OBJ_051_oPCAN_RADAR_6c859f96_Tx: ComSignalType=UINT8
            OBJ_EXISTENCE_PROB_051_oRDR_TRACKER_OBJ_051_oPCAN_RADAR_879bdc43_Tx: ComSignalType=UINT16
            OBJ_GROUP_ID_051_oRDR_TRACKER_OBJ_051_oPCAN_RADAR_0ee9c8ee_Tx: ComSignalType=UINT8
            OBJ_ID_051_oRDR_TRACKER_OBJ_051_oPCAN_RADAR_fdc7e3e9_Tx: ComSignalType=UINT8
            OBJ_MEASUREMENT_STATUS_051_oRDR_TRACKER_OBJ_051_oPCAN_RADAR_82159154_Tx: ComSignalType=UINT8
            OBJ_MH_CRC16_051_oRDR_TRACKER_OBJ_051_oPCAN_RADAR_fe752668_Tx: ComSignalType=UINT16
            OBJ_MH_CYCLE_COUNTER_051_oRDR_TRACKER_OBJ_051_oPCAN_RADAR_8f917c89_Tx: ComSignalType=UINT8
            OBJ_MOVEMENT_STATUS_051_oRDR_TRACKER_OBJ_051_oPCAN_RADAR_adbb0418_Tx: ComSignalType=UINT8
            OBJ_POS_ERR_CRR_COEF_051_oRDR_TRACKER_OBJ_051_oPCAN_RADAR_3dc4c422_Tx: ComSignalType=UINT8
            OBJ_POS_LAT_051_oRDR_TRACKER_OBJ_051_oPCAN_RADAR_df6b396e_Tx: ComSignalType=UINT16
            OBJ_POS_LAT_ERR_051_oRDR_TRACKER_OBJ_051_oPCAN_RADAR_db276959_Tx: ComSignalType=UINT8
            OBJ_POS_LONG_051_oRDR_TRACKER_OBJ_051_oPCAN_RADAR_6ecbd2a1_Tx: ComSignalType=UINT16
            OBJ_POS_LONG_ERR_051_oRDR_TRACKER_OBJ_051_oPCAN_RADAR_42df97bb_Tx: ComSignalType=UINT8
            OBJ_RCS_051_oRDR_TRACKER_OBJ_051_oPCAN_RADAR_fda46f69_Tx: ComSignalType=UINT8
            OBJ_REF_PT_LAT_OFFSET_051_oRDR_TRACKER_OBJ_051_oPCAN_RADAR_0899041c_Tx: ComSignalType=UINT16
            OBJ_REF_PT_LONG_OFFSET_051_oRDR_TRACKER_OBJ_051_oPCAN_RADAR_47cbf41f_Tx: ComSignalType=UINT16
            OBJ_TIMESTAMP_OFFSET_051_oRDR_TRACKER_OBJ_051_oPCAN_RADAR_fd086f3f_Tx: ComSignalType=UINT8
            OBJ_TRACK_MOTION_MODEL_051_oRDR_TRACKER_OBJ_051_oPCAN_RADAR_310b6ee2_Tx: ComSignalType=UINT8
            OBJ_VEH_TRACK_FLAG_051_oRDR_TRACKER_OBJ_051_oPCAN_RADAR_b32198bf_Tx: ComSignalType=BOOLEAN
            OBJ_VELOCITY_ERR_CRR_COEF_051_oRDR_TRACKER_OBJ_051_oPCAN_RADAR_94bef9c3_Tx: ComSignalType=UINT8
            OBJ_VELOCITY_LAT_051_oRDR_TRACKER_OBJ_051_oPCAN_RADAR_9b087c49_Tx: ComSignalType=UINT16
            OBJ_VELOCITY_LAT_ERR_051_oRDR_TRACKER_OBJ_051_oPCAN_RADAR_aff20c18_Tx: ComSignalType=UINT8
            OBJ_VELOCITY_LONG_051_oRDR_TRACKER_OBJ_051_oPCAN_RADAR_cb85048f_Tx: ComSignalType=UINT16
            OBJ_VELOCITY_LONG_ERR_051_oRDR_TRACKER_OBJ_051_oPCAN_RADAR_437033d8_Tx: ComSignalType=UINT8
            OBJ_YAW_ANGLE_051_oRDR_TRACKER_OBJ_051_oPCAN_RADAR_77b43809_Tx: ComSignalType=UINT16
            OBJ_YAW_ANGLE_ERR_051_oRDR_TRACKER_OBJ_051_oPCAN_RADAR_a2b93ede_Tx: ComSignalType=UINT8
            OBJ_YAW_RATE_051_oRDR_TRACKER_OBJ_051_oPCAN_RADAR_523b1d4e_Tx: ComSignalType=UINT16
            OBJ_YAW_RATE_ERR_051_oRDR_TRACKER_OBJ_051_oPCAN_RADAR_6de38a92_Tx: ComSignalType=UINT8
        SG_TrackerObject052_oRDR_TRACKER_OBJ_052_oPCAN_RADAR_b655cb0e_Tx
          49 x ComGroupSignal:
            OBJ_ACCELERATION_LAT_052_oRDR_TRACKER_OBJ_052_oPCAN_RADAR_b8719079_Tx: ComSignalType=UINT16
            OBJ_ACCELERATION_LAT_ERR_052_oRDR_TRACKER_OBJ_052_oPCAN_RADAR_6d85aac7_Tx: ComSignalType=UINT8
            OBJ_ACCELERATION_LONG_052_oRDR_TRACKER_OBJ_052_oPCAN_RADAR_ca81c999_Tx: ComSignalType=UINT16
            OBJ_ACCELERATION_LONG_ERR_052_oRDR_TRACKER_OBJ_052_oPCAN_RADAR_72200f6d_Tx: ComSignalType=UINT8
            OBJ_ACCEL_ERR_CRR_COEF_052_oRDR_TRACKER_OBJ_052_oPCAN_RADAR_d2832e0b_Tx: ComSignalType=UINT8
            OBJ_ALIVE_TIME_052_oRDR_TRACKER_OBJ_052_oPCAN_RADAR_aae08225_Tx: ComSignalType=UINT16
            OBJ_CLS_TYPE1_052_oRDR_TRACKER_OBJ_052_oPCAN_RADAR_3d3b6303_Tx: ComSignalType=UINT8
            OBJ_CLS_TYPE1_PROB_052_oRDR_TRACKER_OBJ_052_oPCAN_RADAR_9563b4f0_Tx: ComSignalType=UINT8
            OBJ_CLS_TYPE2_052_oRDR_TRACKER_OBJ_052_oPCAN_RADAR_70d36364_Tx: ComSignalType=UINT8
            OBJ_CLS_TYPE2_PROB_052_oRDR_TRACKER_OBJ_052_oPCAN_RADAR_5c57affd_Tx: ComSignalType=UINT8
            OBJ_CLS_TYPE3_052_oRDR_TRACKER_OBJ_052_oPCAN_RADAR_fd5b9e86_Tx: ComSignalType=UINT8
            OBJ_CLS_TYPE3_PROB_052_oRDR_TRACKER_OBJ_052_oPCAN_RADAR_1b445906_Tx: ComSignalType=UINT8
            OBJ_CLS_TYPE4_052_oRDR_TRACKER_OBJ_052_oPCAN_RADAR_eb0363aa_Tx: ComSignalType=UINT8
            OBJ_CLS_TYPE4_PROB_052_oRDR_TRACKER_OBJ_052_oPCAN_RADAR_154e9fa6_Tx: ComSignalType=UINT8
            OBJ_CLS_TYPE5_052_oRDR_TRACKER_OBJ_052_oPCAN_RADAR_668b9e48_Tx: ComSignalType=UINT8
            OBJ_CLS_TYPE5_PROB_052_oRDR_TRACKER_OBJ_052_oPCAN_RADAR_525d695d_Tx: ComSignalType=UINT8
            OBJ_CLS_TYPE6_052_oRDR_TRACKER_OBJ_052_oPCAN_RADAR_2b639e2f_Tx: ComSignalType=UINT8
            OBJ_CLS_TYPE6_PROB_052_oRDR_TRACKER_OBJ_052_oPCAN_RADAR_9b697250_Tx: ComSignalType=UINT8
            OBJ_DIMENSION_LENGTH_052_oRDR_TRACKER_OBJ_052_oPCAN_RADAR_7fa53047_Tx: ComSignalType=UINT16
            OBJ_DIMENSION_LENGTH_ERR_052_oRDR_TRACKER_OBJ_052_oPCAN_RADAR_445d2f3d_Tx: ComSignalType=UINT16
            OBJ_DIMENSION_WIDTH_052_oRDR_TRACKER_OBJ_052_oPCAN_RADAR_5c6bc7ea_Tx: ComSignalType=UINT16
            OBJ_DIMENSION_WIDTH_ERR_052_oRDR_TRACKER_OBJ_052_oPCAN_RADAR_bcc90002_Tx: ComSignalType=UINT8
            OBJ_EXISTENCE_PROB_052_oRDR_TRACKER_OBJ_052_oPCAN_RADAR_57d743d7_Tx: ComSignalType=UINT16
            OBJ_GROUP_ID_052_oRDR_TRACKER_OBJ_052_oPCAN_RADAR_dea5577a_Tx: ComSignalType=UINT8
            OBJ_ID_052_oRDR_TRACKER_OBJ_052_oPCAN_RADAR_2d8b7c7d_Tx: ComSignalType=UINT8
            OBJ_MEASUREMENT_STATUS_052_oRDR_TRACKER_OBJ_052_oPCAN_RADAR_52590ec0_Tx: ComSignalType=UINT8
            OBJ_MH_CRC16_052_oRDR_TRACKER_OBJ_052_oPCAN_RADAR_2e39b9fc_Tx: ComSignalType=UINT16
            OBJ_MH_CYCLE_COUNTER_052_oRDR_TRACKER_OBJ_052_oPCAN_RADAR_5fdde31d_Tx: ComSignalType=UINT8
            OBJ_MOVEMENT_STATUS_052_oRDR_TRACKER_OBJ_052_oPCAN_RADAR_7df79b8c_Tx: ComSignalType=UINT8
            OBJ_POS_ERR_CRR_COEF_052_oRDR_TRACKER_OBJ_052_oPCAN_RADAR_ed885bb6_Tx: ComSignalType=UINT8
            OBJ_POS_LAT_052_oRDR_TRACKER_OBJ_052_oPCAN_RADAR_0f27a6fa_Tx: ComSignalType=UINT16
            OBJ_POS_LAT_ERR_052_oRDR_TRACKER_OBJ_052_oPCAN_RADAR_0b6bf6cd_Tx: ComSignalType=UINT8
            OBJ_POS_LONG_052_oRDR_TRACKER_OBJ_052_oPCAN_RADAR_be874d35_Tx: ComSignalType=UINT16
            OBJ_POS_LONG_ERR_052_oRDR_TRACKER_OBJ_052_oPCAN_RADAR_9293082f_Tx: ComSignalType=UINT8
            OBJ_RCS_052_oRDR_TRACKER_OBJ_052_oPCAN_RADAR_2de8f0fd_Tx: ComSignalType=UINT8
            OBJ_REF_PT_LAT_OFFSET_052_oRDR_TRACKER_OBJ_052_oPCAN_RADAR_d8d59b88_Tx: ComSignalType=UINT16
            OBJ_REF_PT_LONG_OFFSET_052_oRDR_TRACKER_OBJ_052_oPCAN_RADAR_97876b8b_Tx: ComSignalType=UINT16
            OBJ_TIMESTAMP_OFFSET_052_oRDR_TRACKER_OBJ_052_oPCAN_RADAR_2d44f0ab_Tx: ComSignalType=UINT8
            OBJ_TRACK_MOTION_MODEL_052_oRDR_TRACKER_OBJ_052_oPCAN_RADAR_e147f176_Tx: ComSignalType=UINT8
            OBJ_VEH_TRACK_FLAG_052_oRDR_TRACKER_OBJ_052_oPCAN_RADAR_636d072b_Tx: ComSignalType=BOOLEAN
            OBJ_VELOCITY_ERR_CRR_COEF_052_oRDR_TRACKER_OBJ_052_oPCAN_RADAR_44f26657_Tx: ComSignalType=UINT8
            OBJ_VELOCITY_LAT_052_oRDR_TRACKER_OBJ_052_oPCAN_RADAR_4b44e3dd_Tx: ComSignalType=UINT16
            OBJ_VELOCITY_LAT_ERR_052_oRDR_TRACKER_OBJ_052_oPCAN_RADAR_7fbe938c_Tx: ComSignalType=UINT8
            OBJ_VELOCITY_LONG_052_oRDR_TRACKER_OBJ_052_oPCAN_RADAR_1bc99b1b_Tx: ComSignalType=UINT16
            OBJ_VELOCITY_LONG_ERR_052_oRDR_TRACKER_OBJ_052_oPCAN_RADAR_933cac4c_Tx: ComSignalType=UINT8
            OBJ_YAW_ANGLE_052_oRDR_TRACKER_OBJ_052_oPCAN_RADAR_a7f8a79d_Tx: ComSignalType=UINT16
            OBJ_YAW_ANGLE_ERR_052_oRDR_TRACKER_OBJ_052_oPCAN_RADAR_72f5a14a_Tx: ComSignalType=UINT8
            OBJ_YAW_RATE_052_oRDR_TRACKER_OBJ_052_oPCAN_RADAR_827782da_Tx: ComSignalType=UINT16
            OBJ_YAW_RATE_ERR_052_oRDR_TRACKER_OBJ_052_oPCAN_RADAR_bdaf1506_Tx: ComSignalType=UINT8
        SG_TrackerObject053_oRDR_TRACKER_OBJ_053_oPCAN_RADAR_4f4143bd_Tx
          49 x ComGroupSignal:
            OBJ_ACCELERATION_LAT_053_oRDR_TRACKER_OBJ_053_oPCAN_RADAR_416518ca_Tx: ComSignalType=UINT16
            OBJ_ACCELERATION_LAT_ERR_053_oRDR_TRACKER_OBJ_053_oPCAN_RADAR_94912274_Tx: ComSignalType=UINT8
            OBJ_ACCELERATION_LONG_053_oRDR_TRACKER_OBJ_053_oPCAN_RADAR_3395412a_Tx: ComSignalType=UINT16
            OBJ_ACCELERATION_LONG_ERR_053_oRDR_TRACKER_OBJ_053_oPCAN_RADAR_8b3487de_Tx: ComSignalType=UINT8
            OBJ_ACCEL_ERR_CRR_COEF_053_oRDR_TRACKER_OBJ_053_oPCAN_RADAR_2b97a6b8_Tx: ComSignalType=UINT8
            OBJ_ALIVE_TIME_053_oRDR_TRACKER_OBJ_053_oPCAN_RADAR_53f40a96_Tx: ComSignalType=UINT16
            OBJ_CLS_TYPE1_053_oRDR_TRACKER_OBJ_053_oPCAN_RADAR_c42febb0_Tx: ComSignalType=UINT8
            OBJ_CLS_TYPE1_PROB_053_oRDR_TRACKER_OBJ_053_oPCAN_RADAR_6c773c43_Tx: ComSignalType=UINT8
            OBJ_CLS_TYPE2_053_oRDR_TRACKER_OBJ_053_oPCAN_RADAR_89c7ebd7_Tx: ComSignalType=UINT8
            OBJ_CLS_TYPE2_PROB_053_oRDR_TRACKER_OBJ_053_oPCAN_RADAR_a543274e_Tx: ComSignalType=UINT8
            OBJ_CLS_TYPE3_053_oRDR_TRACKER_OBJ_053_oPCAN_RADAR_044f1635_Tx: ComSignalType=UINT8
            OBJ_CLS_TYPE3_PROB_053_oRDR_TRACKER_OBJ_053_oPCAN_RADAR_e250d1b5_Tx: ComSignalType=UINT8
            OBJ_CLS_TYPE4_053_oRDR_TRACKER_OBJ_053_oPCAN_RADAR_1217eb19_Tx: ComSignalType=UINT8
            OBJ_CLS_TYPE4_PROB_053_oRDR_TRACKER_OBJ_053_oPCAN_RADAR_ec5a1715_Tx: ComSignalType=UINT8
            OBJ_CLS_TYPE5_053_oRDR_TRACKER_OBJ_053_oPCAN_RADAR_9f9f16fb_Tx: ComSignalType=UINT8
            OBJ_CLS_TYPE5_PROB_053_oRDR_TRACKER_OBJ_053_oPCAN_RADAR_ab49e1ee_Tx: ComSignalType=UINT8
            OBJ_CLS_TYPE6_053_oRDR_TRACKER_OBJ_053_oPCAN_RADAR_d277169c_Tx: ComSignalType=UINT8
            OBJ_CLS_TYPE6_PROB_053_oRDR_TRACKER_OBJ_053_oPCAN_RADAR_627dfae3_Tx: ComSignalType=UINT8
            OBJ_DIMENSION_LENGTH_053_oRDR_TRACKER_OBJ_053_oPCAN_RADAR_86b1b8f4_Tx: ComSignalType=UINT16
            OBJ_DIMENSION_LENGTH_ERR_053_oRDR_TRACKER_OBJ_053_oPCAN_RADAR_bd49a78e_Tx: ComSignalType=UINT16
            OBJ_DIMENSION_WIDTH_053_oRDR_TRACKER_OBJ_053_oPCAN_RADAR_a57f4f59_Tx: ComSignalType=UINT16
            OBJ_DIMENSION_WIDTH_ERR_053_oRDR_TRACKER_OBJ_053_oPCAN_RADAR_45dd88b1_Tx: ComSignalType=UINT8
            OBJ_EXISTENCE_PROB_053_oRDR_TRACKER_OBJ_053_oPCAN_RADAR_aec3cb64_Tx: ComSignalType=UINT16
            OBJ_GROUP_ID_053_oRDR_TRACKER_OBJ_053_oPCAN_RADAR_27b1dfc9_Tx: ComSignalType=UINT8
            OBJ_ID_053_oRDR_TRACKER_OBJ_053_oPCAN_RADAR_d49ff4ce_Tx: ComSignalType=UINT8
            OBJ_MEASUREMENT_STATUS_053_oRDR_TRACKER_OBJ_053_oPCAN_RADAR_ab4d8673_Tx: ComSignalType=UINT8
            OBJ_MH_CRC16_053_oRDR_TRACKER_OBJ_053_oPCAN_RADAR_d72d314f_Tx: ComSignalType=UINT16
            OBJ_MH_CYCLE_COUNTER_053_oRDR_TRACKER_OBJ_053_oPCAN_RADAR_a6c96bae_Tx: ComSignalType=UINT8
            OBJ_MOVEMENT_STATUS_053_oRDR_TRACKER_OBJ_053_oPCAN_RADAR_84e3133f_Tx: ComSignalType=UINT8
            OBJ_POS_ERR_CRR_COEF_053_oRDR_TRACKER_OBJ_053_oPCAN_RADAR_149cd305_Tx: ComSignalType=UINT8
            OBJ_POS_LAT_053_oRDR_TRACKER_OBJ_053_oPCAN_RADAR_f6332e49_Tx: ComSignalType=UINT16
            OBJ_POS_LAT_ERR_053_oRDR_TRACKER_OBJ_053_oPCAN_RADAR_f27f7e7e_Tx: ComSignalType=UINT8
            OBJ_POS_LONG_053_oRDR_TRACKER_OBJ_053_oPCAN_RADAR_4793c586_Tx: ComSignalType=UINT16
            OBJ_POS_LONG_ERR_053_oRDR_TRACKER_OBJ_053_oPCAN_RADAR_6b87809c_Tx: ComSignalType=UINT8
            OBJ_RCS_053_oRDR_TRACKER_OBJ_053_oPCAN_RADAR_d4fc784e_Tx: ComSignalType=UINT8
            OBJ_REF_PT_LAT_OFFSET_053_oRDR_TRACKER_OBJ_053_oPCAN_RADAR_21c1133b_Tx: ComSignalType=UINT16
            OBJ_REF_PT_LONG_OFFSET_053_oRDR_TRACKER_OBJ_053_oPCAN_RADAR_6e93e338_Tx: ComSignalType=UINT16
            OBJ_TIMESTAMP_OFFSET_053_oRDR_TRACKER_OBJ_053_oPCAN_RADAR_d4507818_Tx: ComSignalType=UINT8
            OBJ_TRACK_MOTION_MODEL_053_oRDR_TRACKER_OBJ_053_oPCAN_RADAR_185379c5_Tx: ComSignalType=UINT8
            OBJ_VEH_TRACK_FLAG_053_oRDR_TRACKER_OBJ_053_oPCAN_RADAR_9a798f98_Tx: ComSignalType=BOOLEAN
            OBJ_VELOCITY_ERR_CRR_COEF_053_oRDR_TRACKER_OBJ_053_oPCAN_RADAR_bde6eee4_Tx: ComSignalType=UINT8
            OBJ_VELOCITY_LAT_053_oRDR_TRACKER_OBJ_053_oPCAN_RADAR_b2506b6e_Tx: ComSignalType=UINT16
            OBJ_VELOCITY_LAT_ERR_053_oRDR_TRACKER_OBJ_053_oPCAN_RADAR_86aa1b3f_Tx: ComSignalType=UINT8
            OBJ_VELOCITY_LONG_053_oRDR_TRACKER_OBJ_053_oPCAN_RADAR_e2dd13a8_Tx: ComSignalType=UINT16
            OBJ_VELOCITY_LONG_ERR_053_oRDR_TRACKER_OBJ_053_oPCAN_RADAR_6a2824ff_Tx: ComSignalType=UINT8
            OBJ_YAW_ANGLE_053_oRDR_TRACKER_OBJ_053_oPCAN_RADAR_5eec2f2e_Tx: ComSignalType=UINT16
            OBJ_YAW_ANGLE_ERR_053_oRDR_TRACKER_OBJ_053_oPCAN_RADAR_8be129f9_Tx: ComSignalType=UINT8
            OBJ_YAW_RATE_053_oRDR_TRACKER_OBJ_053_oPCAN_RADAR_7b630a69_Tx: ComSignalType=UINT16
            OBJ_YAW_RATE_ERR_053_oRDR_TRACKER_OBJ_053_oPCAN_RADAR_44bb9db5_Tx: ComSignalType=UINT8
        SG_TrackerObject054_oRDR_TRACKER_OBJ_054_oPCAN_RADAR_cdbdf267_Tx
          49 x ComGroupSignal:
            OBJ_ACCELERATION_LAT_054_oRDR_TRACKER_OBJ_054_oPCAN_RADAR_c399a910_Tx: ComSignalType=UINT16
            OBJ_ACCELERATION_LAT_ERR_054_oRDR_TRACKER_OBJ_054_oPCAN_RADAR_166d93ae_Tx: ComSignalType=UINT8
            OBJ_ACCELERATION_LONG_054_oRDR_TRACKER_OBJ_054_oPCAN_RADAR_b169f0f0_Tx: ComSignalType=UINT16
            OBJ_ACCELERATION_LONG_ERR_054_oRDR_TRACKER_OBJ_054_oPCAN_RADAR_09c83604_Tx: ComSignalType=UINT8
            OBJ_ACCEL_ERR_CRR_COEF_054_oRDR_TRACKER_OBJ_054_oPCAN_RADAR_a96b1762_Tx: ComSignalType=UINT8
            OBJ_ALIVE_TIME_054_oRDR_TRACKER_OBJ_054_oPCAN_RADAR_d108bb4c_Tx: ComSignalType=UINT16
            OBJ_CLS_TYPE1_054_oRDR_TRACKER_OBJ_054_oPCAN_RADAR_46d35a6a_Tx: ComSignalType=UINT8
            OBJ_CLS_TYPE1_PROB_054_oRDR_TRACKER_OBJ_054_oPCAN_RADAR_ee8b8d99_Tx: ComSignalType=UINT8
            OBJ_CLS_TYPE2_054_oRDR_TRACKER_OBJ_054_oPCAN_RADAR_0b3b5a0d_Tx: ComSignalType=UINT8
            OBJ_CLS_TYPE2_PROB_054_oRDR_TRACKER_OBJ_054_oPCAN_RADAR_27bf9694_Tx: ComSignalType=UINT8
            OBJ_CLS_TYPE3_054_oRDR_TRACKER_OBJ_054_oPCAN_RADAR_86b3a7ef_Tx: ComSignalType=UINT8
            OBJ_CLS_TYPE3_PROB_054_oRDR_TRACKER_OBJ_054_oPCAN_RADAR_60ac606f_Tx: ComSignalType=UINT8
            OBJ_CLS_TYPE4_054_oRDR_TRACKER_OBJ_054_oPCAN_RADAR_90eb5ac3_Tx: ComSignalType=UINT8
            OBJ_CLS_TYPE4_PROB_054_oRDR_TRACKER_OBJ_054_oPCAN_RADAR_6ea6a6cf_Tx: ComSignalType=UINT8
            OBJ_CLS_TYPE5_054_oRDR_TRACKER_OBJ_054_oPCAN_RADAR_1d63a721_Tx: ComSignalType=UINT8
            OBJ_CLS_TYPE5_PROB_054_oRDR_TRACKER_OBJ_054_oPCAN_RADAR_29b55034_Tx: ComSignalType=UINT8
            OBJ_CLS_TYPE6_054_oRDR_TRACKER_OBJ_054_oPCAN_RADAR_508ba746_Tx: ComSignalType=UINT8
            OBJ_CLS_TYPE6_PROB_054_oRDR_TRACKER_OBJ_054_oPCAN_RADAR_e0814b39_Tx: ComSignalType=UINT8
            OBJ_DIMENSION_LENGTH_054_oRDR_TRACKER_OBJ_054_oPCAN_RADAR_044d092e_Tx: ComSignalType=UINT16
            OBJ_DIMENSION_LENGTH_ERR_054_oRDR_TRACKER_OBJ_054_oPCAN_RADAR_3fb51654_Tx: ComSignalType=UINT16
            OBJ_DIMENSION_WIDTH_054_oRDR_TRACKER_OBJ_054_oPCAN_RADAR_2783fe83_Tx: ComSignalType=UINT16
            OBJ_DIMENSION_WIDTH_ERR_054_oRDR_TRACKER_OBJ_054_oPCAN_RADAR_c721396b_Tx: ComSignalType=UINT8
            OBJ_EXISTENCE_PROB_054_oRDR_TRACKER_OBJ_054_oPCAN_RADAR_2c3f7abe_Tx: ComSignalType=UINT16
            OBJ_GROUP_ID_054_oRDR_TRACKER_OBJ_054_oPCAN_RADAR_a54d6e13_Tx: ComSignalType=UINT8
            OBJ_ID_054_oRDR_TRACKER_OBJ_054_oPCAN_RADAR_56634514_Tx: ComSignalType=UINT8
            OBJ_MEASUREMENT_STATUS_054_oRDR_TRACKER_OBJ_054_oPCAN_RADAR_29b137a9_Tx: ComSignalType=UINT8
            OBJ_MH_CRC16_054_oRDR_TRACKER_OBJ_054_oPCAN_RADAR_55d18095_Tx: ComSignalType=UINT16
            OBJ_MH_CYCLE_COUNTER_054_oRDR_TRACKER_OBJ_054_oPCAN_RADAR_2435da74_Tx: ComSignalType=UINT8
            OBJ_MOVEMENT_STATUS_054_oRDR_TRACKER_OBJ_054_oPCAN_RADAR_061fa2e5_Tx: ComSignalType=UINT8
            OBJ_POS_ERR_CRR_COEF_054_oRDR_TRACKER_OBJ_054_oPCAN_RADAR_966062df_Tx: ComSignalType=UINT8
            OBJ_POS_LAT_054_oRDR_TRACKER_OBJ_054_oPCAN_RADAR_74cf9f93_Tx: ComSignalType=UINT16
            OBJ_POS_LAT_ERR_054_oRDR_TRACKER_OBJ_054_oPCAN_RADAR_7083cfa4_Tx: ComSignalType=UINT8
            OBJ_POS_LONG_054_oRDR_TRACKER_OBJ_054_oPCAN_RADAR_c56f745c_Tx: ComSignalType=UINT16
            OBJ_POS_LONG_ERR_054_oRDR_TRACKER_OBJ_054_oPCAN_RADAR_e97b3146_Tx: ComSignalType=UINT8
            OBJ_RCS_054_oRDR_TRACKER_OBJ_054_oPCAN_RADAR_5600c994_Tx: ComSignalType=UINT8
            OBJ_REF_PT_LAT_OFFSET_054_oRDR_TRACKER_OBJ_054_oPCAN_RADAR_a33da2e1_Tx: ComSignalType=UINT16
            OBJ_REF_PT_LONG_OFFSET_054_oRDR_TRACKER_OBJ_054_oPCAN_RADAR_ec6f52e2_Tx: ComSignalType=UINT16
            OBJ_TIMESTAMP_OFFSET_054_oRDR_TRACKER_OBJ_054_oPCAN_RADAR_56acc9c2_Tx: ComSignalType=UINT8
            OBJ_TRACK_MOTION_MODEL_054_oRDR_TRACKER_OBJ_054_oPCAN_RADAR_9aafc81f_Tx: ComSignalType=UINT8
            OBJ_VEH_TRACK_FLAG_054_oRDR_TRACKER_OBJ_054_oPCAN_RADAR_18853e42_Tx: ComSignalType=BOOLEAN
            OBJ_VELOCITY_ERR_CRR_COEF_054_oRDR_TRACKER_OBJ_054_oPCAN_RADAR_3f1a5f3e_Tx: ComSignalType=UINT8
            OBJ_VELOCITY_LAT_054_oRDR_TRACKER_OBJ_054_oPCAN_RADAR_30acdab4_Tx: ComSignalType=UINT16
            OBJ_VELOCITY_LAT_ERR_054_oRDR_TRACKER_OBJ_054_oPCAN_RADAR_0456aae5_Tx: ComSignalType=UINT8
            OBJ_VELOCITY_LONG_054_oRDR_TRACKER_OBJ_054_oPCAN_RADAR_6021a272_Tx: ComSignalType=UINT16
            OBJ_VELOCITY_LONG_ERR_054_oRDR_TRACKER_OBJ_054_oPCAN_RADAR_e8d49525_Tx: ComSignalType=UINT8
            OBJ_YAW_ANGLE_054_oRDR_TRACKER_OBJ_054_oPCAN_RADAR_dc109ef4_Tx: ComSignalType=UINT16
            OBJ_YAW_ANGLE_ERR_054_oRDR_TRACKER_OBJ_054_oPCAN_RADAR_091d9823_Tx: ComSignalType=UINT8
            OBJ_YAW_RATE_054_oRDR_TRACKER_OBJ_054_oPCAN_RADAR_f99fbbb3_Tx: ComSignalType=UINT16
            OBJ_YAW_RATE_ERR_054_oRDR_TRACKER_OBJ_054_oPCAN_RADAR_c6472c6f_Tx: ComSignalType=UINT8
        SG_TrackerObject055_oRDR_TRACKER_OBJ_055_oPCAN_RADAR_34a97ad4_Tx
          49 x ComGroupSignal:
            OBJ_ACCELERATION_LAT_055_oRDR_TRACKER_OBJ_055_oPCAN_RADAR_3a8d21a3_Tx: ComSignalType=UINT16
            OBJ_ACCELERATION_LAT_ERR_055_oRDR_TRACKER_OBJ_055_oPCAN_RADAR_ef791b1d_Tx: ComSignalType=UINT8
            OBJ_ACCELERATION_LONG_055_oRDR_TRACKER_OBJ_055_oPCAN_RADAR_487d7843_Tx: ComSignalType=UINT16
            OBJ_ACCELERATION_LONG_ERR_055_oRDR_TRACKER_OBJ_055_oPCAN_RADAR_f0dcbeb7_Tx: ComSignalType=UINT8
            OBJ_ACCEL_ERR_CRR_COEF_055_oRDR_TRACKER_OBJ_055_oPCAN_RADAR_507f9fd1_Tx: ComSignalType=UINT8
            OBJ_ALIVE_TIME_055_oRDR_TRACKER_OBJ_055_oPCAN_RADAR_281c33ff_Tx: ComSignalType=UINT16
            OBJ_CLS_TYPE1_055_oRDR_TRACKER_OBJ_055_oPCAN_RADAR_bfc7d2d9_Tx: ComSignalType=UINT8
            OBJ_CLS_TYPE1_PROB_055_oRDR_TRACKER_OBJ_055_oPCAN_RADAR_179f052a_Tx: ComSignalType=UINT8
            OBJ_CLS_TYPE2_055_oRDR_TRACKER_OBJ_055_oPCAN_RADAR_f22fd2be_Tx: ComSignalType=UINT8
            OBJ_CLS_TYPE2_PROB_055_oRDR_TRACKER_OBJ_055_oPCAN_RADAR_deab1e27_Tx: ComSignalType=UINT8
            OBJ_CLS_TYPE3_055_oRDR_TRACKER_OBJ_055_oPCAN_RADAR_7fa72f5c_Tx: ComSignalType=UINT8
            OBJ_CLS_TYPE3_PROB_055_oRDR_TRACKER_OBJ_055_oPCAN_RADAR_99b8e8dc_Tx: ComSignalType=UINT8
            OBJ_CLS_TYPE4_055_oRDR_TRACKER_OBJ_055_oPCAN_RADAR_69ffd270_Tx: ComSignalType=UINT8
            OBJ_CLS_TYPE4_PROB_055_oRDR_TRACKER_OBJ_055_oPCAN_RADAR_97b22e7c_Tx: ComSignalType=UINT8
            OBJ_CLS_TYPE5_055_oRDR_TRACKER_OBJ_055_oPCAN_RADAR_e4772f92_Tx: ComSignalType=UINT8
            OBJ_CLS_TYPE5_PROB_055_oRDR_TRACKER_OBJ_055_oPCAN_RADAR_d0a1d887_Tx: ComSignalType=UINT8
            OBJ_CLS_TYPE6_055_oRDR_TRACKER_OBJ_055_oPCAN_RADAR_a99f2ff5_Tx: ComSignalType=UINT8
            OBJ_CLS_TYPE6_PROB_055_oRDR_TRACKER_OBJ_055_oPCAN_RADAR_1995c38a_Tx: ComSignalType=UINT8
            OBJ_DIMENSION_LENGTH_055_oRDR_TRACKER_OBJ_055_oPCAN_RADAR_fd59819d_Tx: ComSignalType=UINT16
            OBJ_DIMENSION_LENGTH_ERR_055_oRDR_TRACKER_OBJ_055_oPCAN_RADAR_c6a19ee7_Tx: ComSignalType=UINT16
            OBJ_DIMENSION_WIDTH_055_oRDR_TRACKER_OBJ_055_oPCAN_RADAR_de977630_Tx: ComSignalType=UINT16
            OBJ_DIMENSION_WIDTH_ERR_055_oRDR_TRACKER_OBJ_055_oPCAN_RADAR_3e35b1d8_Tx: ComSignalType=UINT8
            OBJ_EXISTENCE_PROB_055_oRDR_TRACKER_OBJ_055_oPCAN_RADAR_d52bf20d_Tx: ComSignalType=UINT16
            OBJ_GROUP_ID_055_oRDR_TRACKER_OBJ_055_oPCAN_RADAR_5c59e6a0_Tx: ComSignalType=UINT8
            OBJ_ID_055_oRDR_TRACKER_OBJ_055_oPCAN_RADAR_af77cda7_Tx: ComSignalType=UINT8
            OBJ_MEASUREMENT_STATUS_055_oRDR_TRACKER_OBJ_055_oPCAN_RADAR_d0a5bf1a_Tx: ComSignalType=UINT8
            OBJ_MH_CRC16_055_oRDR_TRACKER_OBJ_055_oPCAN_RADAR_acc50826_Tx: ComSignalType=UINT16
            OBJ_MH_CYCLE_COUNTER_055_oRDR_TRACKER_OBJ_055_oPCAN_RADAR_dd2152c7_Tx: ComSignalType=UINT8
            OBJ_MOVEMENT_STATUS_055_oRDR_TRACKER_OBJ_055_oPCAN_RADAR_ff0b2a56_Tx: ComSignalType=UINT8
            OBJ_POS_ERR_CRR_COEF_055_oRDR_TRACKER_OBJ_055_oPCAN_RADAR_6f74ea6c_Tx: ComSignalType=UINT8
            OBJ_POS_LAT_055_oRDR_TRACKER_OBJ_055_oPCAN_RADAR_8ddb1720_Tx: ComSignalType=UINT16
            OBJ_POS_LAT_ERR_055_oRDR_TRACKER_OBJ_055_oPCAN_RADAR_89974717_Tx: ComSignalType=UINT8
            OBJ_POS_LONG_055_oRDR_TRACKER_OBJ_055_oPCAN_RADAR_3c7bfcef_Tx: ComSignalType=UINT16
            OBJ_POS_LONG_ERR_055_oRDR_TRACKER_OBJ_055_oPCAN_RADAR_106fb9f5_Tx: ComSignalType=UINT8
            OBJ_RCS_055_oRDR_TRACKER_OBJ_055_oPCAN_RADAR_af144127_Tx: ComSignalType=UINT8
            OBJ_REF_PT_LAT_OFFSET_055_oRDR_TRACKER_OBJ_055_oPCAN_RADAR_5a292a52_Tx: ComSignalType=UINT16
            OBJ_REF_PT_LONG_OFFSET_055_oRDR_TRACKER_OBJ_055_oPCAN_RADAR_157bda51_Tx: ComSignalType=UINT16
            OBJ_TIMESTAMP_OFFSET_055_oRDR_TRACKER_OBJ_055_oPCAN_RADAR_afb84171_Tx: ComSignalType=UINT8
            OBJ_TRACK_MOTION_MODEL_055_oRDR_TRACKER_OBJ_055_oPCAN_RADAR_63bb40ac_Tx: ComSignalType=UINT8
            OBJ_VEH_TRACK_FLAG_055_oRDR_TRACKER_OBJ_055_oPCAN_RADAR_e191b6f1_Tx: ComSignalType=BOOLEAN
            OBJ_VELOCITY_ERR_CRR_COEF_055_oRDR_TRACKER_OBJ_055_oPCAN_RADAR_c60ed78d_Tx: ComSignalType=UINT8
            OBJ_VELOCITY_LAT_055_oRDR_TRACKER_OBJ_055_oPCAN_RADAR_c9b85207_Tx: ComSignalType=UINT16
            OBJ_VELOCITY_LAT_ERR_055_oRDR_TRACKER_OBJ_055_oPCAN_RADAR_fd422256_Tx: ComSignalType=UINT8
            OBJ_VELOCITY_LONG_055_oRDR_TRACKER_OBJ_055_oPCAN_RADAR_99352ac1_Tx: ComSignalType=UINT16
            OBJ_VELOCITY_LONG_ERR_055_oRDR_TRACKER_OBJ_055_oPCAN_RADAR_11c01d96_Tx: ComSignalType=UINT8
            OBJ_YAW_ANGLE_055_oRDR_TRACKER_OBJ_055_oPCAN_RADAR_25041647_Tx: ComSignalType=UINT16
            OBJ_YAW_ANGLE_ERR_055_oRDR_TRACKER_OBJ_055_oPCAN_RADAR_f0091090_Tx: ComSignalType=UINT8
            OBJ_YAW_RATE_055_oRDR_TRACKER_OBJ_055_oPCAN_RADAR_008b3300_Tx: ComSignalType=UINT16
            OBJ_YAW_RATE_ERR_055_oRDR_TRACKER_OBJ_055_oPCAN_RADAR_3f53a4dc_Tx: ComSignalType=UINT8
        SG_TrackerObject056_oRDR_TRACKER_OBJ_056_oPCAN_RADAR_e4e5e540_Tx
          49 x ComGroupSignal:
            OBJ_ACCELERATION_LAT_056_oRDR_TRACKER_OBJ_056_oPCAN_RADAR_eac1be37_Tx: ComSignalType=UINT16
            OBJ_ACCELERATION_LAT_ERR_056_oRDR_TRACKER_OBJ_056_oPCAN_RADAR_3f358489_Tx: ComSignalType=UINT8
            OBJ_ACCELERATION_LONG_056_oRDR_TRACKER_OBJ_056_oPCAN_RADAR_9831e7d7_Tx: ComSignalType=UINT16
            OBJ_ACCELERATION_LONG_ERR_056_oRDR_TRACKER_OBJ_056_oPCAN_RADAR_20902123_Tx: ComSignalType=UINT8
            OBJ_ACCEL_ERR_CRR_COEF_056_oRDR_TRACKER_OBJ_056_oPCAN_RADAR_80330045_Tx: ComSignalType=UINT8
            OBJ_ALIVE_TIME_056_oRDR_TRACKER_OBJ_056_oPCAN_RADAR_f850ac6b_Tx: ComSignalType=UINT16
            OBJ_CLS_TYPE1_056_oRDR_TRACKER_OBJ_056_oPCAN_RADAR_6f8b4d4d_Tx: ComSignalType=UINT8
            OBJ_CLS_TYPE1_PROB_056_oRDR_TRACKER_OBJ_056_oPCAN_RADAR_c7d39abe_Tx: ComSignalType=UINT8
            OBJ_CLS_TYPE2_056_oRDR_TRACKER_OBJ_056_oPCAN_RADAR_22634d2a_Tx: ComSignalType=UINT8
            OBJ_CLS_TYPE2_PROB_056_oRDR_TRACKER_OBJ_056_oPCAN_RADAR_0ee781b3_Tx: ComSignalType=UINT8
            OBJ_CLS_TYPE3_056_oRDR_TRACKER_OBJ_056_oPCAN_RADAR_afebb0c8_Tx: ComSignalType=UINT8
            OBJ_CLS_TYPE3_PROB_056_oRDR_TRACKER_OBJ_056_oPCAN_RADAR_49f47748_Tx: ComSignalType=UINT8
            OBJ_CLS_TYPE4_056_oRDR_TRACKER_OBJ_056_oPCAN_RADAR_b9b34de4_Tx: ComSignalType=UINT8
            OBJ_CLS_TYPE4_PROB_056_oRDR_TRACKER_OBJ_056_oPCAN_RADAR_47feb1e8_Tx: ComSignalType=UINT8
            OBJ_CLS_TYPE5_056_oRDR_TRACKER_OBJ_056_oPCAN_RADAR_343bb006_Tx: ComSignalType=UINT8
            OBJ_CLS_TYPE5_PROB_056_oRDR_TRACKER_OBJ_056_oPCAN_RADAR_00ed4713_Tx: ComSignalType=UINT8
            OBJ_CLS_TYPE6_056_oRDR_TRACKER_OBJ_056_oPCAN_RADAR_79d3b061_Tx: ComSignalType=UINT8
            OBJ_CLS_TYPE6_PROB_056_oRDR_TRACKER_OBJ_056_oPCAN_RADAR_c9d95c1e_Tx: ComSignalType=UINT8
            OBJ_DIMENSION_LENGTH_056_oRDR_TRACKER_OBJ_056_oPCAN_RADAR_2d151e09_Tx: ComSignalType=UINT16
            OBJ_DIMENSION_LENGTH_ERR_056_oRDR_TRACKER_OBJ_056_oPCAN_RADAR_16ed0173_Tx: ComSignalType=UINT16
            OBJ_DIMENSION_WIDTH_056_oRDR_TRACKER_OBJ_056_oPCAN_RADAR_0edbe9a4_Tx: ComSignalType=UINT16
            OBJ_DIMENSION_WIDTH_ERR_056_oRDR_TRACKER_OBJ_056_oPCAN_RADAR_ee792e4c_Tx: ComSignalType=UINT8
            OBJ_EXISTENCE_PROB_056_oRDR_TRACKER_OBJ_056_oPCAN_RADAR_05676d99_Tx: ComSignalType=UINT16
            OBJ_GROUP_ID_056_oRDR_TRACKER_OBJ_056_oPCAN_RADAR_8c157934_Tx: ComSignalType=UINT8
            OBJ_ID_056_oRDR_TRACKER_OBJ_056_oPCAN_RADAR_7f3b5233_Tx: ComSignalType=UINT8
            OBJ_MEASUREMENT_STATUS_056_oRDR_TRACKER_OBJ_056_oPCAN_RADAR_00e9208e_Tx: ComSignalType=UINT8
            OBJ_MH_CRC16_056_oRDR_TRACKER_OBJ_056_oPCAN_RADAR_7c8997b2_Tx: ComSignalType=UINT16
            OBJ_MH_CYCLE_COUNTER_056_oRDR_TRACKER_OBJ_056_oPCAN_RADAR_0d6dcd53_Tx: ComSignalType=UINT8
            OBJ_MOVEMENT_STATUS_056_oRDR_TRACKER_OBJ_056_oPCAN_RADAR_2f47b5c2_Tx: ComSignalType=UINT8
            OBJ_POS_ERR_CRR_COEF_056_oRDR_TRACKER_OBJ_056_oPCAN_RADAR_bf3875f8_Tx: ComSignalType=UINT8
            OBJ_POS_LAT_056_oRDR_TRACKER_OBJ_056_oPCAN_RADAR_5d9788b4_Tx: ComSignalType=UINT16
            OBJ_POS_LAT_ERR_056_oRDR_TRACKER_OBJ_056_oPCAN_RADAR_59dbd883_Tx: ComSignalType=UINT8
            OBJ_POS_LONG_056_oRDR_TRACKER_OBJ_056_oPCAN_RADAR_ec37637b_Tx: ComSignalType=UINT16
            OBJ_POS_LONG_ERR_056_oRDR_TRACKER_OBJ_056_oPCAN_RADAR_c0232661_Tx: ComSignalType=UINT8
            OBJ_RCS_056_oRDR_TRACKER_OBJ_056_oPCAN_RADAR_7f58deb3_Tx: ComSignalType=UINT8
            OBJ_REF_PT_LAT_OFFSET_056_oRDR_TRACKER_OBJ_056_oPCAN_RADAR_8a65b5c6_Tx: ComSignalType=UINT16
            OBJ_REF_PT_LONG_OFFSET_056_oRDR_TRACKER_OBJ_056_oPCAN_RADAR_c53745c5_Tx: ComSignalType=UINT16
            OBJ_TIMESTAMP_OFFSET_056_oRDR_TRACKER_OBJ_056_oPCAN_RADAR_7ff4dee5_Tx: ComSignalType=UINT8
            OBJ_TRACK_MOTION_MODEL_056_oRDR_TRACKER_OBJ_056_oPCAN_RADAR_b3f7df38_Tx: ComSignalType=UINT8
            OBJ_VEH_TRACK_FLAG_056_oRDR_TRACKER_OBJ_056_oPCAN_RADAR_31dd2965_Tx: ComSignalType=BOOLEAN
            OBJ_VELOCITY_ERR_CRR_COEF_056_oRDR_TRACKER_OBJ_056_oPCAN_RADAR_16424819_Tx: ComSignalType=UINT8
            OBJ_VELOCITY_LAT_056_oRDR_TRACKER_OBJ_056_oPCAN_RADAR_19f4cd93_Tx: ComSignalType=UINT16
            OBJ_VELOCITY_LAT_ERR_056_oRDR_TRACKER_OBJ_056_oPCAN_RADAR_2d0ebdc2_Tx: ComSignalType=UINT8
            OBJ_VELOCITY_LONG_056_oRDR_TRACKER_OBJ_056_oPCAN_RADAR_4979b555_Tx: ComSignalType=UINT16
            OBJ_VELOCITY_LONG_ERR_056_oRDR_TRACKER_OBJ_056_oPCAN_RADAR_c18c8202_Tx: ComSignalType=UINT8
            OBJ_YAW_ANGLE_056_oRDR_TRACKER_OBJ_056_oPCAN_RADAR_f54889d3_Tx: ComSignalType=UINT16
            OBJ_YAW_ANGLE_ERR_056_oRDR_TRACKER_OBJ_056_oPCAN_RADAR_20458f04_Tx: ComSignalType=UINT8
            OBJ_YAW_RATE_056_oRDR_TRACKER_OBJ_056_oPCAN_RADAR_d0c7ac94_Tx: ComSignalType=UINT16
            OBJ_YAW_RATE_ERR_056_oRDR_TRACKER_OBJ_056_oPCAN_RADAR_ef1f3b48_Tx: ComSignalType=UINT8
        SG_TrackerObject057_oRDR_TRACKER_OBJ_057_oPCAN_RADAR_1df16df3_Tx
          49 x ComGroupSignal:
            OBJ_ACCELERATION_LAT_057_oRDR_TRACKER_OBJ_057_oPCAN_RADAR_13d53684_Tx: ComSignalType=UINT16
            OBJ_ACCELERATION_LAT_ERR_057_oRDR_TRACKER_OBJ_057_oPCAN_RADAR_c6210c3a_Tx: ComSignalType=UINT8
            OBJ_ACCELERATION_LONG_057_oRDR_TRACKER_OBJ_057_oPCAN_RADAR_61256f64_Tx: ComSignalType=UINT16
            OBJ_ACCELERATION_LONG_ERR_057_oRDR_TRACKER_OBJ_057_oPCAN_RADAR_d984a990_Tx: ComSignalType=UINT8
            OBJ_ACCEL_ERR_CRR_COEF_057_oRDR_TRACKER_OBJ_057_oPCAN_RADAR_792788f6_Tx: ComSignalType=UINT8
            OBJ_ALIVE_TIME_057_oRDR_TRACKER_OBJ_057_oPCAN_RADAR_014424d8_Tx: ComSignalType=UINT16
            OBJ_CLS_TYPE1_057_oRDR_TRACKER_OBJ_057_oPCAN_RADAR_969fc5fe_Tx: ComSignalType=UINT8
            OBJ_CLS_TYPE1_PROB_057_oRDR_TRACKER_OBJ_057_oPCAN_RADAR_3ec7120d_Tx: ComSignalType=UINT8
            OBJ_CLS_TYPE2_057_oRDR_TRACKER_OBJ_057_oPCAN_RADAR_db77c599_Tx: ComSignalType=UINT8
            OBJ_CLS_TYPE2_PROB_057_oRDR_TRACKER_OBJ_057_oPCAN_RADAR_f7f30900_Tx: ComSignalType=UINT8
            OBJ_CLS_TYPE3_057_oRDR_TRACKER_OBJ_057_oPCAN_RADAR_56ff387b_Tx: ComSignalType=UINT8
            OBJ_CLS_TYPE3_PROB_057_oRDR_TRACKER_OBJ_057_oPCAN_RADAR_b0e0fffb_Tx: ComSignalType=UINT8
            OBJ_CLS_TYPE4_057_oRDR_TRACKER_OBJ_057_oPCAN_RADAR_40a7c557_Tx: ComSignalType=UINT8
            OBJ_CLS_TYPE4_PROB_057_oRDR_TRACKER_OBJ_057_oPCAN_RADAR_beea395b_Tx: ComSignalType=UINT8
            OBJ_CLS_TYPE5_057_oRDR_TRACKER_OBJ_057_oPCAN_RADAR_cd2f38b5_Tx: ComSignalType=UINT8
            OBJ_CLS_TYPE5_PROB_057_oRDR_TRACKER_OBJ_057_oPCAN_RADAR_f9f9cfa0_Tx: ComSignalType=UINT8
            OBJ_CLS_TYPE6_057_oRDR_TRACKER_OBJ_057_oPCAN_RADAR_80c738d2_Tx: ComSignalType=UINT8
            OBJ_CLS_TYPE6_PROB_057_oRDR_TRACKER_OBJ_057_oPCAN_RADAR_30cdd4ad_Tx: ComSignalType=UINT8
            OBJ_DIMENSION_LENGTH_057_oRDR_TRACKER_OBJ_057_oPCAN_RADAR_d40196ba_Tx: ComSignalType=UINT16
            OBJ_DIMENSION_LENGTH_ERR_057_oRDR_TRACKER_OBJ_057_oPCAN_RADAR_eff989c0_Tx: ComSignalType=UINT16
            OBJ_DIMENSION_WIDTH_057_oRDR_TRACKER_OBJ_057_oPCAN_RADAR_f7cf6117_Tx: ComSignalType=UINT16
            OBJ_DIMENSION_WIDTH_ERR_057_oRDR_TRACKER_OBJ_057_oPCAN_RADAR_176da6ff_Tx: ComSignalType=UINT8
            OBJ_EXISTENCE_PROB_057_oRDR_TRACKER_OBJ_057_oPCAN_RADAR_fc73e52a_Tx: ComSignalType=UINT16
            OBJ_GROUP_ID_057_oRDR_TRACKER_OBJ_057_oPCAN_RADAR_7501f187_Tx: ComSignalType=UINT8
            OBJ_ID_057_oRDR_TRACKER_OBJ_057_oPCAN_RADAR_862fda80_Tx: ComSignalType=UINT8
            OBJ_MEASUREMENT_STATUS_057_oRDR_TRACKER_OBJ_057_oPCAN_RADAR_f9fda83d_Tx: ComSignalType=UINT8
            OBJ_MH_CRC16_057_oRDR_TRACKER_OBJ_057_oPCAN_RADAR_859d1f01_Tx: ComSignalType=UINT16
            OBJ_MH_CYCLE_COUNTER_057_oRDR_TRACKER_OBJ_057_oPCAN_RADAR_f47945e0_Tx: ComSignalType=UINT8
            OBJ_MOVEMENT_STATUS_057_oRDR_TRACKER_OBJ_057_oPCAN_RADAR_d6533d71_Tx: ComSignalType=UINT8
            OBJ_POS_ERR_CRR_COEF_057_oRDR_TRACKER_OBJ_057_oPCAN_RADAR_462cfd4b_Tx: ComSignalType=UINT8
            OBJ_POS_LAT_057_oRDR_TRACKER_OBJ_057_oPCAN_RADAR_a4830007_Tx: ComSignalType=UINT16
            OBJ_POS_LAT_ERR_057_oRDR_TRACKER_OBJ_057_oPCAN_RADAR_a0cf5030_Tx: ComSignalType=UINT8
            OBJ_POS_LONG_057_oRDR_TRACKER_OBJ_057_oPCAN_RADAR_1523ebc8_Tx: ComSignalType=UINT16
            OBJ_POS_LONG_ERR_057_oRDR_TRACKER_OBJ_057_oPCAN_RADAR_3937aed2_Tx: ComSignalType=UINT8
            OBJ_RCS_057_oRDR_TRACKER_OBJ_057_oPCAN_RADAR_864c5600_Tx: ComSignalType=UINT8
            OBJ_REF_PT_LAT_OFFSET_057_oRDR_TRACKER_OBJ_057_oPCAN_RADAR_73713d75_Tx: ComSignalType=UINT16
            OBJ_REF_PT_LONG_OFFSET_057_oRDR_TRACKER_OBJ_057_oPCAN_RADAR_3c23cd76_Tx: ComSignalType=UINT16
            OBJ_TIMESTAMP_OFFSET_057_oRDR_TRACKER_OBJ_057_oPCAN_RADAR_86e05656_Tx: ComSignalType=UINT8
            OBJ_TRACK_MOTION_MODEL_057_oRDR_TRACKER_OBJ_057_oPCAN_RADAR_4ae3578b_Tx: ComSignalType=UINT8
            OBJ_VEH_TRACK_FLAG_057_oRDR_TRACKER_OBJ_057_oPCAN_RADAR_c8c9a1d6_Tx: ComSignalType=BOOLEAN
            OBJ_VELOCITY_ERR_CRR_COEF_057_oRDR_TRACKER_OBJ_057_oPCAN_RADAR_ef56c0aa_Tx: ComSignalType=UINT8
            OBJ_VELOCITY_LAT_057_oRDR_TRACKER_OBJ_057_oPCAN_RADAR_e0e04520_Tx: ComSignalType=UINT16
            OBJ_VELOCITY_LAT_ERR_057_oRDR_TRACKER_OBJ_057_oPCAN_RADAR_d41a3571_Tx: ComSignalType=UINT8
            OBJ_VELOCITY_LONG_057_oRDR_TRACKER_OBJ_057_oPCAN_RADAR_b06d3de6_Tx: ComSignalType=UINT16
            OBJ_VELOCITY_LONG_ERR_057_oRDR_TRACKER_OBJ_057_oPCAN_RADAR_38980ab1_Tx: ComSignalType=UINT8
            OBJ_YAW_ANGLE_057_oRDR_TRACKER_OBJ_057_oPCAN_RADAR_0c5c0160_Tx: ComSignalType=UINT16
            OBJ_YAW_ANGLE_ERR_057_oRDR_TRACKER_OBJ_057_oPCAN_RADAR_d95107b7_Tx: ComSignalType=UINT8
            OBJ_YAW_RATE_057_oRDR_TRACKER_OBJ_057_oPCAN_RADAR_29d32427_Tx: ComSignalType=UINT16
            OBJ_YAW_RATE_ERR_057_oRDR_TRACKER_OBJ_057_oPCAN_RADAR_160bb3fb_Tx: ComSignalType=UINT8
        SG_TrackerObject058_oRDR_TRACKER_OBJ_058_oPCAN_RADAR_3a6d80b5_Tx
          49 x ComGroupSignal:
            OBJ_ACCELERATION_LAT_058_oRDR_TRACKER_OBJ_058_oPCAN_RADAR_3449dbc2_Tx: ComSignalType=UINT16
            OBJ_ACCELERATION_LAT_ERR_058_oRDR_TRACKER_OBJ_058_oPCAN_RADAR_e1bde17c_Tx: ComSignalType=UINT8
            OBJ_ACCELERATION_LONG_058_oRDR_TRACKER_OBJ_058_oPCAN_RADAR_46b98222_Tx: ComSignalType=UINT16
            OBJ_ACCELERATION_LONG_ERR_058_oRDR_TRACKER_OBJ_058_oPCAN_RADAR_fe1844d6_Tx: ComSignalType=UINT8
            OBJ_ACCEL_ERR_CRR_COEF_058_oRDR_TRACKER_OBJ_058_oPCAN_RADAR_5ebb65b0_Tx: ComSignalType=UINT8
            OBJ_ALIVE_TIME_058_oRDR_TRACKER_OBJ_058_oPCAN_RADAR_26d8c99e_Tx: ComSignalType=UINT16
            OBJ_CLS_TYPE1_058_oRDR_TRACKER_OBJ_058_oPCAN_RADAR_b10328b8_Tx: ComSignalType=UINT8
            OBJ_CLS_TYPE1_PROB_058_oRDR_TRACKER_OBJ_058_oPCAN_RADAR_195bff4b_Tx: ComSignalType=UINT8
            OBJ_CLS_TYPE2_058_oRDR_TRACKER_OBJ_058_oPCAN_RADAR_fceb28df_Tx: ComSignalType=UINT8
            OBJ_CLS_TYPE2_PROB_058_oRDR_TRACKER_OBJ_058_oPCAN_RADAR_d06fe446_Tx: ComSignalType=UINT8
            OBJ_CLS_TYPE3_058_oRDR_TRACKER_OBJ_058_oPCAN_RADAR_7163d53d_Tx: ComSignalType=UINT8
            OBJ_CLS_TYPE3_PROB_058_oRDR_TRACKER_OBJ_058_oPCAN_RADAR_977c12bd_Tx: ComSignalType=UINT8
            OBJ_CLS_TYPE4_058_oRDR_TRACKER_OBJ_058_oPCAN_RADAR_673b2811_Tx: ComSignalType=UINT8
            OBJ_CLS_TYPE4_PROB_058_oRDR_TRACKER_OBJ_058_oPCAN_RADAR_9976d41d_Tx: ComSignalType=UINT8
            OBJ_CLS_TYPE5_058_oRDR_TRACKER_OBJ_058_oPCAN_RADAR_eab3d5f3_Tx: ComSignalType=UINT8
            OBJ_CLS_TYPE5_PROB_058_oRDR_TRACKER_OBJ_058_oPCAN_RADAR_de6522e6_Tx: ComSignalType=UINT8
            OBJ_CLS_TYPE6_058_oRDR_TRACKER_OBJ_058_oPCAN_RADAR_a75bd594_Tx: ComSignalType=UINT8
            OBJ_CLS_TYPE6_PROB_058_oRDR_TRACKER_OBJ_058_oPCAN_RADAR_175139eb_Tx: ComSignalType=UINT8
            OBJ_DIMENSION_LENGTH_058_oRDR_TRACKER_OBJ_058_oPCAN_RADAR_f39d7bfc_Tx: ComSignalType=UINT16
            OBJ_DIMENSION_LENGTH_ERR_058_oRDR_TRACKER_OBJ_058_oPCAN_RADAR_c8656486_Tx: ComSignalType=UINT16
            OBJ_DIMENSION_WIDTH_058_oRDR_TRACKER_OBJ_058_oPCAN_RADAR_d0538c51_Tx: ComSignalType=UINT16
            OBJ_DIMENSION_WIDTH_ERR_058_oRDR_TRACKER_OBJ_058_oPCAN_RADAR_30f14bb9_Tx: ComSignalType=UINT8
            OBJ_EXISTENCE_PROB_058_oRDR_TRACKER_OBJ_058_oPCAN_RADAR_dbef086c_Tx: ComSignalType=UINT16
            OBJ_GROUP_ID_058_oRDR_TRACKER_OBJ_058_oPCAN_RADAR_529d1cc1_Tx: ComSignalType=UINT8
            OBJ_ID_058_oRDR_TRACKER_OBJ_058_oPCAN_RADAR_a1b337c6_Tx: ComSignalType=UINT8
            OBJ_MEASUREMENT_STATUS_058_oRDR_TRACKER_OBJ_058_oPCAN_RADAR_de61457b_Tx: ComSignalType=UINT8
            OBJ_MH_CRC16_058_oRDR_TRACKER_OBJ_058_oPCAN_RADAR_a201f247_Tx: ComSignalType=UINT16
            OBJ_MH_CYCLE_COUNTER_058_oRDR_TRACKER_OBJ_058_oPCAN_RADAR_d3e5a8a6_Tx: ComSignalType=UINT8
            OBJ_MOVEMENT_STATUS_058_oRDR_TRACKER_OBJ_058_oPCAN_RADAR_f1cfd037_Tx: ComSignalType=UINT8
            OBJ_POS_ERR_CRR_COEF_058_oRDR_TRACKER_OBJ_058_oPCAN_RADAR_61b0100d_Tx: ComSignalType=UINT8
            OBJ_POS_LAT_058_oRDR_TRACKER_OBJ_058_oPCAN_RADAR_831fed41_Tx: ComSignalType=UINT16
            OBJ_POS_LAT_ERR_058_oRDR_TRACKER_OBJ_058_oPCAN_RADAR_8753bd76_Tx: ComSignalType=UINT8
            OBJ_POS_LONG_058_oRDR_TRACKER_OBJ_058_oPCAN_RADAR_32bf068e_Tx: ComSignalType=UINT16
            OBJ_POS_LONG_ERR_058_oRDR_TRACKER_OBJ_058_oPCAN_RADAR_1eab4394_Tx: ComSignalType=UINT8
            OBJ_RCS_058_oRDR_TRACKER_OBJ_058_oPCAN_RADAR_a1d0bb46_Tx: ComSignalType=UINT8
            OBJ_REF_PT_LAT_OFFSET_058_oRDR_TRACKER_OBJ_058_oPCAN_RADAR_54edd033_Tx: ComSignalType=UINT16
            OBJ_REF_PT_LONG_OFFSET_058_oRDR_TRACKER_OBJ_058_oPCAN_RADAR_1bbf2030_Tx: ComSignalType=UINT16
            OBJ_TIMESTAMP_OFFSET_058_oRDR_TRACKER_OBJ_058_oPCAN_RADAR_a17cbb10_Tx: ComSignalType=UINT8
            OBJ_TRACK_MOTION_MODEL_058_oRDR_TRACKER_OBJ_058_oPCAN_RADAR_6d7fbacd_Tx: ComSignalType=UINT8
            OBJ_VEH_TRACK_FLAG_058_oRDR_TRACKER_OBJ_058_oPCAN_RADAR_ef554c90_Tx: ComSignalType=BOOLEAN
            OBJ_VELOCITY_ERR_CRR_COEF_058_oRDR_TRACKER_OBJ_058_oPCAN_RADAR_c8ca2dec_Tx: ComSignalType=UINT8
            OBJ_VELOCITY_LAT_058_oRDR_TRACKER_OBJ_058_oPCAN_RADAR_c77ca866_Tx: ComSignalType=UINT16
            OBJ_VELOCITY_LAT_ERR_058_oRDR_TRACKER_OBJ_058_oPCAN_RADAR_f386d837_Tx: ComSignalType=UINT8
            OBJ_VELOCITY_LONG_058_oRDR_TRACKER_OBJ_058_oPCAN_RADAR_97f1d0a0_Tx: ComSignalType=UINT16
            OBJ_VELOCITY_LONG_ERR_058_oRDR_TRACKER_OBJ_058_oPCAN_RADAR_1f04e7f7_Tx: ComSignalType=UINT8
            OBJ_YAW_ANGLE_058_oRDR_TRACKER_OBJ_058_oPCAN_RADAR_2bc0ec26_Tx: ComSignalType=UINT16
            OBJ_YAW_ANGLE_ERR_058_oRDR_TRACKER_OBJ_058_oPCAN_RADAR_fecdeaf1_Tx: ComSignalType=UINT8
            OBJ_YAW_RATE_058_oRDR_TRACKER_OBJ_058_oPCAN_RADAR_0e4fc961_Tx: ComSignalType=UINT16
            OBJ_YAW_RATE_ERR_058_oRDR_TRACKER_OBJ_058_oPCAN_RADAR_31975ebd_Tx: ComSignalType=UINT8
        SG_TrackerObject059_oRDR_TRACKER_OBJ_059_oPCAN_RADAR_c3790806_Tx
          49 x ComGroupSignal:
            OBJ_ACCELERATION_LAT_059_oRDR_TRACKER_OBJ_059_oPCAN_RADAR_cd5d5371_Tx: ComSignalType=UINT16
            OBJ_ACCELERATION_LAT_ERR_059_oRDR_TRACKER_OBJ_059_oPCAN_RADAR_18a969cf_Tx: ComSignalType=UINT8
            OBJ_ACCELERATION_LONG_059_oRDR_TRACKER_OBJ_059_oPCAN_RADAR_bfad0a91_Tx: ComSignalType=UINT16
            OBJ_ACCELERATION_LONG_ERR_059_oRDR_TRACKER_OBJ_059_oPCAN_RADAR_070ccc65_Tx: ComSignalType=UINT8
            OBJ_ACCEL_ERR_CRR_COEF_059_oRDR_TRACKER_OBJ_059_oPCAN_RADAR_a7afed03_Tx: ComSignalType=UINT8
            OBJ_ALIVE_TIME_059_oRDR_TRACKER_OBJ_059_oPCAN_RADAR_dfcc412d_Tx: ComSignalType=UINT16
            OBJ_CLS_TYPE1_059_oRDR_TRACKER_OBJ_059_oPCAN_RADAR_4817a00b_Tx: ComSignalType=UINT8
            OBJ_CLS_TYPE1_PROB_059_oRDR_TRACKER_OBJ_059_oPCAN_RADAR_e04f77f8_Tx: ComSignalType=UINT8
            OBJ_CLS_TYPE2_059_oRDR_TRACKER_OBJ_059_oPCAN_RADAR_05ffa06c_Tx: ComSignalType=UINT8
            OBJ_CLS_TYPE2_PROB_059_oRDR_TRACKER_OBJ_059_oPCAN_RADAR_297b6cf5_Tx: ComSignalType=UINT8
            OBJ_CLS_TYPE3_059_oRDR_TRACKER_OBJ_059_oPCAN_RADAR_88775d8e_Tx: ComSignalType=UINT8
            OBJ_CLS_TYPE3_PROB_059_oRDR_TRACKER_OBJ_059_oPCAN_RADAR_6e689a0e_Tx: ComSignalType=UINT8
            OBJ_CLS_TYPE4_059_oRDR_TRACKER_OBJ_059_oPCAN_RADAR_9e2fa0a2_Tx: ComSignalType=UINT8
            OBJ_CLS_TYPE4_PROB_059_oRDR_TRACKER_OBJ_059_oPCAN_RADAR_60625cae_Tx: ComSignalType=UINT8
            OBJ_CLS_TYPE5_059_oRDR_TRACKER_OBJ_059_oPCAN_RADAR_13a75d40_Tx: ComSignalType=UINT8
            OBJ_CLS_TYPE5_PROB_059_oRDR_TRACKER_OBJ_059_oPCAN_RADAR_2771aa55_Tx: ComSignalType=UINT8
            OBJ_CLS_TYPE6_059_oRDR_TRACKER_OBJ_059_oPCAN_RADAR_5e4f5d27_Tx: ComSignalType=UINT8
            OBJ_CLS_TYPE6_PROB_059_oRDR_TRACKER_OBJ_059_oPCAN_RADAR_ee45b158_Tx: ComSignalType=UINT8
            OBJ_DIMENSION_LENGTH_059_oRDR_TRACKER_OBJ_059_oPCAN_RADAR_0a89f34f_Tx: ComSignalType=UINT16
            OBJ_DIMENSION_LENGTH_ERR_059_oRDR_TRACKER_OBJ_059_oPCAN_RADAR_3171ec35_Tx: ComSignalType=UINT16
            OBJ_DIMENSION_WIDTH_059_oRDR_TRACKER_OBJ_059_oPCAN_RADAR_294704e2_Tx: ComSignalType=UINT16
            OBJ_DIMENSION_WIDTH_ERR_059_oRDR_TRACKER_OBJ_059_oPCAN_RADAR_c9e5c30a_Tx: ComSignalType=UINT8
            OBJ_EXISTENCE_PROB_059_oRDR_TRACKER_OBJ_059_oPCAN_RADAR_22fb80df_Tx: ComSignalType=UINT16
            OBJ_GROUP_ID_059_oRDR_TRACKER_OBJ_059_oPCAN_RADAR_ab899472_Tx: ComSignalType=UINT8
            OBJ_ID_059_oRDR_TRACKER_OBJ_059_oPCAN_RADAR_58a7bf75_Tx: ComSignalType=UINT8
            OBJ_MEASUREMENT_STATUS_059_oRDR_TRACKER_OBJ_059_oPCAN_RADAR_2775cdc8_Tx: ComSignalType=UINT8
            OBJ_MH_CRC16_059_oRDR_TRACKER_OBJ_059_oPCAN_RADAR_5b157af4_Tx: ComSignalType=UINT16
            OBJ_MH_CYCLE_COUNTER_059_oRDR_TRACKER_OBJ_059_oPCAN_RADAR_2af12015_Tx: ComSignalType=UINT8
            OBJ_MOVEMENT_STATUS_059_oRDR_TRACKER_OBJ_059_oPCAN_RADAR_08db5884_Tx: ComSignalType=UINT8
            OBJ_POS_ERR_CRR_COEF_059_oRDR_TRACKER_OBJ_059_oPCAN_RADAR_98a498be_Tx: ComSignalType=UINT8
            OBJ_POS_LAT_059_oRDR_TRACKER_OBJ_059_oPCAN_RADAR_7a0b65f2_Tx: ComSignalType=UINT16
            OBJ_POS_LAT_ERR_059_oRDR_TRACKER_OBJ_059_oPCAN_RADAR_7e4735c5_Tx: ComSignalType=UINT8
            OBJ_POS_LONG_059_oRDR_TRACKER_OBJ_059_oPCAN_RADAR_cbab8e3d_Tx: ComSignalType=UINT16
            OBJ_POS_LONG_ERR_059_oRDR_TRACKER_OBJ_059_oPCAN_RADAR_e7bfcb27_Tx: ComSignalType=UINT8
            OBJ_RCS_059_oRDR_TRACKER_OBJ_059_oPCAN_RADAR_58c433f5_Tx: ComSignalType=UINT8
            OBJ_REF_PT_LAT_OFFSET_059_oRDR_TRACKER_OBJ_059_oPCAN_RADAR_adf95880_Tx: ComSignalType=UINT16
            OBJ_REF_PT_LONG_OFFSET_059_oRDR_TRACKER_OBJ_059_oPCAN_RADAR_e2aba883_Tx: ComSignalType=UINT16
            OBJ_TIMESTAMP_OFFSET_059_oRDR_TRACKER_OBJ_059_oPCAN_RADAR_586833a3_Tx: ComSignalType=UINT8
            OBJ_TRACK_MOTION_MODEL_059_oRDR_TRACKER_OBJ_059_oPCAN_RADAR_946b327e_Tx: ComSignalType=UINT8
            OBJ_VEH_TRACK_FLAG_059_oRDR_TRACKER_OBJ_059_oPCAN_RADAR_1641c423_Tx: ComSignalType=BOOLEAN
            OBJ_VELOCITY_ERR_CRR_COEF_059_oRDR_TRACKER_OBJ_059_oPCAN_RADAR_31dea55f_Tx: ComSignalType=UINT8
            OBJ_VELOCITY_LAT_059_oRDR_TRACKER_OBJ_059_oPCAN_RADAR_3e6820d5_Tx: ComSignalType=UINT16
            OBJ_VELOCITY_LAT_ERR_059_oRDR_TRACKER_OBJ_059_oPCAN_RADAR_0a925084_Tx: ComSignalType=UINT8
            OBJ_VELOCITY_LONG_059_oRDR_TRACKER_OBJ_059_oPCAN_RADAR_6ee55813_Tx: ComSignalType=UINT16
            OBJ_VELOCITY_LONG_ERR_059_oRDR_TRACKER_OBJ_059_oPCAN_RADAR_e6106f44_Tx: ComSignalType=UINT8
            OBJ_YAW_ANGLE_059_oRDR_TRACKER_OBJ_059_oPCAN_RADAR_d2d46495_Tx: ComSignalType=UINT16
            OBJ_YAW_ANGLE_ERR_059_oRDR_TRACKER_OBJ_059_oPCAN_RADAR_07d96242_Tx: ComSignalType=UINT8
            OBJ_YAW_RATE_059_oRDR_TRACKER_OBJ_059_oPCAN_RADAR_f75b41d2_Tx: ComSignalType=UINT16
            OBJ_YAW_RATE_ERR_059_oRDR_TRACKER_OBJ_059_oPCAN_RADAR_c883d60e_Tx: ComSignalType=UINT8
        SG_TrackerObject060_oRDR_TRACKER_OBJ_060_oPCAN_RADAR_68bfc7eb_Tx
          49 x ComGroupSignal:
            OBJ_ACCELERATION_LAT_060_oRDR_TRACKER_OBJ_060_oPCAN_RADAR_669b9c9c_Tx: ComSignalType=UINT16
            OBJ_ACCELERATION_LAT_ERR_060_oRDR_TRACKER_OBJ_060_oPCAN_RADAR_b36fa622_Tx: ComSignalType=UINT8
            OBJ_ACCELERATION_LONG_060_oRDR_TRACKER_OBJ_060_oPCAN_RADAR_146bc57c_Tx: ComSignalType=UINT16
            OBJ_ACCELERATION_LONG_ERR_060_oRDR_TRACKER_OBJ_060_oPCAN_RADAR_acca0388_Tx: ComSignalType=UINT8
            OBJ_ACCEL_ERR_CRR_COEF_060_oRDR_TRACKER_OBJ_060_oPCAN_RADAR_0c6922ee_Tx: ComSignalType=UINT8
            OBJ_ALIVE_TIME_060_oRDR_TRACKER_OBJ_060_oPCAN_RADAR_740a8ec0_Tx: ComSignalType=UINT16
            OBJ_CLS_TYPE1_060_oRDR_TRACKER_OBJ_060_oPCAN_RADAR_e3d16fe6_Tx: ComSignalType=UINT8
            OBJ_CLS_TYPE1_PROB_060_oRDR_TRACKER_OBJ_060_oPCAN_RADAR_4b89b815_Tx: ComSignalType=UINT8
            OBJ_CLS_TYPE2_060_oRDR_TRACKER_OBJ_060_oPCAN_RADAR_ae396f81_Tx: ComSignalType=UINT8
            OBJ_CLS_TYPE2_PROB_060_oRDR_TRACKER_OBJ_060_oPCAN_RADAR_82bda318_Tx: ComSignalType=UINT8
            OBJ_CLS_TYPE3_060_oRDR_TRACKER_OBJ_060_oPCAN_RADAR_23b19263_Tx: ComSignalType=UINT8
            OBJ_CLS_TYPE3_PROB_060_oRDR_TRACKER_OBJ_060_oPCAN_RADAR_c5ae55e3_Tx: ComSignalType=UINT8
            OBJ_CLS_TYPE4_060_oRDR_TRACKER_OBJ_060_oPCAN_RADAR_35e96f4f_Tx: ComSignalType=UINT8
            OBJ_CLS_TYPE4_PROB_060_oRDR_TRACKER_OBJ_060_oPCAN_RADAR_cba49343_Tx: ComSignalType=UINT8
            OBJ_CLS_TYPE5_060_oRDR_TRACKER_OBJ_060_oPCAN_RADAR_b86192ad_Tx: ComSignalType=UINT8
            OBJ_CLS_TYPE5_PROB_060_oRDR_TRACKER_OBJ_060_oPCAN_RADAR_8cb765b8_Tx: ComSignalType=UINT8
            OBJ_CLS_TYPE6_060_oRDR_TRACKER_OBJ_060_oPCAN_RADAR_f58992ca_Tx: ComSignalType=UINT8
            OBJ_CLS_TYPE6_PROB_060_oRDR_TRACKER_OBJ_060_oPCAN_RADAR_45837eb5_Tx: ComSignalType=UINT8
            OBJ_DIMENSION_LENGTH_060_oRDR_TRACKER_OBJ_060_oPCAN_RADAR_a14f3ca2_Tx: ComSignalType=UINT16
            OBJ_DIMENSION_LENGTH_ERR_060_oRDR_TRACKER_OBJ_060_oPCAN_RADAR_9ab723d8_Tx: ComSignalType=UINT16
            OBJ_DIMENSION_WIDTH_060_oRDR_TRACKER_OBJ_060_oPCAN_RADAR_8281cb0f_Tx: ComSignalType=UINT16
            OBJ_DIMENSION_WIDTH_ERR_060_oRDR_TRACKER_OBJ_060_oPCAN_RADAR_62230ce7_Tx: ComSignalType=UINT8
            OBJ_EXISTENCE_PROB_060_oRDR_TRACKER_OBJ_060_oPCAN_RADAR_893d4f32_Tx: ComSignalType=UINT16
            OBJ_GROUP_ID_060_oRDR_TRACKER_OBJ_060_oPCAN_RADAR_004f5b9f_Tx: ComSignalType=UINT8
            OBJ_ID_060_oRDR_TRACKER_OBJ_060_oPCAN_RADAR_f3617098_Tx: ComSignalType=UINT8
            OBJ_MEASUREMENT_STATUS_060_oRDR_TRACKER_OBJ_060_oPCAN_RADAR_8cb30225_Tx: ComSignalType=UINT8
            OBJ_MH_CRC16_060_oRDR_TRACKER_OBJ_060_oPCAN_RADAR_f0d3b519_Tx: ComSignalType=UINT16
            OBJ_MH_CYCLE_COUNTER_060_oRDR_TRACKER_OBJ_060_oPCAN_RADAR_8137eff8_Tx: ComSignalType=UINT8
            OBJ_MOVEMENT_STATUS_060_oRDR_TRACKER_OBJ_060_oPCAN_RADAR_a31d9769_Tx: ComSignalType=UINT8
            OBJ_POS_ERR_CRR_COEF_060_oRDR_TRACKER_OBJ_060_oPCAN_RADAR_33625753_Tx: ComSignalType=UINT8
            OBJ_POS_LAT_060_oRDR_TRACKER_OBJ_060_oPCAN_RADAR_d1cdaa1f_Tx: ComSignalType=UINT16
            OBJ_POS_LAT_ERR_060_oRDR_TRACKER_OBJ_060_oPCAN_RADAR_d581fa28_Tx: ComSignalType=UINT8
            OBJ_POS_LONG_060_oRDR_TRACKER_OBJ_060_oPCAN_RADAR_606d41d0_Tx: ComSignalType=UINT16
            OBJ_POS_LONG_ERR_060_oRDR_TRACKER_OBJ_060_oPCAN_RADAR_4c7904ca_Tx: ComSignalType=UINT8
            OBJ_RCS_060_oRDR_TRACKER_OBJ_060_oPCAN_RADAR_f302fc18_Tx: ComSignalType=UINT8
            OBJ_REF_PT_LAT_OFFSET_060_oRDR_TRACKER_OBJ_060_oPCAN_RADAR_063f976d_Tx: ComSignalType=UINT16
            OBJ_REF_PT_LONG_OFFSET_060_oRDR_TRACKER_OBJ_060_oPCAN_RADAR_496d676e_Tx: ComSignalType=UINT16
            OBJ_TIMESTAMP_OFFSET_060_oRDR_TRACKER_OBJ_060_oPCAN_RADAR_f3aefc4e_Tx: ComSignalType=UINT8
            OBJ_TRACK_MOTION_MODEL_060_oRDR_TRACKER_OBJ_060_oPCAN_RADAR_3fadfd93_Tx: ComSignalType=UINT8
            OBJ_VEH_TRACK_FLAG_060_oRDR_TRACKER_OBJ_060_oPCAN_RADAR_bd870bce_Tx: ComSignalType=BOOLEAN
            OBJ_VELOCITY_ERR_CRR_COEF_060_oRDR_TRACKER_OBJ_060_oPCAN_RADAR_9a186ab2_Tx: ComSignalType=UINT8
            OBJ_VELOCITY_LAT_060_oRDR_TRACKER_OBJ_060_oPCAN_RADAR_95aeef38_Tx: ComSignalType=UINT16
            OBJ_VELOCITY_LAT_ERR_060_oRDR_TRACKER_OBJ_060_oPCAN_RADAR_a1549f69_Tx: ComSignalType=UINT8
            OBJ_VELOCITY_LONG_060_oRDR_TRACKER_OBJ_060_oPCAN_RADAR_c52397fe_Tx: ComSignalType=UINT16
            OBJ_VELOCITY_LONG_ERR_060_oRDR_TRACKER_OBJ_060_oPCAN_RADAR_4dd6a0a9_Tx: ComSignalType=UINT8
            OBJ_YAW_ANGLE_060_oRDR_TRACKER_OBJ_060_oPCAN_RADAR_7912ab78_Tx: ComSignalType=UINT16
            OBJ_YAW_ANGLE_ERR_060_oRDR_TRACKER_OBJ_060_oPCAN_RADAR_ac1fadaf_Tx: ComSignalType=UINT8
            OBJ_YAW_RATE_060_oRDR_TRACKER_OBJ_060_oPCAN_RADAR_5c9d8e3f_Tx: ComSignalType=UINT16
            OBJ_YAW_RATE_ERR_060_oRDR_TRACKER_OBJ_060_oPCAN_RADAR_634519e3_Tx: ComSignalType=UINT8
        SG_TrackerObject061_oRDR_TRACKER_OBJ_061_oPCAN_RADAR_91ab4f58_Tx
          49 x ComGroupSignal:
            OBJ_ACCELERATION_LAT_061_oRDR_TRACKER_OBJ_061_oPCAN_RADAR_9f8f142f_Tx: ComSignalType=UINT16
            OBJ_ACCELERATION_LAT_ERR_061_oRDR_TRACKER_OBJ_061_oPCAN_RADAR_4a7b2e91_Tx: ComSignalType=UINT8
            OBJ_ACCELERATION_LONG_061_oRDR_TRACKER_OBJ_061_oPCAN_RADAR_ed7f4dcf_Tx: ComSignalType=UINT16
            OBJ_ACCELERATION_LONG_ERR_061_oRDR_TRACKER_OBJ_061_oPCAN_RADAR_55de8b3b_Tx: ComSignalType=UINT8
            OBJ_ACCEL_ERR_CRR_COEF_061_oRDR_TRACKER_OBJ_061_oPCAN_RADAR_f57daa5d_Tx: ComSignalType=UINT8
            OBJ_ALIVE_TIME_061_oRDR_TRACKER_OBJ_061_oPCAN_RADAR_8d1e0673_Tx: ComSignalType=UINT16
            OBJ_CLS_TYPE1_061_oRDR_TRACKER_OBJ_061_oPCAN_RADAR_1ac5e755_Tx: ComSignalType=UINT8
            OBJ_CLS_TYPE1_PROB_061_oRDR_TRACKER_OBJ_061_oPCAN_RADAR_b29d30a6_Tx: ComSignalType=UINT8
            OBJ_CLS_TYPE2_061_oRDR_TRACKER_OBJ_061_oPCAN_RADAR_572de732_Tx: ComSignalType=UINT8
            OBJ_CLS_TYPE2_PROB_061_oRDR_TRACKER_OBJ_061_oPCAN_RADAR_7ba92bab_Tx: ComSignalType=UINT8
            OBJ_CLS_TYPE3_061_oRDR_TRACKER_OBJ_061_oPCAN_RADAR_daa51ad0_Tx: ComSignalType=UINT8
            OBJ_CLS_TYPE3_PROB_061_oRDR_TRACKER_OBJ_061_oPCAN_RADAR_3cbadd50_Tx: ComSignalType=UINT8
            OBJ_CLS_TYPE4_061_oRDR_TRACKER_OBJ_061_oPCAN_RADAR_ccfde7fc_Tx: ComSignalType=UINT8
            OBJ_CLS_TYPE4_PROB_061_oRDR_TRACKER_OBJ_061_oPCAN_RADAR_32b01bf0_Tx: ComSignalType=UINT8
            OBJ_CLS_TYPE5_061_oRDR_TRACKER_OBJ_061_oPCAN_RADAR_41751a1e_Tx: ComSignalType=UINT8
            OBJ_CLS_TYPE5_PROB_061_oRDR_TRACKER_OBJ_061_oPCAN_RADAR_75a3ed0b_Tx: ComSignalType=UINT8
            OBJ_CLS_TYPE6_061_oRDR_TRACKER_OBJ_061_oPCAN_RADAR_0c9d1a79_Tx: ComSignalType=UINT8
            OBJ_CLS_TYPE6_PROB_061_oRDR_TRACKER_OBJ_061_oPCAN_RADAR_bc97f606_Tx: ComSignalType=UINT8
            OBJ_DIMENSION_LENGTH_061_oRDR_TRACKER_OBJ_061_oPCAN_RADAR_585bb411_Tx: ComSignalType=UINT16
            OBJ_DIMENSION_LENGTH_ERR_061_oRDR_TRACKER_OBJ_061_oPCAN_RADAR_63a3ab6b_Tx: ComSignalType=UINT16
            OBJ_DIMENSION_WIDTH_061_oRDR_TRACKER_OBJ_061_oPCAN_RADAR_7b9543bc_Tx: ComSignalType=UINT16
            OBJ_DIMENSION_WIDTH_ERR_061_oRDR_TRACKER_OBJ_061_oPCAN_RADAR_9b378454_Tx: ComSignalType=UINT8
            OBJ_EXISTENCE_PROB_061_oRDR_TRACKER_OBJ_061_oPCAN_RADAR_7029c781_Tx: ComSignalType=UINT16
            OBJ_GROUP_ID_061_oRDR_TRACKER_OBJ_061_oPCAN_RADAR_f95bd32c_Tx: ComSignalType=UINT8
            OBJ_ID_061_oRDR_TRACKER_OBJ_061_oPCAN_RADAR_0a75f82b_Tx: ComSignalType=UINT8
            OBJ_MEASUREMENT_STATUS_061_oRDR_TRACKER_OBJ_061_oPCAN_RADAR_75a78a96_Tx: ComSignalType=UINT8
            OBJ_MH_CRC16_061_oRDR_TRACKER_OBJ_061_oPCAN_RADAR_09c73daa_Tx: ComSignalType=UINT16
            OBJ_MH_CYCLE_COUNTER_061_oRDR_TRACKER_OBJ_061_oPCAN_RADAR_7823674b_Tx: ComSignalType=UINT8
            OBJ_MOVEMENT_STATUS_061_oRDR_TRACKER_OBJ_061_oPCAN_RADAR_5a091fda_Tx: ComSignalType=UINT8
            OBJ_POS_ERR_CRR_COEF_061_oRDR_TRACKER_OBJ_061_oPCAN_RADAR_ca76dfe0_Tx: ComSignalType=UINT8
            OBJ_POS_LAT_061_oRDR_TRACKER_OBJ_061_oPCAN_RADAR_28d922ac_Tx: ComSignalType=UINT16
            OBJ_POS_LAT_ERR_061_oRDR_TRACKER_OBJ_061_oPCAN_RADAR_2c95729b_Tx: ComSignalType=UINT8
            OBJ_POS_LONG_061_oRDR_TRACKER_OBJ_061_oPCAN_RADAR_9979c963_Tx: ComSignalType=UINT16
            OBJ_POS_LONG_ERR_061_oRDR_TRACKER_OBJ_061_oPCAN_RADAR_b56d8c79_Tx: ComSignalType=UINT8
            OBJ_RCS_061_oRDR_TRACKER_OBJ_061_oPCAN_RADAR_0a1674ab_Tx: ComSignalType=UINT8
            OBJ_REF_PT_LAT_OFFSET_061_oRDR_TRACKER_OBJ_061_oPCAN_RADAR_ff2b1fde_Tx: ComSignalType=UINT16
            OBJ_REF_PT_LONG_OFFSET_061_oRDR_TRACKER_OBJ_061_oPCAN_RADAR_b079efdd_Tx: ComSignalType=UINT16
            OBJ_TIMESTAMP_OFFSET_061_oRDR_TRACKER_OBJ_061_oPCAN_RADAR_0aba74fd_Tx: ComSignalType=UINT8
            OBJ_TRACK_MOTION_MODEL_061_oRDR_TRACKER_OBJ_061_oPCAN_RADAR_c6b97520_Tx: ComSignalType=UINT8
            OBJ_VEH_TRACK_FLAG_061_oRDR_TRACKER_OBJ_061_oPCAN_RADAR_4493837d_Tx: ComSignalType=BOOLEAN
            OBJ_VELOCITY_ERR_CRR_COEF_061_oRDR_TRACKER_OBJ_061_oPCAN_RADAR_630ce201_Tx: ComSignalType=UINT8
            OBJ_VELOCITY_LAT_061_oRDR_TRACKER_OBJ_061_oPCAN_RADAR_6cba678b_Tx: ComSignalType=UINT16
            OBJ_VELOCITY_LAT_ERR_061_oRDR_TRACKER_OBJ_061_oPCAN_RADAR_584017da_Tx: ComSignalType=UINT8
            OBJ_VELOCITY_LONG_061_oRDR_TRACKER_OBJ_061_oPCAN_RADAR_3c371f4d_Tx: ComSignalType=UINT16
            OBJ_VELOCITY_LONG_ERR_061_oRDR_TRACKER_OBJ_061_oPCAN_RADAR_b4c2281a_Tx: ComSignalType=UINT8
            OBJ_YAW_ANGLE_061_oRDR_TRACKER_OBJ_061_oPCAN_RADAR_800623cb_Tx: ComSignalType=UINT16
            OBJ_YAW_ANGLE_ERR_061_oRDR_TRACKER_OBJ_061_oPCAN_RADAR_550b251c_Tx: ComSignalType=UINT8
            OBJ_YAW_RATE_061_oRDR_TRACKER_OBJ_061_oPCAN_RADAR_a589068c_Tx: ComSignalType=UINT16
            OBJ_YAW_RATE_ERR_061_oRDR_TRACKER_OBJ_061_oPCAN_RADAR_9a519150_Tx: ComSignalType=UINT8
        SG_TrackerObject062_oRDR_TRACKER_OBJ_062_oPCAN_RADAR_41e7d0cc_Tx
          49 x ComGroupSignal:
            OBJ_ACCELERATION_LAT_062_oRDR_TRACKER_OBJ_062_oPCAN_RADAR_4fc38bbb_Tx: ComSignalType=UINT16
            OBJ_ACCELERATION_LAT_ERR_062_oRDR_TRACKER_OBJ_062_oPCAN_RADAR_9a37b105_Tx: ComSignalType=UINT8
            OBJ_ACCELERATION_LONG_062_oRDR_TRACKER_OBJ_062_oPCAN_RADAR_3d33d25b_Tx: ComSignalType=UINT16
            OBJ_ACCELERATION_LONG_ERR_062_oRDR_TRACKER_OBJ_062_oPCAN_RADAR_859214af_Tx: ComSignalType=UINT8
            OBJ_ACCEL_ERR_CRR_COEF_062_oRDR_TRACKER_OBJ_062_oPCAN_RADAR_253135c9_Tx: ComSignalType=UINT8
            OBJ_ALIVE_TIME_062_oRDR_TRACKER_OBJ_062_oPCAN_RADAR_5d5299e7_Tx: ComSignalType=UINT16
            OBJ_CLS_TYPE1_062_oRDR_TRACKER_OBJ_062_oPCAN_RADAR_ca8978c1_Tx: ComSignalType=UINT8
            OBJ_CLS_TYPE1_PROB_062_oRDR_TRACKER_OBJ_062_oPCAN_RADAR_62d1af32_Tx: ComSignalType=UINT8
            OBJ_CLS_TYPE2_062_oRDR_TRACKER_OBJ_062_oPCAN_RADAR_876178a6_Tx: ComSignalType=UINT8
            OBJ_CLS_TYPE2_PROB_062_oRDR_TRACKER_OBJ_062_oPCAN_RADAR_abe5b43f_Tx: ComSignalType=UINT8
            OBJ_CLS_TYPE3_062_oRDR_TRACKER_OBJ_062_oPCAN_RADAR_0ae98544_Tx: ComSignalType=UINT8
            OBJ_CLS_TYPE3_PROB_062_oRDR_TRACKER_OBJ_062_oPCAN_RADAR_ecf642c4_Tx: ComSignalType=UINT8
            OBJ_CLS_TYPE4_062_oRDR_TRACKER_OBJ_062_oPCAN_RADAR_1cb17868_Tx: ComSignalType=UINT8
            OBJ_CLS_TYPE4_PROB_062_oRDR_TRACKER_OBJ_062_oPCAN_RADAR_e2fc8464_Tx: ComSignalType=UINT8
            OBJ_CLS_TYPE5_062_oRDR_TRACKER_OBJ_062_oPCAN_RADAR_9139858a_Tx: ComSignalType=UINT8
            OBJ_CLS_TYPE5_PROB_062_oRDR_TRACKER_OBJ_062_oPCAN_RADAR_a5ef729f_Tx: ComSignalType=UINT8
            OBJ_CLS_TYPE6_062_oRDR_TRACKER_OBJ_062_oPCAN_RADAR_dcd185ed_Tx: ComSignalType=UINT8
            OBJ_CLS_TYPE6_PROB_062_oRDR_TRACKER_OBJ_062_oPCAN_RADAR_6cdb6992_Tx: ComSignalType=UINT8
            OBJ_DIMENSION_LENGTH_062_oRDR_TRACKER_OBJ_062_oPCAN_RADAR_88172b85_Tx: ComSignalType=UINT16
            OBJ_DIMENSION_LENGTH_ERR_062_oRDR_TRACKER_OBJ_062_oPCAN_RADAR_b3ef34ff_Tx: ComSignalType=UINT16
            OBJ_DIMENSION_WIDTH_062_oRDR_TRACKER_OBJ_062_oPCAN_RADAR_abd9dc28_Tx: ComSignalType=UINT16
            OBJ_DIMENSION_WIDTH_ERR_062_oRDR_TRACKER_OBJ_062_oPCAN_RADAR_4b7b1bc0_Tx: ComSignalType=UINT8
            OBJ_EXISTENCE_PROB_062_oRDR_TRACKER_OBJ_062_oPCAN_RADAR_a0655815_Tx: ComSignalType=UINT16
            OBJ_GROUP_ID_062_oRDR_TRACKER_OBJ_062_oPCAN_RADAR_29174cb8_Tx: ComSignalType=UINT8
            OBJ_ID_062_oRDR_TRACKER_OBJ_062_oPCAN_RADAR_da3967bf_Tx: ComSignalType=UINT8
            OBJ_MEASUREMENT_STATUS_062_oRDR_TRACKER_OBJ_062_oPCAN_RADAR_a5eb1502_Tx: ComSignalType=UINT8
            OBJ_MH_CRC16_062_oRDR_TRACKER_OBJ_062_oPCAN_RADAR_d98ba23e_Tx: ComSignalType=UINT16
            OBJ_MH_CYCLE_COUNTER_062_oRDR_TRACKER_OBJ_062_oPCAN_RADAR_a86ff8df_Tx: ComSignalType=UINT8
            OBJ_MOVEMENT_STATUS_062_oRDR_TRACKER_OBJ_062_oPCAN_RADAR_8a45804e_Tx: ComSignalType=UINT8
            OBJ_POS_ERR_CRR_COEF_062_oRDR_TRACKER_OBJ_062_oPCAN_RADAR_1a3a4074_Tx: ComSignalType=UINT8
            OBJ_POS_LAT_062_oRDR_TRACKER_OBJ_062_oPCAN_RADAR_f895bd38_Tx: ComSignalType=UINT16
            OBJ_POS_LAT_ERR_062_oRDR_TRACKER_OBJ_062_oPCAN_RADAR_fcd9ed0f_Tx: ComSignalType=UINT8
            OBJ_POS_LONG_062_oRDR_TRACKER_OBJ_062_oPCAN_RADAR_493556f7_Tx: ComSignalType=UINT16
            OBJ_POS_LONG_ERR_062_oRDR_TRACKER_OBJ_062_oPCAN_RADAR_652113ed_Tx: ComSignalType=UINT8
            OBJ_RCS_062_oRDR_TRACKER_OBJ_062_oPCAN_RADAR_da5aeb3f_Tx: ComSignalType=UINT8
            OBJ_REF_PT_LAT_OFFSET_062_oRDR_TRACKER_OBJ_062_oPCAN_RADAR_2f67804a_Tx: ComSignalType=UINT16
            OBJ_REF_PT_LONG_OFFSET_062_oRDR_TRACKER_OBJ_062_oPCAN_RADAR_60357049_Tx: ComSignalType=UINT16
            OBJ_TIMESTAMP_OFFSET_062_oRDR_TRACKER_OBJ_062_oPCAN_RADAR_daf6eb69_Tx: ComSignalType=UINT8
            OBJ_TRACK_MOTION_MODEL_062_oRDR_TRACKER_OBJ_062_oPCAN_RADAR_16f5eab4_Tx: ComSignalType=UINT8
            OBJ_VEH_TRACK_FLAG_062_oRDR_TRACKER_OBJ_062_oPCAN_RADAR_94df1ce9_Tx: ComSignalType=BOOLEAN
            OBJ_VELOCITY_ERR_CRR_COEF_062_oRDR_TRACKER_OBJ_062_oPCAN_RADAR_b3407d95_Tx: ComSignalType=UINT8
            OBJ_VELOCITY_LAT_062_oRDR_TRACKER_OBJ_062_oPCAN_RADAR_bcf6f81f_Tx: ComSignalType=UINT16
            OBJ_VELOCITY_LAT_ERR_062_oRDR_TRACKER_OBJ_062_oPCAN_RADAR_880c884e_Tx: ComSignalType=UINT8
            OBJ_VELOCITY_LONG_062_oRDR_TRACKER_OBJ_062_oPCAN_RADAR_ec7b80d9_Tx: ComSignalType=UINT16
            OBJ_VELOCITY_LONG_ERR_062_oRDR_TRACKER_OBJ_062_oPCAN_RADAR_648eb78e_Tx: ComSignalType=UINT8
            OBJ_YAW_ANGLE_062_oRDR_TRACKER_OBJ_062_oPCAN_RADAR_504abc5f_Tx: ComSignalType=UINT16
            OBJ_YAW_ANGLE_ERR_062_oRDR_TRACKER_OBJ_062_oPCAN_RADAR_8547ba88_Tx: ComSignalType=UINT8
            OBJ_YAW_RATE_062_oRDR_TRACKER_OBJ_062_oPCAN_RADAR_75c59918_Tx: ComSignalType=UINT16
            OBJ_YAW_RATE_ERR_062_oRDR_TRACKER_OBJ_062_oPCAN_RADAR_4a1d0ec4_Tx: ComSignalType=UINT8
        SG_TrackerObject063_oRDR_TRACKER_OBJ_063_oPCAN_RADAR_b8f3587f_Tx
          49 x ComGroupSignal:
            OBJ_ACCELERATION_LAT_063_oRDR_TRACKER_OBJ_063_oPCAN_RADAR_b6d70308_Tx: ComSignalType=UINT16
            OBJ_ACCELERATION_LAT_ERR_063_oRDR_TRACKER_OBJ_063_oPCAN_RADAR_632339b6_Tx: ComSignalType=UINT8
            OBJ_ACCELERATION_LONG_063_oRDR_TRACKER_OBJ_063_oPCAN_RADAR_c4275ae8_Tx: ComSignalType=UINT16
            OBJ_ACCELERATION_LONG_ERR_063_oRDR_TRACKER_OBJ_063_oPCAN_RADAR_7c869c1c_Tx: ComSignalType=UINT8
            OBJ_ACCEL_ERR_CRR_COEF_063_oRDR_TRACKER_OBJ_063_oPCAN_RADAR_dc25bd7a_Tx: ComSignalType=UINT8
            OBJ_ALIVE_TIME_063_oRDR_TRACKER_OBJ_063_oPCAN_RADAR_a4461154_Tx: ComSignalType=UINT16
            OBJ_CLS_TYPE1_063_oRDR_TRACKER_OBJ_063_oPCAN_RADAR_339df072_Tx: ComSignalType=UINT8
            OBJ_CLS_TYPE1_PROB_063_oRDR_TRACKER_OBJ_063_oPCAN_RADAR_9bc52781_Tx: ComSignalType=UINT8
            OBJ_CLS_TYPE2_063_oRDR_TRACKER_OBJ_063_oPCAN_RADAR_7e75f015_Tx: ComSignalType=UINT8
            OBJ_CLS_TYPE2_PROB_063_oRDR_TRACKER_OBJ_063_oPCAN_RADAR_52f13c8c_Tx: ComSignalType=UINT8
            OBJ_CLS_TYPE3_063_oRDR_TRACKER_OBJ_063_oPCAN_RADAR_f3fd0df7_Tx: ComSignalType=UINT8
            OBJ_CLS_TYPE3_PROB_063_oRDR_TRACKER_OBJ_063_oPCAN_RADAR_15e2ca77_Tx: ComSignalType=UINT8
            OBJ_CLS_TYPE4_063_oRDR_TRACKER_OBJ_063_oPCAN_RADAR_e5a5f0db_Tx: ComSignalType=UINT8
            OBJ_CLS_TYPE4_PROB_063_oRDR_TRACKER_OBJ_063_oPCAN_RADAR_1be80cd7_Tx: ComSignalType=UINT8
            OBJ_CLS_TYPE5_063_oRDR_TRACKER_OBJ_063_oPCAN_RADAR_682d0d39_Tx: ComSignalType=UINT8
            OBJ_CLS_TYPE5_PROB_063_oRDR_TRACKER_OBJ_063_oPCAN_RADAR_5cfbfa2c_Tx: ComSignalType=UINT8
            OBJ_CLS_TYPE6_063_oRDR_TRACKER_OBJ_063_oPCAN_RADAR_25c50d5e_Tx: ComSignalType=UINT8
            OBJ_CLS_TYPE6_PROB_063_oRDR_TRACKER_OBJ_063_oPCAN_RADAR_95cfe121_Tx: ComSignalType=UINT8
            OBJ_DIMENSION_LENGTH_063_oRDR_TRACKER_OBJ_063_oPCAN_RADAR_7103a336_Tx: ComSignalType=UINT16
            OBJ_DIMENSION_LENGTH_ERR_063_oRDR_TRACKER_OBJ_063_oPCAN_RADAR_4afbbc4c_Tx: ComSignalType=UINT16
            OBJ_DIMENSION_WIDTH_063_oRDR_TRACKER_OBJ_063_oPCAN_RADAR_52cd549b_Tx: ComSignalType=UINT16
            OBJ_DIMENSION_WIDTH_ERR_063_oRDR_TRACKER_OBJ_063_oPCAN_RADAR_b26f9373_Tx: ComSignalType=UINT8
            OBJ_EXISTENCE_PROB_063_oRDR_TRACKER_OBJ_063_oPCAN_RADAR_5971d0a6_Tx: ComSignalType=UINT16
            OBJ_GROUP_ID_063_oRDR_TRACKER_OBJ_063_oPCAN_RADAR_d003c40b_Tx: ComSignalType=UINT8
            OBJ_ID_063_oRDR_TRACKER_OBJ_063_oPCAN_RADAR_232def0c_Tx: ComSignalType=UINT8
            OBJ_MEASUREMENT_STATUS_063_oRDR_TRACKER_OBJ_063_oPCAN_RADAR_5cff9db1_Tx: ComSignalType=UINT8
            OBJ_MH_CRC16_063_oRDR_TRACKER_OBJ_063_oPCAN_RADAR_209f2a8d_Tx: ComSignalType=UINT16
            OBJ_MH_CYCLE_COUNTER_063_oRDR_TRACKER_OBJ_063_oPCAN_RADAR_517b706c_Tx: ComSignalType=UINT8
            OBJ_MOVEMENT_STATUS_063_oRDR_TRACKER_OBJ_063_oPCAN_RADAR_735108fd_Tx: ComSignalType=UINT8
            OBJ_POS_ERR_CRR_COEF_063_oRDR_TRACKER_OBJ_063_oPCAN_RADAR_e32ec8c7_Tx: ComSignalType=UINT8
            OBJ_POS_LAT_063_oRDR_TRACKER_OBJ_063_oPCAN_RADAR_0181358b_Tx: ComSignalType=UINT16
            OBJ_POS_LAT_ERR_063_oRDR_TRACKER_OBJ_063_oPCAN_RADAR_05cd65bc_Tx: ComSignalType=UINT8
            OBJ_POS_LONG_063_oRDR_TRACKER_OBJ_063_oPCAN_RADAR_b021de44_Tx: ComSignalType=UINT16
            OBJ_POS_LONG_ERR_063_oRDR_TRACKER_OBJ_063_oPCAN_RADAR_9c359b5e_Tx: ComSignalType=UINT8
            OBJ_RCS_063_oRDR_TRACKER_OBJ_063_oPCAN_RADAR_234e638c_Tx: ComSignalType=UINT8
            OBJ_REF_PT_LAT_OFFSET_063_oRDR_TRACKER_OBJ_063_oPCAN_RADAR_d67308f9_Tx: ComSignalType=UINT16
            OBJ_REF_PT_LONG_OFFSET_063_oRDR_TRACKER_OBJ_063_oPCAN_RADAR_9921f8fa_Tx: ComSignalType=UINT16
            OBJ_TIMESTAMP_OFFSET_063_oRDR_TRACKER_OBJ_063_oPCAN_RADAR_23e263da_Tx: ComSignalType=UINT8
            OBJ_TRACK_MOTION_MODEL_063_oRDR_TRACKER_OBJ_063_oPCAN_RADAR_efe16207_Tx: ComSignalType=UINT8
            OBJ_VEH_TRACK_FLAG_063_oRDR_TRACKER_OBJ_063_oPCAN_RADAR_6dcb945a_Tx: ComSignalType=BOOLEAN
            OBJ_VELOCITY_ERR_CRR_COEF_063_oRDR_TRACKER_OBJ_063_oPCAN_RADAR_4a54f526_Tx: ComSignalType=UINT8
            OBJ_VELOCITY_LAT_063_oRDR_TRACKER_OBJ_063_oPCAN_RADAR_45e270ac_Tx: ComSignalType=UINT16
            OBJ_VELOCITY_LAT_ERR_063_oRDR_TRACKER_OBJ_063_oPCAN_RADAR_711800fd_Tx: ComSignalType=UINT8
            OBJ_VELOCITY_LONG_063_oRDR_TRACKER_OBJ_063_oPCAN_RADAR_156f086a_Tx: ComSignalType=UINT16
            OBJ_VELOCITY_LONG_ERR_063_oRDR_TRACKER_OBJ_063_oPCAN_RADAR_9d9a3f3d_Tx: ComSignalType=UINT8
            OBJ_YAW_ANGLE_063_oRDR_TRACKER_OBJ_063_oPCAN_RADAR_a95e34ec_Tx: ComSignalType=UINT16
            OBJ_YAW_ANGLE_ERR_063_oRDR_TRACKER_OBJ_063_oPCAN_RADAR_7c53323b_Tx: ComSignalType=UINT8
            OBJ_YAW_RATE_063_oRDR_TRACKER_OBJ_063_oPCAN_RADAR_8cd111ab_Tx: ComSignalType=UINT16
            OBJ_YAW_RATE_ERR_063_oRDR_TRACKER_OBJ_063_oPCAN_RADAR_b3098677_Tx: ComSignalType=UINT8
        SG_TrackerObject064_oRDR_TRACKER_OBJ_064_oPCAN_RADAR_3a0fe9a5_Tx
          49 x ComGroupSignal:
            OBJ_ACCELERATION_LAT_064_oRDR_TRACKER_OBJ_064_oPCAN_RADAR_342bb2d2_Tx: ComSignalType=UINT16
            OBJ_ACCELERATION_LAT_ERR_064_oRDR_TRACKER_OBJ_064_oPCAN_RADAR_e1df886c_Tx: ComSignalType=UINT8
            OBJ_ACCELERATION_LONG_064_oRDR_TRACKER_OBJ_064_oPCAN_RADAR_46dbeb32_Tx: ComSignalType=UINT16
            OBJ_ACCELERATION_LONG_ERR_064_oRDR_TRACKER_OBJ_064_oPCAN_RADAR_fe7a2dc6_Tx: ComSignalType=UINT8
            OBJ_ACCEL_ERR_CRR_COEF_064_oRDR_TRACKER_OBJ_064_oPCAN_RADAR_5ed90ca0_Tx: ComSignalType=UINT8
            OBJ_ALIVE_TIME_064_oRDR_TRACKER_OBJ_064_oPCAN_RADAR_26baa08e_Tx: ComSignalType=UINT16
            OBJ_CLS_TYPE1_064_oRDR_TRACKER_OBJ_064_oPCAN_RADAR_b16141a8_Tx: ComSignalType=UINT8
            OBJ_CLS_TYPE1_PROB_064_oRDR_TRACKER_OBJ_064_oPCAN_RADAR_1939965b_Tx: ComSignalType=UINT8
            OBJ_CLS_TYPE2_064_oRDR_TRACKER_OBJ_064_oPCAN_RADAR_fc8941cf_Tx: ComSignalType=UINT8
            OBJ_CLS_TYPE2_PROB_064_oRDR_TRACKER_OBJ_064_oPCAN_RADAR_d00d8d56_Tx: ComSignalType=UINT8
            OBJ_CLS_TYPE3_064_oRDR_TRACKER_OBJ_064_oPCAN_RADAR_7101bc2d_Tx: ComSignalType=UINT8
            OBJ_CLS_TYPE3_PROB_064_oRDR_TRACKER_OBJ_064_oPCAN_RADAR_971e7bad_Tx: ComSignalType=UINT8
            OBJ_CLS_TYPE4_064_oRDR_TRACKER_OBJ_064_oPCAN_RADAR_67594101_Tx: ComSignalType=UINT8
            OBJ_CLS_TYPE4_PROB_064_oRDR_TRACKER_OBJ_064_oPCAN_RADAR_9914bd0d_Tx: ComSignalType=UINT8
            OBJ_CLS_TYPE5_064_oRDR_TRACKER_OBJ_064_oPCAN_RADAR_ead1bce3_Tx: ComSignalType=UINT8
            OBJ_CLS_TYPE5_PROB_064_oRDR_TRACKER_OBJ_064_oPCAN_RADAR_de074bf6_Tx: ComSignalType=UINT8
            OBJ_CLS_TYPE6_064_oRDR_TRACKER_OBJ_064_oPCAN_RADAR_a739bc84_Tx: ComSignalType=UINT8
            OBJ_CLS_TYPE6_PROB_064_oRDR_TRACKER_OBJ_064_oPCAN_RADAR_173350fb_Tx: ComSignalType=UINT8
            OBJ_DIMENSION_LENGTH_064_oRDR_TRACKER_OBJ_064_oPCAN_RADAR_f3ff12ec_Tx: ComSignalType=UINT16
            OBJ_DIMENSION_LENGTH_ERR_064_oRDR_TRACKER_OBJ_064_oPCAN_RADAR_c8070d96_Tx: ComSignalType=UINT16
            OBJ_DIMENSION_WIDTH_064_oRDR_TRACKER_OBJ_064_oPCAN_RADAR_d031e541_Tx: ComSignalType=UINT16
            OBJ_DIMENSION_WIDTH_ERR_064_oRDR_TRACKER_OBJ_064_oPCAN_RADAR_309322a9_Tx: ComSignalType=UINT8
            OBJ_EXISTENCE_PROB_064_oRDR_TRACKER_OBJ_064_oPCAN_RADAR_db8d617c_Tx: ComSignalType=UINT16
            OBJ_GROUP_ID_064_oRDR_TRACKER_OBJ_064_oPCAN_RADAR_52ff75d1_Tx: ComSignalType=UINT8
            OBJ_ID_064_oRDR_TRACKER_OBJ_064_oPCAN_RADAR_a1d15ed6_Tx: ComSignalType=UINT8
            OBJ_MEASUREMENT_STATUS_064_oRDR_TRACKER_OBJ_064_oPCAN_RADAR_de032c6b_Tx: ComSignalType=UINT8
            OBJ_MH_CRC16_064_oRDR_TRACKER_OBJ_064_oPCAN_RADAR_a2639b57_Tx: ComSignalType=UINT16
            OBJ_MH_CYCLE_COUNTER_064_oRDR_TRACKER_OBJ_064_oPCAN_RADAR_d387c1b6_Tx: ComSignalType=UINT8
            OBJ_MOVEMENT_STATUS_064_oRDR_TRACKER_OBJ_064_oPCAN_RADAR_f1adb927_Tx: ComSignalType=UINT8
            OBJ_POS_ERR_CRR_COEF_064_oRDR_TRACKER_OBJ_064_oPCAN_RADAR_61d2791d_Tx: ComSignalType=UINT8
            OBJ_POS_LAT_064_oRDR_TRACKER_OBJ_064_oPCAN_RADAR_837d8451_Tx: ComSignalType=UINT16
            OBJ_POS_LAT_ERR_064_oRDR_TRACKER_OBJ_064_oPCAN_RADAR_8731d466_Tx: ComSignalType=UINT8
            OBJ_POS_LONG_064_oRDR_TRACKER_OBJ_064_oPCAN_RADAR_32dd6f9e_Tx: ComSignalType=UINT16
            OBJ_POS_LONG_ERR_064_oRDR_TRACKER_OBJ_064_oPCAN_RADAR_1ec92a84_Tx: ComSignalType=UINT8
            OBJ_RCS_064_oRDR_TRACKER_OBJ_064_oPCAN_RADAR_a1b2d256_Tx: ComSignalType=UINT8
            OBJ_REF_PT_LAT_OFFSET_064_oRDR_TRACKER_OBJ_064_oPCAN_RADAR_548fb923_Tx: ComSignalType=UINT16
            OBJ_REF_PT_LONG_OFFSET_064_oRDR_TRACKER_OBJ_064_oPCAN_RADAR_1bdd4920_Tx: ComSignalType=UINT16
            OBJ_TIMESTAMP_OFFSET_064_oRDR_TRACKER_OBJ_064_oPCAN_RADAR_a11ed200_Tx: ComSignalType=UINT8
            OBJ_TRACK_MOTION_MODEL_064_oRDR_TRACKER_OBJ_064_oPCAN_RADAR_6d1dd3dd_Tx: ComSignalType=UINT8
            OBJ_VEH_TRACK_FLAG_064_oRDR_TRACKER_OBJ_064_oPCAN_RADAR_ef372580_Tx: ComSignalType=BOOLEAN
            OBJ_VELOCITY_ERR_CRR_COEF_064_oRDR_TRACKER_OBJ_064_oPCAN_RADAR_c8a844fc_Tx: ComSignalType=UINT8
            OBJ_VELOCITY_LAT_064_oRDR_TRACKER_OBJ_064_oPCAN_RADAR_c71ec176_Tx: ComSignalType=UINT16
            OBJ_VELOCITY_LAT_ERR_064_oRDR_TRACKER_OBJ_064_oPCAN_RADAR_f3e4b127_Tx: ComSignalType=UINT8
            OBJ_VELOCITY_LONG_064_oRDR_TRACKER_OBJ_064_oPCAN_RADAR_9793b9b0_Tx: ComSignalType=UINT16
            OBJ_VELOCITY_LONG_ERR_064_oRDR_TRACKER_OBJ_064_oPCAN_RADAR_1f668ee7_Tx: ComSignalType=UINT8
            OBJ_YAW_ANGLE_064_oRDR_TRACKER_OBJ_064_oPCAN_RADAR_2ba28536_Tx: ComSignalType=UINT16
            OBJ_YAW_ANGLE_ERR_064_oRDR_TRACKER_OBJ_064_oPCAN_RADAR_feaf83e1_Tx: ComSignalType=UINT8
            OBJ_YAW_RATE_064_oRDR_TRACKER_OBJ_064_oPCAN_RADAR_0e2da071_Tx: ComSignalType=UINT16
            OBJ_YAW_RATE_ERR_064_oRDR_TRACKER_OBJ_064_oPCAN_RADAR_31f537ad_Tx: ComSignalType=UINT8
        SG_TrackerStatus_oRDR_OBJ_STATUS_003_oPCAN_RADAR_3d577421_Tx
          8 x ComGroupSignal:
            STS_MH_003_CRC16_oRDR_OBJ_STATUS_003_oPCAN_RADAR_358216b5_Tx: ComSignalType=UINT16
            STS_MH_003_CYCLE_COUNTER_oRDR_OBJ_STATUS_003_oPCAN_RADAR_49230fca_Tx: ComSignalType=UINT8
            STS_OBJ_DBC_BASE_VER_MAJOR_oRDR_OBJ_STATUS_003_oPCAN_RADAR_9a35e806_Tx: ComSignalType=UINT8
            STS_OBJ_DBC_BASE_VER_MINOR_oRDR_OBJ_STATUS_003_oPCAN_RADAR_620f0a8a_Tx: ComSignalType=UINT8
            STS_PERCEPTION_MODULE_ID_oRDR_OBJ_STATUS_003_oPCAN_RADAR_a04fe4df_Tx: ComSignalType=UINT16
            STS_TRKR_MAJOR_VERSION_oRDR_OBJ_STATUS_003_oPCAN_RADAR_04b44e02_Tx: ComSignalType=UINT8
            STS_TRKR_MINOR_VERSION_oRDR_OBJ_STATUS_003_oPCAN_RADAR_49ba56fe_Tx: ComSignalType=UINT8
            STS_TRKR_PATCH_VERSION_oRDR_OBJ_STATUS_003_oPCAN_RADAR_4bf666f9_Tx: ComSignalType=UINT8
        SG_VDC2_oVDC2_oVCAN_RADAR_06eddadd_Rx
          4 x ComGroupSignal:
            LateralAcceleration_oVDC2_oVCAN_RADAR_b3e7a398_Rx: ComSignalType=UINT16
            LongitudinalAcceleration_oVDC2_oVCAN_RADAR_f355ad7e_Rx: ComSignalType=UINT8
            SteerWheelAngle_oVDC2_oVCAN_RADAR_c890bb33_Rx: ComSignalType=UINT16
            YawRate_oVDC2_oVCAN_RADAR_bf77bc8a_Rx: ComSignalType=UINT16
        SG_VD_oVD_oVCAN_RADAR_27d322c3_Rx
          Total_vehicle_distance_oVD_oVCAN_RADAR_7583597c_Rx (ComGroupSignal): ComSignalType=UINT32
        SG_VI_oVI_oVCAN_RADAR_7241e1af_Rx
          VehicleIdentification_oVI_oVCAN_RADAR_4b86485f_Rx (ComGroupSignal): ComSignalType=UINT8
        SG_VehicleStatus_oSYS_VEHICLE_STATUS_oPCAN_RADAR_0411a809_Rx
          39 x ComGroupSignal:
            SSTS_CAN_PCAN_MAJOR_ADAS_oSYS_VEHICLE_STATUS_oPCAN_RADAR_7162c0e1_Rx: ComSignalType=UINT8
            SSTS_CAN_PCAN_MINOR_ADAS_oSYS_VEHICLE_STATUS_oPCAN_RADAR_8c9b1f32_Rx: ComSignalType=UINT8
            SSTS_DRIVE_DIR_oSYS_VEHICLE_STATUS_oPCAN_RADAR_a5d0f7d2_Rx: ComSignalType=UINT8
            SSTS_DRIVE_REVERSE_oSYS_VEHICLE_STATUS_oPCAN_RADAR_07d888b2_Rx: ComSignalType=UINT8
            SSTS_GEAR_POSITION_oSYS_VEHICLE_STATUS_oPCAN_RADAR_4533b983_Rx: ComSignalType=UINT8
            SSTS_IGN_STATUS_oSYS_VEHICLE_STATUS_oPCAN_RADAR_59077970_Rx: ComSignalType=UINT8
            SSTS_MH_VS_CRC16_oSYS_VEHICLE_STATUS_oPCAN_RADAR_c31e8b64_Rx: ComSignalType=UINT16
            SSTS_MH_VS_CYCLE_COUNTER_oSYS_VEHICLE_STATUS_oPCAN_RADAR_0f7759f5_Rx: ComSignalType=UINT8
            SSTS_STEERING_ANGLE_SIGN_oSYS_VEHICLE_STATUS_oPCAN_RADAR_2edd7885_Rx: ComSignalType=BOOLEAN
            SSTS_STEERING_ANGLE_oSYS_VEHICLE_STATUS_oPCAN_RADAR_a73dd98d_Rx: ComSignalType=UINT8
            SSTS_SW_VERSION_ADAS_oSYS_VEHICLE_STATUS_oPCAN_RADAR_9ba50e45_Rx: ComSignalType=UINT32
            SSTS_VEHICLE_SPEED_CALC_QF_oSYS_VEHICLE_STATUS_oPCAN_RADAR_95d4c2d0_Rx: ComSignalType=UINT8
            SSTS_VEHICLE_SPEED_CALC_oSYS_VEHICLE_STATUS_oPCAN_RADAR_89c9a9e4_Rx: ComSignalType=UINT16
            SSTS_VEHICLE_STATE_oSYS_VEHICLE_STATUS_oPCAN_RADAR_9637ee7e_Rx: ComSignalType=UINT8
            SSTS_VEH_AbsoluteTime_Day_oSYS_VEHICLE_STATUS_oPCAN_RADAR_98f8a460_Rx: ComSignalType=UINT8
            SSTS_VEH_AbsoluteTime_Hour_oSYS_VEHICLE_STATUS_oPCAN_RADAR_711bf042_Rx: ComSignalType=UINT8
            SSTS_VEH_AbsoluteTime_Minute_oSYS_VEHICLE_STATUS_oPCAN_RADAR_13cd720f_Rx: ComSignalType=UINT8
            SSTS_VEH_AbsoluteTime_Month_oSYS_VEHICLE_STATUS_oPCAN_RADAR_649374da_Rx: ComSignalType=UINT8
            SSTS_VEH_AbsoluteTime_Second_oSYS_VEHICLE_STATUS_oPCAN_RADAR_816ad585_Rx: ComSignalType=UINT8
            SSTS_VEH_AbsoluteTime_Year_oSYS_VEHICLE_STATUS_oPCAN_RADAR_3c9d9324_Rx: ComSignalType=UINT8
            SSTS_VEH_ODOMETER_oSYS_VEHICLE_STATUS_oPCAN_RADAR_751a6302_Rx: ComSignalType=UINT32
            SSTS_VEH_POWER_MODE_STATUS_oSYS_VEHICLE_STATUS_oPCAN_RADAR_73f4a72e_Rx: ComSignalType=UINT8
            SSTS_VEH_SPD_COMP_FACTOR_oSYS_VEHICLE_STATUS_oPCAN_RADAR_3da60ec4_Rx: ComSignalType=SINT8
            SSTS_VEH_SYSTEM_VOLTAGE_oSYS_VEHICLE_STATUS_oPCAN_RADAR_1952d612_Rx: ComSignalType=UINT16
            SSTS_VEH_Status_CMAC_oSYS_VEHICLE_STATUS_oPCAN_RADAR_ac86c39a_Rx: ComSignalType=UINT8_N
            SSTS_VEH_Status_FV_oSYS_VEHICLE_STATUS_oPCAN_RADAR_4df6f68e_Rx: ComSignalType=UINT8_N
            SSTS_VEH_TRAILER_CONNECTED_oSYS_VEHICLE_STATUS_oPCAN_RADAR_377b66dd_Rx: ComSignalType=UINT8
            SSTS_VEH_VARIANT_oSYS_VEHICLE_STATUS_oPCAN_RADAR_87a69a77_Rx: ComSignalType=UINT8
            SSTS_VIN_Data_Byte0_oSYS_VEHICLE_STATUS_oPCAN_RADAR_7d65df3e_Rx: ComSignalType=UINT8
            SSTS_VIN_Data_Byte1_oSYS_VEHICLE_STATUS_oPCAN_RADAR_4b974fcd_Rx: ComSignalType=UINT8
            SSTS_VIN_Data_Byte2_oSYS_VEHICLE_STATUS_oPCAN_RADAR_1080fed8_Rx: ComSignalType=UINT8
            SSTS_VIN_Data_Byte3_oSYS_VEHICLE_STATUS_oPCAN_RADAR_26726e2b_Rx: ComSignalType=UINT8
            SSTS_VIN_Data_Byte4_oSYS_VEHICLE_STATUS_oPCAN_RADAR_a6af9cf2_Rx: ComSignalType=UINT8
            SSTS_VIN_Data_Byte5_oSYS_VEHICLE_STATUS_oPCAN_RADAR_905d0c01_Rx: ComSignalType=UINT8
            SSTS_VIN_Data_Byte6_oSYS_VEHICLE_STATUS_oPCAN_RADAR_cb4abd14_Rx: ComSignalType=UINT8
            SSTS_VIN_FrameIdx_oSYS_VEHICLE_STATUS_oPCAN_RADAR_ef68cb69_Rx: ComSignalType=UINT8
            SSTS_YAW_RATE_BIAS_oSYS_VEHICLE_STATUS_oPCAN_RADAR_c81bff9c_Rx: ComSignalType=UINT8
            SSTS_YAW_RATE_CALC_QF_oSYS_VEHICLE_STATUS_oPCAN_RADAR_61a6cdee_Rx: ComSignalType=UINT8
            SSTS_YAW_RATE_CALC_oSYS_VEHICLE_STATUS_oPCAN_RADAR_070d13a1_Rx: ComSignalType=UINT16
        SG_prop_ADAS_MOIS_info_oprop_ADAS_MOIS_info_oVCAN_RADAR_cb191e50_Tx
          rdn_MOISCollisionWarningLevel_oprop_ADAS_MOIS_info_oVCAN_RADAR_9b3bdf39_Tx (ComGroupSignal): ComSignalType=UINT8
          rdn_MovingObjectDetectionState_oprop_ADAS_MOIS_info_oVCAN_RADAR_f2d3c1fd_Tx (ComGroupSignal): ComSignalType=UINT8
  module config LdCom
    LdComConfig
      4 x LdComIPdu:
        signalPdu_ADAS_Vehicle_Status_638dcd82_Rx: LdComRxIndication=Rte_LdComCbkRxIndication_signalPdu_ADAS_Vehicle_Status_638dcd82_Rx
        signalPdu_RDR_1_Detections_52b391ee_Tx: LdComTxCopyTxData=Rte_LdComCbkCopyTxData_signalPdu_RDR_1_Detections_52b391ee_Tx, LdComTpTxConfirmation=Rte_LdComCbkTpTxConfirmation_signalPdu_RDR_1_Detections_52b391ee_Tx
        signalPdu_RDR_1_SW_Info_b4e751e3_Tx
        signalPdu_RDR_1_Status_9d482741_Tx
  ecuc value collection DaVinci_Project: ecuc-values=[Com, LdCom]
  bsw implementation Rte_Impl
    mc-parameter-instances:
      15 x mc data instance:
        SWC_CMP_PRJ_UDSHandler_SWC_UDSHandler_Attemptcounter_DefaultValue: symbol=Rte_SWC_CMP_PRJ_UDSHandler_SWC_UDSHandler_Attemptcounter_DefaultValue
        SWC_CMP_PRJ_UDSHandler_SWC_UDSHandler_VIN_DefaultValue: symbol=Rte_SWC_CMP_PRJ_UDSHandler_SWC_UDSHandler_VIN_DefaultValue
        SWC_PLT_Appl_IoHwAb_ECU_Position_ROMDefault: symbol=Rte_SWC_PLT_Appl_IoHwAb_ECU_Position_ROMDefault
        SWC_PLT_Appl_NvMHandler_Alignment_NvMBlock_DefaultValue: symbol=Rte_SWC_PLT_Appl_NvMHandler_Alignment_NvMBlock_DefaultValue
        SWC_PLT_Appl_NvMHandler_Correctable_Fault_NvM_DefaultValue: symbol=Rte_SWC_PLT_Appl_NvMHandler_Correctable_Fault_NvM_DefaultValue
        SWC_PLT_Appl_NvMHandler_NvMBringUp_DefaultValue: symbol=Rte_SWC_PLT_Appl_NvMHandler_NvMBringUp_DefaultValue
        SWC_PLT_Appl_NvMHandler_RFE_R1R2_Fault_NvM_DefaultValue: symbol=Rte_SWC_PLT_Appl_NvMHandler_RFE_R1R2_Fault_NvM_DefaultValue
        SWC_PLT_Appl_NvMHandler_SWC_Manual_alignment_Execution_DefaultValue: symbol=Rte_SWC_PLT_Appl_NvMHandler_SWC_Manual_alignment_Execution_DefaultValue
        SWC_PLT_Appl_NvMHandler_SWC_PLT_CDD_FailSafe_DefaultValue: symbol=Rte_SWC_PLT_Appl_NvMHandler_SWC_PLT_CDD_FailSafe_DefaultValue
        SWC_PLT_Appl_NvMHandler_SWC_Static_Alignment_Write_Parameters_DefaultValue: symbol=Rte_SWC_PLT_Appl_NvMHandler_SWC_Static_Alignment_Write_Parameters_DefaultValue
        SWC_PLT_Appl_NvMHandler_SWC_VSE_NVM_Params_DefaultValue: symbol=Rte_SWC_PLT_Appl_NvMHandler_SWC_VSE_NVM_Params_DefaultValue
        SWC_PLT_Appl_NvMHandler_SensorPos_NvM_DefaultValue: symbol=Rte_SWC_PLT_Appl_NvMHandler_SensorPos_NvM_DefaultValue
        SWC_PLT_CDD_FailSafe_ExceptionReason_DefaultValue: symbol=Rte_SWC_PLT_CDD_FailSafe_ExceptionReason_DefaultValue
        SWC_PLT_CDD_FailSafe_ResetReason_DefaultValue: symbol=Rte_SWC_PLT_CDD_FailSafe_ResetReason_DefaultValue
        SWC_PLT_Radar_Alignment_Handler_Appl_AutoAlignment_DefaultValue: symbol=Rte_SWC_PLT_Radar_Alignment_Handler_Appl_AutoAlignment_DefaultValue
