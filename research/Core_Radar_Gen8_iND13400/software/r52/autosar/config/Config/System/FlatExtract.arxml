[part 6 of 11: package /COM/VECTOR/CFG/WORKFLOW/SYSDESC/SYNC]
AUTOSAR XML (schema 00053)
package /COM/VECTOR/CFG/WORKFLOW/SYSDESC/SYNC  (continued)
  system SYSTEM: category=ECU_EXTRACT, client-id-definition-set=CLIENT_ID_DEFINITION_SET  (continued)
    system mapping MAPPINGS  (continued)
      data-mappings:  (continued)
        sender-receiver-to-signal-group-mapping={data-element=COMPOSITIONTYPE.Pp_SG_Detections_345_348_AL.Vdp_SG_Detections_345_348_AL, signal-group=SG_Detections_345_348, type-mapping=sender-rec-record-type-mapping=record-element-mappings=[{application-record-element=DET_AZIMUTH_345, system-signal=DET_AZIMUTH_345}, {application-record-element=DET_AZIMUTH_346, system-signal=DET_AZIMUTH_346}, {application-record-element=DET_AZIMUTH_347, system-signal=DET_AZIMUTH_347}, {application-record-element=DET_AZIMUTH_348, system-signal=DET_AZIMUTH_348}, {application-record-element=DET_AZIMUTH_ERR_345, system-signal=DET_AZIMUTH_ERR_345}, {application-record-element=DET_AZIMUTH_ERR_346, system-signal=DET_AZIMUTH_ERR_346}, {application-record-element=DET_AZIMUTH_ERR_347, system-signal=DET_AZIMUTH_ERR_347}, {application-record-element=DET_AZIMUTH_ERR_348, system-signal=DET_AZIMUTH_ERR_348}, {application-record-element=DET_BELOW_RAIN_THOLD_345, system-signal=DET_BELOW_RAIN_THOLD_345}, {application-record-element=DET_BELOW_RAIN_THOLD_346, system-signal=DET_BELOW_RAIN_THOLD_346}, {application-record-element=DET_BELOW_RAIN_THOLD_347, system-signal=DET_BELOW_RAIN_THOLD_347}, {application-record-element=DET_BELOW_RAIN_THOLD_348, system-signal=DET_BELOW_RAIN_THOLD_348}, {application-record-element=DET_BI_STATIC_FLAG_345, system-signal=DET_BI_STATIC_FLAG_345}, {application-record-element=DET_BI_STATIC_FLAG_346, system-signal=DET_BI_STATIC_FLAG_346}, {application-record-element=DET_BI_STATIC_FLAG_347, system-signal=DET_BI_STATIC_FLAG_347}, {application-record-element=DET_BI_STATIC_FLAG_348, system-signal=DET_BI_STATIC_FLAG_348}, {application-record-element=DET_CONFD_AZIMUTH_345, system-signal=DET_CONFD_AZIMUTH_345}, {application-record-element=DET_CONFD_AZIMUTH_346, system-signal=DET_CONFD_AZIMUTH_346}, {application-record-element=DET_CONFD_AZIMUTH_347, system-signal=DET_CONFD_AZIMUTH_347}, {application-record-element=DET_CONFD_AZIMUTH_348, system-signal=DET_CONFD_AZIMUTH_348}, {application-record-element=DET_CONFD_ELEVATION_345, system-signal=DET_CONFD_ELEVATION_345}, {application-record-element=DET_CONFD_ELEVATION_346, system-signal=DET_CONFD_ELEVATION_346}, {application-record-element=DET_CONFD_ELEVATION_347, system-signal=DET_CONFD_ELEVATION_347}, {application-record-element=DET_CONFD_ELEVATION_348, system-signal=DET_CONFD_ELEVATION_348}, {application-record-element=DET_ELEVATION_345, system-signal=DET_ELEVATION_345}, {application-record-element=DET_ELEVATION_346, system-signal=DET_ELEVATION_346}, {application-record-element=DET_ELEVATION_347, system-signal=DET_ELEVATION_347}, {application-record-element=DET_ELEVATION_348, system-signal=DET_ELEVATION_348}, {application-record-element=DET_ELEVATION_ERR_345, system-signal=DET_ELEVATION_ERR_345}, {application-record-element=DET_ELEVATION_ERR_346, system-signal=DET_ELEVATION_ERR_346}, {application-record-element=DET_ELEVATION_ERR_347, system-signal=DET_ELEVATION_ERR_347}, {application-record-element=DET_ELEVATION_ERR_348, system-signal=DET_ELEVATION_ERR_348}, {application-record-element=DET_EXISTENCE_PROB_345, system-signal=DET_EXISTENCE_PROB_345}, {application-record-element=DET_EXISTENCE_PROB_346, system-signal=DET_EXISTENCE_PROB_346}, {application-record-element=DET_EXISTENCE_PROB_347, system-signal=DET_EXISTENCE_PROB_347}, {application-record-element=DET_EXISTENCE_PROB_348, system-signal=DET_EXISTENCE_PROB_348}, {application-record-element=DET_HVC_FLAG_345, system-signal=DET_HVC_FLAG_345}, {application-record-element=DET_HVC_FLAG_346, system-signal=DET_HVC_FLAG_346}, {application-record-element=DET_HVC_FLAG_347, system-signal=DET_HVC_FLAG_347}, {application-record-element=DET_HVC_FLAG_348, system-signal=DET_HVC_FLAG_348}, {application-record-element=DET_IDM_345, system-signal=DET_IDM_345}, {application-record-element=DET_IDM_346, system-signal=DET_IDM_346}, {application-record-element=DET_IDM_347, system-signal=DET_IDM_347}, {application-record-element=DET_IDM_348, system-signal=DET_IDM_348}, {application-record-element=DET_MH_CRC16_345_348, system-signal=DET_MH_CRC16_345_348}, {application-record-element=DET_MH_CYCLE_COUNTER_345_348, system-signal=DET_MH_CYCLE_COUNTER_345_348}, {application-record-element=DET_MH_SCAN_INDEX_4LSB_345_348, system-signal=DET_MH_SCAN_INDEX_4LSB_345_348}, {application-record-element=DET_MTD_345, system-signal=DET_MTD_345}, {application-record-element=DET_MTD_346, system-signal=DET_MTD_346}, {application-record-element=DET_MTD_347, system-signal=DET_MTD_347}, {application-record-element=DET_MTD_348, system-signal=DET_MTD_348}, {application-record-element=DET_PROB_1STAZHYPO_345, system-signal=DET_PROB_1STAZHYPO_345}, {application-record-element=DET_PROB_1STAZHYPO_346, system-signal=DET_PROB_1STAZHYPO_346}, {application-record-element=DET_PROB_1STAZHYPO_347, system-signal=DET_PROB_1STAZHYPO_347}, {application-record-element=DET_PROB_1STAZHYPO_348, system-signal=DET_PROB_1STAZHYPO_348}, {application-record-element=DET_RANGE_345, system-signal=DET_RANGE_345}, {application-record-element=DET_RANGE_346, system-signal=DET_RANGE_346}, {application-record-element=DET_RANGE_347, system-signal=DET_RANGE_347}, {application-record-element=DET_RANGE_348, system-signal=DET_RANGE_348}, {application-record-element=DET_RANGE_ERR_345, system-signal=DET_RANGE_ERR_345}, {application-record-element=DET_RANGE_ERR_346, system-signal=DET_RANGE_ERR_346}, {application-record-element=DET_RANGE_ERR_347, system-signal=DET_RANGE_ERR_347}, {application-record-element=DET_RANGE_ERR_348, system-signal=DET_RANGE_ERR_348}, {application-record-element=DET_RANGE_VELOCITY_345, system-signal=DET_RANGE_VELOCITY_345}, {application-record-element=DET_RANGE_VELOCITY_346, system-signal=DET_RANGE_VELOCITY_346}, {application-record-element=DET_RANGE_VELOCITY_347, system-signal=DET_RANGE_VELOCITY_347}, {application-record-element=DET_RANGE_VELOCITY_348, system-signal=DET_RANGE_VELOCITY_348}, {application-record-element=DET_RANGE_VELOCITY_ERR_345, system-signal=DET_RANGE_VELOCITY_ERR_345}, {application-record-element=DET_RANGE_VELOCITY_ERR_346, system-signal=DET_RANGE_VELOCITY_ERR_346}, {application-record-element=DET_RANGE_VELOCITY_ERR_347, system-signal=DET_RANGE_VELOCITY_ERR_347}, {application-record-element=DET_RANGE_VELOCITY_ERR_348, system-signal=DET_RANGE_VELOCITY_ERR_348}, {application-record-element=DET_RCS_345, system-signal=DET_RCS_345}, {application-record-element=DET_RCS_346, system-signal=DET_RCS_346}, {application-record-element=DET_RCS_347, system-signal=DET_RCS_347}, {application-record-element=DET_RCS_348, system-signal=DET_RCS_348}, {application-record-element=DET_SNR_345, system-signal=DET_SNR_345}, {application-record-element=DET_SNR_346, system-signal=DET_SNR_346}, {application-record-element=DET_SNR_347, system-signal=DET_SNR_347}, {application-record-element=DET_SNR_348, system-signal=DET_SNR_348}, {application-record-element=DET_SUPER_RES_TARGET_345, system-signal=DET_SUPER_RES_TARGET_345}, {application-record-element=DET_SUPER_RES_TARGET_346, system-signal=DET_SUPER_RES_TARGET_346}, {application-record-element=DET_SUPER_RES_TARGET_347, system-signal=DET_SUPER_RES_TARGET_347}, {application-record-element=DET_SUPER_RES_TARGET_348, system-signal=DET_SUPER_RES_TARGET_348}]}
        sender-receiver-to-signal-group-mapping={data-element=COMPOSITIONTYPE.Pp_SG_Detections_349_352_AL.Vdp_SG_Detections_349_352_AL, signal-group=SG_Detections_349_352, type-mapping=sender-rec-record-type-mapping=record-element-mappings=[{application-record-element=DET_AZIMUTH_349, system-signal=DET_AZIMUTH_349}, {application-record-element=DET_AZIMUTH_350, system-signal=DET_AZIMUTH_350}, {application-record-element=DET_AZIMUTH_351, system-signal=DET_AZIMUTH_351}, {application-record-element=DET_AZIMUTH_352, system-signal=DET_AZIMUTH_352}, {application-record-element=DET_AZIMUTH_ERR_349, system-signal=DET_AZIMUTH_ERR_349}, {application-record-element=DET_AZIMUTH_ERR_350, system-signal=DET_AZIMUTH_ERR_350}, {application-record-element=DET_AZIMUTH_ERR_351, system-signal=DET_AZIMUTH_ERR_351}, {application-record-element=DET_AZIMUTH_ERR_352, system-signal=DET_AZIMUTH_ERR_352}, {application-record-element=DET_BELOW_RAIN_THOLD_349, system-signal=DET_BELOW_RAIN_THOLD_349}, {application-record-element=DET_BELOW_RAIN_THOLD_350, system-signal=DET_BELOW_RAIN_THOLD_350}, {application-record-element=DET_BELOW_RAIN_THOLD_351, system-signal=DET_BELOW_RAIN_THOLD_351}, {application-record-element=DET_BELOW_RAIN_THOLD_352, system-signal=DET_BELOW_RAIN_THOLD_352}, {application-record-element=DET_BI_STATIC_FLAG_349, system-signal=DET_BI_STATIC_FLAG_349}, {application-record-element=DET_BI_STATIC_FLAG_350, system-signal=DET_BI_STATIC_FLAG_350}, {application-record-element=DET_BI_STATIC_FLAG_351, system-signal=DET_BI_STATIC_FLAG_351}, {application-record-element=DET_BI_STATIC_FLAG_352, system-signal=DET_BI_STATIC_FLAG_352}, {application-record-element=DET_CONFD_AZIMUTH_349, system-signal=DET_CONFD_AZIMUTH_349}, {application-record-element=DET_CONFD_AZIMUTH_350, system-signal=DET_CONFD_AZIMUTH_350}, {application-record-element=DET_CONFD_AZIMUTH_351, system-signal=DET_CONFD_AZIMUTH_351}, {application-record-element=DET_CONFD_AZIMUTH_352, system-signal=DET_CONFD_AZIMUTH_352}, {application-record-element=DET_CONFD_ELEVATION_349, system-signal=DET_CONFD_ELEVATION_349}, {application-record-element=DET_CONFD_ELEVATION_350, system-signal=DET_CONFD_ELEVATION_350}, {application-record-element=DET_CONFD_ELEVATION_351, system-signal=DET_CONFD_ELEVATION_351}, {application-record-element=DET_CONFD_ELEVATION_352, system-signal=DET_CONFD_ELEVATION_352}, {application-record-element=DET_ELEVATION_349, system-signal=DET_ELEVATION_349}, {application-record-element=DET_ELEVATION_350, system-signal=DET_ELEVATION_350}, {application-record-element=DET_ELEVATION_351, system-signal=DET_ELEVATION_351}, {application-record-element=DET_ELEVATION_352, system-signal=DET_ELEVATION_352}, {application-record-element=DET_ELEVATION_ERR_349, system-signal=DET_ELEVATION_ERR_349}, {application-record-element=DET_ELEVATION_ERR_350, system-signal=DET_ELEVATION_ERR_350}, {application-record-element=DET_ELEVATION_ERR_351, system-signal=DET_ELEVATION_ERR_351}, {application-record-element=DET_ELEVATION_ERR_352, system-signal=DET_ELEVATION_ERR_352}, {application-record-element=DET_EXISTENCE_PROB_349, system-signal=DET_EXISTENCE_PROB_349}, {application-record-element=DET_EXISTENCE_PROB_350, system-signal=DET_EXISTENCE_PROB_350}, {application-record-element=DET_EXISTENCE_PROB_351, system-signal=DET_EXISTENCE_PROB_351}, {application-record-element=DET_EXISTENCE_PROB_352, system-signal=DET_EXISTENCE_PROB_352}, {application-record-element=DET_HVC_FLAG_349, system-signal=DET_HVC_FLAG_349}, {application-record-element=DET_HVC_FLAG_350, system-signal=DET_HVC_FLAG_350}, {application-record-element=DET_HVC_FLAG_351, system-signal=DET_HVC_FLAG_351}, {application-record-element=DET_HVC_FLAG_352, system-signal=DET_HVC_FLAG_352}, {application-record-element=DET_IDM_349, system-signal=DET_IDM_349}, {application-record-element=DET_IDM_350, system-signal=DET_IDM_350}, {application-record-element=DET_IDM_351, system-signal=DET_IDM_351}, {application-record-element=DET_IDM_352, system-signal=DET_IDM_352}, {application-record-element=DET_MH_CRC16_349_352, system-signal=DET_MH_CRC16_349_352}, {application-record-element=DET_MH_CYCLE_COUNTER_349_352, system-signal=DET_MH_CYCLE_COUNTER_349_352}, {application-record-element=DET_MH_SCAN_INDEX_4LSB_349_352, system-signal=DET_MH_SCAN_INDEX_4LSB_349_352}, {application-record-element=DET_MTD_349, system-signal=DET_MTD_349}, {application-record-element=DET_MTD_350, system-signal=DET_MTD_350}, {application-record-element=DET_MTD_351, system-signal=DET_MTD_351}, {application-record-element=DET_MTD_352, system-signal=DET_MTD_352}, {application-record-element=DET_PROB_1STAZHYPO_349, system-signal=DET_PROB_1STAZHYPO_349}, {application-record-element=DET_PROB_1STAZHYPO_350, system-signal=DET_PROB_1STAZHYPO_350}, {application-record-element=DET_PROB_1STAZHYPO_351, system-signal=DET_PROB_1STAZHYPO_351}, {application-record-element=DET_PROB_1STAZHYPO_352, system-signal=DET_PROB_1STAZHYPO_352}, {application-record-element=DET_RANGE_349, system-signal=DET_RANGE_349}, {application-record-element=DET_RANGE_350, system-signal=DET_RANGE_350}, {application-record-element=DET_RANGE_351, system-signal=DET_RANGE_351}, {application-record-element=DET_RANGE_352, system-signal=DET_RANGE_352}, {application-record-element=DET_RANGE_ERR_349, system-signal=DET_RANGE_ERR_349}, {application-record-element=DET_RANGE_ERR_350, system-signal=DET_RANGE_ERR_350}, {application-record-element=DET_RANGE_ERR_351, system-signal=DET_RANGE_ERR_351}, {application-record-element=DET_RANGE_ERR_352, system-signal=DET_RANGE_ERR_352}, {application-record-element=DET_RANGE_VELOCITY_349, system-signal=DET_RANGE_VELOCITY_349}, {application-record-element=DET_RANGE_VELOCITY_350, system-signal=DET_RANGE_VELOCITY_350}, {application-record-element=DET_RANGE_VELOCITY_351, system-signal=DET_RANGE_VELOCITY_351}, {application-record-element=DET_RANGE_VELOCITY_352, system-signal=DET_RANGE_VELOCITY_352}, {application-record-element=DET_RANGE_VELOCITY_ERR_349, system-signal=DET_RANGE_VELOCITY_ERR_349}, {application-record-element=DET_RANGE_VELOCITY_ERR_350, system-signal=DET_RANGE_VELOCITY_ERR_350}, {application-record-element=DET_RANGE_VELOCITY_ERR_351, system-signal=DET_RANGE_VELOCITY_ERR_351}, {application-record-element=DET_RANGE_VELOCITY_ERR_352, system-signal=DET_RANGE_VELOCITY_ERR_352}, {application-record-element=DET_RCS_349, system-signal=DET_RCS_349}, {application-record-element=DET_RCS_350, system-signal=DET_RCS_350}, {application-record-element=DET_RCS_351, system-signal=DET_RCS_351}, {application-record-element=DET_RCS_352, system-signal=DET_RCS_352}, {application-record-element=DET_SNR_349, system-signal=DET_SNR_349}, {application-record-element=DET_SNR_350, system-signal=DET_SNR_350}, {application-record-element=DET_SNR_351, system-signal=DET_SNR_351}, {application-record-element=DET_SNR_352, system-signal=DET_SNR_352}, {application-record-element=DET_SUPER_RES_TARGET_349, system-signal=DET_SUPER_RES_TARGET_349}, {application-record-element=DET_SUPER_RES_TARGET_350, system-signal=DET_SUPER_RES_TARGET_350}, {application-record-element=DET_SUPER_RES_TARGET_351, system-signal=DET_SUPER_RES_TARGET_351}, {application-record-element=DET_SUPER_RES_TARGET_352, system-signal=DET_SUPER_RES_TARGET_352}]}
        sender-receiver-to-signal-group-mapping={data-element=COMPOSITIONTYPE.Pp_SG_Detections_353_356_AL.Vdp_SG_Detections_353_356_AL, signal-group=SG_Detections_353_356, type-mapping=sender-rec-record-type-mapping=record-element-mappings=[{application-record-element=DET_AZIMUTH_353, system-signal=DET_AZIMUTH_353}, {application-record-element=DET_AZIMUTH_354, system-signal=DET_AZIMUTH_354}, {application-record-element=DET_AZIMUTH_355, system-signal=DET_AZIMUTH_355}, {application-record-element=DET_AZIMUTH_356, system-signal=DET_AZIMUTH_356}, {application-record-element=DET_AZIMUTH_ERR_353, system-signal=DET_AZIMUTH_ERR_353}, {application-record-element=DET_AZIMUTH_ERR_354, system-signal=DET_AZIMUTH_ERR_354}, {application-record-element=DET_AZIMUTH_ERR_355, system-signal=DET_AZIMUTH_ERR_355}, {application-record-element=DET_AZIMUTH_ERR_356, system-signal=DET_AZIMUTH_ERR_356}, {application-record-element=DET_BELOW_RAIN_THOLD_353, system-signal=DET_BELOW_RAIN_THOLD_353}, {application-record-element=DET_BELOW_RAIN_THOLD_354, system-signal=DET_BELOW_RAIN_THOLD_354}, {application-record-element=DET_BELOW_RAIN_THOLD_355, system-signal=DET_BELOW_RAIN_THOLD_355}, {application-record-element=DET_BELOW_RAIN_THOLD_356, system-signal=DET_BELOW_RAIN_THOLD_356}, {application-record-element=DET_BI_STATIC_FLAG_353, system-signal=DET_BI_STATIC_FLAG_353}, {application-record-element=DET_BI_STATIC_FLAG_354, system-signal=DET_BI_STATIC_FLAG_354}, {application-record-element=DET_BI_STATIC_FLAG_355, system-signal=DET_BI_STATIC_FLAG_355}, {application-record-element=DET_BI_STATIC_FLAG_356, system-signal=DET_BI_STATIC_FLAG_356}, {application-record-element=DET_CONFD_AZIMUTH_353, system-signal=DET_CONFD_AZIMUTH_353}, {application-record-element=DET_CONFD_AZIMUTH_354, system-signal=DET_CONFD_AZIMUTH_354}, {application-record-element=DET_CONFD_AZIMUTH_355, system-signal=DET_CONFD_AZIMUTH_355}, {application-record-element=DET_CONFD_AZIMUTH_356, system-signal=DET_CONFD_AZIMUTH_356}, {application-record-element=DET_CONFD_ELEVATION_353, system-signal=DET_CONFD_ELEVATION_353}, {application-record-element=DET_CONFD_ELEVATION_354, system-signal=DET_CONFD_ELEVATION_354}, {application-record-element=DET_CONFD_ELEVATION_355, system-signal=DET_CONFD_ELEVATION_355}, {application-record-element=DET_CONFD_ELEVATION_356, system-signal=DET_CONFD_ELEVATION_356}, {application-record-element=DET_ELEVATION_353, system-signal=DET_ELEVATION_353}, {application-record-element=DET_ELEVATION_354, system-signal=DET_ELEVATION_354}, {application-record-element=DET_ELEVATION_355, system-signal=DET_ELEVATION_355}, {application-record-element=DET_ELEVATION_356, system-signal=DET_ELEVATION_356}, {application-record-element=DET_ELEVATION_ERR_353, system-signal=DET_ELEVATION_ERR_353}, {application-record-element=DET_ELEVATION_ERR_354, system-signal=DET_ELEVATION_ERR_354}, {application-record-element=DET_ELEVATION_ERR_355, system-signal=DET_ELEVATION_ERR_355}, {application-record-element=DET_ELEVATION_ERR_356, system-signal=DET_ELEVATION_ERR_356}, {application-record-element=DET_EXISTENCE_PROB_353, system-signal=DET_EXISTENCE_PROB_353}, {application-record-element=DET_EXISTENCE_PROB_354, system-signal=DET_EXISTENCE_PROB_354}, {application-record-element=DET_EXISTENCE_PROB_355, system-signal=DET_EXISTENCE_PROB_355}, {application-record-element=DET_EXISTENCE_PROB_356, system-signal=DET_EXISTENCE_PROB_356}, {application-record-element=DET_HVC_FLAG_353, system-signal=DET_HVC_FLAG_353}, {application-record-element=DET_HVC_FLAG_354, system-signal=DET_HVC_FLAG_354}, {application-record-element=DET_HVC_FLAG_355, system-signal=DET_HVC_FLAG_355}, {application-record-element=DET_HVC_FLAG_356, system-signal=DET_HVC_FLAG_356}, {application-record-element=DET_IDM_353, system-signal=DET_IDM_353}, {application-record-element=DET_IDM_354, system-signal=DET_IDM_354}, {application-record-element=DET_IDM_355, system-signal=DET_IDM_355}, {application-record-element=DET_IDM_356, system-signal=DET_IDM_356}, {application-record-element=DET_MH_CRC16_353_356, system-signal=DET_MH_CRC16_353_356}, {application-record-element=DET_MH_CYCLE_COUNTER_353_356, system-signal=DET_MH_CYCLE_COUNTER_353_356}, {application-record-element=DET_MH_SCAN_INDEX_4LSB_353_356, system-signal=DET_MH_SCAN_INDEX_4LSB_353_356}, {application-record-element=DET_MTD_353, system-signal=DET_MTD_353}, {application-record-element=DET_MTD_354, system-signal=DET_MTD_354}, {application-record-element=DET_MTD_355, system-signal=DET_MTD_355}, {application-record-element=DET_MTD_356, system-signal=DET_MTD_356}, {application-record-element=DET_PROB_1STAZHYPO_353, system-signal=DET_PROB_1STAZHYPO_353}, {application-record-element=DET_PROB_1STAZHYPO_354, system-signal=DET_PROB_1STAZHYPO_354}, {application-record-element=DET_PROB_1STAZHYPO_355, system-signal=DET_PROB_1STAZHYPO_355}, {application-record-element=DET_PROB_1STAZHYPO_356, system-signal=DET_PROB_1STAZHYPO_356}, {application-record-element=DET_RANGE_353, system-signal=DET_RANGE_353}, {application-record-element=DET_RANGE_354, system-signal=DET_RANGE_354}, {application-record-element=DET_RANGE_355, system-signal=DET_RANGE_355}, {application-record-element=DET_RANGE_356, system-signal=DET_RANGE_356}, {application-record-element=DET_RANGE_ERR_353, system-signal=DET_RANGE_ERR_353}, {application-record-element=DET_RANGE_ERR_354, system-signal=DET_RANGE_ERR_354}, {application-record-element=DET_RANGE_ERR_355, system-signal=DET_RANGE_ERR_355}, {application-record-element=DET_RANGE_ERR_356, system-signal=DET_RANGE_ERR_356}, {application-record-element=DET_RANGE_VELOCITY_353, system-signal=DET_RANGE_VELOCITY_353}, {application-record-element=DET_RANGE_VELOCITY_354, system-signal=DET_RANGE_VELOCITY_354}, {application-record-element=DET_RANGE_VELOCITY_355, system-signal=DET_RANGE_VELOCITY_355}, {application-record-element=DET_RANGE_VELOCITY_356, system-signal=DET_RANGE_VELOCITY_356}, {application-record-element=DET_RANGE_VELOCITY_ERR_353, system-signal=DET_RANGE_VELOCITY_ERR_353}, {application-record-element=DET_RANGE_VELOCITY_ERR_354, system-signal=DET_RANGE_VELOCITY_ERR_354}, {application-record-element=DET_RANGE_VELOCITY_ERR_355, system-signal=DET_RANGE_VELOCITY_ERR_355}, {application-record-element=DET_RANGE_VELOCITY_ERR_356, system-signal=DET_RANGE_VELOCITY_ERR_356}, {application-record-element=DET_RCS_353, system-signal=DET_RCS_353}, {application-record-element=DET_RCS_354, system-signal=DET_RCS_354}, {application-record-element=DET_RCS_355, system-signal=DET_RCS_355}, {application-record-element=DET_RCS_356, system-signal=DET_RCS_356}, {application-record-element=DET_SNR_353, system-signal=DET_SNR_353}, {application-record-element=DET_SNR_354, system-signal=DET_SNR_354}, {application-record-element=DET_SNR_355, system-signal=DET_SNR_355}, {application-record-element=DET_SNR_356, system-signal=DET_SNR_356}, {application-record-element=DET_SUPER_RES_TARGET_353, system-signal=DET_SUPER_RES_TARGET_353}, {application-record-element=DET_SUPER_RES_TARGET_354, system-signal=DET_SUPER_RES_TARGET_354}, {application-record-element=DET_SUPER_RES_TARGET_355, system-signal=DET_SUPER_RES_TARGET_355}, {application-record-element=DET_SUPER_RES_TARGET_356, system-signal=DET_SUPER_RES_TARGET_356}]}
        sender-receiver-to-signal-group-mapping={data-element=COMPOSITIONTYPE.Pp_SG_Detections_357_360_AL.Vdp_SG_Detections_357_360_AL, signal-group=SG_Detections_357_360, type-mapping=sender-rec-record-type-mapping=record-element-mappings=[{application-record-element=DET_AZIMUTH_357, system-signal=DET_AZIMUTH_357}, {application-record-element=DET_AZIMUTH_358, system-signal=DET_AZIMUTH_358}, {application-record-element=DET_AZIMUTH_359, system-signal=DET_AZIMUTH_359}, {application-record-element=DET_AZIMUTH_360, system-signal=DET_AZIMUTH_360}, {application-record-element=DET_AZIMUTH_ERR_357, system-signal=DET_AZIMUTH_ERR_357}, {application-record-element=DET_AZIMUTH_ERR_358, system-signal=DET_AZIMUTH_ERR_358}, {application-record-element=DET_AZIMUTH_ERR_359, system-signal=DET_AZIMUTH_ERR_359}, {application-record-element=DET_AZIMUTH_ERR_360, system-signal=DET_AZIMUTH_ERR_360}, {application-record-element=DET_BELOW_RAIN_THOLD_357, system-signal=DET_BELOW_RAIN_THOLD_357}, {application-record-element=DET_BELOW_RAIN_THOLD_358, system-signal=DET_BELOW_RAIN_THOLD_358}, {application-record-element=DET_BELOW_RAIN_THOLD_359, system-signal=DET_BELOW_RAIN_THOLD_359}, {application-record-element=DET_BELOW_RAIN_THOLD_360, system-signal=DET_BELOW_RAIN_THOLD_360}, {application-record-element=DET_BI_STATIC_FLAG_357, system-signal=DET_BI_STATIC_FLAG_357}, {application-record-element=DET_BI_STATIC_FLAG_358, system-signal=DET_BI_STATIC_FLAG_358}, {application-record-element=DET_BI_STATIC_FLAG_359, system-signal=DET_BI_STATIC_FLAG_359}, {application-record-element=DET_BI_STATIC_FLAG_360, system-signal=DET_BI_STATIC_FLAG_360}, {application-record-element=DET_CONFD_AZIMUTH_357, system-signal=DET_CONFD_AZIMUTH_357}, {application-record-element=DET_CONFD_AZIMUTH_358, system-signal=DET_CONFD_AZIMUTH_358}, {application-record-element=DET_CONFD_AZIMUTH_359, system-signal=DET_CONFD_AZIMUTH_359}, {application-record-element=DET_CONFD_AZIMUTH_360, system-signal=DET_CONFD_AZIMUTH_360}, {application-record-element=DET_CONFD_ELEVATION_357, system-signal=DET_CONFD_ELEVATION_357}, {application-record-element=DET_CONFD_ELEVATION_358, system-signal=DET_CONFD_ELEVATION_358}, {application-record-element=DET_CONFD_ELEVATION_359, system-signal=DET_CONFD_ELEVATION_359}, {application-record-element=DET_CONFD_ELEVATION_360, system-signal=DET_CONFD_ELEVATION_360}, {application-record-element=DET_ELEVATION_357, system-signal=DET_ELEVATION_357}, {application-record-element=DET_ELEVATION_358, system-signal=DET_ELEVATION_358}, {application-record-element=DET_ELEVATION_359, system-signal=DET_ELEVATION_359}, {application-record-element=DET_ELEVATION_360, system-signal=DET_ELEVATION_360}, {application-record-element=DET_ELEVATION_ERR_357, system-signal=DET_ELEVATION_ERR_357}, {application-record-element=DET_ELEVATION_ERR_358, system-signal=DET_ELEVATION_ERR_358}, {application-record-element=DET_ELEVATION_ERR_359, system-signal=DET_ELEVATION_ERR_359}, {application-record-element=DET_ELEVATION_ERR_360, system-signal=DET_ELEVATION_ERR_360}, {application-record-element=DET_EXISTENCE_PROB_357, system-signal=DET_EXISTENCE_PROB_357}, {application-record-element=DET_EXISTENCE_PROB_358, system-signal=DET_EXISTENCE_PROB_358}, {application-record-element=DET_EXISTENCE_PROB_359, system-signal=DET_EXISTENCE_PROB_359}, {application-record-element=DET_EXISTENCE_PROB_360, system-signal=DET_EXISTENCE_PROB_360}, {application-record-element=DET_HVC_FLAG_357, system-signal=DET_HVC_FLAG_357}, {application-record-element=DET_HVC_FLAG_358, system-signal=DET_HVC_FLAG_358}, {application-record-element=DET_HVC_FLAG_359, system-signal=DET_HVC_FLAG_359}, {application-record-element=DET_HVC_FLAG_360, system-signal=DET_HVC_FLAG_360}, {application-record-element=DET_IDM_357, system-signal=DET_IDM_357}, {application-record-element=DET_IDM_358, system-signal=DET_IDM_358}, {application-record-element=DET_IDM_359, system-signal=DET_IDM_359}, {application-record-element=DET_IDM_360, system-signal=DET_IDM_360}, {application-record-element=DET_MH_CRC16_357_360, system-signal=DET_MH_CRC16_357_360}, {application-record-element=DET_MH_CYCLE_COUNTER_357_360, system-signal=DET_MH_CYCLE_COUNTER_357_360}, {application-record-element=DET_MH_SCAN_INDEX_4LSB_357_360, system-signal=DET_MH_SCAN_INDEX_4LSB_357_360}, {application-record-element=DET_MTD_357, system-signal=DET_MTD_357}, {application-record-element=DET_MTD_358, system-signal=DET_MTD_358}, {application-record-element=DET_MTD_359, system-signal=DET_MTD_359}, {application-record-element=DET_MTD_360, system-signal=DET_MTD_360}, {application-record-element=DET_PROB_1STAZHYPO_357, system-signal=DET_PROB_1STAZHYPO_357}, {application-record-element=DET_PROB_1STAZHYPO_358, system-signal=DET_PROB_1STAZHYPO_358}, {application-record-element=DET_PROB_1STAZHYPO_359, system-signal=DET_PROB_1STAZHYPO_359}, {application-record-element=DET_PROB_1STAZHYPO_360, system-signal=DET_PROB_1STAZHYPO_360}, {application-record-element=DET_RANGE_357, system-signal=DET_RANGE_357}, {application-record-element=DET_RANGE_358, system-signal=DET_RANGE_358}, {application-record-element=DET_RANGE_359, system-signal=DET_RANGE_359}, {application-record-element=DET_RANGE_360, system-signal=DET_RANGE_360}, {application-record-element=DET_RANGE_ERR_357, system-signal=DET_RANGE_ERR_357}, {application-record-element=DET_RANGE_ERR_358, system-signal=DET_RANGE_ERR_358}, {application-record-element=DET_RANGE_ERR_359, system-signal=DET_RANGE_ERR_359}, {application-record-element=DET_RANGE_ERR_360, system-signal=DET_RANGE_ERR_360}, {application-record-element=DET_RANGE_VELOCITY_357, system-signal=DET_RANGE_VELOCITY_357}, {application-record-element=DET_RANGE_VELOCITY_358, system-signal=DET_RANGE_VELOCITY_358}, {application-record-element=DET_RANGE_VELOCITY_359, system-signal=DET_RANGE_VELOCITY_359}, {application-record-element=DET_RANGE_VELOCITY_360, system-signal=DET_RANGE_VELOCITY_360}, {application-record-element=DET_RANGE_VELOCITY_ERR_357, system-signal=DET_RANGE_VELOCITY_ERR_357}, {application-record-element=DET_RANGE_VELOCITY_ERR_358, system-signal=DET_RANGE_VELOCITY_ERR_358}, {application-record-element=DET_RANGE_VELOCITY_ERR_359, system-signal=DET_RANGE_VELOCITY_ERR_359}, {application-record-element=DET_RANGE_VELOCITY_ERR_360, system-signal=DET_RANGE_VELOCITY_ERR_360}, {application-record-element=DET_RCS_357, system-signal=DET_RCS_357}, {application-record-element=DET_RCS_358, system-signal=DET_RCS_358}, {application-record-element=DET_RCS_359, system-signal=DET_RCS_359}, {application-record-element=DET_RCS_360, system-signal=DET_RCS_360}, {application-record-element=DET_SNR_357, system-signal=DET_SNR_357}, {application-record-element=DET_SNR_358, system-signal=DET_SNR_358}, {application-record-element=DET_SNR_359, system-signal=DET_SNR_359}, {application-record-element=DET_SNR_360, system-signal=DET_SNR_360}, {application-record-element=DET_SUPER_RES_TARGET_357, system-signal=DET_SUPER_RES_TARGET_357}, {application-record-element=DET_SUPER_RES_TARGET_358, system-signal=DET_SUPER_RES_TARGET_358}, {application-record-element=DET_SUPER_RES_TARGET_359, system-signal=DET_SUPER_RES_TARGET_359}, {application-record-element=DET_SUPER_RES_TARGET_360, system-signal=DET_SUPER_RES_TARGET_360}]}
        sender-receiver-to-signal-group-mapping={data-element=COMPOSITIONTYPE.Pp_SG_Detections_361_364_AL.Vdp_SG_Detections_361_364_AL, signal-group=SG_Detections_361_364, type-mapping=sender-rec-record-type-mapping=record-element-mappings=[{application-record-element=DET_AZIMUTH_361, system-signal=DET_AZIMUTH_361}, {application-record-element=DET_AZIMUTH_362, system-signal=DET_AZIMUTH_362}, {application-record-element=DET_AZIMUTH_363, system-signal=DET_AZIMUTH_363}, {application-record-element=DET_AZIMUTH_364, system-signal=DET_AZIMUTH_364}, {application-record-element=DET_AZIMUTH_ERR_361, system-signal=DET_AZIMUTH_ERR_361}, {application-record-element=DET_AZIMUTH_ERR_362, system-signal=DET_AZIMUTH_ERR_362}, {application-record-element=DET_AZIMUTH_ERR_363, system-signal=DET_AZIMUTH_ERR_363}, {application-record-element=DET_AZIMUTH_ERR_364, system-signal=DET_AZIMUTH_ERR_364}, {application-record-element=DET_BELOW_RAIN_THOLD_361, system-signal=DET_BELOW_RAIN_THOLD_361}, {application-record-element=DET_BELOW_RAIN_THOLD_362, system-signal=DET_BELOW_RAIN_THOLD_362}, {application-record-element=DET_BELOW_RAIN_THOLD_363, system-signal=DET_BELOW_RAIN_THOLD_363}, {application-record-element=DET_BELOW_RAIN_THOLD_364, system-signal=DET_BELOW_RAIN_THOLD_364}, {application-record-element=DET_BI_STATIC_FLAG_361, system-signal=DET_BI_STATIC_FLAG_361}, {application-record-element=DET_BI_STATIC_FLAG_362, system-signal=DET_BI_STATIC_FLAG_362}, {application-record-element=DET_BI_STATIC_FLAG_363, system-signal=DET_BI_STATIC_FLAG_363}, {application-record-element=DET_BI_STATIC_FLAG_364, system-signal=DET_BI_STATIC_FLAG_364}, {application-record-element=DET_CONFD_AZIMUTH_361, system-signal=DET_CONFD_AZIMUTH_361}, {application-record-element=DET_CONFD_AZIMUTH_362, system-signal=DET_CONFD_AZIMUTH_362}, {application-record-element=DET_CONFD_AZIMUTH_363, system-signal=DET_CONFD_AZIMUTH_363}, {application-record-element=DET_CONFD_AZIMUTH_364, system-signal=DET_CONFD_AZIMUTH_364}, {application-record-element=DET_CONFD_ELEVATION_361, system-signal=DET_CONFD_ELEVATION_361}, {application-record-element=DET_CONFD_ELEVATION_362, system-signal=DET_CONFD_ELEVATION_362}, {application-record-element=DET_CONFD_ELEVATION_363, system-signal=DET_CONFD_ELEVATION_363}, {application-record-element=DET_CONFD_ELEVATION_364, system-signal=DET_CONFD_ELEVATION_364}, {application-record-element=DET_ELEVATION_361, system-signal=DET_ELEVATION_361}, {application-record-element=DET_ELEVATION_362, system-signal=DET_ELEVATION_362}, {application-record-element=DET_ELEVATION_363, system-signal=DET_ELEVATION_363}, {application-record-element=DET_ELEVATION_364, system-signal=DET_ELEVATION_364}, {application-record-element=DET_ELEVATION_ERR_361, system-signal=DET_ELEVATION_ERR_361}, {application-record-element=DET_ELEVATION_ERR_362, system-signal=DET_ELEVATION_ERR_362}, {application-record-element=DET_ELEVATION_ERR_363, system-signal=DET_ELEVATION_ERR_363}, {application-record-element=DET_ELEVATION_ERR_364, system-signal=DET_ELEVATION_ERR_364}, {application-record-element=DET_EXISTENCE_PROB_361, system-signal=DET_EXISTENCE_PROB_361}, {application-record-element=DET_EXISTENCE_PROB_362, system-signal=DET_EXISTENCE_PROB_362}, {application-record-element=DET_EXISTENCE_PROB_363, system-signal=DET_EXISTENCE_PROB_363}, {application-record-element=DET_EXISTENCE_PROB_364, system-signal=DET_EXISTENCE_PROB_364}, {application-record-element=DET_HVC_FLAG_361, system-signal=DET_HVC_FLAG_361}, {application-record-element=DET_HVC_FLAG_362, system-signal=DET_HVC_FLAG_362}, {application-record-element=DET_HVC_FLAG_363, system-signal=DET_HVC_FLAG_363}, {application-record-element=DET_HVC_FLAG_364, system-signal=DET_HVC_FLAG_364}, {application-record-element=DET_IDM_361, system-signal=DET_IDM_361}, {application-record-element=DET_IDM_362, system-signal=DET_IDM_362}, {application-record-element=DET_IDM_363, system-signal=DET_IDM_363}, {application-record-element=DET_IDM_364, system-signal=DET_IDM_364}, {application-record-element=DET_MH_CRC16_361_364, system-signal=DET_MH_CRC16_361_364}, {application-record-element=DET_MH_CYCLE_COUNTER_361_364, system-signal=DET_MH_CYCLE_COUNTER_361_364}, {application-record-element=DET_MH_SCAN_INDEX_4LSB_361_364, system-signal=DET_MH_SCAN_INDEX_4LSB_361_364}, {application-record-element=DET_MTD_361, system-signal=DET_MTD_361}, {application-record-element=DET_MTD_362, system-signal=DET_MTD_362}, {application-record-element=DET_MTD_363, system-signal=DET_MTD_363}, {application-record-element=DET_MTD_364, system-signal=DET_MTD_364}, {application-record-element=DET_PROB_1STAZHYPO_361, system-signal=DET_PROB_1STAZHYPO_361}, {application-record-element=DET_PROB_1STAZHYPO_362, system-signal=DET_PROB_1STAZHYPO_362}, {application-record-element=DET_PROB_1STAZHYPO_363, system-signal=DET_PROB_1STAZHYPO_363}, {application-record-element=DET_PROB_1STAZHYPO_364, system-signal=DET_PROB_1STAZHYPO_364}, {application-record-element=DET_RANGE_361, system-signal=DET_RANGE_361}, {application-record-element=DET_RANGE_362, system-signal=DET_RANGE_362}, {application-record-element=DET_RANGE_363, system-signal=DET_RANGE_363}, {application-record-element=DET_RANGE_364, system-signal=DET_RANGE_364}, {application-record-element=DET_RANGE_ERR_361, system-signal=DET_RANGE_ERR_361}, {application-record-element=DET_RANGE_ERR_362, system-signal=DET_RANGE_ERR_362}, {application-record-element=DET_RANGE_ERR_363, system-signal=DET_RANGE_ERR_363}, {application-record-element=DET_RANGE_ERR_364, system-signal=DET_RANGE_ERR_364}, {application-record-element=DET_RANGE_VELOCITY_361, system-signal=DET_RANGE_VELOCITY_361}, {application-record-element=DET_RANGE_VELOCITY_362, system-signal=DET_RANGE_VELOCITY_362}, {application-record-element=DET_RANGE_VELOCITY_363, system-signal=DET_RANGE_VELOCITY_363}, {application-record-element=DET_RANGE_VELOCITY_364, system-signal=DET_RANGE_VELOCITY_364}, {application-record-element=DET_RANGE_VELOCITY_ERR_361, system-signal=DET_RANGE_VELOCITY_ERR_361}, {application-record-element=DET_RANGE_VELOCITY_ERR_362, system-signal=DET_RANGE_VELOCITY_ERR_362}, {application-record-element=DET_RANGE_VELOCITY_ERR_363, system-signal=DET_RANGE_VELOCITY_ERR_363}, {application-record-element=DET_RANGE_VELOCITY_ERR_364, system-signal=DET_RANGE_VELOCITY_ERR_364}, {application-record-element=DET_RCS_361, system-signal=DET_RCS_361}, {application-record-element=DET_RCS_362, system-signal=DET_RCS_362}, {application-record-element=DET_RCS_363, system-signal=DET_RCS_363}, {application-record-element=DET_RCS_364, system-signal=DET_RCS_364}, {application-record-element=DET_SNR_361, system-signal=DET_SNR_361}, {application-record-element=DET_SNR_362, system-signal=DET_SNR_362}, {application-record-element=DET_SNR_363, system-signal=DET_SNR_363}, {application-record-element=DET_SNR_364, system-signal=DET_SNR_364}, {application-record-element=DET_SUPER_RES_TARGET_361, system-signal=DET_SUPER_RES_TARGET_361}, {application-record-element=DET_SUPER_RES_TARGET_362, system-signal=DET_SUPER_RES_TARGET_362}, {application-record-element=DET_SUPER_RES_TARGET_363, system-signal=DET_SUPER_RES_TARGET_363}, {application-record-element=DET_SUPER_RES_TARGET_364, system-signal=DET_SUPER_RES_TARGET_364}]}
        sender-receiver-to-signal-group-mapping={data-element=COMPOSITIONTYPE.Pp_SG_Detections_365_368_AL.Vdp_SG_Detections_365_368_AL, signal-group=SG_Detections_365_368, type-mapping=sender-rec-record-type-mapping=record-element-mappings=[{application-record-element=DET_AZIMUTH_365, system-signal=DET_AZIMUTH_365}, {application-record-element=DET_AZIMUTH_366, system-signal=DET_AZIMUTH_366}, {application-record-element=DET_AZIMUTH_367, system-signal=DET_AZIMUTH_367}, {application-record-element=DET_AZIMUTH_368, system-signal=DET_AZIMUTH_368}, {application-record-element=DET_AZIMUTH_ERR_365, system-signal=DET_AZIMUTH_ERR_365}, {application-record-element=DET_AZIMUTH_ERR_366, system-signal=DET_AZIMUTH_ERR_366}, {application-record-element=DET_AZIMUTH_ERR_367, system-signal=DET_AZIMUTH_ERR_367}, {application-record-element=DET_AZIMUTH_ERR_368, system-signal=DET_AZIMUTH_ERR_368}, {application-record-element=DET_BELOW_RAIN_THOLD_365, system-signal=DET_BELOW_RAIN_THOLD_365}, {application-record-element=DET_BELOW_RAIN_THOLD_366, system-signal=DET_BELOW_RAIN_THOLD_366}, {application-record-element=DET_BELOW_RAIN_THOLD_367, system-signal=DET_BELOW_RAIN_THOLD_367}, {application-record-element=DET_BELOW_RAIN_THOLD_368, system-signal=DET_BELOW_RAIN_THOLD_368}, {application-record-element=DET_BI_STATIC_FLAG_365, system-signal=DET_BI_STATIC_FLAG_365}, {application-record-element=DET_BI_STATIC_FLAG_366, system-signal=DET_BI_STATIC_FLAG_366}, {application-record-element=DET_BI_STATIC_FLAG_367, system-signal=DET_BI_STATIC_FLAG_367}, {application-record-element=DET_BI_STATIC_FLAG_368, system-signal=DET_BI_STATIC_FLAG_368}, {application-record-element=DET_CONFD_AZIMUTH_365, system-signal=DET_CONFD_AZIMUTH_365}, {application-record-element=DET_CONFD_AZIMUTH_366, system-signal=DET_CONFD_AZIMUTH_366}, {application-record-element=DET_CONFD_AZIMUTH_367, system-signal=DET_CONFD_AZIMUTH_367}, {application-record-element=DET_CONFD_AZIMUTH_368, system-signal=DET_CONFD_AZIMUTH_368}, {application-record-element=DET_CONFD_ELEVATION_365, system-signal=DET_CONFD_ELEVATION_365}, {application-record-element=DET_CONFD_ELEVATION_366, system-signal=DET_CONFD_ELEVATION_366}, {application-record-element=DET_CONFD_ELEVATION_367, system-signal=DET_CONFD_ELEVATION_367}, {application-record-element=DET_CONFD_ELEVATION_368, system-signal=DET_CONFD_ELEVATION_368}, {application-record-element=DET_ELEVATION_365, system-signal=DET_ELEVATION_365}, {application-record-element=DET_ELEVATION_366, system-signal=DET_ELEVATION_366}, {application-record-element=DET_ELEVATION_367, system-signal=DET_ELEVATION_367}, {application-record-element=DET_ELEVATION_368, system-signal=DET_ELEVATION_368}, {application-record-element=DET_ELEVATION_ERR_365, system-signal=DET_ELEVATION_ERR_365}, {application-record-element=DET_ELEVATION_ERR_366, system-signal=DET_ELEVATION_ERR_366}, {application-record-element=DET_ELEVATION_ERR_367, system-signal=DET_ELEVATION_ERR_367}, {application-record-element=DET_ELEVATION_ERR_368, system-signal=DET_ELEVATION_ERR_368}, {application-record-element=DET_EXISTENCE_PROB_365, system-signal=DET_EXISTENCE_PROB_365}, {application-record-element=DET_EXISTENCE_PROB_366, system-signal=DET_EXISTENCE_PROB_366}, {application-record-element=DET_EXISTENCE_PROB_367, system-signal=DET_EXISTENCE_PROB_367}, {application-record-element=DET_EXISTENCE_PROB_368, system-signal=DET_EXISTENCE_PROB_368}, {application-record-element=DET_HVC_FLAG_365, system-signal=DET_HVC_FLAG_365}, {application-record-element=DET_HVC_FLAG_366, system-signal=DET_HVC_FLAG_366}, {application-record-element=DET_HVC_FLAG_367, system-signal=DET_HVC_FLAG_367}, {application-record-element=DET_HVC_FLAG_368, system-signal=DET_HVC_FLAG_368}, {application-record-element=DET_IDM_365, system-signal=DET_IDM_365}, {application-record-element=DET_IDM_366, system-signal=DET_IDM_366}, {application-record-element=DET_IDM_367, system-signal=DET_IDM_367}, {application-record-element=DET_IDM_368, system-signal=DET_IDM_368}, {application-record-element=DET_MH_CRC16_365_368, system-signal=DET_MH_CRC16_365_368}, {application-record-element=DET_MH_CYCLE_COUNTER_365_368, system-signal=DET_MH_CYCLE_COUNTER_365_368}, {application-record-element=DET_MH_SCAN_INDEX_4LSB_365_368, system-signal=DET_MH_SCAN_INDEX_4LSB_365_368}, {application-record-element=DET_MTD_365, system-signal=DET_MTD_365}, {application-record-element=DET_MTD_366, system-signal=DET_MTD_366}, {application-record-element=DET_MTD_367, system-signal=DET_MTD_367}, {application-record-element=DET_MTD_368, system-signal=DET_MTD_368}, {application-record-element=DET_PROB_1STAZHYPO_365, system-signal=DET_PROB_1STAZHYPO_365}, {application-record-element=DET_PROB_1STAZHYPO_366, system-signal=DET_PROB_1STAZHYPO_366}, {application-record-element=DET_PROB_1STAZHYPO_367, system-signal=DET_PROB_1STAZHYPO_367}, {application-record-element=DET_PROB_1STAZHYPO_368, system-signal=DET_PROB_1STAZHYPO_368}, {application-record-element=DET_RANGE_365, system-signal=DET_RANGE_365}, {application-record-element=DET_RANGE_366, system-signal=DET_RANGE_366}, {application-record-element=DET_RANGE_367, system-signal=DET_RANGE_367}, {application-record-element=DET_RANGE_368, system-signal=DET_RANGE_368}, {application-record-element=DET_RANGE_ERR_365, system-signal=DET_RANGE_ERR_365}, {application-record-element=DET_RANGE_ERR_366, system-signal=DET_RANGE_ERR_366}, {application-record-element=DET_RANGE_ERR_367, system-signal=DET_RANGE_ERR_367}, {application-record-element=DET_RANGE_ERR_368, system-signal=DET_RANGE_ERR_368}, {application-record-element=DET_RANGE_VELOCITY_365, system-signal=DET_RANGE_VELOCITY_365}, {application-record-element=DET_RANGE_VELOCITY_366, system-signal=DET_RANGE_VELOCITY_366}, {application-record-element=DET_RANGE_VELOCITY_367, system-signal=DET_RANGE_VELOCITY_367}, {application-record-element=DET_RANGE_VELOCITY_368, system-signal=DET_RANGE_VELOCITY_368}, {application-record-element=DET_RANGE_VELOCITY_ERR_365, system-signal=DET_RANGE_VELOCITY_ERR_365}, {application-record-element=DET_RANGE_VELOCITY_ERR_366, system-signal=DET_RANGE_VELOCITY_ERR_366}, {application-record-element=DET_RANGE_VELOCITY_ERR_367, system-signal=DET_RANGE_VELOCITY_ERR_367}, {application-record-element=DET_RANGE_VELOCITY_ERR_368, system-signal=DET_RANGE_VELOCITY_ERR_368}, {application-record-element=DET_RCS_365, system-signal=DET_RCS_365}, {application-record-element=DET_RCS_366, system-signal=DET_RCS_366}, {application-record-element=DET_RCS_367, system-signal=DET_RCS_367}, {application-record-element=DET_RCS_368, system-signal=DET_RCS_368}, {application-record-element=DET_SNR_365, system-signal=DET_SNR_365}, {application-record-element=DET_SNR_366, system-signal=DET_SNR_366}, {application-record-element=DET_SNR_367, system-signal=DET_SNR_367}, {application-record-element=DET_SNR_368, system-signal=DET_SNR_368}, {application-record-element=DET_SUPER_RES_TARGET_365, system-signal=DET_SUPER_RES_TARGET_365}, {application-record-element=DET_SUPER_RES_TARGET_366, system-signal=DET_SUPER_RES_TARGET_366}, {application-record-element=DET_SUPER_RES_TARGET_367, system-signal=DET_SUPER_RES_TARGET_367}, {application-record-element=DET_SUPER_RES_TARGET_368, system-signal=DET_SUPER_RES_TARGET_368}]}
        sender-receiver-to-signal-group-mapping={data-element=COMPOSITIONTYPE.Pp_SG_Detections_369_372_AL.Vdp_SG_Detections_369_372_AL, signal-group=SG_Detections_369_372, type-mapping=sender-rec-record-type-mapping=record-element-mappings=[{application-record-element=DET_AZIMUTH_369, system-signal=DET_AZIMUTH_369}, {application-record-element=DET_AZIMUTH_370, system-signal=DET_AZIMUTH_370}, {application-record-element=DET_AZIMUTH_371, system-signal=DET_AZIMUTH_371}, {application-record-element=DET_AZIMUTH_372, system-signal=DET_AZIMUTH_372}, {application-record-element=DET_AZIMUTH_ERR_369, system-signal=DET_AZIMUTH_ERR_369}, {application-record-element=DET_AZIMUTH_ERR_370, system-signal=DET_AZIMUTH_ERR_370}, {application-record-element=DET_AZIMUTH_ERR_371, system-signal=DET_AZIMUTH_ERR_371}, {application-record-element=DET_AZIMUTH_ERR_372, system-signal=DET_AZIMUTH_ERR_372}, {application-record-element=DET_BELOW_RAIN_THOLD_369, system-signal=DET_BELOW_RAIN_THOLD_369}, {application-record-element=DET_BELOW_RAIN_THOLD_370, system-signal=DET_BELOW_RAIN_THOLD_370}, {application-record-element=DET_BELOW_RAIN_THOLD_371, system-signal=DET_BELOW_RAIN_THOLD_371}, {application-record-element=DET_BELOW_RAIN_THOLD_372, system-signal=DET_BELOW_RAIN_THOLD_372}, {application-record-element=DET_BI_STATIC_FLAG_369, system-signal=DET_BI_STATIC_FLAG_369}, {application-record-element=DET_BI_STATIC_FLAG_370, system-signal=DET_BI_STATIC_FLAG_370}, {application-record-element=DET_BI_STATIC_FLAG_371, system-signal=DET_BI_STATIC_FLAG_371}, {application-record-element=DET_BI_STATIC_FLAG_372, system-signal=DET_BI_STATIC_FLAG_372}, {application-record-element=DET_CONFD_AZIMUTH_369, system-signal=DET_CONFD_AZIMUTH_369}, {application-record-element=DET_CONFD_AZIMUTH_370, system-signal=DET_CONFD_AZIMUTH_370}, {application-record-element=DET_CONFD_AZIMUTH_371, system-signal=DET_CONFD_AZIMUTH_371}, {application-record-element=DET_CONFD_AZIMUTH_372, system-signal=DET_CONFD_AZIMUTH_372}, {application-record-element=DET_CONFD_ELEVATION_369, system-signal=DET_CONFD_ELEVATION_369}, {application-record-element=DET_CONFD_ELEVATION_370, system-signal=DET_CONFD_ELEVATION_370}, {application-record-element=DET_CONFD_ELEVATION_371, system-signal=DET_CONFD_ELEVATION_371}, {application-record-element=DET_CONFD_ELEVATION_372, system-signal=DET_CONFD_ELEVATION_372}, {application-record-element=DET_ELEVATION_369, system-signal=DET_ELEVATION_369}, {application-record-element=DET_ELEVATION_370, system-signal=DET_ELEVATION_370}, {application-record-element=DET_ELEVATION_371, system-signal=DET_ELEVATION_371}, {application-record-element=DET_ELEVATION_372, system-signal=DET_ELEVATION_372}, {application-record-element=DET_ELEVATION_ERR_369, system-signal=DET_ELEVATION_ERR_369}, {application-record-element=DET_ELEVATION_ERR_370, system-signal=DET_ELEVATION_ERR_370}, {application-record-element=DET_ELEVATION_ERR_371, system-signal=DET_ELEVATION_ERR_371}, {application-record-element=DET_ELEVATION_ERR_372, system-signal=DET_ELEVATION_ERR_372}, {application-record-element=DET_EXISTENCE_PROB_369, system-signal=DET_EXISTENCE_PROB_369}, {application-record-element=DET_EXISTENCE_PROB_370, system-signal=DET_EXISTENCE_PROB_370}, {application-record-element=DET_EXISTENCE_PROB_371, system-signal=DET_EXISTENCE_PROB_371}, {application-record-element=DET_EXISTENCE_PROB_372, system-signal=DET_EXISTENCE_PROB_372}, {application-record-element=DET_HVC_FLAG_369, system-signal=DET_HVC_FLAG_369}, {application-record-element=DET_HVC_FLAG_370, system-signal=DET_HVC_FLAG_370}, {application-record-element=DET_HVC_FLAG_371, system-signal=DET_HVC_FLAG_371}, {application-record-element=DET_HVC_FLAG_372, system-signal=DET_HVC_FLAG_372}, {application-record-element=DET_IDM_369, system-signal=DET_IDM_369}, {application-record-element=DET_IDM_370, system-signal=DET_IDM_370}, {application-record-element=DET_IDM_371, system-signal=DET_IDM_371}, {application-record-element=DET_IDM_372, system-signal=DET_IDM_372}, {application-record-element=DET_MH_CRC16_369_372, system-signal=DET_MH_CRC16_369_372}, {application-record-element=DET_MH_CYCLE_COUNTER_369_372, system-signal=DET_MH_CYCLE_COUNTER_369_372}, {application-record-element=DET_MH_SCAN_INDEX_4LSB_369_372, system-signal=DET_MH_SCAN_INDEX_4LSB_369_372}, {application-record-element=DET_MTD_369, system-signal=DET_MTD_369}, {application-record-element=DET_MTD_370, system-signal=DET_MTD_370}, {application-record-element=DET_MTD_371, system-signal=DET_MTD_371}, {application-record-element=DET_MTD_372, system-signal=DET_MTD_372}, {application-record-element=DET_PROB_1STAZHYPO_369, system-signal=DET_PROB_1STAZHYPO_369}, {application-record-element=DET_PROB_1STAZHYPO_370, system-signal=DET_PROB_1STAZHYPO_370}, {application-record-element=DET_PROB_1STAZHYPO_371, system-signal=DET_PROB_1STAZHYPO_371}, {application-record-element=DET_PROB_1STAZHYPO_372, system-signal=DET_PROB_1STAZHYPO_372}, {application-record-element=DET_RANGE_369, system-signal=DET_RANGE_369}, {application-record-element=DET_RANGE_370, system-signal=DET_RANGE_370}, {application-record-element=DET_RANGE_371, system-signal=DET_RANGE_371}, {application-record-element=DET_RANGE_372, system-signal=DET_RANGE_372}, {application-record-element=DET_RANGE_ERR_369, system-signal=DET_RANGE_ERR_369}, {application-record-element=DET_RANGE_ERR_370, system-signal=DET_RANGE_ERR_370}, {application-record-element=DET_RANGE_ERR_371, system-signal=DET_RANGE_ERR_371}, {application-record-element=DET_RANGE_ERR_372, system-signal=DET_RANGE_ERR_372}, {application-record-element=DET_RANGE_VELOCITY_369, system-signal=DET_RANGE_VELOCITY_369}, {application-record-element=DET_RANGE_VELOCITY_370, system-signal=DET_RANGE_VELOCITY_370}, {application-record-element=DET_RANGE_VELOCITY_371, system-signal=DET_RANGE_VELOCITY_371}, {application-record-element=DET_RANGE_VELOCITY_372, system-signal=DET_RANGE_VELOCITY_372}, {application-record-element=DET_RANGE_VELOCITY_ERR_369, system-signal=DET_RANGE_VELOCITY_ERR_369}, {application-record-element=DET_RANGE_VELOCITY_ERR_370, system-signal=DET_RANGE_VELOCITY_ERR_370}, {application-record-element=DET_RANGE_VELOCITY_ERR_371, system-signal=DET_RANGE_VELOCITY_ERR_371}, {application-record-element=DET_RANGE_VELOCITY_ERR_372, system-signal=DET_RANGE_VELOCITY_ERR_372}, {application-record-element=DET_RCS_369, system-signal=DET_RCS_369}, {application-record-element=DET_RCS_370, system-signal=DET_RCS_370}, {application-record-element=DET_RCS_371, system-signal=DET_RCS_371}, {application-record-element=DET_RCS_372, system-signal=DET_RCS_372}, {application-record-element=DET_SNR_369, system-signal=DET_SNR_369}, {application-record-element=DET_SNR_370, system-signal=DET_SNR_370}, {application-record-element=DET_SNR_371, system-signal=DET_SNR_371}, {application-record-element=DET_SNR_372, system-signal=DET_SNR_372}, {application-record-element=DET_SUPER_RES_TARGET_369, system-signal=DET_SUPER_RES_TARGET_369}, {application-record-element=DET_SUPER_RES_TARGET_370, system-signal=DET_SUPER_RES_TARGET_370}, {application-record-element=DET_SUPER_RES_TARGET_371, system-signal=DET_SUPER_RES_TARGET_371}, {application-record-element=DET_SUPER_RES_TARGET_372, system-signal=DET_SUPER_RES_TARGET_372}]}
        sender-receiver-to-signal-group-mapping={data-element=COMPOSITIONTYPE.Pp_SG_Detections_373_376_AL.Vdp_SG_Detections_373_376_AL, signal-group=SG_Detections_373_376, type-mapping=sender-rec-record-type-mapping=record-element-mappings=[{application-record-element=DET_AZIMUTH_373, system-signal=DET_AZIMUTH_373}, {application-record-element=DET_AZIMUTH_374, system-signal=DET_AZIMUTH_374}, {application-record-element=DET_AZIMUTH_375, system-signal=DET_AZIMUTH_375}, {application-record-element=DET_AZIMUTH_376, system-signal=DET_AZIMUTH_376}, {application-record-element=DET_AZIMUTH_ERR_373, system-signal=DET_AZIMUTH_ERR_373}, {application-record-element=DET_AZIMUTH_ERR_374, system-signal=DET_AZIMUTH_ERR_374}, {application-record-element=DET_AZIMUTH_ERR_375, system-signal=DET_AZIMUTH_ERR_375}, {application-record-element=DET_AZIMUTH_ERR_376, system-signal=DET_AZIMUTH_ERR_376}, {application-record-element=DET_BELOW_RAIN_THOLD_373, system-signal=DET_BELOW_RAIN_THOLD_373}, {application-record-element=DET_BELOW_RAIN_THOLD_374, system-signal=DET_BELOW_RAIN_THOLD_374}, {application-record-element=DET_BELOW_RAIN_THOLD_375, system-signal=DET_BELOW_RAIN_THOLD_375}, {application-record-element=DET_BELOW_RAIN_THOLD_376, system-signal=DET_BELOW_RAIN_THOLD_376}, {application-record-element=DET_BI_STATIC_FLAG_373, system-signal=DET_BI_STATIC_FLAG_373}, {application-record-element=DET_BI_STATIC_FLAG_374, system-signal=DET_BI_STATIC_FLAG_374}, {application-record-element=DET_BI_STATIC_FLAG_375, system-signal=DET_BI_STATIC_FLAG_375}, {application-record-element=DET_BI_STATIC_FLAG_376, system-signal=DET_BI_STATIC_FLAG_376}, {application-record-element=DET_CONFD_AZIMUTH_373, system-signal=DET_CONFD_AZIMUTH_373}, {application-record-element=DET_CONFD_AZIMUTH_374, system-signal=DET_CONFD_AZIMUTH_374}, {application-record-element=DET_CONFD_AZIMUTH_375, system-signal=DET_CONFD_AZIMUTH_375}, {application-record-element=DET_CONFD_AZIMUTH_376, system-signal=DET_CONFD_AZIMUTH_376}, {application-record-element=DET_CONFD_ELEVATION_373, system-signal=DET_CONFD_ELEVATION_373}, {application-record-element=DET_CONFD_ELEVATION_374, system-signal=DET_CONFD_ELEVATION_374}, {application-record-element=DET_CONFD_ELEVATION_375, system-signal=DET_CONFD_ELEVATION_375}, {application-record-element=DET_CONFD_ELEVATION_376, system-signal=DET_CONFD_ELEVATION_376}, {application-record-element=DET_ELEVATION_373, system-signal=DET_ELEVATION_373}, {application-record-element=DET_ELEVATION_374, system-signal=DET_ELEVATION_374}, {application-record-element=DET_ELEVATION_375, system-signal=DET_ELEVATION_375}, {application-record-element=DET_ELEVATION_376, system-signal=DET_ELEVATION_376}, {application-record-element=DET_ELEVATION_ERR_373, system-signal=DET_ELEVATION_ERR_373}, {application-record-element=DET_ELEVATION_ERR_374, system-signal=DET_ELEVATION_ERR_374}, {application-record-element=DET_ELEVATION_ERR_375, system-signal=DET_ELEVATION_ERR_375}, {application-record-element=DET_ELEVATION_ERR_376, system-signal=DET_ELEVATION_ERR_376}, {application-record-element=DET_EXISTENCE_PROB_373, system-signal=DET_EXISTENCE_PROB_373}, {application-record-element=DET_EXISTENCE_PROB_374, system-signal=DET_EXISTENCE_PROB_374}, {application-record-element=DET_EXISTENCE_PROB_375, system-signal=DET_EXISTENCE_PROB_375}, {application-record-element=DET_EXISTENCE_PROB_376, system-signal=DET_EXISTENCE_PROB_376}, {application-record-element=DET_HVC_FLAG_373, system-signal=DET_HVC_FLAG_373}, {application-record-element=DET_HVC_FLAG_374, system-signal=DET_HVC_FLAG_374}, {application-record-element=DET_HVC_FLAG_375, system-signal=DET_HVC_FLAG_375}, {application-record-element=DET_HVC_FLAG_376, system-signal=DET_HVC_FLAG_376}, {application-record-element=DET_IDM_373, system-signal=DET_IDM_373}, {application-record-element=DET_IDM_374, system-signal=DET_IDM_374}, {application-record-element=DET_IDM_375, system-signal=DET_IDM_375}, {application-record-element=DET_IDM_376, system-signal=DET_IDM_376}, {application-record-element=DET_MH_CRC16_373_376, system-signal=DET_MH_CRC16_373_376}, {application-record-element=DET_MH_CYCLE_COUNTER_373_376, system-signal=DET_MH_CYCLE_COUNTER_373_376}, {application-record-element=DET_MH_SCAN_INDEX_4LSB_373_376, system-signal=DET_MH_SCAN_INDEX_4LSB_373_376}, {application-record-element=DET_MTD_373, system-signal=DET_MTD_373}, {application-record-element=DET_MTD_374, system-signal=DET_MTD_374}, {application-record-element=DET_MTD_375, system-signal=DET_MTD_375}, {application-record-element=DET_MTD_376, system-signal=DET_MTD_376}, {application-record-element=DET_PROB_1STAZHYPO_373, system-signal=DET_PROB_1STAZHYPO_373}, {application-record-element=DET_PROB_1STAZHYPO_374, system-signal=DET_PROB_1STAZHYPO_374}, {application-record-element=DET_PROB_1STAZHYPO_375, system-signal=DET_PROB_1STAZHYPO_375}, {application-record-element=DET_PROB_1STAZHYPO_376, system-signal=DET_PROB_1STAZHYPO_376}, {application-record-element=DET_RANGE_373, system-signal=DET_RANGE_373}, {application-record-element=DET_RANGE_374, system-signal=DET_RANGE_374}, {application-record-element=DET_RANGE_375, system-signal=DET_RANGE_375}, {application-record-element=DET_RANGE_376, system-signal=DET_RANGE_376}, {application-record-element=DET_RANGE_ERR_373, system-signal=DET_RANGE_ERR_373}, {application-record-element=DET_RANGE_ERR_374, system-signal=DET_RANGE_ERR_374}, {application-record-element=DET_RANGE_ERR_375, system-signal=DET_RANGE_ERR_375}, {application-record-element=DET_RANGE_ERR_376, system-signal=DET_RANGE_ERR_376}, {application-record-element=DET_RANGE_VELOCITY_373, system-signal=DET_RANGE_VELOCITY_373}, {application-record-element=DET_RANGE_VELOCITY_374, system-signal=DET_RANGE_VELOCITY_374}, {application-record-element=DET_RANGE_VELOCITY_375, system-signal=DET_RANGE_VELOCITY_375}, {application-record-element=DET_RANGE_VELOCITY_376, system-signal=DET_RANGE_VELOCITY_376}, {application-record-element=DET_RANGE_VELOCITY_ERR_373, system-signal=DET_RANGE_VELOCITY_ERR_373}, {application-record-element=DET_RANGE_VELOCITY_ERR_374, system-signal=DET_RANGE_VELOCITY_ERR_374}, {application-record-element=DET_RANGE_VELOCITY_ERR_375, system-signal=DET_RANGE_VELOCITY_ERR_375}, {application-record-element=DET_RANGE_VELOCITY_ERR_376, system-signal=DET_RANGE_VELOCITY_ERR_376}, {application-record-element=DET_RCS_373, system-signal=DET_RCS_373}, {application-record-element=DET_RCS_374, system-signal=DET_RCS_374}, {application-record-element=DET_RCS_375, system-signal=DET_RCS_375}, {application-record-element=DET_RCS_376, system-signal=DET_RCS_376}, {application-record-element=DET_SNR_373, system-signal=DET_SNR_373}, {application-record-element=DET_SNR_374, system-signal=DET_SNR_374}, {application-record-element=DET_SNR_375, system-signal=DET_SNR_375}, {application-record-element=DET_SNR_376, system-signal=DET_SNR_376}, {application-record-element=DET_SUPER_RES_TARGET_373, system-signal=DET_SUPER_RES_TARGET_373}, {application-record-element=DET_SUPER_RES_TARGET_374, system-signal=DET_SUPER_RES_TARGET_374}, {application-record-element=DET_SUPER_RES_TARGET_375, system-signal=DET_SUPER_RES_TARGET_375}, {application-record-element=DET_SUPER_RES_TARGET_376, system-signal=DET_SUPER_RES_TARGET_376}]}
        sender-receiver-to-signal-group-mapping={data-element=COMPOSITIONTYPE.Pp_SG_Detections_377_380_AL.Vdp_SG_Detections_377_380_AL, signal-group=SG_Detections_377_380, type-mapping=sender-rec-record-type-mapping=record-element-mappings=[{application-record-element=DET_AZIMUTH_377, system-signal=DET_AZIMUTH_377}, {application-record-element=DET_AZIMUTH_378, system-signal=DET_AZIMUTH_378}, {application-record-element=DET_AZIMUTH_379, system-signal=DET_AZIMUTH_379}, {application-record-element=DET_AZIMUTH_380, system-signal=DET_AZIMUTH_380}, {application-record-element=DET_AZIMUTH_ERR_377, system-signal=DET_AZIMUTH_ERR_377}, {application-record-element=DET_AZIMUTH_ERR_378, system-signal=DET_AZIMUTH_ERR_378}, {application-record-element=DET_AZIMUTH_ERR_379, system-signal=DET_AZIMUTH_ERR_379}, {application-record-element=DET_AZIMUTH_ERR_380, system-signal=DET_AZIMUTH_ERR_380}, {application-record-element=DET_BELOW_RAIN_THOLD_377, system-signal=DET_BELOW_RAIN_THOLD_377}, {application-record-element=DET_BELOW_RAIN_THOLD_378, system-signal=DET_BELOW_RAIN_THOLD_378}, {application-record-element=DET_BELOW_RAIN_THOLD_379, system-signal=DET_BELOW_RAIN_THOLD_379}, {application-record-element=DET_BELOW_RAIN_THOLD_380, system-signal=DET_BELOW_RAIN_THOLD_380}, {application-record-element=DET_BI_STATIC_FLAG_377, system-signal=DET_BI_STATIC_FLAG_377}, {application-record-element=DET_BI_STATIC_FLAG_378, system-signal=DET_BI_STATIC_FLAG_378}, {application-record-element=DET_BI_STATIC_FLAG_379, system-signal=DET_BI_STATIC_FLAG_379}, {application-record-element=DET_BI_STATIC_FLAG_380, system-signal=DET_BI_STATIC_FLAG_380}, {application-record-element=DET_CONFD_AZIMUTH_377, system-signal=DET_CONFD_AZIMUTH_377}, {application-record-element=DET_CONFD_AZIMUTH_378, system-signal=DET_CONFD_AZIMUTH_378}, {application-record-element=DET_CONFD_AZIMUTH_379, system-signal=DET_CONFD_AZIMUTH_379}, {application-record-element=DET_CONFD_AZIMUTH_380, system-signal=DET_CONFD_AZIMUTH_380}, {application-record-element=DET_CONFD_ELEVATION_377, system-signal=DET_CONFD_ELEVATION_377}, {application-record-element=DET_CONFD_ELEVATION_378, system-signal=DET_CONFD_ELEVATION_378}, {application-record-element=DET_CONFD_ELEVATION_379, system-signal=DET_CONFD_ELEVATION_379}, {application-record-element=DET_CONFD_ELEVATION_380, system-signal=DET_CONFD_ELEVATION_380}, {application-record-element=DET_ELEVATION_377, system-signal=DET_ELEVATION_377}, {application-record-element=DET_ELEVATION_378, system-signal=DET_ELEVATION_378}, {application-record-element=DET_ELEVATION_379, system-signal=DET_ELEVATION_379}, {application-record-element=DET_ELEVATION_380, system-signal=DET_ELEVATION_380}, {application-record-element=DET_ELEVATION_ERR_377, system-signal=DET_ELEVATION_ERR_377}, {application-record-element=DET_ELEVATION_ERR_378, system-signal=DET_ELEVATION_ERR_378}, {application-record-element=DET_ELEVATION_ERR_379, system-signal=DET_ELEVATION_ERR_379}, {application-record-element=DET_ELEVATION_ERR_380, system-signal=DET_ELEVATION_ERR_380}, {application-record-element=DET_EXISTENCE_PROB_377, system-signal=DET_EXISTENCE_PROB_377}, {application-record-element=DET_EXISTENCE_PROB_378, system-signal=DET_EXISTENCE_PROB_378}, {application-record-element=DET_EXISTENCE_PROB_379, system-signal=DET_EXISTENCE_PROB_379}, {application-record-element=DET_EXISTENCE_PROB_380, system-signal=DET_EXISTENCE_PROB_380}, {application-record-element=DET_HVC_FLAG_377, system-signal=DET_HVC_FLAG_377}, {application-record-element=DET_HVC_FLAG_378, system-signal=DET_HVC_FLAG_378}, {application-record-element=DET_HVC_FLAG_379, system-signal=DET_HVC_FLAG_379}, {application-record-element=DET_HVC_FLAG_380, system-signal=DET_HVC_FLAG_380}, {application-record-element=DET_IDM_377, system-signal=DET_IDM_377}, {application-record-element=DET_IDM_378, system-signal=DET_IDM_378}, {application-record-element=DET_IDM_379, system-signal=DET_IDM_379}, {application-record-element=DET_IDM_380, system-signal=DET_IDM_380}, {application-record-element=DET_MH_CRC16_377_380, system-signal=DET_MH_CRC16_377_380}, {application-record-element=DET_MH_CYCLE_COUNTER_377_380, system-signal=DET_MH_CYCLE_COUNTER_377_380}, {application-record-element=DET_MH_SCAN_INDEX_4LSB_377_380, system-signal=DET_MH_SCAN_INDEX_4LSB_377_380}, {application-record-element=DET_MTD_377, system-signal=DET_MTD_377}, {application-record-element=DET_MTD_378, system-signal=DET_MTD_378}, {application-record-element=DET_MTD_379, system-signal=DET_MTD_379}, {application-record-element=DET_MTD_380, system-signal=DET_MTD_380}, {application-record-element=DET_PROB_1STAZHYPO_377, system-signal=DET_PROB_1STAZHYPO_377}, {application-record-element=DET_PROB_1STAZHYPO_378, system-signal=DET_PROB_1STAZHYPO_378}, {application-record-element=DET_PROB_1STAZHYPO_379, system-signal=DET_PROB_1STAZHYPO_379}, {application-record-element=DET_PROB_1STAZHYPO_380, system-signal=DET_PROB_1STAZHYPO_380}, {application-record-element=DET_RANGE_377, system-signal=DET_RANGE_377}, {application-record-element=DET_RANGE_378, system-signal=DET_RANGE_378}, {application-record-element=DET_RANGE_379, system-signal=DET_RANGE_379}, {application-record-element=DET_RANGE_380, system-signal=DET_RANGE_380}, {application-record-element=DET_RANGE_ERR_377, system-signal=DET_RANGE_ERR_377}, {application-record-element=DET_RANGE_ERR_378, system-signal=DET_RANGE_ERR_378}, {application-record-element=DET_RANGE_ERR_379, system-signal=DET_RANGE_ERR_379}, {application-record-element=DET_RANGE_ERR_380, system-signal=DET_RANGE_ERR_380}, {application-record-element=DET_RANGE_VELOCITY_377, system-signal=DET_RANGE_VELOCITY_377}, {application-record-element=DET_RANGE_VELOCITY_378, system-signal=DET_RANGE_VELOCITY_378}, {application-record-element=DET_RANGE_VELOCITY_379, system-signal=DET_RANGE_VELOCITY_379}, {application-record-element=DET_RANGE_VELOCITY_380, system-signal=DET_RANGE_VELOCITY_380}, {application-record-element=DET_RANGE_VELOCITY_ERR_377, system-signal=DET_RANGE_VELOCITY_ERR_377}, {application-record-element=DET_RANGE_VELOCITY_ERR_378, system-signal=DET_RANGE_VELOCITY_ERR_378}, {application-record-element=DET_RANGE_VELOCITY_ERR_379, system-signal=DET_RANGE_VELOCITY_ERR_379}, {application-record-element=DET_RANGE_VELOCITY_ERR_380, system-signal=DET_RANGE_VELOCITY_ERR_380}, {application-record-element=DET_RCS_377, system-signal=DET_RCS_377}, {application-record-element=DET_RCS_378, system-signal=DET_RCS_378}, {application-record-element=DET_RCS_379, system-signal=DET_RCS_379}, {application-record-element=DET_RCS_380, system-signal=DET_RCS_380}, {application-record-element=DET_SNR_377, system-signal=DET_SNR_377}, {application-record-element=DET_SNR_378, system-signal=DET_SNR_378}, {application-record-element=DET_SNR_379, system-signal=DET_SNR_379}, {application-record-element=DET_SNR_380, system-signal=DET_SNR_380}, {application-record-element=DET_SUPER_RES_TARGET_377, system-signal=DET_SUPER_RES_TARGET_377}, {application-record-element=DET_SUPER_RES_TARGET_378, system-signal=DET_SUPER_RES_TARGET_378}, {application-record-element=DET_SUPER_RES_TARGET_379, system-signal=DET_SUPER_RES_TARGET_379}, {application-record-element=DET_SUPER_RES_TARGET_380, system-signal=DET_SUPER_RES_TARGET_380}]}
        sender-receiver-to-signal-group-mapping={data-element=COMPOSITIONTYPE.Pp_SG_Detections_381_384_AL.Vdp_SG_Detections_381_384_AL, signal-group=SG_Detections_381_384, type-mapping=sender-rec-record-type-mapping=record-element-mappings=[{application-record-element=DET_AZIMUTH_381, system-signal=DET_AZIMUTH_381}, {application-record-element=DET_AZIMUTH_382, system-signal=DET_AZIMUTH_382}, {application-record-element=DET_AZIMUTH_383, system-signal=DET_AZIMUTH_383}, {application-record-element=DET_AZIMUTH_384, system-signal=DET_AZIMUTH_384}, {application-record-element=DET_AZIMUTH_ERR_381, system-signal=DET_AZIMUTH_ERR_381}, {application-record-element=DET_AZIMUTH_ERR_382, system-signal=DET_AZIMUTH_ERR_382}, {application-record-element=DET_AZIMUTH_ERR_383, system-signal=DET_AZIMUTH_ERR_383}, {application-record-element=DET_AZIMUTH_ERR_384, system-signal=DET_AZIMUTH_ERR_384}, {application-record-element=DET_BELOW_RAIN_THOLD_381, system-signal=DET_BELOW_RAIN_THOLD_381}, {application-record-element=DET_BELOW_RAIN_THOLD_382, system-signal=DET_BELOW_RAIN_THOLD_382}, {application-record-element=DET_BELOW_RAIN_THOLD_383, system-signal=DET_BELOW_RAIN_THOLD_383}, {application-record-element=DET_BELOW_RAIN_THOLD_384, system-signal=DET_BELOW_RAIN_THOLD_384}, {application-record-element=DET_BI_STATIC_FLAG_381, system-signal=DET_BI_STATIC_FLAG_381}, {application-record-element=DET_BI_STATIC_FLAG_382, system-signal=DET_BI_STATIC_FLAG_382}, {application-record-element=DET_BI_STATIC_FLAG_383, system-signal=DET_BI_STATIC_FLAG_383}, {application-record-element=DET_BI_STATIC_FLAG_384, system-signal=DET_BI_STATIC_FLAG_384}, {application-record-element=DET_CONFD_AZIMUTH_381, system-signal=DET_CONFD_AZIMUTH_381}, {application-record-element=DET_CONFD_AZIMUTH_382, system-signal=DET_CONFD_AZIMUTH_382}, {application-record-element=DET_CONFD_AZIMUTH_383, system-signal=DET_CONFD_AZIMUTH_383}, {application-record-element=DET_CONFD_AZIMUTH_384, system-signal=DET_CONFD_AZIMUTH_384}, {application-record-element=DET_CONFD_ELEVATION_381, system-signal=DET_CONFD_ELEVATION_381}, {application-record-element=DET_CONFD_ELEVATION_382, system-signal=DET_CONFD_ELEVATION_382}, {application-record-element=DET_CONFD_ELEVATION_383, system-signal=DET_CONFD_ELEVATION_383}, {application-record-element=DET_CONFD_ELEVATION_384, system-signal=DET_CONFD_ELEVATION_384}, {application-record-element=DET_ELEVATION_381, system-signal=DET_ELEVATION_381}, {application-record-element=DET_ELEVATION_382, system-signal=DET_ELEVATION_382}, {application-record-element=DET_ELEVATION_383, system-signal=DET_ELEVATION_383}, {application-record-element=DET_ELEVATION_384, system-signal=DET_ELEVATION_384}, {application-record-element=DET_ELEVATION_ERR_381, system-signal=DET_ELEVATION_ERR_381}, {application-record-element=DET_ELEVATION_ERR_382, system-signal=DET_ELEVATION_ERR_382}, {application-record-element=DET_ELEVATION_ERR_383, system-signal=DET_ELEVATION_ERR_383}, {application-record-element=DET_ELEVATION_ERR_384, system-signal=DET_ELEVATION_ERR_384}, {application-record-element=DET_EXISTENCE_PROB_381, system-signal=DET_EXISTENCE_PROB_381}, {application-record-element=DET_EXISTENCE_PROB_382, system-signal=DET_EXISTENCE_PROB_382}, {application-record-element=DET_EXISTENCE_PROB_383, system-signal=DET_EXISTENCE_PROB_383}, {application-record-element=DET_EXISTENCE_PROB_384, system-signal=DET_EXISTENCE_PROB_384}, {application-record-element=DET_HVC_FLAG_381, system-signal=DET_HVC_FLAG_381}, {application-record-element=DET_HVC_FLAG_382, system-signal=DET_HVC_FLAG_382}, {application-record-element=DET_HVC_FLAG_383, system-signal=DET_HVC_FLAG_383}, {application-record-element=DET_HVC_FLAG_384, system-signal=DET_HVC_FLAG_384}, {application-record-element=DET_IDM_381, system-signal=DET_IDM_381}, {application-record-element=DET_IDM_382, system-signal=DET_IDM_382}, {application-record-element=DET_IDM_383, system-signal=DET_IDM_383}, {application-record-element=DET_IDM_384, system-signal=DET_IDM_384}, {application-record-element=DET_MH_CRC16_381_384, system-signal=DET_MH_CRC16_381_384}, {application-record-element=DET_MH_CYCLE_COUNTER_381_384, system-signal=DET_MH_CYCLE_COUNTER_381_384}, {application-record-element=DET_MH_SCAN_INDEX_4LSB_381_384, system-signal=DET_MH_SCAN_INDEX_4LSB_381_384}, {application-record-element=DET_MTD_381, system-signal=DET_MTD_381}, {application-record-element=DET_MTD_382, system-signal=DET_MTD_382}, {application-record-element=DET_MTD_383, system-signal=DET_MTD_383}, {application-record-element=DET_MTD_384, system-signal=DET_MTD_384}, {application-record-element=DET_PROB_1STAZHYPO_381, system-signal=DET_PROB_1STAZHYPO_381}, {application-record-element=DET_PROB_1STAZHYPO_382, system-signal=DET_PROB_1STAZHYPO_382}, {application-record-element=DET_PROB_1STAZHYPO_383, system-signal=DET_PROB_1STAZHYPO_383}, {application-record-element=DET_PROB_1STAZHYPO_384, system-signal=DET_PROB_1STAZHYPO_384}, {application-record-element=DET_RANGE_381, system-signal=DET_RANGE_381}, {application-record-element=DET_RANGE_382, system-signal=DET_RANGE_382}, {application-record-element=DET_RANGE_383, system-signal=DET_RANGE_383}, {application-record-element=DET_RANGE_384, system-signal=DET_RANGE_384}, {application-record-element=DET_RANGE_ERR_381, system-signal=DET_RANGE_ERR_381}, {application-record-element=DET_RANGE_ERR_382, system-signal=DET_RANGE_ERR_382}, {application-record-element=DET_RANGE_ERR_383, system-signal=DET_RANGE_ERR_383}, {application-record-element=DET_RANGE_ERR_384, system-signal=DET_RANGE_ERR_384}, {application-record-element=DET_RANGE_VELOCITY_381, system-signal=DET_RANGE_VELOCITY_381}, {application-record-element=DET_RANGE_VELOCITY_382, system-signal=DET_RANGE_VELOCITY_382}, {application-record-element=DET_RANGE_VELOCITY_383, system-signal=DET_RANGE_VELOCITY_383}, {application-record-element=DET_RANGE_VELOCITY_384, system-signal=DET_RANGE_VELOCITY_384}, {application-record-element=DET_RANGE_VELOCITY_ERR_381, system-signal=DET_RANGE_VELOCITY_ERR_381}, {application-record-element=DET_RANGE_VELOCITY_ERR_382, system-signal=DET_RANGE_VELOCITY_ERR_382}, {application-record-element=DET_RANGE_VELOCITY_ERR_383, system-signal=DET_RANGE_VELOCITY_ERR_383}, {application-record-element=DET_RANGE_VELOCITY_ERR_384, system-signal=DET_RANGE_VELOCITY_ERR_384}, {application-record-element=DET_RCS_381, system-signal=DET_RCS_381}, {application-record-element=DET_RCS_382, system-signal=DET_RCS_382}, {application-record-element=DET_RCS_383, system-signal=DET_RCS_383}, {application-record-element=DET_RCS_384, system-signal=DET_RCS_384}, {application-record-element=DET_SNR_381, system-signal=DET_SNR_381}, {application-record-element=DET_SNR_382, system-signal=DET_SNR_382}, {application-record-element=DET_SNR_383, system-signal=DET_SNR_383}, {application-record-element=DET_SNR_384, system-signal=DET_SNR_384}, {application-record-element=DET_SUPER_RES_TARGET_381, system-signal=DET_SUPER_RES_TARGET_381}, {application-record-element=DET_SUPER_RES_TARGET_382, system-signal=DET_SUPER_RES_TARGET_382}, {application-record-element=DET_SUPER_RES_TARGET_383, system-signal=DET_SUPER_RES_TARGET_383}, {application-record-element=DET_SUPER_RES_TARGET_384, system-signal=DET_SUPER_RES_TARGET_384}]}
        sender-receiver-to-signal-group-mapping={data-element=COMPOSITIONTYPE.Pp_SG_Detections_385_388_AL.Vdp_SG_Detections_385_388_AL, signal-group=SG_Detections_385_388, type-mapping=sender-rec-record-type-mapping=record-element-mappings=[{application-record-element=DET_AZIMUTH_385, system-signal=DET_AZIMUTH_385}, {application-record-element=DET_AZIMUTH_386, system-signal=DET_AZIMUTH_386}, {application-record-element=DET_AZIMUTH_387, system-signal=DET_AZIMUTH_387}, {application-record-element=DET_AZIMUTH_388, system-signal=DET_AZIMUTH_388}, {application-record-element=DET_AZIMUTH_ERR_385, system-signal=DET_AZIMUTH_ERR_385}, {application-record-element=DET_AZIMUTH_ERR_386, system-signal=DET_AZIMUTH_ERR_386}, {application-record-element=DET_AZIMUTH_ERR_387, system-signal=DET_AZIMUTH_ERR_387}, {application-record-element=DET_AZIMUTH_ERR_388, system-signal=DET_AZIMUTH_ERR_388}, {application-record-element=DET_BELOW_RAIN_THOLD_385, system-signal=DET_BELOW_RAIN_THOLD_385}, {application-record-element=DET_BELOW_RAIN_THOLD_386, system-signal=DET_BELOW_RAIN_THOLD_386}, {application-record-element=DET_BELOW_RAIN_THOLD_387, system-signal=DET_BELOW_RAIN_THOLD_387}, {application-record-element=DET_BELOW_RAIN_THOLD_388, system-signal=DET_BELOW_RAIN_THOLD_388}, {application-record-element=DET_BI_STATIC_FLAG_385, system-signal=DET_BI_STATIC_FLAG_385}, {application-record-element=DET_BI_STATIC_FLAG_386, system-signal=DET_BI_STATIC_FLAG_386}, {application-record-element=DET_BI_STATIC_FLAG_387, system-signal=DET_BI_STATIC_FLAG_387}, {application-record-element=DET_BI_STATIC_FLAG_388, system-signal=DET_BI_STATIC_FLAG_388}, {application-record-element=DET_CONFD_AZIMUTH_385, system-signal=DET_CONFD_AZIMUTH_385}, {application-record-element=DET_CONFD_AZIMUTH_386, system-signal=DET_CONFD_AZIMUTH_386}, {application-record-element=DET_CONFD_AZIMUTH_387, system-signal=DET_CONFD_AZIMUTH_387}, {application-record-element=DET_CONFD_AZIMUTH_388, system-signal=DET_CONFD_AZIMUTH_388}, {application-record-element=DET_CONFD_ELEVATION_385, system-signal=DET_CONFD_ELEVATION_385}, {application-record-element=DET_CONFD_ELEVATION_386, system-signal=DET_CONFD_ELEVATION_386}, {application-record-element=DET_CONFD_ELEVATION_387, system-signal=DET_CONFD_ELEVATION_387}, {application-record-element=DET_CONFD_ELEVATION_388, system-signal=DET_CONFD_ELEVATION_388}, {application-record-element=DET_ELEVATION_385, system-signal=DET_ELEVATION_385}, {application-record-element=DET_ELEVATION_386, system-signal=DET_ELEVATION_386}, {application-record-element=DET_ELEVATION_387, system-signal=DET_ELEVATION_387}, {application-record-element=DET_ELEVATION_388, system-signal=DET_ELEVATION_388}, {application-record-element=DET_ELEVATION_ERR_385, system-signal=DET_ELEVATION_ERR_385}, {application-record-element=DET_ELEVATION_ERR_386, system-signal=DET_ELEVATION_ERR_386}, {application-record-element=DET_ELEVATION_ERR_387, system-signal=DET_ELEVATION_ERR_387}, {application-record-element=DET_ELEVATION_ERR_388, system-signal=DET_ELEVATION_ERR_388}, {application-record-element=DET_EXISTENCE_PROB_385, system-signal=DET_EXISTENCE_PROB_385}, {application-record-element=DET_EXISTENCE_PROB_386, system-signal=DET_EXISTENCE_PROB_386}, {application-record-element=DET_EXISTENCE_PROB_387, system-signal=DET_EXISTENCE_PROB_387}, {application-record-element=DET_EXISTENCE_PROB_388, system-signal=DET_EXISTENCE_PROB_388}, {application-record-element=DET_HVC_FLAG_385, system-signal=DET_HVC_FLAG_385}, {application-record-element=DET_HVC_FLAG_386, system-signal=DET_HVC_FLAG_386}, {application-record-element=DET_HVC_FLAG_387, system-signal=DET_HVC_FLAG_387}, {application-record-element=DET_HVC_FLAG_388, system-signal=DET_HVC_FLAG_388}, {application-record-element=DET_IDM_385, system-signal=DET_IDM_385}, {application-record-element=DET_IDM_386, system-signal=DET_IDM_386}, {application-record-element=DET_IDM_387, system-signal=DET_IDM_387}, {application-record-element=DET_IDM_388, system-signal=DET_IDM_388}, {application-record-element=DET_MH_CRC16_385_388, system-signal=DET_MH_CRC16_385_388}, {application-record-element=DET_MH_CYCLE_COUNTER_385_388, system-signal=DET_MH_CYCLE_COUNTER_385_388}, {application-record-element=DET_MH_SCAN_INDEX_4LSB_385_388, system-signal=DET_MH_SCAN_INDEX_4LSB_385_388}, {application-record-element=DET_MTD_385, system-signal=DET_MTD_385}, {application-record-element=DET_MTD_386, system-signal=DET_MTD_386}, {application-record-element=DET_MTD_387, system-signal=DET_MTD_387}, {application-record-element=DET_MTD_388, system-signal=DET_MTD_388}, {application-record-element=DET_PROB_1STAZHYPO_385, system-signal=DET_PROB_1STAZHYPO_385}, {application-record-element=DET_PROB_1STAZHYPO_386, system-signal=DET_PROB_1STAZHYPO_386}, {application-record-element=DET_PROB_1STAZHYPO_387, system-signal=DET_PROB_1STAZHYPO_387}, {application-record-element=DET_PROB_1STAZHYPO_388, system-signal=DET_PROB_1STAZHYPO_388}, {application-record-element=DET_RANGE_385, system-signal=DET_RANGE_385}, {application-record-element=DET_RANGE_386, system-signal=DET_RANGE_386}, {application-record-element=DET_RANGE_387, system-signal=DET_RANGE_387}, {application-record-element=DET_RANGE_388, system-signal=DET_RANGE_388}, {application-record-element=DET_RANGE_ERR_385, system-signal=DET_RANGE_ERR_385}, {application-record-element=DET_RANGE_ERR_386, system-signal=DET_RANGE_ERR_386}, {application-record-element=DET_RANGE_ERR_387, system-signal=DET_RANGE_ERR_387}, {application-record-element=DET_RANGE_ERR_388, system-signal=DET_RANGE_ERR_388}, {application-record-element=DET_RANGE_VELOCITY_385, system-signal=DET_RANGE_VELOCITY_385}, {application-record-element=DET_RANGE_VELOCITY_386, system-signal=DET_RANGE_VELOCITY_386}, {application-record-element=DET_RANGE_VELOCITY_387, system-signal=DET_RANGE_VELOCITY_387}, {application-record-element=DET_RANGE_VELOCITY_388, system-signal=DET_RANGE_VELOCITY_388}, {application-record-element=DET_RANGE_VELOCITY_ERR_385, system-signal=DET_RANGE_VELOCITY_ERR_385}, {application-record-element=DET_RANGE_VELOCITY_ERR_386, system-signal=DET_RANGE_VELOCITY_ERR_386}, {application-record-element=DET_RANGE_VELOCITY_ERR_387, system-signal=DET_RANGE_VELOCITY_ERR_387}, {application-record-element=DET_RANGE_VELOCITY_ERR_388, system-signal=DET_RANGE_VELOCITY_ERR_388}, {application-record-element=DET_RCS_385, system-signal=DET_RCS_385}, {application-record-element=DET_RCS_386, system-signal=DET_RCS_386}, {application-record-element=DET_RCS_387, system-signal=DET_RCS_387}, {application-record-element=DET_RCS_388, system-signal=DET_RCS_388}, {application-record-element=DET_SNR_385, system-signal=DET_SNR_385}, {application-record-element=DET_SNR_386, system-signal=DET_SNR_386}, {application-record-element=DET_SNR_387, system-signal=DET_SNR_387}, {application-record-element=DET_SNR_388, system-signal=DET_SNR_388}, {application-record-element=DET_SUPER_RES_TARGET_385, system-signal=DET_SUPER_RES_TARGET_385}, {application-record-element=DET_SUPER_RES_TARGET_386, system-signal=DET_SUPER_RES_TARGET_386}, {application-record-element=DET_SUPER_RES_TARGET_387, system-signal=DET_SUPER_RES_TARGET_387}, {application-record-element=DET_SUPER_RES_TARGET_388, system-signal=DET_SUPER_RES_TARGET_388}]}
        sender-receiver-to-signal-group-mapping={data-element=COMPOSITIONTYPE.Pp_SG_Detections_389_392_AL.Vdp_SG_Detections_389_392_AL, signal-group=SG_Detections_389_392, type-mapping=sender-rec-record-type-mapping=record-element-mappings=[{application-record-element=DET_AZIMUTH_389, system-signal=DET_AZIMUTH_389}, {application-record-element=DET_AZIMUTH_390, system-signal=DET_AZIMUTH_390}, {application-record-element=DET_AZIMUTH_391, system-signal=DET_AZIMUTH_391}, {application-record-element=DET_AZIMUTH_392, system-signal=DET_AZIMUTH_392}, {application-record-element=DET_AZIMUTH_ERR_389, system-signal=DET_AZIMUTH_ERR_389}, {application-record-element=DET_AZIMUTH_ERR_390, system-signal=DET_AZIMUTH_ERR_390}, {application-record-element=DET_AZIMUTH_ERR_391, system-signal=DET_AZIMUTH_ERR_391}, {application-record-element=DET_AZIMUTH_ERR_392, system-signal=DET_AZIMUTH_ERR_392}, {application-record-element=DET_BELOW_RAIN_THOLD_389, system-signal=DET_BELOW_RAIN_THOLD_389}, {application-record-element=DET_BELOW_RAIN_THOLD_390, system-signal=DET_BELOW_RAIN_THOLD_390}, {application-record-element=DET_BELOW_RAIN_THOLD_391, system-signal=DET_BELOW_RAIN_THOLD_391}, {application-record-element=DET_BELOW_RAIN_THOLD_392, system-signal=DET_BELOW_RAIN_THOLD_392}, {application-record-element=DET_BI_STATIC_FLAG_389, system-signal=DET_BI_STATIC_FLAG_389}, {application-record-element=DET_BI_STATIC_FLAG_390, system-signal=DET_BI_STATIC_FLAG_390}, {application-record-element=DET_BI_STATIC_FLAG_391, system-signal=DET_BI_STATIC_FLAG_391}, {application-record-element=DET_BI_STATIC_FLAG_392, system-signal=DET_BI_STATIC_FLAG_392}, {application-record-element=DET_CONFD_AZIMUTH_389, system-signal=DET_CONFD_AZIMUTH_389}, {application-record-element=DET_CONFD_AZIMUTH_390, system-signal=DET_CONFD_AZIMUTH_390}, {application-record-element=DET_CONFD_AZIMUTH_391, system-signal=DET_CONFD_AZIMUTH_391}, {application-record-element=DET_CONFD_AZIMUTH_392, system-signal=DET_CONFD_AZIMUTH_392}, {application-record-element=DET_CONFD_ELEVATION_389, system-signal=DET_CONFD_ELEVATION_389}, {application-record-element=DET_CONFD_ELEVATION_390, system-signal=DET_CONFD_ELEVATION_390}, {application-record-element=DET_CONFD_ELEVATION_391, system-signal=DET_CONFD_ELEVATION_391}, {application-record-element=DET_CONFD_ELEVATION_392, system-signal=DET_CONFD_ELEVATION_392}, {application-record-element=DET_ELEVATION_389, system-signal=DET_ELEVATION_389}, {application-record-element=DET_ELEVATION_390, system-signal=DET_ELEVATION_390}, {application-record-element=DET_ELEVATION_391, system-signal=DET_ELEVATION_391}, {application-record-element=DET_ELEVATION_392, system-signal=DET_ELEVATION_392}, {application-record-element=DET_ELEVATION_ERR_389, system-signal=DET_ELEVATION_ERR_389}, {application-record-element=DET_ELEVATION_ERR_390, system-signal=DET_ELEVATION_ERR_390}, {application-record-element=DET_ELEVATION_ERR_391, system-signal=DET_ELEVATION_ERR_391}, {application-record-element=DET_ELEVATION_ERR_392, system-signal=DET_ELEVATION_ERR_392}, {application-record-element=DET_EXISTENCE_PROB_389, system-signal=DET_EXISTENCE_PROB_389}, {application-record-element=DET_EXISTENCE_PROB_390, system-signal=DET_EXISTENCE_PROB_390}, {application-record-element=DET_EXISTENCE_PROB_391, system-signal=DET_EXISTENCE_PROB_391}, {application-record-element=DET_EXISTENCE_PROB_392, system-signal=DET_EXISTENCE_PROB_392}, {application-record-element=DET_HVC_FLAG_389, system-signal=DET_HVC_FLAG_389}, {application-record-element=DET_HVC_FLAG_390, system-signal=DET_HVC_FLAG_390}, {application-record-element=DET_HVC_FLAG_391, system-signal=DET_HVC_FLAG_391}, {application-record-element=DET_HVC_FLAG_392, system-signal=DET_HVC_FLAG_392}, {application-record-element=DET_IDM_389, system-signal=DET_IDM_389}, {application-record-element=DET_IDM_390, system-signal=DET_IDM_390}, {application-record-element=DET_IDM_391, system-signal=DET_IDM_391}, {application-record-element=DET_IDM_392, system-signal=DET_IDM_392}, {application-record-element=DET_MH_CRC16_389_392, system-signal=DET_MH_CRC16_389_392}, {application-record-element=DET_MH_CYCLE_COUNTER_389_392, system-signal=DET_MH_CYCLE_COUNTER_389_392}, {application-record-element=DET_MH_SCAN_INDEX_4LSB_389_392, system-signal=DET_MH_SCAN_INDEX_4LSB_389_392}, {application-record-element=DET_MTD_389, system-signal=DET_MTD_389}, {application-record-element=DET_MTD_390, system-signal=DET_MTD_390}, {application-record-element=DET_MTD_391, system-signal=DET_MTD_391}, {application-record-element=DET_MTD_392, system-signal=DET_MTD_392}, {application-record-element=DET_PROB_1STAZHYPO_389, system-signal=DET_PROB_1STAZHYPO_389}, {application-record-element=DET_PROB_1STAZHYPO_390, system-signal=DET_PROB_1STAZHYPO_390}, {application-record-element=DET_PROB_1STAZHYPO_391, system-signal=DET_PROB_1STAZHYPO_391}, {application-record-element=DET_PROB_1STAZHYPO_392, system-signal=DET_PROB_1STAZHYPO_392}, {application-record-element=DET_RANGE_389, system-signal=DET_RANGE_389}, {application-record-element=DET_RANGE_390, system-signal=DET_RANGE_390}, {application-record-element=DET_RANGE_391, system-signal=DET_RANGE_391}, {application-record-element=DET_RANGE_392, system-signal=DET_RANGE_392}, {application-record-element=DET_RANGE_ERR_389, system-signal=DET_RANGE_ERR_389}, {application-record-element=DET_RANGE_ERR_390, system-signal=DET_RANGE_ERR_390}, {application-record-element=DET_RANGE_ERR_391, system-signal=DET_RANGE_ERR_391}, {application-record-element=DET_RANGE_ERR_392, system-signal=DET_RANGE_ERR_392}, {application-record-element=DET_RANGE_VELOCITY_389, system-signal=DET_RANGE_VELOCITY_389}, {application-record-element=DET_RANGE_VELOCITY_390, system-signal=DET_RANGE_VELOCITY_390}, {application-record-element=DET_RANGE_VELOCITY_391, system-signal=DET_RANGE_VELOCITY_391}, {application-record-element=DET_RANGE_VELOCITY_392, system-signal=DET_RANGE_VELOCITY_392}, {application-record-element=DET_RANGE_VELOCITY_ERR_389, system-signal=DET_RANGE_VELOCITY_ERR_389}, {application-record-element=DET_RANGE_VELOCITY_ERR_390, system-signal=DET_RANGE_VELOCITY_ERR_390}, {application-record-element=DET_RANGE_VELOCITY_ERR_391, system-signal=DET_RANGE_VELOCITY_ERR_391}, {application-record-element=DET_RANGE_VELOCITY_ERR_392, system-signal=DET_RANGE_VELOCITY_ERR_392}, {application-record-element=DET_RCS_389, system-signal=DET_RCS_389}, {application-record-element=DET_RCS_390, system-signal=DET_RCS_390}, {application-record-element=DET_RCS_391, system-signal=DET_RCS_391}, {application-record-element=DET_RCS_392, system-signal=DET_RCS_392}, {application-record-element=DET_SNR_389, system-signal=DET_SNR_389}, {application-record-element=DET_SNR_390, system-signal=DET_SNR_390}, {application-record-element=DET_SNR_391, system-signal=DET_SNR_391}, {application-record-element=DET_SNR_392, system-signal=DET_SNR_392}, {application-record-element=DET_SUPER_RES_TARGET_389, system-signal=DET_SUPER_RES_TARGET_389}, {application-record-element=DET_SUPER_RES_TARGET_390, system-signal=DET_SUPER_RES_TARGET_390}, {application-record-element=DET_SUPER_RES_TARGET_391, system-signal=DET_SUPER_RES_TARGET_391}, {application-record-element=DET_SUPER_RES_TARGET_392, system-signal=DET_SUPER_RES_TARGET_392}]}
        sender-receiver-to-signal-group-mapping={data-element=COMPOSITIONTYPE.Pp_SG_Detections_393_396_AL.Vdp_SG_Detections_393_396_AL, signal-group=SG_Detections_393_396, type-mapping=sender-rec-record-type-mapping=record-element-mappings=[{application-record-element=DET_AZIMUTH_393, system-signal=DET_AZIMUTH_393}, {application-record-element=DET_AZIMUTH_394, system-signal=DET_AZIMUTH_394}, {application-record-element=DET_AZIMUTH_395, system-signal=DET_AZIMUTH_395}, {application-record-element=DET_AZIMUTH_396, system-signal=DET_AZIMUTH_396}, {application-record-element=DET_AZIMUTH_ERR_393, system-signal=DET_AZIMUTH_ERR_393}, {application-record-element=DET_AZIMUTH_ERR_394, system-signal=DET_AZIMUTH_ERR_394}, {application-record-element=DET_AZIMUTH_ERR_395, system-signal=DET_AZIMUTH_ERR_395}, {application-record-element=DET_AZIMUTH_ERR_396, system-signal=DET_AZIMUTH_ERR_396}, {application-record-element=DET_BELOW_RAIN_THOLD_393, system-signal=DET_BELOW_RAIN_THOLD_393}, {application-record-element=DET_BELOW_RAIN_THOLD_394, system-signal=DET_BELOW_RAIN_THOLD_394}, {application-record-element=DET_BELOW_RAIN_THOLD_395, system-signal=DET_BELOW_RAIN_THOLD_395}, {application-record-element=DET_BELOW_RAIN_THOLD_396, system-signal=DET_BELOW_RAIN_THOLD_396}, {application-record-element=DET_BI_STATIC_FLAG_393, system-signal=DET_BI_STATIC_FLAG_393}, {application-record-element=DET_BI_STATIC_FLAG_394, system-signal=DET_BI_STATIC_FLAG_394}, {application-record-element=DET_BI_STATIC_FLAG_395, system-signal=DET_BI_STATIC_FLAG_395}, {application-record-element=DET_BI_STATIC_FLAG_396, system-signal=DET_BI_STATIC_FLAG_396}, {application-record-element=DET_CONFD_AZIMUTH_393, system-signal=DET_CONFD_AZIMUTH_393}, {application-record-element=DET_CONFD_AZIMUTH_394, system-signal=DET_CONFD_AZIMUTH_394}, {application-record-element=DET_CONFD_AZIMUTH_395, system-signal=DET_CONFD_AZIMUTH_395}, {application-record-element=DET_CONFD_AZIMUTH_396, system-signal=DET_CONFD_AZIMUTH_396}, {application-record-element=DET_CONFD_ELEVATION_393, system-signal=DET_CONFD_ELEVATION_393}, {application-record-element=DET_CONFD_ELEVATION_394, system-signal=DET_CONFD_ELEVATION_394}, {application-record-element=DET_CONFD_ELEVATION_395, system-signal=DET_CONFD_ELEVATION_395}, {application-record-element=DET_CONFD_ELEVATION_396, system-signal=DET_CONFD_ELEVATION_396}, {application-record-element=DET_ELEVATION_393, system-signal=DET_ELEVATION_393}, {application-record-element=DET_ELEVATION_394, system-signal=DET_ELEVATION_394}, {application-record-element=DET_ELEVATION_395, system-signal=DET_ELEVATION_395}, {application-record-element=DET_ELEVATION_396, system-signal=DET_ELEVATION_396}, {application-record-element=DET_ELEVATION_ERR_393, system-signal=DET_ELEVATION_ERR_393}, {application-record-element=DET_ELEVATION_ERR_394, system-signal=DET_ELEVATION_ERR_394}, {application-record-element=DET_ELEVATION_ERR_395, system-signal=DET_ELEVATION_ERR_395}, {application-record-element=DET_ELEVATION_ERR_396, system-signal=DET_ELEVATION_ERR_396}, {application-record-element=DET_EXISTENCE_PROB_393, system-signal=DET_EXISTENCE_PROB_393}, {application-record-element=DET_EXISTENCE_PROB_394, system-signal=DET_EXISTENCE_PROB_394}, {application-record-element=DET_EXISTENCE_PROB_395, system-signal=DET_EXISTENCE_PROB_395}, {application-record-element=DET_EXISTENCE_PROB_396, system-signal=DET_EXISTENCE_PROB_396}, {application-record-element=DET_HVC_FLAG_393, system-signal=DET_HVC_FLAG_393}, {application-record-element=DET_HVC_FLAG_394, system-signal=DET_HVC_FLAG_394}, {application-record-element=DET_HVC_FLAG_395, system-signal=DET_HVC_FLAG_395}, {application-record-element=DET_HVC_FLAG_396, system-signal=DET_HVC_FLAG_396}, {application-record-element=DET_IDM_393, system-signal=DET_IDM_393}, {application-record-element=DET_IDM_394, system-signal=DET_IDM_394}, {application-record-element=DET_IDM_395, system-signal=DET_IDM_395}, {application-record-element=DET_IDM_396, system-signal=DET_IDM_396}, {application-record-element=DET_MH_CRC16_393_396, system-signal=DET_MH_CRC16_393_396}, {application-record-element=DET_MH_CYCLE_COUNTER_393_396, system-signal=DET_MH_CYCLE_COUNTER_393_396}, {application-record-element=DET_MH_SCAN_INDEX_4LSB_393_396, system-signal=DET_MH_SCAN_INDEX_4LSB_393_396}, {application-record-element=DET_MTD_393, system-signal=DET_MTD_393}, {application-record-element=DET_MTD_394, system-signal=DET_MTD_394}, {application-record-element=DET_MTD_395, system-signal=DET_MTD_395}, {application-record-element=DET_MTD_396, system-signal=DET_MTD_396}, {application-record-element=DET_PROB_1STAZHYPO_393, system-signal=DET_PROB_1STAZHYPO_393}, {application-record-element=DET_PROB_1STAZHYPO_394, system-signal=DET_PROB_1STAZHYPO_394}, {application-record-element=DET_PROB_1STAZHYPO_395, system-signal=DET_PROB_1STAZHYPO_395}, {application-record-element=DET_PROB_1STAZHYPO_396, system-signal=DET_PROB_1STAZHYPO_396}, {application-record-element=DET_RANGE_393, system-signal=DET_RANGE_393}, {application-record-element=DET_RANGE_394, system-signal=DET_RANGE_394}, {application-record-element=DET_RANGE_395, system-signal=DET_RANGE_395}, {application-record-element=DET_RANGE_396, system-signal=DET_RANGE_396}, {application-record-element=DET_RANGE_ERR_393, system-signal=DET_RANGE_ERR_393}, {application-record-element=DET_RANGE_ERR_394, system-signal=DET_RANGE_ERR_394}, {application-record-element=DET_RANGE_ERR_395, system-signal=DET_RANGE_ERR_395}, {application-record-element=DET_RANGE_ERR_396, system-signal=DET_RANGE_ERR_396}, {application-record-element=DET_RANGE_VELOCITY_393, system-signal=DET_RANGE_VELOCITY_393}, {application-record-element=DET_RANGE_VELOCITY_394, system-signal=DET_RANGE_VELOCITY_394}, {application-record-element=DET_RANGE_VELOCITY_395, system-signal=DET_RANGE_VELOCITY_395}, {application-record-element=DET_RANGE_VELOCITY_396, system-signal=DET_RANGE_VELOCITY_396}, {application-record-element=DET_RANGE_VELOCITY_ERR_393, system-signal=DET_RANGE_VELOCITY_ERR_393}, {application-record-element=DET_RANGE_VELOCITY_ERR_394, system-signal=DET_RANGE_VELOCITY_ERR_394}, {application-record-element=DET_RANGE_VELOCITY_ERR_395, system-signal=DET_RANGE_VELOCITY_ERR_395}, {application-record-element=DET_RANGE_VELOCITY_ERR_396, system-signal=DET_RANGE_VELOCITY_ERR_396}, {application-record-element=DET_RCS_393, system-signal=DET_RCS_393}, {application-record-element=DET_RCS_394, system-signal=DET_RCS_394}, {application-record-element=DET_RCS_395, system-signal=DET_RCS_395}, {application-record-element=DET_RCS_396, system-signal=DET_RCS_396}, {application-record-element=DET_SNR_393, system-signal=DET_SNR_393}, {application-record-element=DET_SNR_394, system-signal=DET_SNR_394}, {application-record-element=DET_SNR_395, system-signal=DET_SNR_395}, {application-record-element=DET_SNR_396, system-signal=DET_SNR_396}, {application-record-element=DET_SUPER_RES_TARGET_393, system-signal=DET_SUPER_RES_TARGET_393}, {application-record-element=DET_SUPER_RES_TARGET_394, system-signal=DET_SUPER_RES_TARGET_394}, {application-record-element=DET_SUPER_RES_TARGET_395, system-signal=DET_SUPER_RES_TARGET_395}, {application-record-element=DET_SUPER_RES_TARGET_396, system-signal=DET_SUPER_RES_TARGET_396}]}
        sender-receiver-to-signal-group-mapping={data-element=COMPOSITIONTYPE.Pp_SG_Detections_397_400_AL.Vdp_SG_Detections_397_400_AL, signal-group=SG_Detections_397_400, type-mapping=sender-rec-record-type-mapping=record-element-mappings=[{application-record-element=DET_AZIMUTH_397, system-signal=DET_AZIMUTH_397}, {application-record-element=DET_AZIMUTH_398, system-signal=DET_AZIMUTH_398}, {application-record-element=DET_AZIMUTH_399, system-signal=DET_AZIMUTH_399}, {application-record-element=DET_AZIMUTH_400, system-signal=DET_AZIMUTH_400}, {application-record-element=DET_AZIMUTH_ERR_397, system-signal=DET_AZIMUTH_ERR_397}, {application-record-element=DET_AZIMUTH_ERR_398, system-signal=DET_AZIMUTH_ERR_398}, {application-record-element=DET_AZIMUTH_ERR_399, system-signal=DET_AZIMUTH_ERR_399}, {application-record-element=DET_AZIMUTH_ERR_400, system-signal=DET_AZIMUTH_ERR_400}, {application-record-element=DET_BELOW_RAIN_THOLD_397, system-signal=DET_BELOW_RAIN_THOLD_397}, {application-record-element=DET_BELOW_RAIN_THOLD_398, system-signal=DET_BELOW_RAIN_THOLD_398}, {application-record-element=DET_BELOW_RAIN_THOLD_399, system-signal=DET_BELOW_RAIN_THOLD_399}, {application-record-element=DET_BELOW_RAIN_THOLD_400, system-signal=DET_BELOW_RAIN_THOLD_400}, {application-record-element=DET_BI_STATIC_FLAG_397, system-signal=DET_BI_STATIC_FLAG_397}, {application-record-element=DET_BI_STATIC_FLAG_398, system-signal=DET_BI_STATIC_FLAG_398}, {application-record-element=DET_BI_STATIC_FLAG_399, system-signal=DET_BI_STATIC_FLAG_399}, {application-record-element=DET_BI_STATIC_FLAG_400, system-signal=DET_BI_STATIC_FLAG_400}, {application-record-element=DET_CONFD_AZIMUTH_397, system-signal=DET_CONFD_AZIMUTH_397}, {application-record-element=DET_CONFD_AZIMUTH_398, system-signal=DET_CONFD_AZIMUTH_398}, {application-record-element=DET_CONFD_AZIMUTH_399, system-signal=DET_CONFD_AZIMUTH_399}, {application-record-element=DET_CONFD_AZIMUTH_400, system-signal=DET_CONFD_AZIMUTH_400}, {application-record-element=DET_CONFD_ELEVATION_397, system-signal=DET_CONFD_ELEVATION_397}, {application-record-element=DET_CONFD_ELEVATION_398, system-signal=DET_CONFD_ELEVATION_398}, {application-record-element=DET_CONFD_ELEVATION_399, system-signal=DET_CONFD_ELEVATION_399}, {application-record-element=DET_CONFD_ELEVATION_400, system-signal=DET_CONFD_ELEVATION_400}, {application-record-element=DET_ELEVATION_397, system-signal=DET_ELEVATION_397}, {application-record-element=DET_ELEVATION_398, system-signal=DET_ELEVATION_398}, {application-record-element=DET_ELEVATION_399, system-signal=DET_ELEVATION_399}, {application-record-element=DET_ELEVATION_400, system-signal=DET_ELEVATION_400}, {application-record-element=DET_ELEVATION_ERR_397, system-signal=DET_ELEVATION_ERR_397}, {application-record-element=DET_ELEVATION_ERR_398, system-signal=DET_ELEVATION_ERR_398}, {application-record-element=DET_ELEVATION_ERR_399, system-signal=DET_ELEVATION_ERR_399}, {application-record-element=DET_ELEVATION_ERR_400, system-signal=DET_ELEVATION_ERR_400}, {application-record-element=DET_EXISTENCE_PROB_397, system-signal=DET_EXISTENCE_PROB_397}, {application-record-element=DET_EXISTENCE_PROB_398, system-signal=DET_EXISTENCE_PROB_398}, {application-record-element=DET_EXISTENCE_PROB_399, system-signal=DET_EXISTENCE_PROB_399}, {application-record-element=DET_EXISTENCE_PROB_400, system-signal=DET_EXISTENCE_PROB_400}, {application-record-element=DET_HVC_FLAG_397, system-signal=DET_HVC_FLAG_397}, {application-record-element=DET_HVC_FLAG_398, system-signal=DET_HVC_FLAG_398}, {application-record-element=DET_HVC_FLAG_399, system-signal=DET_HVC_FLAG_399}, {application-record-element=DET_HVC_FLAG_400, system-signal=DET_HVC_FLAG_400}, {application-record-element=DET_IDM_397, system-signal=DET_IDM_397}, {application-record-element=DET_IDM_398, system-signal=DET_IDM_398}, {application-record-element=DET_IDM_399, system-signal=DET_IDM_399}, {application-record-element=DET_IDM_400, system-signal=DET_IDM_400}, {application-record-element=DET_MH_CRC16_397_400, system-signal=DET_MH_CRC16_397_400}, {application-record-element=DET_MH_CYCLE_COUNTER_397_400, system-signal=DET_MH_CYCLE_COUNTER_397_400}, {application-record-element=DET_MH_SCAN_INDEX_4LSB_397_400, system-signal=DET_MH_SCAN_INDEX_4LSB_397_400}, {application-record-element=DET_MTD_397, system-signal=DET_MTD_397}, {application-record-element=DET_MTD_398, system-signal=DET_MTD_398}, {application-record-element=DET_MTD_399, system-signal=DET_MTD_399}, {application-record-element=DET_MTD_400, system-signal=DET_MTD_400}, {application-record-element=DET_PROB_1STAZHYPO_397, system-signal=DET_PROB_1STAZHYPO_397}, {application-record-element=DET_PROB_1STAZHYPO_398, system-signal=DET_PROB_1STAZHYPO_398}, {application-record-element=DET_PROB_1STAZHYPO_399, system-signal=DET_PROB_1STAZHYPO_399}, {application-record-element=DET_PROB_1STAZHYPO_400, system-signal=DET_PROB_1STAZHYPO_400}, {application-record-element=DET_RANGE_397, system-signal=DET_RANGE_397}, {application-record-element=DET_RANGE_398, system-signal=DET_RANGE_398}, {application-record-element=DET_RANGE_399, system-signal=DET_RANGE_399}, {application-record-element=DET_RANGE_400, system-signal=DET_RANGE_400}, {application-record-element=DET_RANGE_ERR_397, system-signal=DET_RANGE_ERR_397}, {application-record-element=DET_RANGE_ERR_398, system-signal=DET_RANGE_ERR_398}, {application-record-element=DET_RANGE_ERR_399, system-signal=DET_RANGE_ERR_399}, {application-record-element=DET_RANGE_ERR_400, system-signal=DET_RANGE_ERR_400}, {application-record-element=DET_RANGE_VELOCITY_397, system-signal=DET_RANGE_VELOCITY_397}, {application-record-element=DET_RANGE_VELOCITY_398, system-signal=DET_RANGE_VELOCITY_398}, {application-record-element=DET_RANGE_VELOCITY_399, system-signal=DET_RANGE_VELOCITY_399}, {application-record-element=DET_RANGE_VELOCITY_400, system-signal=DET_RANGE_VELOCITY_400}, {application-record-element=DET_RANGE_VELOCITY_ERR_397, system-signal=DET_RANGE_VELOCITY_ERR_397}, {application-record-element=DET_RANGE_VELOCITY_ERR_398, system-signal=DET_RANGE_VELOCITY_ERR_398}, {application-record-element=DET_RANGE_VELOCITY_ERR_399, system-signal=DET_RANGE_VELOCITY_ERR_399}, {application-record-element=DET_RANGE_VELOCITY_ERR_400, system-signal=DET_RANGE_VELOCITY_ERR_400}, {application-record-element=DET_RCS_397, system-signal=DET_RCS_397}, {application-record-element=DET_RCS_398, system-signal=DET_RCS_398}, {application-record-element=DET_RCS_399, system-signal=DET_RCS_399}, {application-record-element=DET_RCS_400, system-signal=DET_RCS_400}, {application-record-element=DET_SNR_397, system-signal=DET_SNR_397}, {application-record-element=DET_SNR_398, system-signal=DET_SNR_398}, {application-record-element=DET_SNR_399, system-signal=DET_SNR_399}, {application-record-element=DET_SNR_400, system-signal=DET_SNR_400}, {application-record-element=DET_SUPER_RES_TARGET_397, system-signal=DET_SUPER_RES_TARGET_397}, {application-record-element=DET_SUPER_RES_TARGET_398, system-signal=DET_SUPER_RES_TARGET_398}, {application-record-element=DET_SUPER_RES_TARGET_399, system-signal=DET_SUPER_RES_TARGET_399}, {application-record-element=DET_SUPER_RES_TARGET_400, system-signal=DET_SUPER_RES_TARGET_400}]}
        sender-receiver-to-signal-group-mapping={data-element=COMPOSITIONTYPE.Rp_SG_Fusion_Detections_001_004_AL.Vdp_SG_Fusion_Detections_001_004_AL, signal-group=SG_Fusion_Detections_001_004, type-mapping=sender-rec-record-type-mapping=record-element-mappings=[{application-record-element=DET_AZIMUTH_001_Rx, system-signal=DET_AZIMUTH_001_Rx}, {application-record-element=DET_AZIMUTH_002_Rx, system-signal=DET_AZIMUTH_002_Rx}, {application-record-element=DET_AZIMUTH_003_Rx, system-signal=DET_AZIMUTH_003_Rx}, {application-record-element=DET_AZIMUTH_004_Rx, system-signal=DET_AZIMUTH_004_Rx}, {application-record-element=DET_AZIMUTH_ERR_001_Rx, system-signal=DET_AZIMUTH_ERR_001_Rx}, {application-record-element=DET_AZIMUTH_ERR_002_Rx, system-signal=DET_AZIMUTH_ERR_002_Rx}, {application-record-element=DET_AZIMUTH_ERR_003_Rx, system-signal=DET_AZIMUTH_ERR_003_Rx}, {application-record-element=DET_AZIMUTH_ERR_004_Rx, system-signal=DET_AZIMUTH_ERR_004_Rx}, {application-record-element=DET_BELOW_RAIN_THOLD_001_Rx, system-signal=DET_BELOW_RAIN_THOLD_001_Rx}, {application-record-element=DET_BELOW_RAIN_THOLD_002_Rx, system-signal=DET_BELOW_RAIN_THOLD_002_Rx}, {application-record-element=DET_BELOW_RAIN_THOLD_003_Rx, system-signal=DET_BELOW_RAIN_THOLD_003_Rx}, {application-record-element=DET_BELOW_RAIN_THOLD_004_Rx, system-signal=DET_BELOW_RAIN_THOLD_004_Rx}, {application-record-element=DET_BI_STATIC_FLAG_001_Rx, system-signal=DET_BI_STATIC_FLAG_001_Rx}, {application-record-element=DET_BI_STATIC_FLAG_002_Rx, system-signal=DET_BI_STATIC_FLAG_002_Rx}, {application-record-element=DET_BI_STATIC_FLAG_003_Rx, system-signal=DET_BI_STATIC_FLAG_003_Rx}, {application-record-element=DET_BI_STATIC_FLAG_004_Rx, system-signal=DET_BI_STATIC_FLAG_004_Rx}, {application-record-element=DET_CONFD_AZIMUTH_001_Rx, system-signal=DET_CONFD_AZIMUTH_001_Rx}, {application-record-element=DET_CONFD_AZIMUTH_002_Rx, system-signal=DET_CONFD_AZIMUTH_002_Rx}, {application-record-element=DET_CONFD_AZIMUTH_003_Rx, system-signal=DET_CONFD_AZIMUTH_003_Rx}, {application-record-element=DET_CONFD_AZIMUTH_004_Rx, system-signal=DET_CONFD_AZIMUTH_004_Rx}, {application-record-element=DET_CONFD_ELEVATION_001_Rx, system-signal=DET_CONFD_ELEVATION_001_Rx}, {application-record-element=DET_CONFD_ELEVATION_002_Rx, system-signal=DET_CONFD_ELEVATION_002_Rx}, {application-record-element=DET_CONFD_ELEVATION_003_Rx, system-signal=DET_CONFD_ELEVATION_003_Rx}, {application-record-element=DET_CONFD_ELEVATION_004_Rx, system-signal=DET_CONFD_ELEVATION_004_Rx}, {application-record-element=DET_ELEVATION_001_Rx, system-signal=DET_ELEVATION_001_Rx}, {application-record-element=DET_ELEVATION_002_Rx, system-signal=DET_ELEVATION_002_Rx}, {application-record-element=DET_ELEVATION_003_Rx, system-signal=DET_ELEVATION_003_Rx}, {application-record-element=DET_ELEVATION_004_Rx, system-signal=DET_ELEVATION_004_Rx}, {application-record-element=DET_ELEVATION_ERR_001_Rx, system-signal=DET_ELEVATION_ERR_001_Rx}, {application-record-element=DET_ELEVATION_ERR_002_Rx, system-signal=DET_ELEVATION_ERR_002_Rx}, {application-record-element=DET_ELEVATION_ERR_003_Rx, system-signal=DET_ELEVATION_ERR_003_Rx}, {application-record-element=DET_ELEVATION_ERR_004_Rx, system-signal=DET_ELEVATION_ERR_004_Rx}, {application-record-element=DET_EXISTENCE_PROB_001_Rx, system-signal=DET_EXISTENCE_PROB_001_Rx}, {application-record-element=DET_EXISTENCE_PROB_002_Rx, system-signal=DET_EXISTENCE_PROB_002_Rx}, {application-record-element=DET_EXISTENCE_PROB_003_Rx, system-signal=DET_EXISTENCE_PROB_003_Rx}, {application-record-element=DET_EXISTENCE_PROB_004_Rx, system-signal=DET_EXISTENCE_PROB_004_Rx}, {application-record-element=DET_HVC_FLAG_001_Rx, system-signal=DET_HVC_FLAG_001_Rx}, {application-record-element=DET_HVC_FLAG_002_Rx, system-signal=DET_HVC_FLAG_002_Rx}, {application-record-element=DET_HVC_FLAG_003_Rx, system-signal=DET_HVC_FLAG_003_Rx}, {application-record-element=DET_HVC_FLAG_004_Rx, system-signal=DET_HVC_FLAG_004_Rx}, {application-record-element=DET_IDM_001_Rx, system-signal=DET_IDM_001_Rx}, {application-record-element=DET_IDM_002_Rx, system-signal=DET_IDM_002_Rx}, {application-record-element=DET_IDM_003_Rx, system-signal=DET_IDM_003_Rx}, {application-record-element=DET_IDM_004_Rx, system-signal=DET_IDM_004_Rx}, {application-record-element=DET_MH_CRC16_001_004_Rx, system-signal=DET_MH_CRC16_001_004_Rx}, {application-record-element=DET_MH_CYCLE_COUNTER_001_004_Rx, system-signal=DET_MH_CYCLE_COUNTER_001_004_Rx}, {application-record-element=DET_MH_SCAN_INDEX_4LSB_001_004_Rx, system-signal=DET_MH_SCAN_INDEX_4LSB_001_004_Rx}, {application-record-element=DET_MTD_001_Rx, system-signal=DET_MTD_001_Rx}, {application-record-element=DET_MTD_002_Rx, system-signal=DET_MTD_002_Rx}, {application-record-element=DET_MTD_003_Rx, system-signal=DET_MTD_003_Rx}, {application-record-element=DET_MTD_004_Rx, system-signal=DET_MTD_004_Rx}, {application-record-element=DET_PROB_1STAZHYPO_001_Rx, system-signal=DET_PROB_1STAZHYPO_001_Rx}, {application-record-element=DET_PROB_1STAZHYPO_002_Rx, system-signal=DET_PROB_1STAZHYPO_002_Rx}, {application-record-element=DET_PROB_1STAZHYPO_003_Rx, system-signal=DET_PROB_1STAZHYPO_003_Rx}, {application-record-element=DET_PROB_1STAZHYPO_004_Rx, system-signal=DET_PROB_1STAZHYPO_004_Rx}, {application-record-element=DET_RANGE_001_Rx, system-signal=DET_RANGE_001_Rx}, {application-record-element=DET_RANGE_002_Rx, system-signal=DET_RANGE_002_Rx}, {application-record-element=DET_RANGE_003_Rx, system-signal=DET_RANGE_003_Rx}, {application-record-element=DET_RANGE_004_Rx, system-signal=DET_RANGE_004_Rx}, {application-record-element=DET_RANGE_ERR_001_Rx, system-signal=DET_RANGE_ERR_001_Rx}, {application-record-element=DET_RANGE_ERR_002_Rx, system-signal=DET_RANGE_ERR_002_Rx}, {application-record-element=DET_RANGE_ERR_003_Rx, system-signal=DET_RANGE_ERR_003_Rx}, {application-record-element=DET_RANGE_ERR_004_Rx, system-signal=DET_RANGE_ERR_004_Rx}, {application-record-element=DET_RANGE_VELOCITY_001_Rx, system-signal=DET_RANGE_VELOCITY_001_Rx}, {application-record-element=DET_RANGE_VELOCITY_002_Rx, system-signal=DET_RANGE_VELOCITY_002_Rx}, {application-record-element=DET_RANGE_VELOCITY_003_Rx, system-signal=DET_RANGE_VELOCITY_003_Rx}, {application-record-element=DET_RANGE_VELOCITY_004_Rx, system-signal=DET_RANGE_VELOCITY_004_Rx}, {application-record-element=DET_RANGE_VELOCITY_ERR_001_Rx, system-signal=DET_RANGE_VELOCITY_ERR_001_Rx}, {application-record-element=DET_RANGE_VELOCITY_ERR_002_Rx, system-signal=DET_RANGE_VELOCITY_ERR_002_Rx}, {application-record-element=DET_RANGE_VELOCITY_ERR_003_Rx, system-signal=DET_RANGE_VELOCITY_ERR_003_Rx}, {application-record-element=DET_RANGE_VELOCITY_ERR_004_Rx, system-signal=DET_RANGE_VELOCITY_ERR_004_Rx}, {application-record-element=DET_RCS_001_Rx, system-signal=DET_RCS_001_Rx}, {application-record-element=DET_RCS_002_Rx, system-signal=DET_RCS_002_Rx}, {application-record-element=DET_RCS_003_Rx, system-signal=DET_RCS_003_Rx}, {application-record-element=DET_RCS_004_Rx, system-signal=DET_RCS_004_Rx}, {application-record-element=DET_SNR_001_Rx, system-signal=DET_SNR_001_Rx}, {application-record-element=DET_SNR_002_Rx, system-signal=DET_SNR_002_Rx}, {application-record-element=DET_SNR_003_Rx, system-signal=DET_SNR_003_Rx}, {application-record-element=DET_SNR_004_Rx, system-signal=DET_SNR_004_Rx}, {application-record-element=DET_SUPER_RES_TARGET_001_Rx, system-signal=DET_SUPER_RES_TARGET_001_Rx}, {application-record-element=DET_SUPER_RES_TARGET_002_Rx, system-signal=DET_SUPER_RES_TARGET_002_Rx}, {application-record-element=DET_SUPER_RES_TARGET_003_Rx, system-signal=DET_SUPER_RES_TARGET_003_Rx}, {application-record-element=DET_SUPER_RES_TARGET_004_Rx, system-signal=DET_SUPER_RES_TARGET_004_Rx}]}
        sender-receiver-to-signal-group-mapping={data-element=COMPOSITIONTYPE.Rp_SG_Fusion_Detections_005_008_AL.Vdp_SG_Fusion_Detections_005_008_AL, signal-group=SG_Fusion_Detections_005_008, type-mapping=sender-rec-record-type-mapping=record-element-mappings=[{application-record-element=DET_AZIMUTH_005_Rx, system-signal=DET_AZIMUTH_005_Rx}, {application-record-element=DET_AZIMUTH_006_Rx, system-signal=DET_AZIMUTH_006_Rx}, {application-record-element=DET_AZIMUTH_007_Rx, system-signal=DET_AZIMUTH_007_Rx}, {application-record-element=DET_AZIMUTH_008_Rx, system-signal=DET_AZIMUTH_008_Rx}, {application-record-element=DET_AZIMUTH_ERR_005_Rx, system-signal=DET_AZIMUTH_ERR_005_Rx}, {application-record-element=DET_AZIMUTH_ERR_006_Rx, system-signal=DET_AZIMUTH_ERR_006_Rx}, {application-record-element=DET_AZIMUTH_ERR_007_Rx, system-signal=DET_AZIMUTH_ERR_007_Rx}, {application-record-element=DET_AZIMUTH_ERR_008_Rx, system-signal=DET_AZIMUTH_ERR_008_Rx}, {application-record-element=DET_BELOW_RAIN_THOLD_005_Rx, system-signal=DET_BELOW_RAIN_THOLD_005_Rx}, {application-record-element=DET_BELOW_RAIN_THOLD_006_Rx, system-signal=DET_BELOW_RAIN_THOLD_006_Rx}, {application-record-element=DET_BELOW_RAIN_THOLD_007_Rx, system-signal=DET_BELOW_RAIN_THOLD_007_Rx}, {application-record-element=DET_BELOW_RAIN_THOLD_008_Rx, system-signal=DET_BELOW_RAIN_THOLD_008_Rx}, {application-record-element=DET_BI_STATIC_FLAG_005_Rx, system-signal=DET_BI_STATIC_FLAG_005_Rx}, {application-record-element=DET_BI_STATIC_FLAG_006_Rx, system-signal=DET_BI_STATIC_FLAG_006_Rx}, {application-record-element=DET_BI_STATIC_FLAG_007_Rx, system-signal=DET_BI_STATIC_FLAG_007_Rx}, {application-record-element=DET_BI_STATIC_FLAG_008_Rx, system-signal=DET_BI_STATIC_FLAG_008_Rx}, {application-record-element=DET_CONFD_AZIMUTH_005_Rx, system-signal=DET_CONFD_AZIMUTH_005_Rx}, {application-record-element=DET_CONFD_AZIMUTH_006_Rx, system-signal=DET_CONFD_AZIMUTH_006_Rx}, {application-record-element=DET_CONFD_AZIMUTH_007_Rx, system-signal=DET_CONFD_AZIMUTH_007_Rx}, {application-record-element=DET_CONFD_AZIMUTH_008_Rx, system-signal=DET_CONFD_AZIMUTH_008_Rx}, {application-record-element=DET_CONFD_ELEVATION_005_Rx, system-signal=DET_CONFD_ELEVATION_005_Rx}, {application-record-element=DET_CONFD_ELEVATION_006_Rx, system-signal=DET_CONFD_ELEVATION_006_Rx}, {application-record-element=DET_CONFD_ELEVATION_007_Rx, system-signal=DET_CONFD_ELEVATION_007_Rx}, {application-record-element=DET_CONFD_ELEVATION_008_Rx, system-signal=DET_CONFD_ELEVATION_008_Rx}, {application-record-element=DET_ELEVATION_005_Rx, system-signal=DET_ELEVATION_005_Rx}, {application-record-element=DET_ELEVATION_006_Rx, system-signal=DET_ELEVATION_006_Rx}, {application-record-element=DET_ELEVATION_007_Rx, system-signal=DET_ELEVATION_007_Rx}, {application-record-element=DET_ELEVATION_008_Rx, system-signal=DET_ELEVATION_008_Rx}, {application-record-element=DET_ELEVATION_ERR_005_Rx, system-signal=DET_ELEVATION_ERR_005_Rx}, {application-record-element=DET_ELEVATION_ERR_006_Rx, system-signal=DET_ELEVATION_ERR_006_Rx}, {application-record-element=DET_ELEVATION_ERR_007_Rx, system-signal=DET_ELEVATION_ERR_007_Rx}, {application-record-element=DET_ELEVATION_ERR_008_Rx, system-signal=DET_ELEVATION_ERR_008_Rx}, {application-record-element=DET_EXISTENCE_PROB_005_Rx, system-signal=DET_EXISTENCE_PROB_005_Rx}, {application-record-element=DET_EXISTENCE_PROB_006_Rx, system-signal=DET_EXISTENCE_PROB_006_Rx}, {application-record-element=DET_EXISTENCE_PROB_007_Rx, system-signal=DET_EXISTENCE_PROB_007_Rx}, {application-record-element=DET_EXISTENCE_PROB_008_Rx, system-signal=DET_EXISTENCE_PROB_008_Rx}, {application-record-element=DET_HVC_FLAG_005_Rx, system-signal=DET_HVC_FLAG_005_Rx}, {application-record-element=DET_HVC_FLAG_006_Rx, system-signal=DET_HVC_FLAG_006_Rx}, {application-record-element=DET_HVC_FLAG_007_Rx, system-signal=DET_HVC_FLAG_007_Rx}, {application-record-element=DET_HVC_FLAG_008_Rx, system-signal=DET_HVC_FLAG_008_Rx}, {application-record-element=DET_IDM_005_Rx, system-signal=DET_IDM_005_Rx}, {application-record-element=DET_IDM_006_Rx, system-signal=DET_IDM_006_Rx}, {application-record-element=DET_IDM_007_Rx, system-signal=DET_IDM_007_Rx}, {application-record-element=DET_IDM_008_Rx, system-signal=DET_IDM_008_Rx}, {application-record-element=DET_MH_CRC16_005_008_Rx, system-signal=DET_MH_CRC16_005_008_Rx}, {application-record-element=DET_MH_CYCLE_COUNTER_005_008_Rx, system-signal=DET_MH_CYCLE_COUNTER_005_008_Rx}, {application-record-element=DET_MH_SCAN_INDEX_4LSB_005_008_Rx, system-signal=DET_MH_SCAN_INDEX_4LSB_005_008_Rx}, {application-record-element=DET_MTD_005_Rx, system-signal=DET_MTD_005_Rx}, {application-record-element=DET_MTD_006_Rx, system-signal=DET_MTD_006_Rx}, {application-record-element=DET_MTD_007_Rx, system-signal=DET_MTD_007_Rx}, {application-record-element=DET_MTD_008_Rx, system-signal=DET_MTD_008_Rx}, {application-record-element=DET_PROB_1STAZHYPO_005_Rx, system-signal=DET_PROB_1STAZHYPO_005_Rx}, {application-record-element=DET_PROB_1STAZHYPO_006_Rx, system-signal=DET_PROB_1STAZHYPO_006_Rx}, {application-record-element=DET_PROB_1STAZHYPO_007_Rx, system-signal=DET_PROB_1STAZHYPO_007_Rx}, {application-record-element=DET_PROB_1STAZHYPO_008_Rx, system-signal=DET_PROB_1STAZHYPO_008_Rx}, {application-record-element=DET_RANGE_005_Rx, system-signal=DET_RANGE_005_Rx}, {application-record-element=DET_RANGE_006_Rx, system-signal=DET_RANGE_006_Rx}, {application-record-element=DET_RANGE_007_Rx, system-signal=DET_RANGE_007_Rx}, {application-record-element=DET_RANGE_008_Rx, system-signal=DET_RANGE_008_Rx}, {application-record-element=DET_RANGE_ERR_005_Rx, system-signal=DET_RANGE_ERR_005_Rx}, {application-record-element=DET_RANGE_ERR_006_Rx, system-signal=DET_RANGE_ERR_006_Rx}, {application-record-element=DET_RANGE_ERR_007_Rx, system-signal=DET_RANGE_ERR_007_Rx}, {application-record-element=DET_RANGE_ERR_008_Rx, system-signal=DET_RANGE_ERR_008_Rx}, {application-record-element=DET_RANGE_VELOCITY_005_Rx, system-signal=DET_RANGE_VELOCITY_005_Rx}, {application-record-element=DET_RANGE_VELOCITY_006_Rx, system-signal=DET_RANGE_VELOCITY_006_Rx}, {application-record-element=DET_RANGE_VELOCITY_007_Rx, system-signal=DET_RANGE_VELOCITY_007_Rx}, {application-record-element=DET_RANGE_VELOCITY_008_Rx, system-signal=DET_RANGE_VELOCITY_008_Rx}, {application-record-element=DET_RANGE_VELOCITY_ERR_005_Rx, system-signal=DET_RANGE_VELOCITY_ERR_005_Rx}, {application-record-element=DET_RANGE_VELOCITY_ERR_006_Rx, system-signal=DET_RANGE_VELOCITY_ERR_006_Rx}, {application-record-element=DET_RANGE_VELOCITY_ERR_007_Rx, system-signal=DET_RANGE_VELOCITY_ERR_007_Rx}, {application-record-element=DET_RANGE_VELOCITY_ERR_008_Rx, system-signal=DET_RANGE_VELOCITY_ERR_008_Rx}, {application-record-element=DET_RCS_005_Rx, system-signal=DET_RCS_005_Rx}, {application-record-element=DET_RCS_006_Rx, system-signal=DET_RCS_006_Rx}, {application-record-element=DET_RCS_007_Rx, system-signal=DET_RCS_007_Rx}, {application-record-element=DET_RCS_008_Rx, system-signal=DET_RCS_008_Rx}, {application-record-element=DET_SNR_005_Rx, system-signal=DET_SNR_005_Rx}, {application-record-element=DET_SNR_006_Rx, system-signal=DET_SNR_006_Rx}, {application-record-element=DET_SNR_007_Rx, system-signal=DET_SNR_007_Rx}, {application-record-element=DET_SNR_008_Rx, system-signal=DET_SNR_008_Rx}, {application-record-element=DET_SUPER_RES_TARGET_005_Rx, system-signal=DET_SUPER_RES_TARGET_005_Rx}, {application-record-element=DET_SUPER_RES_TARGET_006_Rx, system-signal=DET_SUPER_RES_TARGET_006_Rx}, {application-record-element=DET_SUPER_RES_TARGET_007_Rx, system-signal=DET_SUPER_RES_TARGET_007_Rx}, {application-record-element=DET_SUPER_RES_TARGET_008_Rx, system-signal=DET_SUPER_RES_TARGET_008_Rx}]}
        sender-receiver-to-signal-group-mapping={data-element=COMPOSITIONTYPE.Rp_SG_Fusion_Detections_009_012_AL.Vdp_SG_Fusion_Detections_009_012_AL, signal-group=SG_Fusion_Detections_009_012, type-mapping=sender-rec-record-type-mapping=record-element-mappings=[{application-record-element=DET_AZIMUTH_009_Rx, system-signal=DET_AZIMUTH_009_Rx}, {application-record-element=DET_AZIMUTH_010_Rx, system-signal=DET_AZIMUTH_010_Rx}, {application-record-element=DET_AZIMUTH_011_Rx, system-signal=DET_AZIMUTH_011_Rx}, {application-record-element=DET_AZIMUTH_012_Rx, system-signal=DET_AZIMUTH_012_Rx}, {application-record-element=DET_AZIMUTH_ERR_009_Rx, system-signal=DET_AZIMUTH_ERR_009_Rx}, {application-record-element=DET_AZIMUTH_ERR_010_Rx, system-signal=DET_AZIMUTH_ERR_010_Rx}, {application-record-element=DET_AZIMUTH_ERR_011_Rx, system-signal=DET_AZIMUTH_ERR_011_Rx}, {application-record-element=DET_AZIMUTH_ERR_012_Rx, system-signal=DET_AZIMUTH_ERR_012_Rx}, {application-record-element=DET_BELOW_RAIN_THOLD_009_Rx, system-signal=DET_BELOW_RAIN_THOLD_009_Rx}, {application-record-element=DET_BELOW_RAIN_THOLD_010_Rx, system-signal=DET_BELOW_RAIN_THOLD_010_Rx}, {application-record-element=DET_BELOW_RAIN_THOLD_011_Rx, system-signal=DET_BELOW_RAIN_THOLD_011_Rx}, {application-record-element=DET_BELOW_RAIN_THOLD_012_Rx, system-signal=DET_BELOW_RAIN_THOLD_012_Rx}, {application-record-element=DET_BI_STATIC_FLAG_009_Rx, system-signal=DET_BI_STATIC_FLAG_009_Rx}, {application-record-element=DET_BI_STATIC_FLAG_010_Rx, system-signal=DET_BI_STATIC_FLAG_010_Rx}, {application-record-element=DET_BI_STATIC_FLAG_011_Rx, system-signal=DET_BI_STATIC_FLAG_011_Rx}, {application-record-element=DET_BI_STATIC_FLAG_012_Rx, system-signal=DET_BI_STATIC_FLAG_012_Rx}, {application-record-element=DET_CONFD_AZIMUTH_009_Rx, system-signal=DET_CONFD_AZIMUTH_009_Rx}, {application-record-element=DET_CONFD_AZIMUTH_010_Rx, system-signal=DET_CONFD_AZIMUTH_010_Rx}, {application-record-element=DET_CONFD_AZIMUTH_011_Rx, system-signal=DET_CONFD_AZIMUTH_011_Rx}, {application-record-element=DET_CONFD_AZIMUTH_012_Rx, system-signal=DET_CONFD_AZIMUTH_012_Rx}, {application-record-element=DET_CONFD_ELEVATION_009_Rx, system-signal=DET_CONFD_ELEVATION_009_Rx}, {application-record-element=DET_CONFD_ELEVATION_010_Rx, system-signal=DET_CONFD_ELEVATION_010_Rx}, {application-record-element=DET_CONFD_ELEVATION_011_Rx, system-signal=DET_CONFD_ELEVATION_011_Rx}, {application-record-element=DET_CONFD_ELEVATION_012_Rx, system-signal=DET_CONFD_ELEVATION_012_Rx}, {application-record-element=DET_ELEVATION_009_Rx, system-signal=DET_ELEVATION_009_Rx}, {application-record-element=DET_ELEVATION_010_Rx, system-signal=DET_ELEVATION_010_Rx}, {application-record-element=DET_ELEVATION_011_Rx, system-signal=DET_ELEVATION_011_Rx}, {application-record-element=DET_ELEVATION_012_Rx, system-signal=DET_ELEVATION_012_Rx}, {application-record-element=DET_ELEVATION_ERR_009_Rx, system-signal=DET_ELEVATION_ERR_009_Rx}, {application-record-element=DET_ELEVATION_ERR_010_Rx, system-signal=DET_ELEVATION_ERR_010_Rx}, {application-record-element=DET_ELEVATION_ERR_011_Rx, system-signal=DET_ELEVATION_ERR_011_Rx}, {application-record-element=DET_ELEVATION_ERR_012_Rx, system-signal=DET_ELEVATION_ERR_012_Rx}, {application-record-element=DET_EXISTENCE_PROB_009_Rx, system-signal=DET_EXISTENCE_PROB_009_Rx}, {application-record-element=DET_EXISTENCE_PROB_010_Rx, system-signal=DET_EXISTENCE_PROB_010_Rx}, {application-record-element=DET_EXISTENCE_PROB_011_Rx, system-signal=DET_EXISTENCE_PROB_011_Rx}, {application-record-element=DET_EXISTENCE_PROB_012_Rx, system-signal=DET_EXISTENCE_PROB_012_Rx}, {application-record-element=DET_HVC_FLAG_009_Rx, system-signal=DET_HVC_FLAG_009_Rx}, {application-record-element=DET_HVC_FLAG_010_Rx, system-signal=DET_HVC_FLAG_010_Rx}, {application-record-element=DET_HVC_FLAG_011_Rx, system-signal=DET_HVC_FLAG_011_Rx}, {application-record-element=DET_HVC_FLAG_012_Rx, system-signal=DET_HVC_FLAG_012_Rx}, {application-record-element=DET_IDM_009_Rx, system-signal=DET_IDM_009_Rx}, {application-record-element=DET_IDM_010_Rx, system-signal=DET_IDM_010_Rx}, {application-record-element=DET_IDM_011_Rx, system-signal=DET_IDM_011_Rx}, {application-record-element=DET_IDM_012_Rx, system-signal=DET_IDM_012_Rx}, {application-record-element=DET_MH_CRC16_009_012_Rx, system-signal=DET_MH_CRC16_009_012_Rx}, {application-record-element=DET_MH_CYCLE_COUNTER_009_012_Rx, system-signal=DET_MH_CYCLE_COUNTER_009_012_Rx}, {application-record-element=DET_MH_SCAN_INDEX_4LSB_009_012_Rx, system-signal=DET_MH_SCAN_INDEX_4LSB_009_012_Rx}, {application-record-element=DET_MTD_009_Rx, system-signal=DET_MTD_009_Rx}, {application-record-element=DET_MTD_010_Rx, system-signal=DET_MTD_010_Rx}, {application-record-element=DET_MTD_011_Rx, system-signal=DET_MTD_011_Rx}, {application-record-element=DET_MTD_012_Rx, system-signal=DET_MTD_012_Rx}, {application-record-element=DET_PROB_1STAZHYPO_009_Rx, system-signal=DET_PROB_1STAZHYPO_009_Rx}, {application-record-element=DET_PROB_1STAZHYPO_010_Rx, system-signal=DET_PROB_1STAZHYPO_010_Rx}, {application-record-element=DET_PROB_1STAZHYPO_011_Rx, system-signal=DET_PROB_1STAZHYPO_011_Rx}, {application-record-element=DET_PROB_1STAZHYPO_012_Rx, system-signal=DET_PROB_1STAZHYPO_012_Rx}, {application-record-element=DET_RANGE_009_Rx, system-signal=DET_RANGE_009_Rx}, {application-record-element=DET_RANGE_010_Rx, system-signal=DET_RANGE_010_Rx}, {application-record-element=DET_RANGE_011_Rx, system-signal=DET_RANGE_011_Rx}, {application-record-element=DET_RANGE_012_Rx, system-signal=DET_RANGE_012_Rx}, {application-record-element=DET_RANGE_ERR_009_Rx, system-signal=DET_RANGE_ERR_009_Rx}, {application-record-element=DET_RANGE_ERR_010_Rx, system-signal=DET_RANGE_ERR_010_Rx}, {application-record-element=DET_RANGE_ERR_011_Rx, system-signal=DET_RANGE_ERR_011_Rx}, {application-record-element=DET_RANGE_ERR_012_Rx, system-signal=DET_RANGE_ERR_012_Rx}, {application-record-element=DET_RANGE_VELOCITY_009_Rx, system-signal=DET_RANGE_VELOCITY_009_Rx}, {application-record-element=DET_RANGE_VELOCITY_010_Rx, system-signal=DET_RANGE_VELOCITY_010_Rx}, {application-record-element=DET_RANGE_VELOCITY_011_Rx, system-signal=DET_RANGE_VELOCITY_011_Rx}, {application-record-element=DET_RANGE_VELOCITY_012_Rx, system-signal=DET_RANGE_VELOCITY_012_Rx}, {application-record-element=DET_RANGE_VELOCITY_ERR_009_Rx, system-signal=DET_RANGE_VELOCITY_ERR_009_Rx}, {application-record-element=DET_RANGE_VELOCITY_ERR_010_Rx, system-signal=DET_RANGE_VELOCITY_ERR_010_Rx}, {application-record-element=DET_RANGE_VELOCITY_ERR_011_Rx, system-signal=DET_RANGE_VELOCITY_ERR_011_Rx}, {application-record-element=DET_RANGE_VELOCITY_ERR_012_Rx, system-signal=DET_RANGE_VELOCITY_ERR_012_Rx}, {application-record-element=DET_RCS_009_Rx, system-signal=DET_RCS_009_Rx}, {application-record-element=DET_RCS_010_Rx, system-signal=DET_RCS_010_Rx}, {application-record-element=DET_RCS_011_Rx, system-signal=DET_RCS_011_Rx}, {application-record-element=DET_RCS_012_Rx, system-signal=DET_RCS_012_Rx}, {application-record-element=DET_SNR_009_Rx, system-signal=DET_SNR_009_Rx}, {application-record-element=DET_SNR_010_Rx, system-signal=DET_SNR_010_Rx}, {application-record-element=DET_SNR_011_Rx, system-signal=DET_SNR_011_Rx}, {application-record-element=DET_SNR_012_Rx, system-signal=DET_SNR_012_Rx}, {application-record-element=DET_SUPER_RES_TARGET_009_Rx, system-signal=DET_SUPER_RES_TARGET_009_Rx}, {application-record-element=DET_SUPER_RES_TARGET_010_Rx, system-signal=DET_SUPER_RES_TARGET_010_Rx}, {application-record-element=DET_SUPER_RES_TARGET_011_Rx, system-signal=DET_SUPER_RES_TARGET_011_Rx}, {application-record-element=DET_SUPER_RES_TARGET_012_Rx, system-signal=DET_SUPER_RES_TARGET_012_Rx}]}
        sender-receiver-to-signal-group-mapping={data-element=COMPOSITIONTYPE.Rp_SG_Fusion_Detections_013_016_AL.Vdp_SG_Fusion_Detections_013_016_AL, signal-group=SG_Fusion_Detections_013_016, type-mapping=sender-rec-record-type-mapping=record-element-mappings=[{application-record-element=DET_AZIMUTH_013_Rx, system-signal=DET_AZIMUTH_013_Rx}, {application-record-element=DET_AZIMUTH_014_Rx, system-signal=DET_AZIMUTH_014_Rx}, {application-record-element=DET_AZIMUTH_015_Rx, system-signal=DET_AZIMUTH_015_Rx}, {application-record-element=DET_AZIMUTH_016_Rx, system-signal=DET_AZIMUTH_016_Rx}, {application-record-element=DET_AZIMUTH_ERR_013_Rx, system-signal=DET_AZIMUTH_ERR_013_Rx}, {application-record-element=DET_AZIMUTH_ERR_014_Rx, system-signal=DET_AZIMUTH_ERR_014_Rx}, {application-record-element=DET_AZIMUTH_ERR_015_Rx, system-signal=DET_AZIMUTH_ERR_015_Rx}, {application-record-element=DET_AZIMUTH_ERR_016_Rx, system-signal=DET_AZIMUTH_ERR_016_Rx}, {application-record-element=DET_BELOW_RAIN_THOLD_013_Rx, system-signal=DET_BELOW_RAIN_THOLD_013_Rx}, {application-record-element=DET_BELOW_RAIN_THOLD_014_Rx, system-signal=DET_BELOW_RAIN_THOLD_014_Rx}, {application-record-element=DET_BELOW_RAIN_THOLD_015_Rx, system-signal=DET_BELOW_RAIN_THOLD_015_Rx}, {application-record-element=DET_BELOW_RAIN_THOLD_016_Rx, system-signal=DET_BELOW_RAIN_THOLD_016_Rx}, {application-record-element=DET_BI_STATIC_FLAG_013_Rx, system-signal=DET_BI_STATIC_FLAG_013_Rx}, {application-record-element=DET_BI_STATIC_FLAG_014_Rx, system-signal=DET_BI_STATIC_FLAG_014_Rx}, {application-record-element=DET_BI_STATIC_FLAG_015_Rx, system-signal=DET_BI_STATIC_FLAG_015_Rx}, {application-record-element=DET_BI_STATIC_FLAG_016_Rx, system-signal=DET_BI_STATIC_FLAG_016_Rx}, {application-record-element=DET_CONFD_AZIMUTH_013_Rx, system-signal=DET_CONFD_AZIMUTH_013_Rx}, {application-record-element=DET_CONFD_AZIMUTH_014_Rx, system-signal=DET_CONFD_AZIMUTH_014_Rx}, {application-record-element=DET_CONFD_AZIMUTH_015_Rx, system-signal=DET_CONFD_AZIMUTH_015_Rx}, {application-record-element=DET_CONFD_AZIMUTH_016_Rx, system-signal=DET_CONFD_AZIMUTH_016_Rx}, {application-record-element=DET_CONFD_ELEVATION_013_Rx, system-signal=DET_CONFD_ELEVATION_013_Rx}, {application-record-element=DET_CONFD_ELEVATION_014_Rx, system-signal=DET_CONFD_ELEVATION_014_Rx}, {application-record-element=DET_CONFD_ELEVATION_015_Rx, system-signal=DET_CONFD_ELEVATION_015_Rx}, {application-record-element=DET_CONFD_ELEVATION_016_Rx, system-signal=DET_CONFD_ELEVATION_016_Rx}, {application-record-element=DET_ELEVATION_013_Rx, system-signal=DET_ELEVATION_013_Rx}, {application-record-element=DET_ELEVATION_014_Rx, system-signal=DET_ELEVATION_014_Rx}, {application-record-element=DET_ELEVATION_015_Rx, system-signal=DET_ELEVATION_015_Rx}, {application-record-element=DET_ELEVATION_016_Rx, system-signal=DET_ELEVATION_016_Rx}, {application-record-element=DET_ELEVATION_ERR_013_Rx, system-signal=DET_ELEVATION_ERR_013_Rx}, {application-record-element=DET_ELEVATION_ERR_014_Rx, system-signal=DET_ELEVATION_ERR_014_Rx}, {application-record-element=DET_ELEVATION_ERR_015_Rx, system-signal=DET_ELEVATION_ERR_015_Rx}, {application-record-element=DET_ELEVATION_ERR_016_Rx, system-signal=DET_ELEVATION_ERR_016_Rx}, {application-record-element=DET_EXISTENCE_PROB_013_Rx, system-signal=DET_EXISTENCE_PROB_013_Rx}, {application-record-element=DET_EXISTENCE_PROB_014_Rx, system-signal=DET_EXISTENCE_PROB_014_Rx}, {application-record-element=DET_EXISTENCE_PROB_015_Rx, system-signal=DET_EXISTENCE_PROB_015_Rx}, {application-record-element=DET_EXISTENCE_PROB_016_Rx, system-signal=DET_EXISTENCE_PROB_016_Rx}, {application-record-element=DET_HVC_FLAG_013_Rx, system-signal=DET_HVC_FLAG_013_Rx}, {application-record-element=DET_HVC_FLAG_014_Rx, system-signal=DET_HVC_FLAG_014_Rx}, {application-record-element=DET_HVC_FLAG_015_Rx, system-signal=DET_HVC_FLAG_015_Rx}, {application-record-element=DET_HVC_FLAG_016_Rx, system-signal=DET_HVC_FLAG_016_Rx}, {application-record-element=DET_IDM_013_Rx, system-signal=DET_IDM_013_Rx}, {application-record-element=DET_IDM_014_Rx, system-signal=DET_IDM_014_Rx}, {application-record-element=DET_IDM_015_Rx, system-signal=DET_IDM_015_Rx}, {application-record-element=DET_IDM_016_Rx, system-signal=DET_IDM_016_Rx}, {application-record-element=DET_MH_CRC16_013_016_Rx, system-signal=DET_MH_CRC16_013_016_Rx}, {application-record-element=DET_MH_CYCLE_COUNTER_013_016_Rx, system-signal=DET_MH_CYCLE_COUNTER_013_016_Rx}, {application-record-element=DET_MH_SCAN_INDEX_4LSB_013_016_Rx, system-signal=DET_MH_SCAN_INDEX_4LSB_013_016_Rx}, {application-record-element=DET_MTD_013_Rx, system-signal=DET_MTD_013_Rx}, {application-record-element=DET_MTD_014_Rx, system-signal=DET_MTD_014_Rx}, {application-record-element=DET_MTD_015_Rx, system-signal=DET_MTD_015_Rx}, {application-record-element=DET_MTD_016_Rx, system-signal=DET_MTD_016_Rx}, {application-record-element=DET_PROB_1STAZHYPO_013_Rx, system-signal=DET_PROB_1STAZHYPO_013_Rx}, {application-record-element=DET_PROB_1STAZHYPO_014_Rx, system-signal=DET_PROB_1STAZHYPO_014_Rx}, {application-record-element=DET_PROB_1STAZHYPO_015_Rx, system-signal=DET_PROB_1STAZHYPO_015_Rx}, {application-record-element=DET_PROB_1STAZHYPO_016_Rx, system-signal=DET_PROB_1STAZHYPO_016_Rx}, {application-record-element=DET_RANGE_013_Rx, system-signal=DET_RANGE_013_Rx}, {application-record-element=DET_RANGE_014_Rx, system-signal=DET_RANGE_014_Rx}, {application-record-element=DET_RANGE_015_Rx, system-signal=DET_RANGE_015_Rx}, {application-record-element=DET_RANGE_016_Rx, system-signal=DET_RANGE_016_Rx}, {application-record-element=DET_RANGE_ERR_013_Rx, system-signal=DET_RANGE_ERR_013_Rx}, {application-record-element=DET_RANGE_ERR_014_Rx, system-signal=DET_RANGE_ERR_014_Rx}, {application-record-element=DET_RANGE_ERR_015_Rx, system-signal=DET_RANGE_ERR_015_Rx}, {application-record-element=DET_RANGE_ERR_016_Rx, system-signal=DET_RANGE_ERR_016_Rx}, {application-record-element=DET_RANGE_VELOCITY_013_Rx, system-signal=DET_RANGE_VELOCITY_013_Rx}, {application-record-element=DET_RANGE_VELOCITY_014_Rx, system-signal=DET_RANGE_VELOCITY_014_Rx}, {application-record-element=DET_RANGE_VELOCITY_015_Rx, system-signal=DET_RANGE_VELOCITY_015_Rx}, {application-record-element=DET_RANGE_VELOCITY_016_Rx, system-signal=DET_RANGE_VELOCITY_016_Rx}, {application-record-element=DET_RANGE_VELOCITY_ERR_013_Rx, system-signal=DET_RANGE_VELOCITY_ERR_013_Rx}, {application-record-element=DET_RANGE_VELOCITY_ERR_014_Rx, system-signal=DET_RANGE_VELOCITY_ERR_014_Rx}, {application-record-element=DET_RANGE_VELOCITY_ERR_015_Rx, system-signal=DET_RANGE_VELOCITY_ERR_015_Rx}, {application-record-element=DET_RANGE_VELOCITY_ERR_016_Rx, system-signal=DET_RANGE_VELOCITY_ERR_016_Rx}, {application-record-element=DET_RCS_013_Rx, system-signal=DET_RCS_013_Rx}, {application-record-element=DET_RCS_014_Rx, system-signal=DET_RCS_014_Rx}, {application-record-element=DET_RCS_015_Rx, system-signal=DET_RCS_015_Rx}, {application-record-element=DET_RCS_016_Rx, system-signal=DET_RCS_016_Rx}, {application-record-element=DET_SNR_013_Rx, system-signal=DET_SNR_013_Rx}, {application-record-element=DET_SNR_014_Rx, system-signal=DET_SNR_014_Rx}, {application-record-element=DET_SNR_015_Rx, system-signal=DET_SNR_015_Rx}, {application-record-element=DET_SNR_016_Rx, system-signal=DET_SNR_016_Rx}, {application-record-element=DET_SUPER_RES_TARGET_013_Rx, system-signal=DET_SUPER_RES_TARGET_013_Rx}, {application-record-element=DET_SUPER_RES_TARGET_014_Rx, system-signal=DET_SUPER_RES_TARGET_014_Rx}, {application-record-element=DET_SUPER_RES_TARGET_015_Rx, system-signal=DET_SUPER_RES_TARGET_015_Rx}, {application-record-element=DET_SUPER_RES_TARGET_016_Rx, system-signal=DET_SUPER_RES_TARGET_016_Rx}]}
        sender-receiver-to-signal-group-mapping={data-element=COMPOSITIONTYPE.Rp_SG_Fusion_Detections_017_020_AL.Vdp_SG_Fusion_Detections_017_020_AL, signal-group=SG_Fusion_Detections_017_020, type-mapping=sender-rec-record-type-mapping=record-element-mappings=[{application-record-element=DET_AZIMUTH_017_Rx, system-signal=DET_AZIMUTH_017_Rx}, {application-record-element=DET_AZIMUTH_018_Rx, system-signal=DET_AZIMUTH_018_Rx}, {application-record-element=DET_AZIMUTH_019_Rx, system-signal=DET_AZIMUTH_019_Rx}, {application-record-element=DET_AZIMUTH_020_Rx, system-signal=DET_AZIMUTH_020_Rx}, {application-record-element=DET_AZIMUTH_ERR_017_Rx, system-signal=DET_AZIMUTH_ERR_017_Rx}, {application-record-element=DET_AZIMUTH_ERR_018_Rx, system-signal=DET_AZIMUTH_ERR_018_Rx}, {application-record-element=DET_AZIMUTH_ERR_019_Rx, system-signal=DET_AZIMUTH_ERR_019_Rx}, {application-record-element=DET_AZIMUTH_ERR_020_Rx, system-signal=DET_AZIMUTH_ERR_020_Rx}, {application-record-element=DET_BELOW_RAIN_THOLD_017_Rx, system-signal=DET_BELOW_RAIN_THOLD_017_Rx}, {application-record-element=DET_BELOW_RAIN_THOLD_018_Rx, system-signal=DET_BELOW_RAIN_THOLD_018_Rx}, {application-record-element=DET_BELOW_RAIN_THOLD_019_Rx, system-signal=DET_BELOW_RAIN_THOLD_019_Rx}, {application-record-element=DET_BELOW_RAIN_THOLD_020_Rx, system-signal=DET_BELOW_RAIN_THOLD_020_Rx}, {application-record-element=DET_BI_STATIC_FLAG_017_Rx, system-signal=DET_BI_STATIC_FLAG_017_Rx}, {application-record-element=DET_BI_STATIC_FLAG_018_Rx, system-signal=DET_BI_STATIC_FLAG_018_Rx}, {application-record-element=DET_BI_STATIC_FLAG_019_Rx, system-signal=DET_BI_STATIC_FLAG_019_Rx}, {application-record-element=DET_BI_STATIC_FLAG_020_Rx, system-signal=DET_BI_STATIC_FLAG_020_Rx}, {application-record-element=DET_CONFD_AZIMUTH_017_Rx, system-signal=DET_CONFD_AZIMUTH_017_Rx}, {application-record-element=DET_CONFD_AZIMUTH_018_Rx, system-signal=DET_CONFD_AZIMUTH_018_Rx}, {application-record-element=DET_CONFD_AZIMUTH_019_Rx, system-signal=DET_CONFD_AZIMUTH_019_Rx}, {application-record-element=DET_CONFD_AZIMUTH_020_Rx, system-signal=DET_CONFD_AZIMUTH_020_Rx}, {application-record-element=DET_CONFD_ELEVATION_017_Rx, system-signal=DET_CONFD_ELEVATION_017_Rx}, {application-record-element=DET_CONFD_ELEVATION_018_Rx, system-signal=DET_CONFD_ELEVATION_018_Rx}, {application-record-element=DET_CONFD_ELEVATION_019_Rx, system-signal=DET_CONFD_ELEVATION_019_Rx}, {application-record-element=DET_CONFD_ELEVATION_020_Rx, system-signal=DET_CONFD_ELEVATION_020_Rx}, {application-record-element=DET_ELEVATION_017_Rx, system-signal=DET_ELEVATION_017_Rx}, {application-record-element=DET_ELEVATION_018_Rx, system-signal=DET_ELEVATION_018_Rx}, {application-record-element=DET_ELEVATION_019_Rx, system-signal=DET_ELEVATION_019_Rx}, {application-record-element=DET_ELEVATION_020_Rx, system-signal=DET_ELEVATION_020_Rx}, {application-record-element=DET_ELEVATION_ERR_017_Rx, system-signal=DET_ELEVATION_ERR_017_Rx}, {application-record-element=DET_ELEVATION_ERR_018_Rx, system-signal=DET_ELEVATION_ERR_018_Rx}, {application-record-element=DET_ELEVATION_ERR_019_Rx, system-signal=DET_ELEVATION_ERR_019_Rx}, {application-record-element=DET_ELEVATION_ERR_020_Rx, system-signal=DET_ELEVATION_ERR_020_Rx}, {application-record-element=DET_EXISTENCE_PROB_017_Rx, system-signal=DET_EXISTENCE_PROB_017_Rx}, {application-record-element=DET_EXISTENCE_PROB_018_Rx, system-signal=DET_EXISTENCE_PROB_018_Rx}, {application-record-element=DET_EXISTENCE_PROB_019_Rx, system-signal=DET_EXISTENCE_PROB_019_Rx}, {application-record-element=DET_EXISTENCE_PROB_020_Rx, system-signal=DET_EXISTENCE_PROB_020_Rx}, {application-record-element=DET_HVC_FLAG_017_Rx, system-signal=DET_HVC_FLAG_017_Rx}, {application-record-element=DET_HVC_FLAG_018_Rx, system-signal=DET_HVC_FLAG_018_Rx}, {application-record-element=DET_HVC_FLAG_019_Rx, system-signal=DET_HVC_FLAG_019_Rx}, {application-record-element=DET_HVC_FLAG_020_Rx, system-signal=DET_HVC_FLAG_020_Rx}, {application-record-element=DET_IDM_017_Rx, system-signal=DET_IDM_017_Rx}, {application-record-element=DET_IDM_018_Rx, system-signal=DET_IDM_018_Rx}, {application-record-element=DET_IDM_019_Rx, system-signal=DET_IDM_019_Rx}, {application-record-element=DET_IDM_020_Rx, system-signal=DET_IDM_020_Rx}, {application-record-element=DET_MH_CRC16_017_020_Rx, system-signal=DET_MH_CRC16_017_020_Rx}, {application-record-element=DET_MH_CYCLE_COUNTER_017_020_Rx, system-signal=DET_MH_CYCLE_COUNTER_017_020_Rx}, {application-record-element=DET_MH_SCAN_INDEX_4LSB_017_020_Rx, system-signal=DET_MH_SCAN_INDEX_4LSB_017_020_Rx}, {application-record-element=DET_MTD_017_Rx, system-signal=DET_MTD_017_Rx}, {application-record-element=DET_MTD_018_Rx, system-signal=DET_MTD_018_Rx}, {application-record-element=DET_MTD_019_Rx, system-signal=DET_MTD_019_Rx}, {application-record-element=DET_MTD_020_Rx, system-signal=DET_MTD_020_Rx}, {application-record-element=DET_PROB_1STAZHYPO_017_Rx, system-signal=DET_PROB_1STAZHYPO_017_Rx}, {application-record-element=DET_PROB_1STAZHYPO_018_Rx, system-signal=DET_PROB_1STAZHYPO_018_Rx}, {application-record-element=DET_PROB_1STAZHYPO_019_Rx, system-signal=DET_PROB_1STAZHYPO_019_Rx}, {application-record-element=DET_PROB_1STAZHYPO_020_Rx, system-signal=DET_PROB_1STAZHYPO_020_Rx}, {application-record-element=DET_RANGE_017_Rx, system-signal=DET_RANGE_017_Rx}, {application-record-element=DET_RANGE_018_Rx, system-signal=DET_RANGE_018_Rx}, {application-record-element=DET_RANGE_019_Rx, system-signal=DET_RANGE_019_Rx}, {application-record-element=DET_RANGE_020_Rx, system-signal=DET_RANGE_020_Rx}, {application-record-element=DET_RANGE_ERR_017_Rx, system-signal=DET_RANGE_ERR_017_Rx}, {application-record-element=DET_RANGE_ERR_018_Rx, system-signal=DET_RANGE_ERR_018_Rx}, {application-record-element=DET_RANGE_ERR_019_Rx, system-signal=DET_RANGE_ERR_019_Rx}, {application-record-element=DET_RANGE_ERR_020_Rx, system-signal=DET_RANGE_ERR_020_Rx}, {application-record-element=DET_RANGE_VELOCITY_017_Rx, system-signal=DET_RANGE_VELOCITY_017_Rx}, {application-record-element=DET_RANGE_VELOCITY_018_Rx, system-signal=DET_RANGE_VELOCITY_018_Rx}, {application-record-element=DET_RANGE_VELOCITY_019_Rx, system-signal=DET_RANGE_VELOCITY_019_Rx}, {application-record-element=DET_RANGE_VELOCITY_020_Rx, system-signal=DET_RANGE_VELOCITY_020_Rx}, {application-record-element=DET_RANGE_VELOCITY_ERR_017_Rx, system-signal=DET_RANGE_VELOCITY_ERR_017_Rx}, {application-record-element=DET_RANGE_VELOCITY_ERR_018_Rx, system-signal=DET_RANGE_VELOCITY_ERR_018_Rx}, {application-record-element=DET_RANGE_VELOCITY_ERR_019_Rx, system-signal=DET_RANGE_VELOCITY_ERR_019_Rx}, {application-record-element=DET_RANGE_VELOCITY_ERR_020_Rx, system-signal=DET_RANGE_VELOCITY_ERR_020_Rx}, {application-record-element=DET_RCS_017_Rx, system-signal=DET_RCS_017_Rx}, {application-record-element=DET_RCS_018_Rx, system-signal=DET_RCS_018_Rx}, {application-record-element=DET_RCS_019_Rx, system-signal=DET_RCS_019_Rx}, {application-record-element=DET_RCS_020_Rx, system-signal=DET_RCS_020_Rx}, {application-record-element=DET_SNR_017_Rx, system-signal=DET_SNR_017_Rx}, {application-record-element=DET_SNR_018_Rx, system-signal=DET_SNR_018_Rx}, {application-record-element=DET_SNR_019_Rx, system-signal=DET_SNR_019_Rx}, {application-record-element=DET_SNR_020_Rx, system-signal=DET_SNR_020_Rx}, {application-record-element=DET_SUPER_RES_TARGET_017_Rx, system-signal=DET_SUPER_RES_TARGET_017_Rx}, {application-record-element=DET_SUPER_RES_TARGET_018_Rx, system-signal=DET_SUPER_RES_TARGET_018_Rx}, {application-record-element=DET_SUPER_RES_TARGET_019_Rx, system-signal=DET_SUPER_RES_TARGET_019_Rx}, {application-record-element=DET_SUPER_RES_TARGET_020_Rx, system-signal=DET_SUPER_RES_TARGET_020_Rx}]}
        sender-receiver-to-signal-group-mapping={data-element=COMPOSITIONTYPE.Rp_SG_Fusion_Detections_021_024_AL.Vdp_SG_Fusion_Detections_021_024_AL, signal-group=SG_Fusion_Detections_021_024, type-mapping=sender-rec-record-type-mapping=record-element-mappings=[{application-record-element=DET_AZIMUTH_021_Rx, system-signal=DET_AZIMUTH_021_Rx}, {application-record-element=DET_AZIMUTH_022_Rx, system-signal=DET_AZIMUTH_022_Rx}, {application-record-element=DET_AZIMUTH_023_Rx, system-signal=DET_AZIMUTH_023_Rx}, {application-record-element=DET_AZIMUTH_024_Rx, system-signal=DET_AZIMUTH_024_Rx}, {application-record-element=DET_AZIMUTH_ERR_021_Rx, system-signal=DET_AZIMUTH_ERR_021_Rx}, {application-record-element=DET_AZIMUTH_ERR_022_Rx, system-signal=DET_AZIMUTH_ERR_022_Rx}, {application-record-element=DET_AZIMUTH_ERR_023_Rx, system-signal=DET_AZIMUTH_ERR_023_Rx}, {application-record-element=DET_AZIMUTH_ERR_024_Rx, system-signal=DET_AZIMUTH_ERR_024_Rx}, {application-record-element=DET_BELOW_RAIN_THOLD_021_Rx, system-signal=DET_BELOW_RAIN_THOLD_021_Rx}, {application-record-element=DET_BELOW_RAIN_THOLD_022_Rx, system-signal=DET_BELOW_RAIN_THOLD_022_Rx}, {application-record-element=DET_BELOW_RAIN_THOLD_023_Rx, system-signal=DET_BELOW_RAIN_THOLD_023_Rx}, {application-record-element=DET_BELOW_RAIN_THOLD_024_Rx, system-signal=DET_BELOW_RAIN_THOLD_024_Rx}, {application-record-element=DET_BI_STATIC_FLAG_021_Rx, system-signal=DET_BI_STATIC_FLAG_021_Rx}, {application-record-element=DET_BI_STATIC_FLAG_022_Rx, system-signal=DET_BI_STATIC_FLAG_022_Rx}, {application-record-element=DET_BI_STATIC_FLAG_023_Rx, system-signal=DET_BI_STATIC_FLAG_023_Rx}, {application-record-element=DET_BI_STATIC_FLAG_024_Rx, system-signal=DET_BI_STATIC_FLAG_024_Rx}, {application-record-element=DET_CONFD_AZIMUTH_021_Rx, system-signal=DET_CONFD_AZIMUTH_021_Rx}, {application-record-element=DET_CONFD_AZIMUTH_022_Rx, system-signal=DET_CONFD_AZIMUTH_022_Rx}, {application-record-element=DET_CONFD_AZIMUTH_023_Rx, system-signal=DET_CONFD_AZIMUTH_023_Rx}, {application-record-element=DET_CONFD_AZIMUTH_024_Rx, system-signal=DET_CONFD_AZIMUTH_024_Rx}, {application-record-element=DET_CONFD_ELEVATION_021_Rx, system-signal=DET_CONFD_ELEVATION_021_Rx}, {application-record-element=DET_CONFD_ELEVATION_022_Rx, system-signal=DET_CONFD_ELEVATION_022_Rx}, {application-record-element=DET_CONFD_ELEVATION_023_Rx, system-signal=DET_CONFD_ELEVATION_023_Rx}, {application-record-element=DET_CONFD_ELEVATION_024_Rx, system-signal=DET_CONFD_ELEVATION_024_Rx}, {application-record-element=DET_ELEVATION_021_Rx, system-signal=DET_ELEVATION_021_Rx}, {application-record-element=DET_ELEVATION_022_Rx, system-signal=DET_ELEVATION_022_Rx}, {application-record-element=DET_ELEVATION_023_Rx, system-signal=DET_ELEVATION_023_Rx}, {application-record-element=DET_ELEVATION_024_Rx, system-signal=DET_ELEVATION_024_Rx}, {application-record-element=DET_ELEVATION_ERR_021_Rx, system-signal=DET_ELEVATION_ERR_021_Rx}, {application-record-element=DET_ELEVATION_ERR_022_Rx, system-signal=DET_ELEVATION_ERR_022_Rx}, {application-record-element=DET_ELEVATION_ERR_023_Rx, system-signal=DET_ELEVATION_ERR_023_Rx}, {application-record-element=DET_ELEVATION_ERR_024_Rx, system-signal=DET_ELEVATION_ERR_024_Rx}, {application-record-element=DET_EXISTENCE_PROB_021_Rx, system-signal=DET_EXISTENCE_PROB_021_Rx}, {application-record-element=DET_EXISTENCE_PROB_022_Rx, system-signal=DET_EXISTENCE_PROB_022_Rx}, {application-record-element=DET_EXISTENCE_PROB_023_Rx, system-signal=DET_EXISTENCE_PROB_023_Rx}, {application-record-element=DET_EXISTENCE_PROB_024_Rx, system-signal=DET_EXISTENCE_PROB_024_Rx}, {application-record-element=DET_HVC_FLAG_021_Rx, system-signal=DET_HVC_FLAG_021_Rx}, {application-record-element=DET_HVC_FLAG_022_Rx, system-signal=DET_HVC_FLAG_022_Rx}, {application-record-element=DET_HVC_FLAG_023_Rx, system-signal=DET_HVC_FLAG_023_Rx}, {application-record-element=DET_HVC_FLAG_024_Rx, system-signal=DET_HVC_FLAG_024_Rx}, {application-record-element=DET_IDM_021_Rx, system-signal=DET_IDM_021_Rx}, {application-record-element=DET_IDM_022_Rx, system-signal=DET_IDM_022_Rx}, {application-record-element=DET_IDM_023_Rx, system-signal=DET_IDM_023_Rx}, {application-record-element=DET_IDM_024_Rx, system-signal=DET_IDM_024_Rx}, {application-record-element=DET_MH_CRC16_021_024_Rx, system-signal=DET_MH_CRC16_021_024_Rx}, {application-record-element=DET_MH_CYCLE_COUNTER_021_024_Rx, system-signal=DET_MH_CYCLE_COUNTER_021_024_Rx}, {application-record-element=DET_MH_SCAN_INDEX_4LSB_021_024_Rx, system-signal=DET_MH_SCAN_INDEX_4LSB_021_024_Rx}, {application-record-element=DET_MTD_021_Rx, system-signal=DET_MTD_021_Rx}, {application-record-element=DET_MTD_022_Rx, system-signal=DET_MTD_022_Rx}, {application-record-element=DET_MTD_023_Rx, system-signal=DET_MTD_023_Rx}, {application-record-element=DET_MTD_024_Rx, system-signal=DET_MTD_024_Rx}, {application-record-element=DET_PROB_1STAZHYPO_021_Rx, system-signal=DET_PROB_1STAZHYPO_021_Rx}, {application-record-element=DET_PROB_1STAZHYPO_022_Rx, system-signal=DET_PROB_1STAZHYPO_022_Rx}, {application-record-element=DET_PROB_1STAZHYPO_023_Rx, system-signal=DET_PROB_1STAZHYPO_023_Rx}, {application-record-element=DET_PROB_1STAZHYPO_024_Rx, system-signal=DET_PROB_1STAZHYPO_024_Rx}, {application-record-element=DET_RANGE_021_Rx, system-signal=DET_RANGE_021_Rx}, {application-record-element=DET_RANGE_022_Rx, system-signal=DET_RANGE_022_Rx}, {application-record-element=DET_RANGE_023_Rx, system-signal=DET_RANGE_023_Rx}, {application-record-element=DET_RANGE_024_Rx, system-signal=DET_RANGE_024_Rx}, {application-record-element=DET_RANGE_ERR_021_Rx, system-signal=DET_RANGE_ERR_021_Rx}, {application-record-element=DET_RANGE_ERR_022_Rx, system-signal=DET_RANGE_ERR_022_Rx}, {application-record-element=DET_RANGE_ERR_023_Rx, system-signal=DET_RANGE_ERR_023_Rx}, {application-record-element=DET_RANGE_ERR_024_Rx, system-signal=DET_RANGE_ERR_024_Rx}, {application-record-element=DET_RANGE_VELOCITY_021_Rx, system-signal=DET_RANGE_VELOCITY_021_Rx}, {application-record-element=DET_RANGE_VELOCITY_022_Rx, system-signal=DET_RANGE_VELOCITY_022_Rx}, {application-record-element=DET_RANGE_VELOCITY_023_Rx, system-signal=DET_RANGE_VELOCITY_023_Rx}, {application-record-element=DET_RANGE_VELOCITY_024_Rx, system-signal=DET_RANGE_VELOCITY_024_Rx}, {application-record-element=DET_RANGE_VELOCITY_ERR_021_Rx, system-signal=DET_RANGE_VELOCITY_ERR_021_Rx}, {application-record-element=DET_RANGE_VELOCITY_ERR_022_Rx, system-signal=DET_RANGE_VELOCITY_ERR_022_Rx}, {application-record-element=DET_RANGE_VELOCITY_ERR_023_Rx, system-signal=DET_RANGE_VELOCITY_ERR_023_Rx}, {application-record-element=DET_RANGE_VELOCITY_ERR_024_Rx, system-signal=DET_RANGE_VELOCITY_ERR_024_Rx}, {application-record-element=DET_RCS_021_Rx, system-signal=DET_RCS_021_Rx}, {application-record-element=DET_RCS_022_Rx, system-signal=DET_RCS_022_Rx}, {application-record-element=DET_RCS_023_Rx, system-signal=DET_RCS_023_Rx}, {application-record-element=DET_RCS_024_Rx, system-signal=DET_RCS_024_Rx}, {application-record-element=DET_SNR_021_Rx, system-signal=DET_SNR_021_Rx}, {application-record-element=DET_SNR_022_Rx, system-signal=DET_SNR_022_Rx}, {application-record-element=DET_SNR_023_Rx, system-signal=DET_SNR_023_Rx}, {application-record-element=DET_SNR_024_Rx, system-signal=DET_SNR_024_Rx}, {application-record-element=DET_SUPER_RES_TARGET_021_Rx, system-signal=DET_SUPER_RES_TARGET_021_Rx}, {application-record-element=DET_SUPER_RES_TARGET_022_Rx, system-signal=DET_SUPER_RES_TARGET_022_Rx}, {application-record-element=DET_SUPER_RES_TARGET_023_Rx, system-signal=DET_SUPER_RES_TARGET_023_Rx}, {application-record-element=DET_SUPER_RES_TARGET_024_Rx, system-signal=DET_SUPER_RES_TARGET_024_Rx}]}
        sender-receiver-to-signal-group-mapping={data-element=COMPOSITIONTYPE.Rp_SG_Fusion_Detections_025_028_AL.Vdp_SG_Fusion_Detections_025_028_AL, signal-group=SG_Fusion_Detections_025_028, type-mapping=sender-rec-record-type-mapping=record-element-mappings=[{application-record-element=DET_AZIMUTH_025_Rx, system-signal=DET_AZIMUTH_025_Rx}, {application-record-element=DET_AZIMUTH_026_Rx, system-signal=DET_AZIMUTH_026_Rx}, {application-record-element=DET_AZIMUTH_027_Rx, system-signal=DET_AZIMUTH_027_Rx}, {application-record-element=DET_AZIMUTH_028_Rx, system-signal=DET_AZIMUTH_028_Rx}, {application-record-element=DET_AZIMUTH_ERR_025_Rx, system-signal=DET_AZIMUTH_ERR_025_Rx}, {application-record-element=DET_AZIMUTH_ERR_026_Rx, system-signal=DET_AZIMUTH_ERR_026_Rx}, {application-record-element=DET_AZIMUTH_ERR_027_Rx, system-signal=DET_AZIMUTH_ERR_027_Rx}, {application-record-element=DET_AZIMUTH_ERR_028_Rx, system-signal=DET_AZIMUTH_ERR_028_Rx}, {application-record-element=DET_BELOW_RAIN_THOLD_025_Rx, system-signal=DET_BELOW_RAIN_THOLD_025_Rx}, {application-record-element=DET_BELOW_RAIN_THOLD_026_Rx, system-signal=DET_BELOW_RAIN_THOLD_026_Rx}, {application-record-element=DET_BELOW_RAIN_THOLD_027_Rx, system-signal=DET_BELOW_RAIN_THOLD_027_Rx}, {application-record-element=DET_BELOW_RAIN_THOLD_028_Rx, system-signal=DET_BELOW_RAIN_THOLD_028_Rx}, {application-record-element=DET_BI_STATIC_FLAG_025_Rx, system-signal=DET_BI_STATIC_FLAG_025_Rx}, {application-record-element=DET_BI_STATIC_FLAG_026_Rx, system-signal=DET_BI_STATIC_FLAG_026_Rx}, {application-record-element=DET_BI_STATIC_FLAG_027_Rx, system-signal=DET_BI_STATIC_FLAG_027_Rx}, {application-record-element=DET_BI_STATIC_FLAG_028_Rx, system-signal=DET_BI_STATIC_FLAG_028_Rx}, {application-record-element=DET_CONFD_AZIMUTH_025_Rx, system-signal=DET_CONFD_AZIMUTH_025_Rx}, {application-record-element=DET_CONFD_AZIMUTH_026_Rx, system-signal=DET_CONFD_AZIMUTH_026_Rx}, {application-record-element=DET_CONFD_AZIMUTH_027_Rx, system-signal=DET_CONFD_AZIMUTH_027_Rx}, {application-record-element=DET_CONFD_AZIMUTH_028_Rx, system-signal=DET_CONFD_AZIMUTH_028_Rx}, {application-record-element=DET_CONFD_ELEVATION_025_Rx, system-signal=DET_CONFD_ELEVATION_025_Rx}, {application-record-element=DET_CONFD_ELEVATION_026_Rx, system-signal=DET_CONFD_ELEVATION_026_Rx}, {application-record-element=DET_CONFD_ELEVATION_027_Rx, system-signal=DET_CONFD_ELEVATION_027_Rx}, {application-record-element=DET_CONFD_ELEVATION_028_Rx, system-signal=DET_CONFD_ELEVATION_028_Rx}, {application-record-element=DET_ELEVATION_025_Rx, system-signal=DET_ELEVATION_025_Rx}, {application-record-element=DET_ELEVATION_026_Rx, system-signal=DET_ELEVATION_026_Rx}, {application-record-element=DET_ELEVATION_027_Rx, system-signal=DET_ELEVATION_027_Rx}, {application-record-element=DET_ELEVATION_028_Rx, system-signal=DET_ELEVATION_028_Rx}, {application-record-element=DET_ELEVATION_ERR_025_Rx, system-signal=DET_ELEVATION_ERR_025_Rx}, {application-record-element=DET_ELEVATION_ERR_026_Rx, system-signal=DET_ELEVATION_ERR_026_Rx}, {application-record-element=DET_ELEVATION_ERR_027_Rx, system-signal=DET_ELEVATION_ERR_027_Rx}, {application-record-element=DET_ELEVATION_ERR_028_Rx, system-signal=DET_ELEVATION_ERR_028_Rx}, {application-record-element=DET_EXISTENCE_PROB_025_Rx, system-signal=DET_EXISTENCE_PROB_025_Rx}, {application-record-element=DET_EXISTENCE_PROB_026_Rx, system-signal=DET_EXISTENCE_PROB_026_Rx}, {application-record-element=DET_EXISTENCE_PROB_027_Rx, system-signal=DET_EXISTENCE_PROB_027_Rx}, {application-record-element=DET_EXISTENCE_PROB_028_Rx, system-signal=DET_EXISTENCE_PROB_028_Rx}, {application-record-element=DET_HVC_FLAG_025_Rx, system-signal=DET_HVC_FLAG_025_Rx}, {application-record-element=DET_HVC_FLAG_026_Rx, system-signal=DET_HVC_FLAG_026_Rx}, {application-record-element=DET_HVC_FLAG_027_Rx, system-signal=DET_HVC_FLAG_027_Rx}, {application-record-element=DET_HVC_FLAG_028_Rx, system-signal=DET_HVC_FLAG_028_Rx}, {application-record-element=DET_IDM_025_Rx, system-signal=DET_IDM_025_Rx}, {application-record-element=DET_IDM_026_Rx, system-signal=DET_IDM_026_Rx}, {application-record-element=DET_IDM_027_Rx, system-signal=DET_IDM_027_Rx}, {application-record-element=DET_IDM_028_Rx, system-signal=DET_IDM_028_Rx}, {application-record-element=DET_MH_CRC16_025_028_Rx, system-signal=DET_MH_CRC16_025_028_Rx}, {application-record-element=DET_MH_CYCLE_COUNTER_025_028_Rx, system-signal=DET_MH_CYCLE_COUNTER_025_028_Rx}, {application-record-element=DET_MH_SCAN_INDEX_4LSB_025_028_Rx, system-signal=DET_MH_SCAN_INDEX_4LSB_025_028_Rx}, {application-record-element=DET_MTD_025_Rx, system-signal=DET_MTD_025_Rx}, {application-record-element=DET_MTD_026_Rx, system-signal=DET_MTD_026_Rx}, {application-record-element=DET_MTD_027_Rx, system-signal=DET_MTD_027_Rx}, {application-record-element=DET_MTD_028_Rx, system-signal=DET_MTD_028_Rx}, {application-record-element=DET_PROB_1STAZHYPO_025_Rx, system-signal=DET_PROB_1STAZHYPO_025_Rx}, {application-record-element=DET_PROB_1STAZHYPO_026_Rx, system-signal=DET_PROB_1STAZHYPO_026_Rx}, {application-record-element=DET_PROB_1STAZHYPO_027_Rx, system-signal=DET_PROB_1STAZHYPO_027_Rx}, {application-record-element=DET_PROB_1STAZHYPO_028_Rx, system-signal=DET_PROB_1STAZHYPO_028_Rx}, {application-record-element=DET_RANGE_025_Rx, system-signal=DET_RANGE_025_Rx}, {application-record-element=DET_RANGE_026_Rx, system-signal=DET_RANGE_026_Rx}, {application-record-element=DET_RANGE_027_Rx, system-signal=DET_RANGE_027_Rx}, {application-record-element=DET_RANGE_028_Rx, system-signal=DET_RANGE_028_Rx}, {application-record-element=DET_RANGE_ERR_025_Rx, system-signal=DET_RANGE_ERR_025_Rx}, {application-record-element=DET_RANGE_ERR_026_Rx, system-signal=DET_RANGE_ERR_026_Rx}, {application-record-element=DET_RANGE_ERR_027_Rx, system-signal=DET_RANGE_ERR_027_Rx}, {application-record-element=DET_RANGE_ERR_028_Rx, system-signal=DET_RANGE_ERR_028_Rx}, {application-record-element=DET_RANGE_VELOCITY_025_Rx, system-signal=DET_RANGE_VELOCITY_025_Rx}, {application-record-element=DET_RANGE_VELOCITY_026_Rx, system-signal=DET_RANGE_VELOCITY_026_Rx}, {application-record-element=DET_RANGE_VELOCITY_027_Rx, system-signal=DET_RANGE_VELOCITY_027_Rx}, {application-record-element=DET_RANGE_VELOCITY_028_Rx, system-signal=DET_RANGE_VELOCITY_028_Rx}, {application-record-element=DET_RANGE_VELOCITY_ERR_025_Rx, system-signal=DET_RANGE_VELOCITY_ERR_025_Rx}, {application-record-element=DET_RANGE_VELOCITY_ERR_026_Rx, system-signal=DET_RANGE_VELOCITY_ERR_026_Rx}, {application-record-element=DET_RANGE_VELOCITY_ERR_027_Rx, system-signal=DET_RANGE_VELOCITY_ERR_027_Rx}, {application-record-element=DET_RANGE_VELOCITY_ERR_028_Rx, system-signal=DET_RANGE_VELOCITY_ERR_028_Rx}, {application-record-element=DET_RCS_025_Rx, system-signal=DET_RCS_025_Rx}, {application-record-element=DET_RCS_026_Rx, system-signal=DET_RCS_026_Rx}, {application-record-element=DET_RCS_027_Rx, system-signal=DET_RCS_027_Rx}, {application-record-element=DET_RCS_028_Rx, system-signal=DET_RCS_028_Rx}, {application-record-element=DET_SNR_025_Rx, system-signal=DET_SNR_025_Rx}, {application-record-element=DET_SNR_026_Rx, system-signal=DET_SNR_026_Rx}, {application-record-element=DET_SNR_027_Rx, system-signal=DET_SNR_027_Rx}, {application-record-element=DET_SNR_028_Rx, system-signal=DET_SNR_028_Rx}, {application-record-element=DET_SUPER_RES_TARGET_025_Rx, system-signal=DET_SUPER_RES_TARGET_025_Rx}, {application-record-element=DET_SUPER_RES_TARGET_026_Rx, system-signal=DET_SUPER_RES_TARGET_026_Rx}, {application-record-element=DET_SUPER_RES_TARGET_027_Rx, system-signal=DET_SUPER_RES_TARGET_027_Rx}, {application-record-element=DET_SUPER_RES_TARGET_028_Rx, system-signal=DET_SUPER_RES_TARGET_028_Rx}]}
        sender-receiver-to-signal-group-mapping={data-element=COMPOSITIONTYPE.Rp_SG_Fusion_Detections_029_032_AL.Vdp_SG_Fusion_Detections_029_032_AL, signal-group=SG_Fusion_Detections_029_032, type-mapping=sender-rec-record-type-mapping=record-element-mappings=[{application-record-element=DET_AZIMUTH_029_Rx, system-signal=DET_AZIMUTH_029_Rx}, {application-record-element=DET_AZIMUTH_030_Rx, system-signal=DET_AZIMUTH_030_Rx}, {application-record-element=DET_AZIMUTH_031_Rx, system-signal=DET_AZIMUTH_031_Rx}, {application-record-element=DET_AZIMUTH_032_Rx, system-signal=DET_AZIMUTH_032_Rx}, {application-record-element=DET_AZIMUTH_ERR_029_Rx, system-signal=DET_AZIMUTH_ERR_029_Rx}, {application-record-element=DET_AZIMUTH_ERR_030_Rx, system-signal=DET_AZIMUTH_ERR_030_Rx}, {application-record-element=DET_AZIMUTH_ERR_031_Rx, system-signal=DET_AZIMUTH_ERR_031_Rx}, {application-record-element=DET_AZIMUTH_ERR_032_Rx, system-signal=DET_AZIMUTH_ERR_032_Rx}, {application-record-element=DET_BELOW_RAIN_THOLD_029_Rx, system-signal=DET_BELOW_RAIN_THOLD_029_Rx}, {application-record-element=DET_BELOW_RAIN_THOLD_030_Rx, system-signal=DET_BELOW_RAIN_THOLD_030_Rx}, {application-record-element=DET_BELOW_RAIN_THOLD_031_Rx, system-signal=DET_BELOW_RAIN_THOLD_031_Rx}, {application-record-element=DET_BELOW_RAIN_THOLD_032_Rx, system-signal=DET_BELOW_RAIN_THOLD_032_Rx}, {application-record-element=DET_BI_STATIC_FLAG_029_Rx, system-signal=DET_BI_STATIC_FLAG_029_Rx}, {application-record-element=DET_BI_STATIC_FLAG_030_Rx, system-signal=DET_BI_STATIC_FLAG_030_Rx}, {application-record-element=DET_BI_STATIC_FLAG_031_Rx, system-signal=DET_BI_STATIC_FLAG_031_Rx}, {application-record-element=DET_BI_STATIC_FLAG_032_Rx, system-signal=DET_BI_STATIC_FLAG_032_Rx}, {application-record-element=DET_CONFD_AZIMUTH_029_Rx, system-signal=DET_CONFD_AZIMUTH_029_Rx}, {application-record-element=DET_CONFD_AZIMUTH_030_Rx, system-signal=DET_CONFD_AZIMUTH_030_Rx}, {application-record-element=DET_CONFD_AZIMUTH_031_Rx, system-signal=DET_CONFD_AZIMUTH_031_Rx}, {application-record-element=DET_CONFD_AZIMUTH_032_Rx, system-signal=DET_CONFD_AZIMUTH_032_Rx}, {application-record-element=DET_CONFD_ELEVATION_029_Rx, system-signal=DET_CONFD_ELEVATION_029_Rx}, {application-record-element=DET_CONFD_ELEVATION_030_Rx, system-signal=DET_CONFD_ELEVATION_030_Rx}, {application-record-element=DET_CONFD_ELEVATION_031_Rx, system-signal=DET_CONFD_ELEVATION_031_Rx}, {application-record-element=DET_CONFD_ELEVATION_032_Rx, system-signal=DET_CONFD_ELEVATION_032_Rx}, {application-record-element=DET_ELEVATION_029_Rx, system-signal=DET_ELEVATION_029_Rx}, {application-record-element=DET_ELEVATION_030_Rx, system-signal=DET_ELEVATION_030_Rx}, {application-record-element=DET_ELEVATION_031_Rx, system-signal=DET_ELEVATION_031_Rx}, {application-record-element=DET_ELEVATION_032_Rx, system-signal=DET_ELEVATION_032_Rx}, {application-record-element=DET_ELEVATION_ERR_029_Rx, system-signal=DET_ELEVATION_ERR_029_Rx}, {application-record-element=DET_ELEVATION_ERR_030_Rx, system-signal=DET_ELEVATION_ERR_030_Rx}, {application-record-element=DET_ELEVATION_ERR_031_Rx, system-signal=DET_ELEVATION_ERR_031_Rx}, {application-record-element=DET_ELEVATION_ERR_032_Rx, system-signal=DET_ELEVATION_ERR_032_Rx}, {application-record-element=DET_EXISTENCE_PROB_029_Rx, system-signal=DET_EXISTENCE_PROB_029_Rx}, {application-record-element=DET_EXISTENCE_PROB_030_Rx, system-signal=DET_EXISTENCE_PROB_030_Rx}, {application-record-element=DET_EXISTENCE_PROB_031_Rx, system-signal=DET_EXISTENCE_PROB_031_Rx}, {application-record-element=DET_EXISTENCE_PROB_032_Rx, system-signal=DET_EXISTENCE_PROB_032_Rx}, {application-record-element=DET_HVC_FLAG_029_Rx, system-signal=DET_HVC_FLAG_029_Rx}, {application-record-element=DET_HVC_FLAG_030_Rx, system-signal=DET_HVC_FLAG_030_Rx}, {application-record-element=DET_HVC_FLAG_031_Rx, system-signal=DET_HVC_FLAG_031_Rx}, {application-record-element=DET_HVC_FLAG_032_Rx, system-signal=DET_HVC_FLAG_032_Rx}, {application-record-element=DET_IDM_029_Rx, system-signal=DET_IDM_029_Rx}, {application-record-element=DET_IDM_030_Rx, system-signal=DET_IDM_030_Rx}, {application-record-element=DET_IDM_031_Rx, system-signal=DET_IDM_031_Rx}, {application-record-element=DET_IDM_032_Rx, system-signal=DET_IDM_032_Rx}, {application-record-element=DET_MH_CRC16_029_032_Rx, system-signal=DET_MH_CRC16_029_032_Rx}, {application-record-element=DET_MH_CYCLE_COUNTER_029_032_Rx, system-signal=DET_MH_CYCLE_COUNTER_029_032_Rx}, {application-record-element=DET_MH_SCAN_INDEX_4LSB_029_032_Rx, system-signal=DET_MH_SCAN_INDEX_4LSB_029_032_Rx}, {application-record-element=DET_MTD_029_Rx, system-signal=DET_MTD_029_Rx}, {application-record-element=DET_MTD_030_Rx, system-signal=DET_MTD_030_Rx}, {application-record-element=DET_MTD_031_Rx, system-signal=DET_MTD_031_Rx}, {application-record-element=DET_MTD_032_Rx, system-signal=DET_MTD_032_Rx}, {application-record-element=DET_PROB_1STAZHYPO_029_Rx, system-signal=DET_PROB_1STAZHYPO_029_Rx}, {application-record-element=DET_PROB_1STAZHYPO_030_Rx, system-signal=DET_PROB_1STAZHYPO_030_Rx}, {application-record-element=DET_PROB_1STAZHYPO_031_Rx, system-signal=DET_PROB_1STAZHYPO_031_Rx}, {application-record-element=DET_PROB_1STAZHYPO_032_Rx, system-signal=DET_PROB_1STAZHYPO_032_Rx}, {application-record-element=DET_RANGE_029_Rx, system-signal=DET_RANGE_029_Rx}, {application-record-element=DET_RANGE_030_Rx, system-signal=DET_RANGE_030_Rx}, {application-record-element=DET_RANGE_031_Rx, system-signal=DET_RANGE_031_Rx}, {application-record-element=DET_RANGE_032_Rx, system-signal=DET_RANGE_032_Rx}, {application-record-element=DET_RANGE_ERR_029_Rx, system-signal=DET_RANGE_ERR_029_Rx}, {application-record-element=DET_RANGE_ERR_030_Rx, system-signal=DET_RANGE_ERR_030_Rx}, {application-record-element=DET_RANGE_ERR_031_Rx, system-signal=DET_RANGE_ERR_031_Rx}, {application-record-element=DET_RANGE_ERR_032_Rx, system-signal=DET_RANGE_ERR_032_Rx}, {application-record-element=DET_RANGE_VELOCITY_029_Rx, system-signal=DET_RANGE_VELOCITY_029_Rx}, {application-record-element=DET_RANGE_VELOCITY_030_Rx, system-signal=DET_RANGE_VELOCITY_030_Rx}, {application-record-element=DET_RANGE_VELOCITY_031_Rx, system-signal=DET_RANGE_VELOCITY_031_Rx}, {application-record-element=DET_RANGE_VELOCITY_032_Rx, system-signal=DET_RANGE_VELOCITY_032_Rx}, {application-record-element=DET_RANGE_VELOCITY_ERR_029_Rx, system-signal=DET_RANGE_VELOCITY_ERR_029_Rx}, {application-record-element=DET_RANGE_VELOCITY_ERR_030_Rx, system-signal=DET_RANGE_VELOCITY_ERR_030_Rx}, {application-record-element=DET_RANGE_VELOCITY_ERR_031_Rx, system-signal=DET_RANGE_VELOCITY_ERR_031_Rx}, {application-record-element=DET_RANGE_VELOCITY_ERR_032_Rx, system-signal=DET_RANGE_VELOCITY_ERR_032_Rx}, {application-record-element=DET_RCS_029_Rx, system-signal=DET_RCS_029_Rx}, {application-record-element=DET_RCS_030_Rx, system-signal=DET_RCS_030_Rx}, {application-record-element=DET_RCS_031_Rx, system-signal=DET_RCS_031_Rx}, {application-record-element=DET_RCS_032_Rx, system-signal=DET_RCS_032_Rx}, {application-record-element=DET_SNR_029_Rx, system-signal=DET_SNR_029_Rx}, {application-record-element=DET_SNR_030_Rx, system-signal=DET_SNR_030_Rx}, {application-record-element=DET_SNR_031_Rx, system-signal=DET_SNR_031_Rx}, {application-record-element=DET_SNR_032_Rx, system-signal=DET_SNR_032_Rx}, {application-record-element=DET_SUPER_RES_TARGET_029_Rx, system-signal=DET_SUPER_RES_TARGET_029_Rx}, {application-record-element=DET_SUPER_RES_TARGET_030_Rx, system-signal=DET_SUPER_RES_TARGET_030_Rx}, {application-record-element=DET_SUPER_RES_TARGET_031_Rx, system-signal=DET_SUPER_RES_TARGET_031_Rx}, {application-record-element=DET_SUPER_RES_TARGET_032_Rx, system-signal=DET_SUPER_RES_TARGET_032_Rx}]}
        sender-receiver-to-signal-group-mapping={data-element=COMPOSITIONTYPE.Rp_SG_Fusion_Detections_033_036_AL.Vdp_SG_Fusion_Detections_033_036_AL, signal-group=SG_Fusion_Detections_033_036, type-mapping=sender-rec-record-type-mapping=record-element-mappings=[{application-record-element=DET_AZIMUTH_033_Rx, system-signal=DET_AZIMUTH_033_Rx}, {application-record-element=DET_AZIMUTH_034_Rx, system-signal=DET_AZIMUTH_034_Rx}, {application-record-element=DET_AZIMUTH_035_Rx, system-signal=DET_AZIMUTH_035_Rx}, {application-record-element=DET_AZIMUTH_036_Rx, system-signal=DET_AZIMUTH_036_Rx}, {application-record-element=DET_AZIMUTH_ERR_033_Rx, system-signal=DET_AZIMUTH_ERR_033_Rx}, {application-record-element=DET_AZIMUTH_ERR_034_Rx, system-signal=DET_AZIMUTH_ERR_034_Rx}, {application-record-element=DET_AZIMUTH_ERR_035_Rx, system-signal=DET_AZIMUTH_ERR_035_Rx}, {application-record-element=DET_AZIMUTH_ERR_036_Rx, system-signal=DET_AZIMUTH_ERR_036_Rx}, {application-record-element=DET_BELOW_RAIN_THOLD_033_Rx, system-signal=DET_BELOW_RAIN_THOLD_033_Rx}, {application-record-element=DET_BELOW_RAIN_THOLD_034_Rx, system-signal=DET_BELOW_RAIN_THOLD_034_Rx}, {application-record-element=DET_BELOW_RAIN_THOLD_035_Rx, system-signal=DET_BELOW_RAIN_THOLD_035_Rx}, {application-record-element=DET_BELOW_RAIN_THOLD_036_Rx, system-signal=DET_BELOW_RAIN_THOLD_036_Rx}, {application-record-element=DET_BI_STATIC_FLAG_033_Rx, system-signal=DET_BI_STATIC_FLAG_033_Rx}, {application-record-element=DET_BI_STATIC_FLAG_034_Rx, system-signal=DET_BI_STATIC_FLAG_034_Rx}, {application-record-element=DET_BI_STATIC_FLAG_035_Rx, system-signal=DET_BI_STATIC_FLAG_035_Rx}, {application-record-element=DET_BI_STATIC_FLAG_036_Rx, system-signal=DET_BI_STATIC_FLAG_036_Rx}, {application-record-element=DET_CONFD_AZIMUTH_033_Rx, system-signal=DET_CONFD_AZIMUTH_033_Rx}, {application-record-element=DET_CONFD_AZIMUTH_034_Rx, system-signal=DET_CONFD_AZIMUTH_034_Rx}, {application-record-element=DET_CONFD_AZIMUTH_035_Rx, system-signal=DET_CONFD_AZIMUTH_035_Rx}, {application-record-element=DET_CONFD_AZIMUTH_036_Rx, system-signal=DET_CONFD_AZIMUTH_036_Rx}, {application-record-element=DET_CONFD_ELEVATION_033_Rx, system-signal=DET_CONFD_ELEVATION_033_Rx}, {application-record-element=DET_CONFD_ELEVATION_034_Rx, system-signal=DET_CONFD_ELEVATION_034_Rx}, {application-record-element=DET_CONFD_ELEVATION_035_Rx, system-signal=DET_CONFD_ELEVATION_035_Rx}, {application-record-element=DET_CONFD_ELEVATION_036_Rx, system-signal=DET_CONFD_ELEVATION_036_Rx}, {application-record-element=DET_ELEVATION_033_Rx, system-signal=DET_ELEVATION_033_Rx}, {application-record-element=DET_ELEVATION_034_Rx, system-signal=DET_ELEVATION_034_Rx}, {application-record-element=DET_ELEVATION_035_Rx, system-signal=DET_ELEVATION_035_Rx}, {application-record-element=DET_ELEVATION_036_Rx, system-signal=DET_ELEVATION_036_Rx}, {application-record-element=DET_ELEVATION_ERR_033_Rx, system-signal=DET_ELEVATION_ERR_033_Rx}, {application-record-element=DET_ELEVATION_ERR_034_Rx, system-signal=DET_ELEVATION_ERR_034_Rx}, {application-record-element=DET_ELEVATION_ERR_035_Rx, system-signal=DET_ELEVATION_ERR_035_Rx}, {application-record-element=DET_ELEVATION_ERR_036_Rx, system-signal=DET_ELEVATION_ERR_036_Rx}, {application-record-element=DET_EXISTENCE_PROB_033_Rx, system-signal=DET_EXISTENCE_PROB_033_Rx}, {application-record-element=DET_EXISTENCE_PROB_034_Rx, system-signal=DET_EXISTENCE_PROB_034_Rx}, {application-record-element=DET_EXISTENCE_PROB_035_Rx, system-signal=DET_EXISTENCE_PROB_035_Rx}, {application-record-element=DET_EXISTENCE_PROB_036_Rx, system-signal=DET_EXISTENCE_PROB_036_Rx}, {application-record-element=DET_HVC_FLAG_033_Rx, system-signal=DET_HVC_FLAG_033_Rx}, {application-record-element=DET_HVC_FLAG_034_Rx, system-signal=DET_HVC_FLAG_034_Rx}, {application-record-element=DET_HVC_FLAG_035_Rx, system-signal=DET_HVC_FLAG_035_Rx}, {application-record-element=DET_HVC_FLAG_036_Rx, system-signal=DET_HVC_FLAG_036_Rx}, {application-record-element=DET_IDM_033_Rx, system-signal=DET_IDM_033_Rx}, {application-record-element=DET_IDM_034_Rx, system-signal=DET_IDM_034_Rx}, {application-record-element=DET_IDM_035_Rx, system-signal=DET_IDM_035_Rx}, {application-record-element=DET_IDM_036_Rx, system-signal=DET_IDM_036_Rx}, {application-record-element=DET_MH_CRC16_033_036_Rx, system-signal=DET_MH_CRC16_033_036_Rx}, {application-record-element=DET_MH_CYCLE_COUNTER_033_036_Rx, system-signal=DET_MH_CYCLE_COUNTER_033_036_Rx}, {application-record-element=DET_MH_SCAN_INDEX_4LSB_033_036_Rx, system-signal=DET_MH_SCAN_INDEX_4LSB_033_036_Rx}, {application-record-element=DET_MTD_033_Rx, system-signal=DET_MTD_033_Rx}, {application-record-element=DET_MTD_034_Rx, system-signal=DET_MTD_034_Rx}, {application-record-element=DET_MTD_035_Rx, system-signal=DET_MTD_035_Rx}, {application-record-element=DET_MTD_036_Rx, system-signal=DET_MTD_036_Rx}, {application-record-element=DET_PROB_1STAZHYPO_033_Rx, system-signal=DET_PROB_1STAZHYPO_033_Rx}, {application-record-element=DET_PROB_1STAZHYPO_034_Rx, system-signal=DET_PROB_1STAZHYPO_034_Rx}, {application-record-element=DET_PROB_1STAZHYPO_035_Rx, system-signal=DET_PROB_1STAZHYPO_035_Rx}, {application-record-element=DET_PROB_1STAZHYPO_036_Rx, system-signal=DET_PROB_1STAZHYPO_036_Rx}, {application-record-element=DET_RANGE_033_Rx, system-signal=DET_RANGE_033_Rx}, {application-record-element=DET_RANGE_034_Rx, system-signal=DET_RANGE_034_Rx}, {application-record-element=DET_RANGE_035_Rx, system-signal=DET_RANGE_035_Rx}, {application-record-element=DET_RANGE_036_Rx, system-signal=DET_RANGE_036_Rx}, {application-record-element=DET_RANGE_ERR_033_Rx, system-signal=DET_RANGE_ERR_033_Rx}, {application-record-element=DET_RANGE_ERR_034_Rx, system-signal=DET_RANGE_ERR_034_Rx}, {application-record-element=DET_RANGE_ERR_035_Rx, system-signal=DET_RANGE_ERR_035_Rx}, {application-record-element=DET_RANGE_ERR_036_Rx, system-signal=DET_RANGE_ERR_036_Rx}, {application-record-element=DET_RANGE_VELOCITY_033_Rx, system-signal=DET_RANGE_VELOCITY_033_Rx}, {application-record-element=DET_RANGE_VELOCITY_034_Rx, system-signal=DET_RANGE_VELOCITY_034_Rx}, {application-record-element=DET_RANGE_VELOCITY_035_Rx, system-signal=DET_RANGE_VELOCITY_035_Rx}, {application-record-element=DET_RANGE_VELOCITY_036_Rx, system-signal=DET_RANGE_VELOCITY_036_Rx}, {application-record-element=DET_RANGE_VELOCITY_ERR_033_Rx, system-signal=DET_RANGE_VELOCITY_ERR_033_Rx}, {application-record-element=DET_RANGE_VELOCITY_ERR_034_Rx, system-signal=DET_RANGE_VELOCITY_ERR_034_Rx}, {application-record-element=DET_RANGE_VELOCITY_ERR_035_Rx, system-signal=DET_RANGE_VELOCITY_ERR_035_Rx}, {application-record-element=DET_RANGE_VELOCITY_ERR_036_Rx, system-signal=DET_RANGE_VELOCITY_ERR_036_Rx}, {application-record-element=DET_RCS_033_Rx, system-signal=DET_RCS_033_Rx}, {application-record-element=DET_RCS_034_Rx, system-signal=DET_RCS_034_Rx}, {application-record-element=DET_RCS_035_Rx, system-signal=DET_RCS_035_Rx}, {application-record-element=DET_RCS_036_Rx, system-signal=DET_RCS_036_Rx}, {application-record-element=DET_SNR_033_Rx, system-signal=DET_SNR_033_Rx}, {application-record-element=DET_SNR_034_Rx, system-signal=DET_SNR_034_Rx}, {application-record-element=DET_SNR_035_Rx, system-signal=DET_SNR_035_Rx}, {application-record-element=DET_SNR_036_Rx, system-signal=DET_SNR_036_Rx}, {application-record-element=DET_SUPER_RES_TARGET_033_Rx, system-signal=DET_SUPER_RES_TARGET_033_Rx}, {application-record-element=DET_SUPER_RES_TARGET_034_Rx, system-signal=DET_SUPER_RES_TARGET_034_Rx}, {application-record-element=DET_SUPER_RES_TARGET_035_Rx, system-signal=DET_SUPER_RES_TARGET_035_Rx}, {application-record-element=DET_SUPER_RES_TARGET_036_Rx, system-signal=DET_SUPER_RES_TARGET_036_Rx}]}
        sender-receiver-to-signal-group-mapping={data-element=COMPOSITIONTYPE.Rp_SG_Fusion_Detections_037_040_AL.Vdp_SG_Fusion_Detections_037_040_AL, signal-group=SG_Fusion_Detections_037_040, type-mapping=sender-rec-record-type-mapping=record-element-mappings=[{application-record-element=DET_AZIMUTH_037_Rx, system-signal=DET_AZIMUTH_037_Rx}, {application-record-element=DET_AZIMUTH_038_Rx, system-signal=DET_AZIMUTH_038_Rx}, {application-record-element=DET_AZIMUTH_039_Rx, system-signal=DET_AZIMUTH_039_Rx}, {application-record-element=DET_AZIMUTH_040_Rx, system-signal=DET_AZIMUTH_040_Rx}, {application-record-element=DET_AZIMUTH_ERR_037_Rx, system-signal=DET_AZIMUTH_ERR_037_Rx}, {application-record-element=DET_AZIMUTH_ERR_038_Rx, system-signal=DET_AZIMUTH_ERR_038_Rx}, {application-record-element=DET_AZIMUTH_ERR_039_Rx, system-signal=DET_AZIMUTH_ERR_039_Rx}, {application-record-element=DET_AZIMUTH_ERR_040_Rx, system-signal=DET_AZIMUTH_ERR_040_Rx}, {application-record-element=DET_BELOW_RAIN_THOLD_037_Rx, system-signal=DET_BELOW_RAIN_THOLD_037_Rx}, {application-record-element=DET_BELOW_RAIN_THOLD_038_Rx, system-signal=DET_BELOW_RAIN_THOLD_038_Rx}, {application-record-element=DET_BELOW_RAIN_THOLD_039_Rx, system-signal=DET_BELOW_RAIN_THOLD_039_Rx}, {application-record-element=DET_BELOW_RAIN_THOLD_040_Rx, system-signal=DET_BELOW_RAIN_THOLD_040_Rx}, {application-record-element=DET_BI_STATIC_FLAG_037_Rx, system-signal=DET_BI_STATIC_FLAG_037_Rx}, {application-record-element=DET_BI_STATIC_FLAG_038_Rx, system-signal=DET_BI_STATIC_FLAG_038_Rx}, {application-record-element=DET_BI_STATIC_FLAG_039_Rx, system-signal=DET_BI_STATIC_FLAG_039_Rx}, {application-record-element=DET_BI_STATIC_FLAG_040_Rx, system-signal=DET_BI_STATIC_FLAG_040_Rx}, {application-record-element=DET_CONFD_AZIMUTH_037_Rx, system-signal=DET_CONFD_AZIMUTH_037_Rx}, {application-record-element=DET_CONFD_AZIMUTH_038_Rx, system-signal=DET_CONFD_AZIMUTH_038_Rx}, {application-record-element=DET_CONFD_AZIMUTH_039_Rx, system-signal=DET_CONFD_AZIMUTH_039_Rx}, {application-record-element=DET_CONFD_AZIMUTH_040_Rx, system-signal=DET_CONFD_AZIMUTH_040_Rx}, {application-record-element=DET_CONFD_ELEVATION_037_Rx, system-signal=DET_CONFD_ELEVATION_037_Rx}, {application-record-element=DET_CONFD_ELEVATION_038_Rx, system-signal=DET_CONFD_ELEVATION_038_Rx}, {application-record-element=DET_CONFD_ELEVATION_039_Rx, system-signal=DET_CONFD_ELEVATION_039_Rx}, {application-record-element=DET_CONFD_ELEVATION_040_Rx, system-signal=DET_CONFD_ELEVATION_040_Rx}, {application-record-element=DET_ELEVATION_037_Rx, system-signal=DET_ELEVATION_037_Rx}, {application-record-element=DET_ELEVATION_038_Rx, system-signal=DET_ELEVATION_038_Rx}, {application-record-element=DET_ELEVATION_039_Rx, system-signal=DET_ELEVATION_039_Rx}, {application-record-element=DET_ELEVATION_040_Rx, system-signal=DET_ELEVATION_040_Rx}, {application-record-element=DET_ELEVATION_ERR_037_Rx, system-signal=DET_ELEVATION_ERR_037_Rx}, {application-record-element=DET_ELEVATION_ERR_038_Rx, system-signal=DET_ELEVATION_ERR_038_Rx}, {application-record-element=DET_ELEVATION_ERR_039_Rx, system-signal=DET_ELEVATION_ERR_039_Rx}, {application-record-element=DET_ELEVATION_ERR_040_Rx, system-signal=DET_ELEVATION_ERR_040_Rx}, {application-record-element=DET_EXISTENCE_PROB_037_Rx, system-signal=DET_EXISTENCE_PROB_037_Rx}, {application-record-element=DET_EXISTENCE_PROB_038_Rx, system-signal=DET_EXISTENCE_PROB_038_Rx}, {application-record-element=DET_EXISTENCE_PROB_039_Rx, system-signal=DET_EXISTENCE_PROB_039_Rx}, {application-record-element=DET_EXISTENCE_PROB_040_Rx, system-signal=DET_EXISTENCE_PROB_040_Rx}, {application-record-element=DET_HVC_FLAG_037_Rx, system-signal=DET_HVC_FLAG_037_Rx}, {application-record-element=DET_HVC_FLAG_038_Rx, system-signal=DET_HVC_FLAG_038_Rx}, {application-record-element=DET_HVC_FLAG_039_Rx, system-signal=DET_HVC_FLAG_039_Rx}, {application-record-element=DET_HVC_FLAG_040_Rx, system-signal=DET_HVC_FLAG_040_Rx}, {application-record-element=DET_IDM_037_Rx, system-signal=DET_IDM_037_Rx}, {application-record-element=DET_IDM_038_Rx, system-signal=DET_IDM_038_Rx}, {application-record-element=DET_IDM_039_Rx, system-signal=DET_IDM_039_Rx}, {application-record-element=DET_IDM_040_Rx, system-signal=DET_IDM_040_Rx}, {application-record-element=DET_MH_CRC16_037_040_Rx, system-signal=DET_MH_CRC16_037_040_Rx}, {application-record-element=DET_MH_CYCLE_COUNTER_037_040_Rx, system-signal=DET_MH_CYCLE_COUNTER_037_040_Rx}, {application-record-element=DET_MH_SCAN_INDEX_4LSB_037_040_Rx, system-signal=DET_MH_SCAN_INDEX_4LSB_037_040_Rx}, {application-record-element=DET_MTD_037_Rx, system-signal=DET_MTD_037_Rx}, {application-record-element=DET_MTD_038_Rx, system-signal=DET_MTD_038_Rx}, {application-record-element=DET_MTD_039_Rx, system-signal=DET_MTD_039_Rx}, {application-record-element=DET_MTD_040_Rx, system-signal=DET_MTD_040_Rx}, {application-record-element=DET_PROB_1STAZHYPO_037_Rx, system-signal=DET_PROB_1STAZHYPO_037_Rx}, {application-record-element=DET_PROB_1STAZHYPO_038_Rx, system-signal=DET_PROB_1STAZHYPO_038_Rx}, {application-record-element=DET_PROB_1STAZHYPO_039_Rx, system-signal=DET_PROB_1STAZHYPO_039_Rx}, {application-record-element=DET_PROB_1STAZHYPO_040_Rx, system-signal=DET_PROB_1STAZHYPO_040_Rx}, {application-record-element=DET_RANGE_037_Rx, system-signal=DET_RANGE_037_Rx}, {application-record-element=DET_RANGE_038_Rx, system-signal=DET_RANGE_038_Rx}, {application-record-element=DET_RANGE_039_Rx, system-signal=DET_RANGE_039_Rx}, {application-record-element=DET_RANGE_040_Rx, system-signal=DET_RANGE_040_Rx}, {application-record-element=DET_RANGE_ERR_037_Rx, system-signal=DET_RANGE_ERR_037_Rx}, {application-record-element=DET_RANGE_ERR_038_Rx, system-signal=DET_RANGE_ERR_038_Rx}, {application-record-element=DET_RANGE_ERR_039_Rx, system-signal=DET_RANGE_ERR_039_Rx}, {application-record-element=DET_RANGE_ERR_040_Rx, system-signal=DET_RANGE_ERR_040_Rx}, {application-record-element=DET_RANGE_VELOCITY_037_Rx, system-signal=DET_RANGE_VELOCITY_037_Rx}, {application-record-element=DET_RANGE_VELOCITY_038_Rx, system-signal=DET_RANGE_VELOCITY_038_Rx}, {application-record-element=DET_RANGE_VELOCITY_039_Rx, system-signal=DET_RANGE_VELOCITY_039_Rx}, {application-record-element=DET_RANGE_VELOCITY_040_Rx, system-signal=DET_RANGE_VELOCITY_040_Rx}, {application-record-element=DET_RANGE_VELOCITY_ERR_037_Rx, system-signal=DET_RANGE_VELOCITY_ERR_037_Rx}, {application-record-element=DET_RANGE_VELOCITY_ERR_038_Rx, system-signal=DET_RANGE_VELOCITY_ERR_038_Rx}, {application-record-element=DET_RANGE_VELOCITY_ERR_039_Rx, system-signal=DET_RANGE_VELOCITY_ERR_039_Rx}, {application-record-element=DET_RANGE_VELOCITY_ERR_040_Rx, system-signal=DET_RANGE_VELOCITY_ERR_040_Rx}, {application-record-element=DET_RCS_037_Rx, system-signal=DET_RCS_037_Rx}, {application-record-element=DET_RCS_038_Rx, system-signal=DET_RCS_038_Rx}, {application-record-element=DET_RCS_039_Rx, system-signal=DET_RCS_039_Rx}, {application-record-element=DET_RCS_040_Rx, system-signal=DET_RCS_040_Rx}, {application-record-element=DET_SNR_037_Rx, system-signal=DET_SNR_037_Rx}, {application-record-element=DET_SNR_038_Rx, system-signal=DET_SNR_038_Rx}, {application-record-element=DET_SNR_039_Rx, system-signal=DET_SNR_039_Rx}, {application-record-element=DET_SNR_040_Rx, system-signal=DET_SNR_040_Rx}, {application-record-element=DET_SUPER_RES_TARGET_037_Rx, system-signal=DET_SUPER_RES_TARGET_037_Rx}, {application-record-element=DET_SUPER_RES_TARGET_038_Rx, system-signal=DET_SUPER_RES_TARGET_038_Rx}, {application-record-element=DET_SUPER_RES_TARGET_039_Rx, system-signal=DET_SUPER_RES_TARGET_039_Rx}, {application-record-element=DET_SUPER_RES_TARGET_040_Rx, system-signal=DET_SUPER_RES_TARGET_040_Rx}]}
        sender-receiver-to-signal-group-mapping={data-element=COMPOSITIONTYPE.Rp_SG_Fusion_Detections_041_044_AL.Vdp_SG_Fusion_Detections_041_044_AL, signal-group=SG_Fusion_Detections_041_044, type-mapping=sender-rec-record-type-mapping=record-element-mappings=[{application-record-element=DET_AZIMUTH_041_Rx, system-signal=DET_AZIMUTH_041_Rx}, {application-record-element=DET_AZIMUTH_042_Rx, system-signal=DET_AZIMUTH_042_Rx}, {application-record-element=DET_AZIMUTH_043_Rx, system-signal=DET_AZIMUTH_043_Rx}, {application-record-element=DET_AZIMUTH_044_Rx, system-signal=DET_AZIMUTH_044_Rx}, {application-record-element=DET_AZIMUTH_ERR_041_Rx, system-signal=DET_AZIMUTH_ERR_041_Rx}, {application-record-element=DET_AZIMUTH_ERR_042_Rx, system-signal=DET_AZIMUTH_ERR_042_Rx}, {application-record-element=DET_AZIMUTH_ERR_043_Rx, system-signal=DET_AZIMUTH_ERR_043_Rx}, {application-record-element=DET_AZIMUTH_ERR_044_Rx, system-signal=DET_AZIMUTH_ERR_044_Rx}, {application-record-element=DET_BELOW_RAIN_THOLD_041_Rx, system-signal=DET_BELOW_RAIN_THOLD_041_Rx}, {application-record-element=DET_BELOW_RAIN_THOLD_042_Rx, system-signal=DET_BELOW_RAIN_THOLD_042_Rx}, {application-record-element=DET_BELOW_RAIN_THOLD_043_Rx, system-signal=DET_BELOW_RAIN_THOLD_043_Rx}, {application-record-element=DET_BELOW_RAIN_THOLD_044_Rx, system-signal=DET_BELOW_RAIN_THOLD_044_Rx}, {application-record-element=DET_BI_STATIC_FLAG_041_Rx, system-signal=DET_BI_STATIC_FLAG_041_Rx}, {application-record-element=DET_BI_STATIC_FLAG_042_Rx, system-signal=DET_BI_STATIC_FLAG_042_Rx}, {application-record-element=DET_BI_STATIC_FLAG_043_Rx, system-signal=DET_BI_STATIC_FLAG_043_Rx}, {application-record-element=DET_BI_STATIC_FLAG_044_Rx, system-signal=DET_BI_STATIC_FLAG_044_Rx}, {application-record-element=DET_CONFD_AZIMUTH_041_Rx, system-signal=DET_CONFD_AZIMUTH_041_Rx}, {application-record-element=DET_CONFD_AZIMUTH_042_Rx, system-signal=DET_CONFD_AZIMUTH_042_Rx}, {application-record-element=DET_CONFD_AZIMUTH_043_Rx, system-signal=DET_CONFD_AZIMUTH_043_Rx}, {application-record-element=DET_CONFD_AZIMUTH_044_Rx, system-signal=DET_CONFD_AZIMUTH_044_Rx}, {application-record-element=DET_CONFD_ELEVATION_041_Rx, system-signal=DET_CONFD_ELEVATION_041_Rx}, {application-record-element=DET_CONFD_ELEVATION_042_Rx, system-signal=DET_CONFD_ELEVATION_042_Rx}, {application-record-element=DET_CONFD_ELEVATION_043_Rx, system-signal=DET_CONFD_ELEVATION_043_Rx}, {application-record-element=DET_CONFD_ELEVATION_044_Rx, system-signal=DET_CONFD_ELEVATION_044_Rx}, {application-record-element=DET_ELEVATION_041_Rx, system-signal=DET_ELEVATION_041_Rx}, {application-record-element=DET_ELEVATION_042_Rx, system-signal=DET_ELEVATION_042_Rx}, {application-record-element=DET_ELEVATION_043_Rx, system-signal=DET_ELEVATION_043_Rx}, {application-record-element=DET_ELEVATION_044_Rx, system-signal=DET_ELEVATION_044_Rx}, {application-record-element=DET_ELEVATION_ERR_041_Rx, system-signal=DET_ELEVATION_ERR_041_Rx}, {application-record-element=DET_ELEVATION_ERR_042_Rx, system-signal=DET_ELEVATION_ERR_042_Rx}, {application-record-element=DET_ELEVATION_ERR_043_Rx, system-signal=DET_ELEVATION_ERR_043_Rx}, {application-record-element=DET_ELEVATION_ERR_044_Rx, system-signal=DET_ELEVATION_ERR_044_Rx}, {application-record-element=DET_EXISTENCE_PROB_041_Rx, system-signal=DET_EXISTENCE_PROB_041_Rx}, {application-record-element=DET_EXISTENCE_PROB_042_Rx, system-signal=DET_EXISTENCE_PROB_042_Rx}, {application-record-element=DET_EXISTENCE_PROB_043_Rx, system-signal=DET_EXISTENCE_PROB_043_Rx}, {application-record-element=DET_EXISTENCE_PROB_044_Rx, system-signal=DET_EXISTENCE_PROB_044_Rx}, {application-record-element=DET_HVC_FLAG_041_Rx, system-signal=DET_HVC_FLAG_041_Rx}, {application-record-element=DET_HVC_FLAG_042_Rx, system-signal=DET_HVC_FLAG_042_Rx}, {application-record-element=DET_HVC_FLAG_043_Rx, system-signal=DET_HVC_FLAG_043_Rx}, {application-record-element=DET_HVC_FLAG_044_Rx, system-signal=DET_HVC_FLAG_044_Rx}, {application-record-element=DET_IDM_041_Rx, system-signal=DET_IDM_041_Rx}, {application-record-element=DET_IDM_042_Rx, system-signal=DET_IDM_042_Rx}, {application-record-element=DET_IDM_043_Rx, system-signal=DET_IDM_043_Rx}, {application-record-element=DET_IDM_044_Rx, system-signal=DET_IDM_044_Rx}, {application-record-element=DET_MH_CRC16_041_044_Rx, system-signal=DET_MH_CRC16_041_044_Rx}, {application-record-element=DET_MH_CYCLE_COUNTER_041_044_Rx, system-signal=DET_MH_CYCLE_COUNTER_041_044_Rx}, {application-record-element=DET_MH_SCAN_INDEX_4LSB_041_044_Rx, system-signal=DET_MH_SCAN_INDEX_4LSB_041_044_Rx}, {application-record-element=DET_MTD_041_Rx, system-signal=DET_MTD_041_Rx}, {application-record-element=DET_MTD_042_Rx, system-signal=DET_MTD_042_Rx}, {application-record-element=DET_MTD_043_Rx, system-signal=DET_MTD_043_Rx}, {application-record-element=DET_MTD_044_Rx, system-signal=DET_MTD_044_Rx}, {application-record-element=DET_PROB_1STAZHYPO_041_Rx, system-signal=DET_PROB_1STAZHYPO_041_Rx}, {application-record-element=DET_PROB_1STAZHYPO_042_Rx, system-signal=DET_PROB_1STAZHYPO_042_Rx}, {application-record-element=DET_PROB_1STAZHYPO_043_Rx, system-signal=DET_PROB_1STAZHYPO_043_Rx}, {application-record-element=DET_PROB_1STAZHYPO_044_Rx, system-signal=DET_PROB_1STAZHYPO_044_Rx}, {application-record-element=DET_RANGE_041_Rx, system-signal=DET_RANGE_041_Rx}, {application-record-element=DET_RANGE_042_Rx, system-signal=DET_RANGE_042_Rx}, {application-record-element=DET_RANGE_043_Rx, system-signal=DET_RANGE_043_Rx}, {application-record-element=DET_RANGE_044_Rx, system-signal=DET_RANGE_044_Rx}, {application-record-element=DET_RANGE_ERR_041_Rx, system-signal=DET_RANGE_ERR_041_Rx}, {application-record-element=DET_RANGE_ERR_042_Rx, system-signal=DET_RANGE_ERR_042_Rx}, {application-record-element=DET_RANGE_ERR_043_Rx, system-signal=DET_RANGE_ERR_043_Rx}, {application-record-element=DET_RANGE_ERR_044_Rx, system-signal=DET_RANGE_ERR_044_Rx}, {application-record-element=DET_RANGE_VELOCITY_041_Rx, system-signal=DET_RANGE_VELOCITY_041_Rx}, {application-record-element=DET_RANGE_VELOCITY_042_Rx, system-signal=DET_RANGE_VELOCITY_042_Rx}, {application-record-element=DET_RANGE_VELOCITY_043_Rx, system-signal=DET_RANGE_VELOCITY_043_Rx}, {application-record-element=DET_RANGE_VELOCITY_044_Rx, system-signal=DET_RANGE_VELOCITY_044_Rx}, {application-record-element=DET_RANGE_VELOCITY_ERR_041_Rx, system-signal=DET_RANGE_VELOCITY_ERR_041_Rx}, {application-record-element=DET_RANGE_VELOCITY_ERR_042_Rx, system-signal=DET_RANGE_VELOCITY_ERR_042_Rx}, {application-record-element=DET_RANGE_VELOCITY_ERR_043_Rx, system-signal=DET_RANGE_VELOCITY_ERR_043_Rx}, {application-record-element=DET_RANGE_VELOCITY_ERR_044_Rx, system-signal=DET_RANGE_VELOCITY_ERR_044_Rx}, {application-record-element=DET_RCS_041_Rx, system-signal=DET_RCS_041_Rx}, {application-record-element=DET_RCS_042_Rx, system-signal=DET_RCS_042_Rx}, {application-record-element=DET_RCS_043_Rx, system-signal=DET_RCS_043_Rx}, {application-record-element=DET_RCS_044_Rx, system-signal=DET_RCS_044_Rx}, {application-record-element=DET_SNR_041_Rx, system-signal=DET_SNR_041_Rx}, {application-record-element=DET_SNR_042_Rx, system-signal=DET_SNR_042_Rx}, {application-record-element=DET_SNR_043_Rx, system-signal=DET_SNR_043_Rx}, {application-record-element=DET_SNR_044_Rx, system-signal=DET_SNR_044_Rx}, {application-record-element=DET_SUPER_RES_TARGET_041_Rx, system-signal=DET_SUPER_RES_TARGET_041_Rx}, {application-record-element=DET_SUPER_RES_TARGET_042_Rx, system-signal=DET_SUPER_RES_TARGET_042_Rx}, {application-record-element=DET_SUPER_RES_TARGET_043_Rx, system-signal=DET_SUPER_RES_TARGET_043_Rx}, {application-record-element=DET_SUPER_RES_TARGET_044_Rx, system-signal=DET_SUPER_RES_TARGET_044_Rx}]}
