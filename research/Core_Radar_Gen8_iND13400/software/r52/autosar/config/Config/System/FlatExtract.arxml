[part 2 of 11: package /COM/VECTOR/CFG/WORKFLOW/SYSDESC/SYNC]
AUTOSAR XML (schema 00053)
package /COM/VECTOR/CFG/WORKFLOW/SYSDESC/SYNC  (continued)
  system SYSTEM: category=ECU_EXTRACT, client-id-definition-set=CLIENT_ID_DEFINITION_SET  (continued)
    system mapping MAPPINGS  (continued)
      data-mappings:  (continued)
        sender-receiver-to-signal-group-mapping={data-element=COMPOSITIONTYPE.Pp_SG_TrackerObject040.Vdp_SG_TrackerObject040, signal-group=SG_TrackerObject040, type-mapping=sender-rec-record-type-mapping=record-element-mappings=[{implementation-record-element=OBJ_ACCEL_ERR_CRR_COEF_001, system-signal=OBJ_ACCEL_ERR_CRR_COEF_040}, {implementation-record-element=OBJ_ALIVE_TIME_001, system-signal=OBJ_ALIVE_TIME_040}, {implementation-record-element=OBJ_EXISTENCE_PROB_001, system-signal=OBJ_EXISTENCE_PROB_040}, {implementation-record-element=OBJ_GROUP_ID_001, system-signal=OBJ_GROUP_ID_040}, {implementation-record-element=OBJ_ID_001, system-signal=OBJ_ID_040}, {implementation-record-element=OBJ_MEASUREMENT_STATUS_001, system-signal=OBJ_MEASUREMENT_STATUS_040}, {implementation-record-element=OBJ_MH_CRC16_001, system-signal=OBJ_MH_CRC16_040}, {implementation-record-element=OBJ_MH_CYCLE_COUNTER_001, system-signal=OBJ_MH_CYCLE_COUNTER_040}, {implementation-record-element=OBJ_MOVEMENT_STATUS_001, system-signal=OBJ_MOVEMENT_STATUS_040}, {implementation-record-element=OBJ_POS_ERR_CRR_COEF_001, system-signal=OBJ_POS_ERR_CRR_COEF_040}, {implementation-record-element=OBJ_RCS_001, system-signal=OBJ_RCS_040}, {implementation-record-element=OBJ_REF_PT_LAT_OFFSET_001, system-signal=OBJ_REF_PT_LAT_OFFSET_040}, {implementation-record-element=OBJ_REF_PT_LONG_OFFSET_001, system-signal=OBJ_REF_PT_LONG_OFFSET_040}, {implementation-record-element=OBJ_TIMESTAMP_OFFSET_001, system-signal=OBJ_TIMESTAMP_OFFSET_040}, {implementation-record-element=OBJ_TRACK_MOTION_MODEL_001, system-signal=OBJ_TRACK_MOTION_MODEL_040}, {implementation-record-element=OBJ_VEH_TRACK_FLAG_001, system-signal=OBJ_VEH_TRACK_FLAG_040}, {implementation-record-element=OBJ_VELOCITY_ERR_CRR_COEF_001, system-signal=OBJ_VELOCITY_ERR_CRR_COEF_040}, {implementation-record-element=OBJ_CLS_TYPE2_PROB_001, system-signal=OBJ_CLS_TYPE2_PROB_040}, {implementation-record-element=OBJ_ACCELERATION_LONG_001, system-signal=OBJ_ACCELERATION_LONG_040}, {implementation-record-element=OBJ_CLS_TYPE1_001, system-signal=OBJ_CLS_TYPE1_040}, {implementation-record-element=OBJ_DIMENSION_LENGTH_001, system-signal=OBJ_DIMENSION_LENGTH_040}, {implementation-record-element=OBJ_DIMENSION_LENGTH_ERR_001, system-signal=OBJ_DIMENSION_LENGTH_ERR_040}, {implementation-record-element=OBJ_DIMENSION_WIDTH_001, system-signal=OBJ_DIMENSION_WIDTH_040}, {implementation-record-element=OBJ_CLS_TYPE5_001, system-signal=OBJ_CLS_TYPE5_040}, {implementation-record-element=OBJ_DIMENSION_WIDTH_ERR_001, system-signal=OBJ_DIMENSION_WIDTH_ERR_040}, {implementation-record-element=OBJ_ACCELERATION_LAT_001, system-signal=OBJ_ACCELERATION_LAT_040}, {implementation-record-element=OBJ_CLS_TYPE1_PROB_001, system-signal=OBJ_CLS_TYPE1_PROB_040}, {implementation-record-element=OBJ_CLS_TYPE3_PROB_001, system-signal=OBJ_CLS_TYPE3_PROB_040}, {implementation-record-element=OBJ_CLS_TYPE3_001, system-signal=OBJ_CLS_TYPE3_040}, {implementation-record-element=OBJ_CLS_TYPE6_PROB_001, system-signal=OBJ_CLS_TYPE6_PROB_040}, {implementation-record-element=OBJ_ACCELERATION_LONG_ERR_001, system-signal=OBJ_ACCELERATION_LONG_ERR_040}, {implementation-record-element=OBJ_ACCELERATION_LAT_ERR_001, system-signal=OBJ_ACCELERATION_LAT_ERR_040}, {implementation-record-element=OBJ_CLS_TYPE2_001, system-signal=OBJ_CLS_TYPE2_040}, {implementation-record-element=OBJ_CLS_TYPE6_001, system-signal=OBJ_CLS_TYPE6_040}, {implementation-record-element=OBJ_CLS_TYPE4_001, system-signal=OBJ_CLS_TYPE4_040}, {implementation-record-element=OBJ_CLS_TYPE4_PROB_001, system-signal=OBJ_CLS_TYPE4_PROB_040}, {implementation-record-element=OBJ_CLS_TYPE5_PROB_001, system-signal=OBJ_CLS_TYPE5_PROB_040}, {implementation-record-element=OBJ_POS_LAT_001, system-signal=OBJ_POS_LAT_040}, {implementation-record-element=OBJ_VELOCITY_LONG_001, system-signal=OBJ_VELOCITY_LONG_040}, {implementation-record-element=OBJ_VELOCITY_LAT_001, system-signal=OBJ_VELOCITY_LAT_040}, {implementation-record-element=OBJ_YAW_ANGLE_ERR_001, system-signal=OBJ_YAW_ANGLE_ERR_040}, {implementation-record-element=OBJ_YAW_RATE_001, system-signal=OBJ_YAW_RATE_040}, {implementation-record-element=OBJ_POS_LONG_001, system-signal=OBJ_POS_LONG_040}, {implementation-record-element=OBJ_YAW_ANGLE_001, system-signal=OBJ_YAW_ANGLE_040}, {implementation-record-element=OBJ_POS_LONG_ERR_001, system-signal=OBJ_POS_LONG_ERR_040}, {implementation-record-element=OBJ_VELOCITY_LAT_ERR_001, system-signal=OBJ_VELOCITY_LAT_ERR_040}, {implementation-record-element=OBJ_YAW_RATE_ERR_001, system-signal=OBJ_YAW_RATE_ERR_040}, {implementation-record-element=OBJ_POS_LAT_ERR_001, system-signal=OBJ_POS_LAT_ERR_040}, {implementation-record-element=OBJ_VELOCITY_LONG_ERR_001, system-signal=OBJ_VELOCITY_LONG_ERR_040}]}
        sender-receiver-to-signal-group-mapping={data-element=COMPOSITIONTYPE.Pp_SG_TrackerObject041.Vdp_SG_TrackerObject041, signal-group=SG_TrackerObject041, type-mapping=sender-rec-record-type-mapping=record-element-mappings=[{implementation-record-element=OBJ_ACCEL_ERR_CRR_COEF_001, system-signal=OBJ_ACCEL_ERR_CRR_COEF_041}, {implementation-record-element=OBJ_ALIVE_TIME_001, system-signal=OBJ_ALIVE_TIME_041}, {implementation-record-element=OBJ_EXISTENCE_PROB_001, system-signal=OBJ_EXISTENCE_PROB_041}, {implementation-record-element=OBJ_GROUP_ID_001, system-signal=OBJ_GROUP_ID_041}, {implementation-record-element=OBJ_ID_001, system-signal=OBJ_ID_041}, {implementation-record-element=OBJ_MEASUREMENT_STATUS_001, system-signal=OBJ_MEASUREMENT_STATUS_041}, {implementation-record-element=OBJ_MH_CRC16_001, system-signal=OBJ_MH_CRC16_041}, {implementation-record-element=OBJ_MH_CYCLE_COUNTER_001, system-signal=OBJ_MH_CYCLE_COUNTER_041}, {implementation-record-element=OBJ_MOVEMENT_STATUS_001, system-signal=OBJ_MOVEMENT_STATUS_041}, {implementation-record-element=OBJ_POS_ERR_CRR_COEF_001, system-signal=OBJ_POS_ERR_CRR_COEF_041}, {implementation-record-element=OBJ_RCS_001, system-signal=OBJ_RCS_041}, {implementation-record-element=OBJ_REF_PT_LAT_OFFSET_001, system-signal=OBJ_REF_PT_LAT_OFFSET_041}, {implementation-record-element=OBJ_REF_PT_LONG_OFFSET_001, system-signal=OBJ_REF_PT_LONG_OFFSET_041}, {implementation-record-element=OBJ_TIMESTAMP_OFFSET_001, system-signal=OBJ_TIMESTAMP_OFFSET_041}, {implementation-record-element=OBJ_TRACK_MOTION_MODEL_001, system-signal=OBJ_TRACK_MOTION_MODEL_041}, {implementation-record-element=OBJ_VEH_TRACK_FLAG_001, system-signal=OBJ_VEH_TRACK_FLAG_041}, {implementation-record-element=OBJ_VELOCITY_ERR_CRR_COEF_001, system-signal=OBJ_VELOCITY_ERR_CRR_COEF_041}, {implementation-record-element=OBJ_POS_LONG_ERR_001, system-signal=OBJ_POS_LONG_ERR_041}, {implementation-record-element=OBJ_CLS_TYPE1_001, system-signal=OBJ_CLS_TYPE1_041}, {implementation-record-element=OBJ_CLS_TYPE1_PROB_001, system-signal=OBJ_CLS_TYPE1_PROB_041}, {implementation-record-element=OBJ_POS_LAT_ERR_001, system-signal=OBJ_POS_LAT_ERR_041}, {implementation-record-element=OBJ_CLS_TYPE2_001, system-signal=OBJ_CLS_TYPE2_041}, {implementation-record-element=OBJ_VELOCITY_LAT_001, system-signal=OBJ_VELOCITY_LAT_041}, {implementation-record-element=OBJ_VELOCITY_LAT_ERR_001, system-signal=OBJ_VELOCITY_LAT_ERR_041}, {implementation-record-element=OBJ_CLS_TYPE4_001, system-signal=OBJ_CLS_TYPE4_041}, {implementation-record-element=OBJ_CLS_TYPE5_PROB_001, system-signal=OBJ_CLS_TYPE5_PROB_041}, {implementation-record-element=OBJ_CLS_TYPE6_PROB_001, system-signal=OBJ_CLS_TYPE6_PROB_041}, {implementation-record-element=OBJ_CLS_TYPE4_PROB_001, system-signal=OBJ_CLS_TYPE4_PROB_041}, {implementation-record-element=OBJ_DIMENSION_LENGTH_001, system-signal=OBJ_DIMENSION_LENGTH_041}, {implementation-record-element=OBJ_DIMENSION_WIDTH_001, system-signal=OBJ_DIMENSION_WIDTH_041}, {implementation-record-element=OBJ_DIMENSION_WIDTH_ERR_001, system-signal=OBJ_DIMENSION_WIDTH_ERR_041}, {implementation-record-element=OBJ_ACCELERATION_LAT_001, system-signal=OBJ_ACCELERATION_LAT_041}, {implementation-record-element=OBJ_ACCELERATION_LONG_ERR_001, system-signal=OBJ_ACCELERATION_LONG_ERR_041}, {implementation-record-element=OBJ_ACCELERATION_LONG_001, system-signal=OBJ_ACCELERATION_LONG_041}, {implementation-record-element=OBJ_CLS_TYPE3_PROB_001, system-signal=OBJ_CLS_TYPE3_PROB_041}, {implementation-record-element=OBJ_CLS_TYPE5_001, system-signal=OBJ_CLS_TYPE5_041}, {implementation-record-element=OBJ_CLS_TYPE6_001, system-signal=OBJ_CLS_TYPE6_041}, {implementation-record-element=OBJ_DIMENSION_LENGTH_ERR_001, system-signal=OBJ_DIMENSION_LENGTH_ERR_041}, {implementation-record-element=OBJ_ACCELERATION_LAT_ERR_001, system-signal=OBJ_ACCELERATION_LAT_ERR_041}, {implementation-record-element=OBJ_CLS_TYPE3_001, system-signal=OBJ_CLS_TYPE3_041}, {implementation-record-element=OBJ_CLS_TYPE2_PROB_001, system-signal=OBJ_CLS_TYPE2_PROB_041}, {implementation-record-element=OBJ_POS_LAT_001, system-signal=OBJ_POS_LAT_041}, {implementation-record-element=OBJ_POS_LONG_001, system-signal=OBJ_POS_LONG_041}, {implementation-record-element=OBJ_YAW_RATE_001, system-signal=OBJ_YAW_RATE_041}, {implementation-record-element=OBJ_YAW_RATE_ERR_001, system-signal=OBJ_YAW_RATE_ERR_041}, {implementation-record-element=OBJ_VELOCITY_LONG_ERR_001, system-signal=OBJ_VELOCITY_LONG_ERR_041}, {implementation-record-element=OBJ_VELOCITY_LONG_001, system-signal=OBJ_VELOCITY_LONG_041}, {implementation-record-element=OBJ_YAW_ANGLE_ERR_001, system-signal=OBJ_YAW_ANGLE_ERR_041}, {implementation-record-element=OBJ_YAW_ANGLE_001, system-signal=OBJ_YAW_ANGLE_041}]}
        sender-receiver-to-signal-group-mapping={data-element=COMPOSITIONTYPE.Pp_SG_TrackerObject042.Vdp_SG_TrackerObject042, signal-group=SG_TrackerObject042, type-mapping=sender-rec-record-type-mapping=record-element-mappings=[{implementation-record-element=OBJ_ACCEL_ERR_CRR_COEF_001, system-signal=OBJ_ACCEL_ERR_CRR_COEF_042}, {implementation-record-element=OBJ_ALIVE_TIME_001, system-signal=OBJ_ALIVE_TIME_042}, {implementation-record-element=OBJ_EXISTENCE_PROB_001, system-signal=OBJ_EXISTENCE_PROB_042}, {implementation-record-element=OBJ_GROUP_ID_001, system-signal=OBJ_GROUP_ID_042}, {implementation-record-element=OBJ_ID_001, system-signal=OBJ_ID_042}, {implementation-record-element=OBJ_MEASUREMENT_STATUS_001, system-signal=OBJ_MEASUREMENT_STATUS_042}, {implementation-record-element=OBJ_MH_CRC16_001, system-signal=OBJ_MH_CRC16_042}, {implementation-record-element=OBJ_MH_CYCLE_COUNTER_001, system-signal=OBJ_MH_CYCLE_COUNTER_042}, {implementation-record-element=OBJ_MOVEMENT_STATUS_001, system-signal=OBJ_MOVEMENT_STATUS_042}, {implementation-record-element=OBJ_POS_ERR_CRR_COEF_001, system-signal=OBJ_POS_ERR_CRR_COEF_042}, {implementation-record-element=OBJ_RCS_001, system-signal=OBJ_RCS_042}, {implementation-record-element=OBJ_REF_PT_LAT_OFFSET_001, system-signal=OBJ_REF_PT_LAT_OFFSET_042}, {implementation-record-element=OBJ_REF_PT_LONG_OFFSET_001, system-signal=OBJ_REF_PT_LONG_OFFSET_042}, {implementation-record-element=OBJ_TIMESTAMP_OFFSET_001, system-signal=OBJ_TIMESTAMP_OFFSET_042}, {implementation-record-element=OBJ_TRACK_MOTION_MODEL_001, system-signal=OBJ_TRACK_MOTION_MODEL_042}, {implementation-record-element=OBJ_VEH_TRACK_FLAG_001, system-signal=OBJ_VEH_TRACK_FLAG_042}, {implementation-record-element=OBJ_VELOCITY_ERR_CRR_COEF_001, system-signal=OBJ_VELOCITY_ERR_CRR_COEF_042}, {implementation-record-element=OBJ_CLS_TYPE1_PROB_001, system-signal=OBJ_CLS_TYPE1_PROB_042}, {implementation-record-element=OBJ_CLS_TYPE4_001, system-signal=OBJ_CLS_TYPE4_042}, {implementation-record-element=OBJ_DIMENSION_WIDTH_001, system-signal=OBJ_DIMENSION_WIDTH_042}, {implementation-record-element=OBJ_DIMENSION_WIDTH_ERR_001, system-signal=OBJ_DIMENSION_WIDTH_ERR_042}, {implementation-record-element=OBJ_POS_LONG_ERR_001, system-signal=OBJ_POS_LONG_ERR_042}, {implementation-record-element=OBJ_POS_LAT_001, system-signal=OBJ_POS_LAT_042}, {implementation-record-element=OBJ_POS_LAT_ERR_001, system-signal=OBJ_POS_LAT_ERR_042}, {implementation-record-element=OBJ_YAW_ANGLE_001, system-signal=OBJ_YAW_ANGLE_042}, {implementation-record-element=OBJ_DIMENSION_LENGTH_ERR_001, system-signal=OBJ_DIMENSION_LENGTH_ERR_042}, {implementation-record-element=OBJ_CLS_TYPE5_001, system-signal=OBJ_CLS_TYPE5_042}, {implementation-record-element=OBJ_ACCELERATION_LONG_ERR_001, system-signal=OBJ_ACCELERATION_LONG_ERR_042}, {implementation-record-element=OBJ_CLS_TYPE6_001, system-signal=OBJ_CLS_TYPE6_042}, {implementation-record-element=OBJ_CLS_TYPE2_PROB_001, system-signal=OBJ_CLS_TYPE2_PROB_042}, {implementation-record-element=OBJ_CLS_TYPE6_PROB_001, system-signal=OBJ_CLS_TYPE6_PROB_042}, {implementation-record-element=OBJ_CLS_TYPE1_001, system-signal=OBJ_CLS_TYPE1_042}, {implementation-record-element=OBJ_CLS_TYPE3_001, system-signal=OBJ_CLS_TYPE3_042}, {implementation-record-element=OBJ_CLS_TYPE4_PROB_001, system-signal=OBJ_CLS_TYPE4_PROB_042}, {implementation-record-element=OBJ_ACCELERATION_LAT_ERR_001, system-signal=OBJ_ACCELERATION_LAT_ERR_042}, {implementation-record-element=OBJ_ACCELERATION_LONG_001, system-signal=OBJ_ACCELERATION_LONG_042}, {implementation-record-element=OBJ_CLS_TYPE2_001, system-signal=OBJ_CLS_TYPE2_042}, {implementation-record-element=OBJ_VELOCITY_LAT_ERR_001, system-signal=OBJ_VELOCITY_LAT_ERR_042}, {implementation-record-element=OBJ_YAW_ANGLE_ERR_001, system-signal=OBJ_YAW_ANGLE_ERR_042}, {implementation-record-element=OBJ_ACCELERATION_LAT_001, system-signal=OBJ_ACCELERATION_LAT_042}, {implementation-record-element=OBJ_YAW_RATE_ERR_001, system-signal=OBJ_YAW_RATE_ERR_042}, {implementation-record-element=OBJ_CLS_TYPE3_PROB_001, system-signal=OBJ_CLS_TYPE3_PROB_042}, {implementation-record-element=OBJ_CLS_TYPE5_PROB_001, system-signal=OBJ_CLS_TYPE5_PROB_042}, {implementation-record-element=OBJ_VELOCITY_LONG_001, system-signal=OBJ_VELOCITY_LONG_042}, {implementation-record-element=OBJ_YAW_RATE_001, system-signal=OBJ_YAW_RATE_042}, {implementation-record-element=OBJ_VELOCITY_LONG_ERR_001, system-signal=OBJ_VELOCITY_LONG_ERR_042}, {implementation-record-element=OBJ_DIMENSION_LENGTH_001, system-signal=OBJ_DIMENSION_LENGTH_042}, {implementation-record-element=OBJ_POS_LONG_001, system-signal=OBJ_POS_LONG_042}, {implementation-record-element=OBJ_VELOCITY_LAT_001, system-signal=OBJ_VELOCITY_LAT_042}]}
        sender-receiver-to-signal-group-mapping={data-element=COMPOSITIONTYPE.Pp_SG_TrackerObject043.Vdp_SG_TrackerObject043, signal-group=SG_TrackerObject043, type-mapping=sender-rec-record-type-mapping=record-element-mappings=[{implementation-record-element=OBJ_ACCEL_ERR_CRR_COEF_001, system-signal=OBJ_ACCEL_ERR_CRR_COEF_043}, {implementation-record-element=OBJ_ALIVE_TIME_001, system-signal=OBJ_ALIVE_TIME_043}, {implementation-record-element=OBJ_EXISTENCE_PROB_001, system-signal=OBJ_EXISTENCE_PROB_043}, {implementation-record-element=OBJ_GROUP_ID_001, system-signal=OBJ_GROUP_ID_043}, {implementation-record-element=OBJ_ID_001, system-signal=OBJ_ID_043}, {implementation-record-element=OBJ_MEASUREMENT_STATUS_001, system-signal=OBJ_MEASUREMENT_STATUS_043}, {implementation-record-element=OBJ_MH_CRC16_001, system-signal=OBJ_MH_CRC16_043}, {implementation-record-element=OBJ_MH_CYCLE_COUNTER_001, system-signal=OBJ_MH_CYCLE_COUNTER_043}, {implementation-record-element=OBJ_MOVEMENT_STATUS_001, system-signal=OBJ_MOVEMENT_STATUS_043}, {implementation-record-element=OBJ_POS_ERR_CRR_COEF_001, system-signal=OBJ_POS_ERR_CRR_COEF_043}, {implementation-record-element=OBJ_RCS_001, system-signal=OBJ_RCS_043}, {implementation-record-element=OBJ_REF_PT_LAT_OFFSET_001, system-signal=OBJ_REF_PT_LAT_OFFSET_043}, {implementation-record-element=OBJ_REF_PT_LONG_OFFSET_001, system-signal=OBJ_REF_PT_LONG_OFFSET_043}, {implementation-record-element=OBJ_TIMESTAMP_OFFSET_001, system-signal=OBJ_TIMESTAMP_OFFSET_043}, {implementation-record-element=OBJ_TRACK_MOTION_MODEL_001, system-signal=OBJ_TRACK_MOTION_MODEL_043}, {implementation-record-element=OBJ_VEH_TRACK_FLAG_001, system-signal=OBJ_VEH_TRACK_FLAG_043}, {implementation-record-element=OBJ_VELOCITY_ERR_CRR_COEF_001, system-signal=OBJ_VELOCITY_ERR_CRR_COEF_043}, {implementation-record-element=OBJ_ACCELERATION_LAT_001, system-signal=OBJ_ACCELERATION_LAT_043}, {implementation-record-element=OBJ_ACCELERATION_LONG_ERR_001, system-signal=OBJ_ACCELERATION_LONG_ERR_043}, {implementation-record-element=OBJ_CLS_TYPE1_001, system-signal=OBJ_CLS_TYPE1_043}, {implementation-record-element=OBJ_ACCELERATION_LAT_ERR_001, system-signal=OBJ_ACCELERATION_LAT_ERR_043}, {implementation-record-element=OBJ_ACCELERATION_LONG_001, system-signal=OBJ_ACCELERATION_LONG_043}, {implementation-record-element=OBJ_CLS_TYPE2_PROB_001, system-signal=OBJ_CLS_TYPE2_PROB_043}, {implementation-record-element=OBJ_CLS_TYPE3_PROB_001, system-signal=OBJ_CLS_TYPE3_PROB_043}, {implementation-record-element=OBJ_POS_LAT_ERR_001, system-signal=OBJ_POS_LAT_ERR_043}, {implementation-record-element=OBJ_POS_LONG_001, system-signal=OBJ_POS_LONG_043}, {implementation-record-element=OBJ_CLS_TYPE1_PROB_001, system-signal=OBJ_CLS_TYPE1_PROB_043}, {implementation-record-element=OBJ_CLS_TYPE2_001, system-signal=OBJ_CLS_TYPE2_043}, {implementation-record-element=OBJ_YAW_ANGLE_001, system-signal=OBJ_YAW_ANGLE_043}, {implementation-record-element=OBJ_POS_LONG_ERR_001, system-signal=OBJ_POS_LONG_ERR_043}, {implementation-record-element=OBJ_CLS_TYPE5_PROB_001, system-signal=OBJ_CLS_TYPE5_PROB_043}, {implementation-record-element=OBJ_VELOCITY_LAT_001, system-signal=OBJ_VELOCITY_LAT_043}, {implementation-record-element=OBJ_YAW_RATE_ERR_001, system-signal=OBJ_YAW_RATE_ERR_043}, {implementation-record-element=OBJ_VELOCITY_LONG_001, system-signal=OBJ_VELOCITY_LONG_043}, {implementation-record-element=OBJ_YAW_RATE_001, system-signal=OBJ_YAW_RATE_043}, {implementation-record-element=OBJ_VELOCITY_LAT_ERR_001, system-signal=OBJ_VELOCITY_LAT_ERR_043}, {implementation-record-element=OBJ_CLS_TYPE5_001, system-signal=OBJ_CLS_TYPE5_043}, {implementation-record-element=OBJ_DIMENSION_WIDTH_ERR_001, system-signal=OBJ_DIMENSION_WIDTH_ERR_043}, {implementation-record-element=OBJ_DIMENSION_LENGTH_001, system-signal=OBJ_DIMENSION_LENGTH_043}, {implementation-record-element=OBJ_DIMENSION_LENGTH_ERR_001, system-signal=OBJ_DIMENSION_LENGTH_ERR_043}, {implementation-record-element=OBJ_CLS_TYPE6_PROB_001, system-signal=OBJ_CLS_TYPE6_PROB_043}, {implementation-record-element=OBJ_VELOCITY_LONG_ERR_001, system-signal=OBJ_VELOCITY_LONG_ERR_043}, {implementation-record-element=OBJ_CLS_TYPE4_001, system-signal=OBJ_CLS_TYPE4_043}, {implementation-record-element=OBJ_CLS_TYPE4_PROB_001, system-signal=OBJ_CLS_TYPE4_PROB_043}, {implementation-record-element=OBJ_YAW_ANGLE_ERR_001, system-signal=OBJ_YAW_ANGLE_ERR_043}, {implementation-record-element=OBJ_CLS_TYPE3_001, system-signal=OBJ_CLS_TYPE3_043}, {implementation-record-element=OBJ_POS_LAT_001, system-signal=OBJ_POS_LAT_043}, {implementation-record-element=OBJ_DIMENSION_WIDTH_001, system-signal=OBJ_DIMENSION_WIDTH_043}, {implementation-record-element=OBJ_CLS_TYPE6_001, system-signal=OBJ_CLS_TYPE6_043}]}
        sender-receiver-to-signal-group-mapping={data-element=COMPOSITIONTYPE.Pp_SG_TrackerObject044.Vdp_SG_TrackerObject044, signal-group=SG_TrackerObject044, type-mapping=sender-rec-record-type-mapping=record-element-mappings=[{implementation-record-element=OBJ_ACCEL_ERR_CRR_COEF_001, system-signal=OBJ_ACCEL_ERR_CRR_COEF_044}, {implementation-record-element=OBJ_ALIVE_TIME_001, system-signal=OBJ_ALIVE_TIME_044}, {implementation-record-element=OBJ_EXISTENCE_PROB_001, system-signal=OBJ_EXISTENCE_PROB_044}, {implementation-record-element=OBJ_GROUP_ID_001, system-signal=OBJ_GROUP_ID_044}, {implementation-record-element=OBJ_ID_001, system-signal=OBJ_ID_044}, {implementation-record-element=OBJ_MEASUREMENT_STATUS_001, system-signal=OBJ_MEASUREMENT_STATUS_044}, {implementation-record-element=OBJ_MH_CRC16_001, system-signal=OBJ_MH_CRC16_044}, {implementation-record-element=OBJ_MH_CYCLE_COUNTER_001, system-signal=OBJ_MH_CYCLE_COUNTER_044}, {implementation-record-element=OBJ_MOVEMENT_STATUS_001, system-signal=OBJ_MOVEMENT_STATUS_044}, {implementation-record-element=OBJ_POS_ERR_CRR_COEF_001, system-signal=OBJ_POS_ERR_CRR_COEF_044}, {implementation-record-element=OBJ_RCS_001, system-signal=OBJ_RCS_044}, {implementation-record-element=OBJ_REF_PT_LAT_OFFSET_001, system-signal=OBJ_REF_PT_LAT_OFFSET_044}, {implementation-record-element=OBJ_REF_PT_LONG_OFFSET_001, system-signal=OBJ_REF_PT_LONG_OFFSET_044}, {implementation-record-element=OBJ_TIMESTAMP_OFFSET_001, system-signal=OBJ_TIMESTAMP_OFFSET_044}, {implementation-record-element=OBJ_TRACK_MOTION_MODEL_001, system-signal=OBJ_TRACK_MOTION_MODEL_044}, {implementation-record-element=OBJ_VEH_TRACK_FLAG_001, system-signal=OBJ_VEH_TRACK_FLAG_044}, {implementation-record-element=OBJ_VELOCITY_ERR_CRR_COEF_001, system-signal=OBJ_VELOCITY_ERR_CRR_COEF_044}, {implementation-record-element=OBJ_ACCELERATION_LAT_ERR_001, system-signal=OBJ_ACCELERATION_LAT_ERR_044}, {implementation-record-element=OBJ_ACCELERATION_LONG_001, system-signal=OBJ_ACCELERATION_LONG_044}, {implementation-record-element=OBJ_CLS_TYPE1_001, system-signal=OBJ_CLS_TYPE1_044}, {implementation-record-element=OBJ_CLS_TYPE2_PROB_001, system-signal=OBJ_CLS_TYPE2_PROB_044}, {implementation-record-element=OBJ_CLS_TYPE3_001, system-signal=OBJ_CLS_TYPE3_044}, {implementation-record-element=OBJ_CLS_TYPE5_001, system-signal=OBJ_CLS_TYPE5_044}, {implementation-record-element=OBJ_ACCELERATION_LONG_ERR_001, system-signal=OBJ_ACCELERATION_LONG_ERR_044}, {implementation-record-element=OBJ_ACCELERATION_LAT_001, system-signal=OBJ_ACCELERATION_LAT_044}, {implementation-record-element=OBJ_CLS_TYPE6_001, system-signal=OBJ_CLS_TYPE6_044}, {implementation-record-element=OBJ_CLS_TYPE2_001, system-signal=OBJ_CLS_TYPE2_044}, {implementation-record-element=OBJ_CLS_TYPE6_PROB_001, system-signal=OBJ_CLS_TYPE6_PROB_044}, {implementation-record-element=OBJ_DIMENSION_LENGTH_001, system-signal=OBJ_DIMENSION_LENGTH_044}, {implementation-record-element=OBJ_CLS_TYPE3_PROB_001, system-signal=OBJ_CLS_TYPE3_PROB_044}, {implementation-record-element=OBJ_CLS_TYPE4_001, system-signal=OBJ_CLS_TYPE4_044}, {implementation-record-element=OBJ_CLS_TYPE4_PROB_001, system-signal=OBJ_CLS_TYPE4_PROB_044}, {implementation-record-element=OBJ_CLS_TYPE5_PROB_001, system-signal=OBJ_CLS_TYPE5_PROB_044}, {implementation-record-element=OBJ_DIMENSION_LENGTH_ERR_001, system-signal=OBJ_DIMENSION_LENGTH_ERR_044}, {implementation-record-element=OBJ_DIMENSION_WIDTH_001, system-signal=OBJ_DIMENSION_WIDTH_044}, {implementation-record-element=OBJ_CLS_TYPE1_PROB_001, system-signal=OBJ_CLS_TYPE1_PROB_044}, {implementation-record-element=OBJ_POS_LAT_ERR_001, system-signal=OBJ_POS_LAT_ERR_044}, {implementation-record-element=OBJ_YAW_RATE_ERR_001, system-signal=OBJ_YAW_RATE_ERR_044}, {implementation-record-element=OBJ_POS_LAT_001, system-signal=OBJ_POS_LAT_044}, {implementation-record-element=OBJ_VELOCITY_LAT_ERR_001, system-signal=OBJ_VELOCITY_LAT_ERR_044}, {implementation-record-element=OBJ_VELOCITY_LONG_ERR_001, system-signal=OBJ_VELOCITY_LONG_ERR_044}, {implementation-record-element=OBJ_YAW_RATE_001, system-signal=OBJ_YAW_RATE_044}, {implementation-record-element=OBJ_YAW_ANGLE_001, system-signal=OBJ_YAW_ANGLE_044}, {implementation-record-element=OBJ_DIMENSION_WIDTH_ERR_001, system-signal=OBJ_DIMENSION_WIDTH_ERR_044}, {implementation-record-element=OBJ_POS_LONG_ERR_001, system-signal=OBJ_POS_LONG_ERR_044}, {implementation-record-element=OBJ_VELOCITY_LAT_001, system-signal=OBJ_VELOCITY_LAT_044}, {implementation-record-element=OBJ_VELOCITY_LONG_001, system-signal=OBJ_VELOCITY_LONG_044}, {implementation-record-element=OBJ_YAW_ANGLE_ERR_001, system-signal=OBJ_YAW_ANGLE_ERR_044}, {implementation-record-element=OBJ_POS_LONG_001, system-signal=OBJ_POS_LONG_044}]}
        sender-receiver-to-signal-group-mapping={data-element=COMPOSITIONTYPE.Pp_SG_TrackerObject045.Vdp_SG_TrackerObject045, signal-group=SG_TrackerObject045, type-mapping=sender-rec-record-type-mapping=record-element-mappings=[{implementation-record-element=OBJ_ACCEL_ERR_CRR_COEF_001, system-signal=OBJ_ACCEL_ERR_CRR_COEF_045}, {implementation-record-element=OBJ_ALIVE_TIME_001, system-signal=OBJ_ALIVE_TIME_045}, {implementation-record-element=OBJ_EXISTENCE_PROB_001, system-signal=OBJ_EXISTENCE_PROB_045}, {implementation-record-element=OBJ_GROUP_ID_001, system-signal=OBJ_GROUP_ID_045}, {implementation-record-element=OBJ_ID_001, system-signal=OBJ_ID_045}, {implementation-record-element=OBJ_MEASUREMENT_STATUS_001, system-signal=OBJ_MEASUREMENT_STATUS_045}, {implementation-record-element=OBJ_MH_CRC16_001, system-signal=OBJ_MH_CRC16_045}, {implementation-record-element=OBJ_MH_CYCLE_COUNTER_001, system-signal=OBJ_MH_CYCLE_COUNTER_045}, {implementation-record-element=OBJ_MOVEMENT_STATUS_001, system-signal=OBJ_MOVEMENT_STATUS_045}, {implementation-record-element=OBJ_POS_ERR_CRR_COEF_001, system-signal=OBJ_POS_ERR_CRR_COEF_045}, {implementation-record-element=OBJ_RCS_001, system-signal=OBJ_RCS_045}, {implementation-record-element=OBJ_REF_PT_LAT_OFFSET_001, system-signal=OBJ_REF_PT_LAT_OFFSET_045}, {implementation-record-element=OBJ_REF_PT_LONG_OFFSET_001, system-signal=OBJ_REF_PT_LONG_OFFSET_045}, {implementation-record-element=OBJ_TIMESTAMP_OFFSET_001, system-signal=OBJ_TIMESTAMP_OFFSET_045}, {implementation-record-element=OBJ_TRACK_MOTION_MODEL_001, system-signal=OBJ_TRACK_MOTION_MODEL_045}, {implementation-record-element=OBJ_VEH_TRACK_FLAG_001, system-signal=OBJ_VEH_TRACK_FLAG_045}, {implementation-record-element=OBJ_VELOCITY_ERR_CRR_COEF_001, system-signal=OBJ_VELOCITY_ERR_CRR_COEF_045}, {implementation-record-element=OBJ_CLS_TYPE2_PROB_001, system-signal=OBJ_CLS_TYPE2_PROB_045}, {implementation-record-element=OBJ_CLS_TYPE3_001, system-signal=OBJ_CLS_TYPE3_045}, {implementation-record-element=OBJ_POS_LONG_001, system-signal=OBJ_POS_LONG_045}, {implementation-record-element=OBJ_POS_LONG_ERR_001, system-signal=OBJ_POS_LONG_ERR_045}, {implementation-record-element=OBJ_ACCELERATION_LAT_ERR_001, system-signal=OBJ_ACCELERATION_LAT_ERR_045}, {implementation-record-element=OBJ_CLS_TYPE3_PROB_001, system-signal=OBJ_CLS_TYPE3_PROB_045}, {implementation-record-element=OBJ_CLS_TYPE2_001, system-signal=OBJ_CLS_TYPE2_045}, {implementation-record-element=OBJ_DIMENSION_WIDTH_001, system-signal=OBJ_DIMENSION_WIDTH_045}, {implementation-record-element=OBJ_CLS_TYPE5_PROB_001, system-signal=OBJ_CLS_TYPE5_PROB_045}, {implementation-record-element=OBJ_CLS_TYPE6_001, system-signal=OBJ_CLS_TYPE6_045}, {implementation-record-element=OBJ_DIMENSION_LENGTH_001, system-signal=OBJ_DIMENSION_LENGTH_045}, {implementation-record-element=OBJ_DIMENSION_LENGTH_ERR_001, system-signal=OBJ_DIMENSION_LENGTH_ERR_045}, {implementation-record-element=OBJ_ACCELERATION_LAT_001, system-signal=OBJ_ACCELERATION_LAT_045}, {implementation-record-element=OBJ_ACCELERATION_LONG_ERR_001, system-signal=OBJ_ACCELERATION_LONG_ERR_045}, {implementation-record-element=OBJ_CLS_TYPE1_PROB_001, system-signal=OBJ_CLS_TYPE1_PROB_045}, {implementation-record-element=OBJ_CLS_TYPE1_001, system-signal=OBJ_CLS_TYPE1_045}, {implementation-record-element=OBJ_CLS_TYPE5_001, system-signal=OBJ_CLS_TYPE5_045}, {implementation-record-element=OBJ_CLS_TYPE6_PROB_001, system-signal=OBJ_CLS_TYPE6_PROB_045}, {implementation-record-element=OBJ_DIMENSION_WIDTH_ERR_001, system-signal=OBJ_DIMENSION_WIDTH_ERR_045}, {implementation-record-element=OBJ_CLS_TYPE4_001, system-signal=OBJ_CLS_TYPE4_045}, {implementation-record-element=OBJ_CLS_TYPE4_PROB_001, system-signal=OBJ_CLS_TYPE4_PROB_045}, {implementation-record-element=OBJ_POS_LAT_001, system-signal=OBJ_POS_LAT_045}, {implementation-record-element=OBJ_ACCELERATION_LONG_001, system-signal=OBJ_ACCELERATION_LONG_045}, {implementation-record-element=OBJ_POS_LAT_ERR_001, system-signal=OBJ_POS_LAT_ERR_045}, {implementation-record-element=OBJ_YAW_ANGLE_ERR_001, system-signal=OBJ_YAW_ANGLE_ERR_045}, {implementation-record-element=OBJ_YAW_RATE_ERR_001, system-signal=OBJ_YAW_RATE_ERR_045}, {implementation-record-element=OBJ_YAW_ANGLE_001, system-signal=OBJ_YAW_ANGLE_045}, {implementation-record-element=OBJ_VELOCITY_LAT_001, system-signal=OBJ_VELOCITY_LAT_045}, {implementation-record-element=OBJ_VELOCITY_LONG_ERR_001, system-signal=OBJ_VELOCITY_LONG_ERR_045}, {implementation-record-element=OBJ_VELOCITY_LONG_001, system-signal=OBJ_VELOCITY_LONG_045}, {implementation-record-element=OBJ_YAW_RATE_001, system-signal=OBJ_YAW_RATE_045}, {implementation-record-element=OBJ_VELOCITY_LAT_ERR_001, system-signal=OBJ_VELOCITY_LAT_ERR_045}]}
        sender-receiver-to-signal-group-mapping={data-element=COMPOSITIONTYPE.Pp_SG_TrackerObject046.Vdp_SG_TrackerObject046, signal-group=SG_TrackerObject046, type-mapping=sender-rec-record-type-mapping=record-element-mappings=[{implementation-record-element=OBJ_ACCEL_ERR_CRR_COEF_001, system-signal=OBJ_ACCEL_ERR_CRR_COEF_046}, {implementation-record-element=OBJ_ALIVE_TIME_001, system-signal=OBJ_ALIVE_TIME_046}, {implementation-record-element=OBJ_EXISTENCE_PROB_001, system-signal=OBJ_EXISTENCE_PROB_046}, {implementation-record-element=OBJ_GROUP_ID_001, system-signal=OBJ_GROUP_ID_046}, {implementation-record-element=OBJ_ID_001, system-signal=OBJ_ID_046}, {implementation-record-element=OBJ_MEASUREMENT_STATUS_001, system-signal=OBJ_MEASUREMENT_STATUS_046}, {implementation-record-element=OBJ_MH_CRC16_001, system-signal=OBJ_MH_CRC16_046}, {implementation-record-element=OBJ_MH_CYCLE_COUNTER_001, system-signal=OBJ_MH_CYCLE_COUNTER_046}, {implementation-record-element=OBJ_MOVEMENT_STATUS_001, system-signal=OBJ_MOVEMENT_STATUS_046}, {implementation-record-element=OBJ_POS_ERR_CRR_COEF_001, system-signal=OBJ_POS_ERR_CRR_COEF_046}, {implementation-record-element=OBJ_RCS_001, system-signal=OBJ_RCS_046}, {implementation-record-element=OBJ_REF_PT_LAT_OFFSET_001, system-signal=OBJ_REF_PT_LAT_OFFSET_046}, {implementation-record-element=OBJ_REF_PT_LONG_OFFSET_001, system-signal=OBJ_REF_PT_LONG_OFFSET_046}, {implementation-record-element=OBJ_TIMESTAMP_OFFSET_001, system-signal=OBJ_TIMESTAMP_OFFSET_046}, {implementation-record-element=OBJ_TRACK_MOTION_MODEL_001, system-signal=OBJ_TRACK_MOTION_MODEL_046}, {implementation-record-element=OBJ_VEH_TRACK_FLAG_001, system-signal=OBJ_VEH_TRACK_FLAG_046}, {implementation-record-element=OBJ_VELOCITY_ERR_CRR_COEF_001, system-signal=OBJ_VELOCITY_ERR_CRR_COEF_046}, {implementation-record-element=OBJ_CLS_TYPE1_001, system-signal=OBJ_CLS_TYPE1_046}, {implementation-record-element=OBJ_CLS_TYPE5_001, system-signal=OBJ_CLS_TYPE5_046}, {implementation-record-element=OBJ_CLS_TYPE4_001, system-signal=OBJ_CLS_TYPE4_046}, {implementation-record-element=OBJ_VELOCITY_LONG_001, system-signal=OBJ_VELOCITY_LONG_046}, {implementation-record-element=OBJ_CLS_TYPE2_PROB_001, system-signal=OBJ_CLS_TYPE2_PROB_046}, {implementation-record-element=OBJ_POS_LAT_001, system-signal=OBJ_POS_LAT_046}, {implementation-record-element=OBJ_VELOCITY_LAT_001, system-signal=OBJ_VELOCITY_LAT_046}, {implementation-record-element=OBJ_ACCELERATION_LONG_001, system-signal=OBJ_ACCELERATION_LONG_046}, {implementation-record-element=OBJ_YAW_RATE_001, system-signal=OBJ_YAW_RATE_046}, {implementation-record-element=OBJ_YAW_RATE_ERR_001, system-signal=OBJ_YAW_RATE_ERR_046}, {implementation-record-element=OBJ_CLS_TYPE4_PROB_001, system-signal=OBJ_CLS_TYPE4_PROB_046}, {implementation-record-element=OBJ_DIMENSION_WIDTH_ERR_001, system-signal=OBJ_DIMENSION_WIDTH_ERR_046}, {implementation-record-element=OBJ_CLS_TYPE1_PROB_001, system-signal=OBJ_CLS_TYPE1_PROB_046}, {implementation-record-element=OBJ_DIMENSION_WIDTH_001, system-signal=OBJ_DIMENSION_WIDTH_046}, {implementation-record-element=OBJ_CLS_TYPE3_001, system-signal=OBJ_CLS_TYPE3_046}, {implementation-record-element=OBJ_POS_LONG_001, system-signal=OBJ_POS_LONG_046}, {implementation-record-element=OBJ_POS_LAT_ERR_001, system-signal=OBJ_POS_LAT_ERR_046}, {implementation-record-element=OBJ_ACCELERATION_LONG_ERR_001, system-signal=OBJ_ACCELERATION_LONG_ERR_046}, {implementation-record-element=OBJ_VELOCITY_LONG_ERR_001, system-signal=OBJ_VELOCITY_LONG_ERR_046}, {implementation-record-element=OBJ_YAW_ANGLE_001, system-signal=OBJ_YAW_ANGLE_046}, {implementation-record-element=OBJ_ACCELERATION_LAT_ERR_001, system-signal=OBJ_ACCELERATION_LAT_ERR_046}, {implementation-record-element=OBJ_ACCELERATION_LAT_001, system-signal=OBJ_ACCELERATION_LAT_046}, {implementation-record-element=OBJ_POS_LONG_ERR_001, system-signal=OBJ_POS_LONG_ERR_046}, {implementation-record-element=OBJ_CLS_TYPE3_PROB_001, system-signal=OBJ_CLS_TYPE3_PROB_046}, {implementation-record-element=OBJ_CLS_TYPE5_PROB_001, system-signal=OBJ_CLS_TYPE5_PROB_046}, {implementation-record-element=OBJ_CLS_TYPE6_001, system-signal=OBJ_CLS_TYPE6_046}, {implementation-record-element=OBJ_CLS_TYPE6_PROB_001, system-signal=OBJ_CLS_TYPE6_PROB_046}, {implementation-record-element=OBJ_DIMENSION_LENGTH_ERR_001, system-signal=OBJ_DIMENSION_LENGTH_ERR_046}, {implementation-record-element=OBJ_CLS_TYPE2_001, system-signal=OBJ_CLS_TYPE2_046}, {implementation-record-element=OBJ_DIMENSION_LENGTH_001, system-signal=OBJ_DIMENSION_LENGTH_046}, {implementation-record-element=OBJ_VELOCITY_LAT_ERR_001, system-signal=OBJ_VELOCITY_LAT_ERR_046}, {implementation-record-element=OBJ_YAW_ANGLE_ERR_001, system-signal=OBJ_YAW_ANGLE_ERR_046}]}
        sender-receiver-to-signal-group-mapping={data-element=COMPOSITIONTYPE.Pp_SG_TrackerObject047.Vdp_SG_TrackerObject047, signal-group=SG_TrackerObject047, type-mapping=sender-rec-record-type-mapping=record-element-mappings=[{implementation-record-element=OBJ_ACCEL_ERR_CRR_COEF_001, system-signal=OBJ_ACCEL_ERR_CRR_COEF_047}, {implementation-record-element=OBJ_ALIVE_TIME_001, system-signal=OBJ_ALIVE_TIME_047}, {implementation-record-element=OBJ_EXISTENCE_PROB_001, system-signal=OBJ_EXISTENCE_PROB_047}, {implementation-record-element=OBJ_GROUP_ID_001, system-signal=OBJ_GROUP_ID_047}, {implementation-record-element=OBJ_ID_001, system-signal=OBJ_ID_047}, {implementation-record-element=OBJ_MEASUREMENT_STATUS_001, system-signal=OBJ_MEASUREMENT_STATUS_047}, {implementation-record-element=OBJ_MH_CRC16_001, system-signal=OBJ_MH_CRC16_047}, {implementation-record-element=OBJ_MH_CYCLE_COUNTER_001, system-signal=OBJ_MH_CYCLE_COUNTER_047}, {implementation-record-element=OBJ_MOVEMENT_STATUS_001, system-signal=OBJ_MOVEMENT_STATUS_047}, {implementation-record-element=OBJ_POS_ERR_CRR_COEF_001, system-signal=OBJ_POS_ERR_CRR_COEF_047}, {implementation-record-element=OBJ_RCS_001, system-signal=OBJ_RCS_047}, {implementation-record-element=OBJ_REF_PT_LAT_OFFSET_001, system-signal=OBJ_REF_PT_LAT_OFFSET_047}, {implementation-record-element=OBJ_REF_PT_LONG_OFFSET_001, system-signal=OBJ_REF_PT_LONG_OFFSET_047}, {implementation-record-element=OBJ_TIMESTAMP_OFFSET_001, system-signal=OBJ_TIMESTAMP_OFFSET_047}, {implementation-record-element=OBJ_TRACK_MOTION_MODEL_001, system-signal=OBJ_TRACK_MOTION_MODEL_047}, {implementation-record-element=OBJ_VEH_TRACK_FLAG_001, system-signal=OBJ_VEH_TRACK_FLAG_047}, {implementation-record-element=OBJ_VELOCITY_ERR_CRR_COEF_001, system-signal=OBJ_VELOCITY_ERR_CRR_COEF_047}, {implementation-record-element=OBJ_CLS_TYPE2_PROB_001, system-signal=OBJ_CLS_TYPE2_PROB_047}, {implementation-record-element=OBJ_CLS_TYPE4_001, system-signal=OBJ_CLS_TYPE4_047}, {implementation-record-element=OBJ_CLS_TYPE4_PROB_001, system-signal=OBJ_CLS_TYPE4_PROB_047}, {implementation-record-element=OBJ_CLS_TYPE1_001, system-signal=OBJ_CLS_TYPE1_047}, {implementation-record-element=OBJ_CLS_TYPE5_PROB_001, system-signal=OBJ_CLS_TYPE5_PROB_047}, {implementation-record-element=OBJ_YAW_ANGLE_001, system-signal=OBJ_YAW_ANGLE_047}, {implementation-record-element=OBJ_ACCELERATION_LONG_ERR_001, system-signal=OBJ_ACCELERATION_LONG_ERR_047}, {implementation-record-element=OBJ_ACCELERATION_LAT_001, system-signal=OBJ_ACCELERATION_LAT_047}, {implementation-record-element=OBJ_CLS_TYPE5_001, system-signal=OBJ_CLS_TYPE5_047}, {implementation-record-element=OBJ_CLS_TYPE6_PROB_001, system-signal=OBJ_CLS_TYPE6_PROB_047}, {implementation-record-element=OBJ_CLS_TYPE3_PROB_001, system-signal=OBJ_CLS_TYPE3_PROB_047}, {implementation-record-element=OBJ_ACCELERATION_LAT_ERR_001, system-signal=OBJ_ACCELERATION_LAT_ERR_047}, {implementation-record-element=OBJ_DIMENSION_LENGTH_001, system-signal=OBJ_DIMENSION_LENGTH_047}, {implementation-record-element=OBJ_CLS_TYPE2_001, system-signal=OBJ_CLS_TYPE2_047}, {implementation-record-element=OBJ_POS_LONG_ERR_001, system-signal=OBJ_POS_LONG_ERR_047}, {implementation-record-element=OBJ_VELOCITY_LAT_001, system-signal=OBJ_VELOCITY_LAT_047}, {implementation-record-element=OBJ_YAW_RATE_001, system-signal=OBJ_YAW_RATE_047}, {implementation-record-element=OBJ_POS_LONG_001, system-signal=OBJ_POS_LONG_047}, {implementation-record-element=OBJ_POS_LAT_ERR_001, system-signal=OBJ_POS_LAT_ERR_047}, {implementation-record-element=OBJ_DIMENSION_LENGTH_ERR_001, system-signal=OBJ_DIMENSION_LENGTH_ERR_047}, {implementation-record-element=OBJ_YAW_ANGLE_ERR_001, system-signal=OBJ_YAW_ANGLE_ERR_047}, {implementation-record-element=OBJ_POS_LAT_001, system-signal=OBJ_POS_LAT_047}, {implementation-record-element=OBJ_VELOCITY_LAT_ERR_001, system-signal=OBJ_VELOCITY_LAT_ERR_047}, {implementation-record-element=OBJ_VELOCITY_LONG_ERR_001, system-signal=OBJ_VELOCITY_LONG_ERR_047}, {implementation-record-element=OBJ_CLS_TYPE1_PROB_001, system-signal=OBJ_CLS_TYPE1_PROB_047}, {implementation-record-element=OBJ_DIMENSION_WIDTH_001, system-signal=OBJ_DIMENSION_WIDTH_047}, {implementation-record-element=OBJ_DIMENSION_WIDTH_ERR_001, system-signal=OBJ_DIMENSION_WIDTH_ERR_047}, {implementation-record-element=OBJ_ACCELERATION_LONG_001, system-signal=OBJ_ACCELERATION_LONG_047}, {implementation-record-element=OBJ_CLS_TYPE3_001, system-signal=OBJ_CLS_TYPE3_047}, {implementation-record-element=OBJ_YAW_RATE_ERR_001, system-signal=OBJ_YAW_RATE_ERR_047}, {implementation-record-element=OBJ_CLS_TYPE6_001, system-signal=OBJ_CLS_TYPE6_047}, {implementation-record-element=OBJ_VELOCITY_LONG_001, system-signal=OBJ_VELOCITY_LONG_047}]}
        sender-receiver-to-signal-group-mapping={data-element=COMPOSITIONTYPE.Pp_SG_TrackerObject048.Vdp_SG_TrackerObject048, signal-group=SG_TrackerObject048, type-mapping=sender-rec-record-type-mapping=record-element-mappings=[{implementation-record-element=OBJ_ACCEL_ERR_CRR_COEF_001, system-signal=OBJ_ACCEL_ERR_CRR_COEF_048}, {implementation-record-element=OBJ_ALIVE_TIME_001, system-signal=OBJ_ALIVE_TIME_048}, {implementation-record-element=OBJ_EXISTENCE_PROB_001, system-signal=OBJ_EXISTENCE_PROB_048}, {implementation-record-element=OBJ_GROUP_ID_001, system-signal=OBJ_GROUP_ID_048}, {implementation-record-element=OBJ_ID_001, system-signal=OBJ_ID_048}, {implementation-record-element=OBJ_MEASUREMENT_STATUS_001, system-signal=OBJ_MEASUREMENT_STATUS_048}, {implementation-record-element=OBJ_MH_CRC16_001, system-signal=OBJ_MH_CRC16_048}, {implementation-record-element=OBJ_MH_CYCLE_COUNTER_001, system-signal=OBJ_MH_CYCLE_COUNTER_048}, {implementation-record-element=OBJ_MOVEMENT_STATUS_001, system-signal=OBJ_MOVEMENT_STATUS_048}, {implementation-record-element=OBJ_POS_ERR_CRR_COEF_001, system-signal=OBJ_POS_ERR_CRR_COEF_048}, {implementation-record-element=OBJ_RCS_001, system-signal=OBJ_RCS_048}, {implementation-record-element=OBJ_REF_PT_LAT_OFFSET_001, system-signal=OBJ_REF_PT_LAT_OFFSET_048}, {implementation-record-element=OBJ_REF_PT_LONG_OFFSET_001, system-signal=OBJ_REF_PT_LONG_OFFSET_048}, {implementation-record-element=OBJ_TIMESTAMP_OFFSET_001, system-signal=OBJ_TIMESTAMP_OFFSET_048}, {implementation-record-element=OBJ_TRACK_MOTION_MODEL_001, system-signal=OBJ_TRACK_MOTION_MODEL_048}, {implementation-record-element=OBJ_VEH_TRACK_FLAG_001, system-signal=OBJ_VEH_TRACK_FLAG_048}, {implementation-record-element=OBJ_VELOCITY_ERR_CRR_COEF_001, system-signal=OBJ_VELOCITY_ERR_CRR_COEF_048}, {implementation-record-element=OBJ_CLS_TYPE1_PROB_001, system-signal=OBJ_CLS_TYPE1_PROB_048}, {implementation-record-element=OBJ_CLS_TYPE2_001, system-signal=OBJ_CLS_TYPE2_048}, {implementation-record-element=OBJ_CLS_TYPE2_PROB_001, system-signal=OBJ_CLS_TYPE2_PROB_048}, {implementation-record-element=OBJ_CLS_TYPE3_PROB_001, system-signal=OBJ_CLS_TYPE3_PROB_048}, {implementation-record-element=OBJ_CLS_TYPE4_001, system-signal=OBJ_CLS_TYPE4_048}, {implementation-record-element=OBJ_CLS_TYPE3_001, system-signal=OBJ_CLS_TYPE3_048}, {implementation-record-element=OBJ_ACCELERATION_LAT_001, system-signal=OBJ_ACCELERATION_LAT_048}, {implementation-record-element=OBJ_ACCELERATION_LAT_ERR_001, system-signal=OBJ_ACCELERATION_LAT_ERR_048}, {implementation-record-element=OBJ_ACCELERATION_LONG_001, system-signal=OBJ_ACCELERATION_LONG_048}, {implementation-record-element=OBJ_ACCELERATION_LONG_ERR_001, system-signal=OBJ_ACCELERATION_LONG_ERR_048}, {implementation-record-element=OBJ_CLS_TYPE1_001, system-signal=OBJ_CLS_TYPE1_048}, {implementation-record-element=OBJ_VELOCITY_LAT_001, system-signal=OBJ_VELOCITY_LAT_048}, {implementation-record-element=OBJ_CLS_TYPE5_001, system-signal=OBJ_CLS_TYPE5_048}, {implementation-record-element=OBJ_CLS_TYPE5_PROB_001, system-signal=OBJ_CLS_TYPE5_PROB_048}, {implementation-record-element=OBJ_VELOCITY_LONG_001, system-signal=OBJ_VELOCITY_LONG_048}, {implementation-record-element=OBJ_DIMENSION_LENGTH_ERR_001, system-signal=OBJ_DIMENSION_LENGTH_ERR_048}, {implementation-record-element=OBJ_DIMENSION_LENGTH_001, system-signal=OBJ_DIMENSION_LENGTH_048}, {implementation-record-element=OBJ_YAW_RATE_ERR_001, system-signal=OBJ_YAW_RATE_ERR_048}, {implementation-record-element=OBJ_CLS_TYPE4_PROB_001, system-signal=OBJ_CLS_TYPE4_PROB_048}, {implementation-record-element=OBJ_YAW_ANGLE_ERR_001, system-signal=OBJ_YAW_ANGLE_ERR_048}, {implementation-record-element=OBJ_CLS_TYPE6_PROB_001, system-signal=OBJ_CLS_TYPE6_PROB_048}, {implementation-record-element=OBJ_YAW_ANGLE_001, system-signal=OBJ_YAW_ANGLE_048}, {implementation-record-element=OBJ_VELOCITY_LAT_ERR_001, system-signal=OBJ_VELOCITY_LAT_ERR_048}, {implementation-record-element=OBJ_POS_LAT_001, system-signal=OBJ_POS_LAT_048}, {implementation-record-element=OBJ_VELOCITY_LONG_ERR_001, system-signal=OBJ_VELOCITY_LONG_ERR_048}, {implementation-record-element=OBJ_DIMENSION_WIDTH_ERR_001, system-signal=OBJ_DIMENSION_WIDTH_ERR_048}, {implementation-record-element=OBJ_POS_LONG_ERR_001, system-signal=OBJ_POS_LONG_ERR_048}, {implementation-record-element=OBJ_POS_LONG_001, system-signal=OBJ_POS_LONG_048}, {implementation-record-element=OBJ_YAW_RATE_001, system-signal=OBJ_YAW_RATE_048}, {implementation-record-element=OBJ_CLS_TYPE6_001, system-signal=OBJ_CLS_TYPE6_048}, {implementation-record-element=OBJ_DIMENSION_WIDTH_001, system-signal=OBJ_DIMENSION_WIDTH_048}, {implementation-record-element=OBJ_POS_LAT_ERR_001, system-signal=OBJ_POS_LAT_ERR_048}]}
        sender-receiver-to-signal-group-mapping={data-element=COMPOSITIONTYPE.Pp_SG_TrackerObject049.Vdp_SG_TrackerObject049, signal-group=SG_TrackerObject049, type-mapping=sender-rec-record-type-mapping=record-element-mappings=[{implementation-record-element=OBJ_ACCEL_ERR_CRR_COEF_001, system-signal=OBJ_ACCEL_ERR_CRR_COEF_049}, {implementation-record-element=OBJ_ALIVE_TIME_001, system-signal=OBJ_ALIVE_TIME_049}, {implementation-record-element=OBJ_EXISTENCE_PROB_001, system-signal=OBJ_EXISTENCE_PROB_049}, {implementation-record-element=OBJ_GROUP_ID_001, system-signal=OBJ_GROUP_ID_049}, {implementation-record-element=OBJ_ID_001, system-signal=OBJ_ID_049}, {implementation-record-element=OBJ_MEASUREMENT_STATUS_001, system-signal=OBJ_MEASUREMENT_STATUS_049}, {implementation-record-element=OBJ_MH_CRC16_001, system-signal=OBJ_MH_CRC16_049}, {implementation-record-element=OBJ_MH_CYCLE_COUNTER_001, system-signal=OBJ_MH_CYCLE_COUNTER_049}, {implementation-record-element=OBJ_MOVEMENT_STATUS_001, system-signal=OBJ_MOVEMENT_STATUS_049}, {implementation-record-element=OBJ_POS_ERR_CRR_COEF_001, system-signal=OBJ_POS_ERR_CRR_COEF_049}, {implementation-record-element=OBJ_RCS_001, system-signal=OBJ_RCS_049}, {implementation-record-element=OBJ_REF_PT_LAT_OFFSET_001, system-signal=OBJ_REF_PT_LAT_OFFSET_049}, {implementation-record-element=OBJ_REF_PT_LONG_OFFSET_001, system-signal=OBJ_REF_PT_LONG_OFFSET_049}, {implementation-record-element=OBJ_TIMESTAMP_OFFSET_001, system-signal=OBJ_TIMESTAMP_OFFSET_049}, {implementation-record-element=OBJ_TRACK_MOTION_MODEL_001, system-signal=OBJ_TRACK_MOTION_MODEL_049}, {implementation-record-element=OBJ_VEH_TRACK_FLAG_001, system-signal=OBJ_VEH_TRACK_FLAG_049}, {implementation-record-element=OBJ_VELOCITY_ERR_CRR_COEF_001, system-signal=OBJ_VELOCITY_ERR_CRR_COEF_049}, {implementation-record-element=OBJ_CLS_TYPE3_001, system-signal=OBJ_CLS_TYPE3_049}, {implementation-record-element=OBJ_ACCELERATION_LONG_ERR_001, system-signal=OBJ_ACCELERATION_LONG_ERR_049}, {implementation-record-element=OBJ_CLS_TYPE4_001, system-signal=OBJ_CLS_TYPE4_049}, {implementation-record-element=OBJ_DIMENSION_LENGTH_001, system-signal=OBJ_DIMENSION_LENGTH_049}, {implementation-record-element=OBJ_DIMENSION_LENGTH_ERR_001, system-signal=OBJ_DIMENSION_LENGTH_ERR_049}, {implementation-record-element=OBJ_DIMENSION_WIDTH_001, system-signal=OBJ_DIMENSION_WIDTH_049}, {implementation-record-element=OBJ_ACCELERATION_LONG_001, system-signal=OBJ_ACCELERATION_LONG_049}, {implementation-record-element=OBJ_CLS_TYPE5_001, system-signal=OBJ_CLS_TYPE5_049}, {implementation-record-element=OBJ_CLS_TYPE6_PROB_001, system-signal=OBJ_CLS_TYPE6_PROB_049}, {implementation-record-element=OBJ_CLS_TYPE2_001, system-signal=OBJ_CLS_TYPE2_049}, {implementation-record-element=OBJ_ACCELERATION_LAT_ERR_001, system-signal=OBJ_ACCELERATION_LAT_ERR_049}, {implementation-record-element=OBJ_CLS_TYPE6_001, system-signal=OBJ_CLS_TYPE6_049}, {implementation-record-element=OBJ_CLS_TYPE1_PROB_001, system-signal=OBJ_CLS_TYPE1_PROB_049}, {implementation-record-element=OBJ_CLS_TYPE4_PROB_001, system-signal=OBJ_CLS_TYPE4_PROB_049}, {implementation-record-element=OBJ_DIMENSION_WIDTH_ERR_001, system-signal=OBJ_DIMENSION_WIDTH_ERR_049}, {implementation-record-element=OBJ_CLS_TYPE2_PROB_001, system-signal=OBJ_CLS_TYPE2_PROB_049}, {implementation-record-element=OBJ_CLS_TYPE3_PROB_001, system-signal=OBJ_CLS_TYPE3_PROB_049}, {implementation-record-element=OBJ_ACCELERATION_LAT_001, system-signal=OBJ_ACCELERATION_LAT_049}, {implementation-record-element=OBJ_CLS_TYPE5_PROB_001, system-signal=OBJ_CLS_TYPE5_PROB_049}, {implementation-record-element=OBJ_CLS_TYPE1_001, system-signal=OBJ_CLS_TYPE1_049}, {implementation-record-element=OBJ_VELOCITY_LONG_001, system-signal=OBJ_VELOCITY_LONG_049}, {implementation-record-element=OBJ_VELOCITY_LAT_ERR_001, system-signal=OBJ_VELOCITY_LAT_ERR_049}, {implementation-record-element=OBJ_YAW_ANGLE_ERR_001, system-signal=OBJ_YAW_ANGLE_ERR_049}, {implementation-record-element=OBJ_POS_LAT_001, system-signal=OBJ_POS_LAT_049}, {implementation-record-element=OBJ_VELOCITY_LONG_ERR_001, system-signal=OBJ_VELOCITY_LONG_ERR_049}, {implementation-record-element=OBJ_POS_LONG_001, system-signal=OBJ_POS_LONG_049}, {implementation-record-element=OBJ_POS_LONG_ERR_001, system-signal=OBJ_POS_LONG_ERR_049}, {implementation-record-element=OBJ_YAW_RATE_001, system-signal=OBJ_YAW_RATE_049}, {implementation-record-element=OBJ_VELOCITY_LAT_001, system-signal=OBJ_VELOCITY_LAT_049}, {implementation-record-element=OBJ_YAW_RATE_ERR_001, system-signal=OBJ_YAW_RATE_ERR_049}, {implementation-record-element=OBJ_POS_LAT_ERR_001, system-signal=OBJ_POS_LAT_ERR_049}, {implementation-record-element=OBJ_YAW_ANGLE_001, system-signal=OBJ_YAW_ANGLE_049}]}
        sender-receiver-to-signal-group-mapping={data-element=COMPOSITIONTYPE.Pp_SG_TrackerObject050.Vdp_SG_TrackerObject050, signal-group=SG_TrackerObject050, type-mapping=sender-rec-record-type-mapping=record-element-mappings=[{implementation-record-element=OBJ_ACCEL_ERR_CRR_COEF_001, system-signal=OBJ_ACCEL_ERR_CRR_COEF_050}, {implementation-record-element=OBJ_ALIVE_TIME_001, system-signal=OBJ_ALIVE_TIME_050}, {implementation-record-element=OBJ_EXISTENCE_PROB_001, system-signal=OBJ_EXISTENCE_PROB_050}, {implementation-record-element=OBJ_GROUP_ID_001, system-signal=OBJ_GROUP_ID_050}, {implementation-record-element=OBJ_ID_001, system-signal=OBJ_ID_050}, {implementation-record-element=OBJ_MEASUREMENT_STATUS_001, system-signal=OBJ_MEASUREMENT_STATUS_050}, {implementation-record-element=OBJ_MH_CRC16_001, system-signal=OBJ_MH_CRC16_050}, {implementation-record-element=OBJ_MH_CYCLE_COUNTER_001, system-signal=OBJ_MH_CYCLE_COUNTER_050}, {implementation-record-element=OBJ_MOVEMENT_STATUS_001, system-signal=OBJ_MOVEMENT_STATUS_050}, {implementation-record-element=OBJ_POS_ERR_CRR_COEF_001, system-signal=OBJ_POS_ERR_CRR_COEF_050}, {implementation-record-element=OBJ_RCS_001, system-signal=OBJ_RCS_050}, {implementation-record-element=OBJ_REF_PT_LAT_OFFSET_001, system-signal=OBJ_REF_PT_LAT_OFFSET_050}, {implementation-record-element=OBJ_REF_PT_LONG_OFFSET_001, system-signal=OBJ_REF_PT_LONG_OFFSET_050}, {implementation-record-element=OBJ_TIMESTAMP_OFFSET_001, system-signal=OBJ_TIMESTAMP_OFFSET_050}, {implementation-record-element=OBJ_TRACK_MOTION_MODEL_001, system-signal=OBJ_TRACK_MOTION_MODEL_050}, {implementation-record-element=OBJ_VEH_TRACK_FLAG_001, system-signal=OBJ_VEH_TRACK_FLAG_050}, {implementation-record-element=OBJ_VELOCITY_ERR_CRR_COEF_001, system-signal=OBJ_VELOCITY_ERR_CRR_COEF_050}, {implementation-record-element=OBJ_CLS_TYPE6_PROB_001, system-signal=OBJ_CLS_TYPE6_PROB_050}, {implementation-record-element=OBJ_DIMENSION_WIDTH_ERR_001, system-signal=OBJ_DIMENSION_WIDTH_ERR_050}, {implementation-record-element=OBJ_DIMENSION_LENGTH_001, system-signal=OBJ_DIMENSION_LENGTH_050}, {implementation-record-element=OBJ_POS_LONG_001, system-signal=OBJ_POS_LONG_050}, {implementation-record-element=OBJ_CLS_TYPE6_001, system-signal=OBJ_CLS_TYPE6_050}, {implementation-record-element=OBJ_ACCELERATION_LONG_001, system-signal=OBJ_ACCELERATION_LONG_050}, {implementation-record-element=OBJ_CLS_TYPE3_PROB_001, system-signal=OBJ_CLS_TYPE3_PROB_050}, {implementation-record-element=OBJ_CLS_TYPE4_PROB_001, system-signal=OBJ_CLS_TYPE4_PROB_050}, {implementation-record-element=OBJ_ACCELERATION_LAT_ERR_001, system-signal=OBJ_ACCELERATION_LAT_ERR_050}, {implementation-record-element=OBJ_CLS_TYPE5_001, system-signal=OBJ_CLS_TYPE5_050}, {implementation-record-element=OBJ_DIMENSION_WIDTH_001, system-signal=OBJ_DIMENSION_WIDTH_050}, {implementation-record-element=OBJ_POS_LAT_001, system-signal=OBJ_POS_LAT_050}, {implementation-record-element=OBJ_ACCELERATION_LAT_001, system-signal=OBJ_ACCELERATION_LAT_050}, {implementation-record-element=OBJ_CLS_TYPE1_001, system-signal=OBJ_CLS_TYPE1_050}, {implementation-record-element=OBJ_CLS_TYPE2_001, system-signal=OBJ_CLS_TYPE2_050}, {implementation-record-element=OBJ_CLS_TYPE2_PROB_001, system-signal=OBJ_CLS_TYPE2_PROB_050}, {implementation-record-element=OBJ_CLS_TYPE3_001, system-signal=OBJ_CLS_TYPE3_050}, {implementation-record-element=OBJ_POS_LONG_ERR_001, system-signal=OBJ_POS_LONG_ERR_050}, {implementation-record-element=OBJ_ACCELERATION_LONG_ERR_001, system-signal=OBJ_ACCELERATION_LONG_ERR_050}, {implementation-record-element=OBJ_CLS_TYPE1_PROB_001, system-signal=OBJ_CLS_TYPE1_PROB_050}, {implementation-record-element=OBJ_CLS_TYPE4_001, system-signal=OBJ_CLS_TYPE4_050}, {implementation-record-element=OBJ_DIMENSION_LENGTH_ERR_001, system-signal=OBJ_DIMENSION_LENGTH_ERR_050}, {implementation-record-element=OBJ_POS_LAT_ERR_001, system-signal=OBJ_POS_LAT_ERR_050}, {implementation-record-element=OBJ_CLS_TYPE5_PROB_001, system-signal=OBJ_CLS_TYPE5_PROB_050}, {implementation-record-element=OBJ_VELOCITY_LONG_ERR_001, system-signal=OBJ_VELOCITY_LONG_ERR_050}, {implementation-record-element=OBJ_YAW_ANGLE_ERR_001, system-signal=OBJ_YAW_ANGLE_ERR_050}, {implementation-record-element=OBJ_YAW_RATE_ERR_001, system-signal=OBJ_YAW_RATE_ERR_050}, {implementation-record-element=OBJ_VELOCITY_LONG_001, system-signal=OBJ_VELOCITY_LONG_050}, {implementation-record-element=OBJ_YAW_ANGLE_001, system-signal=OBJ_YAW_ANGLE_050}, {implementation-record-element=OBJ_YAW_RATE_001, system-signal=OBJ_YAW_RATE_050}, {implementation-record-element=OBJ_VELOCITY_LAT_ERR_001, system-signal=OBJ_VELOCITY_LAT_ERR_050}, {implementation-record-element=OBJ_VELOCITY_LAT_001, system-signal=OBJ_VELOCITY_LAT_050}]}
        sender-receiver-to-signal-group-mapping={data-element=COMPOSITIONTYPE.Pp_SG_TrackerObject051.Vdp_SG_TrackerObject051, signal-group=SG_TrackerObject051, type-mapping=sender-rec-record-type-mapping=record-element-mappings=[{implementation-record-element=OBJ_ACCEL_ERR_CRR_COEF_001, system-signal=OBJ_ACCEL_ERR_CRR_COEF_051}, {implementation-record-element=OBJ_ALIVE_TIME_001, system-signal=OBJ_ALIVE_TIME_051}, {implementation-record-element=OBJ_EXISTENCE_PROB_001, system-signal=OBJ_EXISTENCE_PROB_051}, {implementation-record-element=OBJ_GROUP_ID_001, system-signal=OBJ_GROUP_ID_051}, {implementation-record-element=OBJ_ID_001, system-signal=OBJ_ID_051}, {implementation-record-element=OBJ_MEASUREMENT_STATUS_001, system-signal=OBJ_MEASUREMENT_STATUS_051}, {implementation-record-element=OBJ_MH_CRC16_001, system-signal=OBJ_MH_CRC16_051}, {implementation-record-element=OBJ_MH_CYCLE_COUNTER_001, system-signal=OBJ_MH_CYCLE_COUNTER_051}, {implementation-record-element=OBJ_MOVEMENT_STATUS_001, system-signal=OBJ_MOVEMENT_STATUS_051}, {implementation-record-element=OBJ_POS_ERR_CRR_COEF_001, system-signal=OBJ_POS_ERR_CRR_COEF_051}, {implementation-record-element=OBJ_RCS_001, system-signal=OBJ_RCS_051}, {implementation-record-element=OBJ_REF_PT_LAT_OFFSET_001, system-signal=OBJ_REF_PT_LAT_OFFSET_051}, {implementation-record-element=OBJ_REF_PT_LONG_OFFSET_001, system-signal=OBJ_REF_PT_LONG_OFFSET_051}, {implementation-record-element=OBJ_TIMESTAMP_OFFSET_001, system-signal=OBJ_TIMESTAMP_OFFSET_051}, {implementation-record-element=OBJ_TRACK_MOTION_MODEL_001, system-signal=OBJ_TRACK_MOTION_MODEL_051}, {implementation-record-element=OBJ_VEH_TRACK_FLAG_001, system-signal=OBJ_VEH_TRACK_FLAG_051}, {implementation-record-element=OBJ_VELOCITY_ERR_CRR_COEF_001, system-signal=OBJ_VELOCITY_ERR_CRR_COEF_051}, {implementation-record-element=OBJ_CLS_TYPE4_PROB_001, system-signal=OBJ_CLS_TYPE4_PROB_051}, {implementation-record-element=OBJ_POS_LAT_001, system-signal=OBJ_POS_LAT_051}, {implementation-record-element=OBJ_CLS_TYPE1_001, system-signal=OBJ_CLS_TYPE1_051}, {implementation-record-element=OBJ_CLS_TYPE4_001, system-signal=OBJ_CLS_TYPE4_051}, {implementation-record-element=OBJ_DIMENSION_LENGTH_001, system-signal=OBJ_DIMENSION_LENGTH_051}, {implementation-record-element=OBJ_VELOCITY_LAT_ERR_001, system-signal=OBJ_VELOCITY_LAT_ERR_051}, {implementation-record-element=OBJ_VELOCITY_LONG_001, system-signal=OBJ_VELOCITY_LONG_051}, {implementation-record-element=OBJ_VELOCITY_LONG_ERR_001, system-signal=OBJ_VELOCITY_LONG_ERR_051}, {implementation-record-element=OBJ_YAW_ANGLE_001, system-signal=OBJ_YAW_ANGLE_051}, {implementation-record-element=OBJ_YAW_ANGLE_ERR_001, system-signal=OBJ_YAW_ANGLE_ERR_051}, {implementation-record-element=OBJ_YAW_RATE_001, system-signal=OBJ_YAW_RATE_051}, {implementation-record-element=OBJ_YAW_RATE_ERR_001, system-signal=OBJ_YAW_RATE_ERR_051}, {implementation-record-element=OBJ_CLS_TYPE2_001, system-signal=OBJ_CLS_TYPE2_051}, {implementation-record-element=OBJ_POS_LONG_ERR_001, system-signal=OBJ_POS_LONG_ERR_051}, {implementation-record-element=OBJ_CLS_TYPE3_PROB_001, system-signal=OBJ_CLS_TYPE3_PROB_051}, {implementation-record-element=OBJ_VELOCITY_LAT_001, system-signal=OBJ_VELOCITY_LAT_051}, {implementation-record-element=OBJ_POS_LONG_001, system-signal=OBJ_POS_LONG_051}, {implementation-record-element=OBJ_ACCELERATION_LAT_ERR_001, system-signal=OBJ_ACCELERATION_LAT_ERR_051}, {implementation-record-element=OBJ_POS_LAT_ERR_001, system-signal=OBJ_POS_LAT_ERR_051}, {implementation-record-element=OBJ_DIMENSION_WIDTH_ERR_001, system-signal=OBJ_DIMENSION_WIDTH_ERR_051}, {implementation-record-element=OBJ_CLS_TYPE3_001, system-signal=OBJ_CLS_TYPE3_051}, {implementation-record-element=OBJ_CLS_TYPE5_PROB_001, system-signal=OBJ_CLS_TYPE5_PROB_051}, {implementation-record-element=OBJ_CLS_TYPE1_PROB_001, system-signal=OBJ_CLS_TYPE1_PROB_051}, {implementation-record-element=OBJ_DIMENSION_LENGTH_ERR_001, system-signal=OBJ_DIMENSION_LENGTH_ERR_051}, {implementation-record-element=OBJ_CLS_TYPE6_001, system-signal=OBJ_CLS_TYPE6_051}, {implementation-record-element=OBJ_ACCELERATION_LONG_001, system-signal=OBJ_ACCELERATION_LONG_051}, {implementation-record-element=OBJ_DIMENSION_WIDTH_001, system-signal=OBJ_DIMENSION_WIDTH_051}, {implementation-record-element=OBJ_ACCELERATION_LAT_001, system-signal=OBJ_ACCELERATION_LAT_051}, {implementation-record-element=OBJ_CLS_TYPE6_PROB_001, system-signal=OBJ_CLS_TYPE6_PROB_051}, {implementation-record-element=OBJ_CLS_TYPE2_PROB_001, system-signal=OBJ_CLS_TYPE2_PROB_051}, {implementation-record-element=OBJ_ACCELERATION_LONG_ERR_001, system-signal=OBJ_ACCELERATION_LONG_ERR_051}, {implementation-record-element=OBJ_CLS_TYPE5_001, system-signal=OBJ_CLS_TYPE5_051}]}
        sender-receiver-to-signal-group-mapping={data-element=COMPOSITIONTYPE.Pp_SG_TrackerObject052.Vdp_SG_TrackerObject052, signal-group=SG_TrackerObject052, type-mapping=sender-rec-record-type-mapping=record-element-mappings=[{implementation-record-element=OBJ_ACCEL_ERR_CRR_COEF_001, system-signal=OBJ_ACCEL_ERR_CRR_COEF_052}, {implementation-record-element=OBJ_ALIVE_TIME_001, system-signal=OBJ_ALIVE_TIME_052}, {implementation-record-element=OBJ_EXISTENCE_PROB_001, system-signal=OBJ_EXISTENCE_PROB_052}, {implementation-record-element=OBJ_GROUP_ID_001, system-signal=OBJ_GROUP_ID_052}, {implementation-record-element=OBJ_ID_001, system-signal=OBJ_ID_052}, {implementation-record-element=OBJ_MEASUREMENT_STATUS_001, system-signal=OBJ_MEASUREMENT_STATUS_052}, {implementation-record-element=OBJ_MH_CRC16_001, system-signal=OBJ_MH_CRC16_052}, {implementation-record-element=OBJ_MH_CYCLE_COUNTER_001, system-signal=OBJ_MH_CYCLE_COUNTER_052}, {implementation-record-element=OBJ_MOVEMENT_STATUS_001, system-signal=OBJ_MOVEMENT_STATUS_052}, {implementation-record-element=OBJ_POS_ERR_CRR_COEF_001, system-signal=OBJ_POS_ERR_CRR_COEF_052}, {implementation-record-element=OBJ_RCS_001, system-signal=OBJ_RCS_052}, {implementation-record-element=OBJ_REF_PT_LAT_OFFSET_001, system-signal=OBJ_REF_PT_LAT_OFFSET_052}, {implementation-record-element=OBJ_REF_PT_LONG_OFFSET_001, system-signal=OBJ_REF_PT_LONG_OFFSET_052}, {implementation-record-element=OBJ_TIMESTAMP_OFFSET_001, system-signal=OBJ_TIMESTAMP_OFFSET_052}, {implementation-record-element=OBJ_TRACK_MOTION_MODEL_001, system-signal=OBJ_TRACK_MOTION_MODEL_052}, {implementation-record-element=OBJ_VEH_TRACK_FLAG_001, system-signal=OBJ_VEH_TRACK_FLAG_052}, {implementation-record-element=OBJ_VELOCITY_ERR_CRR_COEF_001, system-signal=OBJ_VELOCITY_ERR_CRR_COEF_052}, {implementation-record-element=OBJ_ACCELERATION_LAT_001, system-signal=OBJ_ACCELERATION_LAT_052}, {implementation-record-element=OBJ_ACCELERATION_LAT_ERR_001, system-signal=OBJ_ACCELERATION_LAT_ERR_052}, {implementation-record-element=OBJ_ACCELERATION_LONG_001, system-signal=OBJ_ACCELERATION_LONG_052}, {implementation-record-element=OBJ_ACCELERATION_LONG_ERR_001, system-signal=OBJ_ACCELERATION_LONG_ERR_052}, {implementation-record-element=OBJ_DIMENSION_WIDTH_001, system-signal=OBJ_DIMENSION_WIDTH_052}, {implementation-record-element=OBJ_CLS_TYPE2_001, system-signal=OBJ_CLS_TYPE2_052}, {implementation-record-element=OBJ_CLS_TYPE4_001, system-signal=OBJ_CLS_TYPE4_052}, {implementation-record-element=OBJ_CLS_TYPE5_PROB_001, system-signal=OBJ_CLS_TYPE5_PROB_052}, {implementation-record-element=OBJ_CLS_TYPE6_001, system-signal=OBJ_CLS_TYPE6_052}, {implementation-record-element=OBJ_CLS_TYPE2_PROB_001, system-signal=OBJ_CLS_TYPE2_PROB_052}, {implementation-record-element=OBJ_DIMENSION_LENGTH_001, system-signal=OBJ_DIMENSION_LENGTH_052}, {implementation-record-element=OBJ_DIMENSION_LENGTH_ERR_001, system-signal=OBJ_DIMENSION_LENGTH_ERR_052}, {implementation-record-element=OBJ_VELOCITY_LONG_001, system-signal=OBJ_VELOCITY_LONG_052}, {implementation-record-element=OBJ_CLS_TYPE1_PROB_001, system-signal=OBJ_CLS_TYPE1_PROB_052}, {implementation-record-element=OBJ_CLS_TYPE6_PROB_001, system-signal=OBJ_CLS_TYPE6_PROB_052}, {implementation-record-element=OBJ_CLS_TYPE5_001, system-signal=OBJ_CLS_TYPE5_052}, {implementation-record-element=OBJ_POS_LAT_001, system-signal=OBJ_POS_LAT_052}, {implementation-record-element=OBJ_CLS_TYPE3_PROB_001, system-signal=OBJ_CLS_TYPE3_PROB_052}, {implementation-record-element=OBJ_POS_LONG_ERR_001, system-signal=OBJ_POS_LONG_ERR_052}, {implementation-record-element=OBJ_VELOCITY_LONG_ERR_001, system-signal=OBJ_VELOCITY_LONG_ERR_052}, {implementation-record-element=OBJ_VELOCITY_LAT_ERR_001, system-signal=OBJ_VELOCITY_LAT_ERR_052}, {implementation-record-element=OBJ_DIMENSION_WIDTH_ERR_001, system-signal=OBJ_DIMENSION_WIDTH_ERR_052}, {implementation-record-element=OBJ_YAW_ANGLE_ERR_001, system-signal=OBJ_YAW_ANGLE_ERR_052}, {implementation-record-element=OBJ_YAW_RATE_ERR_001, system-signal=OBJ_YAW_RATE_ERR_052}, {implementation-record-element=OBJ_YAW_ANGLE_001, system-signal=OBJ_YAW_ANGLE_052}, {implementation-record-element=OBJ_POS_LAT_ERR_001, system-signal=OBJ_POS_LAT_ERR_052}, {implementation-record-element=OBJ_YAW_RATE_001, system-signal=OBJ_YAW_RATE_052}, {implementation-record-element=OBJ_POS_LONG_001, system-signal=OBJ_POS_LONG_052}, {implementation-record-element=OBJ_CLS_TYPE3_001, system-signal=OBJ_CLS_TYPE3_052}, {implementation-record-element=OBJ_CLS_TYPE1_001, system-signal=OBJ_CLS_TYPE1_052}, {implementation-record-element=OBJ_CLS_TYPE4_PROB_001, system-signal=OBJ_CLS_TYPE4_PROB_052}, {implementation-record-element=OBJ_VELOCITY_LAT_001, system-signal=OBJ_VELOCITY_LAT_052}]}
        sender-receiver-to-signal-group-mapping={data-element=COMPOSITIONTYPE.Pp_SG_TrackerObject053.Vdp_SG_TrackerObject053, signal-group=SG_TrackerObject053, type-mapping=sender-rec-record-type-mapping=record-element-mappings=[{implementation-record-element=OBJ_ACCEL_ERR_CRR_COEF_001, system-signal=OBJ_ACCEL_ERR_CRR_COEF_053}, {implementation-record-element=OBJ_ALIVE_TIME_001, system-signal=OBJ_ALIVE_TIME_053}, {implementation-record-element=OBJ_EXISTENCE_PROB_001, system-signal=OBJ_EXISTENCE_PROB_053}, {implementation-record-element=OBJ_GROUP_ID_001, system-signal=OBJ_GROUP_ID_053}, {implementation-record-element=OBJ_ID_001, system-signal=OBJ_ID_053}, {implementation-record-element=OBJ_MEASUREMENT_STATUS_001, system-signal=OBJ_MEASUREMENT_STATUS_053}, {implementation-record-element=OBJ_MH_CRC16_001, system-signal=OBJ_MH_CRC16_053}, {implementation-record-element=OBJ_MH_CYCLE_COUNTER_001, system-signal=OBJ_MH_CYCLE_COUNTER_053}, {implementation-record-element=OBJ_MOVEMENT_STATUS_001, system-signal=OBJ_MOVEMENT_STATUS_053}, {implementation-record-element=OBJ_POS_ERR_CRR_COEF_001, system-signal=OBJ_POS_ERR_CRR_COEF_053}, {implementation-record-element=OBJ_RCS_001, system-signal=OBJ_RCS_053}, {implementation-record-element=OBJ_REF_PT_LAT_OFFSET_001, system-signal=OBJ_REF_PT_LAT_OFFSET_053}, {implementation-record-element=OBJ_REF_PT_LONG_OFFSET_001, system-signal=OBJ_REF_PT_LONG_OFFSET_053}, {implementation-record-element=OBJ_TIMESTAMP_OFFSET_001, system-signal=OBJ_TIMESTAMP_OFFSET_053}, {implementation-record-element=OBJ_TRACK_MOTION_MODEL_001, system-signal=OBJ_TRACK_MOTION_MODEL_053}, {implementation-record-element=OBJ_VEH_TRACK_FLAG_001, system-signal=OBJ_VEH_TRACK_FLAG_053}, {implementation-record-element=OBJ_VELOCITY_ERR_CRR_COEF_001, system-signal=OBJ_VELOCITY_ERR_CRR_COEF_053}, {implementation-record-element=OBJ_CLS_TYPE4_001, system-signal=OBJ_CLS_TYPE4_053}, {implementation-record-element=OBJ_ACCELERATION_LAT_001, system-signal=OBJ_ACCELERATION_LAT_053}, {implementation-record-element=OBJ_CLS_TYPE2_PROB_001, system-signal=OBJ_CLS_TYPE2_PROB_053}, {implementation-record-element=OBJ_ACCELERATION_LAT_ERR_001, system-signal=OBJ_ACCELERATION_LAT_ERR_053}, {implementation-record-element=OBJ_ACCELERATION_LONG_001, system-signal=OBJ_ACCELERATION_LONG_053}, {implementation-record-element=OBJ_DIMENSION_LENGTH_001, system-signal=OBJ_DIMENSION_LENGTH_053}, {implementation-record-element=OBJ_CLS_TYPE4_PROB_001, system-signal=OBJ_CLS_TYPE4_PROB_053}, {implementation-record-element=OBJ_CLS_TYPE5_001, system-signal=OBJ_CLS_TYPE5_053}, {implementation-record-element=OBJ_CLS_TYPE1_001, system-signal=OBJ_CLS_TYPE1_053}, {implementation-record-element=OBJ_ACCELERATION_LONG_ERR_001, system-signal=OBJ_ACCELERATION_LONG_ERR_053}, {implementation-record-element=OBJ_CLS_TYPE2_001, system-signal=OBJ_CLS_TYPE2_053}, {implementation-record-element=OBJ_CLS_TYPE3_PROB_001, system-signal=OBJ_CLS_TYPE3_PROB_053}, {implementation-record-element=OBJ_CLS_TYPE5_PROB_001, system-signal=OBJ_CLS_TYPE5_PROB_053}, {implementation-record-element=OBJ_CLS_TYPE1_PROB_001, system-signal=OBJ_CLS_TYPE1_PROB_053}, {implementation-record-element=OBJ_CLS_TYPE6_001, system-signal=OBJ_CLS_TYPE6_053}, {implementation-record-element=OBJ_CLS_TYPE6_PROB_001, system-signal=OBJ_CLS_TYPE6_PROB_053}, {implementation-record-element=OBJ_CLS_TYPE3_001, system-signal=OBJ_CLS_TYPE3_053}, {implementation-record-element=OBJ_POS_LAT_001, system-signal=OBJ_POS_LAT_053}, {implementation-record-element=OBJ_YAW_RATE_ERR_001, system-signal=OBJ_YAW_RATE_ERR_053}, {implementation-record-element=OBJ_DIMENSION_WIDTH_001, system-signal=OBJ_DIMENSION_WIDTH_053}, {implementation-record-element=OBJ_VELOCITY_LONG_001, system-signal=OBJ_VELOCITY_LONG_053}, {implementation-record-element=OBJ_VELOCITY_LAT_001, system-signal=OBJ_VELOCITY_LAT_053}, {implementation-record-element=OBJ_VELOCITY_LAT_ERR_001, system-signal=OBJ_VELOCITY_LAT_ERR_053}, {implementation-record-element=OBJ_YAW_ANGLE_001, system-signal=OBJ_YAW_ANGLE_053}, {implementation-record-element=OBJ_POS_LONG_001, system-signal=OBJ_POS_LONG_053}, {implementation-record-element=OBJ_YAW_RATE_001, system-signal=OBJ_YAW_RATE_053}, {implementation-record-element=OBJ_DIMENSION_WIDTH_ERR_001, system-signal=OBJ_DIMENSION_WIDTH_ERR_053}, {implementation-record-element=OBJ_YAW_ANGLE_ERR_001, system-signal=OBJ_YAW_ANGLE_ERR_053}, {implementation-record-element=OBJ_DIMENSION_LENGTH_ERR_001, system-signal=OBJ_DIMENSION_LENGTH_ERR_053}, {implementation-record-element=OBJ_POS_LONG_ERR_001, system-signal=OBJ_POS_LONG_ERR_053}, {implementation-record-element=OBJ_VELOCITY_LONG_ERR_001, system-signal=OBJ_VELOCITY_LONG_ERR_053}, {implementation-record-element=OBJ_POS_LAT_ERR_001, system-signal=OBJ_POS_LAT_ERR_053}]}
        sender-receiver-to-signal-group-mapping={data-element=COMPOSITIONTYPE.Pp_SG_TrackerObject054.Vdp_SG_TrackerObject054, signal-group=SG_TrackerObject054, type-mapping=sender-rec-record-type-mapping=record-element-mappings=[{implementation-record-element=OBJ_ACCEL_ERR_CRR_COEF_001, system-signal=OBJ_ACCEL_ERR_CRR_COEF_054}, {implementation-record-element=OBJ_ALIVE_TIME_001, system-signal=OBJ_ALIVE_TIME_054}, {implementation-record-element=OBJ_EXISTENCE_PROB_001, system-signal=OBJ_EXISTENCE_PROB_054}, {implementation-record-element=OBJ_GROUP_ID_001, system-signal=OBJ_GROUP_ID_054}, {implementation-record-element=OBJ_ID_001, system-signal=OBJ_ID_054}, {implementation-record-element=OBJ_MEASUREMENT_STATUS_001, system-signal=OBJ_MEASUREMENT_STATUS_054}, {implementation-record-element=OBJ_MH_CRC16_001, system-signal=OBJ_MH_CRC16_054}, {implementation-record-element=OBJ_MH_CYCLE_COUNTER_001, system-signal=OBJ_MH_CYCLE_COUNTER_054}, {implementation-record-element=OBJ_MOVEMENT_STATUS_001, system-signal=OBJ_MOVEMENT_STATUS_054}, {implementation-record-element=OBJ_POS_ERR_CRR_COEF_001, system-signal=OBJ_POS_ERR_CRR_COEF_054}, {implementation-record-element=OBJ_RCS_001, system-signal=OBJ_RCS_054}, {implementation-record-element=OBJ_REF_PT_LAT_OFFSET_001, system-signal=OBJ_REF_PT_LAT_OFFSET_054}, {implementation-record-element=OBJ_REF_PT_LONG_OFFSET_001, system-signal=OBJ_REF_PT_LONG_OFFSET_054}, {implementation-record-element=OBJ_TIMESTAMP_OFFSET_001, system-signal=OBJ_TIMESTAMP_OFFSET_054}, {implementation-record-element=OBJ_TRACK_MOTION_MODEL_001, system-signal=OBJ_TRACK_MOTION_MODEL_054}, {implementation-record-element=OBJ_VEH_TRACK_FLAG_001, system-signal=OBJ_VEH_TRACK_FLAG_054}, {implementation-record-element=OBJ_VELOCITY_ERR_CRR_COEF_001, system-signal=OBJ_VELOCITY_ERR_CRR_COEF_054}, {implementation-record-element=OBJ_CLS_TYPE2_PROB_001, system-signal=OBJ_CLS_TYPE2_PROB_054}, {implementation-record-element=OBJ_CLS_TYPE6_PROB_001, system-signal=OBJ_CLS_TYPE6_PROB_054}, {implementation-record-element=OBJ_CLS_TYPE1_001, system-signal=OBJ_CLS_TYPE1_054}, {implementation-record-element=OBJ_CLS_TYPE1_PROB_001, system-signal=OBJ_CLS_TYPE1_PROB_054}, {implementation-record-element=OBJ_CLS_TYPE3_PROB_001, system-signal=OBJ_CLS_TYPE3_PROB_054}, {implementation-record-element=OBJ_DIMENSION_WIDTH_ERR_001, system-signal=OBJ_DIMENSION_WIDTH_ERR_054}, {implementation-record-element=OBJ_POS_LAT_ERR_001, system-signal=OBJ_POS_LAT_ERR_054}, {implementation-record-element=OBJ_POS_LONG_001, system-signal=OBJ_POS_LONG_054}, {implementation-record-element=OBJ_POS_LAT_001, system-signal=OBJ_POS_LAT_054}, {implementation-record-element=OBJ_ACCELERATION_LAT_001, system-signal=OBJ_ACCELERATION_LAT_054}, {implementation-record-element=OBJ_CLS_TYPE5_001, system-signal=OBJ_CLS_TYPE5_054}, {implementation-record-element=OBJ_CLS_TYPE3_001, system-signal=OBJ_CLS_TYPE3_054}, {implementation-record-element=OBJ_ACCELERATION_LONG_001, system-signal=OBJ_ACCELERATION_LONG_054}, {implementation-record-element=OBJ_ACCELERATION_LONG_ERR_001, system-signal=OBJ_ACCELERATION_LONG_ERR_054}, {implementation-record-element=OBJ_CLS_TYPE4_PROB_001, system-signal=OBJ_CLS_TYPE4_PROB_054}, {implementation-record-element=OBJ_ACCELERATION_LAT_ERR_001, system-signal=OBJ_ACCELERATION_LAT_ERR_054}, {implementation-record-element=OBJ_CLS_TYPE6_001, system-signal=OBJ_CLS_TYPE6_054}, {implementation-record-element=OBJ_DIMENSION_LENGTH_ERR_001, system-signal=OBJ_DIMENSION_LENGTH_ERR_054}, {implementation-record-element=OBJ_CLS_TYPE2_001, system-signal=OBJ_CLS_TYPE2_054}, {implementation-record-element=OBJ_DIMENSION_LENGTH_001, system-signal=OBJ_DIMENSION_LENGTH_054}, {implementation-record-element=OBJ_CLS_TYPE4_001, system-signal=OBJ_CLS_TYPE4_054}, {implementation-record-element=OBJ_CLS_TYPE5_PROB_001, system-signal=OBJ_CLS_TYPE5_PROB_054}, {implementation-record-element=OBJ_DIMENSION_WIDTH_001, system-signal=OBJ_DIMENSION_WIDTH_054}, {implementation-record-element=OBJ_VELOCITY_LONG_ERR_001, system-signal=OBJ_VELOCITY_LONG_ERR_054}, {implementation-record-element=OBJ_YAW_ANGLE_001, system-signal=OBJ_YAW_ANGLE_054}, {implementation-record-element=OBJ_YAW_ANGLE_ERR_001, system-signal=OBJ_YAW_ANGLE_ERR_054}, {implementation-record-element=OBJ_POS_LONG_ERR_001, system-signal=OBJ_POS_LONG_ERR_054}, {implementation-record-element=OBJ_VELOCITY_LAT_ERR_001, system-signal=OBJ_VELOCITY_LAT_ERR_054}, {implementation-record-element=OBJ_VELOCITY_LAT_001, system-signal=OBJ_VELOCITY_LAT_054}, {implementation-record-element=OBJ_YAW_RATE_ERR_001, system-signal=OBJ_YAW_RATE_ERR_054}, {implementation-record-element=OBJ_YAW_RATE_001, system-signal=OBJ_YAW_RATE_054}, {implementation-record-element=OBJ_VELOCITY_LONG_001, system-signal=OBJ_VELOCITY_LONG_054}]}
        sender-receiver-to-signal-group-mapping={data-element=COMPOSITIONTYPE.Pp_SG_TrackerObject055.Vdp_SG_TrackerObject055, signal-group=SG_TrackerObject055, type-mapping=sender-rec-record-type-mapping=record-element-mappings=[{implementation-record-element=OBJ_ACCEL_ERR_CRR_COEF_001, system-signal=OBJ_ACCEL_ERR_CRR_COEF_055}, {implementation-record-element=OBJ_ALIVE_TIME_001, system-signal=OBJ_ALIVE_TIME_055}, {implementation-record-element=OBJ_EXISTENCE_PROB_001, system-signal=OBJ_EXISTENCE_PROB_055}, {implementation-record-element=OBJ_GROUP_ID_001, system-signal=OBJ_GROUP_ID_055}, {implementation-record-element=OBJ_ID_001, system-signal=OBJ_ID_055}, {implementation-record-element=OBJ_MEASUREMENT_STATUS_001, system-signal=OBJ_MEASUREMENT_STATUS_055}, {implementation-record-element=OBJ_MH_CRC16_001, system-signal=OBJ_MH_CRC16_055}, {implementation-record-element=OBJ_MH_CYCLE_COUNTER_001, system-signal=OBJ_MH_CYCLE_COUNTER_055}, {implementation-record-element=OBJ_MOVEMENT_STATUS_001, system-signal=OBJ_MOVEMENT_STATUS_055}, {implementation-record-element=OBJ_POS_ERR_CRR_COEF_001, system-signal=OBJ_POS_ERR_CRR_COEF_055}, {implementation-record-element=OBJ_RCS_001, system-signal=OBJ_RCS_055}, {implementation-record-element=OBJ_REF_PT_LAT_OFFSET_001, system-signal=OBJ_REF_PT_LAT_OFFSET_055}, {implementation-record-element=OBJ_REF_PT_LONG_OFFSET_001, system-signal=OBJ_REF_PT_LONG_OFFSET_055}, {implementation-record-element=OBJ_TIMESTAMP_OFFSET_001, system-signal=OBJ_TIMESTAMP_OFFSET_055}, {implementation-record-element=OBJ_TRACK_MOTION_MODEL_001, system-signal=OBJ_TRACK_MOTION_MODEL_055}, {implementation-record-element=OBJ_VEH_TRACK_FLAG_001, system-signal=OBJ_VEH_TRACK_FLAG_055}, {implementation-record-element=OBJ_VELOCITY_ERR_CRR_COEF_001, system-signal=OBJ_VELOCITY_ERR_CRR_COEF_055}, {implementation-record-element=OBJ_CLS_TYPE2_001, system-signal=OBJ_CLS_TYPE2_055}, {implementation-record-element=OBJ_ACCELERATION_LAT_001, system-signal=OBJ_ACCELERATION_LAT_055}, {implementation-record-element=OBJ_CLS_TYPE3_001, system-signal=OBJ_CLS_TYPE3_055}, {implementation-record-element=OBJ_CLS_TYPE3_PROB_001, system-signal=OBJ_CLS_TYPE3_PROB_055}, {implementation-record-element=OBJ_CLS_TYPE6_001, system-signal=OBJ_CLS_TYPE6_055}, {implementation-record-element=OBJ_CLS_TYPE4_001, system-signal=OBJ_CLS_TYPE4_055}, {implementation-record-element=OBJ_CLS_TYPE1_PROB_001, system-signal=OBJ_CLS_TYPE1_PROB_055}, {implementation-record-element=OBJ_VELOCITY_LAT_001, system-signal=OBJ_VELOCITY_LAT_055}, {implementation-record-element=OBJ_VELOCITY_LAT_ERR_001, system-signal=OBJ_VELOCITY_LAT_ERR_055}, {implementation-record-element=OBJ_VELOCITY_LONG_001, system-signal=OBJ_VELOCITY_LONG_055}, {implementation-record-element=OBJ_VELOCITY_LONG_ERR_001, system-signal=OBJ_VELOCITY_LONG_ERR_055}, {implementation-record-element=OBJ_ACCELERATION_LONG_001, system-signal=OBJ_ACCELERATION_LONG_055}, {implementation-record-element=OBJ_ACCELERATION_LONG_ERR_001, system-signal=OBJ_ACCELERATION_LONG_ERR_055}, {implementation-record-element=OBJ_POS_LAT_001, system-signal=OBJ_POS_LAT_055}, {implementation-record-element=OBJ_YAW_ANGLE_001, system-signal=OBJ_YAW_ANGLE_055}, {implementation-record-element=OBJ_ACCELERATION_LAT_ERR_001, system-signal=OBJ_ACCELERATION_LAT_ERR_055}, {implementation-record-element=OBJ_CLS_TYPE5_PROB_001, system-signal=OBJ_CLS_TYPE5_PROB_055}, {implementation-record-element=OBJ_YAW_ANGLE_ERR_001, system-signal=OBJ_YAW_ANGLE_ERR_055}, {implementation-record-element=OBJ_CLS_TYPE1_001, system-signal=OBJ_CLS_TYPE1_055}, {implementation-record-element=OBJ_DIMENSION_LENGTH_001, system-signal=OBJ_DIMENSION_LENGTH_055}, {implementation-record-element=OBJ_DIMENSION_WIDTH_ERR_001, system-signal=OBJ_DIMENSION_WIDTH_ERR_055}, {implementation-record-element=OBJ_CLS_TYPE2_PROB_001, system-signal=OBJ_CLS_TYPE2_PROB_055}, {implementation-record-element=OBJ_POS_LAT_ERR_001, system-signal=OBJ_POS_LAT_ERR_055}, {implementation-record-element=OBJ_DIMENSION_WIDTH_001, system-signal=OBJ_DIMENSION_WIDTH_055}, {implementation-record-element=OBJ_POS_LONG_001, system-signal=OBJ_POS_LONG_055}, {implementation-record-element=OBJ_CLS_TYPE4_PROB_001, system-signal=OBJ_CLS_TYPE4_PROB_055}, {implementation-record-element=OBJ_DIMENSION_LENGTH_ERR_001, system-signal=OBJ_DIMENSION_LENGTH_ERR_055}, {implementation-record-element=OBJ_CLS_TYPE6_PROB_001, system-signal=OBJ_CLS_TYPE6_PROB_055}, {implementation-record-element=OBJ_POS_LONG_ERR_001, system-signal=OBJ_POS_LONG_ERR_055}, {implementation-record-element=OBJ_CLS_TYPE5_001, system-signal=OBJ_CLS_TYPE5_055}, {implementation-record-element=OBJ_YAW_RATE_001, system-signal=OBJ_YAW_RATE_055}, {implementation-record-element=OBJ_YAW_RATE_ERR_001, system-signal=OBJ_YAW_RATE_ERR_055}]}
        sender-receiver-to-signal-group-mapping={data-element=COMPOSITIONTYPE.Pp_SG_TrackerObject056.Vdp_SG_TrackerObject056, signal-group=SG_TrackerObject056, type-mapping=sender-rec-record-type-mapping=record-element-mappings=[{implementation-record-element=OBJ_ACCEL_ERR_CRR_COEF_001, system-signal=OBJ_ACCEL_ERR_CRR_COEF_056}, {implementation-record-element=OBJ_ALIVE_TIME_001, system-signal=OBJ_ALIVE_TIME_056}, {implementation-record-element=OBJ_EXISTENCE_PROB_001, system-signal=OBJ_EXISTENCE_PROB_056}, {implementation-record-element=OBJ_GROUP_ID_001, system-signal=OBJ_GROUP_ID_056}, {implementation-record-element=OBJ_ID_001, system-signal=OBJ_ID_056}, {implementation-record-element=OBJ_MEASUREMENT_STATUS_001, system-signal=OBJ_MEASUREMENT_STATUS_056}, {implementation-record-element=OBJ_MH_CRC16_001, system-signal=OBJ_MH_CRC16_056}, {implementation-record-element=OBJ_MH_CYCLE_COUNTER_001, system-signal=OBJ_MH_CYCLE_COUNTER_056}, {implementation-record-element=OBJ_MOVEMENT_STATUS_001, system-signal=OBJ_MOVEMENT_STATUS_056}, {implementation-record-element=OBJ_POS_ERR_CRR_COEF_001, system-signal=OBJ_POS_ERR_CRR_COEF_056}, {implementation-record-element=OBJ_RCS_001, system-signal=OBJ_RCS_056}, {implementation-record-element=OBJ_REF_PT_LAT_OFFSET_001, system-signal=OBJ_REF_PT_LAT_OFFSET_056}, {implementation-record-element=OBJ_REF_PT_LONG_OFFSET_001, system-signal=OBJ_REF_PT_LONG_OFFSET_056}, {implementation-record-element=OBJ_TIMESTAMP_OFFSET_001, system-signal=OBJ_TIMESTAMP_OFFSET_056}, {implementation-record-element=OBJ_TRACK_MOTION_MODEL_001, system-signal=OBJ_TRACK_MOTION_MODEL_056}, {implementation-record-element=OBJ_VEH_TRACK_FLAG_001, system-signal=OBJ_VEH_TRACK_FLAG_056}, {implementation-record-element=OBJ_VELOCITY_ERR_CRR_COEF_001, system-signal=OBJ_VELOCITY_ERR_CRR_COEF_056}, {implementation-record-element=OBJ_CLS_TYPE2_001, system-signal=OBJ_CLS_TYPE2_056}, {implementation-record-element=OBJ_ACCELERATION_LAT_ERR_001, system-signal=OBJ_ACCELERATION_LAT_ERR_056}, {implementation-record-element=OBJ_CLS_TYPE6_001, system-signal=OBJ_CLS_TYPE6_056}, {implementation-record-element=OBJ_CLS_TYPE5_001, system-signal=OBJ_CLS_TYPE5_056}, {implementation-record-element=OBJ_POS_LAT_ERR_001, system-signal=OBJ_POS_LAT_ERR_056}, {implementation-record-element=OBJ_CLS_TYPE1_PROB_001, system-signal=OBJ_CLS_TYPE1_PROB_056}, {implementation-record-element=OBJ_POS_LONG_001, system-signal=OBJ_POS_LONG_056}, {implementation-record-element=OBJ_CLS_TYPE3_PROB_001, system-signal=OBJ_CLS_TYPE3_PROB_056}, {implementation-record-element=OBJ_POS_LONG_ERR_001, system-signal=OBJ_POS_LONG_ERR_056}, {implementation-record-element=OBJ_YAW_RATE_001, system-signal=OBJ_YAW_RATE_056}, {implementation-record-element=OBJ_YAW_RATE_ERR_001, system-signal=OBJ_YAW_RATE_ERR_056}, {implementation-record-element=OBJ_YAW_ANGLE_001, system-signal=OBJ_YAW_ANGLE_056}, {implementation-record-element=OBJ_VELOCITY_LAT_ERR_001, system-signal=OBJ_VELOCITY_LAT_ERR_056}, {implementation-record-element=OBJ_CLS_TYPE5_PROB_001, system-signal=OBJ_CLS_TYPE5_PROB_056}, {implementation-record-element=OBJ_CLS_TYPE2_PROB_001, system-signal=OBJ_CLS_TYPE2_PROB_056}, {implementation-record-element=OBJ_CLS_TYPE4_001, system-signal=OBJ_CLS_TYPE4_056}, {implementation-record-element=OBJ_ACCELERATION_LONG_001, system-signal=OBJ_ACCELERATION_LONG_056}, {implementation-record-element=OBJ_CLS_TYPE1_001, system-signal=OBJ_CLS_TYPE1_056}, {implementation-record-element=OBJ_VELOCITY_LONG_ERR_001, system-signal=OBJ_VELOCITY_LONG_ERR_056}, {implementation-record-element=OBJ_YAW_ANGLE_ERR_001, system-signal=OBJ_YAW_ANGLE_ERR_056}, {implementation-record-element=OBJ_ACCELERATION_LAT_001, system-signal=OBJ_ACCELERATION_LAT_056}, {implementation-record-element=OBJ_CLS_TYPE4_PROB_001, system-signal=OBJ_CLS_TYPE4_PROB_056}, {implementation-record-element=OBJ_CLS_TYPE6_PROB_001, system-signal=OBJ_CLS_TYPE6_PROB_056}, {implementation-record-element=OBJ_DIMENSION_LENGTH_001, system-signal=OBJ_DIMENSION_LENGTH_056}, {implementation-record-element=OBJ_DIMENSION_LENGTH_ERR_001, system-signal=OBJ_DIMENSION_LENGTH_ERR_056}, {implementation-record-element=OBJ_DIMENSION_WIDTH_ERR_001, system-signal=OBJ_DIMENSION_WIDTH_ERR_056}, {implementation-record-element=OBJ_CLS_TYPE3_001, system-signal=OBJ_CLS_TYPE3_056}, {implementation-record-element=OBJ_DIMENSION_WIDTH_001, system-signal=OBJ_DIMENSION_WIDTH_056}, {implementation-record-element=OBJ_POS_LAT_001, system-signal=OBJ_POS_LAT_056}, {implementation-record-element=OBJ_VELOCITY_LAT_001, system-signal=OBJ_VELOCITY_LAT_056}, {implementation-record-element=OBJ_VELOCITY_LONG_001, system-signal=OBJ_VELOCITY_LONG_056}, {implementation-record-element=OBJ_ACCELERATION_LONG_ERR_001, system-signal=OBJ_ACCELERATION_LONG_ERR_056}]}
        sender-receiver-to-signal-group-mapping={data-element=COMPOSITIONTYPE.Pp_SG_TrackerObject057.Vdp_SG_TrackerObject057, signal-group=SG_TrackerObject057, type-mapping=sender-rec-record-type-mapping=record-element-mappings=[{implementation-record-element=OBJ_ACCEL_ERR_CRR_COEF_001, system-signal=OBJ_ACCEL_ERR_CRR_COEF_057}, {implementation-record-element=OBJ_ALIVE_TIME_001, system-signal=OBJ_ALIVE_TIME_057}, {implementation-record-element=OBJ_EXISTENCE_PROB_001, system-signal=OBJ_EXISTENCE_PROB_057}, {implementation-record-element=OBJ_GROUP_ID_001, system-signal=OBJ_GROUP_ID_057}, {implementation-record-element=OBJ_ID_001, system-signal=OBJ_ID_057}, {implementation-record-element=OBJ_MEASUREMENT_STATUS_001, system-signal=OBJ_MEASUREMENT_STATUS_057}, {implementation-record-element=OBJ_MH_CRC16_001, system-signal=OBJ_MH_CRC16_057}, {implementation-record-element=OBJ_MH_CYCLE_COUNTER_001, system-signal=OBJ_MH_CYCLE_COUNTER_057}, {implementation-record-element=OBJ_MOVEMENT_STATUS_001, system-signal=OBJ_MOVEMENT_STATUS_057}, {implementation-record-element=OBJ_POS_ERR_CRR_COEF_001, system-signal=OBJ_POS_ERR_CRR_COEF_057}, {implementation-record-element=OBJ_RCS_001, system-signal=OBJ_RCS_057}, {implementation-record-element=OBJ_REF_PT_LAT_OFFSET_001, system-signal=OBJ_REF_PT_LAT_OFFSET_057}, {implementation-record-element=OBJ_REF_PT_LONG_OFFSET_001, system-signal=OBJ_REF_PT_LONG_OFFSET_057}, {implementation-record-element=OBJ_TIMESTAMP_OFFSET_001, system-signal=OBJ_TIMESTAMP_OFFSET_057}, {implementation-record-element=OBJ_TRACK_MOTION_MODEL_001, system-signal=OBJ_TRACK_MOTION_MODEL_057}, {implementation-record-element=OBJ_VEH_TRACK_FLAG_001, system-signal=OBJ_VEH_TRACK_FLAG_057}, {implementation-record-element=OBJ_VELOCITY_ERR_CRR_COEF_001, system-signal=OBJ_VELOCITY_ERR_CRR_COEF_057}, {implementation-record-element=OBJ_ACCELERATION_LONG_ERR_001, system-signal=OBJ_ACCELERATION_LONG_ERR_057}, {implementation-record-element=OBJ_CLS_TYPE1_001, system-signal=OBJ_CLS_TYPE1_057}, {implementation-record-element=OBJ_CLS_TYPE2_001, system-signal=OBJ_CLS_TYPE2_057}, {implementation-record-element=OBJ_CLS_TYPE2_PROB_001, system-signal=OBJ_CLS_TYPE2_PROB_057}, {implementation-record-element=OBJ_CLS_TYPE3_001, system-signal=OBJ_CLS_TYPE3_057}, {implementation-record-element=OBJ_ACCELERATION_LAT_001, system-signal=OBJ_ACCELERATION_LAT_057}, {implementation-record-element=OBJ_CLS_TYPE1_PROB_001, system-signal=OBJ_CLS_TYPE1_PROB_057}, {implementation-record-element=OBJ_ACCELERATION_LAT_ERR_001, system-signal=OBJ_ACCELERATION_LAT_ERR_057}, {implementation-record-element=OBJ_ACCELERATION_LONG_001, system-signal=OBJ_ACCELERATION_LONG_057}, {implementation-record-element=OBJ_DIMENSION_LENGTH_001, system-signal=OBJ_DIMENSION_LENGTH_057}, {implementation-record-element=OBJ_CLS_TYPE3_PROB_001, system-signal=OBJ_CLS_TYPE3_PROB_057}, {implementation-record-element=OBJ_CLS_TYPE6_PROB_001, system-signal=OBJ_CLS_TYPE6_PROB_057}, {implementation-record-element=OBJ_VELOCITY_LAT_001, system-signal=OBJ_VELOCITY_LAT_057}, {implementation-record-element=OBJ_VELOCITY_LONG_001, system-signal=OBJ_VELOCITY_LONG_057}, {implementation-record-element=OBJ_POS_LONG_ERR_001, system-signal=OBJ_POS_LONG_ERR_057}, {implementation-record-element=OBJ_YAW_ANGLE_001, system-signal=OBJ_YAW_ANGLE_057}, {implementation-record-element=OBJ_CLS_TYPE4_PROB_001, system-signal=OBJ_CLS_TYPE4_PROB_057}, {implementation-record-element=OBJ_VELOCITY_LAT_ERR_001, system-signal=OBJ_VELOCITY_LAT_ERR_057}, {implementation-record-element=OBJ_CLS_TYPE6_001, system-signal=OBJ_CLS_TYPE6_057}, {implementation-record-element=OBJ_POS_LAT_ERR_001, system-signal=OBJ_POS_LAT_ERR_057}, {implementation-record-element=OBJ_VELOCITY_LONG_ERR_001, system-signal=OBJ_VELOCITY_LONG_ERR_057}, {implementation-record-element=OBJ_CLS_TYPE5_PROB_001, system-signal=OBJ_CLS_TYPE5_PROB_057}, {implementation-record-element=OBJ_YAW_RATE_001, system-signal=OBJ_YAW_RATE_057}, {implementation-record-element=OBJ_DIMENSION_WIDTH_001, system-signal=OBJ_DIMENSION_WIDTH_057}, {implementation-record-element=OBJ_CLS_TYPE4_001, system-signal=OBJ_CLS_TYPE4_057}, {implementation-record-element=OBJ_YAW_ANGLE_ERR_001, system-signal=OBJ_YAW_ANGLE_ERR_057}, {implementation-record-element=OBJ_DIMENSION_WIDTH_ERR_001, system-signal=OBJ_DIMENSION_WIDTH_ERR_057}, {implementation-record-element=OBJ_YAW_RATE_ERR_001, system-signal=OBJ_YAW_RATE_ERR_057}, {implementation-record-element=OBJ_POS_LAT_001, system-signal=OBJ_POS_LAT_057}, {implementation-record-element=OBJ_CLS_TYPE5_001, system-signal=OBJ_CLS_TYPE5_057}, {implementation-record-element=OBJ_DIMENSION_LENGTH_ERR_001, system-signal=OBJ_DIMENSION_LENGTH_ERR_057}, {implementation-record-element=OBJ_POS_LONG_001, system-signal=OBJ_POS_LONG_057}]}
        sender-receiver-to-signal-group-mapping={data-element=COMPOSITIONTYPE.Pp_SG_TrackerObject058.Vdp_SG_TrackerObject058, signal-group=SG_TrackerObject058, type-mapping=sender-rec-record-type-mapping=record-element-mappings=[{implementation-record-element=OBJ_ACCEL_ERR_CRR_COEF_001, system-signal=OBJ_ACCEL_ERR_CRR_COEF_058}, {implementation-record-element=OBJ_ALIVE_TIME_001, system-signal=OBJ_ALIVE_TIME_058}, {implementation-record-element=OBJ_EXISTENCE_PROB_001, system-signal=OBJ_EXISTENCE_PROB_058}, {implementation-record-element=OBJ_GROUP_ID_001, system-signal=OBJ_GROUP_ID_058}, {implementation-record-element=OBJ_ID_001, system-signal=OBJ_ID_058}, {implementation-record-element=OBJ_MEASUREMENT_STATUS_001, system-signal=OBJ_MEASUREMENT_STATUS_058}, {implementation-record-element=OBJ_MH_CRC16_001, system-signal=OBJ_MH_CRC16_058}, {implementation-record-element=OBJ_MH_CYCLE_COUNTER_001, system-signal=OBJ_MH_CYCLE_COUNTER_058}, {implementation-record-element=OBJ_MOVEMENT_STATUS_001, system-signal=OBJ_MOVEMENT_STATUS_058}, {implementation-record-element=OBJ_POS_ERR_CRR_COEF_001, system-signal=OBJ_POS_ERR_CRR_COEF_058}, {implementation-record-element=OBJ_RCS_001, system-signal=OBJ_RCS_058}, {implementation-record-element=OBJ_REF_PT_LAT_OFFSET_001, system-signal=OBJ_REF_PT_LAT_OFFSET_058}, {implementation-record-element=OBJ_REF_PT_LONG_OFFSET_001, system-signal=OBJ_REF_PT_LONG_OFFSET_058}, {implementation-record-element=OBJ_TIMESTAMP_OFFSET_001, system-signal=OBJ_TIMESTAMP_OFFSET_058}, {implementation-record-element=OBJ_TRACK_MOTION_MODEL_001, system-signal=OBJ_TRACK_MOTION_MODEL_058}, {implementation-record-element=OBJ_VEH_TRACK_FLAG_001, system-signal=OBJ_VEH_TRACK_FLAG_058}, {implementation-record-element=OBJ_VELOCITY_ERR_CRR_COEF_001, system-signal=OBJ_VELOCITY_ERR_CRR_COEF_058}, {implementation-record-element=OBJ_CLS_TYPE5_PROB_001, system-signal=OBJ_CLS_TYPE5_PROB_058}, {implementation-record-element=OBJ_DIMENSION_LENGTH_001, system-signal=OBJ_DIMENSION_LENGTH_058}, {implementation-record-element=OBJ_DIMENSION_WIDTH_ERR_001, system-signal=OBJ_DIMENSION_WIDTH_ERR_058}, {implementation-record-element=OBJ_CLS_TYPE4_PROB_001, system-signal=OBJ_CLS_TYPE4_PROB_058}, {implementation-record-element=OBJ_ACCELERATION_LAT_001, system-signal=OBJ_ACCELERATION_LAT_058}, {implementation-record-element=OBJ_CLS_TYPE5_001, system-signal=OBJ_CLS_TYPE5_058}, {implementation-record-element=OBJ_CLS_TYPE6_PROB_001, system-signal=OBJ_CLS_TYPE6_PROB_058}, {implementation-record-element=OBJ_DIMENSION_WIDTH_001, system-signal=OBJ_DIMENSION_WIDTH_058}, {implementation-record-element=OBJ_CLS_TYPE1_PROB_001, system-signal=OBJ_CLS_TYPE1_PROB_058}, {implementation-record-element=OBJ_CLS_TYPE2_PROB_001, system-signal=OBJ_CLS_TYPE2_PROB_058}, {implementation-record-element=OBJ_CLS_TYPE3_001, system-signal=OBJ_CLS_TYPE3_058}, {implementation-record-element=OBJ_CLS_TYPE4_001, system-signal=OBJ_CLS_TYPE4_058}, {implementation-record-element=OBJ_ACCELERATION_LONG_ERR_001, system-signal=OBJ_ACCELERATION_LONG_ERR_058}, {implementation-record-element=OBJ_ACCELERATION_LAT_ERR_001, system-signal=OBJ_ACCELERATION_LAT_ERR_058}, {implementation-record-element=OBJ_CLS_TYPE1_001, system-signal=OBJ_CLS_TYPE1_058}, {implementation-record-element=OBJ_CLS_TYPE6_001, system-signal=OBJ_CLS_TYPE6_058}, {implementation-record-element=OBJ_DIMENSION_LENGTH_ERR_001, system-signal=OBJ_DIMENSION_LENGTH_ERR_058}, {implementation-record-element=OBJ_ACCELERATION_LONG_001, system-signal=OBJ_ACCELERATION_LONG_058}, {implementation-record-element=OBJ_CLS_TYPE2_001, system-signal=OBJ_CLS_TYPE2_058}, {implementation-record-element=OBJ_CLS_TYPE3_PROB_001, system-signal=OBJ_CLS_TYPE3_PROB_058}, {implementation-record-element=OBJ_YAW_RATE_001, system-signal=OBJ_YAW_RATE_058}, {implementation-record-element=OBJ_YAW_RATE_ERR_001, system-signal=OBJ_YAW_RATE_ERR_058}, {implementation-record-element=OBJ_POS_LONG_ERR_001, system-signal=OBJ_POS_LONG_ERR_058}, {implementation-record-element=OBJ_YAW_ANGLE_ERR_001, system-signal=OBJ_YAW_ANGLE_ERR_058}, {implementation-record-element=OBJ_POS_LAT_001, system-signal=OBJ_POS_LAT_058}, {implementation-record-element=OBJ_YAW_ANGLE_001, system-signal=OBJ_YAW_ANGLE_058}, {implementation-record-element=OBJ_VELOCITY_LAT_001, system-signal=OBJ_VELOCITY_LAT_058}, {implementation-record-element=OBJ_VELOCITY_LAT_ERR_001, system-signal=OBJ_VELOCITY_LAT_ERR_058}, {implementation-record-element=OBJ_VELOCITY_LONG_001, system-signal=OBJ_VELOCITY_LONG_058}, {implementation-record-element=OBJ_VELOCITY_LONG_ERR_001, system-signal=OBJ_VELOCITY_LONG_ERR_058}, {implementation-record-element=OBJ_POS_LAT_ERR_001, system-signal=OBJ_POS_LAT_ERR_058}, {implementation-record-element=OBJ_POS_LONG_001, system-signal=OBJ_POS_LONG_058}]}
        sender-receiver-to-signal-group-mapping={data-element=COMPOSITIONTYPE.Pp_SG_TrackerObject059.Vdp_SG_TrackerObject059, signal-group=SG_TrackerObject059, type-mapping=sender-rec-record-type-mapping=record-element-mappings=[{implementation-record-element=OBJ_ACCEL_ERR_CRR_COEF_001, system-signal=OBJ_ACCEL_ERR_CRR_COEF_059}, {implementation-record-element=OBJ_ALIVE_TIME_001, system-signal=OBJ_ALIVE_TIME_059}, {implementation-record-element=OBJ_EXISTENCE_PROB_001, system-signal=OBJ_EXISTENCE_PROB_059}, {implementation-record-element=OBJ_GROUP_ID_001, system-signal=OBJ_GROUP_ID_059}, {implementation-record-element=OBJ_ID_001, system-signal=OBJ_ID_059}, {implementation-record-element=OBJ_MEASUREMENT_STATUS_001, system-signal=OBJ_MEASUREMENT_STATUS_059}, {implementation-record-element=OBJ_MH_CRC16_001, system-signal=OBJ_MH_CRC16_059}, {implementation-record-element=OBJ_MH_CYCLE_COUNTER_001, system-signal=OBJ_MH_CYCLE_COUNTER_059}, {implementation-record-element=OBJ_MOVEMENT_STATUS_001, system-signal=OBJ_MOVEMENT_STATUS_059}, {implementation-record-element=OBJ_POS_ERR_CRR_COEF_001, system-signal=OBJ_POS_ERR_CRR_COEF_059}, {implementation-record-element=OBJ_RCS_001, system-signal=OBJ_RCS_059}, {implementation-record-element=OBJ_REF_PT_LAT_OFFSET_001, system-signal=OBJ_REF_PT_LAT_OFFSET_059}, {implementation-record-element=OBJ_REF_PT_LONG_OFFSET_001, system-signal=OBJ_REF_PT_LONG_OFFSET_059}, {implementation-record-element=OBJ_TIMESTAMP_OFFSET_001, system-signal=OBJ_TIMESTAMP_OFFSET_059}, {implementation-record-element=OBJ_TRACK_MOTION_MODEL_001, system-signal=OBJ_TRACK_MOTION_MODEL_059}, {implementation-record-element=OBJ_VEH_TRACK_FLAG_001, system-signal=OBJ_VEH_TRACK_FLAG_059}, {implementation-record-element=OBJ_VELOCITY_ERR_CRR_COEF_001, system-signal=OBJ_VELOCITY_ERR_CRR_COEF_059}, {implementation-record-element=OBJ_ACCELERATION_LAT_ERR_001, system-signal=OBJ_ACCELERATION_LAT_ERR_059}, {implementation-record-element=OBJ_POS_LAT_001, system-signal=OBJ_POS_LAT_059}, {implementation-record-element=OBJ_POS_LAT_ERR_001, system-signal=OBJ_POS_LAT_ERR_059}, {implementation-record-element=OBJ_ACCELERATION_LAT_001, system-signal=OBJ_ACCELERATION_LAT_059}, {implementation-record-element=OBJ_CLS_TYPE1_PROB_001, system-signal=OBJ_CLS_TYPE1_PROB_059}, {implementation-record-element=OBJ_CLS_TYPE4_PROB_001, system-signal=OBJ_CLS_TYPE4_PROB_059}, {implementation-record-element=OBJ_CLS_TYPE5_PROB_001, system-signal=OBJ_CLS_TYPE5_PROB_059}, {implementation-record-element=OBJ_POS_LONG_001, system-signal=OBJ_POS_LONG_059}, {implementation-record-element=OBJ_POS_LONG_ERR_001, system-signal=OBJ_POS_LONG_ERR_059}, {implementation-record-element=OBJ_CLS_TYPE6_001, system-signal=OBJ_CLS_TYPE6_059}, {implementation-record-element=OBJ_CLS_TYPE3_001, system-signal=OBJ_CLS_TYPE3_059}, {implementation-record-element=OBJ_CLS_TYPE2_001, system-signal=OBJ_CLS_TYPE2_059}, {implementation-record-element=OBJ_CLS_TYPE3_PROB_001, system-signal=OBJ_CLS_TYPE3_PROB_059}, {implementation-record-element=OBJ_ACCELERATION_LONG_ERR_001, system-signal=OBJ_ACCELERATION_LONG_ERR_059}, {implementation-record-element=OBJ_CLS_TYPE4_001, system-signal=OBJ_CLS_TYPE4_059}, {implementation-record-element=OBJ_DIMENSION_LENGTH_001, system-signal=OBJ_DIMENSION_LENGTH_059}, {implementation-record-element=OBJ_DIMENSION_LENGTH_ERR_001, system-signal=OBJ_DIMENSION_LENGTH_ERR_059}, {implementation-record-element=OBJ_DIMENSION_WIDTH_001, system-signal=OBJ_DIMENSION_WIDTH_059}, {implementation-record-element=OBJ_CLS_TYPE2_PROB_001, system-signal=OBJ_CLS_TYPE2_PROB_059}, {implementation-record-element=OBJ_CLS_TYPE1_001, system-signal=OBJ_CLS_TYPE1_059}, {implementation-record-element=OBJ_CLS_TYPE5_001, system-signal=OBJ_CLS_TYPE5_059}, {implementation-record-element=OBJ_DIMENSION_WIDTH_ERR_001, system-signal=OBJ_DIMENSION_WIDTH_ERR_059}, {implementation-record-element=OBJ_ACCELERATION_LONG_001, system-signal=OBJ_ACCELERATION_LONG_059}, {implementation-record-element=OBJ_CLS_TYPE6_PROB_001, system-signal=OBJ_CLS_TYPE6_PROB_059}, {implementation-record-element=OBJ_YAW_ANGLE_ERR_001, system-signal=OBJ_YAW_ANGLE_ERR_059}, {implementation-record-element=OBJ_YAW_RATE_001, system-signal=OBJ_YAW_RATE_059}, {implementation-record-element=OBJ_YAW_RATE_ERR_001, system-signal=OBJ_YAW_RATE_ERR_059}, {implementation-record-element=OBJ_VELOCITY_LAT_001, system-signal=OBJ_VELOCITY_LAT_059}, {implementation-record-element=OBJ_VELOCITY_LONG_ERR_001, system-signal=OBJ_VELOCITY_LONG_ERR_059}, {implementation-record-element=OBJ_VELOCITY_LONG_001, system-signal=OBJ_VELOCITY_LONG_059}, {implementation-record-element=OBJ_VELOCITY_LAT_ERR_001, system-signal=OBJ_VELOCITY_LAT_ERR_059}, {implementation-record-element=OBJ_YAW_ANGLE_001, system-signal=OBJ_YAW_ANGLE_059}]}
        sender-receiver-to-signal-group-mapping={data-element=COMPOSITIONTYPE.Pp_SG_TrackerObject060.Vdp_SG_TrackerObject060, signal-group=SG_TrackerObject060, type-mapping=sender-rec-record-type-mapping=record-element-mappings=[{implementation-record-element=OBJ_ACCEL_ERR_CRR_COEF_001, system-signal=OBJ_ACCEL_ERR_CRR_COEF_060}, {implementation-record-element=OBJ_ALIVE_TIME_001, system-signal=OBJ_ALIVE_TIME_060}, {implementation-record-element=OBJ_EXISTENCE_PROB_001, system-signal=OBJ_EXISTENCE_PROB_060}, {implementation-record-element=OBJ_GROUP_ID_001, system-signal=OBJ_GROUP_ID_060}, {implementation-record-element=OBJ_ID_001, system-signal=OBJ_ID_060}, {implementation-record-element=OBJ_MEASUREMENT_STATUS_001, system-signal=OBJ_MEASUREMENT_STATUS_060}, {implementation-record-element=OBJ_MH_CRC16_001, system-signal=OBJ_MH_CRC16_060}, {implementation-record-element=OBJ_MH_CYCLE_COUNTER_001, system-signal=OBJ_MH_CYCLE_COUNTER_060}, {implementation-record-element=OBJ_MOVEMENT_STATUS_001, system-signal=OBJ_MOVEMENT_STATUS_060}, {implementation-record-element=OBJ_POS_ERR_CRR_COEF_001, system-signal=OBJ_POS_ERR_CRR_COEF_060}, {implementation-record-element=OBJ_RCS_001, system-signal=OBJ_RCS_060}, {implementation-record-element=OBJ_REF_PT_LAT_OFFSET_001, system-signal=OBJ_REF_PT_LAT_OFFSET_060}, {implementation-record-element=OBJ_REF_PT_LONG_OFFSET_001, system-signal=OBJ_REF_PT_LONG_OFFSET_060}, {implementation-record-element=OBJ_TIMESTAMP_OFFSET_001, system-signal=OBJ_TIMESTAMP_OFFSET_060}, {implementation-record-element=OBJ_TRACK_MOTION_MODEL_001, system-signal=OBJ_TRACK_MOTION_MODEL_060}, {implementation-record-element=OBJ_VEH_TRACK_FLAG_001, system-signal=OBJ_VEH_TRACK_FLAG_060}, {implementation-record-element=OBJ_VELOCITY_ERR_CRR_COEF_001, system-signal=OBJ_VELOCITY_ERR_CRR_COEF_060}, {implementation-record-element=OBJ_CLS_TYPE5_001, system-signal=OBJ_CLS_TYPE5_060}, {implementation-record-element=OBJ_CLS_TYPE6_001, system-signal=OBJ_CLS_TYPE6_060}, {implementation-record-element=OBJ_CLS_TYPE3_001, system-signal=OBJ_CLS_TYPE3_060}, {implementation-record-element=OBJ_POS_LONG_ERR_001, system-signal=OBJ_POS_LONG_ERR_060}, {implementation-record-element=OBJ_ACCELERATION_LONG_001, system-signal=OBJ_ACCELERATION_LONG_060}, {implementation-record-element=OBJ_CLS_TYPE4_PROB_001, system-signal=OBJ_CLS_TYPE4_PROB_060}, {implementation-record-element=OBJ_VELOCITY_LAT_001, system-signal=OBJ_VELOCITY_LAT_060}, {implementation-record-element=OBJ_VELOCITY_LAT_ERR_001, system-signal=OBJ_VELOCITY_LAT_ERR_060}, {implementation-record-element=OBJ_POS_LAT_001, system-signal=OBJ_POS_LAT_060}, {implementation-record-element=OBJ_CLS_TYPE2_PROB_001, system-signal=OBJ_CLS_TYPE2_PROB_060}, {implementation-record-element=OBJ_POS_LAT_ERR_001, system-signal=OBJ_POS_LAT_ERR_060}, {implementation-record-element=OBJ_VELOCITY_LONG_001, system-signal=OBJ_VELOCITY_LONG_060}, {implementation-record-element=OBJ_YAW_ANGLE_001, system-signal=OBJ_YAW_ANGLE_060}, {implementation-record-element=OBJ_YAW_ANGLE_ERR_001, system-signal=OBJ_YAW_ANGLE_ERR_060}, {implementation-record-element=OBJ_VELOCITY_LONG_ERR_001, system-signal=OBJ_VELOCITY_LONG_ERR_060}, {implementation-record-element=OBJ_YAW_RATE_001, system-signal=OBJ_YAW_RATE_060}, {implementation-record-element=OBJ_YAW_RATE_ERR_001, system-signal=OBJ_YAW_RATE_ERR_060}, {implementation-record-element=OBJ_CLS_TYPE1_001, system-signal=OBJ_CLS_TYPE1_060}, {implementation-record-element=OBJ_DIMENSION_LENGTH_ERR_001, system-signal=OBJ_DIMENSION_LENGTH_ERR_060}, {implementation-record-element=OBJ_ACCELERATION_LONG_ERR_001, system-signal=OBJ_ACCELERATION_LONG_ERR_060}, {implementation-record-element=OBJ_CLS_TYPE2_001, system-signal=OBJ_CLS_TYPE2_060}, {implementation-record-element=OBJ_CLS_TYPE4_001, system-signal=OBJ_CLS_TYPE4_060}, {implementation-record-element=OBJ_POS_LONG_001, system-signal=OBJ_POS_LONG_060}, {implementation-record-element=OBJ_CLS_TYPE3_PROB_001, system-signal=OBJ_CLS_TYPE3_PROB_060}, {implementation-record-element=OBJ_DIMENSION_WIDTH_001, system-signal=OBJ_DIMENSION_WIDTH_060}, {implementation-record-element=OBJ_ACCELERATION_LAT_ERR_001, system-signal=OBJ_ACCELERATION_LAT_ERR_060}, {implementation-record-element=OBJ_ACCELERATION_LAT_001, system-signal=OBJ_ACCELERATION_LAT_060}, {implementation-record-element=OBJ_CLS_TYPE1_PROB_001, system-signal=OBJ_CLS_TYPE1_PROB_060}, {implementation-record-element=OBJ_CLS_TYPE5_PROB_001, system-signal=OBJ_CLS_TYPE5_PROB_060}, {implementation-record-element=OBJ_CLS_TYPE6_PROB_001, system-signal=OBJ_CLS_TYPE6_PROB_060}, {implementation-record-element=OBJ_DIMENSION_LENGTH_001, system-signal=OBJ_DIMENSION_LENGTH_060}, {implementation-record-element=OBJ_DIMENSION_WIDTH_ERR_001, system-signal=OBJ_DIMENSION_WIDTH_ERR_060}]}
        sender-receiver-to-signal-group-mapping={data-element=COMPOSITIONTYPE.Pp_SG_TrackerObject061.Vdp_SG_TrackerObject061, signal-group=SG_TrackerObject061, type-mapping=sender-rec-record-type-mapping=record-element-mappings=[{implementation-record-element=OBJ_ACCEL_ERR_CRR_COEF_001, system-signal=OBJ_ACCEL_ERR_CRR_COEF_061}, {implementation-record-element=OBJ_ALIVE_TIME_001, system-signal=OBJ_ALIVE_TIME_061}, {implementation-record-element=OBJ_EXISTENCE_PROB_001, system-signal=OBJ_EXISTENCE_PROB_061}, {implementation-record-element=OBJ_GROUP_ID_001, system-signal=OBJ_GROUP_ID_061}, {implementation-record-element=OBJ_ID_001, system-signal=OBJ_ID_061}, {implementation-record-element=OBJ_MEASUREMENT_STATUS_001, system-signal=OBJ_MEASUREMENT_STATUS_061}, {implementation-record-element=OBJ_MH_CRC16_001, system-signal=OBJ_MH_CRC16_061}, {implementation-record-element=OBJ_MH_CYCLE_COUNTER_001, system-signal=OBJ_MH_CYCLE_COUNTER_061}, {implementation-record-element=OBJ_MOVEMENT_STATUS_001, system-signal=OBJ_MOVEMENT_STATUS_061}, {implementation-record-element=OBJ_POS_ERR_CRR_COEF_001, system-signal=OBJ_POS_ERR_CRR_COEF_061}, {implementation-record-element=OBJ_RCS_001, system-signal=OBJ_RCS_061}, {implementation-record-element=OBJ_REF_PT_LAT_OFFSET_001, system-signal=OBJ_REF_PT_LAT_OFFSET_061}, {implementation-record-element=OBJ_REF_PT_LONG_OFFSET_001, system-signal=OBJ_REF_PT_LONG_OFFSET_061}, {implementation-record-element=OBJ_TIMESTAMP_OFFSET_001, system-signal=OBJ_TIMESTAMP_OFFSET_061}, {implementation-record-element=OBJ_TRACK_MOTION_MODEL_001, system-signal=OBJ_TRACK_MOTION_MODEL_061}, {implementation-record-element=OBJ_VEH_TRACK_FLAG_001, system-signal=OBJ_VEH_TRACK_FLAG_061}, {implementation-record-element=OBJ_VELOCITY_ERR_CRR_COEF_001, system-signal=OBJ_VELOCITY_ERR_CRR_COEF_061}, {implementation-record-element=OBJ_ACCELERATION_LAT_001, system-signal=OBJ_ACCELERATION_LAT_061}, {implementation-record-element=OBJ_ACCELERATION_LAT_ERR_001, system-signal=OBJ_ACCELERATION_LAT_ERR_061}, {implementation-record-element=OBJ_CLS_TYPE1_001, system-signal=OBJ_CLS_TYPE1_061}, {implementation-record-element=OBJ_ACCELERATION_LONG_001, system-signal=OBJ_ACCELERATION_LONG_061}, {implementation-record-element=OBJ_CLS_TYPE2_001, system-signal=OBJ_CLS_TYPE2_061}, {implementation-record-element=OBJ_VELOCITY_LAT_001, system-signal=OBJ_VELOCITY_LAT_061}, {implementation-record-element=OBJ_CLS_TYPE6_PROB_001, system-signal=OBJ_CLS_TYPE6_PROB_061}, {implementation-record-element=OBJ_CLS_TYPE3_PROB_001, system-signal=OBJ_CLS_TYPE3_PROB_061}, {implementation-record-element=OBJ_CLS_TYPE4_001, system-signal=OBJ_CLS_TYPE4_061}, {implementation-record-element=OBJ_YAW_RATE_ERR_001, system-signal=OBJ_YAW_RATE_ERR_061}, {implementation-record-element=OBJ_CLS_TYPE5_001, system-signal=OBJ_CLS_TYPE5_061}, {implementation-record-element=OBJ_CLS_TYPE5_PROB_001, system-signal=OBJ_CLS_TYPE5_PROB_061}, {implementation-record-element=OBJ_CLS_TYPE4_PROB_001, system-signal=OBJ_CLS_TYPE4_PROB_061}, {implementation-record-element=OBJ_CLS_TYPE3_001, system-signal=OBJ_CLS_TYPE3_061}, {implementation-record-element=OBJ_VELOCITY_LONG_ERR_001, system-signal=OBJ_VELOCITY_LONG_ERR_061}, {implementation-record-element=OBJ_DIMENSION_WIDTH_001, system-signal=OBJ_DIMENSION_WIDTH_061}, {implementation-record-element=OBJ_POS_LONG_001, system-signal=OBJ_POS_LONG_061}, {implementation-record-element=OBJ_YAW_ANGLE_ERR_001, system-signal=OBJ_YAW_ANGLE_ERR_061}, {implementation-record-element=OBJ_YAW_RATE_001, system-signal=OBJ_YAW_RATE_061}, {implementation-record-element=OBJ_DIMENSION_WIDTH_ERR_001, system-signal=OBJ_DIMENSION_WIDTH_ERR_061}, {implementation-record-element=OBJ_DIMENSION_LENGTH_ERR_001, system-signal=OBJ_DIMENSION_LENGTH_ERR_061}, {implementation-record-element=OBJ_VELOCITY_LAT_ERR_001, system-signal=OBJ_VELOCITY_LAT_ERR_061}, {implementation-record-element=OBJ_POS_LAT_001, system-signal=OBJ_POS_LAT_061}, {implementation-record-element=OBJ_YAW_ANGLE_001, system-signal=OBJ_YAW_ANGLE_061}, {implementation-record-element=OBJ_DIMENSION_LENGTH_001, system-signal=OBJ_DIMENSION_LENGTH_061}, {implementation-record-element=OBJ_CLS_TYPE1_PROB_001, system-signal=OBJ_CLS_TYPE1_PROB_061}, {implementation-record-element=OBJ_VELOCITY_LONG_001, system-signal=OBJ_VELOCITY_LONG_061}, {implementation-record-element=OBJ_ACCELERATION_LONG_ERR_001, system-signal=OBJ_ACCELERATION_LONG_ERR_061}, {implementation-record-element=OBJ_CLS_TYPE2_PROB_001, system-signal=OBJ_CLS_TYPE2_PROB_061}, {implementation-record-element=OBJ_CLS_TYPE6_001, system-signal=OBJ_CLS_TYPE6_061}, {implementation-record-element=OBJ_POS_LAT_ERR_001, system-signal=OBJ_POS_LAT_ERR_061}, {implementation-record-element=OBJ_POS_LONG_ERR_001, system-signal=OBJ_POS_LONG_ERR_061}]}
        sender-receiver-to-signal-group-mapping={data-element=COMPOSITIONTYPE.Pp_SG_TrackerObject062.Vdp_SG_TrackerObject062, signal-group=SG_TrackerObject062, type-mapping=sender-rec-record-type-mapping=record-element-mappings=[{implementation-record-element=OBJ_ACCEL_ERR_CRR_COEF_001, system-signal=OBJ_ACCEL_ERR_CRR_COEF_062}, {implementation-record-element=OBJ_ALIVE_TIME_001, system-signal=OBJ_ALIVE_TIME_062}, {implementation-record-element=OBJ_EXISTENCE_PROB_001, system-signal=OBJ_EXISTENCE_PROB_062}, {implementation-record-element=OBJ_GROUP_ID_001, system-signal=OBJ_GROUP_ID_062}, {implementation-record-element=OBJ_ID_001, system-signal=OBJ_ID_062}, {implementation-record-element=OBJ_MEASUREMENT_STATUS_001, system-signal=OBJ_MEASUREMENT_STATUS_062}, {implementation-record-element=OBJ_MH_CRC16_001, system-signal=OBJ_MH_CRC16_062}, {implementation-record-element=OBJ_MH_CYCLE_COUNTER_001, system-signal=OBJ_MH_CYCLE_COUNTER_062}, {implementation-record-element=OBJ_MOVEMENT_STATUS_001, system-signal=OBJ_MOVEMENT_STATUS_062}, {implementation-record-element=OBJ_POS_ERR_CRR_COEF_001, system-signal=OBJ_POS_ERR_CRR_COEF_062}, {implementation-record-element=OBJ_RCS_001, system-signal=OBJ_RCS_062}, {implementation-record-element=OBJ_REF_PT_LAT_OFFSET_001, system-signal=OBJ_REF_PT_LAT_OFFSET_062}, {implementation-record-element=OBJ_REF_PT_LONG_OFFSET_001, system-signal=OBJ_REF_PT_LONG_OFFSET_062}, {implementation-record-element=OBJ_TIMESTAMP_OFFSET_001, system-signal=OBJ_TIMESTAMP_OFFSET_062}, {implementation-record-element=OBJ_TRACK_MOTION_MODEL_001, system-signal=OBJ_TRACK_MOTION_MODEL_062}, {implementation-record-element=OBJ_VEH_TRACK_FLAG_001, system-signal=OBJ_VEH_TRACK_FLAG_062}, {implementation-record-element=OBJ_VELOCITY_ERR_CRR_COEF_001, system-signal=OBJ_VELOCITY_ERR_CRR_COEF_062}, {implementation-record-element=OBJ_ACCELERATION_LAT_001, system-signal=OBJ_ACCELERATION_LAT_062}, {implementation-record-element=OBJ_ACCELERATION_LONG_ERR_001, system-signal=OBJ_ACCELERATION_LONG_ERR_062}, {implementation-record-element=OBJ_CLS_TYPE1_001, system-signal=OBJ_CLS_TYPE1_062}, {implementation-record-element=OBJ_CLS_TYPE1_PROB_001, system-signal=OBJ_CLS_TYPE1_PROB_062}, {implementation-record-element=OBJ_CLS_TYPE3_001, system-signal=OBJ_CLS_TYPE3_062}, {implementation-record-element=OBJ_CLS_TYPE3_PROB_001, system-signal=OBJ_CLS_TYPE3_PROB_062}, {implementation-record-element=OBJ_CLS_TYPE4_001, system-signal=OBJ_CLS_TYPE4_062}, {implementation-record-element=OBJ_CLS_TYPE4_PROB_001, system-signal=OBJ_CLS_TYPE4_PROB_062}, {implementation-record-element=OBJ_ACCELERATION_LONG_001, system-signal=OBJ_ACCELERATION_LONG_062}, {implementation-record-element=OBJ_CLS_TYPE5_001, system-signal=OBJ_CLS_TYPE5_062}, {implementation-record-element=OBJ_CLS_TYPE5_PROB_001, system-signal=OBJ_CLS_TYPE5_PROB_062}, {implementation-record-element=OBJ_CLS_TYPE6_001, system-signal=OBJ_CLS_TYPE6_062}, {implementation-record-element=OBJ_CLS_TYPE2_PROB_001, system-signal=OBJ_CLS_TYPE2_PROB_062}, {implementation-record-element=OBJ_ACCELERATION_LAT_ERR_001, system-signal=OBJ_ACCELERATION_LAT_ERR_062}, {implementation-record-element=OBJ_CLS_TYPE2_001, system-signal=OBJ_CLS_TYPE2_062}, {implementation-record-element=OBJ_CLS_TYPE6_PROB_001, system-signal=OBJ_CLS_TYPE6_PROB_062}, {implementation-record-element=OBJ_YAW_ANGLE_ERR_001, system-signal=OBJ_YAW_ANGLE_ERR_062}, {implementation-record-element=OBJ_YAW_ANGLE_001, system-signal=OBJ_YAW_ANGLE_062}, {implementation-record-element=OBJ_YAW_RATE_001, system-signal=OBJ_YAW_RATE_062}, {implementation-record-element=OBJ_DIMENSION_WIDTH_001, system-signal=OBJ_DIMENSION_WIDTH_062}, {implementation-record-element=OBJ_VELOCITY_LAT_ERR_001, system-signal=OBJ_VELOCITY_LAT_ERR_062}, {implementation-record-element=OBJ_VELOCITY_LONG_ERR_001, system-signal=OBJ_VELOCITY_LONG_ERR_062}, {implementation-record-element=OBJ_DIMENSION_LENGTH_ERR_001, system-signal=OBJ_DIMENSION_LENGTH_ERR_062}, {implementation-record-element=OBJ_VELOCITY_LAT_001, system-signal=OBJ_VELOCITY_LAT_062}, {implementation-record-element=OBJ_DIMENSION_LENGTH_001, system-signal=OBJ_DIMENSION_LENGTH_062}, {implementation-record-element=OBJ_POS_LAT_ERR_001, system-signal=OBJ_POS_LAT_ERR_062}, {implementation-record-element=OBJ_POS_LAT_001, system-signal=OBJ_POS_LAT_062}, {implementation-record-element=OBJ_POS_LONG_001, system-signal=OBJ_POS_LONG_062}, {implementation-record-element=OBJ_YAW_RATE_ERR_001, system-signal=OBJ_YAW_RATE_ERR_062}, {implementation-record-element=OBJ_DIMENSION_WIDTH_ERR_001, system-signal=OBJ_DIMENSION_WIDTH_ERR_062}, {implementation-record-element=OBJ_POS_LONG_ERR_001, system-signal=OBJ_POS_LONG_ERR_062}, {implementation-record-element=OBJ_VELOCITY_LONG_001, system-signal=OBJ_VELOCITY_LONG_062}]}
        sender-receiver-to-signal-group-mapping={data-element=COMPOSITIONTYPE.Pp_SG_TrackerObject063.Vdp_SG_TrackerObject063, signal-group=SG_TrackerObject063, type-mapping=sender-rec-record-type-mapping=record-element-mappings=[{implementation-record-element=OBJ_ACCEL_ERR_CRR_COEF_001, system-signal=OBJ_ACCEL_ERR_CRR_COEF_063}, {implementation-record-element=OBJ_ALIVE_TIME_001, system-signal=OBJ_ALIVE_TIME_063}, {implementation-record-element=OBJ_EXISTENCE_PROB_001, system-signal=OBJ_EXISTENCE_PROB_063}, {implementation-record-element=OBJ_GROUP_ID_001, system-signal=OBJ_GROUP_ID_063}, {implementation-record-element=OBJ_ID_001, system-signal=OBJ_ID_063}, {implementation-record-element=OBJ_MEASUREMENT_STATUS_001, system-signal=OBJ_MEASUREMENT_STATUS_063}, {implementation-record-element=OBJ_MH_CRC16_001, system-signal=OBJ_MH_CRC16_063}, {implementation-record-element=OBJ_MH_CYCLE_COUNTER_001, system-signal=OBJ_MH_CYCLE_COUNTER_063}, {implementation-record-element=OBJ_MOVEMENT_STATUS_001, system-signal=OBJ_MOVEMENT_STATUS_063}, {implementation-record-element=OBJ_POS_ERR_CRR_COEF_001, system-signal=OBJ_POS_ERR_CRR_COEF_063}, {implementation-record-element=OBJ_RCS_001, system-signal=OBJ_RCS_063}, {implementation-record-element=OBJ_REF_PT_LAT_OFFSET_001, system-signal=OBJ_REF_PT_LAT_OFFSET_063}, {implementation-record-element=OBJ_REF_PT_LONG_OFFSET_001, system-signal=OBJ_REF_PT_LONG_OFFSET_063}, {implementation-record-element=OBJ_TIMESTAMP_OFFSET_001, system-signal=OBJ_TIMESTAMP_OFFSET_063}, {implementation-record-element=OBJ_TRACK_MOTION_MODEL_001, system-signal=OBJ_TRACK_MOTION_MODEL_063}, {implementation-record-element=OBJ_VEH_TRACK_FLAG_001, system-signal=OBJ_VEH_TRACK_FLAG_063}, {implementation-record-element=OBJ_VELOCITY_ERR_CRR_COEF_001, system-signal=OBJ_VELOCITY_ERR_CRR_COEF_063}, {implementation-record-element=OBJ_CLS_TYPE5_001, system-signal=OBJ_CLS_TYPE5_063}, {implementation-record-element=OBJ_POS_LAT_001, system-signal=OBJ_POS_LAT_063}, {implementation-record-element=OBJ_ACCELERATION_LAT_001, system-signal=OBJ_ACCELERATION_LAT_063}, {implementation-record-element=OBJ_ACCELERATION_LAT_ERR_001, system-signal=OBJ_ACCELERATION_LAT_ERR_063}, {implementation-record-element=OBJ_ACCELERATION_LONG_001, system-signal=OBJ_ACCELERATION_LONG_063}, {implementation-record-element=OBJ_ACCELERATION_LONG_ERR_001, system-signal=OBJ_ACCELERATION_LONG_ERR_063}, {implementation-record-element=OBJ_CLS_TYPE1_PROB_001, system-signal=OBJ_CLS_TYPE1_PROB_063}, {implementation-record-element=OBJ_CLS_TYPE4_PROB_001, system-signal=OBJ_CLS_TYPE4_PROB_063}, {implementation-record-element=OBJ_CLS_TYPE3_001, system-signal=OBJ_CLS_TYPE3_063}, {implementation-record-element=OBJ_CLS_TYPE6_PROB_001, system-signal=OBJ_CLS_TYPE6_PROB_063}, {implementation-record-element=OBJ_DIMENSION_LENGTH_ERR_001, system-signal=OBJ_DIMENSION_LENGTH_ERR_063}, {implementation-record-element=OBJ_CLS_TYPE4_001, system-signal=OBJ_CLS_TYPE4_063}, {implementation-record-element=OBJ_DIMENSION_WIDTH_ERR_001, system-signal=OBJ_DIMENSION_WIDTH_ERR_063}, {implementation-record-element=OBJ_DIMENSION_LENGTH_001, system-signal=OBJ_DIMENSION_LENGTH_063}, {implementation-record-element=OBJ_DIMENSION_WIDTH_001, system-signal=OBJ_DIMENSION_WIDTH_063}, {implementation-record-element=OBJ_CLS_TYPE3_PROB_001, system-signal=OBJ_CLS_TYPE3_PROB_063}, {implementation-record-element=OBJ_CLS_TYPE2_PROB_001, system-signal=OBJ_CLS_TYPE2_PROB_063}, {implementation-record-element=OBJ_CLS_TYPE2_001, system-signal=OBJ_CLS_TYPE2_063}, {implementation-record-element=OBJ_CLS_TYPE5_PROB_001, system-signal=OBJ_CLS_TYPE5_PROB_063}, {implementation-record-element=OBJ_CLS_TYPE6_001, system-signal=OBJ_CLS_TYPE6_063}, {implementation-record-element=OBJ_CLS_TYPE1_001, system-signal=OBJ_CLS_TYPE1_063}, {implementation-record-element=OBJ_YAW_RATE_ERR_001, system-signal=OBJ_YAW_RATE_ERR_063}, {implementation-record-element=OBJ_VELOCITY_LONG_ERR_001, system-signal=OBJ_VELOCITY_LONG_ERR_063}, {implementation-record-element=OBJ_POS_LONG_ERR_001, system-signal=OBJ_POS_LONG_ERR_063}, {implementation-record-element=OBJ_VELOCITY_LAT_001, system-signal=OBJ_VELOCITY_LAT_063}, {implementation-record-element=OBJ_VELOCITY_LONG_001, system-signal=OBJ_VELOCITY_LONG_063}, {implementation-record-element=OBJ_POS_LAT_ERR_001, system-signal=OBJ_POS_LAT_ERR_063}, {implementation-record-element=OBJ_YAW_ANGLE_ERR_001, system-signal=OBJ_YAW_ANGLE_ERR_063}, {implementation-record-element=OBJ_POS_LONG_001, system-signal=OBJ_POS_LONG_063}, {implementation-record-element=OBJ_YAW_RATE_001, system-signal=OBJ_YAW_RATE_063}, {implementation-record-element=OBJ_YAW_ANGLE_001, system-signal=OBJ_YAW_ANGLE_063}, {implementation-record-element=OBJ_VELOCITY_LAT_ERR_001, system-signal=OBJ_VELOCITY_LAT_ERR_063}]}
        sender-receiver-to-signal-group-mapping={data-element=COMPOSITIONTYPE.Pp_SG_TrackerObject064.Vdp_SG_TrackerObject064, signal-group=SG_TrackerObject064, type-mapping=sender-rec-record-type-mapping=record-element-mappings=[{implementation-record-element=OBJ_ACCEL_ERR_CRR_COEF_001, system-signal=OBJ_ACCEL_ERR_CRR_COEF_064}, {implementation-record-element=OBJ_ALIVE_TIME_001, system-signal=OBJ_ALIVE_TIME_064}, {implementation-record-element=OBJ_EXISTENCE_PROB_001, system-signal=OBJ_EXISTENCE_PROB_064}, {implementation-record-element=OBJ_GROUP_ID_001, system-signal=OBJ_GROUP_ID_064}, {implementation-record-element=OBJ_ID_001, system-signal=OBJ_ID_064}, {implementation-record-element=OBJ_MEASUREMENT_STATUS_001, system-signal=OBJ_MEASUREMENT_STATUS_064}, {implementation-record-element=OBJ_MH_CRC16_001, system-signal=OBJ_MH_CRC16_064}, {implementation-record-element=OBJ_MH_CYCLE_COUNTER_001, system-signal=OBJ_MH_CYCLE_COUNTER_064}, {implementation-record-element=OBJ_MOVEMENT_STATUS_001, system-signal=OBJ_MOVEMENT_STATUS_064}, {implementation-record-element=OBJ_POS_ERR_CRR_COEF_001, system-signal=OBJ_POS_ERR_CRR_COEF_064}, {implementation-record-element=OBJ_RCS_001, system-signal=OBJ_RCS_064}, {implementation-record-element=OBJ_REF_PT_LAT_OFFSET_001, system-signal=OBJ_REF_PT_LAT_OFFSET_064}, {implementation-record-element=OBJ_REF_PT_LONG_OFFSET_001, system-signal=OBJ_REF_PT_LONG_OFFSET_064}, {implementation-record-element=OBJ_TIMESTAMP_OFFSET_001, system-signal=OBJ_TIMESTAMP_OFFSET_064}, {implementation-record-element=OBJ_TRACK_MOTION_MODEL_001, system-signal=OBJ_TRACK_MOTION_MODEL_064}, {implementation-record-element=OBJ_VEH_TRACK_FLAG_001, system-signal=OBJ_VEH_TRACK_FLAG_064}, {implementation-record-element=OBJ_VELOCITY_ERR_CRR_COEF_001, system-signal=OBJ_VELOCITY_ERR_CRR_COEF_064}, {implementation-record-element=OBJ_VELOCITY_LAT_001, system-signal=OBJ_VELOCITY_LAT_064}, {implementation-record-element=OBJ_CLS_TYPE1_001, system-signal=OBJ_CLS_TYPE1_064}, {implementation-record-element=OBJ_CLS_TYPE5_001, system-signal=OBJ_CLS_TYPE5_064}, {implementation-record-element=OBJ_CLS_TYPE5_PROB_001, system-signal=OBJ_CLS_TYPE5_PROB_064}, {implementation-record-element=OBJ_CLS_TYPE3_PROB_001, system-signal=OBJ_CLS_TYPE3_PROB_064}, {implementation-record-element=OBJ_DIMENSION_LENGTH_ERR_001, system-signal=OBJ_DIMENSION_LENGTH_ERR_064}, {implementation-record-element=OBJ_CLS_TYPE1_PROB_001, system-signal=OBJ_CLS_TYPE1_PROB_064}, {implementation-record-element=OBJ_DIMENSION_LENGTH_001, system-signal=OBJ_DIMENSION_LENGTH_064}, {implementation-record-element=OBJ_POS_LAT_001, system-signal=OBJ_POS_LAT_064}, {implementation-record-element=OBJ_VELOCITY_LONG_001, system-signal=OBJ_VELOCITY_LONG_064}, {implementation-record-element=OBJ_CLS_TYPE6_PROB_001, system-signal=OBJ_CLS_TYPE6_PROB_064}, {implementation-record-element=OBJ_VELOCITY_LAT_ERR_001, system-signal=OBJ_VELOCITY_LAT_ERR_064}, {implementation-record-element=OBJ_ACCELERATION_LAT_001, system-signal=OBJ_ACCELERATION_LAT_064}, {implementation-record-element=OBJ_POS_LONG_ERR_001, system-signal=OBJ_POS_LONG_ERR_064}, {implementation-record-element=OBJ_CLS_TYPE3_001, system-signal=OBJ_CLS_TYPE3_064}, {implementation-record-element=OBJ_CLS_TYPE4_PROB_001, system-signal=OBJ_CLS_TYPE4_PROB_064}, {implementation-record-element=OBJ_ACCELERATION_LONG_ERR_001, system-signal=OBJ_ACCELERATION_LONG_ERR_064}, {implementation-record-element=OBJ_ACCELERATION_LONG_001, system-signal=OBJ_ACCELERATION_LONG_064}, {implementation-record-element=OBJ_CLS_TYPE4_001, system-signal=OBJ_CLS_TYPE4_064}, {implementation-record-element=OBJ_DIMENSION_WIDTH_ERR_001, system-signal=OBJ_DIMENSION_WIDTH_ERR_064}, {implementation-record-element=OBJ_CLS_TYPE2_PROB_001, system-signal=OBJ_CLS_TYPE2_PROB_064}, {implementation-record-element=OBJ_ACCELERATION_LAT_ERR_001, system-signal=OBJ_ACCELERATION_LAT_ERR_064}, {implementation-record-element=OBJ_VELOCITY_LONG_ERR_001, system-signal=OBJ_VELOCITY_LONG_ERR_064}, {implementation-record-element=OBJ_CLS_TYPE2_001, system-signal=OBJ_CLS_TYPE2_064}, {implementation-record-element=OBJ_POS_LAT_ERR_001, system-signal=OBJ_POS_LAT_ERR_064}, {implementation-record-element=OBJ_CLS_TYPE6_001, system-signal=OBJ_CLS_TYPE6_064}, {implementation-record-element=OBJ_DIMENSION_WIDTH_001, system-signal=OBJ_DIMENSION_WIDTH_064}, {implementation-record-element=OBJ_POS_LONG_001, system-signal=OBJ_POS_LONG_064}, {implementation-record-element=OBJ_YAW_RATE_001, system-signal=OBJ_YAW_RATE_064}, {implementation-record-element=OBJ_YAW_RATE_ERR_001, system-signal=OBJ_YAW_RATE_ERR_064}, {implementation-record-element=OBJ_YAW_ANGLE_ERR_001, system-signal=OBJ_YAW_ANGLE_ERR_064}, {implementation-record-element=OBJ_YAW_ANGLE_001, system-signal=OBJ_YAW_ANGLE_064}]}
        sender-receiver-to-signal-group-mapping={data-element=COMPOSITIONTYPE.Pp_SG_TrackerStatus.Vdp_SG_TrackerStatus, signal-group=SG_TrackerStatus, type-mapping=sender-rec-record-type-mapping=record-element-mappings=[{implementation-record-element=STS_MH_003_CRC16, system-signal=STS_MH_003_CRC16}, {implementation-record-element=STS_MH_003_CYCLE_COUNTER, system-signal=STS_MH_003_CYCLE_COUNTER}, {implementation-record-element=STS_OBJ_DBC_BASE_VER_MAJOR, system-signal=STS_OBJ_DBC_BASE_VER_MAJOR}, {implementation-record-element=STS_OBJ_DBC_BASE_VER_MINOR, system-signal=STS_OBJ_DBC_BASE_VER_MINOR}, {implementation-record-element=STS_PERCEPTION_MODULE_ID, system-signal=STS_PERCEPTION_MODULE_ID}, {implementation-record-element=STS_TRKR_MAJOR_VERSION, system-signal=STS_TRKR_MAJOR_VERSION}, {implementation-record-element=STS_TRKR_MINOR_VERSION, system-signal=STS_TRKR_MINOR_VERSION}, {implementation-record-element=STS_TRKR_PATCH_VERSION, system-signal=STS_TRKR_PATCH_VERSION}]}
        sender-receiver-to-signal-mapping={data-element=COMPOSITIONTYPE.Pp_RDR_NM_CAN_NM_State.Vdp_RDR_NM_CAN_NM_State, system-signal=RDR_NM_CAN_NM_State}
        sender-receiver-to-signal-mapping={data-element=COMPOSITIONTYPE.Pp_RDR_NM_CBV_ActWakeBit_4.Vdp_RDR_NM_CBV_ActWakeBit_4, system-signal=RDR_NM_CBV_ActWakeBit_4}
        sender-receiver-to-signal-mapping={data-element=COMPOSITIONTYPE.Pp_RDR_NM_CBV_NMCoordBit_3.Vdp_RDR_NM_CBV_NMCoordBit_3, system-signal=RDR_NM_CBV_NMCoordBit_3}
        sender-receiver-to-signal-mapping={data-element=COMPOSITIONTYPE.Pp_RDR_NM_CBV_PNIBit_6.Vdp_RDR_NM_CBV_PNIBit_6, system-signal=RDR_NM_CBV_PNIBit_6}
        sender-receiver-to-signal-mapping={data-element=COMPOSITIONTYPE.Pp_RDR_NM_CBV_ReptMsgBit0.Vdp_RDR_NM_CBV_ReptMsgBit0, system-signal=RDR_NM_CBV_ReptMsgBit0}
        sender-receiver-to-signal-mapping={data-element=COMPOSITIONTYPE.Pp_RDR_NM_CBV_ResdBit_1.Vdp_RDR_NM_CBV_ResdBit_1, system-signal=RDR_NM_CBV_ResdBit_1}
        sender-receiver-to-signal-mapping={data-element=COMPOSITIONTYPE.Pp_RDR_NM_CBV_ResdBit_2.Vdp_RDR_NM_CBV_ResdBit_2, system-signal=RDR_NM_CBV_ResdBit_2}
        sender-receiver-to-signal-mapping={data-element=COMPOSITIONTYPE.Pp_RDR_NM_CBV_ResdBit_5.Vdp_RDR_NM_CBV_ResdBit_5, system-signal=RDR_NM_CBV_ResdBit_5}
        sender-receiver-to-signal-mapping={data-element=COMPOSITIONTYPE.Pp_RDR_NM_CBV_ResdBit_7.Vdp_RDR_NM_CBV_ResdBit_7, system-signal=RDR_NM_CBV_ResdBit_7}
        sender-receiver-to-signal-mapping={data-element=COMPOSITIONTYPE.Pp_RDR_NM_PN_User_Data.Vdp_RDR_NM_PN_User_Data, system-signal=RDR_NM_PN_User_Data}
        sender-receiver-to-signal-mapping={data-element=COMPOSITIONTYPE.Pp_RDR_NM_PNC_Reserved{1..3}.Vdp_RDR_NM_PNC_Reserved{1..3}, system-signal=RDR_NM_PNC_Reserved{1..3}}
        sender-receiver-to-signal-mapping={data-element=COMPOSITIONTYPE.Pp_RDR_NM_Wakeup_And_Reason.Vdp_RDR_NM_Wakeup_And_Reason, system-signal=RDR_NM_Wakeup_And_Reason}
        sender-receiver-to-signal-mapping={variation-point=post-build-variant-condition{matching-criterion=RDR_POS, value=1}, data-element=COMPOSITIONTYPE.Rp_TSYN_OVS.Vdp_TSYN_OVS, system-signal=TSYN_OVS}
        sender-receiver-to-signal-mapping={variation-point=post-build-variant-condition{matching-criterion=RDR_POS, value=1}, data-element=COMPOSITIONTYPE.Rp_TSYN_PDU.Vdp_TSYN_PDU, system-signal=TSYN_PDU}
        sender-receiver-to-signal-mapping={variation-point=post-build-variant-condition{matching-criterion=RDR_POS, value=1}, data-element=COMPOSITIONTYPE.Rp_TSYN_RESERVED.Vdp_TSYN_RESERVED, system-signal=TSYN_RESERVED}
        sender-receiver-to-signal-mapping={variation-point=post-build-variant-condition{matching-criterion=RDR_POS, value=1}, data-element=COMPOSITIONTYPE.Rp_TSYN_SEQUENCE_COUNTER.Vdp_TSYN_SEQUENCE_COUNTER, system-signal=TSYN_SEQUENCE_COUNTER}
        sender-receiver-to-signal-mapping={variation-point=post-build-variant-condition{matching-criterion=RDR_POS, value=1}, data-element=COMPOSITIONTYPE.Rp_TSYN_SGW.Vdp_TSYN_SGW, system-signal=TSYN_SGW}
        sender-receiver-to-signal-mapping={variation-point=post-build-variant-condition{matching-criterion=RDR_POS, value=1}, data-element=COMPOSITIONTYPE.Rp_TSYN_SYNCTIME_NANOSEC.Vdp_TSYN_SYNCTIME_NANOSEC, system-signal=TSYN_SYNCTIME_NANOSEC}
        sender-receiver-to-signal-mapping={variation-point=post-build-variant-condition{matching-criterion=RDR_POS, value=1}, data-element=COMPOSITIONTYPE.Rp_TSYN_SYNCTIME_SEC.Vdp_TSYN_SYNCTIME_SEC, system-signal=TSYN_SYNCTIME_SEC}
        sender-receiver-to-signal-mapping={variation-point=post-build-variant-condition{matching-criterion=RDR_POS, value=1}, data-element=COMPOSITIONTYPE.Rp_TSYN_TIMEDOMAIN.Vdp_TSYN_TIMEDOMAIN, system-signal=TSYN_TIMEDOMAIN}
        sender-receiver-to-signal-mapping={variation-point=post-build-variant-condition{matching-criterion=RDR_POS, value=1}, data-element=COMPOSITIONTYPE.Rp_TSYN_USERBYTE.Vdp_TSYN_USERBYTE, system-signal=TSYN_USERBYTE}
        sender-receiver-to-signal-mapping={variation-point=post-build-variant-condition{matching-criterion=RDR_POS, value=1}, data-element=COMPOSITIONTYPE.Rp_TSYNC_CRC.Vdp_TSYNC_CRC, system-signal=TSYNC_CRC}
        sender-receiver-to-signal-group-mapping={data-element=COMPOSITIONTYPE.Pp_SG_AlignmentStatus1_AL.Vdp_SG_AlignmentStatus1_AL, signal-group=SG_AlignmentStatus1, type-mapping=sender-rec-record-type-mapping=record-element-mappings=[{application-record-element=AL_STS_001_CYCLE_COUNTER, system-signal=AL_STS_001_CYCLE_COUNTER}, {application-record-element=AL_STS_001_MH_CRC16, system-signal=AL_STS_001_MH_CRC16}, {application-record-element=STS_AAAzimuthStd, system-signal=STS_AAAzimuthStd}, {application-record-element=STS_AACurrentAzimuth, system-signal=STS_AACurrentAzimuth}, {application-record-element=STS_AACurrentElevation, system-signal=STS_AACurrentElevation}, {application-record-element=STS_AACurrentRoll, system-signal=STS_AACurrentRoll}, {application-record-element=STS_AAElevationStd, system-signal=STS_AAElevationStd}, {application-record-element=STS_AARoll_Std, system-signal=STS_AARoll_Std}, {application-record-element=STS_AlignmentAutoStatus, system-signal=STS_AlignmentAutoStatus}, {application-record-element=STS_AlignmentAzimuth, system-signal=STS_AlignmentAzimuth}, {application-record-element=STS_AlignmentElevation, system-signal=STS_AlignmentElevation}, {application-record-element=STS_AlignmentError, system-signal=STS_AlignmentError}, {application-record-element=STS_AlignmentModeIn, system-signal=STS_AlignmentModeIn}, {application-record-element=STS_AlignmentModeOut, system-signal=STS_AlignmentModeOut}, {application-record-element=STS_AutoAlignmentFailRootCause, system-signal=STS_AutoAlignmentFailRootCause}, {application-record-element=STS_AzimuthErrorNegative, system-signal=STS_AzimuthErrorNegative}, {application-record-element=STS_AzimuthErrorPositive, system-signal=STS_AzimuthErrorPositive}, {application-record-element=STS_AzimuthStd, system-signal=STS_AzimuthStd}, {application-record-element=STS_AzimuthUpdates, system-signal=STS_AzimuthUpdates}, {application-record-element=STS_CalDisplay, system-signal=STS_CalDisplay}, {application-record-element=STS_CalTime, system-signal=STS_CalTime}, {application-record-element=STS_CoordinateSystemInput, system-signal=STS_CoordinateSystemInput}, {application-record-element=STS_ElevationErrorNegative, system-signal=STS_ElevationErrorNegative}, {application-record-element=STS_ElevationErrorPositive, system-signal=STS_ElevationErrorPositive}, {application-record-element=STS_ElevationStd, system-signal=STS_ElevationStd}, {application-record-element=STS_ElevationUpdates, system-signal=STS_ElevationUpdates}, {application-record-element=STS_HostSpdCompensationFactorQF, system-signal=STS_HostSpdCompensationFactorQF}, {application-record-element=STS_HostSpeedCompensationFactor, system-signal=STS_HostSpeedCompensationFactor}, {application-record-element=STS_InitAlignResultAzimuthUpdate, system-signal=STS_InitAlignResultAzimuthUpdate}, {application-record-element=STS_InitAlignRsltElevationUpdate, system-signal=STS_InitAlignRsltElevationUpdate}, {application-record-element=STS_InitAlignRsltHostSpdCompFac, system-signal=STS_InitAlignRsltHostSpdCompFac}, {application-record-element=STS_InitAlignmentResultAzimuth, system-signal=STS_InitAlignmentResultAzimuth}, {application-record-element=STS_InitAlignmentResultElevation, system-signal=STS_InitAlignmentResultElevation}, {application-record-element=STS_InitLastSuccessfulAlignMode, system-signal=STS_InitLastSuccessfulAlignMode}, {application-record-element=STS_ProgressPercent, system-signal=STS_ProgressPercent}, {application-record-element=STS_RadarTypeInput, system-signal=STS_RadarTypeInput}, {application-record-element=STS_RollErrorNegative, system-signal=STS_RollErrorNegative}, {application-record-element=STS_RollErrorPositive, system-signal=STS_RollErrorPositive}, {application-record-element=STS_Roll_Updates, system-signal=STS_Roll_Updates}, {application-record-element=STS_StartAzimuth, system-signal=STS_StartAzimuth}, {application-record-element=STS_StartElevation, system-signal=STS_StartElevation}, {application-record-element=STS_StartRoll, system-signal=STS_StartRoll}]}
        sender-receiver-to-signal-group-mapping={data-element=COMPOSITIONTYPE.Pp_SG_AlignmentStatus2_AL.Vdp_SG_AlignmentStatus2_AL, signal-group=SG_AlignmentStatus2, type-mapping=sender-rec-record-type-mapping=record-element-mappings=[{application-record-element=AL_STS_002_CYCLE_COUNTER, system-signal=AL_STS_002_CYCLE_COUNTER}, {application-record-element=AL_STS_002_MH_CRC16, system-signal=AL_STS_002_MH_CRC16}, {application-record-element=STS_AlignmentServiceStatus, system-signal=STS_AlignmentServiceStatus}, {application-record-element=STS_AlignmentShortTrackStatus, system-signal=STS_AlignmentShortTrackStatus}, {application-record-element=STS_AlignmentStaticStatus, system-signal=STS_AlignmentStaticStatus}, {application-record-element=STS_AverageNumberOfDetections, system-signal=STS_AverageNumberOfDetections}, {application-record-element=STS_AverageSpeed, system-signal=STS_AverageSpeed}, {application-record-element=STS_DistanceAbsolute, system-signal=STS_DistanceAbsolute}, {application-record-element=STS_DistanceEffective, system-signal=STS_DistanceEffective}, {application-record-element=STS_DurationAbsolute, system-signal=STS_DurationAbsolute}, {application-record-element=STS_DurationEffective, system-signal=STS_DurationEffective}, {application-record-element=STS_ImpactByInterference, system-signal=STS_ImpactByInterference}, {application-record-element=STS_MeasuredAmpSTD, system-signal=STS_MeasuredAmpSTD}, {application-record-element=STS_MeasuredRangeRate, system-signal=STS_MeasuredRangeRate}, {application-record-element=STS_MeasuredRangeRateStd, system-signal=STS_MeasuredRangeRateStd}, {application-record-element=STS_MeasuredRangeStd, system-signal=STS_MeasuredRangeStd}, {application-record-element=STS_MeasuredRawAmplitude, system-signal=STS_MeasuredRawAmplitude}, {application-record-element=STS_Measured_Range, system-signal=STS_Measured_Range}, {application-record-element=STS_VehicleCondition, system-signal=STS_VehicleCondition}]}
        sender-receiver-to-signal-group-mapping={data-element=COMPOSITIONTYPE.Pp_SG_Detections_001_004_AL.Vdp_SG_Detections_001_004_AL, signal-group=SG_Detections_001_004, type-mapping=sender-rec-record-type-mapping=record-element-mappings=[{application-record-element=DET_AZIMUTH_001, system-signal=DET_AZIMUTH_001}, {application-record-element=DET_AZIMUTH_002, system-signal=DET_AZIMUTH_002}, {application-record-element=DET_AZIMUTH_003, system-signal=DET_AZIMUTH_003}, {application-record-element=DET_AZIMUTH_004, system-signal=DET_AZIMUTH_004}, {application-record-element=DET_AZIMUTH_ERR_001, system-signal=DET_AZIMUTH_ERR_001}, {application-record-element=DET_AZIMUTH_ERR_002, system-signal=DET_AZIMUTH_ERR_002}, {application-record-element=DET_AZIMUTH_ERR_003, system-signal=DET_AZIMUTH_ERR_003}, {application-record-element=DET_AZIMUTH_ERR_004, system-signal=DET_AZIMUTH_ERR_004}, {application-record-element=DET_BELOW_RAIN_THOLD_001, system-signal=DET_BELOW_RAIN_THOLD_001}, {application-record-element=DET_BELOW_RAIN_THOLD_002, system-signal=DET_BELOW_RAIN_THOLD_002}, {application-record-element=DET_BELOW_RAIN_THOLD_003, system-signal=DET_BELOW_RAIN_THOLD_003}, {application-record-element=DET_BELOW_RAIN_THOLD_004, system-signal=DET_BELOW_RAIN_THOLD_004}, {application-record-element=DET_BI_STATIC_FLAG_001, system-signal=DET_BI_STATIC_FLAG_001}, {application-record-element=DET_BI_STATIC_FLAG_002, system-signal=DET_BI_STATIC_FLAG_002}, {application-record-element=DET_BI_STATIC_FLAG_003, system-signal=DET_BI_STATIC_FLAG_003}, {application-record-element=DET_BI_STATIC_FLAG_004, system-signal=DET_BI_STATIC_FLAG_004}, {application-record-element=DET_CONFD_AZIMUTH_001, system-signal=DET_CONFD_AZIMUTH_001}, {application-record-element=DET_CONFD_AZIMUTH_002, system-signal=DET_CONFD_AZIMUTH_002}, {application-record-element=DET_CONFD_AZIMUTH_003, system-signal=DET_CONFD_AZIMUTH_003}, {application-record-element=DET_CONFD_AZIMUTH_004, system-signal=DET_CONFD_AZIMUTH_004}, {application-record-element=DET_CONFD_ELEVATION_001, system-signal=DET_CONFD_ELEVATION_001}, {application-record-element=DET_CONFD_ELEVATION_002, system-signal=DET_CONFD_ELEVATION_002}, {application-record-element=DET_CONFD_ELEVATION_003, system-signal=DET_CONFD_ELEVATION_003}, {application-record-element=DET_CONFD_ELEVATION_004, system-signal=DET_CONFD_ELEVATION_004}, {application-record-element=DET_ELEVATION_001, system-signal=DET_ELEVATION_001}, {application-record-element=DET_ELEVATION_002, system-signal=DET_ELEVATION_002}, {application-record-element=DET_ELEVATION_003, system-signal=DET_ELEVATION_003}, {application-record-element=DET_ELEVATION_004, system-signal=DET_ELEVATION_004}, {application-record-element=DET_ELEVATION_ERR_001, system-signal=DET_ELEVATION_ERR_001}, {application-record-element=DET_ELEVATION_ERR_002, system-signal=DET_ELEVATION_ERR_002}, {application-record-element=DET_ELEVATION_ERR_003, system-signal=DET_ELEVATION_ERR_003}, {application-record-element=DET_ELEVATION_ERR_004, system-signal=DET_ELEVATION_ERR_004}, {application-record-element=DET_EXISTENCE_PROB_001, system-signal=DET_EXISTENCE_PROB_001}, {application-record-element=DET_EXISTENCE_PROB_002, system-signal=DET_EXISTENCE_PROB_002}, {application-record-element=DET_EXISTENCE_PROB_003, system-signal=DET_EXISTENCE_PROB_003}, {application-record-element=DET_EXISTENCE_PROB_004, system-signal=DET_EXISTENCE_PROB_004}, {application-record-element=DET_HVC_FLAG_001, system-signal=DET_HVC_FLAG_001}, {application-record-element=DET_HVC_FLAG_002, system-signal=DET_HVC_FLAG_002}, {application-record-element=DET_HVC_FLAG_003, system-signal=DET_HVC_FLAG_003}, {application-record-element=DET_HVC_FLAG_004, system-signal=DET_HVC_FLAG_004}, {application-record-element=DET_IDM_001, system-signal=DET_IDM_001}, {application-record-element=DET_IDM_002, system-signal=DET_IDM_002}, {application-record-element=DET_IDM_003, system-signal=DET_IDM_003}, {application-record-element=DET_IDM_004, system-signal=DET_IDM_004}, {application-record-element=DET_MH_CRC16_001_004, system-signal=DET_MH_CRC16_001_004}, {application-record-element=DET_MH_CYCLE_COUNTER_001_004, system-signal=DET_MH_CYCLE_COUNTER_001_004}, {application-record-element=DET_MH_SCAN_INDEX_4LSB_001_004, system-signal=DET_MH_SCAN_INDEX_4LSB_001_004}, {application-record-element=DET_MTD_001, system-signal=DET_MTD_001}, {application-record-element=DET_MTD_002, system-signal=DET_MTD_002}, {application-record-element=DET_MTD_003, system-signal=DET_MTD_003}, {application-record-element=DET_MTD_004, system-signal=DET_MTD_004}, {application-record-element=DET_PROB_1STAZHYPO_001, system-signal=DET_PROB_1STAZHYPO_001}, {application-record-element=DET_PROB_1STAZHYPO_002, system-signal=DET_PROB_1STAZHYPO_002}, {application-record-element=DET_PROB_1STAZHYPO_003, system-signal=DET_PROB_1STAZHYPO_003}, {application-record-element=DET_PROB_1STAZHYPO_004, system-signal=DET_PROB_1STAZHYPO_004}, {application-record-element=DET_RANGE_001, system-signal=DET_RANGE_001}, {application-record-element=DET_RANGE_002, system-signal=DET_RANGE_002}, {application-record-element=DET_RANGE_003, system-signal=DET_RANGE_003}, {application-record-element=DET_RANGE_004, system-signal=DET_RANGE_004}, {application-record-element=DET_RANGE_ERR_001, system-signal=DET_RANGE_ERR_001}, {application-record-element=DET_RANGE_ERR_002, system-signal=DET_RANGE_ERR_002}, {application-record-element=DET_RANGE_ERR_003, system-signal=DET_RANGE_ERR_003}, {application-record-element=DET_RANGE_ERR_004, system-signal=DET_RANGE_ERR_004}, {application-record-element=DET_RANGE_VELOCITY_001, system-signal=DET_RANGE_VELOCITY_001}, {application-record-element=DET_RANGE_VELOCITY_002, system-signal=DET_RANGE_VELOCITY_002}, {application-record-element=DET_RANGE_VELOCITY_003, system-signal=DET_RANGE_VELOCITY_003}, {application-record-element=DET_RANGE_VELOCITY_004, system-signal=DET_RANGE_VELOCITY_004}, {application-record-element=DET_RANGE_VELOCITY_ERR_001, system-signal=DET_RANGE_VELOCITY_ERR_001}, {application-record-element=DET_RANGE_VELOCITY_ERR_002, system-signal=DET_RANGE_VELOCITY_ERR_002}, {application-record-element=DET_RANGE_VELOCITY_ERR_003, system-signal=DET_RANGE_VELOCITY_ERR_003}, {application-record-element=DET_RANGE_VELOCITY_ERR_004, system-signal=DET_RANGE_VELOCITY_ERR_004}, {application-record-element=DET_RCS_001, system-signal=DET_RCS_001}, {application-record-element=DET_RCS_002, system-signal=DET_RCS_002}, {application-record-element=DET_RCS_003, system-signal=DET_RCS_003}, {application-record-element=DET_RCS_004, system-signal=DET_RCS_004}, {application-record-element=DET_SNR_001, system-signal=DET_SNR_001}, {application-record-element=DET_SNR_002, system-signal=DET_SNR_002}, {application-record-element=DET_SNR_003, system-signal=DET_SNR_003}, {application-record-element=DET_SNR_004, system-signal=DET_SNR_004}, {application-record-element=DET_SUPER_RES_TARGET_001, system-signal=DET_SUPER_RES_TARGET_001}, {application-record-element=DET_SUPER_RES_TARGET_002, system-signal=DET_SUPER_RES_TARGET_002}, {application-record-element=DET_SUPER_RES_TARGET_003, system-signal=DET_SUPER_RES_TARGET_003}, {application-record-element=DET_SUPER_RES_TARGET_004, system-signal=DET_SUPER_RES_TARGET_004}]}
        sender-receiver-to-signal-group-mapping={data-element=COMPOSITIONTYPE.Pp_SG_Detections_005_008_AL.Vdp_SG_Detections_005_008_AL, signal-group=SG_Detections_005_008, type-mapping=sender-rec-record-type-mapping=record-element-mappings=[{application-record-element=DET_AZIMUTH_005, system-signal=DET_AZIMUTH_005}, {application-record-element=DET_AZIMUTH_006, system-signal=DET_AZIMUTH_006}, {application-record-element=DET_AZIMUTH_007, system-signal=DET_AZIMUTH_007}, {application-record-element=DET_AZIMUTH_008, system-signal=DET_AZIMUTH_008}, {application-record-element=DET_AZIMUTH_ERR_005, system-signal=DET_AZIMUTH_ERR_005}, {application-record-element=DET_AZIMUTH_ERR_006, system-signal=DET_AZIMUTH_ERR_006}, {application-record-element=DET_AZIMUTH_ERR_007, system-signal=DET_AZIMUTH_ERR_007}, {application-record-element=DET_AZIMUTH_ERR_008, system-signal=DET_AZIMUTH_ERR_008}, {application-record-element=DET_BELOW_RAIN_THOLD_005, system-signal=DET_BELOW_RAIN_THOLD_005}, {application-record-element=DET_BELOW_RAIN_THOLD_006, system-signal=DET_BELOW_RAIN_THOLD_006}, {application-record-element=DET_BELOW_RAIN_THOLD_007, system-signal=DET_BELOW_RAIN_THOLD_007}, {application-record-element=DET_BELOW_RAIN_THOLD_008, system-signal=DET_BELOW_RAIN_THOLD_008}, {application-record-element=DET_BI_STATIC_FLAG_005, system-signal=DET_BI_STATIC_FLAG_005}, {application-record-element=DET_BI_STATIC_FLAG_006, system-signal=DET_BI_STATIC_FLAG_006}, {application-record-element=DET_BI_STATIC_FLAG_007, system-signal=DET_BI_STATIC_FLAG_007}, {application-record-element=DET_BI_STATIC_FLAG_008, system-signal=DET_BI_STATIC_FLAG_008}, {application-record-element=DET_CONFD_AZIMUTH_005, system-signal=DET_CONFD_AZIMUTH_005}, {application-record-element=DET_CONFD_AZIMUTH_006, system-signal=DET_CONFD_AZIMUTH_006}, {application-record-element=DET_CONFD_AZIMUTH_007, system-signal=DET_CONFD_AZIMUTH_007}, {application-record-element=DET_CONFD_AZIMUTH_008, system-signal=DET_CONFD_AZIMUTH_008}, {application-record-element=DET_CONFD_ELEVATION_005, system-signal=DET_CONFD_ELEVATION_005}, {application-record-element=DET_CONFD_ELEVATION_006, system-signal=DET_CONFD_ELEVATION_006}, {application-record-element=DET_CONFD_ELEVATION_007, system-signal=DET_CONFD_ELEVATION_007}, {application-record-element=DET_CONFD_ELEVATION_008, system-signal=DET_CONFD_ELEVATION_008}, {application-record-element=DET_ELEVATION_005, system-signal=DET_ELEVATION_005}, {application-record-element=DET_ELEVATION_006, system-signal=DET_ELEVATION_006}, {application-record-element=DET_ELEVATION_007, system-signal=DET_ELEVATION_007}, {application-record-element=DET_ELEVATION_008, system-signal=DET_ELEVATION_008}, {application-record-element=DET_ELEVATION_ERR_005, system-signal=DET_ELEVATION_ERR_005}, {application-record-element=DET_ELEVATION_ERR_006, system-signal=DET_ELEVATION_ERR_006}, {application-record-element=DET_ELEVATION_ERR_007, system-signal=DET_ELEVATION_ERR_007}, {application-record-element=DET_ELEVATION_ERR_008, system-signal=DET_ELEVATION_ERR_008}, {application-record-element=DET_EXISTENCE_PROB_005, system-signal=DET_EXISTENCE_PROB_005}, {application-record-element=DET_EXISTENCE_PROB_006, system-signal=DET_EXISTENCE_PROB_006}, {application-record-element=DET_EXISTENCE_PROB_007, system-signal=DET_EXISTENCE_PROB_007}, {application-record-element=DET_EXISTENCE_PROB_008, system-signal=DET_EXISTENCE_PROB_008}, {application-record-element=DET_HVC_FLAG_005, system-signal=DET_HVC_FLAG_005}, {application-record-element=DET_HVC_FLAG_006, system-signal=DET_HVC_FLAG_006}, {application-record-element=DET_HVC_FLAG_007, system-signal=DET_HVC_FLAG_007}, {application-record-element=DET_HVC_FLAG_008, system-signal=DET_HVC_FLAG_008}, {application-record-element=DET_IDM_005, system-signal=DET_IDM_005}, {application-record-element=DET_IDM_006, system-signal=DET_IDM_006}, {application-record-element=DET_IDM_007, system-signal=DET_IDM_007}, {application-record-element=DET_IDM_008, system-signal=DET_IDM_008}, {application-record-element=DET_MH_CRC16_005_008, system-signal=DET_MH_CRC16_005_008}, {application-record-element=DET_MH_CYCLE_COUNTER_005_008, system-signal=DET_MH_CYCLE_COUNTER_005_008}, {application-record-element=DET_MH_SCAN_INDEX_4LSB_005_008, system-signal=DET_MH_SCAN_INDEX_4LSB_005_008}, {application-record-element=DET_MTD_005, system-signal=DET_MTD_005}, {application-record-element=DET_MTD_006, system-signal=DET_MTD_006}, {application-record-element=DET_MTD_007, system-signal=DET_MTD_007}, {application-record-element=DET_MTD_008, system-signal=DET_MTD_008}, {application-record-element=DET_PROB_1STAZHYPO_005, system-signal=DET_PROB_1STAZHYPO_005}, {application-record-element=DET_PROB_1STAZHYPO_006, system-signal=DET_PROB_1STAZHYPO_006}, {application-record-element=DET_PROB_1STAZHYPO_007, system-signal=DET_PROB_1STAZHYPO_007}, {application-record-element=DET_PROB_1STAZHYPO_008, system-signal=DET_PROB_1STAZHYPO_008}, {application-record-element=DET_RANGE_005, system-signal=DET_RANGE_005}, {application-record-element=DET_RANGE_006, system-signal=DET_RANGE_006}, {application-record-element=DET_RANGE_007, system-signal=DET_RANGE_007}, {application-record-element=DET_RANGE_008, system-signal=DET_RANGE_008}, {application-record-element=DET_RANGE_ERR_005, system-signal=DET_RANGE_ERR_005}, {application-record-element=DET_RANGE_ERR_006, system-signal=DET_RANGE_ERR_006}, {application-record-element=DET_RANGE_ERR_007, system-signal=DET_RANGE_ERR_007}, {application-record-element=DET_RANGE_ERR_008, system-signal=DET_RANGE_ERR_008}, {application-record-element=DET_RANGE_VELOCITY_005, system-signal=DET_RANGE_VELOCITY_005}, {application-record-element=DET_RANGE_VELOCITY_006, system-signal=DET_RANGE_VELOCITY_006}, {application-record-element=DET_RANGE_VELOCITY_007, system-signal=DET_RANGE_VELOCITY_007}, {application-record-element=DET_RANGE_VELOCITY_008, system-signal=DET_RANGE_VELOCITY_008}, {application-record-element=DET_RANGE_VELOCITY_ERR_005, system-signal=DET_RANGE_VELOCITY_ERR_005}, {application-record-element=DET_RANGE_VELOCITY_ERR_006, system-signal=DET_RANGE_VELOCITY_ERR_006}, {application-record-element=DET_RANGE_VELOCITY_ERR_007, system-signal=DET_RANGE_VELOCITY_ERR_007}, {application-record-element=DET_RANGE_VELOCITY_ERR_008, system-signal=DET_RANGE_VELOCITY_ERR_008}, {application-record-element=DET_RCS_005, system-signal=DET_RCS_005}, {application-record-element=DET_RCS_006, system-signal=DET_RCS_006}, {application-record-element=DET_RCS_007, system-signal=DET_RCS_007}, {application-record-element=DET_RCS_008, system-signal=DET_RCS_008}, {application-record-element=DET_SNR_005, system-signal=DET_SNR_005}, {application-record-element=DET_SNR_006, system-signal=DET_SNR_006}, {application-record-element=DET_SNR_007, system-signal=DET_SNR_007}, {application-record-element=DET_SNR_008, system-signal=DET_SNR_008}, {application-record-element=DET_SUPER_RES_TARGET_005, system-signal=DET_SUPER_RES_TARGET_005}, {application-record-element=DET_SUPER_RES_TARGET_006, system-signal=DET_SUPER_RES_TARGET_006}, {application-record-element=DET_SUPER_RES_TARGET_007, system-signal=DET_SUPER_RES_TARGET_007}, {application-record-element=DET_SUPER_RES_TARGET_008, system-signal=DET_SUPER_RES_TARGET_008}]}
        sender-receiver-to-signal-group-mapping={data-element=COMPOSITIONTYPE.Pp_SG_Detections_009_012_AL.Vdp_SG_Detections_009_012_AL, signal-group=SG_Detections_009_012, type-mapping=sender-rec-record-type-mapping=record-element-mappings=[{application-record-element=DET_AZIMUTH_009, system-signal=DET_AZIMUTH_009}, {application-record-element=DET_AZIMUTH_010, system-signal=DET_AZIMUTH_010}, {application-record-element=DET_AZIMUTH_011, system-signal=DET_AZIMUTH_011}, {application-record-element=DET_AZIMUTH_012, system-signal=DET_AZIMUTH_012}, {application-record-element=DET_AZIMUTH_ERR_009, system-signal=DET_AZIMUTH_ERR_009}, {application-record-element=DET_AZIMUTH_ERR_010, system-signal=DET_AZIMUTH_ERR_010}, {application-record-element=DET_AZIMUTH_ERR_011, system-signal=DET_AZIMUTH_ERR_011}, {application-record-element=DET_AZIMUTH_ERR_012, system-signal=DET_AZIMUTH_ERR_012}, {application-record-element=DET_BELOW_RAIN_THOLD_009, system-signal=DET_BELOW_RAIN_THOLD_009}, {application-record-element=DET_BELOW_RAIN_THOLD_010, system-signal=DET_BELOW_RAIN_THOLD_010}, {application-record-element=DET_BELOW_RAIN_THOLD_011, system-signal=DET_BELOW_RAIN_THOLD_011}, {application-record-element=DET_BELOW_RAIN_THOLD_012, system-signal=DET_BELOW_RAIN_THOLD_012}, {application-record-element=DET_BI_STATIC_FLAG_009, system-signal=DET_BI_STATIC_FLAG_009}, {application-record-element=DET_BI_STATIC_FLAG_010, system-signal=DET_BI_STATIC_FLAG_010}, {application-record-element=DET_BI_STATIC_FLAG_011, system-signal=DET_BI_STATIC_FLAG_011}, {application-record-element=DET_BI_STATIC_FLAG_012, system-signal=DET_BI_STATIC_FLAG_012}, {application-record-element=DET_CONFD_AZIMUTH_009, system-signal=DET_CONFD_AZIMUTH_009}, {application-record-element=DET_CONFD_AZIMUTH_010, system-signal=DET_CONFD_AZIMUTH_010}, {application-record-element=DET_CONFD_AZIMUTH_011, system-signal=DET_CONFD_AZIMUTH_011}, {application-record-element=DET_CONFD_AZIMUTH_012, system-signal=DET_CONFD_AZIMUTH_012}, {application-record-element=DET_CONFD_ELEVATION_009, system-signal=DET_CONFD_ELEVATION_009}, {application-record-element=DET_CONFD_ELEVATION_010, system-signal=DET_CONFD_ELEVATION_010}, {application-record-element=DET_CONFD_ELEVATION_011, system-signal=DET_CONFD_ELEVATION_011}, {application-record-element=DET_CONFD_ELEVATION_012, system-signal=DET_CONFD_ELEVATION_012}, {application-record-element=DET_ELEVATION_009, system-signal=DET_ELEVATION_009}, {application-record-element=DET_ELEVATION_010, system-signal=DET_ELEVATION_010}, {application-record-element=DET_ELEVATION_011, system-signal=DET_ELEVATION_011}, {application-record-element=DET_ELEVATION_012, system-signal=DET_ELEVATION_012}, {application-record-element=DET_ELEVATION_ERR_009, system-signal=DET_ELEVATION_ERR_009}, {application-record-element=DET_ELEVATION_ERR_010, system-signal=DET_ELEVATION_ERR_010}, {application-record-element=DET_ELEVATION_ERR_011, system-signal=DET_ELEVATION_ERR_011}, {application-record-element=DET_ELEVATION_ERR_012, system-signal=DET_ELEVATION_ERR_012}, {application-record-element=DET_EXISTENCE_PROB_009, system-signal=DET_EXISTENCE_PROB_009}, {application-record-element=DET_EXISTENCE_PROB_010, system-signal=DET_EXISTENCE_PROB_010}, {application-record-element=DET_EXISTENCE_PROB_011, system-signal=DET_EXISTENCE_PROB_011}, {application-record-element=DET_EXISTENCE_PROB_012, system-signal=DET_EXISTENCE_PROB_012}, {application-record-element=DET_HVC_FLAG_009, system-signal=DET_HVC_FLAG_009}, {application-record-element=DET_HVC_FLAG_010, system-signal=DET_HVC_FLAG_010}, {application-record-element=DET_HVC_FLAG_011, system-signal=DET_HVC_FLAG_011}, {application-record-element=DET_HVC_FLAG_012, system-signal=DET_HVC_FLAG_012}, {application-record-element=DET_IDM_009, system-signal=DET_IDM_009}, {application-record-element=DET_IDM_010, system-signal=DET_IDM_010}, {application-record-element=DET_IDM_011, system-signal=DET_IDM_011}, {application-record-element=DET_IDM_012, system-signal=DET_IDM_012}, {application-record-element=DET_MH_CRC16_009_012, system-signal=DET_MH_CRC16_009_012}, {application-record-element=DET_MH_CYCLE_COUNTER_009_012, system-signal=DET_MH_CYCLE_COUNTER_009_012}, {application-record-element=DET_MH_SCAN_INDEX_4LSB_009_012, system-signal=DET_MH_SCAN_INDEX_4LSB_009_012}, {application-record-element=DET_MTD_009, system-signal=DET_MTD_009}, {application-record-element=DET_MTD_010, system-signal=DET_MTD_010}, {application-record-element=DET_MTD_011, system-signal=DET_MTD_011}, {application-record-element=DET_MTD_012, system-signal=DET_MTD_012}, {application-record-element=DET_PROB_1STAZHYPO_009, system-signal=DET_PROB_1STAZHYPO_009}, {application-record-element=DET_PROB_1STAZHYPO_010, system-signal=DET_PROB_1STAZHYPO_010}, {application-record-element=DET_PROB_1STAZHYPO_011, system-signal=DET_PROB_1STAZHYPO_011}, {application-record-element=DET_PROB_1STAZHYPO_012, system-signal=DET_PROB_1STAZHYPO_012}, {application-record-element=DET_RANGE_009, system-signal=DET_RANGE_009}, {application-record-element=DET_RANGE_010, system-signal=DET_RANGE_010}, {application-record-element=DET_RANGE_011, system-signal=DET_RANGE_011}, {application-record-element=DET_RANGE_012, system-signal=DET_RANGE_012}, {application-record-element=DET_RANGE_ERR_009, system-signal=DET_RANGE_ERR_009}, {application-record-element=DET_RANGE_ERR_010, system-signal=DET_RANGE_ERR_010}, {application-record-element=DET_RANGE_ERR_011, system-signal=DET_RANGE_ERR_011}, {application-record-element=DET_RANGE_ERR_012, system-signal=DET_RANGE_ERR_012}, {application-record-element=DET_RANGE_VELOCITY_009, system-signal=DET_RANGE_VELOCITY_009}, {application-record-element=DET_RANGE_VELOCITY_010, system-signal=DET_RANGE_VELOCITY_010}, {application-record-element=DET_RANGE_VELOCITY_011, system-signal=DET_RANGE_VELOCITY_011}, {application-record-element=DET_RANGE_VELOCITY_012, system-signal=DET_RANGE_VELOCITY_012}, {application-record-element=DET_RANGE_VELOCITY_ERR_009, system-signal=DET_RANGE_VELOCITY_ERR_009}, {application-record-element=DET_RANGE_VELOCITY_ERR_010, system-signal=DET_RANGE_VELOCITY_ERR_010}, {application-record-element=DET_RANGE_VELOCITY_ERR_011, system-signal=DET_RANGE_VELOCITY_ERR_011}, {application-record-element=DET_RANGE_VELOCITY_ERR_012, system-signal=DET_RANGE_VELOCITY_ERR_012}, {application-record-element=DET_RCS_009, system-signal=DET_RCS_009}, {application-record-element=DET_RCS_010, system-signal=DET_RCS_010}, {application-record-element=DET_RCS_011, system-signal=DET_RCS_011}, {application-record-element=DET_RCS_012, system-signal=DET_RCS_012}, {application-record-element=DET_SNR_009, system-signal=DET_SNR_009}, {application-record-element=DET_SNR_010, system-signal=DET_SNR_010}, {application-record-element=DET_SNR_011, system-signal=DET_SNR_011}, {application-record-element=DET_SNR_012, system-signal=DET_SNR_012}, {application-record-element=DET_SUPER_RES_TARGET_009, system-signal=DET_SUPER_RES_TARGET_009}, {application-record-element=DET_SUPER_RES_TARGET_010, system-signal=DET_SUPER_RES_TARGET_010}, {application-record-element=DET_SUPER_RES_TARGET_011, system-signal=DET_SUPER_RES_TARGET_011}, {application-record-element=DET_SUPER_RES_TARGET_012, system-signal=DET_SUPER_RES_TARGET_012}]}
        sender-receiver-to-signal-group-mapping={data-element=COMPOSITIONTYPE.Pp_SG_Detections_013_016_AL.Vdp_SG_Detections_013_016_AL, signal-group=SG_Detections_013_016, type-mapping=sender-rec-record-type-mapping=record-element-mappings=[{application-record-element=DET_AZIMUTH_013, system-signal=DET_AZIMUTH_013}, {application-record-element=DET_AZIMUTH_014, system-signal=DET_AZIMUTH_014}, {application-record-element=DET_AZIMUTH_015, system-signal=DET_AZIMUTH_015}, {application-record-element=DET_AZIMUTH_016, system-signal=DET_AZIMUTH_016}, {application-record-element=DET_AZIMUTH_ERR_013, system-signal=DET_AZIMUTH_ERR_013}, {application-record-element=DET_AZIMUTH_ERR_014, system-signal=DET_AZIMUTH_ERR_014}, {application-record-element=DET_AZIMUTH_ERR_015, system-signal=DET_AZIMUTH_ERR_015}, {application-record-element=DET_AZIMUTH_ERR_016, system-signal=DET_AZIMUTH_ERR_016}, {application-record-element=DET_BELOW_RAIN_THOLD_013, system-signal=DET_BELOW_RAIN_THOLD_013}, {application-record-element=DET_BELOW_RAIN_THOLD_014, system-signal=DET_BELOW_RAIN_THOLD_014}, {application-record-element=DET_BELOW_RAIN_THOLD_015, system-signal=DET_BELOW_RAIN_THOLD_015}, {application-record-element=DET_BELOW_RAIN_THOLD_016, system-signal=DET_BELOW_RAIN_THOLD_016}, {application-record-element=DET_BI_STATIC_FLAG_013, system-signal=DET_BI_STATIC_FLAG_013}, {application-record-element=DET_BI_STATIC_FLAG_014, system-signal=DET_BI_STATIC_FLAG_014}, {application-record-element=DET_BI_STATIC_FLAG_015, system-signal=DET_BI_STATIC_FLAG_015}, {application-record-element=DET_BI_STATIC_FLAG_016, system-signal=DET_BI_STATIC_FLAG_016}, {application-record-element=DET_CONFD_AZIMUTH_013, system-signal=DET_CONFD_AZIMUTH_013}, {application-record-element=DET_CONFD_AZIMUTH_014, system-signal=DET_CONFD_AZIMUTH_014}, {application-record-element=DET_CONFD_AZIMUTH_015, system-signal=DET_CONFD_AZIMUTH_015}, {application-record-element=DET_CONFD_AZIMUTH_016, system-signal=DET_CONFD_AZIMUTH_016}, {application-record-element=DET_CONFD_ELEVATION_013, system-signal=DET_CONFD_ELEVATION_013}, {application-record-element=DET_CONFD_ELEVATION_014, system-signal=DET_CONFD_ELEVATION_014}, {application-record-element=DET_CONFD_ELEVATION_015, system-signal=DET_CONFD_ELEVATION_015}, {application-record-element=DET_CONFD_ELEVATION_016, system-signal=DET_CONFD_ELEVATION_016}, {application-record-element=DET_ELEVATION_013, system-signal=DET_ELEVATION_013}, {application-record-element=DET_ELEVATION_014, system-signal=DET_ELEVATION_014}, {application-record-element=DET_ELEVATION_015, system-signal=DET_ELEVATION_015}, {application-record-element=DET_ELEVATION_016, system-signal=DET_ELEVATION_016}, {application-record-element=DET_ELEVATION_ERR_013, system-signal=DET_ELEVATION_ERR_013}, {application-record-element=DET_ELEVATION_ERR_014, system-signal=DET_ELEVATION_ERR_014}, {application-record-element=DET_ELEVATION_ERR_015, system-signal=DET_ELEVATION_ERR_015}, {application-record-element=DET_ELEVATION_ERR_016, system-signal=DET_ELEVATION_ERR_016}, {application-record-element=DET_EXISTENCE_PROB_013, system-signal=DET_EXISTENCE_PROB_013}, {application-record-element=DET_EXISTENCE_PROB_014, system-signal=DET_EXISTENCE_PROB_014}, {application-record-element=DET_EXISTENCE_PROB_015, system-signal=DET_EXISTENCE_PROB_015}, {application-record-element=DET_EXISTENCE_PROB_016, system-signal=DET_EXISTENCE_PROB_016}, {application-record-element=DET_HVC_FLAG_013, system-signal=DET_HVC_FLAG_013}, {application-record-element=DET_HVC_FLAG_014, system-signal=DET_HVC_FLAG_014}, {application-record-element=DET_HVC_FLAG_015, system-signal=DET_HVC_FLAG_015}, {application-record-element=DET_HVC_FLAG_016, system-signal=DET_HVC_FLAG_016}, {application-record-element=DET_IDM_013, system-signal=DET_IDM_013}, {application-record-element=DET_IDM_014, system-signal=DET_IDM_014}, {application-record-element=DET_IDM_015, system-signal=DET_IDM_015}, {application-record-element=DET_IDM_016, system-signal=DET_IDM_016}, {application-record-element=DET_MH_CRC16_013_016, system-signal=DET_MH_CRC16_013_016}, {application-record-element=DET_MH_CYCLE_COUNTER_013_016, system-signal=DET_MH_CYCLE_COUNTER_013_016}, {application-record-element=DET_MH_SCAN_INDEX_4LSB_013_016, system-signal=DET_MH_SCAN_INDEX_4LSB_013_016}, {application-record-element=DET_MTD_013, system-signal=DET_MTD_013}, {application-record-element=DET_MTD_014, system-signal=DET_MTD_014}, {application-record-element=DET_MTD_015, system-signal=DET_MTD_015}, {application-record-element=DET_MTD_016, system-signal=DET_MTD_016}, {application-record-element=DET_PROB_1STAZHYPO_013, system-signal=DET_PROB_1STAZHYPO_013}, {application-record-element=DET_PROB_1STAZHYPO_014, system-signal=DET_PROB_1STAZHYPO_014}, {application-record-element=DET_PROB_1STAZHYPO_015, system-signal=DET_PROB_1STAZHYPO_015}, {application-record-element=DET_PROB_1STAZHYPO_016, system-signal=DET_PROB_1STAZHYPO_016}, {application-record-element=DET_RANGE_013, system-signal=DET_RANGE_013}, {application-record-element=DET_RANGE_014, system-signal=DET_RANGE_014}, {application-record-element=DET_RANGE_015, system-signal=DET_RANGE_015}, {application-record-element=DET_RANGE_016, system-signal=DET_RANGE_016}, {application-record-element=DET_RANGE_ERR_013, system-signal=DET_RANGE_ERR_013}, {application-record-element=DET_RANGE_ERR_014, system-signal=DET_RANGE_ERR_014}, {application-record-element=DET_RANGE_ERR_015, system-signal=DET_RANGE_ERR_015}, {application-record-element=DET_RANGE_ERR_016, system-signal=DET_RANGE_ERR_016}, {application-record-element=DET_RANGE_VELOCITY_013, system-signal=DET_RANGE_VELOCITY_013}, {application-record-element=DET_RANGE_VELOCITY_014, system-signal=DET_RANGE_VELOCITY_014}, {application-record-element=DET_RANGE_VELOCITY_015, system-signal=DET_RANGE_VELOCITY_015}, {application-record-element=DET_RANGE_VELOCITY_016, system-signal=DET_RANGE_VELOCITY_016}, {application-record-element=DET_RANGE_VELOCITY_ERR_013, system-signal=DET_RANGE_VELOCITY_ERR_013}, {application-record-element=DET_RANGE_VELOCITY_ERR_014, system-signal=DET_RANGE_VELOCITY_ERR_014}, {application-record-element=DET_RANGE_VELOCITY_ERR_015, system-signal=DET_RANGE_VELOCITY_ERR_015}, {application-record-element=DET_RANGE_VELOCITY_ERR_016, system-signal=DET_RANGE_VELOCITY_ERR_016}, {application-record-element=DET_RCS_013, system-signal=DET_RCS_013}, {application-record-element=DET_RCS_014, system-signal=DET_RCS_014}, {application-record-element=DET_RCS_015, system-signal=DET_RCS_015}, {application-record-element=DET_RCS_016, system-signal=DET_RCS_016}, {application-record-element=DET_SNR_013, system-signal=DET_SNR_013}, {application-record-element=DET_SNR_014, system-signal=DET_SNR_014}, {application-record-element=DET_SNR_015, system-signal=DET_SNR_015}, {application-record-element=DET_SNR_016, system-signal=DET_SNR_016}, {application-record-element=DET_SUPER_RES_TARGET_013, system-signal=DET_SUPER_RES_TARGET_013}, {application-record-element=DET_SUPER_RES_TARGET_014, system-signal=DET_SUPER_RES_TARGET_014}, {application-record-element=DET_SUPER_RES_TARGET_015, system-signal=DET_SUPER_RES_TARGET_015}, {application-record-element=DET_SUPER_RES_TARGET_016, system-signal=DET_SUPER_RES_TARGET_016}]}
        sender-receiver-to-signal-group-mapping={data-element=COMPOSITIONTYPE.Pp_SG_Detections_017_020_AL.Vdp_SG_Detections_017_020_AL, signal-group=SG_Detections_017_020, type-mapping=sender-rec-record-type-mapping=record-element-mappings=[{application-record-element=DET_AZIMUTH_017, system-signal=DET_AZIMUTH_017}, {application-record-element=DET_AZIMUTH_018, system-signal=DET_AZIMUTH_018}, {application-record-element=DET_AZIMUTH_019, system-signal=DET_AZIMUTH_019}, {application-record-element=DET_AZIMUTH_020, system-signal=DET_AZIMUTH_020}, {application-record-element=DET_AZIMUTH_ERR_017, system-signal=DET_AZIMUTH_ERR_017}, {application-record-element=DET_AZIMUTH_ERR_018, system-signal=DET_AZIMUTH_ERR_018}, {application-record-element=DET_AZIMUTH_ERR_019, system-signal=DET_AZIMUTH_ERR_019}, {application-record-element=DET_AZIMUTH_ERR_020, system-signal=DET_AZIMUTH_ERR_020}, {application-record-element=DET_BELOW_RAIN_THOLD_017, system-signal=DET_BELOW_RAIN_THOLD_017}, {application-record-element=DET_BELOW_RAIN_THOLD_018, system-signal=DET_BELOW_RAIN_THOLD_018}, {application-record-element=DET_BELOW_RAIN_THOLD_019, system-signal=DET_BELOW_RAIN_THOLD_019}, {application-record-element=DET_BELOW_RAIN_THOLD_020, system-signal=DET_BELOW_RAIN_THOLD_020}, {application-record-element=DET_BI_STATIC_FLAG_017, system-signal=DET_BI_STATIC_FLAG_017}, {application-record-element=DET_BI_STATIC_FLAG_018, system-signal=DET_BI_STATIC_FLAG_018}, {application-record-element=DET_BI_STATIC_FLAG_019, system-signal=DET_BI_STATIC_FLAG_019}, {application-record-element=DET_BI_STATIC_FLAG_020, system-signal=DET_BI_STATIC_FLAG_020}, {application-record-element=DET_CONFD_AZIMUTH_017, system-signal=DET_CONFD_AZIMUTH_017}, {application-record-element=DET_CONFD_AZIMUTH_018, system-signal=DET_CONFD_AZIMUTH_018}, {application-record-element=DET_CONFD_AZIMUTH_019, system-signal=DET_CONFD_AZIMUTH_019}, {application-record-element=DET_CONFD_AZIMUTH_020, system-signal=DET_CONFD_AZIMUTH_020}, {application-record-element=DET_CONFD_ELEVATION_017, system-signal=DET_CONFD_ELEVATION_017}, {application-record-element=DET_CONFD_ELEVATION_018, system-signal=DET_CONFD_ELEVATION_018}, {application-record-element=DET_CONFD_ELEVATION_019, system-signal=DET_CONFD_ELEVATION_019}, {application-record-element=DET_CONFD_ELEVATION_020, system-signal=DET_CONFD_ELEVATION_020}, {application-record-element=DET_ELEVATION_017, system-signal=DET_ELEVATION_017}, {application-record-element=DET_ELEVATION_018, system-signal=DET_ELEVATION_018}, {application-record-element=DET_ELEVATION_019, system-signal=DET_ELEVATION_019}, {application-record-element=DET_ELEVATION_020, system-signal=DET_ELEVATION_020}, {application-record-element=DET_ELEVATION_ERR_017, system-signal=DET_ELEVATION_ERR_017}, {application-record-element=DET_ELEVATION_ERR_018, system-signal=DET_ELEVATION_ERR_018}, {application-record-element=DET_ELEVATION_ERR_019, system-signal=DET_ELEVATION_ERR_019}, {application-record-element=DET_ELEVATION_ERR_020, system-signal=DET_ELEVATION_ERR_020}, {application-record-element=DET_EXISTENCE_PROB_017, system-signal=DET_EXISTENCE_PROB_017}, {application-record-element=DET_EXISTENCE_PROB_018, system-signal=DET_EXISTENCE_PROB_018}, {application-record-element=DET_EXISTENCE_PROB_019, system-signal=DET_EXISTENCE_PROB_019}, {application-record-element=DET_EXISTENCE_PROB_020, system-signal=DET_EXISTENCE_PROB_020}, {application-record-element=DET_HVC_FLAG_017, system-signal=DET_HVC_FLAG_017}, {application-record-element=DET_HVC_FLAG_018, system-signal=DET_HVC_FLAG_018}, {application-record-element=DET_HVC_FLAG_019, system-signal=DET_HVC_FLAG_019}, {application-record-element=DET_HVC_FLAG_020, system-signal=DET_HVC_FLAG_020}, {application-record-element=DET_IDM_017, system-signal=DET_IDM_017}, {application-record-element=DET_IDM_018, system-signal=DET_IDM_018}, {application-record-element=DET_IDM_019, system-signal=DET_IDM_019}, {application-record-element=DET_IDM_020, system-signal=DET_IDM_020}, {application-record-element=DET_MH_CRC16_017_020, system-signal=DET_MH_CRC16_017_020}, {application-record-element=DET_MH_CYCLE_COUNTER_017_020, system-signal=DET_MH_CYCLE_COUNTER_017_020}, {application-record-element=DET_MH_SCAN_INDEX_4LSB_017_020, system-signal=DET_MH_SCAN_INDEX_4LSB_017_020}, {application-record-element=DET_MTD_017, system-signal=DET_MTD_017}, {application-record-element=DET_MTD_018, system-signal=DET_MTD_018}, {application-record-element=DET_MTD_019, system-signal=DET_MTD_019}, {application-record-element=DET_MTD_020, system-signal=DET_MTD_020}, {application-record-element=DET_PROB_1STAZHYPO_017, system-signal=DET_PROB_1STAZHYPO_017}, {application-record-element=DET_PROB_1STAZHYPO_018, system-signal=DET_PROB_1STAZHYPO_018}, {application-record-element=DET_PROB_1STAZHYPO_019, system-signal=DET_PROB_1STAZHYPO_019}, {application-record-element=DET_PROB_1STAZHYPO_020, system-signal=DET_PROB_1STAZHYPO_020}, {application-record-element=DET_RANGE_017, system-signal=DET_RANGE_017}, {application-record-element=DET_RANGE_018, system-signal=DET_RANGE_018}, {application-record-element=DET_RANGE_019, system-signal=DET_RANGE_019}, {application-record-element=DET_RANGE_020, system-signal=DET_RANGE_020}, {application-record-element=DET_RANGE_ERR_017, system-signal=DET_RANGE_ERR_017}, {application-record-element=DET_RANGE_ERR_018, system-signal=DET_RANGE_ERR_018}, {application-record-element=DET_RANGE_ERR_019, system-signal=DET_RANGE_ERR_019}, {application-record-element=DET_RANGE_ERR_020, system-signal=DET_RANGE_ERR_020}, {application-record-element=DET_RANGE_VELOCITY_017, system-signal=DET_RANGE_VELOCITY_017}, {application-record-element=DET_RANGE_VELOCITY_018, system-signal=DET_RANGE_VELOCITY_018}, {application-record-element=DET_RANGE_VELOCITY_019, system-signal=DET_RANGE_VELOCITY_019}, {application-record-element=DET_RANGE_VELOCITY_020, system-signal=DET_RANGE_VELOCITY_020}, {application-record-element=DET_RANGE_VELOCITY_ERR_017, system-signal=DET_RANGE_VELOCITY_ERR_017}, {application-record-element=DET_RANGE_VELOCITY_ERR_018, system-signal=DET_RANGE_VELOCITY_ERR_018}, {application-record-element=DET_RANGE_VELOCITY_ERR_019, system-signal=DET_RANGE_VELOCITY_ERR_019}, {application-record-element=DET_RANGE_VELOCITY_ERR_020, system-signal=DET_RANGE_VELOCITY_ERR_020}, {application-record-element=DET_RCS_017, system-signal=DET_RCS_017}, {application-record-element=DET_RCS_018, system-signal=DET_RCS_018}, {application-record-element=DET_RCS_019, system-signal=DET_RCS_019}, {application-record-element=DET_RCS_020, system-signal=DET_RCS_020}, {application-record-element=DET_SNR_017, system-signal=DET_SNR_017}, {application-record-element=DET_SNR_018, system-signal=DET_SNR_018}, {application-record-element=DET_SNR_019, system-signal=DET_SNR_019}, {application-record-element=DET_SNR_020, system-signal=DET_SNR_020}, {application-record-element=DET_SUPER_RES_TARGET_017, system-signal=DET_SUPER_RES_TARGET_017}, {application-record-element=DET_SUPER_RES_TARGET_018, system-signal=DET_SUPER_RES_TARGET_018}, {application-record-element=DET_SUPER_RES_TARGET_019, system-signal=DET_SUPER_RES_TARGET_019}, {application-record-element=DET_SUPER_RES_TARGET_020, system-signal=DET_SUPER_RES_TARGET_020}]}
        sender-receiver-to-signal-group-mapping={data-element=COMPOSITIONTYPE.Pp_SG_Detections_021_024_AL.Vdp_SG_Detections_021_024_AL, signal-group=SG_Detections_021_024, type-mapping=sender-rec-record-type-mapping=record-element-mappings=[{application-record-element=DET_AZIMUTH_021, system-signal=DET_AZIMUTH_021}, {application-record-element=DET_AZIMUTH_022, system-signal=DET_AZIMUTH_022}, {application-record-element=DET_AZIMUTH_023, system-signal=DET_AZIMUTH_023}, {application-record-element=DET_AZIMUTH_024, system-signal=DET_AZIMUTH_024}, {application-record-element=DET_AZIMUTH_ERR_021, system-signal=DET_AZIMUTH_ERR_021}, {application-record-element=DET_AZIMUTH_ERR_022, system-signal=DET_AZIMUTH_ERR_022}, {application-record-element=DET_AZIMUTH_ERR_023, system-signal=DET_AZIMUTH_ERR_023}, {application-record-element=DET_AZIMUTH_ERR_024, system-signal=DET_AZIMUTH_ERR_024}, {application-record-element=DET_BELOW_RAIN_THOLD_021, system-signal=DET_BELOW_RAIN_THOLD_021}, {application-record-element=DET_BELOW_RAIN_THOLD_022, system-signal=DET_BELOW_RAIN_THOLD_022}, {application-record-element=DET_BELOW_RAIN_THOLD_023, system-signal=DET_BELOW_RAIN_THOLD_023}, {application-record-element=DET_BELOW_RAIN_THOLD_024, system-signal=DET_BELOW_RAIN_THOLD_024}, {application-record-element=DET_BI_STATIC_FLAG_021, system-signal=DET_BI_STATIC_FLAG_021}, {application-record-element=DET_BI_STATIC_FLAG_022, system-signal=DET_BI_STATIC_FLAG_022}, {application-record-element=DET_BI_STATIC_FLAG_023, system-signal=DET_BI_STATIC_FLAG_023}, {application-record-element=DET_BI_STATIC_FLAG_024, system-signal=DET_BI_STATIC_FLAG_024}, {application-record-element=DET_CONFD_AZIMUTH_021, system-signal=DET_CONFD_AZIMUTH_021}, {application-record-element=DET_CONFD_AZIMUTH_022, system-signal=DET_CONFD_AZIMUTH_022}, {application-record-element=DET_CONFD_AZIMUTH_023, system-signal=DET_CONFD_AZIMUTH_023}, {application-record-element=DET_CONFD_AZIMUTH_024, system-signal=DET_CONFD_AZIMUTH_024}, {application-record-element=DET_CONFD_ELEVATION_021, system-signal=DET_CONFD_ELEVATION_021}, {application-record-element=DET_CONFD_ELEVATION_022, system-signal=DET_CONFD_ELEVATION_022}, {application-record-element=DET_CONFD_ELEVATION_023, system-signal=DET_CONFD_ELEVATION_023}, {application-record-element=DET_CONFD_ELEVATION_024, system-signal=DET_CONFD_ELEVATION_024}, {application-record-element=DET_ELEVATION_021, system-signal=DET_ELEVATION_021}, {application-record-element=DET_ELEVATION_022, system-signal=DET_ELEVATION_022}, {application-record-element=DET_ELEVATION_023, system-signal=DET_ELEVATION_023}, {application-record-element=DET_ELEVATION_024, system-signal=DET_ELEVATION_024}, {application-record-element=DET_ELEVATION_ERR_021, system-signal=DET_ELEVATION_ERR_021}, {application-record-element=DET_ELEVATION_ERR_022, system-signal=DET_ELEVATION_ERR_022}, {application-record-element=DET_ELEVATION_ERR_023, system-signal=DET_ELEVATION_ERR_023}, {application-record-element=DET_ELEVATION_ERR_024, system-signal=DET_ELEVATION_ERR_024}, {application-record-element=DET_EXISTENCE_PROB_021, system-signal=DET_EXISTENCE_PROB_021}, {application-record-element=DET_EXISTENCE_PROB_022, system-signal=DET_EXISTENCE_PROB_022}, {application-record-element=DET_EXISTENCE_PROB_023, system-signal=DET_EXISTENCE_PROB_023}, {application-record-element=DET_EXISTENCE_PROB_024, system-signal=DET_EXISTENCE_PROB_024}, {application-record-element=DET_HVC_FLAG_021, system-signal=DET_HVC_FLAG_021}, {application-record-element=DET_HVC_FLAG_022, system-signal=DET_HVC_FLAG_022}, {application-record-element=DET_HVC_FLAG_023, system-signal=DET_HVC_FLAG_023}, {application-record-element=DET_HVC_FLAG_024, system-signal=DET_HVC_FLAG_024}, {application-record-element=DET_IDM_021, system-signal=DET_IDM_021}, {application-record-element=DET_IDM_022, system-signal=DET_IDM_022}, {application-record-element=DET_IDM_023, system-signal=DET_IDM_023}, {application-record-element=DET_IDM_024, system-signal=DET_IDM_024}, {application-record-element=DET_MH_CRC16_021_024, system-signal=DET_MH_CRC16_021_024}, {application-record-element=DET_MH_CYCLE_COUNTER_021_024, system-signal=DET_MH_CYCLE_COUNTER_021_024}, {application-record-element=DET_MH_SCAN_INDEX_4LSB_021_024, system-signal=DET_MH_SCAN_INDEX_4LSB_021_024}, {application-record-element=DET_MTD_021, system-signal=DET_MTD_021}, {application-record-element=DET_MTD_022, system-signal=DET_MTD_022}, {application-record-element=DET_MTD_023, system-signal=DET_MTD_023}, {application-record-element=DET_MTD_024, system-signal=DET_MTD_024}, {application-record-element=DET_PROB_1STAZHYPO_021, system-signal=DET_PROB_1STAZHYPO_021}, {application-record-element=DET_PROB_1STAZHYPO_022, system-signal=DET_PROB_1STAZHYPO_022}, {application-record-element=DET_PROB_1STAZHYPO_023, system-signal=DET_PROB_1STAZHYPO_023}, {application-record-element=DET_PROB_1STAZHYPO_024, system-signal=DET_PROB_1STAZHYPO_024}, {application-record-element=DET_RANGE_021, system-signal=DET_RANGE_021}, {application-record-element=DET_RANGE_022, system-signal=DET_RANGE_022}, {application-record-element=DET_RANGE_023, system-signal=DET_RANGE_023}, {application-record-element=DET_RANGE_024, system-signal=DET_RANGE_024}, {application-record-element=DET_RANGE_ERR_021, system-signal=DET_RANGE_ERR_021}, {application-record-element=DET_RANGE_ERR_022, system-signal=DET_RANGE_ERR_022}, {application-record-element=DET_RANGE_ERR_023, system-signal=DET_RANGE_ERR_023}, {application-record-element=DET_RANGE_ERR_024, system-signal=DET_RANGE_ERR_024}, {application-record-element=DET_RANGE_VELOCITY_021, system-signal=DET_RANGE_VELOCITY_021}, {application-record-element=DET_RANGE_VELOCITY_022, system-signal=DET_RANGE_VELOCITY_022}, {application-record-element=DET_RANGE_VELOCITY_023, system-signal=DET_RANGE_VELOCITY_023}, {application-record-element=DET_RANGE_VELOCITY_024, system-signal=DET_RANGE_VELOCITY_024}, {application-record-element=DET_RANGE_VELOCITY_ERR_021, system-signal=DET_RANGE_VELOCITY_ERR_021}, {application-record-element=DET_RANGE_VELOCITY_ERR_022, system-signal=DET_RANGE_VELOCITY_ERR_022}, {application-record-element=DET_RANGE_VELOCITY_ERR_023, system-signal=DET_RANGE_VELOCITY_ERR_023}, {application-record-element=DET_RANGE_VELOCITY_ERR_024, system-signal=DET_RANGE_VELOCITY_ERR_024}, {application-record-element=DET_RCS_021, system-signal=DET_RCS_021}, {application-record-element=DET_RCS_022, system-signal=DET_RCS_022}, {application-record-element=DET_RCS_023, system-signal=DET_RCS_023}, {application-record-element=DET_RCS_024, system-signal=DET_RCS_024}, {application-record-element=DET_SNR_021, system-signal=DET_SNR_021}, {application-record-element=DET_SNR_022, system-signal=DET_SNR_022}, {application-record-element=DET_SNR_023, system-signal=DET_SNR_023}, {application-record-element=DET_SNR_024, system-signal=DET_SNR_024}, {application-record-element=DET_SUPER_RES_TARGET_021, system-signal=DET_SUPER_RES_TARGET_021}, {application-record-element=DET_SUPER_RES_TARGET_022, system-signal=DET_SUPER_RES_TARGET_022}, {application-record-element=DET_SUPER_RES_TARGET_023, system-signal=DET_SUPER_RES_TARGET_023}, {application-record-element=DET_SUPER_RES_TARGET_024, system-signal=DET_SUPER_RES_TARGET_024}]}
        sender-receiver-to-signal-group-mapping={data-element=COMPOSITIONTYPE.Pp_SG_Detections_025_028_AL.Vdp_SG_Detections_025_028_AL, signal-group=SG_Detections_025_028, type-mapping=sender-rec-record-type-mapping=record-element-mappings=[{application-record-element=DET_AZIMUTH_025, system-signal=DET_AZIMUTH_025}, {application-record-element=DET_AZIMUTH_026, system-signal=DET_AZIMUTH_026}, {application-record-element=DET_AZIMUTH_027, system-signal=DET_AZIMUTH_027}, {application-record-element=DET_AZIMUTH_028, system-signal=DET_AZIMUTH_028}, {application-record-element=DET_AZIMUTH_ERR_025, system-signal=DET_AZIMUTH_ERR_025}, {application-record-element=DET_AZIMUTH_ERR_026, system-signal=DET_AZIMUTH_ERR_026}, {application-record-element=DET_AZIMUTH_ERR_027, system-signal=DET_AZIMUTH_ERR_027}, {application-record-element=DET_AZIMUTH_ERR_028, system-signal=DET_AZIMUTH_ERR_028}, {application-record-element=DET_BELOW_RAIN_THOLD_025, system-signal=DET_BELOW_RAIN_THOLD_025}, {application-record-element=DET_BELOW_RAIN_THOLD_026, system-signal=DET_BELOW_RAIN_THOLD_026}, {application-record-element=DET_BELOW_RAIN_THOLD_027, system-signal=DET_BELOW_RAIN_THOLD_027}, {application-record-element=DET_BELOW_RAIN_THOLD_028, system-signal=DET_BELOW_RAIN_THOLD_028}, {application-record-element=DET_BI_STATIC_FLAG_025, system-signal=DET_BI_STATIC_FLAG_025}, {application-record-element=DET_BI_STATIC_FLAG_026, system-signal=DET_BI_STATIC_FLAG_026}, {application-record-element=DET_BI_STATIC_FLAG_027, system-signal=DET_BI_STATIC_FLAG_027}, {application-record-element=DET_BI_STATIC_FLAG_028, system-signal=DET_BI_STATIC_FLAG_028}, {application-record-element=DET_CONFD_AZIMUTH_025, system-signal=DET_CONFD_AZIMUTH_025}, {application-record-element=DET_CONFD_AZIMUTH_026, system-signal=DET_CONFD_AZIMUTH_026}, {application-record-element=DET_CONFD_AZIMUTH_027, system-signal=DET_CONFD_AZIMUTH_027}, {application-record-element=DET_CONFD_AZIMUTH_028, system-signal=DET_CONFD_AZIMUTH_028}, {application-record-element=DET_CONFD_ELEVATION_025, system-signal=DET_CONFD_ELEVATION_025}, {application-record-element=DET_CONFD_ELEVATION_026, system-signal=DET_CONFD_ELEVATION_026}, {application-record-element=DET_CONFD_ELEVATION_027, system-signal=DET_CONFD_ELEVATION_027}, {application-record-element=DET_CONFD_ELEVATION_028, system-signal=DET_CONFD_ELEVATION_028}, {application-record-element=DET_ELEVATION_025, system-signal=DET_ELEVATION_025}, {application-record-element=DET_ELEVATION_026, system-signal=DET_ELEVATION_026}, {application-record-element=DET_ELEVATION_027, system-signal=DET_ELEVATION_027}, {application-record-element=DET_ELEVATION_028, system-signal=DET_ELEVATION_028}, {application-record-element=DET_ELEVATION_ERR_025, system-signal=DET_ELEVATION_ERR_025}, {application-record-element=DET_ELEVATION_ERR_026, system-signal=DET_ELEVATION_ERR_026}, {application-record-element=DET_ELEVATION_ERR_027, system-signal=DET_ELEVATION_ERR_027}, {application-record-element=DET_ELEVATION_ERR_028, system-signal=DET_ELEVATION_ERR_028}, {application-record-element=DET_EXISTENCE_PROB_025, system-signal=DET_EXISTENCE_PROB_025}, {application-record-element=DET_EXISTENCE_PROB_026, system-signal=DET_EXISTENCE_PROB_026}, {application-record-element=DET_EXISTENCE_PROB_027, system-signal=DET_EXISTENCE_PROB_027}, {application-record-element=DET_EXISTENCE_PROB_028, system-signal=DET_EXISTENCE_PROB_028}, {application-record-element=DET_HVC_FLAG_025, system-signal=DET_HVC_FLAG_025}, {application-record-element=DET_HVC_FLAG_026, system-signal=DET_HVC_FLAG_026}, {application-record-element=DET_HVC_FLAG_027, system-signal=DET_HVC_FLAG_027}, {application-record-element=DET_HVC_FLAG_028, system-signal=DET_HVC_FLAG_028}, {application-record-element=DET_IDM_025, system-signal=DET_IDM_025}, {application-record-element=DET_IDM_026, system-signal=DET_IDM_026}, {application-record-element=DET_IDM_027, system-signal=DET_IDM_027}, {application-record-element=DET_IDM_028, system-signal=DET_IDM_028}, {application-record-element=DET_MH_CRC16_025_028, system-signal=DET_MH_CRC16_025_028}, {application-record-element=DET_MH_CYCLE_COUNTER_025_028, system-signal=DET_MH_CYCLE_COUNTER_025_028}, {application-record-element=DET_MH_SCAN_INDEX_4LSB_025_028, system-signal=DET_MH_SCAN_INDEX_4LSB_025_028}, {application-record-element=DET_MTD_025, system-signal=DET_MTD_025}, {application-record-element=DET_MTD_026, system-signal=DET_MTD_026}, {application-record-element=DET_MTD_027, system-signal=DET_MTD_027}, {application-record-element=DET_MTD_028, system-signal=DET_MTD_028}, {application-record-element=DET_PROB_1STAZHYPO_025, system-signal=DET_PROB_1STAZHYPO_025}, {application-record-element=DET_PROB_1STAZHYPO_026, system-signal=DET_PROB_1STAZHYPO_026}, {application-record-element=DET_PROB_1STAZHYPO_027, system-signal=DET_PROB_1STAZHYPO_027}, {application-record-element=DET_PROB_1STAZHYPO_028, system-signal=DET_PROB_1STAZHYPO_028}, {application-record-element=DET_RANGE_025, system-signal=DET_RANGE_025}, {application-record-element=DET_RANGE_026, system-signal=DET_RANGE_026}, {application-record-element=DET_RANGE_027, system-signal=DET_RANGE_027}, {application-record-element=DET_RANGE_028, system-signal=DET_RANGE_028}, {application-record-element=DET_RANGE_ERR_025, system-signal=DET_RANGE_ERR_025}, {application-record-element=DET_RANGE_ERR_026, system-signal=DET_RANGE_ERR_026}, {application-record-element=DET_RANGE_ERR_027, system-signal=DET_RANGE_ERR_027}, {application-record-element=DET_RANGE_ERR_028, system-signal=DET_RANGE_ERR_028}, {application-record-element=DET_RANGE_VELOCITY_025, system-signal=DET_RANGE_VELOCITY_025}, {application-record-element=DET_RANGE_VELOCITY_026, system-signal=DET_RANGE_VELOCITY_026}, {application-record-element=DET_RANGE_VELOCITY_027, system-signal=DET_RANGE_VELOCITY_027}, {application-record-element=DET_RANGE_VELOCITY_028, system-signal=DET_RANGE_VELOCITY_028}, {application-record-element=DET_RANGE_VELOCITY_ERR_025, system-signal=DET_RANGE_VELOCITY_ERR_025}, {application-record-element=DET_RANGE_VELOCITY_ERR_026, system-signal=DET_RANGE_VELOCITY_ERR_026}, {application-record-element=DET_RANGE_VELOCITY_ERR_027, system-signal=DET_RANGE_VELOCITY_ERR_027}, {application-record-element=DET_RANGE_VELOCITY_ERR_028, system-signal=DET_RANGE_VELOCITY_ERR_028}, {application-record-element=DET_RCS_025, system-signal=DET_RCS_025}, {application-record-element=DET_RCS_026, system-signal=DET_RCS_026}, {application-record-element=DET_RCS_027, system-signal=DET_RCS_027}, {application-record-element=DET_RCS_028, system-signal=DET_RCS_028}, {application-record-element=DET_SNR_025, system-signal=DET_SNR_025}, {application-record-element=DET_SNR_026, system-signal=DET_SNR_026}, {application-record-element=DET_SNR_027, system-signal=DET_SNR_027}, {application-record-element=DET_SNR_028, system-signal=DET_SNR_028}, {application-record-element=DET_SUPER_RES_TARGET_025, system-signal=DET_SUPER_RES_TARGET_025}, {application-record-element=DET_SUPER_RES_TARGET_026, system-signal=DET_SUPER_RES_TARGET_026}, {application-record-element=DET_SUPER_RES_TARGET_027, system-signal=DET_SUPER_RES_TARGET_027}, {application-record-element=DET_SUPER_RES_TARGET_028, system-signal=DET_SUPER_RES_TARGET_028}]}
        sender-receiver-to-signal-group-mapping={data-element=COMPOSITIONTYPE.Pp_SG_Detections_045_048_AL.Vdp_SG_Detections_045_048_AL, signal-group=SG_Detections_045_048, type-mapping=sender-rec-record-type-mapping=record-element-mappings=[{application-record-element=DET_AZIMUTH_045, system-signal=DET_AZIMUTH_045}, {application-record-element=DET_AZIMUTH_046, system-signal=DET_AZIMUTH_046}, {application-record-element=DET_AZIMUTH_047, system-signal=DET_AZIMUTH_047}, {application-record-element=DET_AZIMUTH_048, system-signal=DET_AZIMUTH_048}, {application-record-element=DET_AZIMUTH_ERR_045, system-signal=DET_AZIMUTH_ERR_045}, {application-record-element=DET_AZIMUTH_ERR_046, system-signal=DET_AZIMUTH_ERR_046}, {application-record-element=DET_AZIMUTH_ERR_047, system-signal=DET_AZIMUTH_ERR_047}, {application-record-element=DET_AZIMUTH_ERR_048, system-signal=DET_AZIMUTH_ERR_048}, {application-record-element=DET_BELOW_RAIN_THOLD_045, system-signal=DET_BELOW_RAIN_THOLD_045}, {application-record-element=DET_BELOW_RAIN_THOLD_046, system-signal=DET_BELOW_RAIN_THOLD_046}, {application-record-element=DET_BELOW_RAIN_THOLD_047, system-signal=DET_BELOW_RAIN_THOLD_047}, {application-record-element=DET_BELOW_RAIN_THOLD_048, system-signal=DET_BELOW_RAIN_THOLD_048}, {application-record-element=DET_BI_STATIC_FLAG_045, system-signal=DET_BI_STATIC_FLAG_045}, {application-record-element=DET_BI_STATIC_FLAG_046, system-signal=DET_BI_STATIC_FLAG_046}, {application-record-element=DET_BI_STATIC_FLAG_047, system-signal=DET_BI_STATIC_FLAG_047}, {application-record-element=DET_BI_STATIC_FLAG_048, system-signal=DET_BI_STATIC_FLAG_048}, {application-record-element=DET_CONFD_AZIMUTH_045, system-signal=DET_CONFD_AZIMUTH_045}, {application-record-element=DET_CONFD_AZIMUTH_046, system-signal=DET_CONFD_AZIMUTH_046}, {application-record-element=DET_CONFD_AZIMUTH_047, system-signal=DET_CONFD_AZIMUTH_047}, {application-record-element=DET_CONFD_AZIMUTH_048, system-signal=DET_CONFD_AZIMUTH_048}, {application-record-element=DET_CONFD_ELEVATION_045, system-signal=DET_CONFD_ELEVATION_045}, {application-record-element=DET_CONFD_ELEVATION_046, system-signal=DET_CONFD_ELEVATION_046}, {application-record-element=DET_CONFD_ELEVATION_047, system-signal=DET_CONFD_ELEVATION_047}, {application-record-element=DET_CONFD_ELEVATION_048, system-signal=DET_CONFD_ELEVATION_048}, {application-record-element=DET_ELEVATION_045, system-signal=DET_ELEVATION_045}, {application-record-element=DET_ELEVATION_046, system-signal=DET_ELEVATION_046}, {application-record-element=DET_ELEVATION_047, system-signal=DET_ELEVATION_047}, {application-record-element=DET_ELEVATION_048, system-signal=DET_ELEVATION_048}, {application-record-element=DET_ELEVATION_ERR_045, system-signal=DET_ELEVATION_ERR_045}, {application-record-element=DET_ELEVATION_ERR_046, system-signal=DET_ELEVATION_ERR_046}, {application-record-element=DET_ELEVATION_ERR_047, system-signal=DET_ELEVATION_ERR_047}, {application-record-element=DET_ELEVATION_ERR_048, system-signal=DET_ELEVATION_ERR_048}, {application-record-element=DET_EXISTENCE_PROB_045, system-signal=DET_EXISTENCE_PROB_045}, {application-record-element=DET_EXISTENCE_PROB_046, system-signal=DET_EXISTENCE_PROB_046}, {application-record-element=DET_EXISTENCE_PROB_047, system-signal=DET_EXISTENCE_PROB_047}, {application-record-element=DET_EXISTENCE_PROB_048, system-signal=DET_EXISTENCE_PROB_048}, {application-record-element=DET_HVC_FLAG_045, system-signal=DET_HVC_FLAG_045}, {application-record-element=DET_HVC_FLAG_046, system-signal=DET_HVC_FLAG_046}, {application-record-element=DET_HVC_FLAG_047, system-signal=DET_HVC_FLAG_047}, {application-record-element=DET_HVC_FLAG_048, system-signal=DET_HVC_FLAG_048}, {application-record-element=DET_IDM_045, system-signal=DET_IDM_045}, {application-record-element=DET_IDM_046, system-signal=DET_IDM_046}, {application-record-element=DET_IDM_047, system-signal=DET_IDM_047}, {application-record-element=DET_IDM_048, system-signal=DET_IDM_048}, {application-record-element=DET_MH_CRC16_045_048, system-signal=DET_MH_CRC16_045_048}, {application-record-element=DET_MH_CYCLE_COUNTER_045_048, system-signal=DET_MH_CYCLE_COUNTER_045_048}, {application-record-element=DET_MH_SCAN_INDEX_4LSB_045_048, system-signal=DET_MH_SCAN_INDEX_4LSB_045_048}, {application-record-element=DET_MTD_045, system-signal=DET_MTD_045}, {application-record-element=DET_MTD_046, system-signal=DET_MTD_046}, {application-record-element=DET_MTD_047, system-signal=DET_MTD_047}, {application-record-element=DET_MTD_048, system-signal=DET_MTD_048}, {application-record-element=DET_PROB_1STAZHYPO_045, system-signal=DET_PROB_1STAZHYPO_045}, {application-record-element=DET_PROB_1STAZHYPO_046, system-signal=DET_PROB_1STAZHYPO_046}, {application-record-element=DET_PROB_1STAZHYPO_047, system-signal=DET_PROB_1STAZHYPO_047}, {application-record-element=DET_PROB_1STAZHYPO_048, system-signal=DET_PROB_1STAZHYPO_048}, {application-record-element=DET_RANGE_045, system-signal=DET_RANGE_045}, {application-record-element=DET_RANGE_046, system-signal=DET_RANGE_046}, {application-record-element=DET_RANGE_047, system-signal=DET_RANGE_047}, {application-record-element=DET_RANGE_048, system-signal=DET_RANGE_048}, {application-record-element=DET_RANGE_ERR_045, system-signal=DET_RANGE_ERR_045}, {application-record-element=DET_RANGE_ERR_046, system-signal=DET_RANGE_ERR_046}, {application-record-element=DET_RANGE_ERR_047, system-signal=DET_RANGE_ERR_047}, {application-record-element=DET_RANGE_ERR_048, system-signal=DET_RANGE_ERR_048}, {application-record-element=DET_RANGE_VELOCITY_045, system-signal=DET_RANGE_VELOCITY_045}, {application-record-element=DET_RANGE_VELOCITY_046, system-signal=DET_RANGE_VELOCITY_046}, {application-record-element=DET_RANGE_VELOCITY_047, system-signal=DET_RANGE_VELOCITY_047}, {application-record-element=DET_RANGE_VELOCITY_048, system-signal=DET_RANGE_VELOCITY_048}, {application-record-element=DET_RANGE_VELOCITY_ERR_045, system-signal=DET_RANGE_VELOCITY_ERR_045}, {application-record-element=DET_RANGE_VELOCITY_ERR_046, system-signal=DET_RANGE_VELOCITY_ERR_046}, {application-record-element=DET_RANGE_VELOCITY_ERR_047, system-signal=DET_RANGE_VELOCITY_ERR_047}, {application-record-element=DET_RANGE_VELOCITY_ERR_048, system-signal=DET_RANGE_VELOCITY_ERR_048}, {application-record-element=DET_RCS_045, system-signal=DET_RCS_045}, {application-record-element=DET_RCS_046, system-signal=DET_RCS_046}, {application-record-element=DET_RCS_047, system-signal=DET_RCS_047}, {application-record-element=DET_RCS_048, system-signal=DET_RCS_048}, {application-record-element=DET_SNR_045, system-signal=DET_SNR_045}, {application-record-element=DET_SNR_046, system-signal=DET_SNR_046}, {application-record-element=DET_SNR_047, system-signal=DET_SNR_047}, {application-record-element=DET_SNR_048, system-signal=DET_SNR_048}, {application-record-element=DET_SUPER_RES_TARGET_045, system-signal=DET_SUPER_RES_TARGET_045}, {application-record-element=DET_SUPER_RES_TARGET_046, system-signal=DET_SUPER_RES_TARGET_046}, {application-record-element=DET_SUPER_RES_TARGET_047, system-signal=DET_SUPER_RES_TARGET_047}, {application-record-element=DET_SUPER_RES_TARGET_048, system-signal=DET_SUPER_RES_TARGET_048}]}
