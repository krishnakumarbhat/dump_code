[part 4 of 11: package /COM/VECTOR/CFG/WORKFLOW/SYSDESC/SYNC]
AUTOSAR XML (schema 00053)
package /COM/VECTOR/CFG/WORKFLOW/SYSDESC/SYNC  (continued)
  system SYSTEM: category=ECU_EXTRACT, client-id-definition-set=CLIENT_ID_DEFINITION_SET  (continued)
    system mapping MAPPINGS  (continued)
      data-mappings:  (continued)
        sender-receiver-to-signal-group-mapping={data-element=COMPOSITIONTYPE.Pp_SG_Detections_137_140_AL.Vdp_SG_Detections_137_140_AL, signal-group=SG_Detections_137_140, type-mapping=sender-rec-record-type-mapping=record-element-mappings=[{application-record-element=DET_AZIMUTH_137, system-signal=DET_AZIMUTH_137}, {application-record-element=DET_AZIMUTH_138, system-signal=DET_AZIMUTH_138}, {application-record-element=DET_AZIMUTH_139, system-signal=DET_AZIMUTH_139}, {application-record-element=DET_AZIMUTH_140, system-signal=DET_AZIMUTH_140}, {application-record-element=DET_AZIMUTH_ERR_137, system-signal=DET_AZIMUTH_ERR_137}, {application-record-element=DET_AZIMUTH_ERR_138, system-signal=DET_AZIMUTH_ERR_138}, {application-record-element=DET_AZIMUTH_ERR_139, system-signal=DET_AZIMUTH_ERR_139}, {application-record-element=DET_AZIMUTH_ERR_140, system-signal=DET_AZIMUTH_ERR_140}, {application-record-element=DET_BELOW_RAIN_THOLD_137, system-signal=DET_BELOW_RAIN_THOLD_137}, {application-record-element=DET_BELOW_RAIN_THOLD_138, system-signal=DET_BELOW_RAIN_THOLD_138}, {application-record-element=DET_BELOW_RAIN_THOLD_139, system-signal=DET_BELOW_RAIN_THOLD_139}, {application-record-element=DET_BELOW_RAIN_THOLD_140, system-signal=DET_BELOW_RAIN_THOLD_140}, {application-record-element=DET_BI_STATIC_FLAG_137, system-signal=DET_BI_STATIC_FLAG_137}, {application-record-element=DET_BI_STATIC_FLAG_138, system-signal=DET_BI_STATIC_FLAG_138}, {application-record-element=DET_BI_STATIC_FLAG_139, system-signal=DET_BI_STATIC_FLAG_139}, {application-record-element=DET_BI_STATIC_FLAG_140, system-signal=DET_BI_STATIC_FLAG_140}, {application-record-element=DET_CONFD_AZIMUTH_137, system-signal=DET_CONFD_AZIMUTH_137}, {application-record-element=DET_CONFD_AZIMUTH_138, system-signal=DET_CONFD_AZIMUTH_138}, {application-record-element=DET_CONFD_AZIMUTH_139, system-signal=DET_CONFD_AZIMUTH_139}, {application-record-element=DET_CONFD_AZIMUTH_140, system-signal=DET_CONFD_AZIMUTH_140}, {application-record-element=DET_CONFD_ELEVATION_137, system-signal=DET_CONFD_ELEVATION_137}, {application-record-element=DET_CONFD_ELEVATION_138, system-signal=DET_CONFD_ELEVATION_138}, {application-record-element=DET_CONFD_ELEVATION_139, system-signal=DET_CONFD_ELEVATION_139}, {application-record-element=DET_CONFD_ELEVATION_140, system-signal=DET_CONFD_ELEVATION_140}, {application-record-element=DET_ELEVATION_137, system-signal=DET_ELEVATION_137}, {application-record-element=DET_ELEVATION_138, system-signal=DET_ELEVATION_138}, {application-record-element=DET_ELEVATION_139, system-signal=DET_ELEVATION_139}, {application-record-element=DET_ELEVATION_140, system-signal=DET_ELEVATION_140}, {application-record-element=DET_ELEVATION_ERR_137, system-signal=DET_ELEVATION_ERR_137}, {application-record-element=DET_ELEVATION_ERR_138, system-signal=DET_ELEVATION_ERR_138}, {application-record-element=DET_ELEVATION_ERR_139, system-signal=DET_ELEVATION_ERR_139}, {application-record-element=DET_ELEVATION_ERR_140, system-signal=DET_ELEVATION_ERR_140}, {application-record-element=DET_EXISTENCE_PROB_137, system-signal=DET_EXISTENCE_PROB_137}, {application-record-element=DET_EXISTENCE_PROB_138, system-signal=DET_EXISTENCE_PROB_138}, {application-record-element=DET_EXISTENCE_PROB_139, system-signal=DET_EXISTENCE_PROB_139}, {application-record-element=DET_EXISTENCE_PROB_140, system-signal=DET_EXISTENCE_PROB_140}, {application-record-element=DET_HVC_FLAG_137, system-signal=DET_HVC_FLAG_137}, {application-record-element=DET_HVC_FLAG_138, system-signal=DET_HVC_FLAG_138}, {application-record-element=DET_HVC_FLAG_139, system-signal=DET_HVC_FLAG_139}, {application-record-element=DET_HVC_FLAG_140, system-signal=DET_HVC_FLAG_140}, {application-record-element=DET_IDM_137, system-signal=DET_IDM_137}, {application-record-element=DET_IDM_138, system-signal=DET_IDM_138}, {application-record-element=DET_IDM_139, system-signal=DET_IDM_139}, {application-record-element=DET_IDM_140, system-signal=DET_IDM_140}, {application-record-element=DET_MH_CRC16_137_140, system-signal=DET_MH_CRC16_137_140}, {application-record-element=DET_MH_CYCLE_COUNTER_137_140, system-signal=DET_MH_CYCLE_COUNTER_137_140}, {application-record-element=DET_MH_SCAN_INDEX_4LSB_137_140, system-signal=DET_MH_SCAN_INDEX_4LSB_137_140}, {application-record-element=DET_MTD_137, system-signal=DET_MTD_137}, {application-record-element=DET_MTD_138, system-signal=DET_MTD_138}, {application-record-element=DET_MTD_139, system-signal=DET_MTD_139}, {application-record-element=DET_MTD_140, system-signal=DET_MTD_140}, {application-record-element=DET_PROB_1STAZHYPO_137, system-signal=DET_PROB_1STAZHYPO_137}, {application-record-element=DET_PROB_1STAZHYPO_138, system-signal=DET_PROB_1STAZHYPO_138}, {application-record-element=DET_PROB_1STAZHYPO_139, system-signal=DET_PROB_1STAZHYPO_139}, {application-record-element=DET_PROB_1STAZHYPO_140, system-signal=DET_PROB_1STAZHYPO_140}, {application-record-element=DET_RANGE_137, system-signal=DET_RANGE_137}, {application-record-element=DET_RANGE_138, system-signal=DET_RANGE_138}, {application-record-element=DET_RANGE_139, system-signal=DET_RANGE_139}, {application-record-element=DET_RANGE_140, system-signal=DET_RANGE_140}, {application-record-element=DET_RANGE_ERR_137, system-signal=DET_RANGE_ERR_137}, {application-record-element=DET_RANGE_ERR_138, system-signal=DET_RANGE_ERR_138}, {application-record-element=DET_RANGE_ERR_139, system-signal=DET_RANGE_ERR_139}, {application-record-element=DET_RANGE_ERR_140, system-signal=DET_RANGE_ERR_140}, {application-record-element=DET_RANGE_VELOCITY_137, system-signal=DET_RANGE_VELOCITY_137}, {application-record-element=DET_RANGE_VELOCITY_138, system-signal=DET_RANGE_VELOCITY_138}, {application-record-element=DET_RANGE_VELOCITY_139, system-signal=DET_RANGE_VELOCITY_139}, {application-record-element=DET_RANGE_VELOCITY_140, system-signal=DET_RANGE_VELOCITY_140}, {application-record-element=DET_RANGE_VELOCITY_ERR_137, system-signal=DET_RANGE_VELOCITY_ERR_137}, {application-record-element=DET_RANGE_VELOCITY_ERR_138, system-signal=DET_RANGE_VELOCITY_ERR_138}, {application-record-element=DET_RANGE_VELOCITY_ERR_139, system-signal=DET_RANGE_VELOCITY_ERR_139}, {application-record-element=DET_RANGE_VELOCITY_ERR_140, system-signal=DET_RANGE_VELOCITY_ERR_140}, {application-record-element=DET_RCS_137, system-signal=DET_RCS_137}, {application-record-element=DET_RCS_138, system-signal=DET_RCS_138}, {application-record-element=DET_RCS_139, system-signal=DET_RCS_139}, {application-record-element=DET_RCS_140, system-signal=DET_RCS_140}, {application-record-element=DET_SNR_137, system-signal=DET_SNR_137}, {application-record-element=DET_SNR_138, system-signal=DET_SNR_138}, {application-record-element=DET_SNR_139, system-signal=DET_SNR_139}, {application-record-element=DET_SNR_140, system-signal=DET_SNR_140}, {application-record-element=DET_SUPER_RES_TARGET_137, system-signal=DET_SUPER_RES_TARGET_137}, {application-record-element=DET_SUPER_RES_TARGET_138, system-signal=DET_SUPER_RES_TARGET_138}, {application-record-element=DET_SUPER_RES_TARGET_139, system-signal=DET_SUPER_RES_TARGET_139}, {application-record-element=DET_SUPER_RES_TARGET_140, system-signal=DET_SUPER_RES_TARGET_140}]}
        sender-receiver-to-signal-group-mapping={data-element=COMPOSITIONTYPE.Pp_SG_Detections_141_144_AL.Vdp_SG_Detections_141_144_AL, signal-group=SG_Detections_141_144, type-mapping=sender-rec-record-type-mapping=record-element-mappings=[{application-record-element=DET_AZIMUTH_141, system-signal=DET_AZIMUTH_141}, {application-record-element=DET_AZIMUTH_142, system-signal=DET_AZIMUTH_142}, {application-record-element=DET_AZIMUTH_143, system-signal=DET_AZIMUTH_143}, {application-record-element=DET_AZIMUTH_144, system-signal=DET_AZIMUTH_144}, {application-record-element=DET_AZIMUTH_ERR_141, system-signal=DET_AZIMUTH_ERR_141}, {application-record-element=DET_AZIMUTH_ERR_142, system-signal=DET_AZIMUTH_ERR_142}, {application-record-element=DET_AZIMUTH_ERR_143, system-signal=DET_AZIMUTH_ERR_143}, {application-record-element=DET_AZIMUTH_ERR_144, system-signal=DET_AZIMUTH_ERR_144}, {application-record-element=DET_BELOW_RAIN_THOLD_141, system-signal=DET_BELOW_RAIN_THOLD_141}, {application-record-element=DET_BELOW_RAIN_THOLD_142, system-signal=DET_BELOW_RAIN_THOLD_142}, {application-record-element=DET_BELOW_RAIN_THOLD_143, system-signal=DET_BELOW_RAIN_THOLD_143}, {application-record-element=DET_BELOW_RAIN_THOLD_144, system-signal=DET_BELOW_RAIN_THOLD_144}, {application-record-element=DET_BI_STATIC_FLAG_141, system-signal=DET_BI_STATIC_FLAG_141}, {application-record-element=DET_BI_STATIC_FLAG_142, system-signal=DET_BI_STATIC_FLAG_142}, {application-record-element=DET_BI_STATIC_FLAG_143, system-signal=DET_BI_STATIC_FLAG_143}, {application-record-element=DET_BI_STATIC_FLAG_144, system-signal=DET_BI_STATIC_FLAG_144}, {application-record-element=DET_CONFD_AZIMUTH_141, system-signal=DET_CONFD_AZIMUTH_141}, {application-record-element=DET_CONFD_AZIMUTH_142, system-signal=DET_CONFD_AZIMUTH_142}, {application-record-element=DET_CONFD_AZIMUTH_143, system-signal=DET_CONFD_AZIMUTH_143}, {application-record-element=DET_CONFD_AZIMUTH_144, system-signal=DET_CONFD_AZIMUTH_144}, {application-record-element=DET_CONFD_ELEVATION_141, system-signal=DET_CONFD_ELEVATION_141}, {application-record-element=DET_CONFD_ELEVATION_142, system-signal=DET_CONFD_ELEVATION_142}, {application-record-element=DET_CONFD_ELEVATION_143, system-signal=DET_CONFD_ELEVATION_143}, {application-record-element=DET_CONFD_ELEVATION_144, system-signal=DET_CONFD_ELEVATION_144}, {application-record-element=DET_ELEVATION_141, system-signal=DET_ELEVATION_141}, {application-record-element=DET_ELEVATION_142, system-signal=DET_ELEVATION_142}, {application-record-element=DET_ELEVATION_143, system-signal=DET_ELEVATION_143}, {application-record-element=DET_ELEVATION_144, system-signal=DET_ELEVATION_144}, {application-record-element=DET_ELEVATION_ERR_141, system-signal=DET_ELEVATION_ERR_141}, {application-record-element=DET_ELEVATION_ERR_142, system-signal=DET_ELEVATION_ERR_142}, {application-record-element=DET_ELEVATION_ERR_143, system-signal=DET_ELEVATION_ERR_143}, {application-record-element=DET_ELEVATION_ERR_144, system-signal=DET_ELEVATION_ERR_144}, {application-record-element=DET_EXISTENCE_PROB_141, system-signal=DET_EXISTENCE_PROB_141}, {application-record-element=DET_EXISTENCE_PROB_142, system-signal=DET_EXISTENCE_PROB_142}, {application-record-element=DET_EXISTENCE_PROB_143, system-signal=DET_EXISTENCE_PROB_143}, {application-record-element=DET_EXISTENCE_PROB_144, system-signal=DET_EXISTENCE_PROB_144}, {application-record-element=DET_HVC_FLAG_141, system-signal=DET_HVC_FLAG_141}, {application-record-element=DET_HVC_FLAG_142, system-signal=DET_HVC_FLAG_142}, {application-record-element=DET_HVC_FLAG_143, system-signal=DET_HVC_FLAG_143}, {application-record-element=DET_HVC_FLAG_144, system-signal=DET_HVC_FLAG_144}, {application-record-element=DET_IDM_141, system-signal=DET_IDM_141}, {application-record-element=DET_IDM_142, system-signal=DET_IDM_142}, {application-record-element=DET_IDM_143, system-signal=DET_IDM_143}, {application-record-element=DET_IDM_144, system-signal=DET_IDM_144}, {application-record-element=DET_MH_CRC16_141_144, system-signal=DET_MH_CRC16_141_144}, {application-record-element=DET_MH_CYCLE_COUNTER_141_144, system-signal=DET_MH_CYCLE_COUNTER_141_144}, {application-record-element=DET_MH_SCAN_INDEX_4LSB_141_144, system-signal=DET_MH_SCAN_INDEX_4LSB_141_144}, {application-record-element=DET_MTD_141, system-signal=DET_MTD_141}, {application-record-element=DET_MTD_142, system-signal=DET_MTD_142}, {application-record-element=DET_MTD_143, system-signal=DET_MTD_143}, {application-record-element=DET_MTD_144, system-signal=DET_MTD_144}, {application-record-element=DET_PROB_1STAZHYPO_141, system-signal=DET_PROB_1STAZHYPO_141}, {application-record-element=DET_PROB_1STAZHYPO_142, system-signal=DET_PROB_1STAZHYPO_142}, {application-record-element=DET_PROB_1STAZHYPO_143, system-signal=DET_PROB_1STAZHYPO_143}, {application-record-element=DET_PROB_1STAZHYPO_144, system-signal=DET_PROB_1STAZHYPO_144}, {application-record-element=DET_RANGE_141, system-signal=DET_RANGE_141}, {application-record-element=DET_RANGE_142, system-signal=DET_RANGE_142}, {application-record-element=DET_RANGE_143, system-signal=DET_RANGE_143}, {application-record-element=DET_RANGE_144, system-signal=DET_RANGE_144}, {application-record-element=DET_RANGE_ERR_141, system-signal=DET_RANGE_ERR_141}, {application-record-element=DET_RANGE_ERR_142, system-signal=DET_RANGE_ERR_142}, {application-record-element=DET_RANGE_ERR_143, system-signal=DET_RANGE_ERR_143}, {application-record-element=DET_RANGE_ERR_144, system-signal=DET_RANGE_ERR_144}, {application-record-element=DET_RANGE_VELOCITY_141, system-signal=DET_RANGE_VELOCITY_141}, {application-record-element=DET_RANGE_VELOCITY_142, system-signal=DET_RANGE_VELOCITY_142}, {application-record-element=DET_RANGE_VELOCITY_143, system-signal=DET_RANGE_VELOCITY_143}, {application-record-element=DET_RANGE_VELOCITY_144, system-signal=DET_RANGE_VELOCITY_144}, {application-record-element=DET_RANGE_VELOCITY_ERR_141, system-signal=DET_RANGE_VELOCITY_ERR_141}, {application-record-element=DET_RANGE_VELOCITY_ERR_142, system-signal=DET_RANGE_VELOCITY_ERR_142}, {application-record-element=DET_RANGE_VELOCITY_ERR_143, system-signal=DET_RANGE_VELOCITY_ERR_143}, {application-record-element=DET_RANGE_VELOCITY_ERR_144, system-signal=DET_RANGE_VELOCITY_ERR_144}, {application-record-element=DET_RCS_141, system-signal=DET_RCS_141}, {application-record-element=DET_RCS_142, system-signal=DET_RCS_142}, {application-record-element=DET_RCS_143, system-signal=DET_RCS_143}, {application-record-element=DET_RCS_144, system-signal=DET_RCS_144}, {application-record-element=DET_SNR_141, system-signal=DET_SNR_141}, {application-record-element=DET_SNR_142, system-signal=DET_SNR_142}, {application-record-element=DET_SNR_143, system-signal=DET_SNR_143}, {application-record-element=DET_SNR_144, system-signal=DET_SNR_144}, {application-record-element=DET_SUPER_RES_TARGET_141, system-signal=DET_SUPER_RES_TARGET_141}, {application-record-element=DET_SUPER_RES_TARGET_142, system-signal=DET_SUPER_RES_TARGET_142}, {application-record-element=DET_SUPER_RES_TARGET_143, system-signal=DET_SUPER_RES_TARGET_143}, {application-record-element=DET_SUPER_RES_TARGET_144, system-signal=DET_SUPER_RES_TARGET_144}]}
        sender-receiver-to-signal-group-mapping={data-element=COMPOSITIONTYPE.Pp_SG_Detections_145_148_AL.Vdp_SG_Detections_145_148_AL, signal-group=SG_Detections_145_148, type-mapping=sender-rec-record-type-mapping=record-element-mappings=[{application-record-element=DET_AZIMUTH_145, system-signal=DET_AZIMUTH_145}, {application-record-element=DET_AZIMUTH_146, system-signal=DET_AZIMUTH_146}, {application-record-element=DET_AZIMUTH_147, system-signal=DET_AZIMUTH_147}, {application-record-element=DET_AZIMUTH_148, system-signal=DET_AZIMUTH_148}, {application-record-element=DET_AZIMUTH_ERR_145, system-signal=DET_AZIMUTH_ERR_145}, {application-record-element=DET_AZIMUTH_ERR_146, system-signal=DET_AZIMUTH_ERR_146}, {application-record-element=DET_AZIMUTH_ERR_147, system-signal=DET_AZIMUTH_ERR_147}, {application-record-element=DET_AZIMUTH_ERR_148, system-signal=DET_AZIMUTH_ERR_148}, {application-record-element=DET_BELOW_RAIN_THOLD_145, system-signal=DET_BELOW_RAIN_THOLD_145}, {application-record-element=DET_BELOW_RAIN_THOLD_146, system-signal=DET_BELOW_RAIN_THOLD_146}, {application-record-element=DET_BELOW_RAIN_THOLD_147, system-signal=DET_BELOW_RAIN_THOLD_147}, {application-record-element=DET_BELOW_RAIN_THOLD_148, system-signal=DET_BELOW_RAIN_THOLD_148}, {application-record-element=DET_BI_STATIC_FLAG_145, system-signal=DET_BI_STATIC_FLAG_145}, {application-record-element=DET_BI_STATIC_FLAG_146, system-signal=DET_BI_STATIC_FLAG_146}, {application-record-element=DET_BI_STATIC_FLAG_147, system-signal=DET_BI_STATIC_FLAG_147}, {application-record-element=DET_BI_STATIC_FLAG_148, system-signal=DET_BI_STATIC_FLAG_148}, {application-record-element=DET_CONFD_AZIMUTH_145, system-signal=DET_CONFD_AZIMUTH_145}, {application-record-element=DET_CONFD_AZIMUTH_146, system-signal=DET_CONFD_AZIMUTH_146}, {application-record-element=DET_CONFD_AZIMUTH_147, system-signal=DET_CONFD_AZIMUTH_147}, {application-record-element=DET_CONFD_AZIMUTH_148, system-signal=DET_CONFD_AZIMUTH_148}, {application-record-element=DET_CONFD_ELEVATION_145, system-signal=DET_CONFD_ELEVATION_145}, {application-record-element=DET_CONFD_ELEVATION_146, system-signal=DET_CONFD_ELEVATION_146}, {application-record-element=DET_CONFD_ELEVATION_147, system-signal=DET_CONFD_ELEVATION_147}, {application-record-element=DET_CONFD_ELEVATION_148, system-signal=DET_CONFD_ELEVATION_148}, {application-record-element=DET_ELEVATION_145, system-signal=DET_ELEVATION_145}, {application-record-element=DET_ELEVATION_146, system-signal=DET_ELEVATION_146}, {application-record-element=DET_ELEVATION_147, system-signal=DET_ELEVATION_147}, {application-record-element=DET_ELEVATION_148, system-signal=DET_ELEVATION_148}, {application-record-element=DET_ELEVATION_ERR_145, system-signal=DET_ELEVATION_ERR_145}, {application-record-element=DET_ELEVATION_ERR_146, system-signal=DET_ELEVATION_ERR_146}, {application-record-element=DET_ELEVATION_ERR_147, system-signal=DET_ELEVATION_ERR_147}, {application-record-element=DET_ELEVATION_ERR_148, system-signal=DET_ELEVATION_ERR_148}, {application-record-element=DET_EXISTENCE_PROB_145, system-signal=DET_EXISTENCE_PROB_145}, {application-record-element=DET_EXISTENCE_PROB_146, system-signal=DET_EXISTENCE_PROB_146}, {application-record-element=DET_EXISTENCE_PROB_147, system-signal=DET_EXISTENCE_PROB_147}, {application-record-element=DET_EXISTENCE_PROB_148, system-signal=DET_EXISTENCE_PROB_148}, {application-record-element=DET_HVC_FLAG_145, system-signal=DET_HVC_FLAG_145}, {application-record-element=DET_HVC_FLAG_146, system-signal=DET_HVC_FLAG_146}, {application-record-element=DET_HVC_FLAG_147, system-signal=DET_HVC_FLAG_147}, {application-record-element=DET_HVC_FLAG_148, system-signal=DET_HVC_FLAG_148}, {application-record-element=DET_IDM_145, system-signal=DET_IDM_145}, {application-record-element=DET_IDM_146, system-signal=DET_IDM_146}, {application-record-element=DET_IDM_147, system-signal=DET_IDM_147}, {application-record-element=DET_IDM_148, system-signal=DET_IDM_148}, {application-record-element=DET_MH_CRC16_145_148, system-signal=DET_MH_CRC16_145_148}, {application-record-element=DET_MH_CYCLE_COUNTER_145_148, system-signal=DET_MH_CYCLE_COUNTER_145_148}, {application-record-element=DET_MH_SCAN_INDEX_4LSB_145_148, system-signal=DET_MH_SCAN_INDEX_4LSB_145_148}, {application-record-element=DET_MTD_145, system-signal=DET_MTD_145}, {application-record-element=DET_MTD_146, system-signal=DET_MTD_146}, {application-record-element=DET_MTD_147, system-signal=DET_MTD_147}, {application-record-element=DET_MTD_148, system-signal=DET_MTD_148}, {application-record-element=DET_PROB_1STAZHYPO_145, system-signal=DET_PROB_1STAZHYPO_145}, {application-record-element=DET_PROB_1STAZHYPO_146, system-signal=DET_PROB_1STAZHYPO_146}, {application-record-element=DET_PROB_1STAZHYPO_147, system-signal=DET_PROB_1STAZHYPO_147}, {application-record-element=DET_PROB_1STAZHYPO_148, system-signal=DET_PROB_1STAZHYPO_148}, {application-record-element=DET_RANGE_145, system-signal=DET_RANGE_145}, {application-record-element=DET_RANGE_146, system-signal=DET_RANGE_146}, {application-record-element=DET_RANGE_147, system-signal=DET_RANGE_147}, {application-record-element=DET_RANGE_148, system-signal=DET_RANGE_148}, {application-record-element=DET_RANGE_ERR_145, system-signal=DET_RANGE_ERR_145}, {application-record-element=DET_RANGE_ERR_146, system-signal=DET_RANGE_ERR_146}, {application-record-element=DET_RANGE_ERR_147, system-signal=DET_RANGE_ERR_147}, {application-record-element=DET_RANGE_ERR_148, system-signal=DET_RANGE_ERR_148}, {application-record-element=DET_RANGE_VELOCITY_145, system-signal=DET_RANGE_VELOCITY_145}, {application-record-element=DET_RANGE_VELOCITY_146, system-signal=DET_RANGE_VELOCITY_146}, {application-record-element=DET_RANGE_VELOCITY_147, system-signal=DET_RANGE_VELOCITY_147}, {application-record-element=DET_RANGE_VELOCITY_148, system-signal=DET_RANGE_VELOCITY_148}, {application-record-element=DET_RANGE_VELOCITY_ERR_145, system-signal=DET_RANGE_VELOCITY_ERR_145}, {application-record-element=DET_RANGE_VELOCITY_ERR_146, system-signal=DET_RANGE_VELOCITY_ERR_146}, {application-record-element=DET_RANGE_VELOCITY_ERR_147, system-signal=DET_RANGE_VELOCITY_ERR_147}, {application-record-element=DET_RANGE_VELOCITY_ERR_148, system-signal=DET_RANGE_VELOCITY_ERR_148}, {application-record-element=DET_RCS_145, system-signal=DET_RCS_145}, {application-record-element=DET_RCS_146, system-signal=DET_RCS_146}, {application-record-element=DET_RCS_147, system-signal=DET_RCS_147}, {application-record-element=DET_RCS_148, system-signal=DET_RCS_148}, {application-record-element=DET_SNR_145, system-signal=DET_SNR_145}, {application-record-element=DET_SNR_146, system-signal=DET_SNR_146}, {application-record-element=DET_SNR_147, system-signal=DET_SNR_147}, {application-record-element=DET_SNR_148, system-signal=DET_SNR_148}, {application-record-element=DET_SUPER_RES_TARGET_145, system-signal=DET_SUPER_RES_TARGET_145}, {application-record-element=DET_SUPER_RES_TARGET_146, system-signal=DET_SUPER_RES_TARGET_146}, {application-record-element=DET_SUPER_RES_TARGET_147, system-signal=DET_SUPER_RES_TARGET_147}, {application-record-element=DET_SUPER_RES_TARGET_148, system-signal=DET_SUPER_RES_TARGET_148}]}
        sender-receiver-to-signal-group-mapping={data-element=COMPOSITIONTYPE.Pp_SG_Detections_149_152_AL.Vdp_SG_Detections_149_152_AL, signal-group=SG_Detections_149_152, type-mapping=sender-rec-record-type-mapping=record-element-mappings=[{application-record-element=DET_AZIMUTH_149, system-signal=DET_AZIMUTH_149}, {application-record-element=DET_AZIMUTH_150, system-signal=DET_AZIMUTH_150}, {application-record-element=DET_AZIMUTH_151, system-signal=DET_AZIMUTH_151}, {application-record-element=DET_AZIMUTH_152, system-signal=DET_AZIMUTH_152}, {application-record-element=DET_AZIMUTH_ERR_149, system-signal=DET_AZIMUTH_ERR_149}, {application-record-element=DET_AZIMUTH_ERR_150, system-signal=DET_AZIMUTH_ERR_150}, {application-record-element=DET_AZIMUTH_ERR_151, system-signal=DET_AZIMUTH_ERR_151}, {application-record-element=DET_AZIMUTH_ERR_152, system-signal=DET_AZIMUTH_ERR_152}, {application-record-element=DET_BELOW_RAIN_THOLD_149, system-signal=DET_BELOW_RAIN_THOLD_149}, {application-record-element=DET_BELOW_RAIN_THOLD_150, system-signal=DET_BELOW_RAIN_THOLD_150}, {application-record-element=DET_BELOW_RAIN_THOLD_151, system-signal=DET_BELOW_RAIN_THOLD_151}, {application-record-element=DET_BELOW_RAIN_THOLD_152, system-signal=DET_BELOW_RAIN_THOLD_152}, {application-record-element=DET_BI_STATIC_FLAG_149, system-signal=DET_BI_STATIC_FLAG_149}, {application-record-element=DET_BI_STATIC_FLAG_150, system-signal=DET_BI_STATIC_FLAG_150}, {application-record-element=DET_BI_STATIC_FLAG_151, system-signal=DET_BI_STATIC_FLAG_151}, {application-record-element=DET_BI_STATIC_FLAG_152, system-signal=DET_BI_STATIC_FLAG_152}, {application-record-element=DET_CONFD_AZIMUTH_149, system-signal=DET_CONFD_AZIMUTH_149}, {application-record-element=DET_CONFD_AZIMUTH_150, system-signal=DET_CONFD_AZIMUTH_150}, {application-record-element=DET_CONFD_AZIMUTH_151, system-signal=DET_CONFD_AZIMUTH_151}, {application-record-element=DET_CONFD_AZIMUTH_152, system-signal=DET_CONFD_AZIMUTH_152}, {application-record-element=DET_CONFD_ELEVATION_149, system-signal=DET_CONFD_ELEVATION_149}, {application-record-element=DET_CONFD_ELEVATION_150, system-signal=DET_CONFD_ELEVATION_150}, {application-record-element=DET_CONFD_ELEVATION_151, system-signal=DET_CONFD_ELEVATION_151}, {application-record-element=DET_CONFD_ELEVATION_152, system-signal=DET_CONFD_ELEVATION_152}, {application-record-element=DET_ELEVATION_149, system-signal=DET_ELEVATION_149}, {application-record-element=DET_ELEVATION_150, system-signal=DET_ELEVATION_150}, {application-record-element=DET_ELEVATION_151, system-signal=DET_ELEVATION_151}, {application-record-element=DET_ELEVATION_152, system-signal=DET_ELEVATION_152}, {application-record-element=DET_ELEVATION_ERR_149, system-signal=DET_ELEVATION_ERR_149}, {application-record-element=DET_ELEVATION_ERR_150, system-signal=DET_ELEVATION_ERR_150}, {application-record-element=DET_ELEVATION_ERR_151, system-signal=DET_ELEVATION_ERR_151}, {application-record-element=DET_ELEVATION_ERR_152, system-signal=DET_ELEVATION_ERR_152}, {application-record-element=DET_EXISTENCE_PROB_149, system-signal=DET_EXISTENCE_PROB_149}, {application-record-element=DET_EXISTENCE_PROB_150, system-signal=DET_EXISTENCE_PROB_150}, {application-record-element=DET_EXISTENCE_PROB_151, system-signal=DET_EXISTENCE_PROB_151}, {application-record-element=DET_EXISTENCE_PROB_152, system-signal=DET_EXISTENCE_PROB_152}, {application-record-element=DET_HVC_FLAG_149, system-signal=DET_HVC_FLAG_149}, {application-record-element=DET_HVC_FLAG_150, system-signal=DET_HVC_FLAG_150}, {application-record-element=DET_HVC_FLAG_151, system-signal=DET_HVC_FLAG_151}, {application-record-element=DET_HVC_FLAG_152, system-signal=DET_HVC_FLAG_152}, {application-record-element=DET_IDM_149, system-signal=DET_IDM_149}, {application-record-element=DET_IDM_150, system-signal=DET_IDM_150}, {application-record-element=DET_IDM_151, system-signal=DET_IDM_151}, {application-record-element=DET_IDM_152, system-signal=DET_IDM_152}, {application-record-element=DET_MH_CRC16_149_152, system-signal=DET_MH_CRC16_149_152}, {application-record-element=DET_MH_CYCLE_COUNTER_149_152, system-signal=DET_MH_CYCLE_COUNTER_149_152}, {application-record-element=DET_MH_SCAN_INDEX_4LSB_149_152, system-signal=DET_MH_SCAN_INDEX_4LSB_149_152}, {application-record-element=DET_MTD_149, system-signal=DET_MTD_149}, {application-record-element=DET_MTD_150, system-signal=DET_MTD_150}, {application-record-element=DET_MTD_151, system-signal=DET_MTD_151}, {application-record-element=DET_MTD_152, system-signal=DET_MTD_152}, {application-record-element=DET_PROB_1STAZHYPO_149, system-signal=DET_PROB_1STAZHYPO_149}, {application-record-element=DET_PROB_1STAZHYPO_150, system-signal=DET_PROB_1STAZHYPO_150}, {application-record-element=DET_PROB_1STAZHYPO_151, system-signal=DET_PROB_1STAZHYPO_151}, {application-record-element=DET_PROB_1STAZHYPO_152, system-signal=DET_PROB_1STAZHYPO_152}, {application-record-element=DET_RANGE_149, system-signal=DET_RANGE_149}, {application-record-element=DET_RANGE_150, system-signal=DET_RANGE_150}, {application-record-element=DET_RANGE_151, system-signal=DET_RANGE_151}, {application-record-element=DET_RANGE_152, system-signal=DET_RANGE_152}, {application-record-element=DET_RANGE_ERR_149, system-signal=DET_RANGE_ERR_149}, {application-record-element=DET_RANGE_ERR_150, system-signal=DET_RANGE_ERR_150}, {application-record-element=DET_RANGE_ERR_151, system-signal=DET_RANGE_ERR_151}, {application-record-element=DET_RANGE_ERR_152, system-signal=DET_RANGE_ERR_152}, {application-record-element=DET_RANGE_VELOCITY_149, system-signal=DET_RANGE_VELOCITY_149}, {application-record-element=DET_RANGE_VELOCITY_150, system-signal=DET_RANGE_VELOCITY_150}, {application-record-element=DET_RANGE_VELOCITY_151, system-signal=DET_RANGE_VELOCITY_151}, {application-record-element=DET_RANGE_VELOCITY_152, system-signal=DET_RANGE_VELOCITY_152}, {application-record-element=DET_RANGE_VELOCITY_ERR_149, system-signal=DET_RANGE_VELOCITY_ERR_149}, {application-record-element=DET_RANGE_VELOCITY_ERR_150, system-signal=DET_RANGE_VELOCITY_ERR_150}, {application-record-element=DET_RANGE_VELOCITY_ERR_151, system-signal=DET_RANGE_VELOCITY_ERR_151}, {application-record-element=DET_RANGE_VELOCITY_ERR_152, system-signal=DET_RANGE_VELOCITY_ERR_152}, {application-record-element=DET_RCS_149, system-signal=DET_RCS_149}, {application-record-element=DET_RCS_150, system-signal=DET_RCS_150}, {application-record-element=DET_RCS_151, system-signal=DET_RCS_151}, {application-record-element=DET_RCS_152, system-signal=DET_RCS_152}, {application-record-element=DET_SNR_149, system-signal=DET_SNR_149}, {application-record-element=DET_SNR_150, system-signal=DET_SNR_150}, {application-record-element=DET_SNR_151, system-signal=DET_SNR_151}, {application-record-element=DET_SNR_152, system-signal=DET_SNR_152}, {application-record-element=DET_SUPER_RES_TARGET_149, system-signal=DET_SUPER_RES_TARGET_149}, {application-record-element=DET_SUPER_RES_TARGET_150, system-signal=DET_SUPER_RES_TARGET_150}, {application-record-element=DET_SUPER_RES_TARGET_151, system-signal=DET_SUPER_RES_TARGET_151}, {application-record-element=DET_SUPER_RES_TARGET_152, system-signal=DET_SUPER_RES_TARGET_152}]}
        sender-receiver-to-signal-group-mapping={data-element=COMPOSITIONTYPE.Pp_SG_Detections_153_156_AL.Vdp_SG_Detections_153_156_AL, signal-group=SG_Detections_153_156, type-mapping=sender-rec-record-type-mapping=record-element-mappings=[{application-record-element=DET_AZIMUTH_153, system-signal=DET_AZIMUTH_153}, {application-record-element=DET_AZIMUTH_154, system-signal=DET_AZIMUTH_154}, {application-record-element=DET_AZIMUTH_155, system-signal=DET_AZIMUTH_155}, {application-record-element=DET_AZIMUTH_156, system-signal=DET_AZIMUTH_156}, {application-record-element=DET_AZIMUTH_ERR_153, system-signal=DET_AZIMUTH_ERR_153}, {application-record-element=DET_AZIMUTH_ERR_154, system-signal=DET_AZIMUTH_ERR_154}, {application-record-element=DET_AZIMUTH_ERR_155, system-signal=DET_AZIMUTH_ERR_155}, {application-record-element=DET_AZIMUTH_ERR_156, system-signal=DET_AZIMUTH_ERR_156}, {application-record-element=DET_BELOW_RAIN_THOLD_153, system-signal=DET_BELOW_RAIN_THOLD_153}, {application-record-element=DET_BELOW_RAIN_THOLD_154, system-signal=DET_BELOW_RAIN_THOLD_154}, {application-record-element=DET_BELOW_RAIN_THOLD_155, system-signal=DET_BELOW_RAIN_THOLD_155}, {application-record-element=DET_BELOW_RAIN_THOLD_156, system-signal=DET_BELOW_RAIN_THOLD_156}, {application-record-element=DET_BI_STATIC_FLAG_153, system-signal=DET_BI_STATIC_FLAG_153}, {application-record-element=DET_BI_STATIC_FLAG_154, system-signal=DET_BI_STATIC_FLAG_154}, {application-record-element=DET_BI_STATIC_FLAG_155, system-signal=DET_BI_STATIC_FLAG_155}, {application-record-element=DET_BI_STATIC_FLAG_156, system-signal=DET_BI_STATIC_FLAG_156}, {application-record-element=DET_CONFD_AZIMUTH_153, system-signal=DET_CONFD_AZIMUTH_153}, {application-record-element=DET_CONFD_AZIMUTH_154, system-signal=DET_CONFD_AZIMUTH_154}, {application-record-element=DET_CONFD_AZIMUTH_155, system-signal=DET_CONFD_AZIMUTH_155}, {application-record-element=DET_CONFD_AZIMUTH_156, system-signal=DET_CONFD_AZIMUTH_156}, {application-record-element=DET_CONFD_ELEVATION_153, system-signal=DET_CONFD_ELEVATION_153}, {application-record-element=DET_CONFD_ELEVATION_154, system-signal=DET_CONFD_ELEVATION_154}, {application-record-element=DET_CONFD_ELEVATION_155, system-signal=DET_CONFD_ELEVATION_155}, {application-record-element=DET_CONFD_ELEVATION_156, system-signal=DET_CONFD_ELEVATION_156}, {application-record-element=DET_ELEVATION_153, system-signal=DET_ELEVATION_153}, {application-record-element=DET_ELEVATION_154, system-signal=DET_ELEVATION_154}, {application-record-element=DET_ELEVATION_155, system-signal=DET_ELEVATION_155}, {application-record-element=DET_ELEVATION_156, system-signal=DET_ELEVATION_156}, {application-record-element=DET_ELEVATION_ERR_153, system-signal=DET_ELEVATION_ERR_153}, {application-record-element=DET_ELEVATION_ERR_154, system-signal=DET_ELEVATION_ERR_154}, {application-record-element=DET_ELEVATION_ERR_155, system-signal=DET_ELEVATION_ERR_155}, {application-record-element=DET_ELEVATION_ERR_156, system-signal=DET_ELEVATION_ERR_156}, {application-record-element=DET_EXISTENCE_PROB_153, system-signal=DET_EXISTENCE_PROB_153}, {application-record-element=DET_EXISTENCE_PROB_154, system-signal=DET_EXISTENCE_PROB_154}, {application-record-element=DET_EXISTENCE_PROB_155, system-signal=DET_EXISTENCE_PROB_155}, {application-record-element=DET_EXISTENCE_PROB_156, system-signal=DET_EXISTENCE_PROB_156}, {application-record-element=DET_HVC_FLAG_153, system-signal=DET_HVC_FLAG_153}, {application-record-element=DET_HVC_FLAG_154, system-signal=DET_HVC_FLAG_154}, {application-record-element=DET_HVC_FLAG_155, system-signal=DET_HVC_FLAG_155}, {application-record-element=DET_HVC_FLAG_156, system-signal=DET_HVC_FLAG_156}, {application-record-element=DET_IDM_153, system-signal=DET_IDM_153}, {application-record-element=DET_IDM_154, system-signal=DET_IDM_154}, {application-record-element=DET_IDM_155, system-signal=DET_IDM_155}, {application-record-element=DET_IDM_156, system-signal=DET_IDM_156}, {application-record-element=DET_MH_CRC16_153_156, system-signal=DET_MH_CRC16_153_156}, {application-record-element=DET_MH_CYCLE_COUNTER_153_156, system-signal=DET_MH_CYCLE_COUNTER_153_156}, {application-record-element=DET_MH_SCAN_INDEX_4LSB_153_156, system-signal=DET_MH_SCAN_INDEX_4LSB_153_156}, {application-record-element=DET_MTD_153, system-signal=DET_MTD_153}, {application-record-element=DET_MTD_154, system-signal=DET_MTD_154}, {application-record-element=DET_MTD_155, system-signal=DET_MTD_155}, {application-record-element=DET_MTD_156, system-signal=DET_MTD_156}, {application-record-element=DET_PROB_1STAZHYPO_153, system-signal=DET_PROB_1STAZHYPO_153}, {application-record-element=DET_PROB_1STAZHYPO_154, system-signal=DET_PROB_1STAZHYPO_154}, {application-record-element=DET_PROB_1STAZHYPO_155, system-signal=DET_PROB_1STAZHYPO_155}, {application-record-element=DET_PROB_1STAZHYPO_156, system-signal=DET_PROB_1STAZHYPO_156}, {application-record-element=DET_RANGE_153, system-signal=DET_RANGE_153}, {application-record-element=DET_RANGE_154, system-signal=DET_RANGE_154}, {application-record-element=DET_RANGE_155, system-signal=DET_RANGE_155}, {application-record-element=DET_RANGE_156, system-signal=DET_RANGE_156}, {application-record-element=DET_RANGE_ERR_153, system-signal=DET_RANGE_ERR_153}, {application-record-element=DET_RANGE_ERR_154, system-signal=DET_RANGE_ERR_154}, {application-record-element=DET_RANGE_ERR_155, system-signal=DET_RANGE_ERR_155}, {application-record-element=DET_RANGE_ERR_156, system-signal=DET_RANGE_ERR_156}, {application-record-element=DET_RANGE_VELOCITY_153, system-signal=DET_RANGE_VELOCITY_153}, {application-record-element=DET_RANGE_VELOCITY_154, system-signal=DET_RANGE_VELOCITY_154}, {application-record-element=DET_RANGE_VELOCITY_155, system-signal=DET_RANGE_VELOCITY_155}, {application-record-element=DET_RANGE_VELOCITY_156, system-signal=DET_RANGE_VELOCITY_156}, {application-record-element=DET_RANGE_VELOCITY_ERR_153, system-signal=DET_RANGE_VELOCITY_ERR_153}, {application-record-element=DET_RANGE_VELOCITY_ERR_154, system-signal=DET_RANGE_VELOCITY_ERR_154}, {application-record-element=DET_RANGE_VELOCITY_ERR_155, system-signal=DET_RANGE_VELOCITY_ERR_155}, {application-record-element=DET_RANGE_VELOCITY_ERR_156, system-signal=DET_RANGE_VELOCITY_ERR_156}, {application-record-element=DET_RCS_153, system-signal=DET_RCS_153}, {application-record-element=DET_RCS_154, system-signal=DET_RCS_154}, {application-record-element=DET_RCS_155, system-signal=DET_RCS_155}, {application-record-element=DET_RCS_156, system-signal=DET_RCS_156}, {application-record-element=DET_SNR_153, system-signal=DET_SNR_153}, {application-record-element=DET_SNR_154, system-signal=DET_SNR_154}, {application-record-element=DET_SNR_155, system-signal=DET_SNR_155}, {application-record-element=DET_SNR_156, system-signal=DET_SNR_156}, {application-record-element=DET_SUPER_RES_TARGET_153, system-signal=DET_SUPER_RES_TARGET_153}, {application-record-element=DET_SUPER_RES_TARGET_154, system-signal=DET_SUPER_RES_TARGET_154}, {application-record-element=DET_SUPER_RES_TARGET_155, system-signal=DET_SUPER_RES_TARGET_155}, {application-record-element=DET_SUPER_RES_TARGET_156, system-signal=DET_SUPER_RES_TARGET_156}]}
        sender-receiver-to-signal-group-mapping={data-element=COMPOSITIONTYPE.Pp_SG_Detections_157_160_AL.Vdp_SG_Detections_157_160_AL, signal-group=SG_Detections_157_160, type-mapping=sender-rec-record-type-mapping=record-element-mappings=[{application-record-element=DET_AZIMUTH_157, system-signal=DET_AZIMUTH_157}, {application-record-element=DET_AZIMUTH_158, system-signal=DET_AZIMUTH_158}, {application-record-element=DET_AZIMUTH_159, system-signal=DET_AZIMUTH_159}, {application-record-element=DET_AZIMUTH_160, system-signal=DET_AZIMUTH_160}, {application-record-element=DET_AZIMUTH_ERR_157, system-signal=DET_AZIMUTH_ERR_157}, {application-record-element=DET_AZIMUTH_ERR_158, system-signal=DET_AZIMUTH_ERR_158}, {application-record-element=DET_AZIMUTH_ERR_159, system-signal=DET_AZIMUTH_ERR_159}, {application-record-element=DET_AZIMUTH_ERR_160, system-signal=DET_AZIMUTH_ERR_160}, {application-record-element=DET_BELOW_RAIN_THOLD_157, system-signal=DET_BELOW_RAIN_THOLD_157}, {application-record-element=DET_BELOW_RAIN_THOLD_158, system-signal=DET_BELOW_RAIN_THOLD_158}, {application-record-element=DET_BELOW_RAIN_THOLD_159, system-signal=DET_BELOW_RAIN_THOLD_159}, {application-record-element=DET_BELOW_RAIN_THOLD_160, system-signal=DET_BELOW_RAIN_THOLD_160}, {application-record-element=DET_BI_STATIC_FLAG_157, system-signal=DET_BI_STATIC_FLAG_157}, {application-record-element=DET_BI_STATIC_FLAG_158, system-signal=DET_BI_STATIC_FLAG_158}, {application-record-element=DET_BI_STATIC_FLAG_159, system-signal=DET_BI_STATIC_FLAG_159}, {application-record-element=DET_BI_STATIC_FLAG_160, system-signal=DET_BI_STATIC_FLAG_160}, {application-record-element=DET_CONFD_AZIMUTH_157, system-signal=DET_CONFD_AZIMUTH_157}, {application-record-element=DET_CONFD_AZIMUTH_158, system-signal=DET_CONFD_AZIMUTH_158}, {application-record-element=DET_CONFD_AZIMUTH_159, system-signal=DET_CONFD_AZIMUTH_159}, {application-record-element=DET_CONFD_AZIMUTH_160, system-signal=DET_CONFD_AZIMUTH_160}, {application-record-element=DET_CONFD_ELEVATION_157, system-signal=DET_CONFD_ELEVATION_157}, {application-record-element=DET_CONFD_ELEVATION_158, system-signal=DET_CONFD_ELEVATION_158}, {application-record-element=DET_CONFD_ELEVATION_159, system-signal=DET_CONFD_ELEVATION_159}, {application-record-element=DET_CONFD_ELEVATION_160, system-signal=DET_CONFD_ELEVATION_160}, {application-record-element=DET_ELEVATION_157, system-signal=DET_ELEVATION_157}, {application-record-element=DET_ELEVATION_158, system-signal=DET_ELEVATION_158}, {application-record-element=DET_ELEVATION_159, system-signal=DET_ELEVATION_159}, {application-record-element=DET_ELEVATION_160, system-signal=DET_ELEVATION_160}, {application-record-element=DET_ELEVATION_ERR_157, system-signal=DET_ELEVATION_ERR_157}, {application-record-element=DET_ELEVATION_ERR_158, system-signal=DET_ELEVATION_ERR_158}, {application-record-element=DET_ELEVATION_ERR_159, system-signal=DET_ELEVATION_ERR_159}, {application-record-element=DET_ELEVATION_ERR_160, system-signal=DET_ELEVATION_ERR_160}, {application-record-element=DET_EXISTENCE_PROB_157, system-signal=DET_EXISTENCE_PROB_157}, {application-record-element=DET_EXISTENCE_PROB_158, system-signal=DET_EXISTENCE_PROB_158}, {application-record-element=DET_EXISTENCE_PROB_159, system-signal=DET_EXISTENCE_PROB_159}, {application-record-element=DET_EXISTENCE_PROB_160, system-signal=DET_EXISTENCE_PROB_160}, {application-record-element=DET_HVC_FLAG_157, system-signal=DET_HVC_FLAG_157}, {application-record-element=DET_HVC_FLAG_158, system-signal=DET_HVC_FLAG_158}, {application-record-element=DET_HVC_FLAG_159, system-signal=DET_HVC_FLAG_159}, {application-record-element=DET_HVC_FLAG_160, system-signal=DET_HVC_FLAG_160}, {application-record-element=DET_IDM_157, system-signal=DET_IDM_157}, {application-record-element=DET_IDM_158, system-signal=DET_IDM_158}, {application-record-element=DET_IDM_159, system-signal=DET_IDM_159}, {application-record-element=DET_IDM_160, system-signal=DET_IDM_160}, {application-record-element=DET_MH_CRC16_157_160, system-signal=DET_MH_CRC16_157_160}, {application-record-element=DET_MH_CYCLE_COUNTER_157_160, system-signal=DET_MH_CYCLE_COUNTER_157_160}, {application-record-element=DET_MH_SCAN_INDEX_4LSB_157_160, system-signal=DET_MH_SCAN_INDEX_4LSB_157_160}, {application-record-element=DET_MTD_157, system-signal=DET_MTD_157}, {application-record-element=DET_MTD_158, system-signal=DET_MTD_158}, {application-record-element=DET_MTD_159, system-signal=DET_MTD_159}, {application-record-element=DET_MTD_160, system-signal=DET_MTD_160}, {application-record-element=DET_PROB_1STAZHYPO_157, system-signal=DET_PROB_1STAZHYPO_157}, {application-record-element=DET_PROB_1STAZHYPO_158, system-signal=DET_PROB_1STAZHYPO_158}, {application-record-element=DET_PROB_1STAZHYPO_159, system-signal=DET_PROB_1STAZHYPO_159}, {application-record-element=DET_PROB_1STAZHYPO_160, system-signal=DET_PROB_1STAZHYPO_160}, {application-record-element=DET_RANGE_157, system-signal=DET_RANGE_157}, {application-record-element=DET_RANGE_158, system-signal=DET_RANGE_158}, {application-record-element=DET_RANGE_159, system-signal=DET_RANGE_159}, {application-record-element=DET_RANGE_160, system-signal=DET_RANGE_160}, {application-record-element=DET_RANGE_ERR_157, system-signal=DET_RANGE_ERR_157}, {application-record-element=DET_RANGE_ERR_158, system-signal=DET_RANGE_ERR_158}, {application-record-element=DET_RANGE_ERR_159, system-signal=DET_RANGE_ERR_159}, {application-record-element=DET_RANGE_ERR_160, system-signal=DET_RANGE_ERR_160}, {application-record-element=DET_RANGE_VELOCITY_157, system-signal=DET_RANGE_VELOCITY_157}, {application-record-element=DET_RANGE_VELOCITY_158, system-signal=DET_RANGE_VELOCITY_158}, {application-record-element=DET_RANGE_VELOCITY_159, system-signal=DET_RANGE_VELOCITY_159}, {application-record-element=DET_RANGE_VELOCITY_160, system-signal=DET_RANGE_VELOCITY_160}, {application-record-element=DET_RANGE_VELOCITY_ERR_157, system-signal=DET_RANGE_VELOCITY_ERR_157}, {application-record-element=DET_RANGE_VELOCITY_ERR_158, system-signal=DET_RANGE_VELOCITY_ERR_158}, {application-record-element=DET_RANGE_VELOCITY_ERR_159, system-signal=DET_RANGE_VELOCITY_ERR_159}, {application-record-element=DET_RANGE_VELOCITY_ERR_160, system-signal=DET_RANGE_VELOCITY_ERR_160}, {application-record-element=DET_RCS_157, system-signal=DET_RCS_157}, {application-record-element=DET_RCS_158, system-signal=DET_RCS_158}, {application-record-element=DET_RCS_159, system-signal=DET_RCS_159}, {application-record-element=DET_RCS_160, system-signal=DET_RCS_160}, {application-record-element=DET_SNR_157, system-signal=DET_SNR_157}, {application-record-element=DET_SNR_158, system-signal=DET_SNR_158}, {application-record-element=DET_SNR_159, system-signal=DET_SNR_159}, {application-record-element=DET_SNR_160, system-signal=DET_SNR_160}, {application-record-element=DET_SUPER_RES_TARGET_157, system-signal=DET_SUPER_RES_TARGET_157}, {application-record-element=DET_SUPER_RES_TARGET_158, system-signal=DET_SUPER_RES_TARGET_158}, {application-record-element=DET_SUPER_RES_TARGET_159, system-signal=DET_SUPER_RES_TARGET_159}, {application-record-element=DET_SUPER_RES_TARGET_160, system-signal=DET_SUPER_RES_TARGET_160}]}
        sender-receiver-to-signal-group-mapping={data-element=COMPOSITIONTYPE.Pp_SG_Detections_161_164_AL.Vdp_SG_Detections_161_164_AL, signal-group=SG_Detections_161_164, type-mapping=sender-rec-record-type-mapping=record-element-mappings=[{application-record-element=DET_AZIMUTH_161, system-signal=DET_AZIMUTH_161}, {application-record-element=DET_AZIMUTH_162, system-signal=DET_AZIMUTH_162}, {application-record-element=DET_AZIMUTH_163, system-signal=DET_AZIMUTH_163}, {application-record-element=DET_AZIMUTH_164, system-signal=DET_AZIMUTH_164}, {application-record-element=DET_AZIMUTH_ERR_161, system-signal=DET_AZIMUTH_ERR_161}, {application-record-element=DET_AZIMUTH_ERR_162, system-signal=DET_AZIMUTH_ERR_162}, {application-record-element=DET_AZIMUTH_ERR_163, system-signal=DET_AZIMUTH_ERR_163}, {application-record-element=DET_AZIMUTH_ERR_164, system-signal=DET_AZIMUTH_ERR_164}, {application-record-element=DET_BELOW_RAIN_THOLD_161, system-signal=DET_BELOW_RAIN_THOLD_161}, {application-record-element=DET_BELOW_RAIN_THOLD_162, system-signal=DET_BELOW_RAIN_THOLD_162}, {application-record-element=DET_BELOW_RAIN_THOLD_163, system-signal=DET_BELOW_RAIN_THOLD_163}, {application-record-element=DET_BELOW_RAIN_THOLD_164, system-signal=DET_BELOW_RAIN_THOLD_164}, {application-record-element=DET_BI_STATIC_FLAG_161, system-signal=DET_BI_STATIC_FLAG_161}, {application-record-element=DET_BI_STATIC_FLAG_162, system-signal=DET_BI_STATIC_FLAG_162}, {application-record-element=DET_BI_STATIC_FLAG_163, system-signal=DET_BI_STATIC_FLAG_163}, {application-record-element=DET_BI_STATIC_FLAG_164, system-signal=DET_BI_STATIC_FLAG_164}, {application-record-element=DET_CONFD_AZIMUTH_161, system-signal=DET_CONFD_AZIMUTH_161}, {application-record-element=DET_CONFD_AZIMUTH_162, system-signal=DET_CONFD_AZIMUTH_162}, {application-record-element=DET_CONFD_AZIMUTH_163, system-signal=DET_CONFD_AZIMUTH_163}, {application-record-element=DET_CONFD_AZIMUTH_164, system-signal=DET_CONFD_AZIMUTH_164}, {application-record-element=DET_CONFD_ELEVATION_161, system-signal=DET_CONFD_ELEVATION_161}, {application-record-element=DET_CONFD_ELEVATION_162, system-signal=DET_CONFD_ELEVATION_162}, {application-record-element=DET_CONFD_ELEVATION_163, system-signal=DET_CONFD_ELEVATION_163}, {application-record-element=DET_CONFD_ELEVATION_164, system-signal=DET_CONFD_ELEVATION_164}, {application-record-element=DET_ELEVATION_161, system-signal=DET_ELEVATION_161}, {application-record-element=DET_ELEVATION_162, system-signal=DET_ELEVATION_162}, {application-record-element=DET_ELEVATION_163, system-signal=DET_ELEVATION_163}, {application-record-element=DET_ELEVATION_164, system-signal=DET_ELEVATION_164}, {application-record-element=DET_ELEVATION_ERR_161, system-signal=DET_ELEVATION_ERR_161}, {application-record-element=DET_ELEVATION_ERR_162, system-signal=DET_ELEVATION_ERR_162}, {application-record-element=DET_ELEVATION_ERR_163, system-signal=DET_ELEVATION_ERR_163}, {application-record-element=DET_ELEVATION_ERR_164, system-signal=DET_ELEVATION_ERR_164}, {application-record-element=DET_EXISTENCE_PROB_161, system-signal=DET_EXISTENCE_PROB_161}, {application-record-element=DET_EXISTENCE_PROB_162, system-signal=DET_EXISTENCE_PROB_162}, {application-record-element=DET_EXISTENCE_PROB_163, system-signal=DET_EXISTENCE_PROB_163}, {application-record-element=DET_EXISTENCE_PROB_164, system-signal=DET_EXISTENCE_PROB_164}, {application-record-element=DET_HVC_FLAG_161, system-signal=DET_HVC_FLAG_161}, {application-record-element=DET_HVC_FLAG_162, system-signal=DET_HVC_FLAG_162}, {application-record-element=DET_HVC_FLAG_163, system-signal=DET_HVC_FLAG_163}, {application-record-element=DET_HVC_FLAG_164, system-signal=DET_HVC_FLAG_164}, {application-record-element=DET_IDM_161, system-signal=DET_IDM_161}, {application-record-element=DET_IDM_162, system-signal=DET_IDM_162}, {application-record-element=DET_IDM_163, system-signal=DET_IDM_163}, {application-record-element=DET_IDM_164, system-signal=DET_IDM_164}, {application-record-element=DET_MH_CRC16_161_164, system-signal=DET_MH_CRC16_161_164}, {application-record-element=DET_MH_CYCLE_COUNTER_161_164, system-signal=DET_MH_CYCLE_COUNTER_161_164}, {application-record-element=DET_MH_SCAN_INDEX_4LSB_161_164, system-signal=DET_MH_SCAN_INDEX_4LSB_161_164}, {application-record-element=DET_MTD_161, system-signal=DET_MTD_161}, {application-record-element=DET_MTD_162, system-signal=DET_MTD_162}, {application-record-element=DET_MTD_163, system-signal=DET_MTD_163}, {application-record-element=DET_MTD_164, system-signal=DET_MTD_164}, {application-record-element=DET_PROB_1STAZHYPO_161, system-signal=DET_PROB_1STAZHYPO_161}, {application-record-element=DET_PROB_1STAZHYPO_162, system-signal=DET_PROB_1STAZHYPO_162}, {application-record-element=DET_PROB_1STAZHYPO_163, system-signal=DET_PROB_1STAZHYPO_163}, {application-record-element=DET_PROB_1STAZHYPO_164, system-signal=DET_PROB_1STAZHYPO_164}, {application-record-element=DET_RANGE_161, system-signal=DET_RANGE_161}, {application-record-element=DET_RANGE_162, system-signal=DET_RANGE_162}, {application-record-element=DET_RANGE_163, system-signal=DET_RANGE_163}, {application-record-element=DET_RANGE_164, system-signal=DET_RANGE_164}, {application-record-element=DET_RANGE_ERR_161, system-signal=DET_RANGE_ERR_161}, {application-record-element=DET_RANGE_ERR_162, system-signal=DET_RANGE_ERR_162}, {application-record-element=DET_RANGE_ERR_163, system-signal=DET_RANGE_ERR_163}, {application-record-element=DET_RANGE_ERR_164, system-signal=DET_RANGE_ERR_164}, {application-record-element=DET_RANGE_VELOCITY_161, system-signal=DET_RANGE_VELOCITY_161}, {application-record-element=DET_RANGE_VELOCITY_162, system-signal=DET_RANGE_VELOCITY_162}, {application-record-element=DET_RANGE_VELOCITY_163, system-signal=DET_RANGE_VELOCITY_163}, {application-record-element=DET_RANGE_VELOCITY_164, system-signal=DET_RANGE_VELOCITY_164}, {application-record-element=DET_RANGE_VELOCITY_ERR_161, system-signal=DET_RANGE_VELOCITY_ERR_161}, {application-record-element=DET_RANGE_VELOCITY_ERR_162, system-signal=DET_RANGE_VELOCITY_ERR_162}, {application-record-element=DET_RANGE_VELOCITY_ERR_163, system-signal=DET_RANGE_VELOCITY_ERR_163}, {application-record-element=DET_RANGE_VELOCITY_ERR_164, system-signal=DET_RANGE_VELOCITY_ERR_164}, {application-record-element=DET_RCS_161, system-signal=DET_RCS_161}, {application-record-element=DET_RCS_162, system-signal=DET_RCS_162}, {application-record-element=DET_RCS_163, system-signal=DET_RCS_163}, {application-record-element=DET_RCS_164, system-signal=DET_RCS_164}, {application-record-element=DET_SNR_161, system-signal=DET_SNR_161}, {application-record-element=DET_SNR_162, system-signal=DET_SNR_162}, {application-record-element=DET_SNR_163, system-signal=DET_SNR_163}, {application-record-element=DET_SNR_164, system-signal=DET_SNR_164}, {application-record-element=DET_SUPER_RES_TARGET_161, system-signal=DET_SUPER_RES_TARGET_161}, {application-record-element=DET_SUPER_RES_TARGET_162, system-signal=DET_SUPER_RES_TARGET_162}, {application-record-element=DET_SUPER_RES_TARGET_163, system-signal=DET_SUPER_RES_TARGET_163}, {application-record-element=DET_SUPER_RES_TARGET_164, system-signal=DET_SUPER_RES_TARGET_164}]}
        sender-receiver-to-signal-group-mapping={data-element=COMPOSITIONTYPE.Pp_SG_Detections_165_168_AL.Vdp_SG_Detections_165_168_AL, signal-group=SG_Detections_165_168, type-mapping=sender-rec-record-type-mapping=record-element-mappings=[{application-record-element=DET_AZIMUTH_165, system-signal=DET_AZIMUTH_165}, {application-record-element=DET_AZIMUTH_166, system-signal=DET_AZIMUTH_166}, {application-record-element=DET_AZIMUTH_167, system-signal=DET_AZIMUTH_167}, {application-record-element=DET_AZIMUTH_168, system-signal=DET_AZIMUTH_168}, {application-record-element=DET_AZIMUTH_ERR_165, system-signal=DET_AZIMUTH_ERR_165}, {application-record-element=DET_AZIMUTH_ERR_166, system-signal=DET_AZIMUTH_ERR_166}, {application-record-element=DET_AZIMUTH_ERR_167, system-signal=DET_AZIMUTH_ERR_167}, {application-record-element=DET_AZIMUTH_ERR_168, system-signal=DET_AZIMUTH_ERR_168}, {application-record-element=DET_BELOW_RAIN_THOLD_165, system-signal=DET_BELOW_RAIN_THOLD_165}, {application-record-element=DET_BELOW_RAIN_THOLD_166, system-signal=DET_BELOW_RAIN_THOLD_166}, {application-record-element=DET_BELOW_RAIN_THOLD_167, system-signal=DET_BELOW_RAIN_THOLD_167}, {application-record-element=DET_BELOW_RAIN_THOLD_168, system-signal=DET_BELOW_RAIN_THOLD_168}, {application-record-element=DET_BI_STATIC_FLAG_165, system-signal=DET_BI_STATIC_FLAG_165}, {application-record-element=DET_BI_STATIC_FLAG_166, system-signal=DET_BI_STATIC_FLAG_166}, {application-record-element=DET_BI_STATIC_FLAG_167, system-signal=DET_BI_STATIC_FLAG_167}, {application-record-element=DET_BI_STATIC_FLAG_168, system-signal=DET_BI_STATIC_FLAG_168}, {application-record-element=DET_CONFD_AZIMUTH_165, system-signal=DET_CONFD_AZIMUTH_165}, {application-record-element=DET_CONFD_AZIMUTH_166, system-signal=DET_CONFD_AZIMUTH_166}, {application-record-element=DET_CONFD_AZIMUTH_167, system-signal=DET_CONFD_AZIMUTH_167}, {application-record-element=DET_CONFD_AZIMUTH_168, system-signal=DET_CONFD_AZIMUTH_168}, {application-record-element=DET_CONFD_ELEVATION_165, system-signal=DET_CONFD_ELEVATION_165}, {application-record-element=DET_CONFD_ELEVATION_166, system-signal=DET_CONFD_ELEVATION_166}, {application-record-element=DET_CONFD_ELEVATION_167, system-signal=DET_CONFD_ELEVATION_167}, {application-record-element=DET_CONFD_ELEVATION_168, system-signal=DET_CONFD_ELEVATION_168}, {application-record-element=DET_ELEVATION_165, system-signal=DET_ELEVATION_165}, {application-record-element=DET_ELEVATION_166, system-signal=DET_ELEVATION_166}, {application-record-element=DET_ELEVATION_167, system-signal=DET_ELEVATION_167}, {application-record-element=DET_ELEVATION_168, system-signal=DET_ELEVATION_168}, {application-record-element=DET_ELEVATION_ERR_165, system-signal=DET_ELEVATION_ERR_165}, {application-record-element=DET_ELEVATION_ERR_166, system-signal=DET_ELEVATION_ERR_166}, {application-record-element=DET_ELEVATION_ERR_167, system-signal=DET_ELEVATION_ERR_167}, {application-record-element=DET_ELEVATION_ERR_168, system-signal=DET_ELEVATION_ERR_168}, {application-record-element=DET_EXISTENCE_PROB_165, system-signal=DET_EXISTENCE_PROB_165}, {application-record-element=DET_EXISTENCE_PROB_166, system-signal=DET_EXISTENCE_PROB_166}, {application-record-element=DET_EXISTENCE_PROB_167, system-signal=DET_EXISTENCE_PROB_167}, {application-record-element=DET_EXISTENCE_PROB_168, system-signal=DET_EXISTENCE_PROB_168}, {application-record-element=DET_HVC_FLAG_165, system-signal=DET_HVC_FLAG_165}, {application-record-element=DET_HVC_FLAG_166, system-signal=DET_HVC_FLAG_166}, {application-record-element=DET_HVC_FLAG_167, system-signal=DET_HVC_FLAG_167}, {application-record-element=DET_HVC_FLAG_168, system-signal=DET_HVC_FLAG_168}, {application-record-element=DET_IDM_165, system-signal=DET_IDM_165}, {application-record-element=DET_IDM_166, system-signal=DET_IDM_166}, {application-record-element=DET_IDM_167, system-signal=DET_IDM_167}, {application-record-element=DET_IDM_168, system-signal=DET_IDM_168}, {application-record-element=DET_MH_CRC16_165_168, system-signal=DET_MH_CRC16_165_168}, {application-record-element=DET_MH_CYCLE_COUNTER_165_168, system-signal=DET_MH_CYCLE_COUNTER_165_168}, {application-record-element=DET_MH_SCAN_INDEX_4LSB_165_168, system-signal=DET_MH_SCAN_INDEX_4LSB_165_168}, {application-record-element=DET_MTD_165, system-signal=DET_MTD_165}, {application-record-element=DET_MTD_166, system-signal=DET_MTD_166}, {application-record-element=DET_MTD_167, system-signal=DET_MTD_167}, {application-record-element=DET_MTD_168, system-signal=DET_MTD_168}, {application-record-element=DET_PROB_1STAZHYPO_165, system-signal=DET_PROB_1STAZHYPO_165}, {application-record-element=DET_PROB_1STAZHYPO_166, system-signal=DET_PROB_1STAZHYPO_166}, {application-record-element=DET_PROB_1STAZHYPO_167, system-signal=DET_PROB_1STAZHYPO_167}, {application-record-element=DET_PROB_1STAZHYPO_168, system-signal=DET_PROB_1STAZHYPO_168}, {application-record-element=DET_RANGE_165, system-signal=DET_RANGE_165}, {application-record-element=DET_RANGE_166, system-signal=DET_RANGE_166}, {application-record-element=DET_RANGE_167, system-signal=DET_RANGE_167}, {application-record-element=DET_RANGE_168, system-signal=DET_RANGE_168}, {application-record-element=DET_RANGE_ERR_165, system-signal=DET_RANGE_ERR_165}, {application-record-element=DET_RANGE_ERR_166, system-signal=DET_RANGE_ERR_166}, {application-record-element=DET_RANGE_ERR_167, system-signal=DET_RANGE_ERR_167}, {application-record-element=DET_RANGE_ERR_168, system-signal=DET_RANGE_ERR_168}, {application-record-element=DET_RANGE_VELOCITY_165, system-signal=DET_RANGE_VELOCITY_165}, {application-record-element=DET_RANGE_VELOCITY_166, system-signal=DET_RANGE_VELOCITY_166}, {application-record-element=DET_RANGE_VELOCITY_167, system-signal=DET_RANGE_VELOCITY_167}, {application-record-element=DET_RANGE_VELOCITY_168, system-signal=DET_RANGE_VELOCITY_168}, {application-record-element=DET_RANGE_VELOCITY_ERR_165, system-signal=DET_RANGE_VELOCITY_ERR_165}, {application-record-element=DET_RANGE_VELOCITY_ERR_166, system-signal=DET_RANGE_VELOCITY_ERR_166}, {application-record-element=DET_RANGE_VELOCITY_ERR_167, system-signal=DET_RANGE_VELOCITY_ERR_167}, {application-record-element=DET_RANGE_VELOCITY_ERR_168, system-signal=DET_RANGE_VELOCITY_ERR_168}, {application-record-element=DET_RCS_165, system-signal=DET_RCS_165}, {application-record-element=DET_RCS_166, system-signal=DET_RCS_166}, {application-record-element=DET_RCS_167, system-signal=DET_RCS_167}, {application-record-element=DET_RCS_168, system-signal=DET_RCS_168}, {application-record-element=DET_SNR_165, system-signal=DET_SNR_165}, {application-record-element=DET_SNR_166, system-signal=DET_SNR_166}, {application-record-element=DET_SNR_167, system-signal=DET_SNR_167}, {application-record-element=DET_SNR_168, system-signal=DET_SNR_168}, {application-record-element=DET_SUPER_RES_TARGET_165, system-signal=DET_SUPER_RES_TARGET_165}, {application-record-element=DET_SUPER_RES_TARGET_166, system-signal=DET_SUPER_RES_TARGET_166}, {application-record-element=DET_SUPER_RES_TARGET_167, system-signal=DET_SUPER_RES_TARGET_167}, {application-record-element=DET_SUPER_RES_TARGET_168, system-signal=DET_SUPER_RES_TARGET_168}]}
        sender-receiver-to-signal-group-mapping={data-element=COMPOSITIONTYPE.Pp_SG_Detections_169_172_AL.Vdp_SG_Detections_169_172_AL, signal-group=SG_Detections_169_172, type-mapping=sender-rec-record-type-mapping=record-element-mappings=[{application-record-element=DET_AZIMUTH_169, system-signal=DET_AZIMUTH_169}, {application-record-element=DET_AZIMUTH_170, system-signal=DET_AZIMUTH_170}, {application-record-element=DET_AZIMUTH_171, system-signal=DET_AZIMUTH_171}, {application-record-element=DET_AZIMUTH_172, system-signal=DET_AZIMUTH_172}, {application-record-element=DET_AZIMUTH_ERR_169, system-signal=DET_AZIMUTH_ERR_169}, {application-record-element=DET_AZIMUTH_ERR_170, system-signal=DET_AZIMUTH_ERR_170}, {application-record-element=DET_AZIMUTH_ERR_171, system-signal=DET_AZIMUTH_ERR_171}, {application-record-element=DET_AZIMUTH_ERR_172, system-signal=DET_AZIMUTH_ERR_172}, {application-record-element=DET_BELOW_RAIN_THOLD_169, system-signal=DET_BELOW_RAIN_THOLD_169}, {application-record-element=DET_BELOW_RAIN_THOLD_170, system-signal=DET_BELOW_RAIN_THOLD_170}, {application-record-element=DET_BELOW_RAIN_THOLD_171, system-signal=DET_BELOW_RAIN_THOLD_171}, {application-record-element=DET_BELOW_RAIN_THOLD_172, system-signal=DET_BELOW_RAIN_THOLD_172}, {application-record-element=DET_BI_STATIC_FLAG_169, system-signal=DET_BI_STATIC_FLAG_169}, {application-record-element=DET_BI_STATIC_FLAG_170, system-signal=DET_BI_STATIC_FLAG_170}, {application-record-element=DET_BI_STATIC_FLAG_171, system-signal=DET_BI_STATIC_FLAG_171}, {application-record-element=DET_BI_STATIC_FLAG_172, system-signal=DET_BI_STATIC_FLAG_172}, {application-record-element=DET_CONFD_AZIMUTH_169, system-signal=DET_CONFD_AZIMUTH_169}, {application-record-element=DET_CONFD_AZIMUTH_170, system-signal=DET_CONFD_AZIMUTH_170}, {application-record-element=DET_CONFD_AZIMUTH_171, system-signal=DET_CONFD_AZIMUTH_171}, {application-record-element=DET_CONFD_AZIMUTH_172, system-signal=DET_CONFD_AZIMUTH_172}, {application-record-element=DET_CONFD_ELEVATION_169, system-signal=DET_CONFD_ELEVATION_169}, {application-record-element=DET_CONFD_ELEVATION_170, system-signal=DET_CONFD_ELEVATION_170}, {application-record-element=DET_CONFD_ELEVATION_171, system-signal=DET_CONFD_ELEVATION_171}, {application-record-element=DET_CONFD_ELEVATION_172, system-signal=DET_CONFD_ELEVATION_172}, {application-record-element=DET_ELEVATION_169, system-signal=DET_ELEVATION_169}, {application-record-element=DET_ELEVATION_170, system-signal=DET_ELEVATION_170}, {application-record-element=DET_ELEVATION_171, system-signal=DET_ELEVATION_171}, {application-record-element=DET_ELEVATION_172, system-signal=DET_ELEVATION_172}, {application-record-element=DET_ELEVATION_ERR_169, system-signal=DET_ELEVATION_ERR_169}, {application-record-element=DET_ELEVATION_ERR_170, system-signal=DET_ELEVATION_ERR_170}, {application-record-element=DET_ELEVATION_ERR_171, system-signal=DET_ELEVATION_ERR_171}, {application-record-element=DET_ELEVATION_ERR_172, system-signal=DET_ELEVATION_ERR_172}, {application-record-element=DET_EXISTENCE_PROB_169, system-signal=DET_EXISTENCE_PROB_169}, {application-record-element=DET_EXISTENCE_PROB_170, system-signal=DET_EXISTENCE_PROB_170}, {application-record-element=DET_EXISTENCE_PROB_171, system-signal=DET_EXISTENCE_PROB_171}, {application-record-element=DET_EXISTENCE_PROB_172, system-signal=DET_EXISTENCE_PROB_172}, {application-record-element=DET_HVC_FLAG_169, system-signal=DET_HVC_FLAG_169}, {application-record-element=DET_HVC_FLAG_170, system-signal=DET_HVC_FLAG_170}, {application-record-element=DET_HVC_FLAG_171, system-signal=DET_HVC_FLAG_171}, {application-record-element=DET_HVC_FLAG_172, system-signal=DET_HVC_FLAG_172}, {application-record-element=DET_IDM_169, system-signal=DET_IDM_169}, {application-record-element=DET_IDM_170, system-signal=DET_IDM_170}, {application-record-element=DET_IDM_171, system-signal=DET_IDM_171}, {application-record-element=DET_IDM_172, system-signal=DET_IDM_172}, {application-record-element=DET_MH_CRC16_169_172, system-signal=DET_MH_CRC16_169_172}, {application-record-element=DET_MH_CYCLE_COUNTER_169_172, system-signal=DET_MH_CYCLE_COUNTER_169_172}, {application-record-element=DET_MH_SCAN_INDEX_4LSB_169_172, system-signal=DET_MH_SCAN_INDEX_4LSB_169_172}, {application-record-element=DET_MTD_169, system-signal=DET_MTD_169}, {application-record-element=DET_MTD_170, system-signal=DET_MTD_170}, {application-record-element=DET_MTD_171, system-signal=DET_MTD_171}, {application-record-element=DET_MTD_172, system-signal=DET_MTD_172}, {application-record-element=DET_PROB_1STAZHYPO_169, system-signal=DET_PROB_1STAZHYPO_169}, {application-record-element=DET_PROB_1STAZHYPO_170, system-signal=DET_PROB_1STAZHYPO_170}, {application-record-element=DET_PROB_1STAZHYPO_171, system-signal=DET_PROB_1STAZHYPO_171}, {application-record-element=DET_PROB_1STAZHYPO_172, system-signal=DET_PROB_1STAZHYPO_172}, {application-record-element=DET_RANGE_169, system-signal=DET_RANGE_169}, {application-record-element=DET_RANGE_170, system-signal=DET_RANGE_170}, {application-record-element=DET_RANGE_171, system-signal=DET_RANGE_171}, {application-record-element=DET_RANGE_172, system-signal=DET_RANGE_172}, {application-record-element=DET_RANGE_ERR_169, system-signal=DET_RANGE_ERR_169}, {application-record-element=DET_RANGE_ERR_170, system-signal=DET_RANGE_ERR_170}, {application-record-element=DET_RANGE_ERR_171, system-signal=DET_RANGE_ERR_171}, {application-record-element=DET_RANGE_ERR_172, system-signal=DET_RANGE_ERR_172}, {application-record-element=DET_RANGE_VELOCITY_169, system-signal=DET_RANGE_VELOCITY_169}, {application-record-element=DET_RANGE_VELOCITY_170, system-signal=DET_RANGE_VELOCITY_170}, {application-record-element=DET_RANGE_VELOCITY_171, system-signal=DET_RANGE_VELOCITY_171}, {application-record-element=DET_RANGE_VELOCITY_172, system-signal=DET_RANGE_VELOCITY_172}, {application-record-element=DET_RANGE_VELOCITY_ERR_169, system-signal=DET_RANGE_VELOCITY_ERR_169}, {application-record-element=DET_RANGE_VELOCITY_ERR_170, system-signal=DET_RANGE_VELOCITY_ERR_170}, {application-record-element=DET_RANGE_VELOCITY_ERR_171, system-signal=DET_RANGE_VELOCITY_ERR_171}, {application-record-element=DET_RANGE_VELOCITY_ERR_172, system-signal=DET_RANGE_VELOCITY_ERR_172}, {application-record-element=DET_RCS_169, system-signal=DET_RCS_169}, {application-record-element=DET_RCS_170, system-signal=DET_RCS_170}, {application-record-element=DET_RCS_171, system-signal=DET_RCS_171}, {application-record-element=DET_RCS_172, system-signal=DET_RCS_172}, {application-record-element=DET_SNR_169, system-signal=DET_SNR_169}, {application-record-element=DET_SNR_170, system-signal=DET_SNR_170}, {application-record-element=DET_SNR_171, system-signal=DET_SNR_171}, {application-record-element=DET_SNR_172, system-signal=DET_SNR_172}, {application-record-element=DET_SUPER_RES_TARGET_169, system-signal=DET_SUPER_RES_TARGET_169}, {application-record-element=DET_SUPER_RES_TARGET_170, system-signal=DET_SUPER_RES_TARGET_170}, {application-record-element=DET_SUPER_RES_TARGET_171, system-signal=DET_SUPER_RES_TARGET_171}, {application-record-element=DET_SUPER_RES_TARGET_172, system-signal=DET_SUPER_RES_TARGET_172}]}
        sender-receiver-to-signal-group-mapping={data-element=COMPOSITIONTYPE.Pp_SG_Detections_173_176_AL.Vdp_SG_Detections_173_176_AL, signal-group=SG_Detections_173_176, type-mapping=sender-rec-record-type-mapping=record-element-mappings=[{application-record-element=DET_AZIMUTH_173, system-signal=DET_AZIMUTH_173}, {application-record-element=DET_AZIMUTH_174, system-signal=DET_AZIMUTH_174}, {application-record-element=DET_AZIMUTH_175, system-signal=DET_AZIMUTH_175}, {application-record-element=DET_AZIMUTH_176, system-signal=DET_AZIMUTH_176}, {application-record-element=DET_AZIMUTH_ERR_173, system-signal=DET_AZIMUTH_ERR_173}, {application-record-element=DET_AZIMUTH_ERR_174, system-signal=DET_AZIMUTH_ERR_174}, {application-record-element=DET_AZIMUTH_ERR_175, system-signal=DET_AZIMUTH_ERR_175}, {application-record-element=DET_AZIMUTH_ERR_176, system-signal=DET_AZIMUTH_ERR_176}, {application-record-element=DET_BELOW_RAIN_THOLD_173, system-signal=DET_BELOW_RAIN_THOLD_173}, {application-record-element=DET_BELOW_RAIN_THOLD_174, system-signal=DET_BELOW_RAIN_THOLD_174}, {application-record-element=DET_BELOW_RAIN_THOLD_175, system-signal=DET_BELOW_RAIN_THOLD_175}, {application-record-element=DET_BELOW_RAIN_THOLD_176, system-signal=DET_BELOW_RAIN_THOLD_176}, {application-record-element=DET_BI_STATIC_FLAG_173, system-signal=DET_BI_STATIC_FLAG_173}, {application-record-element=DET_BI_STATIC_FLAG_174, system-signal=DET_BI_STATIC_FLAG_174}, {application-record-element=DET_BI_STATIC_FLAG_175, system-signal=DET_BI_STATIC_FLAG_175}, {application-record-element=DET_BI_STATIC_FLAG_176, system-signal=DET_BI_STATIC_FLAG_176}, {application-record-element=DET_CONFD_AZIMUTH_173, system-signal=DET_CONFD_AZIMUTH_173}, {application-record-element=DET_CONFD_AZIMUTH_174, system-signal=DET_CONFD_AZIMUTH_174}, {application-record-element=DET_CONFD_AZIMUTH_175, system-signal=DET_CONFD_AZIMUTH_175}, {application-record-element=DET_CONFD_AZIMUTH_176, system-signal=DET_CONFD_AZIMUTH_176}, {application-record-element=DET_CONFD_ELEVATION_173, system-signal=DET_CONFD_ELEVATION_173}, {application-record-element=DET_CONFD_ELEVATION_174, system-signal=DET_CONFD_ELEVATION_174}, {application-record-element=DET_CONFD_ELEVATION_175, system-signal=DET_CONFD_ELEVATION_175}, {application-record-element=DET_CONFD_ELEVATION_176, system-signal=DET_CONFD_ELEVATION_176}, {application-record-element=DET_ELEVATION_173, system-signal=DET_ELEVATION_173}, {application-record-element=DET_ELEVATION_174, system-signal=DET_ELEVATION_174}, {application-record-element=DET_ELEVATION_175, system-signal=DET_ELEVATION_175}, {application-record-element=DET_ELEVATION_176, system-signal=DET_ELEVATION_176}, {application-record-element=DET_ELEVATION_ERR_173, system-signal=DET_ELEVATION_ERR_173}, {application-record-element=DET_ELEVATION_ERR_174, system-signal=DET_ELEVATION_ERR_174}, {application-record-element=DET_ELEVATION_ERR_175, system-signal=DET_ELEVATION_ERR_175}, {application-record-element=DET_ELEVATION_ERR_176, system-signal=DET_ELEVATION_ERR_176}, {application-record-element=DET_EXISTENCE_PROB_173, system-signal=DET_EXISTENCE_PROB_173}, {application-record-element=DET_EXISTENCE_PROB_174, system-signal=DET_EXISTENCE_PROB_174}, {application-record-element=DET_EXISTENCE_PROB_175, system-signal=DET_EXISTENCE_PROB_175}, {application-record-element=DET_EXISTENCE_PROB_176, system-signal=DET_EXISTENCE_PROB_176}, {application-record-element=DET_HVC_FLAG_173, system-signal=DET_HVC_FLAG_173}, {application-record-element=DET_HVC_FLAG_174, system-signal=DET_HVC_FLAG_174}, {application-record-element=DET_HVC_FLAG_175, system-signal=DET_HVC_FLAG_175}, {application-record-element=DET_HVC_FLAG_176, system-signal=DET_HVC_FLAG_176}, {application-record-element=DET_IDM_173, system-signal=DET_IDM_173}, {application-record-element=DET_IDM_174, system-signal=DET_IDM_174}, {application-record-element=DET_IDM_175, system-signal=DET_IDM_175}, {application-record-element=DET_IDM_176, system-signal=DET_IDM_176}, {application-record-element=DET_MH_CRC16_173_176, system-signal=DET_MH_CRC16_173_176}, {application-record-element=DET_MH_CYCLE_COUNTER_173_176, system-signal=DET_MH_CYCLE_COUNTER_173_176}, {application-record-element=DET_MH_SCAN_INDEX_4LSB_173_176, system-signal=DET_MH_SCAN_INDEX_4LSB_173_176}, {application-record-element=DET_MTD_173, system-signal=DET_MTD_173}, {application-record-element=DET_MTD_174, system-signal=DET_MTD_174}, {application-record-element=DET_MTD_175, system-signal=DET_MTD_175}, {application-record-element=DET_MTD_176, system-signal=DET_MTD_176}, {application-record-element=DET_PROB_1STAZHYPO_173, system-signal=DET_PROB_1STAZHYPO_173}, {application-record-element=DET_PROB_1STAZHYPO_174, system-signal=DET_PROB_1STAZHYPO_174}, {application-record-element=DET_PROB_1STAZHYPO_175, system-signal=DET_PROB_1STAZHYPO_175}, {application-record-element=DET_PROB_1STAZHYPO_176, system-signal=DET_PROB_1STAZHYPO_176}, {application-record-element=DET_RANGE_173, system-signal=DET_RANGE_173}, {application-record-element=DET_RANGE_174, system-signal=DET_RANGE_174}, {application-record-element=DET_RANGE_175, system-signal=DET_RANGE_175}, {application-record-element=DET_RANGE_176, system-signal=DET_RANGE_176}, {application-record-element=DET_RANGE_ERR_173, system-signal=DET_RANGE_ERR_173}, {application-record-element=DET_RANGE_ERR_174, system-signal=DET_RANGE_ERR_174}, {application-record-element=DET_RANGE_ERR_175, system-signal=DET_RANGE_ERR_175}, {application-record-element=DET_RANGE_ERR_176, system-signal=DET_RANGE_ERR_176}, {application-record-element=DET_RANGE_VELOCITY_173, system-signal=DET_RANGE_VELOCITY_173}, {application-record-element=DET_RANGE_VELOCITY_174, system-signal=DET_RANGE_VELOCITY_174}, {application-record-element=DET_RANGE_VELOCITY_175, system-signal=DET_RANGE_VELOCITY_175}, {application-record-element=DET_RANGE_VELOCITY_176, system-signal=DET_RANGE_VELOCITY_176}, {application-record-element=DET_RANGE_VELOCITY_ERR_173, system-signal=DET_RANGE_VELOCITY_ERR_173}, {application-record-element=DET_RANGE_VELOCITY_ERR_174, system-signal=DET_RANGE_VELOCITY_ERR_174}, {application-record-element=DET_RANGE_VELOCITY_ERR_175, system-signal=DET_RANGE_VELOCITY_ERR_175}, {application-record-element=DET_RANGE_VELOCITY_ERR_176, system-signal=DET_RANGE_VELOCITY_ERR_176}, {application-record-element=DET_RCS_173, system-signal=DET_RCS_173}, {application-record-element=DET_RCS_174, system-signal=DET_RCS_174}, {application-record-element=DET_RCS_175, system-signal=DET_RCS_175}, {application-record-element=DET_RCS_176, system-signal=DET_RCS_176}, {application-record-element=DET_SNR_173, system-signal=DET_SNR_173}, {application-record-element=DET_SNR_174, system-signal=DET_SNR_174}, {application-record-element=DET_SNR_175, system-signal=DET_SNR_175}, {application-record-element=DET_SNR_176, system-signal=DET_SNR_176}, {application-record-element=DET_SUPER_RES_TARGET_173, system-signal=DET_SUPER_RES_TARGET_173}, {application-record-element=DET_SUPER_RES_TARGET_174, system-signal=DET_SUPER_RES_TARGET_174}, {application-record-element=DET_SUPER_RES_TARGET_175, system-signal=DET_SUPER_RES_TARGET_175}, {application-record-element=DET_SUPER_RES_TARGET_176, system-signal=DET_SUPER_RES_TARGET_176}]}
        sender-receiver-to-signal-group-mapping={data-element=COMPOSITIONTYPE.Pp_SG_Detections_177_180_AL.Vdp_SG_Detections_177_180_AL, signal-group=SG_Detections_177_180, type-mapping=sender-rec-record-type-mapping=record-element-mappings=[{application-record-element=DET_AZIMUTH_177, system-signal=DET_AZIMUTH_177}, {application-record-element=DET_AZIMUTH_178, system-signal=DET_AZIMUTH_178}, {application-record-element=DET_AZIMUTH_179, system-signal=DET_AZIMUTH_179}, {application-record-element=DET_AZIMUTH_180, system-signal=DET_AZIMUTH_180}, {application-record-element=DET_AZIMUTH_ERR_177, system-signal=DET_AZIMUTH_ERR_177}, {application-record-element=DET_AZIMUTH_ERR_178, system-signal=DET_AZIMUTH_ERR_178}, {application-record-element=DET_AZIMUTH_ERR_179, system-signal=DET_AZIMUTH_ERR_179}, {application-record-element=DET_AZIMUTH_ERR_180, system-signal=DET_AZIMUTH_ERR_180}, {application-record-element=DET_BELOW_RAIN_THOLD_177, system-signal=DET_BELOW_RAIN_THOLD_177}, {application-record-element=DET_BELOW_RAIN_THOLD_178, system-signal=DET_BELOW_RAIN_THOLD_178}, {application-record-element=DET_BELOW_RAIN_THOLD_179, system-signal=DET_BELOW_RAIN_THOLD_179}, {application-record-element=DET_BELOW_RAIN_THOLD_180, system-signal=DET_BELOW_RAIN_THOLD_180}, {application-record-element=DET_BI_STATIC_FLAG_177, system-signal=DET_BI_STATIC_FLAG_177}, {application-record-element=DET_BI_STATIC_FLAG_178, system-signal=DET_BI_STATIC_FLAG_178}, {application-record-element=DET_BI_STATIC_FLAG_179, system-signal=DET_BI_STATIC_FLAG_179}, {application-record-element=DET_BI_STATIC_FLAG_180, system-signal=DET_BI_STATIC_FLAG_180}, {application-record-element=DET_CONFD_AZIMUTH_177, system-signal=DET_CONFD_AZIMUTH_177}, {application-record-element=DET_CONFD_AZIMUTH_178, system-signal=DET_CONFD_AZIMUTH_178}, {application-record-element=DET_CONFD_AZIMUTH_179, system-signal=DET_CONFD_AZIMUTH_179}, {application-record-element=DET_CONFD_AZIMUTH_180, system-signal=DET_CONFD_AZIMUTH_180}, {application-record-element=DET_CONFD_ELEVATION_177, system-signal=DET_CONFD_ELEVATION_177}, {application-record-element=DET_CONFD_ELEVATION_178, system-signal=DET_CONFD_ELEVATION_178}, {application-record-element=DET_CONFD_ELEVATION_179, system-signal=DET_CONFD_ELEVATION_179}, {application-record-element=DET_CONFD_ELEVATION_180, system-signal=DET_CONFD_ELEVATION_180}, {application-record-element=DET_ELEVATION_177, system-signal=DET_ELEVATION_177}, {application-record-element=DET_ELEVATION_178, system-signal=DET_ELEVATION_178}, {application-record-element=DET_ELEVATION_179, system-signal=DET_ELEVATION_179}, {application-record-element=DET_ELEVATION_180, system-signal=DET_ELEVATION_180}, {application-record-element=DET_ELEVATION_ERR_177, system-signal=DET_ELEVATION_ERR_177}, {application-record-element=DET_ELEVATION_ERR_178, system-signal=DET_ELEVATION_ERR_178}, {application-record-element=DET_ELEVATION_ERR_179, system-signal=DET_ELEVATION_ERR_179}, {application-record-element=DET_ELEVATION_ERR_180, system-signal=DET_ELEVATION_ERR_180}, {application-record-element=DET_EXISTENCE_PROB_177, system-signal=DET_EXISTENCE_PROB_177}, {application-record-element=DET_EXISTENCE_PROB_178, system-signal=DET_EXISTENCE_PROB_178}, {application-record-element=DET_EXISTENCE_PROB_179, system-signal=DET_EXISTENCE_PROB_179}, {application-record-element=DET_EXISTENCE_PROB_180, system-signal=DET_EXISTENCE_PROB_180}, {application-record-element=DET_HVC_FLAG_177, system-signal=DET_HVC_FLAG_177}, {application-record-element=DET_HVC_FLAG_178, system-signal=DET_HVC_FLAG_178}, {application-record-element=DET_HVC_FLAG_179, system-signal=DET_HVC_FLAG_179}, {application-record-element=DET_HVC_FLAG_180, system-signal=DET_HVC_FLAG_180}, {application-record-element=DET_IDM_177, system-signal=DET_IDM_177}, {application-record-element=DET_IDM_178, system-signal=DET_IDM_178}, {application-record-element=DET_IDM_179, system-signal=DET_IDM_179}, {application-record-element=DET_IDM_180, system-signal=DET_IDM_180}, {application-record-element=DET_MH_CRC16_177_180, system-signal=DET_MH_CRC16_177_180}, {application-record-element=DET_MH_CYCLE_COUNTER_177_180, system-signal=DET_MH_CYCLE_COUNTER_177_180}, {application-record-element=DET_MH_SCAN_INDEX_4LSB_177_180, system-signal=DET_MH_SCAN_INDEX_4LSB_177_180}, {application-record-element=DET_MTD_177, system-signal=DET_MTD_177}, {application-record-element=DET_MTD_178, system-signal=DET_MTD_178}, {application-record-element=DET_MTD_179, system-signal=DET_MTD_179}, {application-record-element=DET_MTD_180, system-signal=DET_MTD_180}, {application-record-element=DET_PROB_1STAZHYPO_177, system-signal=DET_PROB_1STAZHYPO_177}, {application-record-element=DET_PROB_1STAZHYPO_178, system-signal=DET_PROB_1STAZHYPO_178}, {application-record-element=DET_PROB_1STAZHYPO_179, system-signal=DET_PROB_1STAZHYPO_179}, {application-record-element=DET_PROB_1STAZHYPO_180, system-signal=DET_PROB_1STAZHYPO_180}, {application-record-element=DET_RANGE_177, system-signal=DET_RANGE_177}, {application-record-element=DET_RANGE_178, system-signal=DET_RANGE_178}, {application-record-element=DET_RANGE_179, system-signal=DET_RANGE_179}, {application-record-element=DET_RANGE_180, system-signal=DET_RANGE_180}, {application-record-element=DET_RANGE_ERR_177, system-signal=DET_RANGE_ERR_177}, {application-record-element=DET_RANGE_ERR_178, system-signal=DET_RANGE_ERR_178}, {application-record-element=DET_RANGE_ERR_179, system-signal=DET_RANGE_ERR_179}, {application-record-element=DET_RANGE_ERR_180, system-signal=DET_RANGE_ERR_180}, {application-record-element=DET_RANGE_VELOCITY_177, system-signal=DET_RANGE_VELOCITY_177}, {application-record-element=DET_RANGE_VELOCITY_178, system-signal=DET_RANGE_VELOCITY_178}, {application-record-element=DET_RANGE_VELOCITY_179, system-signal=DET_RANGE_VELOCITY_179}, {application-record-element=DET_RANGE_VELOCITY_180, system-signal=DET_RANGE_VELOCITY_180}, {application-record-element=DET_RANGE_VELOCITY_ERR_177, system-signal=DET_RANGE_VELOCITY_ERR_177}, {application-record-element=DET_RANGE_VELOCITY_ERR_178, system-signal=DET_RANGE_VELOCITY_ERR_178}, {application-record-element=DET_RANGE_VELOCITY_ERR_179, system-signal=DET_RANGE_VELOCITY_ERR_179}, {application-record-element=DET_RANGE_VELOCITY_ERR_180, system-signal=DET_RANGE_VELOCITY_ERR_180}, {application-record-element=DET_RCS_177, system-signal=DET_RCS_177}, {application-record-element=DET_RCS_178, system-signal=DET_RCS_178}, {application-record-element=DET_RCS_179, system-signal=DET_RCS_179}, {application-record-element=DET_RCS_180, system-signal=DET_RCS_180}, {application-record-element=DET_SNR_177, system-signal=DET_SNR_177}, {application-record-element=DET_SNR_178, system-signal=DET_SNR_178}, {application-record-element=DET_SNR_179, system-signal=DET_SNR_179}, {application-record-element=DET_SNR_180, system-signal=DET_SNR_180}, {application-record-element=DET_SUPER_RES_TARGET_177, system-signal=DET_SUPER_RES_TARGET_177}, {application-record-element=DET_SUPER_RES_TARGET_178, system-signal=DET_SUPER_RES_TARGET_178}, {application-record-element=DET_SUPER_RES_TARGET_179, system-signal=DET_SUPER_RES_TARGET_179}, {application-record-element=DET_SUPER_RES_TARGET_180, system-signal=DET_SUPER_RES_TARGET_180}]}
        sender-receiver-to-signal-group-mapping={data-element=COMPOSITIONTYPE.Pp_SG_Detections_181_184_AL.Vdp_SG_Detections_181_184_AL, signal-group=SG_Detections_181_184, type-mapping=sender-rec-record-type-mapping=record-element-mappings=[{application-record-element=DET_AZIMUTH_181, system-signal=DET_AZIMUTH_181}, {application-record-element=DET_AZIMUTH_182, system-signal=DET_AZIMUTH_182}, {application-record-element=DET_AZIMUTH_183, system-signal=DET_AZIMUTH_183}, {application-record-element=DET_AZIMUTH_184, system-signal=DET_AZIMUTH_184}, {application-record-element=DET_AZIMUTH_ERR_181, system-signal=DET_AZIMUTH_ERR_181}, {application-record-element=DET_AZIMUTH_ERR_182, system-signal=DET_AZIMUTH_ERR_182}, {application-record-element=DET_AZIMUTH_ERR_183, system-signal=DET_AZIMUTH_ERR_183}, {application-record-element=DET_AZIMUTH_ERR_184, system-signal=DET_AZIMUTH_ERR_184}, {application-record-element=DET_BELOW_RAIN_THOLD_181, system-signal=DET_BELOW_RAIN_THOLD_181}, {application-record-element=DET_BELOW_RAIN_THOLD_182, system-signal=DET_BELOW_RAIN_THOLD_182}, {application-record-element=DET_BELOW_RAIN_THOLD_183, system-signal=DET_BELOW_RAIN_THOLD_183}, {application-record-element=DET_BELOW_RAIN_THOLD_184, system-signal=DET_BELOW_RAIN_THOLD_184}, {application-record-element=DET_BI_STATIC_FLAG_181, system-signal=DET_BI_STATIC_FLAG_181}, {application-record-element=DET_BI_STATIC_FLAG_182, system-signal=DET_BI_STATIC_FLAG_182}, {application-record-element=DET_BI_STATIC_FLAG_183, system-signal=DET_BI_STATIC_FLAG_183}, {application-record-element=DET_BI_STATIC_FLAG_184, system-signal=DET_BI_STATIC_FLAG_184}, {application-record-element=DET_CONFD_AZIMUTH_181, system-signal=DET_CONFD_AZIMUTH_181}, {application-record-element=DET_CONFD_AZIMUTH_182, system-signal=DET_CONFD_AZIMUTH_182}, {application-record-element=DET_CONFD_AZIMUTH_183, system-signal=DET_CONFD_AZIMUTH_183}, {application-record-element=DET_CONFD_AZIMUTH_184, system-signal=DET_CONFD_AZIMUTH_184}, {application-record-element=DET_CONFD_ELEVATION_181, system-signal=DET_CONFD_ELEVATION_181}, {application-record-element=DET_CONFD_ELEVATION_182, system-signal=DET_CONFD_ELEVATION_182}, {application-record-element=DET_CONFD_ELEVATION_183, system-signal=DET_CONFD_ELEVATION_183}, {application-record-element=DET_CONFD_ELEVATION_184, system-signal=DET_CONFD_ELEVATION_184}, {application-record-element=DET_ELEVATION_181, system-signal=DET_ELEVATION_181}, {application-record-element=DET_ELEVATION_182, system-signal=DET_ELEVATION_182}, {application-record-element=DET_ELEVATION_183, system-signal=DET_ELEVATION_183}, {application-record-element=DET_ELEVATION_184, system-signal=DET_ELEVATION_184}, {application-record-element=DET_ELEVATION_ERR_181, system-signal=DET_ELEVATION_ERR_181}, {application-record-element=DET_ELEVATION_ERR_182, system-signal=DET_ELEVATION_ERR_182}, {application-record-element=DET_ELEVATION_ERR_183, system-signal=DET_ELEVATION_ERR_183}, {application-record-element=DET_ELEVATION_ERR_184, system-signal=DET_ELEVATION_ERR_184}, {application-record-element=DET_EXISTENCE_PROB_181, system-signal=DET_EXISTENCE_PROB_181}, {application-record-element=DET_EXISTENCE_PROB_182, system-signal=DET_EXISTENCE_PROB_182}, {application-record-element=DET_EXISTENCE_PROB_183, system-signal=DET_EXISTENCE_PROB_183}, {application-record-element=DET_EXISTENCE_PROB_184, system-signal=DET_EXISTENCE_PROB_184}, {application-record-element=DET_HVC_FLAG_181, system-signal=DET_HVC_FLAG_181}, {application-record-element=DET_HVC_FLAG_182, system-signal=DET_HVC_FLAG_182}, {application-record-element=DET_HVC_FLAG_183, system-signal=DET_HVC_FLAG_183}, {application-record-element=DET_HVC_FLAG_184, system-signal=DET_HVC_FLAG_184}, {application-record-element=DET_IDM_181, system-signal=DET_IDM_181}, {application-record-element=DET_IDM_182, system-signal=DET_IDM_182}, {application-record-element=DET_IDM_183, system-signal=DET_IDM_183}, {application-record-element=DET_IDM_184, system-signal=DET_IDM_184}, {application-record-element=DET_MH_CRC16_181_184, system-signal=DET_MH_CRC16_181_184}, {application-record-element=DET_MH_CYCLE_COUNTER_181_184, system-signal=DET_MH_CYCLE_COUNTER_181_184}, {application-record-element=DET_MH_SCAN_INDEX_4LSB_181_184, system-signal=DET_MH_SCAN_INDEX_4LSB_181_184}, {application-record-element=DET_MTD_181, system-signal=DET_MTD_181}, {application-record-element=DET_MTD_182, system-signal=DET_MTD_182}, {application-record-element=DET_MTD_183, system-signal=DET_MTD_183}, {application-record-element=DET_MTD_184, system-signal=DET_MTD_184}, {application-record-element=DET_PROB_1STAZHYPO_181, system-signal=DET_PROB_1STAZHYPO_181}, {application-record-element=DET_PROB_1STAZHYPO_182, system-signal=DET_PROB_1STAZHYPO_182}, {application-record-element=DET_PROB_1STAZHYPO_183, system-signal=DET_PROB_1STAZHYPO_183}, {application-record-element=DET_PROB_1STAZHYPO_184, system-signal=DET_PROB_1STAZHYPO_184}, {application-record-element=DET_RANGE_181, system-signal=DET_RANGE_181}, {application-record-element=DET_RANGE_182, system-signal=DET_RANGE_182}, {application-record-element=DET_RANGE_183, system-signal=DET_RANGE_183}, {application-record-element=DET_RANGE_184, system-signal=DET_RANGE_184}, {application-record-element=DET_RANGE_ERR_181, system-signal=DET_RANGE_ERR_181}, {application-record-element=DET_RANGE_ERR_182, system-signal=DET_RANGE_ERR_182}, {application-record-element=DET_RANGE_ERR_183, system-signal=DET_RANGE_ERR_183}, {application-record-element=DET_RANGE_ERR_184, system-signal=DET_RANGE_ERR_184}, {application-record-element=DET_RANGE_VELOCITY_181, system-signal=DET_RANGE_VELOCITY_181}, {application-record-element=DET_RANGE_VELOCITY_182, system-signal=DET_RANGE_VELOCITY_182}, {application-record-element=DET_RANGE_VELOCITY_183, system-signal=DET_RANGE_VELOCITY_183}, {application-record-element=DET_RANGE_VELOCITY_184, system-signal=DET_RANGE_VELOCITY_184}, {application-record-element=DET_RANGE_VELOCITY_ERR_181, system-signal=DET_RANGE_VELOCITY_ERR_181}, {application-record-element=DET_RANGE_VELOCITY_ERR_182, system-signal=DET_RANGE_VELOCITY_ERR_182}, {application-record-element=DET_RANGE_VELOCITY_ERR_183, system-signal=DET_RANGE_VELOCITY_ERR_183}, {application-record-element=DET_RANGE_VELOCITY_ERR_184, system-signal=DET_RANGE_VELOCITY_ERR_184}, {application-record-element=DET_RCS_181, system-signal=DET_RCS_181}, {application-record-element=DET_RCS_182, system-signal=DET_RCS_182}, {application-record-element=DET_RCS_183, system-signal=DET_RCS_183}, {application-record-element=DET_RCS_184, system-signal=DET_RCS_184}, {application-record-element=DET_SNR_181, system-signal=DET_SNR_181}, {application-record-element=DET_SNR_182, system-signal=DET_SNR_182}, {application-record-element=DET_SNR_183, system-signal=DET_SNR_183}, {application-record-element=DET_SNR_184, system-signal=DET_SNR_184}, {application-record-element=DET_SUPER_RES_TARGET_181, system-signal=DET_SUPER_RES_TARGET_181}, {application-record-element=DET_SUPER_RES_TARGET_182, system-signal=DET_SUPER_RES_TARGET_182}, {application-record-element=DET_SUPER_RES_TARGET_183, system-signal=DET_SUPER_RES_TARGET_183}, {application-record-element=DET_SUPER_RES_TARGET_184, system-signal=DET_SUPER_RES_TARGET_184}]}
        sender-receiver-to-signal-group-mapping={data-element=COMPOSITIONTYPE.Pp_SG_Detections_185_188_AL.Vdp_SG_Detections_185_188_AL, signal-group=SG_Detections_185_188, type-mapping=sender-rec-record-type-mapping=record-element-mappings=[{application-record-element=DET_AZIMUTH_185, system-signal=DET_AZIMUTH_185}, {application-record-element=DET_AZIMUTH_186, system-signal=DET_AZIMUTH_186}, {application-record-element=DET_AZIMUTH_187, system-signal=DET_AZIMUTH_187}, {application-record-element=DET_AZIMUTH_188, system-signal=DET_AZIMUTH_188}, {application-record-element=DET_AZIMUTH_ERR_185, system-signal=DET_AZIMUTH_ERR_185}, {application-record-element=DET_AZIMUTH_ERR_186, system-signal=DET_AZIMUTH_ERR_186}, {application-record-element=DET_AZIMUTH_ERR_187, system-signal=DET_AZIMUTH_ERR_187}, {application-record-element=DET_AZIMUTH_ERR_188, system-signal=DET_AZIMUTH_ERR_188}, {application-record-element=DET_BELOW_RAIN_THOLD_185, system-signal=DET_BELOW_RAIN_THOLD_185}, {application-record-element=DET_BELOW_RAIN_THOLD_186, system-signal=DET_BELOW_RAIN_THOLD_186}, {application-record-element=DET_BELOW_RAIN_THOLD_187, system-signal=DET_BELOW_RAIN_THOLD_187}, {application-record-element=DET_BELOW_RAIN_THOLD_188, system-signal=DET_BELOW_RAIN_THOLD_188}, {application-record-element=DET_BI_STATIC_FLAG_185, system-signal=DET_BI_STATIC_FLAG_185}, {application-record-element=DET_BI_STATIC_FLAG_186, system-signal=DET_BI_STATIC_FLAG_186}, {application-record-element=DET_BI_STATIC_FLAG_187, system-signal=DET_BI_STATIC_FLAG_187}, {application-record-element=DET_BI_STATIC_FLAG_188, system-signal=DET_BI_STATIC_FLAG_188}, {application-record-element=DET_CONFD_AZIMUTH_185, system-signal=DET_CONFD_AZIMUTH_185}, {application-record-element=DET_CONFD_AZIMUTH_186, system-signal=DET_CONFD_AZIMUTH_186}, {application-record-element=DET_CONFD_AZIMUTH_187, system-signal=DET_CONFD_AZIMUTH_187}, {application-record-element=DET_CONFD_AZIMUTH_188, system-signal=DET_CONFD_AZIMUTH_188}, {application-record-element=DET_CONFD_ELEVATION_185, system-signal=DET_CONFD_ELEVATION_185}, {application-record-element=DET_CONFD_ELEVATION_186, system-signal=DET_CONFD_ELEVATION_186}, {application-record-element=DET_CONFD_ELEVATION_187, system-signal=DET_CONFD_ELEVATION_187}, {application-record-element=DET_CONFD_ELEVATION_188, system-signal=DET_CONFD_ELEVATION_188}, {application-record-element=DET_ELEVATION_185, system-signal=DET_ELEVATION_185}, {application-record-element=DET_ELEVATION_186, system-signal=DET_ELEVATION_186}, {application-record-element=DET_ELEVATION_187, system-signal=DET_ELEVATION_187}, {application-record-element=DET_ELEVATION_188, system-signal=DET_ELEVATION_188}, {application-record-element=DET_ELEVATION_ERR_185, system-signal=DET_ELEVATION_ERR_185}, {application-record-element=DET_ELEVATION_ERR_186, system-signal=DET_ELEVATION_ERR_186}, {application-record-element=DET_ELEVATION_ERR_187, system-signal=DET_ELEVATION_ERR_187}, {application-record-element=DET_ELEVATION_ERR_188, system-signal=DET_ELEVATION_ERR_188}, {application-record-element=DET_EXISTENCE_PROB_185, system-signal=DET_EXISTENCE_PROB_185}, {application-record-element=DET_EXISTENCE_PROB_186, system-signal=DET_EXISTENCE_PROB_186}, {application-record-element=DET_EXISTENCE_PROB_187, system-signal=DET_EXISTENCE_PROB_187}, {application-record-element=DET_EXISTENCE_PROB_188, system-signal=DET_EXISTENCE_PROB_188}, {application-record-element=DET_HVC_FLAG_185, system-signal=DET_HVC_FLAG_185}, {application-record-element=DET_HVC_FLAG_186, system-signal=DET_HVC_FLAG_186}, {application-record-element=DET_HVC_FLAG_187, system-signal=DET_HVC_FLAG_187}, {application-record-element=DET_HVC_FLAG_188, system-signal=DET_HVC_FLAG_188}, {application-record-element=DET_IDM_185, system-signal=DET_IDM_185}, {application-record-element=DET_IDM_186, system-signal=DET_IDM_186}, {application-record-element=DET_IDM_187, system-signal=DET_IDM_187}, {application-record-element=DET_IDM_188, system-signal=DET_IDM_188}, {application-record-element=DET_MH_CRC16_185_188, system-signal=DET_MH_CRC16_185_188}, {application-record-element=DET_MH_CYCLE_COUNTER_185_188, system-signal=DET_MH_CYCLE_COUNTER_185_188}, {application-record-element=DET_MH_SCAN_INDEX_4LSB_185_188, system-signal=DET_MH_SCAN_INDEX_4LSB_185_188}, {application-record-element=DET_MTD_185, system-signal=DET_MTD_185}, {application-record-element=DET_MTD_186, system-signal=DET_MTD_186}, {application-record-element=DET_MTD_187, system-signal=DET_MTD_187}, {application-record-element=DET_MTD_188, system-signal=DET_MTD_188}, {application-record-element=DET_PROB_1STAZHYPO_185, system-signal=DET_PROB_1STAZHYPO_185}, {application-record-element=DET_PROB_1STAZHYPO_186, system-signal=DET_PROB_1STAZHYPO_186}, {application-record-element=DET_PROB_1STAZHYPO_187, system-signal=DET_PROB_1STAZHYPO_187}, {application-record-element=DET_PROB_1STAZHYPO_188, system-signal=DET_PROB_1STAZHYPO_188}, {application-record-element=DET_RANGE_185, system-signal=DET_RANGE_185}, {application-record-element=DET_RANGE_186, system-signal=DET_RANGE_186}, {application-record-element=DET_RANGE_187, system-signal=DET_RANGE_187}, {application-record-element=DET_RANGE_188, system-signal=DET_RANGE_188}, {application-record-element=DET_RANGE_ERR_185, system-signal=DET_RANGE_ERR_185}, {application-record-element=DET_RANGE_ERR_186, system-signal=DET_RANGE_ERR_186}, {application-record-element=DET_RANGE_ERR_187, system-signal=DET_RANGE_ERR_187}, {application-record-element=DET_RANGE_ERR_188, system-signal=DET_RANGE_ERR_188}, {application-record-element=DET_RANGE_VELOCITY_185, system-signal=DET_RANGE_VELOCITY_185}, {application-record-element=DET_RANGE_VELOCITY_186, system-signal=DET_RANGE_VELOCITY_186}, {application-record-element=DET_RANGE_VELOCITY_187, system-signal=DET_RANGE_VELOCITY_187}, {application-record-element=DET_RANGE_VELOCITY_188, system-signal=DET_RANGE_VELOCITY_188}, {application-record-element=DET_RANGE_VELOCITY_ERR_185, system-signal=DET_RANGE_VELOCITY_ERR_185}, {application-record-element=DET_RANGE_VELOCITY_ERR_186, system-signal=DET_RANGE_VELOCITY_ERR_186}, {application-record-element=DET_RANGE_VELOCITY_ERR_187, system-signal=DET_RANGE_VELOCITY_ERR_187}, {application-record-element=DET_RANGE_VELOCITY_ERR_188, system-signal=DET_RANGE_VELOCITY_ERR_188}, {application-record-element=DET_RCS_185, system-signal=DET_RCS_185}, {application-record-element=DET_RCS_186, system-signal=DET_RCS_186}, {application-record-element=DET_RCS_187, system-signal=DET_RCS_187}, {application-record-element=DET_RCS_188, system-signal=DET_RCS_188}, {application-record-element=DET_SNR_185, system-signal=DET_SNR_185}, {application-record-element=DET_SNR_186, system-signal=DET_SNR_186}, {application-record-element=DET_SNR_187, system-signal=DET_SNR_187}, {application-record-element=DET_SNR_188, system-signal=DET_SNR_188}, {application-record-element=DET_SUPER_RES_TARGET_185, system-signal=DET_SUPER_RES_TARGET_185}, {application-record-element=DET_SUPER_RES_TARGET_186, system-signal=DET_SUPER_RES_TARGET_186}, {application-record-element=DET_SUPER_RES_TARGET_187, system-signal=DET_SUPER_RES_TARGET_187}, {application-record-element=DET_SUPER_RES_TARGET_188, system-signal=DET_SUPER_RES_TARGET_188}]}
        sender-receiver-to-signal-group-mapping={data-element=COMPOSITIONTYPE.Pp_SG_Detections_189_192_AL.Vdp_SG_Detections_189_192_AL, signal-group=SG_Detections_189_192, type-mapping=sender-rec-record-type-mapping=record-element-mappings=[{application-record-element=DET_AZIMUTH_189, system-signal=DET_AZIMUTH_189}, {application-record-element=DET_AZIMUTH_190, system-signal=DET_AZIMUTH_190}, {application-record-element=DET_AZIMUTH_191, system-signal=DET_AZIMUTH_191}, {application-record-element=DET_AZIMUTH_192, system-signal=DET_AZIMUTH_192}, {application-record-element=DET_AZIMUTH_ERR_189, system-signal=DET_AZIMUTH_ERR_189}, {application-record-element=DET_AZIMUTH_ERR_190, system-signal=DET_AZIMUTH_ERR_190}, {application-record-element=DET_AZIMUTH_ERR_191, system-signal=DET_AZIMUTH_ERR_191}, {application-record-element=DET_AZIMUTH_ERR_192, system-signal=DET_AZIMUTH_ERR_192}, {application-record-element=DET_BELOW_RAIN_THOLD_189, system-signal=DET_BELOW_RAIN_THOLD_189}, {application-record-element=DET_BELOW_RAIN_THOLD_190, system-signal=DET_BELOW_RAIN_THOLD_190}, {application-record-element=DET_BELOW_RAIN_THOLD_191, system-signal=DET_BELOW_RAIN_THOLD_191}, {application-record-element=DET_BELOW_RAIN_THOLD_192, system-signal=DET_BELOW_RAIN_THOLD_192}, {application-record-element=DET_BI_STATIC_FLAG_189, system-signal=DET_BI_STATIC_FLAG_189}, {application-record-element=DET_BI_STATIC_FLAG_190, system-signal=DET_BI_STATIC_FLAG_190}, {application-record-element=DET_BI_STATIC_FLAG_191, system-signal=DET_BI_STATIC_FLAG_191}, {application-record-element=DET_BI_STATIC_FLAG_192, system-signal=DET_BI_STATIC_FLAG_192}, {application-record-element=DET_CONFD_AZIMUTH_189, system-signal=DET_CONFD_AZIMUTH_189}, {application-record-element=DET_CONFD_AZIMUTH_190, system-signal=DET_CONFD_AZIMUTH_190}, {application-record-element=DET_CONFD_AZIMUTH_191, system-signal=DET_CONFD_AZIMUTH_191}, {application-record-element=DET_CONFD_AZIMUTH_192, system-signal=DET_CONFD_AZIMUTH_192}, {application-record-element=DET_CONFD_ELEVATION_189, system-signal=DET_CONFD_ELEVATION_189}, {application-record-element=DET_CONFD_ELEVATION_190, system-signal=DET_CONFD_ELEVATION_190}, {application-record-element=DET_CONFD_ELEVATION_191, system-signal=DET_CONFD_ELEVATION_191}, {application-record-element=DET_CONFD_ELEVATION_192, system-signal=DET_CONFD_ELEVATION_192}, {application-record-element=DET_ELEVATION_189, system-signal=DET_ELEVATION_189}, {application-record-element=DET_ELEVATION_190, system-signal=DET_ELEVATION_190}, {application-record-element=DET_ELEVATION_191, system-signal=DET_ELEVATION_191}, {application-record-element=DET_ELEVATION_192, system-signal=DET_ELEVATION_192}, {application-record-element=DET_ELEVATION_ERR_189, system-signal=DET_ELEVATION_ERR_189}, {application-record-element=DET_ELEVATION_ERR_190, system-signal=DET_ELEVATION_ERR_190}, {application-record-element=DET_ELEVATION_ERR_191, system-signal=DET_ELEVATION_ERR_191}, {application-record-element=DET_ELEVATION_ERR_192, system-signal=DET_ELEVATION_ERR_192}, {application-record-element=DET_EXISTENCE_PROB_189, system-signal=DET_EXISTENCE_PROB_189}, {application-record-element=DET_EXISTENCE_PROB_190, system-signal=DET_EXISTENCE_PROB_190}, {application-record-element=DET_EXISTENCE_PROB_191, system-signal=DET_EXISTENCE_PROB_191}, {application-record-element=DET_EXISTENCE_PROB_192, system-signal=DET_EXISTENCE_PROB_192}, {application-record-element=DET_HVC_FLAG_189, system-signal=DET_HVC_FLAG_189}, {application-record-element=DET_HVC_FLAG_190, system-signal=DET_HVC_FLAG_190}, {application-record-element=DET_HVC_FLAG_191, system-signal=DET_HVC_FLAG_191}, {application-record-element=DET_HVC_FLAG_192, system-signal=DET_HVC_FLAG_192}, {application-record-element=DET_IDM_189, system-signal=DET_IDM_189}, {application-record-element=DET_IDM_190, system-signal=DET_IDM_190}, {application-record-element=DET_IDM_191, system-signal=DET_IDM_191}, {application-record-element=DET_IDM_192, system-signal=DET_IDM_192}, {application-record-element=DET_MH_CRC16_189_192, system-signal=DET_MH_CRC16_189_192}, {application-record-element=DET_MH_CYCLE_COUNTER_189_192, system-signal=DET_MH_CYCLE_COUNTER_189_192}, {application-record-element=DET_MH_SCAN_INDEX_4LSB_189_192, system-signal=DET_MH_SCAN_INDEX_4LSB_189_192}, {application-record-element=DET_MTD_189, system-signal=DET_MTD_189}, {application-record-element=DET_MTD_190, system-signal=DET_MTD_190}, {application-record-element=DET_MTD_191, system-signal=DET_MTD_191}, {application-record-element=DET_MTD_192, system-signal=DET_MTD_192}, {application-record-element=DET_PROB_1STAZHYPO_189, system-signal=DET_PROB_1STAZHYPO_189}, {application-record-element=DET_PROB_1STAZHYPO_190, system-signal=DET_PROB_1STAZHYPO_190}, {application-record-element=DET_PROB_1STAZHYPO_191, system-signal=DET_PROB_1STAZHYPO_191}, {application-record-element=DET_PROB_1STAZHYPO_192, system-signal=DET_PROB_1STAZHYPO_192}, {application-record-element=DET_RANGE_189, system-signal=DET_RANGE_189}, {application-record-element=DET_RANGE_190, system-signal=DET_RANGE_190}, {application-record-element=DET_RANGE_191, system-signal=DET_RANGE_191}, {application-record-element=DET_RANGE_192, system-signal=DET_RANGE_192}, {application-record-element=DET_RANGE_ERR_189, system-signal=DET_RANGE_ERR_189}, {application-record-element=DET_RANGE_ERR_190, system-signal=DET_RANGE_ERR_190}, {application-record-element=DET_RANGE_ERR_191, system-signal=DET_RANGE_ERR_191}, {application-record-element=DET_RANGE_ERR_192, system-signal=DET_RANGE_ERR_192}, {application-record-element=DET_RANGE_VELOCITY_189, system-signal=DET_RANGE_VELOCITY_189}, {application-record-element=DET_RANGE_VELOCITY_190, system-signal=DET_RANGE_VELOCITY_190}, {application-record-element=DET_RANGE_VELOCITY_191, system-signal=DET_RANGE_VELOCITY_191}, {application-record-element=DET_RANGE_VELOCITY_192, system-signal=DET_RANGE_VELOCITY_192}, {application-record-element=DET_RANGE_VELOCITY_ERR_189, system-signal=DET_RANGE_VELOCITY_ERR_189}, {application-record-element=DET_RANGE_VELOCITY_ERR_190, system-signal=DET_RANGE_VELOCITY_ERR_190}, {application-record-element=DET_RANGE_VELOCITY_ERR_191, system-signal=DET_RANGE_VELOCITY_ERR_191}, {application-record-element=DET_RANGE_VELOCITY_ERR_192, system-signal=DET_RANGE_VELOCITY_ERR_192}, {application-record-element=DET_RCS_189, system-signal=DET_RCS_189}, {application-record-element=DET_RCS_190, system-signal=DET_RCS_190}, {application-record-element=DET_RCS_191, system-signal=DET_RCS_191}, {application-record-element=DET_RCS_192, system-signal=DET_RCS_192}, {application-record-element=DET_SNR_189, system-signal=DET_SNR_189}, {application-record-element=DET_SNR_190, system-signal=DET_SNR_190}, {application-record-element=DET_SNR_191, system-signal=DET_SNR_191}, {application-record-element=DET_SNR_192, system-signal=DET_SNR_192}, {application-record-element=DET_SUPER_RES_TARGET_189, system-signal=DET_SUPER_RES_TARGET_189}, {application-record-element=DET_SUPER_RES_TARGET_190, system-signal=DET_SUPER_RES_TARGET_190}, {application-record-element=DET_SUPER_RES_TARGET_191, system-signal=DET_SUPER_RES_TARGET_191}, {application-record-element=DET_SUPER_RES_TARGET_192, system-signal=DET_SUPER_RES_TARGET_192}]}
        sender-receiver-to-signal-group-mapping={data-element=COMPOSITIONTYPE.Pp_SG_Detections_193_196_AL.Vdp_SG_Detections_193_196_AL, signal-group=SG_Detections_193_196, type-mapping=sender-rec-record-type-mapping=record-element-mappings=[{application-record-element=DET_AZIMUTH_193, system-signal=DET_AZIMUTH_193}, {application-record-element=DET_AZIMUTH_194, system-signal=DET_AZIMUTH_194}, {application-record-element=DET_AZIMUTH_195, system-signal=DET_AZIMUTH_195}, {application-record-element=DET_AZIMUTH_196, system-signal=DET_AZIMUTH_196}, {application-record-element=DET_AZIMUTH_ERR_193, system-signal=DET_AZIMUTH_ERR_193}, {application-record-element=DET_AZIMUTH_ERR_194, system-signal=DET_AZIMUTH_ERR_194}, {application-record-element=DET_AZIMUTH_ERR_195, system-signal=DET_AZIMUTH_ERR_195}, {application-record-element=DET_AZIMUTH_ERR_196, system-signal=DET_AZIMUTH_ERR_196}, {application-record-element=DET_BELOW_RAIN_THOLD_193, system-signal=DET_BELOW_RAIN_THOLD_193}, {application-record-element=DET_BELOW_RAIN_THOLD_194, system-signal=DET_BELOW_RAIN_THOLD_194}, {application-record-element=DET_BELOW_RAIN_THOLD_195, system-signal=DET_BELOW_RAIN_THOLD_195}, {application-record-element=DET_BELOW_RAIN_THOLD_196, system-signal=DET_BELOW_RAIN_THOLD_196}, {application-record-element=DET_BI_STATIC_FLAG_193, system-signal=DET_BI_STATIC_FLAG_193}, {application-record-element=DET_BI_STATIC_FLAG_194, system-signal=DET_BI_STATIC_FLAG_194}, {application-record-element=DET_BI_STATIC_FLAG_195, system-signal=DET_BI_STATIC_FLAG_195}, {application-record-element=DET_BI_STATIC_FLAG_196, system-signal=DET_BI_STATIC_FLAG_196}, {application-record-element=DET_CONFD_AZIMUTH_193, system-signal=DET_CONFD_AZIMUTH_193}, {application-record-element=DET_CONFD_AZIMUTH_194, system-signal=DET_CONFD_AZIMUTH_194}, {application-record-element=DET_CONFD_AZIMUTH_195, system-signal=DET_CONFD_AZIMUTH_195}, {application-record-element=DET_CONFD_AZIMUTH_196, system-signal=DET_CONFD_AZIMUTH_196}, {application-record-element=DET_CONFD_ELEVATION_193, system-signal=DET_CONFD_ELEVATION_193}, {application-record-element=DET_CONFD_ELEVATION_194, system-signal=DET_CONFD_ELEVATION_194}, {application-record-element=DET_CONFD_ELEVATION_195, system-signal=DET_CONFD_ELEVATION_195}, {application-record-element=DET_CONFD_ELEVATION_196, system-signal=DET_CONFD_ELEVATION_196}, {application-record-element=DET_ELEVATION_193, system-signal=DET_ELEVATION_193}, {application-record-element=DET_ELEVATION_194, system-signal=DET_ELEVATION_194}, {application-record-element=DET_ELEVATION_195, system-signal=DET_ELEVATION_195}, {application-record-element=DET_ELEVATION_196, system-signal=DET_ELEVATION_196}, {application-record-element=DET_ELEVATION_ERR_193, system-signal=DET_ELEVATION_ERR_193}, {application-record-element=DET_ELEVATION_ERR_194, system-signal=DET_ELEVATION_ERR_194}, {application-record-element=DET_ELEVATION_ERR_195, system-signal=DET_ELEVATION_ERR_195}, {application-record-element=DET_ELEVATION_ERR_196, system-signal=DET_ELEVATION_ERR_196}, {application-record-element=DET_EXISTENCE_PROB_193, system-signal=DET_EXISTENCE_PROB_193}, {application-record-element=DET_EXISTENCE_PROB_194, system-signal=DET_EXISTENCE_PROB_194}, {application-record-element=DET_EXISTENCE_PROB_195, system-signal=DET_EXISTENCE_PROB_195}, {application-record-element=DET_EXISTENCE_PROB_196, system-signal=DET_EXISTENCE_PROB_196}, {application-record-element=DET_HVC_FLAG_193, system-signal=DET_HVC_FLAG_193}, {application-record-element=DET_HVC_FLAG_194, system-signal=DET_HVC_FLAG_194}, {application-record-element=DET_HVC_FLAG_195, system-signal=DET_HVC_FLAG_195}, {application-record-element=DET_HVC_FLAG_196, system-signal=DET_HVC_FLAG_196}, {application-record-element=DET_IDM_193, system-signal=DET_IDM_193}, {application-record-element=DET_IDM_194, system-signal=DET_IDM_194}, {application-record-element=DET_IDM_195, system-signal=DET_IDM_195}, {application-record-element=DET_IDM_196, system-signal=DET_IDM_196}, {application-record-element=DET_MH_CRC16_193_196, system-signal=DET_MH_CRC16_193_196}, {application-record-element=DET_MH_CYCLE_COUNTER_193_196, system-signal=DET_MH_CYCLE_COUNTER_193_196}, {application-record-element=DET_MH_SCAN_INDEX_4LSB_193_196, system-signal=DET_MH_SCAN_INDEX_4LSB_193_196}, {application-record-element=DET_MTD_193, system-signal=DET_MTD_193}, {application-record-element=DET_MTD_194, system-signal=DET_MTD_194}, {application-record-element=DET_MTD_195, system-signal=DET_MTD_195}, {application-record-element=DET_MTD_196, system-signal=DET_MTD_196}, {application-record-element=DET_PROB_1STAZHYPO_193, system-signal=DET_PROB_1STAZHYPO_193}, {application-record-element=DET_PROB_1STAZHYPO_194, system-signal=DET_PROB_1STAZHYPO_194}, {application-record-element=DET_PROB_1STAZHYPO_195, system-signal=DET_PROB_1STAZHYPO_195}, {application-record-element=DET_PROB_1STAZHYPO_196, system-signal=DET_PROB_1STAZHYPO_196}, {application-record-element=DET_RANGE_193, system-signal=DET_RANGE_193}, {application-record-element=DET_RANGE_194, system-signal=DET_RANGE_194}, {application-record-element=DET_RANGE_195, system-signal=DET_RANGE_195}, {application-record-element=DET_RANGE_196, system-signal=DET_RANGE_196}, {application-record-element=DET_RANGE_ERR_193, system-signal=DET_RANGE_ERR_193}, {application-record-element=DET_RANGE_ERR_194, system-signal=DET_RANGE_ERR_194}, {application-record-element=DET_RANGE_ERR_195, system-signal=DET_RANGE_ERR_195}, {application-record-element=DET_RANGE_ERR_196, system-signal=DET_RANGE_ERR_196}, {application-record-element=DET_RANGE_VELOCITY_193, system-signal=DET_RANGE_VELOCITY_193}, {application-record-element=DET_RANGE_VELOCITY_194, system-signal=DET_RANGE_VELOCITY_194}, {application-record-element=DET_RANGE_VELOCITY_195, system-signal=DET_RANGE_VELOCITY_195}, {application-record-element=DET_RANGE_VELOCITY_196, system-signal=DET_RANGE_VELOCITY_196}, {application-record-element=DET_RANGE_VELOCITY_ERR_193, system-signal=DET_RANGE_VELOCITY_ERR_193}, {application-record-element=DET_RANGE_VELOCITY_ERR_194, system-signal=DET_RANGE_VELOCITY_ERR_194}, {application-record-element=DET_RANGE_VELOCITY_ERR_195, system-signal=DET_RANGE_VELOCITY_ERR_195}, {application-record-element=DET_RANGE_VELOCITY_ERR_196, system-signal=DET_RANGE_VELOCITY_ERR_196}, {application-record-element=DET_RCS_193, system-signal=DET_RCS_193}, {application-record-element=DET_RCS_194, system-signal=DET_RCS_194}, {application-record-element=DET_RCS_195, system-signal=DET_RCS_195}, {application-record-element=DET_RCS_196, system-signal=DET_RCS_196}, {application-record-element=DET_SNR_193, system-signal=DET_SNR_193}, {application-record-element=DET_SNR_194, system-signal=DET_SNR_194}, {application-record-element=DET_SNR_195, system-signal=DET_SNR_195}, {application-record-element=DET_SNR_196, system-signal=DET_SNR_196}, {application-record-element=DET_SUPER_RES_TARGET_193, system-signal=DET_SUPER_RES_TARGET_193}, {application-record-element=DET_SUPER_RES_TARGET_194, system-signal=DET_SUPER_RES_TARGET_194}, {application-record-element=DET_SUPER_RES_TARGET_195, system-signal=DET_SUPER_RES_TARGET_195}, {application-record-element=DET_SUPER_RES_TARGET_196, system-signal=DET_SUPER_RES_TARGET_196}]}
        sender-receiver-to-signal-group-mapping={data-element=COMPOSITIONTYPE.Pp_SG_Detections_197_200_AL.Vdp_SG_Detections_197_200_AL, signal-group=SG_Detections_197_200, type-mapping=sender-rec-record-type-mapping=record-element-mappings=[{application-record-element=DET_AZIMUTH_197, system-signal=DET_AZIMUTH_197}, {application-record-element=DET_AZIMUTH_198, system-signal=DET_AZIMUTH_198}, {application-record-element=DET_AZIMUTH_199, system-signal=DET_AZIMUTH_199}, {application-record-element=DET_AZIMUTH_200, system-signal=DET_AZIMUTH_200}, {application-record-element=DET_AZIMUTH_ERR_197, system-signal=DET_AZIMUTH_ERR_197}, {application-record-element=DET_AZIMUTH_ERR_198, system-signal=DET_AZIMUTH_ERR_198}, {application-record-element=DET_AZIMUTH_ERR_199, system-signal=DET_AZIMUTH_ERR_199}, {application-record-element=DET_AZIMUTH_ERR_200, system-signal=DET_AZIMUTH_ERR_200}, {application-record-element=DET_BELOW_RAIN_THOLD_197, system-signal=DET_BELOW_RAIN_THOLD_197}, {application-record-element=DET_BELOW_RAIN_THOLD_198, system-signal=DET_BELOW_RAIN_THOLD_198}, {application-record-element=DET_BELOW_RAIN_THOLD_199, system-signal=DET_BELOW_RAIN_THOLD_199}, {application-record-element=DET_BELOW_RAIN_THOLD_200, system-signal=DET_BELOW_RAIN_THOLD_200}, {application-record-element=DET_BI_STATIC_FLAG_197, system-signal=DET_BI_STATIC_FLAG_197}, {application-record-element=DET_BI_STATIC_FLAG_198, system-signal=DET_BI_STATIC_FLAG_198}, {application-record-element=DET_BI_STATIC_FLAG_199, system-signal=DET_BI_STATIC_FLAG_199}, {application-record-element=DET_BI_STATIC_FLAG_200, system-signal=DET_BI_STATIC_FLAG_200}, {application-record-element=DET_CONFD_AZIMUTH_197, system-signal=DET_CONFD_AZIMUTH_197}, {application-record-element=DET_CONFD_AZIMUTH_198, system-signal=DET_CONFD_AZIMUTH_198}, {application-record-element=DET_CONFD_AZIMUTH_199, system-signal=DET_CONFD_AZIMUTH_199}, {application-record-element=DET_CONFD_AZIMUTH_200, system-signal=DET_CONFD_AZIMUTH_200}, {application-record-element=DET_CONFD_ELEVATION_197, system-signal=DET_CONFD_ELEVATION_197}, {application-record-element=DET_CONFD_ELEVATION_198, system-signal=DET_CONFD_ELEVATION_198}, {application-record-element=DET_CONFD_ELEVATION_199, system-signal=DET_CONFD_ELEVATION_199}, {application-record-element=DET_CONFD_ELEVATION_200, system-signal=DET_CONFD_ELEVATION_200}, {application-record-element=DET_ELEVATION_197, system-signal=DET_ELEVATION_197}, {application-record-element=DET_ELEVATION_198, system-signal=DET_ELEVATION_198}, {application-record-element=DET_ELEVATION_199, system-signal=DET_ELEVATION_199}, {application-record-element=DET_ELEVATION_200, system-signal=DET_ELEVATION_200}, {application-record-element=DET_ELEVATION_ERR_197, system-signal=DET_ELEVATION_ERR_197}, {application-record-element=DET_ELEVATION_ERR_198, system-signal=DET_ELEVATION_ERR_198}, {application-record-element=DET_ELEVATION_ERR_199, system-signal=DET_ELEVATION_ERR_199}, {application-record-element=DET_ELEVATION_ERR_200, system-signal=DET_ELEVATION_ERR_200}, {application-record-element=DET_EXISTENCE_PROB_197, system-signal=DET_EXISTENCE_PROB_197}, {application-record-element=DET_EXISTENCE_PROB_198, system-signal=DET_EXISTENCE_PROB_198}, {application-record-element=DET_EXISTENCE_PROB_199, system-signal=DET_EXISTENCE_PROB_199}, {application-record-element=DET_EXISTENCE_PROB_200, system-signal=DET_EXISTENCE_PROB_200}, {application-record-element=DET_HVC_FLAG_197, system-signal=DET_HVC_FLAG_197}, {application-record-element=DET_HVC_FLAG_198, system-signal=DET_HVC_FLAG_198}, {application-record-element=DET_HVC_FLAG_199, system-signal=DET_HVC_FLAG_199}, {application-record-element=DET_HVC_FLAG_200, system-signal=DET_HVC_FLAG_200}, {application-record-element=DET_IDM_197, system-signal=DET_IDM_197}, {application-record-element=DET_IDM_198, system-signal=DET_IDM_198}, {application-record-element=DET_IDM_199, system-signal=DET_IDM_199}, {application-record-element=DET_IDM_200, system-signal=DET_IDM_200}, {application-record-element=DET_MH_CRC16_197_200, system-signal=DET_MH_CRC16_197_200}, {application-record-element=DET_MH_CYCLE_COUNTER_197_200, system-signal=DET_MH_CYCLE_COUNTER_197_200}, {application-record-element=DET_MH_SCAN_INDEX_4LSB_197_200, system-signal=DET_MH_SCAN_INDEX_4LSB_197_200}, {application-record-element=DET_MTD_197, system-signal=DET_MTD_197}, {application-record-element=DET_MTD_198, system-signal=DET_MTD_198}, {application-record-element=DET_MTD_199, system-signal=DET_MTD_199}, {application-record-element=DET_MTD_200, system-signal=DET_MTD_200}, {application-record-element=DET_PROB_1STAZHYPO_197, system-signal=DET_PROB_1STAZHYPO_197}, {application-record-element=DET_PROB_1STAZHYPO_198, system-signal=DET_PROB_1STAZHYPO_198}, {application-record-element=DET_PROB_1STAZHYPO_199, system-signal=DET_PROB_1STAZHYPO_199}, {application-record-element=DET_PROB_1STAZHYPO_200, system-signal=DET_PROB_1STAZHYPO_200}, {application-record-element=DET_RANGE_197, system-signal=DET_RANGE_197}, {application-record-element=DET_RANGE_198, system-signal=DET_RANGE_198}, {application-record-element=DET_RANGE_199, system-signal=DET_RANGE_199}, {application-record-element=DET_RANGE_200, system-signal=DET_RANGE_200}, {application-record-element=DET_RANGE_ERR_197, system-signal=DET_RANGE_ERR_197}, {application-record-element=DET_RANGE_ERR_198, system-signal=DET_RANGE_ERR_198}, {application-record-element=DET_RANGE_ERR_199, system-signal=DET_RANGE_ERR_199}, {application-record-element=DET_RANGE_ERR_200, system-signal=DET_RANGE_ERR_200}, {application-record-element=DET_RANGE_VELOCITY_197, system-signal=DET_RANGE_VELOCITY_197}, {application-record-element=DET_RANGE_VELOCITY_198, system-signal=DET_RANGE_VELOCITY_198}, {application-record-element=DET_RANGE_VELOCITY_199, system-signal=DET_RANGE_VELOCITY_199}, {application-record-element=DET_RANGE_VELOCITY_200, system-signal=DET_RANGE_VELOCITY_200}, {application-record-element=DET_RANGE_VELOCITY_ERR_197, system-signal=DET_RANGE_VELOCITY_ERR_197}, {application-record-element=DET_RANGE_VELOCITY_ERR_198, system-signal=DET_RANGE_VELOCITY_ERR_198}, {application-record-element=DET_RANGE_VELOCITY_ERR_199, system-signal=DET_RANGE_VELOCITY_ERR_199}, {application-record-element=DET_RANGE_VELOCITY_ERR_200, system-signal=DET_RANGE_VELOCITY_ERR_200}, {application-record-element=DET_RCS_197, system-signal=DET_RCS_197}, {application-record-element=DET_RCS_198, system-signal=DET_RCS_198}, {application-record-element=DET_RCS_199, system-signal=DET_RCS_199}, {application-record-element=DET_RCS_200, system-signal=DET_RCS_200}, {application-record-element=DET_SNR_197, system-signal=DET_SNR_197}, {application-record-element=DET_SNR_198, system-signal=DET_SNR_198}, {application-record-element=DET_SNR_199, system-signal=DET_SNR_199}, {application-record-element=DET_SNR_200, system-signal=DET_SNR_200}, {application-record-element=DET_SUPER_RES_TARGET_197, system-signal=DET_SUPER_RES_TARGET_197}, {application-record-element=DET_SUPER_RES_TARGET_198, system-signal=DET_SUPER_RES_TARGET_198}, {application-record-element=DET_SUPER_RES_TARGET_199, system-signal=DET_SUPER_RES_TARGET_199}, {application-record-element=DET_SUPER_RES_TARGET_200, system-signal=DET_SUPER_RES_TARGET_200}]}
        sender-receiver-to-signal-group-mapping={data-element=COMPOSITIONTYPE.Pp_SG_Detections_201_204_AL.Vdp_SG_Detections_201_204_AL, signal-group=SG_Detections_201_204, type-mapping=sender-rec-record-type-mapping=record-element-mappings=[{application-record-element=DET_AZIMUTH_201, system-signal=DET_AZIMUTH_201}, {application-record-element=DET_AZIMUTH_202, system-signal=DET_AZIMUTH_202}, {application-record-element=DET_AZIMUTH_203, system-signal=DET_AZIMUTH_203}, {application-record-element=DET_AZIMUTH_204, system-signal=DET_AZIMUTH_204}, {application-record-element=DET_AZIMUTH_ERR_201, system-signal=DET_AZIMUTH_ERR_201}, {application-record-element=DET_AZIMUTH_ERR_202, system-signal=DET_AZIMUTH_ERR_202}, {application-record-element=DET_AZIMUTH_ERR_203, system-signal=DET_AZIMUTH_ERR_203}, {application-record-element=DET_AZIMUTH_ERR_204, system-signal=DET_AZIMUTH_ERR_204}, {application-record-element=DET_BELOW_RAIN_THOLD_201, system-signal=DET_BELOW_RAIN_THOLD_201}, {application-record-element=DET_BELOW_RAIN_THOLD_202, system-signal=DET_BELOW_RAIN_THOLD_202}, {application-record-element=DET_BELOW_RAIN_THOLD_203, system-signal=DET_BELOW_RAIN_THOLD_203}, {application-record-element=DET_BELOW_RAIN_THOLD_204, system-signal=DET_BELOW_RAIN_THOLD_204}, {application-record-element=DET_BI_STATIC_FLAG_201, system-signal=DET_BI_STATIC_FLAG_201}, {application-record-element=DET_BI_STATIC_FLAG_202, system-signal=DET_BI_STATIC_FLAG_202}, {application-record-element=DET_BI_STATIC_FLAG_203, system-signal=DET_BI_STATIC_FLAG_203}, {application-record-element=DET_BI_STATIC_FLAG_204, system-signal=DET_BI_STATIC_FLAG_204}, {application-record-element=DET_CONFD_AZIMUTH_201, system-signal=DET_CONFD_AZIMUTH_201}, {application-record-element=DET_CONFD_AZIMUTH_202, system-signal=DET_CONFD_AZIMUTH_202}, {application-record-element=DET_CONFD_AZIMUTH_203, system-signal=DET_CONFD_AZIMUTH_203}, {application-record-element=DET_CONFD_AZIMUTH_204, system-signal=DET_CONFD_AZIMUTH_204}, {application-record-element=DET_CONFD_ELEVATION_201, system-signal=DET_CONFD_ELEVATION_201}, {application-record-element=DET_CONFD_ELEVATION_202, system-signal=DET_CONFD_ELEVATION_202}, {application-record-element=DET_CONFD_ELEVATION_203, system-signal=DET_CONFD_ELEVATION_203}, {application-record-element=DET_CONFD_ELEVATION_204, system-signal=DET_CONFD_ELEVATION_204}, {application-record-element=DET_ELEVATION_201, system-signal=DET_ELEVATION_201}, {application-record-element=DET_ELEVATION_202, system-signal=DET_ELEVATION_202}, {application-record-element=DET_ELEVATION_203, system-signal=DET_ELEVATION_203}, {application-record-element=DET_ELEVATION_204, system-signal=DET_ELEVATION_204}, {application-record-element=DET_ELEVATION_ERR_201, system-signal=DET_ELEVATION_ERR_201}, {application-record-element=DET_ELEVATION_ERR_202, system-signal=DET_ELEVATION_ERR_202}, {application-record-element=DET_ELEVATION_ERR_203, system-signal=DET_ELEVATION_ERR_203}, {application-record-element=DET_ELEVATION_ERR_204, system-signal=DET_ELEVATION_ERR_204}, {application-record-element=DET_EXISTENCE_PROB_201, system-signal=DET_EXISTENCE_PROB_201}, {application-record-element=DET_EXISTENCE_PROB_202, system-signal=DET_EXISTENCE_PROB_202}, {application-record-element=DET_EXISTENCE_PROB_203, system-signal=DET_EXISTENCE_PROB_203}, {application-record-element=DET_EXISTENCE_PROB_204, system-signal=DET_EXISTENCE_PROB_204}, {application-record-element=DET_HVC_FLAG_201, system-signal=DET_HVC_FLAG_201}, {application-record-element=DET_HVC_FLAG_202, system-signal=DET_HVC_FLAG_202}, {application-record-element=DET_HVC_FLAG_203, system-signal=DET_HVC_FLAG_203}, {application-record-element=DET_HVC_FLAG_204, system-signal=DET_HVC_FLAG_204}, {application-record-element=DET_IDM_201, system-signal=DET_IDM_201}, {application-record-element=DET_IDM_202, system-signal=DET_IDM_202}, {application-record-element=DET_IDM_203, system-signal=DET_IDM_203}, {application-record-element=DET_IDM_204, system-signal=DET_IDM_204}, {application-record-element=DET_MH_CRC16_201_204, system-signal=DET_MH_CRC16_201_204}, {application-record-element=DET_MH_CYCLE_COUNTER_201_204, system-signal=DET_MH_CYCLE_COUNTER_201_204}, {application-record-element=DET_MH_SCAN_INDEX_4LSB_201_204, system-signal=DET_MH_SCAN_INDEX_4LSB_201_204}, {application-record-element=DET_MTD_201, system-signal=DET_MTD_201}, {application-record-element=DET_MTD_202, system-signal=DET_MTD_202}, {application-record-element=DET_MTD_203, system-signal=DET_MTD_203}, {application-record-element=DET_MTD_204, system-signal=DET_MTD_204}, {application-record-element=DET_PROB_1STAZHYPO_201, system-signal=DET_PROB_1STAZHYPO_201}, {application-record-element=DET_PROB_1STAZHYPO_202, system-signal=DET_PROB_1STAZHYPO_202}, {application-record-element=DET_PROB_1STAZHYPO_203, system-signal=DET_PROB_1STAZHYPO_203}, {application-record-element=DET_PROB_1STAZHYPO_204, system-signal=DET_PROB_1STAZHYPO_204}, {application-record-element=DET_RANGE_201, system-signal=DET_RANGE_201}, {application-record-element=DET_RANGE_202, system-signal=DET_RANGE_202}, {application-record-element=DET_RANGE_203, system-signal=DET_RANGE_203}, {application-record-element=DET_RANGE_204, system-signal=DET_RANGE_204}, {application-record-element=DET_RANGE_ERR_201, system-signal=DET_RANGE_ERR_201}, {application-record-element=DET_RANGE_ERR_202, system-signal=DET_RANGE_ERR_202}, {application-record-element=DET_RANGE_ERR_203, system-signal=DET_RANGE_ERR_203}, {application-record-element=DET_RANGE_ERR_204, system-signal=DET_RANGE_ERR_204}, {application-record-element=DET_RANGE_VELOCITY_201, system-signal=DET_RANGE_VELOCITY_201}, {application-record-element=DET_RANGE_VELOCITY_202, system-signal=DET_RANGE_VELOCITY_202}, {application-record-element=DET_RANGE_VELOCITY_203, system-signal=DET_RANGE_VELOCITY_203}, {application-record-element=DET_RANGE_VELOCITY_204, system-signal=DET_RANGE_VELOCITY_204}, {application-record-element=DET_RANGE_VELOCITY_ERR_201, system-signal=DET_RANGE_VELOCITY_ERR_201}, {application-record-element=DET_RANGE_VELOCITY_ERR_202, system-signal=DET_RANGE_VELOCITY_ERR_202}, {application-record-element=DET_RANGE_VELOCITY_ERR_203, system-signal=DET_RANGE_VELOCITY_ERR_203}, {application-record-element=DET_RANGE_VELOCITY_ERR_204, system-signal=DET_RANGE_VELOCITY_ERR_204}, {application-record-element=DET_RCS_201, system-signal=DET_RCS_201}, {application-record-element=DET_RCS_202, system-signal=DET_RCS_202}, {application-record-element=DET_RCS_203, system-signal=DET_RCS_203}, {application-record-element=DET_RCS_204, system-signal=DET_RCS_204}, {application-record-element=DET_SNR_201, system-signal=DET_SNR_201}, {application-record-element=DET_SNR_202, system-signal=DET_SNR_202}, {application-record-element=DET_SNR_203, system-signal=DET_SNR_203}, {application-record-element=DET_SNR_204, system-signal=DET_SNR_204}, {application-record-element=DET_SUPER_RES_TARGET_201, system-signal=DET_SUPER_RES_TARGET_201}, {application-record-element=DET_SUPER_RES_TARGET_202, system-signal=DET_SUPER_RES_TARGET_202}, {application-record-element=DET_SUPER_RES_TARGET_203, system-signal=DET_SUPER_RES_TARGET_203}, {application-record-element=DET_SUPER_RES_TARGET_204, system-signal=DET_SUPER_RES_TARGET_204}]}
        sender-receiver-to-signal-group-mapping={data-element=COMPOSITIONTYPE.Pp_SG_Detections_205_208_AL.Vdp_SG_Detections_205_208_AL, signal-group=SG_Detections_205_208, type-mapping=sender-rec-record-type-mapping=record-element-mappings=[{application-record-element=DET_AZIMUTH_205, system-signal=DET_AZIMUTH_205}, {application-record-element=DET_AZIMUTH_206, system-signal=DET_AZIMUTH_206}, {application-record-element=DET_AZIMUTH_207, system-signal=DET_AZIMUTH_207}, {application-record-element=DET_AZIMUTH_208, system-signal=DET_AZIMUTH_208}, {application-record-element=DET_AZIMUTH_ERR_205, system-signal=DET_AZIMUTH_ERR_205}, {application-record-element=DET_AZIMUTH_ERR_206, system-signal=DET_AZIMUTH_ERR_206}, {application-record-element=DET_AZIMUTH_ERR_207, system-signal=DET_AZIMUTH_ERR_207}, {application-record-element=DET_AZIMUTH_ERR_208, system-signal=DET_AZIMUTH_ERR_208}, {application-record-element=DET_BELOW_RAIN_THOLD_205, system-signal=DET_BELOW_RAIN_THOLD_205}, {application-record-element=DET_BELOW_RAIN_THOLD_206, system-signal=DET_BELOW_RAIN_THOLD_206}, {application-record-element=DET_BELOW_RAIN_THOLD_207, system-signal=DET_BELOW_RAIN_THOLD_207}, {application-record-element=DET_BELOW_RAIN_THOLD_208, system-signal=DET_BELOW_RAIN_THOLD_208}, {application-record-element=DET_BI_STATIC_FLAG_205, system-signal=DET_BI_STATIC_FLAG_205}, {application-record-element=DET_BI_STATIC_FLAG_206, system-signal=DET_BI_STATIC_FLAG_206}, {application-record-element=DET_BI_STATIC_FLAG_207, system-signal=DET_BI_STATIC_FLAG_207}, {application-record-element=DET_BI_STATIC_FLAG_208, system-signal=DET_BI_STATIC_FLAG_208}, {application-record-element=DET_CONFD_AZIMUTH_205, system-signal=DET_CONFD_AZIMUTH_205}, {application-record-element=DET_CONFD_AZIMUTH_206, system-signal=DET_CONFD_AZIMUTH_206}, {application-record-element=DET_CONFD_AZIMUTH_207, system-signal=DET_CONFD_AZIMUTH_207}, {application-record-element=DET_CONFD_AZIMUTH_208, system-signal=DET_CONFD_AZIMUTH_208}, {application-record-element=DET_CONFD_ELEVATION_205, system-signal=DET_CONFD_ELEVATION_205}, {application-record-element=DET_CONFD_ELEVATION_206, system-signal=DET_CONFD_ELEVATION_206}, {application-record-element=DET_CONFD_ELEVATION_207, system-signal=DET_CONFD_ELEVATION_207}, {application-record-element=DET_CONFD_ELEVATION_208, system-signal=DET_CONFD_ELEVATION_208}, {application-record-element=DET_ELEVATION_205, system-signal=DET_ELEVATION_205}, {application-record-element=DET_ELEVATION_206, system-signal=DET_ELEVATION_206}, {application-record-element=DET_ELEVATION_207, system-signal=DET_ELEVATION_207}, {application-record-element=DET_ELEVATION_208, system-signal=DET_ELEVATION_208}, {application-record-element=DET_ELEVATION_ERR_205, system-signal=DET_ELEVATION_ERR_205}, {application-record-element=DET_ELEVATION_ERR_206, system-signal=DET_ELEVATION_ERR_206}, {application-record-element=DET_ELEVATION_ERR_207, system-signal=DET_ELEVATION_ERR_207}, {application-record-element=DET_ELEVATION_ERR_208, system-signal=DET_ELEVATION_ERR_208}, {application-record-element=DET_EXISTENCE_PROB_205, system-signal=DET_EXISTENCE_PROB_205}, {application-record-element=DET_EXISTENCE_PROB_206, system-signal=DET_EXISTENCE_PROB_206}, {application-record-element=DET_EXISTENCE_PROB_207, system-signal=DET_EXISTENCE_PROB_207}, {application-record-element=DET_EXISTENCE_PROB_208, system-signal=DET_EXISTENCE_PROB_208}, {application-record-element=DET_HVC_FLAG_205, system-signal=DET_HVC_FLAG_205}, {application-record-element=DET_HVC_FLAG_206, system-signal=DET_HVC_FLAG_206}, {application-record-element=DET_HVC_FLAG_207, system-signal=DET_HVC_FLAG_207}, {application-record-element=DET_HVC_FLAG_208, system-signal=DET_HVC_FLAG_208}, {application-record-element=DET_IDM_205, system-signal=DET_IDM_205}, {application-record-element=DET_IDM_206, system-signal=DET_IDM_206}, {application-record-element=DET_IDM_207, system-signal=DET_IDM_207}, {application-record-element=DET_IDM_208, system-signal=DET_IDM_208}, {application-record-element=DET_MH_CRC16_205_208, system-signal=DET_MH_CRC16_205_208}, {application-record-element=DET_MH_CYCLE_COUNTER_205_208, system-signal=DET_MH_CYCLE_COUNTER_205_208}, {application-record-element=DET_MH_SCAN_INDEX_4LSB_205_208, system-signal=DET_MH_SCAN_INDEX_4LSB_205_208}, {application-record-element=DET_MTD_205, system-signal=DET_MTD_205}, {application-record-element=DET_MTD_206, system-signal=DET_MTD_206}, {application-record-element=DET_MTD_207, system-signal=DET_MTD_207}, {application-record-element=DET_MTD_208, system-signal=DET_MTD_208}, {application-record-element=DET_PROB_1STAZHYPO_205, system-signal=DET_PROB_1STAZHYPO_205}, {application-record-element=DET_PROB_1STAZHYPO_206, system-signal=DET_PROB_1STAZHYPO_206}, {application-record-element=DET_PROB_1STAZHYPO_207, system-signal=DET_PROB_1STAZHYPO_207}, {application-record-element=DET_PROB_1STAZHYPO_208, system-signal=DET_PROB_1STAZHYPO_208}, {application-record-element=DET_RANGE_205, system-signal=DET_RANGE_205}, {application-record-element=DET_RANGE_206, system-signal=DET_RANGE_206}, {application-record-element=DET_RANGE_207, system-signal=DET_RANGE_207}, {application-record-element=DET_RANGE_208, system-signal=DET_RANGE_208}, {application-record-element=DET_RANGE_ERR_205, system-signal=DET_RANGE_ERR_205}, {application-record-element=DET_RANGE_ERR_206, system-signal=DET_RANGE_ERR_206}, {application-record-element=DET_RANGE_ERR_207, system-signal=DET_RANGE_ERR_207}, {application-record-element=DET_RANGE_ERR_208, system-signal=DET_RANGE_ERR_208}, {application-record-element=DET_RANGE_VELOCITY_205, system-signal=DET_RANGE_VELOCITY_205}, {application-record-element=DET_RANGE_VELOCITY_206, system-signal=DET_RANGE_VELOCITY_206}, {application-record-element=DET_RANGE_VELOCITY_207, system-signal=DET_RANGE_VELOCITY_207}, {application-record-element=DET_RANGE_VELOCITY_208, system-signal=DET_RANGE_VELOCITY_208}, {application-record-element=DET_RANGE_VELOCITY_ERR_205, system-signal=DET_RANGE_VELOCITY_ERR_205}, {application-record-element=DET_RANGE_VELOCITY_ERR_206, system-signal=DET_RANGE_VELOCITY_ERR_206}, {application-record-element=DET_RANGE_VELOCITY_ERR_207, system-signal=DET_RANGE_VELOCITY_ERR_207}, {application-record-element=DET_RANGE_VELOCITY_ERR_208, system-signal=DET_RANGE_VELOCITY_ERR_208}, {application-record-element=DET_RCS_205, system-signal=DET_RCS_205}, {application-record-element=DET_RCS_206, system-signal=DET_RCS_206}, {application-record-element=DET_RCS_207, system-signal=DET_RCS_207}, {application-record-element=DET_RCS_208, system-signal=DET_RCS_208}, {application-record-element=DET_SNR_205, system-signal=DET_SNR_205}, {application-record-element=DET_SNR_206, system-signal=DET_SNR_206}, {application-record-element=DET_SNR_207, system-signal=DET_SNR_207}, {application-record-element=DET_SNR_208, system-signal=DET_SNR_208}, {application-record-element=DET_SUPER_RES_TARGET_205, system-signal=DET_SUPER_RES_TARGET_205}, {application-record-element=DET_SUPER_RES_TARGET_206, system-signal=DET_SUPER_RES_TARGET_206}, {application-record-element=DET_SUPER_RES_TARGET_207, system-signal=DET_SUPER_RES_TARGET_207}, {application-record-element=DET_SUPER_RES_TARGET_208, system-signal=DET_SUPER_RES_TARGET_208}]}
        sender-receiver-to-signal-group-mapping={data-element=COMPOSITIONTYPE.Pp_SG_Detections_209_212_AL.Vdp_SG_Detections_209_212_AL, signal-group=SG_Detections_209_212, type-mapping=sender-rec-record-type-mapping=record-element-mappings=[{application-record-element=DET_AZIMUTH_209, system-signal=DET_AZIMUTH_209}, {application-record-element=DET_AZIMUTH_210, system-signal=DET_AZIMUTH_210}, {application-record-element=DET_AZIMUTH_211, system-signal=DET_AZIMUTH_211}, {application-record-element=DET_AZIMUTH_212, system-signal=DET_AZIMUTH_212}, {application-record-element=DET_AZIMUTH_ERR_209, system-signal=DET_AZIMUTH_ERR_209}, {application-record-element=DET_AZIMUTH_ERR_210, system-signal=DET_AZIMUTH_ERR_210}, {application-record-element=DET_AZIMUTH_ERR_211, system-signal=DET_AZIMUTH_ERR_211}, {application-record-element=DET_AZIMUTH_ERR_212, system-signal=DET_AZIMUTH_ERR_212}, {application-record-element=DET_BELOW_RAIN_THOLD_209, system-signal=DET_BELOW_RAIN_THOLD_209}, {application-record-element=DET_BELOW_RAIN_THOLD_210, system-signal=DET_BELOW_RAIN_THOLD_210}, {application-record-element=DET_BELOW_RAIN_THOLD_211, system-signal=DET_BELOW_RAIN_THOLD_211}, {application-record-element=DET_BELOW_RAIN_THOLD_212, system-signal=DET_BELOW_RAIN_THOLD_212}, {application-record-element=DET_BI_STATIC_FLAG_209, system-signal=DET_BI_STATIC_FLAG_209}, {application-record-element=DET_BI_STATIC_FLAG_210, system-signal=DET_BI_STATIC_FLAG_210}, {application-record-element=DET_BI_STATIC_FLAG_211, system-signal=DET_BI_STATIC_FLAG_211}, {application-record-element=DET_BI_STATIC_FLAG_212, system-signal=DET_BI_STATIC_FLAG_212}, {application-record-element=DET_CONFD_AZIMUTH_209, system-signal=DET_CONFD_AZIMUTH_209}, {application-record-element=DET_CONFD_AZIMUTH_210, system-signal=DET_CONFD_AZIMUTH_210}, {application-record-element=DET_CONFD_AZIMUTH_211, system-signal=DET_CONFD_AZIMUTH_211}, {application-record-element=DET_CONFD_AZIMUTH_212, system-signal=DET_CONFD_AZIMUTH_212}, {application-record-element=DET_CONFD_ELEVATION_209, system-signal=DET_CONFD_ELEVATION_209}, {application-record-element=DET_CONFD_ELEVATION_210, system-signal=DET_CONFD_ELEVATION_210}, {application-record-element=DET_CONFD_ELEVATION_211, system-signal=DET_CONFD_ELEVATION_211}, {application-record-element=DET_CONFD_ELEVATION_212, system-signal=DET_CONFD_ELEVATION_212}, {application-record-element=DET_ELEVATION_209, system-signal=DET_ELEVATION_209}, {application-record-element=DET_ELEVATION_210, system-signal=DET_ELEVATION_210}, {application-record-element=DET_ELEVATION_211, system-signal=DET_ELEVATION_211}, {application-record-element=DET_ELEVATION_212, system-signal=DET_ELEVATION_212}, {application-record-element=DET_ELEVATION_ERR_209, system-signal=DET_ELEVATION_ERR_209}, {application-record-element=DET_ELEVATION_ERR_210, system-signal=DET_ELEVATION_ERR_210}, {application-record-element=DET_ELEVATION_ERR_211, system-signal=DET_ELEVATION_ERR_211}, {application-record-element=DET_ELEVATION_ERR_212, system-signal=DET_ELEVATION_ERR_212}, {application-record-element=DET_EXISTENCE_PROB_209, system-signal=DET_EXISTENCE_PROB_209}, {application-record-element=DET_EXISTENCE_PROB_210, system-signal=DET_EXISTENCE_PROB_210}, {application-record-element=DET_EXISTENCE_PROB_211, system-signal=DET_EXISTENCE_PROB_211}, {application-record-element=DET_EXISTENCE_PROB_212, system-signal=DET_EXISTENCE_PROB_212}, {application-record-element=DET_HVC_FLAG_209, system-signal=DET_HVC_FLAG_209}, {application-record-element=DET_HVC_FLAG_210, system-signal=DET_HVC_FLAG_210}, {application-record-element=DET_HVC_FLAG_211, system-signal=DET_HVC_FLAG_211}, {application-record-element=DET_HVC_FLAG_212, system-signal=DET_HVC_FLAG_212}, {application-record-element=DET_IDM_209, system-signal=DET_IDM_209}, {application-record-element=DET_IDM_210, system-signal=DET_IDM_210}, {application-record-element=DET_IDM_211, system-signal=DET_IDM_211}, {application-record-element=DET_IDM_212, system-signal=DET_IDM_212}, {application-record-element=DET_MH_CRC16_209_212, system-signal=DET_MH_CRC16_209_212}, {application-record-element=DET_MH_CYCLE_COUNTER_209_212, system-signal=DET_MH_CYCLE_COUNTER_209_212}, {application-record-element=DET_MH_SCAN_INDEX_4LSB_209_212, system-signal=DET_MH_SCAN_INDEX_4LSB_209_212}, {application-record-element=DET_MTD_209, system-signal=DET_MTD_209}, {application-record-element=DET_MTD_210, system-signal=DET_MTD_210}, {application-record-element=DET_MTD_211, system-signal=DET_MTD_211}, {application-record-element=DET_MTD_212, system-signal=DET_MTD_212}, {application-record-element=DET_PROB_1STAZHYPO_209, system-signal=DET_PROB_1STAZHYPO_209}, {application-record-element=DET_PROB_1STAZHYPO_210, system-signal=DET_PROB_1STAZHYPO_210}, {application-record-element=DET_PROB_1STAZHYPO_211, system-signal=DET_PROB_1STAZHYPO_211}, {application-record-element=DET_PROB_1STAZHYPO_212, system-signal=DET_PROB_1STAZHYPO_212}, {application-record-element=DET_RANGE_209, system-signal=DET_RANGE_209}, {application-record-element=DET_RANGE_210, system-signal=DET_RANGE_210}, {application-record-element=DET_RANGE_211, system-signal=DET_RANGE_211}, {application-record-element=DET_RANGE_212, system-signal=DET_RANGE_212}, {application-record-element=DET_RANGE_ERR_209, system-signal=DET_RANGE_ERR_209}, {application-record-element=DET_RANGE_ERR_210, system-signal=DET_RANGE_ERR_210}, {application-record-element=DET_RANGE_ERR_211, system-signal=DET_RANGE_ERR_211}, {application-record-element=DET_RANGE_ERR_212, system-signal=DET_RANGE_ERR_212}, {application-record-element=DET_RANGE_VELOCITY_209, system-signal=DET_RANGE_VELOCITY_209}, {application-record-element=DET_RANGE_VELOCITY_210, system-signal=DET_RANGE_VELOCITY_210}, {application-record-element=DET_RANGE_VELOCITY_211, system-signal=DET_RANGE_VELOCITY_211}, {application-record-element=DET_RANGE_VELOCITY_212, system-signal=DET_RANGE_VELOCITY_212}, {application-record-element=DET_RANGE_VELOCITY_ERR_209, system-signal=DET_RANGE_VELOCITY_ERR_209}, {application-record-element=DET_RANGE_VELOCITY_ERR_210, system-signal=DET_RANGE_VELOCITY_ERR_210}, {application-record-element=DET_RANGE_VELOCITY_ERR_211, system-signal=DET_RANGE_VELOCITY_ERR_211}, {application-record-element=DET_RANGE_VELOCITY_ERR_212, system-signal=DET_RANGE_VELOCITY_ERR_212}, {application-record-element=DET_RCS_209, system-signal=DET_RCS_209}, {application-record-element=DET_RCS_210, system-signal=DET_RCS_210}, {application-record-element=DET_RCS_211, system-signal=DET_RCS_211}, {application-record-element=DET_RCS_212, system-signal=DET_RCS_212}, {application-record-element=DET_SNR_209, system-signal=DET_SNR_209}, {application-record-element=DET_SNR_210, system-signal=DET_SNR_210}, {application-record-element=DET_SNR_211, system-signal=DET_SNR_211}, {application-record-element=DET_SNR_212, system-signal=DET_SNR_212}, {application-record-element=DET_SUPER_RES_TARGET_209, system-signal=DET_SUPER_RES_TARGET_209}, {application-record-element=DET_SUPER_RES_TARGET_210, system-signal=DET_SUPER_RES_TARGET_210}, {application-record-element=DET_SUPER_RES_TARGET_211, system-signal=DET_SUPER_RES_TARGET_211}, {application-record-element=DET_SUPER_RES_TARGET_212, system-signal=DET_SUPER_RES_TARGET_212}]}
        sender-receiver-to-signal-group-mapping={data-element=COMPOSITIONTYPE.Pp_SG_Detections_213_216_AL.Vdp_SG_Detections_213_216_AL, signal-group=SG_Detections_213_216, type-mapping=sender-rec-record-type-mapping=record-element-mappings=[{application-record-element=DET_AZIMUTH_213, system-signal=DET_AZIMUTH_213}, {application-record-element=DET_AZIMUTH_214, system-signal=DET_AZIMUTH_214}, {application-record-element=DET_AZIMUTH_215, system-signal=DET_AZIMUTH_215}, {application-record-element=DET_AZIMUTH_216, system-signal=DET_AZIMUTH_216}, {application-record-element=DET_AZIMUTH_ERR_213, system-signal=DET_AZIMUTH_ERR_213}, {application-record-element=DET_AZIMUTH_ERR_214, system-signal=DET_AZIMUTH_ERR_214}, {application-record-element=DET_AZIMUTH_ERR_215, system-signal=DET_AZIMUTH_ERR_215}, {application-record-element=DET_AZIMUTH_ERR_216, system-signal=DET_AZIMUTH_ERR_216}, {application-record-element=DET_BELOW_RAIN_THOLD_213, system-signal=DET_BELOW_RAIN_THOLD_213}, {application-record-element=DET_BELOW_RAIN_THOLD_214, system-signal=DET_BELOW_RAIN_THOLD_214}, {application-record-element=DET_BELOW_RAIN_THOLD_215, system-signal=DET_BELOW_RAIN_THOLD_215}, {application-record-element=DET_BELOW_RAIN_THOLD_216, system-signal=DET_BELOW_RAIN_THOLD_216}, {application-record-element=DET_BI_STATIC_FLAG_213, system-signal=DET_BI_STATIC_FLAG_213}, {application-record-element=DET_BI_STATIC_FLAG_214, system-signal=DET_BI_STATIC_FLAG_214}, {application-record-element=DET_BI_STATIC_FLAG_215, system-signal=DET_BI_STATIC_FLAG_215}, {application-record-element=DET_BI_STATIC_FLAG_216, system-signal=DET_BI_STATIC_FLAG_216}, {application-record-element=DET_CONFD_AZIMUTH_213, system-signal=DET_CONFD_AZIMUTH_213}, {application-record-element=DET_CONFD_AZIMUTH_214, system-signal=DET_CONFD_AZIMUTH_214}, {application-record-element=DET_CONFD_AZIMUTH_215, system-signal=DET_CONFD_AZIMUTH_215}, {application-record-element=DET_CONFD_AZIMUTH_216, system-signal=DET_CONFD_AZIMUTH_216}, {application-record-element=DET_CONFD_ELEVATION_213, system-signal=DET_CONFD_ELEVATION_213}, {application-record-element=DET_CONFD_ELEVATION_214, system-signal=DET_CONFD_ELEVATION_214}, {application-record-element=DET_CONFD_ELEVATION_215, system-signal=DET_CONFD_ELEVATION_215}, {application-record-element=DET_CONFD_ELEVATION_216, system-signal=DET_CONFD_ELEVATION_216}, {application-record-element=DET_ELEVATION_213, system-signal=DET_ELEVATION_213}, {application-record-element=DET_ELEVATION_214, system-signal=DET_ELEVATION_214}, {application-record-element=DET_ELEVATION_215, system-signal=DET_ELEVATION_215}, {application-record-element=DET_ELEVATION_216, system-signal=DET_ELEVATION_216}, {application-record-element=DET_ELEVATION_ERR_213, system-signal=DET_ELEVATION_ERR_213}, {application-record-element=DET_ELEVATION_ERR_214, system-signal=DET_ELEVATION_ERR_214}, {application-record-element=DET_ELEVATION_ERR_215, system-signal=DET_ELEVATION_ERR_215}, {application-record-element=DET_ELEVATION_ERR_216, system-signal=DET_ELEVATION_ERR_216}, {application-record-element=DET_EXISTENCE_PROB_213, system-signal=DET_EXISTENCE_PROB_213}, {application-record-element=DET_EXISTENCE_PROB_214, system-signal=DET_EXISTENCE_PROB_214}, {application-record-element=DET_EXISTENCE_PROB_215, system-signal=DET_EXISTENCE_PROB_215}, {application-record-element=DET_EXISTENCE_PROB_216, system-signal=DET_EXISTENCE_PROB_216}, {application-record-element=DET_HVC_FLAG_213, system-signal=DET_HVC_FLAG_213}, {application-record-element=DET_HVC_FLAG_214, system-signal=DET_HVC_FLAG_214}, {application-record-element=DET_HVC_FLAG_215, system-signal=DET_HVC_FLAG_215}, {application-record-element=DET_HVC_FLAG_216, system-signal=DET_HVC_FLAG_216}, {application-record-element=DET_IDM_213, system-signal=DET_IDM_213}, {application-record-element=DET_IDM_214, system-signal=DET_IDM_214}, {application-record-element=DET_IDM_215, system-signal=DET_IDM_215}, {application-record-element=DET_IDM_216, system-signal=DET_IDM_216}, {application-record-element=DET_MH_CRC16_213_216, system-signal=DET_MH_CRC16_213_216}, {application-record-element=DET_MH_CYCLE_COUNTER_213_216, system-signal=DET_MH_CYCLE_COUNTER_213_216}, {application-record-element=DET_MH_SCAN_INDEX_4LSB_213_216, system-signal=DET_MH_SCAN_INDEX_4LSB_213_216}, {application-record-element=DET_MTD_213, system-signal=DET_MTD_213}, {application-record-element=DET_MTD_214, system-signal=DET_MTD_214}, {application-record-element=DET_MTD_215, system-signal=DET_MTD_215}, {application-record-element=DET_MTD_216, system-signal=DET_MTD_216}, {application-record-element=DET_PROB_1STAZHYPO_213, system-signal=DET_PROB_1STAZHYPO_213}, {application-record-element=DET_PROB_1STAZHYPO_214, system-signal=DET_PROB_1STAZHYPO_214}, {application-record-element=DET_PROB_1STAZHYPO_215, system-signal=DET_PROB_1STAZHYPO_215}, {application-record-element=DET_PROB_1STAZHYPO_216, system-signal=DET_PROB_1STAZHYPO_216}, {application-record-element=DET_RANGE_213, system-signal=DET_RANGE_213}, {application-record-element=DET_RANGE_214, system-signal=DET_RANGE_214}, {application-record-element=DET_RANGE_215, system-signal=DET_RANGE_215}, {application-record-element=DET_RANGE_216, system-signal=DET_RANGE_216}, {application-record-element=DET_RANGE_ERR_213, system-signal=DET_RANGE_ERR_213}, {application-record-element=DET_RANGE_ERR_214, system-signal=DET_RANGE_ERR_214}, {application-record-element=DET_RANGE_ERR_215, system-signal=DET_RANGE_ERR_215}, {application-record-element=DET_RANGE_ERR_216, system-signal=DET_RANGE_ERR_216}, {application-record-element=DET_RANGE_VELOCITY_213, system-signal=DET_RANGE_VELOCITY_213}, {application-record-element=DET_RANGE_VELOCITY_214, system-signal=DET_RANGE_VELOCITY_214}, {application-record-element=DET_RANGE_VELOCITY_215, system-signal=DET_RANGE_VELOCITY_215}, {application-record-element=DET_RANGE_VELOCITY_216, system-signal=DET_RANGE_VELOCITY_216}, {application-record-element=DET_RANGE_VELOCITY_ERR_213, system-signal=DET_RANGE_VELOCITY_ERR_213}, {application-record-element=DET_RANGE_VELOCITY_ERR_214, system-signal=DET_RANGE_VELOCITY_ERR_214}, {application-record-element=DET_RANGE_VELOCITY_ERR_215, system-signal=DET_RANGE_VELOCITY_ERR_215}, {application-record-element=DET_RANGE_VELOCITY_ERR_216, system-signal=DET_RANGE_VELOCITY_ERR_216}, {application-record-element=DET_RCS_213, system-signal=DET_RCS_213}, {application-record-element=DET_RCS_214, system-signal=DET_RCS_214}, {application-record-element=DET_RCS_215, system-signal=DET_RCS_215}, {application-record-element=DET_RCS_216, system-signal=DET_RCS_216}, {application-record-element=DET_SNR_213, system-signal=DET_SNR_213}, {application-record-element=DET_SNR_214, system-signal=DET_SNR_214}, {application-record-element=DET_SNR_215, system-signal=DET_SNR_215}, {application-record-element=DET_SNR_216, system-signal=DET_SNR_216}, {application-record-element=DET_SUPER_RES_TARGET_213, system-signal=DET_SUPER_RES_TARGET_213}, {application-record-element=DET_SUPER_RES_TARGET_214, system-signal=DET_SUPER_RES_TARGET_214}, {application-record-element=DET_SUPER_RES_TARGET_215, system-signal=DET_SUPER_RES_TARGET_215}, {application-record-element=DET_SUPER_RES_TARGET_216, system-signal=DET_SUPER_RES_TARGET_216}]}
        sender-receiver-to-signal-group-mapping={data-element=COMPOSITIONTYPE.Pp_SG_Detections_217_220_AL.Vdp_SG_Detections_217_220_AL, signal-group=SG_Detections_217_220, type-mapping=sender-rec-record-type-mapping=record-element-mappings=[{application-record-element=DET_AZIMUTH_217, system-signal=DET_AZIMUTH_217}, {application-record-element=DET_AZIMUTH_218, system-signal=DET_AZIMUTH_218}, {application-record-element=DET_AZIMUTH_219, system-signal=DET_AZIMUTH_219}, {application-record-element=DET_AZIMUTH_220, system-signal=DET_AZIMUTH_220}, {application-record-element=DET_AZIMUTH_ERR_217, system-signal=DET_AZIMUTH_ERR_217}, {application-record-element=DET_AZIMUTH_ERR_218, system-signal=DET_AZIMUTH_ERR_218}, {application-record-element=DET_AZIMUTH_ERR_219, system-signal=DET_AZIMUTH_ERR_219}, {application-record-element=DET_AZIMUTH_ERR_220, system-signal=DET_AZIMUTH_ERR_220}, {application-record-element=DET_BELOW_RAIN_THOLD_217, system-signal=DET_BELOW_RAIN_THOLD_217}, {application-record-element=DET_BELOW_RAIN_THOLD_218, system-signal=DET_BELOW_RAIN_THOLD_218}, {application-record-element=DET_BELOW_RAIN_THOLD_219, system-signal=DET_BELOW_RAIN_THOLD_219}, {application-record-element=DET_BELOW_RAIN_THOLD_220, system-signal=DET_BELOW_RAIN_THOLD_220}, {application-record-element=DET_BI_STATIC_FLAG_217, system-signal=DET_BI_STATIC_FLAG_217}, {application-record-element=DET_BI_STATIC_FLAG_218, system-signal=DET_BI_STATIC_FLAG_218}, {application-record-element=DET_BI_STATIC_FLAG_219, system-signal=DET_BI_STATIC_FLAG_219}, {application-record-element=DET_BI_STATIC_FLAG_220, system-signal=DET_BI_STATIC_FLAG_220}, {application-record-element=DET_CONFD_AZIMUTH_217, system-signal=DET_CONFD_AZIMUTH_217}, {application-record-element=DET_CONFD_AZIMUTH_218, system-signal=DET_CONFD_AZIMUTH_218}, {application-record-element=DET_CONFD_AZIMUTH_219, system-signal=DET_CONFD_AZIMUTH_219}, {application-record-element=DET_CONFD_AZIMUTH_220, system-signal=DET_CONFD_AZIMUTH_220}, {application-record-element=DET_CONFD_ELEVATION_217, system-signal=DET_CONFD_ELEVATION_217}, {application-record-element=DET_CONFD_ELEVATION_218, system-signal=DET_CONFD_ELEVATION_218}, {application-record-element=DET_CONFD_ELEVATION_219, system-signal=DET_CONFD_ELEVATION_219}, {application-record-element=DET_CONFD_ELEVATION_220, system-signal=DET_CONFD_ELEVATION_220}, {application-record-element=DET_ELEVATION_217, system-signal=DET_ELEVATION_217}, {application-record-element=DET_ELEVATION_218, system-signal=DET_ELEVATION_218}, {application-record-element=DET_ELEVATION_219, system-signal=DET_ELEVATION_219}, {application-record-element=DET_ELEVATION_220, system-signal=DET_ELEVATION_220}, {application-record-element=DET_ELEVATION_ERR_217, system-signal=DET_ELEVATION_ERR_217}, {application-record-element=DET_ELEVATION_ERR_218, system-signal=DET_ELEVATION_ERR_218}, {application-record-element=DET_ELEVATION_ERR_219, system-signal=DET_ELEVATION_ERR_219}, {application-record-element=DET_ELEVATION_ERR_220, system-signal=DET_ELEVATION_ERR_220}, {application-record-element=DET_EXISTENCE_PROB_217, system-signal=DET_EXISTENCE_PROB_217}, {application-record-element=DET_EXISTENCE_PROB_218, system-signal=DET_EXISTENCE_PROB_218}, {application-record-element=DET_EXISTENCE_PROB_219, system-signal=DET_EXISTENCE_PROB_219}, {application-record-element=DET_EXISTENCE_PROB_220, system-signal=DET_EXISTENCE_PROB_220}, {application-record-element=DET_HVC_FLAG_217, system-signal=DET_HVC_FLAG_217}, {application-record-element=DET_HVC_FLAG_218, system-signal=DET_HVC_FLAG_218}, {application-record-element=DET_HVC_FLAG_219, system-signal=DET_HVC_FLAG_219}, {application-record-element=DET_HVC_FLAG_220, system-signal=DET_HVC_FLAG_220}, {application-record-element=DET_IDM_217, system-signal=DET_IDM_217}, {application-record-element=DET_IDM_218, system-signal=DET_IDM_218}, {application-record-element=DET_IDM_219, system-signal=DET_IDM_219}, {application-record-element=DET_IDM_220, system-signal=DET_IDM_220}, {application-record-element=DET_MH_CRC16_217_220, system-signal=DET_MH_CRC16_217_220}, {application-record-element=DET_MH_CYCLE_COUNTER_217_220, system-signal=DET_MH_CYCLE_COUNTER_217_220}, {application-record-element=DET_MH_SCAN_INDEX_4LSB_217_220, system-signal=DET_MH_SCAN_INDEX_4LSB_217_220}, {application-record-element=DET_MTD_217, system-signal=DET_MTD_217}, {application-record-element=DET_MTD_218, system-signal=DET_MTD_218}, {application-record-element=DET_MTD_219, system-signal=DET_MTD_219}, {application-record-element=DET_MTD_220, system-signal=DET_MTD_220}, {application-record-element=DET_PROB_1STAZHYPO_217, system-signal=DET_PROB_1STAZHYPO_217}, {application-record-element=DET_PROB_1STAZHYPO_218, system-signal=DET_PROB_1STAZHYPO_218}, {application-record-element=DET_PROB_1STAZHYPO_219, system-signal=DET_PROB_1STAZHYPO_219}, {application-record-element=DET_PROB_1STAZHYPO_220, system-signal=DET_PROB_1STAZHYPO_220}, {application-record-element=DET_RANGE_217, system-signal=DET_RANGE_217}, {application-record-element=DET_RANGE_218, system-signal=DET_RANGE_218}, {application-record-element=DET_RANGE_219, system-signal=DET_RANGE_219}, {application-record-element=DET_RANGE_220, system-signal=DET_RANGE_220}, {application-record-element=DET_RANGE_ERR_217, system-signal=DET_RANGE_ERR_217}, {application-record-element=DET_RANGE_ERR_218, system-signal=DET_RANGE_ERR_218}, {application-record-element=DET_RANGE_ERR_219, system-signal=DET_RANGE_ERR_219}, {application-record-element=DET_RANGE_ERR_220, system-signal=DET_RANGE_ERR_220}, {application-record-element=DET_RANGE_VELOCITY_217, system-signal=DET_RANGE_VELOCITY_217}, {application-record-element=DET_RANGE_VELOCITY_218, system-signal=DET_RANGE_VELOCITY_218}, {application-record-element=DET_RANGE_VELOCITY_219, system-signal=DET_RANGE_VELOCITY_219}, {application-record-element=DET_RANGE_VELOCITY_220, system-signal=DET_RANGE_VELOCITY_220}, {application-record-element=DET_RANGE_VELOCITY_ERR_217, system-signal=DET_RANGE_VELOCITY_ERR_217}, {application-record-element=DET_RANGE_VELOCITY_ERR_218, system-signal=DET_RANGE_VELOCITY_ERR_218}, {application-record-element=DET_RANGE_VELOCITY_ERR_219, system-signal=DET_RANGE_VELOCITY_ERR_219}, {application-record-element=DET_RANGE_VELOCITY_ERR_220, system-signal=DET_RANGE_VELOCITY_ERR_220}, {application-record-element=DET_RCS_217, system-signal=DET_RCS_217}, {application-record-element=DET_RCS_218, system-signal=DET_RCS_218}, {application-record-element=DET_RCS_219, system-signal=DET_RCS_219}, {application-record-element=DET_RCS_220, system-signal=DET_RCS_220}, {application-record-element=DET_SNR_217, system-signal=DET_SNR_217}, {application-record-element=DET_SNR_218, system-signal=DET_SNR_218}, {application-record-element=DET_SNR_219, system-signal=DET_SNR_219}, {application-record-element=DET_SNR_220, system-signal=DET_SNR_220}, {application-record-element=DET_SUPER_RES_TARGET_217, system-signal=DET_SUPER_RES_TARGET_217}, {application-record-element=DET_SUPER_RES_TARGET_218, system-signal=DET_SUPER_RES_TARGET_218}, {application-record-element=DET_SUPER_RES_TARGET_219, system-signal=DET_SUPER_RES_TARGET_219}, {application-record-element=DET_SUPER_RES_TARGET_220, system-signal=DET_SUPER_RES_TARGET_220}]}
        sender-receiver-to-signal-group-mapping={data-element=COMPOSITIONTYPE.Pp_SG_Detections_221_224_AL.Vdp_SG_Detections_221_224_AL, signal-group=SG_Detections_221_224, type-mapping=sender-rec-record-type-mapping=record-element-mappings=[{application-record-element=DET_AZIMUTH_221, system-signal=DET_AZIMUTH_221}, {application-record-element=DET_AZIMUTH_222, system-signal=DET_AZIMUTH_222}, {application-record-element=DET_AZIMUTH_223, system-signal=DET_AZIMUTH_223}, {application-record-element=DET_AZIMUTH_224, system-signal=DET_AZIMUTH_224}, {application-record-element=DET_AZIMUTH_ERR_221, system-signal=DET_AZIMUTH_ERR_221}, {application-record-element=DET_AZIMUTH_ERR_222, system-signal=DET_AZIMUTH_ERR_222}, {application-record-element=DET_AZIMUTH_ERR_223, system-signal=DET_AZIMUTH_ERR_223}, {application-record-element=DET_AZIMUTH_ERR_224, system-signal=DET_AZIMUTH_ERR_224}, {application-record-element=DET_BELOW_RAIN_THOLD_221, system-signal=DET_BELOW_RAIN_THOLD_221}, {application-record-element=DET_BELOW_RAIN_THOLD_222, system-signal=DET_BELOW_RAIN_THOLD_222}, {application-record-element=DET_BELOW_RAIN_THOLD_223, system-signal=DET_BELOW_RAIN_THOLD_223}, {application-record-element=DET_BELOW_RAIN_THOLD_224, system-signal=DET_BELOW_RAIN_THOLD_224}, {application-record-element=DET_BI_STATIC_FLAG_221, system-signal=DET_BI_STATIC_FLAG_221}, {application-record-element=DET_BI_STATIC_FLAG_222, system-signal=DET_BI_STATIC_FLAG_222}, {application-record-element=DET_BI_STATIC_FLAG_223, system-signal=DET_BI_STATIC_FLAG_223}, {application-record-element=DET_BI_STATIC_FLAG_224, system-signal=DET_BI_STATIC_FLAG_224}, {application-record-element=DET_CONFD_AZIMUTH_221, system-signal=DET_CONFD_AZIMUTH_221}, {application-record-element=DET_CONFD_AZIMUTH_222, system-signal=DET_CONFD_AZIMUTH_222}, {application-record-element=DET_CONFD_AZIMUTH_223, system-signal=DET_CONFD_AZIMUTH_223}, {application-record-element=DET_CONFD_AZIMUTH_224, system-signal=DET_CONFD_AZIMUTH_224}, {application-record-element=DET_CONFD_ELEVATION_221, system-signal=DET_CONFD_ELEVATION_221}, {application-record-element=DET_CONFD_ELEVATION_222, system-signal=DET_CONFD_ELEVATION_222}, {application-record-element=DET_CONFD_ELEVATION_223, system-signal=DET_CONFD_ELEVATION_223}, {application-record-element=DET_CONFD_ELEVATION_224, system-signal=DET_CONFD_ELEVATION_224}, {application-record-element=DET_ELEVATION_221, system-signal=DET_ELEVATION_221}, {application-record-element=DET_ELEVATION_222, system-signal=DET_ELEVATION_222}, {application-record-element=DET_ELEVATION_223, system-signal=DET_ELEVATION_223}, {application-record-element=DET_ELEVATION_224, system-signal=DET_ELEVATION_224}, {application-record-element=DET_ELEVATION_ERR_221, system-signal=DET_ELEVATION_ERR_221}, {application-record-element=DET_ELEVATION_ERR_222, system-signal=DET_ELEVATION_ERR_222}, {application-record-element=DET_ELEVATION_ERR_223, system-signal=DET_ELEVATION_ERR_223}, {application-record-element=DET_ELEVATION_ERR_224, system-signal=DET_ELEVATION_ERR_224}, {application-record-element=DET_EXISTENCE_PROB_221, system-signal=DET_EXISTENCE_PROB_221}, {application-record-element=DET_EXISTENCE_PROB_222, system-signal=DET_EXISTENCE_PROB_222}, {application-record-element=DET_EXISTENCE_PROB_223, system-signal=DET_EXISTENCE_PROB_223}, {application-record-element=DET_EXISTENCE_PROB_224, system-signal=DET_EXISTENCE_PROB_224}, {application-record-element=DET_HVC_FLAG_221, system-signal=DET_HVC_FLAG_221}, {application-record-element=DET_HVC_FLAG_222, system-signal=DET_HVC_FLAG_222}, {application-record-element=DET_HVC_FLAG_223, system-signal=DET_HVC_FLAG_223}, {application-record-element=DET_HVC_FLAG_224, system-signal=DET_HVC_FLAG_224}, {application-record-element=DET_IDM_221, system-signal=DET_IDM_221}, {application-record-element=DET_IDM_222, system-signal=DET_IDM_222}, {application-record-element=DET_IDM_223, system-signal=DET_IDM_223}, {application-record-element=DET_IDM_224, system-signal=DET_IDM_224}, {application-record-element=DET_MH_CRC16_221_224, system-signal=DET_MH_CRC16_221_224}, {application-record-element=DET_MH_CYCLE_COUNTER_221_224, system-signal=DET_MH_CYCLE_COUNTER_221_224}, {application-record-element=DET_MH_SCAN_INDEX_4LSB_221_224, system-signal=DET_MH_SCAN_INDEX_4LSB_221_224}, {application-record-element=DET_MTD_221, system-signal=DET_MTD_221}, {application-record-element=DET_MTD_222, system-signal=DET_MTD_222}, {application-record-element=DET_MTD_223, system-signal=DET_MTD_223}, {application-record-element=DET_MTD_224, system-signal=DET_MTD_224}, {application-record-element=DET_PROB_1STAZHYPO_221, system-signal=DET_PROB_1STAZHYPO_221}, {application-record-element=DET_PROB_1STAZHYPO_222, system-signal=DET_PROB_1STAZHYPO_222}, {application-record-element=DET_PROB_1STAZHYPO_223, system-signal=DET_PROB_1STAZHYPO_223}, {application-record-element=DET_PROB_1STAZHYPO_224, system-signal=DET_PROB_1STAZHYPO_224}, {application-record-element=DET_RANGE_221, system-signal=DET_RANGE_221}, {application-record-element=DET_RANGE_222, system-signal=DET_RANGE_222}, {application-record-element=DET_RANGE_223, system-signal=DET_RANGE_223}, {application-record-element=DET_RANGE_224, system-signal=DET_RANGE_224}, {application-record-element=DET_RANGE_ERR_221, system-signal=DET_RANGE_ERR_221}, {application-record-element=DET_RANGE_ERR_222, system-signal=DET_RANGE_ERR_222}, {application-record-element=DET_RANGE_ERR_223, system-signal=DET_RANGE_ERR_223}, {application-record-element=DET_RANGE_ERR_224, system-signal=DET_RANGE_ERR_224}, {application-record-element=DET_RANGE_VELOCITY_221, system-signal=DET_RANGE_VELOCITY_221}, {application-record-element=DET_RANGE_VELOCITY_222, system-signal=DET_RANGE_VELOCITY_222}, {application-record-element=DET_RANGE_VELOCITY_223, system-signal=DET_RANGE_VELOCITY_223}, {application-record-element=DET_RANGE_VELOCITY_224, system-signal=DET_RANGE_VELOCITY_224}, {application-record-element=DET_RANGE_VELOCITY_ERR_221, system-signal=DET_RANGE_VELOCITY_ERR_221}, {application-record-element=DET_RANGE_VELOCITY_ERR_222, system-signal=DET_RANGE_VELOCITY_ERR_222}, {application-record-element=DET_RANGE_VELOCITY_ERR_223, system-signal=DET_RANGE_VELOCITY_ERR_223}, {application-record-element=DET_RANGE_VELOCITY_ERR_224, system-signal=DET_RANGE_VELOCITY_ERR_224}, {application-record-element=DET_RCS_221, system-signal=DET_RCS_221}, {application-record-element=DET_RCS_222, system-signal=DET_RCS_222}, {application-record-element=DET_RCS_223, system-signal=DET_RCS_223}, {application-record-element=DET_RCS_224, system-signal=DET_RCS_224}, {application-record-element=DET_SNR_221, system-signal=DET_SNR_221}, {application-record-element=DET_SNR_222, system-signal=DET_SNR_222}, {application-record-element=DET_SNR_223, system-signal=DET_SNR_223}, {application-record-element=DET_SNR_224, system-signal=DET_SNR_224}, {application-record-element=DET_SUPER_RES_TARGET_221, system-signal=DET_SUPER_RES_TARGET_221}, {application-record-element=DET_SUPER_RES_TARGET_222, system-signal=DET_SUPER_RES_TARGET_222}, {application-record-element=DET_SUPER_RES_TARGET_223, system-signal=DET_SUPER_RES_TARGET_223}, {application-record-element=DET_SUPER_RES_TARGET_224, system-signal=DET_SUPER_RES_TARGET_224}]}
        sender-receiver-to-signal-group-mapping={data-element=COMPOSITIONTYPE.Pp_SG_Detections_225_228_AL.Vdp_SG_Detections_225_228_AL, signal-group=SG_Detections_225_228, type-mapping=sender-rec-record-type-mapping=record-element-mappings=[{application-record-element=DET_AZIMUTH_225, system-signal=DET_AZIMUTH_225}, {application-record-element=DET_AZIMUTH_226, system-signal=DET_AZIMUTH_226}, {application-record-element=DET_AZIMUTH_227, system-signal=DET_AZIMUTH_227}, {application-record-element=DET_AZIMUTH_228, system-signal=DET_AZIMUTH_228}, {application-record-element=DET_AZIMUTH_ERR_225, system-signal=DET_AZIMUTH_ERR_225}, {application-record-element=DET_AZIMUTH_ERR_226, system-signal=DET_AZIMUTH_ERR_226}, {application-record-element=DET_AZIMUTH_ERR_227, system-signal=DET_AZIMUTH_ERR_227}, {application-record-element=DET_AZIMUTH_ERR_228, system-signal=DET_AZIMUTH_ERR_228}, {application-record-element=DET_BELOW_RAIN_THOLD_225, system-signal=DET_BELOW_RAIN_THOLD_225}, {application-record-element=DET_BELOW_RAIN_THOLD_226, system-signal=DET_BELOW_RAIN_THOLD_226}, {application-record-element=DET_BELOW_RAIN_THOLD_227, system-signal=DET_BELOW_RAIN_THOLD_227}, {application-record-element=DET_BELOW_RAIN_THOLD_228, system-signal=DET_BELOW_RAIN_THOLD_228}, {application-record-element=DET_BI_STATIC_FLAG_225, system-signal=DET_BI_STATIC_FLAG_225}, {application-record-element=DET_BI_STATIC_FLAG_226, system-signal=DET_BI_STATIC_FLAG_226}, {application-record-element=DET_BI_STATIC_FLAG_227, system-signal=DET_BI_STATIC_FLAG_227}, {application-record-element=DET_BI_STATIC_FLAG_228, system-signal=DET_BI_STATIC_FLAG_228}, {application-record-element=DET_CONFD_AZIMUTH_225, system-signal=DET_CONFD_AZIMUTH_225}, {application-record-element=DET_CONFD_AZIMUTH_226, system-signal=DET_CONFD_AZIMUTH_226}, {application-record-element=DET_CONFD_AZIMUTH_227, system-signal=DET_CONFD_AZIMUTH_227}, {application-record-element=DET_CONFD_AZIMUTH_228, system-signal=DET_CONFD_AZIMUTH_228}, {application-record-element=DET_CONFD_ELEVATION_225, system-signal=DET_CONFD_ELEVATION_225}, {application-record-element=DET_CONFD_ELEVATION_226, system-signal=DET_CONFD_ELEVATION_226}, {application-record-element=DET_CONFD_ELEVATION_227, system-signal=DET_CONFD_ELEVATION_227}, {application-record-element=DET_CONFD_ELEVATION_228, system-signal=DET_CONFD_ELEVATION_228}, {application-record-element=DET_ELEVATION_225, system-signal=DET_ELEVATION_225}, {application-record-element=DET_ELEVATION_226, system-signal=DET_ELEVATION_226}, {application-record-element=DET_ELEVATION_227, system-signal=DET_ELEVATION_227}, {application-record-element=DET_ELEVATION_228, system-signal=DET_ELEVATION_228}, {application-record-element=DET_ELEVATION_ERR_225, system-signal=DET_ELEVATION_ERR_225}, {application-record-element=DET_ELEVATION_ERR_226, system-signal=DET_ELEVATION_ERR_226}, {application-record-element=DET_ELEVATION_ERR_227, system-signal=DET_ELEVATION_ERR_227}, {application-record-element=DET_ELEVATION_ERR_228, system-signal=DET_ELEVATION_ERR_228}, {application-record-element=DET_EXISTENCE_PROB_225, system-signal=DET_EXISTENCE_PROB_225}, {application-record-element=DET_EXISTENCE_PROB_226, system-signal=DET_EXISTENCE_PROB_226}, {application-record-element=DET_EXISTENCE_PROB_227, system-signal=DET_EXISTENCE_PROB_227}, {application-record-element=DET_EXISTENCE_PROB_228, system-signal=DET_EXISTENCE_PROB_228}, {application-record-element=DET_HVC_FLAG_225, system-signal=DET_HVC_FLAG_225}, {application-record-element=DET_HVC_FLAG_226, system-signal=DET_HVC_FLAG_226}, {application-record-element=DET_HVC_FLAG_227, system-signal=DET_HVC_FLAG_227}, {application-record-element=DET_HVC_FLAG_228, system-signal=DET_HVC_FLAG_228}, {application-record-element=DET_IDM_225, system-signal=DET_IDM_225}, {application-record-element=DET_IDM_226, system-signal=DET_IDM_226}, {application-record-element=DET_IDM_227, system-signal=DET_IDM_227}, {application-record-element=DET_IDM_228, system-signal=DET_IDM_228}, {application-record-element=DET_MH_CRC16_225_228, system-signal=DET_MH_CRC16_225_228}, {application-record-element=DET_MH_CYCLE_COUNTER_225_228, system-signal=DET_MH_CYCLE_COUNTER_225_228}, {application-record-element=DET_MH_SCAN_INDEX_4LSB_225_228, system-signal=DET_MH_SCAN_INDEX_4LSB_225_228}, {application-record-element=DET_MTD_225, system-signal=DET_MTD_225}, {application-record-element=DET_MTD_226, system-signal=DET_MTD_226}, {application-record-element=DET_MTD_227, system-signal=DET_MTD_227}, {application-record-element=DET_MTD_228, system-signal=DET_MTD_228}, {application-record-element=DET_PROB_1STAZHYPO_225, system-signal=DET_PROB_1STAZHYPO_225}, {application-record-element=DET_PROB_1STAZHYPO_226, system-signal=DET_PROB_1STAZHYPO_226}, {application-record-element=DET_PROB_1STAZHYPO_227, system-signal=DET_PROB_1STAZHYPO_227}, {application-record-element=DET_PROB_1STAZHYPO_228, system-signal=DET_PROB_1STAZHYPO_228}, {application-record-element=DET_RANGE_225, system-signal=DET_RANGE_225}, {application-record-element=DET_RANGE_226, system-signal=DET_RANGE_226}, {application-record-element=DET_RANGE_227, system-signal=DET_RANGE_227}, {application-record-element=DET_RANGE_228, system-signal=DET_RANGE_228}, {application-record-element=DET_RANGE_ERR_225, system-signal=DET_RANGE_ERR_225}, {application-record-element=DET_RANGE_ERR_226, system-signal=DET_RANGE_ERR_226}, {application-record-element=DET_RANGE_ERR_227, system-signal=DET_RANGE_ERR_227}, {application-record-element=DET_RANGE_ERR_228, system-signal=DET_RANGE_ERR_228}, {application-record-element=DET_RANGE_VELOCITY_225, system-signal=DET_RANGE_VELOCITY_225}, {application-record-element=DET_RANGE_VELOCITY_226, system-signal=DET_RANGE_VELOCITY_226}, {application-record-element=DET_RANGE_VELOCITY_227, system-signal=DET_RANGE_VELOCITY_227}, {application-record-element=DET_RANGE_VELOCITY_228, system-signal=DET_RANGE_VELOCITY_228}, {application-record-element=DET_RANGE_VELOCITY_ERR_225, system-signal=DET_RANGE_VELOCITY_ERR_225}, {application-record-element=DET_RANGE_VELOCITY_ERR_226, system-signal=DET_RANGE_VELOCITY_ERR_226}, {application-record-element=DET_RANGE_VELOCITY_ERR_227, system-signal=DET_RANGE_VELOCITY_ERR_227}, {application-record-element=DET_RANGE_VELOCITY_ERR_228, system-signal=DET_RANGE_VELOCITY_ERR_228}, {application-record-element=DET_RCS_225, system-signal=DET_RCS_225}, {application-record-element=DET_RCS_226, system-signal=DET_RCS_226}, {application-record-element=DET_RCS_227, system-signal=DET_RCS_227}, {application-record-element=DET_RCS_228, system-signal=DET_RCS_228}, {application-record-element=DET_SNR_225, system-signal=DET_SNR_225}, {application-record-element=DET_SNR_226, system-signal=DET_SNR_226}, {application-record-element=DET_SNR_227, system-signal=DET_SNR_227}, {application-record-element=DET_SNR_228, system-signal=DET_SNR_228}, {application-record-element=DET_SUPER_RES_TARGET_225, system-signal=DET_SUPER_RES_TARGET_225}, {application-record-element=DET_SUPER_RES_TARGET_226, system-signal=DET_SUPER_RES_TARGET_226}, {application-record-element=DET_SUPER_RES_TARGET_227, system-signal=DET_SUPER_RES_TARGET_227}, {application-record-element=DET_SUPER_RES_TARGET_228, system-signal=DET_SUPER_RES_TARGET_228}]}
        sender-receiver-to-signal-group-mapping={data-element=COMPOSITIONTYPE.Pp_SG_Detections_229_232_AL.Vdp_SG_Detections_229_232_AL, signal-group=SG_Detections_229_232, type-mapping=sender-rec-record-type-mapping=record-element-mappings=[{application-record-element=DET_AZIMUTH_229, system-signal=DET_AZIMUTH_229}, {application-record-element=DET_AZIMUTH_230, system-signal=DET_AZIMUTH_230}, {application-record-element=DET_AZIMUTH_231, system-signal=DET_AZIMUTH_231}, {application-record-element=DET_AZIMUTH_232, system-signal=DET_AZIMUTH_232}, {application-record-element=DET_AZIMUTH_ERR_229, system-signal=DET_AZIMUTH_ERR_229}, {application-record-element=DET_AZIMUTH_ERR_230, system-signal=DET_AZIMUTH_ERR_230}, {application-record-element=DET_AZIMUTH_ERR_231, system-signal=DET_AZIMUTH_ERR_231}, {application-record-element=DET_AZIMUTH_ERR_232, system-signal=DET_AZIMUTH_ERR_232}, {application-record-element=DET_BELOW_RAIN_THOLD_229, system-signal=DET_BELOW_RAIN_THOLD_229}, {application-record-element=DET_BELOW_RAIN_THOLD_230, system-signal=DET_BELOW_RAIN_THOLD_230}, {application-record-element=DET_BELOW_RAIN_THOLD_231, system-signal=DET_BELOW_RAIN_THOLD_231}, {application-record-element=DET_BELOW_RAIN_THOLD_232, system-signal=DET_BELOW_RAIN_THOLD_232}, {application-record-element=DET_BI_STATIC_FLAG_229, system-signal=DET_BI_STATIC_FLAG_229}, {application-record-element=DET_BI_STATIC_FLAG_230, system-signal=DET_BI_STATIC_FLAG_230}, {application-record-element=DET_BI_STATIC_FLAG_231, system-signal=DET_BI_STATIC_FLAG_231}, {application-record-element=DET_BI_STATIC_FLAG_232, system-signal=DET_BI_STATIC_FLAG_232}, {application-record-element=DET_CONFD_AZIMUTH_229, system-signal=DET_CONFD_AZIMUTH_229}, {application-record-element=DET_CONFD_AZIMUTH_230, system-signal=DET_CONFD_AZIMUTH_230}, {application-record-element=DET_CONFD_AZIMUTH_231, system-signal=DET_CONFD_AZIMUTH_231}, {application-record-element=DET_CONFD_AZIMUTH_232, system-signal=DET_CONFD_AZIMUTH_232}, {application-record-element=DET_CONFD_ELEVATION_229, system-signal=DET_CONFD_ELEVATION_229}, {application-record-element=DET_CONFD_ELEVATION_230, system-signal=DET_CONFD_ELEVATION_230}, {application-record-element=DET_CONFD_ELEVATION_231, system-signal=DET_CONFD_ELEVATION_231}, {application-record-element=DET_CONFD_ELEVATION_232, system-signal=DET_CONFD_ELEVATION_232}, {application-record-element=DET_ELEVATION_229, system-signal=DET_ELEVATION_229}, {application-record-element=DET_ELEVATION_230, system-signal=DET_ELEVATION_230}, {application-record-element=DET_ELEVATION_231, system-signal=DET_ELEVATION_231}, {application-record-element=DET_ELEVATION_232, system-signal=DET_ELEVATION_232}, {application-record-element=DET_ELEVATION_ERR_229, system-signal=DET_ELEVATION_ERR_229}, {application-record-element=DET_ELEVATION_ERR_230, system-signal=DET_ELEVATION_ERR_230}, {application-record-element=DET_ELEVATION_ERR_231, system-signal=DET_ELEVATION_ERR_231}, {application-record-element=DET_ELEVATION_ERR_232, system-signal=DET_ELEVATION_ERR_232}, {application-record-element=DET_EXISTENCE_PROB_229, system-signal=DET_EXISTENCE_PROB_229}, {application-record-element=DET_EXISTENCE_PROB_230, system-signal=DET_EXISTENCE_PROB_230}, {application-record-element=DET_EXISTENCE_PROB_231, system-signal=DET_EXISTENCE_PROB_231}, {application-record-element=DET_EXISTENCE_PROB_232, system-signal=DET_EXISTENCE_PROB_232}, {application-record-element=DET_HVC_FLAG_229, system-signal=DET_HVC_FLAG_229}, {application-record-element=DET_HVC_FLAG_230, system-signal=DET_HVC_FLAG_230}, {application-record-element=DET_HVC_FLAG_231, system-signal=DET_HVC_FLAG_231}, {application-record-element=DET_HVC_FLAG_232, system-signal=DET_HVC_FLAG_232}, {application-record-element=DET_IDM_229, system-signal=DET_IDM_229}, {application-record-element=DET_IDM_230, system-signal=DET_IDM_230}, {application-record-element=DET_IDM_231, system-signal=DET_IDM_231}, {application-record-element=DET_IDM_232, system-signal=DET_IDM_232}, {application-record-element=DET_MH_CRC16_229_232, system-signal=DET_MH_CRC16_229_232}, {application-record-element=DET_MH_CYCLE_COUNTER_229_232, system-signal=DET_MH_CYCLE_COUNTER_229_232}, {application-record-element=DET_MH_SCAN_INDEX_4LSB_229_232, system-signal=DET_MH_SCAN_INDEX_4LSB_229_232}, {application-record-element=DET_MTD_229, system-signal=DET_MTD_229}, {application-record-element=DET_MTD_230, system-signal=DET_MTD_230}, {application-record-element=DET_MTD_231, system-signal=DET_MTD_231}, {application-record-element=DET_MTD_232, system-signal=DET_MTD_232}, {application-record-element=DET_PROB_1STAZHYPO_229, system-signal=DET_PROB_1STAZHYPO_229}, {application-record-element=DET_PROB_1STAZHYPO_230, system-signal=DET_PROB_1STAZHYPO_230}, {application-record-element=DET_PROB_1STAZHYPO_231, system-signal=DET_PROB_1STAZHYPO_231}, {application-record-element=DET_PROB_1STAZHYPO_232, system-signal=DET_PROB_1STAZHYPO_232}, {application-record-element=DET_RANGE_229, system-signal=DET_RANGE_229}, {application-record-element=DET_RANGE_230, system-signal=DET_RANGE_230}, {application-record-element=DET_RANGE_231, system-signal=DET_RANGE_231}, {application-record-element=DET_RANGE_232, system-signal=DET_RANGE_232}, {application-record-element=DET_RANGE_ERR_229, system-signal=DET_RANGE_ERR_229}, {application-record-element=DET_RANGE_ERR_230, system-signal=DET_RANGE_ERR_230}, {application-record-element=DET_RANGE_ERR_231, system-signal=DET_RANGE_ERR_231}, {application-record-element=DET_RANGE_ERR_232, system-signal=DET_RANGE_ERR_232}, {application-record-element=DET_RANGE_VELOCITY_229, system-signal=DET_RANGE_VELOCITY_229}, {application-record-element=DET_RANGE_VELOCITY_230, system-signal=DET_RANGE_VELOCITY_230}, {application-record-element=DET_RANGE_VELOCITY_231, system-signal=DET_RANGE_VELOCITY_231}, {application-record-element=DET_RANGE_VELOCITY_232, system-signal=DET_RANGE_VELOCITY_232}, {application-record-element=DET_RANGE_VELOCITY_ERR_229, system-signal=DET_RANGE_VELOCITY_ERR_229}, {application-record-element=DET_RANGE_VELOCITY_ERR_230, system-signal=DET_RANGE_VELOCITY_ERR_230}, {application-record-element=DET_RANGE_VELOCITY_ERR_231, system-signal=DET_RANGE_VELOCITY_ERR_231}, {application-record-element=DET_RANGE_VELOCITY_ERR_232, system-signal=DET_RANGE_VELOCITY_ERR_232}, {application-record-element=DET_RCS_229, system-signal=DET_RCS_229}, {application-record-element=DET_RCS_230, system-signal=DET_RCS_230}, {application-record-element=DET_RCS_231, system-signal=DET_RCS_231}, {application-record-element=DET_RCS_232, system-signal=DET_RCS_232}, {application-record-element=DET_SNR_229, system-signal=DET_SNR_229}, {application-record-element=DET_SNR_230, system-signal=DET_SNR_230}, {application-record-element=DET_SNR_231, system-signal=DET_SNR_231}, {application-record-element=DET_SNR_232, system-signal=DET_SNR_232}, {application-record-element=DET_SUPER_RES_TARGET_229, system-signal=DET_SUPER_RES_TARGET_229}, {application-record-element=DET_SUPER_RES_TARGET_230, system-signal=DET_SUPER_RES_TARGET_230}, {application-record-element=DET_SUPER_RES_TARGET_231, system-signal=DET_SUPER_RES_TARGET_231}, {application-record-element=DET_SUPER_RES_TARGET_232, system-signal=DET_SUPER_RES_TARGET_232}]}
        sender-receiver-to-signal-group-mapping={data-element=COMPOSITIONTYPE.Pp_SG_Detections_233_236_AL.Vdp_SG_Detections_233_236_AL, signal-group=SG_Detections_233_236, type-mapping=sender-rec-record-type-mapping=record-element-mappings=[{application-record-element=DET_AZIMUTH_233, system-signal=DET_AZIMUTH_233}, {application-record-element=DET_AZIMUTH_234, system-signal=DET_AZIMUTH_234}, {application-record-element=DET_AZIMUTH_235, system-signal=DET_AZIMUTH_235}, {application-record-element=DET_AZIMUTH_236, system-signal=DET_AZIMUTH_236}, {application-record-element=DET_AZIMUTH_ERR_233, system-signal=DET_AZIMUTH_ERR_233}, {application-record-element=DET_AZIMUTH_ERR_234, system-signal=DET_AZIMUTH_ERR_234}, {application-record-element=DET_AZIMUTH_ERR_235, system-signal=DET_AZIMUTH_ERR_235}, {application-record-element=DET_AZIMUTH_ERR_236, system-signal=DET_AZIMUTH_ERR_236}, {application-record-element=DET_BELOW_RAIN_THOLD_233, system-signal=DET_BELOW_RAIN_THOLD_233}, {application-record-element=DET_BELOW_RAIN_THOLD_234, system-signal=DET_BELOW_RAIN_THOLD_234}, {application-record-element=DET_BELOW_RAIN_THOLD_235, system-signal=DET_BELOW_RAIN_THOLD_235}, {application-record-element=DET_BELOW_RAIN_THOLD_236, system-signal=DET_BELOW_RAIN_THOLD_236}, {application-record-element=DET_BI_STATIC_FLAG_233, system-signal=DET_BI_STATIC_FLAG_233}, {application-record-element=DET_BI_STATIC_FLAG_234, system-signal=DET_BI_STATIC_FLAG_234}, {application-record-element=DET_BI_STATIC_FLAG_235, system-signal=DET_BI_STATIC_FLAG_235}, {application-record-element=DET_BI_STATIC_FLAG_236, system-signal=DET_BI_STATIC_FLAG_236}, {application-record-element=DET_CONFD_AZIMUTH_233, system-signal=DET_CONFD_AZIMUTH_233}, {application-record-element=DET_CONFD_AZIMUTH_234, system-signal=DET_CONFD_AZIMUTH_234}, {application-record-element=DET_CONFD_AZIMUTH_235, system-signal=DET_CONFD_AZIMUTH_235}, {application-record-element=DET_CONFD_AZIMUTH_236, system-signal=DET_CONFD_AZIMUTH_236}, {application-record-element=DET_CONFD_ELEVATION_233, system-signal=DET_CONFD_ELEVATION_233}, {application-record-element=DET_CONFD_ELEVATION_234, system-signal=DET_CONFD_ELEVATION_234}, {application-record-element=DET_CONFD_ELEVATION_235, system-signal=DET_CONFD_ELEVATION_235}, {application-record-element=DET_CONFD_ELEVATION_236, system-signal=DET_CONFD_ELEVATION_236}, {application-record-element=DET_ELEVATION_233, system-signal=DET_ELEVATION_233}, {application-record-element=DET_ELEVATION_234, system-signal=DET_ELEVATION_234}, {application-record-element=DET_ELEVATION_235, system-signal=DET_ELEVATION_235}, {application-record-element=DET_ELEVATION_236, system-signal=DET_ELEVATION_236}, {application-record-element=DET_ELEVATION_ERR_233, system-signal=DET_ELEVATION_ERR_233}, {application-record-element=DET_ELEVATION_ERR_234, system-signal=DET_ELEVATION_ERR_234}, {application-record-element=DET_ELEVATION_ERR_235, system-signal=DET_ELEVATION_ERR_235}, {application-record-element=DET_ELEVATION_ERR_236, system-signal=DET_ELEVATION_ERR_236}, {application-record-element=DET_EXISTENCE_PROB_233, system-signal=DET_EXISTENCE_PROB_233}, {application-record-element=DET_EXISTENCE_PROB_234, system-signal=DET_EXISTENCE_PROB_234}, {application-record-element=DET_EXISTENCE_PROB_235, system-signal=DET_EXISTENCE_PROB_235}, {application-record-element=DET_EXISTENCE_PROB_236, system-signal=DET_EXISTENCE_PROB_236}, {application-record-element=DET_HVC_FLAG_233, system-signal=DET_HVC_FLAG_233}, {application-record-element=DET_HVC_FLAG_234, system-signal=DET_HVC_FLAG_234}, {application-record-element=DET_HVC_FLAG_235, system-signal=DET_HVC_FLAG_235}, {application-record-element=DET_HVC_FLAG_236, system-signal=DET_HVC_FLAG_236}, {application-record-element=DET_IDM_233, system-signal=DET_IDM_233}, {application-record-element=DET_IDM_234, system-signal=DET_IDM_234}, {application-record-element=DET_IDM_235, system-signal=DET_IDM_235}, {application-record-element=DET_IDM_236, system-signal=DET_IDM_236}, {application-record-element=DET_MH_CRC16_233_236, system-signal=DET_MH_CRC16_233_236}, {application-record-element=DET_MH_CYCLE_COUNTER_233_236, system-signal=DET_MH_CYCLE_COUNTER_233_236}, {application-record-element=DET_MH_SCAN_INDEX_4LSB_233_236, system-signal=DET_MH_SCAN_INDEX_4LSB_233_236}, {application-record-element=DET_MTD_233, system-signal=DET_MTD_233}, {application-record-element=DET_MTD_234, system-signal=DET_MTD_234}, {application-record-element=DET_MTD_235, system-signal=DET_MTD_235}, {application-record-element=DET_MTD_236, system-signal=DET_MTD_236}, {application-record-element=DET_PROB_1STAZHYPO_233, system-signal=DET_PROB_1STAZHYPO_233}, {application-record-element=DET_PROB_1STAZHYPO_234, system-signal=DET_PROB_1STAZHYPO_234}, {application-record-element=DET_PROB_1STAZHYPO_235, system-signal=DET_PROB_1STAZHYPO_235}, {application-record-element=DET_PROB_1STAZHYPO_236, system-signal=DET_PROB_1STAZHYPO_236}, {application-record-element=DET_RANGE_233, system-signal=DET_RANGE_233}, {application-record-element=DET_RANGE_234, system-signal=DET_RANGE_234}, {application-record-element=DET_RANGE_235, system-signal=DET_RANGE_235}, {application-record-element=DET_RANGE_236, system-signal=DET_RANGE_236}, {application-record-element=DET_RANGE_ERR_233, system-signal=DET_RANGE_ERR_233}, {application-record-element=DET_RANGE_ERR_234, system-signal=DET_RANGE_ERR_234}, {application-record-element=DET_RANGE_ERR_235, system-signal=DET_RANGE_ERR_235}, {application-record-element=DET_RANGE_ERR_236, system-signal=DET_RANGE_ERR_236}, {application-record-element=DET_RANGE_VELOCITY_233, system-signal=DET_RANGE_VELOCITY_233}, {application-record-element=DET_RANGE_VELOCITY_234, system-signal=DET_RANGE_VELOCITY_234}, {application-record-element=DET_RANGE_VELOCITY_235, system-signal=DET_RANGE_VELOCITY_235}, {application-record-element=DET_RANGE_VELOCITY_236, system-signal=DET_RANGE_VELOCITY_236}, {application-record-element=DET_RANGE_VELOCITY_ERR_233, system-signal=DET_RANGE_VELOCITY_ERR_233}, {application-record-element=DET_RANGE_VELOCITY_ERR_234, system-signal=DET_RANGE_VELOCITY_ERR_234}, {application-record-element=DET_RANGE_VELOCITY_ERR_235, system-signal=DET_RANGE_VELOCITY_ERR_235}, {application-record-element=DET_RANGE_VELOCITY_ERR_236, system-signal=DET_RANGE_VELOCITY_ERR_236}, {application-record-element=DET_RCS_233, system-signal=DET_RCS_233}, {application-record-element=DET_RCS_234, system-signal=DET_RCS_234}, {application-record-element=DET_RCS_235, system-signal=DET_RCS_235}, {application-record-element=DET_RCS_236, system-signal=DET_RCS_236}, {application-record-element=DET_SNR_233, system-signal=DET_SNR_233}, {application-record-element=DET_SNR_234, system-signal=DET_SNR_234}, {application-record-element=DET_SNR_235, system-signal=DET_SNR_235}, {application-record-element=DET_SNR_236, system-signal=DET_SNR_236}, {application-record-element=DET_SUPER_RES_TARGET_233, system-signal=DET_SUPER_RES_TARGET_233}, {application-record-element=DET_SUPER_RES_TARGET_234, system-signal=DET_SUPER_RES_TARGET_234}, {application-record-element=DET_SUPER_RES_TARGET_235, system-signal=DET_SUPER_RES_TARGET_235}, {application-record-element=DET_SUPER_RES_TARGET_236, system-signal=DET_SUPER_RES_TARGET_236}]}
        sender-receiver-to-signal-group-mapping={data-element=COMPOSITIONTYPE.Pp_SG_Detections_237_240_AL.Vdp_SG_Detections_237_240_AL, signal-group=SG_Detections_237_240, type-mapping=sender-rec-record-type-mapping=record-element-mappings=[{application-record-element=DET_AZIMUTH_237, system-signal=DET_AZIMUTH_237}, {application-record-element=DET_AZIMUTH_238, system-signal=DET_AZIMUTH_238}, {application-record-element=DET_AZIMUTH_239, system-signal=DET_AZIMUTH_239}, {application-record-element=DET_AZIMUTH_240, system-signal=DET_AZIMUTH_240}, {application-record-element=DET_AZIMUTH_ERR_237, system-signal=DET_AZIMUTH_ERR_237}, {application-record-element=DET_AZIMUTH_ERR_238, system-signal=DET_AZIMUTH_ERR_238}, {application-record-element=DET_AZIMUTH_ERR_239, system-signal=DET_AZIMUTH_ERR_239}, {application-record-element=DET_AZIMUTH_ERR_240, system-signal=DET_AZIMUTH_ERR_240}, {application-record-element=DET_BELOW_RAIN_THOLD_237, system-signal=DET_BELOW_RAIN_THOLD_237}, {application-record-element=DET_BELOW_RAIN_THOLD_238, system-signal=DET_BELOW_RAIN_THOLD_238}, {application-record-element=DET_BELOW_RAIN_THOLD_239, system-signal=DET_BELOW_RAIN_THOLD_239}, {application-record-element=DET_BELOW_RAIN_THOLD_240, system-signal=DET_BELOW_RAIN_THOLD_240}, {application-record-element=DET_BI_STATIC_FLAG_237, system-signal=DET_BI_STATIC_FLAG_237}, {application-record-element=DET_BI_STATIC_FLAG_238, system-signal=DET_BI_STATIC_FLAG_238}, {application-record-element=DET_BI_STATIC_FLAG_239, system-signal=DET_BI_STATIC_FLAG_239}, {application-record-element=DET_BI_STATIC_FLAG_240, system-signal=DET_BI_STATIC_FLAG_240}, {application-record-element=DET_CONFD_AZIMUTH_237, system-signal=DET_CONFD_AZIMUTH_237}, {application-record-element=DET_CONFD_AZIMUTH_238, system-signal=DET_CONFD_AZIMUTH_238}, {application-record-element=DET_CONFD_AZIMUTH_239, system-signal=DET_CONFD_AZIMUTH_239}, {application-record-element=DET_CONFD_AZIMUTH_240, system-signal=DET_CONFD_AZIMUTH_240}, {application-record-element=DET_CONFD_ELEVATION_237, system-signal=DET_CONFD_ELEVATION_237}, {application-record-element=DET_CONFD_ELEVATION_238, system-signal=DET_CONFD_ELEVATION_238}, {application-record-element=DET_CONFD_ELEVATION_239, system-signal=DET_CONFD_ELEVATION_239}, {application-record-element=DET_CONFD_ELEVATION_240, system-signal=DET_CONFD_ELEVATION_240}, {application-record-element=DET_ELEVATION_237, system-signal=DET_ELEVATION_237}, {application-record-element=DET_ELEVATION_238, system-signal=DET_ELEVATION_238}, {application-record-element=DET_ELEVATION_239, system-signal=DET_ELEVATION_239}, {application-record-element=DET_ELEVATION_240, system-signal=DET_ELEVATION_240}, {application-record-element=DET_ELEVATION_ERR_237, system-signal=DET_ELEVATION_ERR_237}, {application-record-element=DET_ELEVATION_ERR_238, system-signal=DET_ELEVATION_ERR_238}, {application-record-element=DET_ELEVATION_ERR_239, system-signal=DET_ELEVATION_ERR_239}, {application-record-element=DET_ELEVATION_ERR_240, system-signal=DET_ELEVATION_ERR_240}, {application-record-element=DET_EXISTENCE_PROB_237, system-signal=DET_EXISTENCE_PROB_237}, {application-record-element=DET_EXISTENCE_PROB_238, system-signal=DET_EXISTENCE_PROB_238}, {application-record-element=DET_EXISTENCE_PROB_239, system-signal=DET_EXISTENCE_PROB_239}, {application-record-element=DET_EXISTENCE_PROB_240, system-signal=DET_EXISTENCE_PROB_240}, {application-record-element=DET_HVC_FLAG_237, system-signal=DET_HVC_FLAG_237}, {application-record-element=DET_HVC_FLAG_238, system-signal=DET_HVC_FLAG_238}, {application-record-element=DET_HVC_FLAG_239, system-signal=DET_HVC_FLAG_239}, {application-record-element=DET_HVC_FLAG_240, system-signal=DET_HVC_FLAG_240}, {application-record-element=DET_IDM_237, system-signal=DET_IDM_237}, {application-record-element=DET_IDM_238, system-signal=DET_IDM_238}, {application-record-element=DET_IDM_239, system-signal=DET_IDM_239}, {application-record-element=DET_IDM_240, system-signal=DET_IDM_240}, {application-record-element=DET_MH_CRC16_237_240, system-signal=DET_MH_CRC16_237_240}, {application-record-element=DET_MH_CYCLE_COUNTER_237_240, system-signal=DET_MH_CYCLE_COUNTER_237_240}, {application-record-element=DET_MH_SCAN_INDEX_4LSB_237_240, system-signal=DET_MH_SCAN_INDEX_4LSB_237_240}, {application-record-element=DET_MTD_237, system-signal=DET_MTD_237}, {application-record-element=DET_MTD_238, system-signal=DET_MTD_238}, {application-record-element=DET_MTD_239, system-signal=DET_MTD_239}, {application-record-element=DET_MTD_240, system-signal=DET_MTD_240}, {application-record-element=DET_PROB_1STAZHYPO_237, system-signal=DET_PROB_1STAZHYPO_237}, {application-record-element=DET_PROB_1STAZHYPO_238, system-signal=DET_PROB_1STAZHYPO_238}, {application-record-element=DET_PROB_1STAZHYPO_239, system-signal=DET_PROB_1STAZHYPO_239}, {application-record-element=DET_PROB_1STAZHYPO_240, system-signal=DET_PROB_1STAZHYPO_240}, {application-record-element=DET_RANGE_237, system-signal=DET_RANGE_237}, {application-record-element=DET_RANGE_238, system-signal=DET_RANGE_238}, {application-record-element=DET_RANGE_239, system-signal=DET_RANGE_239}, {application-record-element=DET_RANGE_240, system-signal=DET_RANGE_240}, {application-record-element=DET_RANGE_ERR_237, system-signal=DET_RANGE_ERR_237}, {application-record-element=DET_RANGE_ERR_238, system-signal=DET_RANGE_ERR_238}, {application-record-element=DET_RANGE_ERR_239, system-signal=DET_RANGE_ERR_239}, {application-record-element=DET_RANGE_ERR_240, system-signal=DET_RANGE_ERR_240}, {application-record-element=DET_RANGE_VELOCITY_237, system-signal=DET_RANGE_VELOCITY_237}, {application-record-element=DET_RANGE_VELOCITY_238, system-signal=DET_RANGE_VELOCITY_238}, {application-record-element=DET_RANGE_VELOCITY_239, system-signal=DET_RANGE_VELOCITY_239}, {application-record-element=DET_RANGE_VELOCITY_240, system-signal=DET_RANGE_VELOCITY_240}, {application-record-element=DET_RANGE_VELOCITY_ERR_237, system-signal=DET_RANGE_VELOCITY_ERR_237}, {application-record-element=DET_RANGE_VELOCITY_ERR_238, system-signal=DET_RANGE_VELOCITY_ERR_238}, {application-record-element=DET_RANGE_VELOCITY_ERR_239, system-signal=DET_RANGE_VELOCITY_ERR_239}, {application-record-element=DET_RANGE_VELOCITY_ERR_240, system-signal=DET_RANGE_VELOCITY_ERR_240}, {application-record-element=DET_RCS_237, system-signal=DET_RCS_237}, {application-record-element=DET_RCS_238, system-signal=DET_RCS_238}, {application-record-element=DET_RCS_239, system-signal=DET_RCS_239}, {application-record-element=DET_RCS_240, system-signal=DET_RCS_240}, {application-record-element=DET_SNR_237, system-signal=DET_SNR_237}, {application-record-element=DET_SNR_238, system-signal=DET_SNR_238}, {application-record-element=DET_SNR_239, system-signal=DET_SNR_239}, {application-record-element=DET_SNR_240, system-signal=DET_SNR_240}, {application-record-element=DET_SUPER_RES_TARGET_237, system-signal=DET_SUPER_RES_TARGET_237}, {application-record-element=DET_SUPER_RES_TARGET_238, system-signal=DET_SUPER_RES_TARGET_238}, {application-record-element=DET_SUPER_RES_TARGET_239, system-signal=DET_SUPER_RES_TARGET_239}, {application-record-element=DET_SUPER_RES_TARGET_240, system-signal=DET_SUPER_RES_TARGET_240}]}
