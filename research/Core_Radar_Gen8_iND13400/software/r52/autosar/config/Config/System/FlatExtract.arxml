[part 1 of 11: package /COM/VECTOR/CFG/WORKFLOW/SYSDESC/SYNC]
AUTOSAR XML (schema 00053)
package /COM/VECTOR/CFG/WORKFLOW/SYSDESC/SYNC
  system SYSTEM: category=ECU_EXTRACT, client-id-definition-set=CLIENT_ID_DEFINITION_SET
    system mapping MAPPINGS
      data-mappings:
        sender-receiver-to-signal-mapping={data-element=COMPOSITIONTYPE.PP_DetectionList_Event.DetectionList_Event, system-signal=sysSignal_RDR_1_Detections}
        sender-receiver-to-signal-mapping={data-element=COMPOSITIONTYPE.PP_RDR_Radar_SW_Info.RDR_SW_Info, system-signal=sysSignal_RDR_1_SW_Info}
        sender-receiver-to-signal-mapping={data-element=COMPOSITIONTYPE.PP_RDR_Radar_Status.RDR_Status, system-signal=sysSignal_RDR_1_Status}
        sender-receiver-to-signal-mapping={data-element=COMPOSITIONTYPE.RP_Vehicle_Status.Vehicle_Status, system-signal=sysSignal_ADAS_Vehicle_Status}
        sender-receiver-to-signal-group-mapping={data-element=COMPOSITIONTYPE.Pp_SG_TrackerHeader.Vdp_SG_TrackerHeader, signal-group=SG_TrackerHeader, type-mapping=sender-rec-record-type-mapping=record-element-mappings=[{implementation-record-element=HED_MH_002_CRC16, system-signal=HED_MH_002_CRC16}, {implementation-record-element=HED_MH_002_CYCLE_COUNTER, system-signal=HED_MH_002_CYCLE_COUNTER}, {implementation-record-element=HED_TRKR_DATA_QUALIFIER, system-signal=HED_TRKR_DATA_QUALIFIER}, {implementation-record-element=HED_TRKR_IDX, system-signal=HED_TRKR_IDX}, {implementation-record-element=HED_TRKR_NUM_OF_ACTIV_OBJS, system-signal=HED_TRKR_NUM_OF_ACTIV_OBJS}, {implementation-record-element=HED_TRKR_OBJLST_TIME_STAMP_NS, system-signal=HED_TRKR_OBJLST_TIME_STAMP_NS}, {implementation-record-element=HED_TRKR_OBJLST_TIME_STAMP_SC, system-signal=HED_TRKR_OBJLST_TIME_STAMP_SC}, {implementation-record-element=HED_TRKR_TIME_INST, system-signal=HED_TRKR_TIME_INST}, {implementation-record-element=HED_TRKR_TIME_PEAK, system-signal=HED_TRKR_TIME_PEAK}, {implementation-record-element=HED_TRKR_VEHICLE_IDX, system-signal=HED_TRKR_VEHICLE_IDX}, {implementation-record-element=HED_TRKR_VEH_COORD_TYPE, system-signal=HED_TRKR_VEH_COORD_TYPE}]}
        sender-receiver-to-signal-group-mapping={data-element=COMPOSITIONTYPE.Pp_SG_TrackerObject001.Vdp_SG_TrackerObject001, signal-group=SG_TrackerObject001, type-mapping=sender-rec-record-type-mapping=record-element-mappings=[{implementation-record-element=OBJ_ACCELERATION_LAT_001, system-signal=OBJ_ACCELERATION_LAT_001}, {implementation-record-element=OBJ_ACCELERATION_LAT_ERR_001, system-signal=OBJ_ACCELERATION_LAT_ERR_001}, {implementation-record-element=OBJ_ACCELERATION_LONG_001, system-signal=OBJ_ACCELERATION_LONG_001}, {implementation-record-element=OBJ_ACCELERATION_LONG_ERR_001, system-signal=OBJ_ACCELERATION_LONG_ERR_001}, {implementation-record-element=OBJ_ACCEL_ERR_CRR_COEF_001, system-signal=OBJ_ACCEL_ERR_CRR_COEF_001}, {implementation-record-element=OBJ_ALIVE_TIME_001, system-signal=OBJ_ALIVE_TIME_001}, {implementation-record-element=OBJ_CLS_TYPE1_001, system-signal=OBJ_CLS_TYPE1_001}, {implementation-record-element=OBJ_CLS_TYPE1_PROB_001, system-signal=OBJ_CLS_TYPE1_PROB_001}, {implementation-record-element=OBJ_CLS_TYPE2_001, system-signal=OBJ_CLS_TYPE2_001}, {implementation-record-element=OBJ_CLS_TYPE2_PROB_001, system-signal=OBJ_CLS_TYPE2_PROB_001}, {implementation-record-element=OBJ_CLS_TYPE3_001, system-signal=OBJ_CLS_TYPE3_001}, {implementation-record-element=OBJ_CLS_TYPE3_PROB_001, system-signal=OBJ_CLS_TYPE3_PROB_001}, {implementation-record-element=OBJ_CLS_TYPE4_001, system-signal=OBJ_CLS_TYPE4_001}, {implementation-record-element=OBJ_CLS_TYPE4_PROB_001, system-signal=OBJ_CLS_TYPE4_PROB_001}, {implementation-record-element=OBJ_CLS_TYPE5_001, system-signal=OBJ_CLS_TYPE5_001}, {implementation-record-element=OBJ_CLS_TYPE5_PROB_001, system-signal=OBJ_CLS_TYPE5_PROB_001}, {implementation-record-element=OBJ_CLS_TYPE6_001, system-signal=OBJ_CLS_TYPE6_001}, {implementation-record-element=OBJ_CLS_TYPE6_PROB_001, system-signal=OBJ_CLS_TYPE6_PROB_001}, {implementation-record-element=OBJ_DIMENSION_LENGTH_001, system-signal=OBJ_DIMENSION_LENGTH_001}, {implementation-record-element=OBJ_DIMENSION_LENGTH_ERR_001, system-signal=OBJ_DIMENSION_LENGTH_ERR_001}, {implementation-record-element=OBJ_DIMENSION_WIDTH_001, system-signal=OBJ_DIMENSION_WIDTH_001}, {implementation-record-element=OBJ_DIMENSION_WIDTH_ERR_001, system-signal=OBJ_DIMENSION_WIDTH_ERR_001}, {implementation-record-element=OBJ_EXISTENCE_PROB_001, system-signal=OBJ_EXISTENCE_PROB_001}, {implementation-record-element=OBJ_GROUP_ID_001, system-signal=OBJ_GROUP_ID_001}, {implementation-record-element=OBJ_ID_001, system-signal=OBJ_ID_001}, {implementation-record-element=OBJ_MEASUREMENT_STATUS_001, system-signal=OBJ_MEASUREMENT_STATUS_001}, {implementation-record-element=OBJ_MH_CRC16_001, system-signal=OBJ_MH_CRC16_001}, {implementation-record-element=OBJ_MH_CYCLE_COUNTER_001, system-signal=OBJ_MH_CYCLE_COUNTER_001}, {implementation-record-element=OBJ_MOVEMENT_STATUS_001, system-signal=OBJ_MOVEMENT_STATUS_001}, {implementation-record-element=OBJ_POS_ERR_CRR_COEF_001, system-signal=OBJ_POS_ERR_CRR_COEF_001}, {implementation-record-element=OBJ_POS_LAT_001, system-signal=OBJ_POS_LAT_001}, {implementation-record-element=OBJ_POS_LAT_ERR_001, system-signal=OBJ_POS_LAT_ERR_001}, {implementation-record-element=OBJ_POS_LONG_001, system-signal=OBJ_POS_LONG_001}, {implementation-record-element=OBJ_POS_LONG_ERR_001, system-signal=OBJ_POS_LONG_ERR_001}, {implementation-record-element=OBJ_RCS_001, system-signal=OBJ_RCS_001}, {implementation-record-element=OBJ_REF_PT_LAT_OFFSET_001, system-signal=OBJ_REF_PT_LAT_OFFSET_001}, {implementation-record-element=OBJ_REF_PT_LONG_OFFSET_001, system-signal=OBJ_REF_PT_LONG_OFFSET_001}, {implementation-record-element=OBJ_TIMESTAMP_OFFSET_001, system-signal=OBJ_TIMESTAMP_OFFSET_001}, {implementation-record-element=OBJ_TRACK_MOTION_MODEL_001, system-signal=OBJ_TRACK_MOTION_MODEL_001}, {implementation-record-element=OBJ_VEH_TRACK_FLAG_001, system-signal=OBJ_VEH_TRACK_FLAG_001}, {implementation-record-element=OBJ_VELOCITY_ERR_CRR_COEF_001, system-signal=OBJ_VELOCITY_ERR_CRR_COEF_001}, {implementation-record-element=OBJ_VELOCITY_LAT_001, system-signal=OBJ_VELOCITY_LAT_001}, {implementation-record-element=OBJ_VELOCITY_LAT_ERR_001, system-signal=OBJ_VELOCITY_LAT_ERR_001}, {implementation-record-element=OBJ_VELOCITY_LONG_001, system-signal=OBJ_VELOCITY_LONG_001}, {implementation-record-element=OBJ_VELOCITY_LONG_ERR_001, system-signal=OBJ_VELOCITY_LONG_ERR_001}, {implementation-record-element=OBJ_YAW_ANGLE_001, system-signal=OBJ_YAW_ANGLE_001}, {implementation-record-element=OBJ_YAW_ANGLE_ERR_001, system-signal=OBJ_YAW_ANGLE_ERR_001}, {implementation-record-element=OBJ_YAW_RATE_001, system-signal=OBJ_YAW_RATE_001}, {implementation-record-element=OBJ_YAW_RATE_ERR_001, system-signal=OBJ_YAW_RATE_ERR_001}]}
        sender-receiver-to-signal-group-mapping={data-element=COMPOSITIONTYPE.Pp_SG_TrackerObject002.Vdp_SG_TrackerObject002, signal-group=SG_TrackerObject002, type-mapping=sender-rec-record-type-mapping=record-element-mappings=[{implementation-record-element=OBJ_ACCEL_ERR_CRR_COEF_001, system-signal=OBJ_ACCEL_ERR_CRR_COEF_002}, {implementation-record-element=OBJ_ALIVE_TIME_001, system-signal=OBJ_ALIVE_TIME_002}, {implementation-record-element=OBJ_EXISTENCE_PROB_001, system-signal=OBJ_EXISTENCE_PROB_002}, {implementation-record-element=OBJ_GROUP_ID_001, system-signal=OBJ_GROUP_ID_002}, {implementation-record-element=OBJ_ID_001, system-signal=OBJ_ID_002}, {implementation-record-element=OBJ_MEASUREMENT_STATUS_001, system-signal=OBJ_MEASUREMENT_STATUS_002}, {implementation-record-element=OBJ_MH_CRC16_001, system-signal=OBJ_MH_CRC16_002}, {implementation-record-element=OBJ_MH_CYCLE_COUNTER_001, system-signal=OBJ_MH_CYCLE_COUNTER_002}, {implementation-record-element=OBJ_MOVEMENT_STATUS_001, system-signal=OBJ_MOVEMENT_STATUS_002}, {implementation-record-element=OBJ_POS_ERR_CRR_COEF_001, system-signal=OBJ_POS_ERR_CRR_COEF_002}, {implementation-record-element=OBJ_RCS_001, system-signal=OBJ_RCS_002}, {implementation-record-element=OBJ_REF_PT_LAT_OFFSET_001, system-signal=OBJ_REF_PT_LAT_OFFSET_002}, {implementation-record-element=OBJ_REF_PT_LONG_OFFSET_001, system-signal=OBJ_REF_PT_LONG_OFFSET_002}, {implementation-record-element=OBJ_TIMESTAMP_OFFSET_001, system-signal=OBJ_TIMESTAMP_OFFSET_002}, {implementation-record-element=OBJ_TRACK_MOTION_MODEL_001, system-signal=OBJ_TRACK_MOTION_MODEL_002}, {implementation-record-element=OBJ_VEH_TRACK_FLAG_001, system-signal=OBJ_VEH_TRACK_FLAG_002}, {implementation-record-element=OBJ_VELOCITY_ERR_CRR_COEF_001, system-signal=OBJ_VELOCITY_ERR_CRR_COEF_002}, {implementation-record-element=OBJ_CLS_TYPE5_001, system-signal=OBJ_CLS_TYPE5_002}, {implementation-record-element=OBJ_CLS_TYPE4_001, system-signal=OBJ_CLS_TYPE4_002}, {implementation-record-element=OBJ_CLS_TYPE6_PROB_001, system-signal=OBJ_CLS_TYPE6_PROB_002}, {implementation-record-element=OBJ_CLS_TYPE3_PROB_001, system-signal=OBJ_CLS_TYPE3_PROB_002}, {implementation-record-element=OBJ_CLS_TYPE1_PROB_001, system-signal=OBJ_CLS_TYPE1_PROB_002}, {implementation-record-element=OBJ_CLS_TYPE3_001, system-signal=OBJ_CLS_TYPE3_002}, {implementation-record-element=OBJ_DIMENSION_LENGTH_ERR_001, system-signal=OBJ_DIMENSION_LENGTH_ERR_002}, {implementation-record-element=OBJ_DIMENSION_WIDTH_ERR_001, system-signal=OBJ_DIMENSION_WIDTH_ERR_002}, {implementation-record-element=OBJ_CLS_TYPE2_PROB_001, system-signal=OBJ_CLS_TYPE2_PROB_002}, {implementation-record-element=OBJ_CLS_TYPE5_PROB_001, system-signal=OBJ_CLS_TYPE5_PROB_002}, {implementation-record-element=OBJ_CLS_TYPE1_001, system-signal=OBJ_CLS_TYPE1_002}, {implementation-record-element=OBJ_CLS_TYPE2_001, system-signal=OBJ_CLS_TYPE2_002}, {implementation-record-element=OBJ_ACCELERATION_LONG_ERR_001, system-signal=OBJ_ACCELERATION_LONG_ERR_002}, {implementation-record-element=OBJ_ACCELERATION_LAT_ERR_001, system-signal=OBJ_ACCELERATION_LAT_ERR_002}, {implementation-record-element=OBJ_CLS_TYPE6_001, system-signal=OBJ_CLS_TYPE6_002}, {implementation-record-element=OBJ_CLS_TYPE4_PROB_001, system-signal=OBJ_CLS_TYPE4_PROB_002}, {implementation-record-element=OBJ_DIMENSION_WIDTH_001, system-signal=OBJ_DIMENSION_WIDTH_002}, {implementation-record-element=OBJ_ACCELERATION_LAT_001, system-signal=OBJ_ACCELERATION_LAT_002}, {implementation-record-element=OBJ_DIMENSION_LENGTH_001, system-signal=OBJ_DIMENSION_LENGTH_002}, {implementation-record-element=OBJ_ACCELERATION_LONG_001, system-signal=OBJ_ACCELERATION_LONG_002}, {implementation-record-element=OBJ_VELOCITY_LAT_001, system-signal=OBJ_VELOCITY_LAT_002}, {implementation-record-element=OBJ_VELOCITY_LONG_001, system-signal=OBJ_VELOCITY_LONG_002}, {implementation-record-element=OBJ_VELOCITY_LONG_ERR_001, system-signal=OBJ_VELOCITY_LONG_ERR_002}, {implementation-record-element=OBJ_YAW_ANGLE_001, system-signal=OBJ_YAW_ANGLE_002}, {implementation-record-element=OBJ_YAW_RATE_001, system-signal=OBJ_YAW_RATE_002}, {implementation-record-element=OBJ_VELOCITY_LAT_ERR_001, system-signal=OBJ_VELOCITY_LAT_ERR_002}, {implementation-record-element=OBJ_YAW_RATE_ERR_001, system-signal=OBJ_YAW_RATE_ERR_002}, {implementation-record-element=OBJ_YAW_ANGLE_ERR_001, system-signal=OBJ_YAW_ANGLE_ERR_002}, {implementation-record-element=OBJ_POS_LONG_001, system-signal=OBJ_POS_LONG_002}, {implementation-record-element=OBJ_POS_LAT_001, system-signal=OBJ_POS_LAT_002}, {implementation-record-element=OBJ_POS_LONG_ERR_001, system-signal=OBJ_POS_LONG_ERR_002}, {implementation-record-element=OBJ_POS_LAT_ERR_001, system-signal=OBJ_POS_LAT_ERR_002}]}
        sender-receiver-to-signal-group-mapping={data-element=COMPOSITIONTYPE.Pp_SG_TrackerObject003.Vdp_SG_TrackerObject003, signal-group=SG_TrackerObject003, type-mapping=sender-rec-record-type-mapping=record-element-mappings=[{implementation-record-element=OBJ_ACCEL_ERR_CRR_COEF_001, system-signal=OBJ_ACCEL_ERR_CRR_COEF_003}, {implementation-record-element=OBJ_ALIVE_TIME_001, system-signal=OBJ_ALIVE_TIME_003}, {implementation-record-element=OBJ_EXISTENCE_PROB_001, system-signal=OBJ_EXISTENCE_PROB_003}, {implementation-record-element=OBJ_GROUP_ID_001, system-signal=OBJ_GROUP_ID_003}, {implementation-record-element=OBJ_ID_001, system-signal=OBJ_ID_003}, {implementation-record-element=OBJ_MEASUREMENT_STATUS_001, system-signal=OBJ_MEASUREMENT_STATUS_003}, {implementation-record-element=OBJ_MH_CRC16_001, system-signal=OBJ_MH_CRC16_003}, {implementation-record-element=OBJ_MH_CYCLE_COUNTER_001, system-signal=OBJ_MH_CYCLE_COUNTER_003}, {implementation-record-element=OBJ_MOVEMENT_STATUS_001, system-signal=OBJ_MOVEMENT_STATUS_003}, {implementation-record-element=OBJ_POS_ERR_CRR_COEF_001, system-signal=OBJ_POS_ERR_CRR_COEF_003}, {implementation-record-element=OBJ_RCS_001, system-signal=OBJ_RCS_003}, {implementation-record-element=OBJ_REF_PT_LAT_OFFSET_001, system-signal=OBJ_REF_PT_LAT_OFFSET_003}, {implementation-record-element=OBJ_REF_PT_LONG_OFFSET_001, system-signal=OBJ_REF_PT_LONG_OFFSET_003}, {implementation-record-element=OBJ_TIMESTAMP_OFFSET_001, system-signal=OBJ_TIMESTAMP_OFFSET_003}, {implementation-record-element=OBJ_TRACK_MOTION_MODEL_001, system-signal=OBJ_TRACK_MOTION_MODEL_003}, {implementation-record-element=OBJ_VEH_TRACK_FLAG_001, system-signal=OBJ_VEH_TRACK_FLAG_003}, {implementation-record-element=OBJ_VELOCITY_ERR_CRR_COEF_001, system-signal=OBJ_VELOCITY_ERR_CRR_COEF_003}, {implementation-record-element=OBJ_CLS_TYPE4_PROB_001, system-signal=OBJ_CLS_TYPE4_PROB_003}, {implementation-record-element=OBJ_ACCELERATION_LAT_001, system-signal=OBJ_ACCELERATION_LAT_003}, {implementation-record-element=OBJ_CLS_TYPE1_001, system-signal=OBJ_CLS_TYPE1_003}, {implementation-record-element=OBJ_CLS_TYPE2_001, system-signal=OBJ_CLS_TYPE2_003}, {implementation-record-element=OBJ_ACCELERATION_LONG_001, system-signal=OBJ_ACCELERATION_LONG_003}, {implementation-record-element=OBJ_ACCELERATION_LAT_ERR_001, system-signal=OBJ_ACCELERATION_LAT_ERR_003}, {implementation-record-element=OBJ_ACCELERATION_LONG_ERR_001, system-signal=OBJ_ACCELERATION_LONG_ERR_003}, {implementation-record-element=OBJ_CLS_TYPE2_PROB_001, system-signal=OBJ_CLS_TYPE2_PROB_003}, {implementation-record-element=OBJ_CLS_TYPE5_PROB_001, system-signal=OBJ_CLS_TYPE5_PROB_003}, {implementation-record-element=OBJ_DIMENSION_LENGTH_ERR_001, system-signal=OBJ_DIMENSION_LENGTH_ERR_003}, {implementation-record-element=OBJ_DIMENSION_WIDTH_001, system-signal=OBJ_DIMENSION_WIDTH_003}, {implementation-record-element=OBJ_DIMENSION_LENGTH_001, system-signal=OBJ_DIMENSION_LENGTH_003}, {implementation-record-element=OBJ_POS_LAT_001, system-signal=OBJ_POS_LAT_003}, {implementation-record-element=OBJ_CLS_TYPE3_PROB_001, system-signal=OBJ_CLS_TYPE3_PROB_003}, {implementation-record-element=OBJ_POS_LAT_ERR_001, system-signal=OBJ_POS_LAT_ERR_003}, {implementation-record-element=OBJ_POS_LONG_001, system-signal=OBJ_POS_LONG_003}, {implementation-record-element=OBJ_CLS_TYPE3_001, system-signal=OBJ_CLS_TYPE3_003}, {implementation-record-element=OBJ_DIMENSION_WIDTH_ERR_001, system-signal=OBJ_DIMENSION_WIDTH_ERR_003}, {implementation-record-element=OBJ_CLS_TYPE4_001, system-signal=OBJ_CLS_TYPE4_003}, {implementation-record-element=OBJ_POS_LONG_ERR_001, system-signal=OBJ_POS_LONG_ERR_003}, {implementation-record-element=OBJ_CLS_TYPE1_PROB_001, system-signal=OBJ_CLS_TYPE1_PROB_003}, {implementation-record-element=OBJ_CLS_TYPE5_001, system-signal=OBJ_CLS_TYPE5_003}, {implementation-record-element=OBJ_CLS_TYPE6_001, system-signal=OBJ_CLS_TYPE6_003}, {implementation-record-element=OBJ_CLS_TYPE6_PROB_001, system-signal=OBJ_CLS_TYPE6_PROB_003}, {implementation-record-element=OBJ_YAW_RATE_ERR_001, system-signal=OBJ_YAW_RATE_ERR_003}, {implementation-record-element=OBJ_VELOCITY_LAT_001, system-signal=OBJ_VELOCITY_LAT_003}, {implementation-record-element=OBJ_VELOCITY_LONG_001, system-signal=OBJ_VELOCITY_LONG_003}, {implementation-record-element=OBJ_YAW_ANGLE_001, system-signal=OBJ_YAW_ANGLE_003}, {implementation-record-element=OBJ_YAW_RATE_001, system-signal=OBJ_YAW_RATE_003}, {implementation-record-element=OBJ_VELOCITY_LAT_ERR_001, system-signal=OBJ_VELOCITY_LAT_ERR_003}, {implementation-record-element=OBJ_VELOCITY_LONG_ERR_001, system-signal=OBJ_VELOCITY_LONG_ERR_003}, {implementation-record-element=OBJ_YAW_ANGLE_ERR_001, system-signal=OBJ_YAW_ANGLE_ERR_003}]}
        sender-receiver-to-signal-group-mapping={data-element=COMPOSITIONTYPE.Pp_SG_TrackerObject004.Vdp_SG_TrackerObject004, signal-group=SG_TrackerObject004, type-mapping=sender-rec-record-type-mapping=record-element-mappings=[{implementation-record-element=OBJ_ACCEL_ERR_CRR_COEF_001, system-signal=OBJ_ACCEL_ERR_CRR_COEF_004}, {implementation-record-element=OBJ_ALIVE_TIME_001, system-signal=OBJ_ALIVE_TIME_004}, {implementation-record-element=OBJ_EXISTENCE_PROB_001, system-signal=OBJ_EXISTENCE_PROB_004}, {implementation-record-element=OBJ_GROUP_ID_001, system-signal=OBJ_GROUP_ID_004}, {implementation-record-element=OBJ_ID_001, system-signal=OBJ_ID_004}, {implementation-record-element=OBJ_MEASUREMENT_STATUS_001, system-signal=OBJ_MEASUREMENT_STATUS_004}, {implementation-record-element=OBJ_MH_CRC16_001, system-signal=OBJ_MH_CRC16_004}, {implementation-record-element=OBJ_MH_CYCLE_COUNTER_001, system-signal=OBJ_MH_CYCLE_COUNTER_004}, {implementation-record-element=OBJ_MOVEMENT_STATUS_001, system-signal=OBJ_MOVEMENT_STATUS_004}, {implementation-record-element=OBJ_POS_ERR_CRR_COEF_001, system-signal=OBJ_POS_ERR_CRR_COEF_004}, {implementation-record-element=OBJ_RCS_001, system-signal=OBJ_RCS_004}, {implementation-record-element=OBJ_REF_PT_LAT_OFFSET_001, system-signal=OBJ_REF_PT_LAT_OFFSET_004}, {implementation-record-element=OBJ_REF_PT_LONG_OFFSET_001, system-signal=OBJ_REF_PT_LONG_OFFSET_004}, {implementation-record-element=OBJ_TIMESTAMP_OFFSET_001, system-signal=OBJ_TIMESTAMP_OFFSET_004}, {implementation-record-element=OBJ_TRACK_MOTION_MODEL_001, system-signal=OBJ_TRACK_MOTION_MODEL_004}, {implementation-record-element=OBJ_VEH_TRACK_FLAG_001, system-signal=OBJ_VEH_TRACK_FLAG_004}, {implementation-record-element=OBJ_VELOCITY_ERR_CRR_COEF_001, system-signal=OBJ_VELOCITY_ERR_CRR_COEF_004}, {implementation-record-element=OBJ_CLS_TYPE3_PROB_001, system-signal=OBJ_CLS_TYPE3_PROB_004}, {implementation-record-element=OBJ_ACCELERATION_LAT_001, system-signal=OBJ_ACCELERATION_LAT_004}, {implementation-record-element=OBJ_ACCELERATION_LAT_ERR_001, system-signal=OBJ_ACCELERATION_LAT_ERR_004}, {implementation-record-element=OBJ_CLS_TYPE2_001, system-signal=OBJ_CLS_TYPE2_004}, {implementation-record-element=OBJ_CLS_TYPE6_PROB_001, system-signal=OBJ_CLS_TYPE6_PROB_004}, {implementation-record-element=OBJ_DIMENSION_WIDTH_001, system-signal=OBJ_DIMENSION_WIDTH_004}, {implementation-record-element=OBJ_POS_LONG_001, system-signal=OBJ_POS_LONG_004}, {implementation-record-element=OBJ_VELOCITY_LAT_001, system-signal=OBJ_VELOCITY_LAT_004}, {implementation-record-element=OBJ_DIMENSION_LENGTH_ERR_001, system-signal=OBJ_DIMENSION_LENGTH_ERR_004}, {implementation-record-element=OBJ_CLS_TYPE4_PROB_001, system-signal=OBJ_CLS_TYPE4_PROB_004}, {implementation-record-element=OBJ_CLS_TYPE4_001, system-signal=OBJ_CLS_TYPE4_004}, {implementation-record-element=OBJ_DIMENSION_WIDTH_ERR_001, system-signal=OBJ_DIMENSION_WIDTH_ERR_004}, {implementation-record-element=OBJ_CLS_TYPE3_001, system-signal=OBJ_CLS_TYPE3_004}, {implementation-record-element=OBJ_POS_LONG_ERR_001, system-signal=OBJ_POS_LONG_ERR_004}, {implementation-record-element=OBJ_DIMENSION_LENGTH_001, system-signal=OBJ_DIMENSION_LENGTH_004}, {implementation-record-element=OBJ_ACCELERATION_LONG_ERR_001, system-signal=OBJ_ACCELERATION_LONG_ERR_004}, {implementation-record-element=OBJ_CLS_TYPE5_001, system-signal=OBJ_CLS_TYPE5_004}, {implementation-record-element=OBJ_VELOCITY_LAT_ERR_001, system-signal=OBJ_VELOCITY_LAT_ERR_004}, {implementation-record-element=OBJ_VELOCITY_LONG_001, system-signal=OBJ_VELOCITY_LONG_004}, {implementation-record-element=OBJ_POS_LAT_ERR_001, system-signal=OBJ_POS_LAT_ERR_004}, {implementation-record-element=OBJ_VELOCITY_LONG_ERR_001, system-signal=OBJ_VELOCITY_LONG_ERR_004}, {implementation-record-element=OBJ_YAW_ANGLE_001, system-signal=OBJ_YAW_ANGLE_004}, {implementation-record-element=OBJ_YAW_ANGLE_ERR_001, system-signal=OBJ_YAW_ANGLE_ERR_004}, {implementation-record-element=OBJ_YAW_RATE_001, system-signal=OBJ_YAW_RATE_004}, {implementation-record-element=OBJ_CLS_TYPE1_001, system-signal=OBJ_CLS_TYPE1_004}, {implementation-record-element=OBJ_CLS_TYPE5_PROB_001, system-signal=OBJ_CLS_TYPE5_PROB_004}, {implementation-record-element=OBJ_CLS_TYPE2_PROB_001, system-signal=OBJ_CLS_TYPE2_PROB_004}, {implementation-record-element=OBJ_CLS_TYPE6_001, system-signal=OBJ_CLS_TYPE6_004}, {implementation-record-element=OBJ_POS_LAT_001, system-signal=OBJ_POS_LAT_004}, {implementation-record-element=OBJ_CLS_TYPE1_PROB_001, system-signal=OBJ_CLS_TYPE1_PROB_004}, {implementation-record-element=OBJ_ACCELERATION_LONG_001, system-signal=OBJ_ACCELERATION_LONG_004}, {implementation-record-element=OBJ_YAW_RATE_ERR_001, system-signal=OBJ_YAW_RATE_ERR_004}]}
        sender-receiver-to-signal-group-mapping={data-element=COMPOSITIONTYPE.Pp_SG_TrackerObject005.Vdp_SG_TrackerObject005, signal-group=SG_TrackerObject005, type-mapping=sender-rec-record-type-mapping=record-element-mappings=[{implementation-record-element=OBJ_ACCEL_ERR_CRR_COEF_001, system-signal=OBJ_ACCEL_ERR_CRR_COEF_005}, {implementation-record-element=OBJ_ALIVE_TIME_001, system-signal=OBJ_ALIVE_TIME_005}, {implementation-record-element=OBJ_EXISTENCE_PROB_001, system-signal=OBJ_EXISTENCE_PROB_005}, {implementation-record-element=OBJ_GROUP_ID_001, system-signal=OBJ_GROUP_ID_005}, {implementation-record-element=OBJ_ID_001, system-signal=OBJ_ID_005}, {implementation-record-element=OBJ_MEASUREMENT_STATUS_001, system-signal=OBJ_MEASUREMENT_STATUS_005}, {implementation-record-element=OBJ_MH_CRC16_001, system-signal=OBJ_MH_CRC16_005}, {implementation-record-element=OBJ_MH_CYCLE_COUNTER_001, system-signal=OBJ_MH_CYCLE_COUNTER_005}, {implementation-record-element=OBJ_MOVEMENT_STATUS_001, system-signal=OBJ_MOVEMENT_STATUS_005}, {implementation-record-element=OBJ_POS_ERR_CRR_COEF_001, system-signal=OBJ_POS_ERR_CRR_COEF_005}, {implementation-record-element=OBJ_RCS_001, system-signal=OBJ_RCS_005}, {implementation-record-element=OBJ_REF_PT_LAT_OFFSET_001, system-signal=OBJ_REF_PT_LAT_OFFSET_005}, {implementation-record-element=OBJ_REF_PT_LONG_OFFSET_001, system-signal=OBJ_REF_PT_LONG_OFFSET_005}, {implementation-record-element=OBJ_TIMESTAMP_OFFSET_001, system-signal=OBJ_TIMESTAMP_OFFSET_005}, {implementation-record-element=OBJ_TRACK_MOTION_MODEL_001, system-signal=OBJ_TRACK_MOTION_MODEL_005}, {implementation-record-element=OBJ_VEH_TRACK_FLAG_001, system-signal=OBJ_VEH_TRACK_FLAG_005}, {implementation-record-element=OBJ_VELOCITY_ERR_CRR_COEF_001, system-signal=OBJ_VELOCITY_ERR_CRR_COEF_005}, {implementation-record-element=OBJ_ACCELERATION_LAT_001, system-signal=OBJ_ACCELERATION_LAT_005}, {implementation-record-element=OBJ_YAW_ANGLE_001, system-signal=OBJ_YAW_ANGLE_005}, {implementation-record-element=OBJ_POS_LAT_001, system-signal=OBJ_POS_LAT_005}, {implementation-record-element=OBJ_YAW_ANGLE_ERR_001, system-signal=OBJ_YAW_ANGLE_ERR_005}, {implementation-record-element=OBJ_CLS_TYPE5_001, system-signal=OBJ_CLS_TYPE5_005}, {implementation-record-element=OBJ_CLS_TYPE5_PROB_001, system-signal=OBJ_CLS_TYPE5_PROB_005}, {implementation-record-element=OBJ_DIMENSION_WIDTH_ERR_001, system-signal=OBJ_DIMENSION_WIDTH_ERR_005}, {implementation-record-element=OBJ_YAW_RATE_001, system-signal=OBJ_YAW_RATE_005}, {implementation-record-element=OBJ_VELOCITY_LAT_ERR_001, system-signal=OBJ_VELOCITY_LAT_ERR_005}, {implementation-record-element=OBJ_VELOCITY_LAT_001, system-signal=OBJ_VELOCITY_LAT_005}, {implementation-record-element=OBJ_CLS_TYPE3_PROB_001, system-signal=OBJ_CLS_TYPE3_PROB_005}, {implementation-record-element=OBJ_DIMENSION_WIDTH_001, system-signal=OBJ_DIMENSION_WIDTH_005}, {implementation-record-element=OBJ_CLS_TYPE1_001, system-signal=OBJ_CLS_TYPE1_005}, {implementation-record-element=OBJ_POS_LONG_ERR_001, system-signal=OBJ_POS_LONG_ERR_005}, {implementation-record-element=OBJ_ACCELERATION_LONG_001, system-signal=OBJ_ACCELERATION_LONG_005}, {implementation-record-element=OBJ_ACCELERATION_LAT_ERR_001, system-signal=OBJ_ACCELERATION_LAT_ERR_005}, {implementation-record-element=OBJ_ACCELERATION_LONG_ERR_001, system-signal=OBJ_ACCELERATION_LONG_ERR_005}, {implementation-record-element=OBJ_CLS_TYPE1_PROB_001, system-signal=OBJ_CLS_TYPE1_PROB_005}, {implementation-record-element=OBJ_YAW_RATE_ERR_001, system-signal=OBJ_YAW_RATE_ERR_005}, {implementation-record-element=OBJ_POS_LONG_001, system-signal=OBJ_POS_LONG_005}, {implementation-record-element=OBJ_CLS_TYPE3_001, system-signal=OBJ_CLS_TYPE3_005}, {implementation-record-element=OBJ_VELOCITY_LONG_001, system-signal=OBJ_VELOCITY_LONG_005}, {implementation-record-element=OBJ_POS_LAT_ERR_001, system-signal=OBJ_POS_LAT_ERR_005}, {implementation-record-element=OBJ_CLS_TYPE4_001, system-signal=OBJ_CLS_TYPE4_005}, {implementation-record-element=OBJ_CLS_TYPE2_PROB_001, system-signal=OBJ_CLS_TYPE2_PROB_005}, {implementation-record-element=OBJ_CLS_TYPE4_PROB_001, system-signal=OBJ_CLS_TYPE4_PROB_005}, {implementation-record-element=OBJ_CLS_TYPE6_001, system-signal=OBJ_CLS_TYPE6_005}, {implementation-record-element=OBJ_CLS_TYPE6_PROB_001, system-signal=OBJ_CLS_TYPE6_PROB_005}, {implementation-record-element=OBJ_DIMENSION_LENGTH_001, system-signal=OBJ_DIMENSION_LENGTH_005}, {implementation-record-element=OBJ_CLS_TYPE2_001, system-signal=OBJ_CLS_TYPE2_005}, {implementation-record-element=OBJ_DIMENSION_LENGTH_ERR_001, system-signal=OBJ_DIMENSION_LENGTH_ERR_005}, {implementation-record-element=OBJ_VELOCITY_LONG_ERR_001, system-signal=OBJ_VELOCITY_LONG_ERR_005}]}
        sender-receiver-to-signal-group-mapping={data-element=COMPOSITIONTYPE.Pp_SG_TrackerObject006.Vdp_SG_TrackerObject006, signal-group=SG_TrackerObject006, type-mapping=sender-rec-record-type-mapping=record-element-mappings=[{implementation-record-element=OBJ_ACCEL_ERR_CRR_COEF_001, system-signal=OBJ_ACCEL_ERR_CRR_COEF_006}, {implementation-record-element=OBJ_ALIVE_TIME_001, system-signal=OBJ_ALIVE_TIME_006}, {implementation-record-element=OBJ_EXISTENCE_PROB_001, system-signal=OBJ_EXISTENCE_PROB_006}, {implementation-record-element=OBJ_GROUP_ID_001, system-signal=OBJ_GROUP_ID_006}, {implementation-record-element=OBJ_ID_001, system-signal=OBJ_ID_006}, {implementation-record-element=OBJ_MEASUREMENT_STATUS_001, system-signal=OBJ_MEASUREMENT_STATUS_006}, {implementation-record-element=OBJ_MH_CRC16_001, system-signal=OBJ_MH_CRC16_006}, {implementation-record-element=OBJ_MH_CYCLE_COUNTER_001, system-signal=OBJ_MH_CYCLE_COUNTER_006}, {implementation-record-element=OBJ_MOVEMENT_STATUS_001, system-signal=OBJ_MOVEMENT_STATUS_006}, {implementation-record-element=OBJ_POS_ERR_CRR_COEF_001, system-signal=OBJ_POS_ERR_CRR_COEF_006}, {implementation-record-element=OBJ_RCS_001, system-signal=OBJ_RCS_006}, {implementation-record-element=OBJ_REF_PT_LAT_OFFSET_001, system-signal=OBJ_REF_PT_LAT_OFFSET_006}, {implementation-record-element=OBJ_REF_PT_LONG_OFFSET_001, system-signal=OBJ_REF_PT_LONG_OFFSET_006}, {implementation-record-element=OBJ_TIMESTAMP_OFFSET_001, system-signal=OBJ_TIMESTAMP_OFFSET_006}, {implementation-record-element=OBJ_TRACK_MOTION_MODEL_001, system-signal=OBJ_TRACK_MOTION_MODEL_006}, {implementation-record-element=OBJ_VEH_TRACK_FLAG_001, system-signal=OBJ_VEH_TRACK_FLAG_006}, {implementation-record-element=OBJ_VELOCITY_ERR_CRR_COEF_001, system-signal=OBJ_VELOCITY_ERR_CRR_COEF_006}, {implementation-record-element=OBJ_ACCELERATION_LAT_001, system-signal=OBJ_ACCELERATION_LAT_006}, {implementation-record-element=OBJ_ACCELERATION_LAT_ERR_001, system-signal=OBJ_ACCELERATION_LAT_ERR_006}, {implementation-record-element=OBJ_ACCELERATION_LONG_001, system-signal=OBJ_ACCELERATION_LONG_006}, {implementation-record-element=OBJ_ACCELERATION_LONG_ERR_001, system-signal=OBJ_ACCELERATION_LONG_ERR_006}, {implementation-record-element=OBJ_CLS_TYPE1_001, system-signal=OBJ_CLS_TYPE1_006}, {implementation-record-element=OBJ_CLS_TYPE1_PROB_001, system-signal=OBJ_CLS_TYPE1_PROB_006}, {implementation-record-element=OBJ_CLS_TYPE2_001, system-signal=OBJ_CLS_TYPE2_006}, {implementation-record-element=OBJ_CLS_TYPE2_PROB_001, system-signal=OBJ_CLS_TYPE2_PROB_006}, {implementation-record-element=OBJ_CLS_TYPE3_001, system-signal=OBJ_CLS_TYPE3_006}, {implementation-record-element=OBJ_CLS_TYPE3_PROB_001, system-signal=OBJ_CLS_TYPE3_PROB_006}, {implementation-record-element=OBJ_POS_LONG_ERR_001, system-signal=OBJ_POS_LONG_ERR_006}, {implementation-record-element=OBJ_VELOCITY_LAT_001, system-signal=OBJ_VELOCITY_LAT_006}, {implementation-record-element=OBJ_VELOCITY_LAT_ERR_001, system-signal=OBJ_VELOCITY_LAT_ERR_006}, {implementation-record-element=OBJ_DIMENSION_LENGTH_ERR_001, system-signal=OBJ_DIMENSION_LENGTH_ERR_006}, {implementation-record-element=OBJ_POS_LAT_ERR_001, system-signal=OBJ_POS_LAT_ERR_006}, {implementation-record-element=OBJ_POS_LONG_001, system-signal=OBJ_POS_LONG_006}, {implementation-record-element=OBJ_VELOCITY_LONG_001, system-signal=OBJ_VELOCITY_LONG_006}, {implementation-record-element=OBJ_CLS_TYPE5_001, system-signal=OBJ_CLS_TYPE5_006}, {implementation-record-element=OBJ_CLS_TYPE6_PROB_001, system-signal=OBJ_CLS_TYPE6_PROB_006}, {implementation-record-element=OBJ_YAW_ANGLE_ERR_001, system-signal=OBJ_YAW_ANGLE_ERR_006}, {implementation-record-element=OBJ_CLS_TYPE5_PROB_001, system-signal=OBJ_CLS_TYPE5_PROB_006}, {implementation-record-element=OBJ_YAW_RATE_001, system-signal=OBJ_YAW_RATE_006}, {implementation-record-element=OBJ_DIMENSION_WIDTH_ERR_001, system-signal=OBJ_DIMENSION_WIDTH_ERR_006}, {implementation-record-element=OBJ_DIMENSION_WIDTH_001, system-signal=OBJ_DIMENSION_WIDTH_006}, {implementation-record-element=OBJ_CLS_TYPE4_PROB_001, system-signal=OBJ_CLS_TYPE4_PROB_006}, {implementation-record-element=OBJ_CLS_TYPE6_001, system-signal=OBJ_CLS_TYPE6_006}, {implementation-record-element=OBJ_YAW_ANGLE_001, system-signal=OBJ_YAW_ANGLE_006}, {implementation-record-element=OBJ_POS_LAT_001, system-signal=OBJ_POS_LAT_006}, {implementation-record-element=OBJ_DIMENSION_LENGTH_001, system-signal=OBJ_DIMENSION_LENGTH_006}, {implementation-record-element=OBJ_YAW_RATE_ERR_001, system-signal=OBJ_YAW_RATE_ERR_006}, {implementation-record-element=OBJ_CLS_TYPE4_001, system-signal=OBJ_CLS_TYPE4_006}, {implementation-record-element=OBJ_VELOCITY_LONG_ERR_001, system-signal=OBJ_VELOCITY_LONG_ERR_006}]}
        sender-receiver-to-signal-group-mapping={data-element=COMPOSITIONTYPE.Pp_SG_TrackerObject007.Vdp_SG_TrackerObject007, signal-group=SG_TrackerObject007, type-mapping=sender-rec-record-type-mapping=record-element-mappings=[{implementation-record-element=OBJ_ACCEL_ERR_CRR_COEF_001, system-signal=OBJ_ACCEL_ERR_CRR_COEF_007}, {implementation-record-element=OBJ_ALIVE_TIME_001, system-signal=OBJ_ALIVE_TIME_007}, {implementation-record-element=OBJ_EXISTENCE_PROB_001, system-signal=OBJ_EXISTENCE_PROB_007}, {implementation-record-element=OBJ_GROUP_ID_001, system-signal=OBJ_GROUP_ID_007}, {implementation-record-element=OBJ_ID_001, system-signal=OBJ_ID_007}, {implementation-record-element=OBJ_MEASUREMENT_STATUS_001, system-signal=OBJ_MEASUREMENT_STATUS_007}, {implementation-record-element=OBJ_MH_CRC16_001, system-signal=OBJ_MH_CRC16_007}, {implementation-record-element=OBJ_MH_CYCLE_COUNTER_001, system-signal=OBJ_MH_CYCLE_COUNTER_007}, {implementation-record-element=OBJ_MOVEMENT_STATUS_001, system-signal=OBJ_MOVEMENT_STATUS_007}, {implementation-record-element=OBJ_POS_ERR_CRR_COEF_001, system-signal=OBJ_POS_ERR_CRR_COEF_007}, {implementation-record-element=OBJ_RCS_001, system-signal=OBJ_RCS_007}, {implementation-record-element=OBJ_REF_PT_LAT_OFFSET_001, system-signal=OBJ_REF_PT_LAT_OFFSET_007}, {implementation-record-element=OBJ_REF_PT_LONG_OFFSET_001, system-signal=OBJ_REF_PT_LONG_OFFSET_007}, {implementation-record-element=OBJ_TIMESTAMP_OFFSET_001, system-signal=OBJ_TIMESTAMP_OFFSET_007}, {implementation-record-element=OBJ_TRACK_MOTION_MODEL_001, system-signal=OBJ_TRACK_MOTION_MODEL_007}, {implementation-record-element=OBJ_VEH_TRACK_FLAG_001, system-signal=OBJ_VEH_TRACK_FLAG_007}, {implementation-record-element=OBJ_VELOCITY_ERR_CRR_COEF_001, system-signal=OBJ_VELOCITY_ERR_CRR_COEF_007}, {implementation-record-element=OBJ_DIMENSION_WIDTH_ERR_001, system-signal=OBJ_DIMENSION_WIDTH_ERR_007}, {implementation-record-element=OBJ_CLS_TYPE4_PROB_001, system-signal=OBJ_CLS_TYPE4_PROB_007}, {implementation-record-element=OBJ_ACCELERATION_LONG_ERR_001, system-signal=OBJ_ACCELERATION_LONG_ERR_007}, {implementation-record-element=OBJ_CLS_TYPE5_001, system-signal=OBJ_CLS_TYPE5_007}, {implementation-record-element=OBJ_CLS_TYPE4_001, system-signal=OBJ_CLS_TYPE4_007}, {implementation-record-element=OBJ_CLS_TYPE5_PROB_001, system-signal=OBJ_CLS_TYPE5_PROB_007}, {implementation-record-element=OBJ_ACCELERATION_LONG_001, system-signal=OBJ_ACCELERATION_LONG_007}, {implementation-record-element=OBJ_ACCELERATION_LAT_ERR_001, system-signal=OBJ_ACCELERATION_LAT_ERR_007}, {implementation-record-element=OBJ_CLS_TYPE1_001, system-signal=OBJ_CLS_TYPE1_007}, {implementation-record-element=OBJ_CLS_TYPE1_PROB_001, system-signal=OBJ_CLS_TYPE1_PROB_007}, {implementation-record-element=OBJ_CLS_TYPE2_PROB_001, system-signal=OBJ_CLS_TYPE2_PROB_007}, {implementation-record-element=OBJ_CLS_TYPE3_001, system-signal=OBJ_CLS_TYPE3_007}, {implementation-record-element=OBJ_ACCELERATION_LAT_001, system-signal=OBJ_ACCELERATION_LAT_007}, {implementation-record-element=OBJ_CLS_TYPE3_PROB_001, system-signal=OBJ_CLS_TYPE3_PROB_007}, {implementation-record-element=OBJ_CLS_TYPE6_001, system-signal=OBJ_CLS_TYPE6_007}, {implementation-record-element=OBJ_CLS_TYPE6_PROB_001, system-signal=OBJ_CLS_TYPE6_PROB_007}, {implementation-record-element=OBJ_CLS_TYPE2_001, system-signal=OBJ_CLS_TYPE2_007}, {implementation-record-element=OBJ_DIMENSION_LENGTH_001, system-signal=OBJ_DIMENSION_LENGTH_007}, {implementation-record-element=OBJ_DIMENSION_LENGTH_ERR_001, system-signal=OBJ_DIMENSION_LENGTH_ERR_007}, {implementation-record-element=OBJ_DIMENSION_WIDTH_001, system-signal=OBJ_DIMENSION_WIDTH_007}, {implementation-record-element=OBJ_VELOCITY_LAT_ERR_001, system-signal=OBJ_VELOCITY_LAT_ERR_007}, {implementation-record-element=OBJ_VELOCITY_LONG_ERR_001, system-signal=OBJ_VELOCITY_LONG_ERR_007}, {implementation-record-element=OBJ_POS_LAT_001, system-signal=OBJ_POS_LAT_007}, {implementation-record-element=OBJ_POS_LONG_001, system-signal=OBJ_POS_LONG_007}, {implementation-record-element=OBJ_POS_LONG_ERR_001, system-signal=OBJ_POS_LONG_ERR_007}, {implementation-record-element=OBJ_POS_LAT_ERR_001, system-signal=OBJ_POS_LAT_ERR_007}, {implementation-record-element=OBJ_VELOCITY_LAT_001, system-signal=OBJ_VELOCITY_LAT_007}, {implementation-record-element=OBJ_YAW_RATE_001, system-signal=OBJ_YAW_RATE_007}, {implementation-record-element=OBJ_YAW_ANGLE_001, system-signal=OBJ_YAW_ANGLE_007}, {implementation-record-element=OBJ_YAW_ANGLE_ERR_001, system-signal=OBJ_YAW_ANGLE_ERR_007}, {implementation-record-element=OBJ_VELOCITY_LONG_001, system-signal=OBJ_VELOCITY_LONG_007}, {implementation-record-element=OBJ_YAW_RATE_ERR_001, system-signal=OBJ_YAW_RATE_ERR_007}]}
        sender-receiver-to-signal-group-mapping={data-element=COMPOSITIONTYPE.Pp_SG_TrackerObject008.Vdp_SG_TrackerObject008, signal-group=SG_TrackerObject008, type-mapping=sender-rec-record-type-mapping=record-element-mappings=[{implementation-record-element=OBJ_ACCEL_ERR_CRR_COEF_001, system-signal=OBJ_ACCEL_ERR_CRR_COEF_008}, {implementation-record-element=OBJ_ALIVE_TIME_001, system-signal=OBJ_ALIVE_TIME_008}, {implementation-record-element=OBJ_EXISTENCE_PROB_001, system-signal=OBJ_EXISTENCE_PROB_008}, {implementation-record-element=OBJ_GROUP_ID_001, system-signal=OBJ_GROUP_ID_008}, {implementation-record-element=OBJ_ID_001, system-signal=OBJ_ID_008}, {implementation-record-element=OBJ_MEASUREMENT_STATUS_001, system-signal=OBJ_MEASUREMENT_STATUS_008}, {implementation-record-element=OBJ_MH_CRC16_001, system-signal=OBJ_MH_CRC16_008}, {implementation-record-element=OBJ_MH_CYCLE_COUNTER_001, system-signal=OBJ_MH_CYCLE_COUNTER_008}, {implementation-record-element=OBJ_MOVEMENT_STATUS_001, system-signal=OBJ_MOVEMENT_STATUS_008}, {implementation-record-element=OBJ_POS_ERR_CRR_COEF_001, system-signal=OBJ_POS_ERR_CRR_COEF_008}, {implementation-record-element=OBJ_RCS_001, system-signal=OBJ_RCS_008}, {implementation-record-element=OBJ_REF_PT_LAT_OFFSET_001, system-signal=OBJ_REF_PT_LAT_OFFSET_008}, {implementation-record-element=OBJ_REF_PT_LONG_OFFSET_001, system-signal=OBJ_REF_PT_LONG_OFFSET_008}, {implementation-record-element=OBJ_TIMESTAMP_OFFSET_001, system-signal=OBJ_TIMESTAMP_OFFSET_008}, {implementation-record-element=OBJ_TRACK_MOTION_MODEL_001, system-signal=OBJ_TRACK_MOTION_MODEL_008}, {implementation-record-element=OBJ_VEH_TRACK_FLAG_001, system-signal=OBJ_VEH_TRACK_FLAG_008}, {implementation-record-element=OBJ_VELOCITY_ERR_CRR_COEF_001, system-signal=OBJ_VELOCITY_ERR_CRR_COEF_008}, {implementation-record-element=OBJ_CLS_TYPE2_001, system-signal=OBJ_CLS_TYPE2_008}, {implementation-record-element=OBJ_ACCELERATION_LAT_ERR_001, system-signal=OBJ_ACCELERATION_LAT_ERR_008}, {implementation-record-element=OBJ_ACCELERATION_LONG_001, system-signal=OBJ_ACCELERATION_LONG_008}, {implementation-record-element=OBJ_POS_LAT_001, system-signal=OBJ_POS_LAT_008}, {implementation-record-element=OBJ_POS_LONG_ERR_001, system-signal=OBJ_POS_LONG_ERR_008}, {implementation-record-element=OBJ_DIMENSION_LENGTH_001, system-signal=OBJ_DIMENSION_LENGTH_008}, {implementation-record-element=OBJ_CLS_TYPE4_PROB_001, system-signal=OBJ_CLS_TYPE4_PROB_008}, {implementation-record-element=OBJ_CLS_TYPE4_001, system-signal=OBJ_CLS_TYPE4_008}, {implementation-record-element=OBJ_CLS_TYPE3_001, system-signal=OBJ_CLS_TYPE3_008}, {implementation-record-element=OBJ_CLS_TYPE2_PROB_001, system-signal=OBJ_CLS_TYPE2_PROB_008}, {implementation-record-element=OBJ_CLS_TYPE3_PROB_001, system-signal=OBJ_CLS_TYPE3_PROB_008}, {implementation-record-element=OBJ_CLS_TYPE5_001, system-signal=OBJ_CLS_TYPE5_008}, {implementation-record-element=OBJ_DIMENSION_WIDTH_ERR_001, system-signal=OBJ_DIMENSION_WIDTH_ERR_008}, {implementation-record-element=OBJ_POS_LAT_ERR_001, system-signal=OBJ_POS_LAT_ERR_008}, {implementation-record-element=OBJ_POS_LONG_001, system-signal=OBJ_POS_LONG_008}, {implementation-record-element=OBJ_CLS_TYPE6_PROB_001, system-signal=OBJ_CLS_TYPE6_PROB_008}, {implementation-record-element=OBJ_CLS_TYPE1_001, system-signal=OBJ_CLS_TYPE1_008}, {implementation-record-element=OBJ_CLS_TYPE1_PROB_001, system-signal=OBJ_CLS_TYPE1_PROB_008}, {implementation-record-element=OBJ_DIMENSION_LENGTH_ERR_001, system-signal=OBJ_DIMENSION_LENGTH_ERR_008}, {implementation-record-element=OBJ_ACCELERATION_LAT_001, system-signal=OBJ_ACCELERATION_LAT_008}, {implementation-record-element=OBJ_CLS_TYPE6_001, system-signal=OBJ_CLS_TYPE6_008}, {implementation-record-element=OBJ_ACCELERATION_LONG_ERR_001, system-signal=OBJ_ACCELERATION_LONG_ERR_008}, {implementation-record-element=OBJ_CLS_TYPE5_PROB_001, system-signal=OBJ_CLS_TYPE5_PROB_008}, {implementation-record-element=OBJ_DIMENSION_WIDTH_001, system-signal=OBJ_DIMENSION_WIDTH_008}, {implementation-record-element=OBJ_YAW_RATE_ERR_001, system-signal=OBJ_YAW_RATE_ERR_008}, {implementation-record-element=OBJ_VELOCITY_LONG_ERR_001, system-signal=OBJ_VELOCITY_LONG_ERR_008}, {implementation-record-element=OBJ_YAW_ANGLE_001, system-signal=OBJ_YAW_ANGLE_008}, {implementation-record-element=OBJ_YAW_RATE_001, system-signal=OBJ_YAW_RATE_008}, {implementation-record-element=OBJ_YAW_ANGLE_ERR_001, system-signal=OBJ_YAW_ANGLE_ERR_008}, {implementation-record-element=OBJ_VELOCITY_LAT_001, system-signal=OBJ_VELOCITY_LAT_008}, {implementation-record-element=OBJ_VELOCITY_LAT_ERR_001, system-signal=OBJ_VELOCITY_LAT_ERR_008}, {implementation-record-element=OBJ_VELOCITY_LONG_001, system-signal=OBJ_VELOCITY_LONG_008}]}
        sender-receiver-to-signal-group-mapping={data-element=COMPOSITIONTYPE.Pp_SG_TrackerObject009.Vdp_SG_TrackerObject009, signal-group=SG_TrackerObject009, type-mapping=sender-rec-record-type-mapping=record-element-mappings=[{implementation-record-element=OBJ_ACCEL_ERR_CRR_COEF_001, system-signal=OBJ_ACCEL_ERR_CRR_COEF_009}, {implementation-record-element=OBJ_ALIVE_TIME_001, system-signal=OBJ_ALIVE_TIME_009}, {implementation-record-element=OBJ_EXISTENCE_PROB_001, system-signal=OBJ_EXISTENCE_PROB_009}, {implementation-record-element=OBJ_GROUP_ID_001, system-signal=OBJ_GROUP_ID_009}, {implementation-record-element=OBJ_ID_001, system-signal=OBJ_ID_009}, {implementation-record-element=OBJ_MEASUREMENT_STATUS_001, system-signal=OBJ_MEASUREMENT_STATUS_009}, {implementation-record-element=OBJ_MH_CRC16_001, system-signal=OBJ_MH_CRC16_009}, {implementation-record-element=OBJ_MH_CYCLE_COUNTER_001, system-signal=OBJ_MH_CYCLE_COUNTER_009}, {implementation-record-element=OBJ_MOVEMENT_STATUS_001, system-signal=OBJ_MOVEMENT_STATUS_009}, {implementation-record-element=OBJ_POS_ERR_CRR_COEF_001, system-signal=OBJ_POS_ERR_CRR_COEF_009}, {implementation-record-element=OBJ_RCS_001, system-signal=OBJ_RCS_009}, {implementation-record-element=OBJ_REF_PT_LAT_OFFSET_001, system-signal=OBJ_REF_PT_LAT_OFFSET_009}, {implementation-record-element=OBJ_REF_PT_LONG_OFFSET_001, system-signal=OBJ_REF_PT_LONG_OFFSET_009}, {implementation-record-element=OBJ_TIMESTAMP_OFFSET_001, system-signal=OBJ_TIMESTAMP_OFFSET_009}, {implementation-record-element=OBJ_TRACK_MOTION_MODEL_001, system-signal=OBJ_TRACK_MOTION_MODEL_009}, {implementation-record-element=OBJ_VEH_TRACK_FLAG_001, system-signal=OBJ_VEH_TRACK_FLAG_009}, {implementation-record-element=OBJ_VELOCITY_ERR_CRR_COEF_001, system-signal=OBJ_VELOCITY_ERR_CRR_COEF_009}, {implementation-record-element=OBJ_CLS_TYPE2_001, system-signal=OBJ_CLS_TYPE2_009}, {implementation-record-element=OBJ_CLS_TYPE5_001, system-signal=OBJ_CLS_TYPE5_009}, {implementation-record-element=OBJ_DIMENSION_LENGTH_001, system-signal=OBJ_DIMENSION_LENGTH_009}, {implementation-record-element=OBJ_VELOCITY_LAT_ERR_001, system-signal=OBJ_VELOCITY_LAT_ERR_009}, {implementation-record-element=OBJ_CLS_TYPE5_PROB_001, system-signal=OBJ_CLS_TYPE5_PROB_009}, {implementation-record-element=OBJ_POS_LAT_001, system-signal=OBJ_POS_LAT_009}, {implementation-record-element=OBJ_CLS_TYPE6_PROB_001, system-signal=OBJ_CLS_TYPE6_PROB_009}, {implementation-record-element=OBJ_CLS_TYPE2_PROB_001, system-signal=OBJ_CLS_TYPE2_PROB_009}, {implementation-record-element=OBJ_CLS_TYPE3_001, system-signal=OBJ_CLS_TYPE3_009}, {implementation-record-element=OBJ_DIMENSION_LENGTH_ERR_001, system-signal=OBJ_DIMENSION_LENGTH_ERR_009}, {implementation-record-element=OBJ_CLS_TYPE1_PROB_001, system-signal=OBJ_CLS_TYPE1_PROB_009}, {implementation-record-element=OBJ_DIMENSION_WIDTH_ERR_001, system-signal=OBJ_DIMENSION_WIDTH_ERR_009}, {implementation-record-element=OBJ_POS_LONG_001, system-signal=OBJ_POS_LONG_009}, {implementation-record-element=OBJ_ACCELERATION_LAT_ERR_001, system-signal=OBJ_ACCELERATION_LAT_ERR_009}, {implementation-record-element=OBJ_DIMENSION_WIDTH_001, system-signal=OBJ_DIMENSION_WIDTH_009}, {implementation-record-element=OBJ_ACCELERATION_LAT_001, system-signal=OBJ_ACCELERATION_LAT_009}, {implementation-record-element=OBJ_CLS_TYPE6_001, system-signal=OBJ_CLS_TYPE6_009}, {implementation-record-element=OBJ_VELOCITY_LAT_001, system-signal=OBJ_VELOCITY_LAT_009}, {implementation-record-element=OBJ_VELOCITY_LONG_001, system-signal=OBJ_VELOCITY_LONG_009}, {implementation-record-element=OBJ_POS_LAT_ERR_001, system-signal=OBJ_POS_LAT_ERR_009}, {implementation-record-element=OBJ_VELOCITY_LONG_ERR_001, system-signal=OBJ_VELOCITY_LONG_ERR_009}, {implementation-record-element=OBJ_CLS_TYPE3_PROB_001, system-signal=OBJ_CLS_TYPE3_PROB_009}, {implementation-record-element=OBJ_YAW_ANGLE_ERR_001, system-signal=OBJ_YAW_ANGLE_ERR_009}, {implementation-record-element=OBJ_YAW_RATE_ERR_001, system-signal=OBJ_YAW_RATE_ERR_009}, {implementation-record-element=OBJ_YAW_RATE_001, system-signal=OBJ_YAW_RATE_009}, {implementation-record-element=OBJ_YAW_ANGLE_001, system-signal=OBJ_YAW_ANGLE_009}, {implementation-record-element=OBJ_ACCELERATION_LONG_001, system-signal=OBJ_ACCELERATION_LONG_009}, {implementation-record-element=OBJ_CLS_TYPE4_001, system-signal=OBJ_CLS_TYPE4_009}, {implementation-record-element=OBJ_CLS_TYPE4_PROB_001, system-signal=OBJ_CLS_TYPE4_PROB_009}, {implementation-record-element=OBJ_CLS_TYPE1_001, system-signal=OBJ_CLS_TYPE1_009}, {implementation-record-element=OBJ_POS_LONG_ERR_001, system-signal=OBJ_POS_LONG_ERR_009}, {implementation-record-element=OBJ_ACCELERATION_LONG_ERR_001, system-signal=OBJ_ACCELERATION_LONG_ERR_009}]}
        sender-receiver-to-signal-group-mapping={data-element=COMPOSITIONTYPE.Pp_SG_TrackerObject010.Vdp_SG_TrackerObject010, signal-group=SG_TrackerObject010, type-mapping=sender-rec-record-type-mapping=record-element-mappings=[{implementation-record-element=OBJ_ACCEL_ERR_CRR_COEF_001, system-signal=OBJ_ACCEL_ERR_CRR_COEF_010}, {implementation-record-element=OBJ_ALIVE_TIME_001, system-signal=OBJ_ALIVE_TIME_010}, {implementation-record-element=OBJ_EXISTENCE_PROB_001, system-signal=OBJ_EXISTENCE_PROB_010}, {implementation-record-element=OBJ_GROUP_ID_001, system-signal=OBJ_GROUP_ID_010}, {implementation-record-element=OBJ_ID_001, system-signal=OBJ_ID_010}, {implementation-record-element=OBJ_MEASUREMENT_STATUS_001, system-signal=OBJ_MEASUREMENT_STATUS_010}, {implementation-record-element=OBJ_MH_CRC16_001, system-signal=OBJ_MH_CRC16_010}, {implementation-record-element=OBJ_MH_CYCLE_COUNTER_001, system-signal=OBJ_MH_CYCLE_COUNTER_010}, {implementation-record-element=OBJ_MOVEMENT_STATUS_001, system-signal=OBJ_MOVEMENT_STATUS_010}, {implementation-record-element=OBJ_POS_ERR_CRR_COEF_001, system-signal=OBJ_POS_ERR_CRR_COEF_010}, {implementation-record-element=OBJ_RCS_001, system-signal=OBJ_RCS_010}, {implementation-record-element=OBJ_REF_PT_LAT_OFFSET_001, system-signal=OBJ_REF_PT_LAT_OFFSET_010}, {implementation-record-element=OBJ_REF_PT_LONG_OFFSET_001, system-signal=OBJ_REF_PT_LONG_OFFSET_010}, {implementation-record-element=OBJ_TIMESTAMP_OFFSET_001, system-signal=OBJ_TIMESTAMP_OFFSET_010}, {implementation-record-element=OBJ_TRACK_MOTION_MODEL_001, system-signal=OBJ_TRACK_MOTION_MODEL_010}, {implementation-record-element=OBJ_VEH_TRACK_FLAG_001, system-signal=OBJ_VEH_TRACK_FLAG_010}, {implementation-record-element=OBJ_VELOCITY_ERR_CRR_COEF_001, system-signal=OBJ_VELOCITY_ERR_CRR_COEF_010}, {implementation-record-element=OBJ_ACCELERATION_LAT_001, system-signal=OBJ_ACCELERATION_LAT_010}, {implementation-record-element=OBJ_ACCELERATION_LAT_ERR_001, system-signal=OBJ_ACCELERATION_LAT_ERR_010}, {implementation-record-element=OBJ_ACCELERATION_LONG_001, system-signal=OBJ_ACCELERATION_LONG_010}, {implementation-record-element=OBJ_CLS_TYPE6_PROB_001, system-signal=OBJ_CLS_TYPE6_PROB_010}, {implementation-record-element=OBJ_VELOCITY_LAT_001, system-signal=OBJ_VELOCITY_LAT_010}, {implementation-record-element=OBJ_CLS_TYPE1_001, system-signal=OBJ_CLS_TYPE1_010}, {implementation-record-element=OBJ_CLS_TYPE2_PROB_001, system-signal=OBJ_CLS_TYPE2_PROB_010}, {implementation-record-element=OBJ_CLS_TYPE3_001, system-signal=OBJ_CLS_TYPE3_010}, {implementation-record-element=OBJ_POS_LAT_001, system-signal=OBJ_POS_LAT_010}, {implementation-record-element=OBJ_POS_LONG_ERR_001, system-signal=OBJ_POS_LONG_ERR_010}, {implementation-record-element=OBJ_VELOCITY_LAT_ERR_001, system-signal=OBJ_VELOCITY_LAT_ERR_010}, {implementation-record-element=OBJ_YAW_RATE_ERR_001, system-signal=OBJ_YAW_RATE_ERR_010}, {implementation-record-element=OBJ_CLS_TYPE5_001, system-signal=OBJ_CLS_TYPE5_010}, {implementation-record-element=OBJ_CLS_TYPE5_PROB_001, system-signal=OBJ_CLS_TYPE5_PROB_010}, {implementation-record-element=OBJ_CLS_TYPE3_PROB_001, system-signal=OBJ_CLS_TYPE3_PROB_010}, {implementation-record-element=OBJ_YAW_RATE_001, system-signal=OBJ_YAW_RATE_010}, {implementation-record-element=OBJ_CLS_TYPE2_001, system-signal=OBJ_CLS_TYPE2_010}, {implementation-record-element=OBJ_POS_LONG_001, system-signal=OBJ_POS_LONG_010}, {implementation-record-element=OBJ_CLS_TYPE4_001, system-signal=OBJ_CLS_TYPE4_010}, {implementation-record-element=OBJ_ACCELERATION_LONG_ERR_001, system-signal=OBJ_ACCELERATION_LONG_ERR_010}, {implementation-record-element=OBJ_DIMENSION_LENGTH_ERR_001, system-signal=OBJ_DIMENSION_LENGTH_ERR_010}, {implementation-record-element=OBJ_DIMENSION_WIDTH_001, system-signal=OBJ_DIMENSION_WIDTH_010}, {implementation-record-element=OBJ_CLS_TYPE4_PROB_001, system-signal=OBJ_CLS_TYPE4_PROB_010}, {implementation-record-element=OBJ_DIMENSION_LENGTH_001, system-signal=OBJ_DIMENSION_LENGTH_010}, {implementation-record-element=OBJ_VELOCITY_LONG_001, system-signal=OBJ_VELOCITY_LONG_010}, {implementation-record-element=OBJ_CLS_TYPE6_001, system-signal=OBJ_CLS_TYPE6_010}, {implementation-record-element=OBJ_DIMENSION_WIDTH_ERR_001, system-signal=OBJ_DIMENSION_WIDTH_ERR_010}, {implementation-record-element=OBJ_CLS_TYPE1_PROB_001, system-signal=OBJ_CLS_TYPE1_PROB_010}, {implementation-record-element=OBJ_POS_LAT_ERR_001, system-signal=OBJ_POS_LAT_ERR_010}, {implementation-record-element=OBJ_VELOCITY_LONG_ERR_001, system-signal=OBJ_VELOCITY_LONG_ERR_010}, {implementation-record-element=OBJ_YAW_ANGLE_001, system-signal=OBJ_YAW_ANGLE_010}, {implementation-record-element=OBJ_YAW_ANGLE_ERR_001, system-signal=OBJ_YAW_ANGLE_ERR_010}]}
        sender-receiver-to-signal-group-mapping={data-element=COMPOSITIONTYPE.Pp_SG_TrackerObject011.Vdp_SG_TrackerObject011, signal-group=SG_TrackerObject011, type-mapping=sender-rec-record-type-mapping=record-element-mappings=[{implementation-record-element=OBJ_ACCEL_ERR_CRR_COEF_001, system-signal=OBJ_ACCEL_ERR_CRR_COEF_011}, {implementation-record-element=OBJ_ALIVE_TIME_001, system-signal=OBJ_ALIVE_TIME_011}, {implementation-record-element=OBJ_EXISTENCE_PROB_001, system-signal=OBJ_EXISTENCE_PROB_011}, {implementation-record-element=OBJ_GROUP_ID_001, system-signal=OBJ_GROUP_ID_011}, {implementation-record-element=OBJ_ID_001, system-signal=OBJ_ID_011}, {implementation-record-element=OBJ_MEASUREMENT_STATUS_001, system-signal=OBJ_MEASUREMENT_STATUS_011}, {implementation-record-element=OBJ_MH_CRC16_001, system-signal=OBJ_MH_CRC16_011}, {implementation-record-element=OBJ_MH_CYCLE_COUNTER_001, system-signal=OBJ_MH_CYCLE_COUNTER_011}, {implementation-record-element=OBJ_MOVEMENT_STATUS_001, system-signal=OBJ_MOVEMENT_STATUS_011}, {implementation-record-element=OBJ_POS_ERR_CRR_COEF_001, system-signal=OBJ_POS_ERR_CRR_COEF_011}, {implementation-record-element=OBJ_RCS_001, system-signal=OBJ_RCS_011}, {implementation-record-element=OBJ_REF_PT_LAT_OFFSET_001, system-signal=OBJ_REF_PT_LAT_OFFSET_011}, {implementation-record-element=OBJ_REF_PT_LONG_OFFSET_001, system-signal=OBJ_REF_PT_LONG_OFFSET_011}, {implementation-record-element=OBJ_TIMESTAMP_OFFSET_001, system-signal=OBJ_TIMESTAMP_OFFSET_011}, {implementation-record-element=OBJ_TRACK_MOTION_MODEL_001, system-signal=OBJ_TRACK_MOTION_MODEL_011}, {implementation-record-element=OBJ_VEH_TRACK_FLAG_001, system-signal=OBJ_VEH_TRACK_FLAG_011}, {implementation-record-element=OBJ_VELOCITY_ERR_CRR_COEF_001, system-signal=OBJ_VELOCITY_ERR_CRR_COEF_011}, {implementation-record-element=OBJ_ACCELERATION_LAT_001, system-signal=OBJ_ACCELERATION_LAT_011}, {implementation-record-element=OBJ_ACCELERATION_LONG_001, system-signal=OBJ_ACCELERATION_LONG_011}, {implementation-record-element=OBJ_CLS_TYPE1_PROB_001, system-signal=OBJ_CLS_TYPE1_PROB_011}, {implementation-record-element=OBJ_CLS_TYPE2_001, system-signal=OBJ_CLS_TYPE2_011}, {implementation-record-element=OBJ_CLS_TYPE2_PROB_001, system-signal=OBJ_CLS_TYPE2_PROB_011}, {implementation-record-element=OBJ_ACCELERATION_LONG_ERR_001, system-signal=OBJ_ACCELERATION_LONG_ERR_011}, {implementation-record-element=OBJ_CLS_TYPE4_PROB_001, system-signal=OBJ_CLS_TYPE4_PROB_011}, {implementation-record-element=OBJ_CLS_TYPE5_001, system-signal=OBJ_CLS_TYPE5_011}, {implementation-record-element=OBJ_CLS_TYPE3_PROB_001, system-signal=OBJ_CLS_TYPE3_PROB_011}, {implementation-record-element=OBJ_ACCELERATION_LAT_ERR_001, system-signal=OBJ_ACCELERATION_LAT_ERR_011}, {implementation-record-element=OBJ_CLS_TYPE3_001, system-signal=OBJ_CLS_TYPE3_011}, {implementation-record-element=OBJ_CLS_TYPE5_PROB_001, system-signal=OBJ_CLS_TYPE5_PROB_011}, {implementation-record-element=OBJ_CLS_TYPE6_001, system-signal=OBJ_CLS_TYPE6_011}, {implementation-record-element=OBJ_CLS_TYPE4_001, system-signal=OBJ_CLS_TYPE4_011}, {implementation-record-element=OBJ_CLS_TYPE6_PROB_001, system-signal=OBJ_CLS_TYPE6_PROB_011}, {implementation-record-element=OBJ_CLS_TYPE1_001, system-signal=OBJ_CLS_TYPE1_011}, {implementation-record-element=OBJ_POS_LAT_001, system-signal=OBJ_POS_LAT_011}, {implementation-record-element=OBJ_POS_LONG_001, system-signal=OBJ_POS_LONG_011}, {implementation-record-element=OBJ_YAW_RATE_001, system-signal=OBJ_YAW_RATE_011}, {implementation-record-element=OBJ_YAW_ANGLE_001, system-signal=OBJ_YAW_ANGLE_011}, {implementation-record-element=OBJ_DIMENSION_LENGTH_001, system-signal=OBJ_DIMENSION_LENGTH_011}, {implementation-record-element=OBJ_YAW_ANGLE_ERR_001, system-signal=OBJ_YAW_ANGLE_ERR_011}, {implementation-record-element=OBJ_YAW_RATE_ERR_001, system-signal=OBJ_YAW_RATE_ERR_011}, {implementation-record-element=OBJ_DIMENSION_WIDTH_001, system-signal=OBJ_DIMENSION_WIDTH_011}, {implementation-record-element=OBJ_DIMENSION_WIDTH_ERR_001, system-signal=OBJ_DIMENSION_WIDTH_ERR_011}, {implementation-record-element=OBJ_DIMENSION_LENGTH_ERR_001, system-signal=OBJ_DIMENSION_LENGTH_ERR_011}, {implementation-record-element=OBJ_VELOCITY_LAT_001, system-signal=OBJ_VELOCITY_LAT_011}, {implementation-record-element=OBJ_VELOCITY_LAT_ERR_001, system-signal=OBJ_VELOCITY_LAT_ERR_011}, {implementation-record-element=OBJ_VELOCITY_LONG_ERR_001, system-signal=OBJ_VELOCITY_LONG_ERR_011}, {implementation-record-element=OBJ_POS_LONG_ERR_001, system-signal=OBJ_POS_LONG_ERR_011}, {implementation-record-element=OBJ_VELOCITY_LONG_001, system-signal=OBJ_VELOCITY_LONG_011}, {implementation-record-element=OBJ_POS_LAT_ERR_001, system-signal=OBJ_POS_LAT_ERR_011}]}
        sender-receiver-to-signal-group-mapping={data-element=COMPOSITIONTYPE.Pp_SG_TrackerObject012.Vdp_SG_TrackerObject012, signal-group=SG_TrackerObject012, type-mapping=sender-rec-record-type-mapping=record-element-mappings=[{implementation-record-element=OBJ_ACCEL_ERR_CRR_COEF_001, system-signal=OBJ_ACCEL_ERR_CRR_COEF_012}, {implementation-record-element=OBJ_ALIVE_TIME_001, system-signal=OBJ_ALIVE_TIME_012}, {implementation-record-element=OBJ_EXISTENCE_PROB_001, system-signal=OBJ_EXISTENCE_PROB_012}, {implementation-record-element=OBJ_GROUP_ID_001, system-signal=OBJ_GROUP_ID_012}, {implementation-record-element=OBJ_ID_001, system-signal=OBJ_ID_012}, {implementation-record-element=OBJ_MEASUREMENT_STATUS_001, system-signal=OBJ_MEASUREMENT_STATUS_012}, {implementation-record-element=OBJ_MH_CRC16_001, system-signal=OBJ_MH_CRC16_012}, {implementation-record-element=OBJ_MH_CYCLE_COUNTER_001, system-signal=OBJ_MH_CYCLE_COUNTER_012}, {implementation-record-element=OBJ_MOVEMENT_STATUS_001, system-signal=OBJ_MOVEMENT_STATUS_012}, {implementation-record-element=OBJ_POS_ERR_CRR_COEF_001, system-signal=OBJ_POS_ERR_CRR_COEF_012}, {implementation-record-element=OBJ_RCS_001, system-signal=OBJ_RCS_012}, {implementation-record-element=OBJ_REF_PT_LAT_OFFSET_001, system-signal=OBJ_REF_PT_LAT_OFFSET_012}, {implementation-record-element=OBJ_REF_PT_LONG_OFFSET_001, system-signal=OBJ_REF_PT_LONG_OFFSET_012}, {implementation-record-element=OBJ_TIMESTAMP_OFFSET_001, system-signal=OBJ_TIMESTAMP_OFFSET_012}, {implementation-record-element=OBJ_TRACK_MOTION_MODEL_001, system-signal=OBJ_TRACK_MOTION_MODEL_012}, {implementation-record-element=OBJ_VEH_TRACK_FLAG_001, system-signal=OBJ_VEH_TRACK_FLAG_012}, {implementation-record-element=OBJ_VELOCITY_ERR_CRR_COEF_001, system-signal=OBJ_VELOCITY_ERR_CRR_COEF_012}, {implementation-record-element=OBJ_CLS_TYPE3_001, system-signal=OBJ_CLS_TYPE3_012}, {implementation-record-element=OBJ_CLS_TYPE2_PROB_001, system-signal=OBJ_CLS_TYPE2_PROB_012}, {implementation-record-element=OBJ_CLS_TYPE5_001, system-signal=OBJ_CLS_TYPE5_012}, {implementation-record-element=OBJ_CLS_TYPE5_PROB_001, system-signal=OBJ_CLS_TYPE5_PROB_012}, {implementation-record-element=OBJ_CLS_TYPE3_PROB_001, system-signal=OBJ_CLS_TYPE3_PROB_012}, {implementation-record-element=OBJ_CLS_TYPE4_001, system-signal=OBJ_CLS_TYPE4_012}, {implementation-record-element=OBJ_CLS_TYPE6_001, system-signal=OBJ_CLS_TYPE6_012}, {implementation-record-element=OBJ_CLS_TYPE1_001, system-signal=OBJ_CLS_TYPE1_012}, {implementation-record-element=OBJ_CLS_TYPE6_PROB_001, system-signal=OBJ_CLS_TYPE6_PROB_012}, {implementation-record-element=OBJ_DIMENSION_LENGTH_001, system-signal=OBJ_DIMENSION_LENGTH_012}, {implementation-record-element=OBJ_DIMENSION_WIDTH_001, system-signal=OBJ_DIMENSION_WIDTH_012}, {implementation-record-element=OBJ_DIMENSION_WIDTH_ERR_001, system-signal=OBJ_DIMENSION_WIDTH_ERR_012}, {implementation-record-element=OBJ_CLS_TYPE2_001, system-signal=OBJ_CLS_TYPE2_012}, {implementation-record-element=OBJ_POS_LAT_001, system-signal=OBJ_POS_LAT_012}, {implementation-record-element=OBJ_POS_LAT_ERR_001, system-signal=OBJ_POS_LAT_ERR_012}, {implementation-record-element=OBJ_DIMENSION_LENGTH_ERR_001, system-signal=OBJ_DIMENSION_LENGTH_ERR_012}, {implementation-record-element=OBJ_ACCELERATION_LAT_001, system-signal=OBJ_ACCELERATION_LAT_012}, {implementation-record-element=OBJ_ACCELERATION_LONG_001, system-signal=OBJ_ACCELERATION_LONG_012}, {implementation-record-element=OBJ_ACCELERATION_LONG_ERR_001, system-signal=OBJ_ACCELERATION_LONG_ERR_012}, {implementation-record-element=OBJ_CLS_TYPE4_PROB_001, system-signal=OBJ_CLS_TYPE4_PROB_012}, {implementation-record-element=OBJ_CLS_TYPE1_PROB_001, system-signal=OBJ_CLS_TYPE1_PROB_012}, {implementation-record-element=OBJ_ACCELERATION_LAT_ERR_001, system-signal=OBJ_ACCELERATION_LAT_ERR_012}, {implementation-record-element=OBJ_YAW_ANGLE_ERR_001, system-signal=OBJ_YAW_ANGLE_ERR_012}, {implementation-record-element=OBJ_YAW_ANGLE_001, system-signal=OBJ_YAW_ANGLE_012}, {implementation-record-element=OBJ_YAW_RATE_001, system-signal=OBJ_YAW_RATE_012}, {implementation-record-element=OBJ_POS_LONG_ERR_001, system-signal=OBJ_POS_LONG_ERR_012}, {implementation-record-element=OBJ_VELOCITY_LONG_001, system-signal=OBJ_VELOCITY_LONG_012}, {implementation-record-element=OBJ_VELOCITY_LONG_ERR_001, system-signal=OBJ_VELOCITY_LONG_ERR_012}, {implementation-record-element=OBJ_VELOCITY_LAT_001, system-signal=OBJ_VELOCITY_LAT_012}, {implementation-record-element=OBJ_POS_LONG_001, system-signal=OBJ_POS_LONG_012}, {implementation-record-element=OBJ_YAW_RATE_ERR_001, system-signal=OBJ_YAW_RATE_ERR_012}, {implementation-record-element=OBJ_VELOCITY_LAT_ERR_001, system-signal=OBJ_VELOCITY_LAT_ERR_012}]}
        sender-receiver-to-signal-group-mapping={data-element=COMPOSITIONTYPE.Pp_SG_TrackerObject013.Vdp_SG_TrackerObject013, signal-group=SG_TrackerObject013, type-mapping=sender-rec-record-type-mapping=record-element-mappings=[{implementation-record-element=OBJ_ACCEL_ERR_CRR_COEF_001, system-signal=OBJ_ACCEL_ERR_CRR_COEF_013}, {implementation-record-element=OBJ_ALIVE_TIME_001, system-signal=OBJ_ALIVE_TIME_013}, {implementation-record-element=OBJ_EXISTENCE_PROB_001, system-signal=OBJ_EXISTENCE_PROB_013}, {implementation-record-element=OBJ_GROUP_ID_001, system-signal=OBJ_GROUP_ID_013}, {implementation-record-element=OBJ_ID_001, system-signal=OBJ_ID_013}, {implementation-record-element=OBJ_MEASUREMENT_STATUS_001, system-signal=OBJ_MEASUREMENT_STATUS_013}, {implementation-record-element=OBJ_MH_CRC16_001, system-signal=OBJ_MH_CRC16_013}, {implementation-record-element=OBJ_MH_CYCLE_COUNTER_001, system-signal=OBJ_MH_CYCLE_COUNTER_013}, {implementation-record-element=OBJ_MOVEMENT_STATUS_001, system-signal=OBJ_MOVEMENT_STATUS_013}, {implementation-record-element=OBJ_POS_ERR_CRR_COEF_001, system-signal=OBJ_POS_ERR_CRR_COEF_013}, {implementation-record-element=OBJ_RCS_001, system-signal=OBJ_RCS_013}, {implementation-record-element=OBJ_REF_PT_LAT_OFFSET_001, system-signal=OBJ_REF_PT_LAT_OFFSET_013}, {implementation-record-element=OBJ_REF_PT_LONG_OFFSET_001, system-signal=OBJ_REF_PT_LONG_OFFSET_013}, {implementation-record-element=OBJ_TIMESTAMP_OFFSET_001, system-signal=OBJ_TIMESTAMP_OFFSET_013}, {implementation-record-element=OBJ_TRACK_MOTION_MODEL_001, system-signal=OBJ_TRACK_MOTION_MODEL_013}, {implementation-record-element=OBJ_VEH_TRACK_FLAG_001, system-signal=OBJ_VEH_TRACK_FLAG_013}, {implementation-record-element=OBJ_VELOCITY_ERR_CRR_COEF_001, system-signal=OBJ_VELOCITY_ERR_CRR_COEF_013}, {implementation-record-element=OBJ_ACCELERATION_LAT_ERR_001, system-signal=OBJ_ACCELERATION_LAT_ERR_013}, {implementation-record-element=OBJ_CLS_TYPE3_PROB_001, system-signal=OBJ_CLS_TYPE3_PROB_013}, {implementation-record-element=OBJ_ACCELERATION_LONG_001, system-signal=OBJ_ACCELERATION_LONG_013}, {implementation-record-element=OBJ_ACCELERATION_LONG_ERR_001, system-signal=OBJ_ACCELERATION_LONG_ERR_013}, {implementation-record-element=OBJ_POS_LAT_ERR_001, system-signal=OBJ_POS_LAT_ERR_013}, {implementation-record-element=OBJ_DIMENSION_WIDTH_ERR_001, system-signal=OBJ_DIMENSION_WIDTH_ERR_013}, {implementation-record-element=OBJ_POS_LONG_ERR_001, system-signal=OBJ_POS_LONG_ERR_013}, {implementation-record-element=OBJ_POS_LONG_001, system-signal=OBJ_POS_LONG_013}, {implementation-record-element=OBJ_DIMENSION_WIDTH_001, system-signal=OBJ_DIMENSION_WIDTH_013}, {implementation-record-element=OBJ_CLS_TYPE2_001, system-signal=OBJ_CLS_TYPE2_013}, {implementation-record-element=OBJ_CLS_TYPE2_PROB_001, system-signal=OBJ_CLS_TYPE2_PROB_013}, {implementation-record-element=OBJ_CLS_TYPE6_PROB_001, system-signal=OBJ_CLS_TYPE6_PROB_013}, {implementation-record-element=OBJ_VELOCITY_LAT_001, system-signal=OBJ_VELOCITY_LAT_013}, {implementation-record-element=OBJ_VELOCITY_LAT_ERR_001, system-signal=OBJ_VELOCITY_LAT_ERR_013}, {implementation-record-element=OBJ_VELOCITY_LONG_001, system-signal=OBJ_VELOCITY_LONG_013}, {implementation-record-element=OBJ_CLS_TYPE1_001, system-signal=OBJ_CLS_TYPE1_013}, {implementation-record-element=OBJ_VELOCITY_LONG_ERR_001, system-signal=OBJ_VELOCITY_LONG_ERR_013}, {implementation-record-element=OBJ_YAW_ANGLE_001, system-signal=OBJ_YAW_ANGLE_013}, {implementation-record-element=OBJ_DIMENSION_LENGTH_ERR_001, system-signal=OBJ_DIMENSION_LENGTH_ERR_013}, {implementation-record-element=OBJ_CLS_TYPE6_001, system-signal=OBJ_CLS_TYPE6_013}, {implementation-record-element=OBJ_POS_LAT_001, system-signal=OBJ_POS_LAT_013}, {implementation-record-element=OBJ_CLS_TYPE1_PROB_001, system-signal=OBJ_CLS_TYPE1_PROB_013}, {implementation-record-element=OBJ_CLS_TYPE4_001, system-signal=OBJ_CLS_TYPE4_013}, {implementation-record-element=OBJ_CLS_TYPE5_001, system-signal=OBJ_CLS_TYPE5_013}, {implementation-record-element=OBJ_ACCELERATION_LAT_001, system-signal=OBJ_ACCELERATION_LAT_013}, {implementation-record-element=OBJ_CLS_TYPE3_001, system-signal=OBJ_CLS_TYPE3_013}, {implementation-record-element=OBJ_CLS_TYPE5_PROB_001, system-signal=OBJ_CLS_TYPE5_PROB_013}, {implementation-record-element=OBJ_DIMENSION_LENGTH_001, system-signal=OBJ_DIMENSION_LENGTH_013}, {implementation-record-element=OBJ_CLS_TYPE4_PROB_001, system-signal=OBJ_CLS_TYPE4_PROB_013}, {implementation-record-element=OBJ_YAW_RATE_ERR_001, system-signal=OBJ_YAW_RATE_ERR_013}, {implementation-record-element=OBJ_YAW_RATE_001, system-signal=OBJ_YAW_RATE_013}, {implementation-record-element=OBJ_YAW_ANGLE_ERR_001, system-signal=OBJ_YAW_ANGLE_ERR_013}]}
        sender-receiver-to-signal-group-mapping={data-element=COMPOSITIONTYPE.Pp_SG_TrackerObject014.Vdp_SG_TrackerObject014, signal-group=SG_TrackerObject014, type-mapping=sender-rec-record-type-mapping=record-element-mappings=[{implementation-record-element=OBJ_ACCEL_ERR_CRR_COEF_001, system-signal=OBJ_ACCEL_ERR_CRR_COEF_014}, {implementation-record-element=OBJ_ALIVE_TIME_001, system-signal=OBJ_ALIVE_TIME_014}, {implementation-record-element=OBJ_EXISTENCE_PROB_001, system-signal=OBJ_EXISTENCE_PROB_014}, {implementation-record-element=OBJ_GROUP_ID_001, system-signal=OBJ_GROUP_ID_014}, {implementation-record-element=OBJ_ID_001, system-signal=OBJ_ID_014}, {implementation-record-element=OBJ_MEASUREMENT_STATUS_001, system-signal=OBJ_MEASUREMENT_STATUS_014}, {implementation-record-element=OBJ_MH_CRC16_001, system-signal=OBJ_MH_CRC16_014}, {implementation-record-element=OBJ_MH_CYCLE_COUNTER_001, system-signal=OBJ_MH_CYCLE_COUNTER_014}, {implementation-record-element=OBJ_MOVEMENT_STATUS_001, system-signal=OBJ_MOVEMENT_STATUS_014}, {implementation-record-element=OBJ_POS_ERR_CRR_COEF_001, system-signal=OBJ_POS_ERR_CRR_COEF_014}, {implementation-record-element=OBJ_RCS_001, system-signal=OBJ_RCS_014}, {implementation-record-element=OBJ_REF_PT_LAT_OFFSET_001, system-signal=OBJ_REF_PT_LAT_OFFSET_014}, {implementation-record-element=OBJ_REF_PT_LONG_OFFSET_001, system-signal=OBJ_REF_PT_LONG_OFFSET_014}, {implementation-record-element=OBJ_TIMESTAMP_OFFSET_001, system-signal=OBJ_TIMESTAMP_OFFSET_014}, {implementation-record-element=OBJ_TRACK_MOTION_MODEL_001, system-signal=OBJ_TRACK_MOTION_MODEL_014}, {implementation-record-element=OBJ_VEH_TRACK_FLAG_001, system-signal=OBJ_VEH_TRACK_FLAG_014}, {implementation-record-element=OBJ_VELOCITY_ERR_CRR_COEF_001, system-signal=OBJ_VELOCITY_ERR_CRR_COEF_014}, {implementation-record-element=OBJ_YAW_RATE_001, system-signal=OBJ_YAW_RATE_014}, {implementation-record-element=OBJ_ACCELERATION_LAT_ERR_001, system-signal=OBJ_ACCELERATION_LAT_ERR_014}, {implementation-record-element=OBJ_VELOCITY_LONG_ERR_001, system-signal=OBJ_VELOCITY_LONG_ERR_014}, {implementation-record-element=OBJ_POS_LAT_ERR_001, system-signal=OBJ_POS_LAT_ERR_014}, {implementation-record-element=OBJ_DIMENSION_LENGTH_ERR_001, system-signal=OBJ_DIMENSION_LENGTH_ERR_014}, {implementation-record-element=OBJ_YAW_ANGLE_001, system-signal=OBJ_YAW_ANGLE_014}, {implementation-record-element=OBJ_POS_LONG_001, system-signal=OBJ_POS_LONG_014}, {implementation-record-element=OBJ_VELOCITY_LAT_001, system-signal=OBJ_VELOCITY_LAT_014}, {implementation-record-element=OBJ_CLS_TYPE3_001, system-signal=OBJ_CLS_TYPE3_014}, {implementation-record-element=OBJ_POS_LONG_ERR_001, system-signal=OBJ_POS_LONG_ERR_014}, {implementation-record-element=OBJ_ACCELERATION_LONG_ERR_001, system-signal=OBJ_ACCELERATION_LONG_ERR_014}, {implementation-record-element=OBJ_ACCELERATION_LAT_001, system-signal=OBJ_ACCELERATION_LAT_014}, {implementation-record-element=OBJ_ACCELERATION_LONG_001, system-signal=OBJ_ACCELERATION_LONG_014}, {implementation-record-element=OBJ_CLS_TYPE1_001, system-signal=OBJ_CLS_TYPE1_014}, {implementation-record-element=OBJ_CLS_TYPE4_PROB_001, system-signal=OBJ_CLS_TYPE4_PROB_014}, {implementation-record-element=OBJ_CLS_TYPE5_PROB_001, system-signal=OBJ_CLS_TYPE5_PROB_014}, {implementation-record-element=OBJ_VELOCITY_LONG_001, system-signal=OBJ_VELOCITY_LONG_014}, {implementation-record-element=OBJ_CLS_TYPE2_PROB_001, system-signal=OBJ_CLS_TYPE2_PROB_014}, {implementation-record-element=OBJ_CLS_TYPE6_001, system-signal=OBJ_CLS_TYPE6_014}, {implementation-record-element=OBJ_CLS_TYPE6_PROB_001, system-signal=OBJ_CLS_TYPE6_PROB_014}, {implementation-record-element=OBJ_CLS_TYPE5_001, system-signal=OBJ_CLS_TYPE5_014}, {implementation-record-element=OBJ_CLS_TYPE3_PROB_001, system-signal=OBJ_CLS_TYPE3_PROB_014}, {implementation-record-element=OBJ_VELOCITY_LAT_ERR_001, system-signal=OBJ_VELOCITY_LAT_ERR_014}, {implementation-record-element=OBJ_YAW_ANGLE_ERR_001, system-signal=OBJ_YAW_ANGLE_ERR_014}, {implementation-record-element=OBJ_DIMENSION_LENGTH_001, system-signal=OBJ_DIMENSION_LENGTH_014}, {implementation-record-element=OBJ_CLS_TYPE2_001, system-signal=OBJ_CLS_TYPE2_014}, {implementation-record-element=OBJ_CLS_TYPE4_001, system-signal=OBJ_CLS_TYPE4_014}, {implementation-record-element=OBJ_DIMENSION_WIDTH_001, system-signal=OBJ_DIMENSION_WIDTH_014}, {implementation-record-element=OBJ_POS_LAT_001, system-signal=OBJ_POS_LAT_014}, {implementation-record-element=OBJ_CLS_TYPE1_PROB_001, system-signal=OBJ_CLS_TYPE1_PROB_014}, {implementation-record-element=OBJ_YAW_RATE_ERR_001, system-signal=OBJ_YAW_RATE_ERR_014}, {implementation-record-element=OBJ_DIMENSION_WIDTH_ERR_001, system-signal=OBJ_DIMENSION_WIDTH_ERR_014}]}
        sender-receiver-to-signal-group-mapping={data-element=COMPOSITIONTYPE.Pp_SG_TrackerObject015.Vdp_SG_TrackerObject015, signal-group=SG_TrackerObject015, type-mapping=sender-rec-record-type-mapping=record-element-mappings=[{implementation-record-element=OBJ_ACCEL_ERR_CRR_COEF_001, system-signal=OBJ_ACCEL_ERR_CRR_COEF_015}, {implementation-record-element=OBJ_ALIVE_TIME_001, system-signal=OBJ_ALIVE_TIME_015}, {implementation-record-element=OBJ_EXISTENCE_PROB_001, system-signal=OBJ_EXISTENCE_PROB_015}, {implementation-record-element=OBJ_GROUP_ID_001, system-signal=OBJ_GROUP_ID_015}, {implementation-record-element=OBJ_ID_001, system-signal=OBJ_ID_015}, {implementation-record-element=OBJ_MEASUREMENT_STATUS_001, system-signal=OBJ_MEASUREMENT_STATUS_015}, {implementation-record-element=OBJ_MH_CRC16_001, system-signal=OBJ_MH_CRC16_015}, {implementation-record-element=OBJ_MH_CYCLE_COUNTER_001, system-signal=OBJ_MH_CYCLE_COUNTER_015}, {implementation-record-element=OBJ_MOVEMENT_STATUS_001, system-signal=OBJ_MOVEMENT_STATUS_015}, {implementation-record-element=OBJ_POS_ERR_CRR_COEF_001, system-signal=OBJ_POS_ERR_CRR_COEF_015}, {implementation-record-element=OBJ_RCS_001, system-signal=OBJ_RCS_015}, {implementation-record-element=OBJ_REF_PT_LAT_OFFSET_001, system-signal=OBJ_REF_PT_LAT_OFFSET_015}, {implementation-record-element=OBJ_REF_PT_LONG_OFFSET_001, system-signal=OBJ_REF_PT_LONG_OFFSET_015}, {implementation-record-element=OBJ_TIMESTAMP_OFFSET_001, system-signal=OBJ_TIMESTAMP_OFFSET_015}, {implementation-record-element=OBJ_TRACK_MOTION_MODEL_001, system-signal=OBJ_TRACK_MOTION_MODEL_015}, {implementation-record-element=OBJ_VEH_TRACK_FLAG_001, system-signal=OBJ_VEH_TRACK_FLAG_015}, {implementation-record-element=OBJ_VELOCITY_ERR_CRR_COEF_001, system-signal=OBJ_VELOCITY_ERR_CRR_COEF_015}, {implementation-record-element=OBJ_ACCELERATION_LONG_001, system-signal=OBJ_ACCELERATION_LONG_015}, {implementation-record-element=OBJ_CLS_TYPE1_001, system-signal=OBJ_CLS_TYPE1_015}, {implementation-record-element=OBJ_CLS_TYPE2_001, system-signal=OBJ_CLS_TYPE2_015}, {implementation-record-element=OBJ_CLS_TYPE2_PROB_001, system-signal=OBJ_CLS_TYPE2_PROB_015}, {implementation-record-element=OBJ_ACCELERATION_LONG_ERR_001, system-signal=OBJ_ACCELERATION_LONG_ERR_015}, {implementation-record-element=OBJ_CLS_TYPE1_PROB_001, system-signal=OBJ_CLS_TYPE1_PROB_015}, {implementation-record-element=OBJ_ACCELERATION_LAT_001, system-signal=OBJ_ACCELERATION_LAT_015}, {implementation-record-element=OBJ_ACCELERATION_LAT_ERR_001, system-signal=OBJ_ACCELERATION_LAT_ERR_015}, {implementation-record-element=OBJ_DIMENSION_LENGTH_001, system-signal=OBJ_DIMENSION_LENGTH_015}, {implementation-record-element=OBJ_VELOCITY_LAT_ERR_001, system-signal=OBJ_VELOCITY_LAT_ERR_015}, {implementation-record-element=OBJ_VELOCITY_LONG_001, system-signal=OBJ_VELOCITY_LONG_015}, {implementation-record-element=OBJ_CLS_TYPE5_PROB_001, system-signal=OBJ_CLS_TYPE5_PROB_015}, {implementation-record-element=OBJ_CLS_TYPE4_001, system-signal=OBJ_CLS_TYPE4_015}, {implementation-record-element=OBJ_CLS_TYPE4_PROB_001, system-signal=OBJ_CLS_TYPE4_PROB_015}, {implementation-record-element=OBJ_CLS_TYPE3_PROB_001, system-signal=OBJ_CLS_TYPE3_PROB_015}, {implementation-record-element=OBJ_VELOCITY_LONG_ERR_001, system-signal=OBJ_VELOCITY_LONG_ERR_015}, {implementation-record-element=OBJ_POS_LONG_ERR_001, system-signal=OBJ_POS_LONG_ERR_015}, {implementation-record-element=OBJ_DIMENSION_WIDTH_001, system-signal=OBJ_DIMENSION_WIDTH_015}, {implementation-record-element=OBJ_DIMENSION_LENGTH_ERR_001, system-signal=OBJ_DIMENSION_LENGTH_ERR_015}, {implementation-record-element=OBJ_DIMENSION_WIDTH_ERR_001, system-signal=OBJ_DIMENSION_WIDTH_ERR_015}, {implementation-record-element=OBJ_VELOCITY_LAT_001, system-signal=OBJ_VELOCITY_LAT_015}, {implementation-record-element=OBJ_POS_LAT_ERR_001, system-signal=OBJ_POS_LAT_ERR_015}, {implementation-record-element=OBJ_YAW_ANGLE_001, system-signal=OBJ_YAW_ANGLE_015}, {implementation-record-element=OBJ_POS_LONG_001, system-signal=OBJ_POS_LONG_015}, {implementation-record-element=OBJ_CLS_TYPE6_001, system-signal=OBJ_CLS_TYPE6_015}, {implementation-record-element=OBJ_CLS_TYPE6_PROB_001, system-signal=OBJ_CLS_TYPE6_PROB_015}, {implementation-record-element=OBJ_YAW_ANGLE_ERR_001, system-signal=OBJ_YAW_ANGLE_ERR_015}, {implementation-record-element=OBJ_YAW_RATE_001, system-signal=OBJ_YAW_RATE_015}, {implementation-record-element=OBJ_CLS_TYPE3_001, system-signal=OBJ_CLS_TYPE3_015}, {implementation-record-element=OBJ_POS_LAT_001, system-signal=OBJ_POS_LAT_015}, {implementation-record-element=OBJ_CLS_TYPE5_001, system-signal=OBJ_CLS_TYPE5_015}, {implementation-record-element=OBJ_YAW_RATE_ERR_001, system-signal=OBJ_YAW_RATE_ERR_015}]}
        sender-receiver-to-signal-group-mapping={data-element=COMPOSITIONTYPE.Pp_SG_TrackerObject016.Vdp_SG_TrackerObject016, signal-group=SG_TrackerObject016, type-mapping=sender-rec-record-type-mapping=record-element-mappings=[{implementation-record-element=OBJ_ACCEL_ERR_CRR_COEF_001, system-signal=OBJ_ACCEL_ERR_CRR_COEF_016}, {implementation-record-element=OBJ_ALIVE_TIME_001, system-signal=OBJ_ALIVE_TIME_016}, {implementation-record-element=OBJ_EXISTENCE_PROB_001, system-signal=OBJ_EXISTENCE_PROB_016}, {implementation-record-element=OBJ_GROUP_ID_001, system-signal=OBJ_GROUP_ID_016}, {implementation-record-element=OBJ_ID_001, system-signal=OBJ_ID_016}, {implementation-record-element=OBJ_MEASUREMENT_STATUS_001, system-signal=OBJ_MEASUREMENT_STATUS_016}, {implementation-record-element=OBJ_MH_CRC16_001, system-signal=OBJ_MH_CRC16_016}, {implementation-record-element=OBJ_MH_CYCLE_COUNTER_001, system-signal=OBJ_MH_CYCLE_COUNTER_016}, {implementation-record-element=OBJ_MOVEMENT_STATUS_001, system-signal=OBJ_MOVEMENT_STATUS_016}, {implementation-record-element=OBJ_POS_ERR_CRR_COEF_001, system-signal=OBJ_POS_ERR_CRR_COEF_016}, {implementation-record-element=OBJ_RCS_001, system-signal=OBJ_RCS_016}, {implementation-record-element=OBJ_REF_PT_LAT_OFFSET_001, system-signal=OBJ_REF_PT_LAT_OFFSET_016}, {implementation-record-element=OBJ_REF_PT_LONG_OFFSET_001, system-signal=OBJ_REF_PT_LONG_OFFSET_016}, {implementation-record-element=OBJ_TIMESTAMP_OFFSET_001, system-signal=OBJ_TIMESTAMP_OFFSET_016}, {implementation-record-element=OBJ_TRACK_MOTION_MODEL_001, system-signal=OBJ_TRACK_MOTION_MODEL_016}, {implementation-record-element=OBJ_VEH_TRACK_FLAG_001, system-signal=OBJ_VEH_TRACK_FLAG_016}, {implementation-record-element=OBJ_VELOCITY_ERR_CRR_COEF_001, system-signal=OBJ_VELOCITY_ERR_CRR_COEF_016}, {implementation-record-element=OBJ_ACCELERATION_LAT_ERR_001, system-signal=OBJ_ACCELERATION_LAT_ERR_016}, {implementation-record-element=OBJ_CLS_TYPE3_PROB_001, system-signal=OBJ_CLS_TYPE3_PROB_016}, {implementation-record-element=OBJ_CLS_TYPE6_PROB_001, system-signal=OBJ_CLS_TYPE6_PROB_016}, {implementation-record-element=OBJ_CLS_TYPE1_001, system-signal=OBJ_CLS_TYPE1_016}, {implementation-record-element=OBJ_ACCELERATION_LAT_001, system-signal=OBJ_ACCELERATION_LAT_016}, {implementation-record-element=OBJ_CLS_TYPE5_001, system-signal=OBJ_CLS_TYPE5_016}, {implementation-record-element=OBJ_ACCELERATION_LONG_001, system-signal=OBJ_ACCELERATION_LONG_016}, {implementation-record-element=OBJ_CLS_TYPE2_PROB_001, system-signal=OBJ_CLS_TYPE2_PROB_016}, {implementation-record-element=OBJ_CLS_TYPE1_PROB_001, system-signal=OBJ_CLS_TYPE1_PROB_016}, {implementation-record-element=OBJ_CLS_TYPE4_PROB_001, system-signal=OBJ_CLS_TYPE4_PROB_016}, {implementation-record-element=OBJ_CLS_TYPE5_PROB_001, system-signal=OBJ_CLS_TYPE5_PROB_016}, {implementation-record-element=OBJ_CLS_TYPE2_001, system-signal=OBJ_CLS_TYPE2_016}, {implementation-record-element=OBJ_CLS_TYPE3_001, system-signal=OBJ_CLS_TYPE3_016}, {implementation-record-element=OBJ_DIMENSION_LENGTH_001, system-signal=OBJ_DIMENSION_LENGTH_016}, {implementation-record-element=OBJ_ACCELERATION_LONG_ERR_001, system-signal=OBJ_ACCELERATION_LONG_ERR_016}, {implementation-record-element=OBJ_DIMENSION_WIDTH_001, system-signal=OBJ_DIMENSION_WIDTH_016}, {implementation-record-element=OBJ_CLS_TYPE4_001, system-signal=OBJ_CLS_TYPE4_016}, {implementation-record-element=OBJ_CLS_TYPE6_001, system-signal=OBJ_CLS_TYPE6_016}, {implementation-record-element=OBJ_DIMENSION_LENGTH_ERR_001, system-signal=OBJ_DIMENSION_LENGTH_ERR_016}, {implementation-record-element=OBJ_DIMENSION_WIDTH_ERR_001, system-signal=OBJ_DIMENSION_WIDTH_ERR_016}, {implementation-record-element=OBJ_YAW_RATE_001, system-signal=OBJ_YAW_RATE_016}, {implementation-record-element=OBJ_YAW_RATE_ERR_001, system-signal=OBJ_YAW_RATE_ERR_016}, {implementation-record-element=OBJ_VELOCITY_LAT_001, system-signal=OBJ_VELOCITY_LAT_016}, {implementation-record-element=OBJ_POS_LAT_001, system-signal=OBJ_POS_LAT_016}, {implementation-record-element=OBJ_YAW_ANGLE_ERR_001, system-signal=OBJ_YAW_ANGLE_ERR_016}, {implementation-record-element=OBJ_POS_LONG_001, system-signal=OBJ_POS_LONG_016}, {implementation-record-element=OBJ_POS_LAT_ERR_001, system-signal=OBJ_POS_LAT_ERR_016}, {implementation-record-element=OBJ_POS_LONG_ERR_001, system-signal=OBJ_POS_LONG_ERR_016}, {implementation-record-element=OBJ_VELOCITY_LAT_ERR_001, system-signal=OBJ_VELOCITY_LAT_ERR_016}, {implementation-record-element=OBJ_VELOCITY_LONG_001, system-signal=OBJ_VELOCITY_LONG_016}, {implementation-record-element=OBJ_VELOCITY_LONG_ERR_001, system-signal=OBJ_VELOCITY_LONG_ERR_016}, {implementation-record-element=OBJ_YAW_ANGLE_001, system-signal=OBJ_YAW_ANGLE_016}]}
        sender-receiver-to-signal-group-mapping={data-element=COMPOSITIONTYPE.Pp_SG_TrackerObject017.Vdp_SG_TrackerObject017, signal-group=SG_TrackerObject017, type-mapping=sender-rec-record-type-mapping=record-element-mappings=[{implementation-record-element=OBJ_ACCEL_ERR_CRR_COEF_001, system-signal=OBJ_ACCEL_ERR_CRR_COEF_017}, {implementation-record-element=OBJ_ALIVE_TIME_001, system-signal=OBJ_ALIVE_TIME_017}, {implementation-record-element=OBJ_EXISTENCE_PROB_001, system-signal=OBJ_EXISTENCE_PROB_017}, {implementation-record-element=OBJ_GROUP_ID_001, system-signal=OBJ_GROUP_ID_017}, {implementation-record-element=OBJ_ID_001, system-signal=OBJ_ID_017}, {implementation-record-element=OBJ_MEASUREMENT_STATUS_001, system-signal=OBJ_MEASUREMENT_STATUS_017}, {implementation-record-element=OBJ_MH_CRC16_001, system-signal=OBJ_MH_CRC16_017}, {implementation-record-element=OBJ_MH_CYCLE_COUNTER_001, system-signal=OBJ_MH_CYCLE_COUNTER_017}, {implementation-record-element=OBJ_MOVEMENT_STATUS_001, system-signal=OBJ_MOVEMENT_STATUS_017}, {implementation-record-element=OBJ_POS_ERR_CRR_COEF_001, system-signal=OBJ_POS_ERR_CRR_COEF_017}, {implementation-record-element=OBJ_RCS_001, system-signal=OBJ_RCS_017}, {implementation-record-element=OBJ_REF_PT_LAT_OFFSET_001, system-signal=OBJ_REF_PT_LAT_OFFSET_017}, {implementation-record-element=OBJ_REF_PT_LONG_OFFSET_001, system-signal=OBJ_REF_PT_LONG_OFFSET_017}, {implementation-record-element=OBJ_TIMESTAMP_OFFSET_001, system-signal=OBJ_TIMESTAMP_OFFSET_017}, {implementation-record-element=OBJ_TRACK_MOTION_MODEL_001, system-signal=OBJ_TRACK_MOTION_MODEL_017}, {implementation-record-element=OBJ_VEH_TRACK_FLAG_001, system-signal=OBJ_VEH_TRACK_FLAG_017}, {implementation-record-element=OBJ_VELOCITY_ERR_CRR_COEF_001, system-signal=OBJ_VELOCITY_ERR_CRR_COEF_017}, {implementation-record-element=OBJ_CLS_TYPE6_001, system-signal=OBJ_CLS_TYPE6_017}, {implementation-record-element=OBJ_POS_LAT_001, system-signal=OBJ_POS_LAT_017}, {implementation-record-element=OBJ_POS_LAT_ERR_001, system-signal=OBJ_POS_LAT_ERR_017}, {implementation-record-element=OBJ_POS_LONG_001, system-signal=OBJ_POS_LONG_017}, {implementation-record-element=OBJ_POS_LONG_ERR_001, system-signal=OBJ_POS_LONG_ERR_017}, {implementation-record-element=OBJ_ACCELERATION_LONG_ERR_001, system-signal=OBJ_ACCELERATION_LONG_ERR_017}, {implementation-record-element=OBJ_CLS_TYPE2_PROB_001, system-signal=OBJ_CLS_TYPE2_PROB_017}, {implementation-record-element=OBJ_DIMENSION_WIDTH_ERR_001, system-signal=OBJ_DIMENSION_WIDTH_ERR_017}, {implementation-record-element=OBJ_ACCELERATION_LONG_001, system-signal=OBJ_ACCELERATION_LONG_017}, {implementation-record-element=OBJ_DIMENSION_WIDTH_001, system-signal=OBJ_DIMENSION_WIDTH_017}, {implementation-record-element=OBJ_ACCELERATION_LAT_001, system-signal=OBJ_ACCELERATION_LAT_017}, {implementation-record-element=OBJ_ACCELERATION_LAT_ERR_001, system-signal=OBJ_ACCELERATION_LAT_ERR_017}, {implementation-record-element=OBJ_CLS_TYPE4_001, system-signal=OBJ_CLS_TYPE4_017}, {implementation-record-element=OBJ_CLS_TYPE5_001, system-signal=OBJ_CLS_TYPE5_017}, {implementation-record-element=OBJ_CLS_TYPE2_001, system-signal=OBJ_CLS_TYPE2_017}, {implementation-record-element=OBJ_CLS_TYPE5_PROB_001, system-signal=OBJ_CLS_TYPE5_PROB_017}, {implementation-record-element=OBJ_CLS_TYPE6_PROB_001, system-signal=OBJ_CLS_TYPE6_PROB_017}, {implementation-record-element=OBJ_CLS_TYPE4_PROB_001, system-signal=OBJ_CLS_TYPE4_PROB_017}, {implementation-record-element=OBJ_CLS_TYPE3_001, system-signal=OBJ_CLS_TYPE3_017}, {implementation-record-element=OBJ_DIMENSION_LENGTH_001, system-signal=OBJ_DIMENSION_LENGTH_017}, {implementation-record-element=OBJ_DIMENSION_LENGTH_ERR_001, system-signal=OBJ_DIMENSION_LENGTH_ERR_017}, {implementation-record-element=OBJ_CLS_TYPE1_PROB_001, system-signal=OBJ_CLS_TYPE1_PROB_017}, {implementation-record-element=OBJ_CLS_TYPE3_PROB_001, system-signal=OBJ_CLS_TYPE3_PROB_017}, {implementation-record-element=OBJ_CLS_TYPE1_001, system-signal=OBJ_CLS_TYPE1_017}, {implementation-record-element=OBJ_YAW_RATE_001, system-signal=OBJ_YAW_RATE_017}, {implementation-record-element=OBJ_VELOCITY_LONG_ERR_001, system-signal=OBJ_VELOCITY_LONG_ERR_017}, {implementation-record-element=OBJ_VELOCITY_LAT_001, system-signal=OBJ_VELOCITY_LAT_017}, {implementation-record-element=OBJ_VELOCITY_LAT_ERR_001, system-signal=OBJ_VELOCITY_LAT_ERR_017}, {implementation-record-element=OBJ_YAW_RATE_ERR_001, system-signal=OBJ_YAW_RATE_ERR_017}, {implementation-record-element=OBJ_YAW_ANGLE_001, system-signal=OBJ_YAW_ANGLE_017}, {implementation-record-element=OBJ_YAW_ANGLE_ERR_001, system-signal=OBJ_YAW_ANGLE_ERR_017}, {implementation-record-element=OBJ_VELOCITY_LONG_001, system-signal=OBJ_VELOCITY_LONG_017}]}
        sender-receiver-to-signal-group-mapping={data-element=COMPOSITIONTYPE.Pp_SG_TrackerObject018.Vdp_SG_TrackerObject018, signal-group=SG_TrackerObject018, type-mapping=sender-rec-record-type-mapping=record-element-mappings=[{implementation-record-element=OBJ_ACCEL_ERR_CRR_COEF_001, system-signal=OBJ_ACCEL_ERR_CRR_COEF_018}, {implementation-record-element=OBJ_ALIVE_TIME_001, system-signal=OBJ_ALIVE_TIME_018}, {implementation-record-element=OBJ_EXISTENCE_PROB_001, system-signal=OBJ_EXISTENCE_PROB_018}, {implementation-record-element=OBJ_GROUP_ID_001, system-signal=OBJ_GROUP_ID_018}, {implementation-record-element=OBJ_ID_001, system-signal=OBJ_ID_018}, {implementation-record-element=OBJ_MEASUREMENT_STATUS_001, system-signal=OBJ_MEASUREMENT_STATUS_018}, {implementation-record-element=OBJ_MH_CRC16_001, system-signal=OBJ_MH_CRC16_018}, {implementation-record-element=OBJ_MH_CYCLE_COUNTER_001, system-signal=OBJ_MH_CYCLE_COUNTER_018}, {implementation-record-element=OBJ_MOVEMENT_STATUS_001, system-signal=OBJ_MOVEMENT_STATUS_018}, {implementation-record-element=OBJ_POS_ERR_CRR_COEF_001, system-signal=OBJ_POS_ERR_CRR_COEF_018}, {implementation-record-element=OBJ_RCS_001, system-signal=OBJ_RCS_018}, {implementation-record-element=OBJ_REF_PT_LAT_OFFSET_001, system-signal=OBJ_REF_PT_LAT_OFFSET_018}, {implementation-record-element=OBJ_REF_PT_LONG_OFFSET_001, system-signal=OBJ_REF_PT_LONG_OFFSET_018}, {implementation-record-element=OBJ_TIMESTAMP_OFFSET_001, system-signal=OBJ_TIMESTAMP_OFFSET_018}, {implementation-record-element=OBJ_TRACK_MOTION_MODEL_001, system-signal=OBJ_TRACK_MOTION_MODEL_018}, {implementation-record-element=OBJ_VEH_TRACK_FLAG_001, system-signal=OBJ_VEH_TRACK_FLAG_018}, {implementation-record-element=OBJ_VELOCITY_ERR_CRR_COEF_001, system-signal=OBJ_VELOCITY_ERR_CRR_COEF_018}, {implementation-record-element=OBJ_CLS_TYPE3_PROB_001, system-signal=OBJ_CLS_TYPE3_PROB_018}, {implementation-record-element=OBJ_CLS_TYPE4_001, system-signal=OBJ_CLS_TYPE4_018}, {implementation-record-element=OBJ_CLS_TYPE4_PROB_001, system-signal=OBJ_CLS_TYPE4_PROB_018}, {implementation-record-element=OBJ_DIMENSION_WIDTH_001, system-signal=OBJ_DIMENSION_WIDTH_018}, {implementation-record-element=OBJ_DIMENSION_WIDTH_ERR_001, system-signal=OBJ_DIMENSION_WIDTH_ERR_018}, {implementation-record-element=OBJ_CLS_TYPE1_PROB_001, system-signal=OBJ_CLS_TYPE1_PROB_018}, {implementation-record-element=OBJ_DIMENSION_LENGTH_ERR_001, system-signal=OBJ_DIMENSION_LENGTH_ERR_018}, {implementation-record-element=OBJ_ACCELERATION_LAT_001, system-signal=OBJ_ACCELERATION_LAT_018}, {implementation-record-element=OBJ_ACCELERATION_LONG_001, system-signal=OBJ_ACCELERATION_LONG_018}, {implementation-record-element=OBJ_CLS_TYPE2_001, system-signal=OBJ_CLS_TYPE2_018}, {implementation-record-element=OBJ_CLS_TYPE6_001, system-signal=OBJ_CLS_TYPE6_018}, {implementation-record-element=OBJ_DIMENSION_LENGTH_001, system-signal=OBJ_DIMENSION_LENGTH_018}, {implementation-record-element=OBJ_POS_LAT_001, system-signal=OBJ_POS_LAT_018}, {implementation-record-element=OBJ_CLS_TYPE2_PROB_001, system-signal=OBJ_CLS_TYPE2_PROB_018}, {implementation-record-element=OBJ_POS_LONG_ERR_001, system-signal=OBJ_POS_LONG_ERR_018}, {implementation-record-element=OBJ_POS_LONG_001, system-signal=OBJ_POS_LONG_018}, {implementation-record-element=OBJ_VELOCITY_LONG_001, system-signal=OBJ_VELOCITY_LONG_018}, {implementation-record-element=OBJ_VELOCITY_LONG_ERR_001, system-signal=OBJ_VELOCITY_LONG_ERR_018}, {implementation-record-element=OBJ_ACCELERATION_LAT_ERR_001, system-signal=OBJ_ACCELERATION_LAT_ERR_018}, {implementation-record-element=OBJ_CLS_TYPE5_001, system-signal=OBJ_CLS_TYPE5_018}, {implementation-record-element=OBJ_YAW_ANGLE_001, system-signal=OBJ_YAW_ANGLE_018}, {implementation-record-element=OBJ_YAW_ANGLE_ERR_001, system-signal=OBJ_YAW_ANGLE_ERR_018}, {implementation-record-element=OBJ_YAW_RATE_001, system-signal=OBJ_YAW_RATE_018}, {implementation-record-element=OBJ_CLS_TYPE3_001, system-signal=OBJ_CLS_TYPE3_018}, {implementation-record-element=OBJ_YAW_RATE_ERR_001, system-signal=OBJ_YAW_RATE_ERR_018}, {implementation-record-element=OBJ_CLS_TYPE6_PROB_001, system-signal=OBJ_CLS_TYPE6_PROB_018}, {implementation-record-element=OBJ_CLS_TYPE1_001, system-signal=OBJ_CLS_TYPE1_018}, {implementation-record-element=OBJ_ACCELERATION_LONG_ERR_001, system-signal=OBJ_ACCELERATION_LONG_ERR_018}, {implementation-record-element=OBJ_CLS_TYPE5_PROB_001, system-signal=OBJ_CLS_TYPE5_PROB_018}, {implementation-record-element=OBJ_VELOCITY_LAT_001, system-signal=OBJ_VELOCITY_LAT_018}, {implementation-record-element=OBJ_VELOCITY_LAT_ERR_001, system-signal=OBJ_VELOCITY_LAT_ERR_018}, {implementation-record-element=OBJ_POS_LAT_ERR_001, system-signal=OBJ_POS_LAT_ERR_018}]}
        sender-receiver-to-signal-group-mapping={data-element=COMPOSITIONTYPE.Pp_SG_TrackerObject019.Vdp_SG_TrackerObject019, signal-group=SG_TrackerObject019, type-mapping=sender-rec-record-type-mapping=record-element-mappings=[{implementation-record-element=OBJ_ACCEL_ERR_CRR_COEF_001, system-signal=OBJ_ACCEL_ERR_CRR_COEF_019}, {implementation-record-element=OBJ_ALIVE_TIME_001, system-signal=OBJ_ALIVE_TIME_019}, {implementation-record-element=OBJ_EXISTENCE_PROB_001, system-signal=OBJ_EXISTENCE_PROB_019}, {implementation-record-element=OBJ_GROUP_ID_001, system-signal=OBJ_GROUP_ID_019}, {implementation-record-element=OBJ_ID_001, system-signal=OBJ_ID_019}, {implementation-record-element=OBJ_MEASUREMENT_STATUS_001, system-signal=OBJ_MEASUREMENT_STATUS_019}, {implementation-record-element=OBJ_MH_CRC16_001, system-signal=OBJ_MH_CRC16_019}, {implementation-record-element=OBJ_MH_CYCLE_COUNTER_001, system-signal=OBJ_MH_CYCLE_COUNTER_019}, {implementation-record-element=OBJ_MOVEMENT_STATUS_001, system-signal=OBJ_MOVEMENT_STATUS_019}, {implementation-record-element=OBJ_POS_ERR_CRR_COEF_001, system-signal=OBJ_POS_ERR_CRR_COEF_019}, {implementation-record-element=OBJ_RCS_001, system-signal=OBJ_RCS_019}, {implementation-record-element=OBJ_REF_PT_LAT_OFFSET_001, system-signal=OBJ_REF_PT_LAT_OFFSET_019}, {implementation-record-element=OBJ_REF_PT_LONG_OFFSET_001, system-signal=OBJ_REF_PT_LONG_OFFSET_019}, {implementation-record-element=OBJ_TIMESTAMP_OFFSET_001, system-signal=OBJ_TIMESTAMP_OFFSET_019}, {implementation-record-element=OBJ_TRACK_MOTION_MODEL_001, system-signal=OBJ_TRACK_MOTION_MODEL_019}, {implementation-record-element=OBJ_VEH_TRACK_FLAG_001, system-signal=OBJ_VEH_TRACK_FLAG_019}, {implementation-record-element=OBJ_VELOCITY_ERR_CRR_COEF_001, system-signal=OBJ_VELOCITY_ERR_CRR_COEF_019}, {implementation-record-element=OBJ_ACCELERATION_LAT_001, system-signal=OBJ_ACCELERATION_LAT_019}, {implementation-record-element=OBJ_CLS_TYPE6_PROB_001, system-signal=OBJ_CLS_TYPE6_PROB_019}, {implementation-record-element=OBJ_YAW_ANGLE_001, system-signal=OBJ_YAW_ANGLE_019}, {implementation-record-element=OBJ_CLS_TYPE2_PROB_001, system-signal=OBJ_CLS_TYPE2_PROB_019}, {implementation-record-element=OBJ_CLS_TYPE1_001, system-signal=OBJ_CLS_TYPE1_019}, {implementation-record-element=OBJ_CLS_TYPE3_001, system-signal=OBJ_CLS_TYPE3_019}, {implementation-record-element=OBJ_DIMENSION_WIDTH_ERR_001, system-signal=OBJ_DIMENSION_WIDTH_ERR_019}, {implementation-record-element=OBJ_YAW_RATE_001, system-signal=OBJ_YAW_RATE_019}, {implementation-record-element=OBJ_VELOCITY_LONG_001, system-signal=OBJ_VELOCITY_LONG_019}, {implementation-record-element=OBJ_CLS_TYPE5_001, system-signal=OBJ_CLS_TYPE5_019}, {implementation-record-element=OBJ_CLS_TYPE5_PROB_001, system-signal=OBJ_CLS_TYPE5_PROB_019}, {implementation-record-element=OBJ_CLS_TYPE3_PROB_001, system-signal=OBJ_CLS_TYPE3_PROB_019}, {implementation-record-element=OBJ_ACCELERATION_LONG_ERR_001, system-signal=OBJ_ACCELERATION_LONG_ERR_019}, {implementation-record-element=OBJ_CLS_TYPE2_001, system-signal=OBJ_CLS_TYPE2_019}, {implementation-record-element=OBJ_YAW_ANGLE_ERR_001, system-signal=OBJ_YAW_ANGLE_ERR_019}, {implementation-record-element=OBJ_ACCELERATION_LONG_001, system-signal=OBJ_ACCELERATION_LONG_019}, {implementation-record-element=OBJ_CLS_TYPE4_001, system-signal=OBJ_CLS_TYPE4_019}, {implementation-record-element=OBJ_ACCELERATION_LAT_ERR_001, system-signal=OBJ_ACCELERATION_LAT_ERR_019}, {implementation-record-element=OBJ_POS_LAT_001, system-signal=OBJ_POS_LAT_019}, {implementation-record-element=OBJ_POS_LONG_ERR_001, system-signal=OBJ_POS_LONG_ERR_019}, {implementation-record-element=OBJ_VELOCITY_LAT_001, system-signal=OBJ_VELOCITY_LAT_019}, {implementation-record-element=OBJ_VELOCITY_LAT_ERR_001, system-signal=OBJ_VELOCITY_LAT_ERR_019}, {implementation-record-element=OBJ_CLS_TYPE4_PROB_001, system-signal=OBJ_CLS_TYPE4_PROB_019}, {implementation-record-element=OBJ_DIMENSION_LENGTH_001, system-signal=OBJ_DIMENSION_LENGTH_019}, {implementation-record-element=OBJ_DIMENSION_WIDTH_001, system-signal=OBJ_DIMENSION_WIDTH_019}, {implementation-record-element=OBJ_POS_LONG_001, system-signal=OBJ_POS_LONG_019}, {implementation-record-element=OBJ_VELOCITY_LONG_ERR_001, system-signal=OBJ_VELOCITY_LONG_ERR_019}, {implementation-record-element=OBJ_CLS_TYPE6_001, system-signal=OBJ_CLS_TYPE6_019}, {implementation-record-element=OBJ_CLS_TYPE1_PROB_001, system-signal=OBJ_CLS_TYPE1_PROB_019}, {implementation-record-element=OBJ_POS_LAT_ERR_001, system-signal=OBJ_POS_LAT_ERR_019}, {implementation-record-element=OBJ_YAW_RATE_ERR_001, system-signal=OBJ_YAW_RATE_ERR_019}, {implementation-record-element=OBJ_DIMENSION_LENGTH_ERR_001, system-signal=OBJ_DIMENSION_LENGTH_ERR_019}]}
        sender-receiver-to-signal-group-mapping={data-element=COMPOSITIONTYPE.Pp_SG_TrackerObject020.Vdp_SG_TrackerObject020, signal-group=SG_TrackerObject020, type-mapping=sender-rec-record-type-mapping=record-element-mappings=[{implementation-record-element=OBJ_ACCEL_ERR_CRR_COEF_001, system-signal=OBJ_ACCEL_ERR_CRR_COEF_020}, {implementation-record-element=OBJ_ALIVE_TIME_001, system-signal=OBJ_ALIVE_TIME_020}, {implementation-record-element=OBJ_EXISTENCE_PROB_001, system-signal=OBJ_EXISTENCE_PROB_020}, {implementation-record-element=OBJ_GROUP_ID_001, system-signal=OBJ_GROUP_ID_020}, {implementation-record-element=OBJ_ID_001, system-signal=OBJ_ID_020}, {implementation-record-element=OBJ_MEASUREMENT_STATUS_001, system-signal=OBJ_MEASUREMENT_STATUS_020}, {implementation-record-element=OBJ_MH_CRC16_001, system-signal=OBJ_MH_CRC16_020}, {implementation-record-element=OBJ_MH_CYCLE_COUNTER_001, system-signal=OBJ_MH_CYCLE_COUNTER_020}, {implementation-record-element=OBJ_MOVEMENT_STATUS_001, system-signal=OBJ_MOVEMENT_STATUS_020}, {implementation-record-element=OBJ_POS_ERR_CRR_COEF_001, system-signal=OBJ_POS_ERR_CRR_COEF_020}, {implementation-record-element=OBJ_RCS_001, system-signal=OBJ_RCS_020}, {implementation-record-element=OBJ_REF_PT_LAT_OFFSET_001, system-signal=OBJ_REF_PT_LAT_OFFSET_020}, {implementation-record-element=OBJ_REF_PT_LONG_OFFSET_001, system-signal=OBJ_REF_PT_LONG_OFFSET_020}, {implementation-record-element=OBJ_TIMESTAMP_OFFSET_001, system-signal=OBJ_TIMESTAMP_OFFSET_020}, {implementation-record-element=OBJ_TRACK_MOTION_MODEL_001, system-signal=OBJ_TRACK_MOTION_MODEL_020}, {implementation-record-element=OBJ_VEH_TRACK_FLAG_001, system-signal=OBJ_VEH_TRACK_FLAG_020}, {implementation-record-element=OBJ_VELOCITY_ERR_CRR_COEF_001, system-signal=OBJ_VELOCITY_ERR_CRR_COEF_020}, {implementation-record-element=OBJ_CLS_TYPE1_PROB_001, system-signal=OBJ_CLS_TYPE1_PROB_020}, {implementation-record-element=OBJ_ACCELERATION_LONG_ERR_001, system-signal=OBJ_ACCELERATION_LONG_ERR_020}, {implementation-record-element=OBJ_CLS_TYPE3_001, system-signal=OBJ_CLS_TYPE3_020}, {implementation-record-element=OBJ_CLS_TYPE3_PROB_001, system-signal=OBJ_CLS_TYPE3_PROB_020}, {implementation-record-element=OBJ_CLS_TYPE4_001, system-signal=OBJ_CLS_TYPE4_020}, {implementation-record-element=OBJ_ACCELERATION_LAT_ERR_001, system-signal=OBJ_ACCELERATION_LAT_ERR_020}, {implementation-record-element=OBJ_CLS_TYPE2_PROB_001, system-signal=OBJ_CLS_TYPE2_PROB_020}, {implementation-record-element=OBJ_CLS_TYPE4_PROB_001, system-signal=OBJ_CLS_TYPE4_PROB_020}, {implementation-record-element=OBJ_ACCELERATION_LAT_001, system-signal=OBJ_ACCELERATION_LAT_020}, {implementation-record-element=OBJ_ACCELERATION_LONG_001, system-signal=OBJ_ACCELERATION_LONG_020}, {implementation-record-element=OBJ_CLS_TYPE2_001, system-signal=OBJ_CLS_TYPE2_020}, {implementation-record-element=OBJ_CLS_TYPE5_PROB_001, system-signal=OBJ_CLS_TYPE5_PROB_020}, {implementation-record-element=OBJ_CLS_TYPE1_001, system-signal=OBJ_CLS_TYPE1_020}, {implementation-record-element=OBJ_CLS_TYPE5_001, system-signal=OBJ_CLS_TYPE5_020}, {implementation-record-element=OBJ_YAW_ANGLE_ERR_001, system-signal=OBJ_YAW_ANGLE_ERR_020}, {implementation-record-element=OBJ_VELOCITY_LONG_001, system-signal=OBJ_VELOCITY_LONG_020}, {implementation-record-element=OBJ_DIMENSION_LENGTH_001, system-signal=OBJ_DIMENSION_LENGTH_020}, {implementation-record-element=OBJ_YAW_RATE_ERR_001, system-signal=OBJ_YAW_RATE_ERR_020}, {implementation-record-element=OBJ_YAW_RATE_001, system-signal=OBJ_YAW_RATE_020}, {implementation-record-element=OBJ_YAW_ANGLE_001, system-signal=OBJ_YAW_ANGLE_020}, {implementation-record-element=OBJ_POS_LONG_001, system-signal=OBJ_POS_LONG_020}, {implementation-record-element=OBJ_DIMENSION_WIDTH_001, system-signal=OBJ_DIMENSION_WIDTH_020}, {implementation-record-element=OBJ_DIMENSION_LENGTH_ERR_001, system-signal=OBJ_DIMENSION_LENGTH_ERR_020}, {implementation-record-element=OBJ_POS_LAT_001, system-signal=OBJ_POS_LAT_020}, {implementation-record-element=OBJ_DIMENSION_WIDTH_ERR_001, system-signal=OBJ_DIMENSION_WIDTH_ERR_020}, {implementation-record-element=OBJ_POS_LAT_ERR_001, system-signal=OBJ_POS_LAT_ERR_020}, {implementation-record-element=OBJ_POS_LONG_ERR_001, system-signal=OBJ_POS_LONG_ERR_020}, {implementation-record-element=OBJ_CLS_TYPE6_PROB_001, system-signal=OBJ_CLS_TYPE6_PROB_020}, {implementation-record-element=OBJ_CLS_TYPE6_001, system-signal=OBJ_CLS_TYPE6_020}, {implementation-record-element=OBJ_VELOCITY_LAT_001, system-signal=OBJ_VELOCITY_LAT_020}, {implementation-record-element=OBJ_VELOCITY_LONG_ERR_001, system-signal=OBJ_VELOCITY_LONG_ERR_020}, {implementation-record-element=OBJ_VELOCITY_LAT_ERR_001, system-signal=OBJ_VELOCITY_LAT_ERR_020}]}
        sender-receiver-to-signal-group-mapping={data-element=COMPOSITIONTYPE.Pp_SG_TrackerObject021.Vdp_SG_TrackerObject021, signal-group=SG_TrackerObject021, type-mapping=sender-rec-record-type-mapping=record-element-mappings=[{implementation-record-element=OBJ_ACCEL_ERR_CRR_COEF_001, system-signal=OBJ_ACCEL_ERR_CRR_COEF_021}, {implementation-record-element=OBJ_ALIVE_TIME_001, system-signal=OBJ_ALIVE_TIME_021}, {implementation-record-element=OBJ_EXISTENCE_PROB_001, system-signal=OBJ_EXISTENCE_PROB_021}, {implementation-record-element=OBJ_GROUP_ID_001, system-signal=OBJ_GROUP_ID_021}, {implementation-record-element=OBJ_ID_001, system-signal=OBJ_ID_021}, {implementation-record-element=OBJ_MEASUREMENT_STATUS_001, system-signal=OBJ_MEASUREMENT_STATUS_021}, {implementation-record-element=OBJ_MH_CRC16_001, system-signal=OBJ_MH_CRC16_021}, {implementation-record-element=OBJ_MH_CYCLE_COUNTER_001, system-signal=OBJ_MH_CYCLE_COUNTER_021}, {implementation-record-element=OBJ_MOVEMENT_STATUS_001, system-signal=OBJ_MOVEMENT_STATUS_021}, {implementation-record-element=OBJ_POS_ERR_CRR_COEF_001, system-signal=OBJ_POS_ERR_CRR_COEF_021}, {implementation-record-element=OBJ_RCS_001, system-signal=OBJ_RCS_021}, {implementation-record-element=OBJ_REF_PT_LAT_OFFSET_001, system-signal=OBJ_REF_PT_LAT_OFFSET_021}, {implementation-record-element=OBJ_REF_PT_LONG_OFFSET_001, system-signal=OBJ_REF_PT_LONG_OFFSET_021}, {implementation-record-element=OBJ_TIMESTAMP_OFFSET_001, system-signal=OBJ_TIMESTAMP_OFFSET_021}, {implementation-record-element=OBJ_TRACK_MOTION_MODEL_001, system-signal=OBJ_TRACK_MOTION_MODEL_021}, {implementation-record-element=OBJ_VEH_TRACK_FLAG_001, system-signal=OBJ_VEH_TRACK_FLAG_021}, {implementation-record-element=OBJ_VELOCITY_ERR_CRR_COEF_001, system-signal=OBJ_VELOCITY_ERR_CRR_COEF_021}, {implementation-record-element=OBJ_ACCELERATION_LONG_ERR_001, system-signal=OBJ_ACCELERATION_LONG_ERR_021}, {implementation-record-element=OBJ_CLS_TYPE1_PROB_001, system-signal=OBJ_CLS_TYPE1_PROB_021}, {implementation-record-element=OBJ_ACCELERATION_LAT_001, system-signal=OBJ_ACCELERATION_LAT_021}, {implementation-record-element=OBJ_ACCELERATION_LAT_ERR_001, system-signal=OBJ_ACCELERATION_LAT_ERR_021}, {implementation-record-element=OBJ_CLS_TYPE6_PROB_001, system-signal=OBJ_CLS_TYPE6_PROB_021}, {implementation-record-element=OBJ_CLS_TYPE4_001, system-signal=OBJ_CLS_TYPE4_021}, {implementation-record-element=OBJ_CLS_TYPE3_PROB_001, system-signal=OBJ_CLS_TYPE3_PROB_021}, {implementation-record-element=OBJ_CLS_TYPE2_001, system-signal=OBJ_CLS_TYPE2_021}, {implementation-record-element=OBJ_CLS_TYPE2_PROB_001, system-signal=OBJ_CLS_TYPE2_PROB_021}, {implementation-record-element=OBJ_CLS_TYPE3_001, system-signal=OBJ_CLS_TYPE3_021}, {implementation-record-element=OBJ_CLS_TYPE4_PROB_001, system-signal=OBJ_CLS_TYPE4_PROB_021}, {implementation-record-element=OBJ_DIMENSION_WIDTH_001, system-signal=OBJ_DIMENSION_WIDTH_021}, {implementation-record-element=OBJ_CLS_TYPE1_001, system-signal=OBJ_CLS_TYPE1_021}, {implementation-record-element=OBJ_CLS_TYPE6_001, system-signal=OBJ_CLS_TYPE6_021}, {implementation-record-element=OBJ_DIMENSION_LENGTH_001, system-signal=OBJ_DIMENSION_LENGTH_021}, {implementation-record-element=OBJ_CLS_TYPE5_PROB_001, system-signal=OBJ_CLS_TYPE5_PROB_021}, {implementation-record-element=OBJ_DIMENSION_LENGTH_ERR_001, system-signal=OBJ_DIMENSION_LENGTH_ERR_021}, {implementation-record-element=OBJ_DIMENSION_WIDTH_ERR_001, system-signal=OBJ_DIMENSION_WIDTH_ERR_021}, {implementation-record-element=OBJ_ACCELERATION_LONG_001, system-signal=OBJ_ACCELERATION_LONG_021}, {implementation-record-element=OBJ_CLS_TYPE5_001, system-signal=OBJ_CLS_TYPE5_021}, {implementation-record-element=OBJ_VELOCITY_LAT_001, system-signal=OBJ_VELOCITY_LAT_021}, {implementation-record-element=OBJ_POS_LONG_ERR_001, system-signal=OBJ_POS_LONG_ERR_021}, {implementation-record-element=OBJ_YAW_ANGLE_001, system-signal=OBJ_YAW_ANGLE_021}, {implementation-record-element=OBJ_VELOCITY_LONG_ERR_001, system-signal=OBJ_VELOCITY_LONG_ERR_021}, {implementation-record-element=OBJ_POS_LAT_001, system-signal=OBJ_POS_LAT_021}, {implementation-record-element=OBJ_VELOCITY_LAT_ERR_001, system-signal=OBJ_VELOCITY_LAT_ERR_021}, {implementation-record-element=OBJ_POS_LONG_001, system-signal=OBJ_POS_LONG_021}, {implementation-record-element=OBJ_VELOCITY_LONG_001, system-signal=OBJ_VELOCITY_LONG_021}, {implementation-record-element=OBJ_YAW_ANGLE_ERR_001, system-signal=OBJ_YAW_ANGLE_ERR_021}, {implementation-record-element=OBJ_YAW_RATE_ERR_001, system-signal=OBJ_YAW_RATE_ERR_021}, {implementation-record-element=OBJ_YAW_RATE_001, system-signal=OBJ_YAW_RATE_021}, {implementation-record-element=OBJ_POS_LAT_ERR_001, system-signal=OBJ_POS_LAT_ERR_021}]}
        sender-receiver-to-signal-group-mapping={data-element=COMPOSITIONTYPE.Pp_SG_TrackerObject022.Vdp_SG_TrackerObject022, signal-group=SG_TrackerObject022, type-mapping=sender-rec-record-type-mapping=record-element-mappings=[{implementation-record-element=OBJ_ACCEL_ERR_CRR_COEF_001, system-signal=OBJ_ACCEL_ERR_CRR_COEF_022}, {implementation-record-element=OBJ_ALIVE_TIME_001, system-signal=OBJ_ALIVE_TIME_022}, {implementation-record-element=OBJ_EXISTENCE_PROB_001, system-signal=OBJ_EXISTENCE_PROB_022}, {implementation-record-element=OBJ_GROUP_ID_001, system-signal=OBJ_GROUP_ID_022}, {implementation-record-element=OBJ_ID_001, system-signal=OBJ_ID_022}, {implementation-record-element=OBJ_MEASUREMENT_STATUS_001, system-signal=OBJ_MEASUREMENT_STATUS_022}, {implementation-record-element=OBJ_MH_CRC16_001, system-signal=OBJ_MH_CRC16_022}, {implementation-record-element=OBJ_MH_CYCLE_COUNTER_001, system-signal=OBJ_MH_CYCLE_COUNTER_022}, {implementation-record-element=OBJ_MOVEMENT_STATUS_001, system-signal=OBJ_MOVEMENT_STATUS_022}, {implementation-record-element=OBJ_POS_ERR_CRR_COEF_001, system-signal=OBJ_POS_ERR_CRR_COEF_022}, {implementation-record-element=OBJ_RCS_001, system-signal=OBJ_RCS_022}, {implementation-record-element=OBJ_REF_PT_LAT_OFFSET_001, system-signal=OBJ_REF_PT_LAT_OFFSET_022}, {implementation-record-element=OBJ_REF_PT_LONG_OFFSET_001, system-signal=OBJ_REF_PT_LONG_OFFSET_022}, {implementation-record-element=OBJ_TIMESTAMP_OFFSET_001, system-signal=OBJ_TIMESTAMP_OFFSET_022}, {implementation-record-element=OBJ_TRACK_MOTION_MODEL_001, system-signal=OBJ_TRACK_MOTION_MODEL_022}, {implementation-record-element=OBJ_VEH_TRACK_FLAG_001, system-signal=OBJ_VEH_TRACK_FLAG_022}, {implementation-record-element=OBJ_VELOCITY_ERR_CRR_COEF_001, system-signal=OBJ_VELOCITY_ERR_CRR_COEF_022}, {implementation-record-element=OBJ_CLS_TYPE2_001, system-signal=OBJ_CLS_TYPE2_022}, {implementation-record-element=OBJ_CLS_TYPE5_001, system-signal=OBJ_CLS_TYPE5_022}, {implementation-record-element=OBJ_DIMENSION_WIDTH_001, system-signal=OBJ_DIMENSION_WIDTH_022}, {implementation-record-element=OBJ_DIMENSION_WIDTH_ERR_001, system-signal=OBJ_DIMENSION_WIDTH_ERR_022}, {implementation-record-element=OBJ_POS_LAT_001, system-signal=OBJ_POS_LAT_022}, {implementation-record-element=OBJ_POS_LAT_ERR_001, system-signal=OBJ_POS_LAT_ERR_022}, {implementation-record-element=OBJ_POS_LONG_001, system-signal=OBJ_POS_LONG_022}, {implementation-record-element=OBJ_CLS_TYPE4_PROB_001, system-signal=OBJ_CLS_TYPE4_PROB_022}, {implementation-record-element=OBJ_POS_LONG_ERR_001, system-signal=OBJ_POS_LONG_ERR_022}, {implementation-record-element=OBJ_ACCELERATION_LAT_001, system-signal=OBJ_ACCELERATION_LAT_022}, {implementation-record-element=OBJ_ACCELERATION_LAT_ERR_001, system-signal=OBJ_ACCELERATION_LAT_ERR_022}, {implementation-record-element=OBJ_CLS_TYPE3_001, system-signal=OBJ_CLS_TYPE3_022}, {implementation-record-element=OBJ_CLS_TYPE5_PROB_001, system-signal=OBJ_CLS_TYPE5_PROB_022}, {implementation-record-element=OBJ_ACCELERATION_LONG_ERR_001, system-signal=OBJ_ACCELERATION_LONG_ERR_022}, {implementation-record-element=OBJ_CLS_TYPE4_001, system-signal=OBJ_CLS_TYPE4_022}, {implementation-record-element=OBJ_CLS_TYPE6_PROB_001, system-signal=OBJ_CLS_TYPE6_PROB_022}, {implementation-record-element=OBJ_CLS_TYPE2_PROB_001, system-signal=OBJ_CLS_TYPE2_PROB_022}, {implementation-record-element=OBJ_VELOCITY_LAT_001, system-signal=OBJ_VELOCITY_LAT_022}, {implementation-record-element=OBJ_DIMENSION_LENGTH_ERR_001, system-signal=OBJ_DIMENSION_LENGTH_ERR_022}, {implementation-record-element=OBJ_VELOCITY_LAT_ERR_001, system-signal=OBJ_VELOCITY_LAT_ERR_022}, {implementation-record-element=OBJ_CLS_TYPE1_PROB_001, system-signal=OBJ_CLS_TYPE1_PROB_022}, {implementation-record-element=OBJ_DIMENSION_LENGTH_001, system-signal=OBJ_DIMENSION_LENGTH_022}, {implementation-record-element=OBJ_ACCELERATION_LONG_001, system-signal=OBJ_ACCELERATION_LONG_022}, {implementation-record-element=OBJ_CLS_TYPE3_PROB_001, system-signal=OBJ_CLS_TYPE3_PROB_022}, {implementation-record-element=OBJ_VELOCITY_LONG_001, system-signal=OBJ_VELOCITY_LONG_022}, {implementation-record-element=OBJ_CLS_TYPE1_001, system-signal=OBJ_CLS_TYPE1_022}, {implementation-record-element=OBJ_CLS_TYPE6_001, system-signal=OBJ_CLS_TYPE6_022}, {implementation-record-element=OBJ_YAW_RATE_001, system-signal=OBJ_YAW_RATE_022}, {implementation-record-element=OBJ_YAW_ANGLE_ERR_001, system-signal=OBJ_YAW_ANGLE_ERR_022}, {implementation-record-element=OBJ_VELOCITY_LONG_ERR_001, system-signal=OBJ_VELOCITY_LONG_ERR_022}, {implementation-record-element=OBJ_YAW_RATE_ERR_001, system-signal=OBJ_YAW_RATE_ERR_022}, {implementation-record-element=OBJ_YAW_ANGLE_001, system-signal=OBJ_YAW_ANGLE_022}]}
        sender-receiver-to-signal-group-mapping={data-element=COMPOSITIONTYPE.Pp_SG_TrackerObject023.Vdp_SG_TrackerObject023, signal-group=SG_TrackerObject023, type-mapping=sender-rec-record-type-mapping=record-element-mappings=[{implementation-record-element=OBJ_ACCEL_ERR_CRR_COEF_001, system-signal=OBJ_ACCEL_ERR_CRR_COEF_023}, {implementation-record-element=OBJ_ALIVE_TIME_001, system-signal=OBJ_ALIVE_TIME_023}, {implementation-record-element=OBJ_EXISTENCE_PROB_001, system-signal=OBJ_EXISTENCE_PROB_023}, {implementation-record-element=OBJ_GROUP_ID_001, system-signal=OBJ_GROUP_ID_023}, {implementation-record-element=OBJ_ID_001, system-signal=OBJ_ID_023}, {implementation-record-element=OBJ_MEASUREMENT_STATUS_001, system-signal=OBJ_MEASUREMENT_STATUS_023}, {implementation-record-element=OBJ_MH_CRC16_001, system-signal=OBJ_MH_CRC16_023}, {implementation-record-element=OBJ_MH_CYCLE_COUNTER_001, system-signal=OBJ_MH_CYCLE_COUNTER_023}, {implementation-record-element=OBJ_MOVEMENT_STATUS_001, system-signal=OBJ_MOVEMENT_STATUS_023}, {implementation-record-element=OBJ_POS_ERR_CRR_COEF_001, system-signal=OBJ_POS_ERR_CRR_COEF_023}, {implementation-record-element=OBJ_RCS_001, system-signal=OBJ_RCS_023}, {implementation-record-element=OBJ_REF_PT_LAT_OFFSET_001, system-signal=OBJ_REF_PT_LAT_OFFSET_023}, {implementation-record-element=OBJ_REF_PT_LONG_OFFSET_001, system-signal=OBJ_REF_PT_LONG_OFFSET_023}, {implementation-record-element=OBJ_TIMESTAMP_OFFSET_001, system-signal=OBJ_TIMESTAMP_OFFSET_023}, {implementation-record-element=OBJ_TRACK_MOTION_MODEL_001, system-signal=OBJ_TRACK_MOTION_MODEL_023}, {implementation-record-element=OBJ_VEH_TRACK_FLAG_001, system-signal=OBJ_VEH_TRACK_FLAG_023}, {implementation-record-element=OBJ_VELOCITY_ERR_CRR_COEF_001, system-signal=OBJ_VELOCITY_ERR_CRR_COEF_023}, {implementation-record-element=OBJ_POS_LAT_001, system-signal=OBJ_POS_LAT_023}, {implementation-record-element=OBJ_YAW_ANGLE_ERR_001, system-signal=OBJ_YAW_ANGLE_ERR_023}, {implementation-record-element=OBJ_VELOCITY_LAT_ERR_001, system-signal=OBJ_VELOCITY_LAT_ERR_023}, {implementation-record-element=OBJ_DIMENSION_WIDTH_ERR_001, system-signal=OBJ_DIMENSION_WIDTH_ERR_023}, {implementation-record-element=OBJ_CLS_TYPE3_PROB_001, system-signal=OBJ_CLS_TYPE3_PROB_023}, {implementation-record-element=OBJ_VELOCITY_LONG_001, system-signal=OBJ_VELOCITY_LONG_023}, {implementation-record-element=OBJ_ACCELERATION_LAT_ERR_001, system-signal=OBJ_ACCELERATION_LAT_ERR_023}, {implementation-record-element=OBJ_CLS_TYPE6_001, system-signal=OBJ_CLS_TYPE6_023}, {implementation-record-element=OBJ_YAW_ANGLE_001, system-signal=OBJ_YAW_ANGLE_023}, {implementation-record-element=OBJ_ACCELERATION_LAT_001, system-signal=OBJ_ACCELERATION_LAT_023}, {implementation-record-element=OBJ_CLS_TYPE4_PROB_001, system-signal=OBJ_CLS_TYPE4_PROB_023}, {implementation-record-element=OBJ_YAW_RATE_001, system-signal=OBJ_YAW_RATE_023}, {implementation-record-element=OBJ_DIMENSION_LENGTH_ERR_001, system-signal=OBJ_DIMENSION_LENGTH_ERR_023}, {implementation-record-element=OBJ_CLS_TYPE4_001, system-signal=OBJ_CLS_TYPE4_023}, {implementation-record-element=OBJ_DIMENSION_WIDTH_001, system-signal=OBJ_DIMENSION_WIDTH_023}, {implementation-record-element=OBJ_VELOCITY_LONG_ERR_001, system-signal=OBJ_VELOCITY_LONG_ERR_023}, {implementation-record-element=OBJ_CLS_TYPE2_001, system-signal=OBJ_CLS_TYPE2_023}, {implementation-record-element=OBJ_CLS_TYPE5_001, system-signal=OBJ_CLS_TYPE5_023}, {implementation-record-element=OBJ_CLS_TYPE1_PROB_001, system-signal=OBJ_CLS_TYPE1_PROB_023}, {implementation-record-element=OBJ_CLS_TYPE6_PROB_001, system-signal=OBJ_CLS_TYPE6_PROB_023}, {implementation-record-element=OBJ_DIMENSION_LENGTH_001, system-signal=OBJ_DIMENSION_LENGTH_023}, {implementation-record-element=OBJ_POS_LAT_ERR_001, system-signal=OBJ_POS_LAT_ERR_023}, {implementation-record-element=OBJ_CLS_TYPE5_PROB_001, system-signal=OBJ_CLS_TYPE5_PROB_023}, {implementation-record-element=OBJ_POS_LONG_001, system-signal=OBJ_POS_LONG_023}, {implementation-record-element=OBJ_CLS_TYPE3_001, system-signal=OBJ_CLS_TYPE3_023}, {implementation-record-element=OBJ_CLS_TYPE2_PROB_001, system-signal=OBJ_CLS_TYPE2_PROB_023}, {implementation-record-element=OBJ_POS_LONG_ERR_001, system-signal=OBJ_POS_LONG_ERR_023}, {implementation-record-element=OBJ_YAW_RATE_ERR_001, system-signal=OBJ_YAW_RATE_ERR_023}, {implementation-record-element=OBJ_VELOCITY_LAT_001, system-signal=OBJ_VELOCITY_LAT_023}, {implementation-record-element=OBJ_ACCELERATION_LONG_001, system-signal=OBJ_ACCELERATION_LONG_023}, {implementation-record-element=OBJ_ACCELERATION_LONG_ERR_001, system-signal=OBJ_ACCELERATION_LONG_ERR_023}, {implementation-record-element=OBJ_CLS_TYPE1_001, system-signal=OBJ_CLS_TYPE1_023}]}
        sender-receiver-to-signal-group-mapping={data-element=COMPOSITIONTYPE.Pp_SG_TrackerObject024.Vdp_SG_TrackerObject024, signal-group=SG_TrackerObject024, type-mapping=sender-rec-record-type-mapping=record-element-mappings=[{implementation-record-element=OBJ_ACCEL_ERR_CRR_COEF_001, system-signal=OBJ_ACCEL_ERR_CRR_COEF_024}, {implementation-record-element=OBJ_ALIVE_TIME_001, system-signal=OBJ_ALIVE_TIME_024}, {implementation-record-element=OBJ_EXISTENCE_PROB_001, system-signal=OBJ_EXISTENCE_PROB_024}, {implementation-record-element=OBJ_GROUP_ID_001, system-signal=OBJ_GROUP_ID_024}, {implementation-record-element=OBJ_ID_001, system-signal=OBJ_ID_024}, {implementation-record-element=OBJ_MEASUREMENT_STATUS_001, system-signal=OBJ_MEASUREMENT_STATUS_024}, {implementation-record-element=OBJ_MH_CRC16_001, system-signal=OBJ_MH_CRC16_024}, {implementation-record-element=OBJ_MH_CYCLE_COUNTER_001, system-signal=OBJ_MH_CYCLE_COUNTER_024}, {implementation-record-element=OBJ_MOVEMENT_STATUS_001, system-signal=OBJ_MOVEMENT_STATUS_024}, {implementation-record-element=OBJ_POS_ERR_CRR_COEF_001, system-signal=OBJ_POS_ERR_CRR_COEF_024}, {implementation-record-element=OBJ_RCS_001, system-signal=OBJ_RCS_024}, {implementation-record-element=OBJ_REF_PT_LAT_OFFSET_001, system-signal=OBJ_REF_PT_LAT_OFFSET_024}, {implementation-record-element=OBJ_REF_PT_LONG_OFFSET_001, system-signal=OBJ_REF_PT_LONG_OFFSET_024}, {implementation-record-element=OBJ_TIMESTAMP_OFFSET_001, system-signal=OBJ_TIMESTAMP_OFFSET_024}, {implementation-record-element=OBJ_TRACK_MOTION_MODEL_001, system-signal=OBJ_TRACK_MOTION_MODEL_024}, {implementation-record-element=OBJ_VEH_TRACK_FLAG_001, system-signal=OBJ_VEH_TRACK_FLAG_024}, {implementation-record-element=OBJ_VELOCITY_ERR_CRR_COEF_001, system-signal=OBJ_VELOCITY_ERR_CRR_COEF_024}, {implementation-record-element=OBJ_ACCELERATION_LAT_001, system-signal=OBJ_ACCELERATION_LAT_024}, {implementation-record-element=OBJ_ACCELERATION_LAT_ERR_001, system-signal=OBJ_ACCELERATION_LAT_ERR_024}, {implementation-record-element=OBJ_ACCELERATION_LONG_ERR_001, system-signal=OBJ_ACCELERATION_LONG_ERR_024}, {implementation-record-element=OBJ_CLS_TYPE1_PROB_001, system-signal=OBJ_CLS_TYPE1_PROB_024}, {implementation-record-element=OBJ_ACCELERATION_LONG_001, system-signal=OBJ_ACCELERATION_LONG_024}, {implementation-record-element=OBJ_CLS_TYPE1_001, system-signal=OBJ_CLS_TYPE1_024}, {implementation-record-element=OBJ_CLS_TYPE2_PROB_001, system-signal=OBJ_CLS_TYPE2_PROB_024}, {implementation-record-element=OBJ_DIMENSION_LENGTH_ERR_001, system-signal=OBJ_DIMENSION_LENGTH_ERR_024}, {implementation-record-element=OBJ_YAW_RATE_001, system-signal=OBJ_YAW_RATE_024}, {implementation-record-element=OBJ_DIMENSION_LENGTH_001, system-signal=OBJ_DIMENSION_LENGTH_024}, {implementation-record-element=OBJ_YAW_ANGLE_001, system-signal=OBJ_YAW_ANGLE_024}, {implementation-record-element=OBJ_YAW_RATE_ERR_001, system-signal=OBJ_YAW_RATE_ERR_024}, {implementation-record-element=OBJ_CLS_TYPE2_001, system-signal=OBJ_CLS_TYPE2_024}, {implementation-record-element=OBJ_YAW_ANGLE_ERR_001, system-signal=OBJ_YAW_ANGLE_ERR_024}, {implementation-record-element=OBJ_CLS_TYPE4_PROB_001, system-signal=OBJ_CLS_TYPE4_PROB_024}, {implementation-record-element=OBJ_DIMENSION_WIDTH_ERR_001, system-signal=OBJ_DIMENSION_WIDTH_ERR_024}, {implementation-record-element=OBJ_DIMENSION_WIDTH_001, system-signal=OBJ_DIMENSION_WIDTH_024}, {implementation-record-element=OBJ_CLS_TYPE3_PROB_001, system-signal=OBJ_CLS_TYPE3_PROB_024}, {implementation-record-element=OBJ_CLS_TYPE6_001, system-signal=OBJ_CLS_TYPE6_024}, {implementation-record-element=OBJ_CLS_TYPE6_PROB_001, system-signal=OBJ_CLS_TYPE6_PROB_024}, {implementation-record-element=OBJ_CLS_TYPE5_PROB_001, system-signal=OBJ_CLS_TYPE5_PROB_024}, {implementation-record-element=OBJ_CLS_TYPE5_001, system-signal=OBJ_CLS_TYPE5_024}, {implementation-record-element=OBJ_POS_LONG_ERR_001, system-signal=OBJ_POS_LONG_ERR_024}, {implementation-record-element=OBJ_VELOCITY_LAT_001, system-signal=OBJ_VELOCITY_LAT_024}, {implementation-record-element=OBJ_CLS_TYPE4_001, system-signal=OBJ_CLS_TYPE4_024}, {implementation-record-element=OBJ_POS_LAT_001, system-signal=OBJ_POS_LAT_024}, {implementation-record-element=OBJ_POS_LONG_001, system-signal=OBJ_POS_LONG_024}, {implementation-record-element=OBJ_VELOCITY_LAT_ERR_001, system-signal=OBJ_VELOCITY_LAT_ERR_024}, {implementation-record-element=OBJ_VELOCITY_LONG_ERR_001, system-signal=OBJ_VELOCITY_LONG_ERR_024}, {implementation-record-element=OBJ_VELOCITY_LONG_001, system-signal=OBJ_VELOCITY_LONG_024}, {implementation-record-element=OBJ_CLS_TYPE3_001, system-signal=OBJ_CLS_TYPE3_024}, {implementation-record-element=OBJ_POS_LAT_ERR_001, system-signal=OBJ_POS_LAT_ERR_024}]}
        sender-receiver-to-signal-group-mapping={data-element=COMPOSITIONTYPE.Pp_SG_TrackerObject025.Vdp_SG_TrackerObject025, signal-group=SG_TrackerObject025, type-mapping=sender-rec-record-type-mapping=record-element-mappings=[{implementation-record-element=OBJ_ACCEL_ERR_CRR_COEF_001, system-signal=OBJ_ACCEL_ERR_CRR_COEF_025}, {implementation-record-element=OBJ_ALIVE_TIME_001, system-signal=OBJ_ALIVE_TIME_025}, {implementation-record-element=OBJ_EXISTENCE_PROB_001, system-signal=OBJ_EXISTENCE_PROB_025}, {implementation-record-element=OBJ_GROUP_ID_001, system-signal=OBJ_GROUP_ID_025}, {implementation-record-element=OBJ_ID_001, system-signal=OBJ_ID_025}, {implementation-record-element=OBJ_MEASUREMENT_STATUS_001, system-signal=OBJ_MEASUREMENT_STATUS_025}, {implementation-record-element=OBJ_MH_CRC16_001, system-signal=OBJ_MH_CRC16_025}, {implementation-record-element=OBJ_MH_CYCLE_COUNTER_001, system-signal=OBJ_MH_CYCLE_COUNTER_025}, {implementation-record-element=OBJ_MOVEMENT_STATUS_001, system-signal=OBJ_MOVEMENT_STATUS_025}, {implementation-record-element=OBJ_POS_ERR_CRR_COEF_001, system-signal=OBJ_POS_ERR_CRR_COEF_025}, {implementation-record-element=OBJ_RCS_001, system-signal=OBJ_RCS_025}, {implementation-record-element=OBJ_REF_PT_LAT_OFFSET_001, system-signal=OBJ_REF_PT_LAT_OFFSET_025}, {implementation-record-element=OBJ_REF_PT_LONG_OFFSET_001, system-signal=OBJ_REF_PT_LONG_OFFSET_025}, {implementation-record-element=OBJ_TIMESTAMP_OFFSET_001, system-signal=OBJ_TIMESTAMP_OFFSET_025}, {implementation-record-element=OBJ_TRACK_MOTION_MODEL_001, system-signal=OBJ_TRACK_MOTION_MODEL_025}, {implementation-record-element=OBJ_VEH_TRACK_FLAG_001, system-signal=OBJ_VEH_TRACK_FLAG_025}, {implementation-record-element=OBJ_VELOCITY_ERR_CRR_COEF_001, system-signal=OBJ_VELOCITY_ERR_CRR_COEF_025}, {implementation-record-element=OBJ_ACCELERATION_LONG_ERR_001, system-signal=OBJ_ACCELERATION_LONG_ERR_025}, {implementation-record-element=OBJ_CLS_TYPE5_PROB_001, system-signal=OBJ_CLS_TYPE5_PROB_025}, {implementation-record-element=OBJ_CLS_TYPE6_001, system-signal=OBJ_CLS_TYPE6_025}, {implementation-record-element=OBJ_CLS_TYPE6_PROB_001, system-signal=OBJ_CLS_TYPE6_PROB_025}, {implementation-record-element=OBJ_DIMENSION_LENGTH_001, system-signal=OBJ_DIMENSION_LENGTH_025}, {implementation-record-element=OBJ_DIMENSION_WIDTH_001, system-signal=OBJ_DIMENSION_WIDTH_025}, {implementation-record-element=OBJ_CLS_TYPE3_001, system-signal=OBJ_CLS_TYPE3_025}, {implementation-record-element=OBJ_CLS_TYPE1_001, system-signal=OBJ_CLS_TYPE1_025}, {implementation-record-element=OBJ_CLS_TYPE3_PROB_001, system-signal=OBJ_CLS_TYPE3_PROB_025}, {implementation-record-element=OBJ_CLS_TYPE4_PROB_001, system-signal=OBJ_CLS_TYPE4_PROB_025}, {implementation-record-element=OBJ_CLS_TYPE2_001, system-signal=OBJ_CLS_TYPE2_025}, {implementation-record-element=OBJ_DIMENSION_LENGTH_ERR_001, system-signal=OBJ_DIMENSION_LENGTH_ERR_025}, {implementation-record-element=OBJ_DIMENSION_WIDTH_ERR_001, system-signal=OBJ_DIMENSION_WIDTH_ERR_025}, {implementation-record-element=OBJ_ACCELERATION_LAT_001, system-signal=OBJ_ACCELERATION_LAT_025}, {implementation-record-element=OBJ_ACCELERATION_LONG_001, system-signal=OBJ_ACCELERATION_LONG_025}, {implementation-record-element=OBJ_CLS_TYPE1_PROB_001, system-signal=OBJ_CLS_TYPE1_PROB_025}, {implementation-record-element=OBJ_CLS_TYPE2_PROB_001, system-signal=OBJ_CLS_TYPE2_PROB_025}, {implementation-record-element=OBJ_CLS_TYPE4_001, system-signal=OBJ_CLS_TYPE4_025}, {implementation-record-element=OBJ_ACCELERATION_LAT_ERR_001, system-signal=OBJ_ACCELERATION_LAT_ERR_025}, {implementation-record-element=OBJ_CLS_TYPE5_001, system-signal=OBJ_CLS_TYPE5_025}, {implementation-record-element=OBJ_POS_LONG_001, system-signal=OBJ_POS_LONG_025}, {implementation-record-element=OBJ_VELOCITY_LAT_ERR_001, system-signal=OBJ_VELOCITY_LAT_ERR_025}, {implementation-record-element=OBJ_VELOCITY_LAT_001, system-signal=OBJ_VELOCITY_LAT_025}, {implementation-record-element=OBJ_YAW_RATE_ERR_001, system-signal=OBJ_YAW_RATE_ERR_025}, {implementation-record-element=OBJ_YAW_RATE_001, system-signal=OBJ_YAW_RATE_025}, {implementation-record-element=OBJ_YAW_ANGLE_001, system-signal=OBJ_YAW_ANGLE_025}, {implementation-record-element=OBJ_POS_LAT_ERR_001, system-signal=OBJ_POS_LAT_ERR_025}, {implementation-record-element=OBJ_VELOCITY_LONG_ERR_001, system-signal=OBJ_VELOCITY_LONG_ERR_025}, {implementation-record-element=OBJ_POS_LAT_001, system-signal=OBJ_POS_LAT_025}, {implementation-record-element=OBJ_VELOCITY_LONG_001, system-signal=OBJ_VELOCITY_LONG_025}, {implementation-record-element=OBJ_POS_LONG_ERR_001, system-signal=OBJ_POS_LONG_ERR_025}, {implementation-record-element=OBJ_YAW_ANGLE_ERR_001, system-signal=OBJ_YAW_ANGLE_ERR_025}]}
        sender-receiver-to-signal-group-mapping={data-element=COMPOSITIONTYPE.Pp_SG_TrackerObject026.Vdp_SG_TrackerObject026, signal-group=SG_TrackerObject026, type-mapping=sender-rec-record-type-mapping=record-element-mappings=[{implementation-record-element=OBJ_ACCEL_ERR_CRR_COEF_001, system-signal=OBJ_ACCEL_ERR_CRR_COEF_026}, {implementation-record-element=OBJ_ALIVE_TIME_001, system-signal=OBJ_ALIVE_TIME_026}, {implementation-record-element=OBJ_EXISTENCE_PROB_001, system-signal=OBJ_EXISTENCE_PROB_026}, {implementation-record-element=OBJ_GROUP_ID_001, system-signal=OBJ_GROUP_ID_026}, {implementation-record-element=OBJ_ID_001, system-signal=OBJ_ID_026}, {implementation-record-element=OBJ_MEASUREMENT_STATUS_001, system-signal=OBJ_MEASUREMENT_STATUS_026}, {implementation-record-element=OBJ_MH_CRC16_001, system-signal=OBJ_MH_CRC16_026}, {implementation-record-element=OBJ_MH_CYCLE_COUNTER_001, system-signal=OBJ_MH_CYCLE_COUNTER_026}, {implementation-record-element=OBJ_MOVEMENT_STATUS_001, system-signal=OBJ_MOVEMENT_STATUS_026}, {implementation-record-element=OBJ_POS_ERR_CRR_COEF_001, system-signal=OBJ_POS_ERR_CRR_COEF_026}, {implementation-record-element=OBJ_RCS_001, system-signal=OBJ_RCS_026}, {implementation-record-element=OBJ_REF_PT_LAT_OFFSET_001, system-signal=OBJ_REF_PT_LAT_OFFSET_026}, {implementation-record-element=OBJ_REF_PT_LONG_OFFSET_001, system-signal=OBJ_REF_PT_LONG_OFFSET_026}, {implementation-record-element=OBJ_TIMESTAMP_OFFSET_001, system-signal=OBJ_TIMESTAMP_OFFSET_026}, {implementation-record-element=OBJ_TRACK_MOTION_MODEL_001, system-signal=OBJ_TRACK_MOTION_MODEL_026}, {implementation-record-element=OBJ_VEH_TRACK_FLAG_001, system-signal=OBJ_VEH_TRACK_FLAG_026}, {implementation-record-element=OBJ_VELOCITY_ERR_CRR_COEF_001, system-signal=OBJ_VELOCITY_ERR_CRR_COEF_026}, {implementation-record-element=OBJ_ACCELERATION_LONG_001, system-signal=OBJ_ACCELERATION_LONG_026}, {implementation-record-element=OBJ_CLS_TYPE3_001, system-signal=OBJ_CLS_TYPE3_026}, {implementation-record-element=OBJ_CLS_TYPE3_PROB_001, system-signal=OBJ_CLS_TYPE3_PROB_026}, {implementation-record-element=OBJ_CLS_TYPE4_001, system-signal=OBJ_CLS_TYPE4_026}, {implementation-record-element=OBJ_CLS_TYPE2_PROB_001, system-signal=OBJ_CLS_TYPE2_PROB_026}, {implementation-record-element=OBJ_ACCELERATION_LAT_ERR_001, system-signal=OBJ_ACCELERATION_LAT_ERR_026}, {implementation-record-element=OBJ_DIMENSION_WIDTH_ERR_001, system-signal=OBJ_DIMENSION_WIDTH_ERR_026}, {implementation-record-element=OBJ_CLS_TYPE6_001, system-signal=OBJ_CLS_TYPE6_026}, {implementation-record-element=OBJ_DIMENSION_LENGTH_ERR_001, system-signal=OBJ_DIMENSION_LENGTH_ERR_026}, {implementation-record-element=OBJ_POS_LAT_001, system-signal=OBJ_POS_LAT_026}, {implementation-record-element=OBJ_CLS_TYPE6_PROB_001, system-signal=OBJ_CLS_TYPE6_PROB_026}, {implementation-record-element=OBJ_DIMENSION_WIDTH_001, system-signal=OBJ_DIMENSION_WIDTH_026}, {implementation-record-element=OBJ_ACCELERATION_LAT_001, system-signal=OBJ_ACCELERATION_LAT_026}, {implementation-record-element=OBJ_CLS_TYPE2_001, system-signal=OBJ_CLS_TYPE2_026}, {implementation-record-element=OBJ_CLS_TYPE5_PROB_001, system-signal=OBJ_CLS_TYPE5_PROB_026}, {implementation-record-element=OBJ_CLS_TYPE1_PROB_001, system-signal=OBJ_CLS_TYPE1_PROB_026}, {implementation-record-element=OBJ_DIMENSION_LENGTH_001, system-signal=OBJ_DIMENSION_LENGTH_026}, {implementation-record-element=OBJ_CLS_TYPE1_001, system-signal=OBJ_CLS_TYPE1_026}, {implementation-record-element=OBJ_CLS_TYPE4_PROB_001, system-signal=OBJ_CLS_TYPE4_PROB_026}, {implementation-record-element=OBJ_CLS_TYPE5_001, system-signal=OBJ_CLS_TYPE5_026}, {implementation-record-element=OBJ_POS_LAT_ERR_001, system-signal=OBJ_POS_LAT_ERR_026}, {implementation-record-element=OBJ_ACCELERATION_LONG_ERR_001, system-signal=OBJ_ACCELERATION_LONG_ERR_026}, {implementation-record-element=OBJ_POS_LONG_001, system-signal=OBJ_POS_LONG_026}, {implementation-record-element=OBJ_POS_LONG_ERR_001, system-signal=OBJ_POS_LONG_ERR_026}, {implementation-record-element=OBJ_YAW_ANGLE_001, system-signal=OBJ_YAW_ANGLE_026}, {implementation-record-element=OBJ_YAW_RATE_001, system-signal=OBJ_YAW_RATE_026}, {implementation-record-element=OBJ_VELOCITY_LAT_001, system-signal=OBJ_VELOCITY_LAT_026}, {implementation-record-element=OBJ_YAW_ANGLE_ERR_001, system-signal=OBJ_YAW_ANGLE_ERR_026}, {implementation-record-element=OBJ_VELOCITY_LAT_ERR_001, system-signal=OBJ_VELOCITY_LAT_ERR_026}, {implementation-record-element=OBJ_VELOCITY_LONG_ERR_001, system-signal=OBJ_VELOCITY_LONG_ERR_026}, {implementation-record-element=OBJ_YAW_RATE_ERR_001, system-signal=OBJ_YAW_RATE_ERR_026}, {implementation-record-element=OBJ_VELOCITY_LONG_001, system-signal=OBJ_VELOCITY_LONG_026}]}
        sender-receiver-to-signal-group-mapping={data-element=COMPOSITIONTYPE.Pp_SG_TrackerObject027.Vdp_SG_TrackerObject027, signal-group=SG_TrackerObject027, type-mapping=sender-rec-record-type-mapping=record-element-mappings=[{implementation-record-element=OBJ_ACCEL_ERR_CRR_COEF_001, system-signal=OBJ_ACCEL_ERR_CRR_COEF_027}, {implementation-record-element=OBJ_ALIVE_TIME_001, system-signal=OBJ_ALIVE_TIME_027}, {implementation-record-element=OBJ_EXISTENCE_PROB_001, system-signal=OBJ_EXISTENCE_PROB_027}, {implementation-record-element=OBJ_GROUP_ID_001, system-signal=OBJ_GROUP_ID_027}, {implementation-record-element=OBJ_ID_001, system-signal=OBJ_ID_027}, {implementation-record-element=OBJ_MEASUREMENT_STATUS_001, system-signal=OBJ_MEASUREMENT_STATUS_027}, {implementation-record-element=OBJ_MH_CRC16_001, system-signal=OBJ_MH_CRC16_027}, {implementation-record-element=OBJ_MH_CYCLE_COUNTER_001, system-signal=OBJ_MH_CYCLE_COUNTER_027}, {implementation-record-element=OBJ_MOVEMENT_STATUS_001, system-signal=OBJ_MOVEMENT_STATUS_027}, {implementation-record-element=OBJ_POS_ERR_CRR_COEF_001, system-signal=OBJ_POS_ERR_CRR_COEF_027}, {implementation-record-element=OBJ_RCS_001, system-signal=OBJ_RCS_027}, {implementation-record-element=OBJ_REF_PT_LAT_OFFSET_001, system-signal=OBJ_REF_PT_LAT_OFFSET_027}, {implementation-record-element=OBJ_REF_PT_LONG_OFFSET_001, system-signal=OBJ_REF_PT_LONG_OFFSET_027}, {implementation-record-element=OBJ_TIMESTAMP_OFFSET_001, system-signal=OBJ_TIMESTAMP_OFFSET_027}, {implementation-record-element=OBJ_TRACK_MOTION_MODEL_001, system-signal=OBJ_TRACK_MOTION_MODEL_027}, {implementation-record-element=OBJ_VEH_TRACK_FLAG_001, system-signal=OBJ_VEH_TRACK_FLAG_027}, {implementation-record-element=OBJ_VELOCITY_ERR_CRR_COEF_001, system-signal=OBJ_VELOCITY_ERR_CRR_COEF_027}, {implementation-record-element=OBJ_ACCELERATION_LAT_ERR_001, system-signal=OBJ_ACCELERATION_LAT_ERR_027}, {implementation-record-element=OBJ_DIMENSION_LENGTH_001, system-signal=OBJ_DIMENSION_LENGTH_027}, {implementation-record-element=OBJ_CLS_TYPE5_001, system-signal=OBJ_CLS_TYPE5_027}, {implementation-record-element=OBJ_DIMENSION_LENGTH_ERR_001, system-signal=OBJ_DIMENSION_LENGTH_ERR_027}, {implementation-record-element=OBJ_POS_LAT_ERR_001, system-signal=OBJ_POS_LAT_ERR_027}, {implementation-record-element=OBJ_VELOCITY_LAT_ERR_001, system-signal=OBJ_VELOCITY_LAT_ERR_027}, {implementation-record-element=OBJ_YAW_ANGLE_001, system-signal=OBJ_YAW_ANGLE_027}, {implementation-record-element=OBJ_YAW_ANGLE_ERR_001, system-signal=OBJ_YAW_ANGLE_ERR_027}, {implementation-record-element=OBJ_YAW_RATE_001, system-signal=OBJ_YAW_RATE_027}, {implementation-record-element=OBJ_YAW_RATE_ERR_001, system-signal=OBJ_YAW_RATE_ERR_027}, {implementation-record-element=OBJ_VELOCITY_LONG_001, system-signal=OBJ_VELOCITY_LONG_027}, {implementation-record-element=OBJ_VELOCITY_LONG_ERR_001, system-signal=OBJ_VELOCITY_LONG_ERR_027}, {implementation-record-element=OBJ_POS_LAT_001, system-signal=OBJ_POS_LAT_027}, {implementation-record-element=OBJ_ACCELERATION_LAT_001, system-signal=OBJ_ACCELERATION_LAT_027}, {implementation-record-element=OBJ_CLS_TYPE5_PROB_001, system-signal=OBJ_CLS_TYPE5_PROB_027}, {implementation-record-element=OBJ_DIMENSION_WIDTH_001, system-signal=OBJ_DIMENSION_WIDTH_027}, {implementation-record-element=OBJ_POS_LONG_001, system-signal=OBJ_POS_LONG_027}, {implementation-record-element=OBJ_CLS_TYPE2_PROB_001, system-signal=OBJ_CLS_TYPE2_PROB_027}, {implementation-record-element=OBJ_CLS_TYPE6_PROB_001, system-signal=OBJ_CLS_TYPE6_PROB_027}, {implementation-record-element=OBJ_CLS_TYPE3_PROB_001, system-signal=OBJ_CLS_TYPE3_PROB_027}, {implementation-record-element=OBJ_CLS_TYPE4_PROB_001, system-signal=OBJ_CLS_TYPE4_PROB_027}, {implementation-record-element=OBJ_CLS_TYPE2_001, system-signal=OBJ_CLS_TYPE2_027}, {implementation-record-element=OBJ_DIMENSION_WIDTH_ERR_001, system-signal=OBJ_DIMENSION_WIDTH_ERR_027}, {implementation-record-element=OBJ_ACCELERATION_LONG_001, system-signal=OBJ_ACCELERATION_LONG_027}, {implementation-record-element=OBJ_ACCELERATION_LONG_ERR_001, system-signal=OBJ_ACCELERATION_LONG_ERR_027}, {implementation-record-element=OBJ_CLS_TYPE1_PROB_001, system-signal=OBJ_CLS_TYPE1_PROB_027}, {implementation-record-element=OBJ_CLS_TYPE3_001, system-signal=OBJ_CLS_TYPE3_027}, {implementation-record-element=OBJ_CLS_TYPE4_001, system-signal=OBJ_CLS_TYPE4_027}, {implementation-record-element=OBJ_CLS_TYPE1_001, system-signal=OBJ_CLS_TYPE1_027}, {implementation-record-element=OBJ_CLS_TYPE6_001, system-signal=OBJ_CLS_TYPE6_027}, {implementation-record-element=OBJ_POS_LONG_ERR_001, system-signal=OBJ_POS_LONG_ERR_027}, {implementation-record-element=OBJ_VELOCITY_LAT_001, system-signal=OBJ_VELOCITY_LAT_027}]}
        sender-receiver-to-signal-group-mapping={data-element=COMPOSITIONTYPE.Pp_SG_TrackerObject028.Vdp_SG_TrackerObject028, signal-group=SG_TrackerObject028, type-mapping=sender-rec-record-type-mapping=record-element-mappings=[{implementation-record-element=OBJ_ACCEL_ERR_CRR_COEF_001, system-signal=OBJ_ACCEL_ERR_CRR_COEF_028}, {implementation-record-element=OBJ_ALIVE_TIME_001, system-signal=OBJ_ALIVE_TIME_028}, {implementation-record-element=OBJ_EXISTENCE_PROB_001, system-signal=OBJ_EXISTENCE_PROB_028}, {implementation-record-element=OBJ_GROUP_ID_001, system-signal=OBJ_GROUP_ID_028}, {implementation-record-element=OBJ_ID_001, system-signal=OBJ_ID_028}, {implementation-record-element=OBJ_MEASUREMENT_STATUS_001, system-signal=OBJ_MEASUREMENT_STATUS_028}, {implementation-record-element=OBJ_MH_CRC16_001, system-signal=OBJ_MH_CRC16_028}, {implementation-record-element=OBJ_MH_CYCLE_COUNTER_001, system-signal=OBJ_MH_CYCLE_COUNTER_028}, {implementation-record-element=OBJ_MOVEMENT_STATUS_001, system-signal=OBJ_MOVEMENT_STATUS_028}, {implementation-record-element=OBJ_POS_ERR_CRR_COEF_001, system-signal=OBJ_POS_ERR_CRR_COEF_028}, {implementation-record-element=OBJ_RCS_001, system-signal=OBJ_RCS_028}, {implementation-record-element=OBJ_REF_PT_LAT_OFFSET_001, system-signal=OBJ_REF_PT_LAT_OFFSET_028}, {implementation-record-element=OBJ_REF_PT_LONG_OFFSET_001, system-signal=OBJ_REF_PT_LONG_OFFSET_028}, {implementation-record-element=OBJ_TIMESTAMP_OFFSET_001, system-signal=OBJ_TIMESTAMP_OFFSET_028}, {implementation-record-element=OBJ_TRACK_MOTION_MODEL_001, system-signal=OBJ_TRACK_MOTION_MODEL_028}, {implementation-record-element=OBJ_VEH_TRACK_FLAG_001, system-signal=OBJ_VEH_TRACK_FLAG_028}, {implementation-record-element=OBJ_VELOCITY_ERR_CRR_COEF_001, system-signal=OBJ_VELOCITY_ERR_CRR_COEF_028}, {implementation-record-element=OBJ_DIMENSION_WIDTH_001, system-signal=OBJ_DIMENSION_WIDTH_028}, {implementation-record-element=OBJ_ACCELERATION_LAT_ERR_001, system-signal=OBJ_ACCELERATION_LAT_ERR_028}, {implementation-record-element=OBJ_DIMENSION_WIDTH_ERR_001, system-signal=OBJ_DIMENSION_WIDTH_ERR_028}, {implementation-record-element=OBJ_ACCELERATION_LONG_001, system-signal=OBJ_ACCELERATION_LONG_028}, {implementation-record-element=OBJ_CLS_TYPE5_001, system-signal=OBJ_CLS_TYPE5_028}, {implementation-record-element=OBJ_POS_LAT_ERR_001, system-signal=OBJ_POS_LAT_ERR_028}, {implementation-record-element=OBJ_VELOCITY_LAT_001, system-signal=OBJ_VELOCITY_LAT_028}, {implementation-record-element=OBJ_VELOCITY_LONG_ERR_001, system-signal=OBJ_VELOCITY_LONG_ERR_028}, {implementation-record-element=OBJ_YAW_ANGLE_001, system-signal=OBJ_YAW_ANGLE_028}, {implementation-record-element=OBJ_VELOCITY_LAT_ERR_001, system-signal=OBJ_VELOCITY_LAT_ERR_028}, {implementation-record-element=OBJ_POS_LONG_ERR_001, system-signal=OBJ_POS_LONG_ERR_028}, {implementation-record-element=OBJ_CLS_TYPE1_PROB_001, system-signal=OBJ_CLS_TYPE1_PROB_028}, {implementation-record-element=OBJ_CLS_TYPE2_001, system-signal=OBJ_CLS_TYPE2_028}, {implementation-record-element=OBJ_POS_LONG_001, system-signal=OBJ_POS_LONG_028}, {implementation-record-element=OBJ_ACCELERATION_LONG_ERR_001, system-signal=OBJ_ACCELERATION_LONG_ERR_028}, {implementation-record-element=OBJ_CLS_TYPE6_001, system-signal=OBJ_CLS_TYPE6_028}, {implementation-record-element=OBJ_POS_LAT_001, system-signal=OBJ_POS_LAT_028}, {implementation-record-element=OBJ_ACCELERATION_LAT_001, system-signal=OBJ_ACCELERATION_LAT_028}, {implementation-record-element=OBJ_CLS_TYPE3_001, system-signal=OBJ_CLS_TYPE3_028}, {implementation-record-element=OBJ_YAW_RATE_001, system-signal=OBJ_YAW_RATE_028}, {implementation-record-element=OBJ_DIMENSION_LENGTH_001, system-signal=OBJ_DIMENSION_LENGTH_028}, {implementation-record-element=OBJ_YAW_ANGLE_ERR_001, system-signal=OBJ_YAW_ANGLE_ERR_028}, {implementation-record-element=OBJ_CLS_TYPE5_PROB_001, system-signal=OBJ_CLS_TYPE5_PROB_028}, {implementation-record-element=OBJ_YAW_RATE_ERR_001, system-signal=OBJ_YAW_RATE_ERR_028}, {implementation-record-element=OBJ_CLS_TYPE1_001, system-signal=OBJ_CLS_TYPE1_028}, {implementation-record-element=OBJ_CLS_TYPE3_PROB_001, system-signal=OBJ_CLS_TYPE3_PROB_028}, {implementation-record-element=OBJ_CLS_TYPE4_PROB_001, system-signal=OBJ_CLS_TYPE4_PROB_028}, {implementation-record-element=OBJ_DIMENSION_LENGTH_ERR_001, system-signal=OBJ_DIMENSION_LENGTH_ERR_028}, {implementation-record-element=OBJ_CLS_TYPE2_PROB_001, system-signal=OBJ_CLS_TYPE2_PROB_028}, {implementation-record-element=OBJ_CLS_TYPE6_PROB_001, system-signal=OBJ_CLS_TYPE6_PROB_028}, {implementation-record-element=OBJ_VELOCITY_LONG_001, system-signal=OBJ_VELOCITY_LONG_028}, {implementation-record-element=OBJ_CLS_TYPE4_001, system-signal=OBJ_CLS_TYPE4_028}]}
        sender-receiver-to-signal-group-mapping={data-element=COMPOSITIONTYPE.Pp_SG_TrackerObject029.Vdp_SG_TrackerObject029, signal-group=SG_TrackerObject029, type-mapping=sender-rec-record-type-mapping=record-element-mappings=[{implementation-record-element=OBJ_ACCEL_ERR_CRR_COEF_001, system-signal=OBJ_ACCEL_ERR_CRR_COEF_029}, {implementation-record-element=OBJ_ALIVE_TIME_001, system-signal=OBJ_ALIVE_TIME_029}, {implementation-record-element=OBJ_EXISTENCE_PROB_001, system-signal=OBJ_EXISTENCE_PROB_029}, {implementation-record-element=OBJ_GROUP_ID_001, system-signal=OBJ_GROUP_ID_029}, {implementation-record-element=OBJ_ID_001, system-signal=OBJ_ID_029}, {implementation-record-element=OBJ_MEASUREMENT_STATUS_001, system-signal=OBJ_MEASUREMENT_STATUS_029}, {implementation-record-element=OBJ_MH_CRC16_001, system-signal=OBJ_MH_CRC16_029}, {implementation-record-element=OBJ_MH_CYCLE_COUNTER_001, system-signal=OBJ_MH_CYCLE_COUNTER_029}, {implementation-record-element=OBJ_MOVEMENT_STATUS_001, system-signal=OBJ_MOVEMENT_STATUS_029}, {implementation-record-element=OBJ_POS_ERR_CRR_COEF_001, system-signal=OBJ_POS_ERR_CRR_COEF_029}, {implementation-record-element=OBJ_RCS_001, system-signal=OBJ_RCS_029}, {implementation-record-element=OBJ_REF_PT_LAT_OFFSET_001, system-signal=OBJ_REF_PT_LAT_OFFSET_029}, {implementation-record-element=OBJ_REF_PT_LONG_OFFSET_001, system-signal=OBJ_REF_PT_LONG_OFFSET_029}, {implementation-record-element=OBJ_TIMESTAMP_OFFSET_001, system-signal=OBJ_TIMESTAMP_OFFSET_029}, {implementation-record-element=OBJ_TRACK_MOTION_MODEL_001, system-signal=OBJ_TRACK_MOTION_MODEL_029}, {implementation-record-element=OBJ_VEH_TRACK_FLAG_001, system-signal=OBJ_VEH_TRACK_FLAG_029}, {implementation-record-element=OBJ_VELOCITY_ERR_CRR_COEF_001, system-signal=OBJ_VELOCITY_ERR_CRR_COEF_029}, {implementation-record-element=OBJ_ACCELERATION_LONG_ERR_001, system-signal=OBJ_ACCELERATION_LONG_ERR_029}, {implementation-record-element=OBJ_CLS_TYPE1_001, system-signal=OBJ_CLS_TYPE1_029}, {implementation-record-element=OBJ_CLS_TYPE2_001, system-signal=OBJ_CLS_TYPE2_029}, {implementation-record-element=OBJ_CLS_TYPE1_PROB_001, system-signal=OBJ_CLS_TYPE1_PROB_029}, {implementation-record-element=OBJ_CLS_TYPE3_001, system-signal=OBJ_CLS_TYPE3_029}, {implementation-record-element=OBJ_ACCELERATION_LAT_001, system-signal=OBJ_ACCELERATION_LAT_029}, {implementation-record-element=OBJ_ACCELERATION_LONG_001, system-signal=OBJ_ACCELERATION_LONG_029}, {implementation-record-element=OBJ_CLS_TYPE2_PROB_001, system-signal=OBJ_CLS_TYPE2_PROB_029}, {implementation-record-element=OBJ_CLS_TYPE3_PROB_001, system-signal=OBJ_CLS_TYPE3_PROB_029}, {implementation-record-element=OBJ_CLS_TYPE4_001, system-signal=OBJ_CLS_TYPE4_029}, {implementation-record-element=OBJ_CLS_TYPE4_PROB_001, system-signal=OBJ_CLS_TYPE4_PROB_029}, {implementation-record-element=OBJ_ACCELERATION_LAT_ERR_001, system-signal=OBJ_ACCELERATION_LAT_ERR_029}, {implementation-record-element=OBJ_POS_LAT_001, system-signal=OBJ_POS_LAT_029}, {implementation-record-element=OBJ_CLS_TYPE5_PROB_001, system-signal=OBJ_CLS_TYPE5_PROB_029}, {implementation-record-element=OBJ_POS_LAT_ERR_001, system-signal=OBJ_POS_LAT_ERR_029}, {implementation-record-element=OBJ_POS_LONG_ERR_001, system-signal=OBJ_POS_LONG_ERR_029}, {implementation-record-element=OBJ_YAW_RATE_ERR_001, system-signal=OBJ_YAW_RATE_ERR_029}, {implementation-record-element=OBJ_YAW_ANGLE_ERR_001, system-signal=OBJ_YAW_ANGLE_ERR_029}, {implementation-record-element=OBJ_DIMENSION_LENGTH_ERR_001, system-signal=OBJ_DIMENSION_LENGTH_ERR_029}, {implementation-record-element=OBJ_CLS_TYPE6_PROB_001, system-signal=OBJ_CLS_TYPE6_PROB_029}, {implementation-record-element=OBJ_POS_LONG_001, system-signal=OBJ_POS_LONG_029}, {implementation-record-element=OBJ_VELOCITY_LAT_001, system-signal=OBJ_VELOCITY_LAT_029}, {implementation-record-element=OBJ_DIMENSION_LENGTH_001, system-signal=OBJ_DIMENSION_LENGTH_029}, {implementation-record-element=OBJ_CLS_TYPE6_001, system-signal=OBJ_CLS_TYPE6_029}, {implementation-record-element=OBJ_DIMENSION_WIDTH_001, system-signal=OBJ_DIMENSION_WIDTH_029}, {implementation-record-element=OBJ_YAW_ANGLE_001, system-signal=OBJ_YAW_ANGLE_029}, {implementation-record-element=OBJ_YAW_RATE_001, system-signal=OBJ_YAW_RATE_029}, {implementation-record-element=OBJ_VELOCITY_LONG_001, system-signal=OBJ_VELOCITY_LONG_029}, {implementation-record-element=OBJ_VELOCITY_LONG_ERR_001, system-signal=OBJ_VELOCITY_LONG_ERR_029}, {implementation-record-element=OBJ_CLS_TYPE5_001, system-signal=OBJ_CLS_TYPE5_029}, {implementation-record-element=OBJ_DIMENSION_WIDTH_ERR_001, system-signal=OBJ_DIMENSION_WIDTH_ERR_029}, {implementation-record-element=OBJ_VELOCITY_LAT_ERR_001, system-signal=OBJ_VELOCITY_LAT_ERR_029}]}
        sender-receiver-to-signal-group-mapping={data-element=COMPOSITIONTYPE.Pp_SG_TrackerObject030.Vdp_SG_TrackerObject030, signal-group=SG_TrackerObject030, type-mapping=sender-rec-record-type-mapping=record-element-mappings=[{implementation-record-element=OBJ_ACCEL_ERR_CRR_COEF_001, system-signal=OBJ_ACCEL_ERR_CRR_COEF_030}, {implementation-record-element=OBJ_ALIVE_TIME_001, system-signal=OBJ_ALIVE_TIME_030}, {implementation-record-element=OBJ_EXISTENCE_PROB_001, system-signal=OBJ_EXISTENCE_PROB_030}, {implementation-record-element=OBJ_GROUP_ID_001, system-signal=OBJ_GROUP_ID_030}, {implementation-record-element=OBJ_ID_001, system-signal=OBJ_ID_030}, {implementation-record-element=OBJ_MEASUREMENT_STATUS_001, system-signal=OBJ_MEASUREMENT_STATUS_030}, {implementation-record-element=OBJ_MH_CRC16_001, system-signal=OBJ_MH_CRC16_030}, {implementation-record-element=OBJ_MH_CYCLE_COUNTER_001, system-signal=OBJ_MH_CYCLE_COUNTER_030}, {implementation-record-element=OBJ_MOVEMENT_STATUS_001, system-signal=OBJ_MOVEMENT_STATUS_030}, {implementation-record-element=OBJ_POS_ERR_CRR_COEF_001, system-signal=OBJ_POS_ERR_CRR_COEF_030}, {implementation-record-element=OBJ_RCS_001, system-signal=OBJ_RCS_030}, {implementation-record-element=OBJ_REF_PT_LAT_OFFSET_001, system-signal=OBJ_REF_PT_LAT_OFFSET_030}, {implementation-record-element=OBJ_REF_PT_LONG_OFFSET_001, system-signal=OBJ_REF_PT_LONG_OFFSET_030}, {implementation-record-element=OBJ_TIMESTAMP_OFFSET_001, system-signal=OBJ_TIMESTAMP_OFFSET_030}, {implementation-record-element=OBJ_TRACK_MOTION_MODEL_001, system-signal=OBJ_TRACK_MOTION_MODEL_030}, {implementation-record-element=OBJ_VEH_TRACK_FLAG_001, system-signal=OBJ_VEH_TRACK_FLAG_030}, {implementation-record-element=OBJ_VELOCITY_ERR_CRR_COEF_001, system-signal=OBJ_VELOCITY_ERR_CRR_COEF_030}, {implementation-record-element=OBJ_DIMENSION_WIDTH_001, system-signal=OBJ_DIMENSION_WIDTH_030}, {implementation-record-element=OBJ_VELOCITY_LONG_ERR_001, system-signal=OBJ_VELOCITY_LONG_ERR_030}, {implementation-record-element=OBJ_YAW_ANGLE_ERR_001, system-signal=OBJ_YAW_ANGLE_ERR_030}, {implementation-record-element=OBJ_YAW_ANGLE_001, system-signal=OBJ_YAW_ANGLE_030}, {implementation-record-element=OBJ_VELOCITY_LAT_ERR_001, system-signal=OBJ_VELOCITY_LAT_ERR_030}, {implementation-record-element=OBJ_VELOCITY_LONG_001, system-signal=OBJ_VELOCITY_LONG_030}, {implementation-record-element=OBJ_POS_LAT_001, system-signal=OBJ_POS_LAT_030}, {implementation-record-element=OBJ_YAW_RATE_ERR_001, system-signal=OBJ_YAW_RATE_ERR_030}, {implementation-record-element=OBJ_POS_LONG_ERR_001, system-signal=OBJ_POS_LONG_ERR_030}, {implementation-record-element=OBJ_DIMENSION_WIDTH_ERR_001, system-signal=OBJ_DIMENSION_WIDTH_ERR_030}, {implementation-record-element=OBJ_YAW_RATE_001, system-signal=OBJ_YAW_RATE_030}, {implementation-record-element=OBJ_CLS_TYPE6_PROB_001, system-signal=OBJ_CLS_TYPE6_PROB_030}, {implementation-record-element=OBJ_DIMENSION_LENGTH_001, system-signal=OBJ_DIMENSION_LENGTH_030}, {implementation-record-element=OBJ_DIMENSION_LENGTH_ERR_001, system-signal=OBJ_DIMENSION_LENGTH_ERR_030}, {implementation-record-element=OBJ_POS_LAT_ERR_001, system-signal=OBJ_POS_LAT_ERR_030}, {implementation-record-element=OBJ_VELOCITY_LAT_001, system-signal=OBJ_VELOCITY_LAT_030}, {implementation-record-element=OBJ_POS_LONG_001, system-signal=OBJ_POS_LONG_030}, {implementation-record-element=OBJ_ACCELERATION_LAT_001, system-signal=OBJ_ACCELERATION_LAT_030}, {implementation-record-element=OBJ_ACCELERATION_LAT_ERR_001, system-signal=OBJ_ACCELERATION_LAT_ERR_030}, {implementation-record-element=OBJ_ACCELERATION_LONG_ERR_001, system-signal=OBJ_ACCELERATION_LONG_ERR_030}, {implementation-record-element=OBJ_ACCELERATION_LONG_001, system-signal=OBJ_ACCELERATION_LONG_030}, {implementation-record-element=OBJ_CLS_TYPE2_001, system-signal=OBJ_CLS_TYPE2_030}, {implementation-record-element=OBJ_CLS_TYPE2_PROB_001, system-signal=OBJ_CLS_TYPE2_PROB_030}, {implementation-record-element=OBJ_CLS_TYPE4_PROB_001, system-signal=OBJ_CLS_TYPE4_PROB_030}, {implementation-record-element=OBJ_CLS_TYPE5_001, system-signal=OBJ_CLS_TYPE5_030}, {implementation-record-element=OBJ_CLS_TYPE6_001, system-signal=OBJ_CLS_TYPE6_030}, {implementation-record-element=OBJ_CLS_TYPE1_001, system-signal=OBJ_CLS_TYPE1_030}, {implementation-record-element=OBJ_CLS_TYPE1_PROB_001, system-signal=OBJ_CLS_TYPE1_PROB_030}, {implementation-record-element=OBJ_CLS_TYPE3_PROB_001, system-signal=OBJ_CLS_TYPE3_PROB_030}, {implementation-record-element=OBJ_CLS_TYPE4_001, system-signal=OBJ_CLS_TYPE4_030}, {implementation-record-element=OBJ_CLS_TYPE5_PROB_001, system-signal=OBJ_CLS_TYPE5_PROB_030}, {implementation-record-element=OBJ_CLS_TYPE3_001, system-signal=OBJ_CLS_TYPE3_030}]}
        sender-receiver-to-signal-group-mapping={data-element=COMPOSITIONTYPE.Pp_SG_TrackerObject031.Vdp_SG_TrackerObject031, signal-group=SG_TrackerObject031, type-mapping=sender-rec-record-type-mapping=record-element-mappings=[{implementation-record-element=OBJ_ACCEL_ERR_CRR_COEF_001, system-signal=OBJ_ACCEL_ERR_CRR_COEF_031}, {implementation-record-element=OBJ_ALIVE_TIME_001, system-signal=OBJ_ALIVE_TIME_031}, {implementation-record-element=OBJ_EXISTENCE_PROB_001, system-signal=OBJ_EXISTENCE_PROB_031}, {implementation-record-element=OBJ_GROUP_ID_001, system-signal=OBJ_GROUP_ID_031}, {implementation-record-element=OBJ_ID_001, system-signal=OBJ_ID_031}, {implementation-record-element=OBJ_MEASUREMENT_STATUS_001, system-signal=OBJ_MEASUREMENT_STATUS_031}, {implementation-record-element=OBJ_MH_CRC16_001, system-signal=OBJ_MH_CRC16_031}, {implementation-record-element=OBJ_MH_CYCLE_COUNTER_001, system-signal=OBJ_MH_CYCLE_COUNTER_031}, {implementation-record-element=OBJ_MOVEMENT_STATUS_001, system-signal=OBJ_MOVEMENT_STATUS_031}, {implementation-record-element=OBJ_POS_ERR_CRR_COEF_001, system-signal=OBJ_POS_ERR_CRR_COEF_031}, {implementation-record-element=OBJ_RCS_001, system-signal=OBJ_RCS_031}, {implementation-record-element=OBJ_REF_PT_LAT_OFFSET_001, system-signal=OBJ_REF_PT_LAT_OFFSET_031}, {implementation-record-element=OBJ_REF_PT_LONG_OFFSET_001, system-signal=OBJ_REF_PT_LONG_OFFSET_031}, {implementation-record-element=OBJ_TIMESTAMP_OFFSET_001, system-signal=OBJ_TIMESTAMP_OFFSET_031}, {implementation-record-element=OBJ_TRACK_MOTION_MODEL_001, system-signal=OBJ_TRACK_MOTION_MODEL_031}, {implementation-record-element=OBJ_VEH_TRACK_FLAG_001, system-signal=OBJ_VEH_TRACK_FLAG_031}, {implementation-record-element=OBJ_VELOCITY_ERR_CRR_COEF_001, system-signal=OBJ_VELOCITY_ERR_CRR_COEF_031}, {implementation-record-element=OBJ_POS_LAT_001, system-signal=OBJ_POS_LAT_031}, {implementation-record-element=OBJ_ACCELERATION_LAT_001, system-signal=OBJ_ACCELERATION_LAT_031}, {implementation-record-element=OBJ_CLS_TYPE1_PROB_001, system-signal=OBJ_CLS_TYPE1_PROB_031}, {implementation-record-element=OBJ_CLS_TYPE2_001, system-signal=OBJ_CLS_TYPE2_031}, {implementation-record-element=OBJ_CLS_TYPE3_PROB_001, system-signal=OBJ_CLS_TYPE3_PROB_031}, {implementation-record-element=OBJ_CLS_TYPE6_001, system-signal=OBJ_CLS_TYPE6_031}, {implementation-record-element=OBJ_CLS_TYPE2_PROB_001, system-signal=OBJ_CLS_TYPE2_PROB_031}, {implementation-record-element=OBJ_CLS_TYPE1_001, system-signal=OBJ_CLS_TYPE1_031}, {implementation-record-element=OBJ_CLS_TYPE4_PROB_001, system-signal=OBJ_CLS_TYPE4_PROB_031}, {implementation-record-element=OBJ_ACCELERATION_LONG_001, system-signal=OBJ_ACCELERATION_LONG_031}, {implementation-record-element=OBJ_CLS_TYPE4_001, system-signal=OBJ_CLS_TYPE4_031}, {implementation-record-element=OBJ_DIMENSION_LENGTH_ERR_001, system-signal=OBJ_DIMENSION_LENGTH_ERR_031}, {implementation-record-element=OBJ_CLS_TYPE3_001, system-signal=OBJ_CLS_TYPE3_031}, {implementation-record-element=OBJ_DIMENSION_LENGTH_001, system-signal=OBJ_DIMENSION_LENGTH_031}, {implementation-record-element=OBJ_ACCELERATION_LAT_ERR_001, system-signal=OBJ_ACCELERATION_LAT_ERR_031}, {implementation-record-element=OBJ_DIMENSION_WIDTH_001, system-signal=OBJ_DIMENSION_WIDTH_031}, {implementation-record-element=OBJ_DIMENSION_WIDTH_ERR_001, system-signal=OBJ_DIMENSION_WIDTH_ERR_031}, {implementation-record-element=OBJ_ACCELERATION_LONG_ERR_001, system-signal=OBJ_ACCELERATION_LONG_ERR_031}, {implementation-record-element=OBJ_CLS_TYPE5_001, system-signal=OBJ_CLS_TYPE5_031}, {implementation-record-element=OBJ_CLS_TYPE5_PROB_001, system-signal=OBJ_CLS_TYPE5_PROB_031}, {implementation-record-element=OBJ_CLS_TYPE6_PROB_001, system-signal=OBJ_CLS_TYPE6_PROB_031}, {implementation-record-element=OBJ_VELOCITY_LAT_001, system-signal=OBJ_VELOCITY_LAT_031}, {implementation-record-element=OBJ_YAW_RATE_001, system-signal=OBJ_YAW_RATE_031}, {implementation-record-element=OBJ_YAW_RATE_ERR_001, system-signal=OBJ_YAW_RATE_ERR_031}, {implementation-record-element=OBJ_POS_LAT_ERR_001, system-signal=OBJ_POS_LAT_ERR_031}, {implementation-record-element=OBJ_VELOCITY_LONG_001, system-signal=OBJ_VELOCITY_LONG_031}, {implementation-record-element=OBJ_VELOCITY_LAT_ERR_001, system-signal=OBJ_VELOCITY_LAT_ERR_031}, {implementation-record-element=OBJ_VELOCITY_LONG_ERR_001, system-signal=OBJ_VELOCITY_LONG_ERR_031}, {implementation-record-element=OBJ_YAW_ANGLE_ERR_001, system-signal=OBJ_YAW_ANGLE_ERR_031}, {implementation-record-element=OBJ_POS_LONG_ERR_001, system-signal=OBJ_POS_LONG_ERR_031}, {implementation-record-element=OBJ_POS_LONG_001, system-signal=OBJ_POS_LONG_031}, {implementation-record-element=OBJ_YAW_ANGLE_001, system-signal=OBJ_YAW_ANGLE_031}]}
        sender-receiver-to-signal-group-mapping={data-element=COMPOSITIONTYPE.Pp_SG_TrackerObject032.Vdp_SG_TrackerObject032, signal-group=SG_TrackerObject032, type-mapping=sender-rec-record-type-mapping=record-element-mappings=[{implementation-record-element=OBJ_ACCEL_ERR_CRR_COEF_001, system-signal=OBJ_ACCEL_ERR_CRR_COEF_032}, {implementation-record-element=OBJ_ALIVE_TIME_001, system-signal=OBJ_ALIVE_TIME_032}, {implementation-record-element=OBJ_EXISTENCE_PROB_001, system-signal=OBJ_EXISTENCE_PROB_032}, {implementation-record-element=OBJ_GROUP_ID_001, system-signal=OBJ_GROUP_ID_032}, {implementation-record-element=OBJ_ID_001, system-signal=OBJ_ID_032}, {implementation-record-element=OBJ_MEASUREMENT_STATUS_001, system-signal=OBJ_MEASUREMENT_STATUS_032}, {implementation-record-element=OBJ_MH_CRC16_001, system-signal=OBJ_MH_CRC16_032}, {implementation-record-element=OBJ_MH_CYCLE_COUNTER_001, system-signal=OBJ_MH_CYCLE_COUNTER_032}, {implementation-record-element=OBJ_MOVEMENT_STATUS_001, system-signal=OBJ_MOVEMENT_STATUS_032}, {implementation-record-element=OBJ_POS_ERR_CRR_COEF_001, system-signal=OBJ_POS_ERR_CRR_COEF_032}, {implementation-record-element=OBJ_RCS_001, system-signal=OBJ_RCS_032}, {implementation-record-element=OBJ_REF_PT_LAT_OFFSET_001, system-signal=OBJ_REF_PT_LAT_OFFSET_032}, {implementation-record-element=OBJ_REF_PT_LONG_OFFSET_001, system-signal=OBJ_REF_PT_LONG_OFFSET_032}, {implementation-record-element=OBJ_TIMESTAMP_OFFSET_001, system-signal=OBJ_TIMESTAMP_OFFSET_032}, {implementation-record-element=OBJ_TRACK_MOTION_MODEL_001, system-signal=OBJ_TRACK_MOTION_MODEL_032}, {implementation-record-element=OBJ_VEH_TRACK_FLAG_001, system-signal=OBJ_VEH_TRACK_FLAG_032}, {implementation-record-element=OBJ_VELOCITY_ERR_CRR_COEF_001, system-signal=OBJ_VELOCITY_ERR_CRR_COEF_032}, {implementation-record-element=OBJ_DIMENSION_LENGTH_ERR_001, system-signal=OBJ_DIMENSION_LENGTH_ERR_032}, {implementation-record-element=OBJ_CLS_TYPE2_001, system-signal=OBJ_CLS_TYPE2_032}, {implementation-record-element=OBJ_CLS_TYPE2_PROB_001, system-signal=OBJ_CLS_TYPE2_PROB_032}, {implementation-record-element=OBJ_CLS_TYPE3_001, system-signal=OBJ_CLS_TYPE3_032}, {implementation-record-element=OBJ_CLS_TYPE6_001, system-signal=OBJ_CLS_TYPE6_032}, {implementation-record-element=OBJ_POS_LONG_001, system-signal=OBJ_POS_LONG_032}, {implementation-record-element=OBJ_DIMENSION_WIDTH_ERR_001, system-signal=OBJ_DIMENSION_WIDTH_ERR_032}, {implementation-record-element=OBJ_DIMENSION_WIDTH_001, system-signal=OBJ_DIMENSION_WIDTH_032}, {implementation-record-element=OBJ_VELOCITY_LAT_001, system-signal=OBJ_VELOCITY_LAT_032}, {implementation-record-element=OBJ_VELOCITY_LAT_ERR_001, system-signal=OBJ_VELOCITY_LAT_ERR_032}, {implementation-record-element=OBJ_CLS_TYPE4_PROB_001, system-signal=OBJ_CLS_TYPE4_PROB_032}, {implementation-record-element=OBJ_DIMENSION_LENGTH_001, system-signal=OBJ_DIMENSION_LENGTH_032}, {implementation-record-element=OBJ_ACCELERATION_LAT_ERR_001, system-signal=OBJ_ACCELERATION_LAT_ERR_032}, {implementation-record-element=OBJ_CLS_TYPE4_001, system-signal=OBJ_CLS_TYPE4_032}, {implementation-record-element=OBJ_POS_LONG_ERR_001, system-signal=OBJ_POS_LONG_ERR_032}, {implementation-record-element=OBJ_VELOCITY_LONG_001, system-signal=OBJ_VELOCITY_LONG_032}, {implementation-record-element=OBJ_VELOCITY_LONG_ERR_001, system-signal=OBJ_VELOCITY_LONG_ERR_032}, {implementation-record-element=OBJ_ACCELERATION_LONG_ERR_001, system-signal=OBJ_ACCELERATION_LONG_ERR_032}, {implementation-record-element=OBJ_CLS_TYPE1_001, system-signal=OBJ_CLS_TYPE1_032}, {implementation-record-element=OBJ_ACCELERATION_LONG_001, system-signal=OBJ_ACCELERATION_LONG_032}, {implementation-record-element=OBJ_POS_LAT_001, system-signal=OBJ_POS_LAT_032}, {implementation-record-element=OBJ_CLS_TYPE1_PROB_001, system-signal=OBJ_CLS_TYPE1_PROB_032}, {implementation-record-element=OBJ_ACCELERATION_LAT_001, system-signal=OBJ_ACCELERATION_LAT_032}, {implementation-record-element=OBJ_CLS_TYPE5_001, system-signal=OBJ_CLS_TYPE5_032}, {implementation-record-element=OBJ_CLS_TYPE6_PROB_001, system-signal=OBJ_CLS_TYPE6_PROB_032}, {implementation-record-element=OBJ_POS_LAT_ERR_001, system-signal=OBJ_POS_LAT_ERR_032}, {implementation-record-element=OBJ_CLS_TYPE5_PROB_001, system-signal=OBJ_CLS_TYPE5_PROB_032}, {implementation-record-element=OBJ_CLS_TYPE3_PROB_001, system-signal=OBJ_CLS_TYPE3_PROB_032}, {implementation-record-element=OBJ_YAW_ANGLE_001, system-signal=OBJ_YAW_ANGLE_032}, {implementation-record-element=OBJ_YAW_ANGLE_ERR_001, system-signal=OBJ_YAW_ANGLE_ERR_032}, {implementation-record-element=OBJ_YAW_RATE_ERR_001, system-signal=OBJ_YAW_RATE_ERR_032}, {implementation-record-element=OBJ_YAW_RATE_001, system-signal=OBJ_YAW_RATE_032}]}
        sender-receiver-to-signal-group-mapping={data-element=COMPOSITIONTYPE.Pp_SG_TrackerObject033.Vdp_SG_TrackerObject033, signal-group=SG_TrackerObject033, type-mapping=sender-rec-record-type-mapping=record-element-mappings=[{implementation-record-element=OBJ_ACCEL_ERR_CRR_COEF_001, system-signal=OBJ_ACCEL_ERR_CRR_COEF_033}, {implementation-record-element=OBJ_ALIVE_TIME_001, system-signal=OBJ_ALIVE_TIME_033}, {implementation-record-element=OBJ_EXISTENCE_PROB_001, system-signal=OBJ_EXISTENCE_PROB_033}, {implementation-record-element=OBJ_GROUP_ID_001, system-signal=OBJ_GROUP_ID_033}, {implementation-record-element=OBJ_ID_001, system-signal=OBJ_ID_033}, {implementation-record-element=OBJ_MEASUREMENT_STATUS_001, system-signal=OBJ_MEASUREMENT_STATUS_033}, {implementation-record-element=OBJ_MH_CRC16_001, system-signal=OBJ_MH_CRC16_033}, {implementation-record-element=OBJ_MH_CYCLE_COUNTER_001, system-signal=OBJ_MH_CYCLE_COUNTER_033}, {implementation-record-element=OBJ_MOVEMENT_STATUS_001, system-signal=OBJ_MOVEMENT_STATUS_033}, {implementation-record-element=OBJ_POS_ERR_CRR_COEF_001, system-signal=OBJ_POS_ERR_CRR_COEF_033}, {implementation-record-element=OBJ_RCS_001, system-signal=OBJ_RCS_033}, {implementation-record-element=OBJ_REF_PT_LAT_OFFSET_001, system-signal=OBJ_REF_PT_LAT_OFFSET_033}, {implementation-record-element=OBJ_REF_PT_LONG_OFFSET_001, system-signal=OBJ_REF_PT_LONG_OFFSET_033}, {implementation-record-element=OBJ_TIMESTAMP_OFFSET_001, system-signal=OBJ_TIMESTAMP_OFFSET_033}, {implementation-record-element=OBJ_TRACK_MOTION_MODEL_001, system-signal=OBJ_TRACK_MOTION_MODEL_033}, {implementation-record-element=OBJ_VEH_TRACK_FLAG_001, system-signal=OBJ_VEH_TRACK_FLAG_033}, {implementation-record-element=OBJ_VELOCITY_ERR_CRR_COEF_001, system-signal=OBJ_VELOCITY_ERR_CRR_COEF_033}, {implementation-record-element=OBJ_CLS_TYPE1_PROB_001, system-signal=OBJ_CLS_TYPE1_PROB_033}, {implementation-record-element=OBJ_CLS_TYPE5_PROB_001, system-signal=OBJ_CLS_TYPE5_PROB_033}, {implementation-record-element=OBJ_POS_LAT_ERR_001, system-signal=OBJ_POS_LAT_ERR_033}, {implementation-record-element=OBJ_YAW_RATE_ERR_001, system-signal=OBJ_YAW_RATE_ERR_033}, {implementation-record-element=OBJ_CLS_TYPE1_001, system-signal=OBJ_CLS_TYPE1_033}, {implementation-record-element=OBJ_CLS_TYPE3_001, system-signal=OBJ_CLS_TYPE3_033}, {implementation-record-element=OBJ_VELOCITY_LONG_001, system-signal=OBJ_VELOCITY_LONG_033}, {implementation-record-element=OBJ_ACCELERATION_LONG_ERR_001, system-signal=OBJ_ACCELERATION_LONG_ERR_033}, {implementation-record-element=OBJ_ACCELERATION_LAT_001, system-signal=OBJ_ACCELERATION_LAT_033}, {implementation-record-element=OBJ_CLS_TYPE4_PROB_001, system-signal=OBJ_CLS_TYPE4_PROB_033}, {implementation-record-element=OBJ_CLS_TYPE5_001, system-signal=OBJ_CLS_TYPE5_033}, {implementation-record-element=OBJ_POS_LONG_ERR_001, system-signal=OBJ_POS_LONG_ERR_033}, {implementation-record-element=OBJ_CLS_TYPE2_001, system-signal=OBJ_CLS_TYPE2_033}, {implementation-record-element=OBJ_YAW_ANGLE_001, system-signal=OBJ_YAW_ANGLE_033}, {implementation-record-element=OBJ_CLS_TYPE3_PROB_001, system-signal=OBJ_CLS_TYPE3_PROB_033}, {implementation-record-element=OBJ_POS_LAT_001, system-signal=OBJ_POS_LAT_033}, {implementation-record-element=OBJ_ACCELERATION_LONG_001, system-signal=OBJ_ACCELERATION_LONG_033}, {implementation-record-element=OBJ_YAW_RATE_001, system-signal=OBJ_YAW_RATE_033}, {implementation-record-element=OBJ_ACCELERATION_LAT_ERR_001, system-signal=OBJ_ACCELERATION_LAT_ERR_033}, {implementation-record-element=OBJ_DIMENSION_WIDTH_ERR_001, system-signal=OBJ_DIMENSION_WIDTH_ERR_033}, {implementation-record-element=OBJ_CLS_TYPE4_001, system-signal=OBJ_CLS_TYPE4_033}, {implementation-record-element=OBJ_CLS_TYPE6_001, system-signal=OBJ_CLS_TYPE6_033}, {implementation-record-element=OBJ_CLS_TYPE6_PROB_001, system-signal=OBJ_CLS_TYPE6_PROB_033}, {implementation-record-element=OBJ_DIMENSION_LENGTH_001, system-signal=OBJ_DIMENSION_LENGTH_033}, {implementation-record-element=OBJ_DIMENSION_WIDTH_001, system-signal=OBJ_DIMENSION_WIDTH_033}, {implementation-record-element=OBJ_CLS_TYPE2_PROB_001, system-signal=OBJ_CLS_TYPE2_PROB_033}, {implementation-record-element=OBJ_POS_LONG_001, system-signal=OBJ_POS_LONG_033}, {implementation-record-element=OBJ_DIMENSION_LENGTH_ERR_001, system-signal=OBJ_DIMENSION_LENGTH_ERR_033}, {implementation-record-element=OBJ_VELOCITY_LAT_ERR_001, system-signal=OBJ_VELOCITY_LAT_ERR_033}, {implementation-record-element=OBJ_VELOCITY_LONG_ERR_001, system-signal=OBJ_VELOCITY_LONG_ERR_033}, {implementation-record-element=OBJ_VELOCITY_LAT_001, system-signal=OBJ_VELOCITY_LAT_033}, {implementation-record-element=OBJ_YAW_ANGLE_ERR_001, system-signal=OBJ_YAW_ANGLE_ERR_033}]}
        sender-receiver-to-signal-group-mapping={data-element=COMPOSITIONTYPE.Pp_SG_TrackerObject034.Vdp_SG_TrackerObject034, signal-group=SG_TrackerObject034, type-mapping=sender-rec-record-type-mapping=record-element-mappings=[{implementation-record-element=OBJ_ACCEL_ERR_CRR_COEF_001, system-signal=OBJ_ACCEL_ERR_CRR_COEF_034}, {implementation-record-element=OBJ_ALIVE_TIME_001, system-signal=OBJ_ALIVE_TIME_034}, {implementation-record-element=OBJ_EXISTENCE_PROB_001, system-signal=OBJ_EXISTENCE_PROB_034}, {implementation-record-element=OBJ_GROUP_ID_001, system-signal=OBJ_GROUP_ID_034}, {implementation-record-element=OBJ_ID_001, system-signal=OBJ_ID_034}, {implementation-record-element=OBJ_MEASUREMENT_STATUS_001, system-signal=OBJ_MEASUREMENT_STATUS_034}, {implementation-record-element=OBJ_MH_CRC16_001, system-signal=OBJ_MH_CRC16_034}, {implementation-record-element=OBJ_MH_CYCLE_COUNTER_001, system-signal=OBJ_MH_CYCLE_COUNTER_034}, {implementation-record-element=OBJ_MOVEMENT_STATUS_001, system-signal=OBJ_MOVEMENT_STATUS_034}, {implementation-record-element=OBJ_POS_ERR_CRR_COEF_001, system-signal=OBJ_POS_ERR_CRR_COEF_034}, {implementation-record-element=OBJ_RCS_001, system-signal=OBJ_RCS_034}, {implementation-record-element=OBJ_REF_PT_LAT_OFFSET_001, system-signal=OBJ_REF_PT_LAT_OFFSET_034}, {implementation-record-element=OBJ_REF_PT_LONG_OFFSET_001, system-signal=OBJ_REF_PT_LONG_OFFSET_034}, {implementation-record-element=OBJ_TIMESTAMP_OFFSET_001, system-signal=OBJ_TIMESTAMP_OFFSET_034}, {implementation-record-element=OBJ_TRACK_MOTION_MODEL_001, system-signal=OBJ_TRACK_MOTION_MODEL_034}, {implementation-record-element=OBJ_VEH_TRACK_FLAG_001, system-signal=OBJ_VEH_TRACK_FLAG_034}, {implementation-record-element=OBJ_VELOCITY_ERR_CRR_COEF_001, system-signal=OBJ_VELOCITY_ERR_CRR_COEF_034}, {implementation-record-element=OBJ_ACCELERATION_LAT_ERR_001, system-signal=OBJ_ACCELERATION_LAT_ERR_034}, {implementation-record-element=OBJ_ACCELERATION_LONG_001, system-signal=OBJ_ACCELERATION_LONG_034}, {implementation-record-element=OBJ_ACCELERATION_LONG_ERR_001, system-signal=OBJ_ACCELERATION_LONG_ERR_034}, {implementation-record-element=OBJ_CLS_TYPE1_001, system-signal=OBJ_CLS_TYPE1_034}, {implementation-record-element=OBJ_CLS_TYPE1_PROB_001, system-signal=OBJ_CLS_TYPE1_PROB_034}, {implementation-record-element=OBJ_CLS_TYPE2_001, system-signal=OBJ_CLS_TYPE2_034}, {implementation-record-element=OBJ_ACCELERATION_LAT_001, system-signal=OBJ_ACCELERATION_LAT_034}, {implementation-record-element=OBJ_CLS_TYPE5_PROB_001, system-signal=OBJ_CLS_TYPE5_PROB_034}, {implementation-record-element=OBJ_VELOCITY_LAT_001, system-signal=OBJ_VELOCITY_LAT_034}, {implementation-record-element=OBJ_YAW_ANGLE_ERR_001, system-signal=OBJ_YAW_ANGLE_ERR_034}, {implementation-record-element=OBJ_DIMENSION_WIDTH_001, system-signal=OBJ_DIMENSION_WIDTH_034}, {implementation-record-element=OBJ_VELOCITY_LONG_ERR_001, system-signal=OBJ_VELOCITY_LONG_ERR_034}, {implementation-record-element=OBJ_YAW_RATE_001, system-signal=OBJ_YAW_RATE_034}, {implementation-record-element=OBJ_CLS_TYPE2_PROB_001, system-signal=OBJ_CLS_TYPE2_PROB_034}, {implementation-record-element=OBJ_CLS_TYPE3_001, system-signal=OBJ_CLS_TYPE3_034}, {implementation-record-element=OBJ_POS_LONG_ERR_001, system-signal=OBJ_POS_LONG_ERR_034}, {implementation-record-element=OBJ_POS_LONG_001, system-signal=OBJ_POS_LONG_034}, {implementation-record-element=OBJ_CLS_TYPE6_001, system-signal=OBJ_CLS_TYPE6_034}, {implementation-record-element=OBJ_DIMENSION_LENGTH_001, system-signal=OBJ_DIMENSION_LENGTH_034}, {implementation-record-element=OBJ_CLS_TYPE4_001, system-signal=OBJ_CLS_TYPE4_034}, {implementation-record-element=OBJ_CLS_TYPE4_PROB_001, system-signal=OBJ_CLS_TYPE4_PROB_034}, {implementation-record-element=OBJ_CLS_TYPE5_001, system-signal=OBJ_CLS_TYPE5_034}, {implementation-record-element=OBJ_YAW_RATE_ERR_001, system-signal=OBJ_YAW_RATE_ERR_034}, {implementation-record-element=OBJ_DIMENSION_WIDTH_ERR_001, system-signal=OBJ_DIMENSION_WIDTH_ERR_034}, {implementation-record-element=OBJ_POS_LAT_001, system-signal=OBJ_POS_LAT_034}, {implementation-record-element=OBJ_POS_LAT_ERR_001, system-signal=OBJ_POS_LAT_ERR_034}, {implementation-record-element=OBJ_YAW_ANGLE_001, system-signal=OBJ_YAW_ANGLE_034}, {implementation-record-element=OBJ_CLS_TYPE3_PROB_001, system-signal=OBJ_CLS_TYPE3_PROB_034}, {implementation-record-element=OBJ_VELOCITY_LAT_ERR_001, system-signal=OBJ_VELOCITY_LAT_ERR_034}, {implementation-record-element=OBJ_DIMENSION_LENGTH_ERR_001, system-signal=OBJ_DIMENSION_LENGTH_ERR_034}, {implementation-record-element=OBJ_VELOCITY_LONG_001, system-signal=OBJ_VELOCITY_LONG_034}, {implementation-record-element=OBJ_CLS_TYPE6_PROB_001, system-signal=OBJ_CLS_TYPE6_PROB_034}]}
        sender-receiver-to-signal-group-mapping={data-element=COMPOSITIONTYPE.Pp_SG_TrackerObject035.Vdp_SG_TrackerObject035, signal-group=SG_TrackerObject035, type-mapping=sender-rec-record-type-mapping=record-element-mappings=[{implementation-record-element=OBJ_ACCEL_ERR_CRR_COEF_001, system-signal=OBJ_ACCEL_ERR_CRR_COEF_035}, {implementation-record-element=OBJ_ALIVE_TIME_001, system-signal=OBJ_ALIVE_TIME_035}, {implementation-record-element=OBJ_EXISTENCE_PROB_001, system-signal=OBJ_EXISTENCE_PROB_035}, {implementation-record-element=OBJ_GROUP_ID_001, system-signal=OBJ_GROUP_ID_035}, {implementation-record-element=OBJ_ID_001, system-signal=OBJ_ID_035}, {implementation-record-element=OBJ_MEASUREMENT_STATUS_001, system-signal=OBJ_MEASUREMENT_STATUS_035}, {implementation-record-element=OBJ_MH_CRC16_001, system-signal=OBJ_MH_CRC16_035}, {implementation-record-element=OBJ_MH_CYCLE_COUNTER_001, system-signal=OBJ_MH_CYCLE_COUNTER_035}, {implementation-record-element=OBJ_MOVEMENT_STATUS_001, system-signal=OBJ_MOVEMENT_STATUS_035}, {implementation-record-element=OBJ_POS_ERR_CRR_COEF_001, system-signal=OBJ_POS_ERR_CRR_COEF_035}, {implementation-record-element=OBJ_RCS_001, system-signal=OBJ_RCS_035}, {implementation-record-element=OBJ_REF_PT_LAT_OFFSET_001, system-signal=OBJ_REF_PT_LAT_OFFSET_035}, {implementation-record-element=OBJ_REF_PT_LONG_OFFSET_001, system-signal=OBJ_REF_PT_LONG_OFFSET_035}, {implementation-record-element=OBJ_TIMESTAMP_OFFSET_001, system-signal=OBJ_TIMESTAMP_OFFSET_035}, {implementation-record-element=OBJ_TRACK_MOTION_MODEL_001, system-signal=OBJ_TRACK_MOTION_MODEL_035}, {implementation-record-element=OBJ_VEH_TRACK_FLAG_001, system-signal=OBJ_VEH_TRACK_FLAG_035}, {implementation-record-element=OBJ_VELOCITY_ERR_CRR_COEF_001, system-signal=OBJ_VELOCITY_ERR_CRR_COEF_035}, {implementation-record-element=OBJ_CLS_TYPE1_PROB_001, system-signal=OBJ_CLS_TYPE1_PROB_035}, {implementation-record-element=OBJ_CLS_TYPE2_001, system-signal=OBJ_CLS_TYPE2_035}, {implementation-record-element=OBJ_CLS_TYPE2_PROB_001, system-signal=OBJ_CLS_TYPE2_PROB_035}, {implementation-record-element=OBJ_CLS_TYPE3_001, system-signal=OBJ_CLS_TYPE3_035}, {implementation-record-element=OBJ_CLS_TYPE3_PROB_001, system-signal=OBJ_CLS_TYPE3_PROB_035}, {implementation-record-element=OBJ_CLS_TYPE4_PROB_001, system-signal=OBJ_CLS_TYPE4_PROB_035}, {implementation-record-element=OBJ_CLS_TYPE5_001, system-signal=OBJ_CLS_TYPE5_035}, {implementation-record-element=OBJ_CLS_TYPE6_001, system-signal=OBJ_CLS_TYPE6_035}, {implementation-record-element=OBJ_CLS_TYPE6_PROB_001, system-signal=OBJ_CLS_TYPE6_PROB_035}, {implementation-record-element=OBJ_DIMENSION_LENGTH_001, system-signal=OBJ_DIMENSION_LENGTH_035}, {implementation-record-element=OBJ_DIMENSION_LENGTH_ERR_001, system-signal=OBJ_DIMENSION_LENGTH_ERR_035}, {implementation-record-element=OBJ_ACCELERATION_LONG_001, system-signal=OBJ_ACCELERATION_LONG_035}, {implementation-record-element=OBJ_DIMENSION_WIDTH_001, system-signal=OBJ_DIMENSION_WIDTH_035}, {implementation-record-element=OBJ_DIMENSION_WIDTH_ERR_001, system-signal=OBJ_DIMENSION_WIDTH_ERR_035}, {implementation-record-element=OBJ_CLS_TYPE4_001, system-signal=OBJ_CLS_TYPE4_035}, {implementation-record-element=OBJ_CLS_TYPE5_PROB_001, system-signal=OBJ_CLS_TYPE5_PROB_035}, {implementation-record-element=OBJ_ACCELERATION_LAT_001, system-signal=OBJ_ACCELERATION_LAT_035}, {implementation-record-element=OBJ_ACCELERATION_LONG_ERR_001, system-signal=OBJ_ACCELERATION_LONG_ERR_035}, {implementation-record-element=OBJ_ACCELERATION_LAT_ERR_001, system-signal=OBJ_ACCELERATION_LAT_ERR_035}, {implementation-record-element=OBJ_CLS_TYPE1_001, system-signal=OBJ_CLS_TYPE1_035}, {implementation-record-element=OBJ_POS_LONG_001, system-signal=OBJ_POS_LONG_035}, {implementation-record-element=OBJ_VELOCITY_LONG_ERR_001, system-signal=OBJ_VELOCITY_LONG_ERR_035}, {implementation-record-element=OBJ_VELOCITY_LONG_001, system-signal=OBJ_VELOCITY_LONG_035}, {implementation-record-element=OBJ_VELOCITY_LAT_001, system-signal=OBJ_VELOCITY_LAT_035}, {implementation-record-element=OBJ_POS_LAT_ERR_001, system-signal=OBJ_POS_LAT_ERR_035}, {implementation-record-element=OBJ_POS_LONG_ERR_001, system-signal=OBJ_POS_LONG_ERR_035}, {implementation-record-element=OBJ_YAW_ANGLE_001, system-signal=OBJ_YAW_ANGLE_035}, {implementation-record-element=OBJ_YAW_ANGLE_ERR_001, system-signal=OBJ_YAW_ANGLE_ERR_035}, {implementation-record-element=OBJ_YAW_RATE_001, system-signal=OBJ_YAW_RATE_035}, {implementation-record-element=OBJ_POS_LAT_001, system-signal=OBJ_POS_LAT_035}, {implementation-record-element=OBJ_VELOCITY_LAT_ERR_001, system-signal=OBJ_VELOCITY_LAT_ERR_035}, {implementation-record-element=OBJ_YAW_RATE_ERR_001, system-signal=OBJ_YAW_RATE_ERR_035}]}
        sender-receiver-to-signal-group-mapping={data-element=COMPOSITIONTYPE.Pp_SG_TrackerObject036.Vdp_SG_TrackerObject036, signal-group=SG_TrackerObject036, type-mapping=sender-rec-record-type-mapping=record-element-mappings=[{implementation-record-element=OBJ_ACCEL_ERR_CRR_COEF_001, system-signal=OBJ_ACCEL_ERR_CRR_COEF_036}, {implementation-record-element=OBJ_ALIVE_TIME_001, system-signal=OBJ_ALIVE_TIME_036}, {implementation-record-element=OBJ_EXISTENCE_PROB_001, system-signal=OBJ_EXISTENCE_PROB_036}, {implementation-record-element=OBJ_GROUP_ID_001, system-signal=OBJ_GROUP_ID_036}, {implementation-record-element=OBJ_ID_001, system-signal=OBJ_ID_036}, {implementation-record-element=OBJ_MEASUREMENT_STATUS_001, system-signal=OBJ_MEASUREMENT_STATUS_036}, {implementation-record-element=OBJ_MH_CRC16_001, system-signal=OBJ_MH_CRC16_036}, {implementation-record-element=OBJ_MH_CYCLE_COUNTER_001, system-signal=OBJ_MH_CYCLE_COUNTER_036}, {implementation-record-element=OBJ_MOVEMENT_STATUS_001, system-signal=OBJ_MOVEMENT_STATUS_036}, {implementation-record-element=OBJ_POS_ERR_CRR_COEF_001, system-signal=OBJ_POS_ERR_CRR_COEF_036}, {implementation-record-element=OBJ_RCS_001, system-signal=OBJ_RCS_036}, {implementation-record-element=OBJ_REF_PT_LAT_OFFSET_001, system-signal=OBJ_REF_PT_LAT_OFFSET_036}, {implementation-record-element=OBJ_REF_PT_LONG_OFFSET_001, system-signal=OBJ_REF_PT_LONG_OFFSET_036}, {implementation-record-element=OBJ_TIMESTAMP_OFFSET_001, system-signal=OBJ_TIMESTAMP_OFFSET_036}, {implementation-record-element=OBJ_TRACK_MOTION_MODEL_001, system-signal=OBJ_TRACK_MOTION_MODEL_036}, {implementation-record-element=OBJ_VEH_TRACK_FLAG_001, system-signal=OBJ_VEH_TRACK_FLAG_036}, {implementation-record-element=OBJ_VELOCITY_ERR_CRR_COEF_001, system-signal=OBJ_VELOCITY_ERR_CRR_COEF_036}, {implementation-record-element=OBJ_CLS_TYPE3_001, system-signal=OBJ_CLS_TYPE3_036}, {implementation-record-element=OBJ_CLS_TYPE3_PROB_001, system-signal=OBJ_CLS_TYPE3_PROB_036}, {implementation-record-element=OBJ_CLS_TYPE2_001, system-signal=OBJ_CLS_TYPE2_036}, {implementation-record-element=OBJ_ACCELERATION_LAT_ERR_001, system-signal=OBJ_ACCELERATION_LAT_ERR_036}, {implementation-record-element=OBJ_ACCELERATION_LONG_001, system-signal=OBJ_ACCELERATION_LONG_036}, {implementation-record-element=OBJ_CLS_TYPE4_001, system-signal=OBJ_CLS_TYPE4_036}, {implementation-record-element=OBJ_POS_LAT_001, system-signal=OBJ_POS_LAT_036}, {implementation-record-element=OBJ_CLS_TYPE1_001, system-signal=OBJ_CLS_TYPE1_036}, {implementation-record-element=OBJ_DIMENSION_WIDTH_ERR_001, system-signal=OBJ_DIMENSION_WIDTH_ERR_036}, {implementation-record-element=OBJ_ACCELERATION_LONG_ERR_001, system-signal=OBJ_ACCELERATION_LONG_ERR_036}, {implementation-record-element=OBJ_ACCELERATION_LAT_001, system-signal=OBJ_ACCELERATION_LAT_036}, {implementation-record-element=OBJ_CLS_TYPE6_001, system-signal=OBJ_CLS_TYPE6_036}, {implementation-record-element=OBJ_CLS_TYPE6_PROB_001, system-signal=OBJ_CLS_TYPE6_PROB_036}, {implementation-record-element=OBJ_DIMENSION_LENGTH_ERR_001, system-signal=OBJ_DIMENSION_LENGTH_ERR_036}, {implementation-record-element=OBJ_DIMENSION_WIDTH_001, system-signal=OBJ_DIMENSION_WIDTH_036}, {implementation-record-element=OBJ_CLS_TYPE5_PROB_001, system-signal=OBJ_CLS_TYPE5_PROB_036}, {implementation-record-element=OBJ_DIMENSION_LENGTH_001, system-signal=OBJ_DIMENSION_LENGTH_036}, {implementation-record-element=OBJ_POS_LAT_ERR_001, system-signal=OBJ_POS_LAT_ERR_036}, {implementation-record-element=OBJ_POS_LONG_001, system-signal=OBJ_POS_LONG_036}, {implementation-record-element=OBJ_POS_LONG_ERR_001, system-signal=OBJ_POS_LONG_ERR_036}, {implementation-record-element=OBJ_CLS_TYPE2_PROB_001, system-signal=OBJ_CLS_TYPE2_PROB_036}, {implementation-record-element=OBJ_CLS_TYPE4_PROB_001, system-signal=OBJ_CLS_TYPE4_PROB_036}, {implementation-record-element=OBJ_CLS_TYPE5_001, system-signal=OBJ_CLS_TYPE5_036}, {implementation-record-element=OBJ_CLS_TYPE1_PROB_001, system-signal=OBJ_CLS_TYPE1_PROB_036}, {implementation-record-element=OBJ_YAW_RATE_001, system-signal=OBJ_YAW_RATE_036}, {implementation-record-element=OBJ_YAW_ANGLE_ERR_001, system-signal=OBJ_YAW_ANGLE_ERR_036}, {implementation-record-element=OBJ_VELOCITY_LONG_ERR_001, system-signal=OBJ_VELOCITY_LONG_ERR_036}, {implementation-record-element=OBJ_VELOCITY_LAT_001, system-signal=OBJ_VELOCITY_LAT_036}, {implementation-record-element=OBJ_YAW_RATE_ERR_001, system-signal=OBJ_YAW_RATE_ERR_036}, {implementation-record-element=OBJ_YAW_ANGLE_001, system-signal=OBJ_YAW_ANGLE_036}, {implementation-record-element=OBJ_VELOCITY_LONG_001, system-signal=OBJ_VELOCITY_LONG_036}, {implementation-record-element=OBJ_VELOCITY_LAT_ERR_001, system-signal=OBJ_VELOCITY_LAT_ERR_036}]}
        sender-receiver-to-signal-group-mapping={data-element=COMPOSITIONTYPE.Pp_SG_TrackerObject037.Vdp_SG_TrackerObject037, signal-group=SG_TrackerObject037, type-mapping=sender-rec-record-type-mapping=record-element-mappings=[{implementation-record-element=OBJ_ACCEL_ERR_CRR_COEF_001, system-signal=OBJ_ACCEL_ERR_CRR_COEF_037}, {implementation-record-element=OBJ_ALIVE_TIME_001, system-signal=OBJ_ALIVE_TIME_037}, {implementation-record-element=OBJ_EXISTENCE_PROB_001, system-signal=OBJ_EXISTENCE_PROB_037}, {implementation-record-element=OBJ_GROUP_ID_001, system-signal=OBJ_GROUP_ID_037}, {implementation-record-element=OBJ_ID_001, system-signal=OBJ_ID_037}, {implementation-record-element=OBJ_MEASUREMENT_STATUS_001, system-signal=OBJ_MEASUREMENT_STATUS_037}, {implementation-record-element=OBJ_MH_CRC16_001, system-signal=OBJ_MH_CRC16_037}, {implementation-record-element=OBJ_MH_CYCLE_COUNTER_001, system-signal=OBJ_MH_CYCLE_COUNTER_037}, {implementation-record-element=OBJ_MOVEMENT_STATUS_001, system-signal=OBJ_MOVEMENT_STATUS_037}, {implementation-record-element=OBJ_POS_ERR_CRR_COEF_001, system-signal=OBJ_POS_ERR_CRR_COEF_037}, {implementation-record-element=OBJ_RCS_001, system-signal=OBJ_RCS_037}, {implementation-record-element=OBJ_REF_PT_LAT_OFFSET_001, system-signal=OBJ_REF_PT_LAT_OFFSET_037}, {implementation-record-element=OBJ_REF_PT_LONG_OFFSET_001, system-signal=OBJ_REF_PT_LONG_OFFSET_037}, {implementation-record-element=OBJ_TIMESTAMP_OFFSET_001, system-signal=OBJ_TIMESTAMP_OFFSET_037}, {implementation-record-element=OBJ_TRACK_MOTION_MODEL_001, system-signal=OBJ_TRACK_MOTION_MODEL_037}, {implementation-record-element=OBJ_VEH_TRACK_FLAG_001, system-signal=OBJ_VEH_TRACK_FLAG_037}, {implementation-record-element=OBJ_VELOCITY_ERR_CRR_COEF_001, system-signal=OBJ_VELOCITY_ERR_CRR_COEF_037}, {implementation-record-element=OBJ_CLS_TYPE2_001, system-signal=OBJ_CLS_TYPE2_037}, {implementation-record-element=OBJ_ACCELERATION_LAT_ERR_001, system-signal=OBJ_ACCELERATION_LAT_ERR_037}, {implementation-record-element=OBJ_ACCELERATION_LONG_ERR_001, system-signal=OBJ_ACCELERATION_LONG_ERR_037}, {implementation-record-element=OBJ_ACCELERATION_LONG_001, system-signal=OBJ_ACCELERATION_LONG_037}, {implementation-record-element=OBJ_ACCELERATION_LAT_001, system-signal=OBJ_ACCELERATION_LAT_037}, {implementation-record-element=OBJ_DIMENSION_LENGTH_001, system-signal=OBJ_DIMENSION_LENGTH_037}, {implementation-record-element=OBJ_VELOCITY_LAT_001, system-signal=OBJ_VELOCITY_LAT_037}, {implementation-record-element=OBJ_DIMENSION_WIDTH_001, system-signal=OBJ_DIMENSION_WIDTH_037}, {implementation-record-element=OBJ_CLS_TYPE1_PROB_001, system-signal=OBJ_CLS_TYPE1_PROB_037}, {implementation-record-element=OBJ_CLS_TYPE4_001, system-signal=OBJ_CLS_TYPE4_037}, {implementation-record-element=OBJ_CLS_TYPE4_PROB_001, system-signal=OBJ_CLS_TYPE4_PROB_037}, {implementation-record-element=OBJ_CLS_TYPE1_001, system-signal=OBJ_CLS_TYPE1_037}, {implementation-record-element=OBJ_DIMENSION_WIDTH_ERR_001, system-signal=OBJ_DIMENSION_WIDTH_ERR_037}, {implementation-record-element=OBJ_CLS_TYPE3_001, system-signal=OBJ_CLS_TYPE3_037}, {implementation-record-element=OBJ_DIMENSION_LENGTH_ERR_001, system-signal=OBJ_DIMENSION_LENGTH_ERR_037}, {implementation-record-element=OBJ_POS_LAT_001, system-signal=OBJ_POS_LAT_037}, {implementation-record-element=OBJ_CLS_TYPE5_001, system-signal=OBJ_CLS_TYPE5_037}, {implementation-record-element=OBJ_POS_LAT_ERR_001, system-signal=OBJ_POS_LAT_ERR_037}, {implementation-record-element=OBJ_POS_LONG_ERR_001, system-signal=OBJ_POS_LONG_ERR_037}, {implementation-record-element=OBJ_VELOCITY_LAT_ERR_001, system-signal=OBJ_VELOCITY_LAT_ERR_037}, {implementation-record-element=OBJ_VELOCITY_LONG_ERR_001, system-signal=OBJ_VELOCITY_LONG_ERR_037}, {implementation-record-element=OBJ_VELOCITY_LONG_001, system-signal=OBJ_VELOCITY_LONG_037}, {implementation-record-element=OBJ_YAW_ANGLE_001, system-signal=OBJ_YAW_ANGLE_037}, {implementation-record-element=OBJ_CLS_TYPE5_PROB_001, system-signal=OBJ_CLS_TYPE5_PROB_037}, {implementation-record-element=OBJ_CLS_TYPE6_001, system-signal=OBJ_CLS_TYPE6_037}, {implementation-record-element=OBJ_YAW_ANGLE_ERR_001, system-signal=OBJ_YAW_ANGLE_ERR_037}, {implementation-record-element=OBJ_YAW_RATE_001, system-signal=OBJ_YAW_RATE_037}, {implementation-record-element=OBJ_CLS_TYPE2_PROB_001, system-signal=OBJ_CLS_TYPE2_PROB_037}, {implementation-record-element=OBJ_POS_LONG_001, system-signal=OBJ_POS_LONG_037}, {implementation-record-element=OBJ_YAW_RATE_ERR_001, system-signal=OBJ_YAW_RATE_ERR_037}, {implementation-record-element=OBJ_CLS_TYPE3_PROB_001, system-signal=OBJ_CLS_TYPE3_PROB_037}, {implementation-record-element=OBJ_CLS_TYPE6_PROB_001, system-signal=OBJ_CLS_TYPE6_PROB_037}]}
        sender-receiver-to-signal-group-mapping={data-element=COMPOSITIONTYPE.Pp_SG_TrackerObject038.Vdp_SG_TrackerObject038, signal-group=SG_TrackerObject038, type-mapping=sender-rec-record-type-mapping=record-element-mappings=[{implementation-record-element=OBJ_ACCEL_ERR_CRR_COEF_001, system-signal=OBJ_ACCEL_ERR_CRR_COEF_038}, {implementation-record-element=OBJ_ALIVE_TIME_001, system-signal=OBJ_ALIVE_TIME_038}, {implementation-record-element=OBJ_EXISTENCE_PROB_001, system-signal=OBJ_EXISTENCE_PROB_038}, {implementation-record-element=OBJ_GROUP_ID_001, system-signal=OBJ_GROUP_ID_038}, {implementation-record-element=OBJ_ID_001, system-signal=OBJ_ID_038}, {implementation-record-element=OBJ_MEASUREMENT_STATUS_001, system-signal=OBJ_MEASUREMENT_STATUS_038}, {implementation-record-element=OBJ_MH_CRC16_001, system-signal=OBJ_MH_CRC16_038}, {implementation-record-element=OBJ_MH_CYCLE_COUNTER_001, system-signal=OBJ_MH_CYCLE_COUNTER_038}, {implementation-record-element=OBJ_MOVEMENT_STATUS_001, system-signal=OBJ_MOVEMENT_STATUS_038}, {implementation-record-element=OBJ_POS_ERR_CRR_COEF_001, system-signal=OBJ_POS_ERR_CRR_COEF_038}, {implementation-record-element=OBJ_RCS_001, system-signal=OBJ_RCS_038}, {implementation-record-element=OBJ_REF_PT_LAT_OFFSET_001, system-signal=OBJ_REF_PT_LAT_OFFSET_038}, {implementation-record-element=OBJ_REF_PT_LONG_OFFSET_001, system-signal=OBJ_REF_PT_LONG_OFFSET_038}, {implementation-record-element=OBJ_TIMESTAMP_OFFSET_001, system-signal=OBJ_TIMESTAMP_OFFSET_038}, {implementation-record-element=OBJ_TRACK_MOTION_MODEL_001, system-signal=OBJ_TRACK_MOTION_MODEL_038}, {implementation-record-element=OBJ_VEH_TRACK_FLAG_001, system-signal=OBJ_VEH_TRACK_FLAG_038}, {implementation-record-element=OBJ_VELOCITY_ERR_CRR_COEF_001, system-signal=OBJ_VELOCITY_ERR_CRR_COEF_038}, {implementation-record-element=OBJ_YAW_ANGLE_001, system-signal=OBJ_YAW_ANGLE_038}, {implementation-record-element=OBJ_CLS_TYPE3_PROB_001, system-signal=OBJ_CLS_TYPE3_PROB_038}, {implementation-record-element=OBJ_ACCELERATION_LAT_ERR_001, system-signal=OBJ_ACCELERATION_LAT_ERR_038}, {implementation-record-element=OBJ_ACCELERATION_LONG_001, system-signal=OBJ_ACCELERATION_LONG_038}, {implementation-record-element=OBJ_CLS_TYPE4_001, system-signal=OBJ_CLS_TYPE4_038}, {implementation-record-element=OBJ_CLS_TYPE4_PROB_001, system-signal=OBJ_CLS_TYPE4_PROB_038}, {implementation-record-element=OBJ_ACCELERATION_LONG_ERR_001, system-signal=OBJ_ACCELERATION_LONG_ERR_038}, {implementation-record-element=OBJ_POS_LAT_001, system-signal=OBJ_POS_LAT_038}, {implementation-record-element=OBJ_CLS_TYPE3_001, system-signal=OBJ_CLS_TYPE3_038}, {implementation-record-element=OBJ_ACCELERATION_LAT_001, system-signal=OBJ_ACCELERATION_LAT_038}, {implementation-record-element=OBJ_POS_LONG_ERR_001, system-signal=OBJ_POS_LONG_ERR_038}, {implementation-record-element=OBJ_YAW_ANGLE_ERR_001, system-signal=OBJ_YAW_ANGLE_ERR_038}, {implementation-record-element=OBJ_YAW_RATE_001, system-signal=OBJ_YAW_RATE_038}, {implementation-record-element=OBJ_POS_LONG_001, system-signal=OBJ_POS_LONG_038}, {implementation-record-element=OBJ_CLS_TYPE6_PROB_001, system-signal=OBJ_CLS_TYPE6_PROB_038}, {implementation-record-element=OBJ_DIMENSION_WIDTH_001, system-signal=OBJ_DIMENSION_WIDTH_038}, {implementation-record-element=OBJ_VELOCITY_LAT_ERR_001, system-signal=OBJ_VELOCITY_LAT_ERR_038}, {implementation-record-element=OBJ_DIMENSION_LENGTH_001, system-signal=OBJ_DIMENSION_LENGTH_038}, {implementation-record-element=OBJ_DIMENSION_WIDTH_ERR_001, system-signal=OBJ_DIMENSION_WIDTH_ERR_038}, {implementation-record-element=OBJ_YAW_RATE_ERR_001, system-signal=OBJ_YAW_RATE_ERR_038}, {implementation-record-element=OBJ_CLS_TYPE1_001, system-signal=OBJ_CLS_TYPE1_038}, {implementation-record-element=OBJ_CLS_TYPE2_PROB_001, system-signal=OBJ_CLS_TYPE2_PROB_038}, {implementation-record-element=OBJ_POS_LAT_ERR_001, system-signal=OBJ_POS_LAT_ERR_038}, {implementation-record-element=OBJ_CLS_TYPE6_001, system-signal=OBJ_CLS_TYPE6_038}, {implementation-record-element=OBJ_DIMENSION_LENGTH_ERR_001, system-signal=OBJ_DIMENSION_LENGTH_ERR_038}, {implementation-record-element=OBJ_VELOCITY_LAT_001, system-signal=OBJ_VELOCITY_LAT_038}, {implementation-record-element=OBJ_CLS_TYPE2_001, system-signal=OBJ_CLS_TYPE2_038}, {implementation-record-element=OBJ_VELOCITY_LONG_001, system-signal=OBJ_VELOCITY_LONG_038}, {implementation-record-element=OBJ_CLS_TYPE1_PROB_001, system-signal=OBJ_CLS_TYPE1_PROB_038}, {implementation-record-element=OBJ_CLS_TYPE5_PROB_001, system-signal=OBJ_CLS_TYPE5_PROB_038}, {implementation-record-element=OBJ_CLS_TYPE5_001, system-signal=OBJ_CLS_TYPE5_038}, {implementation-record-element=OBJ_VELOCITY_LONG_ERR_001, system-signal=OBJ_VELOCITY_LONG_ERR_038}]}
        sender-receiver-to-signal-group-mapping={data-element=COMPOSITIONTYPE.Pp_SG_TrackerObject039.Vdp_SG_TrackerObject039, signal-group=SG_TrackerObject039, type-mapping=sender-rec-record-type-mapping=record-element-mappings=[{implementation-record-element=OBJ_ACCEL_ERR_CRR_COEF_001, system-signal=OBJ_ACCEL_ERR_CRR_COEF_039}, {implementation-record-element=OBJ_ALIVE_TIME_001, system-signal=OBJ_ALIVE_TIME_039}, {implementation-record-element=OBJ_EXISTENCE_PROB_001, system-signal=OBJ_EXISTENCE_PROB_039}, {implementation-record-element=OBJ_GROUP_ID_001, system-signal=OBJ_GROUP_ID_039}, {implementation-record-element=OBJ_ID_001, system-signal=OBJ_ID_039}, {implementation-record-element=OBJ_MEASUREMENT_STATUS_001, system-signal=OBJ_MEASUREMENT_STATUS_039}, {implementation-record-element=OBJ_MH_CRC16_001, system-signal=OBJ_MH_CRC16_039}, {implementation-record-element=OBJ_MH_CYCLE_COUNTER_001, system-signal=OBJ_MH_CYCLE_COUNTER_039}, {implementation-record-element=OBJ_MOVEMENT_STATUS_001, system-signal=OBJ_MOVEMENT_STATUS_039}, {implementation-record-element=OBJ_POS_ERR_CRR_COEF_001, system-signal=OBJ_POS_ERR_CRR_COEF_039}, {implementation-record-element=OBJ_RCS_001, system-signal=OBJ_RCS_039}, {implementation-record-element=OBJ_REF_PT_LAT_OFFSET_001, system-signal=OBJ_REF_PT_LAT_OFFSET_039}, {implementation-record-element=OBJ_REF_PT_LONG_OFFSET_001, system-signal=OBJ_REF_PT_LONG_OFFSET_039}, {implementation-record-element=OBJ_TIMESTAMP_OFFSET_001, system-signal=OBJ_TIMESTAMP_OFFSET_039}, {implementation-record-element=OBJ_TRACK_MOTION_MODEL_001, system-signal=OBJ_TRACK_MOTION_MODEL_039}, {implementation-record-element=OBJ_VEH_TRACK_FLAG_001, system-signal=OBJ_VEH_TRACK_FLAG_039}, {implementation-record-element=OBJ_VELOCITY_ERR_CRR_COEF_001, system-signal=OBJ_VELOCITY_ERR_CRR_COEF_039}, {implementation-record-element=OBJ_ACCELERATION_LONG_ERR_001, system-signal=OBJ_ACCELERATION_LONG_ERR_039}, {implementation-record-element=OBJ_ACCELERATION_LAT_001, system-signal=OBJ_ACCELERATION_LAT_039}, {implementation-record-element=OBJ_ACCELERATION_LAT_ERR_001, system-signal=OBJ_ACCELERATION_LAT_ERR_039}, {implementation-record-element=OBJ_ACCELERATION_LONG_001, system-signal=OBJ_ACCELERATION_LONG_039}, {implementation-record-element=OBJ_CLS_TYPE1_PROB_001, system-signal=OBJ_CLS_TYPE1_PROB_039}, {implementation-record-element=OBJ_CLS_TYPE1_001, system-signal=OBJ_CLS_TYPE1_039}, {implementation-record-element=OBJ_CLS_TYPE2_001, system-signal=OBJ_CLS_TYPE2_039}, {implementation-record-element=OBJ_CLS_TYPE2_PROB_001, system-signal=OBJ_CLS_TYPE2_PROB_039}, {implementation-record-element=OBJ_CLS_TYPE3_001, system-signal=OBJ_CLS_TYPE3_039}, {implementation-record-element=OBJ_CLS_TYPE3_PROB_001, system-signal=OBJ_CLS_TYPE3_PROB_039}, {implementation-record-element=OBJ_CLS_TYPE4_001, system-signal=OBJ_CLS_TYPE4_039}, {implementation-record-element=OBJ_CLS_TYPE4_PROB_001, system-signal=OBJ_CLS_TYPE4_PROB_039}, {implementation-record-element=OBJ_CLS_TYPE5_001, system-signal=OBJ_CLS_TYPE5_039}, {implementation-record-element=OBJ_YAW_ANGLE_ERR_001, system-signal=OBJ_YAW_ANGLE_ERR_039}, {implementation-record-element=OBJ_POS_LAT_001, system-signal=OBJ_POS_LAT_039}, {implementation-record-element=OBJ_POS_LAT_ERR_001, system-signal=OBJ_POS_LAT_ERR_039}, {implementation-record-element=OBJ_VELOCITY_LAT_ERR_001, system-signal=OBJ_VELOCITY_LAT_ERR_039}, {implementation-record-element=OBJ_VELOCITY_LAT_001, system-signal=OBJ_VELOCITY_LAT_039}, {implementation-record-element=OBJ_DIMENSION_LENGTH_ERR_001, system-signal=OBJ_DIMENSION_LENGTH_ERR_039}, {implementation-record-element=OBJ_POS_LONG_001, system-signal=OBJ_POS_LONG_039}, {implementation-record-element=OBJ_DIMENSION_WIDTH_ERR_001, system-signal=OBJ_DIMENSION_WIDTH_ERR_039}, {implementation-record-element=OBJ_POS_LONG_ERR_001, system-signal=OBJ_POS_LONG_ERR_039}, {implementation-record-element=OBJ_DIMENSION_LENGTH_001, system-signal=OBJ_DIMENSION_LENGTH_039}, {implementation-record-element=OBJ_VELOCITY_LONG_001, system-signal=OBJ_VELOCITY_LONG_039}, {implementation-record-element=OBJ_YAW_RATE_001, system-signal=OBJ_YAW_RATE_039}, {implementation-record-element=OBJ_YAW_RATE_ERR_001, system-signal=OBJ_YAW_RATE_ERR_039}, {implementation-record-element=OBJ_CLS_TYPE5_PROB_001, system-signal=OBJ_CLS_TYPE5_PROB_039}, {implementation-record-element=OBJ_CLS_TYPE6_PROB_001, system-signal=OBJ_CLS_TYPE6_PROB_039}, {implementation-record-element=OBJ_DIMENSION_WIDTH_001, system-signal=OBJ_DIMENSION_WIDTH_039}, {implementation-record-element=OBJ_CLS_TYPE6_001, system-signal=OBJ_CLS_TYPE6_039}, {implementation-record-element=OBJ_VELOCITY_LONG_ERR_001, system-signal=OBJ_VELOCITY_LONG_ERR_039}, {implementation-record-element=OBJ_YAW_ANGLE_001, system-signal=OBJ_YAW_ANGLE_039}]}
