AUTOSAR XML (schema 00053)
package /COM/VECTOR/CFG/WORKFLOW/SYSDESC/SYNC
  flat map FLATMAP
    715 x flat instance descriptor:
      SWC_PLT_CDD_Logging: upstream-reference=PlatformComposition.RootComposition.SWC_PLT_CDD_Logging, ecu-extract-reference=COMPOSITIONTYPE.SWC_PLT_CDD_Logging
      SWC_PLT_CDD_Radar_Control: upstream-reference=PlatformComposition.RootComposition.SWC_PLT_CDD_Radar_Control, ecu-extract-reference=COMPOSITIONTYPE.SWC_PLT_CDD_Radar_Control
      SWC_PLT_Appl_IoHwAb: upstream-reference=PlatformComposition.ModeManagerCompositionType.RootComposition.SWC_PLT_Appl_IoHwAb, ecu-extract-reference=COMPOSITIONTYPE.SWC_PLT_Appl_IoHwAb
      SWC_PLT_CDD_XCP: upstream-reference=PlatformComposition.RootComposition.SWC_PLT_CDD_XCP, ecu-extract-reference=COMPOSITIONTYPE.SWC_PLT_CDD_XCP
      SWC_PLT_CDD_ECUSync: upstream-reference=PlatformComposition.RootComposition.SWC_PLT_CDD_ECUSync, ecu-extract-reference=COMPOSITIONTYPE.SWC_PLT_CDD_ECUSync
      SG_TrackerObject004: upstream-reference=Pp_SG_TrackerObject004.RootComposition.Vdp_SG_TrackerObject004, ecu-extract-reference=COMPOSITIONTYPE.Pp_SG_TrackerObject004.Vdp_SG_TrackerObject004
      Pp_SG_TrackerObject004: upstream-reference=RootComposition.Pp_SG_TrackerObject004, ecu-extract-reference=COMPOSITIONTYPE.Pp_SG_TrackerObject004
      SWC_PLT_Appl_Communication: upstream-reference=PlatformComposition.RootComposition.SWC_PLT_Appl_Communication, ecu-extract-reference=COMPOSITIONTYPE.SWC_PLT_Appl_Communication
      SWC_PLT_Radar_Alignment_Handler: upstream-reference=ProjectComposition.RootComposition.SWC_PLT_Radar_Alignment_Handler, ecu-extract-reference=COMPOSITIONTYPE.SWC_PLT_Radar_Alignment_Handler
      SWC_PLT_Appl_PlatformTime: upstream-reference=PlatformComposition.RootComposition.SWC_PLT_Appl_PlatformTime, ecu-extract-reference=COMPOSITIONTYPE.SWC_PLT_Appl_PlatformTime
      SWC_PLT_Appl_RTM: upstream-reference=PlatformComposition.RootComposition.SWC_PLT_Appl_RTM, ecu-extract-reference=COMPOSITIONTYPE.SWC_PLT_Appl_RTM
      SWC_CDD_IPC: upstream-reference=PlatformComposition.ModeManagerCompositionType.RootComposition.SWC_CDD_IPC, ecu-extract-reference=COMPOSITIONTYPE.SWC_CDD_IPC
      SWC_PLT_Appl_Diag: upstream-reference=PlatformComposition.ModeManagerCompositionType.RootComposition.SWC_PLT_Appl_Diag, ecu-extract-reference=COMPOSITIONTYPE.SWC_PLT_Appl_Diag
      SWC_PLT_Appl_FaultMgr: upstream-reference=PlatformComposition.ModeManagerCompositionType.RootComposition.SWC_PLT_Appl_FaultMgr, ecu-extract-reference=COMPOSITIONTYPE.SWC_PLT_Appl_FaultMgr
      SWC_PLT_Appl_ModeManager: upstream-reference=PlatformComposition.ModeManagerCompositionType.RootComposition.SWC_PLT_Appl_ModeManager, ecu-extract-reference=COMPOSITIONTYPE.SWC_PLT_Appl_ModeManager
      SWC_PLT_CDD_FailSafe: upstream-reference=PlatformComposition.ModeManagerCompositionType.RootComposition.SWC_PLT_CDD_FailSafe, ecu-extract-reference=COMPOSITIONTYPE.SWC_PLT_CDD_FailSafe
      SWC_PLT_CDD_MCU_Safety: upstream-reference=PlatformComposition.ModeManagerCompositionType.RootComposition.SWC_PLT_CDD_MCU_Safety, ecu-extract-reference=COMPOSITIONTYPE.SWC_PLT_CDD_MCU_Safety
      Pp_Alignment_Faults: upstream-reference=RootComposition.Pp_Alignment_Faults, ecu-extract-reference=COMPOSITIONTYPE.Pp_Alignment_Faults
      SG_TrackerObject001: upstream-reference=Pp_SG_TrackerObject001.RootComposition.Vdp_SG_TrackerObject001, ecu-extract-reference=COMPOSITIONTYPE.Pp_SG_TrackerObject001.Vdp_SG_TrackerObject001
      Pp_SG_TrackerObject001: upstream-reference=RootComposition.Pp_SG_TrackerObject001, ecu-extract-reference=COMPOSITIONTYPE.Pp_SG_TrackerObject001
      SG_TrackerObject002: upstream-reference=Pp_SG_TrackerObject002.RootComposition.Vdp_SG_TrackerObject002, ecu-extract-reference=COMPOSITIONTYPE.Pp_SG_TrackerObject002.Vdp_SG_TrackerObject002
      Pp_SG_TrackerObject002: upstream-reference=RootComposition.Pp_SG_TrackerObject002, ecu-extract-reference=COMPOSITIONTYPE.Pp_SG_TrackerObject002
      SG_TrackerObject003: upstream-reference=Pp_SG_TrackerObject003.RootComposition.Vdp_SG_TrackerObject003, ecu-extract-reference=COMPOSITIONTYPE.Pp_SG_TrackerObject003.Vdp_SG_TrackerObject003
      Pp_SG_TrackerObject003: upstream-reference=RootComposition.Pp_SG_TrackerObject003, ecu-extract-reference=COMPOSITIONTYPE.Pp_SG_TrackerObject003
      SG_TrackerObject005: upstream-reference=Pp_SG_TrackerObject005.RootComposition.Vdp_SG_TrackerObject005, ecu-extract-reference=COMPOSITIONTYPE.Pp_SG_TrackerObject005.Vdp_SG_TrackerObject005
      Pp_SG_TrackerObject005: upstream-reference=RootComposition.Pp_SG_TrackerObject005, ecu-extract-reference=COMPOSITIONTYPE.Pp_SG_TrackerObject005
      SG_TrackerObject006: upstream-reference=Pp_SG_TrackerObject006.RootComposition.Vdp_SG_TrackerObject006, ecu-extract-reference=COMPOSITIONTYPE.Pp_SG_TrackerObject006.Vdp_SG_TrackerObject006
      Pp_SG_TrackerObject006: upstream-reference=RootComposition.Pp_SG_TrackerObject006, ecu-extract-reference=COMPOSITIONTYPE.Pp_SG_TrackerObject006
      SG_TrackerObject007: upstream-reference=Pp_SG_TrackerObject007.RootComposition.Vdp_SG_TrackerObject007, ecu-extract-reference=COMPOSITIONTYPE.Pp_SG_TrackerObject007.Vdp_SG_TrackerObject007
      Pp_SG_TrackerObject007: upstream-reference=RootComposition.Pp_SG_TrackerObject007, ecu-extract-reference=COMPOSITIONTYPE.Pp_SG_TrackerObject007
      SG_TrackerObject008: upstream-reference=Pp_SG_TrackerObject008.RootComposition.Vdp_SG_TrackerObject008, ecu-extract-reference=COMPOSITIONTYPE.Pp_SG_TrackerObject008.Vdp_SG_TrackerObject008
      Pp_SG_TrackerObject008: upstream-reference=RootComposition.Pp_SG_TrackerObject008, ecu-extract-reference=COMPOSITIONTYPE.Pp_SG_TrackerObject008
      SG_TrackerObject009: upstream-reference=Pp_SG_TrackerObject009.RootComposition.Vdp_SG_TrackerObject009, ecu-extract-reference=COMPOSITIONTYPE.Pp_SG_TrackerObject009.Vdp_SG_TrackerObject009
      Pp_SG_TrackerObject009: upstream-reference=RootComposition.Pp_SG_TrackerObject009, ecu-extract-reference=COMPOSITIONTYPE.Pp_SG_TrackerObject009
      SG_TrackerObject010: upstream-reference=Pp_SG_TrackerObject010.RootComposition.Vdp_SG_TrackerObject010, ecu-extract-reference=COMPOSITIONTYPE.Pp_SG_TrackerObject010.Vdp_SG_TrackerObject010
      Pp_SG_TrackerObject010: upstream-reference=RootComposition.Pp_SG_TrackerObject010, ecu-extract-reference=COMPOSITIONTYPE.Pp_SG_TrackerObject010
      SG_TrackerObject011: upstream-reference=Pp_SG_TrackerObject011.RootComposition.Vdp_SG_TrackerObject011, ecu-extract-reference=COMPOSITIONTYPE.Pp_SG_TrackerObject011.Vdp_SG_TrackerObject011
      Pp_SG_TrackerObject011: upstream-reference=RootComposition.Pp_SG_TrackerObject011, ecu-extract-reference=COMPOSITIONTYPE.Pp_SG_TrackerObject011
      SG_TrackerObject012: upstream-reference=Pp_SG_TrackerObject012.RootComposition.Vdp_SG_TrackerObject012, ecu-extract-reference=COMPOSITIONTYPE.Pp_SG_TrackerObject012.Vdp_SG_TrackerObject012
      Pp_SG_TrackerObject012: upstream-reference=RootComposition.Pp_SG_TrackerObject012, ecu-extract-reference=COMPOSITIONTYPE.Pp_SG_TrackerObject012
      SG_TrackerObject013: upstream-reference=Pp_SG_TrackerObject013.RootComposition.Vdp_SG_TrackerObject013, ecu-extract-reference=COMPOSITIONTYPE.Pp_SG_TrackerObject013.Vdp_SG_TrackerObject013
      Pp_SG_TrackerObject013: upstream-reference=RootComposition.Pp_SG_TrackerObject013, ecu-extract-reference=COMPOSITIONTYPE.Pp_SG_TrackerObject013
      SG_TrackerObject014: upstream-reference=Pp_SG_TrackerObject014.RootComposition.Vdp_SG_TrackerObject014, ecu-extract-reference=COMPOSITIONTYPE.Pp_SG_TrackerObject014.Vdp_SG_TrackerObject014
      Pp_SG_TrackerObject014: upstream-reference=RootComposition.Pp_SG_TrackerObject014, ecu-extract-reference=COMPOSITIONTYPE.Pp_SG_TrackerObject014
      SG_TrackerObject015: upstream-reference=Pp_SG_TrackerObject015.RootComposition.Vdp_SG_TrackerObject015, ecu-extract-reference=COMPOSITIONTYPE.Pp_SG_TrackerObject015.Vdp_SG_TrackerObject015
      Pp_SG_TrackerObject015: upstream-reference=RootComposition.Pp_SG_TrackerObject015, ecu-extract-reference=COMPOSITIONTYPE.Pp_SG_TrackerObject015
      SG_TrackerObject016: upstream-reference=Pp_SG_TrackerObject016.RootComposition.Vdp_SG_TrackerObject016, ecu-extract-reference=COMPOSITIONTYPE.Pp_SG_TrackerObject016.Vdp_SG_TrackerObject016
      Pp_SG_TrackerObject016: upstream-reference=RootComposition.Pp_SG_TrackerObject016, ecu-extract-reference=COMPOSITIONTYPE.Pp_SG_TrackerObject016
      SG_TrackerObject017: upstream-reference=Pp_SG_TrackerObject017.RootComposition.Vdp_SG_TrackerObject017, ecu-extract-reference=COMPOSITIONTYPE.Pp_SG_TrackerObject017.Vdp_SG_TrackerObject017
      Pp_SG_TrackerObject017: upstream-reference=RootComposition.Pp_SG_TrackerObject017, ecu-extract-reference=COMPOSITIONTYPE.Pp_SG_TrackerObject017
      SG_TrackerObject018: upstream-reference=Pp_SG_TrackerObject018.RootComposition.Vdp_SG_TrackerObject018, ecu-extract-reference=COMPOSITIONTYPE.Pp_SG_TrackerObject018.Vdp_SG_TrackerObject018
      Pp_SG_TrackerObject018: upstream-reference=RootComposition.Pp_SG_TrackerObject018, ecu-extract-reference=COMPOSITIONTYPE.Pp_SG_TrackerObject018
      SG_TrackerObject019: upstream-reference=Pp_SG_TrackerObject019.RootComposition.Vdp_SG_TrackerObject019, ecu-extract-reference=COMPOSITIONTYPE.Pp_SG_TrackerObject019.Vdp_SG_TrackerObject019
      Pp_SG_TrackerObject019: upstream-reference=RootComposition.Pp_SG_TrackerObject019, ecu-extract-reference=COMPOSITIONTYPE.Pp_SG_TrackerObject019
      SG_TrackerObject020: upstream-reference=Pp_SG_TrackerObject020.RootComposition.Vdp_SG_TrackerObject020, ecu-extract-reference=COMPOSITIONTYPE.Pp_SG_TrackerObject020.Vdp_SG_TrackerObject020
      Pp_SG_TrackerObject020: upstream-reference=RootComposition.Pp_SG_TrackerObject020, ecu-extract-reference=COMPOSITIONTYPE.Pp_SG_TrackerObject020
      SG_TrackerObject021: upstream-reference=Pp_SG_TrackerObject021.RootComposition.Vdp_SG_TrackerObject021, ecu-extract-reference=COMPOSITIONTYPE.Pp_SG_TrackerObject021.Vdp_SG_TrackerObject021
      Pp_SG_TrackerObject021: upstream-reference=RootComposition.Pp_SG_TrackerObject021, ecu-extract-reference=COMPOSITIONTYPE.Pp_SG_TrackerObject021
      SG_TrackerObject022: upstream-reference=Pp_SG_TrackerObject022.RootComposition.Vdp_SG_TrackerObject022, ecu-extract-reference=COMPOSITIONTYPE.Pp_SG_TrackerObject022.Vdp_SG_TrackerObject022
      Pp_SG_TrackerObject022: upstream-reference=RootComposition.Pp_SG_TrackerObject022, ecu-extract-reference=COMPOSITIONTYPE.Pp_SG_TrackerObject022
      SG_TrackerObject023: upstream-reference=Pp_SG_TrackerObject023.RootComposition.Vdp_SG_TrackerObject023, ecu-extract-reference=COMPOSITIONTYPE.Pp_SG_TrackerObject023.Vdp_SG_TrackerObject023
      Pp_SG_TrackerObject023: upstream-reference=RootComposition.Pp_SG_TrackerObject023, ecu-extract-reference=COMPOSITIONTYPE.Pp_SG_TrackerObject023
      SG_TrackerObject024: upstream-reference=Pp_SG_TrackerObject024.RootComposition.Vdp_SG_TrackerObject024, ecu-extract-reference=COMPOSITIONTYPE.Pp_SG_TrackerObject024.Vdp_SG_TrackerObject024
      Pp_SG_TrackerObject024: upstream-reference=RootComposition.Pp_SG_TrackerObject024, ecu-extract-reference=COMPOSITIONTYPE.Pp_SG_TrackerObject024
      SG_TrackerObject025: upstream-reference=Pp_SG_TrackerObject025.RootComposition.Vdp_SG_TrackerObject025, ecu-extract-reference=COMPOSITIONTYPE.Pp_SG_TrackerObject025.Vdp_SG_TrackerObject025
      Pp_SG_TrackerObject025: upstream-reference=RootComposition.Pp_SG_TrackerObject025, ecu-extract-reference=COMPOSITIONTYPE.Pp_SG_TrackerObject025
      SG_TrackerObject026: upstream-reference=Pp_SG_TrackerObject026.RootComposition.Vdp_SG_TrackerObject026, ecu-extract-reference=COMPOSITIONTYPE.Pp_SG_TrackerObject026.Vdp_SG_TrackerObject026
      Pp_SG_TrackerObject026: upstream-reference=RootComposition.Pp_SG_TrackerObject026, ecu-extract-reference=COMPOSITIONTYPE.Pp_SG_TrackerObject026
      SG_TrackerObject027: upstream-reference=Pp_SG_TrackerObject027.RootComposition.Vdp_SG_TrackerObject027, ecu-extract-reference=COMPOSITIONTYPE.Pp_SG_TrackerObject027.Vdp_SG_TrackerObject027
      Pp_SG_TrackerObject027: upstream-reference=RootComposition.Pp_SG_TrackerObject027, ecu-extract-reference=COMPOSITIONTYPE.Pp_SG_TrackerObject027
      SG_TrackerObject028: upstream-reference=Pp_SG_TrackerObject028.RootComposition.Vdp_SG_TrackerObject028, ecu-extract-reference=COMPOSITIONTYPE.Pp_SG_TrackerObject028.Vdp_SG_TrackerObject028
      Pp_SG_TrackerObject028: upstream-reference=RootComposition.Pp_SG_TrackerObject028, ecu-extract-reference=COMPOSITIONTYPE.Pp_SG_TrackerObject028
      SG_TrackerObject029: upstream-reference=Pp_SG_TrackerObject029.RootComposition.Vdp_SG_TrackerObject029, ecu-extract-reference=COMPOSITIONTYPE.Pp_SG_TrackerObject029.Vdp_SG_TrackerObject029
      Pp_SG_TrackerObject029: upstream-reference=RootComposition.Pp_SG_TrackerObject029, ecu-extract-reference=COMPOSITIONTYPE.Pp_SG_TrackerObject029
      SG_TrackerObject030: upstream-reference=Pp_SG_TrackerObject030.RootComposition.Vdp_SG_TrackerObject030, ecu-extract-reference=COMPOSITIONTYPE.Pp_SG_TrackerObject030.Vdp_SG_TrackerObject030
      Pp_SG_TrackerObject030: upstream-reference=RootComposition.Pp_SG_TrackerObject030, ecu-extract-reference=COMPOSITIONTYPE.Pp_SG_TrackerObject030
      SG_TrackerObject031: upstream-reference=Pp_SG_TrackerObject031.RootComposition.Vdp_SG_TrackerObject031, ecu-extract-reference=COMPOSITIONTYPE.Pp_SG_TrackerObject031.Vdp_SG_TrackerObject031
      Pp_SG_TrackerObject031: upstream-reference=RootComposition.Pp_SG_TrackerObject031, ecu-extract-reference=COMPOSITIONTYPE.Pp_SG_TrackerObject031
      SG_TrackerObject032: upstream-reference=Pp_SG_TrackerObject032.RootComposition.Vdp_SG_TrackerObject032, ecu-extract-reference=COMPOSITIONTYPE.Pp_SG_TrackerObject032.Vdp_SG_TrackerObject032
      Pp_SG_TrackerObject032: upstream-reference=RootComposition.Pp_SG_TrackerObject032, ecu-extract-reference=COMPOSITIONTYPE.Pp_SG_TrackerObject032
      SG_TrackerObject033: upstream-reference=Pp_SG_TrackerObject033.RootComposition.Vdp_SG_TrackerObject033, ecu-extract-reference=COMPOSITIONTYPE.Pp_SG_TrackerObject033.Vdp_SG_TrackerObject033
      Pp_SG_TrackerObject033: upstream-reference=RootComposition.Pp_SG_TrackerObject033, ecu-extract-reference=COMPOSITIONTYPE.Pp_SG_TrackerObject033
      SG_TrackerObject034: upstream-reference=Pp_SG_TrackerObject034.RootComposition.Vdp_SG_TrackerObject034, ecu-extract-reference=COMPOSITIONTYPE.Pp_SG_TrackerObject034.Vdp_SG_TrackerObject034
      Pp_SG_TrackerObject034: upstream-reference=RootComposition.Pp_SG_TrackerObject034, ecu-extract-reference=COMPOSITIONTYPE.Pp_SG_TrackerObject034
      SG_TrackerObject035: upstream-reference=Pp_SG_TrackerObject035.RootComposition.Vdp_SG_TrackerObject035, ecu-extract-reference=COMPOSITIONTYPE.Pp_SG_TrackerObject035.Vdp_SG_TrackerObject035
      Pp_SG_TrackerObject035: upstream-reference=RootComposition.Pp_SG_TrackerObject035, ecu-extract-reference=COMPOSITIONTYPE.Pp_SG_TrackerObject035
      SG_TrackerObject036: upstream-reference=Pp_SG_TrackerObject036.RootComposition.Vdp_SG_TrackerObject036, ecu-extract-reference=COMPOSITIONTYPE.Pp_SG_TrackerObject036.Vdp_SG_TrackerObject036
      Pp_SG_TrackerObject036: upstream-reference=RootComposition.Pp_SG_TrackerObject036, ecu-extract-reference=COMPOSITIONTYPE.Pp_SG_TrackerObject036
      SG_TrackerObject037: upstream-reference=Pp_SG_TrackerObject037.RootComposition.Vdp_SG_TrackerObject037, ecu-extract-reference=COMPOSITIONTYPE.Pp_SG_TrackerObject037.Vdp_SG_TrackerObject037
      Pp_SG_TrackerObject037: upstream-reference=RootComposition.Pp_SG_TrackerObject037, ecu-extract-reference=COMPOSITIONTYPE.Pp_SG_TrackerObject037
      SG_TrackerObject038: upstream-reference=Pp_SG_TrackerObject038.RootComposition.Vdp_SG_TrackerObject038, ecu-extract-reference=COMPOSITIONTYPE.Pp_SG_TrackerObject038.Vdp_SG_TrackerObject038
      Pp_SG_TrackerObject038: upstream-reference=RootComposition.Pp_SG_TrackerObject038, ecu-extract-reference=COMPOSITIONTYPE.Pp_SG_TrackerObject038
      SG_TrackerObject039: upstream-reference=Pp_SG_TrackerObject039.RootComposition.Vdp_SG_TrackerObject039, ecu-extract-reference=COMPOSITIONTYPE.Pp_SG_TrackerObject039.Vdp_SG_TrackerObject039
      Pp_SG_TrackerObject039: upstream-reference=RootComposition.Pp_SG_TrackerObject039, ecu-extract-reference=COMPOSITIONTYPE.Pp_SG_TrackerObject039
      SG_TrackerObject040: upstream-reference=Pp_SG_TrackerObject040.RootComposition.Vdp_SG_TrackerObject040, ecu-extract-reference=COMPOSITIONTYPE.Pp_SG_TrackerObject040.Vdp_SG_TrackerObject040
      Pp_SG_TrackerObject040: upstream-reference=RootComposition.Pp_SG_TrackerObject040, ecu-extract-reference=COMPOSITIONTYPE.Pp_SG_TrackerObject040
      SG_TrackerObject041: upstream-reference=Pp_SG_TrackerObject041.RootComposition.Vdp_SG_TrackerObject041, ecu-extract-reference=COMPOSITIONTYPE.Pp_SG_TrackerObject041.Vdp_SG_TrackerObject041
      Pp_SG_TrackerObject041: upstream-reference=RootComposition.Pp_SG_TrackerObject041, ecu-extract-reference=COMPOSITIONTYPE.Pp_SG_TrackerObject041
      SG_TrackerObject042: upstream-reference=Pp_SG_TrackerObject042.RootComposition.Vdp_SG_TrackerObject042, ecu-extract-reference=COMPOSITIONTYPE.Pp_SG_TrackerObject042.Vdp_SG_TrackerObject042
      Pp_SG_TrackerObject042: upstream-reference=RootComposition.Pp_SG_TrackerObject042, ecu-extract-reference=COMPOSITIONTYPE.Pp_SG_TrackerObject042
      SG_TrackerObject043: upstream-reference=Pp_SG_TrackerObject043.RootComposition.Vdp_SG_TrackerObject043, ecu-extract-reference=COMPOSITIONTYPE.Pp_SG_TrackerObject043.Vdp_SG_TrackerObject043
      Pp_SG_TrackerObject043: upstream-reference=RootComposition.Pp_SG_TrackerObject043, ecu-extract-reference=COMPOSITIONTYPE.Pp_SG_TrackerObject043
      SG_TrackerObject044: upstream-reference=Pp_SG_TrackerObject044.RootComposition.Vdp_SG_TrackerObject044, ecu-extract-reference=COMPOSITIONTYPE.Pp_SG_TrackerObject044.Vdp_SG_TrackerObject044
      Pp_SG_TrackerObject044: upstream-reference=RootComposition.Pp_SG_TrackerObject044, ecu-extract-reference=COMPOSITIONTYPE.Pp_SG_TrackerObject044
      SG_TrackerObject045: upstream-reference=Pp_SG_TrackerObject045.RootComposition.Vdp_SG_TrackerObject045, ecu-extract-reference=COMPOSITIONTYPE.Pp_SG_TrackerObject045.Vdp_SG_TrackerObject045
      Pp_SG_TrackerObject045: upstream-reference=RootComposition.Pp_SG_TrackerObject045, ecu-extract-reference=COMPOSITIONTYPE.Pp_SG_TrackerObject045
      SG_TrackerObject046: upstream-reference=Pp_SG_TrackerObject046.RootComposition.Vdp_SG_TrackerObject046, ecu-extract-reference=COMPOSITIONTYPE.Pp_SG_TrackerObject046.Vdp_SG_TrackerObject046
      Pp_SG_TrackerObject046: upstream-reference=RootComposition.Pp_SG_TrackerObject046, ecu-extract-reference=COMPOSITIONTYPE.Pp_SG_TrackerObject046
      SG_TrackerObject047: upstream-reference=Pp_SG_TrackerObject047.RootComposition.Vdp_SG_TrackerObject047, ecu-extract-reference=COMPOSITIONTYPE.Pp_SG_TrackerObject047.Vdp_SG_TrackerObject047
      Pp_SG_TrackerObject047: upstream-reference=RootComposition.Pp_SG_TrackerObject047, ecu-extract-reference=COMPOSITIONTYPE.Pp_SG_TrackerObject047
      SG_TrackerObject048: upstream-reference=Pp_SG_TrackerObject048.RootComposition.Vdp_SG_TrackerObject048, ecu-extract-reference=COMPOSITIONTYPE.Pp_SG_TrackerObject048.Vdp_SG_TrackerObject048
      Pp_SG_TrackerObject048: upstream-reference=RootComposition.Pp_SG_TrackerObject048, ecu-extract-reference=COMPOSITIONTYPE.Pp_SG_TrackerObject048
      SG_TrackerObject049: upstream-reference=Pp_SG_TrackerObject049.RootComposition.Vdp_SG_TrackerObject049, ecu-extract-reference=COMPOSITIONTYPE.Pp_SG_TrackerObject049.Vdp_SG_TrackerObject049
      Pp_SG_TrackerObject049: upstream-reference=RootComposition.Pp_SG_TrackerObject049, ecu-extract-reference=COMPOSITIONTYPE.Pp_SG_TrackerObject049
      SG_TrackerObject050: upstream-reference=Pp_SG_TrackerObject050.RootComposition.Vdp_SG_TrackerObject050, ecu-extract-reference=COMPOSITIONTYPE.Pp_SG_TrackerObject050.Vdp_SG_TrackerObject050
      Pp_SG_TrackerObject050: upstream-reference=RootComposition.Pp_SG_TrackerObject050, ecu-extract-reference=COMPOSITIONTYPE.Pp_SG_TrackerObject050
      SG_TrackerObject051: upstream-reference=Pp_SG_TrackerObject051.RootComposition.Vdp_SG_TrackerObject051, ecu-extract-reference=COMPOSITIONTYPE.Pp_SG_TrackerObject051.Vdp_SG_TrackerObject051
      Pp_SG_TrackerObject051: upstream-reference=RootComposition.Pp_SG_TrackerObject051, ecu-extract-reference=COMPOSITIONTYPE.Pp_SG_TrackerObject051
      SG_TrackerObject052: upstream-reference=Pp_SG_TrackerObject052.RootComposition.Vdp_SG_TrackerObject052, ecu-extract-reference=COMPOSITIONTYPE.Pp_SG_TrackerObject052.Vdp_SG_TrackerObject052
      Pp_SG_TrackerObject052: upstream-reference=RootComposition.Pp_SG_TrackerObject052, ecu-extract-reference=COMPOSITIONTYPE.Pp_SG_TrackerObject052
      SG_TrackerObject053: upstream-reference=Pp_SG_TrackerObject053.RootComposition.Vdp_SG_TrackerObject053, ecu-extract-reference=COMPOSITIONTYPE.Pp_SG_TrackerObject053.Vdp_SG_TrackerObject053
      Pp_SG_TrackerObject053: upstream-reference=RootComposition.Pp_SG_TrackerObject053, ecu-extract-reference=COMPOSITIONTYPE.Pp_SG_TrackerObject053
      SG_TrackerObject054: upstream-reference=Pp_SG_TrackerObject054.RootComposition.Vdp_SG_TrackerObject054, ecu-extract-reference=COMPOSITIONTYPE.Pp_SG_TrackerObject054.Vdp_SG_TrackerObject054
      Pp_SG_TrackerObject054: upstream-reference=RootComposition.Pp_SG_TrackerObject054, ecu-extract-reference=COMPOSITIONTYPE.Pp_SG_TrackerObject054
      SG_TrackerObject055: upstream-reference=Pp_SG_TrackerObject055.RootComposition.Vdp_SG_TrackerObject055, ecu-extract-reference=COMPOSITIONTYPE.Pp_SG_TrackerObject055.Vdp_SG_TrackerObject055
      Pp_SG_TrackerObject055: upstream-reference=RootComposition.Pp_SG_TrackerObject055, ecu-extract-reference=COMPOSITIONTYPE.Pp_SG_TrackerObject055
      SG_TrackerObject056: upstream-reference=Pp_SG_TrackerObject056.RootComposition.Vdp_SG_TrackerObject056, ecu-extract-reference=COMPOSITIONTYPE.Pp_SG_TrackerObject056.Vdp_SG_TrackerObject056
      Pp_SG_TrackerObject056: upstream-reference=RootComposition.Pp_SG_TrackerObject056, ecu-extract-reference=COMPOSITIONTYPE.Pp_SG_TrackerObject056
      SG_TrackerObject057: upstream-reference=Pp_SG_TrackerObject057.RootComposition.Vdp_SG_TrackerObject057, ecu-extract-reference=COMPOSITIONTYPE.Pp_SG_TrackerObject057.Vdp_SG_TrackerObject057
      Pp_SG_TrackerObject057: upstream-reference=RootComposition.Pp_SG_TrackerObject057, ecu-extract-reference=COMPOSITIONTYPE.Pp_SG_TrackerObject057
      SG_TrackerObject058: upstream-reference=Pp_SG_TrackerObject058.RootComposition.Vdp_SG_TrackerObject058, ecu-extract-reference=COMPOSITIONTYPE.Pp_SG_TrackerObject058.Vdp_SG_TrackerObject058
      Pp_SG_TrackerObject058: upstream-reference=RootComposition.Pp_SG_TrackerObject058, ecu-extract-reference=COMPOSITIONTYPE.Pp_SG_TrackerObject058
      SG_TrackerObject059: upstream-reference=Pp_SG_TrackerObject059.RootComposition.Vdp_SG_TrackerObject059, ecu-extract-reference=COMPOSITIONTYPE.Pp_SG_TrackerObject059.Vdp_SG_TrackerObject059
      Pp_SG_TrackerObject059: upstream-reference=RootComposition.Pp_SG_TrackerObject059, ecu-extract-reference=COMPOSITIONTYPE.Pp_SG_TrackerObject059
      SG_TrackerObject060: upstream-reference=Pp_SG_TrackerObject060.RootComposition.Vdp_SG_TrackerObject060, ecu-extract-reference=COMPOSITIONTYPE.Pp_SG_TrackerObject060.Vdp_SG_TrackerObject060
      Pp_SG_TrackerObject060: upstream-reference=RootComposition.Pp_SG_TrackerObject060, ecu-extract-reference=COMPOSITIONTYPE.Pp_SG_TrackerObject060
      SG_TrackerObject061: upstream-reference=Pp_SG_TrackerObject061.RootComposition.Vdp_SG_TrackerObject061, ecu-extract-reference=COMPOSITIONTYPE.Pp_SG_TrackerObject061.Vdp_SG_TrackerObject061
      Pp_SG_TrackerObject061: upstream-reference=RootComposition.Pp_SG_TrackerObject061, ecu-extract-reference=COMPOSITIONTYPE.Pp_SG_TrackerObject061
      SG_TrackerObject062: upstream-reference=Pp_SG_TrackerObject062.RootComposition.Vdp_SG_TrackerObject062, ecu-extract-reference=COMPOSITIONTYPE.Pp_SG_TrackerObject062.Vdp_SG_TrackerObject062
      Pp_SG_TrackerObject062: upstream-reference=RootComposition.Pp_SG_TrackerObject062, ecu-extract-reference=COMPOSITIONTYPE.Pp_SG_TrackerObject062
      SG_TrackerObject063: upstream-reference=Pp_SG_TrackerObject063.RootComposition.Vdp_SG_TrackerObject063, ecu-extract-reference=COMPOSITIONTYPE.Pp_SG_TrackerObject063.Vdp_SG_TrackerObject063
      Pp_SG_TrackerObject063: upstream-reference=RootComposition.Pp_SG_TrackerObject063, ecu-extract-reference=COMPOSITIONTYPE.Pp_SG_TrackerObject063
      SG_TrackerObject064: upstream-reference=Pp_SG_TrackerObject064.RootComposition.Vdp_SG_TrackerObject064, ecu-extract-reference=COMPOSITIONTYPE.Pp_SG_TrackerObject064.Vdp_SG_TrackerObject064
      Pp_SG_TrackerObject064: upstream-reference=RootComposition.Pp_SG_TrackerObject064, ecu-extract-reference=COMPOSITIONTYPE.Pp_SG_TrackerObject064
      SWC_PLT_Appl_NvMHandler: upstream-reference=PlatformComposition.RootComposition.SWC_PLT_Appl_NvMHandler, ecu-extract-reference=COMPOSITIONTYPE.SWC_PLT_Appl_NvMHandler
      SWC_PLT_Appl_NvMHandlerRp_PS_Swc_Xcp_AlignmentNvM_PS_SWC_PLT_Appl_NvMHandlerAlignment_NvMBlock: upstream-reference=COMPOSITIONTYPE.SWC_PLT_Appl_NvMHandler.Alignment_NvMBlock, ecu-extract-reference=SWC_PLT_Appl_NvMHandlerRp_PS_Swc_Xcp_AlignmentNvM_PS_SWC_PLT_Appl_NvMHandlerAlignment_NvMBlock
      SWC_PLT_Appl_NvMHandlerAlignment_NvMBlock: upstream-reference=COMPOSITIONTYPE.SWC_PLT_Appl_NvMHandler.Alignment_NvMBlock
      SWC_PLT_Appl_NvMHandlerRp_SWC_PLT_CDD_Rfe_R1R2_FaultNvM_PS_SWC_PLT_Appl_NvMHandlerRFE_R1R2_Fault_NvM: upstream-reference=COMPOSITIONTYPE.SWC_PLT_Appl_NvMHandler.RFE_R1R2_Fault_NvM, ecu-extract-reference=SWC_PLT_Appl_NvMHandlerRp_SWC_PLT_CDD_Rfe_R1R2_FaultNvM_PS_SWC_PLT_Appl_NvMHandlerRFE_R1R2_Fault_NvM
      SWC_PLT_Appl_NvMHandlerRFE_R1R2_Fault_NvM: upstream-reference=COMPOSITIONTYPE.SWC_PLT_Appl_NvMHandler.RFE_R1R2_Fault_NvM
      SWC_PLT_Appl_NvMHandlerRp_SWC_PLT_CDD_FailSafe_ResetReasonNvM_PS_SWC_PLT_Appl_NvMHandlerSWC_PLT_CDD_FailSafe: upstream-reference=COMPOSITIONTYPE.SWC_PLT_Appl_NvMHandler.SWC_PLT_CDD_FailSafe, ecu-extract-reference=SWC_PLT_Appl_NvMHandlerRp_SWC_PLT_CDD_FailSafe_ResetReasonNvM_PS_SWC_PLT_Appl_NvMHandlerSWC_PLT_CDD_FailSafe
      SWC_PLT_Appl_NvMHandlerSWC_PLT_CDD_FailSafe: upstream-reference=COMPOSITIONTYPE.SWC_PLT_Appl_NvMHandler.SWC_PLT_CDD_FailSafe
      SWC_PLT_Appl_NvMHandlerBringup_NvMBlock: upstream-reference=COMPOSITIONTYPE.SWC_PLT_Appl_NvMHandler.Bringup_NvMBlock
      SWC_PLT_Appl_NvMHandlerRp_PS_Swc_NvMBringupNvM_PS_SWC_PLT_Appl_NvMHandlerBringup_NvMBlock: upstream-reference=COMPOSITIONTYPE.SWC_PLT_Appl_NvMHandler.Bringup_NvMBlock, ecu-extract-reference=SWC_PLT_Appl_NvMHandlerRp_NvMBringupNvM_PS_SWC_PLT_Appl_NvMHandlerBringup_NvMBlock
      SWC_PLT_CDD_ExternalWdg: upstream-reference=PlatformComposition.RootComposition.SWC_PLT_CDD_ExternalWdg, ecu-extract-reference=COMPOSITIONTYPE.SWC_PLT_CDD_ExternalWdg
      sysSignal_RDR_1_Detections: upstream-reference=RootComposition.PP_DetectionList_Event.DetectionList_Event, ecu-extract-reference=COMPOSITIONTYPE.PP_DetectionList_Event.DetectionList_Event
      PP_DetectionList_Event: upstream-reference=RootComposition.PP_DetectionList_Event, ecu-extract-reference=COMPOSITIONTYPE.PP_DetectionList_Event
      sysSignal_RDR_1_SW_Info: upstream-reference=RootComposition.PP_RDR_Radar_SW_Info.RDR_SW_Info, ecu-extract-reference=COMPOSITIONTYPE.PP_RDR_Radar_SW_Info.RDR_SW_Info
      PP_RDR_Radar_SW_Info: upstream-reference=RootComposition.PP_RDR_Radar_SW_Info, ecu-extract-reference=COMPOSITIONTYPE.PP_RDR_Radar_SW_Info
      sysSignal_RDR_1_Status: upstream-reference=RootComposition.PP_RDR_Radar_Status.RDR_Status, ecu-extract-reference=COMPOSITIONTYPE.PP_RDR_Radar_Status.RDR_Status
      PP_RDR_Radar_Status: upstream-reference=RootComposition.PP_RDR_Radar_Status, ecu-extract-reference=COMPOSITIONTYPE.PP_RDR_Radar_Status
      sysSignal_ADAS_Vehicle_Status: upstream-reference=RootComposition.RP_Vehicle_Status.Vehicle_Status, ecu-extract-reference=COMPOSITIONTYPE.RP_Vehicle_Status.Vehicle_Status
      RP_Vehicle_Status: upstream-reference=RootComposition.RP_Vehicle_Status, ecu-extract-reference=COMPOSITIONTYPE.RP_Vehicle_Status
      SWC_PLT_Appl_IntWDG: upstream-reference=RootComposition.PlatformComposition.SWC_PLT_Appl_IntWDG, ecu-extract-reference=COMPOSITIONTYPE.SWC_PLT_Appl_IntWDG
      SWC_PLT_CDD_WdgHandler: upstream-reference=RootComposition.PlatformComposition.SWC_PLT_CDD_WdgHandler, ecu-extract-reference=COMPOSITIONTYPE.SWC_PLT_CDD_WdgHandler
      SWC_Appl_Project: upstream-reference=RootComposition.ProjectComposition.SWC_Appl_Project, ecu-extract-reference=COMPOSITIONTYPE.SWC_Appl_Project
      RDR_NM_CAN_NM_State: upstream-reference=RootComposition.Pp_RDR_NM_CAN_NM_State.Vdp_RDR_NM_CAN_NM_State, ecu-extract-reference=COMPOSITIONTYPE.Pp_RDR_NM_CAN_NM_State.Vdp_RDR_NM_CAN_NM_State
      Pp_RDR_NM_CAN_NM_State: upstream-reference=RootComposition.Pp_RDR_NM_CAN_NM_State, ecu-extract-reference=COMPOSITIONTYPE.Pp_RDR_NM_CAN_NM_State
      RDR_NM_CBV_ActWakeBit_4: upstream-reference=RootComposition.Pp_RDR_NM_CBV_ActWakeBit_4.Vdp_RDR_NM_CBV_ActWakeBit_4, ecu-extract-reference=COMPOSITIONTYPE.Pp_RDR_NM_CBV_ActWakeBit_4.Vdp_RDR_NM_CBV_ActWakeBit_4
      Pp_RDR_NM_CBV_ActWakeBit_4: upstream-reference=RootComposition.Pp_RDR_NM_CBV_ActWakeBit_4, ecu-extract-reference=COMPOSITIONTYPE.Pp_RDR_NM_CBV_ActWakeBit_4
      RDR_NM_CBV_NMCoordBit_3: upstream-reference=RootComposition.Pp_RDR_NM_CBV_NMCoordBit_3.Vdp_RDR_NM_CBV_NMCoordBit_3, ecu-extract-reference=COMPOSITIONTYPE.Pp_RDR_NM_CBV_NMCoordBit_3.Vdp_RDR_NM_CBV_NMCoordBit_3
      Pp_RDR_NM_CBV_NMCoordBit_3: upstream-reference=RootComposition.Pp_RDR_NM_CBV_NMCoordBit_3, ecu-extract-reference=COMPOSITIONTYPE.Pp_RDR_NM_CBV_NMCoordBit_3
      RDR_NM_CBV_PNIBit_6: upstream-reference=RootComposition.Pp_RDR_NM_CBV_PNIBit_6.Vdp_RDR_NM_CBV_PNIBit_6, ecu-extract-reference=COMPOSITIONTYPE.Pp_RDR_NM_CBV_PNIBit_6.Vdp_RDR_NM_CBV_PNIBit_6
      Pp_RDR_NM_CBV_PNIBit_6: upstream-reference=RootComposition.Pp_RDR_NM_CBV_PNIBit_6, ecu-extract-reference=COMPOSITIONTYPE.Pp_RDR_NM_CBV_PNIBit_6
      RDR_NM_CBV_ReptMsgBit0: upstream-reference=RootComposition.Pp_RDR_NM_CBV_ReptMsgBit0.Vdp_RDR_NM_CBV_ReptMsgBit0, ecu-extract-reference=COMPOSITIONTYPE.Pp_RDR_NM_CBV_ReptMsgBit0.Vdp_RDR_NM_CBV_ReptMsgBit0
      Pp_RDR_NM_CBV_ReptMsgBit0: upstream-reference=RootComposition.Pp_RDR_NM_CBV_ReptMsgBit0, ecu-extract-reference=COMPOSITIONTYPE.Pp_RDR_NM_CBV_ReptMsgBit0
      RDR_NM_CBV_ResdBit_1: upstream-reference=RootComposition.Pp_RDR_NM_CBV_ResdBit_1.Vdp_RDR_NM_CBV_ResdBit_1, ecu-extract-reference=COMPOSITIONTYPE.Pp_RDR_NM_CBV_ResdBit_1.Vdp_RDR_NM_CBV_ResdBit_1
      Pp_RDR_NM_CBV_ResdBit_1: upstream-reference=RootComposition.Pp_RDR_NM_CBV_ResdBit_1, ecu-extract-reference=COMPOSITIONTYPE.Pp_RDR_NM_CBV_ResdBit_1
      RDR_NM_CBV_ResdBit_2: upstream-reference=RootComposition.Pp_RDR_NM_CBV_ResdBit_2.Vdp_RDR_NM_CBV_ResdBit_2, ecu-extract-reference=COMPOSITIONTYPE.Pp_RDR_NM_CBV_ResdBit_2.Vdp_RDR_NM_CBV_ResdBit_2
      Pp_RDR_NM_CBV_ResdBit_2: upstream-reference=RootComposition.Pp_RDR_NM_CBV_ResdBit_2, ecu-extract-reference=COMPOSITIONTYPE.Pp_RDR_NM_CBV_ResdBit_2
      RDR_NM_CBV_ResdBit_5: upstream-reference=RootComposition.Pp_RDR_NM_CBV_ResdBit_5.Vdp_RDR_NM_CBV_ResdBit_5, ecu-extract-reference=COMPOSITIONTYPE.Pp_RDR_NM_CBV_ResdBit_5.Vdp_RDR_NM_CBV_ResdBit_5
      Pp_RDR_NM_CBV_ResdBit_5: upstream-reference=RootComposition.Pp_RDR_NM_CBV_ResdBit_5, ecu-extract-reference=COMPOSITIONTYPE.Pp_RDR_NM_CBV_ResdBit_5
      RDR_NM_CBV_ResdBit_7: upstream-reference=RootComposition.Pp_RDR_NM_CBV_ResdBit_7.Vdp_RDR_NM_CBV_ResdBit_7, ecu-extract-reference=COMPOSITIONTYPE.Pp_RDR_NM_CBV_ResdBit_7.Vdp_RDR_NM_CBV_ResdBit_7
      Pp_RDR_NM_CBV_ResdBit_7: upstream-reference=RootComposition.Pp_RDR_NM_CBV_ResdBit_7, ecu-extract-reference=COMPOSITIONTYPE.Pp_RDR_NM_CBV_ResdBit_7
      RDR_NM_PN_User_Data: upstream-reference=RootComposition.Pp_RDR_NM_PN_User_Data.Vdp_RDR_NM_PN_User_Data, ecu-extract-reference=COMPOSITIONTYPE.Pp_RDR_NM_PN_User_Data.Vdp_RDR_NM_PN_User_Data
      Pp_RDR_NM_PN_User_Data: upstream-reference=RootComposition.Pp_RDR_NM_PN_User_Data, ecu-extract-reference=COMPOSITIONTYPE.Pp_RDR_NM_PN_User_Data
      RDR_NM_PNC_Reserved1: upstream-reference=RootComposition.Pp_RDR_NM_PNC_Reserved1.Vdp_RDR_NM_PNC_Reserved1, ecu-extract-reference=COMPOSITIONTYPE.Pp_RDR_NM_PNC_Reserved1.Vdp_RDR_NM_PNC_Reserved1
      Pp_RDR_NM_PNC_Reserved1: upstream-reference=RootComposition.Pp_RDR_NM_PNC_Reserved1, ecu-extract-reference=COMPOSITIONTYPE.Pp_RDR_NM_PNC_Reserved1
      RDR_NM_PNC_Reserved2: upstream-reference=RootComposition.Pp_RDR_NM_PNC_Reserved2.Vdp_RDR_NM_PNC_Reserved2, ecu-extract-reference=COMPOSITIONTYPE.Pp_RDR_NM_PNC_Reserved2.Vdp_RDR_NM_PNC_Reserved2
      Pp_RDR_NM_PNC_Reserved2: upstream-reference=RootComposition.Pp_RDR_NM_PNC_Reserved2, ecu-extract-reference=COMPOSITIONTYPE.Pp_RDR_NM_PNC_Reserved2
      RDR_NM_PNC_Reserved3: upstream-reference=RootComposition.Pp_RDR_NM_PNC_Reserved3.Vdp_RDR_NM_PNC_Reserved3, ecu-extract-reference=COMPOSITIONTYPE.Pp_RDR_NM_PNC_Reserved3.Vdp_RDR_NM_PNC_Reserved3
      Pp_RDR_NM_PNC_Reserved3: upstream-reference=RootComposition.Pp_RDR_NM_PNC_Reserved3, ecu-extract-reference=COMPOSITIONTYPE.Pp_RDR_NM_PNC_Reserved3
      RDR_NM_Wakeup_And_Reason: upstream-reference=RootComposition.Pp_RDR_NM_Wakeup_And_Reason.Vdp_RDR_NM_Wakeup_And_Reason, ecu-extract-reference=COMPOSITIONTYPE.Pp_RDR_NM_Wakeup_And_Reason.Vdp_RDR_NM_Wakeup_And_Reason
      Pp_RDR_NM_Wakeup_And_Reason: upstream-reference=RootComposition.Pp_RDR_NM_Wakeup_And_Reason, ecu-extract-reference=COMPOSITIONTYPE.Pp_RDR_NM_Wakeup_And_Reason
      Pp_SG_AlignmentStatus1: upstream-reference=RootComposition.Pp_SG_AlignmentStatus1, ecu-extract-reference=COMPOSITIONTYPE.Pp_SG_AlignmentStatus1
      Pp_SG_AlignmentStatus2: upstream-reference=RootComposition.Pp_SG_AlignmentStatus2, ecu-extract-reference=COMPOSITIONTYPE.Pp_SG_AlignmentStatus2
      Pp_SG_Detections_001_004: upstream-reference=RootComposition.Pp_SG_Detections_001_004, ecu-extract-reference=COMPOSITIONTYPE.Pp_SG_Detections_001_004
      Pp_SG_Detections_005_008: upstream-reference=RootComposition.Pp_SG_Detections_005_008, ecu-extract-reference=COMPOSITIONTYPE.Pp_SG_Detections_005_008
      Pp_SG_Detections_009_012: upstream-reference=RootComposition.Pp_SG_Detections_009_012, ecu-extract-reference=COMPOSITIONTYPE.Pp_SG_Detections_009_012
      Pp_SG_Detections_013_016: upstream-reference=RootComposition.Pp_SG_Detections_013_016, ecu-extract-reference=COMPOSITIONTYPE.Pp_SG_Detections_013_016
      Pp_SG_Detections_017_020: upstream-reference=RootComposition.Pp_SG_Detections_017_020, ecu-extract-reference=COMPOSITIONTYPE.Pp_SG_Detections_017_020
      Pp_SG_Detections_021_024: upstream-reference=RootComposition.Pp_SG_Detections_021_024, ecu-extract-reference=COMPOSITIONTYPE.Pp_SG_Detections_021_024
      Pp_SG_Detections_025_028: upstream-reference=RootComposition.Pp_SG_Detections_025_028, ecu-extract-reference=COMPOSITIONTYPE.Pp_SG_Detections_025_028
      Pp_SG_Detections_029_032: upstream-reference=RootComposition.Pp_SG_Detections_029_032, ecu-extract-reference=COMPOSITIONTYPE.Pp_SG_Detections_029_032
      Pp_SG_Detections_033_036: upstream-reference=RootComposition.Pp_SG_Detections_033_036, ecu-extract-reference=COMPOSITIONTYPE.Pp_SG_Detections_033_036
      Pp_SG_Detections_037_040: upstream-reference=RootComposition.Pp_SG_Detections_037_040, ecu-extract-reference=COMPOSITIONTYPE.Pp_SG_Detections_037_040
      Pp_SG_Detections_041_044: upstream-reference=RootComposition.Pp_SG_Detections_041_044, ecu-extract-reference=COMPOSITIONTYPE.Pp_SG_Detections_041_044
      Pp_SG_Detections_045_048: upstream-reference=RootComposition.Pp_SG_Detections_045_048, ecu-extract-reference=COMPOSITIONTYPE.Pp_SG_Detections_045_048
      Pp_SG_Detections_049_052: upstream-reference=RootComposition.Pp_SG_Detections_049_052, ecu-extract-reference=COMPOSITIONTYPE.Pp_SG_Detections_049_052
      Pp_SG_Detections_053_056: upstream-reference=RootComposition.Pp_SG_Detections_053_056, ecu-extract-reference=COMPOSITIONTYPE.Pp_SG_Detections_053_056
      Pp_SG_Detections_057_060: upstream-reference=RootComposition.Pp_SG_Detections_057_060, ecu-extract-reference=COMPOSITIONTYPE.Pp_SG_Detections_057_060
      Pp_SG_Detections_061_064: upstream-reference=RootComposition.Pp_SG_Detections_061_064, ecu-extract-reference=COMPOSITIONTYPE.Pp_SG_Detections_061_064
      Pp_SG_Detections_065_068: upstream-reference=RootComposition.Pp_SG_Detections_065_068, ecu-extract-reference=COMPOSITIONTYPE.Pp_SG_Detections_065_068
      Pp_SG_Detections_069_072: upstream-reference=RootComposition.Pp_SG_Detections_069_072, ecu-extract-reference=COMPOSITIONTYPE.Pp_SG_Detections_069_072
      Pp_SG_Detections_073_076: upstream-reference=RootComposition.Pp_SG_Detections_073_076, ecu-extract-reference=COMPOSITIONTYPE.Pp_SG_Detections_073_076
      Pp_SG_Detections_077_080: upstream-reference=RootComposition.Pp_SG_Detections_077_080, ecu-extract-reference=COMPOSITIONTYPE.Pp_SG_Detections_077_080
      Pp_SG_Detections_081_084: upstream-reference=RootComposition.Pp_SG_Detections_081_084, ecu-extract-reference=COMPOSITIONTYPE.Pp_SG_Detections_081_084
      Pp_SG_Detections_085_088: upstream-reference=RootComposition.Pp_SG_Detections_085_088, ecu-extract-reference=COMPOSITIONTYPE.Pp_SG_Detections_085_088
      Pp_SG_Detections_089_092: upstream-reference=RootComposition.Pp_SG_Detections_089_092, ecu-extract-reference=COMPOSITIONTYPE.Pp_SG_Detections_089_092
      Pp_SG_Detections_093_096: upstream-reference=RootComposition.Pp_SG_Detections_093_096, ecu-extract-reference=COMPOSITIONTYPE.Pp_SG_Detections_093_096
      Pp_SG_Detections_097_100: upstream-reference=RootComposition.Pp_SG_Detections_097_100, ecu-extract-reference=COMPOSITIONTYPE.Pp_SG_Detections_097_100
      Pp_SG_Detections_101_104: upstream-reference=RootComposition.Pp_SG_Detections_101_104, ecu-extract-reference=COMPOSITIONTYPE.Pp_SG_Detections_101_104
      Pp_SG_Detections_105_108: upstream-reference=RootComposition.Pp_SG_Detections_105_108, ecu-extract-reference=COMPOSITIONTYPE.Pp_SG_Detections_105_108
      Pp_SG_Detections_109_112: upstream-reference=RootComposition.Pp_SG_Detections_109_112, ecu-extract-reference=COMPOSITIONTYPE.Pp_SG_Detections_109_112
      Pp_SG_Detections_113_116: upstream-reference=RootComposition.Pp_SG_Detections_113_116, ecu-extract-reference=COMPOSITIONTYPE.Pp_SG_Detections_113_116
      Pp_SG_Detections_117_120: upstream-reference=RootComposition.Pp_SG_Detections_117_120, ecu-extract-reference=COMPOSITIONTYPE.Pp_SG_Detections_117_120
      Pp_SG_Detections_121_124: upstream-reference=RootComposition.Pp_SG_Detections_121_124, ecu-extract-reference=COMPOSITIONTYPE.Pp_SG_Detections_121_124
      Pp_SG_Detections_125_128: upstream-reference=RootComposition.Pp_SG_Detections_125_128, ecu-extract-reference=COMPOSITIONTYPE.Pp_SG_Detections_125_128
      Pp_SG_Detections_129_132: upstream-reference=RootComposition.Pp_SG_Detections_129_132, ecu-extract-reference=COMPOSITIONTYPE.Pp_SG_Detections_129_132
      Pp_SG_Detections_133_136: upstream-reference=RootComposition.Pp_SG_Detections_133_136, ecu-extract-reference=COMPOSITIONTYPE.Pp_SG_Detections_133_136
      Pp_SG_Detections_137_140: upstream-reference=RootComposition.Pp_SG_Detections_137_140, ecu-extract-reference=COMPOSITIONTYPE.Pp_SG_Detections_137_140
      Pp_SG_Detections_141_144: upstream-reference=RootComposition.Pp_SG_Detections_141_144, ecu-extract-reference=COMPOSITIONTYPE.Pp_SG_Detections_141_144
      Pp_SG_Detections_145_148: upstream-reference=RootComposition.Pp_SG_Detections_145_148, ecu-extract-reference=COMPOSITIONTYPE.Pp_SG_Detections_145_148
      Pp_SG_Detections_149_152: upstream-reference=RootComposition.Pp_SG_Detections_149_152, ecu-extract-reference=COMPOSITIONTYPE.Pp_SG_Detections_149_152
      Pp_SG_Detections_153_156: upstream-reference=RootComposition.Pp_SG_Detections_153_156, ecu-extract-reference=COMPOSITIONTYPE.Pp_SG_Detections_153_156
      Pp_SG_Detections_157_160: upstream-reference=RootComposition.Pp_SG_Detections_157_160, ecu-extract-reference=COMPOSITIONTYPE.Pp_SG_Detections_157_160
      Pp_SG_Detections_161_164: upstream-reference=RootComposition.Pp_SG_Detections_161_164, ecu-extract-reference=COMPOSITIONTYPE.Pp_SG_Detections_161_164
      Pp_SG_Detections_165_168: upstream-reference=RootComposition.Pp_SG_Detections_165_168, ecu-extract-reference=COMPOSITIONTYPE.Pp_SG_Detections_165_168
      Pp_SG_Detections_169_172: upstream-reference=RootComposition.Pp_SG_Detections_169_172, ecu-extract-reference=COMPOSITIONTYPE.Pp_SG_Detections_169_172
      Pp_SG_Detections_173_176: upstream-reference=RootComposition.Pp_SG_Detections_173_176, ecu-extract-reference=COMPOSITIONTYPE.Pp_SG_Detections_173_176
      Pp_SG_Detections_177_180: upstream-reference=RootComposition.Pp_SG_Detections_177_180, ecu-extract-reference=COMPOSITIONTYPE.Pp_SG_Detections_177_180
      Pp_SG_Detections_181_184: upstream-reference=RootComposition.Pp_SG_Detections_181_184, ecu-extract-reference=COMPOSITIONTYPE.Pp_SG_Detections_181_184
      Pp_SG_Detections_185_188: upstream-reference=RootComposition.Pp_SG_Detections_185_188, ecu-extract-reference=COMPOSITIONTYPE.Pp_SG_Detections_185_188
      Pp_SG_Detections_189_192: upstream-reference=RootComposition.Pp_SG_Detections_189_192, ecu-extract-reference=COMPOSITIONTYPE.Pp_SG_Detections_189_192
      Pp_SG_Detections_193_196: upstream-reference=RootComposition.Pp_SG_Detections_193_196, ecu-extract-reference=COMPOSITIONTYPE.Pp_SG_Detections_193_196
      Pp_SG_Detections_197_200: upstream-reference=RootComposition.Pp_SG_Detections_197_200, ecu-extract-reference=COMPOSITIONTYPE.Pp_SG_Detections_197_200
      Pp_SG_Detections_201_204: upstream-reference=RootComposition.Pp_SG_Detections_201_204, ecu-extract-reference=COMPOSITIONTYPE.Pp_SG_Detections_201_204
      Pp_SG_Detections_205_208: upstream-reference=RootComposition.Pp_SG_Detections_205_208, ecu-extract-reference=COMPOSITIONTYPE.Pp_SG_Detections_205_208
      Pp_SG_Detections_209_212: upstream-reference=RootComposition.Pp_SG_Detections_209_212, ecu-extract-reference=COMPOSITIONTYPE.Pp_SG_Detections_209_212
      Pp_SG_Detections_213_216: upstream-reference=RootComposition.Pp_SG_Detections_213_216, ecu-extract-reference=COMPOSITIONTYPE.Pp_SG_Detections_213_216
      Pp_SG_Detections_217_220: upstream-reference=RootComposition.Pp_SG_Detections_217_220, ecu-extract-reference=COMPOSITIONTYPE.Pp_SG_Detections_217_220
      Pp_SG_Detections_221_224: upstream-reference=RootComposition.Pp_SG_Detections_221_224, ecu-extract-reference=COMPOSITIONTYPE.Pp_SG_Detections_221_224
      Pp_SG_Detections_225_228: upstream-reference=RootComposition.Pp_SG_Detections_225_228, ecu-extract-reference=COMPOSITIONTYPE.Pp_SG_Detections_225_228
      Pp_SG_Detections_229_232: upstream-reference=RootComposition.Pp_SG_Detections_229_232, ecu-extract-reference=COMPOSITIONTYPE.Pp_SG_Detections_229_232
      Pp_SG_Detections_233_236: upstream-reference=RootComposition.Pp_SG_Detections_233_236, ecu-extract-reference=COMPOSITIONTYPE.Pp_SG_Detections_233_236
      Pp_SG_Detections_237_240: upstream-reference=RootComposition.Pp_SG_Detections_237_240, ecu-extract-reference=COMPOSITIONTYPE.Pp_SG_Detections_237_240
      Pp_SG_Detections_241_244: upstream-reference=RootComposition.Pp_SG_Detections_241_244, ecu-extract-reference=COMPOSITIONTYPE.Pp_SG_Detections_241_244
      Pp_SG_Detections_245_248: upstream-reference=RootComposition.Pp_SG_Detections_245_248, ecu-extract-reference=COMPOSITIONTYPE.Pp_SG_Detections_245_248
      Pp_SG_Detections_249_252: upstream-reference=RootComposition.Pp_SG_Detections_249_252, ecu-extract-reference=COMPOSITIONTYPE.Pp_SG_Detections_249_252
      Pp_SG_Detections_253_256: upstream-reference=RootComposition.Pp_SG_Detections_253_256, ecu-extract-reference=COMPOSITIONTYPE.Pp_SG_Detections_253_256
      Pp_SG_Detections_257_260: upstream-reference=RootComposition.Pp_SG_Detections_257_260, ecu-extract-reference=COMPOSITIONTYPE.Pp_SG_Detections_257_260
      Pp_SG_Detections_261_264: upstream-reference=RootComposition.Pp_SG_Detections_261_264, ecu-extract-reference=COMPOSITIONTYPE.Pp_SG_Detections_261_264
      Pp_SG_Detections_265_268: upstream-reference=RootComposition.Pp_SG_Detections_265_268, ecu-extract-reference=COMPOSITIONTYPE.Pp_SG_Detections_265_268
      Pp_SG_Detections_269_272: upstream-reference=RootComposition.Pp_SG_Detections_269_272, ecu-extract-reference=COMPOSITIONTYPE.Pp_SG_Detections_269_272
      Pp_SG_Detections_273_276: upstream-reference=RootComposition.Pp_SG_Detections_273_276, ecu-extract-reference=COMPOSITIONTYPE.Pp_SG_Detections_273_276
      Pp_SG_Detections_277_280: upstream-reference=RootComposition.Pp_SG_Detections_277_280, ecu-extract-reference=COMPOSITIONTYPE.Pp_SG_Detections_277_280
      Pp_SG_Detections_281_284: upstream-reference=RootComposition.Pp_SG_Detections_281_284, ecu-extract-reference=COMPOSITIONTYPE.Pp_SG_Detections_281_284
      Pp_SG_Detections_285_288: upstream-reference=RootComposition.Pp_SG_Detections_285_288, ecu-extract-reference=COMPOSITIONTYPE.Pp_SG_Detections_285_288
      Pp_SG_Detections_289_292: upstream-reference=RootComposition.Pp_SG_Detections_289_292, ecu-extract-reference=COMPOSITIONTYPE.Pp_SG_Detections_289_292
      Pp_SG_Detections_293_296: upstream-reference=RootComposition.Pp_SG_Detections_293_296, ecu-extract-reference=COMPOSITIONTYPE.Pp_SG_Detections_293_296
      Pp_SG_Detections_297_300: upstream-reference=RootComposition.Pp_SG_Detections_297_300, ecu-extract-reference=COMPOSITIONTYPE.Pp_SG_Detections_297_300
      Pp_SG_Detections_301_304: upstream-reference=RootComposition.Pp_SG_Detections_301_304, ecu-extract-reference=COMPOSITIONTYPE.Pp_SG_Detections_301_304
      Pp_SG_Detections_305_308: upstream-reference=RootComposition.Pp_SG_Detections_305_308, ecu-extract-reference=COMPOSITIONTYPE.Pp_SG_Detections_305_308
      Pp_SG_Detections_309_312: upstream-reference=RootComposition.Pp_SG_Detections_309_312, ecu-extract-reference=COMPOSITIONTYPE.Pp_SG_Detections_309_312
      Pp_SG_Detections_313_316: upstream-reference=RootComposition.Pp_SG_Detections_313_316, ecu-extract-reference=COMPOSITIONTYPE.Pp_SG_Detections_313_316
      Pp_SG_Detections_317_320: upstream-reference=RootComposition.Pp_SG_Detections_317_320, ecu-extract-reference=COMPOSITIONTYPE.Pp_SG_Detections_317_320
      Pp_SG_Detections_321_324: upstream-reference=RootComposition.Pp_SG_Detections_321_324, ecu-extract-reference=COMPOSITIONTYPE.Pp_SG_Detections_321_324
      Pp_SG_Detections_325_328: upstream-reference=RootComposition.Pp_SG_Detections_325_328, ecu-extract-reference=COMPOSITIONTYPE.Pp_SG_Detections_325_328
      Pp_SG_Detections_329_332: upstream-reference=RootComposition.Pp_SG_Detections_329_332, ecu-extract-reference=COMPOSITIONTYPE.Pp_SG_Detections_329_332
      Pp_SG_Detections_333_336: upstream-reference=RootComposition.Pp_SG_Detections_333_336, ecu-extract-reference=COMPOSITIONTYPE.Pp_SG_Detections_333_336
      Pp_SG_Detections_337_340: upstream-reference=RootComposition.Pp_SG_Detections_337_340, ecu-extract-reference=COMPOSITIONTYPE.Pp_SG_Detections_337_340
      Pp_SG_Detections_341_344: upstream-reference=RootComposition.Pp_SG_Detections_341_344, ecu-extract-reference=COMPOSITIONTYPE.Pp_SG_Detections_341_344
      Pp_SG_Detections_345_348: upstream-reference=RootComposition.Pp_SG_Detections_345_348, ecu-extract-reference=COMPOSITIONTYPE.Pp_SG_Detections_345_348
      Pp_SG_Detections_349_352: upstream-reference=RootComposition.Pp_SG_Detections_349_352, ecu-extract-reference=COMPOSITIONTYPE.Pp_SG_Detections_349_352
      Pp_SG_Detections_353_356: upstream-reference=RootComposition.Pp_SG_Detections_353_356, ecu-extract-reference=COMPOSITIONTYPE.Pp_SG_Detections_353_356
      Pp_SG_Detections_357_360: upstream-reference=RootComposition.Pp_SG_Detections_357_360, ecu-extract-reference=COMPOSITIONTYPE.Pp_SG_Detections_357_360
      Pp_SG_Detections_361_364: upstream-reference=RootComposition.Pp_SG_Detections_361_364, ecu-extract-reference=COMPOSITIONTYPE.Pp_SG_Detections_361_364
      Pp_SG_Detections_365_368: upstream-reference=RootComposition.Pp_SG_Detections_365_368, ecu-extract-reference=COMPOSITIONTYPE.Pp_SG_Detections_365_368
      Pp_SG_Detections_369_372: upstream-reference=RootComposition.Pp_SG_Detections_369_372, ecu-extract-reference=COMPOSITIONTYPE.Pp_SG_Detections_369_372
      Pp_SG_Detections_373_376: upstream-reference=RootComposition.Pp_SG_Detections_373_376, ecu-extract-reference=COMPOSITIONTYPE.Pp_SG_Detections_373_376
      Pp_SG_Detections_377_380: upstream-reference=RootComposition.Pp_SG_Detections_377_380, ecu-extract-reference=COMPOSITIONTYPE.Pp_SG_Detections_377_380
      Pp_SG_Detections_381_384: upstream-reference=RootComposition.Pp_SG_Detections_381_384, ecu-extract-reference=COMPOSITIONTYPE.Pp_SG_Detections_381_384
      Pp_SG_Detections_385_388: upstream-reference=RootComposition.Pp_SG_Detections_385_388, ecu-extract-reference=COMPOSITIONTYPE.Pp_SG_Detections_385_388
      Pp_SG_Detections_389_392: upstream-reference=RootComposition.Pp_SG_Detections_389_392, ecu-extract-reference=COMPOSITIONTYPE.Pp_SG_Detections_389_392
      Pp_SG_Detections_393_396: upstream-reference=RootComposition.Pp_SG_Detections_393_396, ecu-extract-reference=COMPOSITIONTYPE.Pp_SG_Detections_393_396
      Pp_SG_Detections_397_400: upstream-reference=RootComposition.Pp_SG_Detections_397_400, ecu-extract-reference=COMPOSITIONTYPE.Pp_SG_Detections_397_400
      Pp_SG_RadarCapability: upstream-reference=RootComposition.Pp_SG_RadarCapability, ecu-extract-reference=COMPOSITIONTYPE.Pp_SG_RadarCapability
      Pp_SG_RadarHeader: upstream-reference=RootComposition.Pp_SG_RadarHeader, ecu-extract-reference=COMPOSITIONTYPE.Pp_SG_RadarHeader
      Pp_SG_RadarStatus1: upstream-reference=RootComposition.Pp_SG_RadarStatus1, ecu-extract-reference=COMPOSITIONTYPE.Pp_SG_RadarStatus1
      Pp_SG_RadarStatus2: upstream-reference=RootComposition.Pp_SG_RadarStatus2, ecu-extract-reference=COMPOSITIONTYPE.Pp_SG_RadarStatus2
      SG_TrackerHeader: upstream-reference=RootComposition.Pp_SG_TrackerHeader.Vdp_SG_TrackerHeader, ecu-extract-reference=COMPOSITIONTYPE.Pp_SG_TrackerHeader.Vdp_SG_TrackerHeader
      Pp_SG_TrackerHeader: upstream-reference=RootComposition.Pp_SG_TrackerHeader, ecu-extract-reference=COMPOSITIONTYPE.Pp_SG_TrackerHeader
      SG_TrackerStatus: upstream-reference=RootComposition.Pp_SG_TrackerStatus.Vdp_SG_TrackerStatus, ecu-extract-reference=COMPOSITIONTYPE.Pp_SG_TrackerStatus.Vdp_SG_TrackerStatus
      Pp_SG_TrackerStatus: upstream-reference=RootComposition.Pp_SG_TrackerStatus, ecu-extract-reference=COMPOSITIONTYPE.Pp_SG_TrackerStatus
      Rp_SG_VehicleStatus: upstream-reference=RootComposition.Rp_SG_VehicleStatus, ecu-extract-reference=COMPOSITIONTYPE.Rp_SG_VehicleStatus
      Rp_SG_XcpCTOReq: upstream-reference=RootComposition.Rp_SG_XcpCTOReq, ecu-extract-reference=COMPOSITIONTYPE.Rp_SG_XcpCTOReq
      Pp_SG_XcpCTOResp: upstream-reference=RootComposition.Pp_SG_XcpCTOResp, ecu-extract-reference=COMPOSITIONTYPE.Pp_SG_XcpCTOResp
      Pp_SG_XcpDAQResp: upstream-reference=RootComposition.Pp_SG_XcpDAQResp, ecu-extract-reference=COMPOSITIONTYPE.Pp_SG_XcpDAQResp
      TSYN_OVS: upstream-reference=RootComposition.Rp_TSYN_OVS.Vdp_TSYN_OVS, ecu-extract-reference=COMPOSITIONTYPE.Rp_TSYN_OVS.Vdp_TSYN_OVS, variation-point=post-build-variant-condition{matching-criterion=RDR_POS, value=1}
      Rp_TSYN_OVS: upstream-reference=RootComposition.Rp_TSYN_OVS, ecu-extract-reference=COMPOSITIONTYPE.Rp_TSYN_OVS
      TSYN_PDU: upstream-reference=RootComposition.Rp_TSYN_PDU.Vdp_TSYN_PDU, ecu-extract-reference=COMPOSITIONTYPE.Rp_TSYN_PDU.Vdp_TSYN_PDU, variation-point=post-build-variant-condition{matching-criterion=RDR_POS, value=1}
      Rp_TSYN_PDU: upstream-reference=RootComposition.Rp_TSYN_PDU, ecu-extract-reference=COMPOSITIONTYPE.Rp_TSYN_PDU
      TSYN_RESERVED: upstream-reference=RootComposition.Rp_TSYN_RESERVED.Vdp_TSYN_RESERVED, ecu-extract-reference=COMPOSITIONTYPE.Rp_TSYN_RESERVED.Vdp_TSYN_RESERVED, variation-point=post-build-variant-condition{matching-criterion=RDR_POS, value=1}
      Rp_TSYN_RESERVED: upstream-reference=RootComposition.Rp_TSYN_RESERVED, ecu-extract-reference=COMPOSITIONTYPE.Rp_TSYN_RESERVED
      TSYN_SEQUENCE_COUNTER: upstream-reference=RootComposition.Rp_TSYN_SEQUENCE_COUNTER.Vdp_TSYN_SEQUENCE_COUNTER, ecu-extract-reference=COMPOSITIONTYPE.Rp_TSYN_SEQUENCE_COUNTER.Vdp_TSYN_SEQUENCE_COUNTER, variation-point=post-build-variant-condition{matching-criterion=RDR_POS, value=1}
      Rp_TSYN_SEQUENCE_COUNTER: upstream-reference=RootComposition.Rp_TSYN_SEQUENCE_COUNTER, ecu-extract-reference=COMPOSITIONTYPE.Rp_TSYN_SEQUENCE_COUNTER
      TSYN_SGW: upstream-reference=RootComposition.Rp_TSYN_SGW.Vdp_TSYN_SGW, ecu-extract-reference=COMPOSITIONTYPE.Rp_TSYN_SGW.Vdp_TSYN_SGW, variation-point=post-build-variant-condition{matching-criterion=RDR_POS, value=1}
      Rp_TSYN_SGW: upstream-reference=RootComposition.Rp_TSYN_SGW, ecu-extract-reference=COMPOSITIONTYPE.Rp_TSYN_SGW
      TSYN_SYNCTIME_NANOSEC: upstream-reference=RootComposition.Rp_TSYN_SYNCTIME_NANOSEC.Vdp_TSYN_SYNCTIME_NANOSEC, ecu-extract-reference=COMPOSITIONTYPE.Rp_TSYN_SYNCTIME_NANOSEC.Vdp_TSYN_SYNCTIME_NANOSEC, variation-point=post-build-variant-condition{matching-criterion=RDR_POS, value=1}
      Rp_TSYN_SYNCTIME_NANOSEC: upstream-reference=RootComposition.Rp_TSYN_SYNCTIME_NANOSEC, ecu-extract-reference=COMPOSITIONTYPE.Rp_TSYN_SYNCTIME_NANOSEC
      TSYN_SYNCTIME_SEC: upstream-reference=RootComposition.Rp_TSYN_SYNCTIME_SEC.Vdp_TSYN_SYNCTIME_SEC, ecu-extract-reference=COMPOSITIONTYPE.Rp_TSYN_SYNCTIME_SEC.Vdp_TSYN_SYNCTIME_SEC, variation-point=post-build-variant-condition{matching-criterion=RDR_POS, value=1}
      Rp_TSYN_SYNCTIME_SEC: upstream-reference=RootComposition.Rp_TSYN_SYNCTIME_SEC, ecu-extract-reference=COMPOSITIONTYPE.Rp_TSYN_SYNCTIME_SEC
      TSYN_TIMEDOMAIN: upstream-reference=RootComposition.Rp_TSYN_TIMEDOMAIN.Vdp_TSYN_TIMEDOMAIN, ecu-extract-reference=COMPOSITIONTYPE.Rp_TSYN_TIMEDOMAIN.Vdp_TSYN_TIMEDOMAIN, variation-point=post-build-variant-condition{matching-criterion=RDR_POS, value=1}
      Rp_TSYN_TIMEDOMAIN: upstream-reference=RootComposition.Rp_TSYN_TIMEDOMAIN, ecu-extract-reference=COMPOSITIONTYPE.Rp_TSYN_TIMEDOMAIN
      TSYN_USERBYTE: upstream-reference=RootComposition.Rp_TSYN_USERBYTE.Vdp_TSYN_USERBYTE, ecu-extract-reference=COMPOSITIONTYPE.Rp_TSYN_USERBYTE.Vdp_TSYN_USERBYTE, variation-point=post-build-variant-condition{matching-criterion=RDR_POS, value=1}
      Rp_TSYN_USERBYTE: upstream-reference=RootComposition.Rp_TSYN_USERBYTE, ecu-extract-reference=COMPOSITIONTYPE.Rp_TSYN_USERBYTE
      TSYNC_CRC: upstream-reference=RootComposition.Rp_TSYNC_CRC.Vdp_TSYNC_CRC, ecu-extract-reference=COMPOSITIONTYPE.Rp_TSYNC_CRC.Vdp_TSYNC_CRC, variation-point=post-build-variant-condition{matching-criterion=RDR_POS, value=1}
      Rp_TSYNC_CRC: upstream-reference=RootComposition.Rp_TSYNC_CRC, ecu-extract-reference=COMPOSITIONTYPE.Rp_TSYNC_CRC
      SWC_PLT_CDD_FCRU: upstream-reference=RootComposition.PlatformComposition.SWC_PLT_CDD_FCRU, ecu-extract-reference=COMPOSITIONTYPE.SWC_PLT_CDD_FCRU
      SWC_PLT_CDD_HIL: upstream-reference=RootComposition.PlatformComposition.SWC_PLT_CDD_HIL, ecu-extract-reference=COMPOSITIONTYPE.SWC_PLT_CDD_HIL
      SWC_PRJ_Appl_FaultMgr: upstream-reference=RootComposition.ProjectComposition.SWC_PRJ_Appl_FaultMgr, ecu-extract-reference=COMPOSITIONTYPE.SWC_PRJ_Appl_FaultMgr
      Pp_HistoryFaultTable: upstream-reference=RootComposition.Pp_HistoryFaultTable, ecu-extract-reference=COMPOSITIONTYPE.Pp_HistoryFaultTable
      Pp_FaultTestCompleteTable: upstream-reference=RootComposition.Pp_FaultTestCompleteTable, ecu-extract-reference=COMPOSITIONTYPE.Pp_FaultTestCompleteTable
      Pp_ActiveFaultTable: upstream-reference=RootComposition.Pp_ActiveFaultTable, ecu-extract-reference=COMPOSITIONTYPE.Pp_ActiveFaultTable
      Pp_ActiveFaultLatchTable: upstream-reference=RootComposition.Pp_ActiveFaultLatchTable, ecu-extract-reference=COMPOSITIONTYPE.Pp_ActiveFaultLatchTable
      SWC_PLT_CDD_TimeSync: upstream-reference=RootComposition.PlatformComposition.SWC_PLT_CDD_TimeSync, ecu-extract-reference=COMPOSITIONTYPE.SWC_PLT_CDD_TimeSync
      SG_AlignmentStatus1: upstream-reference=RootComposition.Pp_SG_AlignmentStatus1_AL.Vdp_SG_AlignmentStatus1_AL, ecu-extract-reference=COMPOSITIONTYPE.Pp_SG_AlignmentStatus1_AL.Vdp_SG_AlignmentStatus1_AL
      Pp_SG_AlignmentStatus1_AL: upstream-reference=RootComposition.Pp_SG_AlignmentStatus1_AL, ecu-extract-reference=COMPOSITIONTYPE.Pp_SG_AlignmentStatus1_AL
      SG_AlignmentStatus2: upstream-reference=RootComposition.Pp_SG_AlignmentStatus2_AL.Vdp_SG_AlignmentStatus2_AL, ecu-extract-reference=COMPOSITIONTYPE.Pp_SG_AlignmentStatus2_AL.Vdp_SG_AlignmentStatus2_AL
      Pp_SG_AlignmentStatus2_AL: upstream-reference=RootComposition.Pp_SG_AlignmentStatus2_AL, ecu-extract-reference=COMPOSITIONTYPE.Pp_SG_AlignmentStatus2_AL
      SG_Detections_001_004: upstream-reference=RootComposition.Pp_SG_Detections_001_004_AL.Vdp_SG_Detections_001_004_AL, ecu-extract-reference=COMPOSITIONTYPE.Pp_SG_Detections_001_004_AL.Vdp_SG_Detections_001_004_AL
      Pp_SG_Detections_001_004_AL: upstream-reference=RootComposition.Pp_SG_Detections_001_004_AL, ecu-extract-reference=COMPOSITIONTYPE.Pp_SG_Detections_001_004_AL
      SG_Detections_005_008: upstream-reference=RootComposition.Pp_SG_Detections_005_008_AL.Vdp_SG_Detections_005_008_AL, ecu-extract-reference=COMPOSITIONTYPE.Pp_SG_Detections_005_008_AL.Vdp_SG_Detections_005_008_AL
      Pp_SG_Detections_005_008_AL: upstream-reference=RootComposition.Pp_SG_Detections_005_008_AL, ecu-extract-reference=COMPOSITIONTYPE.Pp_SG_Detections_005_008_AL
      SG_Detections_009_012: upstream-reference=RootComposition.Pp_SG_Detections_009_012_AL.Vdp_SG_Detections_009_012_AL, ecu-extract-reference=COMPOSITIONTYPE.Pp_SG_Detections_009_012_AL.Vdp_SG_Detections_009_012_AL
      Pp_SG_Detections_009_012_AL: upstream-reference=RootComposition.Pp_SG_Detections_009_012_AL, ecu-extract-reference=COMPOSITIONTYPE.Pp_SG_Detections_009_012_AL
      SG_Detections_013_016: upstream-reference=RootComposition.Pp_SG_Detections_013_016_AL.Vdp_SG_Detections_013_016_AL, ecu-extract-reference=COMPOSITIONTYPE.Pp_SG_Detections_013_016_AL.Vdp_SG_Detections_013_016_AL
      Pp_SG_Detections_013_016_AL: upstream-reference=RootComposition.Pp_SG_Detections_013_016_AL, ecu-extract-reference=COMPOSITIONTYPE.Pp_SG_Detections_013_016_AL
      SG_Detections_017_020: upstream-reference=RootComposition.Pp_SG_Detections_017_020_AL.Vdp_SG_Detections_017_020_AL, ecu-extract-reference=COMPOSITIONTYPE.Pp_SG_Detections_017_020_AL.Vdp_SG_Detections_017_020_AL
      Pp_SG_Detections_017_020_AL: upstream-reference=RootComposition.Pp_SG_Detections_017_020_AL, ecu-extract-reference=COMPOSITIONTYPE.Pp_SG_Detections_017_020_AL
      SG_Detections_021_024: upstream-reference=RootComposition.Pp_SG_Detections_021_024_AL.Vdp_SG_Detections_021_024_AL, ecu-extract-reference=COMPOSITIONTYPE.Pp_SG_Detections_021_024_AL.Vdp_SG_Detections_021_024_AL
      Pp_SG_Detections_021_024_AL: upstream-reference=RootComposition.Pp_SG_Detections_021_024_AL, ecu-extract-reference=COMPOSITIONTYPE.Pp_SG_Detections_021_024_AL
      SG_Detections_025_028: upstream-reference=RootComposition.Pp_SG_Detections_025_028_AL.Vdp_SG_Detections_025_028_AL, ecu-extract-reference=COMPOSITIONTYPE.Pp_SG_Detections_025_028_AL.Vdp_SG_Detections_025_028_AL
      Pp_SG_Detections_025_028_AL: upstream-reference=RootComposition.Pp_SG_Detections_025_028_AL, ecu-extract-reference=COMPOSITIONTYPE.Pp_SG_Detections_025_028_AL
      SG_Detections_045_048: upstream-reference=RootComposition.Pp_SG_Detections_045_048_AL.Vdp_SG_Detections_045_048_AL, ecu-extract-reference=COMPOSITIONTYPE.Pp_SG_Detections_045_048_AL.Vdp_SG_Detections_045_048_AL
      Pp_SG_Detections_045_048_AL: upstream-reference=RootComposition.Pp_SG_Detections_045_048_AL, ecu-extract-reference=COMPOSITIONTYPE.Pp_SG_Detections_045_048_AL
      SG_Detections_029_032: upstream-reference=RootComposition.Pp_SG_Detections_029_032_AL.Vdp_SG_Detections_029_032_AL, ecu-extract-reference=COMPOSITIONTYPE.Pp_SG_Detections_029_032_AL.Vdp_SG_Detections_029_032_AL
      Pp_SG_Detections_029_032_AL: upstream-reference=RootComposition.Pp_SG_Detections_029_032_AL, ecu-extract-reference=COMPOSITIONTYPE.Pp_SG_Detections_029_032_AL
      SG_Detections_033_036: upstream-reference=RootComposition.Pp_SG_Detections_033_036_AL.Vdp_SG_Detections_033_036_AL, ecu-extract-reference=COMPOSITIONTYPE.Pp_SG_Detections_033_036_AL.Vdp_SG_Detections_033_036_AL
      Pp_SG_Detections_033_036_AL: upstream-reference=RootComposition.Pp_SG_Detections_033_036_AL, ecu-extract-reference=COMPOSITIONTYPE.Pp_SG_Detections_033_036_AL
      SG_Detections_037_040: upstream-reference=RootComposition.Pp_SG_Detections_037_040_AL.Vdp_SG_Detections_037_040_AL, ecu-extract-reference=COMPOSITIONTYPE.Pp_SG_Detections_037_040_AL.Vdp_SG_Detections_037_040_AL
      Pp_SG_Detections_037_040_AL: upstream-reference=RootComposition.Pp_SG_Detections_037_040_AL, ecu-extract-reference=COMPOSITIONTYPE.Pp_SG_Detections_037_040_AL
      SG_Detections_041_044: upstream-reference=RootComposition.Pp_SG_Detections_041_044_AL.Vdp_SG_Detections_041_044_AL, ecu-extract-reference=COMPOSITIONTYPE.Pp_SG_Detections_041_044_AL.Vdp_SG_Detections_041_044_AL
      Pp_SG_Detections_041_044_AL: upstream-reference=RootComposition.Pp_SG_Detections_041_044_AL, ecu-extract-reference=COMPOSITIONTYPE.Pp_SG_Detections_041_044_AL
      SG_Detections_097_100: upstream-reference=RootComposition.Pp_SG_Detections_097_100_AL.Vdp_SG_Detections_097_100_AL, ecu-extract-reference=COMPOSITIONTYPE.Pp_SG_Detections_097_100_AL.Vdp_SG_Detections_097_100_AL
      Pp_SG_Detections_097_100_AL: upstream-reference=RootComposition.Pp_SG_Detections_097_100_AL, ecu-extract-reference=COMPOSITIONTYPE.Pp_SG_Detections_097_100_AL
      SG_Detections_049_052: upstream-reference=RootComposition.Pp_SG_Detections_049_052_AL.Vdp_SG_Detections_049_052_AL, ecu-extract-reference=COMPOSITIONTYPE.Pp_SG_Detections_049_052_AL.Vdp_SG_Detections_049_052_AL
      Pp_SG_Detections_049_052_AL: upstream-reference=RootComposition.Pp_SG_Detections_049_052_AL, ecu-extract-reference=COMPOSITIONTYPE.Pp_SG_Detections_049_052_AL
      SG_Detections_053_056: upstream-reference=RootComposition.Pp_SG_Detections_053_056_AL.Vdp_SG_Detections_053_056_AL, ecu-extract-reference=COMPOSITIONTYPE.Pp_SG_Detections_053_056_AL.Vdp_SG_Detections_053_056_AL
      Pp_SG_Detections_053_056_AL: upstream-reference=RootComposition.Pp_SG_Detections_053_056_AL, ecu-extract-reference=COMPOSITIONTYPE.Pp_SG_Detections_053_056_AL
      SG_Detections_057_060: upstream-reference=RootComposition.Pp_SG_Detections_057_060_AL.Vdp_SG_Detections_057_060_AL, ecu-extract-reference=COMPOSITIONTYPE.Pp_SG_Detections_057_060_AL.Vdp_SG_Detections_057_060_AL
      Pp_SG_Detections_057_060_AL: upstream-reference=RootComposition.Pp_SG_Detections_057_060_AL, ecu-extract-reference=COMPOSITIONTYPE.Pp_SG_Detections_057_060_AL
      SG_Detections_061_064: upstream-reference=RootComposition.Pp_SG_Detections_061_064_AL.Vdp_SG_Detections_061_064_AL, ecu-extract-reference=COMPOSITIONTYPE.Pp_SG_Detections_061_064_AL.Vdp_SG_Detections_061_064_AL
      Pp_SG_Detections_061_064_AL: upstream-reference=RootComposition.Pp_SG_Detections_061_064_AL, ecu-extract-reference=COMPOSITIONTYPE.Pp_SG_Detections_061_064_AL
      SG_Detections_065_068: upstream-reference=RootComposition.Pp_SG_Detections_065_068_AL.Vdp_SG_Detections_065_068_AL, ecu-extract-reference=COMPOSITIONTYPE.Pp_SG_Detections_065_068_AL.Vdp_SG_Detections_065_068_AL
      Pp_SG_Detections_065_068_AL: upstream-reference=RootComposition.Pp_SG_Detections_065_068_AL, ecu-extract-reference=COMPOSITIONTYPE.Pp_SG_Detections_065_068_AL
      SG_Detections_069_072: upstream-reference=RootComposition.Pp_SG_Detections_069_072_AL.Vdp_SG_Detections_069_072_AL, ecu-extract-reference=COMPOSITIONTYPE.Pp_SG_Detections_069_072_AL.Vdp_SG_Detections_069_072_AL
      Pp_SG_Detections_069_072_AL: upstream-reference=RootComposition.Pp_SG_Detections_069_072_AL, ecu-extract-reference=COMPOSITIONTYPE.Pp_SG_Detections_069_072_AL
      SG_Detections_073_076: upstream-reference=RootComposition.Pp_SG_Detections_073_076_AL.Vdp_SG_Detections_073_076_AL, ecu-extract-reference=COMPOSITIONTYPE.Pp_SG_Detections_073_076_AL.Vdp_SG_Detections_073_076_AL
      Pp_SG_Detections_073_076_AL: upstream-reference=RootComposition.Pp_SG_Detections_073_076_AL, ecu-extract-reference=COMPOSITIONTYPE.Pp_SG_Detections_073_076_AL
      SG_Detections_077_080: upstream-reference=RootComposition.Pp_SG_Detections_077_080_AL.Vdp_SG_Detections_077_080_AL, ecu-extract-reference=COMPOSITIONTYPE.Pp_SG_Detections_077_080_AL.Vdp_SG_Detections_077_080_AL
      Pp_SG_Detections_077_080_AL: upstream-reference=RootComposition.Pp_SG_Detections_077_080_AL, ecu-extract-reference=COMPOSITIONTYPE.Pp_SG_Detections_077_080_AL
      SG_Detections_081_084: upstream-reference=RootComposition.Pp_SG_Detections_081_084_AL.Vdp_SG_Detections_081_084_AL, ecu-extract-reference=COMPOSITIONTYPE.Pp_SG_Detections_081_084_AL.Vdp_SG_Detections_081_084_AL
      Pp_SG_Detections_081_084_AL: upstream-reference=RootComposition.Pp_SG_Detections_081_084_AL, ecu-extract-reference=COMPOSITIONTYPE.Pp_SG_Detections_081_084_AL
      SG_Detections_085_088: upstream-reference=RootComposition.Pp_SG_Detections_085_088_AL.Vdp_SG_Detections_085_088_AL, ecu-extract-reference=COMPOSITIONTYPE.Pp_SG_Detections_085_088_AL.Vdp_SG_Detections_085_088_AL
      Pp_SG_Detections_085_088_AL: upstream-reference=RootComposition.Pp_SG_Detections_085_088_AL, ecu-extract-reference=COMPOSITIONTYPE.Pp_SG_Detections_085_088_AL
      SG_Detections_089_092: upstream-reference=RootComposition.Pp_SG_Detections_089_092_AL.Vdp_SG_Detections_089_092_AL, ecu-extract-reference=COMPOSITIONTYPE.Pp_SG_Detections_089_092_AL.Vdp_SG_Detections_089_092_AL
      Pp_SG_Detections_089_092_AL: upstream-reference=RootComposition.Pp_SG_Detections_089_092_AL, ecu-extract-reference=COMPOSITIONTYPE.Pp_SG_Detections_089_092_AL
      SG_Detections_093_096: upstream-reference=RootComposition.Pp_SG_Detections_093_096_AL.Vdp_SG_Detections_093_096_AL, ecu-extract-reference=COMPOSITIONTYPE.Pp_SG_Detections_093_096_AL.Vdp_SG_Detections_093_096_AL
      Pp_SG_Detections_093_096_AL: upstream-reference=RootComposition.Pp_SG_Detections_093_096_AL, ecu-extract-reference=COMPOSITIONTYPE.Pp_SG_Detections_093_096_AL
      SG_Detections_101_104: upstream-reference=RootComposition.Pp_SG_Detections_101_104_AL.Vdp_SG_Detections_101_104_AL, ecu-extract-reference=COMPOSITIONTYPE.Pp_SG_Detections_101_104_AL.Vdp_SG_Detections_101_104_AL
      Pp_SG_Detections_101_104_AL: upstream-reference=RootComposition.Pp_SG_Detections_101_104_AL, ecu-extract-reference=COMPOSITIONTYPE.Pp_SG_Detections_101_104_AL
      SG_Detections_105_108: upstream-reference=RootComposition.Pp_SG_Detections_105_108_AL.Vdp_SG_Detections_105_108_AL, ecu-extract-reference=COMPOSITIONTYPE.Pp_SG_Detections_105_108_AL.Vdp_SG_Detections_105_108_AL
      Pp_SG_Detections_105_108_AL: upstream-reference=RootComposition.Pp_SG_Detections_105_108_AL, ecu-extract-reference=COMPOSITIONTYPE.Pp_SG_Detections_105_108_AL
      SG_Detections_109_112: upstream-reference=RootComposition.Pp_SG_Detections_109_112_AL.Vdp_SG_Detections_109_112_AL, ecu-extract-reference=COMPOSITIONTYPE.Pp_SG_Detections_109_112_AL.Vdp_SG_Detections_109_112_AL
      Pp_SG_Detections_109_112_AL: upstream-reference=RootComposition.Pp_SG_Detections_109_112_AL, ecu-extract-reference=COMPOSITIONTYPE.Pp_SG_Detections_109_112_AL
      SG_Detections_113_116: upstream-reference=RootComposition.Pp_SG_Detections_113_116_AL.Vdp_SG_Detections_113_116_AL, ecu-extract-reference=COMPOSITIONTYPE.Pp_SG_Detections_113_116_AL.Vdp_SG_Detections_113_116_AL
      Pp_SG_Detections_113_116_AL: upstream-reference=RootComposition.Pp_SG_Detections_113_116_AL, ecu-extract-reference=COMPOSITIONTYPE.Pp_SG_Detections_113_116_AL
      SG_Detections_117_120: upstream-reference=RootComposition.Pp_SG_Detections_117_120_AL.Vdp_SG_Detections_117_120_AL, ecu-extract-reference=COMPOSITIONTYPE.Pp_SG_Detections_117_120_AL.Vdp_SG_Detections_117_120_AL
      Pp_SG_Detections_117_120_AL: upstream-reference=RootComposition.Pp_SG_Detections_117_120_AL, ecu-extract-reference=COMPOSITIONTYPE.Pp_SG_Detections_117_120_AL
      SG_Detections_121_124: upstream-reference=RootComposition.Pp_SG_Detections_121_124_AL.Vdp_SG_Detections_121_124_AL, ecu-extract-reference=COMPOSITIONTYPE.Pp_SG_Detections_121_124_AL.Vdp_SG_Detections_121_124_AL
      Pp_SG_Detections_121_124_AL: upstream-reference=RootComposition.Pp_SG_Detections_121_124_AL, ecu-extract-reference=COMPOSITIONTYPE.Pp_SG_Detections_121_124_AL
      SG_Detections_125_128: upstream-reference=RootComposition.Pp_SG_Detections_125_128_AL.Vdp_SG_Detections_125_128_AL, ecu-extract-reference=COMPOSITIONTYPE.Pp_SG_Detections_125_128_AL.Vdp_SG_Detections_125_128_AL
      Pp_SG_Detections_125_128_AL: upstream-reference=RootComposition.Pp_SG_Detections_125_128_AL, ecu-extract-reference=COMPOSITIONTYPE.Pp_SG_Detections_125_128_AL
      SG_Detections_129_132: upstream-reference=RootComposition.Pp_SG_Detections_129_132_AL.Vdp_SG_Detections_129_132_AL, ecu-extract-reference=COMPOSITIONTYPE.Pp_SG_Detections_129_132_AL.Vdp_SG_Detections_129_132_AL
      Pp_SG_Detections_129_132_AL: upstream-reference=RootComposition.Pp_SG_Detections_129_132_AL, ecu-extract-reference=COMPOSITIONTYPE.Pp_SG_Detections_129_132_AL
      SG_Detections_133_136: upstream-reference=RootComposition.Pp_SG_Detections_133_136_AL.Vdp_SG_Detections_133_136_AL, ecu-extract-reference=COMPOSITIONTYPE.Pp_SG_Detections_133_136_AL.Vdp_SG_Detections_133_136_AL
      Pp_SG_Detections_133_136_AL: upstream-reference=RootComposition.Pp_SG_Detections_133_136_AL, ecu-extract-reference=COMPOSITIONTYPE.Pp_SG_Detections_133_136_AL
      SG_Detections_137_140: upstream-reference=RootComposition.Pp_SG_Detections_137_140_AL.Vdp_SG_Detections_137_140_AL, ecu-extract-reference=COMPOSITIONTYPE.Pp_SG_Detections_137_140_AL.Vdp_SG_Detections_137_140_AL
      Pp_SG_Detections_137_140_AL: upstream-reference=RootComposition.Pp_SG_Detections_137_140_AL, ecu-extract-reference=COMPOSITIONTYPE.Pp_SG_Detections_137_140_AL
      SG_Detections_141_144: upstream-reference=RootComposition.Pp_SG_Detections_141_144_AL.Vdp_SG_Detections_141_144_AL, ecu-extract-reference=COMPOSITIONTYPE.Pp_SG_Detections_141_144_AL.Vdp_SG_Detections_141_144_AL
      Pp_SG_Detections_141_144_AL: upstream-reference=RootComposition.Pp_SG_Detections_141_144_AL, ecu-extract-reference=COMPOSITIONTYPE.Pp_SG_Detections_141_144_AL
      SG_Detections_145_148: upstream-reference=RootComposition.Pp_SG_Detections_145_148_AL.Vdp_SG_Detections_145_148_AL, ecu-extract-reference=COMPOSITIONTYPE.Pp_SG_Detections_145_148_AL.Vdp_SG_Detections_145_148_AL
      Pp_SG_Detections_145_148_AL: upstream-reference=RootComposition.Pp_SG_Detections_145_148_AL, ecu-extract-reference=COMPOSITIONTYPE.Pp_SG_Detections_145_148_AL
      SG_Detections_149_152: upstream-reference=RootComposition.Pp_SG_Detections_149_152_AL.Vdp_SG_Detections_149_152_AL, ecu-extract-reference=COMPOSITIONTYPE.Pp_SG_Detections_149_152_AL.Vdp_SG_Detections_149_152_AL
      Pp_SG_Detections_149_152_AL: upstream-reference=RootComposition.Pp_SG_Detections_149_152_AL, ecu-extract-reference=COMPOSITIONTYPE.Pp_SG_Detections_149_152_AL
      SG_Detections_153_156: upstream-reference=RootComposition.Pp_SG_Detections_153_156_AL.Vdp_SG_Detections_153_156_AL, ecu-extract-reference=COMPOSITIONTYPE.Pp_SG_Detections_153_156_AL.Vdp_SG_Detections_153_156_AL
      Pp_SG_Detections_153_156_AL: upstream-reference=RootComposition.Pp_SG_Detections_153_156_AL, ecu-extract-reference=COMPOSITIONTYPE.Pp_SG_Detections_153_156_AL
      SG_Detections_157_160: upstream-reference=RootComposition.Pp_SG_Detections_157_160_AL.Vdp_SG_Detections_157_160_AL, ecu-extract-reference=COMPOSITIONTYPE.Pp_SG_Detections_157_160_AL.Vdp_SG_Detections_157_160_AL
      Pp_SG_Detections_157_160_AL: upstream-reference=RootComposition.Pp_SG_Detections_157_160_AL, ecu-extract-reference=COMPOSITIONTYPE.Pp_SG_Detections_157_160_AL
      SG_Detections_161_164: upstream-reference=RootComposition.Pp_SG_Detections_161_164_AL.Vdp_SG_Detections_161_164_AL, ecu-extract-reference=COMPOSITIONTYPE.Pp_SG_Detections_161_164_AL.Vdp_SG_Detections_161_164_AL
      Pp_SG_Detections_161_164_AL: upstream-reference=RootComposition.Pp_SG_Detections_161_164_AL, ecu-extract-reference=COMPOSITIONTYPE.Pp_SG_Detections_161_164_AL
      SG_Detections_165_168: upstream-reference=RootComposition.Pp_SG_Detections_165_168_AL.Vdp_SG_Detections_165_168_AL, ecu-extract-reference=COMPOSITIONTYPE.Pp_SG_Detections_165_168_AL.Vdp_SG_Detections_165_168_AL
      Pp_SG_Detections_165_168_AL: upstream-reference=RootComposition.Pp_SG_Detections_165_168_AL, ecu-extract-reference=COMPOSITIONTYPE.Pp_SG_Detections_165_168_AL
      SG_Detections_169_172: upstream-reference=RootComposition.Pp_SG_Detections_169_172_AL.Vdp_SG_Detections_169_172_AL, ecu-extract-reference=COMPOSITIONTYPE.Pp_SG_Detections_169_172_AL.Vdp_SG_Detections_169_172_AL
      Pp_SG_Detections_169_172_AL: upstream-reference=RootComposition.Pp_SG_Detections_169_172_AL, ecu-extract-reference=COMPOSITIONTYPE.Pp_SG_Detections_169_172_AL
      SG_Detections_173_176: upstream-reference=RootComposition.Pp_SG_Detections_173_176_AL.Vdp_SG_Detections_173_176_AL, ecu-extract-reference=COMPOSITIONTYPE.Pp_SG_Detections_173_176_AL.Vdp_SG_Detections_173_176_AL
      Pp_SG_Detections_173_176_AL: upstream-reference=RootComposition.Pp_SG_Detections_173_176_AL, ecu-extract-reference=COMPOSITIONTYPE.Pp_SG_Detections_173_176_AL
      SG_Detections_177_180: upstream-reference=RootComposition.Pp_SG_Detections_177_180_AL.Vdp_SG_Detections_177_180_AL, ecu-extract-reference=COMPOSITIONTYPE.Pp_SG_Detections_177_180_AL.Vdp_SG_Detections_177_180_AL
      Pp_SG_Detections_177_180_AL: upstream-reference=RootComposition.Pp_SG_Detections_177_180_AL, ecu-extract-reference=COMPOSITIONTYPE.Pp_SG_Detections_177_180_AL
      SG_Detections_181_184: upstream-reference=RootComposition.Pp_SG_Detections_181_184_AL.Vdp_SG_Detections_181_184_AL, ecu-extract-reference=COMPOSITIONTYPE.Pp_SG_Detections_181_184_AL.Vdp_SG_Detections_181_184_AL
      Pp_SG_Detections_181_184_AL: upstream-reference=RootComposition.Pp_SG_Detections_181_184_AL, ecu-extract-reference=COMPOSITIONTYPE.Pp_SG_Detections_181_184_AL
      SG_Detections_185_188: upstream-reference=RootComposition.Pp_SG_Detections_185_188_AL.Vdp_SG_Detections_185_188_AL, ecu-extract-reference=COMPOSITIONTYPE.Pp_SG_Detections_185_188_AL.Vdp_SG_Detections_185_188_AL
      Pp_SG_Detections_185_188_AL: upstream-reference=RootComposition.Pp_SG_Detections_185_188_AL, ecu-extract-reference=COMPOSITIONTYPE.Pp_SG_Detections_185_188_AL
      SG_Detections_189_192: upstream-reference=RootComposition.Pp_SG_Detections_189_192_AL.Vdp_SG_Detections_189_192_AL, ecu-extract-reference=COMPOSITIONTYPE.Pp_SG_Detections_189_192_AL.Vdp_SG_Detections_189_192_AL
      Pp_SG_Detections_189_192_AL: upstream-reference=RootComposition.Pp_SG_Detections_189_192_AL, ecu-extract-reference=COMPOSITIONTYPE.Pp_SG_Detections_189_192_AL
      SG_Detections_193_196: upstream-reference=RootComposition.Pp_SG_Detections_193_196_AL.Vdp_SG_Detections_193_196_AL, ecu-extract-reference=COMPOSITIONTYPE.Pp_SG_Detections_193_196_AL.Vdp_SG_Detections_193_196_AL
      Pp_SG_Detections_193_196_AL: upstream-reference=RootComposition.Pp_SG_Detections_193_196_AL, ecu-extract-reference=COMPOSITIONTYPE.Pp_SG_Detections_193_196_AL
      SG_Detections_197_200: upstream-reference=RootComposition.Pp_SG_Detections_197_200_AL.Vdp_SG_Detections_197_200_AL, ecu-extract-reference=COMPOSITIONTYPE.Pp_SG_Detections_197_200_AL.Vdp_SG_Detections_197_200_AL
      Pp_SG_Detections_197_200_AL: upstream-reference=RootComposition.Pp_SG_Detections_197_200_AL, ecu-extract-reference=COMPOSITIONTYPE.Pp_SG_Detections_197_200_AL
      SG_Detections_201_204: upstream-reference=RootComposition.Pp_SG_Detections_201_204_AL.Vdp_SG_Detections_201_204_AL, ecu-extract-reference=COMPOSITIONTYPE.Pp_SG_Detections_201_204_AL.Vdp_SG_Detections_201_204_AL
      Pp_SG_Detections_201_204_AL: upstream-reference=RootComposition.Pp_SG_Detections_201_204_AL, ecu-extract-reference=COMPOSITIONTYPE.Pp_SG_Detections_201_204_AL
      SG_Detections_205_208: upstream-reference=RootComposition.Pp_SG_Detections_205_208_AL.Vdp_SG_Detections_205_208_AL, ecu-extract-reference=COMPOSITIONTYPE.Pp_SG_Detections_205_208_AL.Vdp_SG_Detections_205_208_AL
      Pp_SG_Detections_205_208_AL: upstream-reference=RootComposition.Pp_SG_Detections_205_208_AL, ecu-extract-reference=COMPOSITIONTYPE.Pp_SG_Detections_205_208_AL
      SG_Detections_209_212: upstream-reference=RootComposition.Pp_SG_Detections_209_212_AL.Vdp_SG_Detections_209_212_AL, ecu-extract-reference=COMPOSITIONTYPE.Pp_SG_Detections_209_212_AL.Vdp_SG_Detections_209_212_AL
      Pp_SG_Detections_209_212_AL: upstream-reference=RootComposition.Pp_SG_Detections_209_212_AL, ecu-extract-reference=COMPOSITIONTYPE.Pp_SG_Detections_209_212_AL
      SG_Detections_213_216: upstream-reference=RootComposition.Pp_SG_Detections_213_216_AL.Vdp_SG_Detections_213_216_AL, ecu-extract-reference=COMPOSITIONTYPE.Pp_SG_Detections_213_216_AL.Vdp_SG_Detections_213_216_AL
      Pp_SG_Detections_213_216_AL: upstream-reference=RootComposition.Pp_SG_Detections_213_216_AL, ecu-extract-reference=COMPOSITIONTYPE.Pp_SG_Detections_213_216_AL
      SG_Detections_217_220: upstream-reference=RootComposition.Pp_SG_Detections_217_220_AL.Vdp_SG_Detections_217_220_AL, ecu-extract-reference=COMPOSITIONTYPE.Pp_SG_Detections_217_220_AL.Vdp_SG_Detections_217_220_AL
      Pp_SG_Detections_217_220_AL: upstream-reference=RootComposition.Pp_SG_Detections_217_220_AL, ecu-extract-reference=COMPOSITIONTYPE.Pp_SG_Detections_217_220_AL
      SG_Detections_221_224: upstream-reference=RootComposition.Pp_SG_Detections_221_224_AL.Vdp_SG_Detections_221_224_AL, ecu-extract-reference=COMPOSITIONTYPE.Pp_SG_Detections_221_224_AL.Vdp_SG_Detections_221_224_AL
      Pp_SG_Detections_221_224_AL: upstream-reference=RootComposition.Pp_SG_Detections_221_224_AL, ecu-extract-reference=COMPOSITIONTYPE.Pp_SG_Detections_221_224_AL
      SG_Detections_225_228: upstream-reference=RootComposition.Pp_SG_Detections_225_228_AL.Vdp_SG_Detections_225_228_AL, ecu-extract-reference=COMPOSITIONTYPE.Pp_SG_Detections_225_228_AL.Vdp_SG_Detections_225_228_AL
      Pp_SG_Detections_225_228_AL: upstream-reference=RootComposition.Pp_SG_Detections_225_228_AL, ecu-extract-reference=COMPOSITIONTYPE.Pp_SG_Detections_225_228_AL
      SG_Detections_229_232: upstream-reference=RootComposition.Pp_SG_Detections_229_232_AL.Vdp_SG_Detections_229_232_AL, ecu-extract-reference=COMPOSITIONTYPE.Pp_SG_Detections_229_232_AL.Vdp_SG_Detections_229_232_AL
      Pp_SG_Detections_229_232_AL: upstream-reference=RootComposition.Pp_SG_Detections_229_232_AL, ecu-extract-reference=COMPOSITIONTYPE.Pp_SG_Detections_229_232_AL
      SG_Detections_233_236: upstream-reference=RootComposition.Pp_SG_Detections_233_236_AL.Vdp_SG_Detections_233_236_AL, ecu-extract-reference=COMPOSITIONTYPE.Pp_SG_Detections_233_236_AL.Vdp_SG_Detections_233_236_AL
      Pp_SG_Detections_233_236_AL: upstream-reference=RootComposition.Pp_SG_Detections_233_236_AL, ecu-extract-reference=COMPOSITIONTYPE.Pp_SG_Detections_233_236_AL
      SG_Detections_237_240: upstream-reference=RootComposition.Pp_SG_Detections_237_240_AL.Vdp_SG_Detections_237_240_AL, ecu-extract-reference=COMPOSITIONTYPE.Pp_SG_Detections_237_240_AL.Vdp_SG_Detections_237_240_AL
      Pp_SG_Detections_237_240_AL: upstream-reference=RootComposition.Pp_SG_Detections_237_240_AL, ecu-extract-reference=COMPOSITIONTYPE.Pp_SG_Detections_237_240_AL
      SG_Detections_241_244: upstream-reference=RootComposition.Pp_SG_Detections_241_244_AL.Vdp_SG_Detections_241_244_AL, ecu-extract-reference=COMPOSITIONTYPE.Pp_SG_Detections_241_244_AL.Vdp_SG_Detections_241_244_AL
      Pp_SG_Detections_241_244_AL: upstream-reference=RootComposition.Pp_SG_Detections_241_244_AL, ecu-extract-reference=COMPOSITIONTYPE.Pp_SG_Detections_241_244_AL
      SG_Detections_245_248: upstream-reference=RootComposition.Pp_SG_Detections_245_248_AL.Vdp_SG_Detections_245_248_AL, ecu-extract-reference=COMPOSITIONTYPE.Pp_SG_Detections_245_248_AL.Vdp_SG_Detections_245_248_AL
      Pp_SG_Detections_245_248_AL: upstream-reference=RootComposition.Pp_SG_Detections_245_248_AL, ecu-extract-reference=COMPOSITIONTYPE.Pp_SG_Detections_245_248_AL
      SG_Detections_249_252: upstream-reference=RootComposition.Pp_SG_Detections_249_252_AL.Vdp_SG_Detections_249_252_AL, ecu-extract-reference=COMPOSITIONTYPE.Pp_SG_Detections_249_252_AL.Vdp_SG_Detections_249_252_AL
      Pp_SG_Detections_249_252_AL: upstream-reference=RootComposition.Pp_SG_Detections_249_252_AL, ecu-extract-reference=COMPOSITIONTYPE.Pp_SG_Detections_249_252_AL
      SG_Detections_253_256: upstream-reference=RootComposition.Pp_SG_Detections_253_256_AL.Vdp_SG_Detections_253_256_AL, ecu-extract-reference=COMPOSITIONTYPE.Pp_SG_Detections_253_256_AL.Vdp_SG_Detections_253_256_AL
      Pp_SG_Detections_253_256_AL: upstream-reference=RootComposition.Pp_SG_Detections_253_256_AL, ecu-extract-reference=COMPOSITIONTYPE.Pp_SG_Detections_253_256_AL
      SG_Detections_257_260: upstream-reference=RootComposition.Pp_SG_Detections_257_260_AL.Vdp_SG_Detections_257_260_AL, ecu-extract-reference=COMPOSITIONTYPE.Pp_SG_Detections_257_260_AL.Vdp_SG_Detections_257_260_AL
      Pp_SG_Detections_257_260_AL: upstream-reference=RootComposition.Pp_SG_Detections_257_260_AL, ecu-extract-reference=COMPOSITIONTYPE.Pp_SG_Detections_257_260_AL
      SG_Detections_261_264: upstream-reference=RootComposition.Pp_SG_Detections_261_264_AL.Vdp_SG_Detections_261_264_AL, ecu-extract-reference=COMPOSITIONTYPE.Pp_SG_Detections_261_264_AL.Vdp_SG_Detections_261_264_AL
      Pp_SG_Detections_261_264_AL: upstream-reference=RootComposition.Pp_SG_Detections_261_264_AL, ecu-extract-reference=COMPOSITIONTYPE.Pp_SG_Detections_261_264_AL
      SG_Detections_265_268: upstream-reference=RootComposition.Pp_SG_Detections_265_268_AL.Vdp_SG_Detections_265_268_AL, ecu-extract-reference=COMPOSITIONTYPE.Pp_SG_Detections_265_268_AL.Vdp_SG_Detections_265_268_AL
      Pp_SG_Detections_265_268_AL: upstream-reference=RootComposition.Pp_SG_Detections_265_268_AL, ecu-extract-reference=COMPOSITIONTYPE.Pp_SG_Detections_265_268_AL
      SG_Detections_269_272: upstream-reference=RootComposition.Pp_SG_Detections_269_272_AL.Vdp_SG_Detections_269_272_AL, ecu-extract-reference=COMPOSITIONTYPE.Pp_SG_Detections_269_272_AL.Vdp_SG_Detections_269_272_AL
      Pp_SG_Detections_269_272_AL: upstream-reference=RootComposition.Pp_SG_Detections_269_272_AL, ecu-extract-reference=COMPOSITIONTYPE.Pp_SG_Detections_269_272_AL
      SG_Detections_273_276: upstream-reference=RootComposition.Pp_SG_Detections_273_276_AL.Vdp_SG_Detections_273_276_AL, ecu-extract-reference=COMPOSITIONTYPE.Pp_SG_Detections_273_276_AL.Vdp_SG_Detections_273_276_AL
      Pp_SG_Detections_273_276_AL: upstream-reference=RootComposition.Pp_SG_Detections_273_276_AL, ecu-extract-reference=COMPOSITIONTYPE.Pp_SG_Detections_273_276_AL
      SG_Detections_277_280: upstream-reference=RootComposition.Pp_SG_Detections_277_280_AL.Vdp_SG_Detections_277_280_AL, ecu-extract-reference=COMPOSITIONTYPE.Pp_SG_Detections_277_280_AL.Vdp_SG_Detections_277_280_AL
      Pp_SG_Detections_277_280_AL: upstream-reference=RootComposition.Pp_SG_Detections_277_280_AL, ecu-extract-reference=COMPOSITIONTYPE.Pp_SG_Detections_277_280_AL
      SG_Detections_281_284: upstream-reference=RootComposition.Pp_SG_Detections_281_284_AL.Vdp_SG_Detections_281_284_AL, ecu-extract-reference=COMPOSITIONTYPE.Pp_SG_Detections_281_284_AL.Vdp_SG_Detections_281_284_AL
      Pp_SG_Detections_281_284_AL: upstream-reference=RootComposition.Pp_SG_Detections_281_284_AL, ecu-extract-reference=COMPOSITIONTYPE.Pp_SG_Detections_281_284_AL
      SG_Detections_285_288: upstream-reference=RootComposition.Pp_SG_Detections_285_288_AL.Vdp_SG_Detections_285_288_AL, ecu-extract-reference=COMPOSITIONTYPE.Pp_SG_Detections_285_288_AL.Vdp_SG_Detections_285_288_AL
      Pp_SG_Detections_285_288_AL: upstream-reference=RootComposition.Pp_SG_Detections_285_288_AL, ecu-extract-reference=COMPOSITIONTYPE.Pp_SG_Detections_285_288_AL
      SG_Detections_289_292: upstream-reference=RootComposition.Pp_SG_Detections_289_292_AL.Vdp_SG_Detections_289_292_AL, ecu-extract-reference=COMPOSITIONTYPE.Pp_SG_Detections_289_292_AL.Vdp_SG_Detections_289_292_AL
      Pp_SG_Detections_289_292_AL: upstream-reference=RootComposition.Pp_SG_Detections_289_292_AL, ecu-extract-reference=COMPOSITIONTYPE.Pp_SG_Detections_289_292_AL
      SG_Detections_293_296: upstream-reference=RootComposition.Pp_SG_Detections_293_296_AL.Vdp_SG_Detections_293_296_AL, ecu-extract-reference=COMPOSITIONTYPE.Pp_SG_Detections_293_296_AL.Vdp_SG_Detections_293_296_AL
      Pp_SG_Detections_293_296_AL: upstream-reference=RootComposition.Pp_SG_Detections_293_296_AL, ecu-extract-reference=COMPOSITIONTYPE.Pp_SG_Detections_293_296_AL
      SG_Detections_297_300: upstream-reference=RootComposition.Pp_SG_Detections_297_300_AL.Vdp_SG_Detections_297_300_AL, ecu-extract-reference=COMPOSITIONTYPE.Pp_SG_Detections_297_300_AL.Vdp_SG_Detections_297_300_AL
      Pp_SG_Detections_297_300_AL: upstream-reference=RootComposition.Pp_SG_Detections_297_300_AL, ecu-extract-reference=COMPOSITIONTYPE.Pp_SG_Detections_297_300_AL
      SG_Detections_301_304: upstream-reference=RootComposition.Pp_SG_Detections_301_304_AL.Vdp_SG_Detections_301_304_AL, ecu-extract-reference=COMPOSITIONTYPE.Pp_SG_Detections_301_304_AL.Vdp_SG_Detections_301_304_AL
      Pp_SG_Detections_301_304_AL: upstream-reference=RootComposition.Pp_SG_Detections_301_304_AL, ecu-extract-reference=COMPOSITIONTYPE.Pp_SG_Detections_301_304_AL
      SG_Detections_305_308: upstream-reference=RootComposition.Pp_SG_Detections_305_308_AL.Vdp_SG_Detections_305_308_AL, ecu-extract-reference=COMPOSITIONTYPE.Pp_SG_Detections_305_308_AL.Vdp_SG_Detections_305_308_AL
      Pp_SG_Detections_305_308_AL: upstream-reference=RootComposition.Pp_SG_Detections_305_308_AL, ecu-extract-reference=COMPOSITIONTYPE.Pp_SG_Detections_305_308_AL
      SG_Detections_309_312: upstream-reference=RootComposition.Pp_SG_Detections_309_312_AL.Vdp_SG_Detections_309_312_AL, ecu-extract-reference=COMPOSITIONTYPE.Pp_SG_Detections_309_312_AL.Vdp_SG_Detections_309_312_AL
      Pp_SG_Detections_309_312_AL: upstream-reference=RootComposition.Pp_SG_Detections_309_312_AL, ecu-extract-reference=COMPOSITIONTYPE.Pp_SG_Detections_309_312_AL
      SG_Detections_313_316: upstream-reference=RootComposition.Pp_SG_Detections_313_316_AL.Vdp_SG_Detections_313_316_AL, ecu-extract-reference=COMPOSITIONTYPE.Pp_SG_Detections_313_316_AL.Vdp_SG_Detections_313_316_AL
      Pp_SG_Detections_313_316_AL: upstream-reference=RootComposition.Pp_SG_Detections_313_316_AL, ecu-extract-reference=COMPOSITIONTYPE.Pp_SG_Detections_313_316_AL
      SG_Detections_317_320: upstream-reference=RootComposition.Pp_SG_Detections_317_320_AL.Vdp_SG_Detections_317_320_AL, ecu-extract-reference=COMPOSITIONTYPE.Pp_SG_Detections_317_320_AL.Vdp_SG_Detections_317_320_AL
      Pp_SG_Detections_317_320_AL: upstream-reference=RootComposition.Pp_SG_Detections_317_320_AL, ecu-extract-reference=COMPOSITIONTYPE.Pp_SG_Detections_317_320_AL
      SG_Detections_321_324: upstream-reference=RootComposition.Pp_SG_Detections_321_324_AL.Vdp_SG_Detections_321_324_AL, ecu-extract-reference=COMPOSITIONTYPE.Pp_SG_Detections_321_324_AL.Vdp_SG_Detections_321_324_AL
      Pp_SG_Detections_321_324_AL: upstream-reference=RootComposition.Pp_SG_Detections_321_324_AL, ecu-extract-reference=COMPOSITIONTYPE.Pp_SG_Detections_321_324_AL
      SG_Detections_325_328: upstream-reference=RootComposition.Pp_SG_Detections_325_328_AL.Vdp_SG_Detections_325_328_AL, ecu-extract-reference=COMPOSITIONTYPE.Pp_SG_Detections_325_328_AL.Vdp_SG_Detections_325_328_AL
      Pp_SG_Detections_325_328_AL: upstream-reference=RootComposition.Pp_SG_Detections_325_328_AL, ecu-extract-reference=COMPOSITIONTYPE.Pp_SG_Detections_325_328_AL
      SG_Detections_329_332: upstream-reference=RootComposition.Pp_SG_Detections_329_332_AL.Vdp_SG_Detections_329_332_AL, ecu-extract-reference=COMPOSITIONTYPE.Pp_SG_Detections_329_332_AL.Vdp_SG_Detections_329_332_AL
      Pp_SG_Detections_329_332_AL: upstream-reference=RootComposition.Pp_SG_Detections_329_332_AL, ecu-extract-reference=COMPOSITIONTYPE.Pp_SG_Detections_329_332_AL
      SG_Detections_333_336: upstream-reference=RootComposition.Pp_SG_Detections_333_336_AL.Vdp_SG_Detections_333_336_AL, ecu-extract-reference=COMPOSITIONTYPE.Pp_SG_Detections_333_336_AL.Vdp_SG_Detections_333_336_AL
      Pp_SG_Detections_333_336_AL: upstream-reference=RootComposition.Pp_SG_Detections_333_336_AL, ecu-extract-reference=COMPOSITIONTYPE.Pp_SG_Detections_333_336_AL
      SG_Detections_337_340: upstream-reference=RootComposition.Pp_SG_Detections_337_340_AL.Vdp_SG_Detections_337_340_AL, ecu-extract-reference=COMPOSITIONTYPE.Pp_SG_Detections_337_340_AL.Vdp_SG_Detections_337_340_AL
      Pp_SG_Detections_337_340_AL: upstream-reference=RootComposition.Pp_SG_Detections_337_340_AL, ecu-extract-reference=COMPOSITIONTYPE.Pp_SG_Detections_337_340_AL
      SG_Detections_341_344: upstream-reference=RootComposition.Pp_SG_Detections_341_344_AL.Vdp_SG_Detections_341_344_AL, ecu-extract-reference=COMPOSITIONTYPE.Pp_SG_Detections_341_344_AL.Vdp_SG_Detections_341_344_AL
      Pp_SG_Detections_341_344_AL: upstream-reference=RootComposition.Pp_SG_Detections_341_344_AL, ecu-extract-reference=COMPOSITIONTYPE.Pp_SG_Detections_341_344_AL
      SG_Detections_345_348: upstream-reference=RootComposition.Pp_SG_Detections_345_348_AL.Vdp_SG_Detections_345_348_AL, ecu-extract-reference=COMPOSITIONTYPE.Pp_SG_Detections_345_348_AL.Vdp_SG_Detections_345_348_AL
      Pp_SG_Detections_345_348_AL: upstream-reference=RootComposition.Pp_SG_Detections_345_348_AL, ecu-extract-reference=COMPOSITIONTYPE.Pp_SG_Detections_345_348_AL
      SG_Detections_349_352: upstream-reference=RootComposition.Pp_SG_Detections_349_352_AL.Vdp_SG_Detections_349_352_AL, ecu-extract-reference=COMPOSITIONTYPE.Pp_SG_Detections_349_352_AL.Vdp_SG_Detections_349_352_AL
      Pp_SG_Detections_349_352_AL: upstream-reference=RootComposition.Pp_SG_Detections_349_352_AL, ecu-extract-reference=COMPOSITIONTYPE.Pp_SG_Detections_349_352_AL
      SG_Detections_353_356: upstream-reference=RootComposition.Pp_SG_Detections_353_356_AL.Vdp_SG_Detections_353_356_AL, ecu-extract-reference=COMPOSITIONTYPE.Pp_SG_Detections_353_356_AL.Vdp_SG_Detections_353_356_AL
      Pp_SG_Detections_353_356_AL: upstream-reference=RootComposition.Pp_SG_Detections_353_356_AL, ecu-extract-reference=COMPOSITIONTYPE.Pp_SG_Detections_353_356_AL
      SG_Detections_357_360: upstream-reference=RootComposition.Pp_SG_Detections_357_360_AL.Vdp_SG_Detections_357_360_AL, ecu-extract-reference=COMPOSITIONTYPE.Pp_SG_Detections_357_360_AL.Vdp_SG_Detections_357_360_AL
      Pp_SG_Detections_357_360_AL: upstream-reference=RootComposition.Pp_SG_Detections_357_360_AL, ecu-extract-reference=COMPOSITIONTYPE.Pp_SG_Detections_357_360_AL
      SG_Detections_361_364: upstream-reference=RootComposition.Pp_SG_Detections_361_364_AL.Vdp_SG_Detections_361_364_AL, ecu-extract-reference=COMPOSITIONTYPE.Pp_SG_Detections_361_364_AL.Vdp_SG_Detections_361_364_AL
      Pp_SG_Detections_361_364_AL: upstream-reference=RootComposition.Pp_SG_Detections_361_364_AL, ecu-extract-reference=COMPOSITIONTYPE.Pp_SG_Detections_361_364_AL
      SG_Detections_365_368: upstream-reference=RootComposition.Pp_SG_Detections_365_368_AL.Vdp_SG_Detections_365_368_AL, ecu-extract-reference=COMPOSITIONTYPE.Pp_SG_Detections_365_368_AL.Vdp_SG_Detections_365_368_AL
      Pp_SG_Detections_365_368_AL: upstream-reference=RootComposition.Pp_SG_Detections_365_368_AL, ecu-extract-reference=COMPOSITIONTYPE.Pp_SG_Detections_365_368_AL
      SG_Detections_369_372: upstream-reference=RootComposition.Pp_SG_Detections_369_372_AL.Vdp_SG_Detections_369_372_AL, ecu-extract-reference=COMPOSITIONTYPE.Pp_SG_Detections_369_372_AL.Vdp_SG_Detections_369_372_AL
      Pp_SG_Detections_369_372_AL: upstream-reference=RootComposition.Pp_SG_Detections_369_372_AL, ecu-extract-reference=COMPOSITIONTYPE.Pp_SG_Detections_369_372_AL
      SG_Detections_373_376: upstream-reference=RootComposition.Pp_SG_Detections_373_376_AL.Vdp_SG_Detections_373_376_AL, ecu-extract-reference=COMPOSITIONTYPE.Pp_SG_Detections_373_376_AL.Vdp_SG_Detections_373_376_AL
      Pp_SG_Detections_373_376_AL: upstream-reference=RootComposition.Pp_SG_Detections_373_376_AL, ecu-extract-reference=COMPOSITIONTYPE.Pp_SG_Detections_373_376_AL
      SG_Detections_377_380: upstream-reference=RootComposition.Pp_SG_Detections_377_380_AL.Vdp_SG_Detections_377_380_AL, ecu-extract-reference=COMPOSITIONTYPE.Pp_SG_Detections_377_380_AL.Vdp_SG_Detections_377_380_AL
      Pp_SG_Detections_377_380_AL: upstream-reference=RootComposition.Pp_SG_Detections_377_380_AL, ecu-extract-reference=COMPOSITIONTYPE.Pp_SG_Detections_377_380_AL
      SG_Detections_381_384: upstream-reference=RootComposition.Pp_SG_Detections_381_384_AL.Vdp_SG_Detections_381_384_AL, ecu-extract-reference=COMPOSITIONTYPE.Pp_SG_Detections_381_384_AL.Vdp_SG_Detections_381_384_AL
      Pp_SG_Detections_381_384_AL: upstream-reference=RootComposition.Pp_SG_Detections_381_384_AL, ecu-extract-reference=COMPOSITIONTYPE.Pp_SG_Detections_381_384_AL
      SG_Detections_385_388: upstream-reference=RootComposition.Pp_SG_Detections_385_388_AL.Vdp_SG_Detections_385_388_AL, ecu-extract-reference=COMPOSITIONTYPE.Pp_SG_Detections_385_388_AL.Vdp_SG_Detections_385_388_AL
      Pp_SG_Detections_385_388_AL: upstream-reference=RootComposition.Pp_SG_Detections_385_388_AL, ecu-extract-reference=COMPOSITIONTYPE.Pp_SG_Detections_385_388_AL
      SG_Detections_389_392: upstream-reference=RootComposition.Pp_SG_Detections_389_392_AL.Vdp_SG_Detections_389_392_AL, ecu-extract-reference=COMPOSITIONTYPE.Pp_SG_Detections_389_392_AL.Vdp_SG_Detections_389_392_AL
      Pp_SG_Detections_389_392_AL: upstream-reference=RootComposition.Pp_SG_Detections_389_392_AL, ecu-extract-reference=COMPOSITIONTYPE.Pp_SG_Detections_389_392_AL
      SG_Detections_393_396: upstream-reference=RootComposition.Pp_SG_Detections_393_396_AL.Vdp_SG_Detections_393_396_AL, ecu-extract-reference=COMPOSITIONTYPE.Pp_SG_Detections_393_396_AL.Vdp_SG_Detections_393_396_AL
      Pp_SG_Detections_393_396_AL: upstream-reference=RootComposition.Pp_SG_Detections_393_396_AL, ecu-extract-reference=COMPOSITIONTYPE.Pp_SG_Detections_393_396_AL
      SG_Detections_397_400: upstream-reference=RootComposition.Pp_SG_Detections_397_400_AL.Vdp_SG_Detections_397_400_AL, ecu-extract-reference=COMPOSITIONTYPE.Pp_SG_Detections_397_400_AL.Vdp_SG_Detections_397_400_AL
      Pp_SG_Detections_397_400_AL: upstream-reference=RootComposition.Pp_SG_Detections_397_400_AL, ecu-extract-reference=COMPOSITIONTYPE.Pp_SG_Detections_397_400_AL
      SG_Fusion_Detections_001_004: upstream-reference=RootComposition.Rp_SG_Fusion_Detections_001_004_AL.Vdp_SG_Fusion_Detections_001_004_AL, ecu-extract-reference=COMPOSITIONTYPE.Rp_SG_Fusion_Detections_001_004_AL.Vdp_SG_Fusion_Detections_001_004_AL
      Rp_SG_Fusion_Detections_001_004_AL: upstream-reference=RootComposition.Rp_SG_Fusion_Detections_001_004_AL, ecu-extract-reference=COMPOSITIONTYPE.Rp_SG_Fusion_Detections_001_004_AL
      SG_Fusion_Detections_005_008: upstream-reference=RootComposition.Rp_SG_Fusion_Detections_005_008_AL.Vdp_SG_Fusion_Detections_005_008_AL, ecu-extract-reference=COMPOSITIONTYPE.Rp_SG_Fusion_Detections_005_008_AL.Vdp_SG_Fusion_Detections_005_008_AL
      Rp_SG_Fusion_Detections_005_008_AL: upstream-reference=RootComposition.Rp_SG_Fusion_Detections_005_008_AL, ecu-extract-reference=COMPOSITIONTYPE.Rp_SG_Fusion_Detections_005_008_AL
      SG_Fusion_Detections_009_012: upstream-reference=RootComposition.Rp_SG_Fusion_Detections_009_012_AL.Vdp_SG_Fusion_Detections_009_012_AL, ecu-extract-reference=COMPOSITIONTYPE.Rp_SG_Fusion_Detections_009_012_AL.Vdp_SG_Fusion_Detections_009_012_AL
      Rp_SG_Fusion_Detections_009_012_AL: upstream-reference=RootComposition.Rp_SG_Fusion_Detections_009_012_AL, ecu-extract-reference=COMPOSITIONTYPE.Rp_SG_Fusion_Detections_009_012_AL
      SG_Fusion_Detections_013_016: upstream-reference=RootComposition.Rp_SG_Fusion_Detections_013_016_AL.Vdp_SG_Fusion_Detections_013_016_AL, ecu-extract-reference=COMPOSITIONTYPE.Rp_SG_Fusion_Detections_013_016_AL.Vdp_SG_Fusion_Detections_013_016_AL
      Rp_SG_Fusion_Detections_013_016_AL: upstream-reference=RootComposition.Rp_SG_Fusion_Detections_013_016_AL, ecu-extract-reference=COMPOSITIONTYPE.Rp_SG_Fusion_Detections_013_016_AL
      SG_Fusion_Detections_017_020: upstream-reference=RootComposition.Rp_SG_Fusion_Detections_017_020_AL.Vdp_SG_Fusion_Detections_017_020_AL, ecu-extract-reference=COMPOSITIONTYPE.Rp_SG_Fusion_Detections_017_020_AL.Vdp_SG_Fusion_Detections_017_020_AL
      Rp_SG_Fusion_Detections_017_020_AL: upstream-reference=RootComposition.Rp_SG_Fusion_Detections_017_020_AL, ecu-extract-reference=COMPOSITIONTYPE.Rp_SG_Fusion_Detections_017_020_AL
      SG_Fusion_Detections_021_024: upstream-reference=RootComposition.Rp_SG_Fusion_Detections_021_024_AL.Vdp_SG_Fusion_Detections_021_024_AL, ecu-extract-reference=COMPOSITIONTYPE.Rp_SG_Fusion_Detections_021_024_AL.Vdp_SG_Fusion_Detections_021_024_AL
      Rp_SG_Fusion_Detections_021_024_AL: upstream-reference=RootComposition.Rp_SG_Fusion_Detections_021_024_AL, ecu-extract-reference=COMPOSITIONTYPE.Rp_SG_Fusion_Detections_021_024_AL
      SG_Fusion_Detections_025_028: upstream-reference=RootComposition.Rp_SG_Fusion_Detections_025_028_AL.Vdp_SG_Fusion_Detections_025_028_AL, ecu-extract-reference=COMPOSITIONTYPE.Rp_SG_Fusion_Detections_025_028_AL.Vdp_SG_Fusion_Detections_025_028_AL
      Rp_SG_Fusion_Detections_025_028_AL: upstream-reference=RootComposition.Rp_SG_Fusion_Detections_025_028_AL, ecu-extract-reference=COMPOSITIONTYPE.Rp_SG_Fusion_Detections_025_028_AL
      SG_Fusion_Detections_029_032: upstream-reference=RootComposition.Rp_SG_Fusion_Detections_029_032_AL.Vdp_SG_Fusion_Detections_029_032_AL, ecu-extract-reference=COMPOSITIONTYPE.Rp_SG_Fusion_Detections_029_032_AL.Vdp_SG_Fusion_Detections_029_032_AL
      Rp_SG_Fusion_Detections_029_032_AL: upstream-reference=RootComposition.Rp_SG_Fusion_Detections_029_032_AL, ecu-extract-reference=COMPOSITIONTYPE.Rp_SG_Fusion_Detections_029_032_AL
      SG_Fusion_Detections_033_036: upstream-reference=RootComposition.Rp_SG_Fusion_Detections_033_036_AL.Vdp_SG_Fusion_Detections_033_036_AL, ecu-extract-reference=COMPOSITIONTYPE.Rp_SG_Fusion_Detections_033_036_AL.Vdp_SG_Fusion_Detections_033_036_AL
      Rp_SG_Fusion_Detections_033_036_AL: upstream-reference=RootComposition.Rp_SG_Fusion_Detections_033_036_AL, ecu-extract-reference=COMPOSITIONTYPE.Rp_SG_Fusion_Detections_033_036_AL
      SG_Fusion_Detections_037_040: upstream-reference=RootComposition.Rp_SG_Fusion_Detections_037_040_AL.Vdp_SG_Fusion_Detections_037_040_AL, ecu-extract-reference=COMPOSITIONTYPE.Rp_SG_Fusion_Detections_037_040_AL.Vdp_SG_Fusion_Detections_037_040_AL
      Rp_SG_Fusion_Detections_037_040_AL: upstream-reference=RootComposition.Rp_SG_Fusion_Detections_037_040_AL, ecu-extract-reference=COMPOSITIONTYPE.Rp_SG_Fusion_Detections_037_040_AL
      SG_Fusion_Detections_041_044: upstream-reference=RootComposition.Rp_SG_Fusion_Detections_041_044_AL.Vdp_SG_Fusion_Detections_041_044_AL, ecu-extract-reference=COMPOSITIONTYPE.Rp_SG_Fusion_Detections_041_044_AL.Vdp_SG_Fusion_Detections_041_044_AL
      Rp_SG_Fusion_Detections_041_044_AL: upstream-reference=RootComposition.Rp_SG_Fusion_Detections_041_044_AL, ecu-extract-reference=COMPOSITIONTYPE.Rp_SG_Fusion_Detections_041_044_AL
      SG_Fusion_Detections_045_048: upstream-reference=RootComposition.Rp_SG_Fusion_Detections_045_048_AL.Vdp_SG_Fusion_Detections_045_048_AL, ecu-extract-reference=COMPOSITIONTYPE.Rp_SG_Fusion_Detections_045_048_AL.Vdp_SG_Fusion_Detections_045_048_AL
      Rp_SG_Fusion_Detections_045_048_AL: upstream-reference=RootComposition.Rp_SG_Fusion_Detections_045_048_AL, ecu-extract-reference=COMPOSITIONTYPE.Rp_SG_Fusion_Detections_045_048_AL
      SG_Fusion_Detections_049_052: upstream-reference=RootComposition.Rp_SG_Fusion_Detections_049_052_AL.Vdp_SG_Fusion_Detections_049_052_AL, ecu-extract-reference=COMPOSITIONTYPE.Rp_SG_Fusion_Detections_049_052_AL.Vdp_SG_Fusion_Detections_049_052_AL
      Rp_SG_Fusion_Detections_049_052_AL: upstream-reference=RootComposition.Rp_SG_Fusion_Detections_049_052_AL, ecu-extract-reference=COMPOSITIONTYPE.Rp_SG_Fusion_Detections_049_052_AL
      SG_Fusion_Detections_053_056: upstream-reference=RootComposition.Rp_SG_Fusion_Detections_053_056_AL.Vdp_SG_Fusion_Detections_053_056_AL, ecu-extract-reference=COMPOSITIONTYPE.Rp_SG_Fusion_Detections_053_056_AL.Vdp_SG_Fusion_Detections_053_056_AL
      Rp_SG_Fusion_Detections_053_056_AL: upstream-reference=RootComposition.Rp_SG_Fusion_Detections_053_056_AL, ecu-extract-reference=COMPOSITIONTYPE.Rp_SG_Fusion_Detections_053_056_AL
      SG_Fusion_Detections_057_060: upstream-reference=RootComposition.Rp_SG_Fusion_Detections_057_060_AL.Vdp_SG_Fusion_Detections_057_060_AL, ecu-extract-reference=COMPOSITIONTYPE.Rp_SG_Fusion_Detections_057_060_AL.Vdp_SG_Fusion_Detections_057_060_AL
      Rp_SG_Fusion_Detections_057_060_AL: upstream-reference=RootComposition.Rp_SG_Fusion_Detections_057_060_AL, ecu-extract-reference=COMPOSITIONTYPE.Rp_SG_Fusion_Detections_057_060_AL
      SG_Fusion_Detections_061_064: upstream-reference=RootComposition.Rp_SG_Fusion_Detections_061_064_AL.Vdp_SG_Fusion_Detections_061_064_AL, ecu-extract-reference=COMPOSITIONTYPE.Rp_SG_Fusion_Detections_061_064_AL.Vdp_SG_Fusion_Detections_061_064_AL
      Rp_SG_Fusion_Detections_061_064_AL: upstream-reference=RootComposition.Rp_SG_Fusion_Detections_061_064_AL, ecu-extract-reference=COMPOSITIONTYPE.Rp_SG_Fusion_Detections_061_064_AL
      SG_Fusion_Detections_065_068: upstream-reference=RootComposition.Rp_SG_Fusion_Detections_065_068_AL.Vdp_SG_Fusion_Detections_065_068_AL, ecu-extract-reference=COMPOSITIONTYPE.Rp_SG_Fusion_Detections_065_068_AL.Vdp_SG_Fusion_Detections_065_068_AL
      Rp_SG_Fusion_Detections_065_068_AL: upstream-reference=RootComposition.Rp_SG_Fusion_Detections_065_068_AL, ecu-extract-reference=COMPOSITIONTYPE.Rp_SG_Fusion_Detections_065_068_AL
      SG_Fusion_Detections_069_072: upstream-reference=RootComposition.Rp_SG_Fusion_Detections_069_072_AL.Vdp_SG_Fusion_Detections_069_072_AL, ecu-extract-reference=COMPOSITIONTYPE.Rp_SG_Fusion_Detections_069_072_AL.Vdp_SG_Fusion_Detections_069_072_AL
      Rp_SG_Fusion_Detections_069_072_AL: upstream-reference=RootComposition.Rp_SG_Fusion_Detections_069_072_AL, ecu-extract-reference=COMPOSITIONTYPE.Rp_SG_Fusion_Detections_069_072_AL
      SG_Fusion_Detections_073_076: upstream-reference=RootComposition.Rp_SG_Fusion_Detections_073_076_AL.Vdp_SG_Fusion_Detections_073_076_AL, ecu-extract-reference=COMPOSITIONTYPE.Rp_SG_Fusion_Detections_073_076_AL.Vdp_SG_Fusion_Detections_073_076_AL
      Rp_SG_Fusion_Detections_073_076_AL: upstream-reference=RootComposition.Rp_SG_Fusion_Detections_073_076_AL, ecu-extract-reference=COMPOSITIONTYPE.Rp_SG_Fusion_Detections_073_076_AL
      SG_Fusion_Detections_077_080: upstream-reference=RootComposition.Rp_SG_Fusion_Detections_077_080_AL.Vdp_SG_Fusion_Detections_077_080_AL, ecu-extract-reference=COMPOSITIONTYPE.Rp_SG_Fusion_Detections_077_080_AL.Vdp_SG_Fusion_Detections_077_080_AL
      Rp_SG_Fusion_Detections_077_080_AL: upstream-reference=RootComposition.Rp_SG_Fusion_Detections_077_080_AL, ecu-extract-reference=COMPOSITIONTYPE.Rp_SG_Fusion_Detections_077_080_AL
      SG_Fusion_Detections_081_084: upstream-reference=RootComposition.Rp_SG_Fusion_Detections_081_084_AL.Vdp_SG_Fusion_Detections_081_084_AL, ecu-extract-reference=COMPOSITIONTYPE.Rp_SG_Fusion_Detections_081_084_AL.Vdp_SG_Fusion_Detections_081_084_AL
      Rp_SG_Fusion_Detections_081_084_AL: upstream-reference=RootComposition.Rp_SG_Fusion_Detections_081_084_AL, ecu-extract-reference=COMPOSITIONTYPE.Rp_SG_Fusion_Detections_081_084_AL
      SG_Fusion_Detections_085_088: upstream-reference=RootComposition.Rp_SG_Fusion_Detections_085_088_AL.Vdp_SG_Fusion_Detections_085_088_AL, ecu-extract-reference=COMPOSITIONTYPE.Rp_SG_Fusion_Detections_085_088_AL.Vdp_SG_Fusion_Detections_085_088_AL
      Rp_SG_Fusion_Detections_085_088_AL: upstream-reference=RootComposition.Rp_SG_Fusion_Detections_085_088_AL, ecu-extract-reference=COMPOSITIONTYPE.Rp_SG_Fusion_Detections_085_088_AL
      SG_Fusion_Detections_089_092: upstream-reference=RootComposition.Rp_SG_Fusion_Detections_089_092_AL.Vdp_SG_Fusion_Detections_089_092_AL, ecu-extract-reference=COMPOSITIONTYPE.Rp_SG_Fusion_Detections_089_092_AL.Vdp_SG_Fusion_Detections_089_092_AL
      Rp_SG_Fusion_Detections_089_092_AL: upstream-reference=RootComposition.Rp_SG_Fusion_Detections_089_092_AL, ecu-extract-reference=COMPOSITIONTYPE.Rp_SG_Fusion_Detections_089_092_AL
      SG_Fusion_Detections_093_096: upstream-reference=RootComposition.Rp_SG_Fusion_Detections_093_096_AL.Vdp_SG_Fusion_Detections_093_096_AL, ecu-extract-reference=COMPOSITIONTYPE.Rp_SG_Fusion_Detections_093_096_AL.Vdp_SG_Fusion_Detections_093_096_AL
      Rp_SG_Fusion_Detections_093_096_AL: upstream-reference=RootComposition.Rp_SG_Fusion_Detections_093_096_AL, ecu-extract-reference=COMPOSITIONTYPE.Rp_SG_Fusion_Detections_093_096_AL
      SG_Fusion_Detections_097_100: upstream-reference=RootComposition.Rp_SG_Fusion_Detections_097_100_AL.Vdp_SG_Fusion_Detections_097_100_AL, ecu-extract-reference=COMPOSITIONTYPE.Rp_SG_Fusion_Detections_097_100_AL.Vdp_SG_Fusion_Detections_097_100_AL
      Rp_SG_Fusion_Detections_097_100_AL: upstream-reference=RootComposition.Rp_SG_Fusion_Detections_097_100_AL, ecu-extract-reference=COMPOSITIONTYPE.Rp_SG_Fusion_Detections_097_100_AL
      SG_Fusion_Detections_101_104: upstream-reference=RootComposition.Rp_SG_Fusion_Detections_101_104_AL.Vdp_SG_Fusion_Detections_101_104_AL, ecu-extract-reference=COMPOSITIONTYPE.Rp_SG_Fusion_Detections_101_104_AL.Vdp_SG_Fusion_Detections_101_104_AL
      Rp_SG_Fusion_Detections_101_104_AL: upstream-reference=RootComposition.Rp_SG_Fusion_Detections_101_104_AL, ecu-extract-reference=COMPOSITIONTYPE.Rp_SG_Fusion_Detections_101_104_AL
      SG_Fusion_Detections_105_108: upstream-reference=RootComposition.Rp_SG_Fusion_Detections_105_108_AL.Vdp_SG_Fusion_Detections_105_108_AL, ecu-extract-reference=COMPOSITIONTYPE.Rp_SG_Fusion_Detections_105_108_AL.Vdp_SG_Fusion_Detections_105_108_AL
      Rp_SG_Fusion_Detections_105_108_AL: upstream-reference=RootComposition.Rp_SG_Fusion_Detections_105_108_AL, ecu-extract-reference=COMPOSITIONTYPE.Rp_SG_Fusion_Detections_105_108_AL
      SG_Fusion_Detections_109_112: upstream-reference=RootComposition.Rp_SG_Fusion_Detections_109_112_AL.Vdp_SG_Fusion_Detections_109_112_AL, ecu-extract-reference=COMPOSITIONTYPE.Rp_SG_Fusion_Detections_109_112_AL.Vdp_SG_Fusion_Detections_109_112_AL
      Rp_SG_Fusion_Detections_109_112_AL: upstream-reference=RootComposition.Rp_SG_Fusion_Detections_109_112_AL, ecu-extract-reference=COMPOSITIONTYPE.Rp_SG_Fusion_Detections_109_112_AL
      SG_Fusion_Detections_113_116: upstream-reference=RootComposition.Rp_SG_Fusion_Detections_113_116_AL.Vdp_SG_Fusion_Detections_113_116_AL, ecu-extract-reference=COMPOSITIONTYPE.Rp_SG_Fusion_Detections_113_116_AL.Vdp_SG_Fusion_Detections_113_116_AL
      Rp_SG_Fusion_Detections_113_116_AL: upstream-reference=RootComposition.Rp_SG_Fusion_Detections_113_116_AL, ecu-extract-reference=COMPOSITIONTYPE.Rp_SG_Fusion_Detections_113_116_AL
      SG_Fusion_Detections_117_120: upstream-reference=RootComposition.Rp_SG_Fusion_Detections_117_120_AL.Vdp_SG_Fusion_Detections_117_120_AL, ecu-extract-reference=COMPOSITIONTYPE.Rp_SG_Fusion_Detections_117_120_AL.Vdp_SG_Fusion_Detections_117_120_AL
      Rp_SG_Fusion_Detections_117_120_AL: upstream-reference=RootComposition.Rp_SG_Fusion_Detections_117_120_AL, ecu-extract-reference=COMPOSITIONTYPE.Rp_SG_Fusion_Detections_117_120_AL
      SG_Fusion_Detections_121_124: upstream-reference=RootComposition.Rp_SG_Fusion_Detections_121_124_AL.Vdp_SG_Fusion_Detections_121_124_AL, ecu-extract-reference=COMPOSITIONTYPE.Rp_SG_Fusion_Detections_121_124_AL.Vdp_SG_Fusion_Detections_121_124_AL
      Rp_SG_Fusion_Detections_121_124_AL: upstream-reference=RootComposition.Rp_SG_Fusion_Detections_121_124_AL, ecu-extract-reference=COMPOSITIONTYPE.Rp_SG_Fusion_Detections_121_124_AL
      SG_Fusion_Detections_125_128: upstream-reference=RootComposition.Rp_SG_Fusion_Detections_125_128_AL.Vdp_SG_Fusion_Detections_125_128_AL, ecu-extract-reference=COMPOSITIONTYPE.Rp_SG_Fusion_Detections_125_128_AL.Vdp_SG_Fusion_Detections_125_128_AL
      Rp_SG_Fusion_Detections_125_128_AL: upstream-reference=RootComposition.Rp_SG_Fusion_Detections_125_128_AL, ecu-extract-reference=COMPOSITIONTYPE.Rp_SG_Fusion_Detections_125_128_AL
      SG_RadarCapability: upstream-reference=RootComposition.Pp_SG_RadarCapability_AL.Vdp_SG_RadarCapability_AL, ecu-extract-reference=COMPOSITIONTYPE.Pp_SG_RadarCapability_AL.Vdp_SG_RadarCapability_AL
      Pp_SG_RadarCapability_AL: upstream-reference=RootComposition.Pp_SG_RadarCapability_AL, ecu-extract-reference=COMPOSITIONTYPE.Pp_SG_RadarCapability_AL
      SG_RadarHeader: upstream-reference=RootComposition.Pp_SG_RadarHeader_ALPCAN.Vdp_SG_RadarHeader_ALPCAN, ecu-extract-reference=COMPOSITIONTYPE.Pp_SG_RadarHeader_ALPCAN.Vdp_SG_RadarHeader_ALPCAN
      SG_RadarStatus1: upstream-reference=RootComposition.Pp_SG_RadarStatus1_ALPCAN.Vdp_SG_RadarStatus1_ALPCAN, ecu-extract-reference=COMPOSITIONTYPE.Pp_SG_RadarStatus1_ALPCAN.Vdp_SG_RadarStatus1_ALPCAN
      SG_RadarStatus2: upstream-reference=RootComposition.Pp_SG_RadarStatus2_AL.Vdp_SG_RadarStatus2_AL, ecu-extract-reference=COMPOSITIONTYPE.Pp_SG_RadarStatus2_AL.Vdp_SG_RadarStatus2_AL
      Pp_SG_RadarStatus2_AL: upstream-reference=RootComposition.Pp_SG_RadarStatus2_AL, ecu-extract-reference=COMPOSITIONTYPE.Pp_SG_RadarStatus2_AL
      SG_VehicleStatus: upstream-reference=RootComposition.Rp_SG_VehicleStatus_AL.Vdp_SG_VehicleStatus_AL, ecu-extract-reference=COMPOSITIONTYPE.Rp_SG_VehicleStatus_AL.Vdp_SG_VehicleStatus_AL
      Rp_SG_VehicleStatus_AL: upstream-reference=RootComposition.Rp_SG_VehicleStatus_AL, ecu-extract-reference=COMPOSITIONTYPE.Rp_SG_VehicleStatus_AL
      SG_XcpCTOReq: upstream-reference=RootComposition.Rp_SG_XcpCTOReq_AL.Vdp_SG_XcpCTOReq_AL, ecu-extract-reference=COMPOSITIONTYPE.Rp_SG_XcpCTOReq_AL.Vdp_SG_XcpCTOReq_AL
      Rp_SG_XcpCTOReq_AL: upstream-reference=RootComposition.Rp_SG_XcpCTOReq_AL, ecu-extract-reference=COMPOSITIONTYPE.Rp_SG_XcpCTOReq_AL
      SG_XcpCTOResp: upstream-reference=RootComposition.Pp_SG_XcpCTOResp_AL.Vdp_SG_XcpCTOResp_AL, ecu-extract-reference=COMPOSITIONTYPE.Pp_SG_XcpCTOResp_AL.Vdp_SG_XcpCTOResp_AL
      Pp_SG_XcpCTOResp_AL: upstream-reference=RootComposition.Pp_SG_XcpCTOResp_AL, ecu-extract-reference=COMPOSITIONTYPE.Pp_SG_XcpCTOResp_AL
      SG_XcpDAQResp: upstream-reference=RootComposition.Pp_SG_XcpDAQResp_AL.Vdp_SG_XcpDAQResp_AL, ecu-extract-reference=COMPOSITIONTYPE.Pp_SG_XcpDAQResp_AL.Vdp_SG_XcpDAQResp_AL
      Pp_SG_XcpDAQResp_AL: upstream-reference=RootComposition.Pp_SG_XcpDAQResp_AL, ecu-extract-reference=COMPOSITIONTYPE.Pp_SG_XcpDAQResp_AL
      SWC_PLT_Appl_NvMHandlerRp_SWC_PLT_CDD_Correctable_FaultNvM_PS_SWC_PLT_Appl_NvMHandlerCorrectable_Fault_NvM: upstream-reference=COMPOSITIONTYPE.SWC_PLT_Appl_NvMHandler.Correctable_Fault_NvM, ecu-extract-reference=SWC_PLT_Appl_NvMHandlerRp_SWC_PLT_CDD_Correctable_FaultNvM_PS_SWC_PLT_Appl_NvMHandlerCorrectable_Fault_NvM
      SWC_PLT_Appl_NvMHandlerCorrectable_Fault_NvM: upstream-reference=COMPOSITIONTYPE.SWC_PLT_Appl_NvMHandler.Correctable_Fault_NvM
      SWC_PLT_Appl_IoHwAb_ECU_Position_ROMDefault: ecu-extract-reference=COMPOSITIONTYPE.SWC_PLT_Appl_IoHwAb.ECU_Position_ROMDefault
      SWC_PLT_Appl_NvMHandler_Alignment_NvMBlock_DefaultValue: ecu-extract-reference=COMPOSITIONTYPE.SWC_PLT_Appl_NvMHandler.Alignment_NvMBlock_DefaultValue
      SWC_PLT_Appl_NvMHandler_Correctable_Fault_NvM_DefaultValue: ecu-extract-reference=COMPOSITIONTYPE.SWC_PLT_Appl_NvMHandler.Correctable_Fault_NvM_DefaultValue
      SWC_PLT_Appl_NvMHandler_NvMBringUp_DefaultValue: ecu-extract-reference=COMPOSITIONTYPE.SWC_PLT_Appl_NvMHandler.NvMBringUp_DefaultValue
      SWC_PLT_Appl_NvMHandler_RFE_R1R2_Fault_NvM_DefaultValue: ecu-extract-reference=COMPOSITIONTYPE.SWC_PLT_Appl_NvMHandler.RFE_R1R2_Fault_NvM_DefaultValue
      SWC_PLT_Appl_NvMHandler_SWC_PLT_CDD_FailSafe_DefaultValue: ecu-extract-reference=COMPOSITIONTYPE.SWC_PLT_Appl_NvMHandler.SWC_PLT_CDD_FailSafe_DefaultValue
      SWC_PLT_CDD_FailSafe_ExceptionReason_DefaultValue: ecu-extract-reference=COMPOSITIONTYPE.SWC_PLT_CDD_FailSafe.ExceptionReason_DefaultValue
      SWC_PLT_CDD_FailSafe_ResetReason_DefaultValue: ecu-extract-reference=COMPOSITIONTYPE.SWC_PLT_CDD_FailSafe.ResetReason_DefaultValue
      SWC_PLT_Radar_Alignment_Handler_Appl_AutoAlignment_DefaultValue: ecu-extract-reference=COMPOSITIONTYPE.SWC_PLT_Radar_Alignment_Handler.Appl_AutoAlignment_DefaultValue
      Rp_TurnSignalSwitch_AL: upstream-reference=RootComposition.Rp_TurnSignalSwitch_AL, ecu-extract-reference=COMPOSITIONTYPE.Rp_TurnSignalSwitch_AL
      SWC_PRJ_Appl_Power_Manager: upstream-reference=RootComposition.ProjectComposition.SWC_PRJ_Appl_Power_Manager, ecu-extract-reference=COMPOSITIONTYPE.SWC_PRJ_Appl_Power_Manager
      SWC_CMP_PRJ_UDSHandler: upstream-reference=RootComposition.ProjectComposition.SWC_CMP_PRJ_UDSHandler, ecu-extract-reference=COMPOSITIONTYPE.SWC_CMP_PRJ_UDSHandler
      SWC_CMP_PRJ_UDSHandlerSWC_UDSHandler_VIN: upstream-reference=COMPOSITIONTYPE.SWC_CMP_PRJ_UDSHandler.SWC_UDSHandler_VIN
      SWC_CMP_PRJ_UDSHandlerCS_NvMService_VIN_NvM_PS_SWC_CMP_PRJ_UDSHandlerSWC_UDSHandler_VIN: upstream-reference=COMPOSITIONTYPE.SWC_CMP_PRJ_UDSHandler.SWC_UDSHandler_VIN, ecu-extract-reference=SWC_CMP_PRJ_UDSHandlerCS_NvMService_VIN_NvM_PS_SWC_CMP_PRJ_UDSHandlerSWC_UDSHandler_VIN
      SWC_PLT_Appl_NvMHandlerRp_CDD_SensorPos_UDS_NvM_PS_SWC_PLT_Appl_NvMHandlerSensorPos_NvM: upstream-reference=COMPOSITIONTYPE.SWC_PLT_Appl_NvMHandler.SensorPos_NvM, ecu-extract-reference=SWC_PLT_Appl_NvMHandlerRp_CDD_SensorPos_UDS_NvM_PS_SWC_PLT_Appl_NvMHandlerSensorPos_NvM
      SWC_PLT_Appl_NvMHandlerSensorPos_NvM: upstream-reference=COMPOSITIONTYPE.SWC_PLT_Appl_NvMHandler.SensorPos_NvM
      SWC_PRJ_Appl_SensorPosition: upstream-reference=RootComposition.ProjectComposition.SWC_PRJ_Appl_SensorPosition, ecu-extract-reference=COMPOSITIONTYPE.SWC_PRJ_Appl_SensorPosition
      SG_ADAS_FN_Enable_disable_sts: upstream-reference=RootComposition.Rp_SG_ADAS_FN_Enable_disable_sts_ALVCAN.Vdp_SG_ADAS_FN_Enable_disable_sts_ALVCAN, ecu-extract-reference=COMPOSITIONTYPE.Rp_SG_ADAS_FN_Enable_disable_sts_ALVCAN.Vdp_SG_ADAS_FN_Enable_disable_sts_ALVCAN
      Rp_SG_ADAS_FN_Enable_disable_sts_ALVCAN: upstream-reference=RootComposition.Rp_SG_ADAS_FN_Enable_disable_sts_ALVCAN, ecu-extract-reference=COMPOSITIONTYPE.Rp_SG_ADAS_FN_Enable_disable_sts_ALVCAN
      SG_CCVS1: upstream-reference=RootComposition.Rp_SG_CCVS1_ALVCAN.Vdp_SG_CCVS1_ALVCAN, ecu-extract-reference=COMPOSITIONTYPE.Rp_SG_CCVS1_ALVCAN.Vdp_SG_CCVS1_ALVCAN
      Rp_SG_CCVS1_ALVCAN: upstream-reference=RootComposition.Rp_SG_CCVS1_ALVCAN, ecu-extract-reference=COMPOSITIONTYPE.Rp_SG_CCVS1_ALVCAN
      SG_CLS_Tx_16: upstream-reference=RootComposition.Rp_SG_CLS_Tx_16_ALVCAN.Vdp_SG_CLS_Tx_16_ALVCAN, ecu-extract-reference=COMPOSITIONTYPE.Rp_SG_CLS_Tx_16_ALVCAN.Vdp_SG_CLS_Tx_16_ALVCAN
      Rp_SG_CLS_Tx_16_ALVCAN: upstream-reference=RootComposition.Rp_SG_CLS_Tx_16_ALVCAN, ecu-extract-reference=COMPOSITIONTYPE.Rp_SG_CLS_Tx_16_ALVCAN
      SG_CLS_Tx_4: upstream-reference=RootComposition.Rp_SG_CLS_Tx_4_ALVCAN.Vdp_SG_CLS_Tx_4_ALVCAN, ecu-extract-reference=COMPOSITIONTYPE.Rp_SG_CLS_Tx_4_ALVCAN.Vdp_SG_CLS_Tx_4_ALVCAN
      Rp_SG_CLS_Tx_4_ALVCAN: upstream-reference=RootComposition.Rp_SG_CLS_Tx_4_ALVCAN, ecu-extract-reference=COMPOSITIONTYPE.Rp_SG_CLS_Tx_4_ALVCAN
      SG_ETC2_00: upstream-reference=RootComposition.Rp_SG_ETC2_00_ALVCAN.Vdp_SG_ETC2_00_ALVCAN, ecu-extract-reference=COMPOSITIONTYPE.Rp_SG_ETC2_00_ALVCAN.Vdp_SG_ETC2_00_ALVCAN
      Rp_SG_ETC2_00_ALVCAN: upstream-reference=RootComposition.Rp_SG_ETC2_00_ALVCAN, ecu-extract-reference=COMPOSITIONTYPE.Rp_SG_ETC2_00_ALVCAN
      SG_ETC2_03: upstream-reference=RootComposition.Rp_SG_ETC2_03_ALVCAN.Vdp_SG_ETC2_03_ALVCAN, ecu-extract-reference=COMPOSITIONTYPE.Rp_SG_ETC2_03_ALVCAN.Vdp_SG_ETC2_03_ALVCAN
      Rp_SG_ETC2_03_ALVCAN: upstream-reference=RootComposition.Rp_SG_ETC2_03_ALVCAN, ecu-extract-reference=COMPOSITIONTYPE.Rp_SG_ETC2_03_ALVCAN
      SG_OEL: upstream-reference=RootComposition.Rp_SG_OEL_ALVCAN.Vdp_SG_OEL_ALVCAN, ecu-extract-reference=COMPOSITIONTYPE.Rp_SG_OEL_ALVCAN.Vdp_SG_OEL_ALVCAN
      Rp_SG_OEL_ALVCAN: upstream-reference=RootComposition.Rp_SG_OEL_ALVCAN, ecu-extract-reference=COMPOSITIONTYPE.Rp_SG_OEL_ALVCAN
      SG_SAS: upstream-reference=RootComposition.Rp_SG_SAS_ALVCAN.Vdp_SG_SAS_ALVCAN, ecu-extract-reference=COMPOSITIONTYPE.Rp_SG_SAS_ALVCAN.Vdp_SG_SAS_ALVCAN
      Rp_SG_SAS_ALVCAN: upstream-reference=RootComposition.Rp_SG_SAS_ALVCAN, ecu-extract-reference=COMPOSITIONTYPE.Rp_SG_SAS_ALVCAN
      SG_TD: upstream-reference=RootComposition.Rp_SG_TD_ALVCAN.Vdp_SG_TD_ALVCAN, ecu-extract-reference=COMPOSITIONTYPE.Rp_SG_TD_ALVCAN.Vdp_SG_TD_ALVCAN
      Rp_SG_TD_ALVCAN: upstream-reference=RootComposition.Rp_SG_TD_ALVCAN, ecu-extract-reference=COMPOSITIONTYPE.Rp_SG_TD_ALVCAN
      SG_VD: upstream-reference=RootComposition.Rp_SG_VD_ALVCAN.Vdp_SG_VD_ALVCAN, ecu-extract-reference=COMPOSITIONTYPE.Rp_SG_VD_ALVCAN.Vdp_SG_VD_ALVCAN
      Rp_SG_VD_ALVCAN: upstream-reference=RootComposition.Rp_SG_VD_ALVCAN, ecu-extract-reference=COMPOSITIONTYPE.Rp_SG_VD_ALVCAN
      SG_VDC2: upstream-reference=RootComposition.Rp_SG_VDC2_ALVCAN.Vdp_SG_VDC2_ALVCAN, ecu-extract-reference=COMPOSITIONTYPE.Rp_SG_VDC2_ALVCAN.Vdp_SG_VDC2_ALVCAN
      Rp_SG_VDC2_ALVCAN: upstream-reference=RootComposition.Rp_SG_VDC2_ALVCAN, ecu-extract-reference=COMPOSITIONTYPE.Rp_SG_VDC2_ALVCAN
      SG_VI: upstream-reference=RootComposition.Rp_SG_VI_ALVCAN.Vdp_SG_VI_ALVCAN, ecu-extract-reference=COMPOSITIONTYPE.Rp_SG_VI_ALVCAN.Vdp_SG_VI_ALVCAN
      Rp_SG_VI_ALVCAN: upstream-reference=RootComposition.Rp_SG_VI_ALVCAN, ecu-extract-reference=COMPOSITIONTYPE.Rp_SG_VI_ALVCAN
      SG_Fusion_AlignmentStatus1: upstream-reference=RootComposition.Rp_SG_Fusion_AlignmentStatus1_ALPCAN.Vdp_SG_Fusion_AlignmentStatus1_ALPCAN, ecu-extract-reference=COMPOSITIONTYPE.Rp_SG_Fusion_AlignmentStatus1_ALPCAN.Vdp_SG_Fusion_AlignmentStatus1_ALPCAN
      Rp_SG_Fusion_AlignmentStatus1_ALPCAN: upstream-reference=RootComposition.Rp_SG_Fusion_AlignmentStatus1_ALPCAN, ecu-extract-reference=COMPOSITIONTYPE.Rp_SG_Fusion_AlignmentStatus1_ALPCAN
      SG_Fusion_AlignmentStatus2: upstream-reference=RootComposition.Rp_SG_Fusion_AlignmentStatus2_ALPCAN.Vdp_SG_Fusion_AlignmentStatus2_ALPCAN, ecu-extract-reference=COMPOSITIONTYPE.Rp_SG_Fusion_AlignmentStatus2_ALPCAN.Vdp_SG_Fusion_AlignmentStatus2_ALPCAN
      Rp_SG_Fusion_AlignmentStatus2_ALPCAN: upstream-reference=RootComposition.Rp_SG_Fusion_AlignmentStatus2_ALPCAN, ecu-extract-reference=COMPOSITIONTYPE.Rp_SG_Fusion_AlignmentStatus2_ALPCAN
      SG_Fusion_RadarCapability: upstream-reference=RootComposition.Rp_SG_Fusion_RadarCapability_ALPCAN.Vdp_SG_Fusion_RadarCapability_ALPCAN, ecu-extract-reference=COMPOSITIONTYPE.Rp_SG_Fusion_RadarCapability_ALPCAN.Vdp_SG_Fusion_RadarCapability_ALPCAN
      Rp_SG_Fusion_RadarCapability_ALPCAN: upstream-reference=RootComposition.Rp_SG_Fusion_RadarCapability_ALPCAN, ecu-extract-reference=COMPOSITIONTYPE.Rp_SG_Fusion_RadarCapability_ALPCAN
      SG_Fusion_RadarStatus2: upstream-reference=RootComposition.Rp_SG_Fusion_RadarStatus2_ALPCAN.Vdp_SG_Fusion_RadarStatus2_ALPCAN, ecu-extract-reference=COMPOSITIONTYPE.Rp_SG_Fusion_RadarStatus2_ALPCAN.Vdp_SG_Fusion_RadarStatus2_ALPCAN
      Rp_SG_Fusion_RadarStatus2_ALPCAN: upstream-reference=RootComposition.Rp_SG_Fusion_RadarStatus2_ALPCAN, ecu-extract-reference=COMPOSITIONTYPE.Rp_SG_Fusion_RadarStatus2_ALPCAN
      SG_GW_ADAS_FN_Enable_disable_sts: upstream-reference=RootComposition.Rp_SG_GW_ADAS_FN_Enable_disable_sts_ALPCAN.Vdp_SG_GW_ADAS_FN_Enable_disable_sts_ALPCAN, ecu-extract-reference=COMPOSITIONTYPE.Rp_SG_GW_ADAS_FN_Enable_disable_sts_ALPCAN.Vdp_SG_GW_ADAS_FN_Enable_disable_sts_ALPCAN
      Rp_SG_GW_ADAS_FN_Enable_disable_sts_ALPCAN: upstream-reference=RootComposition.Rp_SG_GW_ADAS_FN_Enable_disable_sts_ALPCAN, ecu-extract-reference=COMPOSITIONTYPE.Rp_SG_GW_ADAS_FN_Enable_disable_sts_ALPCAN
      SG_GW_CCVS1: upstream-reference=RootComposition.Rp_SG_GW_CCVS1_ALPCAN.Vdp_SG_GW_CCVS1_ALPCAN, ecu-extract-reference=COMPOSITIONTYPE.Rp_SG_GW_CCVS1_ALPCAN.Vdp_SG_GW_CCVS1_ALPCAN
      Rp_SG_GW_CCVS1_ALPCAN: upstream-reference=RootComposition.Rp_SG_GW_CCVS1_ALPCAN, ecu-extract-reference=COMPOSITIONTYPE.Rp_SG_GW_CCVS1_ALPCAN
      SG_GW_CLS_Tx_16: upstream-reference=RootComposition.Rp_SG_GW_CLS_Tx_16_ALPCAN.Vdp_SG_GW_CLS_Tx_16_ALPCAN, ecu-extract-reference=COMPOSITIONTYPE.Rp_SG_GW_CLS_Tx_16_ALPCAN.Vdp_SG_GW_CLS_Tx_16_ALPCAN
      Rp_SG_GW_CLS_Tx_16_ALPCAN: upstream-reference=RootComposition.Rp_SG_GW_CLS_Tx_16_ALPCAN, ecu-extract-reference=COMPOSITIONTYPE.Rp_SG_GW_CLS_Tx_16_ALPCAN
      SG_GW_CLS_Tx_4: upstream-reference=RootComposition.Rp_SG_GW_CLS_Tx_4_ALPCAN.Vdp_SG_GW_CLS_Tx_4_ALPCAN, ecu-extract-reference=COMPOSITIONTYPE.Rp_SG_GW_CLS_Tx_4_ALPCAN.Vdp_SG_GW_CLS_Tx_4_ALPCAN
      Rp_SG_GW_CLS_Tx_4_ALPCAN: upstream-reference=RootComposition.Rp_SG_GW_CLS_Tx_4_ALPCAN, ecu-extract-reference=COMPOSITIONTYPE.Rp_SG_GW_CLS_Tx_4_ALPCAN
      SG_GW_ETC2: upstream-reference=RootComposition.Rp_SG_GW_ETC2_ALPCAN.Vdp_SG_GW_ETC2_ALPCAN, ecu-extract-reference=COMPOSITIONTYPE.Rp_SG_GW_ETC2_ALPCAN.Vdp_SG_GW_ETC2_ALPCAN
      Rp_SG_GW_ETC2_ALPCAN: upstream-reference=RootComposition.Rp_SG_GW_ETC2_ALPCAN, ecu-extract-reference=COMPOSITIONTYPE.Rp_SG_GW_ETC2_ALPCAN
      SG_GW_OEL: upstream-reference=RootComposition.Rp_SG_GW_OEL_ALPCAN.Vdp_SG_GW_OEL_ALPCAN, ecu-extract-reference=COMPOSITIONTYPE.Rp_SG_GW_OEL_ALPCAN.Vdp_SG_GW_OEL_ALPCAN
      Rp_SG_GW_OEL_ALPCAN: upstream-reference=RootComposition.Rp_SG_GW_OEL_ALPCAN, ecu-extract-reference=COMPOSITIONTYPE.Rp_SG_GW_OEL_ALPCAN
      SG_GW_SAS: upstream-reference=RootComposition.Rp_SG_GW_SAS_ALPCAN.Vdp_SG_GW_SAS_ALPCAN, ecu-extract-reference=COMPOSITIONTYPE.Rp_SG_GW_SAS_ALPCAN.Vdp_SG_GW_SAS_ALPCAN
      Rp_SG_GW_SAS_ALPCAN: upstream-reference=RootComposition.Rp_SG_GW_SAS_ALPCAN, ecu-extract-reference=COMPOSITIONTYPE.Rp_SG_GW_SAS_ALPCAN
      SG_GW_TD: upstream-reference=RootComposition.Rp_SG_GW_TD_ALPCAN.Vdp_SG_GW_TD_ALPCAN, ecu-extract-reference=COMPOSITIONTYPE.Rp_SG_GW_TD_ALPCAN.Vdp_SG_GW_TD_ALPCAN
      Rp_SG_GW_TD_ALPCAN: upstream-reference=RootComposition.Rp_SG_GW_TD_ALPCAN, ecu-extract-reference=COMPOSITIONTYPE.Rp_SG_GW_TD_ALPCAN
      SG_GW_VD: upstream-reference=RootComposition.Rp_SG_GW_VD_ALPCAN.Vdp_SG_GW_VD_ALPCAN, ecu-extract-reference=COMPOSITIONTYPE.Rp_SG_GW_VD_ALPCAN.Vdp_SG_GW_VD_ALPCAN
      Rp_SG_GW_VD_ALPCAN: upstream-reference=RootComposition.Rp_SG_GW_VD_ALPCAN, ecu-extract-reference=COMPOSITIONTYPE.Rp_SG_GW_VD_ALPCAN
      SG_GW_VI: upstream-reference=RootComposition.Rp_SG_GW_VI_ALPCAN.Vdp_SG_GW_VI_ALPCAN, ecu-extract-reference=COMPOSITIONTYPE.Rp_SG_GW_VI_ALPCAN.Vdp_SG_GW_VI_ALPCAN
      Rp_SG_GW_VI_ALPCAN: upstream-reference=RootComposition.Rp_SG_GW_VI_ALPCAN, ecu-extract-reference=COMPOSITIONTYPE.Rp_SG_GW_VI_ALPCAN
      SG_GW_ETC2_03: upstream-reference=RootComposition.Rp_SG_GW_ETC2_03_ALPCAN.Vdp_SG_GW_ETC2_03_ALPCAN, ecu-extract-reference=COMPOSITIONTYPE.Rp_SG_GW_ETC2_03_ALPCAN.Vdp_SG_GW_ETC2_03_ALPCAN
      Rp_SG_GW_ETC2_03_ALPCAN: upstream-reference=RootComposition.Rp_SG_GW_ETC2_03_ALPCAN, ecu-extract-reference=COMPOSITIONTYPE.Rp_SG_GW_ETC2_03_ALPCAN
      SG_GW_VDC2: upstream-reference=RootComposition.Rp_SG_GW_VDC2_ALPCAN.Vdp_SG_GW_VDC2_ALPCAN, ecu-extract-reference=COMPOSITIONTYPE.Rp_SG_GW_VDC2_ALPCAN.Vdp_SG_GW_VDC2_ALPCAN
      Rp_SG_GW_VDC2_ALPCAN: upstream-reference=RootComposition.Rp_SG_GW_VDC2_ALPCAN, ecu-extract-reference=COMPOSITIONTYPE.Rp_SG_GW_VDC2_ALPCAN
      SG_GW_prop_ADAS_BSIS_info: upstream-reference=RootComposition.Pp_SG_GW_prop_ADAS_BSIS_info_ALPCAN.Vdp_SG_GW_prop_ADAS_BSIS_info_ALPCAN, ecu-extract-reference=COMPOSITIONTYPE.Pp_SG_GW_prop_ADAS_BSIS_info_ALPCAN.Vdp_SG_GW_prop_ADAS_BSIS_info_ALPCAN
      Pp_SG_GW_prop_ADAS_BSIS_info_ALPCAN: upstream-reference=RootComposition.Pp_SG_GW_prop_ADAS_BSIS_info_ALPCAN, ecu-extract-reference=COMPOSITIONTYPE.Pp_SG_GW_prop_ADAS_BSIS_info_ALPCAN
      SG_RDR_BSD1_Tx: upstream-reference=RootComposition.Pp_SG_RDR_BSD1_Tx_ALPCAN.Vdp_SG_RDR_BSD1_Tx_ALPCAN, ecu-extract-reference=COMPOSITIONTYPE.Pp_SG_RDR_BSD1_Tx_ALPCAN.Vdp_SG_RDR_BSD1_Tx_ALPCAN
      Pp_SG_RDR_BSD1_Tx_ALPCAN: upstream-reference=RootComposition.Pp_SG_RDR_BSD1_Tx_ALPCAN, ecu-extract-reference=COMPOSITIONTYPE.Pp_SG_RDR_BSD1_Tx_ALPCAN
      SG_MOIS: upstream-reference=RootComposition.Pp_SG_MOIS_ALVCAN.Vdp_SG_MOIS_ALVCAN, ecu-extract-reference=COMPOSITIONTYPE.Pp_SG_MOIS_ALVCAN.Vdp_SG_MOIS_ALVCAN
      Pp_SG_MOIS_ALVCAN: upstream-reference=RootComposition.Pp_SG_MOIS_ALVCAN, ecu-extract-reference=COMPOSITIONTYPE.Pp_SG_MOIS_ALVCAN
      SG_prop_ADAS_MOIS_info: upstream-reference=RootComposition.Pp_SG_prop_ADAS_MOIS_info_ALVCAN.Vdp_SG_prop_ADAS_MOIS_info_ALVCAN, ecu-extract-reference=COMPOSITIONTYPE.Pp_SG_prop_ADAS_MOIS_info_ALVCAN.Vdp_SG_prop_ADAS_MOIS_info_ALVCAN
      Pp_SG_prop_ADAS_MOIS_info_ALVCAN: upstream-reference=RootComposition.Pp_SG_prop_ADAS_MOIS_info_ALVCAN, ecu-extract-reference=COMPOSITIONTYPE.Pp_SG_prop_ADAS_MOIS_info_ALVCAN
      SG_Fusion_RadarHeader: upstream-reference=RootComposition.Rp_SG_Fusion_RadarHeader_ALPCAN.Vdp_SG_Fusion_RadarHeader_ALPCAN, ecu-extract-reference=COMPOSITIONTYPE.Rp_SG_Fusion_RadarHeader_ALPCAN.Vdp_SG_Fusion_RadarHeader_ALPCAN
      Rp_SG_Fusion_RadarHeader_ALPCAN: upstream-reference=RootComposition.Rp_SG_Fusion_RadarHeader_ALPCAN, ecu-extract-reference=COMPOSITIONTYPE.Rp_SG_Fusion_RadarHeader_ALPCAN
      SG_Fusion_RadarStatus: upstream-reference=RootComposition.Rp_SG_Fusion_RadarStatus_ALPCAN.Vdp_SG_Fusion_RadarStatus_ALPCAN, ecu-extract-reference=COMPOSITIONTYPE.Rp_SG_Fusion_RadarStatus_ALPCAN.Vdp_SG_Fusion_RadarStatus_ALPCAN
      Rp_SG_Fusion_RadarStatus_ALPCAN: upstream-reference=RootComposition.Rp_SG_Fusion_RadarStatus_ALPCAN, ecu-extract-reference=COMPOSITIONTYPE.Rp_SG_Fusion_RadarStatus_ALPCAN
      Pp_SG_RadarHeader_ALPCAN: upstream-reference=RootComposition.Pp_SG_RadarHeader_ALPCAN, ecu-extract-reference=COMPOSITIONTYPE.Pp_SG_RadarHeader_ALPCAN
      Pp_SG_RadarStatus1_ALPCAN: upstream-reference=RootComposition.Pp_SG_RadarStatus1_ALPCAN, ecu-extract-reference=COMPOSITIONTYPE.Pp_SG_RadarStatus1_ALPCAN
      SWC_PRJ_Appl_Security_Manager: upstream-reference=RootComposition.ProjectComposition.SWC_PRJ_Appl_Security_Manager, ecu-extract-reference=COMPOSITIONTYPE.SWC_PRJ_Appl_Security_Manager
      SWC_CMP_PRJ_UDSHandlerCS_NvMService_AttemptCounterNvM_PS_SWC_CMP_PRJ_UDSHandlerSWC_UDSHandler_Attemptcounter: upstream-reference=COMPOSITIONTYPE.SWC_CMP_PRJ_UDSHandler.SWC_UDSHandler_Attemptcounter, ecu-extract-reference=SWC_CMP_PRJ_UDSHandlerCS_NvMService_AttemptCounterNvM_PS_SWC_CMP_PRJ_UDSHandlerSWC_UDSHandler_Attemptcounter
      SWC_CMP_PRJ_UDSHandlerSWC_UDSHandler_Attemptcounter: upstream-reference=COMPOSITIONTYPE.SWC_CMP_PRJ_UDSHandler.SWC_UDSHandler_Attemptcounter
      SWC_PLT_Appl_NvMHandlerCS_NvMService_ManualAlignmentNvM_PS_SWC_PLT_Appl_NvMHandlerSWC_Manual_alignment_Execution: upstream-reference=COMPOSITIONTYPE.SWC_PLT_Appl_NvMHandler.SWC_Manual_alignment_Execution, ecu-extract-reference=SWC_PLT_Appl_NvMHandlerCS_NvMService_ManualAlignmentNvM_PS_SWC_PLT_Appl_NvMHandlerSWC_Manual_alignment_Execution
      SWC_PLT_Appl_NvMHandlerSWC_Manual_alignment_Execution: upstream-reference=COMPOSITIONTYPE.SWC_PLT_Appl_NvMHandler.SWC_Manual_alignment_Execution
      SWC_PLT_Appl_NvMHandlerCS_NvMService_Static_Alignment_Engineering_Write_Configuration_ParametersNvM_PS_SWC_PLT_Appl_NvMHandl: upstream-reference=COMPOSITIONTYPE.SWC_PLT_Appl_NvMHandler.SWC_Static_Alignment_Write_Parameters, ecu-extract-reference=SWC_PLT_Appl_NvMHandlerCS_NvMService_Static_Alignment_Engineering_Write_Configuration_ParametersNvM_PS_SWC_PLT_Appl_NvMHandl
      SWC_PLT_Appl_NvMHandlerSWC_Static_Alignment_Write_Parameters: upstream-reference=COMPOSITIONTYPE.SWC_PLT_Appl_NvMHandler.SWC_Static_Alignment_Write_Parameters
      SWC_PLT_Appl_NvMHandlerCS_NvMService_VSE_ParametersNvM_PS_SWC_PLT_Appl_NvMHandlerSWC_VSE_NVM_Params: upstream-reference=COMPOSITIONTYPE.SWC_PLT_Appl_NvMHandler.SWC_VSE_NVM_Params, ecu-extract-reference=SWC_PLT_Appl_NvMHandlerCS_NvMService_VSE_ParametersNvM_PS_SWC_PLT_Appl_NvMHandlerSWC_VSE_NVM_Params
      SWC_PLT_Appl_NvMHandlerSWC_VSE_NVM_Params: upstream-reference=COMPOSITIONTYPE.SWC_PLT_Appl_NvMHandler.SWC_VSE_NVM_Params
