AUTOSAR XML (schema 00053)
package /VariantDefinition
  evaluated variant set EvaluatedVariantSet: approval-status=APPROVED, evaluated-variant=[RDR_01, RDR_02, RDR_03, RDR_04, RDR_05, RDR_06, RDR_07, RDR_08]
package /VariantDefinition/Variant
  8 x predefined variant:
    RDR_{01..08}: post-build-variant-criterion-value-set=RDR_{01..08}
package /VariantDefinition/Variant/CriterionValueSet
  8 x post build variant criterion value set:
    RDR_01: post-build-variant-criterion-value{variant-criterion=RDR_POS, value=0}
    RDR_02: post-build-variant-criterion-value{variant-criterion=RDR_POS, value=1}
    RDR_03: post-build-variant-criterion-value{variant-criterion=RDR_POS, value=2}
    RDR_04: post-build-variant-criterion-value{variant-criterion=RDR_POS, value=3}
    RDR_05: post-build-variant-criterion-value{variant-criterion=RDR_POS, value=4}
    RDR_06: post-build-variant-criterion-value{variant-criterion=RDR_POS, value=5}
    RDR_07: post-build-variant-criterion-value{variant-criterion=RDR_POS, value=6}
    RDR_08: post-build-variant-criterion-value{variant-criterion=RDR_POS, value=7}
package /VariantDefinition/Criterion
  post build variant criterion RDR_POS: compu {0..7=RDR_01..RDR_08}
