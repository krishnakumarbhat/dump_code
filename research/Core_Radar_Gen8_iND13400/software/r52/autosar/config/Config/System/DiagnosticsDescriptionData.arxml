AUTOSAR XML (schema 00053)
package /InitialEcuC
  ecuc value collection InitialEcuC: ecuc-values=[Dcm, Dem]
  module config Dcm: module-description=Dcm_Impl
    DcmConfigSet
      DcmGeneral: DcmResetToFblAfterSessionFinalResponseEnabled=false
      DcmDsd
        DcmDsdServiceTable
          14 x DcmDsdService:
            DiagSessionControl: DcmDsdSidTabServiceId=16, DcmDsdSidTabSubfuncAvail=true
              3 x DcmDsdSubService:
                Default: DcmDsdSubServiceId=1
                Programming: DcmDsdSubServiceId=2, DcmDsdSubServiceSessionLevelRef=DcmDspSession/Programming, DcmDsdSubServiceSessionLevelRef=DcmDspSession/Extended, DcmDsdSubServiceSecurityLevelRef=UnlockedL1
                Extended: DcmDsdSubServiceId=3, DcmDsdSubServiceSessionLevelRef=DcmDspSession/Default, DcmDsdSubServiceSessionLevelRef=DcmDspSession/Extended
            EcuReset: DcmDsdSidTabServiceId=17, DcmDsdSidTabSubfuncAvail=true
              Hard (DcmDsdSubService): DcmDsdSubServiceId=1
              Soft (DcmDsdSubService): DcmDsdSubServiceId=3
            ClearDiagInfo: DcmDsdSidTabServiceId=20, DcmDsdSidTabSubfuncAvail=false, DcmDsdSidTabSessionLevelRef=DcmDspSession/Default, DcmDsdSidTabSessionLevelRef=DcmDspSession/Extended
            ReadDtcInfo: DcmDsdSidTabServiceId=25, DcmDsdSidTabSubfuncAvail=true, DcmDsdSidTabSessionLevelRef=DcmDspSession/Default, DcmDsdSidTabSessionLevelRef=DcmDspSession/Extended
              3 x DcmDsdSubService, all with DcmDsdSubServiceSessionLevelRef=DcmDspSession/Default, DcmDsdSubServiceSessionLevelRef=DcmDspSession/Extended:
                RDTCBSM: DcmDsdSubServiceId=2
                RDTCSSBDTC: DcmDsdSubServiceId=4
                RDTCEDRBDN: DcmDsdSubServiceId=6
            ReadDataById: DcmDsdSidTabServiceId=34, DcmDsdSidTabSubfuncAvail=false
            SecurityAccess: DcmDsdSidTabServiceId=39, DcmDsdSidTabSubfuncAvail=true, DcmDsdSidTabSessionLevelRef=DcmDspSession/Programming, DcmDsdSidTabSessionLevelRef=DcmDspSession/Extended
              SeedL6_Request (DcmDsdSubService): DcmDsdSubServiceId=11, DcmDsdSubServiceSessionLevelRef=DcmDspSession/Programming, DcmDsdSubServiceSessionLevelRef=DcmDspSession/Extended
              KeyL6_Send (DcmDsdSubService): DcmDsdSubServiceId=12, DcmDsdSubServiceSessionLevelRef=DcmDspSession/Programming, DcmDsdSubServiceSessionLevelRef=DcmDspSession/Extended
            CommunicationControl: DcmDsdSidTabServiceId=40, DcmDsdSidTabSubfuncAvail=true, DcmDsdSidTabSessionLevelRef=DcmDspSession/Extended, DcmDsdSidTabSecurityLevelRef=UnlockedL1
              4 x DcmDsdSubService, all with DcmDsdSubServiceSessionLevelRef=DcmDspSession/Extended, DcmDsdSubServiceSecurityLevelRef=UnlockedL1:
                EnableRxAndTx: DcmDsdSubServiceId=0
                EnableRxAndDisableTx: DcmDsdSubServiceId=1
                DisableRxAndEnableTx: DcmDsdSubServiceId=2
                DisableRxAndTx: DcmDsdSubServiceId=3
            WriteDataById: DcmDsdSidTabServiceId=46, DcmDsdSidTabSubfuncAvail=false, DcmDsdSidTabSessionLevelRef=DcmDspSession/Programming, DcmDsdSidTabSessionLevelRef=DcmDspSession/Extended, DcmDsdSidTabSecurityLevelRef=UnlockedL1
            RoutineControl: DcmDsdSidTabServiceId=49, DcmDsdSidTabSubfuncAvail=true, DcmDsdSidTabSessionLevelRef=DcmDspSession/Programming, DcmDsdSidTabSessionLevelRef=DcmDspSession/Extended
            RequestDownload: DcmDsdSidTabServiceId=52, DcmDsdSidTabSubfuncAvail=false, DcmDsdSidTabSessionLevelRef=DcmDspSession/Programming
            TransferData: DcmDsdSidTabServiceId=54, DcmDsdSidTabSubfuncAvail=false, DcmDsdSidTabSessionLevelRef=DcmDspSession/Programming
            RequestTransferExit: DcmDsdSidTabServiceId=55, DcmDsdSidTabSubfuncAvail=false, DcmDsdSidTabSessionLevelRef=DcmDspSession/Programming
            TesterPresent: DcmDsdSidTabServiceId=62, DcmDsdSidTabSubfuncAvail=true
              TesterPresent (DcmDsdSubService): DcmDsdSubServiceId=0
            ControlDtcSetting: DcmDsdSidTabServiceId=133, DcmDsdSidTabSubfuncAvail=true, DcmDsdSidTabSessionLevelRef=DcmDspSession/Extended, DcmDsdSidTabSecurityLevelRef=UnlockedL1
              Enable (DcmDsdSubService): DcmDsdSubServiceId=1, DcmDsdSubServiceSessionLevelRef=DcmDspSession/Extended, DcmDsdSubServiceSecurityLevelRef=UnlockedL1
              Disable (DcmDsdSubService): DcmDsdSubServiceId=2, DcmDsdSubServiceSessionLevelRef=DcmDspSession/Extended, DcmDsdSubServiceSecurityLevelRef=UnlockedL1
      DcmDsp: DcmDspMaxDidToRead=5
        Data_ECUVoltage_Read (DcmDspData): DcmDspDataSize=16, DcmDspDataType=UINT8_N, DcmDspDataInfoRef=DataInfo_DataInfo_ECUVoltage_Read
        DataInfo_DataInfo_ECUVoltage_Read (DcmDspDataInfo): DcmDspDataFixedLength=true
        Data_VehicleSpeed_Read (DcmDspData): DcmDspDataSize=16, DcmDspDataType=UINT8_N, DcmDspDataInfoRef=DataInfo_DataInfo_VehicleSpeed_Read
        DataInfo_DataInfo_VehicleSpeed_Read (DcmDspDataInfo): DcmDspDataFixedLength=true
        Data_DateandTime_Read (DcmDspData): DcmDspDataSize=56, DcmDspDataType=UINT8_N, DcmDspDataInfoRef=DataInfo_DataInfo_DateandTime_Read
        DataInfo_DataInfo_DateandTime_Read (DcmDspDataInfo): DcmDspDataFixedLength=true
        Data_Sensor_Availability_Flag_Read (DcmDspData): DcmDspDataSize=8, DcmDspDataType=UINT8_N, DcmDspDataInfoRef=DataInfo_DataInfo_Sensor_Availability_Flag_Read
        DataInfo_DataInfo_Sensor_Availability_Flag_Read (DcmDspDataInfo): DcmDspDataFixedLength=true
        Data_SerialNumber_Read (DcmDspData): DcmDspDataSize=128, DcmDspDataType=UINT8_N, DcmDspDataInfoRef=DataInfo_DataInfo_SerialNumber_Read
        DataInfo_DataInfo_SerialNumber_Read (DcmDspDataInfo): DcmDspDataFixedLength=true
        Data_SoftwareNumber_Read (DcmDspData): DcmDspDataSize=112, DcmDspDataType=UINT8_N, DcmDspDataInfoRef=DataInfo_DataInfo_SoftwareNumber_Read
        DataInfo_DataInfo_SoftwareNumber_Read (DcmDspDataInfo): DcmDspDataFixedLength=true
        Data_Dataset_Part_No_and_Revision_Read (DcmDspData): DcmDspDataSize=96, DcmDspDataType=UINT8_N, DcmDspDataInfoRef=DataInfo_DataInfo_Dataset_Part_No_and_Revision_Read
        DataInfo_DataInfo_Dataset_Part_No_and_Revision_Read (DcmDspDataInfo): DcmDspDataFixedLength=true
        Data_SMC_Part_No_and_Revision_Read (DcmDspData): DcmDspDataSize=96, DcmDspDataType=UINT8_N, DcmDspDataInfoRef=DataInfo_DataInfo_SMC_Part_No_and_Revision_Read
        DataInfo_DataInfo_SMC_Part_No_and_Revision_Read (DcmDspDataInfo): DcmDspDataFixedLength=true
        Data_Ego_Acceleration_Read (DcmDspData): DcmDspDataSize=8, DcmDspDataType=UINT8_N, DcmDspDataInfoRef=DataInfo_DataInfo_Ego_Acceleration_Read
        DataInfo_DataInfo_Ego_Acceleration_Read (DcmDspDataInfo): DcmDspDataFixedLength=true
        Data_Vehicle_Variant_Read (DcmDspData): DcmDspDataSize=8, DcmDspDataType=UINT8_N, DcmDspDataInfoRef=DataInfo_DataInfo_Vehicle_Variant_Read
        DataInfo_DataInfo_Vehicle_Variant_Read (DcmDspDataInfo): DcmDspDataFixedLength=true
        Data_Static_Alignment_Engineering_Non_Configuration_Parameters_Read (DcmDspData): DcmDspDataSize=336, DcmDspDataType=UINT8_N, DcmDspDataInfoRef=DataInfo_DataInfo_Static_Alignment_Engineering_Non_Configuration_Parameters_Read
        DataInfo_DataInfo_Static_Alignment_Engineering_Non_Configuration_Parameters_Read (DcmDspDataInfo): DcmDspDataFixedLength=true
        Data_Static_Alignment_Engineering_Read_Parameters_Read (DcmDspData): DcmDspDataSize=176, DcmDspDataType=UINT8_N, DcmDspDataInfoRef=DataInfo_DataInfo_Static_Alignment_Engineering_Read_Parameters_Read
        DataInfo_DataInfo_Static_Alignment_Engineering_Read_Parameters_Read (DcmDspDataInfo): DcmDspDataFixedLength=true
        Data_Static_Alignment_Engineering_Write_Configuration_Parameter_Write (DcmDspData): DcmDspDataSize=48, DcmDspDataType=UINT8_N, DcmDspDataInfoRef=DataInfo_DataInfo_Static_Alignment_Engineering_Write_Configuration_Parameter_Write
        DataInfo_DataInfo_Static_Alignment_Engineering_Write_Configuration_Parameter_Write (DcmDspDataInfo): DcmDspDataFixedLength=true
        Data_Service_Alignment_Engineering_Non_Configuration_Parameters_Read (DcmDspData): DcmDspDataSize=112, DcmDspDataType=UINT8_N, DcmDspDataInfoRef=DataInfo_DataInfo_Service_Alignment_Engineering_Non_Configuration_Parameters_Read
        DataInfo_DataInfo_Service_Alignment_Engineering_Non_Configuration_Parameters_Read (DcmDspDataInfo): DcmDspDataFixedLength=true
        Data_Service_Alignment_Result_Parameters_Read (DcmDspData): DcmDspDataSize=696, DcmDspDataType=UINT8_N, DcmDspDataInfoRef=DataInfo_DataInfo_Service_Alignment_Result_Parameters_Read
        DataInfo_DataInfo_Service_Alignment_Result_Parameters_Read (DcmDspDataInfo): DcmDspDataFixedLength=true
        Data_Auto_Alignment_Status_Information_Read (DcmDspData): DcmDspDataSize=744, DcmDspDataType=UINT8_N, DcmDspDataInfoRef=DataInfo_DataInfo_Auto_Alignment_Status_Information_Read
        DataInfo_DataInfo_Auto_Alignment_Status_Information_Read (DcmDspDataInfo): DcmDspDataFixedLength=true
        Data_Pin_Position_Status_Read (DcmDspData): DcmDspDataSize=16, DcmDspDataType=UINT8_N, DcmDspDataInfoRef=DataInfo_DataInfo_Pin_Position_Status_Read
        DataInfo_DataInfo_Pin_Position_Status_Read (DcmDspDataInfo): DcmDspDataFixedLength=true
        Data_Manual_Alignment_Execution_Read (DcmDspData): DcmDspDataSize=80, DcmDspDataType=UINT8_N, DcmDspDataInfoRef=DataInfo_DataInfo_Manual_Alignment_Execution_Read
        DataInfo_DataInfo_Manual_Alignment_Execution_Read (DcmDspDataInfo): DcmDspDataFixedLength=true
        Data_Static_Alignment_Result_Parameters_Read (DcmDspData): DcmDspDataSize=440, DcmDspDataType=UINT8_N, DcmDspDataInfoRef=DataInfo_DataInfo_Static_Alignment_Result_Parameters_Read
        DataInfo_DataInfo_Static_Alignment_Result_Parameters_Read (DcmDspDataInfo): DcmDspDataFixedLength=true
        Data_Hardware_Version_number_Read (DcmDspData): DcmDspDataSize=40, DcmDspDataType=UINT8_N, DcmDspDataInfoRef=DataInfo_DataInfo_Hardware_Version_number_Read
        DataInfo_DataInfo_Hardware_Version_number_Read (DcmDspDataInfo): DcmDspDataFixedLength=true
        Data_Software_Fingerprint_Read (DcmDspData): DcmDspDataSize=32, DcmDspDataType=UINT8_N, DcmDspDataInfoRef=DataInfo_DataInfo_Software_Fingerprint_Read
        DataInfo_DataInfo_Software_Fingerprint_Read (DcmDspDataInfo): DcmDspDataFixedLength=true
        Data_Boot_App_Identification_DID_Read (DcmDspData): DcmDspDataSize=8, DcmDspDataType=UINT8_N, DcmDspDataInfoRef=DataInfo_DataInfo_Boot_App_Identification_DID_Read
        DataInfo_DataInfo_Boot_App_Identification_DID_Read (DcmDspDataInfo): DcmDspDataFixedLength=true
        Data_BootloaderNumber_Read (DcmDspData): DcmDspDataSize=96, DcmDspDataType=UINT8_N, DcmDspDataInfoRef=DataInfo_DataInfo_BootloaderNumber_Read
        DataInfo_DataInfo_BootloaderNumber_Read (DcmDspDataInfo): DcmDspDataFixedLength=true
        Data_ActiveDiagnosticSessionDataIdentifier_Read (DcmDspData): DcmDspDataSize=8, DcmDspDataType=UINT8_N, DcmDspDataInfoRef=DataInfo_DataInfo_ActiveDiagnosticSessionDataIdentifier_Read
        DataInfo_DataInfo_ActiveDiagnosticSessionDataIdentifier_Read (DcmDspDataInfo): DcmDspDataFixedLength=true
        Data_Base_Software_Version_number_Read (DcmDspData): DcmDspDataSize=56, DcmDspDataType=UINT8_N, DcmDspDataInfoRef=DataInfo_DataInfo_Base_Software_Version_number_Read
        DataInfo_DataInfo_Base_Software_Version_number_Read (DcmDspDataInfo): DcmDspDataFixedLength=true
        Data_ECUBuildDate_Read (DcmDspData): DcmDspDataSize=32, DcmDspDataType=UINT8_N, DcmDspDataInfoRef=DataInfo_DataInfo_ECUBuildDate_Read
        DataInfo_DataInfo_ECUBuildDate_Read (DcmDspDataInfo): DcmDspDataFixedLength=true
        Data_VIN_Read (DcmDspData): DcmDspDataSize=136, DcmDspDataType=UINT8_N, DcmDspDataInfoRef=DataInfo_DataInfo_VIN_Read
        DataInfo_DataInfo_VIN_Read (DcmDspDataInfo): DcmDspDataFixedLength=true
        Data_HardwareNumber_Read (DcmDspData): DcmDspDataSize=104, DcmDspDataType=UINT8_N, DcmDspDataInfoRef=DataInfo_DataInfo_HardwareNumber_Read
        DataInfo_DataInfo_HardwareNumber_Read (DcmDspDataInfo): DcmDspDataFixedLength=true
        Data_CANDBMatrixVer_Read (DcmDspData): DcmDspDataSize=16, DcmDspDataType=UINT8_N, DcmDspDataInfoRef=DataInfo_DataInfo_CANDBMatrixVer_Read
        DataInfo_DataInfo_CANDBMatrixVer_Read (DcmDspDataInfo): DcmDspDataFixedLength=true
        Data_PCAN_DBC_Version_Read (DcmDspData): DcmDspDataSize=16, DcmDspDataType=UINT8_N, DcmDspDataInfoRef=DataInfo_DataInfo_PCAN_DBC_Version_Read
        DataInfo_DataInfo_PCAN_DBC_Version_Read (DcmDspDataInfo): DcmDspDataFixedLength=true
        Data_Read_Active_Fault_Table_Read (DcmDspData): DcmDspDataSize=176, DcmDspDataType=UINT8_N, DcmDspDataInfoRef=DataInfo_DataInfo_Read_Active_Fault_Table_Read
        DataInfo_DataInfo_Read_Active_Fault_Table_Read (DcmDspDataInfo): DcmDspDataFixedLength=true
        31 x DcmDspDid:
          DID_ECUVoltage_Read: DcmDspDidIdentifier=4369, DcmDspDidInfoRef=DidInfo_DidInfo_ECUVoltage_Read
            DcmDspDidSignal: DcmDspDidDataPos=0, DcmDspDidDataRef=Data_ECUVoltage_Read
          DID_VehicleSpeed_Read: DcmDspDidIdentifier=4370, DcmDspDidInfoRef=DidInfo_DidInfo_VehicleSpeed_Read
            DcmDspDidSignal: DcmDspDidDataPos=0, DcmDspDidDataRef=Data_VehicleSpeed_Read
          DID_DateandTime_Read: DcmDspDidIdentifier=4374, DcmDspDidInfoRef=DidInfo_DidInfo_DateandTime_Read
            DcmDspDidSignal: DcmDspDidDataPos=0, DcmDspDidDataRef=Data_DateandTime_Read
          DID_Sensor_Availability_Flag_Read: DcmDspDidIdentifier=4375, DcmDspDidInfoRef=DidInfo_DidInfo_Sensor_Availability_Flag_Read
            DcmDspDidSignal: DcmDspDidDataPos=0, DcmDspDidDataRef=Data_Sensor_Availability_Flag_Read
          DID_SerialNumber_Read: DcmDspDidIdentifier=40960, DcmDspDidInfoRef=DidInfo_DidInfo_SerialNumber_Read
            DcmDspDidSignal: DcmDspDidDataPos=0, DcmDspDidDataRef=Data_SerialNumber_Read
          DID_SoftwareNumber_Read: DcmDspDidIdentifier=40961, DcmDspDidInfoRef=DidInfo_DidInfo_SoftwareNumber_Read
            DcmDspDidSignal: DcmDspDidDataPos=0, DcmDspDidDataRef=Data_SoftwareNumber_Read
          DID_Dataset_Part_No_and_Revision_Read: DcmDspDidIdentifier=40962, DcmDspDidInfoRef=DidInfo_DidInfo_Dataset_Part_No_and_Revision_Read
            DcmDspDidSignal: DcmDspDidDataPos=0, DcmDspDidDataRef=Data_Dataset_Part_No_and_Revision_Read
          DID_SMC_Part_No_and_Revision_Read: DcmDspDidIdentifier=40963, DcmDspDidInfoRef=DidInfo_DidInfo_SMC_Part_No_and_Revision_Read
            DcmDspDidSignal: DcmDspDidDataPos=0, DcmDspDidDataRef=Data_SMC_Part_No_and_Revision_Read
          DID_Ego_Acceleration_Read: DcmDspDidIdentifier=40964, DcmDspDidInfoRef=DidInfo_DidInfo_Ego_Acceleration_Read
            DcmDspDidSignal: DcmDspDidDataPos=0, DcmDspDidDataRef=Data_Ego_Acceleration_Read
          DID_Vehicle_Variant_Read: DcmDspDidIdentifier=61456, DcmDspDidInfoRef=DidInfo_DidInfo_Vehicle_Variant_Read
            DcmDspDidSignal: DcmDspDidDataPos=0, DcmDspDidDataRef=Data_Vehicle_Variant_Read
          DID_Static_Alignment_Engineering_Non_Configuration_Parameters_Read: DcmDspDidIdentifier=61457, DcmDspDidInfoRef=DidInfo_DidInfo_Static_Alignment_Engineering_Non_Configuration_Parameters_Read
            DcmDspDidSignal: DcmDspDidDataPos=0, DcmDspDidDataRef=Data_Static_Alignment_Engineering_Non_Configuration_Parameters_Read
          DID_Static_Alignment_Engineering_Read_Parameters_Read: DcmDspDidIdentifier=61458, DcmDspDidInfoRef=DidInfo_DidInfo_Static_Alignment_Engineering_Read_Parameters_Read
            DcmDspDidSignal: DcmDspDidDataPos=0, DcmDspDidDataRef=Data_Static_Alignment_Engineering_Read_Parameters_Read
          DID_Static_Alignment_Engineering_Write_Configuration_Parameter_Write: DcmDspDidIdentifier=61459, DcmDspDidInfoRef=DidInfo_DidInfo_Static_Alignment_Engineering_Write_Configuration_Parameter_Write
            DcmDspDidSignal: DcmDspDidDataPos=0, DcmDspDidDataRef=Data_Static_Alignment_Engineering_Write_Configuration_Parameter_Write
          DID_Service_Alignment_Engineering_Non_Configuration_Parameters_Read: DcmDspDidIdentifier=61460, DcmDspDidInfoRef=DidInfo_DidInfo_Service_Alignment_Engineering_Non_Configuration_Parameters_Read
            DcmDspDidSignal: DcmDspDidDataPos=0, DcmDspDidDataRef=Data_Service_Alignment_Engineering_Non_Configuration_Parameters_Read
          DID_Service_Alignment_Result_Parameters_Read: DcmDspDidIdentifier=61461, DcmDspDidInfoRef=DidInfo_DidInfo_Service_Alignment_Result_Parameters_Read
            DcmDspDidSignal: DcmDspDidDataPos=0, DcmDspDidDataRef=Data_Service_Alignment_Result_Parameters_Read
          DID_Auto_Alignment_Status_Information_Read: DcmDspDidIdentifier=61462, DcmDspDidInfoRef=DidInfo_DidInfo_Auto_Alignment_Status_Information_Read
            DcmDspDidSignal: DcmDspDidDataPos=0, DcmDspDidDataRef=Data_Auto_Alignment_Status_Information_Read
          DID_Pin_Position_Status_Read: DcmDspDidIdentifier=61463, DcmDspDidInfoRef=DidInfo_DidInfo_Pin_Position_Status_Read
            DcmDspDidSignal: DcmDspDidDataPos=0, DcmDspDidDataRef=Data_Pin_Position_Status_Read
          DID_Manual_Alignment_Execution_Read: DcmDspDidIdentifier=61467, DcmDspDidInfoRef=DidInfo_DidInfo_Manual_Alignment_Execution_Read
            DcmDspDidSignal: DcmDspDidDataPos=0, DcmDspDidDataRef=Data_Manual_Alignment_Execution_Read
          DID_Static_Alignment_Result_Parameters_Read: DcmDspDidIdentifier=61468, DcmDspDidInfoRef=DidInfo_DidInfo_Static_Alignment_Result_Parameters_Read
            DcmDspDidSignal: DcmDspDidDataPos=0, DcmDspDidDataRef=Data_Static_Alignment_Result_Parameters_Read
          DID_Hardware_Version_number_Read: DcmDspDidIdentifier=61776, DcmDspDidInfoRef=DidInfo_DidInfo_Hardware_Version_number_Read
            DcmDspDidSignal: DcmDspDidDataPos=0, DcmDspDidDataRef=Data_Hardware_Version_number_Read
          DID_Software_Fingerprint_Read: DcmDspDidIdentifier=61786, DcmDspDidInfoRef=DidInfo_DidInfo_Software_Fingerprint_Read
            DcmDspDidSignal: DcmDspDidDataPos=0, DcmDspDidDataRef=Data_Software_Fingerprint_Read
          DID_Boot_App_Identification_DID_Read: DcmDspDidIdentifier=61802, DcmDspDidInfoRef=DidInfo_DidInfo_Boot_App_Identification_DID_Read
            DcmDspDidSignal: DcmDspDidDataPos=0, DcmDspDidDataRef=Data_Boot_App_Identification_DID_Read
          DID_BootloaderNumber_Read: DcmDspDidIdentifier=61824, DcmDspDidInfoRef=DidInfo_DidInfo_BootloaderNumber_Read
            DcmDspDidSignal: DcmDspDidDataPos=0, DcmDspDidDataRef=Data_BootloaderNumber_Read
          DID_ActiveDiagnosticSessionDataIdentifier_Read: DcmDspDidIdentifier=61830, DcmDspDidInfoRef=DidInfo_DidInfo_ActiveDiagnosticSessionDataIdentifier_Read
            DcmDspDidSignal: DcmDspDidDataPos=0, DcmDspDidDataRef=Data_ActiveDiagnosticSessionDataIdentifier_Read
          DID_Base_Software_Version_number_Read: DcmDspDidIdentifier=61833, DcmDspDidInfoRef=DidInfo_DidInfo_Base_Software_Version_number_Read
            DcmDspDidSignal: DcmDspDidDataPos=0, DcmDspDidDataRef=Data_Base_Software_Version_number_Read
          DID_ECUBuildDate_Read: DcmDspDidIdentifier=61835, DcmDspDidInfoRef=DidInfo_DidInfo_ECUBuildDate_Read
            DcmDspDidSignal: DcmDspDidDataPos=0, DcmDspDidDataRef=Data_ECUBuildDate_Read
          DID_VIN_Read: DcmDspDidIdentifier=61840, DcmDspDidInfoRef=DidInfo_DidInfo_VIN_Read
            DcmDspDidSignal: DcmDspDidDataPos=0, DcmDspDidDataRef=Data_VIN_Read
          DID_HardwareNumber_Read: DcmDspDidIdentifier=61841, DcmDspDidInfoRef=DidInfo_DidInfo_HardwareNumber_Read
            DcmDspDidSignal: DcmDspDidDataPos=0, DcmDspDidDataRef=Data_HardwareNumber_Read
          DID_CANDBMatrixVer_Read: DcmDspDidIdentifier=61853, DcmDspDidInfoRef=DidInfo_DidInfo_CANDBMatrixVer_Read
            DcmDspDidSignal: DcmDspDidDataPos=0, DcmDspDidDataRef=Data_CANDBMatrixVer_Read
          DID_PCAN_DBC_Version_Read: DcmDspDidIdentifier=61854, DcmDspDidInfoRef=DidInfo_DidInfo_PCAN_DBC_Version_Read
            DcmDspDidSignal: DcmDspDidDataPos=0, DcmDspDidDataRef=Data_PCAN_DBC_Version_Read
          DID_Read_Active_Fault_Table_Read: DcmDspDidIdentifier=64899, DcmDspDidInfoRef=DidInfo_DidInfo_Read_Active_Fault_Table_Read
            DcmDspDidSignal: DcmDspDidDataPos=0, DcmDspDidDataRef=Data_Read_Active_Fault_Table_Read
        31 x DcmDspDidInfo:
          DidInfo_DidInfo_ECUVoltage_Read
            DcmDspDidAccess
              DcmDspDidRead: DcmDspDidReadSessionRef=DcmDspSession/Default, DcmDspDidReadSessionRef=DcmDspSession/Extended
          DidInfo_DidInfo_VehicleSpeed_Read
            DcmDspDidAccess
              DcmDspDidRead: DcmDspDidReadSessionRef=DcmDspSession/Default, DcmDspDidReadSessionRef=DcmDspSession/Extended
          DidInfo_DidInfo_DateandTime_Read
            DcmDspDidAccess
              DcmDspDidRead: DcmDspDidReadSessionRef=DcmDspSession/Default, DcmDspDidReadSessionRef=DcmDspSession/Extended
          DidInfo_DidInfo_Sensor_Availability_Flag_Read
            DcmDspDidAccess
              DcmDspDidRead: DcmDspDidReadSessionRef=DcmDspSession/Default, DcmDspDidReadSessionRef=DcmDspSession/Extended
          DidInfo_DidInfo_SerialNumber_Read
            DcmDspDidAccess
              DcmDspDidRead
          DidInfo_DidInfo_SoftwareNumber_Read
            DcmDspDidAccess
              DcmDspDidRead: DcmDspDidReadSessionRef=DcmDspSession/Default, DcmDspDidReadSessionRef=DcmDspSession/Extended
          DidInfo_DidInfo_Dataset_Part_No_and_Revision_Read
            DcmDspDidAccess
              DcmDspDidRead
          DidInfo_DidInfo_SMC_Part_No_and_Revision_Read
            DcmDspDidAccess
              DcmDspDidRead
          DidInfo_DidInfo_Ego_Acceleration_Read
            DcmDspDidAccess
              DcmDspDidRead: DcmDspDidReadSessionRef=DcmDspSession/Default, DcmDspDidReadSessionRef=DcmDspSession/Extended
          DidInfo_DidInfo_Vehicle_Variant_Read
            DcmDspDidAccess
              DcmDspDidRead: DcmDspDidReadSessionRef=DcmDspSession/Default, DcmDspDidReadSessionRef=DcmDspSession/Extended
          DidInfo_DidInfo_Static_Alignment_Engineering_Non_Configuration_Parameters_Read
            DcmDspDidAccess
              DcmDspDidRead: DcmDspDidReadSessionRef=DcmDspSession/Default, DcmDspDidReadSessionRef=DcmDspSession/Extended
          DidInfo_DidInfo_Static_Alignment_Engineering_Read_Parameters_Read
            DcmDspDidAccess
              DcmDspDidRead: DcmDspDidReadSessionRef=DcmDspSession/Default, DcmDspDidReadSessionRef=DcmDspSession/Extended
          DidInfo_DidInfo_Static_Alignment_Engineering_Write_Configuration_Parameter_Write
            DcmDspDidAccess
              DcmDspDidWrite: DcmDspDidWriteSessionRef=DcmDspSession/Extended, DcmDspDidWriteSecurityLevelRef=UnlockedL1
          DidInfo_DidInfo_Service_Alignment_Engineering_Non_Configuration_Parameters_Read
            DcmDspDidAccess
              DcmDspDidRead: DcmDspDidReadSessionRef=DcmDspSession/Default, DcmDspDidReadSessionRef=DcmDspSession/Extended
          DidInfo_DidInfo_Service_Alignment_Result_Parameters_Read
            DcmDspDidAccess
              DcmDspDidRead: DcmDspDidReadSessionRef=DcmDspSession/Default, DcmDspDidReadSessionRef=DcmDspSession/Extended
          DidInfo_DidInfo_Auto_Alignment_Status_Information_Read
            DcmDspDidAccess
              DcmDspDidRead: DcmDspDidReadSessionRef=DcmDspSession/Default, DcmDspDidReadSessionRef=DcmDspSession/Extended
          DidInfo_DidInfo_Pin_Position_Status_Read
            DcmDspDidAccess
              DcmDspDidRead: DcmDspDidReadSessionRef=DcmDspSession/Default, DcmDspDidReadSessionRef=DcmDspSession/Extended
          DidInfo_DidInfo_Manual_Alignment_Execution_Read
            DcmDspDidAccess
              DcmDspDidRead: DcmDspDidReadSessionRef=DcmDspSession/Default, DcmDspDidReadSessionRef=DcmDspSession/Extended
              DcmDspDidWrite: DcmDspDidWriteSessionRef=DcmDspSession/Extended, DcmDspDidWriteSecurityLevelRef=UnlockedL1
          DidInfo_DidInfo_Static_Alignment_Result_Parameters_Read
            DcmDspDidAccess
              DcmDspDidRead: DcmDspDidReadSessionRef=DcmDspSession/Default, DcmDspDidReadSessionRef=DcmDspSession/Extended
          DidInfo_DidInfo_Hardware_Version_number_Read
            DcmDspDidAccess
              DcmDspDidRead
          DidInfo_DidInfo_Software_Fingerprint_Read
            DcmDspDidAccess
              DcmDspDidRead
              DcmDspDidWrite: DcmDspDidWriteSessionRef=DcmDspSession/Programming, DcmDspDidWriteSecurityLevelRef=UnlockedL1
          DidInfo_DidInfo_Boot_App_Identification_DID_Read
            DcmDspDidAccess
              DcmDspDidRead
          DidInfo_DidInfo_BootloaderNumber_Read
            DcmDspDidAccess
              DcmDspDidRead
          DidInfo_DidInfo_ActiveDiagnosticSessionDataIdentifier_Read
            DcmDspDidAccess
              DcmDspDidRead
          DidInfo_DidInfo_Base_Software_Version_number_Read
            DcmDspDidAccess
              DcmDspDidRead
          DidInfo_DidInfo_ECUBuildDate_Read
            DcmDspDidAccess
              DcmDspDidRead: DcmDspDidReadSessionRef=DcmDspSession/Default, DcmDspDidReadSessionRef=DcmDspSession/Extended
          DidInfo_DidInfo_VIN_Read
            DcmDspDidAccess
              DcmDspDidRead: DcmDspDidReadSessionRef=DcmDspSession/Default, DcmDspDidReadSessionRef=DcmDspSession/Extended
              DcmDspDidWrite: DcmDspDidWriteSessionRef=DcmDspSession/Extended, DcmDspDidWriteSecurityLevelRef=UnlockedL1
          DidInfo_DidInfo_HardwareNumber_Read
            DcmDspDidAccess
              DcmDspDidRead
          DidInfo_DidInfo_CANDBMatrixVer_Read
            DcmDspDidAccess
              DcmDspDidRead: DcmDspDidReadSessionRef=DcmDspSession/Default, DcmDspDidReadSessionRef=DcmDspSession/Extended
          DidInfo_DidInfo_PCAN_DBC_Version_Read
            DcmDspDidAccess
              DcmDspDidRead: DcmDspDidReadSessionRef=DcmDspSession/Default, DcmDspDidReadSessionRef=DcmDspSession/Extended
          DidInfo_DidInfo_Read_Active_Fault_Table_Read
            DcmDspDidAccess
              DcmDspDidRead: DcmDspDidReadSessionRef=DcmDspSession/Default, DcmDspDidReadSessionRef=DcmDspSession/Extended
        8 x DcmDspRoutine:
          Routine_CheckProgPreCond_Start: DcmDspRequestResultsRoutineSupported=false, DcmDspStopRoutineSupported=false, DcmDspRoutineIdentifier=512, DcmDspRoutineInfoRef=RoutineInfo_RoutineInfo_CheckProgPreCond_Start
          Routine_CheckSig_Start: DcmDspRequestResultsRoutineSupported=false, DcmDspStopRoutineSupported=false, DcmDspRoutineIdentifier=526, DcmDspRoutineInfoRef=RoutineInfo_RoutineInfo_CheckSig_Start
          Routine_Static_Alignment_Execution_Start: DcmDspRequestResultsRoutineSupported=true, DcmDspStopRoutineSupported=true, DcmDspRoutineIdentifier=28672, DcmDspRoutineInfoRef=RoutineInfo_RoutineInfo_Static_Alignment_Execution_Start
          Routine_Service_Alignment_Execution_Start: DcmDspRequestResultsRoutineSupported=true, DcmDspStopRoutineSupported=true, DcmDspRoutineIdentifier=28675, DcmDspRoutineInfoRef=RoutineInfo_RoutineInfo_Service_Alignment_Execution_Start
          Routine_Pin_Position_Lock_Start: DcmDspRequestResultsRoutineSupported=true, DcmDspStopRoutineSupported=false, DcmDspRoutineIdentifier=28676, DcmDspRoutineInfoRef=RoutineInfo_RoutineInfo_Pin_Position_Lock_Start
          Routine_Pin_Position_Unlock_Start: DcmDspRequestResultsRoutineSupported=true, DcmDspStopRoutineSupported=false, DcmDspRoutineIdentifier=28677, DcmDspRoutineInfoRef=RoutineInfo_RoutineInfo_Pin_Position_Unlock_Start
          Routine_EraseMem_Start: DcmDspRequestResultsRoutineSupported=false, DcmDspStopRoutineSupported=false, DcmDspRoutineIdentifier=65280, DcmDspRoutineInfoRef=RoutineInfo_RoutineInfo_EraseMem_Start
          Routine_CheckProgDep_Start: DcmDspRequestResultsRoutineSupported=false, DcmDspStopRoutineSupported=false, DcmDspRoutineIdentifier=65281, DcmDspRoutineInfoRef=RoutineInfo_RoutineInfo_CheckProgDep_Start
        8 x DcmDspRoutineInfo:
          RoutineInfo_RoutineInfo_CheckProgPreCond_Start
            DcmDspRoutineAuthorization: DcmDspRoutineSessionRef=DcmDspSession/Extended
            DcmDspStartRoutineOut
              Out_ResData (DcmDspStartRoutineOutSignal): DcmDspRoutineSignalLength=16, DcmDspRoutineSignalType=UINT8_N, DcmDspRoutineSignalEndianness=opaque, DcmDspRoutineSignalPos=0
          RoutineInfo_RoutineInfo_CheckSig_Start
            DcmDspRoutineAuthorization: DcmDspRoutineSessionRef=DcmDspSession/Programming, DcmDspRoutineSecurityLevelRef=UnlockedL1
            DcmDspStartRoutineOut
              Out_ResData (DcmDspStartRoutineOutSignal): DcmDspRoutineSignalLength=8, DcmDspRoutineSignalType=UINT8_N, DcmDspRoutineSignalEndianness=opaque, DcmDspRoutineSignalPos=0
          RoutineInfo_RoutineInfo_Static_Alignment_Execution_Start
            DcmDspRoutineAuthorization: DcmDspRoutineSessionRef=DcmDspSession/Extended, DcmDspRoutineSecurityLevelRef=UnlockedL1
            DcmDspRoutineRequestResOut
              Out_ResData (DcmDspRoutineRequestResOutSignal): DcmDspRoutineSignalLength=24, DcmDspRoutineSignalType=UINT8_N, DcmDspRoutineSignalEndianness=opaque, DcmDspRoutineSignalPos=0
          RoutineInfo_RoutineInfo_Service_Alignment_Execution_Start
            DcmDspRoutineAuthorization: DcmDspRoutineSessionRef=DcmDspSession/Extended, DcmDspRoutineSecurityLevelRef=UnlockedL1
            DcmDspRoutineRequestResOut
              Out_ResData (DcmDspRoutineRequestResOutSignal): DcmDspRoutineSignalLength=224, DcmDspRoutineSignalType=UINT8_N, DcmDspRoutineSignalEndianness=opaque, DcmDspRoutineSignalPos=0
          RoutineInfo_RoutineInfo_Pin_Position_Lock_Start
            DcmDspRoutineAuthorization: DcmDspRoutineSessionRef=DcmDspSession/Extended, DcmDspRoutineSecurityLevelRef=UnlockedL1
            DcmDspStartRoutineIn
              In_ReqData (DcmDspStartRoutineInSignal): DcmDspRoutineSignalLength=8, DcmDspRoutineSignalType=UINT8_N, DcmDspRoutineSignalEndianness=opaque, DcmDspRoutineSignalPos=0
            DcmDspStartRoutineOut
              Out_ResData (DcmDspStartRoutineOutSignal): DcmDspRoutineSignalLength=8, DcmDspRoutineSignalType=UINT8_N, DcmDspRoutineSignalEndianness=opaque, DcmDspRoutineSignalPos=0
            DcmDspRoutineRequestResOut
              Out_ResData (DcmDspRoutineRequestResOutSignal): DcmDspRoutineSignalLength=8, DcmDspRoutineSignalType=UINT8_N, DcmDspRoutineSignalEndianness=opaque, DcmDspRoutineSignalPos=0
          RoutineInfo_RoutineInfo_Pin_Position_Unlock_Start
            DcmDspRoutineAuthorization: DcmDspRoutineSessionRef=DcmDspSession/Extended, DcmDspRoutineSecurityLevelRef=UnlockedL1
            DcmDspStartRoutineIn
              In_ReqData (DcmDspStartRoutineInSignal): DcmDspRoutineSignalLength=8, DcmDspRoutineSignalType=UINT8_N, DcmDspRoutineSignalEndianness=opaque, DcmDspRoutineSignalPos=0
            DcmDspStartRoutineOut
              Out_ResData (DcmDspStartRoutineOutSignal): DcmDspRoutineSignalLength=8, DcmDspRoutineSignalType=UINT8_N, DcmDspRoutineSignalEndianness=opaque, DcmDspRoutineSignalPos=0
            DcmDspRoutineRequestResOut
              Out_ResData (DcmDspRoutineRequestResOutSignal): DcmDspRoutineSignalLength=8, DcmDspRoutineSignalType=UINT8_N, DcmDspRoutineSignalEndianness=opaque, DcmDspRoutineSignalPos=0
          RoutineInfo_RoutineInfo_EraseMem_Start
            DcmDspRoutineAuthorization: DcmDspRoutineSessionRef=DcmDspSession/Programming, DcmDspRoutineSecurityLevelRef=UnlockedL1
            DcmDspStartRoutineIn
              In_ReqData (DcmDspStartRoutineInSignal): DcmDspRoutineSignalLength=72, DcmDspRoutineSignalType=UINT8_N, DcmDspRoutineSignalEndianness=opaque, DcmDspRoutineSignalPos=0
            DcmDspStartRoutineOut
              Out_ResData (DcmDspStartRoutineOutSignal): DcmDspRoutineSignalLength=8, DcmDspRoutineSignalType=UINT8_N, DcmDspRoutineSignalEndianness=opaque, DcmDspRoutineSignalPos=0
          RoutineInfo_RoutineInfo_CheckProgDep_Start
            DcmDspRoutineAuthorization: DcmDspRoutineSessionRef=DcmDspSession/Programming, DcmDspRoutineSecurityLevelRef=UnlockedL1
            DcmDspStartRoutineOut
              Out_ResData (DcmDspStartRoutineOutSignal): DcmDspRoutineSignalLength=8, DcmDspRoutineSignalType=UINT8_N, DcmDspRoutineSignalEndianness=opaque, DcmDspRoutineSignalPos=0
        DcmDspSecurity
          UnlockedL1 (DcmDspSecurityRow):
            DcmDspSecurityDelayTime = 100
            DcmDspSecurityDelayTimeOnBoot = 0
            DcmDspSecurityKeySize = 16
            DcmDspSecurityLevel = 6
            DcmDspSecurityNumAttDelay = 3
            DcmDspSecuritySeedSize = 16
        DcmDspSession
          3 x DcmDspSessionRow, all with DcmDspSessionP2ServerMax=0.05, DcmDspSessionP2StarServerMax=1.95, DcmDspSessionForBoot=DCM_NO_BOOT:
            Default: DcmDspSessionLevel=1
            Programming: DcmDspSessionLevel=2
            Extended: DcmDspSessionLevel=3
        ComControl (DcmDspComControl)
          DspComContolAllChannel (DcmDspComControlAllChannel)
  module config Dem: module-description=Dem_Impl
    DemConfigSet
      DtcAttributes_41914fb7 (DemDTCAttributes): DemMemoryDestinationRef=PrimaryMemory
      DTCClass_DtcClass_DTC_0x560004 (DemDTCClass): DemDTCSeverity=DEM_DTC_SEV_NO_SEVERITY, DemUdsDTC=5636100, DemDTCAttributesRef=DtcAttributes_41914fb7
      Radar_Module_System_Internal_Failure (DemEventParameter):
        DemEventKind = DEM_EVENT_KIND_SWC
        DemDTCClassRef = DTCClass_DtcClass_DTC_0x560004
        DemExtendedDataClassRef = ExtendedDataClass_6d15841f
        DemFreezeFrameClassRef = FreezeFrame_d41460f8
        DemFreezeFrameRecNumClassRef = FreezeFrameRecNum_8514b953
        DemDebounceAlgorithmClass
          DemDebounceCounterBased: DemDebounceCounterBasedClassRef=Counter_Based_Debouncing
        DemEventClass:
          DemAgingAllowed = true
          DemAgingCycleCounterThreshold = 40
          DemEventPriority = 2
          DemEventSignificance = DEM_EVENT_SIGNIFICANCE_FAULT
          DemFFPrestorageSupported = false
          DemAgingCycleRef = Power_On_Off
          DemOperationCycleRef = Power_On_Off
      DTCClass_DtcClass_DTC_0x560106 (DemDTCClass): DemDTCSeverity=DEM_DTC_SEV_NO_SEVERITY, DemUdsDTC=5636358, DemDTCAttributesRef=DtcAttributes_41914fb7
      Radar_Performance_Capability_Algorithm_Based_Failure (DemEventParameter):
        DemEventKind = DEM_EVENT_KIND_SWC
        DemDTCClassRef = DTCClass_DtcClass_DTC_0x560106
        DemExtendedDataClassRef = ExtendedDataClass_6d15841f
        DemFreezeFrameClassRef = FreezeFrame_d41460f8
        DemFreezeFrameRecNumClassRef = FreezeFrameRecNum_8514b953
        DemDebounceAlgorithmClass
          DemDebounceCounterBased: DemDebounceCounterBasedClassRef=Counter_Based_Debouncing
        DemEventClass:
          DemAgingAllowed = true
          DemAgingCycleCounterThreshold = 40
          DemEventPriority = 2
          DemEventSignificance = DEM_EVENT_SIGNIFICANCE_FAULT
          DemFFPrestorageSupported = false
          DemAgingCycleRef = Power_On_Off
          DemOperationCycleRef = Power_On_Off
      DTCClass_DtcClass_DTC_0x560209 (DemDTCClass): DemDTCSeverity=DEM_DTC_SEV_NO_SEVERITY, DemUdsDTC=5636617, DemDTCAttributesRef=DtcAttributes_41914fb7
      Radar_MMIC_Component_Failure (DemEventParameter):
        DemEventKind = DEM_EVENT_KIND_SWC
        DemDTCClassRef = DTCClass_DtcClass_DTC_0x560209
        DemExtendedDataClassRef = ExtendedDataClass_6d15841f
        DemFreezeFrameClassRef = FreezeFrame_d41460f8
        DemFreezeFrameRecNumClassRef = FreezeFrameRecNum_8514b953
        DemDebounceAlgorithmClass
          DemDebounceCounterBased: DemDebounceCounterBasedClassRef=Counter_Based_Debouncing
        DemEventClass:
          DemAgingAllowed = true
          DemAgingCycleCounterThreshold = 40
          DemEventPriority = 2
          DemEventSignificance = DEM_EVENT_SIGNIFICANCE_FAULT
          DemFFPrestorageSupported = false
          DemAgingCycleRef = Power_On_Off
          DemOperationCycleRef = Power_On_Off
      DTCClass_DtcClass_DTC_0x561792 (DemDTCClass): DemDTCSeverity=DEM_DTC_SEV_NO_SEVERITY, DemUdsDTC=5637014, DemDTCAttributesRef=DtcAttributes_41914fb7
      Radar_MMIC_RFBIST_Component_Internal_Failure (DemEventParameter):
        DemEventKind = DEM_EVENT_KIND_SWC
        DemDTCClassRef = DTCClass_DtcClass_DTC_0x561792
        DemExtendedDataClassRef = ExtendedDataClass_6d15841f
        DemFreezeFrameClassRef = FreezeFrame_d41460f8
        DemFreezeFrameRecNumClassRef = FreezeFrameRecNum_8514b953
        DemDebounceAlgorithmClass
          DemDebounceCounterBased: DemDebounceCounterBasedClassRef=Counter_Based_Debouncing
        DemEventClass:
          DemAgingAllowed = true
          DemAgingCycleCounterThreshold = 40
          DemEventPriority = 2
          DemEventSignificance = DEM_EVENT_SIGNIFICANCE_FAULT
          DemFFPrestorageSupported = false
          DemAgingCycleRef = Power_On_Off
          DemOperationCycleRef = Power_On_Off
      DTCClass_DtcClass_DTC_0x561792_001 (DemDTCClass): DemDTCSeverity=DEM_DTC_SEV_NO_SEVERITY, DemUdsDTC=5637266, DemDTCAttributesRef=DtcAttributes_41914fb7
      Application_Interface_Lookup_Performance_or_Incorrect_Operation (DemEventParameter):
        DemEventKind = DEM_EVENT_KIND_SWC
        DemDTCClassRef = DTCClass_DtcClass_DTC_0x561792_001
        DemExtendedDataClassRef = ExtendedDataClass_6d15841f
        DemFreezeFrameClassRef = FreezeFrame_d41460f8
        DemFreezeFrameRecNumClassRef = FreezeFrameRecNum_8514b953
        DemDebounceAlgorithmClass
          DemDebounceCounterBased: DemDebounceCounterBasedClassRef=Counter_Based_Debouncing
        DemEventClass:
          DemAgingAllowed = true
          DemAgingCycleCounterThreshold = 40
          DemEventPriority = 2
          DemEventSignificance = DEM_EVENT_SIGNIFICANCE_FAULT
          DemFFPrestorageSupported = false
          DemAgingCycleRef = Power_On_Off
          DemOperationCycleRef = Power_On_Off
      DTCClass_DtcClass_DTC_0x560642 (DemDTCClass): DemDTCSeverity=DEM_DTC_SEV_NO_SEVERITY, DemUdsDTC=5637698, DemDTCAttributesRef=DtcAttributes_41914fb7
      Radar_Module_General_Memory_Failure (DemEventParameter):
        DemEventKind = DEM_EVENT_KIND_SWC
        DemDTCClassRef = DTCClass_DtcClass_DTC_0x560642
        DemExtendedDataClassRef = ExtendedDataClass_6d15841f
        DemFreezeFrameClassRef = FreezeFrame_d41460f8
        DemFreezeFrameRecNumClassRef = FreezeFrameRecNum_8514b953
        DemDebounceAlgorithmClass
          DemDebounceCounterBased: DemDebounceCounterBasedClassRef=Counter_Based_Debouncing
        DemEventClass:
          DemAgingAllowed = true
          DemAgingCycleCounterThreshold = 40
          DemEventPriority = 2
          DemEventSignificance = DEM_EVENT_SIGNIFICANCE_FAULT
          DemFFPrestorageSupported = false
          DemAgingCycleRef = Power_On_Off
          DemOperationCycleRef = Power_On_Off
      DTCClass_DtcClass_DTC_0x560747 (DemDTCClass): DemDTCSeverity=DEM_DTC_SEV_NO_SEVERITY, DemUdsDTC=5637959, DemDTCAttributesRef=DtcAttributes_41914fb7
      Radar_Module_Watchdog_Failure (DemEventParameter):
        DemEventKind = DEM_EVENT_KIND_SWC
        DemDTCClassRef = DTCClass_DtcClass_DTC_0x560747
        DemExtendedDataClassRef = ExtendedDataClass_6d15841f
        DemFreezeFrameClassRef = FreezeFrame_d41460f8
        DemFreezeFrameRecNumClassRef = FreezeFrameRecNum_8514b953
        DemDebounceAlgorithmClass
          DemDebounceCounterBased: DemDebounceCounterBasedClassRef=Counter_Based_Debouncing
        DemEventClass:
          DemAgingAllowed = true
          DemAgingCycleCounterThreshold = 40
          DemEventPriority = 2
          DemEventSignificance = DEM_EVENT_SIGNIFICANCE_FAULT
          DemFFPrestorageSupported = false
          DemAgingCycleRef = Power_On_Off
          DemOperationCycleRef = Power_On_Off
      DTCClass_DtcClass_DTC_0x5608A2 (DemDTCClass): DemDTCSeverity=DEM_DTC_SEV_NO_SEVERITY, DemUdsDTC=5638306, DemDTCAttributesRef=DtcAttributes_41914fb7
      Radar_System_Battery_Low_Voltage_System_Voltage_Low (DemEventParameter):
        DemEventKind = DEM_EVENT_KIND_SWC
        DemDTCClassRef = DTCClass_DtcClass_DTC_0x5608A2
        DemExtendedDataClassRef = ExtendedDataClass_6d15841f
        DemFreezeFrameClassRef = FreezeFrame_d41460f8
        DemFreezeFrameRecNumClassRef = FreezeFrameRecNum_8514b953
        DemDebounceAlgorithmClass
          DemDebounceCounterBased: DemDebounceCounterBasedClassRef=Counter_Based_Debouncing
        DemEventClass:
          DemAgingAllowed = true
          DemAgingCycleCounterThreshold = 40
          DemEventPriority = 2
          DemEventSignificance = DEM_EVENT_SIGNIFICANCE_FAULT
          DemFFPrestorageSupported = false
          DemAgingCycleRef = Power_On_Off
          DemOperationCycleRef = Power_On_Off
      DTCClass_DtcClass_DTC_0x5609A3 (DemDTCClass): DemDTCSeverity=DEM_DTC_SEV_NO_SEVERITY, DemUdsDTC=5638563, DemDTCAttributesRef=DtcAttributes_41914fb7
      Radar_System_Battery_High_Voltage_System_Voltage_High (DemEventParameter):
        DemEventKind = DEM_EVENT_KIND_SWC
        DemDTCClassRef = DTCClass_DtcClass_DTC_0x5609A3
        DemExtendedDataClassRef = ExtendedDataClass_6d15841f
        DemFreezeFrameClassRef = FreezeFrame_d41460f8
        DemFreezeFrameRecNumClassRef = FreezeFrameRecNum_8514b953
        DemDebounceAlgorithmClass
          DemDebounceCounterBased: DemDebounceCounterBasedClassRef=Counter_Based_Debouncing
        DemEventClass:
          DemAgingAllowed = true
          DemAgingCycleCounterThreshold = 40
          DemEventPriority = 2
          DemEventSignificance = DEM_EVENT_SIGNIFICANCE_FAULT
          DemFFPrestorageSupported = false
          DemAgingCycleRef = Power_On_Off
          DemOperationCycleRef = Power_On_Off
      DTCClass_DtcClass_DTC_0x560A54 (DemDTCClass): DemDTCSeverity=DEM_DTC_SEV_NO_SEVERITY, DemUdsDTC=5638740, DemDTCAttributesRef=DtcAttributes_41914fb7
      Radar_Initial_Alignment_Missing_Calibration (DemEventParameter):
        DemEventKind = DEM_EVENT_KIND_SWC
        DemDTCClassRef = DTCClass_DtcClass_DTC_0x560A54
        DemExtendedDataClassRef = ExtendedDataClass_6d15841f
        DemFreezeFrameClassRef = FreezeFrame_d41460f8
        DemFreezeFrameRecNumClassRef = FreezeFrameRecNum_8514b953
        DemDebounceAlgorithmClass
          DemDebounceCounterBased: DemDebounceCounterBasedClassRef=Counter_Based_Debouncing
        DemEventClass:
          DemAgingAllowed = true
          DemAgingCycleCounterThreshold = 40
          DemEventPriority = 2
          DemEventSignificance = DEM_EVENT_SIGNIFICANCE_FAULT
          DemFFPrestorageSupported = false
          DemAgingCycleRef = Power_On_Off
          DemOperationCycleRef = Power_On_Off
      DTCClass_DtcClass_DTC_0x560B78 (DemDTCClass): DemDTCSeverity=DEM_DTC_SEV_NO_SEVERITY, DemUdsDTC=5639032, DemDTCAttributesRef=DtcAttributes_41914fb7
      Radar_AutoAlignment_Range_Alignment_or_Adjustement_Incorrect (DemEventParameter):
        DemEventKind = DEM_EVENT_KIND_SWC
        DemDTCClassRef = DTCClass_DtcClass_DTC_0x560B78
        DemExtendedDataClassRef = ExtendedDataClass_6d15841f
        DemFreezeFrameClassRef = FreezeFrame_d41460f8
        DemFreezeFrameRecNumClassRef = FreezeFrameRecNum_8514b953
        DemDebounceAlgorithmClass
          DemDebounceCounterBased: DemDebounceCounterBasedClassRef=Counter_Based_Debouncing
        DemEventClass:
          DemAgingAllowed = true
          DemAgingCycleCounterThreshold = 40
          DemEventPriority = 2
          DemEventSignificance = DEM_EVENT_SIGNIFICANCE_FAULT
          DemFFPrestorageSupported = false
          DemAgingCycleRef = Power_On_Off
          DemOperationCycleRef = Power_On_Off
      DTCClass_DtcClass_DTC_0x560C61 (DemDTCClass): DemDTCSeverity=DEM_DTC_SEV_NO_SEVERITY, DemUdsDTC=5639265, DemDTCAttributesRef=DtcAttributes_41914fb7
      Radar_AutoAlignment_Algorithm_Signal_Calculation_Failure (DemEventParameter):
        DemEventKind = DEM_EVENT_KIND_SWC
        DemDTCClassRef = DTCClass_DtcClass_DTC_0x560C61
        DemExtendedDataClassRef = ExtendedDataClass_6d15841f
        DemFreezeFrameClassRef = FreezeFrame_d41460f8
        DemFreezeFrameRecNumClassRef = FreezeFrameRecNum_8514b953
        DemDebounceAlgorithmClass
          DemDebounceCounterBased: DemDebounceCounterBasedClassRef=Counter_Based_Debouncing
        DemEventClass:
          DemAgingAllowed = true
          DemAgingCycleCounterThreshold = 40
          DemEventPriority = 2
          DemEventSignificance = DEM_EVENT_SIGNIFICANCE_FAULT
          DemFFPrestorageSupported = false
          DemAgingCycleRef = Power_On_Off
          DemOperationCycleRef = Power_On_Off
      DTCClass_DtcClass_DTC_0x560D46 (DemDTCClass): DemDTCSeverity=DEM_DTC_SEV_NO_SEVERITY, DemUdsDTC=5639494, DemDTCAttributesRef=DtcAttributes_41914fb7
      Radar_calibration_Calibration_or_Paramater_Memory_Failure (DemEventParameter):
        DemEventKind = DEM_EVENT_KIND_SWC
        DemDTCClassRef = DTCClass_DtcClass_DTC_0x560D46
        DemExtendedDataClassRef = ExtendedDataClass_6d15841f
        DemFreezeFrameClassRef = FreezeFrame_d41460f8
        DemFreezeFrameRecNumClassRef = FreezeFrameRecNum_8514b953
        DemDebounceAlgorithmClass
          DemDebounceCounterBased: DemDebounceCounterBasedClassRef=Counter_Based_Debouncing
        DemEventClass:
          DemAgingAllowed = true
          DemAgingCycleCounterThreshold = 40
          DemEventPriority = 2
          DemEventSignificance = DEM_EVENT_SIGNIFICANCE_FAULT
          DemFFPrestorageSupported = false
          DemAgingCycleRef = Power_On_Off
          DemOperationCycleRef = Power_On_Off
      DTCClass_DtcClass_DTC_0x560E41 (DemDTCClass): DemDTCSeverity=DEM_DTC_SEV_NO_SEVERITY, DemUdsDTC=5639745, DemDTCAttributesRef=DtcAttributes_41914fb7
      Radar_SMC_General_Checksum_Failure (DemEventParameter):
        DemEventKind = DEM_EVENT_KIND_SWC
        DemDTCClassRef = DTCClass_DtcClass_DTC_0x560E41
        DemExtendedDataClassRef = ExtendedDataClass_6d15841f
        DemFreezeFrameClassRef = FreezeFrame_d41460f8
        DemFreezeFrameRecNumClassRef = FreezeFrameRecNum_8514b953
        DemDebounceAlgorithmClass
          DemDebounceCounterBased: DemDebounceCounterBasedClassRef=Counter_Based_Debouncing
        DemEventClass:
          DemAgingAllowed = true
          DemAgingCycleCounterThreshold = 40
          DemEventPriority = 2
          DemEventSignificance = DEM_EVENT_SIGNIFICANCE_FAULT
          DemFFPrestorageSupported = false
          DemAgingCycleRef = Power_On_Off
          DemOperationCycleRef = Power_On_Off
      DTCClass_DtcClass_DTC_0x560F76 (DemDTCClass): DemDTCSeverity=DEM_DTC_SEV_NO_SEVERITY, DemUdsDTC=5640054, DemDTCAttributesRef=DtcAttributes_41914fb7
      Radar_Pin_Position_Wrong_Mounting_Position (DemEventParameter):
        DemEventKind = DEM_EVENT_KIND_SWC
        DemDTCClassRef = DTCClass_DtcClass_DTC_0x560F76
        DemExtendedDataClassRef = ExtendedDataClass_6d15841f
        DemFreezeFrameClassRef = FreezeFrame_d41460f8
        DemFreezeFrameRecNumClassRef = FreezeFrameRecNum_8514b953
        DemDebounceAlgorithmClass
          DemDebounceCounterBased: DemDebounceCounterBasedClassRef=Counter_Based_Debouncing
        DemEventClass:
          DemAgingAllowed = true
          DemAgingCycleCounterThreshold = 40
          DemEventPriority = 2
          DemEventSignificance = DEM_EVENT_SIGNIFICANCE_FAULT
          DemFFPrestorageSupported = false
          DemAgingCycleRef = Power_On_Off
          DemOperationCycleRef = Power_On_Off
      DTCClass_DtcClass_DTC_0x561092 (DemDTCClass): DemDTCSeverity=DEM_DTC_SEV_NO_SEVERITY, DemUdsDTC=5640338, DemDTCAttributesRef=DtcAttributes_41914fb7
      Radar_AutoAlignment_Misalignment_Performance_or_Incorrect_Operation (DemEventParameter):
        DemEventKind = DEM_EVENT_KIND_SWC
        DemDTCClassRef = DTCClass_DtcClass_DTC_0x561092
        DemExtendedDataClassRef = ExtendedDataClass_6d15841f
        DemFreezeFrameClassRef = FreezeFrame_d41460f8
        DemFreezeFrameRecNumClassRef = FreezeFrameRecNum_8514b953
        DemDebounceAlgorithmClass
          DemDebounceCounterBased: DemDebounceCounterBasedClassRef=Counter_Based_Debouncing
        DemEventClass:
          DemAgingAllowed = true
          DemAgingCycleCounterThreshold = 40
          DemEventPriority = 2
          DemEventSignificance = DEM_EVENT_SIGNIFICANCE_FAULT
          DemFFPrestorageSupported = false
          DemAgingCycleRef = Power_On_Off
          DemOperationCycleRef = Power_On_Off
      DTCClass_DtcClass_DTC_0x561195 (DemDTCClass): DemDTCSeverity=DEM_DTC_SEV_NO_SEVERITY, DemUdsDTC=5640597, DemDTCAttributesRef=DtcAttributes_41914fb7
      Radar_Mounting_Orientation_Incorrect_Assembly (DemEventParameter):
        DemEventKind = DEM_EVENT_KIND_SWC
        DemDTCClassRef = DTCClass_DtcClass_DTC_0x561195
        DemExtendedDataClassRef = ExtendedDataClass_6d15841f
        DemFreezeFrameClassRef = FreezeFrame_d41460f8
        DemFreezeFrameRecNumClassRef = FreezeFrameRecNum_8514b953
        DemDebounceAlgorithmClass
          DemDebounceCounterBased: DemDebounceCounterBasedClassRef=Counter_Based_Debouncing
        DemEventClass:
          DemAgingAllowed = true
          DemAgingCycleCounterThreshold = 40
          DemEventPriority = 2
          DemEventSignificance = DEM_EVENT_SIGNIFICANCE_FAULT
          DemFFPrestorageSupported = false
          DemAgingCycleRef = Power_On_Off
          DemOperationCycleRef = Power_On_Off
      DTCClass_DtcClass_DTC_0x561305 (DemDTCClass): DemDTCSeverity=DEM_DTC_SEV_NO_SEVERITY, DemUdsDTC=5640965, DemDTCAttributesRef=DtcAttributes_41914fb7
      Radar_Platform_Time_System_Programming_Failure (DemEventParameter):
        DemEventKind = DEM_EVENT_KIND_SWC
        DemDTCClassRef = DTCClass_DtcClass_DTC_0x561305
        DemExtendedDataClassRef = ExtendedDataClass_6d15841f
        DemFreezeFrameClassRef = FreezeFrame_d41460f8
        DemFreezeFrameRecNumClassRef = FreezeFrameRecNum_8514b953
        DemDebounceAlgorithmClass
          DemDebounceCounterBased: DemDebounceCounterBasedClassRef=Counter_Based_Debouncing
        DemEventClass:
          DemAgingAllowed = true
          DemAgingCycleCounterThreshold = 40
          DemEventPriority = 2
          DemEventSignificance = DEM_EVENT_SIGNIFICANCE_FAULT
          DemFFPrestorageSupported = false
          DemAgingCycleRef = Power_On_Off
          DemOperationCycleRef = Power_On_Off
      DTCClass_DtcClass_DTC_0x561583 (DemDTCClass): DemDTCSeverity=DEM_DTC_SEV_NO_SEVERITY, DemUdsDTC=5641603, DemDTCAttributesRef=DtcAttributes_41914fb7
      Vehicle_Dataset_value_of_signal_protection_calculation_Incorrect (DemEventParameter):
        DemEventKind = DEM_EVENT_KIND_SWC
        DemDTCClassRef = DTCClass_DtcClass_DTC_0x561583
        DemExtendedDataClassRef = ExtendedDataClass_6d15841f
        DemFreezeFrameClassRef = FreezeFrame_d41460f8
        DemFreezeFrameRecNumClassRef = FreezeFrameRecNum_8514b953
        DemDebounceAlgorithmClass
          DemDebounceCounterBased: DemDebounceCounterBasedClassRef=Counter_Based_Debouncing
        DemEventClass:
          DemAgingAllowed = true
          DemAgingCycleCounterThreshold = 40
          DemEventPriority = 2
          DemEventSignificance = DEM_EVENT_SIGNIFICANCE_FAULT
          DemFFPrestorageSupported = false
          DemAgingCycleRef = Power_On_Off
          DemOperationCycleRef = Power_On_Off
      DTCClass_DtcClass_DTC_0x561655 (DemDTCClass): DemDTCSeverity=DEM_DTC_SEV_NO_SEVERITY, DemUdsDTC=5641813, DemDTCAttributesRef=DtcAttributes_41914fb7
      Vehicle_DataSet_Not_Configured (DemEventParameter):
        DemEventKind = DEM_EVENT_KIND_SWC
        DemDTCClassRef = DTCClass_DtcClass_DTC_0x561655
        DemExtendedDataClassRef = ExtendedDataClass_6d15841f
        DemFreezeFrameClassRef = FreezeFrame_d41460f8
        DemFreezeFrameRecNumClassRef = FreezeFrameRecNum_8514b953
        DemDebounceAlgorithmClass
          DemDebounceCounterBased: DemDebounceCounterBasedClassRef=Counter_Based_Debouncing
        DemEventClass:
          DemAgingAllowed = true
          DemAgingCycleCounterThreshold = 40
          DemEventPriority = 2
          DemEventSignificance = DEM_EVENT_SIGNIFICANCE_FAULT
          DemFFPrestorageSupported = false
          DemAgingCycleRef = Power_On_Off
          DemOperationCycleRef = Power_On_Off
      DTCClass_DtcClass_DTC_0x561745 (DemDTCClass): DemDTCSeverity=DEM_DTC_SEV_NO_SEVERITY, DemUdsDTC=5642565, DemDTCAttributesRef=DtcAttributes_41914fb7
      ECU_NVM_Corruption_Program_memory_Failure (DemEventParameter):
        DemEventKind = DEM_EVENT_KIND_SWC
        DemDTCClassRef = DTCClass_DtcClass_DTC_0x561745
        DemExtendedDataClassRef = ExtendedDataClass_6d15841f
        DemFreezeFrameClassRef = FreezeFrame_d41460f8
        DemFreezeFrameRecNumClassRef = FreezeFrameRecNum_8514b953
        DemDebounceAlgorithmClass
          DemDebounceCounterBased: DemDebounceCounterBasedClassRef=Counter_Based_Debouncing
        DemEventClass:
          DemAgingAllowed = true
          DemAgingCycleCounterThreshold = 40
          DemEventPriority = 2
          DemEventSignificance = DEM_EVENT_SIGNIFICANCE_FAULT
          DemFFPrestorageSupported = false
          DemAgingCycleRef = Power_On_Off
          DemOperationCycleRef = Power_On_Off
      DTCClass_DtcClass_DTC_0xD4004B (DemDTCClass): DemDTCSeverity=DEM_DTC_SEV_NO_SEVERITY, DemUdsDTC=13893707, DemDTCAttributesRef=DtcAttributes_41914fb7
      Radar_Module_Over_Temperature (DemEventParameter):
        DemEventKind = DEM_EVENT_KIND_SWC
        DemDTCClassRef = DTCClass_DtcClass_DTC_0xD4004B
        DemExtendedDataClassRef = ExtendedDataClass_6d15841f
        DemFreezeFrameClassRef = FreezeFrame_d41460f8
        DemFreezeFrameRecNumClassRef = FreezeFrameRecNum_8514b953
        DemDebounceAlgorithmClass
          DemDebounceCounterBased: DemDebounceCounterBasedClassRef=Counter_Based_Debouncing
        DemEventClass:
          DemAgingAllowed = true
          DemAgingCycleCounterThreshold = 40
          DemEventPriority = 2
          DemEventSignificance = DEM_EVENT_SIGNIFICANCE_FAULT
          DemFFPrestorageSupported = false
          DemAgingCycleRef = Power_On_Off
          DemOperationCycleRef = Power_On_Off
      DTCClass_DtcClass_DTC_0xD40188 (DemDTCClass): DemDTCSeverity=DEM_DTC_SEV_NO_SEVERITY, DemUdsDTC=13894024, DemDTCAttributesRef=DtcAttributes_41914fb7
      VCAN_Communication_Bus_Off (DemEventParameter):
        DemEventKind = DEM_EVENT_KIND_SWC
        DemDTCClassRef = DTCClass_DtcClass_DTC_0xD40188
        DemExtendedDataClassRef = ExtendedDataClass_6d15841f
        DemFreezeFrameClassRef = FreezeFrame_d41460f8
        DemFreezeFrameRecNumClassRef = FreezeFrameRecNum_8514b953
        DemDebounceAlgorithmClass
          DemDebounceCounterBased: DemDebounceCounterBasedClassRef=Counter_Based_Debouncing
        DemEventClass:
          DemAgingAllowed = true
          DemAgingCycleCounterThreshold = 40
          DemEventPriority = 2
          DemEventSignificance = DEM_EVENT_SIGNIFICANCE_FAULT
          DemFFPrestorageSupported = false
          DemAgingCycleRef = Power_On_Off
          DemOperationCycleRef = Power_On_Off
      DTCClass_DtcClass_DTC_0xD40288 (DemDTCClass): DemDTCSeverity=DEM_DTC_SEV_NO_SEVERITY, DemUdsDTC=13894280, DemDTCAttributesRef=DtcAttributes_41914fb7
      PCAN_Communication_Bus_Off (DemEventParameter):
        DemEventKind = DEM_EVENT_KIND_SWC
        DemDTCClassRef = DTCClass_DtcClass_DTC_0xD40288
        DemExtendedDataClassRef = ExtendedDataClass_6d15841f
        DemFreezeFrameClassRef = FreezeFrame_d41460f8
        DemFreezeFrameRecNumClassRef = FreezeFrameRecNum_8514b953
        DemDebounceAlgorithmClass
          DemDebounceCounterBased: DemDebounceCounterBasedClassRef=Counter_Based_Debouncing
        DemEventClass:
          DemAgingAllowed = true
          DemAgingCycleCounterThreshold = 40
          DemEventPriority = 2
          DemEventSignificance = DEM_EVENT_SIGNIFICANCE_FAULT
          DemFFPrestorageSupported = false
          DemAgingCycleRef = Power_On_Off
          DemOperationCycleRef = Power_On_Off
      DTCClass_DtcClass_DTC_0xD40387 (DemDTCClass): DemDTCSeverity=DEM_DTC_SEV_NO_SEVERITY, DemUdsDTC=13894535, DemDTCAttributesRef=DtcAttributes_41914fb7
      EMS_ECU_CCVS1_message_Missing_Message (DemEventParameter):
        DemEventKind = DEM_EVENT_KIND_SWC
        DemDTCClassRef = DTCClass_DtcClass_DTC_0xD40387
        DemExtendedDataClassRef = ExtendedDataClass_6d15841f
        DemFreezeFrameClassRef = FreezeFrame_d41460f8
        DemFreezeFrameRecNumClassRef = FreezeFrameRecNum_8514b953
        DemDebounceAlgorithmClass
          DemDebounceCounterBased: DemDebounceCounterBasedClassRef=Counter_Based_Debouncing
        DemEventClass:
          DemAgingAllowed = true
          DemAgingCycleCounterThreshold = 40
          DemEventPriority = 2
          DemEventSignificance = DEM_EVENT_SIGNIFICANCE_FAULT
          DemFFPrestorageSupported = false
          DemAgingCycleRef = Power_On_Off
          DemOperationCycleRef = Power_On_Off
      DTCClass_DtcClass_DTC_0xD40487 (DemDTCClass): DemDTCSeverity=DEM_DTC_SEV_NO_SEVERITY, DemUdsDTC=13894791, DemDTCAttributesRef=DtcAttributes_41914fb7
      EMS_ECU_ETC2_00_message_Missing_Message (DemEventParameter):
        DemEventKind = DEM_EVENT_KIND_SWC
        DemDTCClassRef = DTCClass_DtcClass_DTC_0xD40487
        DemExtendedDataClassRef = ExtendedDataClass_6d15841f
        DemFreezeFrameClassRef = FreezeFrame_d41460f8
        DemFreezeFrameRecNumClassRef = FreezeFrameRecNum_8514b953
        DemDebounceAlgorithmClass
          DemDebounceCounterBased: DemDebounceCounterBasedClassRef=Counter_Based_Debouncing
        DemEventClass:
          DemAgingAllowed = true
          DemAgingCycleCounterThreshold = 40
          DemEventPriority = 2
          DemEventSignificance = DEM_EVENT_SIGNIFICANCE_FAULT
          DemFFPrestorageSupported = false
          DemAgingCycleRef = Power_On_Off
          DemOperationCycleRef = Power_On_Off
      DTCClass_DtcClass_DTC_0xD40587 (DemDTCClass): DemDTCSeverity=DEM_DTC_SEV_NO_SEVERITY, DemUdsDTC=13895047, DemDTCAttributesRef=DtcAttributes_41914fb7
      EMS_ECU_VD_message_Missing_Message (DemEventParameter):
        DemEventKind = DEM_EVENT_KIND_SWC
        DemDTCClassRef = DTCClass_DtcClass_DTC_0xD40587
        DemExtendedDataClassRef = ExtendedDataClass_6d15841f
        DemFreezeFrameClassRef = FreezeFrame_d41460f8
        DemFreezeFrameRecNumClassRef = FreezeFrameRecNum_8514b953
        DemDebounceAlgorithmClass
          DemDebounceCounterBased: DemDebounceCounterBasedClassRef=Counter_Based_Debouncing
        DemEventClass:
          DemAgingAllowed = true
          DemAgingCycleCounterThreshold = 40
          DemEventPriority = 2
          DemEventSignificance = DEM_EVENT_SIGNIFICANCE_FAULT
          DemFFPrestorageSupported = false
          DemAgingCycleRef = Power_On_Off
          DemOperationCycleRef = Power_On_Off
      DTCClass_DtcClass_DTC_0xD40687 (DemDTCClass): DemDTCSeverity=DEM_DTC_SEV_NO_SEVERITY, DemUdsDTC=13895303, DemDTCAttributesRef=DtcAttributes_41914fb7
      ESC_ECU_VDC2_message_Missing_Message (DemEventParameter):
        DemEventKind = DEM_EVENT_KIND_SWC
        DemDTCClassRef = DTCClass_DtcClass_DTC_0xD40687
        DemExtendedDataClassRef = ExtendedDataClass_6d15841f
        DemFreezeFrameClassRef = FreezeFrame_d41460f8
        DemFreezeFrameRecNumClassRef = FreezeFrameRecNum_8514b953
        DemDebounceAlgorithmClass
          DemDebounceCounterBased: DemDebounceCounterBasedClassRef=Counter_Based_Debouncing
        DemEventClass:
          DemAgingAllowed = true
          DemAgingCycleCounterThreshold = 40
          DemEventPriority = 2
          DemEventSignificance = DEM_EVENT_SIGNIFICANCE_FAULT
          DemFFPrestorageSupported = false
          DemAgingCycleRef = Power_On_Off
          DemOperationCycleRef = Power_On_Off
      DTCClass_DtcClass_DTC_0xD40787 (DemDTCClass): DemDTCSeverity=DEM_DTC_SEV_NO_SEVERITY, DemUdsDTC=13895559, DemDTCAttributesRef=DtcAttributes_41914fb7
      AT_AMT_ECU_ETC2_03_message_Missing_Message (DemEventParameter):
        DemEventKind = DEM_EVENT_KIND_SWC
        DemDTCClassRef = DTCClass_DtcClass_DTC_0xD40787
        DemExtendedDataClassRef = ExtendedDataClass_6d15841f
        DemFreezeFrameClassRef = FreezeFrame_d41460f8
        DemFreezeFrameRecNumClassRef = FreezeFrameRecNum_8514b953
        DemDebounceAlgorithmClass
          DemDebounceCounterBased: DemDebounceCounterBasedClassRef=Counter_Based_Debouncing
        DemEventClass:
          DemAgingAllowed = true
          DemAgingCycleCounterThreshold = 40
          DemEventPriority = 2
          DemEventSignificance = DEM_EVENT_SIGNIFICANCE_FAULT
          DemFFPrestorageSupported = false
          DemAgingCycleRef = Power_On_Off
          DemOperationCycleRef = Power_On_Off
      DTCClass_DtcClass_DTC_0xD40887 (DemDTCClass): DemDTCSeverity=DEM_DTC_SEV_NO_SEVERITY, DemUdsDTC=13895815, DemDTCAttributesRef=DtcAttributes_41914fb7
      Cluster_ECU_ADAS_FN_STS_message_Missing_Message (DemEventParameter):
        DemEventKind = DEM_EVENT_KIND_SWC
        DemDTCClassRef = DTCClass_DtcClass_DTC_0xD40887
        DemExtendedDataClassRef = ExtendedDataClass_6d15841f
        DemFreezeFrameClassRef = FreezeFrame_d41460f8
        DemFreezeFrameRecNumClassRef = FreezeFrameRecNum_8514b953
        DemDebounceAlgorithmClass
          DemDebounceCounterBased: DemDebounceCounterBasedClassRef=Counter_Based_Debouncing
        DemEventClass:
          DemAgingAllowed = true
          DemAgingCycleCounterThreshold = 40
          DemEventPriority = 2
          DemEventSignificance = DEM_EVENT_SIGNIFICANCE_FAULT
          DemFFPrestorageSupported = false
          DemAgingCycleRef = Power_On_Off
          DemOperationCycleRef = Power_On_Off
      DTCClass_DtcClass_DTC_0xD40987 (DemDTCClass): DemDTCSeverity=DEM_DTC_SEV_NO_SEVERITY, DemUdsDTC=13896071, DemDTCAttributesRef=DtcAttributes_41914fb7
      Cluster_ECU_CLS_Tx_16_message_Missing_Message (DemEventParameter):
        DemEventKind = DEM_EVENT_KIND_SWC
        DemDTCClassRef = DTCClass_DtcClass_DTC_0xD40987
        DemExtendedDataClassRef = ExtendedDataClass_6d15841f
        DemFreezeFrameClassRef = FreezeFrame_d41460f8
        DemFreezeFrameRecNumClassRef = FreezeFrameRecNum_8514b953
        DemDebounceAlgorithmClass
          DemDebounceCounterBased: DemDebounceCounterBasedClassRef=Counter_Based_Debouncing
        DemEventClass:
          DemAgingAllowed = true
          DemAgingCycleCounterThreshold = 40
          DemEventPriority = 2
          DemEventSignificance = DEM_EVENT_SIGNIFICANCE_FAULT
          DemFFPrestorageSupported = false
          DemAgingCycleRef = Power_On_Off
          DemOperationCycleRef = Power_On_Off
      DTCClass_DtcClass_DTC_0xD41087 (DemDTCClass): DemDTCSeverity=DEM_DTC_SEV_NO_SEVERITY, DemUdsDTC=13897863, DemDTCAttributesRef=DtcAttributes_41914fb7
      Cluster_ECU_CLS_Tx_4_message_Missing_Message (DemEventParameter):
        DemEventKind = DEM_EVENT_KIND_SWC
        DemDTCClassRef = DTCClass_DtcClass_DTC_0xD41087
        DemExtendedDataClassRef = ExtendedDataClass_6d15841f
        DemFreezeFrameClassRef = FreezeFrame_d41460f8
        DemFreezeFrameRecNumClassRef = FreezeFrameRecNum_8514b953
        DemDebounceAlgorithmClass
          DemDebounceCounterBased: DemDebounceCounterBasedClassRef=Counter_Based_Debouncing
        DemEventClass:
          DemAgingAllowed = true
          DemAgingCycleCounterThreshold = 40
          DemEventPriority = 2
          DemEventSignificance = DEM_EVENT_SIGNIFICANCE_FAULT
          DemFFPrestorageSupported = false
          DemAgingCycleRef = Power_On_Off
          DemOperationCycleRef = Power_On_Off
      DTCClass_DtcClass_DTC_0xD41187 (DemDTCClass): DemDTCSeverity=DEM_DTC_SEV_NO_SEVERITY, DemUdsDTC=13898119, DemDTCAttributesRef=DtcAttributes_41914fb7
      Cluster_ECU_OEL_message_Missing_Message (DemEventParameter):
        DemEventKind = DEM_EVENT_KIND_SWC
        DemDTCClassRef = DTCClass_DtcClass_DTC_0xD41187
        DemExtendedDataClassRef = ExtendedDataClass_6d15841f
        DemFreezeFrameClassRef = FreezeFrame_d41460f8
        DemFreezeFrameRecNumClassRef = FreezeFrameRecNum_8514b953
        DemDebounceAlgorithmClass
          DemDebounceCounterBased: DemDebounceCounterBasedClassRef=Counter_Based_Debouncing
        DemEventClass:
          DemAgingAllowed = true
          DemAgingCycleCounterThreshold = 40
          DemEventPriority = 2
          DemEventSignificance = DEM_EVENT_SIGNIFICANCE_FAULT
          DemFFPrestorageSupported = false
          DemAgingCycleRef = Power_On_Off
          DemOperationCycleRef = Power_On_Off
      DTCClass_DtcClass_DTC_0xD41287 (DemDTCClass): DemDTCSeverity=DEM_DTC_SEV_NO_SEVERITY, DemUdsDTC=13898375, DemDTCAttributesRef=DtcAttributes_41914fb7
      Cluster_ECU_TD_message_Missing_Message (DemEventParameter):
        DemEventKind = DEM_EVENT_KIND_SWC
        DemDTCClassRef = DTCClass_DtcClass_DTC_0xD41287
        DemExtendedDataClassRef = ExtendedDataClass_6d15841f
        DemFreezeFrameClassRef = FreezeFrame_d41460f8
        DemFreezeFrameRecNumClassRef = FreezeFrameRecNum_8514b953
        DemDebounceAlgorithmClass
          DemDebounceCounterBased: DemDebounceCounterBasedClassRef=Counter_Based_Debouncing
        DemEventClass:
          DemAgingAllowed = true
          DemAgingCycleCounterThreshold = 40
          DemEventPriority = 2
          DemEventSignificance = DEM_EVENT_SIGNIFICANCE_FAULT
          DemFFPrestorageSupported = false
          DemAgingCycleRef = Power_On_Off
          DemOperationCycleRef = Power_On_Off
      DTCClass_DtcClass_DTC_0xD41387 (DemDTCClass): DemDTCSeverity=DEM_DTC_SEV_NO_SEVERITY, DemUdsDTC=13898631, DemDTCAttributesRef=DtcAttributes_41914fb7
      SAS_ECU_SAS_message_Missing_Message (DemEventParameter):
        DemEventKind = DEM_EVENT_KIND_SWC
        DemDTCClassRef = DTCClass_DtcClass_DTC_0xD41387
        DemExtendedDataClassRef = ExtendedDataClass_6d15841f
        DemFreezeFrameClassRef = FreezeFrame_d41460f8
        DemFreezeFrameRecNumClassRef = FreezeFrameRecNum_8514b953
        DemDebounceAlgorithmClass
          DemDebounceCounterBased: DemDebounceCounterBasedClassRef=Counter_Based_Debouncing
        DemEventClass:
          DemAgingAllowed = true
          DemAgingCycleCounterThreshold = 40
          DemEventPriority = 2
          DemEventSignificance = DEM_EVENT_SIGNIFICANCE_FAULT
          DemFFPrestorageSupported = false
          DemAgingCycleRef = Power_On_Off
          DemOperationCycleRef = Power_On_Off
      DTCClass_DtcClass_DTC_0xD4158F (DemDTCClass): DemDTCSeverity=DEM_DTC_SEV_NO_SEVERITY, DemUdsDTC=13899151, DemDTCAttributesRef=DtcAttributes_41914fb7
      EMS_ECU_CCVS1_erratic_communication_Erractic (DemEventParameter):
        DemEventKind = DEM_EVENT_KIND_SWC
        DemDTCClassRef = DTCClass_DtcClass_DTC_0xD4158F
        DemExtendedDataClassRef = ExtendedDataClass_6d15841f
        DemFreezeFrameClassRef = FreezeFrame_d41460f8
        DemFreezeFrameRecNumClassRef = FreezeFrameRecNum_8514b953
        DemDebounceAlgorithmClass
          DemDebounceCounterBased: DemDebounceCounterBasedClassRef=Counter_Based_Debouncing
        DemEventClass:
          DemAgingAllowed = true
          DemAgingCycleCounterThreshold = 40
          DemEventPriority = 2
          DemEventSignificance = DEM_EVENT_SIGNIFICANCE_FAULT
          DemFFPrestorageSupported = false
          DemAgingCycleRef = Power_On_Off
          DemOperationCycleRef = Power_On_Off
      DTCClass_DtcClass_DTC_0xD4168F (DemDTCClass): DemDTCSeverity=DEM_DTC_SEV_NO_SEVERITY, DemUdsDTC=13899407, DemDTCAttributesRef=DtcAttributes_41914fb7
      EMS_ECU_ETC2_erratic_communication_Erractic (DemEventParameter):
        DemEventKind = DEM_EVENT_KIND_SWC
        DemDTCClassRef = DTCClass_DtcClass_DTC_0xD4168F
        DemExtendedDataClassRef = ExtendedDataClass_6d15841f
        DemFreezeFrameClassRef = FreezeFrame_d41460f8
        DemFreezeFrameRecNumClassRef = FreezeFrameRecNum_8514b953
        DemDebounceAlgorithmClass
          DemDebounceCounterBased: DemDebounceCounterBasedClassRef=Counter_Based_Debouncing
        DemEventClass:
          DemAgingAllowed = true
          DemAgingCycleCounterThreshold = 40
          DemEventPriority = 2
          DemEventSignificance = DEM_EVENT_SIGNIFICANCE_FAULT
          DemFFPrestorageSupported = false
          DemAgingCycleRef = Power_On_Off
          DemOperationCycleRef = Power_On_Off
      DTCClass_DtcClass_DTC_0xD4178F (DemDTCClass): DemDTCSeverity=DEM_DTC_SEV_NO_SEVERITY, DemUdsDTC=13899663, DemDTCAttributesRef=DtcAttributes_41914fb7
      EMS_ECU_VD_erratic_communication_Erratic (DemEventParameter):
        DemEventKind = DEM_EVENT_KIND_SWC
        DemDTCClassRef = DTCClass_DtcClass_DTC_0xD4178F
        DemExtendedDataClassRef = ExtendedDataClass_6d15841f
        DemFreezeFrameClassRef = FreezeFrame_d41460f8
        DemFreezeFrameRecNumClassRef = FreezeFrameRecNum_8514b953
        DemDebounceAlgorithmClass
          DemDebounceCounterBased: DemDebounceCounterBasedClassRef=Counter_Based_Debouncing
        DemEventClass:
          DemAgingAllowed = true
          DemAgingCycleCounterThreshold = 40
          DemEventPriority = 2
          DemEventSignificance = DEM_EVENT_SIGNIFICANCE_FAULT
          DemFFPrestorageSupported = false
          DemAgingCycleRef = Power_On_Off
          DemOperationCycleRef = Power_On_Off
      DTCClass_DtcClass_DTC_0xD4188F (DemDTCClass): DemDTCSeverity=DEM_DTC_SEV_NO_SEVERITY, DemUdsDTC=13899919, DemDTCAttributesRef=DtcAttributes_41914fb7
      ESC_ECU_VDC2_erratic_communication_Erratic (DemEventParameter):
        DemEventKind = DEM_EVENT_KIND_SWC
        DemDTCClassRef = DTCClass_DtcClass_DTC_0xD4188F
        DemExtendedDataClassRef = ExtendedDataClass_6d15841f
        DemFreezeFrameClassRef = FreezeFrame_d41460f8
        DemFreezeFrameRecNumClassRef = FreezeFrameRecNum_8514b953
        DemDebounceAlgorithmClass
          DemDebounceCounterBased: DemDebounceCounterBasedClassRef=Counter_Based_Debouncing
        DemEventClass:
          DemAgingAllowed = true
          DemAgingCycleCounterThreshold = 40
          DemEventPriority = 2
          DemEventSignificance = DEM_EVENT_SIGNIFICANCE_FAULT
          DemFFPrestorageSupported = false
          DemAgingCycleRef = Power_On_Off
          DemOperationCycleRef = Power_On_Off
      DTCClass_DtcClass_DTC_0xD4198F (DemDTCClass): DemDTCSeverity=DEM_DTC_SEV_NO_SEVERITY, DemUdsDTC=13900175, DemDTCAttributesRef=DtcAttributes_41914fb7
      AT_AMT_ETC2_erratic_communication_Erratic (DemEventParameter):
        DemEventKind = DEM_EVENT_KIND_SWC
        DemDTCClassRef = DTCClass_DtcClass_DTC_0xD4198F
        DemExtendedDataClassRef = ExtendedDataClass_6d15841f
        DemFreezeFrameClassRef = FreezeFrame_d41460f8
        DemFreezeFrameRecNumClassRef = FreezeFrameRecNum_8514b953
        DemDebounceAlgorithmClass
          DemDebounceCounterBased: DemDebounceCounterBasedClassRef=Counter_Based_Debouncing
        DemEventClass:
          DemAgingAllowed = true
          DemAgingCycleCounterThreshold = 40
          DemEventPriority = 2
          DemEventSignificance = DEM_EVENT_SIGNIFICANCE_FAULT
          DemFFPrestorageSupported = false
          DemAgingCycleRef = Power_On_Off
          DemOperationCycleRef = Power_On_Off
      DTCClass_DtcClass_DTC_0xD4208F (DemDTCClass): DemDTCSeverity=DEM_DTC_SEV_NO_SEVERITY, DemUdsDTC=13901967, DemDTCAttributesRef=DtcAttributes_41914fb7
      Cluster_ECU_CLS_Tx_4_erratic_communication_Erratic (DemEventParameter):
        DemEventKind = DEM_EVENT_KIND_SWC
        DemDTCClassRef = DTCClass_DtcClass_DTC_0xD4208F
        DemExtendedDataClassRef = ExtendedDataClass_6d15841f
        DemFreezeFrameClassRef = FreezeFrame_d41460f8
        DemFreezeFrameRecNumClassRef = FreezeFrameRecNum_8514b953
        DemDebounceAlgorithmClass
          DemDebounceCounterBased: DemDebounceCounterBasedClassRef=Counter_Based_Debouncing
        DemEventClass:
          DemAgingAllowed = true
          DemAgingCycleCounterThreshold = 40
          DemEventPriority = 2
          DemEventSignificance = DEM_EVENT_SIGNIFICANCE_FAULT
          DemFFPrestorageSupported = false
          DemAgingCycleRef = Power_On_Off
          DemOperationCycleRef = Power_On_Off
      DTCClass_DtcClass_DTC_0xD4218F (DemDTCClass): DemDTCSeverity=DEM_DTC_SEV_NO_SEVERITY, DemUdsDTC=13902223, DemDTCAttributesRef=DtcAttributes_41914fb7
      Cluster_ECU_CLS_Tx_16_erratic_communication_Erratic (DemEventParameter):
        DemEventKind = DEM_EVENT_KIND_SWC
        DemDTCClassRef = DTCClass_DtcClass_DTC_0xD4218F
        DemExtendedDataClassRef = ExtendedDataClass_6d15841f
        DemFreezeFrameClassRef = FreezeFrame_d41460f8
        DemFreezeFrameRecNumClassRef = FreezeFrameRecNum_8514b953
        DemDebounceAlgorithmClass
          DemDebounceCounterBased: DemDebounceCounterBasedClassRef=Counter_Based_Debouncing
        DemEventClass:
          DemAgingAllowed = true
          DemAgingCycleCounterThreshold = 40
          DemEventPriority = 2
          DemEventSignificance = DEM_EVENT_SIGNIFICANCE_FAULT
          DemFFPrestorageSupported = false
          DemAgingCycleRef = Power_On_Off
          DemOperationCycleRef = Power_On_Off
      DTCClass_DtcClass_DTC_0xD4228F (DemDTCClass): DemDTCSeverity=DEM_DTC_SEV_NO_SEVERITY, DemUdsDTC=13902479, DemDTCAttributesRef=DtcAttributes_41914fb7
      Cluster_ECU_OEL_erratic_communication_Erratic (DemEventParameter):
        DemEventKind = DEM_EVENT_KIND_SWC
        DemDTCClassRef = DTCClass_DtcClass_DTC_0xD4228F
        DemExtendedDataClassRef = ExtendedDataClass_6d15841f
        DemFreezeFrameClassRef = FreezeFrame_d41460f8
        DemFreezeFrameRecNumClassRef = FreezeFrameRecNum_8514b953
        DemDebounceAlgorithmClass
          DemDebounceCounterBased: DemDebounceCounterBasedClassRef=Counter_Based_Debouncing
        DemEventClass:
          DemAgingAllowed = true
          DemAgingCycleCounterThreshold = 40
          DemEventPriority = 2
          DemEventSignificance = DEM_EVENT_SIGNIFICANCE_FAULT
          DemFFPrestorageSupported = false
          DemAgingCycleRef = Power_On_Off
          DemOperationCycleRef = Power_On_Off
      DTCClass_DtcClass_DTC_0xD4238F (DemDTCClass): DemDTCSeverity=DEM_DTC_SEV_NO_SEVERITY, DemUdsDTC=13902735, DemDTCAttributesRef=DtcAttributes_41914fb7
      Cluster_ECU_ADAS_FN_STS_erratic_communication_Erratic (DemEventParameter):
        DemEventKind = DEM_EVENT_KIND_SWC
        DemDTCClassRef = DTCClass_DtcClass_DTC_0xD4238F
        DemExtendedDataClassRef = ExtendedDataClass_6d15841f
        DemFreezeFrameClassRef = FreezeFrame_d41460f8
        DemFreezeFrameRecNumClassRef = FreezeFrameRecNum_8514b953
        DemDebounceAlgorithmClass
          DemDebounceCounterBased: DemDebounceCounterBasedClassRef=Counter_Based_Debouncing
        DemEventClass:
          DemAgingAllowed = true
          DemAgingCycleCounterThreshold = 40
          DemEventPriority = 2
          DemEventSignificance = DEM_EVENT_SIGNIFICANCE_FAULT
          DemFFPrestorageSupported = false
          DemAgingCycleRef = Power_On_Off
          DemOperationCycleRef = Power_On_Off
      DTCClass_DtcClass_DTC_0xD4248F (DemDTCClass): DemDTCSeverity=DEM_DTC_SEV_NO_SEVERITY, DemUdsDTC=13902991, DemDTCAttributesRef=DtcAttributes_41914fb7
      Cluster_ECU_TD_erratic_communication_Erratic (DemEventParameter):
        DemEventKind = DEM_EVENT_KIND_SWC
        DemDTCClassRef = DTCClass_DtcClass_DTC_0xD4248F
        DemExtendedDataClassRef = ExtendedDataClass_6d15841f
        DemFreezeFrameClassRef = FreezeFrame_d41460f8
        DemFreezeFrameRecNumClassRef = FreezeFrameRecNum_8514b953
        DemDebounceAlgorithmClass
          DemDebounceCounterBased: DemDebounceCounterBasedClassRef=Counter_Based_Debouncing
        DemEventClass:
          DemAgingAllowed = true
          DemAgingCycleCounterThreshold = 40
          DemEventPriority = 2
          DemEventSignificance = DEM_EVENT_SIGNIFICANCE_FAULT
          DemFFPrestorageSupported = false
          DemAgingCycleRef = Power_On_Off
          DemOperationCycleRef = Power_On_Off
      DTCClass_DtcClass_DTC_0xD4258F (DemDTCClass): DemDTCSeverity=DEM_DTC_SEV_NO_SEVERITY, DemUdsDTC=13903247, DemDTCAttributesRef=DtcAttributes_41914fb7
      SAS_ECU_erratic_communication_Erratic (DemEventParameter):
        DemEventKind = DEM_EVENT_KIND_SWC
        DemDTCClassRef = DTCClass_DtcClass_DTC_0xD4258F
        DemExtendedDataClassRef = ExtendedDataClass_6d15841f
        DemFreezeFrameClassRef = FreezeFrame_d41460f8
        DemFreezeFrameRecNumClassRef = FreezeFrameRecNum_8514b953
        DemDebounceAlgorithmClass
          DemDebounceCounterBased: DemDebounceCounterBasedClassRef=Counter_Based_Debouncing
        DemEventClass:
          DemAgingAllowed = true
          DemAgingCycleCounterThreshold = 40
          DemEventPriority = 2
          DemEventSignificance = DEM_EVENT_SIGNIFICANCE_FAULT
          DemFFPrestorageSupported = false
          DemAgingCycleRef = Power_On_Off
          DemOperationCycleRef = Power_On_Off
      DTCClass_DtcClass_DTC_0xD42681 (DemDTCClass): DemDTCSeverity=DEM_DTC_SEV_NO_SEVERITY, DemUdsDTC=13903489, DemDTCAttributesRef=DtcAttributes_41914fb7
      CCVS1_message_Vehicle_Speed_Invalid_Serial_Data_Received (DemEventParameter):
        DemEventKind = DEM_EVENT_KIND_SWC
        DemDTCClassRef = DTCClass_DtcClass_DTC_0xD42681
        DemExtendedDataClassRef = ExtendedDataClass_6d15841f
        DemFreezeFrameClassRef = FreezeFrame_d41460f8
        DemFreezeFrameRecNumClassRef = FreezeFrameRecNum_8514b953
        DemDebounceAlgorithmClass
          DemDebounceCounterBased: DemDebounceCounterBasedClassRef=Counter_Based_Debouncing
        DemEventClass:
          DemAgingAllowed = true
          DemAgingCycleCounterThreshold = 40
          DemEventPriority = 2
          DemEventSignificance = DEM_EVENT_SIGNIFICANCE_FAULT
          DemFFPrestorageSupported = false
          DemAgingCycleRef = Power_On_Off
          DemOperationCycleRef = Power_On_Off
      DTCClass_DtcClass_DTC_0xD42781 (DemDTCClass): DemDTCSeverity=DEM_DTC_SEV_NO_SEVERITY, DemUdsDTC=13903745, DemDTCAttributesRef=DtcAttributes_41914fb7
      CLS_TX_16_message_Transmission_Type_info_Invalid_Serial_Data_Received (DemEventParameter):
        DemEventKind = DEM_EVENT_KIND_SWC
        DemDTCClassRef = DTCClass_DtcClass_DTC_0xD42781
        DemExtendedDataClassRef = ExtendedDataClass_6d15841f
        DemFreezeFrameClassRef = FreezeFrame_d41460f8
        DemFreezeFrameRecNumClassRef = FreezeFrameRecNum_8514b953
        DemDebounceAlgorithmClass
          DemDebounceCounterBased: DemDebounceCounterBasedClassRef=Counter_Based_Debouncing
        DemEventClass:
          DemAgingAllowed = true
          DemAgingCycleCounterThreshold = 40
          DemEventPriority = 2
          DemEventSignificance = DEM_EVENT_SIGNIFICANCE_FAULT
          DemFFPrestorageSupported = false
          DemAgingCycleRef = Power_On_Off
          DemOperationCycleRef = Power_On_Off
      DTCClass_DtcClass_DTC_0xD42981 (DemDTCClass): DemDTCSeverity=DEM_DTC_SEV_NO_SEVERITY, DemUdsDTC=13904257, DemDTCAttributesRef=DtcAttributes_41914fb7
      Manual_ETC2_message_Transcurrent_gear_Invalid_Serial_Data_Received (DemEventParameter):
        DemEventKind = DEM_EVENT_KIND_SWC
        DemDTCClassRef = DTCClass_DtcClass_DTC_0xD42981
        DemExtendedDataClassRef = ExtendedDataClass_6d15841f
        DemFreezeFrameClassRef = FreezeFrame_d41460f8
        DemFreezeFrameRecNumClassRef = FreezeFrameRecNum_8514b953
        DemDebounceAlgorithmClass
          DemDebounceCounterBased: DemDebounceCounterBasedClassRef=Counter_Based_Debouncing
        DemEventClass:
          DemAgingAllowed = true
          DemAgingCycleCounterThreshold = 40
          DemEventPriority = 2
          DemEventSignificance = DEM_EVENT_SIGNIFICANCE_FAULT
          DemFFPrestorageSupported = false
          DemAgingCycleRef = Power_On_Off
          DemOperationCycleRef = Power_On_Off
      DTCClass_DtcClass_DTC_0xD43081 (DemDTCClass): DemDTCSeverity=DEM_DTC_SEV_NO_SEVERITY, DemUdsDTC=13906049, DemDTCAttributesRef=DtcAttributes_41914fb7
      AT_AMT_ETC2_message_Transcurrent_gear_Invalid_Serial_Data_Received (DemEventParameter):
        DemEventKind = DEM_EVENT_KIND_SWC
        DemDTCClassRef = DTCClass_DtcClass_DTC_0xD43081
        DemExtendedDataClassRef = ExtendedDataClass_6d15841f
        DemFreezeFrameClassRef = FreezeFrame_d41460f8
        DemFreezeFrameRecNumClassRef = FreezeFrameRecNum_8514b953
        DemDebounceAlgorithmClass
          DemDebounceCounterBased: DemDebounceCounterBasedClassRef=Counter_Based_Debouncing
        DemEventClass:
          DemAgingAllowed = true
          DemAgingCycleCounterThreshold = 40
          DemEventPriority = 2
          DemEventSignificance = DEM_EVENT_SIGNIFICANCE_FAULT
          DemFFPrestorageSupported = false
          DemAgingCycleRef = Power_On_Off
          DemOperationCycleRef = Power_On_Off
      DTCClass_DtcClass_DTC_0xD43181 (DemDTCClass): DemDTCSeverity=DEM_DTC_SEV_NO_SEVERITY, DemUdsDTC=13906305, DemDTCAttributesRef=DtcAttributes_41914fb7
      OEL_message_Turn_Signal_Switch_Invalid_Serial_Data_Received (DemEventParameter):
        DemEventKind = DEM_EVENT_KIND_SWC
        DemDTCClassRef = DTCClass_DtcClass_DTC_0xD43181
        DemExtendedDataClassRef = ExtendedDataClass_6d15841f
        DemFreezeFrameClassRef = FreezeFrame_d41460f8
        DemFreezeFrameRecNumClassRef = FreezeFrameRecNum_8514b953
        DemDebounceAlgorithmClass
          DemDebounceCounterBased: DemDebounceCounterBasedClassRef=Counter_Based_Debouncing
        DemEventClass:
          DemAgingAllowed = true
          DemAgingCycleCounterThreshold = 40
          DemEventPriority = 2
          DemEventSignificance = DEM_EVENT_SIGNIFICANCE_FAULT
          DemFFPrestorageSupported = false
          DemAgingCycleRef = Power_On_Off
          DemOperationCycleRef = Power_On_Off
      DTCClass_DtcClass_DTC_0xD43281 (DemDTCClass): DemDTCSeverity=DEM_DTC_SEV_NO_SEVERITY, DemUdsDTC=13906561, DemDTCAttributesRef=DtcAttributes_41914fb7
      SAS_message_Steering_Wheel_Angle_Invalid_Serial_Data_Received (DemEventParameter):
        DemEventKind = DEM_EVENT_KIND_SWC
        DemDTCClassRef = DTCClass_DtcClass_DTC_0xD43281
        DemExtendedDataClassRef = ExtendedDataClass_6d15841f
        DemFreezeFrameClassRef = FreezeFrame_d41460f8
        DemFreezeFrameRecNumClassRef = FreezeFrameRecNum_8514b953
        DemDebounceAlgorithmClass
          DemDebounceCounterBased: DemDebounceCounterBasedClassRef=Counter_Based_Debouncing
        DemEventClass:
          DemAgingAllowed = true
          DemAgingCycleCounterThreshold = 40
          DemEventPriority = 2
          DemEventSignificance = DEM_EVENT_SIGNIFICANCE_FAULT
          DemFFPrestorageSupported = false
          DemAgingCycleRef = Power_On_Off
          DemOperationCycleRef = Power_On_Off
      DTCClass_DtcClass_DTC_0xD43381 (DemDTCClass): DemDTCSeverity=DEM_DTC_SEV_NO_SEVERITY, DemUdsDTC=13906817, DemDTCAttributesRef=DtcAttributes_41914fb7
      VDC2_message_Yaw_rate_Invalid_Serial_Data_Received (DemEventParameter):
        DemEventKind = DEM_EVENT_KIND_SWC
        DemDTCClassRef = DTCClass_DtcClass_DTC_0xD43381
        DemExtendedDataClassRef = ExtendedDataClass_6d15841f
        DemFreezeFrameClassRef = FreezeFrame_d41460f8
        DemFreezeFrameRecNumClassRef = FreezeFrameRecNum_8514b953
        DemDebounceAlgorithmClass
          DemDebounceCounterBased: DemDebounceCounterBasedClassRef=Counter_Based_Debouncing
        DemEventClass:
          DemAgingAllowed = true
          DemAgingCycleCounterThreshold = 40
          DemEventPriority = 2
          DemEventSignificance = DEM_EVENT_SIGNIFICANCE_FAULT
          DemFFPrestorageSupported = false
          DemAgingCycleRef = Power_On_Off
          DemOperationCycleRef = Power_On_Off
      DTCClass_DtcClass_DTC_0xD43481 (DemDTCClass): DemDTCSeverity=DEM_DTC_SEV_NO_SEVERITY, DemUdsDTC=13907073, DemDTCAttributesRef=DtcAttributes_41914fb7
      VDC2_message_Lateral_Accleration_Invalid_Serial_Data_Received (DemEventParameter):
        DemEventKind = DEM_EVENT_KIND_SWC
        DemDTCClassRef = DTCClass_DtcClass_DTC_0xD43481
        DemExtendedDataClassRef = ExtendedDataClass_6d15841f
        DemFreezeFrameClassRef = FreezeFrame_d41460f8
        DemFreezeFrameRecNumClassRef = FreezeFrameRecNum_8514b953
        DemDebounceAlgorithmClass
          DemDebounceCounterBased: DemDebounceCounterBasedClassRef=Counter_Based_Debouncing
        DemEventClass:
          DemAgingAllowed = true
          DemAgingCycleCounterThreshold = 40
          DemEventPriority = 2
          DemEventSignificance = DEM_EVENT_SIGNIFICANCE_FAULT
          DemFFPrestorageSupported = false
          DemAgingCycleRef = Power_On_Off
          DemOperationCycleRef = Power_On_Off
      DTCClass_DtcClass_DTC_0xD43581 (DemDTCClass): DemDTCSeverity=DEM_DTC_SEV_NO_SEVERITY, DemUdsDTC=13907329, DemDTCAttributesRef=DtcAttributes_41914fb7
      VDC2_message_LongitudinalAcceleration_Invalid_Serial_Data_Received (DemEventParameter):
        DemEventKind = DEM_EVENT_KIND_SWC
        DemDTCClassRef = DTCClass_DtcClass_DTC_0xD43581
        DemExtendedDataClassRef = ExtendedDataClass_6d15841f
        DemFreezeFrameClassRef = FreezeFrame_d41460f8
        DemFreezeFrameRecNumClassRef = FreezeFrameRecNum_8514b953
        DemDebounceAlgorithmClass
          DemDebounceCounterBased: DemDebounceCounterBasedClassRef=Counter_Based_Debouncing
        DemEventClass:
          DemAgingAllowed = true
          DemAgingCycleCounterThreshold = 40
          DemEventPriority = 2
          DemEventSignificance = DEM_EVENT_SIGNIFICANCE_FAULT
          DemFFPrestorageSupported = false
          DemAgingCycleRef = Power_On_Off
          DemOperationCycleRef = Power_On_Off
      DTCClass_DtcClass_DTC_0xD43681 (DemDTCClass): DemDTCSeverity=DEM_DTC_SEV_NO_SEVERITY, DemUdsDTC=13907585, DemDTCAttributesRef=DtcAttributes_41914fb7
      ADAS_FN_STS_message_BSIS_FN_Switch_STS_Invalid_Serial_Data_Received (DemEventParameter):
        DemEventKind = DEM_EVENT_KIND_SWC
        DemDTCClassRef = DTCClass_DtcClass_DTC_0xD43681
        DemExtendedDataClassRef = ExtendedDataClass_6d15841f
        DemFreezeFrameClassRef = FreezeFrame_d41460f8
        DemFreezeFrameRecNumClassRef = FreezeFrameRecNum_8514b953
        DemDebounceAlgorithmClass
          DemDebounceCounterBased: DemDebounceCounterBasedClassRef=Counter_Based_Debouncing
        DemEventClass:
          DemAgingAllowed = true
          DemAgingCycleCounterThreshold = 40
          DemEventPriority = 2
          DemEventSignificance = DEM_EVENT_SIGNIFICANCE_FAULT
          DemFFPrestorageSupported = false
          DemAgingCycleRef = Power_On_Off
          DemOperationCycleRef = Power_On_Off
      DTCClass_DtcClass_DTC_0xD43781 (DemDTCClass): DemDTCSeverity=DEM_DTC_SEV_NO_SEVERITY, DemUdsDTC=13907841, DemDTCAttributesRef=DtcAttributes_41914fb7
      ADAS_FN_STS_message_MOIS_FN_Switch_STS_Invalid_Serial_Data_Received (DemEventParameter):
        DemEventKind = DEM_EVENT_KIND_SWC
        DemDTCClassRef = DTCClass_DtcClass_DTC_0xD43781
        DemExtendedDataClassRef = ExtendedDataClass_6d15841f
        DemFreezeFrameClassRef = FreezeFrame_d41460f8
        DemFreezeFrameRecNumClassRef = FreezeFrameRecNum_8514b953
        DemDebounceAlgorithmClass
          DemDebounceCounterBased: DemDebounceCounterBasedClassRef=Counter_Based_Debouncing
        DemEventClass:
          DemAgingAllowed = true
          DemAgingCycleCounterThreshold = 40
          DemEventPriority = 2
          DemEventSignificance = DEM_EVENT_SIGNIFICANCE_FAULT
          DemFFPrestorageSupported = false
          DemAgingCycleRef = Power_On_Off
          DemOperationCycleRef = Power_On_Off
      DTCClass_DtcClass_DTC_0xD43987 (DemDTCClass):
        DemDTCSeverity = DEM_DTC_SEV_NO_SEVERITY
        DemUdsDTC = 13908359
        DemDTCAttributesRef = DtcAttributes_41914fb7
        variation-point = post-build-variant-condition{matching-criterion=RDR_POS, value=0}
      Front_Left_Side_Radar_Missing_Message (DemEventParameter):
        DemEventKind = DEM_EVENT_KIND_SWC
        DemDTCClassRef = DTCClass_DtcClass_DTC_0xD43987
        DemExtendedDataClassRef = ExtendedDataClass_6d15841f
        DemFreezeFrameClassRef = FreezeFrame_d41460f8
        DemFreezeFrameRecNumClassRef = FreezeFrameRecNum_8514b953
        variation-point = post-build-variant-condition{matching-criterion=RDR_POS, value=0}
        DemDebounceAlgorithmClass
          DemDebounceCounterBased: DemDebounceCounterBasedClassRef=Counter_Based_Debouncing
        DemEventClass:
          DemAgingAllowed = true
          DemAgingCycleCounterThreshold = 40
          DemEventPriority = 2
          DemEventSignificance = DEM_EVENT_SIGNIFICANCE_FAULT
          DemFFPrestorageSupported = false
          DemAgingCycleRef = Power_On_Off
          DemOperationCycleRef = Power_On_Off
      DTCClass_DtcClass_DTC_0xD44083 (DemDTCClass):
        DemDTCSeverity = DEM_DTC_SEV_NO_SEVERITY
        DemUdsDTC = 13910147
        DemDTCAttributesRef = DtcAttributes_41914fb7
        variation-point = post-build-variant-condition{matching-criterion=RDR_POS, value=0}
      Front_Left_Side_Radar_value_of_signal_protection_calculation_Incorrect (DemEventParameter):
        DemEventKind = DEM_EVENT_KIND_SWC
        DemDTCClassRef = DTCClass_DtcClass_DTC_0xD44083
        DemExtendedDataClassRef = ExtendedDataClass_6d15841f
        DemFreezeFrameClassRef = FreezeFrame_d41460f8
        DemFreezeFrameRecNumClassRef = FreezeFrameRecNum_8514b953
        variation-point = post-build-variant-condition{matching-criterion=RDR_POS, value=0}
        DemDebounceAlgorithmClass
          DemDebounceCounterBased: DemDebounceCounterBasedClassRef=Counter_Based_Debouncing
        DemEventClass:
          DemAgingAllowed = true
          DemAgingCycleCounterThreshold = 40
          DemEventPriority = 2
          DemEventSignificance = DEM_EVENT_SIGNIFICANCE_FAULT
          DemFFPrestorageSupported = false
          DemAgingCycleRef = Power_On_Off
          DemOperationCycleRef = Power_On_Off
      DTCClass_DtcClass_DTC_0xD44187 (DemDTCClass):
        DemDTCSeverity = DEM_DTC_SEV_NO_SEVERITY
        DemUdsDTC = 13910407
        DemDTCAttributesRef = DtcAttributes_41914fb7
        variation-point = post-build-variant-condition{matching-criterion=RDR_POS, value=0}
      PCAN_TimeSync_Missing_Message (DemEventParameter):
        DemEventKind = DEM_EVENT_KIND_SWC
        DemDTCClassRef = DemConfigSet/DTCClass_DtcClass_DTC_0xD44187
        DemExtendedDataClassRef = ExtendedDataClass_6d15841f
        DemFreezeFrameClassRef = FreezeFrame_d41460f8
        DemFreezeFrameRecNumClassRef = FreezeFrameRecNum_8514b953
        variation-point = post-build-variant-condition{matching-criterion=RDR_POS, value=0}
        DemDebounceAlgorithmClass
          DemDebounceCounterBased: DemDebounceCounterBasedClassRef=Counter_Based_Debouncing
        DemEventClass:
          DemAgingAllowed = true
          DemAgingCycleCounterThreshold = 40
          DemEventPriority = 2
          DemEventSignificance = DEM_EVENT_SIGNIFICANCE_FAULT
          DemFFPrestorageSupported = false
          DemAgingCycleRef = Power_On_Off
          DemOperationCycleRef = Power_On_Off
      DTCClass_DtcClass_DTC_0xD4438A (DemDTCClass): DemDTCSeverity=DEM_DTC_SEV_NO_SEVERITY, DemUdsDTC=13910922, DemDTCAttributesRef=DtcAttributes_41914fb7
      Exceeded_Security_Access_0x27_Attempt_Threshold_Authentication_Failure (DemEventParameter):
        DemEventKind = DEM_EVENT_KIND_SWC
        DemDTCClassRef = DTCClass_DtcClass_DTC_0xD4438A
        DemExtendedDataClassRef = ExtendedDataClass_6d15841f
        DemFreezeFrameClassRef = FreezeFrame_d41460f8
        DemFreezeFrameRecNumClassRef = FreezeFrameRecNum_8514b953
        DemDebounceAlgorithmClass
          DemDebounceCounterBased: DemDebounceCounterBasedClassRef=Counter_Based_Debouncing
        DemEventClass:
          DemAgingAllowed = true
          DemAgingCycleCounterThreshold = 40
          DemEventPriority = 2
          DemEventSignificance = DEM_EVENT_SIGNIFICANCE_FAULT
          DemFFPrestorageSupported = false
          DemAgingCycleRef = Power_On_Off
          DemOperationCycleRef = Power_On_Off
      Counter_Based_Debouncing (DemDebounceCounterBasedClass):
        DemDebounceCounterDecrementStepSize = 20
        DemDebounceCounterIncrementStepSize = 20
        DemDebounceCounterJumpDown = true
        DemDebounceCounterJumpDownValue = 0
        DemDebounceCounterJumpUp = false
        DemDebounceCounterJumpUpValue = 0
        DemDebounceCounterFailedThreshold = 127
        DemDebounceCounterPassedThreshold = -128
      DTCClass_DtcClass_DTC_0xD44187 (DemDTCClass):
        DemDTCSeverity = DEM_DTC_SEV_NO_SEVERITY
        DemUdsDTC = 13910407
        DemDTCAttributesRef = DtcAttributes_41914fb7
        variation-point = post-build-variant-condition{matching-criterion=RDR_POS, value=3}
      PCAN_TimeSync_Missing_Message (DemEventParameter):
        DemEventKind = DEM_EVENT_KIND_SWC
        DemDTCClassRef = DemConfigSet/DTCClass_DtcClass_DTC_0xD44187
        DemExtendedDataClassRef = ExtendedDataClass_6d15841f
        DemFreezeFrameClassRef = FreezeFrame_d41460f8
        DemFreezeFrameRecNumClassRef = FreezeFrameRecNum_8514b953
        variation-point = post-build-variant-condition{matching-criterion=RDR_POS, value=3}
        DemDebounceAlgorithmClass
          DemDebounceCounterBased: DemDebounceCounterBasedClassRef=Counter_Based_Debouncing
        DemEventClass:
          DemAgingAllowed = true
          DemAgingCycleCounterThreshold = 40
          DemEventPriority = 2
          DemEventSignificance = DEM_EVENT_SIGNIFICANCE_FAULT
          DemFFPrestorageSupported = false
          DemAgingCycleRef = Power_On_Off
          DemOperationCycleRef = Power_On_Off
    DemGeneral:
      DemOBDSupport = DEM_OBD_NO_OBD_SUPPORT
      DemAgingCycleCounterProcessing = DEM_PROCESS_AGINGCTR_INTERN
      DemDebounceCounterBasedSupport = true
      DemPTOSupport = false
      DemDtcStatusAvailabilityMask = 255
      DemEventMemorySet
        PrimaryMemory (DemPrimaryMemory): DemTypeOfFreezeFrameRecordNumeration=DEM_FF_RECNUM_CONFIGURED
      5 x DemDidClass:
        DID_ECUVoltage_Read_0x1111: DemDidIdentifier=4369, DemDidDataClassRef=Data_DID_0x1111_ECUVoltage
        DID_VehicleSpeed_Read_0x1112: DemDidIdentifier=4370, DemDidDataClassRef=Data_DID_0x1112_VehicleSpeed
        DID_DateandTime_Read_0x1116: DemDidIdentifier=4374, DemDidDataClassRef=Data_DID_0x1116_CombinedSignal
        DID_Sensor_Availability_Flag_Read_0x1117: DemDidIdentifier=4375, DemDidDataClassRef=Data_DID_0x1117_Sensor_Availability_Flag_Information
        DID_Ego_Acceleration_Read_0xa004: DemDidIdentifier=40964, DemDidDataClassRef=Data_DID_0xa004_Ego_Acceleration
      ExtendedDataClass_6d15841f (DemExtendedDataClass): DemExtendedDataRecordClassRef=ExtendedDataRecord_OccurrenceCounter, DemExtendedDataRecordClassRef=ExtendedDataRecord_AgingCounter
      ExtendedDataRecord_OccurrenceCounter (DemExtendedDataRecordClass):
        DemExtendedDataRecordNumber = 1
        DemExtendedDataRecordTrigger = DEM_TRIGGER_ON_CONFIRMED
        DemExtendedDataRecordUpdate = DEM_UPDATE_RECORD_YES
        DemDataClassRef = Data_OccurrenceCounter_Occurrence_Counter
      ExtendedDataRecord_AgingCounter (DemExtendedDataRecordClass):
        DemExtendedDataRecordNumber = 2
        DemExtendedDataRecordTrigger = DEM_TRIGGER_ON_CONFIRMED
        DemExtendedDataRecordUpdate = DEM_UPDATE_RECORD_YES
        DemDataClassRef = Data_AgingCounter_Aging_Counter
      FreezeFrame_d41460f8 (DemFreezeFrameClass):
        DemDidClassRef = DID_ECUVoltage_Read_0x1111
        DemDidClassRef = DID_VehicleSpeed_Read_0x1112
        DemDidClassRef = DID_DateandTime_Read_0x1116
        DemDidClassRef = DID_Sensor_Availability_Flag_Read_0x1117
        DemDidClassRef = DID_Ego_Acceleration_Read_0xa004
      Last_Occurrence (DemFreezeFrameRecordClass): DemFreezeFrameRecordNumber=1, DemFreezeFrameRecordTrigger=DEM_TRIGGER_ON_TEST_FAILED, DemFreezeFrameRecordUpdate=DEM_UPDATE_RECORD_YES
      FreezeFrameRecNum_8514b953 (DemFreezeFrameRecNumClass): DemFreezeFrameRecordClassRef=Last_Occurrence
      4 x DemIndicator:
        ABS_Fault
        Brake_system_fault
        ESC_Fault
        HVIL_Open_Circuit
      Power_On_Off (DemOperationCycle): DemOperationCycleAutostart=true, DemOperationCycleType=DEM_OPCYC_POWER
      7 x DemDataClass:
        Data_DID_0xa004_Ego_Acceleration: DemDataElementDataSize=1, DemDataElementDataType=UINT8_N, DemDataElementEndianness=opaque, DemDataElementUsePort=USE_DATA_CLIENT_SERVER_PORT, DemDataElementStoreNonVolatile=true
        Data_DID_0x1117_Sensor_Availability_Flag_Information: DemDataElementDataSize=1, DemDataElementDataType=UINT8_N, DemDataElementEndianness=opaque, DemDataElementUsePort=USE_DATA_CLIENT_SERVER_PORT, DemDataElementStoreNonVolatile=true
        Data_DID_0x1111_ECUVoltage: DemDataElementDataSize=2, DemDataElementDataType=UINT8_N, DemDataElementEndianness=opaque, DemDataElementUsePort=USE_DATA_CLIENT_SERVER_PORT, DemDataElementStoreNonVolatile=true
        Data_DID_0x1112_VehicleSpeed: DemDataElementDataSize=2, DemDataElementDataType=UINT8_N, DemDataElementEndianness=opaque, DemDataElementUsePort=USE_DATA_CLIENT_SERVER_PORT, DemDataElementStoreNonVolatile=true
        Data_DID_0x1116_CombinedSignal: DemDataElementDataSize=7, DemDataElementDataType=UINT8_N, DemDataElementEndianness=opaque, DemDataElementUsePort=USE_DATA_CLIENT_SERVER_PORT, DemDataElementStoreNonVolatile=true
        Data_OccurrenceCounter_Occurrence_Counter: DemDataElementDataSize=1, DemDataElementInternalData=DEM_OCCCTR, DemDataElementUsePort=USE_DATA_INTERNAL
        Data_AgingCounter_Aging_Counter: DemDataElementDataSize=1, DemDataElementInternalData=DEM_AGINGCTR_UPCNT, DemDataElementUsePort=USE_DATA_INTERNAL
