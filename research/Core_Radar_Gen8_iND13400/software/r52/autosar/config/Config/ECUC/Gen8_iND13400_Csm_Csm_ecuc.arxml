AUTOSAR XML (schema 00053)
package /ActiveEcuC
  module config Csm: implementation-config-variant=VARIANT-PRE-COMPILE, module-description=Csm_Impl
    Crypto_SigGen_ECCNIST_256_SHA256 (CsmPrimitives)
      CsmSignatureGenerate
        Crypto_SigGen_ECCNIST_256_SHA256 (CsmSignatureGenerateConfig):
          CsmSignatureGenerateAlgorithmFamiliy = CRYPTO_ALGOFAM_ECCNIST
          CsmSignatureGenerateAlgorithmFamily = CRYPTO_ALGOFAM_ECCNIST
          CsmSignatureGenerateAlgorithmMode = CRYPTO_ALGOMODE_CUSTOM
          CsmSignatureGenerateAlgorithmSecondaryFamily = CRYPTO_ALGOFAM_SHA2_256
          CsmSignatureGenerateKeyLength = 32
          CsmSignatureGenerateProcessing = CSM_SYNCHRONOUS
          CsmSignatureGenerateResultLength = 32
          CsmSignatureGenerateAlgorithmModeCustomRef = CRYPTO_ALGOMODE_CUSTOM_ECCNIST_P256R1
    CsmGeneral:
      CsmSafeBswChecks = true
      CsmAsymPrivateKeyMaxLength = 32
      CsmAsymPublicKeyMaxLength = 1024
      CsmDevErrorDetect = true
      CsmSymKeyMaxLength = 16
      CsmUseDeprecated = false
      CsmVersionInfoApi = false
      CsmCallbackStartNotification = false
      CsmCancelationDuringProcessing = false
      CsmSwcMainInterfaceVersion = CSM_ASR_VERSION_R21_11
      CsmMultiPartitionRuntimeChecks = false
      CsmJobTypeLayout:
        CsmJobTypeLayoutAsr430Compatibility = true
        CsmJobTypeLayoutVarMembers = false
        CsmJobTypeLayoutInput64 = false
        CsmJobTypeLayoutOutput64Ptr = false
        CsmJobTypeLayoutRedirectionInfoRef = false
        CsmJobTypeLayoutJobInfoPtr = true
        CsmJobTypeLayoutSecureCounterId = false
        CsmJobTypeLayoutCallbackUpdateNotification = false
        CsmJobTypeLayoutResultLength = false
        CsmJobTypeLayoutFieldOrdering = CSM_ASR_VERSION_R21_11
      CsmBswApiCompatibility: CsmDefaultJobKeyApiVersion=CSM_ASR_VERSION_4_04
    CsmJobs
      51 x CsmJob, all with CsmJobPriority=0, CsmJobUsePort=false, CsmJobInterfaceUsePort=CRYPTO_USE_FNC:
        Crypto_SigGen_ECCNIST_256_SHA256: CsmJobId=34, CsmProcessingMode=CRYPTO_PROCESSING_SYNC, CsmJobKeyRef=CsmKey_ECC_256_Key_SigGenerate, CsmJobPrimitiveRef=Csm/Crypto_SigGen_ECCNIST_256_SHA256, CsmJobQueueRef=CsmQueue_PublicKey
        Crypto_Hash_SHA2_256: CsmJobId=19, CsmProcessingMode=CRYPTO_PROCESSING_SYNC, CsmJobKeyRef=CsmKey_Crypto_Hash, CsmJobPrimitiveRef=Csm/Crypto_Hash_SHA2_256, CsmJobQueueRef=CsmQueue_Hash
        MKA_Encrypt_ECB: CsmJobId=47, CsmProcessingMode=CRYPTO_PROCESSING_SYNC, CsmJobKeyRef=CsmKey_MKA_KEK, CsmJobPrimitiveRef=Csm/MKA_Encrypt_ECB, CsmJobQueueRef=CsmQueue_MKA
        MKA_Random: CsmJobId=50, CsmProcessingMode=CRYPTO_PROCESSING_SYNC, CsmJobKeyRef=CsmKey_MKA_Random, CsmJobPrimitiveRef=Csm/MKA_Random, CsmJobQueueRef=CsmQueue_MKA
        MKA_Hash_Key_Derivation: CsmJobId=48, CsmProcessingMode=CRYPTO_PROCESSING_SYNC, CsmJobKeyRef=CsmKey_MKA_SAK, CsmJobPrimitiveRef=Csm/MKA_Encrypt_ECB, CsmJobQueueRef=CsmQueue_MKA
        MKA_KeyDerivationPRF: CsmJobId=49, CsmProcessingMode=CRYPTO_PROCESSING_SYNC, CsmJobKeyRef=CsmKey_MKA_MAC, CsmJobPrimitiveRef=Csm/MKA_KeyDerivationPRF, CsmJobQueueRef=CsmQueue_MKA
        MKA_CMACGenerate: CsmJobId=44, CsmProcessingMode=CRYPTO_PROCESSING_SYNC, CsmJobKeyRef=CsmKey_MKA_ICK, CsmJobPrimitiveRef=Csm/MKA_CMACGenerate, CsmJobQueueRef=CsmQueue_MKA
        MKA_CMACVerify: CsmJobId=45, CsmProcessingMode=CRYPTO_PROCESSING_SYNC, CsmJobKeyRef=CsmKey_MKA_ICK, CsmJobPrimitiveRef=Csm/MKA_CMACVerify, CsmJobQueueRef=CsmQueue_MKA
        MKA_Decrypt_ECB: CsmJobId=46, CsmProcessingMode=CRYPTO_PROCESSING_SYNC, CsmJobKeyRef=CsmKey_MKA_KEK, CsmJobQueueRef=CsmQueue_MKA, CsmJobPrimitiveRef=Csm/MKA_Decrypt_ECB
        Crypto_Encrypt_AES_CFB_128: CsmJobId=14, CsmProcessingMode=CRYPTO_PROCESSING_SYNC, CsmJobKeyRef=CsmKey_Crypto_AES_128, CsmJobPrimitiveRef=Csm/Crypto_Encrypt_AES_CFB_128, CsmJobQueueRef=CsmQueue_AES
        Crypto_Decrypt_AES_CFB_128: CsmJobId=7, CsmProcessingMode=CRYPTO_PROCESSING_SYNC, CsmJobKeyRef=CsmKey_Crypto_AES_128, CsmJobPrimitiveRef=Csm/Crypto_Decrypt_AES_CFB_128, CsmJobQueueRef=CsmQueue_AES
        Crypto_Decrypt_AES_CTR_256: CsmJobId=8, CsmProcessingMode=CRYPTO_PROCESSING_SYNC, CsmJobKeyRef=CsmKey_Crypto_AES_256, CsmJobPrimitiveRef=Csm/Crypto_Decrypt_AES_CTR_256, CsmJobQueueRef=CsmQueue_AES
        Crypto_MAC_CMAC_Generate_128: CsmJobId=22, CsmProcessingMode=CRYPTO_PROCESSING_SYNC, CsmJobKeyRef=CsmKey_Crypto_AES_128, CsmJobPrimitiveRef=Csm/Crypto_MAC_CMAC_Generate_128, CsmJobQueueRef=CsmQueue_AES
        Crypto_MAC_CMAC_Verify_128: CsmJobId=25, CsmProcessingMode=CRYPTO_PROCESSING_SYNC, CsmJobKeyRef=CsmKey_Crypto_AES_128, CsmJobPrimitiveRef=Csm/Crypto_MAC_CMAC_Verify_128, CsmJobQueueRef=CsmQueue_AES
        Crypto_AEAD_GCM_Encrypt: CsmJobId=1, CsmProcessingMode=CRYPTO_PROCESSING_SYNC, CsmJobKeyRef=CsmKey_Crypto_AES_128, CsmJobPrimitiveRef=Csm/Crypto_AEAD_GCM_Encrypt, CsmJobQueueRef=CsmQueue_AES
        Crypto_AEAD_GCM_Decrypt: CsmJobId=0, CsmProcessingMode=CRYPTO_PROCESSING_SYNC, CsmJobKeyRef=CsmKey_Crypto_AES_128, CsmJobPrimitiveRef=Csm/Crypto_AEAD_GCM_Decrypt, CsmJobQueueRef=CsmQueue_AES
        Crypto_RNG: CsmJobId=30, CsmProcessingMode=CRYPTO_PROCESSING_SYNC, CsmJobKeyRef=CsmKey_Crypto_RNG, CsmJobPrimitiveRef=Csm/Crypto_RNG, CsmJobQueueRef=CsmQueue_Hash
        Crypto_MAC_HMAC_SHA2_512: CsmJobId=28, CsmProcessingMode=CRYPTO_PROCESSING_SYNC, CsmJobKeyRef=CsmKey_Crypto_Hash, CsmJobPrimitiveRef=Csm/Crypto_MAC_HMAC_SHA2_512, CsmJobQueueRef=CsmQueue_Hash
        Crypto_Encrypt_AES_CBC_256: CsmJobId=12, CsmProcessingMode=CRYPTO_PROCESSING_SYNC, CsmJobKeyRef=CsmKey_Crypto_AES_256, CsmJobPrimitiveRef=Csm/Crypto_Encrypt_AES_CBC_256, CsmJobQueueRef=CsmQueue_AES
        Crypto_Decrypt_AES_CBC_256: CsmJobId=2, CsmProcessingMode=CRYPTO_PROCESSING_SYNC, CsmJobKeyRef=CsmKey_Crypto_AES_256, CsmJobPrimitiveRef=Csm/Crypto_Decrypt_AES_CBC_256, CsmJobQueueRef=CsmQueue_AES
        Crypto_Decrypt_AES_ECB_256: CsmJobId=9, CsmProcessingMode=CRYPTO_PROCESSING_SYNC, CsmJobKeyRef=CsmKey_Crypto_AES_256, CsmJobPrimitiveRef=Csm/Crypto_Decrypt_AES_ECB_256, CsmJobQueueRef=CsmQueue_AES
        Crypto_Encrypt_AES_CTR_256: CsmJobId=15, CsmProcessingMode=CRYPTO_PROCESSING_SYNC, CsmJobKeyRef=CsmKey_Crypto_AES_256, CsmJobPrimitiveRef=Csm/Crypto_Encrypt_AES_CTR_256, CsmJobQueueRef=CsmQueue_AES
        Crypto_Encrypt_AES_ECB_256: CsmJobId=16, CsmProcessingMode=CRYPTO_PROCESSING_SYNC, CsmJobKeyRef=CsmKey_Crypto_AES_256, CsmJobPrimitiveRef=Csm/Crypto_Encrypt_AES_ECB_256, CsmJobQueueRef=CsmQueue_AES
        Crypto_Decrypt_RSA_4096_OAEP_SHA2_256: CsmJobId=11, CsmProcessingMode=CRYPTO_PROCESSING_SYNC, CsmJobKeyRef=CsmKey_Crypto_RSA_4096, CsmJobPrimitiveRef=Csm/Crypto_Decrypt_RSA_4096_OAEP_SHA2_256, CsmJobQueueRef=CsmQueue_PublicKey
        Crypto_Encrypt_RSA_4096_OAEP_SHA2_256: CsmJobId=18, CsmProcessingMode=CRYPTO_PROCESSING_SYNC, CsmJobKeyRef=CsmKey_Crypto_RSA_4096, CsmJobPrimitiveRef=Csm/Crypto_Encrypt_RSA_4096_OAEP_SHA2_256, CsmJobQueueRef=CsmQueue_PublicKey
        Crypto_SigVer_ECCNIST_256: CsmJobId=40, CsmProcessingMode=CRYPTO_PROCESSING_SYNC, CsmJobKeyRef=CsmKey_ECC_256_Key_SigVerify, CsmJobPrimitiveRef=Csm/Crypto_SigVer_ECCNIST_256_SHA256, CsmJobQueueRef=CsmQueue_PublicKey
        Crypto_SigVer_ECCBrainpool_256T1_SHA256: CsmJobId=39, CsmProcessingMode=CRYPTO_PROCESSING_SYNC, CsmJobKeyRef=CsmKey_ECC_256_Key_SigVerify, CsmJobPrimitiveRef=Csm/Crypto_SigVer_ECCBrainpool_256T1_SHA256, CsmJobQueueRef=CsmQueue_PublicKey
        Crypto_RNG_DRBG: CsmJobId=31, CsmProcessingMode=CRYPTO_PROCESSING_SYNC, CsmJobKeyRef=CsmKey_Crypto_RNG, CsmJobPrimitiveRef=Csm/Crypto_RNG_DRBG, CsmJobQueueRef=CsmQueue_Hash
        Crypto_MAC_CMAC_Generate_256: CsmJobId=23, CsmProcessingMode=CRYPTO_PROCESSING_SYNC, CsmJobKeyRef=CsmKey_Crypto_AES_256, CsmJobPrimitiveRef=Csm/Crypto_MAC_CMAC_Generate_256, CsmJobQueueRef=CsmQueue_AES
        Crypto_MAC_CMAC_Verify_256: CsmJobId=26, CsmProcessingMode=CRYPTO_PROCESSING_SYNC, CsmJobKeyRef=CsmKey_Crypto_AES_256, CsmJobPrimitiveRef=Csm/Crypto_MAC_CMAC_Verify_256, CsmJobQueueRef=CsmQueue_AES
        Crypto_SigGen_Ed25519_256: CsmJobId=36, CsmProcessingMode=CRYPTO_PROCESSING_SYNC, CsmJobKeyRef=CsmKey_ED25519_Key_SigGenerate, CsmJobPrimitiveRef=Csm/Crypto_SigGen_Ed25519_256, CsmJobQueueRef=CsmQueue_PublicKey
        Crypto_SigVer_Ed25519_256: CsmJobId=42, CsmProcessingMode=CRYPTO_PROCESSING_SYNC, CsmJobKeyRef=CsmKey_ED25519_Key_SigVerify, CsmJobPrimitiveRef=Csm/Crypto_SigVer_Ed25519_256, CsmJobQueueRef=CsmQueue_PublicKey
        Crypto_SigVer_RSAPSS_1024: CsmJobId=43, CsmProcessingMode=CRYPTO_PROCESSING_SYNC, CsmJobKeyRef=CsmKey_Crypto_RSA_1024, CsmJobPrimitiveRef=Csm/Crypto_SigVer_RSAPSS_1024, CsmJobQueueRef=CsmQueue_PublicKey
        Crypto_SigGen_RSAPSS_1024: CsmJobId=37, CsmProcessingMode=CRYPTO_PROCESSING_SYNC, CsmJobKeyRef=CsmKey_Crypto_RSA_1024, CsmJobPrimitiveRef=Csm/Crypto_SigGen_RSAPSS_1024, CsmJobQueueRef=CsmQueue_PublicKey
        Crypto_SigGen_ECCBrainpool_256R1_SHA256: CsmJobId=32, CsmProcessingMode=CRYPTO_PROCESSING_SYNC, CsmJobKeyRef=CsmKey_ECC_256_Key_SigGenerate, CsmJobPrimitiveRef=Csm/Crypto_SigGen_ECCBrainpool_256R1_SHA256, CsmJobQueueRef=CsmQueue_PublicKey
        Crypto_SigGen_ECCBrainpool_256T1_SHA256: CsmJobId=33, CsmProcessingMode=CRYPTO_PROCESSING_SYNC, CsmJobKeyRef=CsmKey_ECC_256_Key_SigGenerate, CsmJobPrimitiveRef=Csm/Crypto_SigGen_ECCBrainpool_256T1_SHA256, CsmJobQueueRef=CsmQueue_PublicKey
        Crypto_SigGen_ED448: CsmJobId=35, CsmProcessingMode=CRYPTO_PROCESSING_SYNC, CsmJobKeyRef=CsmKey_ED448_Key_SigGenerate, CsmJobPrimitiveRef=Csm/Crypto_SigGen_ED448, CsmJobQueueRef=CsmQueue_PublicKey
        Crypto_SigVer_ED448: CsmJobId=41, CsmProcessingMode=CRYPTO_PROCESSING_SYNC, CsmJobKeyRef=CsmKey_ED448_Key_SigVerify, CsmJobPrimitiveRef=Csm/Crypto_SigVer_ED448, CsmJobQueueRef=CsmQueue_PublicKey
        Crypto_MAC_HMAC_Verify_SHA2_512: CsmJobId=29, CsmProcessingMode=CRYPTO_PROCESSING_SYNC, CsmJobKeyRef=CsmKey_Crypto_Hash, CsmJobPrimitiveRef=Csm/Crypto_MAC_HMAC_Verify_SHA2_512, CsmJobQueueRef=CsmQueue_Hash
        Crypto_SigVer_ECCBrainpool_256R1_SHA256: CsmJobId=38, CsmProcessingMode=CRYPTO_PROCESSING_SYNC, CsmJobKeyRef=CsmKey_ECC_256_Key_SigVerify, CsmJobPrimitiveRef=Csm/Crypto_SigVer_ECCBrainpool_256R1_SHA256, CsmJobQueueRef=CsmQueue_PublicKey
        Crypto_Decrypt_AES_CBC_256_ASYNC_1: CsmJobId=3, CsmProcessingMode=CRYPTO_PROCESSING_ASYNC, CsmJobKeyRef=CsmKey_Crypto_AES_256, CsmJobPrimitiveRef=Csm/Crypto_Decrypt_AES_CBC_256_ASYNC, CsmJobQueueRef=CsmQueue_AES_Async, CsmJobPrimitiveCallbackRef=CsmCallback
        Crypto_Decrypt_AES_CBC_256_ASYNC_2: CsmJobId=4, CsmProcessingMode=CRYPTO_PROCESSING_ASYNC, CsmJobKeyRef=CsmKey_Crypto_AES_256, CsmJobPrimitiveRef=Csm/Crypto_Decrypt_AES_CBC_256_ASYNC, CsmJobQueueRef=CsmQueue_AES_Async, CsmJobPrimitiveCallbackRef=CsmCallback
        Crypto_Decrypt_AES_CBC_256_ASYNC_3: CsmJobId=5, CsmProcessingMode=CRYPTO_PROCESSING_ASYNC, CsmJobKeyRef=CsmKey_Crypto_AES_256, CsmJobPrimitiveRef=Csm/Crypto_Decrypt_AES_CBC_256_ASYNC, CsmJobQueueRef=CsmQueue_AES_Async, CsmJobPrimitiveCallbackRef=CsmCallback
        Crypto_Hash_SHA2_256_ASYNC_1: CsmJobId=20, CsmProcessingMode=CRYPTO_PROCESSING_ASYNC, CsmJobKeyRef=CsmKey_Crypto_Hash, CsmJobPrimitiveRef=Csm/Crypto_Hash_SHA2_256_ASYNC, CsmJobQueueRef=CsmQueue_Hash_Async, CsmJobPrimitiveCallbackRef=CsmCallback
        Crypto_Hash_SHA2_256_ASYNC_2: CsmJobId=21, CsmProcessingMode=CRYPTO_PROCESSING_ASYNC, CsmJobKeyRef=CsmKey_Crypto_Hash, CsmJobPrimitiveRef=Csm/Crypto_Hash_SHA2_256_ASYNC, CsmJobQueueRef=CsmQueue_Hash_Async, CsmJobPrimitiveCallbackRef=CsmCallback
        Crypto_MAC_CMAC_Generate_SHE: CsmJobId=24, CsmProcessingMode=CRYPTO_PROCESSING_SYNC, CsmJobKeyRef=CsmKey_SHE_KEY_7, CsmJobPrimitiveRef=Csm/Crypto_MAC_CMAC_Generate_SHE, CsmJobQueueRef=CsmQueue_AES
        Crypto_MAC_CMAC_Verify_SHE: CsmJobId=27, CsmProcessingMode=CRYPTO_PROCESSING_SYNC, CsmJobKeyRef=CsmKey_SHE_KEY_7, CsmJobPrimitiveRef=Csm/Crypto_MAC_CMAC_Verify_SHE, CsmJobQueueRef=CsmQueue_AES
        Crypto_Decrypt_AES_CBC_SHE: CsmJobId=6, CsmProcessingMode=CRYPTO_PROCESSING_SYNC, CsmJobKeyRef=CsmKey_SHE_KEY_1, CsmJobPrimitiveRef=Csm/Crypto_Decrypt_AES_CBC_SHE, CsmJobQueueRef=CsmQueue_AES
        Crypto_Decrypt_AES_ECB_SHE: CsmJobId=10, CsmProcessingMode=CRYPTO_PROCESSING_SYNC, CsmJobKeyRef=CsmKey_SHE_KEY_1, CsmJobPrimitiveRef=Csm/Crypto_Decrypt_AES_ECB_SHE, CsmJobQueueRef=CsmQueue_AES
        Crypto_Encrypt_AES_CBC_SHE: CsmJobId=13, CsmProcessingMode=CRYPTO_PROCESSING_SYNC, CsmJobKeyRef=CsmKey_SHE_KEY_1, CsmJobPrimitiveRef=Csm/Crypto_Encrypt_AES_CBC_SHE, CsmJobQueueRef=CsmQueue_AES
        Crypto_Encrypt_AES_ECB_SHE: CsmJobId=17, CsmProcessingMode=CRYPTO_PROCESSING_SYNC, CsmJobKeyRef=CsmKey_SHE_KEY_1, CsmJobPrimitiveRef=Csm/Crypto_Encrypt_AES_ECB_SHE, CsmJobQueueRef=CsmQueue_AES
    CsmKeys
      62 x CsmKey, all with CsmKeyUsePort=false:
        CsmKey_Crypto_Hash: CsmKeyId=4, CsmKeyRef=CryIfKey_Crypto_Hash
        CsmKey_Crypto_AES_128: CsmKeyId=2, CsmKeyRef=CryIfKey_Crypto_AES_128
        CsmKey_MKA_CAK: CsmKeyId=42, CsmKeyRef=CryIfKey_MKA_CAK
        CsmKey_MKA_Random: CsmKeyId=46, CsmKeyRef=CryIfKey_MKA_Random
        CsmKey_MKA_ICK: CsmKeyId=43, CsmKeyRef=CryIfKey_MKA_ICK
        CsmKey_Crypto_RNG: CsmKeyId=5, CsmKeyRef=CryIfKey_Crypto_RNG
        CsmKey_MKA_KEK: CsmKeyId=44, CsmKeyRef=CryIfKey_MKA_KEK
        CsmKey_MKA_SAK: CsmKeyId=47, CsmKeyRef=CryIfKey_MKA_SAK
        CsmKey_MKA_MAC: CsmKeyId=45, CsmKeyRef=CryIfKey_MKA_MAC
        CsmKey_MKA_SAK_Data: CsmKeyId=48, CsmKeyRef=CryIfKey_MKA_SAK_Data
        CsmKey_Crypto_AES_256: CsmKeyId=3, CsmKeyRef=CryIfKey_Crypto_AES_256
        CsmKey_Crypto_RSA_1024: CsmKeyId=6, CsmKeyRef=CryIfKey_Crypto_RSA_1024_Key
        CsmKey_Crypto_RSA_2048: CsmKeyId=7, CsmKeyRef=CryIfKey_Crypto_RSA_2048_Key
        CsmKey_Crypto_RSA_3072: CsmKeyId=8, CsmKeyRef=CryIfKey_Crypto_RSA_3072_Key
        CsmKey_Crypto_RSA_4096: CsmKeyId=9, CsmKeyRef=CryIfKey_Crypto_RSA_4096_Key
        CsmKey_ECC_192_Key_SigGenerate: CsmKeyId=11, CsmKeyRef=CryIfKey_ECC_192_Key_SigGenerate
        CsmKey_ECC_224_Key_SigGenerate: CsmKeyId=13, CsmKeyRef=CryIfKey_ECC_224_Key_SigGenerate
        CsmKey_ECC_256_Key_SigGenerate: CsmKeyId=18, CsmKeyRef=CryIfKey_ECC_256_Key_SigGenerate
        CsmKey_ECC_384_Key_SigGenerate: CsmKeyId=22, CsmKeyRef=CryIfKey_ECC_384_Key_SigGenerate
        CsmKey_ECC_512_Key_SigGenerate: CsmKeyId=24, CsmKeyRef=CryIfKey_ECC_512_Key_SigGenerate
        CsmKey_ECC_521_Key_SigGenerate: CsmKeyId=26, CsmKeyRef=CryIfKey_ECC_521_Key_SigGenerate
        CsmKey_ECC_320_Key_SigGenerate: CsmKeyId=20, CsmKeyRef=CryIfKey_ECC_320_Key_SigGenerate
        CsmKey_Custom_Operations: CsmKeyId=10, CsmKeyRef=CryIfKey_Custom_Operations
        CsmKey_ECDH_128_Key_SigGenerate: CsmKeyId=28, CsmKeyRef=CryIfKey_ECDH_128_Key_SigGenerate
        CsmKey_ECDH_224_Key_SigGenerate: CsmKeyId=30, CsmKeyRef=CryIfKey_ECDH_224_Key_SigGenerate
        CsmKey_ECDH_256_Key_SigGenerate: CsmKeyId=32, CsmKeyRef=CryIfKey_ECDH_256_Key_SigGenerate
        CsmKey_ECDH_384_Key_SigGenerate: CsmKeyId=34, CsmKeyRef=CryIfKey_ECDH_384_Key_SigGenerate
        CsmKey_ECDH_512_Key_SigGenerate: CsmKeyId=36, CsmKeyRef=CryIfKey_ECDH_512_Key_SigGenerate
        CsmKey_Monotonic_Counter: CsmKeyId=50, CsmKeyRef=CryIfKey_Monotonic_Counter
        CsmKey_ED448_Key_SigGenerate: CsmKeyId=38, CsmKeyRef=CryIfKey_ED448_Key_SigGenerate
        CsmKey_ECC_256_Key_Generate: CsmKeyId=16, CsmKeyRef=CryIfKey_ECC_256_Key_Generate
        CsmKey_SHE_KEY_1: CsmKeyId=51, CsmKeyRef=CryIfKey_SHE_KEY_1
        CsmKey_SHE_KEY_2: CsmKeyId=52, CsmKeyRef=CryIfKey_SHE_KEY_2
        CsmKey_SHE_KEY_3: CsmKeyId=53, CsmKeyRef=CryIfKey_SHE_KEY_3
        CsmKey_SHE_KEY_4: CsmKeyId=54, CsmKeyRef=CryIfKey_SHE_KEY_4
        CsmKey_SHE_KEY_5: CsmKeyId=55, CsmKeyRef=CryIfKey_SHE_KEY_5
        CsmKey_SHE_KEY_6: CsmKeyId=56, CsmKeyRef=CryIfKey_SHE_KEY_6
        CsmKey_SHE_KEY_7: CsmKeyId=57, CsmKeyRef=CryIfKey_SHE_KEY_7
        CsmKey_SHE_KEY_8: CsmKeyId=58, CsmKeyRef=CryIfKey_SHE_KEY_8
        CsmKey_SHE_KEY_9: CsmKeyId=59, CsmKeyRef=CryIfKey_SHE_KEY_9
        CsmKey_SHE_KEY_10: CsmKeyId=60, CsmKeyRef=CryIfKey_SHE_KEY_10
        CsmKey_SHE_RAM_KEY: CsmKeyId=61, CsmKeyRef=CryIfKey_SHE_RAM_KEY
        CsmKey_Boot_MAC: CsmKeyId=0, CsmKeyRef=CryIfKey_Boot_MAC
        CsmKey_Boot_MAC_Key: CsmKeyId=1, CsmKeyRef=CryIfKey_Boot_MAC_Key
        CsmKey_Master_ECU_Key: CsmKeyId=49, CsmKeyRef=CryIfKey_Master_ECU_Key
        CsmKey_ED25519_Key_SigGenerate: CsmKeyId=40, CsmKeyRef=CryIfKey_ED25519_Key_SigGenerate
        CsmKey_ECC_192_Key_SigVerify: CsmKeyId=12, CsmKeyRef=CryIfKey_ECC_192_Key_SigVerify
        CsmKey_ECC_224_Key_SigVerify: CsmKeyId=15, CsmKeyRef=CryIfKey_ECC_224_Key_SigVerify
        CsmKey_ECC_256_Key_SigVerify: CsmKeyId=19, CsmKeyRef=CryIfKey_ECC_256_Key_SigVerify
        CsmKey_ECC_320_Key_SigVerify: CsmKeyId=21, CsmKeyRef=CryIfKey_ECC_320_Key_SigVerify
        CsmKey_ECC_384_Key_SigVerify: CsmKeyId=23, CsmKeyRef=CryIfKey_ECC_384_Key_SigVerify
        CsmKey_ECC_512_Key_SigVerify: CsmKeyId=25, CsmKeyRef=CryIfKey_ECC_512_Key_SigVerify
        CsmKey_ECC_521_Key_SigVerify: CsmKeyId=27, CsmKeyRef=CryIfKey_ECC_521_Key_SigVerify
        CsmKey_ECDH_128_Key_SigVerify: CsmKeyId=29, CsmKeyRef=CryIfKey_ECDH_128_Key_SigVerify
        CsmKey_ECDH_224_Key_SigVerify: CsmKeyId=31, CsmKeyRef=CryIfKey_ECDH_224_Key_SigVerify
        CsmKey_ECDH_256_Key_SigVerify: CsmKeyId=33, CsmKeyRef=CryIfKey_ECDH_256_Key_SigVerify
        CsmKey_ECDH_384_Key_SigVerify: CsmKeyId=35, CsmKeyRef=CryIfKey_ECDH_384_Key_SigVerify
        CsmKey_ECDH_512_Key_SigVerify: CsmKeyId=37, CsmKeyRef=CryIfKey_ECDH_512_Key_SigVerify
        CsmKey_ED448_Key_SigVerify: CsmKeyId=39, CsmKeyRef=CryIfKey_ED448_Key_SigVerify
        CsmKey_ED25519_Key_SigVerify: CsmKeyId=41, CsmKeyRef=CryIfKey_ED25519_Key_SigVerify
        CsmKey_ECC_256_Key_Generate_2: CsmKeyId=17, CsmKeyRef=CryIfKey_ECC_256_Key_Generate_2
        CsmKey_ECC_224_Key_Exchange: CsmKeyId=14, CsmKeyRef=CryIfKey_ECC_224_Key_Exchange
    CsmMainFunction: CsmMainFunctionPeriod=0.01, CsmMainFunctionPartitionRef=EcucPartition_SystemApplication_OsCore0
    MKA_Encrypt_ECB (CsmPrimitives)
      CsmEncrypt
        MKA_Encrypt_ECB (CsmEncryptConfig):
          CsmEncryptAlgorithmFamiliy = CRYPTO_ALGOFAM_AES
          CsmEncryptAlgorithmFamily = CRYPTO_ALGOFAM_AES
          CsmEncryptAlgorithmMode = CRYPTO_ALGOMODE_ECB
          CsmEncryptAlgorithmSecondaryFamily = CRYPTO_ALGOFAM_NOT_SET
          CsmEncryptProcessing = CSM_SYNCHRONOUS
          CsmEncryptAlgorithmKeyLength = 16
    Crypto_Hash_SHA2_256 (CsmPrimitives)
      CsmHash
        Crypto_Hash_SHA2_256 (CsmHashConfig):
          CsmHashAlgorithmFamiliy = CRYPTO_ALGOFAM_SHA2_256
          CsmHashAlgorithmFamily = CRYPTO_ALGOFAM_SHA2_256
          CsmHashAlgorithmMode = CRYPTO_ALGOMODE_NOT_SET
          CsmHashAlgorithmSecondaryFamily = CRYPTO_ALGOFAM_NOT_SET
          CsmHashProcessing = CSM_SYNCHRONOUS
          CsmHashResultLength = 32
    CsmQueues
      7 x CsmQueue, all with CsmTriggerAsynchJobsInCallback=false, CsmJobSharing=true, CsmOperationModeLimitation=false, CsmQueueMainFunctionRef=CsmMainFunction:
        CsmQueue_Hash: CsmQueueSize=1, CsmQueueProcessingMode=CRYPTO_PROCESSING_SYNC, CsmChannelRef=CryIfChannel_Crypto_HashDriverObject
        CsmQueue_AES: CsmQueueSize=1, CsmQueueProcessingMode=CRYPTO_PROCESSING_SYNC, CsmChannelRef=CryIfChannel_Crypto_AESDriverObject
        CsmQueue_MKA: CsmQueueSize=1, CsmQueueProcessingMode=CRYPTO_PROCESSING_SYNC, CsmChannelRef=CryIfChannel_MKA
        CsmQueue_PublicKey: CsmQueueSize=1, CsmQueueProcessingMode=CRYPTO_PROCESSING_SYNC, CsmChannelRef=CryIfChannel_Crypto_PublicKeyObject
        CsmQueue_Hash_Async: CsmQueueSize=2, CsmQueueProcessingMode=CRYPTO_PROCESSING_ASYNC, CsmChannelRef=CryIfChannel_Crypto_HashDriverObject
        CsmQueue_PublicKey_Async: CsmQueueSize=1, CsmQueueProcessingMode=CRYPTO_PROCESSING_SYNC, CsmChannelRef=CryIfChannel_Crypto_PublicKeyObject
        CsmQueue_AES_Async: CsmQueueSize=3, CsmQueueProcessingMode=CRYPTO_PROCESSING_ASYNC, CsmChannelRef=CryIfChannel_Crypto_AESDriverObject
    27 x CsmPrimitives:
      MKA_Random
        CsmRandomGenerate
          MKA_Random (CsmRandomGenerateConfig):
            CsmRandomGenerateAlgorithmFamiliy = CRYPTO_ALGOFAM_RNG
            CsmRandomGenerateAlgorithmFamily = CRYPTO_ALGOFAM_RNG
            CsmRandomGenerateAlgorithmMode = CRYPTO_ALGOMODE_NOT_SET
            CsmRandomGenerateAlgorithmSecondaryFamily = CRYPTO_ALGOFAM_NOT_SET
            CsmRandomGenerateProcessing = CSM_SYNCHRONOUS
            CsmRandomGenerateResultLength = 32
      MKA_KeyDerivationPRF
        CsmMacGenerate
          MKA_KeyDerivationPRF (CsmMacGenerateConfig):
            CsmMacGenerateAlgorithmFamiliy = CRYPTO_ALGOFAM_AES
            CsmMacGenerateAlgorithmFamily = CRYPTO_ALGOFAM_AES
            CsmMacGenerateAlgorithmKeyLength = 16
            CsmMacGenerateAlgorithmMode = CRYPTO_ALGOMODE_CMAC
            CsmMacGenerateAlgorithmSecondaryFamily = CRYPTO_ALGOFAM_NOT_SET
            CsmMacGenerateProcessing = CSM_SYNCHRONOUS
            CsmMacGenerateResultLength = 16
      MKA_CMACGenerate
        CsmMacGenerate
          MKA_CMACGenerate (CsmMacGenerateConfig):
            CsmMacGenerateAlgorithmFamiliy = CRYPTO_ALGOFAM_AES
            CsmMacGenerateAlgorithmFamily = CRYPTO_ALGOFAM_AES
            CsmMacGenerateAlgorithmKeyLength = 16
            CsmMacGenerateAlgorithmMode = CRYPTO_ALGOMODE_CMAC
            CsmMacGenerateAlgorithmSecondaryFamily = CRYPTO_ALGOFAM_NOT_SET
            CsmMacGenerateProcessing = CSM_SYNCHRONOUS
            CsmMacGenerateResultLength = 32
      MKA_CMACVerify
        CsmMacVerify
          MKA_CMACVerify (CsmMacVerifyConfig):
            CsmMacVerifyAlgorithmFamiliy = CRYPTO_ALGOFAM_AES
            CsmMacVerifyAlgorithmFamily = CRYPTO_ALGOFAM_AES
            CsmMacVerifyAlgorithmSecondaryFamily = CRYPTO_ALGOFAM_NOT_SET
            CsmMacVerifyCompareLength = 32
            CsmMacVerifyProcessing = CSM_SYNCHRONOUS
            CsmMacVerifyAlgorithmMode = CRYPTO_ALGOMODE_CMAC
            CsmMacVerifyAlgorithmKeyLength = 16
      MKA_Decrypt_ECB
        CsmDecrypt
          MKA_Decrypt_ECB (CsmDecryptConfig):
            CsmDecryptAlgorithmFamiliy = CRYPTO_ALGOFAM_AES
            CsmDecryptAlgorithmFamily = CRYPTO_ALGOFAM_AES
            CsmDecryptAlgorithmKeyLength = 16
            CsmDecryptAlgorithmMode = CRYPTO_ALGOMODE_ECB
            CsmDecryptAlgorithmSecondaryFamily = CRYPTO_ALGOFAM_NOT_SET
            CsmDecryptProcessing = CSM_SYNCHRONOUS
      Crypto_Encrypt_AES_CFB_128
        CsmEncrypt
          Crypto_Encrypt_AES_CFB_128 (CsmEncryptConfig):
            CsmEncryptAlgorithmFamiliy = CRYPTO_ALGOFAM_AES
            CsmEncryptAlgorithmFamily = CRYPTO_ALGOFAM_AES
            CsmEncryptAlgorithmMode = CRYPTO_ALGOMODE_CFB
            CsmEncryptAlgorithmSecondaryFamily = CRYPTO_ALGOFAM_NOT_SET
            CsmEncryptProcessing = CSM_SYNCHRONOUS
            CsmEncryptAlgorithmKeyLength = 16
      Crypto_Decrypt_AES_CFB_128
        CsmDecrypt
          Crypto_Decrypt_AES_CFB_128 (CsmDecryptConfig):
            CsmDecryptAlgorithmFamiliy = CRYPTO_ALGOFAM_AES
            CsmDecryptAlgorithmFamily = CRYPTO_ALGOFAM_AES
            CsmDecryptAlgorithmKeyLength = 16
            CsmDecryptAlgorithmMode = CRYPTO_ALGOMODE_CFB
            CsmDecryptAlgorithmSecondaryFamily = CRYPTO_ALGOFAM_NOT_SET
            CsmDecryptProcessing = CSM_SYNCHRONOUS
      Crypto_MAC_CMAC_Generate_128
        CsmMacGenerate
          Crypto_MAC_CMAC_Generate_128 (CsmMacGenerateConfig):
            CsmMacGenerateAlgorithmFamiliy = CRYPTO_ALGOFAM_AES
            CsmMacGenerateAlgorithmFamily = CRYPTO_ALGOFAM_AES
            CsmMacGenerateAlgorithmKeyLength = 16
            CsmMacGenerateAlgorithmMode = CRYPTO_ALGOMODE_CMAC
            CsmMacGenerateAlgorithmSecondaryFamily = CRYPTO_ALGOFAM_NOT_SET
            CsmMacGenerateProcessing = CSM_SYNCHRONOUS
            CsmMacGenerateResultLength = 16
      Crypto_MAC_CMAC_Verify_128
        CsmMacVerify
          Crypto_MAC_CMAC_Verify_128 (CsmMacVerifyConfig):
            CsmMacVerifyAlgorithmFamiliy = CRYPTO_ALGOFAM_AES
            CsmMacVerifyAlgorithmFamily = CRYPTO_ALGOFAM_AES
            CsmMacVerifyAlgorithmSecondaryFamily = CRYPTO_ALGOFAM_NOT_SET
            CsmMacVerifyCompareLength = 128
            CsmMacVerifyProcessing = CSM_SYNCHRONOUS
            CsmMacVerifyAlgorithmMode = CRYPTO_ALGOMODE_CMAC
            CsmMacVerifyAlgorithmKeyLength = 16
      Crypto_AEAD_GCM_Encrypt
        CsmAEADEncrypt
          Crypto_AEAD_GCM_Encrypt (CsmAEADEncryptConfig):
            CsmAEADEncryptAlgorithmFamiliy = CRYPTO_ALGOFAM_AES
            CsmAEADEncryptAlgorithmFamily = CRYPTO_ALGOFAM_AES
            CsmAEADEncryptAlgorithmKeyLength = 16
            CsmAEADEncryptAlgorithmMode = CRYPTO_ALGOMODE_GCM
            CsmAEADEncryptProcessing = CSM_SYNCHRONOUS
            CsmAEADEncryptTagLength = 16
            CsmAEADEncryptAlgorithmSecondaryFamily = CRYPTO_ALGOFAM_NOT_SET
            CsmAEADEncryptKeyRef = CsmKey_Crypto_AES_128
      Crypto_AEAD_GCM_Decrypt
        CsmAEADDecrypt
          Crypto_AEAD_GCM_Decrypt (CsmAEADDecryptConfig):
            CsmAEADDecryptAlgorithmFamiliy = CRYPTO_ALGOFAM_AES
            CsmAEADDecryptAlgorithmFamily = CRYPTO_ALGOFAM_AES
            CsmAEADDecryptAlgorithmKeyLength = 16
            CsmAEADDecryptAlgorithmMode = CRYPTO_ALGOMODE_GCM
            CsmAEADDecryptProcessing = CSM_SYNCHRONOUS
            CsmAEADDecryptTagLength = 16
            CsmAEADDecryptAlgorithmSecondaryFamily = CRYPTO_ALGOFAM_NOT_SET
            CsmAEADDecryptKeyRef = CsmKey_Crypto_AES_128
      Crypto_RNG
        CsmRandomGenerate
          Crypto_RNG (CsmRandomGenerateConfig):
            CsmRandomGenerateAlgorithmFamiliy = CRYPTO_ALGOFAM_RNG
            CsmRandomGenerateAlgorithmFamily = CRYPTO_ALGOFAM_RNG
            CsmRandomGenerateAlgorithmMode = CRYPTO_ALGOMODE_NOT_SET
            CsmRandomGenerateAlgorithmSecondaryFamily = CRYPTO_ALGOFAM_NOT_SET
            CsmRandomGenerateProcessing = CSM_SYNCHRONOUS
            CsmRandomGenerateResultLength = 32
      Crypto_MAC_HMAC_SHA2_512
        CsmMacGenerate
          Crypto_MAC_HMAC_SHA2_512 (CsmMacGenerateConfig):
            CsmMacGenerateAlgorithmFamiliy = CRYPTO_ALGOFAM_SHA2_512
            CsmMacGenerateAlgorithmFamily = CRYPTO_ALGOFAM_SHA2_512
            CsmMacGenerateAlgorithmKeyLength = 64
            CsmMacGenerateAlgorithmMode = CRYPTO_ALGOMODE_HMAC
            CsmMacGenerateAlgorithmSecondaryFamily = CRYPTO_ALGOFAM_NOT_SET
            CsmMacGenerateProcessing = CSM_SYNCHRONOUS
            CsmMacGenerateResultLength = 64
      Crypto_Decrypt_AES_CBC_256
        CsmDecrypt
          Crypto_Decrypt_AES_CBC_256 (CsmDecryptConfig):
            CsmDecryptAlgorithmFamiliy = CRYPTO_ALGOFAM_AES
            CsmDecryptAlgorithmFamily = CRYPTO_ALGOFAM_AES
            CsmDecryptAlgorithmKeyLength = 32
            CsmDecryptAlgorithmMode = CRYPTO_ALGOMODE_CBC
            CsmDecryptAlgorithmSecondaryFamily = CRYPTO_ALGOFAM_CUSTOM
            CsmDecryptProcessing = CSM_SYNCHRONOUS
            CsmDecryptAlgorithmSecondaryFamilyCustom = CRYPTO_ALGOFAM_PADDING_PKCS7
      Crypto_Decrypt_AES_CTR_256
        CsmDecrypt
          Crypto_Decrypt_AES_CTR_256 (CsmDecryptConfig):
            CsmDecryptAlgorithmFamiliy = CRYPTO_ALGOFAM_AES
            CsmDecryptAlgorithmFamily = CRYPTO_ALGOFAM_AES
            CsmDecryptAlgorithmKeyLength = 32
            CsmDecryptAlgorithmMode = CRYPTO_ALGOMODE_CTR
            CsmDecryptAlgorithmSecondaryFamily = CRYPTO_ALGOFAM_NOT_SET
            CsmDecryptProcessing = CSM_SYNCHRONOUS
      Crypto_Decrypt_AES_ECB_256
        CsmDecrypt
          Crypto_Decrypt_AES_ECB_256 (CsmDecryptConfig):
            CsmDecryptAlgorithmFamiliy = CRYPTO_ALGOFAM_AES
            CsmDecryptAlgorithmFamily = CRYPTO_ALGOFAM_AES
            CsmDecryptAlgorithmKeyLength = 32
            CsmDecryptAlgorithmMode = CRYPTO_ALGOMODE_ECB
            CsmDecryptAlgorithmSecondaryFamily = CRYPTO_ALGOFAM_CUSTOM
            CsmDecryptProcessing = CSM_SYNCHRONOUS
            CsmDecryptAlgorithmSecondaryFamilyCustom = CRYPTO_ALGOFAM_PADDING_PKCS7
      Crypto_Encrypt_AES_CBC_256
        CsmEncrypt
          Crypto_Encrypt_AES_CBC_256 (CsmEncryptConfig):
            CsmEncryptAlgorithmFamiliy = CRYPTO_ALGOFAM_AES
            CsmEncryptAlgorithmFamily = CRYPTO_ALGOFAM_AES
            CsmEncryptAlgorithmMode = CRYPTO_ALGOMODE_CBC
            CsmEncryptAlgorithmSecondaryFamily = CRYPTO_ALGOFAM_CUSTOM
            CsmEncryptProcessing = CSM_SYNCHRONOUS
            CsmEncryptAlgorithmKeyLength = 32
            CsmEncryptAlgorithmSecondaryFamilyCustom = CRYPTO_ALGOFAM_PADDING_PKCS7
      Crypto_Encrypt_AES_CTR_256
        CsmEncrypt
          Crypto_Encrypt_AES_CTR_256 (CsmEncryptConfig):
            CsmEncryptAlgorithmFamiliy = CRYPTO_ALGOFAM_AES
            CsmEncryptAlgorithmFamily = CRYPTO_ALGOFAM_AES
            CsmEncryptAlgorithmMode = CRYPTO_ALGOMODE_CTR
            CsmEncryptAlgorithmSecondaryFamily = CRYPTO_ALGOFAM_NOT_SET
            CsmEncryptProcessing = CSM_SYNCHRONOUS
            CsmEncryptAlgorithmKeyLength = 32
      Crypto_Encrypt_AES_ECB_256
        CsmEncrypt
          Crypto_Encrypt_AES_ECB_256 (CsmEncryptConfig):
            CsmEncryptAlgorithmFamiliy = CRYPTO_ALGOFAM_AES
            CsmEncryptAlgorithmFamily = CRYPTO_ALGOFAM_AES
            CsmEncryptAlgorithmMode = CRYPTO_ALGOMODE_ECB
            CsmEncryptAlgorithmSecondaryFamily = CRYPTO_ALGOFAM_CUSTOM
            CsmEncryptProcessing = CSM_SYNCHRONOUS
            CsmEncryptAlgorithmKeyLength = 32
            CsmEncryptAlgorithmSecondaryFamilyCustom = CRYPTO_ALGOFAM_PADDING_PKCS7
      Crypto_Encrypt_RSA_4096_OAEP_SHA2_256
        CsmEncrypt
          Crypto_Encrypt_RSA_4096_OAEP_SHA2_256 (CsmEncryptConfig):
            CsmEncryptAlgorithmFamiliy = CRYPTO_ALGOFAM_RSA
            CsmEncryptAlgorithmFamily = CRYPTO_ALGOFAM_RSA
            CsmEncryptAlgorithmMode = CRYPTO_ALGOMODE_RSAES_OAEP
            CsmEncryptAlgorithmSecondaryFamily = CRYPTO_ALGOFAM_SHA2_256
            CsmEncryptProcessing = CSM_SYNCHRONOUS
            CsmEncryptAlgorithmKeyLength = 512
      Crypto_SigVer_ECCNIST_256_SHA256
        CsmSignatureVerify
          Crypto_SigVer_ECCNIST_256_SHA256 (CsmSignatureVerifyConfig):
            CsmSignatureVerifyAlgorithmFamiliy = CRYPTO_ALGOFAM_ECCNIST
            CsmSignatureVerifyAlgorithmFamily = CRYPTO_ALGOFAM_ECCNIST
            CsmSignatureVerifyAlgorithmMode = CRYPTO_ALGOMODE_CUSTOM
            CsmSignatureVerifyAlgorithmSecondaryFamily = CRYPTO_ALGOFAM_SHA2_256
            CsmSignatureVerifyCompareLength = 32
            CsmSignatureVerifyProcessing = CSM_SYNCHRONOUS
            CsmSignatureVerifyKeyLength = 32
            CsmSignatureVerifyAlgorithmModeCustomRef = CRYPTO_ALGOMODE_CUSTOM_ECCNIST_P256R1
      Crypto_SigVer_ECCBrainpool_256R1_SHA256
        CsmSignatureVerify
          Crypto_SigVer_ECCBrainpool_256R1_SHA256 (CsmSignatureVerifyConfig):
            CsmSignatureVerifyAlgorithmFamiliy = CRYPTO_ALGOFAM_BRAINPOOL
            CsmSignatureVerifyAlgorithmFamily = CRYPTO_ALGOFAM_BRAINPOOL
            CsmSignatureVerifyAlgorithmMode = CRYPTO_ALGOMODE_CUSTOM
            CsmSignatureVerifyAlgorithmSecondaryFamily = CRYPTO_ALGOFAM_SHA2_256
            CsmSignatureVerifyCompareLength = 32
            CsmSignatureVerifyProcessing = CSM_SYNCHRONOUS
            CsmSignatureVerifyKeyLength = 32
            CsmSignatureVerifyAlgorithmModeCustomRef = CRYPTO_ALGOMODE_CUSTOM_ECCBRAINPOOL_P256R1
      Crypto_RNG_DRBG
        CsmRandomGenerate
          Crypto_RNG_DRBG (CsmRandomGenerateConfig):
            CsmRandomGenerateAlgorithmFamiliy = CRYPTO_ALGOFAM_RNG
            CsmRandomGenerateAlgorithmFamily = CRYPTO_ALGOFAM_RNG
            CsmRandomGenerateAlgorithmMode = CRYPTO_ALGOMODE_CTRDRBG
            CsmRandomGenerateAlgorithmSecondaryFamily = CRYPTO_ALGOFAM_NOT_SET
            CsmRandomGenerateProcessing = CSM_SYNCHRONOUS
            CsmRandomGenerateResultLength = 64
      Crypto_MAC_CMAC_Generate_256
        CsmMacGenerate
          Crypto_MAC_CMAC_Generate_256 (CsmMacGenerateConfig):
            CsmMacGenerateAlgorithmFamiliy = CRYPTO_ALGOFAM_AES
            CsmMacGenerateAlgorithmFamily = CRYPTO_ALGOFAM_AES
            CsmMacGenerateAlgorithmKeyLength = 32
            CsmMacGenerateAlgorithmMode = CRYPTO_ALGOMODE_CMAC
            CsmMacGenerateAlgorithmSecondaryFamily = CRYPTO_ALGOFAM_NOT_SET
            CsmMacGenerateProcessing = CSM_SYNCHRONOUS
            CsmMacGenerateResultLength = 16
      Crypto_MAC_CMAC_Verify_256
        CsmMacVerify
          Crypto_MAC_CMAC_Verify_256 (CsmMacVerifyConfig):
            CsmMacVerifyAlgorithmFamiliy = CRYPTO_ALGOFAM_AES
            CsmMacVerifyAlgorithmFamily = CRYPTO_ALGOFAM_AES
            CsmMacVerifyAlgorithmSecondaryFamily = CRYPTO_ALGOFAM_NOT_SET
            CsmMacVerifyCompareLength = 128
            CsmMacVerifyProcessing = CSM_SYNCHRONOUS
            CsmMacVerifyAlgorithmMode = CRYPTO_ALGOMODE_CMAC
            CsmMacVerifyAlgorithmKeyLength = 32
      Crypto_SigGen_Ed25519_256
        CsmSignatureGenerate
          Crypto_SigGen_Ed25519_256 (CsmSignatureGenerateConfig):
            CsmSignatureGenerateAlgorithmFamiliy = CRYPTO_ALGOFAM_ED25519
            CsmSignatureGenerateAlgorithmFamily = CRYPTO_ALGOFAM_ED25519
            CsmSignatureGenerateAlgorithmMode = CRYPTO_ALGOMODE_CUSTOM
            CsmSignatureGenerateAlgorithmSecondaryFamily = CRYPTO_ALGOFAM_NOT_SET
            CsmSignatureGenerateKeyLength = 32
            CsmSignatureGenerateProcessing = CSM_SYNCHRONOUS
            CsmSignatureGenerateResultLength = 32
            CsmSignatureGenerateAlgorithmModeCustomRef = CRYPTO_ALGOMODE_CUSTOM_EDDSA_ED25519
      Crypto_SigVer_Ed25519_256
        CsmSignatureVerify
          Crypto_SigVer_Ed25519_256 (CsmSignatureVerifyConfig):
            CsmSignatureVerifyAlgorithmFamiliy = CRYPTO_ALGOFAM_ED25519
            CsmSignatureVerifyAlgorithmFamily = CRYPTO_ALGOFAM_ED25519
            CsmSignatureVerifyAlgorithmMode = CRYPTO_ALGOMODE_CUSTOM
            CsmSignatureVerifyAlgorithmSecondaryFamily = CRYPTO_ALGOFAM_NOT_SET
            CsmSignatureVerifyCompareLength = 32
            CsmSignatureVerifyProcessing = CSM_SYNCHRONOUS
            CsmSignatureVerifyKeyLength = 32
            CsmSignatureVerifyAlgorithmModeCustomRef = CRYPTO_ALGOMODE_CUSTOM_EDDSA_ED25519
    CsmCallbacks
      CsmCallback: CsmCallbackFunc=Csm_callback, CsmCallbackId=0
    17 x CsmPrimitives:
      Crypto_Decrypt_RSA_4096_OAEP_SHA2_256
        CsmDecrypt
          Crypto_Decrypt_RSA_4096_OAEP_SHA2_256 (CsmDecryptConfig):
            CsmDecryptAlgorithmFamiliy = CRYPTO_ALGOFAM_RSA
            CsmDecryptAlgorithmFamily = CRYPTO_ALGOFAM_RSA
            CsmDecryptAlgorithmKeyLength = 512
            CsmDecryptAlgorithmMode = CRYPTO_ALGOMODE_RSAES_OAEP
            CsmDecryptAlgorithmSecondaryFamily = CRYPTO_ALGOFAM_SHA2_256
            CsmDecryptProcessing = CSM_SYNCHRONOUS
      Crypto_SigGen_RSAPSS_1024
        CsmSignatureGenerate
          Crypto_SigGen_RSAPSS_1024 (CsmSignatureGenerateConfig):
            CsmSignatureGenerateAlgorithmFamiliy = CRYPTO_ALGOFAM_RSA
            CsmSignatureGenerateAlgorithmFamily = CRYPTO_ALGOFAM_RSA
            CsmSignatureGenerateAlgorithmMode = CRYPTO_ALGOMODE_RSASSA_PSS
            CsmSignatureGenerateAlgorithmSecondaryFamily = CRYPTO_ALGOFAM_SHA2_256
            CsmSignatureGenerateKeyLength = 128
            CsmSignatureGenerateProcessing = CSM_SYNCHRONOUS
            CsmSignatureGenerateResultLength = 128
      Crypto_SigVer_RSAPSS_1024
        CsmSignatureVerify
          Crypto_SigVer_RSAPSS_1024 (CsmSignatureVerifyConfig):
            CsmSignatureVerifyAlgorithmFamiliy = CRYPTO_ALGOFAM_RSA
            CsmSignatureVerifyAlgorithmFamily = CRYPTO_ALGOFAM_RSA
            CsmSignatureVerifyAlgorithmMode = CRYPTO_ALGOMODE_RSASSA_PSS
            CsmSignatureVerifyAlgorithmSecondaryFamily = CRYPTO_ALGOFAM_SHA2_256
            CsmSignatureVerifyCompareLength = 128
            CsmSignatureVerifyProcessing = CSM_SYNCHRONOUS
            CsmSignatureVerifyKeyLength = 128
      Crypto_SigGen_ECCBrainpool_256R1_SHA256
        CsmSignatureGenerate
          Crypto_SigGen_ECCBrainpool_256R1_SHA256 (CsmSignatureGenerateConfig):
            CsmSignatureGenerateAlgorithmFamiliy = CRYPTO_ALGOFAM_BRAINPOOL
            CsmSignatureGenerateAlgorithmFamily = CRYPTO_ALGOFAM_BRAINPOOL
            CsmSignatureGenerateAlgorithmMode = CRYPTO_ALGOMODE_CUSTOM
            CsmSignatureGenerateAlgorithmSecondaryFamily = CRYPTO_ALGOFAM_SHA2_256
            CsmSignatureGenerateKeyLength = 32
            CsmSignatureGenerateProcessing = CSM_SYNCHRONOUS
            CsmSignatureGenerateResultLength = 32
            CsmSignatureGenerateAlgorithmModeCustomRef = CRYPTO_ALGOMODE_CUSTOM_ECCBRAINPOOL_P256R1
      Crypto_SigGen_ECCBrainpool_256T1_SHA256
        CsmSignatureGenerate
          Crypto_SigGen_ECCBrainpool_256T1_SHA256 (CsmSignatureGenerateConfig):
            CsmSignatureGenerateAlgorithmFamiliy = CRYPTO_ALGOFAM_BRAINPOOL
            CsmSignatureGenerateAlgorithmFamily = CRYPTO_ALGOFAM_BRAINPOOL
            CsmSignatureGenerateAlgorithmMode = CRYPTO_ALGOMODE_CUSTOM
            CsmSignatureGenerateAlgorithmSecondaryFamily = CRYPTO_ALGOFAM_SHA2_256
            CsmSignatureGenerateKeyLength = 32
            CsmSignatureGenerateProcessing = CSM_SYNCHRONOUS
            CsmSignatureGenerateResultLength = 32
            CsmSignatureGenerateAlgorithmModeCustomRef = CRYPTO_ALGOMODE_CUSTOM_ECCBRAINPOOL_P256T1
      Crypto_SigGen_ED448
        CsmSignatureGenerate
          Crypto_SigGen_ED448 (CsmSignatureGenerateConfig):
            CsmSignatureGenerateAlgorithmFamiliy = CRYPTO_ALGOFAM_CUSTOM
            CsmSignatureGenerateAlgorithmFamily = CRYPTO_ALGOFAM_CUSTOM
            CsmSignatureGenerateAlgorithmMode = CRYPTO_ALGOMODE_CUSTOM
            CsmSignatureGenerateAlgorithmSecondaryFamily = CRYPTO_ALGOFAM_NOT_SET
            CsmSignatureGenerateKeyLength = 57
            CsmSignatureGenerateProcessing = CSM_SYNCHRONOUS
            CsmSignatureGenerateResultLength = 114
            CsmSignatureGenerateAlgorithmFamilyCustomRef = CRYPTO_ALGOFAM_ED448
            CsmSignatureGenerateAlgorithmModeCustomRef = CRYPTO_ALGOMODE_CUSTOM_EDDSA_ED448
      Crypto_SigVer_ED448
        CsmSignatureVerify
          Crypto_SigVer_ED448 (CsmSignatureVerifyConfig):
            CsmSignatureVerifyAlgorithmFamiliy = CRYPTO_ALGOFAM_CUSTOM
            CsmSignatureVerifyAlgorithmFamily = CRYPTO_ALGOFAM_CUSTOM
            CsmSignatureVerifyAlgorithmMode = CRYPTO_ALGOMODE_CUSTOM
            CsmSignatureVerifyAlgorithmSecondaryFamily = CRYPTO_ALGOFAM_NOT_SET
            CsmSignatureVerifyCompareLength = 57
            CsmSignatureVerifyProcessing = CSM_SYNCHRONOUS
            CsmSignatureVerifyKeyLength = 114
            CsmSignatureVerifyAlgorithmFamilyCustomRef = CRYPTO_ALGOFAM_ED448
            CsmSignatureVerifyAlgorithmModeCustomRef = CRYPTO_ALGOMODE_CUSTOM_EDDSA_ED448
      Crypto_MAC_HMAC_Verify_SHA2_512
        CsmMacVerify
          Crypto_MAC_HMAC_Verify_SHA2_512 (CsmMacVerifyConfig):
            CsmMacVerifyAlgorithmFamiliy = CRYPTO_ALGOFAM_SHA2_512
            CsmMacVerifyAlgorithmFamily = CRYPTO_ALGOFAM_SHA2_512
            CsmMacVerifyAlgorithmSecondaryFamily = CRYPTO_ALGOFAM_NOT_SET
            CsmMacVerifyCompareLength = 64
            CsmMacVerifyProcessing = CSM_SYNCHRONOUS
            CsmMacVerifyAlgorithmMode = CRYPTO_ALGOMODE_HMAC
            CsmMacVerifyAlgorithmKeyLength = 64
      Crypto_SigVer_ECCBrainpool_256T1_SHA256
        CsmSignatureVerify
          Crypto_SigVer_ECCBrainpool_256T1_SHA256 (CsmSignatureVerifyConfig):
            CsmSignatureVerifyAlgorithmFamiliy = CRYPTO_ALGOFAM_BRAINPOOL
            CsmSignatureVerifyAlgorithmFamily = CRYPTO_ALGOFAM_BRAINPOOL
            CsmSignatureVerifyAlgorithmMode = CRYPTO_ALGOMODE_CUSTOM
            CsmSignatureVerifyAlgorithmSecondaryFamily = CRYPTO_ALGOFAM_SHA2_256
            CsmSignatureVerifyCompareLength = 32
            CsmSignatureVerifyProcessing = CSM_SYNCHRONOUS
            CsmSignatureVerifyKeyLength = 32
            CsmSignatureVerifyAlgorithmModeCustomRef = CRYPTO_ALGOMODE_CUSTOM_ECCBRAINPOOL_P256T1
      Crypto_Decrypt_AES_CBC_256_ASYNC
        CsmDecrypt
          Crypto_Decrypt_AES_CBC_256_ASYNC (CsmDecryptConfig):
            CsmDecryptAlgorithmFamiliy = CRYPTO_ALGOFAM_AES
            CsmDecryptAlgorithmFamily = CRYPTO_ALGOFAM_AES
            CsmDecryptAlgorithmKeyLength = 32
            CsmDecryptAlgorithmMode = CRYPTO_ALGOMODE_CBC
            CsmDecryptAlgorithmSecondaryFamily = CRYPTO_ALGOFAM_CUSTOM
            CsmDecryptProcessing = CSM_ASYNCHRONOUS
            CsmDecryptAlgorithmSecondaryFamilyCustom = CRYPTO_ALGOFAM_PADDING_PKCS7
      Crypto_Hash_SHA2_256_ASYNC
        CsmHash
          Crypto_Hash_SHA2_256_ASYNC (CsmHashConfig):
            CsmHashAlgorithmFamiliy = CRYPTO_ALGOFAM_SHA2_256
            CsmHashAlgorithmFamily = CRYPTO_ALGOFAM_SHA2_256
            CsmHashAlgorithmMode = CRYPTO_ALGOMODE_NOT_SET
            CsmHashAlgorithmSecondaryFamily = CRYPTO_ALGOFAM_NOT_SET
            CsmHashProcessing = CSM_ASYNCHRONOUS
            CsmHashResultLength = 32
      Crypto_MAC_CMAC_Generate_SHE
        CsmMacGenerate
          Crypto_MAC_CMAC_Generate_SHE (CsmMacGenerateConfig):
            CsmMacGenerateAlgorithmFamiliy = CRYPTO_ALGOFAM_AES
            CsmMacGenerateAlgorithmFamily = CRYPTO_ALGOFAM_AES
            CsmMacGenerateAlgorithmKeyLength = 16
            CsmMacGenerateAlgorithmMode = CRYPTO_ALGOMODE_CMAC
            CsmMacGenerateAlgorithmSecondaryFamily = CRYPTO_ALGOFAM_NOT_SET
            CsmMacGenerateProcessing = CSM_SYNCHRONOUS
            CsmMacGenerateResultLength = 16
      Crypto_MAC_CMAC_Verify_SHE
        CsmMacVerify
          Crypto_MAC_CMAC_Verify_SHE (CsmMacVerifyConfig):
            CsmMacVerifyAlgorithmFamiliy = CRYPTO_ALGOFAM_AES
            CsmMacVerifyAlgorithmFamily = CRYPTO_ALGOFAM_AES
            CsmMacVerifyAlgorithmSecondaryFamily = CRYPTO_ALGOFAM_NOT_SET
            CsmMacVerifyCompareLength = 128
            CsmMacVerifyProcessing = CSM_SYNCHRONOUS
            CsmMacVerifyAlgorithmMode = CRYPTO_ALGOMODE_CMAC
            CsmMacVerifyAlgorithmKeyLength = 16
      Crypto_Decrypt_AES_CBC_SHE
        CsmDecrypt
          Crypto_Decrypt_AES_CBC_SHE (CsmDecryptConfig):
            CsmDecryptAlgorithmFamiliy = CRYPTO_ALGOFAM_AES
            CsmDecryptAlgorithmFamily = CRYPTO_ALGOFAM_AES
            CsmDecryptAlgorithmKeyLength = 16
            CsmDecryptAlgorithmMode = CRYPTO_ALGOMODE_CBC
            CsmDecryptAlgorithmSecondaryFamily = CRYPTO_ALGOFAM_NOT_SET
            CsmDecryptProcessing = CSM_SYNCHRONOUS
      Crypto_Decrypt_AES_ECB_SHE
        CsmDecrypt
          Crypto_Decrypt_AES_ECB_SHE (CsmDecryptConfig):
            CsmDecryptAlgorithmFamiliy = CRYPTO_ALGOFAM_AES
            CsmDecryptAlgorithmFamily = CRYPTO_ALGOFAM_AES
            CsmDecryptAlgorithmKeyLength = 16
            CsmDecryptAlgorithmMode = CRYPTO_ALGOMODE_ECB
            CsmDecryptAlgorithmSecondaryFamily = CRYPTO_ALGOFAM_NOT_SET
            CsmDecryptProcessing = CSM_SYNCHRONOUS
      Crypto_Encrypt_AES_CBC_SHE
        CsmEncrypt
          Crypto_Encrypt_AES_CBC_SHE (CsmEncryptConfig):
            CsmEncryptAlgorithmFamiliy = CRYPTO_ALGOFAM_AES
            CsmEncryptAlgorithmFamily = CRYPTO_ALGOFAM_AES
            CsmEncryptAlgorithmMode = CRYPTO_ALGOMODE_CBC
            CsmEncryptAlgorithmSecondaryFamily = CRYPTO_ALGOFAM_NOT_SET
            CsmEncryptProcessing = CSM_SYNCHRONOUS
            CsmEncryptAlgorithmKeyLength = 16
      Crypto_Encrypt_AES_ECB_SHE
        CsmEncrypt
          Crypto_Encrypt_AES_ECB_SHE (CsmEncryptConfig):
            CsmEncryptAlgorithmFamiliy = CRYPTO_ALGOFAM_AES
            CsmEncryptAlgorithmFamily = CRYPTO_ALGOFAM_AES
            CsmEncryptAlgorithmMode = CRYPTO_ALGOMODE_ECB
            CsmEncryptAlgorithmSecondaryFamily = CRYPTO_ALGOFAM_NOT_SET
            CsmEncryptProcessing = CSM_SYNCHRONOUS
            CsmEncryptAlgorithmKeyLength = 16
