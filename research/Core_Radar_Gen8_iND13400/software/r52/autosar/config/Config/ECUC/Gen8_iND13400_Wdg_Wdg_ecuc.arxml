AUTOSAR XML (schema 00053)
package /ActiveEcuC
  module config Wdg: implementation-config-variant=VARIANT-PRE-COMPILE, module-description=Wdg_Impl
    WdgGeneral:
      WdgDevErrorDetect = true
      WdgDisableAllowed = true
      WdgChannelSelection = WDG_CHANNEL_ZERO
      WdgIndex = 0
      WdgInitialTimeout = 0
      WdgMaxTimeout = 65.535
      WdgRunArea = RAM
      WdgTriggerLocation = WdgTriggerLocation_WdgGeneral
      WdgVersionInfoApi = false
      WdgEnableTimeoutMapping = false
      WdgEnableInitCheck = false
      WdgEnableRegisterReadback = false
    WdgSettingsConfig: WdgDefaultMode=WDGIF_SLOW_MODE
      WdgSettingsOff: WdgPreloadValue=0, WdgReactionMode=WDG_REACTIONMODE_INTERRUPT
      WdgSettingsFast: WdgReactionMode=WDG_REACTIONMODE_MIXED, WdgPreloadValue=WDG_PRELOADVALUE_52MS
      WdgSettingsSlow: WdgReactionMode=WDG_REACTIONMODE_MIXED, WdgPreloadValue=WDG_PRELOADVALUE_1678MS
    WdgPublishedInformation: WdgTriggerMode=WDG_TOGGLE
