AUTOSAR XML (schema 00053)
package /ActiveEcuC
  module config J1939Nm: implementation-config-variant=VARIANT-PRE-COMPILE
    J1939NmConfigSet
      J1939NmNode:
        J1939NmNodeId = (unset)
        J1939NmNodeNameArbitraryAddressCapable = (unset)
        J1939NmNodeNameECUInstance = (unset)
        J1939NmNodeNameFunction = (unset)
        J1939NmNodeNameFunctionInstance = (unset)
        J1939NmNodeNameIdentityNumber = (unset)
        J1939NmNodeNameIndustryGroup = (unset)
        J1939NmNodeNameManufacturerCode = (unset)
        J1939NmNodeNameVehicleSystem = (unset)
        J1939NmNodeNameVehicleSystemInstance = (unset)
        J1939NmNodePreferredAddress = 208
        J1939NmNodeStartUpDelay = (unset)
        J1939NmNodeChannelRef = (unset)
      VCAN_RADAR_J1939_0bcb74f6 (J1939NmChannel): J1939NmComMNetworkHandleRef=CN_VCAN_RADAR_489180b6
        J1939NmTxPdu_ad6d2a99 (J1939NmTxPdu): J1939NmTxPduId=(unset), J1939NmTxPduRef=(unset)
        J1939NmRxPdu_ad6d2a99 (J1939NmRxPdu): J1939NmRxPduId=(unset), J1939NmRxPduRef=(unset)
    J1939NmGeneral: J1939NmDevErrorDetect=(unset), J1939NmMainFunctionPeriod=(unset), J1939NmTxConfirmationTimeout=(unset), J1939NmVersionInfoApi=(unset)
