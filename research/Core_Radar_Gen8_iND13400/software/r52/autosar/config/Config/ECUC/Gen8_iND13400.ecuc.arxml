AUTOSAR XML (schema 00053)
package /ActiveEcuC
  ecuc value collection ActiveEcuC: ecu-extract=SYSTEM
    ecuc-values:
      Eth
      SoAd
      BswM
      EcuM
      EthIf
      PduR
      Rte
      TcpIp
      Os
      EthSM
      vSet
      Det
      Com
      ComM
      EcuC
      MemMap
      EthTrcv_RTL
      Mcu
      Port
      Adc
      Dio
      I2c
      Fls
      IpBase
      Gpt
      Can
      CanIf
      Pwm
      Spi
      Dma
      CanSM
      Cdd
      Xcp
      Crc
      StbM
      EthTSyn
      Eth_Indie
      Rtm
      MemIf
      NvM
      Fee
      LdCom
      SomeIpTp
      Sd
      SomeIpXf
      ComXf
      WdgIf
      WdgM
      Wdg
      CanTSyn
      VTTMemMap
      vLinkGen
      vBaseEnv
      Uart
      Dem
      Dcm
      CanTp
      J1939Dcm
      J1939Rm
      J1939Nm
      J1939Tp
      E2EXf
      E2E
      Crypto
      CryIf
      Csm
      EthTrcv_NXP
      EthTrcv_RTL
