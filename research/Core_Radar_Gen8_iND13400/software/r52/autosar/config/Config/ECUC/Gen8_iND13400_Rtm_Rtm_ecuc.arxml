AUTOSAR XML (schema 00053)
package /ActiveEcuC
  module config Rtm: implementation-config-variant=VARIANT-PRE-COMPILE, module-description=Rtm_Impl
    RtmGeneral:
      RtmSafeBswChecks = true
      RtmDevErrorDetect = true
      RtmGetMeasurementTimestampFct = Rtm_GetTimeMeasurement
      RtmMeasurementCtrFrequency = 250000
      RtmCtrDirection = RTM_DOWN
      RtmMainfunctionCycleTime = 0.05
      RtmTimerOverrunSupport = false
      Rtm32BitTimer = true
      RtmUseNestingCounter = true
      RtmUsedCoreMask = 1
      RtmControl = true
      RtmEcuName = Rtm
      RtmUserConfigFile = $(DpaProjectFolder)\Appl\Include\User_Rtm.h
      RtmUseFctPtrForTaskResponseTime = false
    RtmCoreDefinition: RtmCoreDefinitionId=0, RtmBSWCore=true, RtmCore=0, RtmBackgroundTaskName=IdleTask_OsCore0
    5 x RtmMeasurementPoint, all with RtmMeasurementEnabled=false, RtmDisableInterrupts=false, RtmMeasurementType=GrossExecutionTime, RtmMeasurementPointType=Runtime, RtmTargetRuntime=0, RtmMeasurementGroup=Xcp, RtmThresholdCallback=false, RtmAssignedToCore=RtmCoreDefinition:
      Xcp_MainFunction: RtmAutostartEnabled=false, RtmMeasurementId=39  # Xcp PLAIN_TEXT Measure Runtime of Xcp_MainFunction function used for CRC calculation and Resume Mode.
      Xcp_Event: RtmAutostartEnabled=false, RtmMeasurementId=37  # Xcp PLAIN_TEXT Measure Runtime of Xcp_Event function used for DAQ measurement and STIM calibration.
      Xcp_TlRxIndication: RtmAutostartEnabled=false, RtmMeasurementId=40  # Xcp PLAIN_TEXT Measure Runtime of Xcp_TlRxIndication function used for command handling.
      Xcp_TlTxConfirmation: RtmAutostartEnabled=false, RtmMeasurementId=41  # Xcp PLAIN_TEXT Measure Runtime of Xcp_TlTxConfirmation used for sending pending tx messages.
      Xcp_Init: RtmAutostartEnabled=true, RtmMeasurementId=38  # Xcp PLAIN_TEXT Measure Runtime of Xcp_Init used for initializing Xcp.
    RtmCpuLoadMeasurement: RtmHyperperiod=0.1, RtmCpuLoadControlMode=C_API
    33 x RtmMeasurementPoint, all with RtmAutostartEnabled=false, RtmDisableInterrupts=false, RtmTargetRuntime=0, RtmThresholdCallback=false, RtmAssignedToCore=RtmCoreDefinition:
      Rtm_CpuLoadMeasurement: RtmMeasurementEnabled=true, RtmMeasurementId=30, RtmMeasurementType=GrossExecutionTime, RtmMeasurementPointType=CPU_Load, RtmMeasurementGroup=CpuLoad
      EthTrcv_30_Rtl9010_TransceiverInit: RtmMeasurementEnabled=false, RtmMeasurementId=26, RtmMeasurementType=GrossExecutionTime, RtmMeasurementPointType=Runtime, RtmMeasurementGroup=EthTrcv_30_Rtl9010  # EthTrcv_30_Rtl9010 PLAIN_TEXT Measurement point for the EthTrcv_30_Rtl9010_TransceiverInit function.
      CANNM_SID_TXCONFIRMATION: RtmMeasurementEnabled=false, RtmMeasurementId=25, RtmMeasurementType=GrossExecutionTime, RtmMeasurementPointType=Runtime, RtmMeasurementGroup=CanNm  # CanNm PLAIN_TEXT Measurement point that measures the CanNm_TxConfirmation function
      CANNM_SID_GETNODEIDENTIFIER: RtmMeasurementEnabled=false, RtmMeasurementId=15, RtmMeasurementType=GrossExecutionTime, RtmMeasurementPointType=Runtime, RtmMeasurementGroup=CanNm  # CanNm PLAIN_TEXT Measurement point that measures the CanNm_GetNodeIdentifier function
      CANNM_SID_GETLOCALNODEIDENTIFIER: RtmMeasurementEnabled=false, RtmMeasurementId=14, RtmMeasurementType=GrossExecutionTime, RtmMeasurementPointType=Runtime, RtmMeasurementGroup=CanNm  # CanNm PLAIN_TEXT Measurement point that measures the CanNm_GetLocalNodeIdentifier function
      CANNM_SID_NETWORKREQUEST: RtmMeasurementEnabled=false, RtmMeasurementId=21, RtmMeasurementType=GrossExecutionTime, RtmMeasurementPointType=Runtime, RtmMeasurementGroup=CanNm  # CanNm PLAIN_TEXT Measurement point that measures the CanNm_NetworkRequest function
      CANNM_SID_NETWORKRELEASE: RtmMeasurementEnabled=false, RtmMeasurementId=20, RtmMeasurementType=GrossExecutionTime, RtmMeasurementPointType=Runtime, RtmMeasurementGroup=CanNm  # CanNm PLAIN_TEXT Measurement point that measures the CanNm_NetworkRelease function
      CANNM_SID_INIT: RtmMeasurementEnabled=false, RtmMeasurementId=18, RtmMeasurementType=GrossExecutionTime, RtmMeasurementPointType=Runtime, RtmMeasurementGroup=CanNm  # CanNm PLAIN_TEXT Measurement point that measures the CanNm_Init function
      CANNM_SID_PASSIVESTARTUP: RtmMeasurementEnabled=false, RtmMeasurementId=22, RtmMeasurementType=GrossExecutionTime, RtmMeasurementPointType=Runtime, RtmMeasurementGroup=CanNm  # CanNm PLAIN_TEXT Measurement point that measures the CanNm_PassiveStartUp function
      CANNM_SID_GETSTATE: RtmMeasurementEnabled=false, RtmMeasurementId=17, RtmMeasurementType=GrossExecutionTime, RtmMeasurementPointType=Runtime, RtmMeasurementGroup=CanNm  # CanNm PLAIN_TEXT Measurement point that measures the CanNm_GetState function
      CANNM_SID_MAINFUNCTION: RtmMeasurementEnabled=false, RtmMeasurementId=19, RtmMeasurementType=GrossExecutionTime, RtmMeasurementPointType=Runtime, RtmMeasurementGroup=CanNm  # CanNm PLAIN_TEXT Measurement point that measures the CanNm_MainFunction function
      CANNM_SID_RXINDICATION: RtmMeasurementEnabled=false, RtmMeasurementId=24, RtmMeasurementType=GrossExecutionTime, RtmMeasurementPointType=Runtime, RtmMeasurementGroup=CanNm  # CanNm PLAIN_TEXT Measurement point that measures the CanNm_RxIndication function
      CANNM_SID_GETPDUDATA: RtmMeasurementEnabled=false, RtmMeasurementId=16, RtmMeasurementType=GrossExecutionTime, RtmMeasurementPointType=Runtime, RtmMeasurementGroup=CanNm  # CanNm PLAIN_TEXT Measurement point that measures the CanNm_GetPduData function
      CANNM_SID_ENABLECOMMUNICATION: RtmMeasurementEnabled=false, RtmMeasurementId=13, RtmMeasurementType=GrossExecutionTime, RtmMeasurementPointType=Runtime, RtmMeasurementGroup=CanNm  # CanNm PLAIN_TEXT Measurement point that measures the CanNm_EnableCommunication function
      CANNM_SID_DISABLECOMMUNICATION: RtmMeasurementEnabled=false, RtmMeasurementId=12, RtmMeasurementType=GrossExecutionTime, RtmMeasurementPointType=Runtime, RtmMeasurementGroup=CanNm  # CanNm PLAIN_TEXT Measurement point that measures the CanNm_DisableCommunication function
      CANNM_SID_REPEATMESSAGEREQUEST: RtmMeasurementEnabled=false, RtmMeasurementId=23, RtmMeasurementType=GrossExecutionTime, RtmMeasurementPointType=Runtime, RtmMeasurementGroup=CanNm  # CanNm PLAIN_TEXT Measurement point that measures the CanNm_RepeatMessageRequest function
      Sd_State_HandleRunMode: RtmMeasurementEnabled=false, RtmMeasurementId=33, RtmMeasurementType=GrossExecutionTime, RtmMeasurementPointType=Runtime, RtmMeasurementGroup=Sd  # Sd PLAIN_TEXT Sd_State_HandleRunMode() is measured.
      Sd_EventServer_Process: RtmMeasurementEnabled=false, RtmMeasurementId=31, RtmMeasurementType=GrossExecutionTime, RtmMeasurementPointType=Runtime, RtmMeasurementGroup=Sd  # Sd PLAIN_TEXT Sd_EventServer_Process() is measured.
      Sd_State_Process__ServerSMs: RtmMeasurementEnabled=false, RtmMeasurementId=35, RtmMeasurementType=GrossExecutionTime, RtmMeasurementPointType=Runtime, RtmMeasurementGroup=Sd  # Sd PLAIN_TEXT Sd_State_Process() for ServerService State Machines is measured.
      Sd_State_Process__ClientSMs: RtmMeasurementEnabled=false, RtmMeasurementId=34, RtmMeasurementType=GrossExecutionTime, RtmMeasurementPointType=Runtime, RtmMeasurementGroup=Sd  # Sd PLAIN_TEXT Sd_State_Process() for ClientService State Machines is measured.
      Sd_Tx_ProcessPendingMessages: RtmMeasurementEnabled=false, RtmMeasurementId=36, RtmMeasurementType=GrossExecutionTime, RtmMeasurementPointType=Runtime, RtmMeasurementGroup=Sd  # Sd PLAIN_TEXT Sd_Tx_ProcessPendingMessages() is measured.
      Sd_RxIndication: RtmMeasurementEnabled=false, RtmMeasurementId=32, RtmMeasurementType=GrossExecutionTime, RtmMeasurementPointType=Runtime, RtmMeasurementGroup=Sd  # Sd PLAIN_TEXT Sd_RxIndication() is measured.
      Appl_BackgroundTask: RtmMeasurementEnabled=true, RtmMeasurementId=4, RtmMeasurementType=NetExecutionTime, RtmMeasurementPointType=Runtime
      IdleTask_OsCore0: RtmMeasurementEnabled=true, RtmMeasurementId=28, RtmMeasurementType=NetExecutionTime, RtmMeasurementPointType=Runtime
      BSW_Task: RtmMeasurementEnabled=true, RtmMeasurementId=11, RtmMeasurementType=NetExecutionTime, RtmMeasurementPointType=Runtime
      Appl_Task: RtmMeasurementEnabled=true, RtmMeasurementId=6, RtmMeasurementType=NetExecutionTime, RtmMeasurementPointType=Runtime
      Appl_Task_Communication: RtmMeasurementEnabled=true, RtmMeasurementId=7, RtmMeasurementType=NetExecutionTime, RtmMeasurementPointType=Runtime
      Appl_Task_Fast: RtmMeasurementEnabled=true, RtmMeasurementId=8, RtmMeasurementType=NetExecutionTime, RtmMeasurementPointType=Runtime
      Appl_Task_High_Prio: RtmMeasurementEnabled=true, RtmMeasurementId=9, RtmMeasurementType=NetExecutionTime, RtmMeasurementPointType=Runtime
      Appl_Task_Logging: RtmMeasurementEnabled=true, RtmMeasurementId=10, RtmMeasurementType=NetExecutionTime, RtmMeasurementPointType=Runtime
      Radar_Ctrl_Task: RtmMeasurementEnabled=true, RtmMeasurementId=29, RtmMeasurementType=NetExecutionTime, RtmMeasurementPointType=Runtime
      Appl_IPC_Task: RtmMeasurementEnabled=true, RtmMeasurementId=5, RtmMeasurementType=NetExecutionTime, RtmMeasurementPointType=Runtime
      EthTrcv_30_Tja1103_TransceiverInit: RtmMeasurementEnabled=false, RtmMeasurementId=27, RtmMeasurementType=GrossExecutionTime, RtmMeasurementPointType=Runtime, RtmMeasurementGroup=EthTrcv_30_Tja1103  # EthTrcv_30_Tja1103 PLAIN_TEXT Measurement point for the EthTrcv_30_Tja1103_TransceiverInit function.
