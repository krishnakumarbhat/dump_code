AUTOSAR XML (schema 00053)
package /ActiveEcuC
  module config EcuM: implementation-config-variant=VARIANT-PRE-COMPILE, module-description=EcuM_Impl
    EcuMConfiguration
      EcuMFlexConfiguration: EcuMFlexModuleConfigurationRef=CanConfigSet, EcuMNormalMcuModeRef=McuModeSettingConf
        ECUM_CAUSE_UNKNOWN (EcuMShutdownCause): EcuMShutdownCauseId=0
        ECUM_RESET_IO (EcuMResetMode): EcuMResetModeId=2
        ECUM_RESET_MCU (EcuMResetMode): EcuMResetModeId=0
        ECUM_CAUSE_DCM (EcuMShutdownCause): EcuMShutdownCauseId=3
        ECUM_RESET_WAKEUP (EcuMResetMode): EcuMResetModeId=3
        ECUM_CAUSE_ECU_STATE (EcuMShutdownCause): EcuMShutdownCauseId=1
        ECUM_RESET_WDG (EcuMResetMode): EcuMResetModeId=1
        ECUM_CAUSE_WDGM (EcuMShutdownCause): EcuMShutdownCauseId=2
      EcuMCommonConfiguration: EcuMDefaultAppMode=OSDEFAULTAPPMODE, EcuMOSResource=OsResource
        4 x EcuMWakeupSource, all with EcuMValidationTimeout=0, EcuMCheckWakeupTimeout=0, EcuMWakeupSourcePolling=false:
          ECUM_WKSOURCE_POWER: EcuMWakeupSourceId=0
          ECUM_WKSOURCE_INTERNAL_WDG: EcuMWakeupSourceId=3
          ECUM_WKSOURCE_INTERNAL_RESET: EcuMWakeupSourceId=2
          ECUM_WKSOURCE_RESET: EcuMWakeupSourceId=1
        EcuMDefaultShutdownTarget: EcuMDefaultState=EcuMStateOff
        ECUM_WKSOURCE_EXTERNAL_WDG (EcuMWakeupSource): EcuMWakeupSourceId=4, EcuMValidationTimeout=0, EcuMCheckWakeupTimeout=0, EcuMWakeupSourcePolling=false
        EcuMDriverInitListZero
          19 x EcuMDriverInitItem:
            BswM_InitMemory: index=0, EcuMModuleID=BswM, EcuMModuleService=BswM_InitMemory, EcuMModuleHeader=BswM.h
            ComM_InitMemory: index=1, EcuMModuleID=ComM, EcuMModuleService=ComM_InitMemory, EcuMModuleHeader=ComM.h
            Com_InitMemory: index=2, EcuMModuleID=Com, EcuMModuleService=Com_InitMemory, EcuMModuleHeader=Com.h
            Det_InitMemory: index=3, EcuMModuleID=Det, EcuMModuleService=Det_InitMemory, EcuMModuleHeader=Det.h
            EthIf_InitMemory: index=5, EcuMModuleID=EthIf, EcuMModuleService=EthIf_InitMemory, EcuMModuleHeader=EthIf.h
            EthSM_InitMemory: index=6, EcuMModuleID=EthSM, EcuMModuleService=EthSM_InitMemory, EcuMModuleHeader=EthSM.h
            PduR_InitMemory: index=7, EcuMModuleID=PduR, EcuMModuleService=PduR_InitMemory, EcuMModuleHeader=PduR.h
            Rte_InitMemory: index=8, EcuMModuleID=Rte, EcuMModuleService=Rte_InitMemory, EcuMModuleHeader=Rte_Main.h
            SoAd_InitMemory: index=9, EcuMModuleID=SoAd, EcuMModuleService=SoAd_InitMemory, EcuMModuleHeader=SoAd.h
            TcpIp_InitMemory: index=10, EcuMModuleID=TcpIp, EcuMModuleService=TcpIp_InitMemory, EcuMModuleHeader=TcpIp.h
            EthTrcv_30_Rtl9010_InitMemory: index=11, EcuMModuleID=EthTrcv, EcuMModuleService=EthTrcv_30_Rtl9010_InitMemory, EcuMModuleHeader=EthTrcv_30_Rtl9010.h
            Det_Init: index=13, EcuMModuleID=Det, EcuMModuleService=Det_Init, EcuMModuleHeader=Det.h
            Xcp_InitMemory: index=14, EcuMModuleID=Xcp, EcuMModuleService=Xcp_InitMemory, EcuMModuleHeader=Xcp.h
            TcpIpXcp_InitMemory: index=15, EcuMModuleID=Xcp, EcuMModuleService=TcpIpXcp_InitMemory, EcuMModuleHeader=TcpIpXcp.h
            CanIf_InitMemory: EcuMModuleID=CanIf, EcuMModuleHeader=CanIf.h, EcuMModuleService=CanIf_InitMemory
            CanSM_InitMemory: EcuMModuleID=CanSM, EcuMModuleHeader=CanSM_EcuM.h, EcuMModuleService=CanSM_InitMemory
            Dcm_InitMemory: index=16, EcuMModuleID=Dcm, EcuMModuleService=Dcm_InitMemory, EcuMModuleHeader=Dcm.h
            CanTp_InitMemory: index=17, EcuMModuleID=CanTp, EcuMModuleService=CanTp_InitMemory, EcuMModuleHeader=CanTp.h
            BswM_PreInit: EcuMModuleID=BswM, EcuMModuleService=BswM_PreInit, EcuMModuleHeader=BswM.h
        EcuMDriverInitListOne
          4 x EcuMDriverInitItem:
            ComM_PreInit: index=1, EcuMModuleID=ComM, EcuMModuleService=ComM_PreInit, EcuMModuleHeader=ComM.h
            PduR_PreInit: index=3, EcuMModuleID=PduR, EcuMModuleService=PduR_PreInit, EcuMModuleHeader=PduR.h
            SoAd_PreInit: index=4, EcuMModuleID=SoAd, EcuMModuleService=SoAd_PreInit, EcuMModuleHeader=SoAd.h
            Eth_30_Wrapper_Init: index=5, EcuMModuleID=Eth, EcuMModuleService=Eth_30_Wrapper_Init, EcuMModuleHeader=Eth_30_Wrapper.h
        3 x EcuMWakeupSource, all with EcuMWakeupSourcePolling=false:
          CN_PCAN_RADAR_458ff0f1: EcuMWakeupSourceId=5, EcuMComMChannelRef=CN_PCAN_RADAR_458ff0f1
          cnctr_RDR_RdrNet_5172a59b: EcuMWakeupSourceId=7, EcuMComMChannelRef=cnctr_RDR_RdrNet_5172a59b
          CN_VCAN_RADAR_489180b6: EcuMWakeupSourceId=6, EcuMComMChannelRef=CN_VCAN_RADAR_489180b6
    EcuMGeneral:
      EcuMDevErrorDetect = true
      EcuMIncludeDem = false
      EcuMIncludeDet = false
      EcuMMainFunctionPeriod = 0.01
      EcuMVersionInfoApi = false
      EcuMDeferredBswMNotification = false
      EcuMSlaveCoreHandling = true
      EcuMEnableFixBehavior = false
      EcuMNonChannelWakeupInRun = false
      EcuMSchMStartInitialization = true
      EcuMSafeBswChecks = false
      EcuMAdditionalIncludes = sensor_position.h
      EcuMAdditionalIncludes = Driver_Port.h
      EcuMAdditionalIncludes = calibration_if.h
      EcuMAdditionalIncludes = reuse.h
      EcuMAdditionalIncludes = SchM_Fls.h
      EcuMGeneration: EcuMOutOfBoundsWriteSanitizer=false, EcuMOutOfBoundsReadSanitizer=false, EcuMInterfacesForDeactivatedData=false
    EcuMFlexGeneral: EcuMAlarmClockPresent=false
