AUTOSAR XML (schema 00053)
package /ActiveEcuC
  module config EthTSyn: implementation-config-variant=VARIANT-PRE-COMPILE, module-description=EthTSyn_Impl
    EthTSynGeneral:
      EthTSynSafeBswChecks = true
      EthTSynDestPhyAddr = 01:80:C2:00:00:0E
      EthTSynDevErrorDetect = true
      EthTSynHardwareTimestampSupport = false
      EthTSynMainFunctionPeriod = 0.01
      EthTSynMasterSlaveConflictDetection = false
      EthTSynMessageCompliance = true
      EthTSynVersionInfoApi = false
      EthTSynEnableSwitchMgmt = false
      EthTSynEnablePortParameterStatistics = false
      EthTSynSwitchMgmtBridgeMode = TRANSPARENT_CLOCK
      EthTSynEthIfFrameType = EthTSyn_PTP
    EthTSynGlobalTimeDomain:
      EthTSynGlobalTimeDomainId = 0
      EthTSynIsOffsetTimeDomain = false
      EthTSynEnableTimeValidation = false
      EthTSynSynchronizedTimeBaseRef = StbMSynchronizedTimeBase
      RDR_EthConnector1_Untagged (EthTSynPortConfig): EthTSynGlobalTimeDebounceTime=0, EthTSynPortNumber=1, EthTSynGlobalTimeEthIfRef=cnctr_RDR_RdrNet_5172a59b
        EthTSynPortRole
          EthTSynGlobalTimeSlave:
            EthTSynGlobalTimeFollowUpTimeout = 0
            EthTSynRxCrcValidated = CRC_IGNORED
            EthTSynEnableAnnounce = false
            EthTSynEnableSourcePortIdentityCheck = false
            EthTSynRxSubTLVOFS = false
            EthTSynRxSubTLVStatus = false
            EthTSynRxSubTLVTime = false
            EthTSynRxSubTLVUserData = false
        EthTSynPdelayConfig:
          EthTSynGlobalTimePdelayRespEnable = true
          EthTSynGlobalTimePropagationDelay = 0
          EthTSynGlobalTimeTxPdelayReqPeriod = 1
          EthTSynPdelayRespAndRespFollowUpTimeout = 0
          EthTSynUseStaticPdelay = false
          EthTSynAlwaysAsCapable = true
          EthTSynPdelayRespUseGlobalTime = false
