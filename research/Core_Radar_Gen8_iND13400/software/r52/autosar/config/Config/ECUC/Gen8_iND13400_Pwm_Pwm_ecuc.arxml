AUTOSAR XML (schema 00053)
package /ActiveEcuC
  module config Pwm: implementation-config-variant=VARIANT-POST-BUILD, module-description=Pwm_Impl
    PwmChannelConfigSet
      PwmChannel_002 (PwmChannel):
        PwmChannelId = 2
        PwmDutycycleDefault = 16384
        PwmIdleState = PWM_LOW
        PwmPolarity = PWM_HIGH
        PwmChannelPrescaler = PWM_PRESCALER_DIV_8
        PwmSlopeStep = 255
        PwmSlopeMinPeriod = 4096
        PwmSlopeMaxPeriod = 32768
        PwmDitherEnable = false
        PwmDitherStep = 15
        PwmStaircaseEocEnable = false
        PwmStaircaseEocCount = 15
        PwmPeriodDefault = 3125
        PwmChannelClass = PWM_FIXED_PERIOD
        PwmStaircaseEocMask = PWM_EOC_MASKED_BLOCKS_EXT_TRIGGER
        PwmStaircaseEofMask = PWM_EOF_MASKED_BLOCKS_EXT_TRIGGER
        PwmStaircaseEocExternalSource = PWM_EOC_SOURCE_MIPI
        PwmStaircaseEocLim = 1
        PwmStaircaseEofExternalSource = PWM_EOF_SOURCE_MIPI
        PwmStaircaseEofLim = 1
        PwmMcuClockReferencePoint = clk_gpadc
      PwmDDSChannel:
        PwmDDSChannelId = 0
        PwmDDSChannelPrescaler = PWM_PRESCALER_DIV_1
        PwmDDSRamp0StartFrequency = 16
        PwmDDSRamp0Step = 1
        PwmDDSRamp0UpdateInterval = 512
        PwmDDSRamp0MaxStepCount = 512
        PwmDDSRamp1StartFrequency = 240
        PwmDDSRamp1Step = 1
        PwmDDSRamp1UpdateInterval = 512
        PwmDDSRamp1MaxStepCount = 512
        PwmDDSDutyCycle = 4096
        PwmDDSDitherStep = 512
        PwmDDSDitherUpdateInterval = 512
        PwmDDSRampUpdateTimerEnable = true
        PwmDDSEocTriggerEnable = false
        PwmDDSEofTriggerEnable = false
        PwmDDSEocExternalSource = PWM_EOC_SOURCE_MIPI
        PwmDDSEofExternalSource = PWM_EOF_SOURCE_MIPI
        PwmDDSEocLim = 1
        PwmDDSEofLim = 1
      PwmDDSChannel_001 (PwmDDSChannel):
        PwmDDSChannelId = 1
        PwmDDSChannelPrescaler = PWM_PRESCALER_DIV_1
        PwmDDSRamp0StartFrequency = 16
        PwmDDSRamp0Step = 1
        PwmDDSRamp0UpdateInterval = 512
        PwmDDSRamp0MaxStepCount = 10
        PwmDDSRamp1StartFrequency = 240
        PwmDDSRamp1Step = 1
        PwmDDSRamp1UpdateInterval = 512
        PwmDDSRamp1MaxStepCount = 10
        PwmDDSDutyCycle = 65535
        PwmDDSDitherStep = 0
        PwmDDSDitherUpdateInterval = 0
        PwmDDSRampUpdateTimerEnable = true
        PwmDDSEocTriggerEnable = false
        PwmDDSEofTriggerEnable = false
        PwmDDSEocExternalSource = PWM_EOC_SOURCE_MIPI
        PwmDDSEofExternalSource = PWM_EOF_SOURCE_MIPI
        PwmDDSEocLim = 1
        PwmDDSEofLim = 1
      PwmChannel_003 (PwmChannel):
        PwmChannelId = 3
        PwmDutycycleDefault = 16384
        PwmIdleState = PWM_LOW
        PwmPolarity = PWM_HIGH
        PwmChannelPrescaler = PWM_PRESCALER_DIV_1
        PwmSlopeStep = 100
        PwmSlopeMinPeriod = 1500
        PwmSlopeMaxPeriod = 3000
        PwmDitherEnable = false
        PwmDitherStep = 0
        PwmStaircaseEocEnable = false
        PwmStaircaseEocCount = 0
        PwmPeriodDefault = 3000
        PwmStaircaseEocMask = PWM_EOC_MASKED_BLOCKS_EXT_TRIGGER
        PwmStaircaseEofMask = PWM_EOF_MASKED_BLOCKS_EXT_TRIGGER
        PwmStaircaseEocExternalSource = PWM_EOC_SOURCE_MIPI
        PwmStaircaseEofExternalSource = PWM_EOF_SOURCE_MIPI
        PwmStaircaseEocLim = 1
        PwmStaircaseEofLim = 1
        PwmChannelClass = PWM_CONTINUOUS_MODE
        PwmMcuClockReferencePoint = clk_gpadc
    PwmConfigurationOfOptApiServices: PwmDeInitApi=true, PwmGetOutputState=true, PwmSetDutyCycle=true, PwmSetOutputToIdle=true, PwmSetPeriodAndDuty=true, PwmVersionInfoApi=true
    PwmGeneral: PwmDevErrorDetect=true, PwmIndex=0, PwmHardwareVariant=PWM_B0_HARDWARE_VARIANT, PwmSafetyEnable=false, PWMSafetyUserCallout=NULL_PTR
