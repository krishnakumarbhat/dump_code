AUTOSAR XML (schema 00053)
package /ActiveEcuC
  module config Fls: implementation-config-variant=VARIANT-POST-BUILD, module-description=Fls_Impl
    FlsConfigSet:
      FlsAcErase = 0
      FlsAcWrite = 0
      FlsCallCycle = 0.005
      FlsDefaultMode = MEMIF_MODE_SLOW
      FlsMaxReadFastMode = 4096
      FlsMaxReadNormalMode = 4096
      FlsMaxWriteFastMode = 4096
      FlsMaxWriteNormalMode = 4096
      FlsProtection = 0
      FlsJobEndNotification = NULL
      FlsJobErrorNotification = NULL
      FlsDriverStrength = 50
      FlsReceiveSampleDelay = 1
      FlsSectorList
        FlsSector: FlsNumberOfSectors=1024, FlsPageSize=256, FlsSectorSize=4096, FlsSectorStartaddress=0
    FlsGeneral:
      FlsAcLoadOnJobStart = false
      FlsBaseAddress = 0
      FlsCancelApi = true
      FlsCompareApi = true
      FlsDevErrorDetect = false
      FlsDriverIndex = 0
      FlsGetJobResultApi = true
      FlsGetStatusApi = true
      FlsSetModeApi = true
      FlsTotalSize = 4194304
      FlsUseInterrupts = false
      FlsVersionInfoApi = true
      FlsWriteVerificationEnable = false
      FlsBlankCheckApi = true
      FlsEraseVerificationEnabled = true
      FlsTimeoutSupervisionEnabled = false
      FlsFastClk = true
      FlsEnableInitCheck = true
      FlsWriteVerificationEnabled = false
      FlsEcucPartitionRef = EcucPartition_SystemApplication_OsCore0
    FlsPublishedInformation:
      FlsAcLocationErase = 0
      FlsAcLocationWrite = 0
      FlsAcSizeErase = 0
      FlsAcSizeWrite = 0
      FlsEraseTime = 0.3
      FlsErasedValue = 4294967295
      FlsExpectedHwId = IS25WP032D
      FlsSpecifiedEraseCycles = 65536
      FlsWriteTime = 0.002
      FlsDisableHWIDCheck = true
