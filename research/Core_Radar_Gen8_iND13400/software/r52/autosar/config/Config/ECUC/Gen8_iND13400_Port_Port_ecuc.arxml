AUTOSAR XML (schema 00053)
package /ActiveEcuC
  module config Port: implementation-config-variant=VARIANT-PRE-COMPILE, module-description=Port_Impl
    PortConfigSet
      PortContainer: PortNumberOfPortPins=26
        26 x PortPin, all with PortPinMode=PORT_PIN_MODE_DIO, PortPinModeChangeable=false, PortPinIrq=PORT_PIN_IRQ_DISABLE, PortPinSchimtterTrigger=false:
          MARS_RESET_N: PortPinDirection=PORT_PIN_OUT, PortPinDirectionChangeable=false, PortPinId=1, PortPinInitialMode=PORT_PIN_MODE_DIO, PortPinLevelValue=PORT_PIN_LEVEL_LOW, PortPinPullMode=PORT_PIN_PULL_NONE, PortPinDriveStrength=0, PortPinReadback=true
          CANWK_EN: PortPinDirection=PORT_PIN_IN, PortPinDirectionChangeable=false, PortPinId=2, PortPinInitialMode=PORT_PIN_MODE_DIO, PortPinLevelValue=PORT_PIN_LEVEL_LOW, PortPinPullMode=PORT_PIN_PULL_NONE, PortPinDriveStrength=0, PortPinReadback=true
          ETH_IRQ: PortPinDirection=PORT_PIN_IN, PortPinDirectionChangeable=false, PortPinId=3, PortPinInitialMode=PORT_PIN_MODE_ETH, PortPinLevelValue=PORT_PIN_LEVEL_LOW, PortPinPullMode=PORT_PIN_PULL_NONE, PortPinDriveStrength=0, PortPinReadback=true
          MM_FRAME_START: PortPinDirection=PORT_PIN_OUT, PortPinDirectionChangeable=false, PortPinId=4, PortPinInitialMode=PORT_PIN_MODE_DIO, PortPinLevelValue=PORT_PIN_LEVEL_LOW, PortPinPullMode=PORT_PIN_PULL_NONE, PortPinDriveStrength=0, PortPinReadback=true
          PIN_POSITION: PortPinDirection=PORT_PIN_IN, PortPinDirectionChangeable=false, PortPinId=5, PortPinInitialMode=PORT_PIN_MODE_DIO, PortPinLevelValue=PORT_PIN_LEVEL_LOW, PortPinPullMode=PORT_PIN_PULL_NONE, PortPinDriveStrength=0, PortPinReadback=true
          UART_RX: PortPinDirection=PORT_PIN_IN, PortPinDirectionChangeable=false, PortPinId=6, PortPinInitialMode=PORT_PIN_MODE_UART, PortPinLevelValue=PORT_PIN_LEVEL_LOW, PortPinPullMode=PORT_PIN_PULL_NONE, PortPinDriveStrength=0, PortPinReadback=true
          I2CM_SCL: PortPinDirection=PORT_PIN_OUT, PortPinDirectionChangeable=false, PortPinId=7, PortPinInitialMode=PORT_PIN_MODE_I2C, PortPinLevelValue=PORT_PIN_LEVEL_LOW, PortPinPullMode=PORT_PIN_PULL_NONE, PortPinDriveStrength=15, PortPinReadback=true
          I2CM_SDA: PortPinDirection=PORT_PIN_IN, PortPinDirectionChangeable=true, PortPinId=8, PortPinInitialMode=PORT_PIN_MODE_I2C, PortPinLevelValue=PORT_PIN_LEVEL_LOW, PortPinPullMode=PORT_PIN_PULL_NONE, PortPinDriveStrength=15, PortPinReadback=true
          GPIO8_DEBUG_DETECT: PortPinDirection=PORT_PIN_IN, PortPinDirectionChangeable=false, PortPinId=9, PortPinInitialMode=PORT_PIN_MODE_DIO, PortPinLevelValue=PORT_PIN_LEVEL_LOW, PortPinPullMode=PORT_PIN_PULL_DOWN, PortPinDriveStrength=0, PortPinReadback=true
          GPIO9_TOD: PortPinDirection=PORT_PIN_OUT, PortPinDirectionChangeable=false, PortPinId=10, PortPinInitialMode=PORT_PIN_MODE_DIO, PortPinLevelValue=PORT_PIN_LEVEL_HIGH, PortPinPullMode=PORT_PIN_PULL_NONE, PortPinDriveStrength=0, PortPinReadback=true
          GPIO10_ERR_N: PortPinDirection=PORT_PIN_IN, PortPinDirectionChangeable=true, PortPinId=11, PortPinInitialMode=PORT_PIN_MODE_DIO, PortPinLevelValue=PORT_PIN_LEVEL_LOW, PortPinPullMode=PORT_PIN_PULL_NONE, PortPinDriveStrength=0, PortPinReadback=true
          GPIO11_FPGA_RST_N: PortPinDirection=PORT_PIN_IN, PortPinDirectionChangeable=true, PortPinId=12, PortPinInitialMode=PORT_PIN_MODE_DIO, PortPinLevelValue=PORT_PIN_LEVEL_LOW, PortPinPullMode=PORT_PIN_PULL_NONE, PortPinDriveStrength=0, PortPinReadback=true
          GPIO12_HSD_FAULT: PortPinDirection=PORT_PIN_IN, PortPinDirectionChangeable=true, PortPinId=13, PortPinInitialMode=PORT_PIN_MODE_DIO, PortPinLevelValue=PORT_PIN_LEVEL_LOW, PortPinPullMode=PORT_PIN_PULL_NONE, PortPinDriveStrength=0, PortPinReadback=true
          GP_QSPI_D3: PortPinDirection=PORT_PIN_IN, PortPinDirectionChangeable=true, PortPinId=14, PortPinInitialMode=PORT_PIN_MODE_SPI, PortPinLevelValue=PORT_PIN_LEVEL_LOW, PortPinPullMode=PORT_PIN_PULL_NONE, PortPinDriveStrength=0, PortPinReadback=true
          ENET_PHYRSTB: PortPinDirection=PORT_PIN_OUT, PortPinDirectionChangeable=false, PortPinId=15, PortPinInitialMode=PORT_PIN_MODE_DIO, PortPinLevelValue=PORT_PIN_LEVEL_HIGH, PortPinPullMode=PORT_PIN_PULL_NONE, PortPinDriveStrength=15, PortPinReadback=false
          PWM_1: PortPinDirection=PORT_PIN_OUT, PortPinDirectionChangeable=false, PortPinId=16, PortPinInitialMode=PORT_PIN_MODE_PWM, PortPinLevelValue=PORT_PIN_LEVEL_LOW, PortPinPullMode=PORT_PIN_PULL_NONE, PortPinDriveStrength=15, PortPinReadback=false
          GPIO16_ERR_N_HSD_EN: PortPinDirection=PORT_PIN_IN, PortPinDirectionChangeable=false, PortPinId=17, PortPinInitialMode=PORT_PIN_MODE_DIO, PortPinLevelValue=PORT_PIN_LEVEL_HIGH, PortPinPullMode=PORT_PIN_PULL_NONE, PortPinDriveStrength=0, PortPinReadback=true
          POS_GND_EN: PortPinDirection=PORT_PIN_OUT, PortPinDirectionChangeable=false, PortPinId=18, PortPinInitialMode=PORT_PIN_MODE_DIO, PortPinLevelValue=PORT_PIN_LEVEL_HIGH, PortPinPullMode=PORT_PIN_PULL_NONE, PortPinDriveStrength=0, PortPinReadback=true
          CAN0_RXD: PortPinDirection=PORT_PIN_IN, PortPinDirectionChangeable=false, PortPinId=19, PortPinInitialMode=PORT_PIN_MODE_CAN, PortPinLevelValue=PORT_PIN_LEVEL_LOW, PortPinPullMode=PORT_PIN_PULL_NONE, PortPinDriveStrength=7, PortPinReadback=true
          CAN0_TXD: PortPinDirection=PORT_PIN_OUT, PortPinDirectionChangeable=false, PortPinId=20, PortPinInitialMode=PORT_PIN_MODE_CAN, PortPinLevelValue=PORT_PIN_LEVEL_LOW, PortPinPullMode=PORT_PIN_PULL_NONE, PortPinDriveStrength=7, PortPinReadback=true
          CAN0_STDBY: PortPinDirection=PORT_PIN_OUT, PortPinDirectionChangeable=true, PortPinId=21, PortPinInitialMode=PORT_PIN_MODE_CAN, PortPinLevelValue=PORT_PIN_LEVEL_LOW, PortPinPullMode=PORT_PIN_PULL_NONE, PortPinDriveStrength=0, PortPinReadback=true
          CAN1_RXD: PortPinDirection=PORT_PIN_IN, PortPinDirectionChangeable=false, PortPinId=22, PortPinInitialMode=PORT_PIN_MODE_CAN, PortPinLevelValue=PORT_PIN_LEVEL_LOW, PortPinPullMode=PORT_PIN_PULL_NONE, PortPinDriveStrength=7, PortPinReadback=true
          CAN1_TXD: PortPinDirection=PORT_PIN_OUT, PortPinDirectionChangeable=false, PortPinId=23, PortPinInitialMode=PORT_PIN_MODE_CAN, PortPinLevelValue=PORT_PIN_LEVEL_LOW, PortPinPullMode=PORT_PIN_PULL_NONE, PortPinDriveStrength=7, PortPinReadback=true
          CAN1_STDBY: PortPinDirection=PORT_PIN_OUT, PortPinDirectionChangeable=false, PortPinId=24, PortPinInitialMode=PORT_PIN_MODE_CAN, PortPinLevelValue=PORT_PIN_LEVEL_LOW, PortPinPullMode=PORT_PIN_PULL_NONE, PortPinDriveStrength=0, PortPinReadback=true
          ETH_MDIO: PortPinDirection=PORT_PIN_OUT, PortPinDirectionChangeable=true, PortPinId=25, PortPinInitialMode=PORT_PIN_MODE_ETH, PortPinLevelValue=PORT_PIN_LEVEL_LOW, PortPinPullMode=PORT_PIN_PULL_NONE, PortPinDriveStrength=0, PortPinReadback=true
          ETH_MDC: PortPinDirection=PORT_PIN_OUT, PortPinDirectionChangeable=false, PortPinId=26, PortPinInitialMode=PORT_PIN_MODE_ETH, PortPinLevelValue=PORT_PIN_LEVEL_LOW, PortPinPullMode=PORT_PIN_PULL_NONE, PortPinDriveStrength=0, PortPinReadback=true
    PortGeneral:
      PortDevErrorDetect = false
      PortSetPinDirectionApi = false
      PortSetPinModeApi = false
      PortVersionInfoApi = false
      PortHardwareVariant = PORT_B0_HARDWARE_VARIANT
      PortSafetyEnable = false
      PortSafetyUserCallout = NULL_PTR
      PortEnableInitCheck = true
