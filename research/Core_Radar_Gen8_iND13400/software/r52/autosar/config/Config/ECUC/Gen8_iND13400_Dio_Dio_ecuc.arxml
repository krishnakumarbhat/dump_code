AUTOSAR XML (schema 00053)
package /ActiveEcuC
  module config Dio: implementation-config-variant=VARIANT-PRE-COMPILE, module-description=Dio_Impl
    DioConfig
      3 x DioPort:
        DioPort: DioPortId=0
          A2_A3_MARS_RESET_N (DioChannel): DioChannelId=0
          DioChannelGroup: DioChannelGroupIdentification=0, DioPortMask=255, DioPortOffset=0
          A2_A3_MM_FRAME_START (DioChannel): DioChannelId=3
          A2_A3_CANWK_EN (DioChannel): DioChannelId=1
        DioPort_002: DioPortId=2
          A2_A3_ERRN_HSDEN (DioChannel): DioChannelId=16
          DioChannelGroup_2 (DioChannelGroup): DioChannelGroupIdentification=0, DioPortMask=255, DioPortOffset=0
          A2_A3_POS_GND_EN (DioChannel): DioChannelId=17
        DioPort_001: DioPortId=1
          A3_DEBUG_DETECT (DioChannel): DioChannelId=8
          DioChannelGroup_1 (DioChannelGroup): DioChannelGroupIdentification=0, DioPortMask=255, DioPortOffset=0
          4 x DioChannel:
            A3_TOD: DioChannelId=9
            A3_ERR_N: DioChannelId=10
            A3_FPGA_RST_N: DioChannelId=11
            A3_HSD_FAULT: DioChannelId=12
    DioGeneral: DioDevErrorDetect=false, DioFlipChannelApi=true, DioMaskedWritePortApi=false, DioVersionInfoApi=false, DioHardwareVariantRef=PortGeneral
