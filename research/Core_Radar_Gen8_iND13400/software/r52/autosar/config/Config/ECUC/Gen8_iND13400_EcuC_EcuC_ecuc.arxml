AUTOSAR XML (schema 00053)
package /ActiveEcuC
  module config EcuC: implementation-config-variant=VARIANT-PRE-COMPILE, module-description=EcuC_Impl
    EcucPduCollection: PduIdTypeEnum=UINT16, PduLengthTypeEnum=UINT16
      735 x Pdu:
        RDR_LOGGING_TX: PduLength=1500, J1939Requestable=false
        RDR_XCP_ETH_RX: PduLength=1448, J1939Requestable=false
        RDR_XCP_ETH_TX: PduLength=1448, J1939Requestable=false
        RDR_TRACKER_OBJ_004_oPCAN_RADAR_067dfb3d_Tx: DynamicLength=false, PduLength=64, J1939Requestable=false, SysTPduToFrameMappingRef=RDR_TRACKER_OBJ_004
        RDR_TRACKER_OBJ_004_oPCAN_RADAR_33a84845_Tx: DynamicLength=false, PduLength=64, J1939Requestable=false
        SYS_VEHICLE_STATUS_oPCAN_RADAR_9bbcdf4b_Rx: DynamicLength=false, PduLength=64, J1939Requestable=false, SysTPduToFrameMappingRef=SYS_VEHICLE_STATUS
        RDR_VEH_UDP_STREAM_RX: PduLength=1500, J1939Requestable=false
        RDR_DETECTION_093_096_oPCAN_RADAR_8d117197_Tx: DynamicLength=false, PduLength=64, J1939Requestable=false, SysTPduToFrameMappingRef=RDR_DETECTION_093_096
        RDR_DETECTION_193_196_oPCAN_RADAR_3c6e99d1_Tx: DynamicLength=false, PduLength=64, J1939Requestable=false
        RDR_DETECTION_273_276_oPCAN_RADAR_5c91dc09_Tx: DynamicLength=false, PduLength=64, J1939Requestable=false, SysTPduToFrameMappingRef=RDR_DETECTION_273_276
        RDR_TRACKER_OBJ_053_oPCAN_RADAR_302b1c0a_Tx: DynamicLength=false, PduLength=64, J1939Requestable=false, SysTPduToFrameMappingRef=RDR_TRACKER_OBJ_053
        RDR_DETECTION_153_156_oPCAN_RADAR_0a6271f6_Tx: DynamicLength=false, PduLength=64, J1939Requestable=false
        RDR_DETECTION_169_172_oPCAN_RADAR_f31fddf6_Tx: DynamicLength=false, PduLength=64, J1939Requestable=false
        RDR_DETECTION_125_128_oPCAN_RADAR_d3536aea_Tx: DynamicLength=false, PduLength=64, J1939Requestable=false
        RDR_DETECTION_033_036_oPCAN_RADAR_4c775b19_Tx: DynamicLength=false, PduLength=64, J1939Requestable=false, SysTPduToFrameMappingRef=RDR_DETECTION_033_036
        RDR_TRACKER_OBJ_035_oPCAN_RADAR_5d099894_Tx: DynamicLength=false, PduLength=64, J1939Requestable=false, SysTPduToFrameMappingRef=RDR_TRACKER_OBJ_035
        RDR_TRACKER_OBJ_064_oPCAN_RADAR_cb6a03f3_Tx: DynamicLength=false, PduLength=64, J1939Requestable=false
        RDR_DETECTION_325_328_oPCAN_RADAR_0f61dd8a_Tx: DynamicLength=false, PduLength=64, J1939Requestable=false
        RDR_OBJ_HEADER_002_oPCAN_RADAR_018ea437_Tx: DynamicLength=false, PduLength=64, J1939Requestable=false, SysTPduToFrameMappingRef=RDR_OBJ_HEADER_002
        RDR_TRACKER_OBJ_003_oPCAN_RADAR_4edb4e1d_Tx: DynamicLength=false, PduLength=64, J1939Requestable=false
        RDR_DETECTION_089_092_oPCAN_RADAR_4fb0c14f_Tx: DynamicLength=false, PduLength=64, J1939Requestable=false
        RDR_DETECTION_181_184_oPCAN_RADAR_fa53ebca_Tx: DynamicLength=false, PduLength=64, J1939Requestable=false
        RDR_DETECTION_381_384_oPCAN_RADAR_cb27f638_Tx: DynamicLength=false, PduLength=64, J1939Requestable=false, SysTPduToFrameMappingRef=RDR_DETECTION_381_384
        RDR_DETECTION_301_304_oPCAN_RADAR_8325835f_Tx: DynamicLength=false, PduLength=64, J1939Requestable=false, SysTPduToFrameMappingRef=RDR_DETECTION_301_304
        RDR_DETECTION_133_136_oPCAN_RADAR_cd604778_Tx: DynamicLength=false, PduLength=64, J1939Requestable=false, SysTPduToFrameMappingRef=RDR_DETECTION_133_136
        RDR_DETECTION_209_212_oPCAN_RADAR_b78ac615_Tx: DynamicLength=false, PduLength=64, J1939Requestable=false
        RDR_TRACKER_OBJ_053_oPCAN_RADAR_ca782070_Tx: DynamicLength=false, PduLength=64, J1939Requestable=false
        RDR_TRACKER_OBJ_061_oPCAN_RADAR_d645b0e0_Tx: DynamicLength=false, PduLength=64, J1939Requestable=false
        RDR_HEADER_001_oPCAN_RADAR_0cd81ee7_Tx: DynamicLength=false, PduLength=64, J1939Requestable=false
        RDR_DETECTION_073_076_oPCAN_RADAR_85cee28a_Tx: DynamicLength=false, PduLength=64, J1939Requestable=false, SysTPduToFrameMappingRef=RDR_DETECTION_073_076
        SYS_TIME_SYNC_oPCAN_RADAR_ba7b9b28_Rx: DynamicLength=false, PduLength=8, J1939Requestable=false, SysTPduToFrameMappingRef=SYS_TIME_SYNC, variation-point=post-build-variant-condition{matching-criterion=RDR_POS, value=0}
        RDR_DETECTION_141_144_oPCAN_RADAR_cc5f03ed_Tx: DynamicLength=false, PduLength=64, J1939Requestable=false
        RDR_DETECTION_309_312_oPCAN_RADAR_d9939da5_Tx: DynamicLength=false, PduLength=64, J1939Requestable=false
        RDR_TRACKER_OBJ_005_oPCAN_RADAR_308f6bce_Tx: DynamicLength=false, PduLength=64, J1939Requestable=false, SysTPduToFrameMappingRef=RDR_TRACKER_OBJ_005
        RDR_TRACKER_OBJ_025_oPCAN_RADAR_798bc9a2_Tx: DynamicLength=false, PduLength=64, J1939Requestable=false, SysTPduToFrameMappingRef=RDR_TRACKER_OBJ_025
        RDR_DETECTION_377_380_oPCAN_RADAR_b793255c_Tx: DynamicLength=false, PduLength=64, J1939Requestable=false
        RDR_DETECTION_361_364_oPCAN_RADAR_f4d71ba3_Tx: DynamicLength=false, PduLength=64, J1939Requestable=false
        RDR_DETECTION_061_064_oPCAN_RADAR_9bb047c7_Tx: DynamicLength=false, PduLength=64, J1939Requestable=false, SysTPduToFrameMappingRef=RDR_DETECTION_061_064
        RDR_DETECTION_117_120_oPCAN_RADAR_b7eaf422_Tx: DynamicLength=false, PduLength=64, J1939Requestable=false
        RDR_DETECTION_233_236_oPCAN_RADAR_4ef76a15_Tx: DynamicLength=false, PduLength=64, J1939Requestable=false
        RDR_DETECTION_069_072_oPCAN_RADAR_9d068646_Tx: DynamicLength=false, PduLength=64, J1939Requestable=false
        RDR_DETECTION_113_116_oPCAN_RADAR_44041891_Tx: DynamicLength=false, PduLength=64, J1939Requestable=false, SysTPduToFrameMappingRef=RDR_DETECTION_113_116
        RDR_DETECTION_177_180_oPCAN_RADAR_dc49f20d_Tx: DynamicLength=false, PduLength=64, J1939Requestable=false, SysTPduToFrameMappingRef=RDR_DETECTION_177_180
        RDR_DETECTION_325_328_oPCAN_RADAR_d33d481c_Tx: DynamicLength=false, PduLength=64, J1939Requestable=false, SysTPduToFrameMappingRef=RDR_DETECTION_325_328
        RDR_TRACKER_OBJ_039_oPCAN_RADAR_ea265a81_Tx: DynamicLength=false, PduLength=64, J1939Requestable=false, SysTPduToFrameMappingRef=RDR_TRACKER_OBJ_039
        RDR_TRACKER_OBJ_034_oPCAN_RADAR_4fc96d9e_Tx: DynamicLength=false, PduLength=64, J1939Requestable=false
        RDR_TRACKER_OBJ_052_oPCAN_RADAR_17eef9f5_Tx: DynamicLength=false, PduLength=64, J1939Requestable=false
        RDR_DETECTION_089_092_oPCAN_RADAR_dd644ab8_Tx: DynamicLength=false, PduLength=64, J1939Requestable=false, SysTPduToFrameMappingRef=RDR_DETECTION_089_092
        RDR_TRACKER_OBJ_016_oPCAN_RADAR_cefb1c78_Tx: DynamicLength=false, PduLength=64, J1939Requestable=false
        RDR_TRACKER_OBJ_023_oPCAN_RADAR_cfa4ab88_Tx: DynamicLength=false, PduLength=64, J1939Requestable=false, SysTPduToFrameMappingRef=RDR_TRACKER_OBJ_023
        RDR_DETECTION_013_016_oPCAN_RADAR_c51304f0_Tx: DynamicLength=false, PduLength=64, J1939Requestable=false, SysTPduToFrameMappingRef=RDR_DETECTION_013_016
        RDR_DETECTION_245_248_oPCAN_RADAR_12f7b207_Tx: DynamicLength=false, PduLength=64, J1939Requestable=false, SysTPduToFrameMappingRef=RDR_DETECTION_245_248
        RDR_DETECTION_013_016_oPCAN_RADAR_767f725b_Tx: DynamicLength=false, PduLength=64, J1939Requestable=false
        RDR_DETECTION_101_104_oPCAN_RADAR_de5b5bf0_Tx: DynamicLength=false, PduLength=64, J1939Requestable=false
        RDR_TRACKER_OBJ_046_oPCAN_RADAR_f9919e03_Tx: DynamicLength=false, PduLength=64, J1939Requestable=false, SysTPduToFrameMappingRef=RDR_TRACKER_OBJ_046
        RDR_ALIGNMENT_STATUS_002_oPCAN_RADAR_604bf216_Tx: DynamicLength=false, PduLength=64, J1939Requestable=false
        RDR_DETECTION_029_032_oPCAN_RADAR_1c026036_Tx: DynamicLength=false, PduLength=64, J1939Requestable=false, SysTPduToFrameMappingRef=RDR_DETECTION_029_032
        RDR_TRACKER_OBJ_040_oPCAN_RADAR_eabdadc8_Tx: DynamicLength=false, PduLength=64, J1939Requestable=false
        RDR_TRACKER_OBJ_012_oPCAN_RADAR_0e4276ee_Tx: DynamicLength=false, PduLength=64, J1939Requestable=false
        RDR_TRACKER_OBJ_045_oPCAN_RADAR_f7921edb_Tx: DynamicLength=false, PduLength=64, J1939Requestable=false
        RDR_DETECTION_297_300_oPCAN_RADAR_4a05a9bb_Tx: DynamicLength=false, PduLength=64, J1939Requestable=false
        RDR_DETECTION_129_132_oPCAN_RADAR_e11b85eb_Tx: DynamicLength=false, PduLength=64, J1939Requestable=false
        RDR_TRACKER_OBJ_018_oPCAN_RADAR_341d10c8_Tx: DynamicLength=false, PduLength=64, J1939Requestable=false
        RDR_ALIGNMENT_STATUS_002_oPCAN_RADAR_14836740_Tx: DynamicLength=false, PduLength=64, J1939Requestable=false, SysTPduToFrameMappingRef=RDR_ALIGNMENT_STATUS_002
        RDR_DETECTION_357_360_oPCAN_RADAR_e118584e_Tx: DynamicLength=false, PduLength=64, J1939Requestable=false, SysTPduToFrameMappingRef=RDR_DETECTION_357_360
        RDR_DETECTION_253_256_oPCAN_RADAR_d5f583e0_Tx: DynamicLength=false, PduLength=64, J1939Requestable=false, SysTPduToFrameMappingRef=RDR_DETECTION_253_256
        RDR_HEADER_001_oPCAN_RADAR_48304dbd_Tx: DynamicLength=false, PduLength=64, J1939Requestable=false, SysTPduToFrameMappingRef=RDR_HEADER_001
        RDR_DETECTION_285_288_oPCAN_RADAR_a1ca992e_Tx: DynamicLength=false, PduLength=64, J1939Requestable=false
        RDR_ALIGNMENT_STATUS_001_oPCAN_RADAR_dd819ed8_Tx: DynamicLength=false, PduLength=64, J1939Requestable=false
        RDR_DETECTION_277_280_oPCAN_RADAR_8401d0ef_Tx: DynamicLength=false, PduLength=64, J1939Requestable=false, SysTPduToFrameMappingRef=RDR_DETECTION_277_280
        RDR_TRACKER_OBJ_059_oPCAN_RADAR_f0274656_Tx: DynamicLength=false, PduLength=64, J1939Requestable=false
        RDR_DETECTION_389_392_oPCAN_RADAR_852c685a_Tx: DynamicLength=false, PduLength=64, J1939Requestable=false, SysTPduToFrameMappingRef=RDR_DETECTION_389_392
        RDR_DETECTION_197_200_oPCAN_RADAR_50a8f4fa_Tx: DynamicLength=false, PduLength=64, J1939Requestable=false
        RDR_DETECTION_241_244_oPCAN_RADAR_cb8b26ad_Tx: DynamicLength=false, PduLength=64, J1939Requestable=false, SysTPduToFrameMappingRef=RDR_DETECTION_241_244
        RDR_TRACKER_OBJ_055_oPCAN_RADAR_86047e20_Tx: DynamicLength=false, PduLength=64, J1939Requestable=false, SysTPduToFrameMappingRef=RDR_TRACKER_OBJ_055
        RDR_DETECTION_369_372_oPCAN_RADAR_2f2d6a96_Tx: DynamicLength=false, PduLength=64, J1939Requestable=false
        RDR_TRACKER_OBJ_030_oPCAN_RADAR_b0314bab_Tx: DynamicLength=false, PduLength=64, J1939Requestable=false, SysTPduToFrameMappingRef=RDR_TRACKER_OBJ_030
        RDR_DETECTION_385_388_oPCAN_RADAR_125b6292_Tx: DynamicLength=false, PduLength=64, J1939Requestable=false, SysTPduToFrameMappingRef=RDR_DETECTION_385_388
        RDR_TRACKER_OBJ_027_oPCAN_RADAR_6f0ce026_Tx: DynamicLength=false, PduLength=64, J1939Requestable=false
        RDR_TRACKER_OBJ_056_oPCAN_RADAR_d7579363_Tx: DynamicLength=false, PduLength=64, J1939Requestable=false
        RDR_DETECTION_017_020_oPCAN_RADAR_d9f3af92_Tx: DynamicLength=false, PduLength=64, J1939Requestable=false
        RDR_DETECTION_209_212_oPCAN_RADAR_4c39015c_Tx: DynamicLength=false, PduLength=64, J1939Requestable=false, SysTPduToFrameMappingRef=RDR_DETECTION_209_212
        RDR_DETECTION_305_308_oPCAN_RADAR_ebdb72a4_Tx: DynamicLength=false, PduLength=64, J1939Requestable=false
        RDR_DETECTION_105_108_oPCAN_RADAR_83062976_Tx: DynamicLength=false, PduLength=64, J1939Requestable=false, SysTPduToFrameMappingRef=RDR_DETECTION_105_108
        RDR_DETECTION_069_072_oPCAN_RADAR_d5bbd9a5_Tx: DynamicLength=false, PduLength=64, J1939Requestable=false, SysTPduToFrameMappingRef=RDR_DETECTION_069_072
        RDR_DETECTION_221_224_oPCAN_RADAR_88ca180e_Tx: DynamicLength=false, PduLength=64, J1939Requestable=false
        RDR_DETECTION_389_392_oPCAN_RADAR_fd9b2d9f_Tx: DynamicLength=false, PduLength=64, J1939Requestable=false
        RDR_TRACKER_OBJ_042_oPCAN_RADAR_8ae11883_Tx: DynamicLength=false, PduLength=64, J1939Requestable=false
        RDR_DETECTION_309_312_oPCAN_RADAR_cd2e1d3d_Tx: DynamicLength=false, PduLength=64, J1939Requestable=false, SysTPduToFrameMappingRef=RDR_DETECTION_309_312
        RDR_DETECTION_017_020_oPCAN_RADAR_70e9c33f_Tx: DynamicLength=false, PduLength=64, J1939Requestable=false, SysTPduToFrameMappingRef=RDR_DETECTION_017_020
        RDR_TRACKER_OBJ_049_oPCAN_RADAR_6d28a720_Tx: DynamicLength=false, PduLength=64, J1939Requestable=false
        RDR_DETECTION_081_084_oPCAN_RADAR_936fd4da_Tx: DynamicLength=false, PduLength=64, J1939Requestable=false, SysTPduToFrameMappingRef=RDR_DETECTION_081_084
        RDR_DETECTION_109_112_oPCAN_RADAR_05a12ac5_Tx: DynamicLength=false, PduLength=64, J1939Requestable=false
        RDR_DETECTION_189_192_oPCAN_RADAR_21a99aff_Tx: DynamicLength=false, PduLength=64, J1939Requestable=false
        RDR_DETECTION_317_320_oPCAN_RADAR_28a1e1dd_Tx: DynamicLength=false, PduLength=64, J1939Requestable=false, SysTPduToFrameMappingRef=RDR_DETECTION_317_320
        RDR_TRACKER_OBJ_029_oPCAN_RADAR_95eaec96_Tx: DynamicLength=false, PduLength=64, J1939Requestable=false
        RDR_TRACKER_OBJ_054_oPCAN_RADAR_b70b2628_Tx: DynamicLength=false, PduLength=64, J1939Requestable=false
        RDR_TRACKER_OBJ_033_oPCAN_RADAR_eb26fabe_Tx: DynamicLength=false, PduLength=64, J1939Requestable=false, SysTPduToFrameMappingRef=RDR_TRACKER_OBJ_033
        RDR_DETECTION_121_124_oPCAN_RADAR_3ae1f4de_Tx: DynamicLength=false, PduLength=64, J1939Requestable=false
        RDR_TRACKER_OBJ_040_oPCAN_RADAR_4fbefc29_Tx: DynamicLength=false, PduLength=64, J1939Requestable=false, SysTPduToFrameMappingRef=RDR_TRACKER_OBJ_040
        RDR_DETECTION_121_124_oPCAN_RADAR_d31ee235_Tx: DynamicLength=false, PduLength=64, J1939Requestable=false, SysTPduToFrameMappingRef=RDR_DETECTION_121_124
        RDR_DETECTION_277_280_oPCAN_RADAR_d98a7eec_Tx: DynamicLength=false, PduLength=64, J1939Requestable=false
        RDR_DETECTION_293_296_oPCAN_RADAR_544e4f14_Tx: DynamicLength=false, PduLength=64, J1939Requestable=false, SysTPduToFrameMappingRef=RDR_DETECTION_293_296
        RDR_DETECTION_373_376_oPCAN_RADAR_dd86c068_Tx: DynamicLength=false, PduLength=64, J1939Requestable=false, SysTPduToFrameMappingRef=RDR_DETECTION_373_376
        RDR_TRACKER_OBJ_022_oPCAN_RADAR_72235335_Tx: DynamicLength=false, PduLength=64, J1939Requestable=false
        RDR_TRACKER_OBJ_028_oPCAN_RADAR_487c3513_Tx: DynamicLength=false, PduLength=64, J1939Requestable=false
        RDR_DETECTION_181_184_oPCAN_RADAR_1278c8bb_Tx: DynamicLength=false, PduLength=64, J1939Requestable=false, SysTPduToFrameMappingRef=RDR_DETECTION_181_184
        RDR_DETECTION_333_336_oPCAN_RADAR_143f79fb_Tx: DynamicLength=false, PduLength=64, J1939Requestable=false, SysTPduToFrameMappingRef=RDR_DETECTION_333_336
        RDR_DETECTION_001_004_oPCAN_RADAR_db6da1bd_Tx: DynamicLength=false, PduLength=64, J1939Requestable=false, SysTPduToFrameMappingRef=RDR_DETECTION_001_004
        RDR_TRACKER_OBJ_039_oPCAN_RADAR_08e50de0_Tx: DynamicLength=false, PduLength=64, J1939Requestable=false
        RDR_DETECTION_337_340_oPCAN_RADAR_96ce6377_Tx: DynamicLength=false, PduLength=64, J1939Requestable=false
        RDR_DETECTION_097_100_oPCAN_RADAR_96371edb_Tx: DynamicLength=false, PduLength=64, J1939Requestable=false
        RDR_TRACKER_OBJ_022_oPCAN_RADAR_f9563b7b_Tx: DynamicLength=false, PduLength=64, J1939Requestable=false, SysTPduToFrameMappingRef=RDR_TRACKER_OBJ_022
        RDR_TRACKER_OBJ_043_oPCAN_RADAR_14a94d3c_Tx: DynamicLength=false, PduLength=64, J1939Requestable=false, SysTPduToFrameMappingRef=RDR_TRACKER_OBJ_043
        RDR_DETECTION_145_148_oPCAN_RADAR_25ed9dd9_Tx: DynamicLength=false, PduLength=64, J1939Requestable=false
        RDR_TRACKER_OBJ_014_oPCAN_RADAR_22ffaa0b_Tx: DynamicLength=false, PduLength=64, J1939Requestable=false, SysTPduToFrameMappingRef=RDR_TRACKER_OBJ_014
        RDR_DETECTION_033_036_oPCAN_RADAR_92c5dd75_Tx: DynamicLength=false, PduLength=64, J1939Requestable=false
        RDR_DETECTION_261_264_oPCAN_RADAR_9ace4013_Tx: DynamicLength=false, PduLength=64, J1939Requestable=false
        RDR_TRACKER_OBJ_044_oPCAN_RADAR_2a04c75e_Tx: DynamicLength=false, PduLength=64, J1939Requestable=false
        RDR_DETECTION_321_324_oPCAN_RADAR_0a41dcb6_Tx: DynamicLength=false, PduLength=64, J1939Requestable=false, SysTPduToFrameMappingRef=RDR_DETECTION_321_324
        RDR_TRACKER_OBJ_019_oPCAN_RADAR_a322f8ed_Tx: DynamicLength=false, PduLength=64, J1939Requestable=false, SysTPduToFrameMappingRef=RDR_TRACKER_OBJ_019
        RDR_TRACKER_OBJ_041_oPCAN_RADAR_794c6cda_Tx: DynamicLength=false, PduLength=64, J1939Requestable=false, SysTPduToFrameMappingRef=RDR_TRACKER_OBJ_041
        RDR_DETECTION_197_200_oPCAN_RADAR_8448b9bd_Tx: DynamicLength=false, PduLength=64, J1939Requestable=false, SysTPduToFrameMappingRef=RDR_DETECTION_197_200
        RDR_TRACKER_OBJ_001_oPCAN_RADAR_2e87fb56_Tx: DynamicLength=false, PduLength=64, J1939Requestable=false
        RDR_DETECTION_049_052_oPCAN_RADAR_79bc2968_Tx: DynamicLength=false, PduLength=64, J1939Requestable=false
        RDR_TRACKER_OBJ_051_oPCAN_RADAR_aa24953b_Tx: DynamicLength=false, PduLength=64, J1939Requestable=false
        RDR_DETECTION_273_276_oPCAN_RADAR_5cf33208_Tx: DynamicLength=false, PduLength=64, J1939Requestable=false
        RDR_DETECTION_289_292_oPCAN_RADAR_043b743b_Tx: DynamicLength=false, PduLength=64, J1939Requestable=false, SysTPduToFrameMappingRef=RDR_DETECTION_289_292
        RDR_DETECTION_053_056_oPCAN_RADAR_0caabd63_Tx: DynamicLength=false, PduLength=64, J1939Requestable=false, SysTPduToFrameMappingRef=RDR_DETECTION_053_056
        RDR_DIAG_RESP_PHYS_oPCAN_RADAR_574db004_Tx: DynamicLength=true, PduLength=64, J1939Requestable=false
        RDR_TRACKER_OBJ_026_oPCAN_RADAR_229c78b7_Tx: DynamicLength=false, PduLength=64, J1939Requestable=false, SysTPduToFrameMappingRef=RDR_TRACKER_OBJ_026
        RDR_DETECTION_065_068_oPCAN_RADAR_42ccd36d_Tx: DynamicLength=false, PduLength=64, J1939Requestable=false, SysTPduToFrameMappingRef=RDR_DETECTION_065_068
        RDR_TRACKER_OBJ_047_oPCAN_RADAR_cf630ef0_Tx: DynamicLength=false, PduLength=64, J1939Requestable=false, SysTPduToFrameMappingRef=RDR_TRACKER_OBJ_047
        RDR_DETECTION_245_248_oPCAN_RADAR_97c67109_Tx: DynamicLength=false, PduLength=64, J1939Requestable=false
        RDR_OBJ_HEADER_002_oPCAN_RADAR_1ea433e3_Tx: DynamicLength=false, PduLength=64, J1939Requestable=false
        RDR_TRACKER_OBJ_033_oPCAN_RADAR_32ba6bc6_Tx: DynamicLength=false, PduLength=64, J1939Requestable=false
        RDR_TRACKER_OBJ_036_oPCAN_RADAR_061e2981_Tx: DynamicLength=false, PduLength=64, J1939Requestable=false, SysTPduToFrameMappingRef=RDR_TRACKER_OBJ_036
        RDR_TRACKER_OBJ_001_oPCAN_RADAR_eb452802_Tx: DynamicLength=false, PduLength=64, J1939Requestable=false, SysTPduToFrameMappingRef=RDR_TRACKER_OBJ_001
        RDR_TRACKER_OBJ_029_oPCAN_RADAR_cea40bb7_Tx: DynamicLength=false, PduLength=64, J1939Requestable=false, SysTPduToFrameMappingRef=RDR_TRACKER_OBJ_029
        RDR_DETECTION_381_384_oPCAN_RADAR_26615caa_Tx: DynamicLength=false, PduLength=64, J1939Requestable=false
        RDR_TRACKER_OBJ_027_oPCAN_RADAR_146ee844_Tx: DynamicLength=false, PduLength=64, J1939Requestable=false, SysTPduToFrameMappingRef=RDR_TRACKER_OBJ_027
        RDR_DETECTION_109_112_oPCAN_RADAR_147123be_Tx: DynamicLength=false, PduLength=64, J1939Requestable=false, SysTPduToFrameMappingRef=RDR_DETECTION_109_112
        RDR_DETECTION_341_344_oPCAN_RADAR_106db48d_Tx: DynamicLength=false, PduLength=64, J1939Requestable=false
        RDR_DETECTION_357_360_oPCAN_RADAR_79dc1b5f_Tx: DynamicLength=false, PduLength=64, J1939Requestable=false
        RDR_TRACKER_OBJ_050_oPCAN_RADAR_6b3cad1f_Tx: DynamicLength=false, PduLength=64, J1939Requestable=false, SysTPduToFrameMappingRef=RDR_TRACKER_OBJ_050
        RDR_DETECTION_041_044_oPCAN_RADAR_12d4182e_Tx: DynamicLength=false, PduLength=64, J1939Requestable=false, SysTPduToFrameMappingRef=RDR_DETECTION_041_044
        RDR_DETECTION_185_188_oPCAN_RADAR_13e175fe_Tx: DynamicLength=false, PduLength=64, J1939Requestable=false
        RDR_TRACKER_OBJ_057_oPCAN_RADAR_0ac14ae6_Tx: DynamicLength=false, PduLength=64, J1939Requestable=false
        RDR_TRACKER_OBJ_051_oPCAN_RADAR_5dce3dec_Tx: DynamicLength=false, PduLength=64, J1939Requestable=false, SysTPduToFrameMappingRef=RDR_TRACKER_OBJ_051
        RDR_DETECTION_065_068_oPCAN_RADAR_af4e6947_Tx: DynamicLength=false, PduLength=64, J1939Requestable=false
        RDR_STATUS_001_oPCAN_RADAR_deb478ca_Tx: DynamicLength=false, PduLength=64, J1939Requestable=false, SysTPduToFrameMappingRef=RDR_STATUS_001
        RDR_DETECTION_177_180_oPCAN_RADAR_6ba1923c_Tx: DynamicLength=false, PduLength=64, J1939Requestable=false
        RDR_TRACKER_OBJ_013_oPCAN_RADAR_a22258d2_Tx: DynamicLength=false, PduLength=64, J1939Requestable=false, SysTPduToFrameMappingRef=RDR_TRACKER_OBJ_013
        RDR_DETECTION_237_240_oPCAN_RADAR_f8d738c7_Tx: DynamicLength=false, PduLength=64, J1939Requestable=false
        RDR_DETECTION_137_140_oPCAN_RADAR_4afcd417_Tx: DynamicLength=false, PduLength=64, J1939Requestable=false
        RDR_DETECTION_045_048_oPCAN_RADAR_4bf4c669_Tx: DynamicLength=false, PduLength=64, J1939Requestable=false
        RDR_DETECTION_113_116_oPCAN_RADAR_186629eb_Tx: DynamicLength=false, PduLength=64, J1939Requestable=false
        RDR_DETECTION_185_188_oPCAN_RADAR_cb045c11_Tx: DynamicLength=false, PduLength=64, J1939Requestable=false, SysTPduToFrameMappingRef=RDR_DETECTION_185_188
        RDR_TRACKER_OBJ_009_oPCAN_RADAR_7484283b_Tx: DynamicLength=false, PduLength=64, J1939Requestable=false
        RDR_DETECTION_061_064_oPCAN_RADAR_46fcf773_Tx: DynamicLength=false, PduLength=64, J1939Requestable=false
        RDR_TRACKER_OBJ_047_oPCAN_RADAR_97ceab90_Tx: DynamicLength=false, PduLength=64, J1939Requestable=false
        RDR_DETECTION_253_256_oPCAN_RADAR_b8499d26_Tx: DynamicLength=false, PduLength=64, J1939Requestable=false
        RDR_TRACKER_OBJ_010_oPCAN_RADAR_f935e9c7_Tx: DynamicLength=false, PduLength=64, J1939Requestable=false, SysTPduToFrameMappingRef=RDR_TRACKER_OBJ_010
        RDR_TRACKER_OBJ_018_oPCAN_RADAR_95d0681e_Tx: DynamicLength=false, PduLength=64, J1939Requestable=false, SysTPduToFrameMappingRef=RDR_TRACKER_OBJ_018
        RDR_TRACKER_OBJ_026_oPCAN_RADAR_b29a39a3_Tx: DynamicLength=false, PduLength=64, J1939Requestable=false
        RDR_DETECTION_201_204_oPCAN_RADAR_02329f3e_Tx: DynamicLength=false, PduLength=64, J1939Requestable=false, SysTPduToFrameMappingRef=RDR_DETECTION_201_204
        RDR_DETECTION_297_300_oPCAN_RADAR_984db28e_Tx: DynamicLength=false, PduLength=64, J1939Requestable=false, SysTPduToFrameMappingRef=RDR_DETECTION_297_300
        RDR_DETECTION_265_268_oPCAN_RADAR_737cde27_Tx: DynamicLength=false, PduLength=64, J1939Requestable=false
        RDR_TRACKER_OBJ_025_oPCAN_RADAR_0f50556d_Tx: DynamicLength=false, PduLength=64, J1939Requestable=false
        RDR_TRACKER_OBJ_064_oPCAN_RADAR_dd701d89_Tx: DynamicLength=false, PduLength=64, J1939Requestable=false, SysTPduToFrameMappingRef=RDR_TRACKER_OBJ_064
        RDR_DETECTION_141_144_oPCAN_RADAR_93c3044f_Tx: DynamicLength=false, PduLength=64, J1939Requestable=false, SysTPduToFrameMappingRef=RDR_DETECTION_141_144
        RDR_DETECTION_237_240_oPCAN_RADAR_b2dbe68d_Tx: DynamicLength=false, PduLength=64, J1939Requestable=false, SysTPduToFrameMappingRef=RDR_DETECTION_237_240
        RDR_DETECTION_269_272_oPCAN_RADAR_41343126_Tx: DynamicLength=false, PduLength=64, J1939Requestable=false
        RDR_DETECTION_129_132_oPCAN_RADAR_9d157c57_Tx: DynamicLength=false, PduLength=64, J1939Requestable=false, SysTPduToFrameMappingRef=RDR_DETECTION_129_132
        RDR_DETECTION_201_204_oPCAN_RADAR_6c70b720_Tx: DynamicLength=false, PduLength=64, J1939Requestable=false
        RDR_TRACKER_OBJ_037_oPCAN_RADAR_f2030150_Tx: DynamicLength=false, PduLength=64, J1939Requestable=false
        RDR_DETECTION_029_032_oPCAN_RADAR_8f02de5b_Tx: DynamicLength=false, PduLength=64, J1939Requestable=false
        RDR_DETECTION_305_308_oPCAN_RADAR_5a5917f5_Tx: DynamicLength=false, PduLength=64, J1939Requestable=false, SysTPduToFrameMappingRef=RDR_DETECTION_305_308
        RDR_TRACKER_OBJ_037_oPCAN_RADAR_30ecb972_Tx: DynamicLength=false, PduLength=64, J1939Requestable=false, SysTPduToFrameMappingRef=RDR_TRACKER_OBJ_037
        RDR_DETECTION_337_340_oPCAN_RADAR_33ccfaec_Tx: DynamicLength=false, PduLength=64, J1939Requestable=false, SysTPduToFrameMappingRef=RDR_DETECTION_337_340
        RDR_TRACKER_OBJ_041_oPCAN_RADAR_372b744d_Tx: DynamicLength=false, PduLength=64, J1939Requestable=false
        RDR_DETECTION_249_252_oPCAN_RADAR_a58e9e08_Tx: DynamicLength=false, PduLength=64, J1939Requestable=false
        RDR_OBJ_STATUS_003_oPCAN_RADAR_84871644_Tx: DynamicLength=false, PduLength=64, J1939Requestable=false
        RDR_TRACKER_OBJ_009_oPCAN_RADAR_87a0a9db_Tx: DynamicLength=false, PduLength=64, J1939Requestable=false, SysTPduToFrameMappingRef=RDR_TRACKER_OBJ_009
        RDR_TRACKER_OBJ_010_oPCAN_RADAR_6e1ec3a5_Tx: DynamicLength=false, PduLength=64, J1939Requestable=false
        RDR_TRACKER_OBJ_045_oPCAN_RADAR_a2862f16_Tx: DynamicLength=false, PduLength=64, J1939Requestable=false, SysTPduToFrameMappingRef=RDR_TRACKER_OBJ_045
        RDR_DETECTION_093_096_oPCAN_RADAR_5277c261_Tx: DynamicLength=false, PduLength=64, J1939Requestable=false
        RDR_DETECTION_281_284_oPCAN_RADAR_4a30ea59_Tx: DynamicLength=false, PduLength=64, J1939Requestable=false, SysTPduToFrameMappingRef=RDR_DETECTION_281_284
        RDR_DETECTION_025_028_oPCAN_RADAR_8b756afe_Tx: DynamicLength=false, PduLength=64, J1939Requestable=false, SysTPduToFrameMappingRef=RDR_DETECTION_025_028
        RDR_DETECTION_397_400_oPCAN_RADAR_06e626f9_Tx: DynamicLength=false, PduLength=64, J1939Requestable=false
        RDR_DETECTION_137_140_oPCAN_RADAR_ea93c46f_Tx: DynamicLength=false, PduLength=64, J1939Requestable=false, SysTPduToFrameMappingRef=RDR_DETECTION_137_140
        RDR_CAPABILITY_oPCAN_RADAR_476dda7e_Tx: DynamicLength=false, PduLength=64, J1939Requestable=false, SysTPduToFrameMappingRef=RDR_CAPABILITY
        RDR_TRACKER_OBJ_007_oPCAN_RADAR_8e62248b_Tx: DynamicLength=false, PduLength=64, J1939Requestable=false
        RDR_TRACKER_OBJ_011_oPCAN_RADAR_b3881a20_Tx: DynamicLength=false, PduLength=64, J1939Requestable=false
        RDR_TRACKER_OBJ_017_oPCAN_RADAR_79e81b1e_Tx: DynamicLength=false, PduLength=64, J1939Requestable=false, SysTPduToFrameMappingRef=RDR_TRACKER_OBJ_017
        RDR_OBJ_STATUS_003_oPCAN_RADAR_a1f801b3_Tx: DynamicLength=false, PduLength=64, J1939Requestable=false, SysTPduToFrameMappingRef=RDR_OBJ_STATUS_003
        RDR_DETECTION_005_008_oPCAN_RADAR_59f09e74_Tx: DynamicLength=false, PduLength=64, J1939Requestable=false
        RDR_DETECTION_157_160_oPCAN_RADAR_384766cd_Tx: DynamicLength=false, PduLength=64, J1939Requestable=false, SysTPduToFrameMappingRef=RDR_DETECTION_157_160
        RDR_DETECTION_229_232_oPCAN_RADAR_c55d5eb5_Tx: DynamicLength=false, PduLength=64, J1939Requestable=false, SysTPduToFrameMappingRef=RDR_DETECTION_229_232
        RDR_TRACKER_OBJ_019_oPCAN_RADAR_e98bc94d_Tx: DynamicLength=false, PduLength=64, J1939Requestable=false
        RDR_DETECTION_365_368_oPCAN_RADAR_1a84f18f_Tx: DynamicLength=false, PduLength=64, J1939Requestable=false, SysTPduToFrameMappingRef=RDR_DETECTION_365_368
        RDR_TRACKER_OBJ_038_oPCAN_RADAR_dcd4ca72_Tx: DynamicLength=false, PduLength=64, J1939Requestable=false, SysTPduToFrameMappingRef=RDR_TRACKER_OBJ_038
        RDR_DETECTION_225_228_oPCAN_RADAR_522a547d_Tx: DynamicLength=false, PduLength=64, J1939Requestable=false, SysTPduToFrameMappingRef=RDR_DETECTION_225_228
        RDR_TRACKER_OBJ_005_oPCAN_RADAR_ee3e91c0_Tx: DynamicLength=false, PduLength=64, J1939Requestable=false
        RDR_TRACKER_OBJ_006_oPCAN_RADAR_6b98dadb_Tx: DynamicLength=false, PduLength=64, J1939Requestable=false, SysTPduToFrameMappingRef=RDR_TRACKER_OBJ_006
        RDR_DETECTION_101_104_oPCAN_RADAR_5a7abddc_Tx: DynamicLength=false, PduLength=64, J1939Requestable=false, SysTPduToFrameMappingRef=RDR_DETECTION_101_104
        RDR_TRACKER_OBJ_057_oPCAN_RADAR_ebe15fc6_Tx: DynamicLength=false, PduLength=64, J1939Requestable=false, SysTPduToFrameMappingRef=RDR_TRACKER_OBJ_057
        RDR_DETECTION_205_208_oPCAN_RADAR_85c22914_Tx: DynamicLength=false, PduLength=64, J1939Requestable=false
        RDR_DETECTION_213_216_oPCAN_RADAR_aa4dc53b_Tx: DynamicLength=false, PduLength=64, J1939Requestable=false
        RDR_DETECTION_021_024_oPCAN_RADAR_54f8af6e_Tx: DynamicLength=false, PduLength=64, J1939Requestable=false
        RDR_DETECTION_257_260_oPCAN_RADAR_17c540ef_Tx: DynamicLength=false, PduLength=64, J1939Requestable=false
        RDR_XCP_CTO_REQ_oPCAN_RADAR_5b59bad2_Rx: DynamicLength=false, PduLength=64, J1939Requestable=false, SysTPduToFrameMappingRef=RDR_XCP_CTO_REQ
        RDR_DETECTION_073_076_oPCAN_RADAR_80c18568_Tx: DynamicLength=false, PduLength=64, J1939Requestable=false
        RDR_DETECTION_205_208_oPCAN_RADAR_db4e0b94_Tx: DynamicLength=false, PduLength=64, J1939Requestable=false, SysTPduToFrameMappingRef=RDR_DETECTION_205_208
        RDR_TRACKER_OBJ_032_oPCAN_RADAR_ef2cb243_Tx: DynamicLength=false, PduLength=64, J1939Requestable=false
        RDR_TRACKER_OBJ_048_oPCAN_RADAR_235b7df0_Tx: DynamicLength=false, PduLength=64, J1939Requestable=false, SysTPduToFrameMappingRef=RDR_TRACKER_OBJ_048
        RDR_DETECTION_313_316_oPCAN_RADAR_c4549e8b_Tx: DynamicLength=false, PduLength=64, J1939Requestable=false
        RDR_TRACKER_OBJ_046_oPCAN_RADAR_4a587215_Tx: DynamicLength=false, PduLength=64, J1939Requestable=false
        RDR_TRACKER_OBJ_060_oPCAN_RADAR_0bd36965_Tx: DynamicLength=false, PduLength=64, J1939Requestable=false
        RDR_TRACKER_OBJ_062_oPCAN_RADAR_6b5f7fa3_Tx: DynamicLength=false, PduLength=64, J1939Requestable=false, SysTPduToFrameMappingRef=RDR_TRACKER_OBJ_062
        RDR_XCP_CTO_RESP_oPCAN_RADAR_e3946380_Tx: DynamicLength=false, PduLength=64, J1939Requestable=false, SysTPduToFrameMappingRef=RDR_XCP_CTO_RESP
        RDR_DETECTION_145_148_oPCAN_RADAR_4abf90e5_Tx: DynamicLength=false, PduLength=64, J1939Requestable=false, SysTPduToFrameMappingRef=RDR_DETECTION_145_148
        RDR_DETECTION_225_228_oPCAN_RADAR_6178863a_Tx: DynamicLength=false, PduLength=64, J1939Requestable=false
        RDR_ALIGNMENT_STATUS_001_oPCAN_RADAR_4f94d655_Tx: DynamicLength=false, PduLength=64, J1939Requestable=false, SysTPduToFrameMappingRef=RDR_ALIGNMENT_STATUS_001
        RDR_TRACKER_OBJ_048_oPCAN_RADAR_b0be7ea5_Tx: DynamicLength=false, PduLength=64, J1939Requestable=false
        RDR_TRACKER_OBJ_032_oPCAN_RADAR_ddd46a4d_Tx: DynamicLength=false, PduLength=64, J1939Requestable=false, SysTPduToFrameMappingRef=RDR_TRACKER_OBJ_032
        RDR_DETECTION_353_356_oPCAN_RADAR_d650c696_Tx: DynamicLength=false, PduLength=64, J1939Requestable=false
        RDR_DETECTION_345_348_oPCAN_RADAR_93e0ae66_Tx: DynamicLength=false, PduLength=64, J1939Requestable=false, SysTPduToFrameMappingRef=RDR_DETECTION_345_348
        RDR_TRACKER_OBJ_020_oPCAN_RADAR_94b31a9d_Tx: DynamicLength=false, PduLength=64, J1939Requestable=false, SysTPduToFrameMappingRef=RDR_TRACKER_OBJ_020
        RDR_TRACKER_OBJ_002_oPCAN_RADAR_b0529917_Tx: DynamicLength=false, PduLength=64, J1939Requestable=false, SysTPduToFrameMappingRef=RDR_TRACKER_OBJ_002
        RDR_TRACKER_OBJ_044_oPCAN_RADAR_9474bfe5_Tx: DynamicLength=false, PduLength=64, J1939Requestable=false, SysTPduToFrameMappingRef=RDR_TRACKER_OBJ_044
        RDR_DETECTION_165_168_oPCAN_RADAR_c15732f7_Tx: DynamicLength=false, PduLength=64, J1939Requestable=false
        RDR_DETECTION_265_268_oPCAN_RADAR_9b93edee_Tx: DynamicLength=false, PduLength=64, J1939Requestable=false, SysTPduToFrameMappingRef=RDR_DETECTION_265_268
        RDR_DETECTION_149_152_oPCAN_RADAR_17a572d8_Tx: DynamicLength=false, PduLength=64, J1939Requestable=false
        RDR_DETECTION_361_364_oPCAN_RADAR_c3f86525_Tx: DynamicLength=false, PduLength=64, J1939Requestable=false, SysTPduToFrameMappingRef=RDR_DETECTION_361_364
        RDR_DETECTION_009_012_oPCAN_RADAR_95663fdf_Tx: DynamicLength=false, PduLength=64, J1939Requestable=false, SysTPduToFrameMappingRef=RDR_DETECTION_009_012
        RDR_DETECTION_313_316_oPCAN_RADAR_9d5b2612_Tx: DynamicLength=false, PduLength=64, J1939Requestable=false, SysTPduToFrameMappingRef=RDR_DETECTION_313_316
        RDR_TRACKER_OBJ_052_oPCAN_RADAR_06d98cf9_Tx: DynamicLength=false, PduLength=64, J1939Requestable=false, SysTPduToFrameMappingRef=RDR_TRACKER_OBJ_052
        RDR_DETECTION_301_304_oPCAN_RADAR_0269ec90_Tx: DynamicLength=false, PduLength=64, J1939Requestable=false
        RDR_DETECTION_041_044_oPCAN_RADAR_a246585d_Tx: DynamicLength=false, PduLength=64, J1939Requestable=false
        RDR_DETECTION_173_176_oPCAN_RADAR_04d9feeb_Tx: DynamicLength=false, PduLength=64, J1939Requestable=false, SysTPduToFrameMappingRef=RDR_DETECTION_173_176
        RDR_TRACKER_OBJ_063_oPCAN_RADAR_5dadef50_Tx: DynamicLength=false, PduLength=64, J1939Requestable=false, SysTPduToFrameMappingRef=RDR_TRACKER_OBJ_063
        RDR_TRACKER_OBJ_015_oPCAN_RADAR_140d3af8_Tx: DynamicLength=false, PduLength=64, J1939Requestable=false, SysTPduToFrameMappingRef=RDR_TRACKER_OBJ_015
        RDR_DETECTION_037_040_oPCAN_RADAR_6b84d80e_Tx: DynamicLength=false, PduLength=64, J1939Requestable=false, SysTPduToFrameMappingRef=RDR_DETECTION_037_040
        RDR_DETECTION_229_232_oPCAN_RADAR_5330693b_Tx: DynamicLength=false, PduLength=64, J1939Requestable=false
        RDR_XCP_DAQ_RESP_oPCAN_RADAR_1cc015b8_Tx: DynamicLength=false, PduLength=64, J1939Requestable=false, SysTPduToFrameMappingRef=RDR_XCP_DAQ_RESP
        RDR_TRACKER_OBJ_058_oPCAN_RADAR_07d92cc6_Tx: DynamicLength=false, PduLength=64, J1939Requestable=false, SysTPduToFrameMappingRef=RDR_TRACKER_OBJ_058
        RDR_DETECTION_321_324_oPCAN_RADAR_e6d343be_Tx: DynamicLength=false, PduLength=64, J1939Requestable=false
        RDR_DETECTION_345_348_oPCAN_RADAR_f9df2ab9_Tx: DynamicLength=false, PduLength=64, J1939Requestable=false
        RDR_DETECTION_385_388_oPCAN_RADAR_cfd3c29e_Tx: DynamicLength=false, PduLength=64, J1939Requestable=false
        RDR_TRACKER_OBJ_017_oPCAN_RADAR_136dc5fd_Tx: DynamicLength=false, PduLength=64, J1939Requestable=false
        RDR_TRACKER_OBJ_031_oPCAN_RADAR_86c3db58_Tx: DynamicLength=false, PduLength=64, J1939Requestable=false, SysTPduToFrameMappingRef=RDR_TRACKER_OBJ_031
        RDR_DETECTION_353_356_oPCAN_RADAR_54e29f81_Tx: DynamicLength=false, PduLength=64, J1939Requestable=false, SysTPduToFrameMappingRef=RDR_DETECTION_353_356
        RDR_DETECTION_045_048_oPCAN_RADAR_cba88c84_Tx: DynamicLength=false, PduLength=64, J1939Requestable=false, SysTPduToFrameMappingRef=RDR_DETECTION_045_048
        RDR_DETECTION_233_236_oPCAN_RADAR_9528659a_Tx: DynamicLength=false, PduLength=64, J1939Requestable=false, SysTPduToFrameMappingRef=RDR_DETECTION_233_236
        RDR_TRACKER_OBJ_060_oPCAN_RADAR_06ba5e45_Tx: DynamicLength=false, PduLength=64, J1939Requestable=false, SysTPduToFrameMappingRef=RDR_TRACKER_OBJ_060
        RDR_DETECTION_217_220_oPCAN_RADAR_a9b6fdbc_Tx: DynamicLength=false, PduLength=64, J1939Requestable=false, SysTPduToFrameMappingRef=RDR_DETECTION_217_220
        RDR_TRACKER_OBJ_007_oPCAN_RADAR_5d6a4a28_Tx: DynamicLength=false, PduLength=64, J1939Requestable=false, SysTPduToFrameMappingRef=RDR_TRACKER_OBJ_007
        RDR_TRACKER_OBJ_012_oPCAN_RADAR_94d0c821_Tx: DynamicLength=false, PduLength=64, J1939Requestable=false, SysTPduToFrameMappingRef=RDR_TRACKER_OBJ_012
        RDR_DETECTION_117_120_oPCAN_RADAR_f1fedf5e_Tx: DynamicLength=false, PduLength=64, J1939Requestable=false, SysTPduToFrameMappingRef=RDR_DETECTION_117_120
        RDR_STATUS_002_oPCAN_RADAR_85a3c9df_Tx: DynamicLength=false, PduLength=64, J1939Requestable=false, SysTPduToFrameMappingRef=RDR_STATUS_002
        RDR_TRACKER_OBJ_024_oPCAN_RADAR_4f795951_Tx: DynamicLength=false, PduLength=64, J1939Requestable=false, SysTPduToFrameMappingRef=RDR_TRACKER_OBJ_024
        RDR_TRACKER_OBJ_059_oPCAN_RADAR_312bbc35_Tx: DynamicLength=false, PduLength=64, J1939Requestable=false, SysTPduToFrameMappingRef=RDR_TRACKER_OBJ_059
        RDR_TRACKER_OBJ_014_oPCAN_RADAR_aea7a933_Tx: DynamicLength=false, PduLength=64, J1939Requestable=false
        RDR_DETECTION_105_108_oPCAN_RADAR_37e9c5c4_Tx: DynamicLength=false, PduLength=64, J1939Requestable=false
        RDR_DETECTION_157_160_oPCAN_RADAR_a5eeac3f_Tx: DynamicLength=false, PduLength=64, J1939Requestable=false
        RDR_DETECTION_293_296_oPCAN_RADAR_8e457501_Tx: DynamicLength=false, PduLength=64, J1939Requestable=false
        RDR_TRACKER_OBJ_042_oPCAN_RADAR_225bddcf_Tx: DynamicLength=false, PduLength=64, J1939Requestable=false, SysTPduToFrameMappingRef=RDR_TRACKER_OBJ_042
        RDR_TRACKER_OBJ_055_oPCAN_RADAR_6a9dffad_Tx: DynamicLength=false, PduLength=64, J1939Requestable=false
        RDR_TRACKER_OBJ_063_oPCAN_RADAR_b61905ab_Tx: DynamicLength=false, PduLength=64, J1939Requestable=false
        RDR_DIAG_REQ_PHYS_oPCAN_RADAR_aca186f0_Rx: DynamicLength=true, PduLength=64, J1939Requestable=false
        RDR_DETECTION_161_164_oPCAN_RADAR_28e5acc3_Tx: DynamicLength=false, PduLength=64, J1939Requestable=false
        RDR_TRACKER_OBJ_021_oPCAN_RADAR_a2418a6e_Tx: DynamicLength=false, PduLength=64, J1939Requestable=false, SysTPduToFrameMappingRef=RDR_TRACKER_OBJ_021
        RDR_DETECTION_097_100_oPCAN_RADAR_41128c0d_Tx: DynamicLength=false, PduLength=64, J1939Requestable=false, SysTPduToFrameMappingRef=RDR_DETECTION_097_100
        RDR_DETECTION_241_244_oPCAN_RADAR_7e74ef3d_Tx: DynamicLength=false, PduLength=64, J1939Requestable=false
        RDR_DETECTION_317_320_oPCAN_RADAR_6bd84342_Tx: DynamicLength=false, PduLength=64, J1939Requestable=false
        RDR_DETECTION_397_400_oPCAN_RADAR_d58dd49c_Tx: DynamicLength=false, PduLength=64, J1939Requestable=false, SysTPduToFrameMappingRef=RDR_DETECTION_397_400
        RDR_DETECTION_373_376_oPCAN_RADAR_32ea69b8_Tx: DynamicLength=false, PduLength=64, J1939Requestable=false
        RDR_TRACKER_OBJ_011_oPCAN_RADAR_cfc77934_Tx: DynamicLength=false, PduLength=64, J1939Requestable=false, SysTPduToFrameMappingRef=RDR_TRACKER_OBJ_011
        RDR_TRACKER_OBJ_036_oPCAN_RADAR_2f95d8d5_Tx: DynamicLength=false, PduLength=64, J1939Requestable=false
        RDR_DETECTION_257_260_oPCAN_RADAR_600f442f_Tx: DynamicLength=false, PduLength=64, J1939Requestable=false, SysTPduToFrameMappingRef=RDR_DETECTION_257_260
        RDR_TRACKER_OBJ_043_oPCAN_RADAR_5777c106_Tx: DynamicLength=false, PduLength=64, J1939Requestable=false
        RDR_DETECTION_249_252_oPCAN_RADAR_8580b8cf_Tx: DynamicLength=false, PduLength=64, J1939Requestable=false, SysTPduToFrameMappingRef=RDR_DETECTION_249_252
        RDR_TRACKER_OBJ_008_oPCAN_RADAR_a912f1be_Tx: DynamicLength=false, PduLength=64, J1939Requestable=false
        RDR_TRACKER_OBJ_050_oPCAN_RADAR_77b24cbe_Tx: DynamicLength=false, PduLength=64, J1939Requestable=false
        RDR_TRACKER_OBJ_002_oPCAN_RADAR_934d9798_Tx: DynamicLength=false, PduLength=64, J1939Requestable=false
        RDR_DETECTION_085_088_oPCAN_RADAR_7df82e4e_Tx: DynamicLength=false, PduLength=64, J1939Requestable=false
        RDR_TRACKER_OBJ_024_oPCAN_RADAR_d2c68ce8_Tx: DynamicLength=false, PduLength=64, J1939Requestable=false
        RDR_DETECTION_161_164_oPCAN_RADAR_1aa75ba6_Tx: DynamicLength=false, PduLength=64, J1939Requestable=false, SysTPduToFrameMappingRef=RDR_DETECTION_161_164
        RDR_DETECTION_285_288_oPCAN_RADAR_934c7ef3_Tx: DynamicLength=false, PduLength=64, J1939Requestable=false, SysTPduToFrameMappingRef=RDR_DETECTION_285_288
        RDR_DETECTION_289_292_oPCAN_RADAR_9382762f_Tx: DynamicLength=false, PduLength=64, J1939Requestable=false
        RDR_TRACKER_OBJ_062_oPCAN_RADAR_6b8fdc2e_Tx: DynamicLength=false, PduLength=64, J1939Requestable=false
        RDR_DETECTION_173_176_oPCAN_RADAR_eed8ded8_Tx: DynamicLength=false, PduLength=64, J1939Requestable=false
        RDR_DETECTION_281_284_oPCAN_RADAR_4878071a_Tx: DynamicLength=false, PduLength=64, J1939Requestable=false
        RDR_DETECTION_133_136_oPCAN_RADAR_fcdc86c5_Tx: DynamicLength=false, PduLength=64, J1939Requestable=false
        RDR_TRACKER_OBJ_023_oPCAN_RADAR_afb58ab0_Tx: DynamicLength=false, PduLength=64, J1939Requestable=false
        RDR_TRACKER_OBJ_054_oPCAN_RADAR_b0f6eed3_Tx: DynamicLength=false, PduLength=64, J1939Requestable=false, SysTPduToFrameMappingRef=RDR_TRACKER_OBJ_054
        RDR_TRACKER_OBJ_038_oPCAN_RADAR_d573d465_Tx: DynamicLength=false, PduLength=64, J1939Requestable=false
        RDR_TRACKER_OBJ_028_oPCAN_RADAR_f8569b44_Tx: DynamicLength=false, PduLength=64, J1939Requestable=false, SysTPduToFrameMappingRef=RDR_TRACKER_OBJ_028
        RDR_TRACKER_OBJ_003_oPCAN_RADAR_86a009e4_Tx: DynamicLength=false, PduLength=64, J1939Requestable=false, SysTPduToFrameMappingRef=RDR_TRACKER_OBJ_003
        RDR_DETECTION_349_352_oPCAN_RADAR_cb97c5b8_Tx: DynamicLength=false, PduLength=64, J1939Requestable=false
        RDR_DETECTION_085_088_oPCAN_RADAR_4a134070_Tx: DynamicLength=false, PduLength=64, J1939Requestable=false, SysTPduToFrameMappingRef=RDR_DETECTION_085_088
        RDR_STATUS_001_oPCAN_RADAR_4b6de2c5_Tx: DynamicLength=false, PduLength=64, J1939Requestable=false
        RDR_TRACKER_OBJ_008_oPCAN_RADAR_b1523928_Tx: DynamicLength=false, PduLength=64, J1939Requestable=false, SysTPduToFrameMappingRef=RDR_TRACKER_OBJ_008
        RDR_TRACKER_OBJ_049_oPCAN_RADAR_15a9ed03_Tx: DynamicLength=false, PduLength=64, J1939Requestable=false, SysTPduToFrameMappingRef=RDR_TRACKER_OBJ_049
        RDR_DETECTION_057_060_oPCAN_RADAR_b9507aac_Tx: DynamicLength=false, PduLength=64, J1939Requestable=false, SysTPduToFrameMappingRef=RDR_DETECTION_057_060
        RDR_DETECTION_057_060_oPCAN_RADAR_cbf7f78f_Tx: DynamicLength=false, PduLength=64, J1939Requestable=false
        RDR_DETECTION_169_172_oPCAN_RADAR_54acc5c4_Tx: DynamicLength=false, PduLength=64, J1939Requestable=false, SysTPduToFrameMappingRef=RDR_DETECTION_169_172
        RDR_TRACKER_OBJ_034_oPCAN_RADAR_6bfb0867_Tx: DynamicLength=false, PduLength=64, J1939Requestable=false, SysTPduToFrameMappingRef=RDR_TRACKER_OBJ_034
        RDR_DETECTION_193_196_oPCAN_RADAR_0c066df6_Tx: DynamicLength=false, PduLength=64, J1939Requestable=false, SysTPduToFrameMappingRef=RDR_DETECTION_193_196
        RDR_DETECTION_081_084_oPCAN_RADAR_944ab07a_Tx: DynamicLength=false, PduLength=64, J1939Requestable=false
        RDR_DETECTION_393_396_oPCAN_RADAR_d5595375_Tx: DynamicLength=false, PduLength=64, J1939Requestable=false, SysTPduToFrameMappingRef=RDR_DETECTION_393_396
        RDR_TRACKER_OBJ_013_oPCAN_RADAR_d3d4af6b_Tx: DynamicLength=false, PduLength=64, J1939Requestable=false
        RDR_DETECTION_189_192_oPCAN_RADAR_5c7356d9_Tx: DynamicLength=false, PduLength=64, J1939Requestable=false, SysTPduToFrameMappingRef=RDR_DETECTION_189_192
        RDR_DETECTION_077_080_oPCAN_RADAR_05b8c98c_Tx: DynamicLength=false, PduLength=64, J1939Requestable=false
        RDR_DETECTION_037_040_oPCAN_RADAR_24e58fa7_Tx: DynamicLength=false, PduLength=64, J1939Requestable=false
        RDR_DETECTION_077_080_oPCAN_RADAR_5d5eee6c_Tx: DynamicLength=false, PduLength=64, J1939Requestable=false, SysTPduToFrameMappingRef=RDR_DETECTION_077_080
        RDR_DIAG_RESP_PHYS_oPCAN_RADAR_20_28778f59_Tx: DynamicLength=true, PduLength=8, J1939Requestable=false
        RDR_DETECTION_025_028_oPCAN_RADAR_bd4a315a_Tx: DynamicLength=false, PduLength=64, J1939Requestable=false
        RDR_STATUS_002_oPCAN_RADAR_f6a78e0b_Tx: DynamicLength=false, PduLength=64, J1939Requestable=false
        RDR_TRACKER_OBJ_031_oPCAN_RADAR_52e6de8d_Tx: DynamicLength=false, PduLength=64, J1939Requestable=false
        RDR_DETECTION_329_332_oPCAN_RADAR_3d29328b_Tx: DynamicLength=false, PduLength=64, J1939Requestable=false
        RDR_CAPABILITY_oPCAN_RADAR_18844568_Tx: DynamicLength=false, PduLength=64, J1939Requestable=false
        RDR_TRACKER_OBJ_035_oPCAN_RADAR_925fb41b_Tx: DynamicLength=false, PduLength=64, J1939Requestable=false
        RDR_TRACKER_OBJ_058_oPCAN_RADAR_2db19fd3_Tx: DynamicLength=false, PduLength=64, J1939Requestable=false
        RDR_TRACKER_OBJ_020_oPCAN_RADAR_127fe67e_Tx: DynamicLength=false, PduLength=64, J1939Requestable=false
        RDR_DETECTION_049_052_oPCAN_RADAR_5cdf864c_Tx: DynamicLength=false, PduLength=64, J1939Requestable=false, SysTPduToFrameMappingRef=RDR_DETECTION_049_052
        RDR_DETECTION_221_224_oPCAN_RADAR_8b56c0d7_Tx: DynamicLength=false, PduLength=64, J1939Requestable=false, SysTPduToFrameMappingRef=RDR_DETECTION_221_224
        RDR_DETECTION_001_004_oPCAN_RADAR_b0420040_Tx: DynamicLength=false, PduLength=64, J1939Requestable=false
        RDR_DETECTION_393_396_oPCAN_RADAR_e05c2eb1_Tx: DynamicLength=false, PduLength=64, J1939Requestable=false
        RDR_DETECTION_021_024_oPCAN_RADAR_5209fe54_Tx: DynamicLength=false, PduLength=64, J1939Requestable=false, SysTPduToFrameMappingRef=RDR_DETECTION_021_024
        RDR_DETECTION_377_380_oPCAN_RADAR_0516cc8e_Tx: DynamicLength=false, PduLength=64, J1939Requestable=false, SysTPduToFrameMappingRef=RDR_DETECTION_377_380
        RDR_DETECTION_329_332_oPCAN_RADAR_444a42d4_Tx: DynamicLength=false, PduLength=64, J1939Requestable=false, SysTPduToFrameMappingRef=RDR_DETECTION_329_332
        RDR_TRACKER_OBJ_015_oPCAN_RADAR_733170b6_Tx: DynamicLength=false, PduLength=64, J1939Requestable=false
        RDR_TRACKER_OBJ_030_oPCAN_RADAR_8f700708_Tx: DynamicLength=false, PduLength=64, J1939Requestable=false
        RDR_DETECTION_333_336_oPCAN_RADAR_20ee31a5_Tx: DynamicLength=false, PduLength=64, J1939Requestable=false
        RDR_DETECTION_165_168_oPCAN_RADAR_c3dbcf0c_Tx: DynamicLength=false, PduLength=64, J1939Requestable=false, SysTPduToFrameMappingRef=RDR_DETECTION_165_168
        RDR_TRACKER_OBJ_021_oPCAN_RADAR_cfe93ffb_Tx: DynamicLength=false, PduLength=64, J1939Requestable=false
        RDR_DETECTION_349_352_oPCAN_RADAR_0497a4ae_Tx: DynamicLength=false, PduLength=64, J1939Requestable=false, SysTPduToFrameMappingRef=RDR_DETECTION_349_352
        RDR_DETECTION_365_368_oPCAN_RADAR_1d658597_Tx: DynamicLength=false, PduLength=64, J1939Requestable=false
        RDR_DETECTION_369_372_oPCAN_RADAR_8df3fb47_Tx: DynamicLength=false, PduLength=64, J1939Requestable=false, SysTPduToFrameMappingRef=RDR_DETECTION_369_372
        RDR_TRACKER_OBJ_006_oPCAN_RADAR_53f4fd0e_Tx: DynamicLength=false, PduLength=64, J1939Requestable=false
        RDR_DETECTION_149_152_oPCAN_RADAR_ddc89a2d_Tx: DynamicLength=false, PduLength=64, J1939Requestable=false, SysTPduToFrameMappingRef=RDR_DETECTION_149_152
        RDR_DETECTION_009_012_oPCAN_RADAR_6bb87175_Tx: DynamicLength=false, PduLength=64, J1939Requestable=false
        RDR_TRACKER_OBJ_056_oPCAN_RADAR_dd13cf35_Tx: DynamicLength=false, PduLength=64, J1939Requestable=false, SysTPduToFrameMappingRef=RDR_TRACKER_OBJ_056
        RDR_DIAG_REQ_PHYS_oPCAN_RADAR_20_ba1a6b88_Rx: DynamicLength=true, PduLength=8, J1939Requestable=false
        RDR_DETECTION_153_156_oPCAN_RADAR_8dbda102_Tx: DynamicLength=false, PduLength=64, J1939Requestable=false, SysTPduToFrameMappingRef=RDR_DETECTION_153_156
        RDR_DETECTION_217_220_oPCAN_RADAR_05c118f2_Tx: DynamicLength=false, PduLength=64, J1939Requestable=false
        RDR_DETECTION_341_344_oPCAN_RADAR_4a9c3acc_Tx: DynamicLength=false, PduLength=64, J1939Requestable=false, SysTPduToFrameMappingRef=RDR_DETECTION_341_344
        RDR_DETECTION_213_216_oPCAN_RADAR_1c4c3a73_Tx: DynamicLength=false, PduLength=64, J1939Requestable=false, SysTPduToFrameMappingRef=RDR_DETECTION_213_216
        RDR_DETECTION_269_272_oPCAN_RADAR_0ce4e726_Tx: DynamicLength=false, PduLength=64, J1939Requestable=false, SysTPduToFrameMappingRef=RDR_DETECTION_269_272
        RDR_DETECTION_005_008_oPCAN_RADAR_02113517_Tx: DynamicLength=false, PduLength=64, J1939Requestable=false, SysTPduToFrameMappingRef=RDR_DETECTION_005_008
        RDR_TRACKER_OBJ_016_oPCAN_RADAR_4f1a8bed_Tx: DynamicLength=false, PduLength=64, J1939Requestable=false, SysTPduToFrameMappingRef=RDR_TRACKER_OBJ_016
        RDR_DETECTION_261_264_oPCAN_RADAR_42ef7944_Tx: DynamicLength=false, PduLength=64, J1939Requestable=false, SysTPduToFrameMappingRef=RDR_DETECTION_261_264
        RDR_DETECTION_053_056_oPCAN_RADAR_647b2a46_Tx: DynamicLength=false, PduLength=64, J1939Requestable=false
        RDR_DETECTION_125_128_oPCAN_RADAR_0a62769f_Tx: DynamicLength=false, PduLength=64, J1939Requestable=false, SysTPduToFrameMappingRef=RDR_DETECTION_125_128
        RDR_TRACKER_OBJ_061_oPCAN_RADAR_3048ceb6_Tx: DynamicLength=false, PduLength=64, J1939Requestable=false, SysTPduToFrameMappingRef=RDR_TRACKER_OBJ_061
        GenerelPurposePDU3_a3a5c5ac_Tx: DynamicLength=true, PduLength=0, J1939Requestable=false
        signalPdu_ADAS_Vehicle_Status_71b7c213_Rx: DynamicLength=false, PduLength=79, J1939Requestable=false
        signalPdu_RDR_1_Status_9d482741_Tx: DynamicLength=false, PduLength=269, J1939Requestable=false
        signalPdu_RDR_1_Detections_Transport_d322aa23_Tx: DynamicLength=true, PduLength=1404, J1939Requestable=false
        signalPdu_ADAS_Vehicle_Status_638dcd82_Rx: DynamicLength=false, PduLength=79, J1939Requestable=false
        GenerelPurposePDU7_a57231d8_Rx: DynamicLength=true, PduLength=0, J1939Requestable=false
        signalPdu_RDR_1_SW_Info_14232baa_Tx: DynamicLength=false, PduLength=90, J1939Requestable=false
        signalPdu_RDR_1_SW_Info_b4e751e3_Tx: DynamicLength=false, PduLength=90, J1939Requestable=false
        signalPdu_RDR_1_Detections_52b391ee_Tx: DynamicLength=false, PduLength=38632, J1939Requestable=false
        signalPdu_RDR_1_Status_67c6fd21_Tx: DynamicLength=false, PduLength=269, J1939Requestable=false
        GenerelPurposePDU4_a7ac36ff_Rx: DynamicLength=true, PduLength=0, J1939Requestable=false
        RDR_LOGGING_TX_FAST: PduLength=1500, J1939Requestable=false
        SYS_VEHICLE_STATUS_oPCAN_RADAR_43e5dd0e_Rx: DynamicLength=false, PduLength=64, J1939Requestable=false
        RDR_HIL_Req_RX: PduLength=1500, J1939Requestable=false
        RDR_HIL_Res_Tx: PduLength=1500, J1939Requestable=false
        RDR_FUSION_DET_085_088_oPCAN_RADAR_48d70a79_Rx: DynamicLength=false, PduLength=64, J1939Requestable=false, SysTPduToFrameMappingRef=RDR_FUSION_DET_085_088
        RDR_FUSION_DET_029_032_oPCAN_RADAR_ecde73ae_Rx: DynamicLength=false, PduLength=64, J1939Requestable=false
        RDR_FUSION_DET_041_044_oPCAN_RADAR_c19af5a8_Rx: DynamicLength=false, PduLength=64, J1939Requestable=false
        RDR_FUSION_DET_057_060_oPCAN_RADAR_bb9430a5_Rx: DynamicLength=false, PduLength=64, J1939Requestable=false, SysTPduToFrameMappingRef=RDR_FUSION_DET_057_060
        RDR_FUSION_DET_117_120_oPCAN_RADAR_f33a9557_Rx: DynamicLength=false, PduLength=64, J1939Requestable=false, SysTPduToFrameMappingRef=RDR_FUSION_DET_117_120
        RDR_FUSION_DET_125_128_oPCAN_RADAR_b08fc71f_Rx: DynamicLength=false, PduLength=64, J1939Requestable=false
        RDR_FUSION_DET_013_016_oPCAN_RADAR_15a3dfae_Rx: DynamicLength=false, PduLength=64, J1939Requestable=false
        RDR_FUSION_DET_089_092_oPCAN_RADAR_dfa000b1_Rx: DynamicLength=false, PduLength=64, J1939Requestable=false, SysTPduToFrameMappingRef=RDR_FUSION_DET_089_092
        RDR_FUSION_DET_001_004_oPCAN_RADAR_d9a9ebb4_Rx: DynamicLength=false, PduLength=64, J1939Requestable=false, SysTPduToFrameMappingRef=RDR_FUSION_DET_001_004
        RDR_FUSION_DET_121_124_oPCAN_RADAR_d1daa83c_Rx: DynamicLength=false, PduLength=64, J1939Requestable=false, SysTPduToFrameMappingRef=RDR_FUSION_DET_121_124
        RDR_FUSION_DET_061_064_oPCAN_RADAR_99740dce_Rx: DynamicLength=false, PduLength=64, J1939Requestable=false, SysTPduToFrameMappingRef=RDR_FUSION_DET_061_064
        RDR_FUSION_DET_097_100_oPCAN_RADAR_43d6c604_Rx: DynamicLength=false, PduLength=64, J1939Requestable=false, SysTPduToFrameMappingRef=RDR_FUSION_DET_097_100
        RDR_FUSION_DET_077_080_oPCAN_RADAR_5f9aa465_Rx: DynamicLength=false, PduLength=64, J1939Requestable=false, SysTPduToFrameMappingRef=RDR_FUSION_DET_077_080
        RDR_FUSION_DET_029_032_oPCAN_RADAR_1ec62a3f_Rx: DynamicLength=false, PduLength=64, J1939Requestable=false, SysTPduToFrameMappingRef=RDR_FUSION_DET_029_032
        RDR_FUSION_DET_017_020_oPCAN_RADAR_ba2f0267_Rx: DynamicLength=false, PduLength=64, J1939Requestable=false
        RDR_FUSION_DET_069_072_oPCAN_RADAR_d77f93ac_Rx: DynamicLength=false, PduLength=64, J1939Requestable=false, SysTPduToFrameMappingRef=RDR_FUSION_DET_069_072
        RDR_FUSION_DET_009_012_oPCAN_RADAR_0864dc80_Rx: DynamicLength=false, PduLength=64, J1939Requestable=false
        RDR_FUSION_DET_093_096_oPCAN_RADAR_31ab6f94_Rx: DynamicLength=false, PduLength=64, J1939Requestable=false
        RDR_FUSION_DET_109_112_oPCAN_RADAR_16b569b7_Rx: DynamicLength=false, PduLength=64, J1939Requestable=false, SysTPduToFrameMappingRef=RDR_FUSION_DET_109_112
        RDR_FUSION_DET_005_008_oPCAN_RADAR_00d57f1e_Rx: DynamicLength=false, PduLength=64, J1939Requestable=false, SysTPduToFrameMappingRef=RDR_FUSION_DET_005_008
        RDR_FUSION_DET_013_016_oPCAN_RADAR_c7d74ef9_Rx: DynamicLength=false, PduLength=64, J1939Requestable=false, SysTPduToFrameMappingRef=RDR_FUSION_DET_013_016
        RDR_FUSION_DET_061_064_oPCAN_RADAR_25205a86_Rx: DynamicLength=false, PduLength=64, J1939Requestable=false
        RDR_FUSION_DET_109_112_oPCAN_RADAR_667d8730_Rx: DynamicLength=false, PduLength=64, J1939Requestable=false
        RDR_FUSION_DET_009_012_oPCAN_RADAR_97a275d6_Rx: DynamicLength=false, PduLength=64, J1939Requestable=false, SysTPduToFrameMappingRef=RDR_FUSION_DET_009_012
        RDR_FUSION_DET_045_048_oPCAN_RADAR_28286b9c_Rx: DynamicLength=false, PduLength=64, J1939Requestable=false
        RDR_FUSION_DET_005_008_oPCAN_RADAR_3a2c3381_Rx: DynamicLength=false, PduLength=64, J1939Requestable=false
        RDR_FUSION_DET_065_068_oPCAN_RADAR_cc92c4b2_Rx: DynamicLength=false, PduLength=64, J1939Requestable=false
        RDR_FUSION_DET_093_096_oPCAN_RADAR_8fd53b9e_Rx: DynamicLength=false, PduLength=64, J1939Requestable=false, SysTPduToFrameMappingRef=RDR_FUSION_DET_093_096
        RDR_FUSION_DET_021_024_oPCAN_RADAR_3724029b_Rx: DynamicLength=false, PduLength=64, J1939Requestable=false
        RDR_FUSION_DET_113_116_oPCAN_RADAR_7bba841e_Rx: DynamicLength=false, PduLength=64, J1939Requestable=false
        RDR_FUSION_DET_053_056_oPCAN_RADAR_07a787b3_Rx: DynamicLength=false, PduLength=64, J1939Requestable=false
        RDR_FUSION_DET_065_068_oPCAN_RADAR_40089964_Rx: DynamicLength=false, PduLength=64, J1939Requestable=false, SysTPduToFrameMappingRef=RDR_FUSION_DET_065_068
        RDR_FUSION_DET_017_020_oPCAN_RADAR_722d8936_Rx: DynamicLength=false, PduLength=64, J1939Requestable=false, SysTPduToFrameMappingRef=RDR_FUSION_DET_017_020
        RDR_FUSION_DET_057_060_oPCAN_RADAR_a82b5a7a_Rx: DynamicLength=false, PduLength=64, J1939Requestable=false
        RDR_FUSION_HEADER_001_oPCAN_RADAR_cc468fbf_Rx: DynamicLength=false, PduLength=64, J1939Requestable=false
        RDR_FUSION_DET_081_084_oPCAN_RADAR_f7961d8f_Rx: DynamicLength=false, PduLength=64, J1939Requestable=false
        RDR_FUSION_DET_121_124_oPCAN_RADAR_593d592b_Rx: DynamicLength=false, PduLength=64, J1939Requestable=false
        RDR_FUSION_DET_081_084_oPCAN_RADAR_91ab9ed3_Rx: DynamicLength=false, PduLength=64, J1939Requestable=false, SysTPduToFrameMappingRef=RDR_FUSION_DET_081_084
        RDR_FUSION_DET_113_116_oPCAN_RADAR_46c05298_Rx: DynamicLength=false, PduLength=64, J1939Requestable=false, SysTPduToFrameMappingRef=RDR_FUSION_DET_113_116
        RDR_FUSION_STATUS_001_oPCAN_RADAR_8bf3739d_Rx: DynamicLength=false, PduLength=64, J1939Requestable=false
        RDR_FUSION_DET_021_024_oPCAN_RADAR_50cdb45d_Rx: DynamicLength=false, PduLength=64, J1939Requestable=false, SysTPduToFrameMappingRef=RDR_FUSION_DET_021_024
        RDR_FUSION_DET_073_076_oPCAN_RADAR_e31d289d_Rx: DynamicLength=false, PduLength=64, J1939Requestable=false
        RDR_FUSION_STATUS_001_oPCAN_RADAR_b6cfc045_Rx: DynamicLength=false, PduLength=64, J1939Requestable=false, SysTPduToFrameMappingRef=RDR_FUSION_STATUS_001
        RDR_FUSION_DET_089_092_oPCAN_RADAR_2c6c6cba_Rx: DynamicLength=false, PduLength=64, J1939Requestable=false
        RDR_FUSION_DET_001_004_oPCAN_RADAR_d39eadb5_Rx: DynamicLength=false, PduLength=64, J1939Requestable=false
        RDR_FUSION_HEADER_001_oPCAN_RADAR_204bf532_Rx: DynamicLength=false, PduLength=64, J1939Requestable=false, SysTPduToFrameMappingRef=RDR_FUSION_HEADER_001
        RDR_IDSM_Audit_Log_Tp_oPCAN_RADAR_ea04d42a_Tx: DynamicLength=false, PduLength=64, J1939Requestable=false, SysTPduToFrameMappingRef=RDR_IDSM_Audit_Log_Tp
        RDR_FUSION_DET_049_052_oPCAN_RADAR_1a60849d_Rx: DynamicLength=false, PduLength=64, J1939Requestable=false
        RDR_FUSION_DET_101_104_oPCAN_RADAR_58bef7d5_Rx: DynamicLength=false, PduLength=64, J1939Requestable=false, SysTPduToFrameMappingRef=RDR_FUSION_DET_101_104
        RDR_FUSION_DET_033_036_oPCAN_RADAR_f1197080_Rx: DynamicLength=false, PduLength=64, J1939Requestable=false
        RDR_FUSION_DET_025_028_oPCAN_RADAR_89b120f7_Rx: DynamicLength=false, PduLength=64, J1939Requestable=false, SysTPduToFrameMappingRef=RDR_FUSION_DET_025_028
        RDR_FUSION_DET_101_104_oPCAN_RADAR_bd87f605_Rx: DynamicLength=false, PduLength=64, J1939Requestable=false
        RDR_FUSION_DET_117_120_oPCAN_RADAR_d43659d7_Rx: DynamicLength=false, PduLength=64, J1939Requestable=false
        RDR_FUSION_DET_041_044_oPCAN_RADAR_10105227_Rx: DynamicLength=false, PduLength=64, J1939Requestable=false, SysTPduToFrameMappingRef=RDR_FUSION_DET_041_044
        RDR_FUSION_DET_045_048_oPCAN_RADAR_c96cc68d_Rx: DynamicLength=false, PduLength=64, J1939Requestable=false, SysTPduToFrameMappingRef=RDR_FUSION_DET_045_048
        RDR_FUSION_DET_053_056_oPCAN_RADAR_0e6ef76a_Rx: DynamicLength=false, PduLength=64, J1939Requestable=false, SysTPduToFrameMappingRef=RDR_FUSION_DET_053_056
        RDR_FUSION_DET_105_108_oPCAN_RADAR_54356831_Rx: DynamicLength=false, PduLength=64, J1939Requestable=false
        RDR_FUSION_DET_025_028_oPCAN_RADAR_de969caf_Rx: DynamicLength=false, PduLength=64, J1939Requestable=false
        RDR_FUSION_DET_073_076_oPCAN_RADAR_870aa883_Rx: DynamicLength=false, PduLength=64, J1939Requestable=false, SysTPduToFrameMappingRef=RDR_FUSION_DET_073_076
        RDR_FUSION_DET_049_052_oPCAN_RADAR_5e1bcc45_Rx: DynamicLength=false, PduLength=64, J1939Requestable=false, SysTPduToFrameMappingRef=RDR_FUSION_DET_049_052
        RDR_FUSION_DET_037_040_oPCAN_RADAR_47392252_Rx: DynamicLength=false, PduLength=64, J1939Requestable=false
        RDR_FUSION_DET_077_080_oPCAN_RADAR_66646479_Rx: DynamicLength=false, PduLength=64, J1939Requestable=false
        RDR_FUSION_DET_125_128_oPCAN_RADAR_08a63c96_Rx: DynamicLength=false, PduLength=64, J1939Requestable=false, SysTPduToFrameMappingRef=RDR_FUSION_DET_125_128
        RDR_FUSION_DET_097_100_oPCAN_RADAR_f5ebb32e_Rx: DynamicLength=false, PduLength=64, J1939Requestable=false
        RDR_FUSION_DET_085_088_oPCAN_RADAR_1e2483bb_Rx: DynamicLength=false, PduLength=64, J1939Requestable=false
        RDR_FUSION_DET_105_108_oPCAN_RADAR_81c2637f_Rx: DynamicLength=false, PduLength=64, J1939Requestable=false, SysTPduToFrameMappingRef=RDR_FUSION_DET_105_108
        RDR_FUSION_DET_037_040_oPCAN_RADAR_69409207_Rx: DynamicLength=false, PduLength=64, J1939Requestable=false, SysTPduToFrameMappingRef=RDR_FUSION_DET_037_040
        RDR_FUSION_DET_069_072_oPCAN_RADAR_feda2bb3_Rx: DynamicLength=false, PduLength=64, J1939Requestable=false
        RDR_FUSION_DET_033_036_oPCAN_RADAR_4eb31110_Rx: DynamicLength=false, PduLength=64, J1939Requestable=false, SysTPduToFrameMappingRef=RDR_FUSION_DET_033_036
        VI_oVCAN_RADAR_260d64a7_Rx: DynamicLength=false, J1939Requestable=true, PduLength=8
        ETC2_03_oVCAN_RADAR_8fe61e94_Rx: DynamicLength=false, J1939Requestable=true, PduLength=8
        ETC2_00_oVCAN_RADAR_fd8cfcd0_Rx: DynamicLength=false, J1939Requestable=true, PduLength=8, SysTPduToFrameMappingRef=ETC2_00
        OEL_oVCAN_RADAR_75091ec5_Rx: DynamicLength=false, J1939Requestable=true, PduLength=8
        CCVS1_oVCAN_RADAR_7fab2fed_Rx: DynamicLength=false, J1939Requestable=true, PduLength=8
        SAS_oVCAN_RADAR_efd6af4d_Rx: DynamicLength=false, J1939Requestable=true, PduLength=8, SysTPduToFrameMappingRef=SAS
        ADAS_FN_Enable_disable_sts_oVCAN_RADAR_dbe1c88d_Rx: DynamicLength=false, J1939Requestable=true, PduLength=8
        MOIS_oVCAN_RADAR_39784631_Tx: DynamicLength=false, J1939Requestable=true, PduLength=8
        MOIS_oVCAN_RADAR_1658382d_Tx: DynamicLength=false, J1939Requestable=true, PduLength=8, SysTPduToFrameMappingRef=MOIS
        VD_oVCAN_RADAR_612104d9_Rx: DynamicLength=false, J1939Requestable=true, PduLength=8
        DM1_D0_oVCAN_RADAR_94793fbe_Tx: DynamicLength=true, J1939Requestable=true, PduLength=22, MetaDataTypeRef=EcucPduCollection/TARGET_ADDRESS_16
        CLS_Tx_16_oVCAN_RADAR_4a01c26f_Rx: DynamicLength=false, J1939Requestable=true, PduLength=8
        BSD1_oVCAN_RADAR_aa49a410_Tx: DynamicLength=false, J1939Requestable=true, PduLength=8, SysTPduToFrameMappingRef=BSD1
        VDC2_oVCAN_RADAR_5a222cac_Rx: DynamicLength=false, J1939Requestable=true, PduLength=8
        SAS_oVCAN_RADAR_fe45d49a_Rx: DynamicLength=false, J1939Requestable=true, PduLength=8
        VDC2_oVCAN_RADAR_9b73b1bc_Rx: DynamicLength=false, J1939Requestable=true, PduLength=8, SysTPduToFrameMappingRef=VDC2
        ETC2_00_oVCAN_RADAR_322c725a_Rx: DynamicLength=false, J1939Requestable=true, PduLength=8
        VI_oVCAN_RADAR_b73d6113_Rx: DynamicLength=false, J1939Requestable=true, PduLength=8, SysTPduToFrameMappingRef=VI
        BSD1_oVCAN_RADAR_6f5008ee_Tx: DynamicLength=false, J1939Requestable=true, PduLength=8
        OEL_oVCAN_RADAR_45092dcb_Rx: DynamicLength=false, J1939Requestable=true, PduLength=8, SysTPduToFrameMappingRef=OEL
        CLS_Tx_4_oVCAN_RADAR_1adbb350_Rx: DynamicLength=false, J1939Requestable=true, PduLength=8
        DM1_B0_oVCAN_RADAR_6cbb7408_Tx: DynamicLength=true, J1939Requestable=true, PduLength=8, MetaDataTypeRef=EcucPduCollection/CAN_ID_32
        ADAS_FN_Enable_disable_sts_oVCAN_RADAR_3f57de57_Rx: DynamicLength=false, J1939Requestable=true, PduLength=8, SysTPduToFrameMappingRef=ADAS_FN_Enable_disable_sts
        CCVS1_oVCAN_RADAR_e4df8c5f_Rx: DynamicLength=false, J1939Requestable=true, PduLength=8, SysTPduToFrameMappingRef=CCVS1
        TPDT_Tp_oVCAN_RADAR_92966f54_Tx: DynamicLength=false, PduLength=8, J1939Requestable=false, MetaDataTypeRef=EcucPduCollection/CAN_ID_32, SysTPduToFrameMappingRef=TPDT_Tp
        TD_oVCAN_RADAR_804fc074_Rx: DynamicLength=false, J1939Requestable=true, PduLength=8
        TD_oVCAN_RADAR_7fe49199_Rx: DynamicLength=false, J1939Requestable=true, PduLength=8, SysTPduToFrameMappingRef=TD
        TPCM_Tp_oVCAN_RADAR_a235016c_Tx: DynamicLength=false, PduLength=8, J1939Requestable=false, MetaDataTypeRef=EcucPduCollection/CAN_ID_32, SysTPduToFrameMappingRef=TPCM_Tp
        ETC2_03_oVCAN_RADAR_a69b4dc5_Rx: DynamicLength=false, J1939Requestable=true, PduLength=8, SysTPduToFrameMappingRef=ETC2_03
        CLS_Tx_16_oVCAN_RADAR_afa2b499_Rx: DynamicLength=false, J1939Requestable=true, PduLength=8, SysTPduToFrameMappingRef=CLS_Tx_16
        DM1_B1_oVCAN_RADAR_b12dad8d_Tx: DynamicLength=true, J1939Requestable=true, PduLength=8, MetaDataTypeRef=EcucPduCollection/CAN_ID_32
        DM1_D0_oVCAN_RADAR_ce78d82a_Tx: DynamicLength=true, J1939Requestable=true, PduLength=22, MetaDataTypeRef=EcucPduCollection/TARGET_ADDRESS_16
        VD_oVCAN_RADAR_36e033f5_Rx: DynamicLength=false, J1939Requestable=true, PduLength=8, SysTPduToFrameMappingRef=VD
        CLS_Tx_4_oVCAN_RADAR_e4fced07_Rx: DynamicLength=false, J1939Requestable=true, PduLength=8, SysTPduToFrameMappingRef=CLS_Tx_4
        TPCM_DirectTp_oVCAN_RADAR_a235016c_Tx: DynamicLength=false, PduLength=8, J1939Requestable=false, MetaDataTypeRef=EcucPduCollection/CAN_ID_32, SysTPduToFrameMappingRef=TPCM_Tp
        RDR_DIAG_REQ_PHYS_Tp_oPCAN_RADAR_25ac4fd7_Rx: DynamicLength=false, PduLength=64, J1939Requestable=false, SysTPduToFrameMappingRef=RDR_DIAG_REQ_PHYS_Tp
        RDR_DIAG_RESP_PHYS_Tp_oPCAN_RADAR_b7c1ab06_Tx: DynamicLength=false, PduLength=64, J1939Requestable=false, SysTPduToFrameMappingRef=RDR_DIAG_RESP_PHYS_Tp
        GW_VI_Tx_oPCAN_RADAR_ad28cbdc_Tx: PduLength=8, J1939Requestable=false, SysTPduToFrameMappingRef=GW_VI_Tx
        RDR_BSD1_oPCAN_RADAR_03d8d8bd_Rx: PduLength=8, J1939Requestable=false, SysTPduToFrameMappingRef=RDR_BSD1
        GW_VD_oPCAN_RADAR_66a1bce9_Rx: DynamicLength=false, PduLength=8, J1939Requestable=false
        GW_ADAS_FN_Enable_disable_sts_oPCAN_RADAR_781ac753_Rx: DynamicLength=false, PduLength=8, J1939Requestable=false, SysTPduToFrameMappingRef=GW_ADAS_FN_Enable_disable_sts
        GW_ETC2_Tx_oPCAN_RADAR_dfec0354_Tx: PduLength=8, J1939Requestable=false, SysTPduToFrameMappingRef=GW_ETC2_Tx
        GW_OEL_oPCAN_RADAR_4c06edea_Rx: DynamicLength=false, PduLength=8, J1939Requestable=false, SysTPduToFrameMappingRef=GW_OEL
        GW_SAS_Tx_oPCAN_RADAR_6c223e7b_Tx: PduLength=8, J1939Requestable=false, SysTPduToFrameMappingRef=GW_SAS_Tx
        GW_ETC2_oPCAN_RADAR_57f17119_Rx: DynamicLength=false, PduLength=8, J1939Requestable=false, SysTPduToFrameMappingRef=GW_ETC2
        GW_OEL_Tx_oPCAN_RADAR_96436c6f_Tx: PduLength=8, J1939Requestable=false, SysTPduToFrameMappingRef=GW_OEL_Tx
        GW_SAS_oPCAN_RADAR_e6d96f6c_Rx: DynamicLength=false, PduLength=8, J1939Requestable=false, SysTPduToFrameMappingRef=GW_SAS
        GW_CCVS1_oPCAN_RADAR_d10adaab_Rx: DynamicLength=false, PduLength=8, J1939Requestable=false, SysTPduToFrameMappingRef=GW_CCVS1
        GW_CLS_Tx_16_Tx_oPCAN_RADAR_b30c42cc_Tx: PduLength=8, J1939Requestable=false, SysTPduToFrameMappingRef=GW_CLS_Tx_16_Tx
        GW_VD_oPCAN_RADAR_e94baa9d_Rx: DynamicLength=false, PduLength=8, J1939Requestable=false, SysTPduToFrameMappingRef=GW_VD
        GW_TD_oPCAN_RADAR_a04f08f1_Rx: DynamicLength=false, PduLength=8, J1939Requestable=false, SysTPduToFrameMappingRef=GW_TD
        GW_ADAS_FN_Enable_disable_sts_Tx_oPCAN_RADAR_27a639a3_Tx: PduLength=8, J1939Requestable=false, SysTPduToFrameMappingRef=GW_ADAS_FN_Enable_disable_sts_Tx
        GW_ETC2_oPCAN_RADAR_2970e6e5_Rx: DynamicLength=false, PduLength=8, J1939Requestable=false
        GW_VI_oPCAN_RADAR_218ddc97_Rx: DynamicLength=false, PduLength=8, J1939Requestable=false
        GW_ADAS_FN_Enable_disable_sts_oPCAN_RADAR_a2ffe33c_Rx: DynamicLength=false, PduLength=8, J1939Requestable=false
        RDR_BSD1_oPCAN_RADAR_a3b58398_Rx: PduLength=8, J1939Requestable=false
        GW_CLS_Tx_4_oPCAN_RADAR_888f4e35_Rx: DynamicLength=false, PduLength=8, J1939Requestable=false
        GW_TD_oPCAN_RADAR_87cf7844_Rx: DynamicLength=false, PduLength=8, J1939Requestable=false
        GW_VDC2_oPCAN_RADAR_9daa2cf0_Rx: DynamicLength=false, PduLength=8, J1939Requestable=false, SysTPduToFrameMappingRef=GW_VDC2
        GW_VD_Tx_oPCAN_RADAR_70a8f6f0_Tx: PduLength=8, J1939Requestable=false, SysTPduToFrameMappingRef=GW_VD_Tx
        GW_CLS_Tx_16_oPCAN_RADAR_c3f80567_Rx: DynamicLength=false, PduLength=8, J1939Requestable=false, SysTPduToFrameMappingRef=GW_CLS_Tx_16
        GW_CLS_Tx_4_Tx_oPCAN_RADAR_ecf0186d_Tx: PduLength=8, J1939Requestable=false, SysTPduToFrameMappingRef=GW_CLS_Tx_4_Tx
        RDR_BSD1_Tx_oPCAN_RADAR_170995fb_Tx: DynamicLength=false, PduLength=8, J1939Requestable=false
        GW_CLS_Tx_16_oPCAN_RADAR_92e0b941_Rx: DynamicLength=false, PduLength=8, J1939Requestable=false
        GW_VDC2_Tx_oPCAN_RADAR_8a7343d4_Tx: PduLength=8, J1939Requestable=false, SysTPduToFrameMappingRef=GW_VDC2_Tx
        GW_CCVS1_oPCAN_RADAR_379fc270_Rx: DynamicLength=false, PduLength=8, J1939Requestable=false
        GW_SAS_oPCAN_RADAR_3d30de8a_Rx: DynamicLength=false, PduLength=8, J1939Requestable=false
        GW_VI_oPCAN_RADAR_6896f87b_Rx: DynamicLength=false, PduLength=8, J1939Requestable=false, SysTPduToFrameMappingRef=GW_VI
        GW_OEL_oPCAN_RADAR_b67c14d5_Rx: DynamicLength=false, PduLength=8, J1939Requestable=false
        RDR_BSD1_Tx_oPCAN_RADAR_3cea6970_Tx: DynamicLength=false, PduLength=8, J1939Requestable=false, SysTPduToFrameMappingRef=RDR_BSD1_Tx
        GW_CLS_Tx_4_oPCAN_RADAR_deff6d37_Rx: DynamicLength=false, PduLength=8, J1939Requestable=false, SysTPduToFrameMappingRef=GW_CLS_Tx_4
        GW_TD_Tx_oPCAN_RADAR_aa39de8f_Tx: PduLength=8, J1939Requestable=false, SysTPduToFrameMappingRef=GW_TD_Tx
        GW_CCVS1_Tx_oPCAN_RADAR_7eaa671a_Tx: PduLength=8, J1939Requestable=false, SysTPduToFrameMappingRef=GW_CCVS1_Tx
        GW_VDC2_oPCAN_RADAR_a2fdf3c6_Rx: DynamicLength=false, PduLength=8, J1939Requestable=false
        RDR_DIAG_RESP_PHYS_Tp_oPCAN_RADAR_b7c1ab06_Tx_OTA: DynamicLength=false, PduLength=64, J1939Requestable=false, SysTPduToFrameMappingRef=RDR_DIAG_RESP_PHYS_Tp
        RDR_DIAG_RESP_PHYS_Tp_oPCAN_RADAR_b7c1ab06_Tx_Plant: DynamicLength=false, PduLength=64, J1939Requestable=false, SysTPduToFrameMappingRef=RDR_DIAG_RESP_PHYS_Tp
        RDR_DIAG_REQ_PHYS_Tp_oPCAN_RADAR_25ac4fd7_Rx_Plant: DynamicLength=false, PduLength=64, J1939Requestable=false, SysTPduToFrameMappingRef=RDR_DIAG_REQ_PHYS_Tp
        RDR_DIAG_REQ_PHYS_Tp_oPCAN_RADAR_25ac4fd7_Rx_OTA: DynamicLength=false, PduLength=64, J1939Requestable=false, SysTPduToFrameMappingRef=RDR_DIAG_REQ_PHYS_Tp
        RDR_DIAG_REQ_PHYS_oPCAN_RADAR_aca186f0_Rx_OTA: DynamicLength=true, PduLength=64, J1939Requestable=false
        RDR_DIAG_REQ_PHYS_oPCAN_RADAR_aca186f0_Rx_Plant: DynamicLength=true, PduLength=64, J1939Requestable=false
        RDR_DIAG_RESP_PHYS_oPCAN_RADAR_574db004_Tx_OTA: DynamicLength=true, PduLength=64, J1939Requestable=false
        RDR_DIAG_RESP_PHYS_oPCAN_RADAR_574db004_Tx_Plant: DynamicLength=true, PduLength=64, J1939Requestable=false
        RDR_DIAG_REQ_FUNC_Tp_oPCAN_RADAR_4295d79d_Rx: DynamicLength=false, PduLength=64, J1939Requestable=false, SysTPduToFrameMappingRef=RDR_DIAG_REQ_PHYS_Tp
        RDR_DIAG_REQ_FUNC_Tp_oPCAN_RADAR_4295d79d_Rx_OTA: DynamicLength=false, PduLength=64, J1939Requestable=false, SysTPduToFrameMappingRef=RDR_DIAG_REQ_PHYS_Tp
        RDR_DIAG_REQ_FUNC_Tp_oPCAN_RADAR_4295d79d_Rx_Plant: DynamicLength=false, PduLength=64, J1939Requestable=false, SysTPduToFrameMappingRef=RDR_DIAG_REQ_PHYS_Tp
        RDR_DIAG_REQ_FUNC_oPCAN_RADAR_333cc5de_Rx: DynamicLength=true, PduLength=61, J1939Requestable=false
        RDR_DIAG_REQ_FUNC_oPCAN_RADAR_333cc5de_Rx_OTA: DynamicLength=true, PduLength=61, J1939Requestable=false
        RDR_DIAG_REQ_FUNC_oPCAN_RADAR_333cc5de_Rx_Plant: DynamicLength=true, PduLength=61, J1939Requestable=false
        PCAN_DIAG_REQ_PHYS_OBD1_Tp_oPCAN_RADAR_20_b6648efa_Rx: DynamicLength=false, PduLength=8, J1939Requestable=false, SysTPduToFrameMappingRef=PCAN_DIAG_REQ_PHYS_OBD1_Tp
        PCAN_DIAG_RESP_PHYS_OTA_Tp_oPCAN_RADAR_37f68c50_Tx: DynamicLength=false, PduLength=64, J1939Requestable=false, SysTPduToFrameMappingRef=PCAN_DIAG_RESP_PHYS_OTA_Tp
        PCAN_DIAG_REQ_FUNC_PLANT_Tp_oPCAN_RADAR_5ec247a5_Rx: DynamicLength=false, PduLength=64, J1939Requestable=false, SysTPduToFrameMappingRef=PCAN_DIAG_REQ_FUNC_PLANT_Tp
        SR2_DIAG_RES_PHY_PLANT_oVCAN_RADAR_bfe81f34_Tx: DynamicLength=false, J1939Requestable=true, PduLength=8, MetaDataTypeRef=EcucPduCollection/CAN_ID_32
        FR_DIAG_RES_PHY_PLANT_oVCAN_RADAR_ee22d0c2_Tx: DynamicLength=true, PduLength=8, J1939Requestable=false
        SR2_DIAG_REQ_PHY_OBD2_oVCAN_RADAR_2a87ddc0_Rx: DynamicLength=false, J1939Requestable=true, PduLength=8
        SR1_DIAG_RES_PHY_OTA_oVCAN_RADAR_349e32f6_Tx: DynamicLength=false, J1939Requestable=true, PduLength=8, SysTPduToFrameMappingRef=SR1_DIAG_RES_PHY_OTA
        SRR_FL_DIAG_REQ_PHYS_OBD2_Tx_oPCAN_RADAR_79efce4a_Tx: PduLength=64, J1939Requestable=false, SysTPduToFrameMappingRef=SRR_FL_DIAG_REQ_PHYS_OBD2_Tx
        PCAN_DIAG_REQ_PHYS_OBD2_oPCAN_RADAR_20_1236930c_Rx: DynamicLength=true, PduLength=8, J1939Requestable=false
        SR1_DIAG_REQ_PHY_OBD1_oVCAN_RADAR_ff3ad7b0_Rx: DynamicLength=false, J1939Requestable=true, PduLength=8, SysTPduToFrameMappingRef=SR1_DIAG_REQ_PHY_OBD1
        PCAN_DIAG_REQ_FUNC_OTA_Tp_oPCAN_RADAR_7ea6262a_Rx: DynamicLength=false, PduLength=64, J1939Requestable=false, SysTPduToFrameMappingRef=PCAN_DIAG_REQ_FUNC_OTA_Tp
        PCAN_DIAG_REQ_FUNC_OTA_oPCAN_RADAR_8729c499_Rx: DynamicLength=true, PduLength=62, J1939Requestable=false
        PCAN_DIAG_REQ_FUNC_OBD2_oPCAN_RADAR_ebaed123_Rx: DynamicLength=true, PduLength=62, J1939Requestable=false
        PCAN_DIAG_REQ_PHYS_OBD2_oPCAN_RADAR_773f87d8_Rx: DynamicLength=true, PduLength=64, J1939Requestable=false
        DIAG_REQ_FNC_OBD2_oVCAN_RADAR_254b3790_Rx: DynamicLength=true, PduLength=7, J1939Requestable=false
        RDR_FUSION_ALIGNMENT_STATUS_001_oPCAN_RADAR_5cbb3751_Rx: DynamicLength=false, PduLength=64, J1939Requestable=false
        RDR_FUSION_CAPABILITY_oPCAN_RADAR_d81ad430_Rx: DynamicLength=false, PduLength=64, J1939Requestable=false
        DIAG_REQ_FNC_OTA_oVCAN_RADAR_e787ed21_Rx: DynamicLength=true, PduLength=7, J1939Requestable=false
        PCAN_DIAG_RESP_PHYS_OBD1_oPCAN_RADAR_20_955df2f4_Tx: DynamicLength=true, PduLength=8, J1939Requestable=false
        SR2_DIAG_RES_PHY_OTA_oVCAN_RADAR_55f88417_Tx: DynamicLength=false, J1939Requestable=true, PduLength=8, MetaDataTypeRef=EcucPduCollection/CAN_ID_32
        SR1_DIAG_RES_PHY_OTA_oVCAN_RADAR_1159a10f_Tx: DynamicLength=false, J1939Requestable=true, PduLength=8, MetaDataTypeRef=EcucPduCollection/CAN_ID_32
        TPCM_SR1_oVCAN_RADAR_a323b0bc_Tx: DynamicLength=false, J1939Requestable=true, PduLength=8, MetaDataTypeRef=EcucPduCollection/CAN_ID_32
        PCAN_DIAG_REQ_PHYS_OTA_Tp_oPCAN_RADAR_94a46e49_Rx: DynamicLength=false, PduLength=64, J1939Requestable=false, SysTPduToFrameMappingRef=PCAN_DIAG_REQ_PHYS_OTA_Tp
        PCAN_DIAG_RESP_PHYS_OTA_oPCAN_RADAR_4fa3c8f0_Tx: DynamicLength=true, PduLength=64, J1939Requestable=false
        FR_DIAG_REQ_PHY_OTA_oVCAN_RADAR_7facfb76_Rx: DynamicLength=true, PduLength=8, J1939Requestable=false
        SR2_DIAG_REQ_PHY_OBD1_oVCAN_RADAR_7a08c544_Rx: DynamicLength=false, J1939Requestable=true, PduLength=8, SysTPduToFrameMappingRef=SR2_DIAG_REQ_PHY_OBD1
        RDR_FUSION_STATUS_002_oPCAN_RADAR_edd87150_Rx: DynamicLength=false, PduLength=64, J1939Requestable=false, SysTPduToFrameMappingRef=RDR_FUSION_STATUS_002
        SR1_DIAG_RES_PHY_OBD1_oVCAN_RADAR_6638d82d_Tx: DynamicLength=false, J1939Requestable=true, PduLength=8, SysTPduToFrameMappingRef=SR1_DIAG_RES_PHY_OBD1
        SR1_DIAG_RES_PHY_OBD1_oVCAN_RADAR_aa3541fd_Tx: DynamicLength=false, J1939Requestable=true, PduLength=8, MetaDataTypeRef=EcucPduCollection/CAN_ID_32
        FR_DIAG_REQ_PHY_PLANT_oVCAN_RADAR_d1c8c991_Rx: DynamicLength=true, PduLength=8, J1939Requestable=false
        SRR_FL_DIAG_RESP_PHYS_OBD2_Rx_oPCAN_RADAR_7e9b2541_Rx: PduLength=64, J1939Requestable=false, SysTPduToFrameMappingRef=SRR_FL_DIAG_RESP_PHYS_OBD2_Rx
        SR2_DIAG_RES_PHY_PLANT_oVCAN_RADAR_20ab64b4_Tx: DynamicLength=false, J1939Requestable=true, PduLength=8, SysTPduToFrameMappingRef=SR2_DIAG_RES_PHY_PLANT
        RDR_FUSION_ALIGNMENT_STATUS_001_oPCAN_RADAR_e2456918_Rx: DynamicLength=false, PduLength=64, J1939Requestable=false, SysTPduToFrameMappingRef=RDR_FUSION_ALIGNMENT_STATUS_001
        FR_DIAG_RES_PHY_OBD1_oVCAN_RADAR_cd47a295_Tx: DynamicLength=true, PduLength=8, J1939Requestable=false
        FR_DIAG_RES_PHY_PLANT_oVCAN_RADAR_5fef2467_Tx: DynamicLength=true, PduLength=8, J1939Requestable=false
        PCAN_DIAG_REQ_FUNC_OBD1_Tp_oPCAN_RADAR_20_9397638b_Rx: DynamicLength=false, PduLength=8, J1939Requestable=false, SysTPduToFrameMappingRef=PCAN_DIAG_REQ_FUNC_OBD1_Tp
        DIAG_REQ_FNC_OBD2_oVCAN_RADAR_57874f35_Rx: DynamicLength=true, PduLength=7, J1939Requestable=false
        PCAN_DIAG_REQ_FUNC_OTA_oPCAN_RADAR_20_4ceedd9c_Rx: DynamicLength=true, PduLength=7, J1939Requestable=false
        SRR_FL_DIAG_REQ_PHYS_PLANT_Tx_oPCAN_RADAR_a38832c1_Tx: PduLength=64, J1939Requestable=false, SysTPduToFrameMappingRef=SRR_FL_DIAG_REQ_PHYS_PLANT_Tx
        SR1_DIAG_REQ_PHY_OBD1_oVCAN_RADAR_8465887d_Rx: DynamicLength=false, J1939Requestable=true, PduLength=8
        TPDT_B1_oVCAN_RADAR_8b1102fa_Tx: DynamicLength=false, J1939Requestable=true, PduLength=8, SysTPduToFrameMappingRef=TPDT_B1
        FR_DIAG_RES_PHY_OTA_Tp_oVCAN_RADAR_19b4e511_Tx: DynamicLength=false, PduLength=8, J1939Requestable=false, SysTPduToFrameMappingRef=FR_DIAG_RES_PHY_OTA_Tp
        FR_DIAG_RES_PHY_OBD1_Tp_oVCAN_RADAR_41a76716_Tx: DynamicLength=false, PduLength=8, J1939Requestable=false, SysTPduToFrameMappingRef=FR_DIAG_RES_PHY_OBD1_Tp
        SR2_DIAG_RES_PHY_OBD1_oVCAN_RADAR_b91d788e_Tx: DynamicLength=false, J1939Requestable=true, PduLength=8, MetaDataTypeRef=EcucPduCollection/CAN_ID_32
        PCAN_DIAG_RESP_PHYS_OBD1_Tp_oPCAN_RADAR_0aebd6ab_Tx: DynamicLength=false, PduLength=64, J1939Requestable=false, SysTPduToFrameMappingRef=PCAN_DIAG_RESP_PHYS_OBD1_Tp
        FR_DIAG_REQ_PHY_OBD2_Tp_oVCAN_RADAR_b91a4a31_Rx: DynamicLength=false, PduLength=8, J1939Requestable=false, SysTPduToFrameMappingRef=FR_DIAG_REQ_PHY_OBD2_Tp
        PCAN_DIAG_RESP_PHYS_PLANT_oPCAN_RADAR_cfac777e_Tx: DynamicLength=true, PduLength=64, J1939Requestable=false
        DIAG_REQ_FNC_PLANT_oVCAN_RADAR_9fd4cadc_Rx: DynamicLength=true, PduLength=7, J1939Requestable=false
        GW_ETC2_03_oPCAN_RADAR_766d20c0_Rx: DynamicLength=false, PduLength=8, J1939Requestable=false, SysTPduToFrameMappingRef=GW_ETC2_03
        SR1_DIAG_RES_PHY_PLANT_oVCAN_RADAR_76f7178b_Tx: DynamicLength=false, J1939Requestable=true, PduLength=8, MetaDataTypeRef=EcucPduCollection/CAN_ID_32
        SRR_RL_DIAG_RESP_PHYS_OTA_Rx_oPCAN_RADAR_eba387b4_Rx: PduLength=64, J1939Requestable=false, SysTPduToFrameMappingRef=SRR_RL_DIAG_RESP_PHYS_OTA_Rx
        PCAN_DIAG_REQ_PHYS_OBD1_oPCAN_RADAR_20_f19508d6_Rx: DynamicLength=true, PduLength=8, J1939Requestable=false
        PCAN_DIAG_REQ_FUNC_OBD2_oPCAN_RADAR_e2bd2c08_Rx: DynamicLength=true, PduLength=62, J1939Requestable=false
        PCAN_DIAG_REQ_PHYS_PLANT_oPCAN_RADAR_20_93ccff8e_Rx: DynamicLength=true, PduLength=8, J1939Requestable=false
        DIAG_REQ_FNC_PLANT_oVCAN_RADAR_42eb2f27_Rx: DynamicLength=true, PduLength=7, J1939Requestable=false
        SR1_DIAG_REQ_PHY_OTA_oVCAN_RADAR_f59da072_Rx: DynamicLength=false, J1939Requestable=true, PduLength=8
        SRR_RL_DIAG_REQ_PHYS_PLANT_Tx_oPCAN_RADAR_90ff5b50_Tx: PduLength=64, J1939Requestable=false, SysTPduToFrameMappingRef=SRR_RL_DIAG_REQ_PHYS_PLANT_Tx
        SR1_DIAG_REQ_PHY_OBD2_oVCAN_RADAR_a42d66a5_Rx: DynamicLength=false, J1939Requestable=true, PduLength=8, SysTPduToFrameMappingRef=SR1_DIAG_REQ_PHY_OBD2
        SR2_DIAG_REQ_PHY_OBD2_oVCAN_RADAR_211f7451_Rx: DynamicLength=false, J1939Requestable=true, PduLength=8, SysTPduToFrameMappingRef=SR2_DIAG_REQ_PHY_OBD2
        RDR_CM_B1_Rx_oPCAN_RADAR_a03442fa_Rx: PduLength=8, J1939Requestable=false, SysTPduToFrameMappingRef=RDR_CM_B1_Rx, MetaDataTypeRef=EcucPduCollection/CAN_ID_32 if post-build-variant-condition{matching-criterion=RDR_POS, value=0}
        PCAN_DIAG_REQ_FUNC_OBD1_Tp_oPCAN_RADAR_ba721e23_Rx: DynamicLength=false, PduLength=64, J1939Requestable=false, SysTPduToFrameMappingRef=PCAN_DIAG_REQ_FUNC_OBD1_Tp
        GW_prop_ADAS_BSIS_info_oPCAN_RADAR_2b91b919_Tx: DynamicLength=false, PduLength=8, J1939Requestable=false, SysTPduToFrameMappingRef=GW_prop_ADAS_BSIS_info
        SR2_DIAG_RES_PHY_OBD1_oVCAN_RADAR_e30acad9_Tx: DynamicLength=false, J1939Requestable=true, PduLength=8, SysTPduToFrameMappingRef=SR2_DIAG_RES_PHY_OBD1
        SR1_DIAG_RES_PHY_PLANT_oVCAN_RADAR_9afe60a3_Tx: DynamicLength=false, J1939Requestable=true, PduLength=8, SysTPduToFrameMappingRef=SR1_DIAG_RES_PHY_PLANT
        PCAN_DIAG_REQ_PHYS_PLANT_oPCAN_RADAR_a4e456d5_Rx: DynamicLength=true, PduLength=64, J1939Requestable=false
        RDR_DT_B1_Rx_oPCAN_RADAR_3eed4299_Rx: PduLength=8, J1939Requestable=false, SysTPduToFrameMappingRef=RDR_DT_B1_Rx
        TPCM_SR2_oVCAN_RADAR_19e46f16_Tx: DynamicLength=false, J1939Requestable=true, PduLength=8, MetaDataTypeRef=EcucPduCollection/CAN_ID_32 if post-build-variant-condition{matching-criterion=RDR_POS, value=0}, SysTPduToFrameMappingRef=TPCM_SR2
        PCAN_DIAG_REQ_PHYS_PLANT_oPCAN_RADAR_214e1a1c_Rx: DynamicLength=true, PduLength=64, J1939Requestable=false
        SR2_DIAG_REQ_PHY_OTA_oVCAN_RADAR_68e239a7_Rx: DynamicLength=false, J1939Requestable=true, PduLength=8, SysTPduToFrameMappingRef=SR2_DIAG_REQ_PHY_OTA
        PCAN_DIAG_REQ_FUNC_PLANT_oPCAN_RADAR_20_3b79581e_Rx: DynamicLength=true, PduLength=7, J1939Requestable=false
        DIAG_REQ_FNC_OTA_oVCAN_RADAR_b630c1e5_Rx: DynamicLength=true, PduLength=7, J1939Requestable=false
        RDR_CM_B0_Rx_oPCAN_RADAR_5d656100_Rx: PduLength=8, J1939Requestable=false
        SR2_DIAG_REQ_PHY_PLANT_oVCAN_RADAR_ae8c8942_Rx: DynamicLength=false, J1939Requestable=true, PduLength=8, SysTPduToFrameMappingRef=SR2_DIAG_REQ_PHY_PLANT
        prop_ADAS_BSIS_info_oVCAN_RADAR_8fdff4c8_Tx: DynamicLength=false, J1939Requestable=true, PduLength=8
        SR1_DIAG_RES_PHY_OBD2_oVCAN_RADAR_3d2f6938_Tx: DynamicLength=false, J1939Requestable=true, PduLength=8, SysTPduToFrameMappingRef=SR1_DIAG_RES_PHY_OBD2
        SRR_RL_DIAG_REQ_PHYS_OTA_Tx_oPCAN_RADAR_2e7c92c0_Tx: PduLength=64, J1939Requestable=false, SysTPduToFrameMappingRef=SRR_RL_DIAG_REQ_PHYS_OTA_Tx
        FR_DIAG_RES_PHY_PLANT_Tp_oVCAN_RADAR_4233d42d_Tx: DynamicLength=false, PduLength=8, J1939Requestable=false, SysTPduToFrameMappingRef=FR_DIAG_RES_PHY_PLANT_Tp
        PCAN_DIAG_RESP_PHYS_OTA_Tp_oPCAN_RADAR_20_6c821aae_Tx: DynamicLength=false, PduLength=8, J1939Requestable=false, SysTPduToFrameMappingRef=PCAN_DIAG_RESP_PHYS_OTA_Tp
        RDR_FUSION_STATUS_002_oPCAN_RADAR_36391f53_Rx: DynamicLength=false, PduLength=64, J1939Requestable=false
        SOFT_D0_oVCAN_RADAR_027b5984_Tx: DynamicLength=false, J1939Requestable=true, PduLength=8
        PCAN_DIAG_REQ_PHYS_OTA_Tp_oPCAN_RADAR_20_96582344_Rx: DynamicLength=false, PduLength=8, J1939Requestable=false, SysTPduToFrameMappingRef=PCAN_DIAG_REQ_PHYS_OTA_Tp
        PCAN_DIAG_REQ_FUNC_OBD2_Tp_oPCAN_RADAR_de9265dd_Rx: DynamicLength=false, PduLength=64, J1939Requestable=false, SysTPduToFrameMappingRef=PCAN_DIAG_REQ_FUNC_OBD2_Tp
        PCAN_DIAG_REQ_FUNC_OBD2_Tp_oPCAN_RADAR_20_400c7f70_Rx: DynamicLength=false, PduLength=8, J1939Requestable=false, SysTPduToFrameMappingRef=PCAN_DIAG_REQ_FUNC_OBD2_Tp
        RDR_CM_B0_Rx_oPCAN_RADAR_3544966f_Rx: PduLength=8, J1939Requestable=false, SysTPduToFrameMappingRef=RDR_CM_B0_Rx
        PCAN_DIAG_REQ_PHYS_OBD2_oPCAN_RADAR_e03546e9_Rx: DynamicLength=true, PduLength=64, J1939Requestable=false
        FR_DIAG_RES_PHY_OBD2_Tp_oVCAN_RADAR_25471ce8_Tx: DynamicLength=false, PduLength=8, J1939Requestable=false, SysTPduToFrameMappingRef=FR_DIAG_RES_PHY_OBD2_Tp
        PCAN_DIAG_REQ_FUNC_PLANT_Tp_oPCAN_RADAR_20_d63751cc_Rx: DynamicLength=false, PduLength=8, J1939Requestable=false, SysTPduToFrameMappingRef=PCAN_DIAG_REQ_FUNC_PLANT_Tp
        PCAN_DIAG_RESP_PHYS_OBD1_Tp_oPCAN_RADAR_20_f6415fa5_Tx: DynamicLength=false, PduLength=8, J1939Requestable=false, SysTPduToFrameMappingRef=PCAN_DIAG_RESP_PHYS_OBD1_Tp
        PCAN_DIAG_REQ_FUNC_OBD2_oPCAN_RADAR_20_c04e56a1_Rx: DynamicLength=true, PduLength=7, J1939Requestable=false
        SR1_DIAG_REQ_PHY_PLANT_oVCAN_RADAR_14d98d55_Rx: DynamicLength=false, J1939Requestable=true, PduLength=8, SysTPduToFrameMappingRef=SR1_DIAG_REQ_PHY_PLANT
        PCAN_DIAG_REQ_FUNC_OBD1_oPCAN_RADAR_20_e986e253_Rx: DynamicLength=true, PduLength=7, J1939Requestable=false
        GW_ETC2_03_Tx_oPCAN_RADAR_07adbeb0_Tx: PduLength=8, J1939Requestable=false, SysTPduToFrameMappingRef=GW_ETC2_03_Tx
        PCAN_DIAG_RESP_PHYS_PLANT_Tp_oPCAN_RADAR_bd11d57f_Tx: DynamicLength=false, PduLength=64, J1939Requestable=false, SysTPduToFrameMappingRef=PCAN_DIAG_RESP_PHYS_PLANT_Tp
        SRR_RL_DIAG_RESP_PHYS_OBD1_Rx_oPCAN_RADAR_290c372e_Rx: PduLength=64, J1939Requestable=false, SysTPduToFrameMappingRef=SRR_RL_DIAG_RESP_PHYS_OBD1_Rx
        PCAN_DIAG_REQ_FUNC_OBD1_oPCAN_RADAR_5664bded_Rx: DynamicLength=true, PduLength=62, J1939Requestable=false
        PCAN_DIAG_RESP_PHYS_PLANT_oPCAN_RADAR_20_0a0c318a_Tx: DynamicLength=true, PduLength=8, J1939Requestable=false
        TPDT_B0_oVCAN_RADAR_bc67f1ce_Tx: DynamicLength=false, J1939Requestable=true, PduLength=8, MetaDataTypeRef=EcucPduCollection/CAN_ID_32
        PCAN_DIAG_REQ_PHYS_OBD2_oPCAN_RADAR_20_95757328_Rx: DynamicLength=true, PduLength=8, J1939Requestable=false
        SRR_FL_DIAG_REQ_PHYS_OTA_Tx_oPCAN_RADAR_ebda6543_Tx: PduLength=64, J1939Requestable=false, SysTPduToFrameMappingRef=SRR_FL_DIAG_REQ_PHYS_OTA_Tx
        PCAN_DIAG_REQ_PHYS_PLANT_Tp_oPCAN_RADAR_68155c61_Rx: DynamicLength=false, PduLength=64, J1939Requestable=false, SysTPduToFrameMappingRef=PCAN_DIAG_REQ_PHYS_PLANT_Tp
        PCAN_DIAG_REQ_PHYS_OTA_oPCAN_RADAR_1f79965d_Rx: DynamicLength=true, PduLength=64, J1939Requestable=false
        PCAN_DIAG_RESP_PHYS_PLANT_oPCAN_RADAR_20_22a7f120_Tx: DynamicLength=true, PduLength=8, J1939Requestable=false
        SR1_DIAG_RES_PHY_OBD2_oVCAN_RADAR_17ff2d33_Tx: DynamicLength=false, J1939Requestable=true, PduLength=8, MetaDataTypeRef=EcucPduCollection/CAN_ID_32
        PCAN_DIAG_RESP_PHYS_PLANT_Tp_oPCAN_RADAR_20_0a848a3f_Tx: DynamicLength=false, PduLength=8, J1939Requestable=false, SysTPduToFrameMappingRef=PCAN_DIAG_RESP_PHYS_PLANT_Tp
        PCAN_DIAG_RESP_PHYS_OBD1_oPCAN_RADAR_20_f26199fd_Tx: DynamicLength=true, PduLength=8, J1939Requestable=false
        PCAN_DIAG_REQ_FUNC_OTA_Tp_oPCAN_RADAR_20_0a67f2f6_Rx: DynamicLength=false, PduLength=8, J1939Requestable=false, SysTPduToFrameMappingRef=PCAN_DIAG_REQ_FUNC_OTA_Tp
        FR_DIAG_RES_PHY_OBD1_oVCAN_RADAR_add2b4bf_Tx: DynamicLength=true, PduLength=8, J1939Requestable=false
        SRR_RL_DIAG_REQ_PHYS_OBD1_Tx_oPCAN_RADAR_697bc1d9_Tx: PduLength=64, J1939Requestable=false, SysTPduToFrameMappingRef=SRR_RL_DIAG_REQ_PHYS_OBD1_Tx
        PCAN_DIAG_RESP_PHYS_OBD2_oPCAN_RADAR_df0882d3_Tx: DynamicLength=true, PduLength=64, J1939Requestable=false
        PCAN_DIAG_RESP_PHYS_OBD2_oPCAN_RADAR_20_dba92d0f_Tx: DynamicLength=true, PduLength=8, J1939Requestable=false
        PCAN_DIAG_REQ_PHYS_OTA_oPCAN_RADAR_20_39ae8dba_Rx: DynamicLength=true, PduLength=8, J1939Requestable=false
        PCAN_DIAG_REQ_PHYS_OBD1_oPCAN_RADAR_20_3bfe27fe_Rx: DynamicLength=true, PduLength=8, J1939Requestable=false
        prop_ADAS_MOIS_info_oVCAN_RADAR_f03aed28_Tx: DynamicLength=false, J1939Requestable=true, PduLength=8
        RDR_DT_B1_Rx_oPCAN_RADAR_df48f0d5_Rx: PduLength=8, J1939Requestable=false
        PCAN_DIAG_RESP_PHYS_OTA_oPCAN_RADAR_20_aa3008c9_Tx: DynamicLength=true, PduLength=8, J1939Requestable=false
        PCAN_DIAG_REQ_PHYS_OBD1_Tp_oPCAN_RADAR_6e232c89_Rx: DynamicLength=false, PduLength=64, J1939Requestable=false, SysTPduToFrameMappingRef=PCAN_DIAG_REQ_PHYS_OBD1_Tp
        PCAN_DIAG_REQ_FUNC_OBD1_oPCAN_RADAR_b9aa9d1d_Rx: DynamicLength=true, PduLength=62, J1939Requestable=false
        PCAN_DIAG_REQ_FUNC_PLANT_oPCAN_RADAR_8e17ec17_Rx: DynamicLength=true, PduLength=62, J1939Requestable=false
        prop_ADAS_BSIS_info_oVCAN_RADAR_a7fddec0_Tx: DynamicLength=false, J1939Requestable=true, PduLength=8, SysTPduToFrameMappingRef=prop_ADAS_BSIS_info
        PCAN_DIAG_RESP_PHYS_OBD2_Tp_oPCAN_RADAR_6e0bad55_Tx: DynamicLength=false, PduLength=64, J1939Requestable=false, SysTPduToFrameMappingRef=PCAN_DIAG_RESP_PHYS_OBD2_Tp
        PCAN_DIAG_REQ_PHYS_PLANT_Tp_oPCAN_RADAR_20_f110e38b_Rx: DynamicLength=false, PduLength=8, J1939Requestable=false, SysTPduToFrameMappingRef=PCAN_DIAG_REQ_PHYS_PLANT_Tp
        FR_DIAG_REQ_PHY_OBD1_Tp_oVCAN_RADAR_ddfa31cf_Rx: DynamicLength=false, PduLength=8, J1939Requestable=false, SysTPduToFrameMappingRef=FR_DIAG_REQ_PHY_OBD1_Tp
        PCAN_DIAG_REQ_PHYS_OBD1_oPCAN_RADAR_caf5eb16_Rx: DynamicLength=true, PduLength=64, J1939Requestable=false
        PCAN_DIAG_REQ_PHYS_OTA_oPCAN_RADAR_45eab9fd_Rx: DynamicLength=true, PduLength=64, J1939Requestable=false
        GW_ETC2_03_oPCAN_RADAR_7791e995_Rx: DynamicLength=false, PduLength=8, J1939Requestable=false
        RDR_FUSION_ALIGNMENT_STATUS_002_oPCAN_RADAR_b952d80d_Rx: DynamicLength=false, PduLength=64, J1939Requestable=false, SysTPduToFrameMappingRef=RDR_FUSION_ALIGNMENT_STATUS_002
        RDR_prop_ADAS_BSIS_info_oPCAN_RADAR_e19e3fbb_Rx: PduLength=8, J1939Requestable=false, SysTPduToFrameMappingRef=RDR_prop_ADAS_BSIS_info
        SR2_DIAG_RES_PHY_OBD2_oVCAN_RADAR_b81d7bcc_Tx: DynamicLength=false, J1939Requestable=true, PduLength=8, SysTPduToFrameMappingRef=SR2_DIAG_RES_PHY_OBD2
        TPDT_B1_oVCAN_RADAR_61f1284b_Tx: DynamicLength=false, J1939Requestable=true, PduLength=8, MetaDataTypeRef=EcucPduCollection/CAN_ID_32
        FR_DIAG_REQ_PHY_PLANT_Tp_oVCAN_RADAR_bda0e30b_Rx: DynamicLength=false, PduLength=8, J1939Requestable=false, SysTPduToFrameMappingRef=FR_DIAG_REQ_PHY_PLANT_Tp
        SR2_DIAG_RES_PHY_OTA_oVCAN_RADAR_63bc1ea4_Tx: DynamicLength=false, J1939Requestable=true, PduLength=8, SysTPduToFrameMappingRef=SR2_DIAG_RES_PHY_OTA
        PCAN_DIAG_REQ_FUNC_OTA_oPCAN_RADAR_20_e1100275_Rx: DynamicLength=true, PduLength=7, J1939Requestable=false
        PCAN_DIAG_REQ_FUNC_PLANT_oPCAN_RADAR_f6414098_Rx: DynamicLength=true, PduLength=62, J1939Requestable=false
        FR_DIAG_REQ_PHY_OBD1_oVCAN_RADAR_83827d3f_Rx: DynamicLength=true, PduLength=8, J1939Requestable=false
        FR_DIAG_REQ_PHY_PLANT_oVCAN_RADAR_03b4032b_Rx: DynamicLength=true, PduLength=8, J1939Requestable=false
        SR2_DIAG_REQ_PHY_PLANT_oVCAN_RADAR_527eccdd_Rx: DynamicLength=false, J1939Requestable=true, PduLength=8
        TPCM_SR1_oVCAN_RADAR_42f3de03_Tx: DynamicLength=false, J1939Requestable=true, PduLength=8, SysTPduToFrameMappingRef=TPCM_SR1
        FR_DIAG_REQ_PHY_OBD1_oVCAN_RADAR_5445ad08_Rx: DynamicLength=true, PduLength=8, J1939Requestable=false
        FR_DIAG_RES_PHY_OTA_oVCAN_RADAR_9ad9d3d9_Tx: DynamicLength=true, PduLength=8, J1939Requestable=false
        FR_DIAG_RES_PHY_OTA_oVCAN_RADAR_9b68fa0b_Tx: DynamicLength=true, PduLength=8, J1939Requestable=false
        FR_DIAG_REQ_PHY_OTA_Tp_oVCAN_RADAR_4de495d5_Rx: DynamicLength=false, PduLength=8, J1939Requestable=false, SysTPduToFrameMappingRef=FR_DIAG_REQ_PHY_OTA_Tp
        SR1_DIAG_REQ_PHY_PLANT_oVCAN_RADAR_9b61c462_Rx: DynamicLength=false, J1939Requestable=true, PduLength=8
        SR1_DIAG_REQ_PHY_OBD2_oVCAN_RADAR_39afe4b3_Rx: DynamicLength=false, J1939Requestable=true, PduLength=8
        PCAN_DIAG_RESP_PHYS_OTA_oPCAN_RADAR_20_a840a80f_Tx: DynamicLength=true, PduLength=8, J1939Requestable=false
        SRR_RL_DIAG_RESP_PHYS_OBD2_Rx_oPCAN_RADAR_4dec4cd0_Rx: PduLength=64, J1939Requestable=false, SysTPduToFrameMappingRef=SRR_RL_DIAG_RESP_PHYS_OBD2_Rx
        SR2_DIAG_REQ_PHY_OBD1_oVCAN_RADAR_974db10e_Rx: DynamicLength=false, J1939Requestable=true, PduLength=8
        FR_DIAG_RES_PHY_OBD2_oVCAN_RADAR_1018d871_Tx: DynamicLength=true, PduLength=8, J1939Requestable=false
        SR1_DIAG_REQ_PHY_OTA_oVCAN_RADAR_3fc015f5_Rx: DynamicLength=false, J1939Requestable=true, PduLength=8, SysTPduToFrameMappingRef=SR1_DIAG_REQ_PHY_OTA
        GW_prop_ADAS_BSIS_info_oPCAN_RADAR_f2d61fec_Tx: DynamicLength=false, PduLength=8, J1939Requestable=false
        PCAN_DIAG_REQ_PHYS_OBD2_Tp_oPCAN_RADAR_0ac35777_Rx: DynamicLength=false, PduLength=64, J1939Requestable=false, SysTPduToFrameMappingRef=PCAN_DIAG_REQ_PHYS_OBD2_Tp
        PCAN_DIAG_RESP_PHYS_OBD2_oPCAN_RADAR_20_f1bd890a_Tx: DynamicLength=true, PduLength=8, J1939Requestable=false
        SRR_FL_DIAG_RESP_PHYS_OBD1_Rx_oPCAN_RADAR_1a7b5ebf_Rx: PduLength=64, J1939Requestable=false, SysTPduToFrameMappingRef=SRR_FL_DIAG_RESP_PHYS_OBD1_Rx
        PCAN_DIAG_REQ_PHYS_PLANT_oPCAN_RADAR_20_f7a3783e_Rx: DynamicLength=true, PduLength=8, J1939Requestable=false
        PCAN_DIAG_RESP_PHYS_OBD1_oPCAN_RADAR_572eb9fe_Tx: DynamicLength=true, PduLength=64, J1939Requestable=false
        DIAG_REQ_FNC_OBD2_Tp_oVCAN_RADAR_42ec9761_Rx: DynamicLength=false, PduLength=8, J1939Requestable=false, SysTPduToFrameMappingRef=DIAG_REQ_FNC_OBD2_Tp
        SRR_RL_DIAG_REQ_PHYS_OBD2_Tx_oPCAN_RADAR_0d9bba27_Tx: PduLength=64, J1939Requestable=false, SysTPduToFrameMappingRef=SRR_RL_DIAG_REQ_PHYS_OBD2_Tx
        FR_DIAG_REQ_PHY_OTA_oVCAN_RADAR_9187f4da_Rx: DynamicLength=true, PduLength=8, J1939Requestable=false
        PCAN_DIAG_REQ_FUNC_OBD2_oPCAN_RADAR_20_41244182_Rx: DynamicLength=true, PduLength=7, J1939Requestable=false
        RDR_CM_B1_Rx_oPCAN_RADAR_f30df091_Rx: PduLength=8, J1939Requestable=false
        TPDT_B0_oVCAN_RADAR_bde39209_Tx: DynamicLength=false, J1939Requestable=true, PduLength=8, SysTPduToFrameMappingRef=TPDT_B0
        PCAN_DIAG_REQ_FUNC_PLANT_oPCAN_RADAR_20_c17463fa_Rx: DynamicLength=true, PduLength=7, J1939Requestable=false
        SR2_DIAG_RES_PHY_OBD2_oVCAN_RADAR_04d71440_Tx: DynamicLength=false, J1939Requestable=true, PduLength=8, MetaDataTypeRef=EcucPduCollection/CAN_ID_32
        SRR_RL_DIAG_RESP_PHYS_PLANT_Rx_oPCAN_RADAR_a4bcd7de_Rx: PduLength=64, J1939Requestable=false, SysTPduToFrameMappingRef=SRR_RL_DIAG_RESP_PHYS_PLANT_Rx
        RDR_DT_B0_Rx_oPCAN_RADAR_ab9d960c_Rx: PduLength=8, J1939Requestable=false, SysTPduToFrameMappingRef=RDR_DT_B0_Rx
        RDR_FUSION_CAPABILITY_oPCAN_RADAR_2f1662f1_Rx: DynamicLength=false, PduLength=64, J1939Requestable=false, SysTPduToFrameMappingRef=RDR_FUSION_CAPABILITY
        PCAN_DIAG_RESP_PHYS_OTA_oPCAN_RADAR_2a569d3c_Tx: DynamicLength=true, PduLength=64, J1939Requestable=false
        DIAG_REQ_FNC_PLANT_Tp_oVCAN_RADAR_d6304422_Rx: DynamicLength=false, PduLength=8, J1939Requestable=false, SysTPduToFrameMappingRef=DIAG_REQ_FNC_PLANT_Tp
        PCAN_DIAG_REQ_FUNC_OTA_oPCAN_RADAR_a013523e_Rx: DynamicLength=true, PduLength=62, J1939Requestable=false
        SRR_FL_DIAG_RESP_PHYS_PLANT_Rx_oPCAN_RADAR_23870365_Rx: PduLength=64, J1939Requestable=false, SysTPduToFrameMappingRef=SRR_FL_DIAG_RESP_PHYS_PLANT_Rx
        PCAN_DIAG_REQ_FUNC_OBD1_oPCAN_RADAR_20_25c43a7c_Rx: DynamicLength=true, PduLength=7, J1939Requestable=false
        PCAN_DIAG_RESP_PHYS_PLANT_oPCAN_RADAR_339eb858_Tx: DynamicLength=true, PduLength=64, J1939Requestable=false
        RDR_FUSION_ALIGNMENT_STATUS_002_oPCAN_RADAR_e1715b9f_Rx: DynamicLength=false, PduLength=64, J1939Requestable=false
        FR_DIAG_REQ_PHY_OBD2_oVCAN_RADAR_0f521c1d_Rx: DynamicLength=true, PduLength=8, J1939Requestable=false
        SR2_DIAG_REQ_PHY_OTA_oVCAN_RADAR_b13c856a_Rx: DynamicLength=false, J1939Requestable=true, PduLength=8
        PCAN_DIAG_REQ_PHYS_OBD1_oPCAN_RADAR_bb22f7fc_Rx: DynamicLength=true, PduLength=64, J1939Requestable=false
        PCAN_DIAG_REQ_PHYS_OTA_oPCAN_RADAR_20_0b124a16_Rx: DynamicLength=true, PduLength=8, J1939Requestable=false
        PCAN_DIAG_RESP_PHYS_OBD2_Tp_oPCAN_RADAR_20_25da435e_Tx: DynamicLength=false, PduLength=8, J1939Requestable=false, SysTPduToFrameMappingRef=PCAN_DIAG_RESP_PHYS_OBD2_Tp
        FR_DIAG_REQ_PHY_OBD2_oVCAN_RADAR_3e4811f1_Rx: DynamicLength=true, PduLength=8, J1939Requestable=false
        PCAN_DIAG_RESP_PHYS_OBD2_oPCAN_RADAR_0c3908eb_Tx: DynamicLength=true, PduLength=64, J1939Requestable=false
        SRR_FL_DIAG_RESP_PHYS_OTA_Rx_oPCAN_RADAR_9fd7f3d9_Rx: PduLength=64, J1939Requestable=false, SysTPduToFrameMappingRef=SRR_FL_DIAG_RESP_PHYS_OTA_Rx
        PCAN_DIAG_RESP_PHYS_OBD1_oPCAN_RADAR_62c2ee1d_Tx: DynamicLength=true, PduLength=64, J1939Requestable=false
        DIAG_REQ_FNC_OBD1_Tp_oVCAN_RADAR_260cec9f_Rx: DynamicLength=false, PduLength=8, J1939Requestable=false, SysTPduToFrameMappingRef=DIAG_REQ_FNC_OBD1_Tp
        prop_ADAS_MOIS_info_oVCAN_RADAR_21657ab6_Tx: DynamicLength=false, J1939Requestable=true, PduLength=8, SysTPduToFrameMappingRef=prop_ADAS_MOIS_info
        TPCM_SR2_oVCAN_RADAR_1ee9dc72_Tx: DynamicLength=false, J1939Requestable=true, PduLength=8, MetaDataTypeRef=EcucPduCollection/CAN_ID_32
        DIAG_REQ_FNC_OBD1_oVCAN_RADAR_7e5c8685_Rx: DynamicLength=true, PduLength=7, J1939Requestable=false
        DIAG_REQ_FNC_OTA_Tp_oVCAN_RADAR_6f75a08a_Rx: DynamicLength=false, PduLength=8, J1939Requestable=false, SysTPduToFrameMappingRef=DIAG_REQ_FNC_OTA_Tp
        PCAN_DIAG_REQ_PHYS_OBD2_Tp_oPCAN_RADAR_20_65ff9201_Rx: DynamicLength=false, PduLength=8, J1939Requestable=false, SysTPduToFrameMappingRef=PCAN_DIAG_REQ_PHYS_OBD2_Tp
        RDR_DT_B0_Rx_oPCAN_RADAR_71206144_Rx: PduLength=8, J1939Requestable=false
        SRR_FL_DIAG_REQ_PHYS_OBD1_Tx_oPCAN_RADAR_1d0fb5b4_Tx: PduLength=64, J1939Requestable=false, SysTPduToFrameMappingRef=SRR_FL_DIAG_REQ_PHYS_OBD1_Tx
        FR_DIAG_RES_PHY_OBD2_oVCAN_RADAR_96501380_Tx: DynamicLength=true, PduLength=8, J1939Requestable=false
        DIAG_REQ_FNC_OBD1_oVCAN_RADAR_ea4d23fb_Rx: DynamicLength=true, PduLength=7, J1939Requestable=false
        SYS_TIME_SYNC_Mx20_oPCAN_RADAR_7e798636_Tx: DynamicLength=false, PduLength=8, J1939Requestable=false, variation-point=post-build-variant-condition{matching-criterion=RDR_POS, value=4}
        SYS_TIME_SYNC_Mx28_oPCAN_RADAR_247a555b_Tx: DynamicLength=false, PduLength=8, J1939Requestable=false, variation-point=post-build-variant-condition{matching-criterion=RDR_POS, value=4}
        SYS_TIME_SYNC_Mx_oPCAN_RADAR_91ffd000_Tx: DynamicLength=false, PduLength=8, J1939Requestable=false, variation-point=post-build-variant-condition{matching-criterion=RDR_POS, value=4}
        SYS_TIME_SYNC_oPCAN_RADAR_ba7b9b28_Tx: DynamicLength=false, PduLength=8, J1939Requestable=false, SysTPduToFrameMappingRef=SYS_TIME_SYNC, variation-point=post-build-variant-condition{matching-criterion=RDR_POS, value=4}
        SYS_TIME_SYNC_oPCAN_RADAR_e9d0a20b_Tx: DynamicLength=false, PduLength=8, J1939Requestable=false, variation-point=post-build-variant-condition{matching-criterion=RDR_POS, value=4}
        SYS_TIME_SYNC_oPCAN_RADAR_ba7b9b28_Rx: DynamicLength=false, PduLength=8, J1939Requestable=false, SysTPduToFrameMappingRef=SYS_TIME_SYNC, variation-point=post-build-variant-condition{matching-criterion=RDR_POS, value={1..3}}
        SYS_TIME_SYNC_oPCAN_RADAR_ba7b9b28_Rx: DynamicLength=false, PduLength=8, J1939Requestable=false, SysTPduToFrameMappingRef=SYS_TIME_SYNC, variation-point=post-build-variant-condition{matching-criterion=RDR_POS, value={5..7}}
        DM1_B0_Rx_oPCAN_RADAR_6b6541a3_Rx: PduLength=22, J1939Requestable=false, SysTPduToFrameMappingRef=DM1_B0_Rx
        DM1_B0_oVCAN_RADAR_15753e9e_Tx: DynamicLength=true, PduLength=8, J1939Requestable=true, SysTPduToFrameMappingRef=DM1_B0
        DM1_B1_Rx_oPCAN_RADAR_fe159536_Rx: PduLength=22, J1939Requestable=false, SysTPduToFrameMappingRef=DM1_B1_Rx
        DM1_B1_oVCAN_RADAR_2387ae6d_Tx: DynamicLength=true, PduLength=8, J1939Requestable=true, SysTPduToFrameMappingRef=DM1_B1
    EcucGeneral:
      CPUType = CPU32Bit
      SizeOfInt = Size32Bit
      ByteOrder = LITTLE_ENDIAN
      BitOrder = LSB_to_MSB
      AtomicBitAccessInBitfield = false
      AtomicVariableAccess = Atomic32BitAccess
      SizeOfEnum = Size32Bit
      SizeOfROMPointer = Size32Bit
      SizeOfRAMPointer = Size32Bit
      BitFieldDataType = INT
      StructAlignment = Auto
      ArrayAlignment = Auto
      StructInArrayAlignment = Auto
      DummyFunction = false
      DummyStatement = true
      DummyStatementKind = SelfAssignment
      ConditionalGenerating = true
      EcucBswImplementationCodeType = EcuCSourceCode
      EcuCUseStdReturnTypeForRte = false
      PostbuildLoadable: AlignmentFillPattern=0, PBROMStartAddress=0, PBRAMStartAddress=0, PBROMEndAddress=0, PBRAMEndAddress=0
      BswInitialization
        249 x InitFunction:
          BswM_InitMemory: Header=BswM.h, InitPhase=INIT_MEMORY, ModuleRef=BswM  # /ActiveEcuC/BswM PLAIN_TEXT InitMemory function description of BswM in UnfilteredViewInInvariantProject (UnfilteredInvariantProjectModelView) .
          BswM_PreInit: Header=BswM.h, InitPhase=INIT_ONE, ConfigType=BswM_ConfigType, ConfigPtrClass=BSWM_INIT_DATA, ConfigPtrName=BswM_Config_RDR_01_Ptr if post-build-variant-condition{matching-criterion=RDR_POS, value=0}, ConfigPtrName=BswM_Config_RDR_02_Ptr if post-build-variant-condition{matching-criterion=RDR_POS, value=1}, ConfigPtrName=BswM_Config_RDR_03_Ptr if post-build-variant-condition{matching-criterion=RDR_POS, value=2}, ConfigPtrName=BswM_Config_RDR_04_Ptr if post-build-variant-condition{matching-criterion=RDR_POS, value=3}, ConfigPtrName=BswM_Config_RDR_05_Ptr if post-build-variant-condition{matching-criterion=RDR_POS, value=4}, ConfigPtrName=BswM_Config_RDR_06_Ptr if post-build-variant-condition{matching-criterion=RDR_POS, value=5}, ConfigPtrName=BswM_Config_RDR_07_Ptr if post-build-variant-condition{matching-criterion=RDR_POS, value=6}, ConfigPtrName=BswM_Config_RDR_08_Ptr if post-build-variant-condition{matching-criterion=RDR_POS, value=7}, ModuleRef=BswM  # /ActiveEcuC/BswM PLAIN_TEXT PreInit function description of BswM in PostBuildPredefinedVariantView (RDR_01) .
          BswM_Init: Header=BswM.h, InitPhase=NO_INIT, ConfigType=BswM_ConfigType, ConfigPtrClass=BSWM_INIT_DATA, ConfigPtrName=BswM_Config_RDR_01_Ptr if post-build-variant-condition{matching-criterion=RDR_POS, value=0}, ConfigPtrName=BswM_Config_RDR_02_Ptr if post-build-variant-condition{matching-criterion=RDR_POS, value=1}, ConfigPtrName=BswM_Config_RDR_03_Ptr if post-build-variant-condition{matching-criterion=RDR_POS, value=2}, ConfigPtrName=BswM_Config_RDR_04_Ptr if post-build-variant-condition{matching-criterion=RDR_POS, value=3}, ConfigPtrName=BswM_Config_RDR_05_Ptr if post-build-variant-condition{matching-criterion=RDR_POS, value=4}, ConfigPtrName=BswM_Config_RDR_06_Ptr if post-build-variant-condition{matching-criterion=RDR_POS, value=5}, ConfigPtrName=BswM_Config_RDR_07_Ptr if post-build-variant-condition{matching-criterion=RDR_POS, value=6}, ConfigPtrName=BswM_Config_RDR_08_Ptr if post-build-variant-condition{matching-criterion=RDR_POS, value=7}, ModuleRef=BswM  # /ActiveEcuC/BswM PLAIN_TEXT Init function description of BswM in PostBuildPredefinedVariantView (RDR_01) .
          ComM_PostInit: Header=ComM.h, InitPhase=INIT_THREE, ModuleRef=ComM  # /ActiveEcuC/ComM PLAIN_TEXT Post-Initialization of the ComM and its internal state machine
          ComM_Init: Header=ComM.h, InitPhase=INIT_TWO_POST_NVMREADALL, ConfigType=ComM_ConfigType, ConfigPtrClass=COMM_INIT_DATA, ConfigPtrName=ComM_Config_Ptr, ModuleRef=ComM  # /ActiveEcuC/ComM PLAIN_TEXT Init function description of ComM in UnfilteredViewInInvariantProject (UnfilteredInvariantProjectModelView) .
          ComM_PreInit: Header=ComM.h, InitPhase=INIT_ONE, ConfigType=ComM_ConfigType, ConfigPtrClass=COMM_INIT_DATA, ConfigPtrName=ComM_Config_Ptr, ModuleRef=ComM  # /ActiveEcuC/ComM PLAIN_TEXT PreInit function description of ComM in UnfilteredViewInInvariantProject (UnfilteredInvariantProjectModelView) .
          ComM_InitMemory: Header=ComM.h, InitPhase=INIT_MEMORY, ModuleRef=ComM  # /ActiveEcuC/ComM PLAIN_TEXT InitMemory function description of ComM in UnfilteredViewInInvariantProject (UnfilteredInvariantProjectModelView) .
          Com_Init: Header=Com.h, InitPhase=INIT_TWO_COM, ConfigType=Com_ConfigType, ConfigPtrClass=COM_INIT_DATA, ConfigPtrName=Com_Config_RDR_01_Ptr if post-build-variant-condition{matching-criterion=RDR_POS, value=0}, ConfigPtrName=Com_Config_RDR_02_Ptr if post-build-variant-condition{matching-criterion=RDR_POS, value=1}, ConfigPtrName=Com_Config_RDR_03_Ptr if post-build-variant-condition{matching-criterion=RDR_POS, value=2}, ConfigPtrName=Com_Config_RDR_04_Ptr if post-build-variant-condition{matching-criterion=RDR_POS, value=3}, ConfigPtrName=Com_Config_RDR_05_Ptr if post-build-variant-condition{matching-criterion=RDR_POS, value=4}, ConfigPtrName=Com_Config_RDR_06_Ptr if post-build-variant-condition{matching-criterion=RDR_POS, value=5}, ConfigPtrName=Com_Config_RDR_07_Ptr if post-build-variant-condition{matching-criterion=RDR_POS, value=6}, ConfigPtrName=Com_Config_RDR_08_Ptr if post-build-variant-condition{matching-criterion=RDR_POS, value=7}, ModuleRef=Com  # /ActiveEcuC/Com PLAIN_TEXT Init function description of Com in PostBuildPredefinedVariantView (RDR_01) .
          Com_InitMemory: Header=Com.h, InitPhase=INIT_MEMORY, ModuleRef=Com  # /ActiveEcuC/Com PLAIN_TEXT InitMemory function description of Com in UnfilteredViewInInvariantProject (UnfilteredInvariantProjectModelView) .
          Det_InitMemory: Header=Det.h, InitPhase=INIT_MEMORY, ModuleRef=Det  # /ActiveEcuC/Det PLAIN_TEXT InitMemory function description of Det in UnfilteredViewInInvariantProject (UnfilteredInvariantProjectModelView) .
          Det_Init: Header=Det.h, InitPhase=INIT_ZERO, ConfigType=Det_ConfigType, ConfigPtrClass=DET_INIT_DATA, ConfigPtrName=Det_Config_Ptr, ModuleRef=Det  # /ActiveEcuC/Det PLAIN_TEXT Init function description of Det in UnfilteredViewInInvariantProject (UnfilteredInvariantProjectModelView) .
          EcuM_Init: Header=EcuM.h, InitPhase=NO_INIT, ConfigType=EcuM_PbConfigType, ConfigPtrClass=ECUM_INIT_DATA, ConfigPtrName=EcuM_Config_RDR_01_Ptr if post-build-variant-condition{matching-criterion=RDR_POS, value=0}, ConfigPtrName=EcuM_Config_RDR_02_Ptr if post-build-variant-condition{matching-criterion=RDR_POS, value=1}, ConfigPtrName=EcuM_Config_RDR_03_Ptr if post-build-variant-condition{matching-criterion=RDR_POS, value=2}, ConfigPtrName=EcuM_Config_RDR_04_Ptr if post-build-variant-condition{matching-criterion=RDR_POS, value=3}, ConfigPtrName=EcuM_Config_RDR_05_Ptr if post-build-variant-condition{matching-criterion=RDR_POS, value=4}, ConfigPtrName=EcuM_Config_RDR_06_Ptr if post-build-variant-condition{matching-criterion=RDR_POS, value=5}, ConfigPtrName=EcuM_Config_RDR_07_Ptr if post-build-variant-condition{matching-criterion=RDR_POS, value=6}, ConfigPtrName=EcuM_Config_RDR_08_Ptr if post-build-variant-condition{matching-criterion=RDR_POS, value=7}, ModuleRef=EcuM  # /ActiveEcuC/EcuM PLAIN_TEXT Init function description of EcuM in PostBuildPredefinedVariantView (RDR_01) .
          EthIf_Init: Header=EthIf.h, InitPhase=INIT_TWO_IF, ConfigType=EthIf_ConfigType, ConfigPtrClass=ETHIF_INIT_DATA, ConfigPtrName=EthIf_Config_RDR_05_Ptr, ModuleRef=EthIf, variation-point=post-build-variant-condition{matching-criterion=RDR_POS, value=4}  # /ActiveEcuC/EthIf PLAIN_TEXT Init function description of EthIf in PostBuildPredefinedVariantView (RDR_05) .
          EthIf_Init: Header=EthIf.h, InitPhase=INIT_TWO_IF, ConfigType=EthIf_ConfigType, ConfigPtrClass=ETHIF_INIT_DATA, ConfigPtrName=EthIf_Config_RDR_06_Ptr, ModuleRef=EthIf, variation-point=post-build-variant-condition{matching-criterion=RDR_POS, value=5}  # /ActiveEcuC/EthIf PLAIN_TEXT Init function description of EthIf in PostBuildPredefinedVariantView (RDR_06) .
          EthIf_Init: Header=EthIf.h, InitPhase=INIT_TWO_IF, ConfigType=EthIf_ConfigType, ConfigPtrClass=ETHIF_INIT_DATA, ConfigPtrName=EthIf_Config_RDR_02_Ptr, ModuleRef=EthIf, variation-point=post-build-variant-condition{matching-criterion=RDR_POS, value=1}  # /ActiveEcuC/EthIf PLAIN_TEXT Init function description of EthIf in PostBuildPredefinedVariantView (RDR_02) .
          EthIf_Init: Header=EthIf.h, InitPhase=INIT_TWO_IF, ConfigType=EthIf_ConfigType, ConfigPtrClass=ETHIF_INIT_DATA, ConfigPtrName=EthIf_Config_RDR_04_Ptr, ModuleRef=EthIf, variation-point=post-build-variant-condition{matching-criterion=RDR_POS, value=3}  # /ActiveEcuC/EthIf PLAIN_TEXT Init function description of EthIf in PostBuildPredefinedVariantView (RDR_04) .
          EthIf_Init: Header=EthIf.h, InitPhase=INIT_TWO_IF, ConfigType=EthIf_ConfigType, ConfigPtrClass=ETHIF_INIT_DATA, ConfigPtrName=EthIf_Config_RDR_07_Ptr, ModuleRef=EthIf, variation-point=post-build-variant-condition{matching-criterion=RDR_POS, value=6}  # /ActiveEcuC/EthIf PLAIN_TEXT Init function description of EthIf in PostBuildPredefinedVariantView (RDR_07) .
          EthIf_Init: Header=EthIf.h, InitPhase=INIT_TWO_IF, ConfigType=EthIf_ConfigType, ConfigPtrClass=ETHIF_INIT_DATA, ConfigPtrName=EthIf_Config_RDR_01_Ptr, ModuleRef=EthIf, variation-point=post-build-variant-condition{matching-criterion=RDR_POS, value=0}  # /ActiveEcuC/EthIf PLAIN_TEXT Init function description of EthIf in PostBuildPredefinedVariantView (RDR_01) .
          EthIf_Init: Header=EthIf.h, InitPhase=INIT_TWO_IF, ConfigType=EthIf_ConfigType, ConfigPtrClass=ETHIF_INIT_DATA, ConfigPtrName=EthIf_Config_RDR_08_Ptr, ModuleRef=EthIf, variation-point=post-build-variant-condition{matching-criterion=RDR_POS, value=7}  # /ActiveEcuC/EthIf PLAIN_TEXT Init function description of EthIf in PostBuildPredefinedVariantView (RDR_08) .
          EthIf_Init: Header=EthIf.h, InitPhase=INIT_TWO_IF, ConfigType=EthIf_ConfigType, ConfigPtrClass=ETHIF_INIT_DATA, ConfigPtrName=EthIf_Config_RDR_03_Ptr, ModuleRef=EthIf, variation-point=post-build-variant-condition{matching-criterion=RDR_POS, value=2}  # /ActiveEcuC/EthIf PLAIN_TEXT Init function description of EthIf in PostBuildPredefinedVariantView (RDR_03) .
          EthIf_InitMemory: Header=EthIf.h, InitPhase=INIT_MEMORY, ModuleRef=EthIf  # /ActiveEcuC/EthIf PLAIN_TEXT InitMemory function description of EthIf in UnfilteredViewInInvariantProject (UnfilteredInvariantProjectModelView) .
          EthSM_InitMemory: Header=EthSM.h, InitPhase=INIT_MEMORY, ModuleRef=EthSM  # /ActiveEcuC/EthSM PLAIN_TEXT InitMemory function description of EthSM in UnfilteredViewInInvariantProject (UnfilteredInvariantProjectModelView) .
          EthSM_Init: Header=EthSM.h, InitPhase=INIT_TWO_SM, ConfigType=EthSM_ConfigType, ConfigPtrClass=ETHSM_INIT_DATA, ConfigPtrName=EthSM_Config_Ptr, ModuleRef=EthSM  # /ActiveEcuC/EthSM PLAIN_TEXT Init function description of EthSM in UnfilteredViewInInvariantProject (UnfilteredInvariantProjectModelView) .
          PduR_PreInit: Header=PduR.h, InitPhase=INIT_ONE, ConfigType=PduR_PBConfigType, ConfigPtrClass=PDUR_INIT_DATA, ConfigPtrName=PduR_Config_RDR_01_Ptr if post-build-variant-condition{matching-criterion=RDR_POS, value=0}, ConfigPtrName=PduR_Config_RDR_02_Ptr if post-build-variant-condition{matching-criterion=RDR_POS, value=1}, ConfigPtrName=PduR_Config_RDR_03_Ptr if post-build-variant-condition{matching-criterion=RDR_POS, value=2}, ConfigPtrName=PduR_Config_RDR_04_Ptr if post-build-variant-condition{matching-criterion=RDR_POS, value=3}, ConfigPtrName=PduR_Config_RDR_05_Ptr if post-build-variant-condition{matching-criterion=RDR_POS, value=4}, ConfigPtrName=PduR_Config_RDR_06_Ptr if post-build-variant-condition{matching-criterion=RDR_POS, value=5}, ConfigPtrName=PduR_Config_RDR_07_Ptr if post-build-variant-condition{matching-criterion=RDR_POS, value=6}, ConfigPtrName=PduR_Config_RDR_08_Ptr if post-build-variant-condition{matching-criterion=RDR_POS, value=7}, ModuleRef=PduR  # /ActiveEcuC/PduR PLAIN_TEXT PreInit function description of PduR in PostBuildPredefinedVariantView (RDR_01) .
          PduR_InitMemory: Header=PduR.h, InitPhase=INIT_MEMORY, ModuleRef=PduR  # /ActiveEcuC/PduR PLAIN_TEXT InitMemory function description of PduR in UnfilteredViewInInvariantProject (UnfilteredInvariantProjectModelView) .
          PduR_Init: Header=PduR.h, InitPhase=INIT_TWO_COM, ConfigType=PduR_PBConfigType, ConfigPtrClass=PDUR_INIT_DATA, ConfigPtrName=PduR_Config_RDR_01_Ptr if post-build-variant-condition{matching-criterion=RDR_POS, value=0}, ConfigPtrName=PduR_Config_RDR_02_Ptr if post-build-variant-condition{matching-criterion=RDR_POS, value=1}, ConfigPtrName=PduR_Config_RDR_03_Ptr if post-build-variant-condition{matching-criterion=RDR_POS, value=2}, ConfigPtrName=PduR_Config_RDR_04_Ptr if post-build-variant-condition{matching-criterion=RDR_POS, value=3}, ConfigPtrName=PduR_Config_RDR_05_Ptr if post-build-variant-condition{matching-criterion=RDR_POS, value=4}, ConfigPtrName=PduR_Config_RDR_06_Ptr if post-build-variant-condition{matching-criterion=RDR_POS, value=5}, ConfigPtrName=PduR_Config_RDR_07_Ptr if post-build-variant-condition{matching-criterion=RDR_POS, value=6}, ConfigPtrName=PduR_Config_RDR_08_Ptr if post-build-variant-condition{matching-criterion=RDR_POS, value=7}, ModuleRef=PduR  # /ActiveEcuC/PduR PLAIN_TEXT Init function description of PduR in PostBuildPredefinedVariantView (RDR_01) .
          Rte_Start: Header=Rte_Main.h, InitPhase=INIT_THREE, ModuleRef=Rte  # /ActiveEcuC/Rte PLAIN_TEXT Automatically generated by BswInitFctConfigurationService.
          SchM_Start: Header=Rte_Main.h, InitPhase=NO_INIT, ModuleRef=Rte  # /ActiveEcuC/Rte PLAIN_TEXT Automatically generated by BswInitFctConfigurationService.
          SchM_Init: Header=Rte_Main.h, InitPhase=NO_INIT, ConfigType=SchM_ConfigType, ConfigPtrClass=RTE_CONST, ConfigPtrName=&Rte_Config_RDR_01 if post-build-variant-condition{matching-criterion=RDR_POS, value=0}, ConfigPtrName=&Rte_Config_RDR_02 if post-build-variant-condition{matching-criterion=RDR_POS, value=1}, ConfigPtrName=&Rte_Config_RDR_03 if post-build-variant-condition{matching-criterion=RDR_POS, value=2}, ConfigPtrName=&Rte_Config_RDR_04 if post-build-variant-condition{matching-criterion=RDR_POS, value=3}, ConfigPtrName=&Rte_Config_RDR_05 if post-build-variant-condition{matching-criterion=RDR_POS, value=4}, ConfigPtrName=&Rte_Config_RDR_06 if post-build-variant-condition{matching-criterion=RDR_POS, value=5}, ConfigPtrName=&Rte_Config_RDR_07 if post-build-variant-condition{matching-criterion=RDR_POS, value=6}, ConfigPtrName=&Rte_Config_RDR_08 if post-build-variant-condition{matching-criterion=RDR_POS, value=7}, ModuleRef=Rte  # /ActiveEcuC/Rte PLAIN_TEXT Automatically generated by BswInitFctConfigurationService.
          SchM_StartTiming: Header=Rte_Main.h, InitPhase=NO_INIT, ModuleRef=Rte  # /ActiveEcuC/Rte PLAIN_TEXT Automatically generated by BswInitFctConfigurationService.
          Rte_StartTiming: Header=Rte_Main.h, InitPhase=NO_INIT, ModuleRef=Rte  # /ActiveEcuC/Rte PLAIN_TEXT Automatically generated by BswInitFctConfigurationService.
          Rte_InitMemory: Header=Rte_Main.h, InitPhase=INIT_MEMORY, ModuleRef=Rte  # /ActiveEcuC/Rte PLAIN_TEXT Automatically generated by BswInitFctConfigurationService.
          SoAd_InitMemory: Header=SoAd.h, InitPhase=INIT_MEMORY, ModuleRef=SoAd  # /ActiveEcuC/SoAd PLAIN_TEXT InitMemory function description of SoAd in UnfilteredViewInInvariantProject (UnfilteredInvariantProjectModelView) .
          SoAd_Init: Header=SoAd.h, InitPhase=INIT_TWO_IF, ConfigType=SoAd_ConfigType, ConfigPtrClass=SOAD_INIT_DATA, ConfigPtrName=SoAd_Config_Ptr, ModuleRef=SoAd  # /ActiveEcuC/SoAd PLAIN_TEXT Init function description of SoAd in UnfilteredViewInInvariantProject (UnfilteredInvariantProjectModelView) .
          SoAd_PreInit: Header=SoAd.h, InitPhase=INIT_ONE, ConfigType=SoAd_ConfigType, ConfigPtrClass=SOAD_INIT_DATA, ConfigPtrName=SoAd_Config_Ptr, ModuleRef=SoAd  # /ActiveEcuC/SoAd PLAIN_TEXT PreInit function description of SoAd in UnfilteredViewInInvariantProject (UnfilteredInvariantProjectModelView) .
          SoAd_PostInit: Header=SoAd.h, InitPhase=INIT_THREE, ModuleRef=SoAd  # /ActiveEcuC/SoAd PLAIN_TEXT PostInit function description of SoAd in UnfilteredViewInInvariantProject (UnfilteredInvariantProjectModelView) .
          TcpIp_InitMemory: Header=TcpIp.h, InitPhase=INIT_MEMORY, ModuleRef=TcpIp  # /ActiveEcuC/TcpIp PLAIN_TEXT InitMemory function description of TcpIp in UnfilteredViewInInvariantProject (UnfilteredInvariantProjectModelView) .
          TcpIp_Init: Header=TcpIp.h, InitPhase=INIT_TWO_TP, ConfigType=TcpIp_ConfigType, ConfigPtrClass=TCPIP_INIT_DATA, ConfigPtrName=TcpIp_Config_Ptr, ModuleRef=TcpIp  # /ActiveEcuC/TcpIp PLAIN_TEXT Init function description of TcpIp in UnfilteredViewInInvariantProject (UnfilteredInvariantProjectModelView) .
          EthTrcv_30_Rtl9010_Init: Header=EthTrcv_30_Rtl9010.h, InitPhase=INIT_TWO_TRCV, ConfigType=EthTrcv_30_Rtl9010_ConfigType, ConfigPtrClass=ETHTRCV_30_RTL9010_INIT_DATA, ConfigPtrName=EthTrcv_30_Rtl9010_Config_Ptr, ModuleRef=EthTrcv_RTL, variation-point=post-build-variant-condition{matching-criterion=RDR_POS, value=5}  # /ActiveEcuC/EthTrcv_RTL PLAIN_TEXT Module Initialization function of module EthTrcv_30_Rtl9010.
          EthTrcv_30_Rtl9010_Init: Header=EthTrcv_30_Rtl9010.h, InitPhase=INIT_TWO_TRCV, ConfigType=EthTrcv_30_Rtl9010_ConfigType, ConfigPtrClass=ETHTRCV_30_RTL9010_INIT_DATA, ConfigPtrName=EthTrcv_30_Rtl9010_Config_Ptr, ModuleRef=EthTrcv_RTL, variation-point=post-build-variant-condition{matching-criterion=RDR_POS, value=1}  # /ActiveEcuC/EthTrcv PLAIN_TEXT Module Initialization function of module EthTrcv_30_Rtl9010.
          EthTrcv_30_Rtl9010_Init: Header=EthTrcv_30_Rtl9010.h, InitPhase=INIT_TWO_TRCV, ConfigType=EthTrcv_30_Rtl9010_ConfigType, ConfigPtrClass=ETHTRCV_30_RTL9010_INIT_DATA, ConfigPtrName=EthTrcv_30_Rtl9010_Config_Ptr, ModuleRef=EthTrcv_RTL, variation-point=post-build-variant-condition{matching-criterion=RDR_POS, value=3}  # /ActiveEcuC/EthTrcv PLAIN_TEXT Module Initialization function of module EthTrcv_30_Rtl9010.
          EthTrcv_30_Rtl9010_Init: Header=EthTrcv_30_Rtl9010.h, InitPhase=INIT_TWO_TRCV, ConfigType=EthTrcv_30_Rtl9010_ConfigType, ConfigPtrClass=ETHTRCV_30_RTL9010_INIT_DATA, ConfigPtrName=EthTrcv_30_Rtl9010_Config_Ptr, ModuleRef=EthTrcv_RTL, variation-point=post-build-variant-condition{matching-criterion=RDR_POS, value=6}  # /ActiveEcuC/EthTrcv PLAIN_TEXT Module Initialization function of module EthTrcv_30_Rtl9010.
          EthTrcv_30_Rtl9010_Init: Header=EthTrcv_30_Rtl9010.h, InitPhase=INIT_TWO_TRCV, ConfigType=EthTrcv_30_Rtl9010_ConfigType, ConfigPtrClass=ETHTRCV_30_RTL9010_INIT_DATA, ConfigPtrName=EthTrcv_30_Rtl9010_Config_Ptr, ModuleRef=EthTrcv_RTL, variation-point=post-build-variant-condition{matching-criterion=RDR_POS, value=0}  # /ActiveEcuC/EthTrcv PLAIN_TEXT Module Initialization function of module EthTrcv_30_Rtl9010.
          EthTrcv_30_Rtl9010_Init: Header=EthTrcv_30_Rtl9010.h, InitPhase=INIT_TWO_TRCV, ConfigType=EthTrcv_30_Rtl9010_ConfigType, ConfigPtrClass=ETHTRCV_30_RTL9010_INIT_DATA, ConfigPtrName=EthTrcv_30_Rtl9010_Config_Ptr, ModuleRef=EthTrcv_RTL, variation-point=post-build-variant-condition{matching-criterion=RDR_POS, value=4}  # /ActiveEcuC/EthTrcv PLAIN_TEXT Module Initialization function of module EthTrcv_30_Rtl9010.
          EthTrcv_30_Rtl9010_Init: Header=EthTrcv_30_Rtl9010.h, InitPhase=INIT_TWO_TRCV, ConfigType=EthTrcv_30_Rtl9010_ConfigType, ConfigPtrClass=ETHTRCV_30_RTL9010_INIT_DATA, ConfigPtrName=EthTrcv_30_Rtl9010_Config_Ptr, ModuleRef=EthTrcv_RTL, variation-point=post-build-variant-condition{matching-criterion=RDR_POS, value=7}  # /ActiveEcuC/EthTrcv PLAIN_TEXT Module Initialization function of module EthTrcv_30_Rtl9010.
          EthTrcv_30_Rtl9010_Init: Header=EthTrcv_30_Rtl9010.h, InitPhase=INIT_TWO_TRCV, ConfigType=EthTrcv_30_Rtl9010_ConfigType, ConfigPtrClass=ETHTRCV_30_RTL9010_INIT_DATA, ConfigPtrName=EthTrcv_30_Rtl9010_Config_Ptr, ModuleRef=EthTrcv_RTL, variation-point=post-build-variant-condition{matching-criterion=RDR_POS, value=2}  # /ActiveEcuC/EthTrcv PLAIN_TEXT Module Initialization function of module EthTrcv_30_Rtl9010.
          EthTrcv_30_Rtl9010_InitMemory: Header=EthTrcv_30_Rtl9010.h, InitPhase=INIT_MEMORY, ModuleRef=EthTrcv_RTL, variation-point=post-build-variant-condition{matching-criterion=RDR_POS, value=5}  # /ActiveEcuC/EthTrcv_RTL PLAIN_TEXT Memory Initialization function of module EthTrcv_30_Rtl9010.
          EthTrcv_30_Rtl9010_InitMemory: Header=EthTrcv_30_Rtl9010.h, InitPhase=INIT_MEMORY, ModuleRef=EthTrcv_RTL, variation-point=post-build-variant-condition{matching-criterion=RDR_POS, value=1}  # /ActiveEcuC/EthTrcv PLAIN_TEXT Memory Initialization function of module EthTrcv_30_Rtl9010.
          EthTrcv_30_Rtl9010_InitMemory: Header=EthTrcv_30_Rtl9010.h, InitPhase=INIT_MEMORY, ModuleRef=EthTrcv_RTL, variation-point=post-build-variant-condition{matching-criterion=RDR_POS, value=3}  # /ActiveEcuC/EthTrcv PLAIN_TEXT Memory Initialization function of module EthTrcv_30_Rtl9010.
          EthTrcv_30_Rtl9010_InitMemory: Header=EthTrcv_30_Rtl9010.h, InitPhase=INIT_MEMORY, ModuleRef=EthTrcv_RTL, variation-point=post-build-variant-condition{matching-criterion=RDR_POS, value=6}  # /ActiveEcuC/EthTrcv PLAIN_TEXT Memory Initialization function of module EthTrcv_30_Rtl9010.
          EthTrcv_30_Rtl9010_InitMemory: Header=EthTrcv_30_Rtl9010.h, InitPhase=INIT_MEMORY, ModuleRef=EthTrcv_RTL, variation-point=post-build-variant-condition{matching-criterion=RDR_POS, value=0}  # /ActiveEcuC/EthTrcv PLAIN_TEXT Memory Initialization function of module EthTrcv_30_Rtl9010.
          EthTrcv_30_Rtl9010_InitMemory: Header=EthTrcv_30_Rtl9010.h, InitPhase=INIT_MEMORY, ModuleRef=EthTrcv_RTL, variation-point=post-build-variant-condition{matching-criterion=RDR_POS, value=4}  # /ActiveEcuC/EthTrcv PLAIN_TEXT Memory Initialization function of module EthTrcv_30_Rtl9010.
          EthTrcv_30_Rtl9010_InitMemory: Header=EthTrcv_30_Rtl9010.h, InitPhase=INIT_MEMORY, ModuleRef=EthTrcv_RTL, variation-point=post-build-variant-condition{matching-criterion=RDR_POS, value=7}  # /ActiveEcuC/EthTrcv PLAIN_TEXT Memory Initialization function of module EthTrcv_30_Rtl9010.
          EthTrcv_30_Rtl9010_InitMemory: Header=EthTrcv_30_Rtl9010.h, InitPhase=INIT_MEMORY, ModuleRef=EthTrcv_RTL, variation-point=post-build-variant-condition{matching-criterion=RDR_POS, value=2}  # /ActiveEcuC/EthTrcv PLAIN_TEXT Memory Initialization function of module EthTrcv_30_Rtl9010.
          Eth_30_Wrapper_Init: Header=Eth_30_Wrapper.h, InitPhase=INIT_TWO_IF, ConfigType=Eth_30_Wrapper_ConfigType, ConfigPtrClass=ETH_30_WRAPPER_INIT_DATA, ConfigPtrName=Eth_30_Wrapper_Config_Ptr, ModuleRef=Eth  # /ActiveEcuC/Eth PLAIN_TEXT Init function description of Eth_30_Wrapper in PostBuildInvariantValuesModelView (PostBuildInvariantValuesModelView) .
          CanIf_Init: Header=CanIf.h, InitPhase=INIT_TWO_IF, ConfigType=CanIf_ConfigType, ConfigPtrClass=CANIF_INIT_DATA, ConfigPtrName=CanIf_Config_RDR_01_Ptr if post-build-variant-condition{matching-criterion=RDR_POS, value=0}, ConfigPtrName=CanIf_Config_RDR_02_Ptr if post-build-variant-condition{matching-criterion=RDR_POS, value=1}, ConfigPtrName=CanIf_Config_RDR_03_Ptr if post-build-variant-condition{matching-criterion=RDR_POS, value=2}, ConfigPtrName=CanIf_Config_RDR_04_Ptr if post-build-variant-condition{matching-criterion=RDR_POS, value=3}, ConfigPtrName=CanIf_Config_RDR_05_Ptr if post-build-variant-condition{matching-criterion=RDR_POS, value=4}, ConfigPtrName=CanIf_Config_RDR_06_Ptr if post-build-variant-condition{matching-criterion=RDR_POS, value=5}, ConfigPtrName=CanIf_Config_RDR_07_Ptr if post-build-variant-condition{matching-criterion=RDR_POS, value=6}, ConfigPtrName=CanIf_Config_RDR_08_Ptr if post-build-variant-condition{matching-criterion=RDR_POS, value=7}, ModuleRef=CanIf  # /ActiveEcuC/CanIf PLAIN_TEXT Init function description of CanIf in PostBuildPredefinedVariantView (RDR_01) .
          CanIf_InitMemory: Header=CanIf.h, InitPhase=INIT_MEMORY, ModuleRef=CanIf  # /ActiveEcuC/CanIf PLAIN_TEXT InitMemory function description of CanIf in UnfilteredViewInInvariantProject (UnfilteredInvariantProjectModelView) .
          CanSM_Init: Header=CanSM_EcuM.h, InitPhase=INIT_TWO_SM, ConfigType=CanSM_ConfigType, ConfigPtrClass=CANSM_INIT_DATA, ConfigPtrName=CanSM_Config_Ptr, ModuleRef=CanSM  # /ActiveEcuC/CanSM PLAIN_TEXT Init function description of CanSM in UnfilteredViewInInvariantProject (UnfilteredInvariantProjectModelView) .
          CanSM_InitMemory: Header=CanSM_EcuM.h, InitPhase=INIT_MEMORY, ModuleRef=CanSM  # /ActiveEcuC/CanSM PLAIN_TEXT InitMemory function description of CanSM in UnfilteredViewInInvariantProject (UnfilteredInvariantProjectModelView) .
          Xcp_InitMemory: Header=Xcp.h, InitPhase=INIT_MEMORY, ModuleRef=Xcp  # /ActiveEcuC/Xcp PLAIN_TEXT Memory Initialization function of module Xcp.
          Xcp_Init: Header=Xcp.h, InitPhase=INIT_TWO_TP, ModuleRef=Xcp  # /ActiveEcuC/Xcp PLAIN_TEXT Module Initialization function of module Xcp.
          TcpIpXcp_InitMemory: Header=TcpIpXcp.h, InitPhase=INIT_MEMORY, ModuleRef=Xcp  # /ActiveEcuC/Xcp PLAIN_TEXT Memory Initialization function of module TcpIpXcp.
          TcpIpXcp_Init: Header=TcpIpXcp.h, InitPhase=INIT_TWO_TP, ConfigType=TcpIpXcp_ConfigType, ConfigPtrClass=TCPIPXCP_CONST, ConfigPtrName=NULL_PTR, ModuleRef=Xcp  # /ActiveEcuC/Xcp PLAIN_TEXT Module Initialization function of module TcpIpXcp.
          StbM_Init: Header=StbM.h, InitPhase=INIT_TWO_SYS, ConfigType=StbM_ConfigType, ConfigPtrClass=STBM_INIT_DATA, ConfigPtrName=StbM_Config_RDR_01_Ptr if post-build-variant-condition{matching-criterion=RDR_POS, value=0}, ConfigPtrName=StbM_Config_RDR_02_Ptr if post-build-variant-condition{matching-criterion=RDR_POS, value=1}, ConfigPtrName=StbM_Config_RDR_03_Ptr if post-build-variant-condition{matching-criterion=RDR_POS, value=2}, ConfigPtrName=StbM_Config_RDR_04_Ptr if post-build-variant-condition{matching-criterion=RDR_POS, value=3}, ConfigPtrName=StbM_Config_RDR_05_Ptr if post-build-variant-condition{matching-criterion=RDR_POS, value=4}, ConfigPtrName=StbM_Config_RDR_06_Ptr if post-build-variant-condition{matching-criterion=RDR_POS, value=5}, ConfigPtrName=StbM_Config_RDR_07_Ptr if post-build-variant-condition{matching-criterion=RDR_POS, value=6}, ConfigPtrName=StbM_Config_RDR_08_Ptr if post-build-variant-condition{matching-criterion=RDR_POS, value=7}, ModuleRef=StbM  # /ActiveEcuC/StbM PLAIN_TEXT Init function description of StbM in PostBuildPredefinedVariantView (RDR_01) .
          StbM_PreInit: Header=StbM.h, InitPhase=INIT_ONE, ConfigType=StbM_ConfigType, ConfigPtrClass=STBM_INIT_DATA, ConfigPtrName=StbM_Config_RDR_01_Ptr if post-build-variant-condition{matching-criterion=RDR_POS, value=0}, ConfigPtrName=StbM_Config_RDR_02_Ptr if post-build-variant-condition{matching-criterion=RDR_POS, value=1}, ConfigPtrName=StbM_Config_RDR_03_Ptr if post-build-variant-condition{matching-criterion=RDR_POS, value=2}, ConfigPtrName=StbM_Config_RDR_04_Ptr if post-build-variant-condition{matching-criterion=RDR_POS, value=3}, ConfigPtrName=StbM_Config_RDR_05_Ptr if post-build-variant-condition{matching-criterion=RDR_POS, value=4}, ConfigPtrName=StbM_Config_RDR_06_Ptr if post-build-variant-condition{matching-criterion=RDR_POS, value=5}, ConfigPtrName=StbM_Config_RDR_07_Ptr if post-build-variant-condition{matching-criterion=RDR_POS, value=6}, ConfigPtrName=StbM_Config_RDR_08_Ptr if post-build-variant-condition{matching-criterion=RDR_POS, value=7}, ModuleRef=StbM  # /ActiveEcuC/StbM PLAIN_TEXT PreInit function description of StbM in PostBuildPredefinedVariantView (RDR_01) .
          StbM_PostInit: Header=StbM.h, InitPhase=INIT_THREE, ModuleRef=StbM  # /ActiveEcuC/StbM PLAIN_TEXT PostInit function description of StbM in UnfilteredViewInInvariantProject (UnfilteredInvariantProjectModelView) .
          StbM_InitMemory: Header=StbM.h, InitPhase=INIT_MEMORY, ModuleRef=StbM  # /ActiveEcuC/StbM PLAIN_TEXT InitMemory function description of StbM in UnfilteredViewInInvariantProject (UnfilteredInvariantProjectModelView) .
          EthTSyn_Init: Header=EthTSyn.h, InitPhase=INIT_TWO_SYS, ConfigType=EthTSyn_ConfigType, ConfigPtrClass=ETHTSYN_INIT_DATA, ConfigPtrName=EthTSyn_Config_Ptr, ModuleRef=EthTSyn  # /ActiveEcuC/EthTSyn PLAIN_TEXT Init function description of EthTSyn in UnfilteredViewInInvariantProject (UnfilteredInvariantProjectModelView) .
          EthTSyn_InitMemory: Header=EthTSyn.h, InitPhase=INIT_MEMORY, ModuleRef=EthTSyn  # /ActiveEcuC/EthTSyn PLAIN_TEXT InitMemory function description of EthTSyn in UnfilteredViewInInvariantProject (UnfilteredInvariantProjectModelView) .
          Adc_Init: Header=Adc.h, InitPhase=INIT_ONE_LATE, ConfigType=Adc_ConfigType, ConfigPtrClass=ADC_CONST, ConfigPtrName=NULL_PTR, ModuleRef=Adc, variation-point=post-build-variant-condition{matching-criterion=RDR_POS, value=5}  # /ActiveEcuC/Adc PLAIN_TEXT Created Adc_Init by Extended Init XML Service
          Adc_Init: Header=Adc.h, InitPhase=INIT_ONE_LATE, ConfigType=Adc_ConfigType, ConfigPtrClass=ADC_CONST, ConfigPtrName=NULL_PTR, ModuleRef=Adc, variation-point=post-build-variant-condition{matching-criterion=RDR_POS, value=6}  # /ActiveEcuC/Adc PLAIN_TEXT Initializes Adc module
          Adc_Init: Header=Adc.h, InitPhase=INIT_ONE_LATE, ConfigType=Adc_ConfigType, ConfigPtrClass=ADC_CONST, ConfigPtrName=NULL_PTR, ModuleRef=Adc, variation-point=post-build-variant-condition{matching-criterion=RDR_POS, value=3}  # /ActiveEcuC/Adc PLAIN_TEXT Initializes Adc module Created Adc_Init by Extended Init XML Service
          Adc_Init: Header=Adc.h, InitPhase=INIT_ONE_LATE, ConfigType=Adc_ConfigType, ConfigPtrClass=ADC_CONST, ConfigPtrName=NULL_PTR, ModuleRef=Adc, variation-point=post-build-variant-condition{matching-criterion=RDR_POS, value=1}  # /ActiveEcuC/Adc PLAIN_TEXT Initializes Adc module Created Adc_Init by Extended Init XML Service
          Adc_Init: Header=Adc.h, InitPhase=INIT_ONE_LATE, ConfigType=Adc_ConfigType, ConfigPtrClass=ADC_CONST, ConfigPtrName=NULL_PTR, ModuleRef=Adc, variation-point=post-build-variant-condition{matching-criterion=RDR_POS, value=4}  # /ActiveEcuC/Adc PLAIN_TEXT Initializes Adc module Created Adc_Init by Extended Init XML Service
          Adc_Init: Header=Adc.h, InitPhase=INIT_ONE_LATE, ConfigType=Adc_ConfigType, ConfigPtrClass=ADC_CONST, ConfigPtrName=NULL_PTR, ModuleRef=Adc, variation-point=post-build-variant-condition{matching-criterion=RDR_POS, value=7}  # /ActiveEcuC/Adc PLAIN_TEXT Initializes Adc module Created Adc_Init by Extended Init XML Service
          Adc_Init: Header=Adc.h, InitPhase=INIT_ONE_LATE, ConfigType=Adc_ConfigType, ConfigPtrClass=ADC_CONST, ConfigPtrName=NULL_PTR, ModuleRef=Adc, variation-point=post-build-variant-condition{matching-criterion=RDR_POS, value=0}  # /ActiveEcuC/Adc PLAIN_TEXT Initializes Adc module
          Adc_Init: Header=Adc.h, InitPhase=INIT_ONE_LATE, ConfigType=Adc_ConfigType, ConfigPtrClass=ADC_CONST, ConfigPtrName=NULL_PTR, ModuleRef=Adc, variation-point=post-build-variant-condition{matching-criterion=RDR_POS, value=2}  # /ActiveEcuC/Adc PLAIN_TEXT Initializes Adc module Created Adc_Init by Extended Init XML Service
          Can_Init: Header=Can.h, InitPhase=INIT_TWO_DRV, ConfigType=Can_ConfigType, ConfigPtrClass=CAN_CONST, ConfigPtrName=NULL_PTR, ModuleRef=Can, variation-point=post-build-variant-condition{matching-criterion=RDR_POS, value=5}  # /ActiveEcuC/Can PLAIN_TEXT Created Can_Init by Extended Init XML Service
          Can_Init: Header=Can.h, InitPhase=INIT_TWO_DRV, ConfigType=Can_ConfigType, ConfigPtrClass=CAN_CONST, ConfigPtrName=NULL_PTR, ModuleRef=Can, variation-point=post-build-variant-condition{matching-criterion=RDR_POS, value=6}  # /ActiveEcuC/Can PLAIN_TEXT Initializes Can module
          Can_Init: Header=Can.h, InitPhase=INIT_TWO_DRV, ConfigType=Can_ConfigType, ConfigPtrClass=CAN_CONST, ConfigPtrName=NULL_PTR, ModuleRef=Can, variation-point=post-build-variant-condition{matching-criterion=RDR_POS, value=4}  # /ActiveEcuC/Can PLAIN_TEXT Initializes Can module
          Dio_Init: Header=Dio.h, InitPhase=NO_INIT, ConfigType=Dio_ConfigType, ConfigPtrClass=DIO_CONST, ConfigPtrName=NULL_PTR, ModuleRef=Dio, variation-point=post-build-variant-condition{matching-criterion=RDR_POS, value=6}  # /ActiveEcuC/Dio PLAIN_TEXT Created Dio_Init by Extended Init XML Service
          Dio_Init: Header=Dio.h, InitPhase=NO_INIT, ConfigType=Dio_ConfigType, ConfigPtrClass=DIO_CONST, ConfigPtrName=NULL_PTR, ModuleRef=Dio, variation-point=post-build-variant-condition{matching-criterion=RDR_POS, value=3}  # /ActiveEcuC/Dio PLAIN_TEXT Created Dio_Init by Extended Init XML Service
          Dio_Init: Header=Dio.h, InitPhase=NO_INIT, ConfigType=Dio_ConfigType, ConfigPtrClass=DIO_CONST, ConfigPtrName=NULL_PTR, ModuleRef=Dio, variation-point=post-build-variant-condition{matching-criterion=RDR_POS, value=1}  # /ActiveEcuC/Dio PLAIN_TEXT Created Dio_Init by Extended Init XML Service
          Dio_Init: Header=Dio.h, InitPhase=NO_INIT, ConfigType=Dio_ConfigType, ConfigPtrClass=DIO_CONST, ConfigPtrName=NULL_PTR, ModuleRef=Dio, variation-point=post-build-variant-condition{matching-criterion=RDR_POS, value=7}  # /ActiveEcuC/Dio PLAIN_TEXT Created Dio_Init by Extended Init XML Service
          Dio_Init: Header=Dio.h, InitPhase=NO_INIT, ConfigType=Dio_ConfigType, ConfigPtrClass=DIO_CONST, ConfigPtrName=NULL_PTR, ModuleRef=Dio, variation-point=post-build-variant-condition{matching-criterion=RDR_POS, value=5}  # /ActiveEcuC/Dio PLAIN_TEXT Created Dio_Init by Extended Init XML Service
          Dio_Init: Header=Dio.h, InitPhase=NO_INIT, ConfigType=Dio_ConfigType, ConfigPtrClass=DIO_CONST, ConfigPtrName=NULL_PTR, ModuleRef=Dio, variation-point=post-build-variant-condition{matching-criterion=RDR_POS, value=2}  # /ActiveEcuC/Dio PLAIN_TEXT Created Dio_Init by Extended Init XML Service
          Dma_Init: Header=Dma.h, InitPhase=INIT_ONE_LATE, ConfigType=Dma_ConfigType, ConfigPtrClass=DMA_CONST, ConfigPtrName=NULL_PTR, ModuleRef=Dma, variation-point=post-build-variant-condition{matching-criterion=RDR_POS, value=4}  # /ActiveEcuC/Dma PLAIN_TEXT Created Dma_Init by Extended Init XML Service
          Dma_Init: Header=Dma.h, InitPhase=INIT_ONE_LATE, ConfigType=Dma_ConfigType, ConfigPtrClass=DMA_CONST, ConfigPtrName=NULL_PTR, ModuleRef=Dma, variation-point=post-build-variant-condition{matching-criterion=RDR_POS, value=6}  # /ActiveEcuC/Dma PLAIN_TEXT Initializes Dma module
          Dma_Init: Header=Dma.h, InitPhase=INIT_ONE_LATE, ConfigType=Dma_ConfigType, ConfigPtrClass=DMA_CONST, ConfigPtrName=NULL_PTR, ModuleRef=Dma, variation-point=post-build-variant-condition{matching-criterion=RDR_POS, value=3}  # /ActiveEcuC/Dma PLAIN_TEXT Initializes Dma module Created Dma_Init by Extended Init XML Service
          Dma_Init: Header=Dma.h, InitPhase=INIT_ONE_LATE, ConfigType=Dma_ConfigType, ConfigPtrClass=DMA_CONST, ConfigPtrName=NULL_PTR, ModuleRef=Dma, variation-point=post-build-variant-condition{matching-criterion=RDR_POS, value=1}  # /ActiveEcuC/Dma PLAIN_TEXT Initializes Dma module Created Dma_Init by Extended Init XML Service
          Dma_Init: Header=Dma.h, InitPhase=INIT_ONE_LATE, ConfigType=Dma_ConfigType, ConfigPtrClass=DMA_CONST, ConfigPtrName=NULL_PTR, ModuleRef=Dma, variation-point=post-build-variant-condition{matching-criterion=RDR_POS, value=7}  # /ActiveEcuC/Dma PLAIN_TEXT Initializes Dma module Created Dma_Init by Extended Init XML Service
          Dma_Init: Header=Dma.h, InitPhase=INIT_ONE_LATE, ConfigType=Dma_ConfigType, ConfigPtrClass=DMA_CONST, ConfigPtrName=NULL_PTR, ModuleRef=Dma, variation-point=post-build-variant-condition{matching-criterion=RDR_POS, value=0}  # /ActiveEcuC/Dma PLAIN_TEXT Initializes Dma module
          Dma_Init: Header=Dma.h, InitPhase=INIT_ONE_LATE, ConfigType=Dma_ConfigType, ConfigPtrClass=DMA_CONST, ConfigPtrName=NULL_PTR, ModuleRef=Dma, variation-point=post-build-variant-condition{matching-criterion=RDR_POS, value=5}  # /ActiveEcuC/Dma PLAIN_TEXT Initializes Dma module Created Dma_Init by Extended Init XML Service
          Dma_Init: Header=Dma.h, InitPhase=INIT_ONE_LATE, ConfigType=Dma_ConfigType, ConfigPtrClass=DMA_CONST, ConfigPtrName=NULL_PTR, ModuleRef=Dma, variation-point=post-build-variant-condition{matching-criterion=RDR_POS, value=2}  # /ActiveEcuC/Dma PLAIN_TEXT Initializes Dma module Created Dma_Init by Extended Init XML Service
          Eth_Init: Header=Eth.h, InitPhase=INIT_TWO_DRV, ConfigType=Eth_ConfigType, ConfigPtrClass=AUTOMATIC, ConfigPtrName=NULL_PTR, ModuleRef=Eth_Indie  # /ActiveEcuC/Eth_Indie PLAIN_TEXT Created Eth_Init by Extended Init XML Service
          Fls_Init: Header=Fls.h, InitPhase=INIT_TWO_MCAL, ConfigType=Fls_ConfigType, ConfigPtrClass=FLS_CONST, ConfigPtrName=&Fls_Config, ModuleRef=Fls, variation-point=post-build-variant-condition{matching-criterion=RDR_POS, value=6}  # /ActiveEcuC/Fls PLAIN_TEXT Created Fls_Init by Extended Init XML Service
          Fls_Init: Header=Fls.h, InitPhase=INIT_TWO_MCAL, ConfigType=Fls_ConfigType, ConfigPtrClass=FLS_CONST, ConfigPtrName=&Fls_Config, ModuleRef=Fls, variation-point=post-build-variant-condition{matching-criterion=RDR_POS, value=3}  # /ActiveEcuC/Fls PLAIN_TEXT Initializes Fls module
          Fls_Init: Header=Fls.h, InitPhase=INIT_TWO_MCAL, ConfigType=Fls_ConfigType, ConfigPtrClass=FLS_CONST, ConfigPtrName=&Fls_Config, ModuleRef=Fls, variation-point=post-build-variant-condition{matching-criterion=RDR_POS, value=1}  # /ActiveEcuC/Fls PLAIN_TEXT Initializes Fls module Created Fls_Init by Extended Init XML Service
          Fls_Init: Header=Fls.h, InitPhase=INIT_TWO_MCAL, ConfigType=Fls_ConfigType, ConfigPtrClass=FLS_CONST, ConfigPtrName=&Fls_Config, ModuleRef=Fls, variation-point=post-build-variant-condition{matching-criterion=RDR_POS, value=4}  # /ActiveEcuC/Fls PLAIN_TEXT Initializes Fls module Created Fls_Init by Extended Init XML Service
          Fls_Init: Header=Fls.h, InitPhase=INIT_TWO_MCAL, ConfigType=Fls_ConfigType, ConfigPtrClass=FLS_CONST, ConfigPtrName=&Fls_Config, ModuleRef=Fls, variation-point=post-build-variant-condition{matching-criterion=RDR_POS, value=7}  # /ActiveEcuC/Fls PLAIN_TEXT Initializes Fls module Created Fls_Init by Extended Init XML Service
          Fls_Init: Header=Fls.h, InitPhase=INIT_TWO_MCAL, ConfigType=Fls_ConfigType, ConfigPtrClass=FLS_CONST, ConfigPtrName=&Fls_Config, ModuleRef=Fls, variation-point=post-build-variant-condition{matching-criterion=RDR_POS, value=0}  # /ActiveEcuC/Fls PLAIN_TEXT Initializes Fls module
          Fls_Init: Header=Fls.h, InitPhase=INIT_TWO_MCAL, ConfigType=Fls_ConfigType, ConfigPtrClass=FLS_CONST, ConfigPtrName=&Fls_Config, ModuleRef=Fls, variation-point=post-build-variant-condition{matching-criterion=RDR_POS, value=5}  # /ActiveEcuC/Fls PLAIN_TEXT Initializes Fls module Created Fls_Init by Extended Init XML Service
          Fls_Init: Header=Fls.h, InitPhase=INIT_TWO_MCAL, ConfigType=Fls_ConfigType, ConfigPtrClass=FLS_CONST, ConfigPtrName=&Fls_Config, ModuleRef=Fls, variation-point=post-build-variant-condition{matching-criterion=RDR_POS, value=2}  # /ActiveEcuC/Fls PLAIN_TEXT Initializes Fls module Created Fls_Init by Extended Init XML Service
          Gpt_Init: Header=Gpt.h, InitPhase=INIT_ONE_LATE, ConfigType=Gpt_ConfigType, ConfigPtrClass=GPT_CONST, ConfigPtrName=NULL_PTR, ModuleRef=Gpt, variation-point=post-build-variant-condition{matching-criterion=RDR_POS, value=6}  # /ActiveEcuC/Gpt PLAIN_TEXT Created Gpt_Init by Extended Init XML Service
          Gpt_Init: Header=Gpt.h, InitPhase=INIT_ONE_LATE, ConfigType=Gpt_ConfigType, ConfigPtrClass=GPT_CONST, ConfigPtrName=NULL_PTR, ModuleRef=Gpt, variation-point=post-build-variant-condition{matching-criterion=RDR_POS, value=3}  # /ActiveEcuC/Gpt PLAIN_TEXT Initializes Gpt module
          Gpt_Init: Header=Gpt.h, InitPhase=INIT_ONE_LATE, ConfigType=Gpt_ConfigType, ConfigPtrClass=GPT_CONST, ConfigPtrName=NULL_PTR, ModuleRef=Gpt, variation-point=post-build-variant-condition{matching-criterion=RDR_POS, value=1}  # /ActiveEcuC/Gpt PLAIN_TEXT Initializes Gpt module Created Gpt_Init by Extended Init XML Service
          Gpt_Init: Header=Gpt.h, InitPhase=INIT_ONE_LATE, ConfigType=Gpt_ConfigType, ConfigPtrClass=GPT_CONST, ConfigPtrName=NULL_PTR, ModuleRef=Gpt, variation-point=post-build-variant-condition{matching-criterion=RDR_POS, value=4}  # /ActiveEcuC/Gpt PLAIN_TEXT Initializes Gpt module Created Gpt_Init by Extended Init XML Service
          Gpt_Init: Header=Gpt.h, InitPhase=INIT_ONE_LATE, ConfigType=Gpt_ConfigType, ConfigPtrClass=GPT_CONST, ConfigPtrName=NULL_PTR, ModuleRef=Gpt, variation-point=post-build-variant-condition{matching-criterion=RDR_POS, value=7}  # /ActiveEcuC/Gpt PLAIN_TEXT Initializes Gpt module Created Gpt_Init by Extended Init XML Service
          Gpt_Init: Header=Gpt.h, InitPhase=INIT_ONE_LATE, ConfigType=Gpt_ConfigType, ConfigPtrClass=GPT_CONST, ConfigPtrName=NULL_PTR, ModuleRef=Gpt, variation-point=post-build-variant-condition{matching-criterion=RDR_POS, value=0}  # /ActiveEcuC/Gpt PLAIN_TEXT Initializes Gpt module
          Gpt_Init: Header=Gpt.h, InitPhase=INIT_ONE_LATE, ConfigType=Gpt_ConfigType, ConfigPtrClass=GPT_CONST, ConfigPtrName=NULL_PTR, ModuleRef=Gpt, variation-point=post-build-variant-condition{matching-criterion=RDR_POS, value=5}  # /ActiveEcuC/Gpt PLAIN_TEXT Initializes Gpt module Created Gpt_Init by Extended Init XML Service
          Gpt_Init: Header=Gpt.h, InitPhase=INIT_ONE_LATE, ConfigType=Gpt_ConfigType, ConfigPtrClass=GPT_CONST, ConfigPtrName=NULL_PTR, ModuleRef=Gpt, variation-point=post-build-variant-condition{matching-criterion=RDR_POS, value=2}  # /ActiveEcuC/Gpt PLAIN_TEXT Initializes Gpt module Created Gpt_Init by Extended Init XML Service
          I2c_Init: Header=I2c.h, InitPhase=INIT_ONE_LATE, ConfigType=I2c_ConfigType, ConfigPtrClass=I2C_CONST, ConfigPtrName=NULL_PTR, ModuleRef=I2c, variation-point=post-build-variant-condition{matching-criterion=RDR_POS, value=6}  # /ActiveEcuC/I2c PLAIN_TEXT Created I2c_Init by Extended Init XML Service
          I2c_Init: Header=I2c.h, InitPhase=INIT_ONE_LATE, ConfigType=I2c_ConfigType, ConfigPtrClass=I2C_CONST, ConfigPtrName=NULL_PTR, ModuleRef=I2c, variation-point=post-build-variant-condition{matching-criterion=RDR_POS, value=3}  # /ActiveEcuC/I2c PLAIN_TEXT Initializes I2c module
          I2c_Init: Header=I2c.h, InitPhase=INIT_ONE_LATE, ConfigType=I2c_ConfigType, ConfigPtrClass=I2C_CONST, ConfigPtrName=NULL_PTR, ModuleRef=I2c, variation-point=post-build-variant-condition{matching-criterion=RDR_POS, value=1}  # /ActiveEcuC/I2c PLAIN_TEXT Initializes I2c module Created I2c_Init by Extended Init XML Service
          I2c_Init: Header=I2c.h, InitPhase=INIT_ONE_LATE, ConfigType=I2c_ConfigType, ConfigPtrClass=I2C_CONST, ConfigPtrName=NULL_PTR, ModuleRef=I2c, variation-point=post-build-variant-condition{matching-criterion=RDR_POS, value=4}  # /ActiveEcuC/I2c PLAIN_TEXT Initializes I2c module Created I2c_Init by Extended Init XML Service
          I2c_Init: Header=I2c.h, InitPhase=INIT_ONE_LATE, ConfigType=I2c_ConfigType, ConfigPtrClass=I2C_CONST, ConfigPtrName=NULL_PTR, ModuleRef=I2c, variation-point=post-build-variant-condition{matching-criterion=RDR_POS, value=7}  # /ActiveEcuC/I2c PLAIN_TEXT Initializes I2c module Created I2c_Init by Extended Init XML Service
          I2c_Init: Header=I2c.h, InitPhase=INIT_ONE_LATE, ConfigType=I2c_ConfigType, ConfigPtrClass=I2C_CONST, ConfigPtrName=NULL_PTR, ModuleRef=I2c, variation-point=post-build-variant-condition{matching-criterion=RDR_POS, value=0}  # /ActiveEcuC/I2c PLAIN_TEXT Initializes I2c module
          I2c_Init: Header=I2c.h, InitPhase=INIT_ONE_LATE, ConfigType=I2c_ConfigType, ConfigPtrClass=I2C_CONST, ConfigPtrName=NULL_PTR, ModuleRef=I2c, variation-point=post-build-variant-condition{matching-criterion=RDR_POS, value=5}  # /ActiveEcuC/I2c PLAIN_TEXT Initializes I2c module Created I2c_Init by Extended Init XML Service
          I2c_Init: Header=I2c.h, InitPhase=INIT_ONE_LATE, ConfigType=I2c_ConfigType, ConfigPtrClass=I2C_CONST, ConfigPtrName=NULL_PTR, ModuleRef=I2c, variation-point=post-build-variant-condition{matching-criterion=RDR_POS, value=2}  # /ActiveEcuC/I2c PLAIN_TEXT Initializes I2c module Created I2c_Init by Extended Init XML Service
          Mcu_Init: Header=Mcu.h, InitPhase=INIT_ONE_EARLY, ConfigType=Mcu_ConfigType, ConfigPtrClass=MCU_CONST, ConfigPtrName=NULL_PTR, ModuleRef=Mcu, variation-point=post-build-variant-condition{matching-criterion=RDR_POS, value=3}  # /ActiveEcuC/Mcu PLAIN_TEXT Created Mcu_Init by Extended Init XML Service
          Mcu_Init: Header=Mcu.h, InitPhase=INIT_ONE_EARLY, ConfigType=Mcu_ConfigType, ConfigPtrClass=MCU_CONST, ConfigPtrName=NULL_PTR, ModuleRef=Mcu, variation-point=post-build-variant-condition{matching-criterion=RDR_POS, value=6}  # /ActiveEcuC/Mcu PLAIN_TEXT Initializes Mcu module
          Mcu_Init: Header=Mcu.h, InitPhase=INIT_ONE_EARLY, ConfigType=Mcu_ConfigType, ConfigPtrClass=MCU_CONST, ConfigPtrName=NULL_PTR, ModuleRef=Mcu, variation-point=post-build-variant-condition{matching-criterion=RDR_POS, value=4}  # /ActiveEcuC/Mcu PLAIN_TEXT Initializes Mcu module Created Mcu_Init by Extended Init XML Service
          Mcu_Init: Header=Mcu.h, InitPhase=INIT_ONE_EARLY, ConfigType=Mcu_ConfigType, ConfigPtrClass=MCU_CONST, ConfigPtrName=NULL_PTR, ModuleRef=Mcu, variation-point=post-build-variant-condition{matching-criterion=RDR_POS, value=1}  # /ActiveEcuC/Mcu PLAIN_TEXT Initializes Mcu module Created Mcu_Init by Extended Init XML Service
          Mcu_Init: Header=Mcu.h, InitPhase=INIT_ONE_EARLY, ConfigType=Mcu_ConfigType, ConfigPtrClass=MCU_CONST, ConfigPtrName=NULL_PTR, ModuleRef=Mcu, variation-point=post-build-variant-condition{matching-criterion=RDR_POS, value=7}  # /ActiveEcuC/Mcu PLAIN_TEXT Initializes Mcu module Created Mcu_Init by Extended Init XML Service
          Mcu_Init: Header=Mcu.h, InitPhase=INIT_ONE_EARLY, ConfigType=Mcu_ConfigType, ConfigPtrClass=MCU_CONST, ConfigPtrName=NULL_PTR, ModuleRef=Mcu, variation-point=post-build-variant-condition{matching-criterion=RDR_POS, value=0}  # /ActiveEcuC/Mcu PLAIN_TEXT Initializes Mcu module
          Mcu_Init: Header=Mcu.h, InitPhase=INIT_ONE_EARLY, ConfigType=Mcu_ConfigType, ConfigPtrClass=MCU_CONST, ConfigPtrName=NULL_PTR, ModuleRef=Mcu, variation-point=post-build-variant-condition{matching-criterion=RDR_POS, value=5}  # /ActiveEcuC/Mcu PLAIN_TEXT Initializes Mcu module Created Mcu_Init by Extended Init XML Service
          Mcu_Init: Header=Mcu.h, InitPhase=INIT_ONE_EARLY, ConfigType=Mcu_ConfigType, ConfigPtrClass=MCU_CONST, ConfigPtrName=NULL_PTR, ModuleRef=Mcu, variation-point=post-build-variant-condition{matching-criterion=RDR_POS, value=2}  # /ActiveEcuC/Mcu PLAIN_TEXT Initializes Mcu module Created Mcu_Init by Extended Init XML Service
          Port_Init: Header=Port.h, InitPhase=INIT_ONE, ConfigType=Port_ConfigType, ConfigPtrClass=PORT_CONST, ConfigPtrName=NULL_PTR, ModuleRef=Port, variation-point=post-build-variant-condition{matching-criterion=RDR_POS, value=6}  # /ActiveEcuC/Port PLAIN_TEXT Created Port_Init by Extended Init XML Service
          Port_Init: Header=Port.h, InitPhase=INIT_ONE, ConfigType=Port_ConfigType, ConfigPtrClass=PORT_CONST, ConfigPtrName=NULL_PTR, ModuleRef=Port, variation-point=post-build-variant-condition{matching-criterion=RDR_POS, value=3}  # /ActiveEcuC/Port PLAIN_TEXT Initializes Port driver
          Port_Init: Header=Port.h, InitPhase=INIT_ONE, ConfigType=Port_ConfigType, ConfigPtrClass=PORT_CONST, ConfigPtrName=NULL_PTR, ModuleRef=Port, variation-point=post-build-variant-condition{matching-criterion=RDR_POS, value=1}  # /ActiveEcuC/Port PLAIN_TEXT Created Port_Init by Extended Init XML Service Initializes Port driver
          Port_Init: Header=Port.h, InitPhase=INIT_ONE, ConfigType=Port_ConfigType, ConfigPtrClass=PORT_CONST, ConfigPtrName=NULL_PTR, ModuleRef=Port, variation-point=post-build-variant-condition{matching-criterion=RDR_POS, value=4}  # /ActiveEcuC/Port PLAIN_TEXT Created Port_Init by Extended Init XML Service Initializes Port driver
          Port_Init: Header=Port.h, InitPhase=INIT_ONE, ConfigType=Port_ConfigType, ConfigPtrClass=PORT_CONST, ConfigPtrName=NULL_PTR, ModuleRef=Port, variation-point=post-build-variant-condition{matching-criterion=RDR_POS, value=0}  # /ActiveEcuC/Port PLAIN_TEXT Created Port_Init by Extended Init XML Service Initializes Port driver
          Port_Init: Header=Port.h, InitPhase=INIT_ONE, ConfigType=Port_ConfigType, ConfigPtrClass=PORT_CONST, ConfigPtrName=NULL_PTR, ModuleRef=Port, variation-point=post-build-variant-condition{matching-criterion=RDR_POS, value=5}  # /ActiveEcuC/Port PLAIN_TEXT Created Port_Init by Extended Init XML Service Initializes Port driver
          Port_Init: Header=Port.h, InitPhase=INIT_ONE, ConfigType=Port_ConfigType, ConfigPtrClass=PORT_CONST, ConfigPtrName=NULL_PTR, ModuleRef=Port, variation-point=post-build-variant-condition{matching-criterion=RDR_POS, value=2}  # /ActiveEcuC/Port PLAIN_TEXT Created Port_Init by Extended Init XML Service Initializes Port driver
          Pwm_Init: Header=Pwm.h, InitPhase=INIT_ONE_LATE, ConfigType=Pwm_ConfigType, ConfigPtrClass=PWM_CONST, ConfigPtrName=&Pwm_Config, ModuleRef=Pwm, variation-point=post-build-variant-condition{matching-criterion=RDR_POS, value=2}  # /ActiveEcuC/Pwm PLAIN_TEXT Created Pwm_Init by Extended Init XML Service
          Pwm_Init: Header=Pwm.h, InitPhase=INIT_ONE_LATE, ConfigType=Pwm_ConfigType, ConfigPtrClass=PWM_CONST, ConfigPtrName=&Pwm_Config, ModuleRef=Pwm, variation-point=post-build-variant-condition{matching-criterion=RDR_POS, value=6}  # /ActiveEcuC/Pwm PLAIN_TEXT Initializes Pwm module
          Pwm_Init: Header=Pwm.h, InitPhase=INIT_ONE_LATE, ConfigType=Pwm_ConfigType, ConfigPtrClass=PWM_CONST, ConfigPtrName=&Pwm_Config, ModuleRef=Pwm, variation-point=post-build-variant-condition{matching-criterion=RDR_POS, value=4}  # /ActiveEcuC/Pwm PLAIN_TEXT Initializes Pwm module
          Pwm_Init: Header=Pwm.h, InitPhase=INIT_ONE_LATE, ConfigType=Pwm_ConfigType, ConfigPtrClass=PWM_CONST, ConfigPtrName=&Pwm_Config, ModuleRef=Pwm, variation-point=post-build-variant-condition{matching-criterion=RDR_POS, value=3}  # /ActiveEcuC/Pwm PLAIN_TEXT Initializes Pwm module
          Pwm_Init: Header=Pwm.h, InitPhase=INIT_ONE_LATE, ConfigType=Pwm_ConfigType, ConfigPtrClass=PWM_CONST, ConfigPtrName=&Pwm_Config, ModuleRef=Pwm, variation-point=post-build-variant-condition{matching-criterion=RDR_POS, value=1}  # /ActiveEcuC/Pwm PLAIN_TEXT Initializes Pwm module
          Pwm_Init: Header=Pwm.h, InitPhase=INIT_ONE_LATE, ConfigType=Pwm_ConfigType, ConfigPtrClass=PWM_CONST, ConfigPtrName=&Pwm_Config, ModuleRef=Pwm, variation-point=post-build-variant-condition{matching-criterion=RDR_POS, value=7}  # /ActiveEcuC/Pwm PLAIN_TEXT Initializes Pwm module
          Pwm_Init: Header=Pwm.h, InitPhase=INIT_ONE_LATE, ConfigType=Pwm_ConfigType, ConfigPtrClass=PWM_CONST, ConfigPtrName=&Pwm_Config, ModuleRef=Pwm, variation-point=post-build-variant-condition{matching-criterion=RDR_POS, value=0}  # /ActiveEcuC/Pwm PLAIN_TEXT Initializes Pwm module
          Pwm_Init: Header=Pwm.h, InitPhase=INIT_ONE_LATE, ConfigType=Pwm_ConfigType, ConfigPtrClass=PWM_CONST, ConfigPtrName=&Pwm_Config, ModuleRef=Pwm, variation-point=post-build-variant-condition{matching-criterion=RDR_POS, value=5}  # /ActiveEcuC/Pwm PLAIN_TEXT Initializes Pwm module
          Spi_Init: Header=Spi.h, InitPhase=INIT_TWO_MCAL, ConfigType=Spi_ConfigType, ConfigPtrClass=SPI_CONST, ConfigPtrName=NULL_PTR, ModuleRef=Spi, variation-point=post-build-variant-condition{matching-criterion=RDR_POS, value=2}  # /ActiveEcuC/Spi PLAIN_TEXT Created Spi_Init by Extended Init XML Service
          Spi_Init: Header=Spi.h, InitPhase=INIT_TWO_MCAL, ConfigType=Spi_ConfigType, ConfigPtrClass=SPI_CONST, ConfigPtrName=NULL_PTR, ModuleRef=Spi, variation-point=post-build-variant-condition{matching-criterion=RDR_POS, value=6}  # /ActiveEcuC/Spi PLAIN_TEXT Initializes Spi module
          Spi_Init: Header=Spi.h, InitPhase=INIT_TWO_MCAL, ConfigType=Spi_ConfigType, ConfigPtrClass=SPI_CONST, ConfigPtrName=NULL_PTR, ModuleRef=Spi, variation-point=post-build-variant-condition{matching-criterion=RDR_POS, value=4}  # /ActiveEcuC/Spi PLAIN_TEXT Initializes Spi module Created Spi_Init by Extended Init XML Service
          Spi_Init: Header=Spi.h, InitPhase=INIT_TWO_MCAL, ConfigType=Spi_ConfigType, ConfigPtrClass=SPI_CONST, ConfigPtrName=NULL_PTR, ModuleRef=Spi, variation-point=post-build-variant-condition{matching-criterion=RDR_POS, value=3}  # /ActiveEcuC/Spi PLAIN_TEXT Initializes Spi module Created Spi_Init by Extended Init XML Service
          Spi_Init: Header=Spi.h, InitPhase=INIT_TWO_MCAL, ConfigType=Spi_ConfigType, ConfigPtrClass=SPI_CONST, ConfigPtrName=NULL_PTR, ModuleRef=Spi, variation-point=post-build-variant-condition{matching-criterion=RDR_POS, value=1}  # /ActiveEcuC/Spi PLAIN_TEXT Initializes Spi module Created Spi_Init by Extended Init XML Service
          Spi_Init: Header=Spi.h, InitPhase=INIT_TWO_MCAL, ConfigType=Spi_ConfigType, ConfigPtrClass=SPI_CONST, ConfigPtrName=NULL_PTR, ModuleRef=Spi, variation-point=post-build-variant-condition{matching-criterion=RDR_POS, value=7}  # /ActiveEcuC/Spi PLAIN_TEXT Initializes Spi module Created Spi_Init by Extended Init XML Service
          Spi_Init: Header=Spi.h, InitPhase=INIT_TWO_MCAL, ConfigType=Spi_ConfigType, ConfigPtrClass=SPI_CONST, ConfigPtrName=NULL_PTR, ModuleRef=Spi, variation-point=post-build-variant-condition{matching-criterion=RDR_POS, value=0}  # /ActiveEcuC/Spi PLAIN_TEXT Initializes Spi module
          Spi_Init: Header=Spi.h, InitPhase=INIT_TWO_MCAL, ConfigType=Spi_ConfigType, ConfigPtrClass=SPI_CONST, ConfigPtrName=NULL_PTR, ModuleRef=Spi, variation-point=post-build-variant-condition{matching-criterion=RDR_POS, value=5}  # /ActiveEcuC/Spi PLAIN_TEXT Initializes Spi module Created Spi_Init by Extended Init XML Service
          Rtm_InitMemory: Header=Rtm.h, InitPhase=INIT_MEMORY, ModuleRef=Rtm  # /ActiveEcuC/Rtm PLAIN_TEXT Memory Initialization function of module Rtm.
          Rtm_Init: Header=Rtm.h, InitPhase=INIT_TWO_POST_NVMREADALL, ModuleRef=Rtm  # /ActiveEcuC/Rtm PLAIN_TEXT Module Initialization function of module Rtm.
          Fee_30_FlexNor_Init: Header=Fee_30_FlexNor.h, InitPhase=INIT_TWO_IF, ModuleRef=Fee  # /ActiveEcuC/Fee PLAIN_TEXT Initialization of FEE FlexNor
          NvM_Init: Header=NvM.h, InitPhase=INIT_TWO_SYS, ModuleRef=NvM  # /ActiveEcuC/NvM PLAIN_TEXT Initialization of the NVRAM Manager, to make it ready for NvM_ReadAll being requested
          LdCom_Init: Header=LdCom.h, ConfigType=LdCom_ConfigType, ConfigPtrClass=LDCOM_INIT_DATA, InitPhase=INIT_TWO_COM, ConfigPtrName=LdCom_Config_Ptr, ModuleRef=LdCom  # /ActiveEcuC/LdCom PLAIN_TEXT Init function description of LdCom in PostBuildPredefinedVariantView (RDR_01) .
          LdCom_InitMemory: Header=LdCom.h, InitPhase=INIT_MEMORY, ModuleRef=LdCom  # /ActiveEcuC/LdCom PLAIN_TEXT InitMemory function description of LdCom in PostBuildPredefinedVariantView (RDR_01) .
          Sd_Init: Header=Sd.h, ConfigType=Sd_ConfigType, ConfigPtrClass=SD_INIT_DATA, InitPhase=INIT_TWO_SYS, ConfigPtrName=Sd_Config_Ptr, ModuleRef=Sd  # /ActiveEcuC/Sd PLAIN_TEXT Init function description of Sd in PostBuildPredefinedVariantView (RDR_01) .
          Sd_PreInit: Header=Sd.h, ConfigType=Sd_ConfigType, ConfigPtrClass=SD_INIT_DATA, InitPhase=INIT_ONE, ConfigPtrName=Sd_Config_Ptr, ModuleRef=Sd  # /ActiveEcuC/Sd PLAIN_TEXT PreInit function description of Sd in PostBuildPredefinedVariantView (RDR_01) .
          Sd_PostInit: Header=Sd.h, InitPhase=INIT_THREE, ModuleRef=Sd  # /ActiveEcuC/Sd PLAIN_TEXT PostInit function description of Sd in PostBuildPredefinedVariantView (RDR_01) .
          Sd_InitMemory: Header=Sd.h, InitPhase=INIT_MEMORY, ModuleRef=Sd  # /ActiveEcuC/Sd PLAIN_TEXT InitMemory function description of Sd in PostBuildPredefinedVariantView (RDR_01) .
          SomeIpTp_Init: Header=SomeIpTp.h, ConfigType=SomeIpTp_ConfigType, ConfigPtrClass=SOMEIPTP_INIT_DATA, InitPhase=INIT_TWO_TP, ConfigPtrName=SomeIpTp_Config_Ptr, ModuleRef=SomeIpTp  # /ActiveEcuC/SomeIpTp PLAIN_TEXT Init function description of SomeIpTp in PostBuildPredefinedVariantView (RDR_01) .
          SomeIpTp_InitMemory: Header=SomeIpTp.h, InitPhase=INIT_MEMORY, ModuleRef=SomeIpTp  # /ActiveEcuC/SomeIpTp PLAIN_TEXT InitMemory function description of SomeIpTp in PostBuildPredefinedVariantView (RDR_01) .
          SomeIpXf_InitMemory: Header=SomeIpXf.h, InitPhase=INIT_MEMORY, ModuleRef=SomeIpXf  # /ActiveEcuC/SomeIpXf PLAIN_TEXT Automatically generated by BswInitFctConfigurationService.
          SomeIpXf_Init: Header=SomeIpXf.h, InitPhase=NO_INIT, ModuleRef=SomeIpXf  # /ActiveEcuC/SomeIpXf PLAIN_TEXT Automatically generated by BswInitFctConfigurationService.
          ComXf_Init: Header=ComXf.h, InitPhase=NO_INIT, ModuleRef=ComXf  # /ActiveEcuC/ComXf PLAIN_TEXT Automatically generated by BswInitFctConfigurationService.
          WdgM_Init: Header=WdgM.h, InitPhase=INIT_TWO_IF, ConfigType=WdgM_ConfigType, ConfigPtrClass=WDGM_APPL_CONST, ConfigPtrName=&WdgMConfig_Mode0_core0, ModuleRef=WdgM  # /ActiveEcuC/WdgM PLAIN_TEXT Initialization of WdgM Module
          CanXcp_InitMemory: Header=CanXcp.h, InitPhase=INIT_MEMORY, ModuleRef=Xcp  # /ActiveEcuC/Xcp PLAIN_TEXT Memory Initialization function of module CanXcp.
          CanXcp_Init: Header=CanXcp.h, ConfigType=CanXcp_ConfigType, ConfigPtrClass=CANXCP_CONST, InitPhase=INIT_TWO_TP, ConfigPtrName=NULL_PTR, ModuleRef=Xcp  # /ActiveEcuC/Xcp PLAIN_TEXT Module Initialization function of module CanXcp.
          CanTSyn_Init: Header=CanTSyn.h, InitPhase=INIT_TWO_SYS, ConfigType=CanTSyn_ConfigType, ConfigPtrClass=CANTSYN_INIT_DATA, ConfigPtrName=CanTSyn_Config_RDR_01_Ptr if post-build-variant-condition{matching-criterion=RDR_POS, value=0}, ConfigPtrName=CanTSyn_Config_RDR_02_Ptr if post-build-variant-condition{matching-criterion=RDR_POS, value=1}, ConfigPtrName=CanTSyn_Config_RDR_03_Ptr if post-build-variant-condition{matching-criterion=RDR_POS, value=2}, ConfigPtrName=CanTSyn_Config_RDR_04_Ptr if post-build-variant-condition{matching-criterion=RDR_POS, value=3}, ConfigPtrName=CanTSyn_Config_RDR_05_Ptr if post-build-variant-condition{matching-criterion=RDR_POS, value=4}, ConfigPtrName=CanTSyn_Config_RDR_06_Ptr if post-build-variant-condition{matching-criterion=RDR_POS, value=5}, ConfigPtrName=CanTSyn_Config_RDR_07_Ptr if post-build-variant-condition{matching-criterion=RDR_POS, value=6}, ConfigPtrName=CanTSyn_Config_RDR_08_Ptr if post-build-variant-condition{matching-criterion=RDR_POS, value=7}, ModuleRef=CanTSyn  # /ActiveEcuC/CanTSyn PLAIN_TEXT Init function description of CanTSyn in PostBuildPredefinedVariantView (RDR_01) .
          CanTSyn_PreInit: Header=CanTSyn.h, InitPhase=INIT_ONE, ConfigType=CanTSyn_ConfigType, ConfigPtrClass=CANTSYN_INIT_DATA, ConfigPtrName=CanTSyn_Config_RDR_01_Ptr if post-build-variant-condition{matching-criterion=RDR_POS, value=0}, ConfigPtrName=CanTSyn_Config_RDR_02_Ptr if post-build-variant-condition{matching-criterion=RDR_POS, value=1}, ConfigPtrName=CanTSyn_Config_RDR_03_Ptr if post-build-variant-condition{matching-criterion=RDR_POS, value=2}, ConfigPtrName=CanTSyn_Config_RDR_04_Ptr if post-build-variant-condition{matching-criterion=RDR_POS, value=3}, ConfigPtrName=CanTSyn_Config_RDR_05_Ptr if post-build-variant-condition{matching-criterion=RDR_POS, value=4}, ConfigPtrName=CanTSyn_Config_RDR_06_Ptr if post-build-variant-condition{matching-criterion=RDR_POS, value=5}, ConfigPtrName=CanTSyn_Config_RDR_07_Ptr if post-build-variant-condition{matching-criterion=RDR_POS, value=6}, ConfigPtrName=CanTSyn_Config_RDR_08_Ptr if post-build-variant-condition{matching-criterion=RDR_POS, value=7}, ModuleRef=CanTSyn  # /ActiveEcuC/CanTSyn PLAIN_TEXT PreInit function description of CanTSyn in PostBuildPredefinedVariantView (RDR_01) .
          CanTSyn_InitMemory: Header=CanTSyn.h, InitPhase=INIT_MEMORY, ModuleRef=CanTSyn  # /ActiveEcuC/CanTSyn PLAIN_TEXT InitMemory function description of CanTSyn in PostBuildPredefinedVariantView (RDR_01) .
          CryIf_InitMemory: Header=CryIf.h, InitPhase=INIT_MEMORY, ModuleRef=CryIf  # /ActiveEcuC/CryIf PLAIN_TEXT Initializes variables of the Crypto Interface
          CryIf_Init: Header=CryIf.h, InitPhase=INIT_TWO_IF, ModuleRef=CryIf  # /ActiveEcuC/CryIf PLAIN_TEXT Initializes the Crypto Interface
          Csm_InitMemory: Header=Csm.h, InitPhase=INIT_MEMORY, ModuleRef=Csm  # /ActiveEcuC/Csm PLAIN_TEXT Initializes variables of the Crypto Service Manager
          Csm_Init: Header=Csm.h, InitPhase=INIT_TWO_SYS, ModuleRef=Csm  # /ActiveEcuC/Csm PLAIN_TEXT Initializes the Crypto Service Manager
          CanSM_PreInit: Header=CanSM_EcuM.h, ConfigType=CanSM_ConfigType, ConfigPtrClass=CANSM_INIT_DATA, InitPhase=INIT_ONE, ConfigPtrName=CanSM_Config_Ptr, ModuleRef=CanSM  # /ActiveEcuC/CanSM PLAIN_TEXT PreInit function description of CanSM in PostBuildPredefinedVariantView (RDR_01) .
          Crypto_182_iND13400_Init: Header=Crypto_182_iND13400.h, ConfigType=Crypto_ConfigType, ConfigPtrClass=CRYPTO_CONST, InitPhase=INIT_TWO_POST_NVMREADALL, ConfigPtrName=NULL_PTR, ModuleRef=Crypto, variation-point=post-build-variant-condition{matching-criterion=RDR_POS, value=3}  # /ActiveEcuC/Crypto PLAIN_TEXT Created Crypto_182_iND13400_Init by Extended Init XML Service
          Crypto_182_iND13400_Init: Header=Crypto_182_iND13400.h, ConfigType=Crypto_ConfigType, ConfigPtrClass=CRYPTO_CONST, InitPhase=INIT_TWO_POST_NVMREADALL, ConfigPtrName=NULL_PTR, ModuleRef=Crypto, variation-point=post-build-variant-condition{matching-criterion=RDR_POS, value=6}  # /ActiveEcuC/Crypto PLAIN_TEXT Created Crypto_182_iND13400_Init by Extended Init XML Service
          Crypto_182_iND13400_Init: Header=Crypto_182_iND13400.h, ConfigType=Crypto_ConfigType, ConfigPtrClass=CRYPTO_CONST, InitPhase=INIT_TWO_POST_NVMREADALL, ConfigPtrName=NULL_PTR, ModuleRef=Crypto, variation-point=post-build-variant-condition{matching-criterion=RDR_POS, value=4}  # /ActiveEcuC/Crypto PLAIN_TEXT Created Crypto_182_iND13400_Init by Extended Init XML Service
          Crypto_182_iND13400_Init: Header=Crypto_182_iND13400.h, ConfigType=Crypto_ConfigType, ConfigPtrClass=CRYPTO_CONST, InitPhase=INIT_TWO_POST_NVMREADALL, ConfigPtrName=NULL_PTR, ModuleRef=Crypto, variation-point=post-build-variant-condition{matching-criterion=RDR_POS, value=1}  # /ActiveEcuC/Crypto PLAIN_TEXT Created Crypto_182_iND13400_Init by Extended Init XML Service
          Crypto_182_iND13400_Init: Header=Crypto_182_iND13400.h, ConfigType=Crypto_ConfigType, ConfigPtrClass=CRYPTO_CONST, InitPhase=INIT_TWO_POST_NVMREADALL, ConfigPtrName=NULL_PTR, ModuleRef=Crypto, variation-point=post-build-variant-condition{matching-criterion=RDR_POS, value=7}  # /ActiveEcuC/Crypto PLAIN_TEXT Created Crypto_182_iND13400_Init by Extended Init XML Service
          Crypto_182_iND13400_Init: Header=Crypto_182_iND13400.h, ConfigType=Crypto_ConfigType, ConfigPtrClass=CRYPTO_CONST, InitPhase=INIT_TWO_POST_NVMREADALL, ConfigPtrName=NULL_PTR, ModuleRef=Crypto, variation-point=post-build-variant-condition{matching-criterion=RDR_POS, value=0}  # /ActiveEcuC/Crypto PLAIN_TEXT Initializes Crypto module
          Crypto_182_iND13400_Init: Header=Crypto_182_iND13400.h, ConfigType=Crypto_ConfigType, ConfigPtrClass=CRYPTO_CONST, InitPhase=INIT_TWO_POST_NVMREADALL, ConfigPtrName=NULL_PTR, ModuleRef=Crypto, variation-point=post-build-variant-condition{matching-criterion=RDR_POS, value=5}  # /ActiveEcuC/Crypto PLAIN_TEXT Created Crypto_182_iND13400_Init by Extended Init XML Service
          Crypto_182_iND13400_Init: Header=Crypto_182_iND13400.h, ConfigType=Crypto_ConfigType, ConfigPtrClass=CRYPTO_CONST, InitPhase=INIT_TWO_POST_NVMREADALL, ConfigPtrName=NULL_PTR, ModuleRef=Crypto, variation-point=post-build-variant-condition{matching-criterion=RDR_POS, value=2}  # /ActiveEcuC/Crypto PLAIN_TEXT Created Crypto_182_iND13400_Init by Extended Init XML Service
          Det_Start: Header=Det.h, InitPhase=INIT_ONE, ModuleRef=Det  # /ActiveEcuC/Det PLAIN_TEXT PostInit function description of Det in PostBuildInvariantValuesModelView (PostBuildInvariantValuesModelView) .
          Eth_30_Wrapper_InitMemory: Header=Eth_30_Wrapper.h, InitPhase=INIT_MEMORY, ModuleRef=Eth  # /ActiveEcuC/Eth PLAIN_TEXT InitMemory function description of Eth_30_Wrapper in PostBuildInvariantValuesModelView (PostBuildInvariantValuesModelView) .
          vLinkGen_Init: Header=vLinkGen_Lcfg.h, InitPhase=NO_INIT, ModuleRef=vLinkGen  # /ActiveEcuC/vLinkGen PLAIN_TEXT Dummy initialization of the vLinkGen
          vBaseEnv_Init: Header=, InitPhase=NO_INIT, ModuleRef=vBaseEnv  # /ActiveEcuC/vBaseEnv PLAIN_TEXT Created vBaseEnv_Init by Extended Init XML Service
          Uart_Init: Header=Uart.h, ConfigType=Uart_ConfigType, ConfigPtrClass=UART_CONST, InitPhase=INIT_ONE_LATE, ConfigPtrName=NULL_PTR, ModuleRef=Uart, variation-point=post-build-variant-condition{matching-criterion=RDR_POS, value=2}  # /ActiveEcuC/Uart PLAIN_TEXT Created Uart_Init by Extended Init XML Service
          Uart_Init: Header=Uart.h, ConfigType=Uart_ConfigType, ConfigPtrClass=UART_CONST, InitPhase=INIT_ONE_LATE, ConfigPtrName=NULL_PTR, ModuleRef=Uart, variation-point=post-build-variant-condition{matching-criterion=RDR_POS, value=6}  # /ActiveEcuC/Uart PLAIN_TEXT Initializes Uart module
          Uart_Init: Header=Uart.h, ConfigType=Uart_ConfigType, ConfigPtrClass=UART_CONST, InitPhase=INIT_ONE_LATE, ConfigPtrName=NULL_PTR, ModuleRef=Uart, variation-point=post-build-variant-condition{matching-criterion=RDR_POS, value=4}  # /ActiveEcuC/Uart PLAIN_TEXT Initializes Uart module Created Uart_Init by Extended Init XML Service
          Uart_Init: Header=Uart.h, ConfigType=Uart_ConfigType, ConfigPtrClass=UART_CONST, InitPhase=INIT_ONE_LATE, ConfigPtrName=NULL_PTR, ModuleRef=Uart, variation-point=post-build-variant-condition{matching-criterion=RDR_POS, value=3}  # /ActiveEcuC/Uart PLAIN_TEXT Initializes Uart module Created Uart_Init by Extended Init XML Service
          Uart_Init: Header=Uart.h, ConfigType=Uart_ConfigType, ConfigPtrClass=UART_CONST, InitPhase=INIT_ONE_LATE, ConfigPtrName=NULL_PTR, ModuleRef=Uart, variation-point=post-build-variant-condition{matching-criterion=RDR_POS, value=1}  # /ActiveEcuC/Uart PLAIN_TEXT Initializes Uart module Created Uart_Init by Extended Init XML Service
          Uart_Init: Header=Uart.h, ConfigType=Uart_ConfigType, ConfigPtrClass=UART_CONST, InitPhase=INIT_ONE_LATE, ConfigPtrName=NULL_PTR, ModuleRef=Uart, variation-point=post-build-variant-condition{matching-criterion=RDR_POS, value=7}  # /ActiveEcuC/Uart PLAIN_TEXT Initializes Uart module Created Uart_Init by Extended Init XML Service
          Uart_Init: Header=Uart.h, ConfigType=Uart_ConfigType, ConfigPtrClass=UART_CONST, InitPhase=INIT_ONE_LATE, ConfigPtrName=NULL_PTR, ModuleRef=Uart, variation-point=post-build-variant-condition{matching-criterion=RDR_POS, value=0}  # /ActiveEcuC/Uart PLAIN_TEXT Initializes Uart module
          Uart_Init: Header=Uart.h, ConfigType=Uart_ConfigType, ConfigPtrClass=UART_CONST, InitPhase=INIT_ONE_LATE, ConfigPtrName=NULL_PTR, ModuleRef=Uart, variation-point=post-build-variant-condition{matching-criterion=RDR_POS, value=5}  # /ActiveEcuC/Uart PLAIN_TEXT Initializes Uart module Created Uart_Init by Extended Init XML Service
          J1939Tp_Init: Header=J1939Tp.h, ConfigType=J1939Tp_ConfigType, ConfigPtrClass=J1939TP_INIT_DATA, InitPhase=INIT_TWO_TP, ConfigPtrName=J1939Tp_Config_RDR_01_Ptr if post-build-variant-condition{matching-criterion=RDR_POS, value=0}, ConfigPtrName=J1939Tp_Config_RDR_02_Ptr if post-build-variant-condition{matching-criterion=RDR_POS, value=1}, ConfigPtrName=J1939Tp_Config_RDR_03_Ptr if post-build-variant-condition{matching-criterion=RDR_POS, value=2}, ConfigPtrName=J1939Tp_Config_RDR_04_Ptr if post-build-variant-condition{matching-criterion=RDR_POS, value=3}, ConfigPtrName=J1939Tp_Config_RDR_05_Ptr if post-build-variant-condition{matching-criterion=RDR_POS, value=4}, ConfigPtrName=J1939Tp_Config_RDR_06_Ptr if post-build-variant-condition{matching-criterion=RDR_POS, value=5}, ConfigPtrName=J1939Tp_Config_RDR_07_Ptr if post-build-variant-condition{matching-criterion=RDR_POS, value=6}, ConfigPtrName=J1939Tp_Config_RDR_08_Ptr if post-build-variant-condition{matching-criterion=RDR_POS, value=7}, ModuleRef=J1939Tp  # /ActiveEcuC/J1939Tp PLAIN_TEXT Init function description of J1939Tp in PostBuildPredefinedVariantView (RDR_01) .
          J1939Tp_InitMemory: Header=J1939Tp.h, InitPhase=INIT_MEMORY, ModuleRef=J1939Tp  # /ActiveEcuC/J1939Tp PLAIN_TEXT InitMemory function description of J1939Tp in PostBuildPredefinedVariantView (RDR_01) .
          Dem_Init: Header=Dem.h, ConfigType=Dem_ConfigType, ConfigPtrClass=DEM_INIT_DATA, InitPhase=INIT_TWO_POST_NVMREADALL, ConfigPtrName=Dem_Config_RDR_01_Ptr if post-build-variant-condition{matching-criterion=RDR_POS, value=0}, ConfigPtrName=Dem_Config_RDR_02_Ptr if post-build-variant-condition{matching-criterion=RDR_POS, value=1}, ConfigPtrName=Dem_Config_RDR_03_Ptr if post-build-variant-condition{matching-criterion=RDR_POS, value=2}, ConfigPtrName=Dem_Config_RDR_04_Ptr if post-build-variant-condition{matching-criterion=RDR_POS, value=3}, ConfigPtrName=Dem_Config_RDR_05_Ptr if post-build-variant-condition{matching-criterion=RDR_POS, value=4}, ConfigPtrName=Dem_Config_RDR_06_Ptr if post-build-variant-condition{matching-criterion=RDR_POS, value=5}, ConfigPtrName=Dem_Config_RDR_07_Ptr if post-build-variant-condition{matching-criterion=RDR_POS, value=6}, ConfigPtrName=Dem_Config_RDR_08_Ptr if post-build-variant-condition{matching-criterion=RDR_POS, value=7}, ModuleRef=Dem  # /ActiveEcuC/Dem PLAIN_TEXT Init function description of Dem in PostBuildPredefinedVariantView (RDR_01) . Init function description of Dem in PostBuildPredefinedVariantView (RDR_02) . Init function description of Dem in PostBuildPredefinedVariantView (RDR_03) . Init function description of Dem in PostBuildPredefinedVariantView (RDR_04) . Init function description of Dem in PostBuildPredefinedVariantView (RDR_05) . Init function description of Dem in PostBuildPredefinedVariantView (RDR_06) . Init function description of Dem in PostBuildPredefinedVariantView (RDR_07) . Init function description of Dem in PostBuildPredefinedVariantView (RDR_08) .
          Dem_PreInit: Header=Dem.h, ConfigType=Dem_ConfigType, ConfigPtrClass=DEM_INIT_DATA, InitPhase=INIT_ZERO, ConfigPtrName=Dem_Config_RDR_01_Ptr if post-build-variant-condition{matching-criterion=RDR_POS, value=0}, ConfigPtrName=Dem_Config_RDR_02_Ptr if post-build-variant-condition{matching-criterion=RDR_POS, value=1}, ConfigPtrName=Dem_Config_RDR_03_Ptr if post-build-variant-condition{matching-criterion=RDR_POS, value=2}, ConfigPtrName=Dem_Config_RDR_04_Ptr if post-build-variant-condition{matching-criterion=RDR_POS, value=3}, ConfigPtrName=Dem_Config_RDR_05_Ptr if post-build-variant-condition{matching-criterion=RDR_POS, value=4}, ConfigPtrName=Dem_Config_RDR_06_Ptr if post-build-variant-condition{matching-criterion=RDR_POS, value=5}, ConfigPtrName=Dem_Config_RDR_07_Ptr if post-build-variant-condition{matching-criterion=RDR_POS, value=6}, ConfigPtrName=Dem_Config_RDR_08_Ptr if post-build-variant-condition{matching-criterion=RDR_POS, value=7}, ModuleRef=Dem  # /ActiveEcuC/Dem PLAIN_TEXT PreInit function description of Dem in PostBuildPredefinedVariantView (RDR_01) . PreInit function description of Dem in PostBuildPredefinedVariantView (RDR_02) . PreInit function description of Dem in PostBuildPredefinedVariantView (RDR_03) . PreInit function description of Dem in PostBuildPredefinedVariantView (RDR_04) . PreInit function description of Dem in PostBuildPredefinedVariantView (RDR_05) . PreInit function description of Dem in PostBuildPredefinedVariantView (RDR_06) . PreInit function description of Dem in PostBuildPredefinedVariantView (RDR_07) . PreInit function description of Dem in PostBuildPredefinedVariantView (RDR_08) .
          Dem_InitMemory: Header=Dem.h, InitPhase=INIT_MEMORY, ModuleRef=Dem  # /ActiveEcuC/Dem PLAIN_TEXT InitMemory function description of Dem in PostBuildPredefinedVariantView (RDR_01) .
          J1939Dcm_Init: Header=J1939Dcm.h, ConfigType=J1939Dcm_ConfigType, ConfigPtrClass=J1939DCM_INIT_DATA, InitPhase=INIT_TWO_POST_NVMREADALL, ConfigPtrName=J1939Dcm_Config_Ptr, ModuleRef=J1939Dcm  # /ActiveEcuC/J1939Dcm PLAIN_TEXT Init function description of J1939Dcm in PostBuildPredefinedVariantView (RDR_01) .
          J1939Dcm_InitMemory: Header=J1939Dcm.h, InitPhase=INIT_MEMORY, ModuleRef=J1939Dcm  # /ActiveEcuC/J1939Dcm PLAIN_TEXT InitMemory function description of J1939Dcm in PostBuildPredefinedVariantView (RDR_01) .
          CanTp_Init: Header=CanTp.h, ConfigType=CanTp_PBConfigType, ConfigPtrClass=CANTP_INIT_DATA, InitPhase=INIT_TWO_TP, ConfigPtrName=CanTp_Config_RDR_01_Ptr if post-build-variant-condition{matching-criterion=RDR_POS, value=0}, ConfigPtrName=CanTp_Config_RDR_02_Ptr if post-build-variant-condition{matching-criterion=RDR_POS, value=1}, ConfigPtrName=CanTp_Config_RDR_03_Ptr if post-build-variant-condition{matching-criterion=RDR_POS, value=2}, ConfigPtrName=CanTp_Config_RDR_04_Ptr if post-build-variant-condition{matching-criterion=RDR_POS, value=3}, ConfigPtrName=CanTp_Config_RDR_05_Ptr if post-build-variant-condition{matching-criterion=RDR_POS, value=4}, ConfigPtrName=CanTp_Config_RDR_06_Ptr if post-build-variant-condition{matching-criterion=RDR_POS, value=5}, ConfigPtrName=CanTp_Config_RDR_07_Ptr if post-build-variant-condition{matching-criterion=RDR_POS, value=6}, ConfigPtrName=CanTp_Config_RDR_08_Ptr if post-build-variant-condition{matching-criterion=RDR_POS, value=7}, ModuleRef=CanTp  # /ActiveEcuC/CanTp PLAIN_TEXT Init function description of CanTp in PostBuildPredefinedVariantView (RDR_01) .
          CanTp_PreInit: Header=CanTp.h, ConfigType=CanTp_PBConfigType, ConfigPtrClass=CANTP_INIT_DATA, InitPhase=INIT_ONE, ConfigPtrName=CanTp_Config_RDR_01_Ptr if post-build-variant-condition{matching-criterion=RDR_POS, value=0}, ConfigPtrName=CanTp_Config_RDR_02_Ptr if post-build-variant-condition{matching-criterion=RDR_POS, value=1}, ConfigPtrName=CanTp_Config_RDR_03_Ptr if post-build-variant-condition{matching-criterion=RDR_POS, value=2}, ConfigPtrName=CanTp_Config_RDR_04_Ptr if post-build-variant-condition{matching-criterion=RDR_POS, value=3}, ConfigPtrName=CanTp_Config_RDR_05_Ptr if post-build-variant-condition{matching-criterion=RDR_POS, value=4}, ConfigPtrName=CanTp_Config_RDR_06_Ptr if post-build-variant-condition{matching-criterion=RDR_POS, value=5}, ConfigPtrName=CanTp_Config_RDR_07_Ptr if post-build-variant-condition{matching-criterion=RDR_POS, value=6}, ConfigPtrName=CanTp_Config_RDR_08_Ptr if post-build-variant-condition{matching-criterion=RDR_POS, value=7}, ModuleRef=CanTp  # /ActiveEcuC/CanTp PLAIN_TEXT PreInit function description of CanTp in PostBuildPredefinedVariantView (RDR_01) .
          CanTp_InitMemory: Header=CanTp.h, InitPhase=INIT_MEMORY, ModuleRef=CanTp  # /ActiveEcuC/CanTp PLAIN_TEXT InitMemory function description of CanTp in PostBuildPredefinedVariantView (RDR_01) .
          Dcm_Init: Header=Dcm.h, ConfigType=Dcm_ConfigType, ConfigPtrClass=DCM_CONST, InitPhase=INIT_TWO_POST_NVMREADALL, ConfigPtrName=&Dcm_CfgConfig_RDR_01 if post-build-variant-condition{matching-criterion=RDR_POS, value=0}, ConfigPtrName=&Dcm_CfgConfig_RDR_02 if post-build-variant-condition{matching-criterion=RDR_POS, value=1}, ConfigPtrName=&Dcm_CfgConfig_RDR_03 if post-build-variant-condition{matching-criterion=RDR_POS, value=2}, ConfigPtrName=&Dcm_CfgConfig_RDR_04 if post-build-variant-condition{matching-criterion=RDR_POS, value=3}, ConfigPtrName=&Dcm_CfgConfig_RDR_05 if post-build-variant-condition{matching-criterion=RDR_POS, value=4}, ConfigPtrName=&Dcm_CfgConfig_RDR_06 if post-build-variant-condition{matching-criterion=RDR_POS, value=5}, ConfigPtrName=&Dcm_CfgConfig_RDR_07 if post-build-variant-condition{matching-criterion=RDR_POS, value=6}, ConfigPtrName=&Dcm_CfgConfig_RDR_08 if post-build-variant-condition{matching-criterion=RDR_POS, value=7}, ModuleRef=Dcm  # /ActiveEcuC/Dcm PLAIN_TEXT Dcm_Init function description
          Dcm_InitMemory: Header=Dcm.h, InitPhase=INIT_MEMORY, ModuleRef=Dcm  # /ActiveEcuC/Dcm PLAIN_TEXT Dcm_InitMemory function description
          EthTrcv_30_Tja1103_InitMemory: Header=EthTrcv_30_Tja1103.h, InitPhase=INIT_MEMORY, ModuleRef=EthTrcv_NXP, variation-point=post-build-variant-condition{matching-criterion=RDR_POS, value=6}  # /ActiveEcuC/EthTrcv_001 PLAIN_TEXT Memory Initialization function of module EthTrcv_30_Tja1103.
          EthTrcv_30_Tja1103_InitMemory: Header=EthTrcv_30_Tja1103.h, InitPhase=INIT_MEMORY, ModuleRef=EthTrcv_NXP, variation-point=post-build-variant-condition{matching-criterion=RDR_POS, value=3}  # /ActiveEcuC/EthTrcv_001 PLAIN_TEXT Memory Initialization function of module EthTrcv_30_Tja1103.
          EthTrcv_30_Tja1103_InitMemory: Header=EthTrcv_30_Tja1103.h, InitPhase=INIT_MEMORY, ModuleRef=EthTrcv_NXP, variation-point=post-build-variant-condition{matching-criterion=RDR_POS, value=1}  # /ActiveEcuC/EthTrcv_001 PLAIN_TEXT Memory Initialization function of module EthTrcv_30_Tja1103.
          EthTrcv_30_Tja1103_InitMemory: Header=EthTrcv_30_Tja1103.h, InitPhase=INIT_MEMORY, ModuleRef=EthTrcv_NXP, variation-point=post-build-variant-condition{matching-criterion=RDR_POS, value=4}  # /ActiveEcuC/EthTrcv_001 PLAIN_TEXT Memory Initialization function of module EthTrcv_30_Tja1103.
          EthTrcv_30_Tja1103_InitMemory: Header=EthTrcv_30_Tja1103.h, InitPhase=INIT_MEMORY, ModuleRef=EthTrcv_NXP, variation-point=post-build-variant-condition{matching-criterion=RDR_POS, value=7}  # /ActiveEcuC/EthTrcv_NXP PLAIN_TEXT Memory Initialization function of module EthTrcv_30_Tja1103.
          EthTrcv_30_Tja1103_InitMemory: Header=EthTrcv_30_Tja1103.h, InitPhase=INIT_MEMORY, ModuleRef=EthTrcv_NXP, variation-point=post-build-variant-condition{matching-criterion=RDR_POS, value=0}  # /ActiveEcuC/EthTrcv_001 PLAIN_TEXT Memory Initialization function of module EthTrcv_30_Tja1103.
          EthTrcv_30_Tja1103_InitMemory: Header=EthTrcv_30_Tja1103.h, InitPhase=INIT_MEMORY, ModuleRef=EthTrcv_NXP, variation-point=post-build-variant-condition{matching-criterion=RDR_POS, value=5}  # /ActiveEcuC/EthTrcv_001 PLAIN_TEXT Memory Initialization function of module EthTrcv_30_Tja1103.
          EthTrcv_30_Tja1103_InitMemory: Header=EthTrcv_30_Tja1103.h, InitPhase=INIT_MEMORY, ModuleRef=EthTrcv_NXP, variation-point=post-build-variant-condition{matching-criterion=RDR_POS, value=2}  # /ActiveEcuC/EthTrcv_001 PLAIN_TEXT Memory Initialization function of module EthTrcv_30_Tja1103.
          EthTrcv_30_Tja1103_Init: Header=EthTrcv_30_Tja1103.h, InitPhase=INIT_TWO_TRCV, ConfigType=EthTrcv_30_Tja1103_ConfigType, ConfigPtrClass=ETHTRCV_30_TJA1103_INIT_DATA, ConfigPtrName=EthTrcv_30_Tja1103_Config_Ptr, ModuleRef=EthTrcv_NXP, variation-point=post-build-variant-condition{matching-criterion=RDR_POS, value=6}  # /ActiveEcuC/EthTrcv_001 PLAIN_TEXT Module Initialization function of module EthTrcv_30_Tja1103.
          EthTrcv_30_Tja1103_Init: Header=EthTrcv_30_Tja1103.h, ConfigType=EthTrcv_30_Tja1103_ConfigType, ConfigPtrClass=ETHTRCV_30_TJA1103_INIT_DATA, InitPhase=INIT_TWO_TRCV, ConfigPtrName=EthTrcv_30_Tja1103_Config_Ptr, ModuleRef=EthTrcv_NXP, variation-point=post-build-variant-condition{matching-criterion=RDR_POS, value=3}  # /ActiveEcuC/EthTrcv_001 PLAIN_TEXT Module Initialization function of module EthTrcv_30_Tja1103.
          EthTrcv_30_Tja1103_Init: Header=EthTrcv_30_Tja1103.h, ConfigType=EthTrcv_30_Tja1103_ConfigType, ConfigPtrClass=ETHTRCV_30_TJA1103_INIT_DATA, InitPhase=INIT_TWO_TRCV, ConfigPtrName=EthTrcv_30_Tja1103_Config_Ptr, ModuleRef=EthTrcv_NXP, variation-point=post-build-variant-condition{matching-criterion=RDR_POS, value=1}  # /ActiveEcuC/EthTrcv_001 PLAIN_TEXT Module Initialization function of module EthTrcv_30_Tja1103.
          EthTrcv_30_Tja1103_Init: Header=EthTrcv_30_Tja1103.h, ConfigType=EthTrcv_30_Tja1103_ConfigType, ConfigPtrClass=ETHTRCV_30_TJA1103_INIT_DATA, InitPhase=INIT_TWO_TRCV, ConfigPtrName=EthTrcv_30_Tja1103_Config_Ptr, ModuleRef=EthTrcv_NXP, variation-point=post-build-variant-condition{matching-criterion=RDR_POS, value=4}  # /ActiveEcuC/EthTrcv_001 PLAIN_TEXT Module Initialization function of module EthTrcv_30_Tja1103.
          EthTrcv_30_Tja1103_Init: Header=EthTrcv_30_Tja1103.h, ConfigType=EthTrcv_30_Tja1103_ConfigType, ConfigPtrClass=ETHTRCV_30_TJA1103_INIT_DATA, InitPhase=INIT_TWO_TRCV, ConfigPtrName=EthTrcv_30_Tja1103_Config_Ptr, ModuleRef=EthTrcv_NXP, variation-point=post-build-variant-condition{matching-criterion=RDR_POS, value=7}  # /ActiveEcuC/EthTrcv_NXP PLAIN_TEXT Module Initialization function of module EthTrcv_30_Tja1103.
          EthTrcv_30_Tja1103_Init: Header=EthTrcv_30_Tja1103.h, ConfigType=EthTrcv_30_Tja1103_ConfigType, ConfigPtrClass=ETHTRCV_30_TJA1103_INIT_DATA, InitPhase=INIT_TWO_TRCV, ConfigPtrName=EthTrcv_30_Tja1103_Config_Ptr, ModuleRef=EthTrcv_NXP, variation-point=post-build-variant-condition{matching-criterion=RDR_POS, value=0}  # /ActiveEcuC/EthTrcv_001 PLAIN_TEXT Module Initialization function of module EthTrcv_30_Tja1103.
          EthTrcv_30_Tja1103_Init: Header=EthTrcv_30_Tja1103.h, ConfigType=EthTrcv_30_Tja1103_ConfigType, ConfigPtrClass=ETHTRCV_30_TJA1103_INIT_DATA, InitPhase=INIT_TWO_TRCV, ConfigPtrName=EthTrcv_30_Tja1103_Config_Ptr, ModuleRef=EthTrcv_NXP, variation-point=post-build-variant-condition{matching-criterion=RDR_POS, value=5}  # /ActiveEcuC/EthTrcv_001 PLAIN_TEXT Module Initialization function of module EthTrcv_30_Tja1103.
          EthTrcv_30_Tja1103_Init: Header=EthTrcv_30_Tja1103.h, ConfigType=EthTrcv_30_Tja1103_ConfigType, ConfigPtrClass=ETHTRCV_30_TJA1103_INIT_DATA, InitPhase=INIT_TWO_TRCV, ConfigPtrName=EthTrcv_30_Tja1103_Config_Ptr, ModuleRef=EthTrcv_NXP, variation-point=post-build-variant-condition{matching-criterion=RDR_POS, value=2}  # /ActiveEcuC/EthTrcv_001 PLAIN_TEXT Module Initialization function of module EthTrcv_30_Tja1103.
          Wdg_182_iND13400_Init: Header=Wdg_182_iND13400.h, InitPhase=INIT_ONE_LATE, ConfigType=Wdg_182_iND13400_ConfigType, ConfigPtrClass=WDG_CONST, ConfigPtrName=NULL_PTR, ModuleRef=Wdg  # /ActiveEcuC/Wdg PLAIN_TEXT Initializes Wdg module
          E2EXf_InitMemory: Header=E2EXf.h, InitPhase=INIT_MEMORY, ModuleRef=E2EXf, variation-point=post-build-variant-condition{matching-criterion=RDR_POS, value=6}  # /ActiveEcuC/E2EXf PLAIN_TEXT Automatically generated by BswInitFctConfigurationService.
          E2EXf_InitMemory: Header=E2EXf.h, InitPhase=INIT_MEMORY, ModuleRef=E2EXf, variation-point=post-build-variant-condition{matching-criterion=RDR_POS, value=1}  # /ActiveEcuC/E2EXf PLAIN_TEXT Automatically generated by BswInitFctConfigurationService.
          E2EXf_InitMemory: Header=E2EXf.h, InitPhase=INIT_MEMORY, ModuleRef=E2EXf, variation-point=post-build-variant-condition{matching-criterion=RDR_POS, value=5}  # /ActiveEcuC/E2EXf PLAIN_TEXT Automatically generated by BswInitFctConfigurationService.
          E2EXf_InitMemory: Header=E2EXf.h, InitPhase=INIT_MEMORY, ModuleRef=E2EXf, variation-point=post-build-variant-condition{matching-criterion=RDR_POS, value=3}  # /ActiveEcuC/E2EXf PLAIN_TEXT Automatically generated by BswInitFctConfigurationService.
          E2EXf_InitMemory: Header=E2EXf.h, InitPhase=INIT_MEMORY, ModuleRef=E2EXf, variation-point=post-build-variant-condition{matching-criterion=RDR_POS, value=0}  # /ActiveEcuC/E2EXf PLAIN_TEXT Automatically generated by BswInitFctConfigurationService.
          E2EXf_InitMemory: Header=E2EXf.h, InitPhase=INIT_MEMORY, ModuleRef=E2EXf, variation-point=post-build-variant-condition{matching-criterion=RDR_POS, value=2}  # /ActiveEcuC/E2EXf PLAIN_TEXT Automatically generated by BswInitFctConfigurationService.
          E2EXf_InitMemory: Header=E2EXf.h, InitPhase=INIT_MEMORY, ModuleRef=E2EXf, variation-point=post-build-variant-condition{matching-criterion=RDR_POS, value=7}  # /ActiveEcuC/E2EXf PLAIN_TEXT Automatically generated by BswInitFctConfigurationService.
          E2EXf_InitMemory: Header=E2EXf.h, InitPhase=INIT_MEMORY, ModuleRef=E2EXf, variation-point=post-build-variant-condition{matching-criterion=RDR_POS, value=4}  # /ActiveEcuC/E2EXf PLAIN_TEXT Automatically generated by BswInitFctConfigurationService.
          E2EXf_Init: Header=E2EXf.h, InitPhase=INIT_ONE, ConfigType=E2EXf_ConfigType, ConfigPtrClass=E2EXF_PBCFG, ConfigPtrName=NULL_PTR, ModuleRef=E2EXf, variation-point=post-build-variant-condition{matching-criterion=RDR_POS, value=6}  # /ActiveEcuC/E2EXf PLAIN_TEXT Automatically generated by BswInitFctConfigurationService.
          E2EXf_Init: Header=E2EXf.h, ConfigType=E2EXf_ConfigType, ConfigPtrClass=E2EXF_PBCFG, InitPhase=INIT_ONE, ConfigPtrName=NULL_PTR, ModuleRef=E2EXf, variation-point=post-build-variant-condition{matching-criterion=RDR_POS, value=1}  # /ActiveEcuC/E2EXf PLAIN_TEXT Automatically generated by BswInitFctConfigurationService.
          E2EXf_Init: Header=E2EXf.h, ConfigType=E2EXf_ConfigType, ConfigPtrClass=E2EXF_PBCFG, InitPhase=INIT_ONE, ConfigPtrName=NULL_PTR, ModuleRef=E2EXf, variation-point=post-build-variant-condition{matching-criterion=RDR_POS, value=5}  # /ActiveEcuC/E2EXf PLAIN_TEXT Automatically generated by BswInitFctConfigurationService.
          E2EXf_Init: Header=E2EXf.h, ConfigType=E2EXf_ConfigType, ConfigPtrClass=E2EXF_PBCFG, InitPhase=INIT_ONE, ConfigPtrName=NULL_PTR, ModuleRef=E2EXf, variation-point=post-build-variant-condition{matching-criterion=RDR_POS, value=3}  # /ActiveEcuC/E2EXf PLAIN_TEXT Automatically generated by BswInitFctConfigurationService.
          E2EXf_Init: Header=E2EXf.h, ConfigType=E2EXf_ConfigType, ConfigPtrClass=E2EXF_PBCFG, InitPhase=INIT_ONE, ConfigPtrName=NULL_PTR, ModuleRef=E2EXf, variation-point=post-build-variant-condition{matching-criterion=RDR_POS, value=0}  # /ActiveEcuC/E2EXf PLAIN_TEXT Automatically generated by BswInitFctConfigurationService.
          E2EXf_Init: Header=E2EXf.h, ConfigType=E2EXf_ConfigType, ConfigPtrClass=E2EXF_PBCFG, InitPhase=INIT_ONE, ConfigPtrName=NULL_PTR, ModuleRef=E2EXf, variation-point=post-build-variant-condition{matching-criterion=RDR_POS, value=2}  # /ActiveEcuC/E2EXf PLAIN_TEXT Automatically generated by BswInitFctConfigurationService.
          E2EXf_Init: Header=E2EXf.h, ConfigType=E2EXf_ConfigType, ConfigPtrClass=E2EXF_PBCFG, InitPhase=INIT_ONE, ConfigPtrName=NULL_PTR, ModuleRef=E2EXf, variation-point=post-build-variant-condition{matching-criterion=RDR_POS, value=7}  # /ActiveEcuC/E2EXf PLAIN_TEXT Automatically generated by BswInitFctConfigurationService.
          E2EXf_Init: Header=E2EXf.h, ConfigType=E2EXf_ConfigType, ConfigPtrClass=E2EXF_PBCFG, InitPhase=INIT_ONE, ConfigPtrName=NULL_PTR, ModuleRef=E2EXf, variation-point=post-build-variant-condition{matching-criterion=RDR_POS, value=4}  # /ActiveEcuC/E2EXf PLAIN_TEXT Automatically generated by BswInitFctConfigurationService.
          Can_Init: Header=Can.h, InitPhase=INIT_TWO_DRV, ConfigType=Can_ConfigType, ConfigPtrClass=CAN_CONST, ConfigPtrName=NULL_PTR, ModuleRef=Can, variation-point=post-build-variant-condition{matching-criterion=RDR_POS, value=0}  # /ActiveEcuC/Can PLAIN_TEXT Initializes Can module
          Can_Init: Header=Can.h, InitPhase=INIT_TWO_DRV, ConfigType=Can_ConfigType, ConfigPtrClass=CAN_CONST, ConfigPtrName=NULL_PTR, ModuleRef=Can, variation-point=post-build-variant-condition{matching-criterion=RDR_POS, value={1..3}}
          Can_Init: Header=Can.h, InitPhase=INIT_TWO_DRV, ConfigType=Can_ConfigType, ConfigPtrClass=CAN_CONST, ConfigPtrName=NULL_PTR, ModuleRef=Can, variation-point=post-build-variant-condition{matching-criterion=RDR_POS, value=7}
          Dio_Init: Header=Dio.h, InitPhase=NO_INIT, ConfigType=Dio_ConfigType, ConfigPtrClass=DIO_CONST, ConfigPtrName=NULL_PTR, ModuleRef=Dio, variation-point=post-build-variant-condition{matching-criterion=RDR_POS, value=0}  # /ActiveEcuC/Dio PLAIN_TEXT Initializes Dio module
          Dio_Init: Header=Dio.h, InitPhase=NO_INIT, ConfigType=Dio_ConfigType, ConfigPtrClass=DIO_CONST, ConfigPtrName=NULL_PTR, ModuleRef=Dio, variation-point=post-build-variant-condition{matching-criterion=RDR_POS, value=4}
          Port_Init: Header=Port.h, InitPhase=INIT_ONE, ConfigType=Port_ConfigType, ConfigPtrClass=PORT_CONST, ConfigPtrName=NULL_PTR, ModuleRef=Port, variation-point=post-build-variant-condition{matching-criterion=RDR_POS, value=7}  # /ActiveEcuC/Port PLAIN_TEXT Initializes Port driver
    EcucHardware
      EcucCoreDefinition_Core0 (EcucCoreDefinition): EcucCoreId=0
    EcucPartitionCollection
      3 x EcucPartition, all with EcucPartitionBswModuleExecution=false, PartitionCanBeRestarted=false:
        EcucPartition_Core0_ASIL: ASIL=B, EcucPartitionSoftwareComponentInstanceRef=COMPOSITIONTYPE.Os_OsCore0_swc, EcucPartitionSoftwareComponentInstanceRef=COMPOSITIONTYPE.SWC_PLT_Appl_Diag, EcucPartitionSoftwareComponentInstanceRef=COMPOSITIONTYPE.SWC_PLT_Appl_FaultMgr, EcucPartitionSoftwareComponentInstanceRef=COMPOSITIONTYPE.SWC_PLT_CDD_Radar_Control, EcucPartitionSoftwareComponentInstanceRef=COMPOSITIONTYPE.SWC_PLT_Appl_ModeManager, EcucPartitionSoftwareComponentInstanceRef=COMPOSITIONTYPE.SWC_PLT_Appl_NvMHandler, EcucPartitionSoftwareComponentInstanceRef=COMPOSITIONTYPE.SWC_PLT_Appl_IoHwAb, EcucPartitionSoftwareComponentInstanceRef=COMPOSITIONTYPE.SWC_PLT_Appl_PlatformTime, EcucPartitionSoftwareComponentInstanceRef=COMPOSITIONTYPE.SWC_PLT_CDD_WdgHandler, EcucPartitionSoftwareComponentInstanceRef=COMPOSITIONTYPE.BswM, EcucPartitionSoftwareComponentInstanceRef=COMPOSITIONTYPE.EcuM, EcucPartitionSoftwareComponentInstanceRef=COMPOSITIONTYPE.Det, EcucPartitionSoftwareComponentInstanceRef=COMPOSITIONTYPE.NvM, EcucPartitionSoftwareComponentInstanceRef=COMPOSITIONTYPE.WdgM_OsCore0_ASIL
        EcucPartition_SystemApplication_OsCore0: ASIL=QM
        EcucPartition_OsCore0_QM: ASIL=QM, EcucPartitionSoftwareComponentInstanceRef=COMPOSITIONTYPE.SWC_PLT_CDD_Logging, EcucPartitionSoftwareComponentInstanceRef=COMPOSITIONTYPE.SWC_PLT_CDD_HIL
    EcucConfigSet
      EcucPduCollection
        TARGET_ADDRESS_16 (MetaDataType)
          TARGET_ADDRESS_16 (MetaDataItem): index=0, MetaDataItemLength=2, MetaDataItemType=TARGET_ADDRESS_16
        CAN_ID_32 (MetaDataType)
          CAN_ID_32 (MetaDataItem): index=0, MetaDataItemLength=4, MetaDataItemType=CAN_ID_32
