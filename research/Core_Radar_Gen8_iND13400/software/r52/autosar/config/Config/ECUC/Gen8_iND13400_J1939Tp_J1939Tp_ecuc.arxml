AUTOSAR XML (schema 00053)
package /ActiveEcuC
  module config J1939Tp: implementation-config-variant=VARIANT-PRE-COMPILE, module-description=J1939Tp_Impl
    J1939TpConfiguration
      VCAN_RADAR_J1939_3cea4416 (J1939TpTxChannel):
        J1939TpTxChannelUsesMultiPG = false
        J1939TpTxPriority = 6
        J1939TpTxSa = 208
        J1939TpTxUseNonDefaultTpPriority = true
        J1939TpTxCanFdChannel = false
        J1939TpTxChannelComMNetworkHandleRef = CN_VCAN_RADAR_489180b6
        DM1_D0_oVCAN_RADAR_51899be1 (J1939TpTxPg): J1939TpTxDirectPriority=6, J1939TpTxPgDynLength=true, J1939TpTxPgPGN=65226
          DM1_D0_oVCAN_RADAR_ce78d82a_Tx (J1939TpTxNSdu): J1939TpTxNSduId=0, J1939TpTxNSduRef=DM1_D0_oVCAN_RADAR_ce78d82a_Tx
          DirectNPdu_DM1_D0_oVCAN_RADAR_51899be1_VCAN_RADAR_J1939_3cea4416 (J1939TpTxDirectNPdu): J1939TpTxDirectNPduTxConfId=2, J1939TpTxDirectNPduRef=TPCM_DirectTp_oVCAN_RADAR_a235016c_Tx
        J1939TpTxDtNPdu_2210d016 (J1939TpTxDtNPdu): J1939TpTxDtNPduTxConfId=1, J1939TpTxDtNPduRef=TPDT_Tp_oVCAN_RADAR_92966f54_Tx
        J1939TpTxCmNPdu_2210d016 (J1939TpTxCmNPdu): J1939TpTxCmNPduTxConfId=0, J1939TpTxCmNPduRef=TPCM_Tp_oVCAN_RADAR_a235016c_Tx
    J1939TpGeneral:
      J1939TpDevErrorDetect = true
      J1939TpMainFunctionPeriod = 0.01
      J1939TpTxConfTimeout = 1.5
      J1939TpVersionInfoApi = false
      J1939TpSupportBam = true
      J1939TpSupportCmdt = true
      J1939TpSupportEtp = true
      J1939TpSupportFptp = true
      J1939TpRuntimeErrorReport = true
      J1939TpSafeBswChecks = true
      J1939TpSupportFdCmdt = true
      J1939TpSupportFdBam = true
      J1939TpGeneration:
        J1939TpOutOfBoundsWriteProtectionStrategy = NONE
        J1939TpOutOfBoundsWriteSanitizer = false
        J1939TpOutOfBoundsReadSanitizer = false
        J1939TpReduceConstantData2Define = false
        J1939TpBoolDataInArrayOfStructStrategy = BOOLEAN
        J1939TpDeduplicateIndirectedData = false
        J1939TpDataDeduplicationStrategy = NONE
        J1939TpReduceBoolDataByNegationThreshold = 0
        J1939TpReduceBoolDataByNumericalComparisonThreshold = 0
        J1939TpReduceBoolDataByNumericalRelationThreshold = 0
        J1939TpReduceBoolDataByNumericalOperandStrategy = NONE
        J1939TpReduceNumericalDataByOffsetThreshold = 0
        J1939TpReduceNumericalDataByArraySubtractionThreshold = 0
        J1939TpReduceDataByStreaming = false
        J1939TpShortLinkerSymbols = false
        J1939TpInterfacesForDeactivatedData = false
        J1939TpReferringKeysInComments = false
