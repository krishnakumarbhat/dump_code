AUTOSAR XML (schema 00053)
package /ActiveEcuC
  module config MemMap: implementation-config-variant=VARIANT-PRE-COMPILE, module-description=MemMap_Impl
    MemMap_Common (MemMapModule): MemMapGenerateAdditionalMemorySections=true
      113 x MemMapAdditionalMemorySection, all with MemMapMemorySectionFileName=MemMap_Common.h, MemMapMemorySectionPrefix=:
        CODE: MemMapMemorySectionSymbol=CODE, MemMapMemorySectionSwAddrMethodRef=CODE
        CODE_FAST: MemMapMemorySectionSymbol=CODE_FAST, MemMapMemorySectionSwAddrMethodRef=CODE_FAST
        CODE_ISR: MemMapMemorySectionSymbol=CODE_ISR, MemMapMemorySectionSwAddrMethodRef=CODE_ISR
        CONST: MemMapMemorySectionAlignment=UNSPECIFIED, MemMapMemorySectionSymbol=CONST, MemMapMemorySectionSwAddrMethodRef=CONST
        CONST_8BIT: MemMapMemorySectionAlignment=8, MemMapMemorySectionSymbol=CONST_8BIT, MemMapMemorySectionSwAddrMethodRef=CONST
        CONST_16BIT: MemMapMemorySectionAlignment=16, MemMapMemorySectionSymbol=CONST_16BIT, MemMapMemorySectionSwAddrMethodRef=CONST
        CONST_32BIT: MemMapMemorySectionAlignment=32, MemMapMemorySectionSymbol=CONST_32BIT, MemMapMemorySectionSwAddrMethodRef=CONST
        CONST_64BIT: MemMapMemorySectionAlignment=64, MemMapMemorySectionSymbol=CONST_64BIT, MemMapMemorySectionSwAddrMethodRef=CONST
        CONST_8: MemMapMemorySectionAlignment=8, MemMapMemorySectionSymbol=CONST_8, MemMapMemorySectionSwAddrMethodRef=CONST
        CONST_16: MemMapMemorySectionAlignment=16, MemMapMemorySectionSymbol=CONST_16, MemMapMemorySectionSwAddrMethodRef=CONST
        CONST_32: MemMapMemorySectionAlignment=32, MemMapMemorySectionSymbol=CONST_32, MemMapMemorySectionSwAddrMethodRef=CONST
        CONST_64: MemMapMemorySectionAlignment=64, MemMapMemorySectionSymbol=CONST_64, MemMapMemorySectionSwAddrMethodRef=CONST
        CONST_UNSPECIFIED: MemMapMemorySectionAlignment=UNSPECIFIED, MemMapMemorySectionSymbol=CONST_UNSPECIFIED, MemMapMemorySectionSwAddrMethodRef=CONST
        CONST_FAST_8BIT: MemMapMemorySectionAlignment=8, MemMapMemorySectionSymbol=CONST_FAST_8BIT, MemMapMemorySectionSwAddrMethodRef=CONST_FAST
        CONST_FAST_16BIT: MemMapMemorySectionAlignment=16, MemMapMemorySectionSymbol=CONST_FAST_16BIT, MemMapMemorySectionSwAddrMethodRef=CONST_FAST
        CONST_FAST_32BIT: MemMapMemorySectionAlignment=32, MemMapMemorySectionSymbol=CONST_FAST_32BIT, MemMapMemorySectionSwAddrMethodRef=CONST_FAST
        CONST_FAST_64BIT: MemMapMemorySectionAlignment=64, MemMapMemorySectionSymbol=CONST_FAST_64BIT, MemMapMemorySectionSwAddrMethodRef=CONST_FAST
        CONST_FAST_8: MemMapMemorySectionAlignment=8, MemMapMemorySectionSymbol=CONST_FAST_8, MemMapMemorySectionSwAddrMethodRef=CONST_FAST
        CONST_FAST_16: MemMapMemorySectionAlignment=16, MemMapMemorySectionSymbol=CONST_FAST_16, MemMapMemorySectionSwAddrMethodRef=CONST_FAST
        CONST_FAST_32: MemMapMemorySectionAlignment=32, MemMapMemorySectionSymbol=CONST_FAST_32, MemMapMemorySectionSwAddrMethodRef=CONST_FAST
        CONST_FAST_64: MemMapMemorySectionAlignment=64, MemMapMemorySectionSymbol=CONST_FAST_64, MemMapMemorySectionSwAddrMethodRef=CONST_FAST
        CONST_FAST_UNSPECIFIED: MemMapMemorySectionAlignment=UNSPECIFIED, MemMapMemorySectionSymbol=CONST_FAST_UNSPECIFIED, MemMapMemorySectionSwAddrMethodRef=CONST_FAST
        CONST_PBCFG: MemMapMemorySectionSymbol=CONST_PBCFG, MemMapMemorySectionSwAddrMethodRef=CONST_PBCFG
        PBCFG_GLOBALROOT: MemMapMemorySectionSymbol=PBCFG_GLOBALROOT, MemMapMemorySectionSwAddrMethodRef=PBCFG_GLOBALROOT
        VAR: MemMapMemorySectionAlignment=UNSPECIFIED, MemMapMemorySectionSymbol=VAR, MemMapMemorySectionSwAddrMethodRef=VAR_INIT
        VAR_INIT_8BIT: MemMapMemorySectionAlignment=8, MemMapMemorySectionSymbol=VAR_INIT_8BIT, MemMapMemorySectionSwAddrMethodRef=VAR_INIT
        VAR_INIT_16BIT: MemMapMemorySectionAlignment=16, MemMapMemorySectionSymbol=VAR_INIT_16BIT, MemMapMemorySectionSwAddrMethodRef=VAR_INIT
        VAR_INIT_32BIT: MemMapMemorySectionAlignment=32, MemMapMemorySectionSymbol=VAR_INIT_32BIT, MemMapMemorySectionSwAddrMethodRef=VAR_INIT
        VAR_INIT_64BIT: MemMapMemorySectionAlignment=64, MemMapMemorySectionSymbol=VAR_INIT_64BIT, MemMapMemorySectionSwAddrMethodRef=VAR_INIT
        VAR_INIT_8: MemMapMemorySectionAlignment=8, MemMapMemorySectionSymbol=VAR_INIT_8, MemMapMemorySectionSwAddrMethodRef=VAR_INIT
        VAR_INIT_16: MemMapMemorySectionAlignment=16, MemMapMemorySectionSymbol=VAR_INIT_16, MemMapMemorySectionSwAddrMethodRef=VAR_INIT
        VAR_INIT_32: MemMapMemorySectionAlignment=32, MemMapMemorySectionSymbol=VAR_INIT_32, MemMapMemorySectionSwAddrMethodRef=VAR_INIT
        VAR_INIT_64: MemMapMemorySectionAlignment=64, MemMapMemorySectionSymbol=VAR_INIT_64, MemMapMemorySectionSwAddrMethodRef=VAR_INIT
        VAR_INIT_UNSPECIFIED: MemMapMemorySectionAlignment=UNSPECIFIED, MemMapMemorySectionSymbol=VAR_INIT_UNSPECIFIED, MemMapMemorySectionSwAddrMethodRef=VAR_INIT
        VAR_NOINIT_8BIT: MemMapMemorySectionAlignment=8, MemMapMemorySectionSymbol=VAR_NOINIT_8BIT, MemMapMemorySectionSwAddrMethodRef=VAR_NO_INIT
        VAR_NOINIT_16BIT: MemMapMemorySectionAlignment=16, MemMapMemorySectionSymbol=VAR_NOINIT_16BIT, MemMapMemorySectionSwAddrMethodRef=VAR_NO_INIT
        VAR_NOINIT_32BIT: MemMapMemorySectionAlignment=32, MemMapMemorySectionSymbol=VAR_NOINIT_32BIT, MemMapMemorySectionSwAddrMethodRef=VAR_NO_INIT
        VAR_NOINIT_64BIT: MemMapMemorySectionAlignment=64, MemMapMemorySectionSymbol=VAR_NOINIT_64BIT, MemMapMemorySectionSwAddrMethodRef=VAR_NO_INIT
        VAR_NO_INIT_8: MemMapMemorySectionAlignment=8, MemMapMemorySectionSymbol=VAR_NO_INIT_8, MemMapMemorySectionSwAddrMethodRef=VAR_NO_INIT
        VAR_NO_INIT_16: MemMapMemorySectionAlignment=16, MemMapMemorySectionSymbol=VAR_NO_INIT_16, MemMapMemorySectionSwAddrMethodRef=VAR_NO_INIT
        VAR_NO_INIT_32: MemMapMemorySectionAlignment=32, MemMapMemorySectionSymbol=VAR_NO_INIT_32, MemMapMemorySectionSwAddrMethodRef=VAR_NO_INIT
        VAR_NO_INIT_64: MemMapMemorySectionAlignment=64, MemMapMemorySectionSymbol=VAR_NO_INIT_64, MemMapMemorySectionSwAddrMethodRef=VAR_NO_INIT
        VAR_NOINIT_UNSPECIFIED: MemMapMemorySectionAlignment=UNSPECIFIED, MemMapMemorySectionSymbol=VAR_NOINIT_UNSPECIFIED, MemMapMemorySectionSwAddrMethodRef=VAR_NO_INIT
        VAR_NO_INIT_UNSPECIFIED: MemMapMemorySectionAlignment=UNSPECIFIED, MemMapMemorySectionSymbol=VAR_NO_INIT_UNSPECIFIED, MemMapMemorySectionSwAddrMethodRef=VAR_NO_INIT
        VAR_ZERO_INIT_8BIT: MemMapMemorySectionAlignment=8, MemMapMemorySectionSymbol=VAR_ZERO_INIT_8BIT, MemMapMemorySectionSwAddrMethodRef=VAR_CLEARED
        VAR_ZERO_INIT_16BIT: MemMapMemorySectionAlignment=16, MemMapMemorySectionSymbol=VAR_ZERO_INIT_16BIT, MemMapMemorySectionSwAddrMethodRef=VAR_CLEARED
        VAR_ZERO_INIT_32BIT: MemMapMemorySectionAlignment=32, MemMapMemorySectionSymbol=VAR_ZERO_INIT_32BIT, MemMapMemorySectionSwAddrMethodRef=VAR_CLEARED
        VAR_ZERO_INIT_64BIT: MemMapMemorySectionAlignment=64, MemMapMemorySectionSymbol=VAR_ZERO_INIT_64BIT, MemMapMemorySectionSwAddrMethodRef=VAR_CLEARED
        VAR_CLEARED_8: MemMapMemorySectionAlignment=8, MemMapMemorySectionSymbol=VAR_CLEARED_8, MemMapMemorySectionSwAddrMethodRef=VAR_CLEARED
        VAR_CLEARED_16: MemMapMemorySectionAlignment=16, MemMapMemorySectionSymbol=VAR_CLEARED_16, MemMapMemorySectionSwAddrMethodRef=VAR_CLEARED
        VAR_CLEARED_32: MemMapMemorySectionAlignment=32, MemMapMemorySectionSymbol=VAR_CLEARED_32, MemMapMemorySectionSwAddrMethodRef=VAR_CLEARED
        VAR_CLEARED_64: MemMapMemorySectionAlignment=64, MemMapMemorySectionSymbol=VAR_CLEARED_64, MemMapMemorySectionSwAddrMethodRef=VAR_CLEARED
        VAR_CLEARED_UNSPECIFIED: MemMapMemorySectionAlignment=UNSPECIFIED, MemMapMemorySectionSymbol=VAR_CLEARED_UNSPECIFIED, MemMapMemorySectionSwAddrMethodRef=VAR_CLEARED
        VAR_ZERO_INIT_UNSPECIFIED: MemMapMemorySectionAlignment=UNSPECIFIED, MemMapMemorySectionSymbol=VAR_ZERO_INIT_UNSPECIFIED, MemMapMemorySectionSwAddrMethodRef=VAR_CLEARED
        VAR_FAST_INIT_8BIT: MemMapMemorySectionAlignment=8, MemMapMemorySectionSymbol=VAR_FAST_INIT_8BIT, MemMapMemorySectionSwAddrMethodRef=VAR_FAST_INIT
        VAR_FAST_INIT_16BIT: MemMapMemorySectionAlignment=16, MemMapMemorySectionSymbol=VAR_FAST_INIT_16BIT, MemMapMemorySectionSwAddrMethodRef=VAR_FAST_INIT
        VAR_FAST_INIT_32BIT: MemMapMemorySectionAlignment=32, MemMapMemorySectionSymbol=VAR_FAST_INIT_32BIT, MemMapMemorySectionSwAddrMethodRef=VAR_FAST_INIT
        VAR_FAST_INIT_64BIT: MemMapMemorySectionAlignment=64, MemMapMemorySectionSymbol=VAR_FAST_INIT_64BIT, MemMapMemorySectionSwAddrMethodRef=VAR_FAST_INIT
        VAR_FAST_INIT_8: MemMapMemorySectionAlignment=8, MemMapMemorySectionSymbol=VAR_FAST_INIT_8, MemMapMemorySectionSwAddrMethodRef=VAR_FAST_INIT
        VAR_FAST_INIT_16: MemMapMemorySectionAlignment=16, MemMapMemorySectionSymbol=VAR_FAST_INIT_16, MemMapMemorySectionSwAddrMethodRef=VAR_FAST_INIT
        VAR_FAST_INIT_32: MemMapMemorySectionAlignment=32, MemMapMemorySectionSymbol=VAR_FAST_INIT_32, MemMapMemorySectionSwAddrMethodRef=VAR_FAST_INIT
        VAR_FAST_INIT_64: MemMapMemorySectionAlignment=64, MemMapMemorySectionSymbol=VAR_FAST_INIT_64, MemMapMemorySectionSwAddrMethodRef=VAR_FAST_INIT
        VAR_FAST_INIT_UNSPECIFIED: MemMapMemorySectionAlignment=UNSPECIFIED, MemMapMemorySectionSymbol=VAR_FAST_INIT_UNSPECIFIED, MemMapMemorySectionSwAddrMethodRef=VAR_FAST_INIT
        VAR_FAST_NOINIT_8BIT: MemMapMemorySectionAlignment=8, MemMapMemorySectionSymbol=VAR_FAST_NOINIT_8BIT, MemMapMemorySectionSwAddrMethodRef=VAR_FAST_NO_INIT
        VAR_FAST_NOINIT_16BIT: MemMapMemorySectionAlignment=16, MemMapMemorySectionSymbol=VAR_FAST_NOINIT_16BIT, MemMapMemorySectionSwAddrMethodRef=VAR_FAST_NO_INIT
        VAR_FAST_NOINIT_32BIT: MemMapMemorySectionAlignment=32, MemMapMemorySectionSymbol=VAR_FAST_NOINIT_32BIT, MemMapMemorySectionSwAddrMethodRef=VAR_FAST_NO_INIT
        VAR_FAST_NOINIT_64BIT: MemMapMemorySectionAlignment=64, MemMapMemorySectionSymbol=VAR_FAST_NOINIT_64BIT, MemMapMemorySectionSwAddrMethodRef=VAR_FAST_NO_INIT
        VAR_FAST_NO_INIT_8: MemMapMemorySectionAlignment=8, MemMapMemorySectionSymbol=VAR_FAST_NO_INIT_8, MemMapMemorySectionSwAddrMethodRef=VAR_FAST_NO_INIT
        VAR_FAST_NO_INIT_16: MemMapMemorySectionAlignment=16, MemMapMemorySectionSymbol=VAR_FAST_NO_INIT_16, MemMapMemorySectionSwAddrMethodRef=VAR_FAST_NO_INIT
        VAR_FAST_NO_INIT_32: MemMapMemorySectionAlignment=32, MemMapMemorySectionSymbol=VAR_FAST_NO_INIT_32, MemMapMemorySectionSwAddrMethodRef=VAR_FAST_NO_INIT
        VAR_FAST_NO_INIT_64: MemMapMemorySectionAlignment=64, MemMapMemorySectionSymbol=VAR_FAST_NO_INIT_64, MemMapMemorySectionSwAddrMethodRef=VAR_FAST_NO_INIT
        VAR_FAST_NOINIT_UNSPECIFIED: MemMapMemorySectionAlignment=UNSPECIFIED, MemMapMemorySectionSymbol=VAR_FAST_NOINIT_UNSPECIFIED, MemMapMemorySectionSwAddrMethodRef=VAR_FAST_NO_INIT
        VAR_FAST_NO_INIT_UNSPECIFIED: MemMapMemorySectionAlignment=UNSPECIFIED, MemMapMemorySectionSymbol=VAR_FAST_NO_INIT_UNSPECIFIED, MemMapMemorySectionSwAddrMethodRef=VAR_FAST_NO_INIT
        VAR_FAST_ZERO_INIT_8BIT: MemMapMemorySectionAlignment=8, MemMapMemorySectionSymbol=VAR_FAST_ZERO_INIT_8BIT, MemMapMemorySectionSwAddrMethodRef=VAR_FAST_CLEARED
        VAR_FAST_ZERO_INIT_16BIT: MemMapMemorySectionAlignment=16, MemMapMemorySectionSymbol=VAR_FAST_ZERO_INIT_16BIT, MemMapMemorySectionSwAddrMethodRef=VAR_FAST_CLEARED
        VAR_FAST_ZERO_INIT_32BIT: MemMapMemorySectionAlignment=32, MemMapMemorySectionSymbol=VAR_FAST_ZERO_INIT_32BIT, MemMapMemorySectionSwAddrMethodRef=VAR_FAST_CLEARED
        VAR_FAST_ZERO_INIT_64BIT: MemMapMemorySectionAlignment=64, MemMapMemorySectionSymbol=VAR_FAST_ZERO_INIT_64BIT, MemMapMemorySectionSwAddrMethodRef=VAR_FAST_CLEARED
        VAR_FAST_CLEARED_8: MemMapMemorySectionAlignment=8, MemMapMemorySectionSymbol=VAR_FAST_CLEARED_8, MemMapMemorySectionSwAddrMethodRef=VAR_FAST_CLEARED
        VAR_FAST_CLEARED_16: MemMapMemorySectionAlignment=16, MemMapMemorySectionSymbol=VAR_FAST_CLEARED_16, MemMapMemorySectionSwAddrMethodRef=VAR_FAST_CLEARED
        VAR_FAST_CLEARED_32: MemMapMemorySectionAlignment=32, MemMapMemorySectionSymbol=VAR_FAST_CLEARED_32, MemMapMemorySectionSwAddrMethodRef=VAR_FAST_CLEARED
        VAR_FAST_CLEARED_64: MemMapMemorySectionAlignment=64, MemMapMemorySectionSymbol=VAR_FAST_CLEARED_64, MemMapMemorySectionSwAddrMethodRef=VAR_FAST_CLEARED
        VAR_FAST_CLEARED_UNSPECIFIED: MemMapMemorySectionAlignment=UNSPECIFIED, MemMapMemorySectionSymbol=VAR_FAST_CLEARED_UNSPECIFIED, MemMapMemorySectionSwAddrMethodRef=VAR_FAST_CLEARED
        VAR_FAST_ZERO_INIT_UNSPECIFIED: MemMapMemorySectionAlignment=UNSPECIFIED, MemMapMemorySectionSymbol=VAR_FAST_ZERO_INIT_UNSPECIFIED, MemMapMemorySectionSwAddrMethodRef=VAR_FAST_CLEARED
        VAR_NOCACHE_INIT_8BIT: MemMapMemorySectionAlignment=8, MemMapMemorySectionSymbol=VAR_NOCACHE_INIT_8BIT, MemMapMemorySectionSwAddrMethodRef=VAR_NOCACHE_INIT
        VAR_NOCACHE_INIT_16BIT: MemMapMemorySectionAlignment=16, MemMapMemorySectionSymbol=VAR_NOCACHE_INIT_16BIT, MemMapMemorySectionSwAddrMethodRef=VAR_NOCACHE_INIT
        VAR_NOCACHE_INIT_32BIT: MemMapMemorySectionAlignment=32, MemMapMemorySectionSymbol=VAR_NOCACHE_INIT_32BIT, MemMapMemorySectionSwAddrMethodRef=VAR_NOCACHE_INIT
        VAR_NOCACHE_INIT_64BIT: MemMapMemorySectionAlignment=64, MemMapMemorySectionSymbol=VAR_NOCACHE_INIT_64BIT, MemMapMemorySectionSwAddrMethodRef=VAR_NOCACHE_INIT
        VAR_NOCACHE_INIT_8: MemMapMemorySectionAlignment=8, MemMapMemorySectionSymbol=VAR_NOCACHE_INIT_8, MemMapMemorySectionSwAddrMethodRef=VAR_NOCACHE_INIT
        VAR_NOCACHE_INIT_16: MemMapMemorySectionAlignment=16, MemMapMemorySectionSymbol=VAR_NOCACHE_INIT_16, MemMapMemorySectionSwAddrMethodRef=VAR_NOCACHE_INIT
        VAR_NOCACHE_INIT_32: MemMapMemorySectionAlignment=32, MemMapMemorySectionSymbol=VAR_NOCACHE_INIT_32, MemMapMemorySectionSwAddrMethodRef=VAR_NOCACHE_INIT
        VAR_NOCACHE_INIT_64: MemMapMemorySectionAlignment=64, MemMapMemorySectionSymbol=VAR_NOCACHE_INIT_64, MemMapMemorySectionSwAddrMethodRef=VAR_NOCACHE_INIT
        VAR_NOCACHE_INIT_UNSPECIFIED: MemMapMemorySectionAlignment=UNSPECIFIED, MemMapMemorySectionSymbol=VAR_NOCACHE_INIT_UNSPECIFIED, MemMapMemorySectionSwAddrMethodRef=VAR_NOCACHE_INIT
        VAR_NOCACHE_NOINIT_8BIT: MemMapMemorySectionAlignment=8, MemMapMemorySectionSymbol=VAR_NOCACHE_NOINIT_8BIT, MemMapMemorySectionSwAddrMethodRef=VAR_NOCACHE_NO_INIT
        VAR_NOCACHE_NOINIT_16BIT: MemMapMemorySectionAlignment=16, MemMapMemorySectionSymbol=VAR_NOCACHE_NOINIT_16BIT, MemMapMemorySectionSwAddrMethodRef=VAR_NOCACHE_NO_INIT
        VAR_NOCACHE_NOINIT_32BIT: MemMapMemorySectionAlignment=32, MemMapMemorySectionSymbol=VAR_NOCACHE_NOINIT_32BIT, MemMapMemorySectionSwAddrMethodRef=VAR_NOCACHE_NO_INIT
        VAR_NOCACHE_NOINIT_64BIT: MemMapMemorySectionAlignment=64, MemMapMemorySectionSymbol=VAR_NOCACHE_NOINIT_64BIT, MemMapMemorySectionSwAddrMethodRef=VAR_NOCACHE_NO_INIT
        VAR_NOCACHE_NO_INIT_8: MemMapMemorySectionAlignment=8, MemMapMemorySectionSymbol=VAR_NOCACHE_NO_INIT_8, MemMapMemorySectionSwAddrMethodRef=VAR_NOCACHE_NO_INIT
        VAR_NOCACHE_NO_INIT_16: MemMapMemorySectionAlignment=16, MemMapMemorySectionSymbol=VAR_NOCACHE_NO_INIT_16, MemMapMemorySectionSwAddrMethodRef=VAR_NOCACHE_NO_INIT
        VAR_NOCACHE_NO_INIT_32: MemMapMemorySectionAlignment=32, MemMapMemorySectionSymbol=VAR_NOCACHE_NO_INIT_32, MemMapMemorySectionSwAddrMethodRef=VAR_NOCACHE_NO_INIT
        VAR_NOCACHE_NO_INIT_64: MemMapMemorySectionAlignment=64, MemMapMemorySectionSymbol=VAR_NOCACHE_NO_INIT_64, MemMapMemorySectionSwAddrMethodRef=VAR_NOCACHE_NO_INIT
        VAR_NOCACHE_NOINIT_UNSPECIFIED: MemMapMemorySectionAlignment=UNSPECIFIED, MemMapMemorySectionSymbol=VAR_NOCACHE_NOINIT_UNSPECIFIED, MemMapMemorySectionSwAddrMethodRef=VAR_NOCACHE_NO_INIT
        VAR_NOCACHE_NO_INIT_UNSPECIFIED: MemMapMemorySectionAlignment=UNSPECIFIED, MemMapMemorySectionSymbol=VAR_NOCACHE_NO_INIT_UNSPECIFIED, MemMapMemorySectionSwAddrMethodRef=VAR_NOCACHE_NO_INIT
        VAR_NOCACHE_ZERO_INIT_8BIT: MemMapMemorySectionAlignment=8, MemMapMemorySectionSymbol=VAR_NOCACHE_ZERO_INIT_8BIT, MemMapMemorySectionSwAddrMethodRef=VAR_NOCACHE_CLEARED
        VAR_NOCACHE_ZERO_INIT_16BIT: MemMapMemorySectionAlignment=16, MemMapMemorySectionSymbol=VAR_NOCACHE_ZERO_INIT_16BIT, MemMapMemorySectionSwAddrMethodRef=VAR_NOCACHE_CLEARED
        VAR_NOCACHE_ZERO_INIT_32BIT: MemMapMemorySectionAlignment=32, MemMapMemorySectionSymbol=VAR_NOCACHE_ZERO_INIT_32BIT, MemMapMemorySectionSwAddrMethodRef=VAR_NOCACHE_CLEARED
        VAR_NOCACHE_ZERO_INIT_64BIT: MemMapMemorySectionAlignment=64, MemMapMemorySectionSymbol=VAR_NOCACHE_ZERO_INIT_64BIT, MemMapMemorySectionSwAddrMethodRef=VAR_NOCACHE_CLEARED
        VAR_NOCACHE_CLEARED_8: MemMapMemorySectionAlignment=8, MemMapMemorySectionSymbol=VAR_NOCACHE_CLEARED_8, MemMapMemorySectionSwAddrMethodRef=VAR_NOCACHE_CLEARED
        VAR_NOCACHE_CLEARED_16: MemMapMemorySectionAlignment=16, MemMapMemorySectionSymbol=VAR_NOCACHE_CLEARED_16, MemMapMemorySectionSwAddrMethodRef=VAR_NOCACHE_CLEARED
        VAR_NOCACHE_CLEARED_32: MemMapMemorySectionAlignment=32, MemMapMemorySectionSymbol=VAR_NOCACHE_CLEARED_32, MemMapMemorySectionSwAddrMethodRef=VAR_NOCACHE_CLEARED
        VAR_NOCACHE_CLEARED_64: MemMapMemorySectionAlignment=64, MemMapMemorySectionSymbol=VAR_NOCACHE_CLEARED_64, MemMapMemorySectionSwAddrMethodRef=VAR_NOCACHE_CLEARED
        VAR_NOCACHE_CLEARED_UNSPECIFIED: MemMapMemorySectionAlignment=UNSPECIFIED, MemMapMemorySectionSymbol=VAR_NOCACHE_CLEARED_UNSPECIFIED, MemMapMemorySectionSwAddrMethodRef=VAR_NOCACHE_CLEARED
        VAR_NOCACHE_ZERO_INIT_UNSPECIFIED: MemMapMemorySectionAlignment=UNSPECIFIED, MemMapMemorySectionSymbol=VAR_NOCACHE_ZERO_INIT_UNSPECIFIED, MemMapMemorySectionSwAddrMethodRef=VAR_NOCACHE_CLEARED
        VAR_PBCFG: MemMapMemorySectionAlignment=UNSPECIFIED, MemMapMemorySectionSymbol=VAR_PBCFG, MemMapMemorySectionSwAddrMethodRef=VAR_PBCFG
    MSR_Generic (MemMapAllocation)
      8 x MemMapGenericMapping:
        MSR_CODE: MemMapSwAddressMethodRef=CODE, MemMapSwAddressMethodRef=CALLOUT_CODE, MemMapSwAddressMethodRef=CODE_FAST, MemMapSwAddressMethodRef=CODE_ISR, MemMapAddressingModeSetRef=MemMap/MSR_CODE, MemMapSwAddressMethodRef=CALLOUT_CODE_ASIL_D, MemMapSwAddressMethodRef=CODE_ASIL_B, MemMapSwAddressMethodRef=CODE_ASIL_D, MemMapSwAddressMethodRef=CODE_QM
        MSR_CONST: MemMapSwAddressMethodRef=CONST_8, MemMapSwAddressMethodRef=CONST_16, MemMapSwAddressMethodRef=CONST_32, MemMapSwAddressMethodRef=CONST_64, MemMapSwAddressMethodRef=CONST_BOOLEAN, MemMapSwAddressMethodRef=CONST_FAST_8, MemMapSwAddressMethodRef=CONST_FAST_16, MemMapSwAddressMethodRef=CONST_FAST_32, MemMapSwAddressMethodRef=CONST_FAST_64, MemMapSwAddressMethodRef=CONST_FAST_BOOLEAN, MemMapSwAddressMethodRef=CONST_FAST_UNSPECIFIED, MemMapSwAddressMethodRef=CONST_UNSPECIFIED, MemMapAddressingModeSetRef=MemMap/MSR_CONST, MemMapSwAddressMethodRef=CONFIG_DATA, MemMapSwAddressMethodRef=CONST, MemMapSwAddressMethodRef=CONST_FAST, MemMapSwAddressMethodRef=CONST_ASIL_D, MemMapSwAddressMethodRef=CONST_ASIL_C, MemMapSwAddressMethodRef=CONST_ASIL_B, MemMapSwAddressMethodRef=CONST_ASIL_A, MemMapSwAddressMethodRef=CONST_QM, MemMapSwAddressMethodRef=CONFIG_DATA_PREBUILD_QM
        MSR_PBCFG_CONST: MemMapSwAddressMethodRef=CONST_PBCFG, MemMapAddressingModeSetRef=MemMap/MSR_PBCFG_CONST, MemMapSwAddressMethodRef=PBCFG_GLOBALROOT, MemMapSwAddressMethodRef=CONFIG_DATA_POSTBUILD, MemMapSwAddressMethodRef=CONFIG_DATA_PREBUILD_ASIL_D
        MSR_PBCFG_VAR: MemMapSwAddressMethodRef=VAR_PBCFG, MemMapAddressingModeSetRef=MemMap/MSR_PBCFG_VAR
        MSR_VAR_CLEARED: MemMapSwAddressMethodRef=VAR_ZERO_INIT_8, MemMapSwAddressMethodRef=VAR_ZERO_INIT_16, MemMapSwAddressMethodRef=VAR_ZERO_INIT_32, MemMapSwAddressMethodRef=VAR_ZERO_INIT_64, MemMapSwAddressMethodRef=VAR_ZERO_INIT_UNSPECIFIED, MemMapAddressingModeSetRef=MemMap/MSR_VAR_CLEARED, MemMapSwAddressMethodRef=VAR_ZERO_INIT_BOOLEAN, MemMapSwAddressMethodRef=VAR_FAST_ZERO_INIT_8, MemMapSwAddressMethodRef=VAR_FAST_ZERO_INIT_16, MemMapSwAddressMethodRef=VAR_FAST_ZERO_INIT_32, MemMapSwAddressMethodRef=VAR_FAST_ZERO_INIT_64, MemMapSwAddressMethodRef=VAR_FAST_ZERO_INIT_BOOLEAN, MemMapSwAddressMethodRef=VAR_FAST_ZERO_INIT_UNSPECIFIED, MemMapSwAddressMethodRef=VAR_NOCACHE_ZERO_INIT_8, MemMapSwAddressMethodRef=VAR_NOCACHE_ZERO_INIT_16, MemMapSwAddressMethodRef=VAR_NOCACHE_ZERO_INIT_32, MemMapSwAddressMethodRef=VAR_NOCACHE_ZERO_INIT_64, MemMapSwAddressMethodRef=VAR_NOCACHE_ZERO_INIT_BOOLEAN, MemMapSwAddressMethodRef=VAR_NOCACHE_ZERO_INIT_UNSPECIFIED, MemMapSwAddressMethodRef=VAR_CLEARED_BOOLEAN, MemMapSwAddressMethodRef=VAR_CLEARED_8, MemMapSwAddressMethodRef=VAR_CLEARED_16, MemMapSwAddressMethodRef=VAR_CLEARED_32, MemMapSwAddressMethodRef=VAR_CLEARED_64, MemMapSwAddressMethodRef=VAR_CLEARED_UNSPECIFIED, MemMapSwAddressMethodRef=VAR_FAST_CLEARED_BOOLEAN, MemMapSwAddressMethodRef=VAR_FAST_CLEARED_8, MemMapSwAddressMethodRef=VAR_FAST_CLEARED_16, MemMapSwAddressMethodRef=VAR_FAST_CLEARED_32, MemMapSwAddressMethodRef=VAR_FAST_CLEARED_64, MemMapSwAddressMethodRef=VAR_FAST_CLEARED_UNSPECIFIED, MemMapSwAddressMethodRef=VAR_NOCACHE_CLEARED_BOOLEAN, MemMapSwAddressMethodRef=VAR_NOCACHE_CLEARED_8, MemMapSwAddressMethodRef=VAR_NOCACHE_CLEARED_16, MemMapSwAddressMethodRef=VAR_NOCACHE_CLEARED_32, MemMapSwAddressMethodRef=VAR_NOCACHE_CLEARED_64, MemMapSwAddressMethodRef=VAR_NOCACHE_CLEARED_UNSPECIFIED, MemMapSwAddressMethodRef=VAR_CLEARED, MemMapSwAddressMethodRef=VAR_FAST_CLEARED, MemMapSwAddressMethodRef=VAR_NOCACHE_CLEARED, MemMapSwAddressMethodRef=VAR_ZERO_INIT, MemMapSwAddressMethodRef=VAR_CLEARED_ASIL_D, MemMapSwAddressMethodRef=VAR_FAST_CLEARED_ASIL_D, MemMapSwAddressMethodRef=VAR_SLOW_CLEARED_ASIL_D, MemMapSwAddressMethodRef=VAR_FAST_CLEARED_QM, MemMapSwAddressMethodRef=VAR_SLOW_CLEARED_QM
        MSR_VAR_INIT: MemMapSwAddressMethodRef=VAR_INIT_8, MemMapSwAddressMethodRef=VAR_INIT_16, MemMapSwAddressMethodRef=VAR_INIT_32, MemMapSwAddressMethodRef=VAR_INIT_64, MemMapSwAddressMethodRef=VAR_INIT_BOOLEAN, MemMapSwAddressMethodRef=VAR_INIT_UNSPECIFIED, MemMapAddressingModeSetRef=MemMap/MSR_VAR_INIT, MemMapSwAddressMethodRef=VAR_NOCACHE_INIT_8, MemMapSwAddressMethodRef=VAR_NOCACHE_INIT_16, MemMapSwAddressMethodRef=VAR_NOCACHE_INIT_32, MemMapSwAddressMethodRef=VAR_NOCACHE_INIT_64, MemMapSwAddressMethodRef=VAR_NOCACHE_INIT_BOOLEAN, MemMapSwAddressMethodRef=VAR_NOCACHE_INIT_UNSPECIFIED, MemMapSwAddressMethodRef=VAR_INIT, MemMapSwAddressMethodRef=VAR_NOCACHE_INIT, MemMapSwAddressMethodRef=VAR_POWER_ON_CLEARED, MemMapSwAddressMethodRef=VAR_INIT_ASIL_D, MemMapSwAddressMethodRef=VAR_SLOW_INIT_ASIL_D, MemMapSwAddressMethodRef=VAR_FAST_INIT, MemMapSwAddressMethodRef=VAR_FAST_INIT_8, MemMapSwAddressMethodRef=VAR_FAST_INIT_16, MemMapSwAddressMethodRef=VAR_FAST_INIT_32, MemMapSwAddressMethodRef=VAR_FAST_INIT_64, MemMapSwAddressMethodRef=VAR_FAST_INIT_ASIL_A, MemMapSwAddressMethodRef=VAR_FAST_INIT_ASIL_B, MemMapSwAddressMethodRef=VAR_FAST_INIT_ASIL_C, MemMapSwAddressMethodRef=VAR_FAST_INIT_ASIL_D, MemMapSwAddressMethodRef=VAR_FAST_INIT_BOOLEAN, MemMapSwAddressMethodRef=VAR_FAST_INIT_QM, MemMapSwAddressMethodRef=VAR_FAST_INIT_UNSPECIFIED, MemMapSwAddressMethodRef=VAR_INIT_QM, MemMapSwAddressMethodRef=VAR_SLOW_INIT_QM
        MSR_VAR_NO_INIT: MemMapAddressingModeSetRef=MemMap/MSR_VAR_NO_INIT, MemMapSwAddressMethodRef=VAR_FAST_NO_INIT_8, MemMapSwAddressMethodRef=VAR_FAST_NO_INIT_16, MemMapSwAddressMethodRef=VAR_FAST_NO_INIT_32, MemMapSwAddressMethodRef=VAR_FAST_NO_INIT_64, MemMapSwAddressMethodRef=VAR_FAST_NO_INIT_UNSPECIFIED, MemMapSwAddressMethodRef=VAR_NO_INIT_8, MemMapSwAddressMethodRef=VAR_NO_INIT_16, MemMapSwAddressMethodRef=VAR_NO_INIT_32, MemMapSwAddressMethodRef=VAR_NO_INIT_64, MemMapSwAddressMethodRef=VAR_NO_INIT_UNSPECIFIED, MemMapSwAddressMethodRef=VAR_NO_INIT_BOOLEAN, MemMapSwAddressMethodRef=VAR_FAST_NO_INIT_BOOLEAN, MemMapSwAddressMethodRef=VAR_NOCACHE_NO_INIT_8, MemMapSwAddressMethodRef=VAR_NOCACHE_NO_INIT_16, MemMapSwAddressMethodRef=VAR_NOCACHE_NO_INIT_32, MemMapSwAddressMethodRef=VAR_NOCACHE_NO_INIT_64, MemMapSwAddressMethodRef=VAR_NOCACHE_NO_INIT_BOOLEAN, MemMapSwAddressMethodRef=VAR_NOCACHE_NO_INIT_UNSPECIFIED, MemMapSwAddressMethodRef=VAR_FAST_NOINIT_8, MemMapSwAddressMethodRef=VAR_FAST_NOINIT_16, MemMapSwAddressMethodRef=VAR_FAST_NOINIT_32, MemMapSwAddressMethodRef=VAR_FAST_NOINIT_64, MemMapSwAddressMethodRef=VAR_FAST_NOINIT_UNSPECIFIED, MemMapSwAddressMethodRef=VAR_NOINIT_8, MemMapSwAddressMethodRef=VAR_NOINIT_16, MemMapSwAddressMethodRef=VAR_NOINIT_32, MemMapSwAddressMethodRef=VAR_NOINIT_64, MemMapSwAddressMethodRef=VAR_NOINIT_UNSPECIFIED, MemMapSwAddressMethodRef=VAR_NOINIT_BOOLEAN, MemMapSwAddressMethodRef=VAR_FAST_NOINIT_BOOLEAN, MemMapSwAddressMethodRef=VAR_NOCACHE_NOINIT_8, MemMapSwAddressMethodRef=VAR_NOCACHE_NOINIT_16, MemMapSwAddressMethodRef=VAR_NOCACHE_NOINIT_32, MemMapSwAddressMethodRef=VAR_NOCACHE_NOINIT_64, MemMapSwAddressMethodRef=VAR_NOCACHE_NOINIT_BOOLEAN, MemMapSwAddressMethodRef=VAR_NOCACHE_NOINIT_UNSPECIFIED, MemMapSwAddressMethodRef=VAR_NO_INIT, MemMapSwAddressMethodRef=VAR_FAST_NO_INIT, MemMapSwAddressMethodRef=VAR_NOCACHE_NO_INIT, MemMapSwAddressMethodRef=INTERNAL_VAR_CLEARED_QM, MemMapSwAddressMethodRef=VAR_CLEARED_ASIL_A, MemMapSwAddressMethodRef=VAR_CLEARED_ASIL_B, MemMapSwAddressMethodRef=VAR_CLEARED_ASIL_C, MemMapSwAddressMethodRef=VAR_CLEARED_QM
        MSR_VAR_SAVED_ZONE: MemMapAddressingModeSetRef=MemMap/MSR_VAR_SAVED_ZONE, MemMapSwAddressMethodRef=VAR_SAVED_ZONE_BOOLEAN, MemMapSwAddressMethodRef=VAR_SAVED_ZONE_8, MemMapSwAddressMethodRef=VAR_SAVED_ZONE_16, MemMapSwAddressMethodRef=VAR_SAVED_ZONE_32, MemMapSwAddressMethodRef=VAR_SAVED_ZONE_64, MemMapSwAddressMethodRef=VAR_SAVED_ZONE_UNSPECIFIED, MemMapSwAddressMethodRef=VAR_SAVED_ZONE, MemMapSwAddressMethodRef=VAR_SAVED_ZONE_QM, MemMapSwAddressMethodRef=VAR_SAVED_ZONE_ASIL_D
    8 x MemMapAddressingModeSet, all with MemMapCompilerMemClassSymbolImpl=:
      MSR_CODE
        MSR_CODE (MemMapAddressingMode):
          MemMapAlignmentSelector = UNSPECIFIED
          MemMapAlignmentSelector = 8
          MemMapAlignmentSelector = 16
          MemMapAlignmentSelector = 32
          MemMapAlignmentSelector = 64
          MemMapAlignmentSelector = BOOLEAN
      MSR_CONST
        MSR_CONST (MemMapAddressingMode):
          MemMapAlignmentSelector = UNSPECIFIED
          MemMapAlignmentSelector = 8
          MemMapAlignmentSelector = 16
          MemMapAlignmentSelector = 32
          MemMapAlignmentSelector = 64
          MemMapAlignmentSelector = BOOLEAN
          MemMapAlignmentSelector = PTR
      MSR_PBCFG_CONST
        MSR_PBCFG_CONST (MemMapAddressingMode):
          MemMapAlignmentSelector = UNSPECIFIED
          MemMapAlignmentSelector = 8
          MemMapAlignmentSelector = 16
          MemMapAlignmentSelector = 32
          MemMapAlignmentSelector = 64
          MemMapAlignmentSelector = BOOLEAN
          MemMapAlignmentSelector = PTR
      MSR_PBCFG_VAR
        MSR_PBCFG_VAR (MemMapAddressingMode):
          MemMapAlignmentSelector = UNSPECIFIED
          MemMapAlignmentSelector = 8
          MemMapAlignmentSelector = 16
          MemMapAlignmentSelector = 32
          MemMapAlignmentSelector = 64
          MemMapAlignmentSelector = BOOLEAN
      MSR_VAR_CLEARED
        MSR_VAR_CLEARED (MemMapAddressingMode):
          MemMapAlignmentSelector = UNSPECIFIED
          MemMapAlignmentSelector = 8
          MemMapAlignmentSelector = 16
          MemMapAlignmentSelector = 32
          MemMapAlignmentSelector = 64
          MemMapAlignmentSelector = BOOLEAN
          MemMapAlignmentSelector = PTR
      MSR_VAR_INIT
        MSR_VAR_INIT (MemMapAddressingMode):
          MemMapAlignmentSelector = UNSPECIFIED
          MemMapAlignmentSelector = 8
          MemMapAlignmentSelector = 16
          MemMapAlignmentSelector = 32
          MemMapAlignmentSelector = 64
          MemMapAlignmentSelector = BOOLEAN
          MemMapAlignmentSelector = PTR
      MSR_VAR_NO_INIT
        MSR_VAR_NO_INIT (MemMapAddressingMode):
          MemMapAlignmentSelector = UNSPECIFIED
          MemMapAlignmentSelector = 8
          MemMapAlignmentSelector = 16
          MemMapAlignmentSelector = 32
          MemMapAlignmentSelector = 64
          MemMapAlignmentSelector = BOOLEAN
          MemMapAlignmentSelector = PTR
          MemMapAlignmentSelector = 128
      MSR_VAR_SAVED_ZONE
        MSR_VAR_SAVED_ZONE (MemMapAddressingMode):
          MemMapAlignmentSelector = UNSPECIFIED
          MemMapAlignmentSelector = 8
          MemMapAlignmentSelector = 16
          MemMapAlignmentSelector = 32
          MemMapAlignmentSelector = 64
          MemMapAlignmentSelector = BOOLEAN
          MemMapAlignmentSelector = PTR
    MemMapGeneral:
      MemMapTypedPragmas = false
      MemMapGeneratePragmasForNearAddressing = false
      MemMapGeneration = FULL
      MemMapCompatibilityGeneration = FULL
      MemMapGeneratePragmas = true
      MemMapErrorChecks = ALL
    4 x MemMapAddressingModeSet, all with MemMapCompilerMemClassSymbolImpl=:
      OS_GLOBALSHARED_VAR_INIT
        OS_GLOBALSHARED_VAR_INIT (MemMapAddressingMode):
          MemMapAlignmentSelector = BOOLEAN
          MemMapAlignmentSelector = 8
          MemMapAlignmentSelector = 16
          MemMapAlignmentSelector = 32
          MemMapAlignmentSelector = 64
          MemMapAlignmentSelector = UNSPECIFIED
          MemMapLinkerLogicalGroupRef = OS_GLOBALSHARED_VAR
      OS_GLOBALSHARED_VAR_NOINIT
        OS_GLOBALSHARED_VAR_NOINIT (MemMapAddressingMode):
          MemMapAlignmentSelector = BOOLEAN
          MemMapAlignmentSelector = 8
          MemMapAlignmentSelector = 16
          MemMapAlignmentSelector = 32
          MemMapAlignmentSelector = 64
          MemMapAlignmentSelector = UNSPECIFIED
      OS_GLOBALSHARED_VAR_ZERO_INIT
        OS_GLOBALSHARED_VAR_ZERO_INIT (MemMapAddressingMode):
          MemMapAlignmentSelector = BOOLEAN
          MemMapAlignmentSelector = 8
          MemMapAlignmentSelector = 16
          MemMapAlignmentSelector = 32
          MemMapAlignmentSelector = 64
          MemMapAlignmentSelector = UNSPECIFIED
      OS_GLOBALSHARED_VAR_SAVED_ZONE
        OS_GLOBALSHARED_VAR_SAVED_ZONE (MemMapAddressingMode):
          MemMapAlignmentSelector = BOOLEAN
          MemMapAlignmentSelector = 8
          MemMapAlignmentSelector = 16
          MemMapAlignmentSelector = 32
          MemMapAlignmentSelector = 64
          MemMapAlignmentSelector = UNSPECIFIED
          MemMapLinkerLogicalGroupRef = OS_GLOBALSHARED_VAR_SAVED_ZONE
    OS_Generic (MemMapAllocation)
      59 x MemMapGenericMapping:
        OS_GLOBALSHARED_VAR_INIT: MemMapAddressingModeSetRef=MemMap/OS_GLOBALSHARED_VAR_INIT, MemMapSwAddressMethodRef=GLOBALSHARED_VAR_INIT, MemMapSwAddressMethodRef=GLOBALSHARED_VAR_FAST_INIT, MemMapSwAddressMethodRef=GLOBALSHARED_VAR_NOCACHE_INIT, MemMapSwAddressMethodRef=GLOBALSHARED_VAR_SLOW_INIT
        OS_GLOBALSHARED_VAR_NOINIT: MemMapAddressingModeSetRef=MemMap/OS_GLOBALSHARED_VAR_NOINIT, MemMapSwAddressMethodRef=GLOBALSHARED_VAR_NO_INIT, MemMapSwAddressMethodRef=GLOBALSHARED_VAR_FAST_NO_INIT, MemMapSwAddressMethodRef=GLOBALSHARED_VAR_NOCACHE_NO_INIT
        OS_GLOBALSHARED_VAR_ZERO_INIT: MemMapAddressingModeSetRef=MemMap/OS_GLOBALSHARED_VAR_ZERO_INIT, MemMapSwAddressMethodRef=GLOBALSHARED_VAR_CLEARED, MemMapSwAddressMethodRef=GLOBALSHARED_VAR_FAST_CLEARED, MemMapSwAddressMethodRef=GLOBALSHARED_VAR_NOCACHE_CLEARED
        OS_GLOBALSHARED_VAR_SAVED_ZONE: MemMapAddressingModeSetRef=MemMap/OS_GLOBALSHARED_VAR_SAVED_ZONE, MemMapSwAddressMethodRef=GLOBALSHARED_VAR_SAVED_ZONE
        OS_GLOBALSHARED_CONST: MemMapAddressingModeSetRef=MemMap/MSR_CONST, MemMapSwAddressMethodRef=GLOBALSHARED_CONST, MemMapSwAddressMethodRef=GLOBALSHARED_CONST_FAST, MemMapSwAddressMethodRef=GLOBALSHARED_CONFIG_DATA_PREBUILD, MemMapSwAddressMethodRef=GLOBALSHARED_CONFIG_DATA_POSTBUILD
        OS_SystemApplication_OsCore0_VAR_INIT: MemMapAddressingModeSetRef=MemMap/OS_SystemApplication_OsCore0_VAR_INIT, MemMapSwAddressMethodRef=SystemApplication_OsCore0_VAR_INIT, MemMapSwAddressMethodRef=SystemApplication_OsCore0_VAR_FAST_INIT, MemMapSwAddressMethodRef=SystemApplication_OsCore0_VAR_NOCACHE_INIT, MemMapSwAddressMethodRef=SystemApplication_OsCore0_VAR_SLOW_INIT
        OS_SystemApplication_OsCore0_VAR_NOINIT: MemMapAddressingModeSetRef=MemMap/OS_SystemApplication_OsCore0_VAR_NOINIT, MemMapSwAddressMethodRef=SystemApplication_OsCore0_VAR_NO_INIT, MemMapSwAddressMethodRef=SystemApplication_OsCore0_VAR_FAST_NO_INIT, MemMapSwAddressMethodRef=SystemApplication_OsCore0_VAR_NOCACHE_NO_INIT
        OS_SystemApplication_OsCore0_VAR_ZERO_INIT: MemMapAddressingModeSetRef=MemMap/OS_SystemApplication_OsCore0_VAR_ZERO_INIT, MemMapSwAddressMethodRef=SystemApplication_OsCore0_VAR_CLEARED, MemMapSwAddressMethodRef=SystemApplication_OsCore0_VAR_FAST_CLEARED, MemMapSwAddressMethodRef=SystemApplication_OsCore0_VAR_NOCACHE_CLEARED
        OS_SystemApplication_OsCore0_VAR_SAVED_ZONE: MemMapAddressingModeSetRef=MemMap/OS_SystemApplication_OsCore0_VAR_SAVED_ZONE, MemMapSwAddressMethodRef=SystemApplication_OsCore0_VAR_SAVED_ZONE
        OS_SystemApplication_OsCore0_CONST: MemMapAddressingModeSetRef=MemMap/MSR_CONST, MemMapSwAddressMethodRef=SystemApplication_OsCore0_CONST, MemMapSwAddressMethodRef=SystemApplication_OsCore0_CONST_FAST, MemMapSwAddressMethodRef=SystemApplication_OsCore0_CONFIG_DATA_PREBUILD, MemMapSwAddressMethodRef=SystemApplication_OsCore0_CONFIG_DATA_POSTBUILD
        OS_OsCore0_ASIL_VAR_INIT: MemMapAddressingModeSetRef=MemMap/OS_OsCore0_ASIL_VAR_INIT, MemMapSwAddressMethodRef=OsCore0_ASIL_VAR_INIT, MemMapSwAddressMethodRef=OsCore0_ASIL_VAR_FAST_INIT, MemMapSwAddressMethodRef=OsCore0_ASIL_VAR_NOCACHE_INIT, MemMapSwAddressMethodRef=OsCore0_ASIL_VAR_SLOW_INIT
        OS_OsCore0_ASIL_VAR_NOINIT: MemMapAddressingModeSetRef=MemMap/OS_OsCore0_ASIL_VAR_NOINIT, MemMapSwAddressMethodRef=OsCore0_ASIL_VAR_NO_INIT, MemMapSwAddressMethodRef=OsCore0_ASIL_VAR_FAST_NO_INIT, MemMapSwAddressMethodRef=OsCore0_ASIL_VAR_NOCACHE_NO_INIT
        OS_OsCore0_ASIL_VAR_ZERO_INIT: MemMapAddressingModeSetRef=MemMap/OS_OsCore0_ASIL_VAR_ZERO_INIT, MemMapSwAddressMethodRef=OsCore0_ASIL_VAR_CLEARED, MemMapSwAddressMethodRef=OsCore0_ASIL_VAR_FAST_CLEARED, MemMapSwAddressMethodRef=OsCore0_ASIL_VAR_NOCACHE_CLEARED
        OS_OsCore0_ASIL_VAR_SAVED_ZONE: MemMapAddressingModeSetRef=MemMap/OS_OsCore0_ASIL_VAR_SAVED_ZONE, MemMapSwAddressMethodRef=OsCore0_ASIL_VAR_SAVED_ZONE
        OS_OsCore0_ASIL_CONST: MemMapAddressingModeSetRef=MemMap/MSR_CONST, MemMapSwAddressMethodRef=OsCore0_ASIL_CONST, MemMapSwAddressMethodRef=OsCore0_ASIL_CONST_FAST, MemMapSwAddressMethodRef=OsCore0_ASIL_CONFIG_DATA_PREBUILD, MemMapSwAddressMethodRef=OsCore0_ASIL_CONFIG_DATA_POSTBUILD
        OS_OsCore_Qm_VAR_INIT: MemMapAddressingModeSetRef=MemMap/OS_OsCore_Qm_VAR_INIT, MemMapSwAddressMethodRef=OsCore_Qm_VAR_INIT, MemMapSwAddressMethodRef=OsCore_Qm_VAR_FAST_INIT, MemMapSwAddressMethodRef=OsCore_Qm_VAR_NOCACHE_INIT, MemMapSwAddressMethodRef=OsCore_Qm_VAR_SLOW_INIT
        OS_OsCore_Qm_VAR_NOINIT: MemMapAddressingModeSetRef=MemMap/OS_OsCore_Qm_VAR_NOINIT, MemMapSwAddressMethodRef=OsCore_Qm_VAR_NO_INIT, MemMapSwAddressMethodRef=OsCore_Qm_VAR_FAST_NO_INIT, MemMapSwAddressMethodRef=OsCore_Qm_VAR_NOCACHE_NO_INIT
        OS_OsCore_Qm_VAR_ZERO_INIT: MemMapAddressingModeSetRef=MemMap/OS_OsCore_Qm_VAR_ZERO_INIT, MemMapSwAddressMethodRef=OsCore_Qm_VAR_CLEARED, MemMapSwAddressMethodRef=OsCore_Qm_VAR_FAST_CLEARED, MemMapSwAddressMethodRef=OsCore_Qm_VAR_NOCACHE_CLEARED
        OS_OsCore_Qm_VAR_SAVED_ZONE: MemMapAddressingModeSetRef=MemMap/OS_OsCore_Qm_VAR_SAVED_ZONE, MemMapSwAddressMethodRef=OsCore_Qm_VAR_SAVED_ZONE
        OS_OsCore_Qm_CONST: MemMapAddressingModeSetRef=MemMap/MSR_CONST, MemMapSwAddressMethodRef=OsCore_Qm_CONST, MemMapSwAddressMethodRef=OsCore_Qm_CONST_FAST, MemMapSwAddressMethodRef=OsCore_Qm_CONFIG_DATA_PREBUILD, MemMapSwAddressMethodRef=OsCore_Qm_CONFIG_DATA_POSTBUILD
        OS_OsCore0_ASIL_VAR_CLEARED: MemMapAddressingModeSetRef=MemMap/OS_OsCore0_ASIL_VAR_CLEARED, MemMapSwAddressMethodRef=OsCore0_ASIL_VAR_SLOW_CLEARED, MemMapSwAddressMethodRef=OsCore0_ASIL_VAR_SLOW_NO_INIT, MemMapSwAddressMethodRef=OsCore0_ASIL_VAR_NOINIT, MemMapSwAddressMethodRef=OsCore0_ASIL_VAR_FAST_NOINIT, MemMapSwAddressMethodRef=OsCore0_ASIL_VAR_NOCACHE_NOINIT, MemMapSwAddressMethodRef=OsCore0_ASIL_VAR_SLOW_NOINIT
        OS_OsCore0_ASIL_VAR_POWER_ON_INIT: MemMapAddressingModeSetRef=MemMap/OS_OsCore0_ASIL_VAR_POWER_ON_INIT, MemMapSwAddressMethodRef=OsCore0_ASIL_VAR_POWER_ON_INIT, MemMapSwAddressMethodRef=OsCore0_ASIL_VAR_FAST_POWER_ON_INIT, MemMapSwAddressMethodRef=OsCore0_ASIL_VAR_NOCACHE_POWER_ON_INIT, MemMapSwAddressMethodRef=OsCore0_ASIL_VAR_SLOW_POWER_ON_INIT
        OS_OsCore0_ASIL_VAR_POWER_ON_CLEARED: MemMapAddressingModeSetRef=MemMap/OS_OsCore0_ASIL_VAR_POWER_ON_CLEARED, MemMapSwAddressMethodRef=OsCore0_ASIL_VAR_POWER_ON_CLEARED, MemMapSwAddressMethodRef=OsCore0_ASIL_VAR_FAST_POWER_ON_CLEARED, MemMapSwAddressMethodRef=OsCore0_ASIL_VAR_NOCACHE_POWER_ON_CLEARED, MemMapSwAddressMethodRef=OsCore0_ASIL_VAR_SLOW_POWER_ON_CLEARED
        OS_OsCore_Qm_VAR_CLEARED: MemMapAddressingModeSetRef=MemMap/OS_OsCore_Qm_VAR_CLEARED, MemMapSwAddressMethodRef=OsCore_Qm_VAR_SLOW_CLEARED, MemMapSwAddressMethodRef=OsCore_Qm_VAR_SLOW_NO_INIT, MemMapSwAddressMethodRef=OsCore_Qm_VAR_NOINIT, MemMapSwAddressMethodRef=OsCore_Qm_VAR_FAST_NOINIT, MemMapSwAddressMethodRef=OsCore_Qm_VAR_NOCACHE_NOINIT, MemMapSwAddressMethodRef=OsCore_Qm_VAR_SLOW_NOINIT
        OS_OsCore_Qm_VAR_POWER_ON_INIT: MemMapAddressingModeSetRef=MemMap/OS_OsCore_Qm_VAR_POWER_ON_INIT, MemMapSwAddressMethodRef=OsCore_Qm_VAR_POWER_ON_INIT, MemMapSwAddressMethodRef=OsCore_Qm_VAR_FAST_POWER_ON_INIT, MemMapSwAddressMethodRef=OsCore_Qm_VAR_NOCACHE_POWER_ON_INIT, MemMapSwAddressMethodRef=OsCore_Qm_VAR_SLOW_POWER_ON_INIT
        OS_OsCore_Qm_VAR_POWER_ON_CLEARED: MemMapAddressingModeSetRef=MemMap/OS_OsCore_Qm_VAR_POWER_ON_CLEARED, MemMapSwAddressMethodRef=OsCore_Qm_VAR_POWER_ON_CLEARED, MemMapSwAddressMethodRef=OsCore_Qm_VAR_FAST_POWER_ON_CLEARED, MemMapSwAddressMethodRef=OsCore_Qm_VAR_NOCACHE_POWER_ON_CLEARED, MemMapSwAddressMethodRef=OsCore_Qm_VAR_SLOW_POWER_ON_CLEARED
        OS_SystemApplication_OsCore0_VAR_CLEARED: MemMapAddressingModeSetRef=MemMap/OS_SystemApplication_OsCore0_VAR_CLEARED, MemMapSwAddressMethodRef=SystemApplication_OsCore0_VAR_SLOW_CLEARED, MemMapSwAddressMethodRef=SystemApplication_OsCore0_VAR_SLOW_NO_INIT, MemMapSwAddressMethodRef=SystemApplication_OsCore0_VAR_NOINIT, MemMapSwAddressMethodRef=SystemApplication_OsCore0_VAR_FAST_NOINIT, MemMapSwAddressMethodRef=SystemApplication_OsCore0_VAR_NOCACHE_NOINIT, MemMapSwAddressMethodRef=SystemApplication_OsCore0_VAR_SLOW_NOINIT
        OS_SystemApplication_OsCore0_VAR_POWER_ON_INIT: MemMapAddressingModeSetRef=MemMap/OS_SystemApplication_OsCore0_VAR_POWER_ON_INIT, MemMapSwAddressMethodRef=SystemApplication_OsCore0_VAR_POWER_ON_INIT, MemMapSwAddressMethodRef=SystemApplication_OsCore0_VAR_FAST_POWER_ON_INIT, MemMapSwAddressMethodRef=SystemApplication_OsCore0_VAR_NOCACHE_POWER_ON_INIT, MemMapSwAddressMethodRef=SystemApplication_OsCore0_VAR_SLOW_POWER_ON_INIT
        OS_SystemApplication_OsCore0_VAR_POWER_ON_CLEARED: MemMapAddressingModeSetRef=MemMap/OS_SystemApplication_OsCore0_VAR_POWER_ON_CLEARED, MemMapSwAddressMethodRef=SystemApplication_OsCore0_VAR_POWER_ON_CLEARED, MemMapSwAddressMethodRef=SystemApplication_OsCore0_VAR_FAST_POWER_ON_CLEARED, MemMapSwAddressMethodRef=SystemApplication_OsCore0_VAR_NOCACHE_POWER_ON_CLEARED, MemMapSwAddressMethodRef=SystemApplication_OsCore0_VAR_SLOW_POWER_ON_CLEARED
        OS_INTVEC_OsCore0_CODE: MemMapAddressingModeSetRef=MemMap/OS_INTVEC_OsCore0_CODE, MemMapSwAddressMethodRef=INTVEC_OsCore0_CODE
        OS_INTVEC_OsCore0_CONST: MemMapAddressingModeSetRef=MemMap/OS_INTVEC_OsCore0_CONST, MemMapSwAddressMethodRef=INTVEC_OsCore0_CONST
        OS_EXCVEC_OsCore0_CODE: MemMapAddressingModeSetRef=MemMap/OS_EXCVEC_OsCore0_CODE, MemMapSwAddressMethodRef=EXCVEC_OsCore0_CODE
        OS_EXCVEC_OsCore0_CONST: MemMapAddressingModeSetRef=MemMap/OS_EXCVEC_OsCore0_CONST, MemMapSwAddressMethodRef=EXCVEC_OsCore0_CONST
        OS_GLOBALSHARED_VAR_CLEARED: MemMapAddressingModeSetRef=MemMap/OS_GLOBALSHARED_VAR_CLEARED, MemMapSwAddressMethodRef=GLOBALSHARED_VAR_SLOW_CLEARED, MemMapSwAddressMethodRef=GLOBALSHARED_VAR_SLOW_NO_INIT, MemMapSwAddressMethodRef=GLOBALSHARED_VAR_NOINIT, MemMapSwAddressMethodRef=GLOBALSHARED_VAR_FAST_NOINIT, MemMapSwAddressMethodRef=GLOBALSHARED_VAR_NOCACHE_NOINIT, MemMapSwAddressMethodRef=GLOBALSHARED_VAR_SLOW_NOINIT
        OS_GLOBALSHARED_VAR_POWER_ON_INIT: MemMapAddressingModeSetRef=MemMap/OS_GLOBALSHARED_VAR_POWER_ON_INIT, MemMapSwAddressMethodRef=GLOBALSHARED_VAR_POWER_ON_INIT, MemMapSwAddressMethodRef=GLOBALSHARED_VAR_FAST_POWER_ON_INIT, MemMapSwAddressMethodRef=GLOBALSHARED_VAR_NOCACHE_POWER_ON_INIT, MemMapSwAddressMethodRef=GLOBALSHARED_VAR_SLOW_POWER_ON_INIT
        OS_GLOBALSHARED_VAR_POWER_ON_CLEARED: MemMapAddressingModeSetRef=MemMap/OS_GLOBALSHARED_VAR_POWER_ON_CLEARED, MemMapSwAddressMethodRef=GLOBALSHARED_VAR_POWER_ON_CLEARED, MemMapSwAddressMethodRef=GLOBALSHARED_VAR_FAST_POWER_ON_CLEARED, MemMapSwAddressMethodRef=GLOBALSHARED_VAR_NOCACHE_POWER_ON_CLEARED, MemMapSwAddressMethodRef=GLOBALSHARED_VAR_SLOW_POWER_ON_CLEARED
        OS_CODE: MemMapAddressingModeSetRef=MemMap/OS_CODE, MemMapSwAddressMethodRef=OS_CODE
        OS_INTVEC_CODE: MemMapAddressingModeSetRef=MemMap/OS_INTVEC_CODE, MemMapSwAddressMethodRef=INTVEC_CODE
        OS_INTVEC_CONST: MemMapAddressingModeSetRef=MemMap/OS_INTVEC_CONST, MemMapSwAddressMethodRef=INTVEC_CONST
        OS_STACK_Appl_Task_VAR_CLEARED: MemMapAddressingModeSetRef=MemMap/OS_STACK_Appl_Task_VAR_CLEARED, MemMapSwAddressMethodRef=STACK_Appl_Task_VAR_CLEARED
        OS_STACK_Appl_Task_Communication_VAR_CLEARED: MemMapAddressingModeSetRef=MemMap/OS_STACK_Appl_Task_Communication_VAR_CLEARED, MemMapSwAddressMethodRef=STACK_Appl_Task_Communication_VAR_CLEARED
        OS_STACK_Appl_Task_Fast_VAR_CLEARED: MemMapAddressingModeSetRef=MemMap/OS_STACK_Appl_Task_Fast_VAR_CLEARED, MemMapSwAddressMethodRef=STACK_Appl_Task_Fast_VAR_CLEARED
        OS_STACK_Appl_Task_High_Prio_VAR_CLEARED: MemMapAddressingModeSetRef=MemMap/OS_STACK_Appl_Task_High_Prio_VAR_CLEARED, MemMapSwAddressMethodRef=STACK_Appl_Task_High_Prio_VAR_CLEARED
        OS_STACK_Appl_Task_Logging_VAR_CLEARED: MemMapAddressingModeSetRef=MemMap/OS_STACK_Appl_Task_Logging_VAR_CLEARED, MemMapSwAddressMethodRef=STACK_Appl_Task_Logging_VAR_CLEARED
        OS_STACK_BSW_Task_VAR_CLEARED: MemMapAddressingModeSetRef=MemMap/OS_STACK_BSW_Task_VAR_CLEARED, MemMapSwAddressMethodRef=STACK_BSW_Task_VAR_CLEARED
        OS_STACK_OsCore0_Error_VAR_CLEARED: MemMapAddressingModeSetRef=MemMap/OS_STACK_OsCore0_Error_VAR_CLEARED, MemMapSwAddressMethodRef=STACK_OsCore0_Error_VAR_CLEARED
        OS_STACK_OsCore0_Init_VAR_CLEARED: MemMapAddressingModeSetRef=MemMap/OS_STACK_OsCore0_Init_VAR_CLEARED, MemMapSwAddressMethodRef=STACK_OsCore0_Init_VAR_CLEARED
        OS_STACK_OsCore0_Isr_Core_VAR_CLEARED: MemMapAddressingModeSetRef=MemMap/OS_STACK_OsCore0_Isr_Core_VAR_CLEARED, MemMapSwAddressMethodRef=STACK_OsCore0_Isr_Core_VAR_CLEARED
        OS_STACK_OsCore0_Kernel_VAR_CLEARED: MemMapAddressingModeSetRef=MemMap/OS_STACK_OsCore0_Kernel_VAR_CLEARED, MemMapSwAddressMethodRef=STACK_OsCore0_Kernel_VAR_CLEARED
        OS_STACK_OsCore0_Shutdown_VAR_CLEARED: MemMapAddressingModeSetRef=MemMap/OS_STACK_OsCore0_Shutdown_VAR_CLEARED, MemMapSwAddressMethodRef=STACK_OsCore0_Shutdown_VAR_CLEARED
        OS_STACK_OsCore0_Startup_VAR_CLEARED: MemMapAddressingModeSetRef=MemMap/OS_STACK_OsCore0_Startup_VAR_CLEARED, MemMapSwAddressMethodRef=STACK_OsCore0_Startup_VAR_CLEARED
        OS_STACK_OsCore0_Task_Prio190_VAR_CLEARED: MemMapAddressingModeSetRef=MemMap/OS_STACK_OsCore0_Task_Prio190_VAR_CLEARED, MemMapSwAddressMethodRef=STACK_OsCore0_Task_Prio190_VAR_CLEARED
        OS_STACK_OsCore0_Task_Prio200_VAR_CLEARED: MemMapAddressingModeSetRef=MemMap/OS_STACK_OsCore0_Task_Prio200_VAR_CLEARED, MemMapSwAddressMethodRef=STACK_OsCore0_Task_Prio200_VAR_CLEARED
        OS_STACK_OsCore0_Task_Prio210_VAR_CLEARED: MemMapAddressingModeSetRef=MemMap/OS_STACK_OsCore0_Task_Prio210_VAR_CLEARED, MemMapSwAddressMethodRef=STACK_OsCore0_Task_Prio210_VAR_CLEARED
        OS_STACK_OsCore0_Task_Prio4294967295_VAR_CLEARED: MemMapAddressingModeSetRef=MemMap/OS_STACK_OsCore0_Task_Prio4294967295_VAR_CLEARED, MemMapSwAddressMethodRef=STACK_OsCore0_Task_Prio4294967295_VAR_CLEARED
        OS_STACK_Radar_Ctrl_Task_VAR_CLEARED: MemMapAddressingModeSetRef=MemMap/OS_STACK_Radar_Ctrl_Task_VAR_CLEARED, MemMapSwAddressMethodRef=STACK_Radar_Ctrl_Task_VAR_CLEARED
        OS_STACK_Appl_IPC_Task_VAR_CLEARED: MemMapAddressingModeSetRef=MemMap/OS_STACK_Appl_IPC_Task_VAR_CLEARED, MemMapSwAddressMethodRef=STACK_Appl_IPC_Task_VAR_CLEARED
        OS_STACK_OsCore0_Protection_VAR_CLEARED: MemMapAddressingModeSetRef=MemMap/OS_STACK_OsCore0_Protection_VAR_CLEARED, MemMapSwAddressMethodRef=STACK_OsCore0_Protection_VAR_CLEARED
        OS_STACK_Appl_BackgroundTask_VAR_CLEARED: MemMapAddressingModeSetRef=MemMap/OS_STACK_Appl_BackgroundTask_VAR_CLEARED, MemMapSwAddressMethodRef=STACK_Appl_BackgroundTask_VAR_CLEARED
    5 x MemMapAddressingModeSet, all with MemMapCompilerMemClassSymbolImpl=:
      OS_SystemApplication_OsCore0_VAR_INIT
        OS_SystemApplication_OsCore0_VAR_INIT (MemMapAddressingMode):
          MemMapAlignmentSelector = BOOLEAN
          MemMapAlignmentSelector = 8
          MemMapAlignmentSelector = 16
          MemMapAlignmentSelector = 32
          MemMapAlignmentSelector = 64
          MemMapAlignmentSelector = UNSPECIFIED
          MemMapLinkerLogicalGroupRef = OS_DATA_CORE0_VAR
      OS_SystemApplication_OsCore0_VAR_NOINIT
        OS_SystemApplication_OsCore0_VAR_NOINIT (MemMapAddressingMode):
          MemMapAlignmentSelector = BOOLEAN
          MemMapAlignmentSelector = 8
          MemMapAlignmentSelector = 16
          MemMapAlignmentSelector = 32
          MemMapAlignmentSelector = 64
          MemMapAlignmentSelector = UNSPECIFIED
      OS_SystemApplication_OsCore0_VAR_ZERO_INIT
        OS_SystemApplication_OsCore0_VAR_ZERO_INIT (MemMapAddressingMode):
          MemMapAlignmentSelector = BOOLEAN
          MemMapAlignmentSelector = 8
          MemMapAlignmentSelector = 16
          MemMapAlignmentSelector = 32
          MemMapAlignmentSelector = 64
          MemMapAlignmentSelector = UNSPECIFIED
      OS_SystemApplication_OsCore0_VAR_SAVED_ZONE
        OS_SystemApplication_OsCore0_VAR_SAVED_ZONE (MemMapAddressingMode):
          MemMapAlignmentSelector = BOOLEAN
          MemMapAlignmentSelector = 8
          MemMapAlignmentSelector = 16
          MemMapAlignmentSelector = 32
          MemMapAlignmentSelector = 64
          MemMapAlignmentSelector = UNSPECIFIED
          MemMapLinkerLogicalGroupRef = OS_DATA_CORE0_VAR
      MSR_MCAL_CONFIG_DATA_POSTBUILD
        MemMapAddressingMode:
          MemMapAlignmentSelector = UNSPECIFIED
          MemMapAlignmentSelector = 8
          MemMapAlignmentSelector = 16
          MemMapAlignmentSelector = 32
          MemMapAlignmentSelector = 64
          MemMapAlignmentSelector = BOOLEAN
    MCAL_SpecificAllocation (MemMapAllocation)
      5 x MemMapAdditionalSpecificMapping:
        AdditionalMcalConfigDataPostBuild: MemMapAddressingModeSetRef=MSR_MCAL_CONFIG_DATA_POSTBUILD, MemMapAdditionalMemorySectionRef=Mcu/CONFIG_DATA_POSTBUILD, MemMapAdditionalMemorySectionRef=Adc/CONFIG_DATA_POSTBUILD, MemMapAdditionalMemorySectionRef=Port/CONFIG_DATA_POSTBUILD, MemMapAdditionalMemorySectionRef=Can/CONFIG_DATA_POSTBUILD, MemMapAdditionalMemorySectionRef=Pwm/CONFIG_DATA_POSTBUILD, MemMapAdditionalMemorySectionRef=I2c/CONFIG_DATA_POSTBUILD, MemMapAdditionalMemorySectionRef=Dma/CONFIG_DATA_POSTBUILD, MemMapAdditionalMemorySectionRef=Fls/CONFIG_DATA_POSTBUILD, MemMapAdditionalMemorySectionRef=Gpt/CONFIG_DATA_POSTBUILD, MemMapAdditionalMemorySectionRef=Dio/CONFIG_DATA_POSTBUILD
        AdditionalMcalCode: MemMapAddressingModeSetRef=MSR_MCAL_CODE, MemMapAdditionalMemorySectionRef=Mcu/CODE_ISR, MemMapAdditionalMemorySectionRef=I2c/CODE, MemMapAdditionalMemorySectionRef=Pwm/CODE
        AdditionalMcalConst: MemMapAddressingModeSetRef=MSR_MCAL_CONST, MemMapAdditionalMemorySectionRef=Mcu/CONST_UNSPECIFIED, MemMapAdditionalMemorySectionRef=Adc/CONST_UNSPECIFIED, MemMapAdditionalMemorySectionRef=Port/CONST_UNSPECIFIED, MemMapAdditionalMemorySectionRef=Can/CONST_UNSPECIFIED, MemMapAdditionalMemorySectionRef=Dio/CONST_UNSPECIFIED, MemMapAdditionalMemorySectionRef=Dma/CONST_UNSPECIFIED, MemMapAdditionalMemorySectionRef=Fls/CONST_UNSPECIFIED, MemMapAdditionalMemorySectionRef=Gpt/CONST_UNSPECIFIED, MemMapAdditionalMemorySectionRef=I2c/CONST_UNSPECIFIED, MemMapAdditionalMemorySectionRef=Pwm/CONST_UNSPECIFIED, MemMapAdditionalMemorySectionRef=Spi/CONST_UNSPECIFIED, MemMapAdditionalMemorySectionRef=Eth/CONST_UNSPECIFIED
        AdditionalMcalVarInit: MemMapAddressingModeSetRef=MSR_MCAL_VAR_INIT, MemMapAdditionalMemorySectionRef=Mcu/VAR_INIT_8BIT, MemMapAdditionalMemorySectionRef=Mcu/VAR_INIT_16BIT, MemMapAdditionalMemorySectionRef=Adc/VAR_INIT_8BIT, MemMapAdditionalMemorySectionRef=Adc/VAR_INIT_16BIT, MemMapAdditionalMemorySectionRef=Port/VAR_INIT_8BIT, MemMapAdditionalMemorySectionRef=Port/VAR_INIT_16BIT, MemMapAdditionalMemorySectionRef=Adc/VAR_INIT_UNSPECIFIED, MemMapAdditionalMemorySectionRef=Can/VAR_INIT_UNSPECIFIED, MemMapAdditionalMemorySectionRef=Port/VAR_INIT_UNSPECIFIED, MemMapAdditionalMemorySectionRef=Dio/VAR_INIT_8BIT, MemMapAdditionalMemorySectionRef=Dio/VAR_INIT_16BIT, MemMapAdditionalMemorySectionRef=Dio/VAR_INIT_UNSPECIFIED, MemMapAdditionalMemorySectionRef=Dma/VAR_INIT_8BIT, MemMapAdditionalMemorySectionRef=Dma/VAR_INIT_16BIT, MemMapAdditionalMemorySectionRef=Dma/VAR_INIT_UNSPECIFIED, MemMapAdditionalMemorySectionRef=Fls/VAR_INIT_8BIT, MemMapAdditionalMemorySectionRef=Fls/VAR_INIT_16BIT, MemMapAdditionalMemorySectionRef=Fls/VAR_INIT_UNSPECIFIED, MemMapAdditionalMemorySectionRef=Gpt/VAR_INIT_8BIT, MemMapAdditionalMemorySectionRef=Gpt/VAR_INIT_16BIT, MemMapAdditionalMemorySectionRef=Gpt/VAR_INIT_UNSPECIFIED, MemMapAdditionalMemorySectionRef=I2c/VAR_INIT_8BIT, MemMapAdditionalMemorySectionRef=I2c/VAR_INIT_16BIT, MemMapAdditionalMemorySectionRef=I2c/VAR_INIT_UNSPECIFIED, MemMapAdditionalMemorySectionRef=Pwm/VAR_INIT_8BIT, MemMapAdditionalMemorySectionRef=Pwm/VAR_INIT_16BIT, MemMapAdditionalMemorySectionRef=Pwm/VAR_INIT_UNSPECIFIED, MemMapAdditionalMemorySectionRef=Fls/VAR_INIT_32BIT, MemMapAdditionalMemorySectionRef=Spi/VAR_INIT_8BIT, MemMapAdditionalMemorySectionRef=Spi/VAR_INIT_16BIT, MemMapAdditionalMemorySectionRef=Spi/VAR_INIT_UNSPECIFIED, MemMapAdditionalMemorySectionRef=Eth/VAR_INIT_UNSPECIFIED, MemMapAdditionalMemorySectionRef=Gpt/VAR_INIT_32BIT
        AdditionalMcalVarNoInit: MemMapAddressingModeSetRef=MSR_MCAL_VAR_NO_INIT, MemMapAdditionalMemorySectionRef=Mcu/VAR_NO_INIT_UNSPECIFIED, MemMapAdditionalMemorySectionRef=Port/VAR_NO_INIT_UNSPECIFIED, MemMapAdditionalMemorySectionRef=Spi/VAR_NO_INIT_UNSPECIFIED, MemMapAdditionalMemorySectionRef=Eth/VAR_NO_INIT_UNSPECIFIED
    4 x MemMapAddressingModeSet, all with MemMapCompilerMemClassSymbolImpl=:
      MSR_MCAL_CODE
        MemMapAddressingMode:
          MemMapAlignmentSelector = 8
          MemMapAlignmentSelector = 16
          MemMapAlignmentSelector = 32
          MemMapAlignmentSelector = 64
          MemMapAlignmentSelector = UNSPECIFIED
          MemMapAlignmentSelector = BOOLEAN
      MSR_MCAL_CONST
        MemMapAddressingMode:
          MemMapAlignmentSelector = 8
          MemMapAlignmentSelector = 16
          MemMapAlignmentSelector = 32
          MemMapAlignmentSelector = 64
          MemMapAlignmentSelector = BOOLEAN
          MemMapAlignmentSelector = UNSPECIFIED
      MSR_MCAL_VAR_INIT
        MemMapAddressingMode:
          MemMapAlignmentSelector = 8
          MemMapAlignmentSelector = 16
          MemMapAlignmentSelector = 32
          MemMapAlignmentSelector = 64
          MemMapAlignmentSelector = BOOLEAN
          MemMapAlignmentSelector = UNSPECIFIED
      MSR_MCAL_VAR_NO_INIT
        MemMapAddressingMode:
          MemMapAlignmentSelector = 8
          MemMapAlignmentSelector = 16
          MemMapAlignmentSelector = 32
          MemMapAlignmentSelector = 64
          MemMapAlignmentSelector = BOOLEAN
          MemMapAlignmentSelector = UNSPECIFIED
          MemMapAddressingModeStart = 
          MemMapAddressingModeStop = 
    11 x MemMapModule, all with MemMapGenerateAdditionalMemorySections=true:
      Mcu: MemMapModuleRef=Mcu
        6 x MemMapAdditionalMemorySection, all with MemMapMemorySectionPrefix=MCU:
          CODE_ISR: MemMapMemorySectionSwAddrMethodRef=CODE_ISR
          CONFIG_DATA_POSTBUILD: MemMapMemorySectionSwAddrMethodRef=CONFIG_DATA
          CONST_UNSPECIFIED: MemMapMemorySectionSwAddrMethodRef=CONST_UNSPECIFIED
          VAR_INIT_8BIT: MemMapMemorySectionSwAddrMethodRef=VAR_INIT_8
          VAR_INIT_16BIT: MemMapMemorySectionSwAddrMethodRef=VAR_INIT_16
          VAR_NO_INIT_UNSPECIFIED: MemMapMemorySectionSwAddrMethodRef=VAR_NOINIT_UNSPECIFIED
      Port: MemMapModuleRef=Port
        6 x MemMapAdditionalMemorySection, all with MemMapMemorySectionPrefix=PORT:
          CONST_UNSPECIFIED: MemMapMemorySectionSwAddrMethodRef=CONST_UNSPECIFIED
          VAR_INIT_8BIT: MemMapMemorySectionSwAddrMethodRef=VAR_INIT_8
          VAR_INIT_16BIT: MemMapMemorySectionSwAddrMethodRef=VAR_INIT_16
          VAR_INIT_UNSPECIFIED: MemMapMemorySectionSwAddrMethodRef=VAR_INIT_UNSPECIFIED
          CONFIG_DATA_POSTBUILD: MemMapMemorySectionSwAddrMethodRef=CONFIG_DATA
          VAR_NO_INIT_UNSPECIFIED: MemMapMemorySectionSwAddrMethodRef=VAR_NO_INIT_UNSPECIFIED
      Adc: MemMapModuleRef=Adc
        5 x MemMapAdditionalMemorySection, all with MemMapMemorySectionPrefix=ADC:
          CONFIG_DATA_POSTBUILD: MemMapMemorySectionSwAddrMethodRef=CONFIG_DATA
          CONST_UNSPECIFIED: MemMapMemorySectionSwAddrMethodRef=CONST_UNSPECIFIED
          VAR_INIT_16BIT: MemMapMemorySectionSwAddrMethodRef=VAR_INIT_16
          VAR_INIT_8BIT: MemMapMemorySectionSwAddrMethodRef=VAR_INIT_8
          VAR_INIT_UNSPECIFIED: MemMapMemorySectionSwAddrMethodRef=VAR_INIT_UNSPECIFIED
      Can: MemMapModuleRef=Can
        5 x MemMapAdditionalMemorySection, all with MemMapMemorySectionPrefix=CAN:
          CONST_UNSPECIFIED: MemMapMemorySectionSwAddrMethodRef=CONST_UNSPECIFIED
          CONFIG_DATA_POSTBUILD: MemMapMemorySectionSwAddrMethodRef=CONFIG_DATA
          VAR_INIT_8BIT: MemMapMemorySectionSwAddrMethodRef=VAR_INIT_8
          VAR_INIT_16BIT: MemMapMemorySectionSwAddrMethodRef=VAR_INIT_16
          VAR_INIT_UNSPECIFIED: MemMapMemorySectionSwAddrMethodRef=VAR_INIT_UNSPECIFIED
      Dio: MemMapModuleRef=Dio
        5 x MemMapAdditionalMemorySection, all with MemMapMemorySectionPrefix=DIO:
          CONST_UNSPECIFIED: MemMapMemorySectionSwAddrMethodRef=CONST_UNSPECIFIED
          VAR_INIT_8BIT: MemMapMemorySectionSwAddrMethodRef=VAR_INIT_8
          VAR_INIT_16BIT: MemMapMemorySectionSwAddrMethodRef=VAR_INIT_16
          VAR_INIT_UNSPECIFIED: MemMapMemorySectionSwAddrMethodRef=VAR_INIT_UNSPECIFIED
          CONFIG_DATA_POSTBUILD: MemMapMemorySectionSwAddrMethodRef=CONFIG_DATA
      Dma: MemMapModuleRef=Dma
        5 x MemMapAdditionalMemorySection, all with MemMapMemorySectionPrefix=DMA:
          CONST_UNSPECIFIED: MemMapMemorySectionSwAddrMethodRef=CONST_UNSPECIFIED
          VAR_INIT_8BIT: MemMapMemorySectionSwAddrMethodRef=VAR_INIT_8
          VAR_INIT_16BIT: MemMapMemorySectionSwAddrMethodRef=VAR_INIT_16
          VAR_INIT_UNSPECIFIED: MemMapMemorySectionSwAddrMethodRef=VAR_INIT_UNSPECIFIED
          CONFIG_DATA_POSTBUILD: MemMapMemorySectionSwAddrMethodRef=CONFIG_DATA
      Fls: MemMapModuleRef=Fls
        6 x MemMapAdditionalMemorySection, all with MemMapMemorySectionPrefix=FLS:
          CONST_UNSPECIFIED: MemMapMemorySectionSwAddrMethodRef=CONST_UNSPECIFIED
          VAR_INIT_8BIT: MemMapMemorySectionSwAddrMethodRef=VAR_INIT_8
          VAR_INIT_16BIT: MemMapMemorySectionSwAddrMethodRef=VAR_INIT_16
          VAR_INIT_UNSPECIFIED: MemMapMemorySectionSwAddrMethodRef=VAR_INIT_UNSPECIFIED
          VAR_INIT_32BIT: MemMapMemorySectionSwAddrMethodRef=VAR_INIT_32
          CONFIG_DATA_POSTBUILD: MemMapMemorySectionSwAddrMethodRef=CONFIG_DATA
      Gpt: MemMapModuleRef=Gpt
        7 x MemMapAdditionalMemorySection, all with MemMapMemorySectionPrefix=GPT:
          CONST_UNSPECIFIED: MemMapMemorySectionSwAddrMethodRef=CONST_UNSPECIFIED
          VAR_INIT_8BIT: MemMapMemorySectionSwAddrMethodRef=VAR_INIT_8
          VAR_INIT_16BIT: MemMapMemorySectionSwAddrMethodRef=VAR_INIT_16
          VAR_INIT_UNSPECIFIED: MemMapMemorySectionSwAddrMethodRef=VAR_INIT_UNSPECIFIED
          VAR_NO_INIT_UNSPECIFIED: MemMapMemorySectionSwAddrMethodRef=VAR_NO_INIT_UNSPECIFIED
          CONFIG_DATA_POSTBUILD: MemMapMemorySectionSwAddrMethodRef=CONFIG_DATA
          VAR_INIT_32BIT: MemMapMemorySectionSwAddrMethodRef=VAR_INIT_32
      I2c: MemMapModuleRef=I2c
        6 x MemMapAdditionalMemorySection, all with MemMapMemorySectionPrefix=I2C:
          CONST_UNSPECIFIED: MemMapMemorySectionSwAddrMethodRef=CONST_UNSPECIFIED
          VAR_INIT_8BIT: MemMapMemorySectionSwAddrMethodRef=VAR_INIT_8
          VAR_INIT_16BIT: MemMapMemorySectionSwAddrMethodRef=VAR_INIT_16
          VAR_INIT_UNSPECIFIED: MemMapMemorySectionSwAddrMethodRef=VAR_INIT_UNSPECIFIED
          CONFIG_DATA_POSTBUILD: MemMapMemorySectionSwAddrMethodRef=CONFIG_DATA
          CODE: MemMapMemorySectionSwAddrMethodRef=CODE
      Pwm: MemMapModuleRef=Pwm
        6 x MemMapAdditionalMemorySection, all with MemMapMemorySectionPrefix=PWM:
          CONFIG_DATA_POSTBUILD: MemMapMemorySectionSwAddrMethodRef=CONFIG_DATA
          CONST_UNSPECIFIED: MemMapMemorySectionSwAddrMethodRef=CONST_UNSPECIFIED
          VAR_INIT_16BIT: MemMapMemorySectionSwAddrMethodRef=VAR_INIT_16
          VAR_INIT_8BIT: MemMapMemorySectionSwAddrMethodRef=VAR_INIT_8
          VAR_INIT_UNSPECIFIED: MemMapMemorySectionSwAddrMethodRef=VAR_INIT_UNSPECIFIED
          CODE: MemMapMemorySectionSwAddrMethodRef=CODE
      Spi: MemMapModuleRef=Spi
        6 x MemMapAdditionalMemorySection, all with MemMapMemorySectionPrefix=SPI:
          CONST_UNSPECIFIED: MemMapMemorySectionSwAddrMethodRef=CONST_UNSPECIFIED
          VAR_INIT_16BIT: MemMapMemorySectionSwAddrMethodRef=VAR_INIT_16
          VAR_INIT_8BIT: MemMapMemorySectionSwAddrMethodRef=VAR_INIT_8
          VAR_INIT_UNSPECIFIED: MemMapMemorySectionSwAddrMethodRef=VAR_INIT_UNSPECIFIED
          VAR_NO_INIT_UNSPECIFIED: MemMapMemorySectionSwAddrMethodRef=VAR_NO_INIT_UNSPECIFIED
          CONFIG_DATA_POSTBUILD: MemMapMemorySectionSwAddrMethodRef=CONFIG_DATA
    12 x MemMapAddressingModeSet, all with MemMapCompilerMemClassSymbolImpl=:
      OS_OsApplication_VAR_INIT
        OS_OsApplication_VAR_INIT (MemMapAddressingMode):
          MemMapAlignmentSelector = BOOLEAN
          MemMapAlignmentSelector = 8
          MemMapAlignmentSelector = 16
          MemMapAlignmentSelector = 32
          MemMapAlignmentSelector = 64
          MemMapAlignmentSelector = UNSPECIFIED
      OS_OsApplication_VAR_NOINIT
        OS_OsApplication_VAR_NOINIT (MemMapAddressingMode):
          MemMapAlignmentSelector = BOOLEAN
          MemMapAlignmentSelector = 8
          MemMapAlignmentSelector = 16
          MemMapAlignmentSelector = 32
          MemMapAlignmentSelector = 64
          MemMapAlignmentSelector = UNSPECIFIED
      OS_OsApplication_VAR_ZERO_INIT
        OS_OsApplication_VAR_ZERO_INIT (MemMapAddressingMode):
          MemMapAlignmentSelector = BOOLEAN
          MemMapAlignmentSelector = 8
          MemMapAlignmentSelector = 16
          MemMapAlignmentSelector = 32
          MemMapAlignmentSelector = 64
          MemMapAlignmentSelector = UNSPECIFIED
      OS_OsApplication_VAR_SAVED_ZONE
        OS_OsApplication_VAR_SAVED_ZONE (MemMapAddressingMode):
          MemMapAlignmentSelector = BOOLEAN
          MemMapAlignmentSelector = 8
          MemMapAlignmentSelector = 16
          MemMapAlignmentSelector = 32
          MemMapAlignmentSelector = 64
          MemMapAlignmentSelector = UNSPECIFIED
      OS_OsCore0_ASIL_VAR_INIT
        OS_OsCore0_ASIL_VAR_INIT (MemMapAddressingMode):
          MemMapAlignmentSelector = BOOLEAN
          MemMapAlignmentSelector = 8
          MemMapAlignmentSelector = 16
          MemMapAlignmentSelector = 32
          MemMapAlignmentSelector = 64
          MemMapAlignmentSelector = UNSPECIFIED
          MemMapLinkerLogicalGroupRef = OS_OsCore0_ASIL_VAR
      OS_OsCore0_ASIL_VAR_NOINIT
        OS_OsCore0_ASIL_VAR_NOINIT (MemMapAddressingMode):
          MemMapAlignmentSelector = BOOLEAN
          MemMapAlignmentSelector = 8
          MemMapAlignmentSelector = 16
          MemMapAlignmentSelector = 32
          MemMapAlignmentSelector = 64
          MemMapAlignmentSelector = UNSPECIFIED
      OS_OsCore0_ASIL_VAR_ZERO_INIT
        OS_OsCore0_ASIL_VAR_ZERO_INIT (MemMapAddressingMode):
          MemMapAlignmentSelector = BOOLEAN
          MemMapAlignmentSelector = 8
          MemMapAlignmentSelector = 16
          MemMapAlignmentSelector = 32
          MemMapAlignmentSelector = 64
          MemMapAlignmentSelector = UNSPECIFIED
      OS_OsCore0_ASIL_VAR_SAVED_ZONE
        OS_OsCore0_ASIL_VAR_SAVED_ZONE (MemMapAddressingMode):
          MemMapAlignmentSelector = BOOLEAN
          MemMapAlignmentSelector = 8
          MemMapAlignmentSelector = 16
          MemMapAlignmentSelector = 32
          MemMapAlignmentSelector = 64
          MemMapAlignmentSelector = UNSPECIFIED
          MemMapLinkerLogicalGroupRef = OS_OsCore0_ASIL_VAR_SAVED_ZONE
      OS_OsCore_Qm_VAR_INIT
        OS_OsCore_Qm_VAR_INIT (MemMapAddressingMode):
          MemMapAlignmentSelector = BOOLEAN
          MemMapAlignmentSelector = 8
          MemMapAlignmentSelector = 16
          MemMapAlignmentSelector = 32
          MemMapAlignmentSelector = 64
          MemMapAlignmentSelector = UNSPECIFIED
          MemMapAddressingModeStart = #pragma clang section data = ".logging.data" bss = ".logging.bss"
          MemMapAddressingModeStop = #pragma clang section data = "" bss = ""
          MemMapLinkerLogicalGroupRef = OS_OsCore_Qm_VAR
      OS_OsCore_Qm_VAR_NOINIT
        OS_OsCore_Qm_VAR_NOINIT (MemMapAddressingMode):
          MemMapAlignmentSelector = BOOLEAN
          MemMapAlignmentSelector = 8
          MemMapAlignmentSelector = 16
          MemMapAlignmentSelector = 32
          MemMapAlignmentSelector = 64
          MemMapAlignmentSelector = UNSPECIFIED
          MemMapAddressingModeStop = #pragma clang section data = "" bss = ""
          MemMapAddressingModeStart = #pragma clang section data = ".logging.data" bss = ".logging.bss"
      OS_OsCore_Qm_VAR_ZERO_INIT
        OS_OsCore_Qm_VAR_ZERO_INIT (MemMapAddressingMode):
          MemMapAlignmentSelector = BOOLEAN
          MemMapAlignmentSelector = 8
          MemMapAlignmentSelector = 16
          MemMapAlignmentSelector = 32
          MemMapAlignmentSelector = 64
          MemMapAlignmentSelector = UNSPECIFIED
          MemMapAddressingModeStop = #pragma clang section data = "" bss = ""
          MemMapAddressingModeStart = #pragma clang section data = ".logging.data" bss = ".logging.bss"
      OS_OsCore_Qm_VAR_SAVED_ZONE
        OS_OsCore_Qm_VAR_SAVED_ZONE (MemMapAddressingMode):
          MemMapAlignmentSelector = BOOLEAN
          MemMapAlignmentSelector = 8
          MemMapAlignmentSelector = 16
          MemMapAlignmentSelector = 32
          MemMapAlignmentSelector = 64
          MemMapAlignmentSelector = UNSPECIFIED
          MemMapAddressingModeStart = #pragma clang section data = ".logging.data" bss = ".logging.bss"
          MemMapAddressingModeStop = #pragma clang section data = "" bss = ""
          MemMapLinkerLogicalGroupRef = OS_OsCore_Qm_VAR_SAVED_ZONE
    QM_Generic (MemMapAllocation)
      4 x MemMapSectionSpecificMapping:
        VAR_OsCore0_Qm_INIT_UNSPECIFIED: MemMapAddressingModeSetRef=MemMap/OS_OsCore_Qm_VAR_INIT, MemMapMemorySectionRef=VAR_INIT_UNSPECIFIED, MemMapMemorySectionRef=VAR_INIT_UNSPECIFIED
        VAR_OsCore0_Qm_VAR_SAVED_ZONE: MemMapAddressingModeSetRef=MemMap/OS_OsCore_Qm_VAR_SAVED_ZONE, MemMapMemorySectionRef=VAR_SAVED_ZONE, MemMapMemorySectionRef=VAR_SAVED_ZONE
        VAR_OsCore0_Qm_ZERO_INIT_UNSPECIFIED: MemMapAddressingModeSetRef=MemMap/OS_OsCore_Qm_VAR_ZERO_INIT, MemMapMemorySectionRef=VAR_ZERO_INIT_UNSPECIFIED, MemMapMemorySectionRef=VAR_ZERO_INIT_UNSPECIFIED
        VAR_OsCore_Qm_NOINIT_UNSPECIFIED: MemMapAddressingModeSetRef=MemMap/OS_OsCore_Qm_VAR_NOINIT, MemMapMemorySectionRef=VAR_NOINIT_UNSPECIFIED, MemMapMemorySectionRef=VAR_NOINIT_UNSPECIFIED
    Uart (MemMapModule): MemMapGenerateAdditionalMemorySections=true, MemMapModuleRef=Uart
      CONST_UNSPECIFIED (MemMapAdditionalMemorySection): MemMapMemorySectionPrefix=UART, MemMapMemorySectionSwAddrMethodRef=CONST_UNSPECIFIED
    Eth (MemMapModule): MemMapGenerateAdditionalMemorySections=true, MemMapModuleRef=Eth
      7 x MemMapAdditionalMemorySection, all with MemMapMemorySectionFileName=Eth_MemMap.h, MemMapMemorySectionPrefix=ETH:
        CONST_UNSPECIFIED: MemMapMemorySectionSwAddrMethodRef=CONST_UNSPECIFIED
        EthernetBufferRx: MemMapMemorySectionSymbol=BUFFER_INIT_RX_UNSPECIFIED, MemMapMemorySectionSwAddrMethodRef=VAR_NO_INIT_UNSPECIFIED
        EthernetDescriptorRx: MemMapMemorySectionSymbol=DESCRIPTOR_INIT_RX_UNSPECIFIED, MemMapMemorySectionAlignment=UNSPECIFIED, MemMapMemorySectionSwAddrMethodRef=VAR_FAST_NO_INIT_UNSPECIFIED
        VAR_INIT_UNSPECIFIED: MemMapMemorySectionSwAddrMethodRef=VAR_INIT_UNSPECIFIED
        VAR_NO_INIT_UNSPECIFIED: MemMapMemorySectionSymbol=VAR_NOINIT_UNSPECIFIED, MemMapMemorySectionAlignment=UNSPECIFIED, MemMapMemorySectionSwAddrMethodRef=VAR_NOINIT_UNSPECIFIED
        EthernetBufferTx: MemMapMemorySectionSymbol=BUFFER_INIT_TX_UNSPECIFIED, MemMapMemorySectionSwAddrMethodRef=VAR_NO_INIT_UNSPECIFIED
        EthernetDescriptorTx: MemMapMemorySectionAlignment=UNSPECIFIED, MemMapMemorySectionSymbol=DESCRIPTOR_INIT_TX_UNSPECIFIED, MemMapMemorySectionSwAddrMethodRef=VAR_FAST_NO_INIT_UNSPECIFIED
    Eth_MemMap (MemMapAllocation)
      4 x MemMapAdditionalSpecificMapping:
        MemMapEthBufferRx: MemMapAddressingModeSetRef=MSR_ETH_BUF_RX, MemMapAdditionalMemorySectionRef=EthernetBufferRx
        MemMapEthDescriptorRx: MemMapAddressingModeSetRef=MSR_ETH_DESC_RX, MemMapAdditionalMemorySectionRef=EthernetDescriptorRx
        MemMapEthDescriptorTx: MemMapAddressingModeSetRef=MSR_ETH_DESC_TX, MemMapAdditionalMemorySectionRef=EthernetDescriptorTx
        MemMapEthBufferTx: MemMapAddressingModeSetRef=MSR_ETH_BUF_TX, MemMapAdditionalMemorySectionRef=EthernetBufferTx
    5 x MemMapAddressingModeSet, all with MemMapCompilerMemClassSymbolImpl=:
      MSR_ETH_BUF_RX
        MemMapAddressingMode:
          MemMapAlignmentSelector = UNSPECIFIED
          MemMapAddressingModeStart = #pragma clang section bss=".eth_buffer_rx"
          MemMapAddressingModeStop = #pragma clang section bss=""
      MSR_ETH_DESC_RX
        MemMapAddressingMode:
          MemMapAlignmentSelector = UNSPECIFIED
          MemMapAddressingModeStart = #pragma clang section bss=".eth_descriptor_rx"
          MemMapAddressingModeStop = #pragma clang section bss=""
      MSR_MCAL_BSS
        MemMapAddressingMode: MemMapAlignmentSelector=
      MSR_ETH_BUF_TX
        MemMapAddressingMode:
          MemMapAlignmentSelector = UNSPECIFIED
          MemMapAddressingModeStart = #pragma clang section bss=".eth_buffer_tx"
          MemMapAddressingModeStop = #pragma clang section bss=""
      MSR_ETH_DESC_TX
        MemMapAddressingMode:
          MemMapAlignmentSelector = UNSPECIFIED
          MemMapAddressingModeStart = #pragma clang section bss=".eth_descriptor_tx"
          MemMapAddressingModeStop = #pragma clang section bss=""
    Wdg (MemMapModule): MemMapGenerateAdditionalMemorySections=true, MemMapModuleRef=Wdg
      6 x MemMapAdditionalMemorySection, all with MemMapMemorySectionPrefix=WDG:
        CONFIG_DATA_POSTBUILD: MemMapMemorySectionSwAddrMethodRef=CONFIG_DATA
        CONST_UNSPECIFIED: MemMapMemorySectionSwAddrMethodRef=CONST_UNSPECIFIED
        VAR_INIT_8BIT: MemMapMemorySectionSwAddrMethodRef=VAR_INIT_8
        VAR_INIT_16BIT: MemMapMemorySectionSwAddrMethodRef=VAR_INIT_16
        VAR_INIT_UNSPECIFIED: MemMapMemorySectionSwAddrMethodRef=VAR_INIT_UNSPECIFIED
        VAR_NO_INIT_UNSPECIFIED: MemMapMemorySectionSwAddrMethodRef=VAR_NO_INIT_UNSPECIFIED
    MSR_CRYPTO_IPC_DataBuffer (MemMapAddressingModeSet): MemMapCompilerMemClassSymbolImpl=
      MemMapAddressingMode:
        MemMapAlignmentSelector = 32
        MemMapAddressingModeStart = #pragma clang section bss=".Crypto_iNDI13400_IPC_Section.Align16Var1"
        MemMapAddressingModeStop = #pragma clang section bss=""
        MemMapAlignmentSelector = 128
        MemMapAlignmentSelector = UNSPECIFIED
    MSR_CRYPTO_IPC_LengthBuffer (MemMapAddressingModeSet): MemMapCompilerMemClassSymbolImpl=
      MemMapAddressingMode:
        MemMapAlignmentSelector = 32
        MemMapAddressingModeStart = #pragma clang section data=".Crypto_iNDI13400_TestData"
        MemMapAddressingModeStop = #pragma clang section data=""
        MemMapAlignmentSelector = 128
        MemMapAlignmentSelector = UNSPECIFIED
    CRYPTO_MemMap (MemMapAllocation)
      12 x MemMapSectionSpecificMapping:
        MemMapIPCDataBuffer: MemMapAddressingModeSetRef=MSR_CRYPTO_IPC_DataBuffer, MemMapMemorySectionRef=CRYPTO_IPC_DATA_BUFFER_128BIT
        MemMapIPCLengthBuffer: MemMapAddressingModeSetRef=MSR_CRYPTO_IPC_LengthBuffer, MemMapMemorySectionRef=CRYPTO_IPC_LENGTH_BUFFER_128BIT
        MemMapKeyStructInitdata: MemMapAddressingModeSetRef=MSR_CRYPTO_KeyStruct_InitData, MemMapMemorySectionRef=CRYPTO_KEYSTRUCT_INITDATA_8BIT
        MemMapKeyStructMetadata: MemMapAddressingModeSetRef=MSR_CRYPTO_KeyStruct_MetaData, MemMapMemorySectionRef=CRYPTO_KEYSTRUCT_METADATA_128BIT
        MemMapSectionSpecificMapping_Code: MemMapAddressingModeSetRef=MSR_MCAL_CODE, MemMapMemorySectionRef=CRYPTO_CODE
        MemMapSectionSpecificMapping_Const: MemMapAddressingModeSetRef=MSR_MCAL_CONST, MemMapMemorySectionRef=CRYPTO_CONST_8BIT, MemMapMemorySectionRef=CRYPTO_CONST_16BIT, MemMapMemorySectionRef=CRYPTO_CONST_32BIT
        MemMapSectionSpecificMapping_VarInit: MemMapAddressingModeSetRef=MSR_MCAL_VAR_INIT, MemMapMemorySectionRef=CRYPTO_VAR_INIT_UNSPECIFIED
        MemMapSectionSpecificMapping_VarNoInit_8BIT: MemMapAddressingModeSetRef=MSR_MCAL_VAR_NO_INIT, MemMapMemorySectionRef=CRYPTO_VAR_NOINIT_8BIT
        MemMapSectionSpecificMapping_VarNoInit_16BIT: MemMapAddressingModeSetRef=MSR_MCAL_VAR_NO_INIT, MemMapMemorySectionRef=CRYPTO_VAR_NOINIT_16BIT
        MemMapSectionSpecificMapping_VarNoInit_32BIT: MemMapAddressingModeSetRef=MSR_MCAL_VAR_NO_INIT, MemMapMemorySectionRef=CRYPTO_VAR_NOINIT_32BIT
        MemMapSectionSpecificMapping_VarNoInit_Unspecified: MemMapAddressingModeSetRef=MSR_MCAL_VAR_NO_INIT, MemMapMemorySectionRef=CRYPTO_VAR_NOINIT_UNSPECIFIED
        MemMapTestData: MemMapAddressingModeSetRef=MSR_CRYPTO_TestData, MemMapMemorySectionRef=CRYPTO_TESTDATA_128BIT
    37 x MemMapAddressingModeSet:
      OS_GLOBALSHARED_VAR_CLEARED
        OS_GLOBALSHARED_VAR_CLEARED (MemMapAddressingMode):
          MemMapAlignmentSelector = BOOLEAN
          MemMapAlignmentSelector = 8
          MemMapAlignmentSelector = 16
          MemMapAlignmentSelector = 32
          MemMapAlignmentSelector = 64
          MemMapAlignmentSelector = PTR
          MemMapAlignmentSelector = UNSPECIFIED
          MemMapLinkerLogicalGroupRef = OS_GLOBALSHARED_VAR
      OS_GLOBALSHARED_VAR_POWER_ON_INIT
        OS_GLOBALSHARED_VAR_POWER_ON_INIT (MemMapAddressingMode):
          MemMapAlignmentSelector = BOOLEAN
          MemMapAlignmentSelector = 8
          MemMapAlignmentSelector = 16
          MemMapAlignmentSelector = 32
          MemMapAlignmentSelector = 64
          MemMapAlignmentSelector = PTR
          MemMapAlignmentSelector = UNSPECIFIED
          MemMapLinkerLogicalGroupRef = OS_GLOBALSHARED_VAR
      OS_GLOBALSHARED_VAR_POWER_ON_CLEARED
        OS_GLOBALSHARED_VAR_POWER_ON_CLEARED (MemMapAddressingMode):
          MemMapAlignmentSelector = BOOLEAN
          MemMapAlignmentSelector = 8
          MemMapAlignmentSelector = 16
          MemMapAlignmentSelector = 32
          MemMapAlignmentSelector = 64
          MemMapAlignmentSelector = PTR
          MemMapAlignmentSelector = UNSPECIFIED
          MemMapLinkerLogicalGroupRef = OS_GLOBALSHARED_VAR
      OS_OsCore0_ASIL_VAR_CLEARED
        OS_OsCore0_ASIL_VAR_CLEARED (MemMapAddressingMode):
          MemMapAlignmentSelector = BOOLEAN
          MemMapAlignmentSelector = 8
          MemMapAlignmentSelector = 16
          MemMapAlignmentSelector = 32
          MemMapAlignmentSelector = 64
          MemMapAlignmentSelector = PTR
          MemMapAlignmentSelector = UNSPECIFIED
          MemMapLinkerLogicalGroupRef = OS_OsCore0_ASIL_VAR
      OS_OsCore0_ASIL_VAR_POWER_ON_INIT
        OS_OsCore0_ASIL_VAR_POWER_ON_INIT (MemMapAddressingMode):
          MemMapAlignmentSelector = BOOLEAN
          MemMapAlignmentSelector = 8
          MemMapAlignmentSelector = 16
          MemMapAlignmentSelector = 32
          MemMapAlignmentSelector = 64
          MemMapAlignmentSelector = PTR
          MemMapAlignmentSelector = UNSPECIFIED
          MemMapLinkerLogicalGroupRef = OS_OsCore0_ASIL_VAR
      OS_OsCore0_ASIL_VAR_POWER_ON_CLEARED
        OS_OsCore0_ASIL_VAR_POWER_ON_CLEARED (MemMapAddressingMode):
          MemMapAlignmentSelector = BOOLEAN
          MemMapAlignmentSelector = 8
          MemMapAlignmentSelector = 16
          MemMapAlignmentSelector = 32
          MemMapAlignmentSelector = 64
          MemMapAlignmentSelector = PTR
          MemMapAlignmentSelector = UNSPECIFIED
          MemMapLinkerLogicalGroupRef = OS_OsCore0_ASIL_VAR
      OS_OsCore_Qm_VAR_CLEARED
        OS_OsCore_Qm_VAR_CLEARED (MemMapAddressingMode):
          MemMapAlignmentSelector = BOOLEAN
          MemMapAlignmentSelector = 8
          MemMapAlignmentSelector = 16
          MemMapAlignmentSelector = 32
          MemMapAlignmentSelector = 64
          MemMapAlignmentSelector = PTR
          MemMapAlignmentSelector = UNSPECIFIED
          MemMapLinkerLogicalGroupRef = OS_OsCore_Qm_VAR
      OS_OsCore_Qm_VAR_POWER_ON_INIT
        OS_OsCore_Qm_VAR_POWER_ON_INIT (MemMapAddressingMode):
          MemMapAlignmentSelector = BOOLEAN
          MemMapAlignmentSelector = 8
          MemMapAlignmentSelector = 16
          MemMapAlignmentSelector = 32
          MemMapAlignmentSelector = 64
          MemMapAlignmentSelector = PTR
          MemMapAlignmentSelector = UNSPECIFIED
          MemMapLinkerLogicalGroupRef = OS_OsCore_Qm_VAR
      OS_OsCore_Qm_VAR_POWER_ON_CLEARED
        OS_OsCore_Qm_VAR_POWER_ON_CLEARED (MemMapAddressingMode):
          MemMapAlignmentSelector = BOOLEAN
          MemMapAlignmentSelector = 8
          MemMapAlignmentSelector = 16
          MemMapAlignmentSelector = 32
          MemMapAlignmentSelector = 64
          MemMapAlignmentSelector = PTR
          MemMapAlignmentSelector = UNSPECIFIED
          MemMapLinkerLogicalGroupRef = OS_OsCore_Qm_VAR
      OS_SystemApplication_OsCore0_VAR_CLEARED
        OS_SystemApplication_OsCore0_VAR_CLEARED (MemMapAddressingMode):
          MemMapAlignmentSelector = BOOLEAN
          MemMapAlignmentSelector = 8
          MemMapAlignmentSelector = 16
          MemMapAlignmentSelector = 32
          MemMapAlignmentSelector = 64
          MemMapAlignmentSelector = PTR
          MemMapAlignmentSelector = UNSPECIFIED
          MemMapLinkerLogicalGroupRef = OS_DATA_CORE0_VAR
      OS_SystemApplication_OsCore0_VAR_POWER_ON_INIT
        OS_SystemApplication_OsCore0_VAR_POWER_ON_INIT (MemMapAddressingMode):
          MemMapAlignmentSelector = BOOLEAN
          MemMapAlignmentSelector = 8
          MemMapAlignmentSelector = 16
          MemMapAlignmentSelector = 32
          MemMapAlignmentSelector = 64
          MemMapAlignmentSelector = PTR
          MemMapAlignmentSelector = UNSPECIFIED
          MemMapLinkerLogicalGroupRef = OS_DATA_CORE0_VAR
      OS_SystemApplication_OsCore0_VAR_POWER_ON_CLEARED
        OS_SystemApplication_OsCore0_VAR_POWER_ON_CLEARED (MemMapAddressingMode):
          MemMapAlignmentSelector = BOOLEAN
          MemMapAlignmentSelector = 8
          MemMapAlignmentSelector = 16
          MemMapAlignmentSelector = 32
          MemMapAlignmentSelector = 64
          MemMapAlignmentSelector = PTR
          MemMapAlignmentSelector = UNSPECIFIED
          MemMapLinkerLogicalGroupRef = OS_DATA_CORE0_VAR
      OS_INTVEC_OsCore0_CODE
        OS_INTVEC_OsCore0_CODE (MemMapAddressingMode):
          MemMapAlignmentSelector = BOOLEAN
          MemMapAlignmentSelector = 8
          MemMapAlignmentSelector = 16
          MemMapAlignmentSelector = 32
          MemMapAlignmentSelector = 64
          MemMapAlignmentSelector = PTR
          MemMapAlignmentSelector = UNSPECIFIED
          MemMapLinkerLogicalGroupRef = OS_INTVEC_CORE0_CODE
      OS_INTVEC_OsCore0_CONST
        OS_INTVEC_OsCore0_CONST (MemMapAddressingMode):
          MemMapAlignmentSelector = BOOLEAN
          MemMapAlignmentSelector = 8
          MemMapAlignmentSelector = 16
          MemMapAlignmentSelector = 32
          MemMapAlignmentSelector = 64
          MemMapAlignmentSelector = PTR
          MemMapAlignmentSelector = UNSPECIFIED
          MemMapLinkerLogicalGroupRef = OS_INTVEC_CORE0_CONST
      OS_EXCVEC_OsCore0_CODE
        OS_EXCVEC_OsCore0_CODE (MemMapAddressingMode):
          MemMapAlignmentSelector = BOOLEAN
          MemMapAlignmentSelector = 8
          MemMapAlignmentSelector = 16
          MemMapAlignmentSelector = 32
          MemMapAlignmentSelector = 64
          MemMapAlignmentSelector = PTR
          MemMapAlignmentSelector = UNSPECIFIED
          MemMapLinkerLogicalGroupRef = OS_EXCVEC_CORE0_CODE
      OS_EXCVEC_OsCore0_CONST
        OS_EXCVEC_OsCore0_CONST (MemMapAddressingMode):
          MemMapAlignmentSelector = BOOLEAN
          MemMapAlignmentSelector = 8
          MemMapAlignmentSelector = 16
          MemMapAlignmentSelector = 32
          MemMapAlignmentSelector = 64
          MemMapAlignmentSelector = PTR
          MemMapAlignmentSelector = UNSPECIFIED
          MemMapLinkerLogicalGroupRef = OS_EXCVEC_CORE0_CONST
      OS_CODE
        OS_CODE (MemMapAddressingMode):
          MemMapAlignmentSelector = BOOLEAN
          MemMapAlignmentSelector = 8
          MemMapAlignmentSelector = 16
          MemMapAlignmentSelector = 32
          MemMapAlignmentSelector = 64
          MemMapAlignmentSelector = PTR
          MemMapAlignmentSelector = UNSPECIFIED
          MemMapLinkerLogicalGroupRef = OS_CODE
      OS_INTVEC_CODE
        OS_INTVEC_CODE (MemMapAddressingMode):
          MemMapAlignmentSelector = BOOLEAN
          MemMapAlignmentSelector = 8
          MemMapAlignmentSelector = 16
          MemMapAlignmentSelector = 32
          MemMapAlignmentSelector = 64
          MemMapAlignmentSelector = PTR
          MemMapAlignmentSelector = UNSPECIFIED
          MemMapLinkerLogicalGroupRef = OS_INTVEC_CODE
      OS_INTVEC_CONST
        OS_INTVEC_CONST (MemMapAddressingMode):
          MemMapAlignmentSelector = BOOLEAN
          MemMapAlignmentSelector = 8
          MemMapAlignmentSelector = 16
          MemMapAlignmentSelector = 32
          MemMapAlignmentSelector = 64
          MemMapAlignmentSelector = PTR
          MemMapAlignmentSelector = UNSPECIFIED
          MemMapLinkerLogicalGroupRef = OS_INTVEC_CONST
      OS_STACK_Appl_Task_VAR_CLEARED
        OS_STACK_Appl_Task_VAR_CLEARED (MemMapAddressingMode):
          MemMapAlignmentSelector = BOOLEAN
          MemMapAlignmentSelector = 8
          MemMapAlignmentSelector = 16
          MemMapAlignmentSelector = 32
          MemMapAlignmentSelector = 64
          MemMapAlignmentSelector = PTR
          MemMapAlignmentSelector = UNSPECIFIED
          MemMapLinkerLogicalGroupRef = OS_STACK_Appl_Task_VAR
      OS_STACK_Appl_Task_Communication_VAR_CLEARED
        OS_STACK_Appl_Task_Communication_VAR_CLEARED (MemMapAddressingMode):
          MemMapAlignmentSelector = BOOLEAN
          MemMapAlignmentSelector = 8
          MemMapAlignmentSelector = 16
          MemMapAlignmentSelector = 32
          MemMapAlignmentSelector = 64
          MemMapAlignmentSelector = PTR
          MemMapAlignmentSelector = UNSPECIFIED
          MemMapLinkerLogicalGroupRef = OS_STACK_Appl_Task_Communication_VAR
      OS_STACK_Appl_Task_Fast_VAR_CLEARED
        OS_STACK_Appl_Task_Fast_VAR_CLEARED (MemMapAddressingMode):
          MemMapAlignmentSelector = BOOLEAN
          MemMapAlignmentSelector = 8
          MemMapAlignmentSelector = 16
          MemMapAlignmentSelector = 32
          MemMapAlignmentSelector = 64
          MemMapAlignmentSelector = PTR
          MemMapAlignmentSelector = UNSPECIFIED
          MemMapLinkerLogicalGroupRef = OS_STACK_Appl_Task_Fast_VAR
      OS_STACK_Appl_Task_High_Prio_VAR_CLEARED
        OS_STACK_Appl_Task_High_Prio_VAR_CLEARED (MemMapAddressingMode):
          MemMapAlignmentSelector = BOOLEAN
          MemMapAlignmentSelector = 8
          MemMapAlignmentSelector = 16
          MemMapAlignmentSelector = 32
          MemMapAlignmentSelector = 64
          MemMapAlignmentSelector = PTR
          MemMapAlignmentSelector = UNSPECIFIED
          MemMapLinkerLogicalGroupRef = OS_STACK_Appl_Task_High_Prio_VAR
      OS_STACK_Appl_Task_Logging_VAR_CLEARED
        OS_STACK_Appl_Task_Logging_VAR_CLEARED (MemMapAddressingMode):
          MemMapAlignmentSelector = BOOLEAN
          MemMapAlignmentSelector = 8
          MemMapAlignmentSelector = 16
          MemMapAlignmentSelector = 32
          MemMapAlignmentSelector = 64
          MemMapAlignmentSelector = PTR
          MemMapAlignmentSelector = UNSPECIFIED
          MemMapLinkerLogicalGroupRef = OS_STACK_Appl_Task_Logging_VAR
      OS_STACK_BSW_Task_VAR_CLEARED
        OS_STACK_BSW_Task_VAR_CLEARED (MemMapAddressingMode):
          MemMapAlignmentSelector = BOOLEAN
          MemMapAlignmentSelector = 8
          MemMapAlignmentSelector = 16
          MemMapAlignmentSelector = 32
          MemMapAlignmentSelector = 64
          MemMapAlignmentSelector = PTR
          MemMapAlignmentSelector = UNSPECIFIED
          MemMapLinkerLogicalGroupRef = OS_STACK_BSW_Task_VAR
      OS_STACK_OsCore0_Error_VAR_CLEARED
        OS_STACK_OsCore0_Error_VAR_CLEARED (MemMapAddressingMode):
          MemMapAlignmentSelector = BOOLEAN
          MemMapAlignmentSelector = 8
          MemMapAlignmentSelector = 16
          MemMapAlignmentSelector = 32
          MemMapAlignmentSelector = 64
          MemMapAlignmentSelector = PTR
          MemMapAlignmentSelector = UNSPECIFIED
          MemMapLinkerLogicalGroupRef = OS_STACK_OsCore0_Error_VAR
      OS_STACK_OsCore0_Init_VAR_CLEARED
        OS_STACK_OsCore0_Init_VAR_CLEARED (MemMapAddressingMode):
          MemMapAlignmentSelector = BOOLEAN
          MemMapAlignmentSelector = 8
          MemMapAlignmentSelector = 16
          MemMapAlignmentSelector = 32
          MemMapAlignmentSelector = 64
          MemMapAlignmentSelector = PTR
          MemMapAlignmentSelector = UNSPECIFIED
          MemMapLinkerLogicalGroupRef = OS_STACK_OsCore0_Init_VAR
      OS_STACK_OsCore0_Isr_Core_VAR_CLEARED
        OS_STACK_OsCore0_Isr_Core_VAR_CLEARED (MemMapAddressingMode):
          MemMapAlignmentSelector = BOOLEAN
          MemMapAlignmentSelector = 8
          MemMapAlignmentSelector = 16
          MemMapAlignmentSelector = 32
          MemMapAlignmentSelector = 64
          MemMapAlignmentSelector = PTR
          MemMapAlignmentSelector = UNSPECIFIED
          MemMapLinkerLogicalGroupRef = OS_STACK_OsCore0_Isr_Core_VAR
      OS_STACK_OsCore0_Kernel_VAR_CLEARED
        OS_STACK_OsCore0_Kernel_VAR_CLEARED (MemMapAddressingMode):
          MemMapAlignmentSelector = BOOLEAN
          MemMapAlignmentSelector = 8
          MemMapAlignmentSelector = 16
          MemMapAlignmentSelector = 32
          MemMapAlignmentSelector = 64
          MemMapAlignmentSelector = PTR
          MemMapAlignmentSelector = UNSPECIFIED
          MemMapLinkerLogicalGroupRef = OS_STACK_OsCore0_Kernel_VAR
      OS_STACK_OsCore0_Shutdown_VAR_CLEARED
        OS_STACK_OsCore0_Shutdown_VAR_CLEARED (MemMapAddressingMode):
          MemMapAlignmentSelector = BOOLEAN
          MemMapAlignmentSelector = 8
          MemMapAlignmentSelector = 16
          MemMapAlignmentSelector = 32
          MemMapAlignmentSelector = 64
          MemMapAlignmentSelector = PTR
          MemMapAlignmentSelector = UNSPECIFIED
          MemMapLinkerLogicalGroupRef = OS_STACK_OsCore0_Shutdown_VAR
      OS_STACK_OsCore0_Startup_VAR_CLEARED
        OS_STACK_OsCore0_Startup_VAR_CLEARED (MemMapAddressingMode):
          MemMapAlignmentSelector = BOOLEAN
          MemMapAlignmentSelector = 8
          MemMapAlignmentSelector = 16
          MemMapAlignmentSelector = 32
          MemMapAlignmentSelector = 64
          MemMapAlignmentSelector = PTR
          MemMapAlignmentSelector = UNSPECIFIED
          MemMapLinkerLogicalGroupRef = OS_STACK_OsCore0_Startup_VAR
      OS_STACK_OsCore0_Task_Prio0_VAR_CLEARED
        OS_STACK_OsCore0_Task_Prio0_VAR_CLEARED (MemMapAddressingMode):
          MemMapAlignmentSelector = BOOLEAN
          MemMapAlignmentSelector = 8
          MemMapAlignmentSelector = 16
          MemMapAlignmentSelector = 32
          MemMapAlignmentSelector = 64
          MemMapAlignmentSelector = PTR
          MemMapAlignmentSelector = UNSPECIFIED
          MemMapLinkerLogicalGroupRef = OS_STACK_OsCore0_Task_Prio0_VAR
      OS_STACK_OsCore0_Task_Prio190_VAR_CLEARED
        OS_STACK_OsCore0_Task_Prio190_VAR_CLEARED (MemMapAddressingMode):
          MemMapAlignmentSelector = BOOLEAN
          MemMapAlignmentSelector = 8
          MemMapAlignmentSelector = 16
          MemMapAlignmentSelector = 32
          MemMapAlignmentSelector = 64
          MemMapAlignmentSelector = PTR
          MemMapAlignmentSelector = UNSPECIFIED
          MemMapLinkerLogicalGroupRef = OS_STACK_OsCore0_Task_Prio190_VAR
      OS_STACK_OsCore0_Task_Prio200_VAR_CLEARED
        OS_STACK_OsCore0_Task_Prio200_VAR_CLEARED (MemMapAddressingMode):
          MemMapAlignmentSelector = BOOLEAN
          MemMapAlignmentSelector = 8
          MemMapAlignmentSelector = 16
          MemMapAlignmentSelector = 32
          MemMapAlignmentSelector = 64
          MemMapAlignmentSelector = PTR
          MemMapAlignmentSelector = UNSPECIFIED
          MemMapLinkerLogicalGroupRef = OS_STACK_OsCore0_Task_Prio200_VAR
      OS_STACK_OsCore0_Task_Prio210_VAR_CLEARED
        OS_STACK_OsCore0_Task_Prio210_VAR_CLEARED (MemMapAddressingMode):
          MemMapAlignmentSelector = BOOLEAN
          MemMapAlignmentSelector = 8
          MemMapAlignmentSelector = 16
          MemMapAlignmentSelector = 32
          MemMapAlignmentSelector = 64
          MemMapAlignmentSelector = PTR
          MemMapAlignmentSelector = UNSPECIFIED
          MemMapLinkerLogicalGroupRef = OS_STACK_OsCore0_Task_Prio210_VAR
      OS_STACK_OsCore0_Task_Prio4294967295_VAR_CLEARED
        OS_STACK_OsCore0_Task_Prio4294967295_VAR_CLEARED (MemMapAddressingMode):
          MemMapAlignmentSelector = BOOLEAN
          MemMapAlignmentSelector = 8
          MemMapAlignmentSelector = 16
          MemMapAlignmentSelector = 32
          MemMapAlignmentSelector = 64
          MemMapAlignmentSelector = PTR
          MemMapAlignmentSelector = UNSPECIFIED
          MemMapLinkerLogicalGroupRef = OS_STACK_OsCore0_Task_Prio4294967295_VAR
      OS_STACK_Radar_Ctrl_Task_VAR_CLEARED
        OS_STACK_Radar_Ctrl_Task_VAR_CLEARED (MemMapAddressingMode):
          MemMapAlignmentSelector = BOOLEAN
          MemMapAlignmentSelector = 8
          MemMapAlignmentSelector = 16
          MemMapAlignmentSelector = 32
          MemMapAlignmentSelector = 64
          MemMapAlignmentSelector = PTR
          MemMapAlignmentSelector = UNSPECIFIED
          MemMapLinkerLogicalGroupRef = OS_STACK_Radar_Ctrl_Task_VAR
    3 x MemMapAllocation:
      SWC_ComM
        3 x MemMapSectionSpecificMapping:
          ComM_VAR_NOINIT_UNSPECIFIED: MemMapAddressingModeSetRef=MemMap/OS_OsCore0_ASIL_VAR_NOINIT, MemMapMemorySectionRef=ComM_VAR_NOINIT_UNSPECIFIED
          ComM_VAR_INIT_UNSPECIFIED: MemMapAddressingModeSetRef=MemMap/OS_OsCore0_ASIL_VAR_INIT, MemMapMemorySectionRef=ComM_VAR_INIT_UNSPECIFIED
          ComM_VAR_ZERO_INIT_UNSPECIFIED: MemMapAddressingModeSetRef=MemMap/OS_OsCore0_ASIL_VAR_ZERO_INIT, MemMapMemorySectionRef=ComM_VAR_ZERO_INIT_UNSPECIFIED
      SWC_EcuM
        3 x MemMapSectionSpecificMapping:
          EcuM_VAR_NOINIT_UNSPECIFIED: MemMapAddressingModeSetRef=MemMap/OS_OsCore0_ASIL_VAR_NOINIT, MemMapMemorySectionRef=EcuM_VAR_NOINIT_UNSPECIFIED
          EcuM_VAR_INIT_UNSPECIFIED: MemMapAddressingModeSetRef=MemMap/OS_OsCore0_ASIL_VAR_INIT, MemMapMemorySectionRef=EcuM_VAR_INIT_UNSPECIFIED
          EcuM_VAR_ZERO_INIT_UNSPECIFIED: MemMapAddressingModeSetRef=MemMap/OS_OsCore0_ASIL_VAR_ZERO_INIT, MemMapMemorySectionRef=EcuM_VAR_ZERO_INIT_UNSPECIFIED
      SWC_StbM
        3 x MemMapSectionSpecificMapping:
          StbM_VAR_NOINIT_UNSPECIFIED: MemMapAddressingModeSetRef=MemMap/OS_OsCore0_ASIL_VAR_NOINIT, MemMapMemorySectionRef=StbM_VAR_NOINIT_UNSPECIFIED
          StbM_VAR_INIT_UNSPECIFIED: MemMapAddressingModeSetRef=MemMap/OS_OsCore0_ASIL_VAR_INIT, MemMapMemorySectionRef=StbM_VAR_INIT_UNSPECIFIED
          StbM_VAR_ZERO_INIT_UNSPECIFIED: MemMapAddressingModeSetRef=MemMap/OS_OsCore0_ASIL_VAR_ZERO_INIT, MemMapMemorySectionRef=StbM_VAR_ZERO_INIT_UNSPECIFIED
    OS_STACK_Appl_IPC_Task_VAR_CLEARED (MemMapAddressingModeSet)
      OS_STACK_Appl_IPC_Task_VAR_CLEARED (MemMapAddressingMode):
        MemMapAlignmentSelector = BOOLEAN
        MemMapAlignmentSelector = 8
        MemMapAlignmentSelector = 16
        MemMapAlignmentSelector = 32
        MemMapAlignmentSelector = 64
        MemMapAlignmentSelector = PTR
        MemMapAlignmentSelector = UNSPECIFIED
        MemMapLinkerLogicalGroupRef = OS_STACK_Appl_IPC_Task_VAR
    SWC_Dcm (MemMapAllocation)
      3 x MemMapSectionSpecificMapping:
        Dcm_VAR_NOINIT_UNSPECIFIED: MemMapAddressingModeSetRef=MemMap/OS_OsCore0_ASIL_VAR_NOINIT, MemMapMemorySectionRef=Dcm_VAR_NOINIT_UNSPECIFIED
        Dcm_VAR_INIT_UNSPECIFIED: MemMapAddressingModeSetRef=MemMap/OS_OsCore0_ASIL_VAR_INIT, MemMapMemorySectionRef=Dcm_VAR_INIT_UNSPECIFIED
        Dcm_VAR_ZERO_INIT_UNSPECIFIED: MemMapAddressingModeSetRef=MemMap/OS_OsCore0_ASIL_VAR_ZERO_INIT, MemMapMemorySectionRef=Dcm_VAR_ZERO_INIT_UNSPECIFIED
    6 x MemMapAddressingModeSet:
      MSR_CRYPTO_KeyStruct_InitData: MemMapCompilerMemClassSymbolImpl=
        MemMapAddressingMode:
          MemMapAddressingModeStart = #pragma clang section rodata=".Crypto_iNDI13400_KeyStruct_InitData"
          MemMapAddressingModeStop = #pragma clang section rodata=""
          MemMapAlignmentSelector = 8
      MSR_CRYPTO_KeyStruct_MetaData: MemMapCompilerMemClassSymbolImpl=
        MemMapAddressingMode:
          MemMapAlignmentSelector = 32
          MemMapAddressingModeStart = #pragma clang section bss=".Crypto_iNDI13400_KeyStruct_MetaData"
          MemMapAddressingModeStop = #pragma clang section bss=""
          MemMapAlignmentSelector = 128
          MemMapAlignmentSelector = UNSPECIFIED
      MSR_CRYPTO_TestData: MemMapCompilerMemClassSymbolImpl=
        MemMapAddressingMode:
          MemMapAlignmentSelector = 32
          MemMapAddressingModeStart = #pragma clang section bss=".Crypto_iNDI13400_IPC_Section.Align16Var1"
          MemMapAddressingModeStop = #pragma clang section bss=""
          MemMapAlignmentSelector = 128
          MemMapAlignmentSelector = UNSPECIFIED
      OS_STACK_OsCore0_Protection_VAR_CLEARED
        OS_STACK_OsCore0_Protection_VAR_CLEARED (MemMapAddressingMode):
          MemMapAlignmentSelector = BOOLEAN
          MemMapAlignmentSelector = 8
          MemMapAlignmentSelector = 16
          MemMapAlignmentSelector = 32
          MemMapAlignmentSelector = 64
          MemMapAlignmentSelector = PTR
          MemMapAlignmentSelector = UNSPECIFIED
          MemMapLinkerLogicalGroupRef = OS_STACK_OsCore0_Protection_VAR
      OS_STACK_OsCore0_Task_Prio1_VAR_CLEARED
        OS_STACK_OsCore0_Task_Prio1_VAR_CLEARED (MemMapAddressingMode):
          MemMapAlignmentSelector = BOOLEAN
          MemMapAlignmentSelector = 8
          MemMapAlignmentSelector = 16
          MemMapAlignmentSelector = 32
          MemMapAlignmentSelector = 64
          MemMapAlignmentSelector = PTR
          MemMapAlignmentSelector = UNSPECIFIED
          MemMapLinkerLogicalGroupRef = OS_STACK_OsCore0_Task_Prio1_VAR
      OS_STACK_Appl_BackgroundTask_VAR_CLEARED
        OS_STACK_Appl_BackgroundTask_VAR_CLEARED (MemMapAddressingMode):
          MemMapAlignmentSelector = BOOLEAN
          MemMapAlignmentSelector = 8
          MemMapAlignmentSelector = 16
          MemMapAlignmentSelector = 32
          MemMapAlignmentSelector = 64
          MemMapAlignmentSelector = PTR
          MemMapAlignmentSelector = UNSPECIFIED
          MemMapLinkerLogicalGroupRef = OS_STACK_Appl_BackgroundTask_VAR
