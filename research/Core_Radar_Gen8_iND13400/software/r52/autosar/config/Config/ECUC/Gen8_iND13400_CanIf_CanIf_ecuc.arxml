[part 1 of 2: package /ActiveEcuC]
AUTOSAR XML (schema 00053)
package /ActiveEcuC
  module config CanIf: implementation-config-variant=VARIANT-POST-BUILD-SELECTABLE, module-description=CanIf_Impl
    CanIfCtrlDrvCfg:
      CanIfCtrlDrvTxCancellation = false
      CanIfCtrlDrvArVersion = CAN_DRV_EQC_AR_431
      CanIfCtrlDrvInitHohConfigRef = CanIfInitHohCfg
      CanIfCtrlDrvNameRef = CanGeneral
      CT_PCAN_RADAR_a3a0f56c (CanIfCtrlCfg): CanIfCtrlId=1, CanIfCtrlWakeupSupport=false, CanIfCtrlJ1939DynAddrSupport=DISABLED, CanIfCtrlCanCtrlRef=CT_PCAN_RADAR_a3a0f56c  # CT_MyECU_CanCluster
      CT_VCAN_RADAR_a3a0f56c (CanIfCtrlCfg): CanIfCtrlId=0, CanIfCtrlWakeupSupport=false, CanIfCtrlJ1939DynAddrSupport=DISABLED, CanIfCtrlCanCtrlRef=CanController2_VCAN
    CanIfDispatchCfg:
      CanIfDispatchUserCtrlBusOffName = CanSM_ControllerBusOff
      CanIfDispatchUserCtrlBusOffUL = CAN_SM
      CanIfDispatchUserCtrlModeIndicationName = CanSM_ControllerModeIndication
      CanIfDispatchUserCtrlModeIndicationUL = CAN_SM
    CanIfInitCfg
      CanIfInitHohCfg: CanIfInitRefCfgSet=CanConfigSet
        CN_PCAN_RADAR_458ff0f1_Tx (CanIfHthCfg): CanIfHthCanCtrlIdRef=CT_PCAN_RADAR_a3a0f56c, CanIfHthIdSymRef=CN_PCAN_RADAR_458ff0f1_Tx
        CN_PCAN_RADAR_a729ccfc_Rx (CanIfHrhCfg): CanIfHrhSoftwareFilter=true, CanIfHrhCanCtrlIdRef=CT_PCAN_RADAR_a3a0f56c, CanIfHrhIdSymRef=CN_PCAN_RADAR_a729ccfc_Rx
        CN_VCAN_RADAR_489180b6_Tx (CanIfHthCfg): CanIfHthCanCtrlIdRef=CT_VCAN_RADAR_a3a0f56c, CanIfHthIdSymRef=CanController2_VCAN_Tx
        CN_VCAN_RADAR_0fbf9117_Rx (CanIfHrhCfg): CanIfHrhSoftwareFilter=true, CanIfHrhCanCtrlIdRef=CT_VCAN_RADAR_a3a0f56c, CanIfHrhIdSymRef=CanController2_VCAN_Rx
      CHNL_2ad3227b_PCAN (CanIfBufferCfg):
        CanIfBufferSize = 196 if post-build-variant-condition{matching-criterion=RDR_POS, value=0}
        CanIfTxBufferHandlingType = FIFO
        CanIfTxBufferMappedTxPdus = 204 if post-build-variant-condition{matching-criterion=RDR_POS, value=0}
        CanIfTxBufferMaxPduLength = 64
        CanIfBufferSize = 175 if post-build-variant-condition{matching-criterion=RDR_POS, value=1}
        CanIfBufferSize = 175 if post-build-variant-condition{matching-criterion=RDR_POS, value=2}
        CanIfBufferSize = 196 if post-build-variant-condition{matching-criterion=RDR_POS, value=3}
        CanIfBufferSize = 197 if post-build-variant-condition{matching-criterion=RDR_POS, value=4}
        CanIfTxBufferMappedTxPdus = 205 if post-build-variant-condition{matching-criterion=RDR_POS, value=4}
        CanIfTxBufferMappedTxPdus = 204 if post-build-variant-condition{matching-criterion=RDR_POS, value={1..3}}
        CanIfBufferSize = 175 if post-build-variant-condition{matching-criterion=RDR_POS, value=5}
        CanIfTxBufferMappedTxPdus = 204 if post-build-variant-condition{matching-criterion=RDR_POS, value=5}
        CanIfBufferSize = 175 if post-build-variant-condition{matching-criterion=RDR_POS, value=6}
        CanIfTxBufferMappedTxPdus = 204 if post-build-variant-condition{matching-criterion=RDR_POS, value=6}
        CanIfBufferSize = 175 if post-build-variant-condition{matching-criterion=RDR_POS, value=7}
        CanIfTxBufferMappedTxPdus = 204 if post-build-variant-condition{matching-criterion=RDR_POS, value=7}
        CanIfBufferHthRef = CN_PCAN_RADAR_458ff0f1_Tx
      SYS_VEHICLE_STATUS_oPCAN_RADAR_877cfaa4_Rx (CanIfRxPduCfg):
        CanIfRxPduCanId = 2
        CanIfRxPduCanIdType = STANDARD_CAN
        CanIfRxPduDlc = 64
        CanIfRxPduUserRxIndicationName = PduR_CanIfRxIndication
        CanIfRxPduUserRxIndicationUL = PDUR
        CanIfRxPduId = 107
        CanIfRxPduReadData = false
        CanIfRxPduReadNotifyStatus = false
        CanIfRxPduDlcCheck = true
        CanIfRxPduType = STATIC
        CanIfRxPduUserRxIndicationType = PDUID_PDUINFOPTR
        CanIfRxPduHrhIdRef = CN_PCAN_RADAR_a729ccfc_Rx
        CanIfRxPduRef = SYS_VEHICLE_STATUS_oPCAN_RADAR_9bbcdf4b_Rx
      172 x CanIfTxPduCfg, all with CanIfTxPduCanIdType=STANDARD_FD_CAN, CanIfTxPduDlc=64, CanIfTxPduUserTxConfirmationName=NULL_PTR, CanIfTxPduUserTxConfirmationUL=NONE, CanIfTxPduReadNotifyStatus=false, CanIfTxPduType=STATIC, CanIfTxPduTruncation=true, CanIfTxPduBufferRef=CHNL_2ad3227b_PCAN:
        RDR_TRACKER_OBJ_004_oPCAN_RADAR_5c8f3866_Tx: CanIfTxPduCanId=1299 if post-build-variant-condition{matching-criterion=RDR_POS, value=0}, CanIfTxPduId=141, CanIfTxPduCanId=1363 if post-build-variant-condition{matching-criterion=RDR_POS, value=1}, CanIfTxPduCanId=1427 if post-build-variant-condition{matching-criterion=RDR_POS, value=2}, CanIfTxPduCanId=1491 if post-build-variant-condition{matching-criterion=RDR_POS, value=3}, CanIfTxPduCanId=1555 if post-build-variant-condition{matching-criterion=RDR_POS, value=4}, CanIfTxPduCanId=1619 if post-build-variant-condition{matching-criterion=RDR_POS, value=5}, CanIfTxPduCanId=1683 if post-build-variant-condition{matching-criterion=RDR_POS, value=6}, CanIfTxPduCanId=1747 if post-build-variant-condition{matching-criterion=RDR_POS, value=7}, CanIfTxPduRef=RDR_TRACKER_OBJ_004_oPCAN_RADAR_067dfb3d_Tx
        RDR_TRACKER_OBJ_012_oPCAN_RADAR_cd32e4a1_Tx: CanIfTxPduCanId=1307 if post-build-variant-condition{matching-criterion=RDR_POS, value=0}, CanIfTxPduId=149, CanIfTxPduCanId=1371 if post-build-variant-condition{matching-criterion=RDR_POS, value=1}, CanIfTxPduCanId=1435 if post-build-variant-condition{matching-criterion=RDR_POS, value=2}, CanIfTxPduCanId=1499 if post-build-variant-condition{matching-criterion=RDR_POS, value=3}, CanIfTxPduCanId=1563 if post-build-variant-condition{matching-criterion=RDR_POS, value=4}, CanIfTxPduCanId=1627 if post-build-variant-condition{matching-criterion=RDR_POS, value=5}, CanIfTxPduCanId=1691 if post-build-variant-condition{matching-criterion=RDR_POS, value=6}, CanIfTxPduCanId=1755 if post-build-variant-condition{matching-criterion=RDR_POS, value=7}, CanIfTxPduRef=RDR_TRACKER_OBJ_012_oPCAN_RADAR_94d0c821_Tx
        RDR_TRACKER_OBJ_033_oPCAN_RADAR_42883d2b_Tx: CanIfTxPduCanId=1328 if post-build-variant-condition{matching-criterion=RDR_POS, value=0}, CanIfTxPduId=170, CanIfTxPduCanId=1392 if post-build-variant-condition{matching-criterion=RDR_POS, value=1}, CanIfTxPduCanId=1456 if post-build-variant-condition{matching-criterion=RDR_POS, value=2}, CanIfTxPduCanId=1520 if post-build-variant-condition{matching-criterion=RDR_POS, value=3}, CanIfTxPduCanId=1584 if post-build-variant-condition{matching-criterion=RDR_POS, value=4}, CanIfTxPduCanId=1648 if post-build-variant-condition{matching-criterion=RDR_POS, value=5}, CanIfTxPduCanId=1712 if post-build-variant-condition{matching-criterion=RDR_POS, value=6}, CanIfTxPduCanId=1776 if post-build-variant-condition{matching-criterion=RDR_POS, value=7}, CanIfTxPduRef=RDR_TRACKER_OBJ_033_oPCAN_RADAR_eb26fabe_Tx
        RDR_TRACKER_OBJ_042_oPCAN_RADAR_b3a27b97_Tx: CanIfTxPduCanId=1337 if post-build-variant-condition{matching-criterion=RDR_POS, value=0}, CanIfTxPduId=180, CanIfTxPduCanId=1401 if post-build-variant-condition{matching-criterion=RDR_POS, value=1}, CanIfTxPduCanId=1465 if post-build-variant-condition{matching-criterion=RDR_POS, value=2}, CanIfTxPduCanId=1529 if post-build-variant-condition{matching-criterion=RDR_POS, value=3}, CanIfTxPduCanId=1593 if post-build-variant-condition{matching-criterion=RDR_POS, value=4}, CanIfTxPduCanId=1657 if post-build-variant-condition{matching-criterion=RDR_POS, value=5}, CanIfTxPduCanId=1721 if post-build-variant-condition{matching-criterion=RDR_POS, value=6}, CanIfTxPduCanId=1785 if post-build-variant-condition{matching-criterion=RDR_POS, value=7}, CanIfTxPduRef=RDR_TRACKER_OBJ_042_oPCAN_RADAR_225bddcf_Tx
        RDR_DETECTION_201_204_oPCAN_RADAR_7aaf8e32_Tx: CanIfTxPduCanId=306 if post-build-variant-condition{matching-criterion=RDR_POS, value=0}, CanIfTxPduId=83, CanIfTxPduCanId=434 if post-build-variant-condition{matching-criterion=RDR_POS, value=1}, CanIfTxPduCanId=562 if post-build-variant-condition{matching-criterion=RDR_POS, value=2}, CanIfTxPduCanId=690 if post-build-variant-condition{matching-criterion=RDR_POS, value=3}, CanIfTxPduCanId=818 if post-build-variant-condition{matching-criterion=RDR_POS, value=4}, CanIfTxPduCanId=946 if post-build-variant-condition{matching-criterion=RDR_POS, value=5}, CanIfTxPduCanId=1074 if post-build-variant-condition{matching-criterion=RDR_POS, value=6}, CanIfTxPduCanId=1202 if post-build-variant-condition{matching-criterion=RDR_POS, value=7}, CanIfTxPduRef=RDR_DETECTION_201_204_oPCAN_RADAR_02329f3e_Tx
        RDR_TRACKER_OBJ_041_oPCAN_RADAR_acfcfd6c_Tx: CanIfTxPduCanId=1336 if post-build-variant-condition{matching-criterion=RDR_POS, value=0}, CanIfTxPduId=178, CanIfTxPduCanId=1400 if post-build-variant-condition{matching-criterion=RDR_POS, value=1}, CanIfTxPduCanId=1464 if post-build-variant-condition{matching-criterion=RDR_POS, value=2}, CanIfTxPduCanId=1528 if post-build-variant-condition{matching-criterion=RDR_POS, value=3}, CanIfTxPduCanId=1592 if post-build-variant-condition{matching-criterion=RDR_POS, value=4}, CanIfTxPduCanId=1656 if post-build-variant-condition{matching-criterion=RDR_POS, value=5}, CanIfTxPduCanId=1720 if post-build-variant-condition{matching-criterion=RDR_POS, value=6}, CanIfTxPduCanId=1784 if post-build-variant-condition{matching-criterion=RDR_POS, value=7}, CanIfTxPduRef=RDR_TRACKER_OBJ_041_oPCAN_RADAR_794c6cda_Tx
        RDR_DETECTION_157_160_oPCAN_RADAR_87b6b9a0_Tx: CanIfTxPduCanId=295 if post-build-variant-condition{matching-criterion=RDR_POS, value=0}, CanIfTxPduId=72, CanIfTxPduCanId=423 if post-build-variant-condition{matching-criterion=RDR_POS, value=1}, CanIfTxPduCanId=551 if post-build-variant-condition{matching-criterion=RDR_POS, value=2}, CanIfTxPduCanId=679 if post-build-variant-condition{matching-criterion=RDR_POS, value=3}, CanIfTxPduCanId=807 if post-build-variant-condition{matching-criterion=RDR_POS, value=4}, CanIfTxPduCanId=935 if post-build-variant-condition{matching-criterion=RDR_POS, value=5}, CanIfTxPduCanId=1063 if post-build-variant-condition{matching-criterion=RDR_POS, value=6}, CanIfTxPduCanId=1191 if post-build-variant-condition{matching-criterion=RDR_POS, value=7}, CanIfTxPduRef=RDR_DETECTION_157_160_oPCAN_RADAR_384766cd_Tx
        RDR_DETECTION_309_312_oPCAN_RADAR_4e3b7cc4_Tx: CanIfTxPduCanId=333 if post-build-variant-condition{matching-criterion=RDR_POS, value=0}, CanIfTxPduId=110, CanIfTxPduCanId=461 if post-build-variant-condition{matching-criterion=RDR_POS, value=1}, CanIfTxPduCanId=589 if post-build-variant-condition{matching-criterion=RDR_POS, value=2}, CanIfTxPduCanId=717 if post-build-variant-condition{matching-criterion=RDR_POS, value=3}, CanIfTxPduCanId=845 if post-build-variant-condition{matching-criterion=RDR_POS, value=4}, CanIfTxPduCanId=973 if post-build-variant-condition{matching-criterion=RDR_POS, value=5}, CanIfTxPduCanId=1101 if post-build-variant-condition{matching-criterion=RDR_POS, value=6}, CanIfTxPduCanId=1229 if post-build-variant-condition{matching-criterion=RDR_POS, value=7}, CanIfTxPduRef=RDR_DETECTION_309_312_oPCAN_RADAR_cd2e1d3d_Tx
        RDR_DETECTION_057_060_oPCAN_RADAR_75ecf6b9_Tx: CanIfTxPduCanId=270 if post-build-variant-condition{matching-criterion=RDR_POS, value=0}, CanIfTxPduId=47, CanIfTxPduCanId=398 if post-build-variant-condition{matching-criterion=RDR_POS, value=1}, CanIfTxPduCanId=526 if post-build-variant-condition{matching-criterion=RDR_POS, value=2}, CanIfTxPduCanId=654 if post-build-variant-condition{matching-criterion=RDR_POS, value=3}, CanIfTxPduCanId=782 if post-build-variant-condition{matching-criterion=RDR_POS, value=4}, CanIfTxPduCanId=910 if post-build-variant-condition{matching-criterion=RDR_POS, value=5}, CanIfTxPduCanId=1038 if post-build-variant-condition{matching-criterion=RDR_POS, value=6}, CanIfTxPduCanId=1166 if post-build-variant-condition{matching-criterion=RDR_POS, value=7}, CanIfTxPduRef=RDR_DETECTION_057_060_oPCAN_RADAR_b9507aac_Tx
        RDR_CAPABILITY_oPCAN_RADAR_834d4809_Tx: CanIfTxPduCanId=135 if post-build-variant-condition{matching-criterion=RDR_POS, value=0}, CanIfTxPduId=32, CanIfTxPduCanId=143 if post-build-variant-condition{matching-criterion=RDR_POS, value=1}, CanIfTxPduCanId=151 if post-build-variant-condition{matching-criterion=RDR_POS, value=2}, CanIfTxPduCanId=159 if post-build-variant-condition{matching-criterion=RDR_POS, value=3}, CanIfTxPduCanId=167 if post-build-variant-condition{matching-criterion=RDR_POS, value=4}, CanIfTxPduCanId=175 if post-build-variant-condition{matching-criterion=RDR_POS, value=5}, CanIfTxPduCanId=183 if post-build-variant-condition{matching-criterion=RDR_POS, value=6}, CanIfTxPduCanId=191 if post-build-variant-condition{matching-criterion=RDR_POS, value=7}, CanIfTxPduRef=RDR_CAPABILITY_oPCAN_RADAR_476dda7e_Tx
        RDR_DETECTION_341_344_oPCAN_RADAR_69c89c67_Tx: CanIfTxPduCanId=341 if post-build-variant-condition{matching-criterion=RDR_POS, value=0}, CanIfTxPduId=118, CanIfTxPduCanId=469 if post-build-variant-condition{matching-criterion=RDR_POS, value=1}, CanIfTxPduCanId=597 if post-build-variant-condition{matching-criterion=RDR_POS, value=2}, CanIfTxPduCanId=725 if post-build-variant-condition{matching-criterion=RDR_POS, value=3}, CanIfTxPduCanId=853 if post-build-variant-condition{matching-criterion=RDR_POS, value=4}, CanIfTxPduCanId=981 if post-build-variant-condition{matching-criterion=RDR_POS, value=5}, CanIfTxPduCanId=1109 if post-build-variant-condition{matching-criterion=RDR_POS, value=6}, CanIfTxPduCanId=1237 if post-build-variant-condition{matching-criterion=RDR_POS, value=7}, CanIfTxPduRef=RDR_DETECTION_341_344_oPCAN_RADAR_4a9c3acc_Tx
        RDR_TRACKER_OBJ_022_oPCAN_RADAR_e74291b3_Tx: CanIfTxPduCanId=1317 if post-build-variant-condition{matching-criterion=RDR_POS, value=0}, CanIfTxPduId=159, CanIfTxPduCanId=1381 if post-build-variant-condition{matching-criterion=RDR_POS, value=1}, CanIfTxPduCanId=1445 if post-build-variant-condition{matching-criterion=RDR_POS, value=2}, CanIfTxPduCanId=1509 if post-build-variant-condition{matching-criterion=RDR_POS, value=3}, CanIfTxPduCanId=1573 if post-build-variant-condition{matching-criterion=RDR_POS, value=4}, CanIfTxPduCanId=1637 if post-build-variant-condition{matching-criterion=RDR_POS, value=5}, CanIfTxPduCanId=1701 if post-build-variant-condition{matching-criterion=RDR_POS, value=6}, CanIfTxPduCanId=1765 if post-build-variant-condition{matching-criterion=RDR_POS, value=7}, CanIfTxPduRef=RDR_TRACKER_OBJ_022_oPCAN_RADAR_f9563b7b_Tx
        RDR_DETECTION_357_360_oPCAN_RADAR_b87321d3_Tx: CanIfTxPduCanId=345 if post-build-variant-condition{matching-criterion=RDR_POS, value=0}, CanIfTxPduId=122, CanIfTxPduCanId=473 if post-build-variant-condition{matching-criterion=RDR_POS, value=1}, CanIfTxPduCanId=601 if post-build-variant-condition{matching-criterion=RDR_POS, value=2}, CanIfTxPduCanId=729 if post-build-variant-condition{matching-criterion=RDR_POS, value=3}, CanIfTxPduCanId=857 if post-build-variant-condition{matching-criterion=RDR_POS, value=4}, CanIfTxPduCanId=985 if post-build-variant-condition{matching-criterion=RDR_POS, value=5}, CanIfTxPduCanId=1113 if post-build-variant-condition{matching-criterion=RDR_POS, value=6}, CanIfTxPduCanId=1241 if post-build-variant-condition{matching-criterion=RDR_POS, value=7}, CanIfTxPduRef=RDR_DETECTION_357_360_oPCAN_RADAR_e118584e_Tx
        RDR_TRACKER_OBJ_038_oPCAN_RADAR_0b855698_Tx: CanIfTxPduCanId=1333 if post-build-variant-condition{matching-criterion=RDR_POS, value=0}, CanIfTxPduId=175, CanIfTxPduCanId=1397 if post-build-variant-condition{matching-criterion=RDR_POS, value=1}, CanIfTxPduCanId=1461 if post-build-variant-condition{matching-criterion=RDR_POS, value=2}, CanIfTxPduCanId=1525 if post-build-variant-condition{matching-criterion=RDR_POS, value=3}, CanIfTxPduCanId=1589 if post-build-variant-condition{matching-criterion=RDR_POS, value=4}, CanIfTxPduCanId=1653 if post-build-variant-condition{matching-criterion=RDR_POS, value=5}, CanIfTxPduCanId=1717 if post-build-variant-condition{matching-criterion=RDR_POS, value=6}, CanIfTxPduCanId=1781 if post-build-variant-condition{matching-criterion=RDR_POS, value=7}, CanIfTxPduRef=RDR_TRACKER_OBJ_038_oPCAN_RADAR_dcd4ca72_Tx
        RDR_DETECTION_253_256_oPCAN_RADAR_5787ad28_Tx: CanIfTxPduCanId=319 if post-build-variant-condition{matching-criterion=RDR_POS, value=0}, CanIfTxPduId=96, CanIfTxPduCanId=447 if post-build-variant-condition{matching-criterion=RDR_POS, value=1}, CanIfTxPduCanId=575 if post-build-variant-condition{matching-criterion=RDR_POS, value=2}, CanIfTxPduCanId=703 if post-build-variant-condition{matching-criterion=RDR_POS, value=3}, CanIfTxPduCanId=831 if post-build-variant-condition{matching-criterion=RDR_POS, value=4}, CanIfTxPduCanId=959 if post-build-variant-condition{matching-criterion=RDR_POS, value=5}, CanIfTxPduCanId=1087 if post-build-variant-condition{matching-criterion=RDR_POS, value=6}, CanIfTxPduCanId=1215 if post-build-variant-condition{matching-criterion=RDR_POS, value=7}, CanIfTxPduRef=RDR_DETECTION_253_256_oPCAN_RADAR_d5f583e0_Tx
        RDR_DETECTION_193_196_oPCAN_RADAR_622e9bd7_Tx: CanIfTxPduCanId=304 if post-build-variant-condition{matching-criterion=RDR_POS, value=0}, CanIfTxPduId=81, CanIfTxPduCanId=432 if post-build-variant-condition{matching-criterion=RDR_POS, value=1}, CanIfTxPduCanId=560 if post-build-variant-condition{matching-criterion=RDR_POS, value=2}, CanIfTxPduCanId=688 if post-build-variant-condition{matching-criterion=RDR_POS, value=3}, CanIfTxPduCanId=816 if post-build-variant-condition{matching-criterion=RDR_POS, value=4}, CanIfTxPduCanId=944 if post-build-variant-condition{matching-criterion=RDR_POS, value=5}, CanIfTxPduCanId=1072 if post-build-variant-condition{matching-criterion=RDR_POS, value=6}, CanIfTxPduCanId=1200 if post-build-variant-condition{matching-criterion=RDR_POS, value=7}, CanIfTxPduRef=RDR_DETECTION_193_196_oPCAN_RADAR_0c066df6_Tx
        RDR_TRACKER_OBJ_031_oPCAN_RADAR_571cc679_Tx: CanIfTxPduCanId=1326 if post-build-variant-condition{matching-criterion=RDR_POS, value=0}, CanIfTxPduId=168, CanIfTxPduCanId=1390 if post-build-variant-condition{matching-criterion=RDR_POS, value=1}, CanIfTxPduCanId=1454 if post-build-variant-condition{matching-criterion=RDR_POS, value=2}, CanIfTxPduCanId=1518 if post-build-variant-condition{matching-criterion=RDR_POS, value=3}, CanIfTxPduCanId=1582 if post-build-variant-condition{matching-criterion=RDR_POS, value=4}, CanIfTxPduCanId=1646 if post-build-variant-condition{matching-criterion=RDR_POS, value=5}, CanIfTxPduCanId=1710 if post-build-variant-condition{matching-criterion=RDR_POS, value=6}, CanIfTxPduCanId=1774 if post-build-variant-condition{matching-criterion=RDR_POS, value=7}, CanIfTxPduRef=RDR_TRACKER_OBJ_031_oPCAN_RADAR_86c3db58_Tx
        RDR_TRACKER_OBJ_032_oPCAN_RADAR_48424082_Tx: CanIfTxPduCanId=1327 if post-build-variant-condition{matching-criterion=RDR_POS, value=0}, CanIfTxPduId=169, CanIfTxPduCanId=1391 if post-build-variant-condition{matching-criterion=RDR_POS, value=1}, CanIfTxPduCanId=1455 if post-build-variant-condition{matching-criterion=RDR_POS, value=2}, CanIfTxPduCanId=1519 if post-build-variant-condition{matching-criterion=RDR_POS, value=3}, CanIfTxPduCanId=1583 if post-build-variant-condition{matching-criterion=RDR_POS, value=4}, CanIfTxPduCanId=1647 if post-build-variant-condition{matching-criterion=RDR_POS, value=5}, CanIfTxPduCanId=1711 if post-build-variant-condition{matching-criterion=RDR_POS, value=6}, CanIfTxPduCanId=1775 if post-build-variant-condition{matching-criterion=RDR_POS, value=7}, CanIfTxPduRef=RDR_TRACKER_OBJ_032_oPCAN_RADAR_ddd46a4d_Tx
        RDR_DETECTION_093_096_oPCAN_RADAR_9074d4ce_Tx: CanIfTxPduCanId=279 if post-build-variant-condition{matching-criterion=RDR_POS, value=0}, CanIfTxPduId=56, CanIfTxPduCanId=407 if post-build-variant-condition{matching-criterion=RDR_POS, value=1}, CanIfTxPduCanId=535 if post-build-variant-condition{matching-criterion=RDR_POS, value=2}, CanIfTxPduCanId=663 if post-build-variant-condition{matching-criterion=RDR_POS, value=3}, CanIfTxPduCanId=791 if post-build-variant-condition{matching-criterion=RDR_POS, value=4}, CanIfTxPduCanId=919 if post-build-variant-condition{matching-criterion=RDR_POS, value=5}, CanIfTxPduCanId=1047 if post-build-variant-condition{matching-criterion=RDR_POS, value=6}, CanIfTxPduCanId=1175 if post-build-variant-condition{matching-criterion=RDR_POS, value=7}, CanIfTxPduRef=RDR_DETECTION_093_096_oPCAN_RADAR_8d117197_Tx
        RDR_TRACKER_OBJ_016_oPCAN_RADAR_e61b1205_Tx: CanIfTxPduCanId=1311 if post-build-variant-condition{matching-criterion=RDR_POS, value=0}, CanIfTxPduId=153, CanIfTxPduCanId=1375 if post-build-variant-condition{matching-criterion=RDR_POS, value=1}, CanIfTxPduCanId=1439 if post-build-variant-condition{matching-criterion=RDR_POS, value=2}, CanIfTxPduCanId=1503 if post-build-variant-condition{matching-criterion=RDR_POS, value=3}, CanIfTxPduCanId=1567 if post-build-variant-condition{matching-criterion=RDR_POS, value=4}, CanIfTxPduCanId=1631 if post-build-variant-condition{matching-criterion=RDR_POS, value=5}, CanIfTxPduCanId=1695 if post-build-variant-condition{matching-criterion=RDR_POS, value=6}, CanIfTxPduCanId=1759 if post-build-variant-condition{matching-criterion=RDR_POS, value=7}, CanIfTxPduRef=RDR_TRACKER_OBJ_016_oPCAN_RADAR_4f1a8bed_Tx
        RDR_DETECTION_285_288_oPCAN_RADAR_b6b2b2b1_Tx: CanIfTxPduCanId=327 if post-build-variant-condition{matching-criterion=RDR_POS, value=0}, CanIfTxPduId=104, CanIfTxPduCanId=455 if post-build-variant-condition{matching-criterion=RDR_POS, value=1}, CanIfTxPduCanId=583 if post-build-variant-condition{matching-criterion=RDR_POS, value=2}, CanIfTxPduCanId=711 if post-build-variant-condition{matching-criterion=RDR_POS, value=3}, CanIfTxPduCanId=839 if post-build-variant-condition{matching-criterion=RDR_POS, value=4}, CanIfTxPduCanId=967 if post-build-variant-condition{matching-criterion=RDR_POS, value=5}, CanIfTxPduCanId=1095 if post-build-variant-condition{matching-criterion=RDR_POS, value=6}, CanIfTxPduCanId=1223 if post-build-variant-condition{matching-criterion=RDR_POS, value=7}, CanIfTxPduRef=RDR_DETECTION_285_288_oPCAN_RADAR_934c7ef3_Tx
        RDR_DETECTION_385_388_oPCAN_RADAR_44e8fda8_Tx: CanIfTxPduCanId=352 if post-build-variant-condition{matching-criterion=RDR_POS, value=0}, CanIfTxPduId=129, CanIfTxPduCanId=480 if post-build-variant-condition{matching-criterion=RDR_POS, value=1}, CanIfTxPduCanId=608 if post-build-variant-condition{matching-criterion=RDR_POS, value=2}, CanIfTxPduCanId=736 if post-build-variant-condition{matching-criterion=RDR_POS, value=3}, CanIfTxPduCanId=864 if post-build-variant-condition{matching-criterion=RDR_POS, value=4}, CanIfTxPduCanId=992 if post-build-variant-condition{matching-criterion=RDR_POS, value=5}, CanIfTxPduCanId=1120 if post-build-variant-condition{matching-criterion=RDR_POS, value=6}, CanIfTxPduCanId=1248 if post-build-variant-condition{matching-criterion=RDR_POS, value=7}, CanIfTxPduRef=RDR_DETECTION_385_388_oPCAN_RADAR_125b6292_Tx
        RDR_DETECTION_233_236_oPCAN_RADAR_c6245ec2_Tx: CanIfTxPduCanId=314 if post-build-variant-condition{matching-criterion=RDR_POS, value=0}, CanIfTxPduId=91, CanIfTxPduCanId=442 if post-build-variant-condition{matching-criterion=RDR_POS, value=1}, CanIfTxPduCanId=570 if post-build-variant-condition{matching-criterion=RDR_POS, value=2}, CanIfTxPduCanId=698 if post-build-variant-condition{matching-criterion=RDR_POS, value=3}, CanIfTxPduCanId=826 if post-build-variant-condition{matching-criterion=RDR_POS, value=4}, CanIfTxPduCanId=954 if post-build-variant-condition{matching-criterion=RDR_POS, value=5}, CanIfTxPduCanId=1082 if post-build-variant-condition{matching-criterion=RDR_POS, value=6}, CanIfTxPduCanId=1210 if post-build-variant-condition{matching-criterion=RDR_POS, value=7}, CanIfTxPduRef=RDR_DETECTION_233_236_oPCAN_RADAR_9528659a_Tx
        RDR_DETECTION_249_252_oPCAN_RADAR_5d5c6e91_Tx: CanIfTxPduCanId=318 if post-build-variant-condition{matching-criterion=RDR_POS, value=0}, CanIfTxPduId=95, CanIfTxPduCanId=446 if post-build-variant-condition{matching-criterion=RDR_POS, value=1}, CanIfTxPduCanId=574 if post-build-variant-condition{matching-criterion=RDR_POS, value=2}, CanIfTxPduCanId=702 if post-build-variant-condition{matching-criterion=RDR_POS, value=3}, CanIfTxPduCanId=830 if post-build-variant-condition{matching-criterion=RDR_POS, value=4}, CanIfTxPduCanId=958 if post-build-variant-condition{matching-criterion=RDR_POS, value=5}, CanIfTxPduCanId=1086 if post-build-variant-condition{matching-criterion=RDR_POS, value=6}, CanIfTxPduCanId=1214 if post-build-variant-condition{matching-criterion=RDR_POS, value=7}, CanIfTxPduRef=RDR_DETECTION_249_252_oPCAN_RADAR_8580b8cf_Tx
        RDR_DETECTION_105_108_oPCAN_RADAR_6226d902_Tx: CanIfTxPduCanId=282 if post-build-variant-condition{matching-criterion=RDR_POS, value=0}, CanIfTxPduId=59, CanIfTxPduCanId=410 if post-build-variant-condition{matching-criterion=RDR_POS, value=1}, CanIfTxPduCanId=538 if post-build-variant-condition{matching-criterion=RDR_POS, value=2}, CanIfTxPduCanId=666 if post-build-variant-condition{matching-criterion=RDR_POS, value=3}, CanIfTxPduCanId=794 if post-build-variant-condition{matching-criterion=RDR_POS, value=4}, CanIfTxPduCanId=922 if post-build-variant-condition{matching-criterion=RDR_POS, value=5}, CanIfTxPduCanId=1050 if post-build-variant-condition{matching-criterion=RDR_POS, value=6}, CanIfTxPduCanId=1178 if post-build-variant-condition{matching-criterion=RDR_POS, value=7}, CanIfTxPduRef=RDR_DETECTION_105_108_oPCAN_RADAR_83062976_Tx
        RDR_DETECTION_329_332_oPCAN_RADAR_3ea5d262_Tx: CanIfTxPduCanId=338 if post-build-variant-condition{matching-criterion=RDR_POS, value=0}, CanIfTxPduId=115, CanIfTxPduCanId=466 if post-build-variant-condition{matching-criterion=RDR_POS, value=1}, CanIfTxPduCanId=594 if post-build-variant-condition{matching-criterion=RDR_POS, value=2}, CanIfTxPduCanId=722 if post-build-variant-condition{matching-criterion=RDR_POS, value=3}, CanIfTxPduCanId=850 if post-build-variant-condition{matching-criterion=RDR_POS, value=4}, CanIfTxPduCanId=978 if post-build-variant-condition{matching-criterion=RDR_POS, value=5}, CanIfTxPduCanId=1106 if post-build-variant-condition{matching-criterion=RDR_POS, value=6}, CanIfTxPduCanId=1234 if post-build-variant-condition{matching-criterion=RDR_POS, value=7}, CanIfTxPduRef=RDR_DETECTION_329_332_oPCAN_RADAR_444a42d4_Tx
        RDR_TRACKER_OBJ_056_oPCAN_RADAR_378b5c02_Tx: CanIfTxPduCanId=1351 if post-build-variant-condition{matching-criterion=RDR_POS, value=0}, CanIfTxPduId=194, CanIfTxPduCanId=1415 if post-build-variant-condition{matching-criterion=RDR_POS, value=1}, CanIfTxPduCanId=1479 if post-build-variant-condition{matching-criterion=RDR_POS, value=2}, CanIfTxPduCanId=1543 if post-build-variant-condition{matching-criterion=RDR_POS, value=3}, CanIfTxPduCanId=1607 if post-build-variant-condition{matching-criterion=RDR_POS, value=4}, CanIfTxPduCanId=1671 if post-build-variant-condition{matching-criterion=RDR_POS, value=5}, CanIfTxPduCanId=1735 if post-build-variant-condition{matching-criterion=RDR_POS, value=6}, CanIfTxPduCanId=1799 if post-build-variant-condition{matching-criterion=RDR_POS, value=7}, CanIfTxPduRef=RDR_TRACKER_OBJ_056_oPCAN_RADAR_dd13cf35_Tx
        RDR_TRACKER_OBJ_054_oPCAN_RADAR_221fa750_Tx: CanIfTxPduCanId=1349 if post-build-variant-condition{matching-criterion=RDR_POS, value=0}, CanIfTxPduId=192, CanIfTxPduCanId=1413 if post-build-variant-condition{matching-criterion=RDR_POS, value=1}, CanIfTxPduCanId=1477 if post-build-variant-condition{matching-criterion=RDR_POS, value=2}, CanIfTxPduCanId=1541 if post-build-variant-condition{matching-criterion=RDR_POS, value=3}, CanIfTxPduCanId=1605 if post-build-variant-condition{matching-criterion=RDR_POS, value=4}, CanIfTxPduCanId=1669 if post-build-variant-condition{matching-criterion=RDR_POS, value=5}, CanIfTxPduCanId=1733 if post-build-variant-condition{matching-criterion=RDR_POS, value=6}, CanIfTxPduCanId=1797 if post-build-variant-condition{matching-criterion=RDR_POS, value=7}, CanIfTxPduRef=RDR_TRACKER_OBJ_054_oPCAN_RADAR_b0f6eed3_Tx
        RDR_DETECTION_045_048_oPCAN_RADAR_7141cb57_Tx: CanIfTxPduCanId=267 if post-build-variant-condition{matching-criterion=RDR_POS, value=0}, CanIfTxPduId=44, CanIfTxPduCanId=395 if post-build-variant-condition{matching-criterion=RDR_POS, value=1}, CanIfTxPduCanId=523 if post-build-variant-condition{matching-criterion=RDR_POS, value=2}, CanIfTxPduCanId=651 if post-build-variant-condition{matching-criterion=RDR_POS, value=3}, CanIfTxPduCanId=779 if post-build-variant-condition{matching-criterion=RDR_POS, value=4}, CanIfTxPduCanId=907 if post-build-variant-condition{matching-criterion=RDR_POS, value=5}, CanIfTxPduCanId=1035 if post-build-variant-condition{matching-criterion=RDR_POS, value=6}, CanIfTxPduCanId=1163 if post-build-variant-condition{matching-criterion=RDR_POS, value=7}, CanIfTxPduRef=RDR_DETECTION_045_048_oPCAN_RADAR_cba88c84_Tx
        RDR_TRACKER_OBJ_020_oPCAN_RADAR_f2d66ae1_Tx: CanIfTxPduCanId=1315 if post-build-variant-condition{matching-criterion=RDR_POS, value=0}, CanIfTxPduId=157, CanIfTxPduCanId=1379 if post-build-variant-condition{matching-criterion=RDR_POS, value=1}, CanIfTxPduCanId=1443 if post-build-variant-condition{matching-criterion=RDR_POS, value=2}, CanIfTxPduCanId=1507 if post-build-variant-condition{matching-criterion=RDR_POS, value=3}, CanIfTxPduCanId=1571 if post-build-variant-condition{matching-criterion=RDR_POS, value=4}, CanIfTxPduCanId=1635 if post-build-variant-condition{matching-criterion=RDR_POS, value=5}, CanIfTxPduCanId=1699 if post-build-variant-condition{matching-criterion=RDR_POS, value=6}, CanIfTxPduCanId=1763 if post-build-variant-condition{matching-criterion=RDR_POS, value=7}, CanIfTxPduRef=RDR_TRACKER_OBJ_020_oPCAN_RADAR_94b31a9d_Tx
        RDR_DETECTION_073_076_oPCAN_RADAR_18dc9bfd_Tx: CanIfTxPduCanId=274 if post-build-variant-condition{matching-criterion=RDR_POS, value=0}, CanIfTxPduId=51, CanIfTxPduCanId=402 if post-build-variant-condition{matching-criterion=RDR_POS, value=1}, CanIfTxPduCanId=530 if post-build-variant-condition{matching-criterion=RDR_POS, value=2}, CanIfTxPduCanId=658 if post-build-variant-condition{matching-criterion=RDR_POS, value=3}, CanIfTxPduCanId=786 if post-build-variant-condition{matching-criterion=RDR_POS, value=4}, CanIfTxPduCanId=914 if post-build-variant-condition{matching-criterion=RDR_POS, value=5}, CanIfTxPduCanId=1042 if post-build-variant-condition{matching-criterion=RDR_POS, value=6}, CanIfTxPduCanId=1170 if post-build-variant-condition{matching-criterion=RDR_POS, value=7}, CanIfTxPduRef=RDR_DETECTION_073_076_oPCAN_RADAR_85cee28a_Tx
        RDR_DETECTION_133_136_oPCAN_RADAR_0bbb89a8_Tx: CanIfTxPduCanId=289 if post-build-variant-condition{matching-criterion=RDR_POS, value=0}, CanIfTxPduId=66, CanIfTxPduCanId=417 if post-build-variant-condition{matching-criterion=RDR_POS, value=1}, CanIfTxPduCanId=545 if post-build-variant-condition{matching-criterion=RDR_POS, value=2}, CanIfTxPduCanId=673 if post-build-variant-condition{matching-criterion=RDR_POS, value=3}, CanIfTxPduCanId=801 if post-build-variant-condition{matching-criterion=RDR_POS, value=4}, CanIfTxPduCanId=929 if post-build-variant-condition{matching-criterion=RDR_POS, value=5}, CanIfTxPduCanId=1057 if post-build-variant-condition{matching-criterion=RDR_POS, value=6}, CanIfTxPduCanId=1185 if post-build-variant-condition{matching-criterion=RDR_POS, value=7}, CanIfTxPduRef=RDR_DETECTION_133_136_oPCAN_RADAR_cd604778_Tx
        RDR_TRACKER_OBJ_059_oPCAN_RADAR_55afc115_Tx: CanIfTxPduCanId=1354 if post-build-variant-condition{matching-criterion=RDR_POS, value=0}, CanIfTxPduId=197, CanIfTxPduCanId=1418 if post-build-variant-condition{matching-criterion=RDR_POS, value=1}, CanIfTxPduCanId=1482 if post-build-variant-condition{matching-criterion=RDR_POS, value=2}, CanIfTxPduCanId=1546 if post-build-variant-condition{matching-criterion=RDR_POS, value=3}, CanIfTxPduCanId=1610 if post-build-variant-condition{matching-criterion=RDR_POS, value=4}, CanIfTxPduCanId=1674 if post-build-variant-condition{matching-criterion=RDR_POS, value=5}, CanIfTxPduCanId=1738 if post-build-variant-condition{matching-criterion=RDR_POS, value=6}, CanIfTxPduCanId=1802 if post-build-variant-condition{matching-criterion=RDR_POS, value=7}, CanIfTxPduRef=RDR_TRACKER_OBJ_059_oPCAN_RADAR_312bbc35_Tx
        RDR_DETECTION_389_392_oPCAN_RADAR_5730c01d_Tx: CanIfTxPduCanId=353 if post-build-variant-condition{matching-criterion=RDR_POS, value=0}, CanIfTxPduId=130, CanIfTxPduCanId=481 if post-build-variant-condition{matching-criterion=RDR_POS, value=1}, CanIfTxPduCanId=609 if post-build-variant-condition{matching-criterion=RDR_POS, value=2}, CanIfTxPduCanId=737 if post-build-variant-condition{matching-criterion=RDR_POS, value=3}, CanIfTxPduCanId=865 if post-build-variant-condition{matching-criterion=RDR_POS, value=4}, CanIfTxPduCanId=993 if post-build-variant-condition{matching-criterion=RDR_POS, value=5}, CanIfTxPduCanId=1121 if post-build-variant-condition{matching-criterion=RDR_POS, value=6}, CanIfTxPduCanId=1249 if post-build-variant-condition{matching-criterion=RDR_POS, value=7}, CanIfTxPduRef=RDR_DETECTION_389_392_oPCAN_RADAR_852c685a_Tx
        RDR_TRACKER_OBJ_064_oPCAN_RADAR_086fd242_Tx: CanIfTxPduCanId=1359 if post-build-variant-condition{matching-criterion=RDR_POS, value=0}, CanIfTxPduId=202, CanIfTxPduCanId=1423 if post-build-variant-condition{matching-criterion=RDR_POS, value=1}, CanIfTxPduCanId=1487 if post-build-variant-condition{matching-criterion=RDR_POS, value=2}, CanIfTxPduCanId=1551 if post-build-variant-condition{matching-criterion=RDR_POS, value=3}, CanIfTxPduCanId=1615 if post-build-variant-condition{matching-criterion=RDR_POS, value=4}, CanIfTxPduCanId=1679 if post-build-variant-condition{matching-criterion=RDR_POS, value=5}, CanIfTxPduCanId=1743 if post-build-variant-condition{matching-criterion=RDR_POS, value=6}, CanIfTxPduCanId=1807 if post-build-variant-condition{matching-criterion=RDR_POS, value=7}, CanIfTxPduRef=RDR_TRACKER_OBJ_064_oPCAN_RADAR_dd701d89_Tx
        RDR_DETECTION_293_296_oPCAN_RADAR_afb14cbd_Tx: CanIfTxPduCanId=329 if post-build-variant-condition{matching-criterion=RDR_POS, value=0}, CanIfTxPduId=106, CanIfTxPduCanId=457 if post-build-variant-condition{matching-criterion=RDR_POS, value=1}, CanIfTxPduCanId=585 if post-build-variant-condition{matching-criterion=RDR_POS, value=2}, CanIfTxPduCanId=713 if post-build-variant-condition{matching-criterion=RDR_POS, value=3}, CanIfTxPduCanId=841 if post-build-variant-condition{matching-criterion=RDR_POS, value=4}, CanIfTxPduCanId=969 if post-build-variant-condition{matching-criterion=RDR_POS, value=5}, CanIfTxPduCanId=1097 if post-build-variant-condition{matching-criterion=RDR_POS, value=6}, CanIfTxPduCanId=1225 if post-build-variant-condition{matching-criterion=RDR_POS, value=7}, CanIfTxPduRef=RDR_DETECTION_293_296_oPCAN_RADAR_544e4f14_Tx
        RDR_DETECTION_373_376_oPCAN_RADAR_d5434c97_Tx: CanIfTxPduCanId=349 if post-build-variant-condition{matching-criterion=RDR_POS, value=0}, CanIfTxPduId=126, CanIfTxPduCanId=477 if post-build-variant-condition{matching-criterion=RDR_POS, value=1}, CanIfTxPduCanId=605 if post-build-variant-condition{matching-criterion=RDR_POS, value=2}, CanIfTxPduCanId=733 if post-build-variant-condition{matching-criterion=RDR_POS, value=3}, CanIfTxPduCanId=861 if post-build-variant-condition{matching-criterion=RDR_POS, value=4}, CanIfTxPduCanId=989 if post-build-variant-condition{matching-criterion=RDR_POS, value=5}, CanIfTxPduCanId=1117 if post-build-variant-condition{matching-criterion=RDR_POS, value=6}, CanIfTxPduCanId=1245 if post-build-variant-condition{matching-criterion=RDR_POS, value=7}, CanIfTxPduRef=RDR_DETECTION_373_376_oPCAN_RADAR_dd86c068_Tx
        RDR_TRACKER_OBJ_035_oPCAN_RADAR_7c3530dd_Tx: CanIfTxPduCanId=1330 if post-build-variant-condition{matching-criterion=RDR_POS, value=0}, CanIfTxPduId=172, CanIfTxPduCanId=1394 if post-build-variant-condition{matching-criterion=RDR_POS, value=1}, CanIfTxPduCanId=1458 if post-build-variant-condition{matching-criterion=RDR_POS, value=2}, CanIfTxPduCanId=1522 if post-build-variant-condition{matching-criterion=RDR_POS, value=3}, CanIfTxPduCanId=1586 if post-build-variant-condition{matching-criterion=RDR_POS, value=4}, CanIfTxPduCanId=1650 if post-build-variant-condition{matching-criterion=RDR_POS, value=5}, CanIfTxPduCanId=1714 if post-build-variant-condition{matching-criterion=RDR_POS, value=6}, CanIfTxPduCanId=1778 if post-build-variant-condition{matching-criterion=RDR_POS, value=7}, CanIfTxPduRef=RDR_TRACKER_OBJ_035_oPCAN_RADAR_5d099894_Tx
        RDR_DETECTION_213_216_oPCAN_RADAR_b6baf064_Tx: CanIfTxPduCanId=309 if post-build-variant-condition{matching-criterion=RDR_POS, value=0}, CanIfTxPduId=86, CanIfTxPduCanId=437 if post-build-variant-condition{matching-criterion=RDR_POS, value=1}, CanIfTxPduCanId=565 if post-build-variant-condition{matching-criterion=RDR_POS, value=2}, CanIfTxPduCanId=693 if post-build-variant-condition{matching-criterion=RDR_POS, value=3}, CanIfTxPduCanId=821 if post-build-variant-condition{matching-criterion=RDR_POS, value=4}, CanIfTxPduCanId=949 if post-build-variant-condition{matching-criterion=RDR_POS, value=5}, CanIfTxPduCanId=1077 if post-build-variant-condition{matching-criterion=RDR_POS, value=6}, CanIfTxPduCanId=1205 if post-build-variant-condition{matching-criterion=RDR_POS, value=7}, CanIfTxPduRef=RDR_DETECTION_213_216_oPCAN_RADAR_1c4c3a73_Tx
        RDR_DETECTION_297_300_oPCAN_RADAR_ae4c7b41_Tx: CanIfTxPduCanId=330 if post-build-variant-condition{matching-criterion=RDR_POS, value=0}, CanIfTxPduId=107, CanIfTxPduCanId=458 if post-build-variant-condition{matching-criterion=RDR_POS, value=1}, CanIfTxPduCanId=586 if post-build-variant-condition{matching-criterion=RDR_POS, value=2}, CanIfTxPduCanId=714 if post-build-variant-condition{matching-criterion=RDR_POS, value=3}, CanIfTxPduCanId=842 if post-build-variant-condition{matching-criterion=RDR_POS, value=4}, CanIfTxPduCanId=970 if post-build-variant-condition{matching-criterion=RDR_POS, value=5}, CanIfTxPduCanId=1098 if post-build-variant-condition{matching-criterion=RDR_POS, value=6}, CanIfTxPduCanId=1226 if post-build-variant-condition{matching-criterion=RDR_POS, value=7}, CanIfTxPduRef=RDR_DETECTION_297_300_oPCAN_RADAR_984db28e_Tx
        RDR_TRACKER_OBJ_049_oPCAN_RADAR_faaf1024_Tx: CanIfTxPduCanId=1344 if post-build-variant-condition{matching-criterion=RDR_POS, value=0}, CanIfTxPduId=187, CanIfTxPduCanId=1408 if post-build-variant-condition{matching-criterion=RDR_POS, value=1}, CanIfTxPduCanId=1472 if post-build-variant-condition{matching-criterion=RDR_POS, value=2}, CanIfTxPduCanId=1536 if post-build-variant-condition{matching-criterion=RDR_POS, value=3}, CanIfTxPduCanId=1600 if post-build-variant-condition{matching-criterion=RDR_POS, value=4}, CanIfTxPduCanId=1664 if post-build-variant-condition{matching-criterion=RDR_POS, value=5}, CanIfTxPduCanId=1728 if post-build-variant-condition{matching-criterion=RDR_POS, value=6}, CanIfTxPduCanId=1792 if post-build-variant-condition{matching-criterion=RDR_POS, value=7}, CanIfTxPduRef=RDR_TRACKER_OBJ_049_oPCAN_RADAR_15a9ed03_Tx
        RDR_DETECTION_229_232_oPCAN_RADAR_ccff9d7b_Tx: CanIfTxPduCanId=313 if post-build-variant-condition{matching-criterion=RDR_POS, value=0}, CanIfTxPduId=90, CanIfTxPduCanId=441 if post-build-variant-condition{matching-criterion=RDR_POS, value=1}, CanIfTxPduCanId=569 if post-build-variant-condition{matching-criterion=RDR_POS, value=2}, CanIfTxPduCanId=697 if post-build-variant-condition{matching-criterion=RDR_POS, value=3}, CanIfTxPduCanId=825 if post-build-variant-condition{matching-criterion=RDR_POS, value=4}, CanIfTxPduCanId=953 if post-build-variant-condition{matching-criterion=RDR_POS, value=5}, CanIfTxPduCanId=1081 if post-build-variant-condition{matching-criterion=RDR_POS, value=6}, CanIfTxPduCanId=1209 if post-build-variant-condition{matching-criterion=RDR_POS, value=7}, CanIfTxPduRef=RDR_DETECTION_229_232_oPCAN_RADAR_c55d5eb5_Tx
        RDR_DETECTION_069_072_oPCAN_RADAR_12075844_Tx: CanIfTxPduCanId=273 if post-build-variant-condition{matching-criterion=RDR_POS, value=0}, CanIfTxPduId=50, CanIfTxPduCanId=401 if post-build-variant-condition{matching-criterion=RDR_POS, value=1}, CanIfTxPduCanId=529 if post-build-variant-condition{matching-criterion=RDR_POS, value=2}, CanIfTxPduCanId=657 if post-build-variant-condition{matching-criterion=RDR_POS, value=3}, CanIfTxPduCanId=785 if post-build-variant-condition{matching-criterion=RDR_POS, value=4}, CanIfTxPduCanId=913 if post-build-variant-condition{matching-criterion=RDR_POS, value=5}, CanIfTxPduCanId=1041 if post-build-variant-condition{matching-criterion=RDR_POS, value=6}, CanIfTxPduCanId=1169 if post-build-variant-condition{matching-criterion=RDR_POS, value=7}, CanIfTxPduRef=RDR_DETECTION_069_072_oPCAN_RADAR_d5bbd9a5_Tx
        RDR_DETECTION_189_192_oPCAN_RADAR_68f5586e_Tx: CanIfTxPduCanId=303 if post-build-variant-condition{matching-criterion=RDR_POS, value=0}, CanIfTxPduId=80, CanIfTxPduCanId=431 if post-build-variant-condition{matching-criterion=RDR_POS, value=1}, CanIfTxPduCanId=559 if post-build-variant-condition{matching-criterion=RDR_POS, value=2}, CanIfTxPduCanId=687 if post-build-variant-condition{matching-criterion=RDR_POS, value=3}, CanIfTxPduCanId=815 if post-build-variant-condition{matching-criterion=RDR_POS, value=4}, CanIfTxPduCanId=943 if post-build-variant-condition{matching-criterion=RDR_POS, value=5}, CanIfTxPduCanId=1071 if post-build-variant-condition{matching-criterion=RDR_POS, value=6}, CanIfTxPduCanId=1199 if post-build-variant-condition{matching-criterion=RDR_POS, value=7}, CanIfTxPduRef=RDR_DETECTION_189_192_oPCAN_RADAR_5c7356d9_Tx
        RDR_TRACKER_OBJ_008_oPCAN_RADAR_21f5238a_Tx: CanIfTxPduCanId=1303 if post-build-variant-condition{matching-criterion=RDR_POS, value=0}, CanIfTxPduId=145, CanIfTxPduCanId=1367 if post-build-variant-condition{matching-criterion=RDR_POS, value=1}, CanIfTxPduCanId=1431 if post-build-variant-condition{matching-criterion=RDR_POS, value=2}, CanIfTxPduCanId=1495 if post-build-variant-condition{matching-criterion=RDR_POS, value=3}, CanIfTxPduCanId=1559 if post-build-variant-condition{matching-criterion=RDR_POS, value=4}, CanIfTxPduCanId=1623 if post-build-variant-condition{matching-criterion=RDR_POS, value=5}, CanIfTxPduCanId=1687 if post-build-variant-condition{matching-criterion=RDR_POS, value=6}, CanIfTxPduCanId=1751 if post-build-variant-condition{matching-criterion=RDR_POS, value=7}, CanIfTxPduRef=RDR_TRACKER_OBJ_008_oPCAN_RADAR_b1523928_Tx
        RDR_DETECTION_277_280_oPCAN_RADAR_65ca4ad9_Tx: CanIfTxPduCanId=325 if post-build-variant-condition{matching-criterion=RDR_POS, value=0}, CanIfTxPduId=102, CanIfTxPduCanId=453 if post-build-variant-condition{matching-criterion=RDR_POS, value=1}, CanIfTxPduCanId=581 if post-build-variant-condition{matching-criterion=RDR_POS, value=2}, CanIfTxPduCanId=709 if post-build-variant-condition{matching-criterion=RDR_POS, value=3}, CanIfTxPduCanId=837 if post-build-variant-condition{matching-criterion=RDR_POS, value=4}, CanIfTxPduCanId=965 if post-build-variant-condition{matching-criterion=RDR_POS, value=5}, CanIfTxPduCanId=1093 if post-build-variant-condition{matching-criterion=RDR_POS, value=6}, CanIfTxPduCanId=1221 if post-build-variant-condition{matching-criterion=RDR_POS, value=7}, CanIfTxPduRef=RDR_DETECTION_277_280_oPCAN_RADAR_8401d0ef_Tx
        RDR_DETECTION_349_352_oPCAN_RADAR_af062188_Tx: CanIfTxPduCanId=343 if post-build-variant-condition{matching-criterion=RDR_POS, value=0}, CanIfTxPduId=120, CanIfTxPduCanId=471 if post-build-variant-condition{matching-criterion=RDR_POS, value=1}, CanIfTxPduCanId=599 if post-build-variant-condition{matching-criterion=RDR_POS, value=2}, CanIfTxPduCanId=727 if post-build-variant-condition{matching-criterion=RDR_POS, value=3}, CanIfTxPduCanId=855 if post-build-variant-condition{matching-criterion=RDR_POS, value=4}, CanIfTxPduCanId=983 if post-build-variant-condition{matching-criterion=RDR_POS, value=5}, CanIfTxPduCanId=1111 if post-build-variant-condition{matching-criterion=RDR_POS, value=6}, CanIfTxPduCanId=1239 if post-build-variant-condition{matching-criterion=RDR_POS, value=7}, CanIfTxPduRef=RDR_DETECTION_349_352_oPCAN_RADAR_0497a4ae_Tx
        RDR_TRACKER_OBJ_026_oPCAN_RADAR_cc6b6717_Tx: CanIfTxPduCanId=1321 if post-build-variant-condition{matching-criterion=RDR_POS, value=0}, CanIfTxPduId=163, CanIfTxPduCanId=1385 if post-build-variant-condition{matching-criterion=RDR_POS, value=1}, CanIfTxPduCanId=1449 if post-build-variant-condition{matching-criterion=RDR_POS, value=2}, CanIfTxPduCanId=1513 if post-build-variant-condition{matching-criterion=RDR_POS, value=3}, CanIfTxPduCanId=1577 if post-build-variant-condition{matching-criterion=RDR_POS, value=4}, CanIfTxPduCanId=1641 if post-build-variant-condition{matching-criterion=RDR_POS, value=5}, CanIfTxPduCanId=1705 if post-build-variant-condition{matching-criterion=RDR_POS, value=6}, CanIfTxPduCanId=1769 if post-build-variant-condition{matching-criterion=RDR_POS, value=7}, CanIfTxPduRef=RDR_TRACKER_OBJ_026_oPCAN_RADAR_229c78b7_Tx
        RDR_TRACKER_OBJ_047_oPCAN_RADAR_9241f09a_Tx: CanIfTxPduCanId=1342 if post-build-variant-condition{matching-criterion=RDR_POS, value=0}, CanIfTxPduId=185, CanIfTxPduCanId=1406 if post-build-variant-condition{matching-criterion=RDR_POS, value=1}, CanIfTxPduCanId=1470 if post-build-variant-condition{matching-criterion=RDR_POS, value=2}, CanIfTxPduCanId=1534 if post-build-variant-condition{matching-criterion=RDR_POS, value=3}, CanIfTxPduCanId=1598 if post-build-variant-condition{matching-criterion=RDR_POS, value=4}, CanIfTxPduCanId=1662 if post-build-variant-condition{matching-criterion=RDR_POS, value=5}, CanIfTxPduCanId=1726 if post-build-variant-condition{matching-criterion=RDR_POS, value=6}, CanIfTxPduCanId=1790 if post-build-variant-condition{matching-criterion=RDR_POS, value=7}, CanIfTxPduRef=RDR_TRACKER_OBJ_047_oPCAN_RADAR_cf630ef0_Tx
        RDR_DETECTION_325_328_oPCAN_RADAR_2d7defd7_Tx: CanIfTxPduCanId=337 if post-build-variant-condition{matching-criterion=RDR_POS, value=0}, CanIfTxPduId=114, CanIfTxPduCanId=465 if post-build-variant-condition{matching-criterion=RDR_POS, value=1}, CanIfTxPduCanId=593 if post-build-variant-condition{matching-criterion=RDR_POS, value=2}, CanIfTxPduCanId=721 if post-build-variant-condition{matching-criterion=RDR_POS, value=3}, CanIfTxPduCanId=849 if post-build-variant-condition{matching-criterion=RDR_POS, value=4}, CanIfTxPduCanId=977 if post-build-variant-condition{matching-criterion=RDR_POS, value=5}, CanIfTxPduCanId=1105 if post-build-variant-condition{matching-criterion=RDR_POS, value=6}, CanIfTxPduCanId=1233 if post-build-variant-condition{matching-criterion=RDR_POS, value=7}, CanIfTxPduRef=RDR_DETECTION_325_328_oPCAN_RADAR_d33d481c_Tx
        RDR_TRACKER_OBJ_044_oPCAN_RADAR_8d1f7661_Tx: CanIfTxPduCanId=1339 if post-build-variant-condition{matching-criterion=RDR_POS, value=0}, CanIfTxPduId=182, CanIfTxPduCanId=1403 if post-build-variant-condition{matching-criterion=RDR_POS, value=1}, CanIfTxPduCanId=1467 if post-build-variant-condition{matching-criterion=RDR_POS, value=2}, CanIfTxPduCanId=1531 if post-build-variant-condition{matching-criterion=RDR_POS, value=3}, CanIfTxPduCanId=1595 if post-build-variant-condition{matching-criterion=RDR_POS, value=4}, CanIfTxPduCanId=1659 if post-build-variant-condition{matching-criterion=RDR_POS, value=5}, CanIfTxPduCanId=1723 if post-build-variant-condition{matching-criterion=RDR_POS, value=6}, CanIfTxPduCanId=1787 if post-build-variant-condition{matching-criterion=RDR_POS, value=7}, CanIfTxPduRef=RDR_TRACKER_OBJ_044_oPCAN_RADAR_9474bfe5_Tx
        RDR_TRACKER_OBJ_050_oPCAN_RADAR_093651f4_Tx: CanIfTxPduCanId=1345 if post-build-variant-condition{matching-criterion=RDR_POS, value=0}, CanIfTxPduId=188, CanIfTxPduCanId=1409 if post-build-variant-condition{matching-criterion=RDR_POS, value=1}, CanIfTxPduCanId=1473 if post-build-variant-condition{matching-criterion=RDR_POS, value=2}, CanIfTxPduCanId=1537 if post-build-variant-condition{matching-criterion=RDR_POS, value=3}, CanIfTxPduCanId=1601 if post-build-variant-condition{matching-criterion=RDR_POS, value=4}, CanIfTxPduCanId=1665 if post-build-variant-condition{matching-criterion=RDR_POS, value=5}, CanIfTxPduCanId=1729 if post-build-variant-condition{matching-criterion=RDR_POS, value=6}, CanIfTxPduCanId=1793 if post-build-variant-condition{matching-criterion=RDR_POS, value=7}, CanIfTxPduRef=RDR_TRACKER_OBJ_050_oPCAN_RADAR_6b3cad1f_Tx
        RDR_DETECTION_145_148_oPCAN_RADAR_831b844e_Tx: CanIfTxPduCanId=292 if post-build-variant-condition{matching-criterion=RDR_POS, value=0}, CanIfTxPduId=69, CanIfTxPduCanId=420 if post-build-variant-condition{matching-criterion=RDR_POS, value=1}, CanIfTxPduCanId=548 if post-build-variant-condition{matching-criterion=RDR_POS, value=2}, CanIfTxPduCanId=676 if post-build-variant-condition{matching-criterion=RDR_POS, value=3}, CanIfTxPduCanId=804 if post-build-variant-condition{matching-criterion=RDR_POS, value=4}, CanIfTxPduCanId=932 if post-build-variant-condition{matching-criterion=RDR_POS, value=5}, CanIfTxPduCanId=1060 if post-build-variant-condition{matching-criterion=RDR_POS, value=6}, CanIfTxPduCanId=1188 if post-build-variant-condition{matching-criterion=RDR_POS, value=7}, CanIfTxPduRef=RDR_DETECTION_145_148_oPCAN_RADAR_4abf90e5_Tx
        RDR_DETECTION_061_064_oPCAN_RADAR_d4c9e5ab_Tx: CanIfTxPduCanId=271 if post-build-variant-condition{matching-criterion=RDR_POS, value=0}, CanIfTxPduId=48, CanIfTxPduCanId=399 if post-build-variant-condition{matching-criterion=RDR_POS, value=1}, CanIfTxPduCanId=527 if post-build-variant-condition{matching-criterion=RDR_POS, value=2}, CanIfTxPduCanId=655 if post-build-variant-condition{matching-criterion=RDR_POS, value=3}, CanIfTxPduCanId=783 if post-build-variant-condition{matching-criterion=RDR_POS, value=4}, CanIfTxPduCanId=911 if post-build-variant-condition{matching-criterion=RDR_POS, value=5}, CanIfTxPduCanId=1039 if post-build-variant-condition{matching-criterion=RDR_POS, value=6}, CanIfTxPduCanId=1167 if post-build-variant-condition{matching-criterion=RDR_POS, value=7}, CanIfTxPduRef=RDR_DETECTION_061_064_oPCAN_RADAR_9bb047c7_Tx
        RDR_DETECTION_321_324_oPCAN_RADAR_f86b6f8d_Tx: CanIfTxPduCanId=336 if post-build-variant-condition{matching-criterion=RDR_POS, value=0}, CanIfTxPduId=113, CanIfTxPduCanId=464 if post-build-variant-condition{matching-criterion=RDR_POS, value=1}, CanIfTxPduCanId=592 if post-build-variant-condition{matching-criterion=RDR_POS, value=2}, CanIfTxPduCanId=720 if post-build-variant-condition{matching-criterion=RDR_POS, value=3}, CanIfTxPduCanId=848 if post-build-variant-condition{matching-criterion=RDR_POS, value=4}, CanIfTxPduCanId=976 if post-build-variant-condition{matching-criterion=RDR_POS, value=5}, CanIfTxPduCanId=1104 if post-build-variant-condition{matching-criterion=RDR_POS, value=6}, CanIfTxPduCanId=1232 if post-build-variant-condition{matching-criterion=RDR_POS, value=7}, CanIfTxPduRef=RDR_DETECTION_321_324_oPCAN_RADAR_0a41dcb6_Tx
        RDR_TRACKER_OBJ_003_oPCAN_RADAR_68f84839_Tx: CanIfTxPduCanId=1298 if post-build-variant-condition{matching-criterion=RDR_POS, value=0}, CanIfTxPduId=140, CanIfTxPduCanId=1362 if post-build-variant-condition{matching-criterion=RDR_POS, value=1}, CanIfTxPduCanId=1426 if post-build-variant-condition{matching-criterion=RDR_POS, value=2}, CanIfTxPduCanId=1490 if post-build-variant-condition{matching-criterion=RDR_POS, value=3}, CanIfTxPduCanId=1554 if post-build-variant-condition{matching-criterion=RDR_POS, value=4}, CanIfTxPduCanId=1618 if post-build-variant-condition{matching-criterion=RDR_POS, value=5}, CanIfTxPduCanId=1682 if post-build-variant-condition{matching-criterion=RDR_POS, value=6}, CanIfTxPduCanId=1746 if post-build-variant-condition{matching-criterion=RDR_POS, value=7}, CanIfTxPduRef=RDR_TRACKER_OBJ_003_oPCAN_RADAR_86a009e4_Tx
        RDR_DETECTION_081_084_oPCAN_RADAR_5c61aa98_Tx: CanIfTxPduCanId=276 if post-build-variant-condition{matching-criterion=RDR_POS, value=0}, CanIfTxPduId=53, CanIfTxPduCanId=404 if post-build-variant-condition{matching-criterion=RDR_POS, value=1}, CanIfTxPduCanId=532 if post-build-variant-condition{matching-criterion=RDR_POS, value=2}, CanIfTxPduCanId=660 if post-build-variant-condition{matching-criterion=RDR_POS, value=3}, CanIfTxPduCanId=788 if post-build-variant-condition{matching-criterion=RDR_POS, value=4}, CanIfTxPduCanId=916 if post-build-variant-condition{matching-criterion=RDR_POS, value=5}, CanIfTxPduCanId=1044 if post-build-variant-condition{matching-criterion=RDR_POS, value=6}, CanIfTxPduCanId=1172 if post-build-variant-condition{matching-criterion=RDR_POS, value=7}, CanIfTxPduRef=RDR_DETECTION_081_084_oPCAN_RADAR_936fd4da_Tx
        RDR_DETECTION_129_132_oPCAN_RADAR_01604a11_Tx: CanIfTxPduCanId=288 if post-build-variant-condition{matching-criterion=RDR_POS, value=0}, CanIfTxPduId=65, CanIfTxPduCanId=416 if post-build-variant-condition{matching-criterion=RDR_POS, value=1}, CanIfTxPduCanId=544 if post-build-variant-condition{matching-criterion=RDR_POS, value=2}, CanIfTxPduCanId=672 if post-build-variant-condition{matching-criterion=RDR_POS, value=3}, CanIfTxPduCanId=800 if post-build-variant-condition{matching-criterion=RDR_POS, value=4}, CanIfTxPduCanId=928 if post-build-variant-condition{matching-criterion=RDR_POS, value=5}, CanIfTxPduCanId=1056 if post-build-variant-condition{matching-criterion=RDR_POS, value=6}, CanIfTxPduCanId=1184 if post-build-variant-condition{matching-criterion=RDR_POS, value=7}, CanIfTxPduRef=RDR_DETECTION_129_132_oPCAN_RADAR_9d157c57_Tx
        RDR_DETECTION_281_284_oPCAN_RADAR_63a432eb_Tx: CanIfTxPduCanId=326 if post-build-variant-condition{matching-criterion=RDR_POS, value=0}, CanIfTxPduId=103, CanIfTxPduCanId=454 if post-build-variant-condition{matching-criterion=RDR_POS, value=1}, CanIfTxPduCanId=582 if post-build-variant-condition{matching-criterion=RDR_POS, value=2}, CanIfTxPduCanId=710 if post-build-variant-condition{matching-criterion=RDR_POS, value=3}, CanIfTxPduCanId=838 if post-build-variant-condition{matching-criterion=RDR_POS, value=4}, CanIfTxPduCanId=966 if post-build-variant-condition{matching-criterion=RDR_POS, value=5}, CanIfTxPduCanId=1094 if post-build-variant-condition{matching-criterion=RDR_POS, value=6}, CanIfTxPduCanId=1222 if post-build-variant-condition{matching-criterion=RDR_POS, value=7}, CanIfTxPduRef=RDR_DETECTION_281_284_oPCAN_RADAR_4a30ea59_Tx
        RDR_DETECTION_269_272_oPCAN_RADAR_2dc2c037_Tx: CanIfTxPduCanId=323 if post-build-variant-condition{matching-criterion=RDR_POS, value=0}, CanIfTxPduId=100, CanIfTxPduCanId=451 if post-build-variant-condition{matching-criterion=RDR_POS, value=1}, CanIfTxPduCanId=579 if post-build-variant-condition{matching-criterion=RDR_POS, value=2}, CanIfTxPduCanId=707 if post-build-variant-condition{matching-criterion=RDR_POS, value=3}, CanIfTxPduCanId=835 if post-build-variant-condition{matching-criterion=RDR_POS, value=4}, CanIfTxPduCanId=963 if post-build-variant-condition{matching-criterion=RDR_POS, value=5}, CanIfTxPduCanId=1091 if post-build-variant-condition{matching-criterion=RDR_POS, value=6}, CanIfTxPduCanId=1219 if post-build-variant-condition{matching-criterion=RDR_POS, value=7}, CanIfTxPduRef=RDR_DETECTION_269_272_oPCAN_RADAR_0ce4e726_Tx
        RDR_TRACKER_OBJ_061_oPCAN_RADAR_298c594f_Tx: CanIfTxPduCanId=1356 if post-build-variant-condition{matching-criterion=RDR_POS, value=0}, CanIfTxPduId=199, CanIfTxPduCanId=1420 if post-build-variant-condition{matching-criterion=RDR_POS, value=1}, CanIfTxPduCanId=1484 if post-build-variant-condition{matching-criterion=RDR_POS, value=2}, CanIfTxPduCanId=1548 if post-build-variant-condition{matching-criterion=RDR_POS, value=3}, CanIfTxPduCanId=1612 if post-build-variant-condition{matching-criterion=RDR_POS, value=4}, CanIfTxPduCanId=1676 if post-build-variant-condition{matching-criterion=RDR_POS, value=5}, CanIfTxPduCanId=1740 if post-build-variant-condition{matching-criterion=RDR_POS, value=6}, CanIfTxPduCanId=1804 if post-build-variant-condition{matching-criterion=RDR_POS, value=7}, CanIfTxPduRef=RDR_TRACKER_OBJ_061_oPCAN_RADAR_3048ceb6_Tx
        RDR_DETECTION_221_224_oPCAN_RADAR_0a312094_Tx: CanIfTxPduCanId=311 if post-build-variant-condition{matching-criterion=RDR_POS, value=0}, CanIfTxPduId=88, CanIfTxPduCanId=439 if post-build-variant-condition{matching-criterion=RDR_POS, value=1}, CanIfTxPduCanId=567 if post-build-variant-condition{matching-criterion=RDR_POS, value=2}, CanIfTxPduCanId=695 if post-build-variant-condition{matching-criterion=RDR_POS, value=3}, CanIfTxPduCanId=823 if post-build-variant-condition{matching-criterion=RDR_POS, value=4}, CanIfTxPduCanId=951 if post-build-variant-condition{matching-criterion=RDR_POS, value=5}, CanIfTxPduCanId=1079 if post-build-variant-condition{matching-criterion=RDR_POS, value=6}, CanIfTxPduCanId=1207 if post-build-variant-condition{matching-criterion=RDR_POS, value=7}, CanIfTxPduRef=RDR_DETECTION_221_224_oPCAN_RADAR_8b56c0d7_Tx
        RDR_OBJ_HEADER_002_oPCAN_RADAR_0a1b3262_Tx: CanIfTxPduCanId=129 if post-build-variant-condition{matching-criterion=RDR_POS, value=0}, CanIfTxPduId=134, CanIfTxPduCanId=137 if post-build-variant-condition{matching-criterion=RDR_POS, value=1}, CanIfTxPduCanId=145 if post-build-variant-condition{matching-criterion=RDR_POS, value=2}, CanIfTxPduCanId=153 if post-build-variant-condition{matching-criterion=RDR_POS, value=3}, CanIfTxPduCanId=161 if post-build-variant-condition{matching-criterion=RDR_POS, value=4}, CanIfTxPduCanId=169 if post-build-variant-condition{matching-criterion=RDR_POS, value=5}, CanIfTxPduCanId=177 if post-build-variant-condition{matching-criterion=RDR_POS, value=6}, CanIfTxPduCanId=185 if post-build-variant-condition{matching-criterion=RDR_POS, value=7}, CanIfTxPduRef=RDR_OBJ_HEADER_002_oPCAN_RADAR_018ea437_Tx
        RDR_TRACKER_OBJ_062_oPCAN_RADAR_36d2dfb4_Tx: CanIfTxPduCanId=1357 if post-build-variant-condition{matching-criterion=RDR_POS, value=0}, CanIfTxPduId=200, CanIfTxPduCanId=1421 if post-build-variant-condition{matching-criterion=RDR_POS, value=1}, CanIfTxPduCanId=1485 if post-build-variant-condition{matching-criterion=RDR_POS, value=2}, CanIfTxPduCanId=1549 if post-build-variant-condition{matching-criterion=RDR_POS, value=3}, CanIfTxPduCanId=1613 if post-build-variant-condition{matching-criterion=RDR_POS, value=4}, CanIfTxPduCanId=1677 if post-build-variant-condition{matching-criterion=RDR_POS, value=5}, CanIfTxPduCanId=1741 if post-build-variant-condition{matching-criterion=RDR_POS, value=6}, CanIfTxPduCanId=1805 if post-build-variant-condition{matching-criterion=RDR_POS, value=7}, CanIfTxPduRef=RDR_TRACKER_OBJ_062_oPCAN_RADAR_6b5f7fa3_Tx
        RDR_DETECTION_197_200_oPCAN_RADAR_baf2dbc8_Tx: CanIfTxPduCanId=305 if post-build-variant-condition{matching-criterion=RDR_POS, value=0}, CanIfTxPduId=82, CanIfTxPduCanId=433 if post-build-variant-condition{matching-criterion=RDR_POS, value=1}, CanIfTxPduCanId=561 if post-build-variant-condition{matching-criterion=RDR_POS, value=2}, CanIfTxPduCanId=689 if post-build-variant-condition{matching-criterion=RDR_POS, value=3}, CanIfTxPduCanId=817 if post-build-variant-condition{matching-criterion=RDR_POS, value=4}, CanIfTxPduCanId=945 if post-build-variant-condition{matching-criterion=RDR_POS, value=5}, CanIfTxPduCanId=1073 if post-build-variant-condition{matching-criterion=RDR_POS, value=6}, CanIfTxPduCanId=1201 if post-build-variant-condition{matching-criterion=RDR_POS, value=7}, CanIfTxPduRef=RDR_DETECTION_197_200_oPCAN_RADAR_8448b9bd_Tx
        RDR_TRACKER_OBJ_048_oPCAN_RADAR_f0656d8d_Tx: CanIfTxPduCanId=1343 if post-build-variant-condition{matching-criterion=RDR_POS, value=0}, CanIfTxPduId=186, CanIfTxPduCanId=1407 if post-build-variant-condition{matching-criterion=RDR_POS, value=1}, CanIfTxPduCanId=1471 if post-build-variant-condition{matching-criterion=RDR_POS, value=2}, CanIfTxPduCanId=1535 if post-build-variant-condition{matching-criterion=RDR_POS, value=3}, CanIfTxPduCanId=1599 if post-build-variant-condition{matching-criterion=RDR_POS, value=4}, CanIfTxPduCanId=1663 if post-build-variant-condition{matching-criterion=RDR_POS, value=5}, CanIfTxPduCanId=1727 if post-build-variant-condition{matching-criterion=RDR_POS, value=6}, CanIfTxPduCanId=1791 if post-build-variant-condition{matching-criterion=RDR_POS, value=7}, CanIfTxPduRef=RDR_TRACKER_OBJ_048_oPCAN_RADAR_235b7df0_Tx
        RDR_DETECTION_025_028_oPCAN_RADAR_e0e238bd_Tx: CanIfTxPduCanId=262 if post-build-variant-condition{matching-criterion=RDR_POS, value=0}, CanIfTxPduId=39, CanIfTxPduCanId=390 if post-build-variant-condition{matching-criterion=RDR_POS, value=1}, CanIfTxPduCanId=518 if post-build-variant-condition{matching-criterion=RDR_POS, value=2}, CanIfTxPduCanId=646 if post-build-variant-condition{matching-criterion=RDR_POS, value=3}, CanIfTxPduCanId=774 if post-build-variant-condition{matching-criterion=RDR_POS, value=4}, CanIfTxPduCanId=902 if post-build-variant-condition{matching-criterion=RDR_POS, value=5}, CanIfTxPduCanId=1030 if post-build-variant-condition{matching-criterion=RDR_POS, value=6}, CanIfTxPduCanId=1158 if post-build-variant-condition{matching-criterion=RDR_POS, value=7}, CanIfTxPduRef=RDR_DETECTION_025_028_oPCAN_RADAR_8b756afe_Tx
        RDR_TRACKER_OBJ_021_oPCAN_RADAR_f81c1748_Tx: CanIfTxPduCanId=1316 if post-build-variant-condition{matching-criterion=RDR_POS, value=0}, CanIfTxPduId=158, CanIfTxPduCanId=1380 if post-build-variant-condition{matching-criterion=RDR_POS, value=1}, CanIfTxPduCanId=1444 if post-build-variant-condition{matching-criterion=RDR_POS, value=2}, CanIfTxPduCanId=1508 if post-build-variant-condition{matching-criterion=RDR_POS, value=3}, CanIfTxPduCanId=1572 if post-build-variant-condition{matching-criterion=RDR_POS, value=4}, CanIfTxPduCanId=1636 if post-build-variant-condition{matching-criterion=RDR_POS, value=5}, CanIfTxPduCanId=1700 if post-build-variant-condition{matching-criterion=RDR_POS, value=6}, CanIfTxPduCanId=1764 if post-build-variant-condition{matching-criterion=RDR_POS, value=7}, CanIfTxPduRef=RDR_TRACKER_OBJ_021_oPCAN_RADAR_a2418a6e_Tx
        RDR_DETECTION_185_188_oPCAN_RADAR_7b2d65db_Tx: CanIfTxPduCanId=302 if post-build-variant-condition{matching-criterion=RDR_POS, value=0}, CanIfTxPduId=79, CanIfTxPduCanId=430 if post-build-variant-condition{matching-criterion=RDR_POS, value=1}, CanIfTxPduCanId=558 if post-build-variant-condition{matching-criterion=RDR_POS, value=2}, CanIfTxPduCanId=686 if post-build-variant-condition{matching-criterion=RDR_POS, value=3}, CanIfTxPduCanId=814 if post-build-variant-condition{matching-criterion=RDR_POS, value=4}, CanIfTxPduCanId=942 if post-build-variant-condition{matching-criterion=RDR_POS, value=5}, CanIfTxPduCanId=1070 if post-build-variant-condition{matching-criterion=RDR_POS, value=6}, CanIfTxPduCanId=1198 if post-build-variant-condition{matching-criterion=RDR_POS, value=7}, CanIfTxPduRef=RDR_DETECTION_185_188_oPCAN_RADAR_cb045c11_Tx
        RDR_DETECTION_041_044_oPCAN_RADAR_a4574b0d_Tx: CanIfTxPduCanId=266 if post-build-variant-condition{matching-criterion=RDR_POS, value=0}, CanIfTxPduId=43, CanIfTxPduCanId=394 if post-build-variant-condition{matching-criterion=RDR_POS, value=1}, CanIfTxPduCanId=522 if post-build-variant-condition{matching-criterion=RDR_POS, value=2}, CanIfTxPduCanId=650 if post-build-variant-condition{matching-criterion=RDR_POS, value=3}, CanIfTxPduCanId=778 if post-build-variant-condition{matching-criterion=RDR_POS, value=4}, CanIfTxPduCanId=906 if post-build-variant-condition{matching-criterion=RDR_POS, value=5}, CanIfTxPduCanId=1034 if post-build-variant-condition{matching-criterion=RDR_POS, value=6}, CanIfTxPduCanId=1162 if post-build-variant-condition{matching-criterion=RDR_POS, value=7}, CanIfTxPduRef=RDR_DETECTION_041_044_oPCAN_RADAR_12d4182e_Tx
        RDR_DETECTION_141_144_oPCAN_RADAR_560d0414_Tx: CanIfTxPduCanId=291 if post-build-variant-condition{matching-criterion=RDR_POS, value=0}, CanIfTxPduId=68, CanIfTxPduCanId=419 if post-build-variant-condition{matching-criterion=RDR_POS, value=1}, CanIfTxPduCanId=547 if post-build-variant-condition{matching-criterion=RDR_POS, value=2}, CanIfTxPduCanId=675 if post-build-variant-condition{matching-criterion=RDR_POS, value=3}, CanIfTxPduCanId=803 if post-build-variant-condition{matching-criterion=RDR_POS, value=4}, CanIfTxPduCanId=931 if post-build-variant-condition{matching-criterion=RDR_POS, value=5}, CanIfTxPduCanId=1059 if post-build-variant-condition{matching-criterion=RDR_POS, value=6}, CanIfTxPduCanId=1187 if post-build-variant-condition{matching-criterion=RDR_POS, value=7}, CanIfTxPduRef=RDR_DETECTION_141_144_oPCAN_RADAR_93c3044f_Tx
        RDR_TRACKER_OBJ_053_oPCAN_RADAR_1668d70f_Tx: CanIfTxPduCanId=1348 if post-build-variant-condition{matching-criterion=RDR_POS, value=0}, CanIfTxPduId=191, CanIfTxPduCanId=1412 if post-build-variant-condition{matching-criterion=RDR_POS, value=1}, CanIfTxPduCanId=1476 if post-build-variant-condition{matching-criterion=RDR_POS, value=2}, CanIfTxPduCanId=1540 if post-build-variant-condition{matching-criterion=RDR_POS, value=3}, CanIfTxPduCanId=1604 if post-build-variant-condition{matching-criterion=RDR_POS, value=4}, CanIfTxPduCanId=1668 if post-build-variant-condition{matching-criterion=RDR_POS, value=5}, CanIfTxPduCanId=1732 if post-build-variant-condition{matching-criterion=RDR_POS, value=6}, CanIfTxPduCanId=1796 if post-build-variant-condition{matching-criterion=RDR_POS, value=7}, CanIfTxPduRef=RDR_TRACKER_OBJ_053_oPCAN_RADAR_302b1c0a_Tx
        RDR_DETECTION_393_396_oPCAN_RADAR_5deb03a4_Tx: CanIfTxPduCanId=354 if post-build-variant-condition{matching-criterion=RDR_POS, value=0}, CanIfTxPduId=131, CanIfTxPduCanId=482 if post-build-variant-condition{matching-criterion=RDR_POS, value=1}, CanIfTxPduCanId=610 if post-build-variant-condition{matching-criterion=RDR_POS, value=2}, CanIfTxPduCanId=738 if post-build-variant-condition{matching-criterion=RDR_POS, value=3}, CanIfTxPduCanId=866 if post-build-variant-condition{matching-criterion=RDR_POS, value=4}, CanIfTxPduCanId=994 if post-build-variant-condition{matching-criterion=RDR_POS, value=5}, CanIfTxPduCanId=1122 if post-build-variant-condition{matching-criterion=RDR_POS, value=6}, CanIfTxPduCanId=1250 if post-build-variant-condition{matching-criterion=RDR_POS, value=7}, CanIfTxPduRef=RDR_DETECTION_393_396_oPCAN_RADAR_d5595375_Tx
        RDR_DETECTION_169_172_oPCAN_RADAR_e05d175d_Tx: CanIfTxPduCanId=298 if post-build-variant-condition{matching-criterion=RDR_POS, value=0}, CanIfTxPduId=75, CanIfTxPduCanId=426 if post-build-variant-condition{matching-criterion=RDR_POS, value=1}, CanIfTxPduCanId=554 if post-build-variant-condition{matching-criterion=RDR_POS, value=2}, CanIfTxPduCanId=682 if post-build-variant-condition{matching-criterion=RDR_POS, value=3}, CanIfTxPduCanId=810 if post-build-variant-condition{matching-criterion=RDR_POS, value=4}, CanIfTxPduCanId=938 if post-build-variant-condition{matching-criterion=RDR_POS, value=5}, CanIfTxPduCanId=1066 if post-build-variant-condition{matching-criterion=RDR_POS, value=6}, CanIfTxPduCanId=1194 if post-build-variant-condition{matching-criterion=RDR_POS, value=7}, CanIfTxPduRef=RDR_DETECTION_169_172_oPCAN_RADAR_54acc5c4_Tx
        RDR_DETECTION_261_264_oPCAN_RADAR_eb0c7dd8_Tx: CanIfTxPduCanId=321 if post-build-variant-condition{matching-criterion=RDR_POS, value=0}, CanIfTxPduId=98, CanIfTxPduCanId=449 if post-build-variant-condition{matching-criterion=RDR_POS, value=1}, CanIfTxPduCanId=577 if post-build-variant-condition{matching-criterion=RDR_POS, value=2}, CanIfTxPduCanId=705 if post-build-variant-condition{matching-criterion=RDR_POS, value=3}, CanIfTxPduCanId=833 if post-build-variant-condition{matching-criterion=RDR_POS, value=4}, CanIfTxPduCanId=961 if post-build-variant-condition{matching-criterion=RDR_POS, value=5}, CanIfTxPduCanId=1089 if post-build-variant-condition{matching-criterion=RDR_POS, value=6}, CanIfTxPduCanId=1217 if post-build-variant-condition{matching-criterion=RDR_POS, value=7}, CanIfTxPduRef=RDR_DETECTION_261_264_oPCAN_RADAR_42ef7944_Tx
        RDR_TRACKER_OBJ_002_oPCAN_RADAR_62323590_Tx: CanIfTxPduCanId=1297 if post-build-variant-condition{matching-criterion=RDR_POS, value=0}, CanIfTxPduId=139, CanIfTxPduCanId=1361 if post-build-variant-condition{matching-criterion=RDR_POS, value=1}, CanIfTxPduCanId=1425 if post-build-variant-condition{matching-criterion=RDR_POS, value=2}, CanIfTxPduCanId=1489 if post-build-variant-condition{matching-criterion=RDR_POS, value=3}, CanIfTxPduCanId=1553 if post-build-variant-condition{matching-criterion=RDR_POS, value=4}, CanIfTxPduCanId=1617 if post-build-variant-condition{matching-criterion=RDR_POS, value=5}, CanIfTxPduCanId=1681 if post-build-variant-condition{matching-criterion=RDR_POS, value=6}, CanIfTxPduCanId=1745 if post-build-variant-condition{matching-criterion=RDR_POS, value=7}, CanIfTxPduRef=RDR_TRACKER_OBJ_002_oPCAN_RADAR_b0529917_Tx
        RDR_TRACKER_OBJ_043_oPCAN_RADAR_b968063e_Tx: CanIfTxPduCanId=1338 if post-build-variant-condition{matching-criterion=RDR_POS, value=0}, CanIfTxPduId=181, CanIfTxPduCanId=1402 if post-build-variant-condition{matching-criterion=RDR_POS, value=1}, CanIfTxPduCanId=1466 if post-build-variant-condition{matching-criterion=RDR_POS, value=2}, CanIfTxPduCanId=1530 if post-build-variant-condition{matching-criterion=RDR_POS, value=3}, CanIfTxPduCanId=1594 if post-build-variant-condition{matching-criterion=RDR_POS, value=4}, CanIfTxPduCanId=1658 if post-build-variant-condition{matching-criterion=RDR_POS, value=5}, CanIfTxPduCanId=1722 if post-build-variant-condition{matching-criterion=RDR_POS, value=6}, CanIfTxPduCanId=1786 if post-build-variant-condition{matching-criterion=RDR_POS, value=7}, CanIfTxPduRef=RDR_TRACKER_OBJ_043_oPCAN_RADAR_14a94d3c_Tx
        RDR_DETECTION_217_220_oPCAN_RADAR_ab143386_Tx: CanIfTxPduCanId=310 if post-build-variant-condition{matching-criterion=RDR_POS, value=0}, CanIfTxPduId=87, CanIfTxPduCanId=438 if post-build-variant-condition{matching-criterion=RDR_POS, value=1}, CanIfTxPduCanId=566 if post-build-variant-condition{matching-criterion=RDR_POS, value=2}, CanIfTxPduCanId=694 if post-build-variant-condition{matching-criterion=RDR_POS, value=3}, CanIfTxPduCanId=822 if post-build-variant-condition{matching-criterion=RDR_POS, value=4}, CanIfTxPduCanId=950 if post-build-variant-condition{matching-criterion=RDR_POS, value=5}, CanIfTxPduCanId=1078 if post-build-variant-condition{matching-criterion=RDR_POS, value=6}, CanIfTxPduCanId=1206 if post-build-variant-condition{matching-criterion=RDR_POS, value=7}, CanIfTxPduRef=RDR_DETECTION_217_220_oPCAN_RADAR_a9b6fdbc_Tx
        RDR_TRACKER_OBJ_001_oPCAN_RADAR_7d6cb36b_Tx: CanIfTxPduCanId=1296 if post-build-variant-condition{matching-criterion=RDR_POS, value=0}, CanIfTxPduId=138, CanIfTxPduCanId=1360 if post-build-variant-condition{matching-criterion=RDR_POS, value=1}, CanIfTxPduCanId=1424 if post-build-variant-condition{matching-criterion=RDR_POS, value=2}, CanIfTxPduCanId=1488 if post-build-variant-condition{matching-criterion=RDR_POS, value=3}, CanIfTxPduCanId=1552 if post-build-variant-condition{matching-criterion=RDR_POS, value=4}, CanIfTxPduCanId=1616 if post-build-variant-condition{matching-criterion=RDR_POS, value=5}, CanIfTxPduCanId=1680 if post-build-variant-condition{matching-criterion=RDR_POS, value=6}, CanIfTxPduCanId=1744 if post-build-variant-condition{matching-criterion=RDR_POS, value=7}, CanIfTxPduRef=RDR_TRACKER_OBJ_001_oPCAN_RADAR_eb452802_Tx
        RDR_DETECTION_369_372_oPCAN_RADAR_df988f2e_Tx: CanIfTxPduCanId=348 if post-build-variant-condition{matching-criterion=RDR_POS, value=0}, CanIfTxPduId=125, CanIfTxPduCanId=476 if post-build-variant-condition{matching-criterion=RDR_POS, value=1}, CanIfTxPduCanId=604 if post-build-variant-condition{matching-criterion=RDR_POS, value=2}, CanIfTxPduCanId=732 if post-build-variant-condition{matching-criterion=RDR_POS, value=3}, CanIfTxPduCanId=860 if post-build-variant-condition{matching-criterion=RDR_POS, value=4}, CanIfTxPduCanId=988 if post-build-variant-condition{matching-criterion=RDR_POS, value=5}, CanIfTxPduCanId=1116 if post-build-variant-condition{matching-criterion=RDR_POS, value=6}, CanIfTxPduCanId=1244 if post-build-variant-condition{matching-criterion=RDR_POS, value=7}, CanIfTxPduRef=RDR_DETECTION_369_372_oPCAN_RADAR_8df3fb47_Tx
        RDR_DETECTION_365_368_oPCAN_RADAR_cc40b29b_Tx: CanIfTxPduCanId=347 if post-build-variant-condition{matching-criterion=RDR_POS, value=0}, CanIfTxPduId=124, CanIfTxPduCanId=475 if post-build-variant-condition{matching-criterion=RDR_POS, value=1}, CanIfTxPduCanId=603 if post-build-variant-condition{matching-criterion=RDR_POS, value=2}, CanIfTxPduCanId=731 if post-build-variant-condition{matching-criterion=RDR_POS, value=3}, CanIfTxPduCanId=859 if post-build-variant-condition{matching-criterion=RDR_POS, value=4}, CanIfTxPduCanId=987 if post-build-variant-condition{matching-criterion=RDR_POS, value=5}, CanIfTxPduCanId=1115 if post-build-variant-condition{matching-criterion=RDR_POS, value=6}, CanIfTxPduCanId=1243 if post-build-variant-condition{matching-criterion=RDR_POS, value=7}, CanIfTxPduRef=RDR_DETECTION_365_368_oPCAN_RADAR_1a84f18f_Tx
        RDR_TRACKER_OBJ_051_oPCAN_RADAR_03fc2c5d_Tx: CanIfTxPduCanId=1346 if post-build-variant-condition{matching-criterion=RDR_POS, value=0}, CanIfTxPduId=189, CanIfTxPduCanId=1410 if post-build-variant-condition{matching-criterion=RDR_POS, value=1}, CanIfTxPduCanId=1474 if post-build-variant-condition{matching-criterion=RDR_POS, value=2}, CanIfTxPduCanId=1538 if post-build-variant-condition{matching-criterion=RDR_POS, value=3}, CanIfTxPduCanId=1602 if post-build-variant-condition{matching-criterion=RDR_POS, value=4}, CanIfTxPduCanId=1666 if post-build-variant-condition{matching-criterion=RDR_POS, value=5}, CanIfTxPduCanId=1730 if post-build-variant-condition{matching-criterion=RDR_POS, value=6}, CanIfTxPduCanId=1794 if post-build-variant-condition{matching-criterion=RDR_POS, value=7}, CanIfTxPduRef=RDR_TRACKER_OBJ_051_oPCAN_RADAR_5dce3dec_Tx
        RDR_DETECTION_265_268_oPCAN_RADAR_3e1afd82_Tx: CanIfTxPduCanId=322 if post-build-variant-condition{matching-criterion=RDR_POS, value=0}, CanIfTxPduId=99, CanIfTxPduCanId=450 if post-build-variant-condition{matching-criterion=RDR_POS, value=1}, CanIfTxPduCanId=578 if post-build-variant-condition{matching-criterion=RDR_POS, value=2}, CanIfTxPduCanId=706 if post-build-variant-condition{matching-criterion=RDR_POS, value=3}, CanIfTxPduCanId=834 if post-build-variant-condition{matching-criterion=RDR_POS, value=4}, CanIfTxPduCanId=962 if post-build-variant-condition{matching-criterion=RDR_POS, value=5}, CanIfTxPduCanId=1090 if post-build-variant-condition{matching-criterion=RDR_POS, value=6}, CanIfTxPduCanId=1218 if post-build-variant-condition{matching-criterion=RDR_POS, value=7}, CanIfTxPduRef=RDR_DETECTION_265_268_oPCAN_RADAR_9b93edee_Tx
        RDR_DETECTION_313_316_oPCAN_RADAR_44e0bf7d_Tx: CanIfTxPduCanId=334 if post-build-variant-condition{matching-criterion=RDR_POS, value=0}, CanIfTxPduId=111, CanIfTxPduCanId=462 if post-build-variant-condition{matching-criterion=RDR_POS, value=1}, CanIfTxPduCanId=590 if post-build-variant-condition{matching-criterion=RDR_POS, value=2}, CanIfTxPduCanId=718 if post-build-variant-condition{matching-criterion=RDR_POS, value=3}, CanIfTxPduCanId=846 if post-build-variant-condition{matching-criterion=RDR_POS, value=4}, CanIfTxPduCanId=974 if post-build-variant-condition{matching-criterion=RDR_POS, value=5}, CanIfTxPduCanId=1102 if post-build-variant-condition{matching-criterion=RDR_POS, value=6}, CanIfTxPduCanId=1230 if post-build-variant-condition{matching-criterion=RDR_POS, value=7}, CanIfTxPduRef=RDR_DETECTION_313_316_oPCAN_RADAR_9d5b2612_Tx
        RDR_TRACKER_OBJ_013_oPCAN_RADAR_c7f89908_Tx: CanIfTxPduCanId=1308 if post-build-variant-condition{matching-criterion=RDR_POS, value=0}, CanIfTxPduId=150, CanIfTxPduCanId=1372 if post-build-variant-condition{matching-criterion=RDR_POS, value=1}, CanIfTxPduCanId=1436 if post-build-variant-condition{matching-criterion=RDR_POS, value=2}, CanIfTxPduCanId=1500 if post-build-variant-condition{matching-criterion=RDR_POS, value=3}, CanIfTxPduCanId=1564 if post-build-variant-condition{matching-criterion=RDR_POS, value=4}, CanIfTxPduCanId=1628 if post-build-variant-condition{matching-criterion=RDR_POS, value=5}, CanIfTxPduCanId=1692 if post-build-variant-condition{matching-criterion=RDR_POS, value=6}, CanIfTxPduCanId=1756 if post-build-variant-condition{matching-criterion=RDR_POS, value=7}, CanIfTxPduRef=RDR_TRACKER_OBJ_013_oPCAN_RADAR_a22258d2_Tx
        RDR_TRACKER_OBJ_058_oPCAN_RADAR_5f65bcbc_Tx: CanIfTxPduCanId=1353 if post-build-variant-condition{matching-criterion=RDR_POS, value=0}, CanIfTxPduId=196, CanIfTxPduCanId=1417 if post-build-variant-condition{matching-criterion=RDR_POS, value=1}, CanIfTxPduCanId=1481 if post-build-variant-condition{matching-criterion=RDR_POS, value=2}, CanIfTxPduCanId=1545 if post-build-variant-condition{matching-criterion=RDR_POS, value=3}, CanIfTxPduCanId=1609 if post-build-variant-condition{matching-criterion=RDR_POS, value=4}, CanIfTxPduCanId=1673 if post-build-variant-condition{matching-criterion=RDR_POS, value=5}, CanIfTxPduCanId=1737 if post-build-variant-condition{matching-criterion=RDR_POS, value=6}, CanIfTxPduCanId=1801 if post-build-variant-condition{matching-criterion=RDR_POS, value=7}, CanIfTxPduRef=RDR_TRACKER_OBJ_058_oPCAN_RADAR_07d92cc6_Tx
        RDR_TRACKER_OBJ_005_oPCAN_RADAR_564545cf_Tx: CanIfTxPduCanId=1300 if post-build-variant-condition{matching-criterion=RDR_POS, value=0}, CanIfTxPduId=142, CanIfTxPduCanId=1364 if post-build-variant-condition{matching-criterion=RDR_POS, value=1}, CanIfTxPduCanId=1428 if post-build-variant-condition{matching-criterion=RDR_POS, value=2}, CanIfTxPduCanId=1492 if post-build-variant-condition{matching-criterion=RDR_POS, value=3}, CanIfTxPduCanId=1556 if post-build-variant-condition{matching-criterion=RDR_POS, value=4}, CanIfTxPduCanId=1620 if post-build-variant-condition{matching-criterion=RDR_POS, value=5}, CanIfTxPduCanId=1684 if post-build-variant-condition{matching-criterion=RDR_POS, value=6}, CanIfTxPduCanId=1748 if post-build-variant-condition{matching-criterion=RDR_POS, value=7}, CanIfTxPduRef=RDR_TRACKER_OBJ_005_oPCAN_RADAR_308f6bce_Tx
        RDR_STATUS_001_oPCAN_RADAR_0ddc5064_Tx: CanIfTxPduCanId=131 if post-build-variant-condition{matching-criterion=RDR_POS, value=0}, CanIfTxPduId=136, CanIfTxPduCanId=139 if post-build-variant-condition{matching-criterion=RDR_POS, value=1}, CanIfTxPduCanId=147 if post-build-variant-condition{matching-criterion=RDR_POS, value=2}, CanIfTxPduCanId=155 if post-build-variant-condition{matching-criterion=RDR_POS, value=3}, CanIfTxPduCanId=163 if post-build-variant-condition{matching-criterion=RDR_POS, value=4}, CanIfTxPduCanId=171 if post-build-variant-condition{matching-criterion=RDR_POS, value=5}, CanIfTxPduCanId=179 if post-build-variant-condition{matching-criterion=RDR_POS, value=6}, CanIfTxPduCanId=187 if post-build-variant-condition{matching-criterion=RDR_POS, value=7}, CanIfTxPduRef=RDR_STATUS_001_oPCAN_RADAR_deb478ca_Tx
        RDR_TRACKER_OBJ_025_oPCAN_RADAR_d335e1ec_Tx: CanIfTxPduCanId=1320 if post-build-variant-condition{matching-criterion=RDR_POS, value=0}, CanIfTxPduId=162, CanIfTxPduCanId=1384 if post-build-variant-condition{matching-criterion=RDR_POS, value=1}, CanIfTxPduCanId=1448 if post-build-variant-condition{matching-criterion=RDR_POS, value=2}, CanIfTxPduCanId=1512 if post-build-variant-condition{matching-criterion=RDR_POS, value=3}, CanIfTxPduCanId=1576 if post-build-variant-condition{matching-criterion=RDR_POS, value=4}, CanIfTxPduCanId=1640 if post-build-variant-condition{matching-criterion=RDR_POS, value=5}, CanIfTxPduCanId=1704 if post-build-variant-condition{matching-criterion=RDR_POS, value=6}, CanIfTxPduCanId=1768 if post-build-variant-condition{matching-criterion=RDR_POS, value=7}, CanIfTxPduRef=RDR_TRACKER_OBJ_025_oPCAN_RADAR_798bc9a2_Tx
        RDR_DETECTION_013_016_oPCAN_RADAR_897f6817_Tx: CanIfTxPduCanId=259 if post-build-variant-condition{matching-criterion=RDR_POS, value=0}, CanIfTxPduId=36, CanIfTxPduCanId=387 if post-build-variant-condition{matching-criterion=RDR_POS, value=1}, CanIfTxPduCanId=515 if post-build-variant-condition{matching-criterion=RDR_POS, value=2}, CanIfTxPduCanId=643 if post-build-variant-condition{matching-criterion=RDR_POS, value=3}, CanIfTxPduCanId=771 if post-build-variant-condition{matching-criterion=RDR_POS, value=4}, CanIfTxPduCanId=899 if post-build-variant-condition{matching-criterion=RDR_POS, value=5}, CanIfTxPduCanId=1027 if post-build-variant-condition{matching-criterion=RDR_POS, value=6}, CanIfTxPduCanId=1155 if post-build-variant-condition{matching-criterion=RDR_POS, value=7}, CanIfTxPduRef=RDR_DETECTION_013_016_oPCAN_RADAR_c51304f0_Tx
        RDR_DETECTION_289_292_oPCAN_RADAR_a56a8f04_Tx: CanIfTxPduCanId=328 if post-build-variant-condition{matching-criterion=RDR_POS, value=0}, CanIfTxPduId=105, CanIfTxPduCanId=456 if post-build-variant-condition{matching-criterion=RDR_POS, value=1}, CanIfTxPduCanId=584 if post-build-variant-condition{matching-criterion=RDR_POS, value=2}, CanIfTxPduCanId=712 if post-build-variant-condition{matching-criterion=RDR_POS, value=3}, CanIfTxPduCanId=840 if post-build-variant-condition{matching-criterion=RDR_POS, value=4}, CanIfTxPduCanId=968 if post-build-variant-condition{matching-criterion=RDR_POS, value=5}, CanIfTxPduCanId=1096 if post-build-variant-condition{matching-criterion=RDR_POS, value=6}, CanIfTxPduCanId=1224 if post-build-variant-condition{matching-criterion=RDR_POS, value=7}, CanIfTxPduRef=RDR_DETECTION_289_292_oPCAN_RADAR_043b743b_Tx
        RDR_DETECTION_205_208_oPCAN_RADAR_afb90e68_Tx: CanIfTxPduCanId=307 if post-build-variant-condition{matching-criterion=RDR_POS, value=0}, CanIfTxPduId=84, CanIfTxPduCanId=435 if post-build-variant-condition{matching-criterion=RDR_POS, value=1}, CanIfTxPduCanId=563 if post-build-variant-condition{matching-criterion=RDR_POS, value=2}, CanIfTxPduCanId=691 if post-build-variant-condition{matching-criterion=RDR_POS, value=3}, CanIfTxPduCanId=819 if post-build-variant-condition{matching-criterion=RDR_POS, value=4}, CanIfTxPduCanId=947 if post-build-variant-condition{matching-criterion=RDR_POS, value=5}, CanIfTxPduCanId=1075 if post-build-variant-condition{matching-criterion=RDR_POS, value=6}, CanIfTxPduCanId=1203 if post-build-variant-condition{matching-criterion=RDR_POS, value=7}, CanIfTxPduRef=RDR_DETECTION_205_208_oPCAN_RADAR_db4e0b94_Tx
        RDR_DETECTION_241_244_oPCAN_RADAR_9b92d37e_Tx: CanIfTxPduCanId=316 if post-build-variant-condition{matching-criterion=RDR_POS, value=0}, CanIfTxPduId=93, CanIfTxPduCanId=444 if post-build-variant-condition{matching-criterion=RDR_POS, value=1}, CanIfTxPduCanId=572 if post-build-variant-condition{matching-criterion=RDR_POS, value=2}, CanIfTxPduCanId=700 if post-build-variant-condition{matching-criterion=RDR_POS, value=3}, CanIfTxPduCanId=828 if post-build-variant-condition{matching-criterion=RDR_POS, value=4}, CanIfTxPduCanId=956 if post-build-variant-condition{matching-criterion=RDR_POS, value=5}, CanIfTxPduCanId=1084 if post-build-variant-condition{matching-criterion=RDR_POS, value=6}, CanIfTxPduCanId=1212 if post-build-variant-condition{matching-criterion=RDR_POS, value=7}, CanIfTxPduRef=RDR_DETECTION_241_244_oPCAN_RADAR_cb8b26ad_Tx
        RDR_TRACKER_OBJ_024_oPCAN_RADAR_d9ff9c45_Tx: CanIfTxPduCanId=1319 if post-build-variant-condition{matching-criterion=RDR_POS, value=0}, CanIfTxPduId=161, CanIfTxPduCanId=1383 if post-build-variant-condition{matching-criterion=RDR_POS, value=1}, CanIfTxPduCanId=1447 if post-build-variant-condition{matching-criterion=RDR_POS, value=2}, CanIfTxPduCanId=1511 if post-build-variant-condition{matching-criterion=RDR_POS, value=3}, CanIfTxPduCanId=1575 if post-build-variant-condition{matching-criterion=RDR_POS, value=4}, CanIfTxPduCanId=1639 if post-build-variant-condition{matching-criterion=RDR_POS, value=5}, CanIfTxPduCanId=1703 if post-build-variant-condition{matching-criterion=RDR_POS, value=6}, CanIfTxPduCanId=1767 if post-build-variant-condition{matching-criterion=RDR_POS, value=7}, CanIfTxPduRef=RDR_TRACKER_OBJ_024_oPCAN_RADAR_4f795951_Tx
        RDR_TRACKER_OBJ_060_oPCAN_RADAR_234624e6_Tx: CanIfTxPduCanId=1355 if post-build-variant-condition{matching-criterion=RDR_POS, value=0}, CanIfTxPduId=198, CanIfTxPduCanId=1419 if post-build-variant-condition{matching-criterion=RDR_POS, value=1}, CanIfTxPduCanId=1483 if post-build-variant-condition{matching-criterion=RDR_POS, value=2}, CanIfTxPduCanId=1547 if post-build-variant-condition{matching-criterion=RDR_POS, value=3}, CanIfTxPduCanId=1611 if post-build-variant-condition{matching-criterion=RDR_POS, value=4}, CanIfTxPduCanId=1675 if post-build-variant-condition{matching-criterion=RDR_POS, value=5}, CanIfTxPduCanId=1739 if post-build-variant-condition{matching-criterion=RDR_POS, value=6}, CanIfTxPduCanId=1803 if post-build-variant-condition{matching-criterion=RDR_POS, value=7}, CanIfTxPduRef=RDR_TRACKER_OBJ_060_oPCAN_RADAR_06ba5e45_Tx
        RDR_TRACKER_OBJ_039_oPCAN_RADAR_014f2b31_Tx: CanIfTxPduCanId=1334 if post-build-variant-condition{matching-criterion=RDR_POS, value=0}, CanIfTxPduId=176, CanIfTxPduCanId=1398 if post-build-variant-condition{matching-criterion=RDR_POS, value=1}, CanIfTxPduCanId=1462 if post-build-variant-condition{matching-criterion=RDR_POS, value=2}, CanIfTxPduCanId=1526 if post-build-variant-condition{matching-criterion=RDR_POS, value=3}, CanIfTxPduCanId=1590 if post-build-variant-condition{matching-criterion=RDR_POS, value=4}, CanIfTxPduCanId=1654 if post-build-variant-condition{matching-criterion=RDR_POS, value=5}, CanIfTxPduCanId=1718 if post-build-variant-condition{matching-criterion=RDR_POS, value=6}, CanIfTxPduCanId=1782 if post-build-variant-condition{matching-criterion=RDR_POS, value=7}, CanIfTxPduRef=RDR_TRACKER_OBJ_039_oPCAN_RADAR_ea265a81_Tx
        RDR_TRACKER_OBJ_007_oPCAN_RADAR_43d1be9d_Tx: CanIfTxPduCanId=1302 if post-build-variant-condition{matching-criterion=RDR_POS, value=0}, CanIfTxPduId=144, CanIfTxPduCanId=1366 if post-build-variant-condition{matching-criterion=RDR_POS, value=1}, CanIfTxPduCanId=1430 if post-build-variant-condition{matching-criterion=RDR_POS, value=2}, CanIfTxPduCanId=1494 if post-build-variant-condition{matching-criterion=RDR_POS, value=3}, CanIfTxPduCanId=1558 if post-build-variant-condition{matching-criterion=RDR_POS, value=4}, CanIfTxPduCanId=1622 if post-build-variant-condition{matching-criterion=RDR_POS, value=5}, CanIfTxPduCanId=1686 if post-build-variant-condition{matching-criterion=RDR_POS, value=6}, CanIfTxPduCanId=1750 if post-build-variant-condition{matching-criterion=RDR_POS, value=7}, CanIfTxPduRef=RDR_TRACKER_OBJ_007_oPCAN_RADAR_5d6a4a28_Tx
        RDR_DETECTION_245_248_oPCAN_RADAR_4e845324_Tx: CanIfTxPduCanId=317 if post-build-variant-condition{matching-criterion=RDR_POS, value=0}, CanIfTxPduId=94, CanIfTxPduCanId=445 if post-build-variant-condition{matching-criterion=RDR_POS, value=1}, CanIfTxPduCanId=573 if post-build-variant-condition{matching-criterion=RDR_POS, value=2}, CanIfTxPduCanId=701 if post-build-variant-condition{matching-criterion=RDR_POS, value=3}, CanIfTxPduCanId=829 if post-build-variant-condition{matching-criterion=RDR_POS, value=4}, CanIfTxPduCanId=957 if post-build-variant-condition{matching-criterion=RDR_POS, value=5}, CanIfTxPduCanId=1085 if post-build-variant-condition{matching-criterion=RDR_POS, value=6}, CanIfTxPduCanId=1213 if post-build-variant-condition{matching-criterion=RDR_POS, value=7}, CanIfTxPduRef=RDR_DETECTION_245_248_oPCAN_RADAR_12f7b207_Tx
        RDR_DETECTION_225_228_oPCAN_RADAR_df27a0ce_Tx: CanIfTxPduCanId=312 if post-build-variant-condition{matching-criterion=RDR_POS, value=0}, CanIfTxPduId=89, CanIfTxPduCanId=440 if post-build-variant-condition{matching-criterion=RDR_POS, value=1}, CanIfTxPduCanId=568 if post-build-variant-condition{matching-criterion=RDR_POS, value=2}, CanIfTxPduCanId=696 if post-build-variant-condition{matching-criterion=RDR_POS, value=3}, CanIfTxPduCanId=824 if post-build-variant-condition{matching-criterion=RDR_POS, value=4}, CanIfTxPduCanId=952 if post-build-variant-condition{matching-criterion=RDR_POS, value=5}, CanIfTxPduCanId=1080 if post-build-variant-condition{matching-criterion=RDR_POS, value=6}, CanIfTxPduCanId=1208 if post-build-variant-condition{matching-criterion=RDR_POS, value=7}, CanIfTxPduRef=RDR_DETECTION_225_228_oPCAN_RADAR_522a547d_Tx
        RDR_DETECTION_301_304_oPCAN_RADAR_88f5c12b_Tx: CanIfTxPduCanId=331 if post-build-variant-condition{matching-criterion=RDR_POS, value=0}, CanIfTxPduId=108, CanIfTxPduCanId=459 if post-build-variant-condition{matching-criterion=RDR_POS, value=1}, CanIfTxPduCanId=587 if post-build-variant-condition{matching-criterion=RDR_POS, value=2}, CanIfTxPduCanId=715 if post-build-variant-condition{matching-criterion=RDR_POS, value=3}, CanIfTxPduCanId=843 if post-build-variant-condition{matching-criterion=RDR_POS, value=4}, CanIfTxPduCanId=971 if post-build-variant-condition{matching-criterion=RDR_POS, value=5}, CanIfTxPduCanId=1099 if post-build-variant-condition{matching-criterion=RDR_POS, value=6}, CanIfTxPduCanId=1227 if post-build-variant-condition{matching-criterion=RDR_POS, value=7}, CanIfTxPduRef=RDR_DETECTION_301_304_oPCAN_RADAR_8325835f_Tx
        RDR_DETECTION_353_356_oPCAN_RADAR_a5dde231_Tx: CanIfTxPduCanId=344 if post-build-variant-condition{matching-criterion=RDR_POS, value=0}, CanIfTxPduId=121, CanIfTxPduCanId=472 if post-build-variant-condition{matching-criterion=RDR_POS, value=1}, CanIfTxPduCanId=600 if post-build-variant-condition{matching-criterion=RDR_POS, value=2}, CanIfTxPduCanId=728 if post-build-variant-condition{matching-criterion=RDR_POS, value=3}, CanIfTxPduCanId=856 if post-build-variant-condition{matching-criterion=RDR_POS, value=4}, CanIfTxPduCanId=984 if post-build-variant-condition{matching-criterion=RDR_POS, value=5}, CanIfTxPduCanId=1112 if post-build-variant-condition{matching-criterion=RDR_POS, value=6}, CanIfTxPduCanId=1240 if post-build-variant-condition{matching-criterion=RDR_POS, value=7}, CanIfTxPduRef=RDR_DETECTION_353_356_oPCAN_RADAR_54e29f81_Tx
        RDR_DETECTION_017_020_oPCAN_RADAR_94d1abf5_Tx: CanIfTxPduCanId=260 if post-build-variant-condition{matching-criterion=RDR_POS, value=0}, CanIfTxPduId=37, CanIfTxPduCanId=388 if post-build-variant-condition{matching-criterion=RDR_POS, value=1}, CanIfTxPduCanId=516 if post-build-variant-condition{matching-criterion=RDR_POS, value=2}, CanIfTxPduCanId=644 if post-build-variant-condition{matching-criterion=RDR_POS, value=3}, CanIfTxPduCanId=772 if post-build-variant-condition{matching-criterion=RDR_POS, value=4}, CanIfTxPduCanId=900 if post-build-variant-condition{matching-criterion=RDR_POS, value=5}, CanIfTxPduCanId=1028 if post-build-variant-condition{matching-criterion=RDR_POS, value=6}, CanIfTxPduCanId=1156 if post-build-variant-condition{matching-criterion=RDR_POS, value=7}, CanIfTxPduRef=RDR_DETECTION_017_020_oPCAN_RADAR_70e9c33f_Tx
        RDR_DETECTION_121_124_oPCAN_RADAR_c7aef7fe_Tx: CanIfTxPduCanId=286 if post-build-variant-condition{matching-criterion=RDR_POS, value=0}, CanIfTxPduId=63, CanIfTxPduCanId=414 if post-build-variant-condition{matching-criterion=RDR_POS, value=1}, CanIfTxPduCanId=542 if post-build-variant-condition{matching-criterion=RDR_POS, value=2}, CanIfTxPduCanId=670 if post-build-variant-condition{matching-criterion=RDR_POS, value=3}, CanIfTxPduCanId=798 if post-build-variant-condition{matching-criterion=RDR_POS, value=4}, CanIfTxPduCanId=926 if post-build-variant-condition{matching-criterion=RDR_POS, value=5}, CanIfTxPduCanId=1054 if post-build-variant-condition{matching-criterion=RDR_POS, value=6}, CanIfTxPduCanId=1182 if post-build-variant-condition{matching-criterion=RDR_POS, value=7}, CanIfTxPduRef=RDR_DETECTION_121_124_oPCAN_RADAR_d31ee235_Tx
        RDR_DETECTION_173_176_oPCAN_RADAR_ea86d4e4_Tx: CanIfTxPduCanId=299 if post-build-variant-condition{matching-criterion=RDR_POS, value=0}, CanIfTxPduId=76, CanIfTxPduCanId=427 if post-build-variant-condition{matching-criterion=RDR_POS, value=1}, CanIfTxPduCanId=555 if post-build-variant-condition{matching-criterion=RDR_POS, value=2}, CanIfTxPduCanId=683 if post-build-variant-condition{matching-criterion=RDR_POS, value=3}, CanIfTxPduCanId=811 if post-build-variant-condition{matching-criterion=RDR_POS, value=4}, CanIfTxPduCanId=939 if post-build-variant-condition{matching-criterion=RDR_POS, value=5}, CanIfTxPduCanId=1067 if post-build-variant-condition{matching-criterion=RDR_POS, value=6}, CanIfTxPduCanId=1195 if post-build-variant-condition{matching-criterion=RDR_POS, value=7}, CanIfTxPduRef=RDR_DETECTION_173_176_oPCAN_RADAR_04d9feeb_Tx
        RDR_TRACKER_OBJ_046_oPCAN_RADAR_988b8d33_Tx: CanIfTxPduCanId=1341 if post-build-variant-condition{matching-criterion=RDR_POS, value=0}, CanIfTxPduId=184, CanIfTxPduCanId=1405 if post-build-variant-condition{matching-criterion=RDR_POS, value=1}, CanIfTxPduCanId=1469 if post-build-variant-condition{matching-criterion=RDR_POS, value=2}, CanIfTxPduCanId=1533 if post-build-variant-condition{matching-criterion=RDR_POS, value=3}, CanIfTxPduCanId=1597 if post-build-variant-condition{matching-criterion=RDR_POS, value=4}, CanIfTxPduCanId=1661 if post-build-variant-condition{matching-criterion=RDR_POS, value=5}, CanIfTxPduCanId=1725 if post-build-variant-condition{matching-criterion=RDR_POS, value=6}, CanIfTxPduCanId=1789 if post-build-variant-condition{matching-criterion=RDR_POS, value=7}, CanIfTxPduRef=RDR_TRACKER_OBJ_046_oPCAN_RADAR_f9919e03_Tx
        RDR_DETECTION_181_184_oPCAN_RADAR_ae3be581_Tx: CanIfTxPduCanId=301 if post-build-variant-condition{matching-criterion=RDR_POS, value=0}, CanIfTxPduId=78, CanIfTxPduCanId=429 if post-build-variant-condition{matching-criterion=RDR_POS, value=1}, CanIfTxPduCanId=557 if post-build-variant-condition{matching-criterion=RDR_POS, value=2}, CanIfTxPduCanId=685 if post-build-variant-condition{matching-criterion=RDR_POS, value=3}, CanIfTxPduCanId=813 if post-build-variant-condition{matching-criterion=RDR_POS, value=4}, CanIfTxPduCanId=941 if post-build-variant-condition{matching-criterion=RDR_POS, value=5}, CanIfTxPduCanId=1069 if post-build-variant-condition{matching-criterion=RDR_POS, value=6}, CanIfTxPduCanId=1197 if post-build-variant-condition{matching-criterion=RDR_POS, value=7}, CanIfTxPduRef=RDR_DETECTION_181_184_oPCAN_RADAR_1278c8bb_Tx
        RDR_TRACKER_OBJ_045_oPCAN_RADAR_87d50bc8_Tx: CanIfTxPduCanId=1340 if post-build-variant-condition{matching-criterion=RDR_POS, value=0}, CanIfTxPduId=183, CanIfTxPduCanId=1404 if post-build-variant-condition{matching-criterion=RDR_POS, value=1}, CanIfTxPduCanId=1468 if post-build-variant-condition{matching-criterion=RDR_POS, value=2}, CanIfTxPduCanId=1532 if post-build-variant-condition{matching-criterion=RDR_POS, value=3}, CanIfTxPduCanId=1596 if post-build-variant-condition{matching-criterion=RDR_POS, value=4}, CanIfTxPduCanId=1660 if post-build-variant-condition{matching-criterion=RDR_POS, value=5}, CanIfTxPduCanId=1724 if post-build-variant-condition{matching-criterion=RDR_POS, value=6}, CanIfTxPduCanId=1788 if post-build-variant-condition{matching-criterion=RDR_POS, value=7}, CanIfTxPduRef=RDR_TRACKER_OBJ_045_oPCAN_RADAR_a2862f16_Tx
        RDR_TRACKER_OBJ_063_oPCAN_RADAR_3c18a21d_Tx: CanIfTxPduCanId=1358 if post-build-variant-condition{matching-criterion=RDR_POS, value=0}, CanIfTxPduId=201, CanIfTxPduCanId=1422 if post-build-variant-condition{matching-criterion=RDR_POS, value=1}, CanIfTxPduCanId=1486 if post-build-variant-condition{matching-criterion=RDR_POS, value=2}, CanIfTxPduCanId=1550 if post-build-variant-condition{matching-criterion=RDR_POS, value=3}, CanIfTxPduCanId=1614 if post-build-variant-condition{matching-criterion=RDR_POS, value=4}, CanIfTxPduCanId=1678 if post-build-variant-condition{matching-criterion=RDR_POS, value=5}, CanIfTxPduCanId=1742 if post-build-variant-condition{matching-criterion=RDR_POS, value=6}, CanIfTxPduCanId=1806 if post-build-variant-condition{matching-criterion=RDR_POS, value=7}, CanIfTxPduRef=RDR_TRACKER_OBJ_063_oPCAN_RADAR_5dadef50_Tx
        RDR_TRACKER_OBJ_017_oPCAN_RADAR_ecd16fac_Tx: CanIfTxPduCanId=1312 if post-build-variant-condition{matching-criterion=RDR_POS, value=0}, CanIfTxPduId=154, CanIfTxPduCanId=1376 if post-build-variant-condition{matching-criterion=RDR_POS, value=1}, CanIfTxPduCanId=1440 if post-build-variant-condition{matching-criterion=RDR_POS, value=2}, CanIfTxPduCanId=1504 if post-build-variant-condition{matching-criterion=RDR_POS, value=3}, CanIfTxPduCanId=1568 if post-build-variant-condition{matching-criterion=RDR_POS, value=4}, CanIfTxPduCanId=1632 if post-build-variant-condition{matching-criterion=RDR_POS, value=5}, CanIfTxPduCanId=1696 if post-build-variant-condition{matching-criterion=RDR_POS, value=6}, CanIfTxPduCanId=1760 if post-build-variant-condition{matching-criterion=RDR_POS, value=7}, CanIfTxPduRef=RDR_TRACKER_OBJ_017_oPCAN_RADAR_79e81b1e_Tx
        RDR_DETECTION_033_036_oPCAN_RADAR_f9e1c6b1_Tx: CanIfTxPduCanId=264 if post-build-variant-condition{matching-criterion=RDR_POS, value=0}, CanIfTxPduId=41, CanIfTxPduCanId=392 if post-build-variant-condition{matching-criterion=RDR_POS, value=1}, CanIfTxPduCanId=520 if post-build-variant-condition{matching-criterion=RDR_POS, value=2}, CanIfTxPduCanId=648 if post-build-variant-condition{matching-criterion=RDR_POS, value=3}, CanIfTxPduCanId=776 if post-build-variant-condition{matching-criterion=RDR_POS, value=4}, CanIfTxPduCanId=904 if post-build-variant-condition{matching-criterion=RDR_POS, value=5}, CanIfTxPduCanId=1032 if post-build-variant-condition{matching-criterion=RDR_POS, value=6}, CanIfTxPduCanId=1160 if post-build-variant-condition{matching-criterion=RDR_POS, value=7}, CanIfTxPduRef=RDR_DETECTION_033_036_oPCAN_RADAR_4c775b19_Tx
        RDR_TRACKER_OBJ_036_oPCAN_RADAR_636bb626_Tx: CanIfTxPduCanId=1331 if post-build-variant-condition{matching-criterion=RDR_POS, value=0}, CanIfTxPduId=173, CanIfTxPduCanId=1395 if post-build-variant-condition{matching-criterion=RDR_POS, value=1}, CanIfTxPduCanId=1459 if post-build-variant-condition{matching-criterion=RDR_POS, value=2}, CanIfTxPduCanId=1523 if post-build-variant-condition{matching-criterion=RDR_POS, value=3}, CanIfTxPduCanId=1587 if post-build-variant-condition{matching-criterion=RDR_POS, value=4}, CanIfTxPduCanId=1651 if post-build-variant-condition{matching-criterion=RDR_POS, value=5}, CanIfTxPduCanId=1715 if post-build-variant-condition{matching-criterion=RDR_POS, value=6}, CanIfTxPduCanId=1779 if post-build-variant-condition{matching-criterion=RDR_POS, value=7}, CanIfTxPduRef=RDR_TRACKER_OBJ_036_oPCAN_RADAR_061e2981_Tx
        RDR_TRACKER_OBJ_006_oPCAN_RADAR_491bc334_Tx: CanIfTxPduCanId=1301 if post-build-variant-condition{matching-criterion=RDR_POS, value=0}, CanIfTxPduId=143, CanIfTxPduCanId=1365 if post-build-variant-condition{matching-criterion=RDR_POS, value=1}, CanIfTxPduCanId=1429 if post-build-variant-condition{matching-criterion=RDR_POS, value=2}, CanIfTxPduCanId=1493 if post-build-variant-condition{matching-criterion=RDR_POS, value=3}, CanIfTxPduCanId=1557 if post-build-variant-condition{matching-criterion=RDR_POS, value=4}, CanIfTxPduCanId=1621 if post-build-variant-condition{matching-criterion=RDR_POS, value=5}, CanIfTxPduCanId=1685 if post-build-variant-condition{matching-criterion=RDR_POS, value=6}, CanIfTxPduCanId=1749 if post-build-variant-condition{matching-criterion=RDR_POS, value=7}, CanIfTxPduRef=RDR_TRACKER_OBJ_006_oPCAN_RADAR_6b98dadb_Tx
        RDR_TRACKER_OBJ_030_oPCAN_RADAR_5dd6bbd0_Tx: CanIfTxPduCanId=1325 if post-build-variant-condition{matching-criterion=RDR_POS, value=0}, CanIfTxPduId=167, CanIfTxPduCanId=1389 if post-build-variant-condition{matching-criterion=RDR_POS, value=1}, CanIfTxPduCanId=1453 if post-build-variant-condition{matching-criterion=RDR_POS, value=2}, CanIfTxPduCanId=1517 if post-build-variant-condition{matching-criterion=RDR_POS, value=3}, CanIfTxPduCanId=1581 if post-build-variant-condition{matching-criterion=RDR_POS, value=4}, CanIfTxPduCanId=1645 if post-build-variant-condition{matching-criterion=RDR_POS, value=5}, CanIfTxPduCanId=1709 if post-build-variant-condition{matching-criterion=RDR_POS, value=6}, CanIfTxPduCanId=1773 if post-build-variant-condition{matching-criterion=RDR_POS, value=7}, CanIfTxPduRef=RDR_TRACKER_OBJ_030_oPCAN_RADAR_b0314bab_Tx
        RDR_DETECTION_005_008_oPCAN_RADAR_907c961b_Tx: CanIfTxPduCanId=257 if post-build-variant-condition{matching-criterion=RDR_POS, value=0}, CanIfTxPduId=34, CanIfTxPduCanId=385 if post-build-variant-condition{matching-criterion=RDR_POS, value=1}, CanIfTxPduCanId=513 if post-build-variant-condition{matching-criterion=RDR_POS, value=2}, CanIfTxPduCanId=641 if post-build-variant-condition{matching-criterion=RDR_POS, value=3}, CanIfTxPduCanId=769 if post-build-variant-condition{matching-criterion=RDR_POS, value=4}, CanIfTxPduCanId=897 if post-build-variant-condition{matching-criterion=RDR_POS, value=5}, CanIfTxPduCanId=1025 if post-build-variant-condition{matching-criterion=RDR_POS, value=6}, CanIfTxPduCanId=1153 if post-build-variant-condition{matching-criterion=RDR_POS, value=7}, CanIfTxPduRef=RDR_DETECTION_005_008_oPCAN_RADAR_02113517_Tx
        RDR_TRACKER_OBJ_014_oPCAN_RADAR_f38fe957_Tx: CanIfTxPduCanId=1309 if post-build-variant-condition{matching-criterion=RDR_POS, value=0}, CanIfTxPduId=151, CanIfTxPduCanId=1373 if post-build-variant-condition{matching-criterion=RDR_POS, value=1}, CanIfTxPduCanId=1437 if post-build-variant-condition{matching-criterion=RDR_POS, value=2}, CanIfTxPduCanId=1501 if post-build-variant-condition{matching-criterion=RDR_POS, value=3}, CanIfTxPduCanId=1565 if post-build-variant-condition{matching-criterion=RDR_POS, value=4}, CanIfTxPduCanId=1629 if post-build-variant-condition{matching-criterion=RDR_POS, value=5}, CanIfTxPduCanId=1693 if post-build-variant-condition{matching-criterion=RDR_POS, value=6}, CanIfTxPduCanId=1757 if post-build-variant-condition{matching-criterion=RDR_POS, value=7}, CanIfTxPduRef=RDR_TRACKER_OBJ_014_oPCAN_RADAR_22ffaa0b_Tx
        RDR_DETECTION_361_364_oPCAN_RADAR_195632c1_Tx: CanIfTxPduCanId=346 if post-build-variant-condition{matching-criterion=RDR_POS, value=0}, CanIfTxPduId=123, CanIfTxPduCanId=474 if post-build-variant-condition{matching-criterion=RDR_POS, value=1}, CanIfTxPduCanId=602 if post-build-variant-condition{matching-criterion=RDR_POS, value=2}, CanIfTxPduCanId=730 if post-build-variant-condition{matching-criterion=RDR_POS, value=3}, CanIfTxPduCanId=858 if post-build-variant-condition{matching-criterion=RDR_POS, value=4}, CanIfTxPduCanId=986 if post-build-variant-condition{matching-criterion=RDR_POS, value=5}, CanIfTxPduCanId=1114 if post-build-variant-condition{matching-criterion=RDR_POS, value=6}, CanIfTxPduCanId=1242 if post-build-variant-condition{matching-criterion=RDR_POS, value=7}, CanIfTxPduRef=RDR_DETECTION_361_364_oPCAN_RADAR_c3f86525_Tx
        RDR_TRACKER_OBJ_009_oPCAN_RADAR_2b3f5e23_Tx: CanIfTxPduCanId=1304 if post-build-variant-condition{matching-criterion=RDR_POS, value=0}, CanIfTxPduId=146, CanIfTxPduCanId=1368 if post-build-variant-condition{matching-criterion=RDR_POS, value=1}, CanIfTxPduCanId=1432 if post-build-variant-condition{matching-criterion=RDR_POS, value=2}, CanIfTxPduCanId=1496 if post-build-variant-condition{matching-criterion=RDR_POS, value=3}, CanIfTxPduCanId=1560 if post-build-variant-condition{matching-criterion=RDR_POS, value=4}, CanIfTxPduCanId=1624 if post-build-variant-condition{matching-criterion=RDR_POS, value=5}, CanIfTxPduCanId=1688 if post-build-variant-condition{matching-criterion=RDR_POS, value=6}, CanIfTxPduCanId=1752 if post-build-variant-condition{matching-criterion=RDR_POS, value=7}, CanIfTxPduRef=RDR_TRACKER_OBJ_009_oPCAN_RADAR_87a0a9db_Tx
        RDR_TRACKER_OBJ_018_oPCAN_RADAR_8ef5f2bb_Tx: CanIfTxPduCanId=1313 if post-build-variant-condition{matching-criterion=RDR_POS, value=0}, CanIfTxPduId=155, CanIfTxPduCanId=1377 if post-build-variant-condition{matching-criterion=RDR_POS, value=1}, CanIfTxPduCanId=1441 if post-build-variant-condition{matching-criterion=RDR_POS, value=2}, CanIfTxPduCanId=1505 if post-build-variant-condition{matching-criterion=RDR_POS, value=3}, CanIfTxPduCanId=1569 if post-build-variant-condition{matching-criterion=RDR_POS, value=4}, CanIfTxPduCanId=1633 if post-build-variant-condition{matching-criterion=RDR_POS, value=5}, CanIfTxPduCanId=1697 if post-build-variant-condition{matching-criterion=RDR_POS, value=6}, CanIfTxPduCanId=1761 if post-build-variant-condition{matching-criterion=RDR_POS, value=7}, CanIfTxPduRef=RDR_TRACKER_OBJ_018_oPCAN_RADAR_95d0681e_Tx
        RDR_DETECTION_113_116_oPCAN_RADAR_7b25270e_Tx: CanIfTxPduCanId=284 if post-build-variant-condition{matching-criterion=RDR_POS, value=0}, CanIfTxPduId=61, CanIfTxPduCanId=412 if post-build-variant-condition{matching-criterion=RDR_POS, value=1}, CanIfTxPduCanId=540 if post-build-variant-condition{matching-criterion=RDR_POS, value=2}, CanIfTxPduCanId=668 if post-build-variant-condition{matching-criterion=RDR_POS, value=3}, CanIfTxPduCanId=796 if post-build-variant-condition{matching-criterion=RDR_POS, value=4}, CanIfTxPduCanId=924 if post-build-variant-condition{matching-criterion=RDR_POS, value=5}, CanIfTxPduCanId=1052 if post-build-variant-condition{matching-criterion=RDR_POS, value=6}, CanIfTxPduCanId=1180 if post-build-variant-condition{matching-criterion=RDR_POS, value=7}, CanIfTxPduRef=RDR_DETECTION_113_116_oPCAN_RADAR_44041891_Tx
        RDR_DETECTION_137_140_oPCAN_RADAR_233e33d9_Tx: CanIfTxPduCanId=290 if post-build-variant-condition{matching-criterion=RDR_POS, value=0}, CanIfTxPduId=67, CanIfTxPduCanId=418 if post-build-variant-condition{matching-criterion=RDR_POS, value=1}, CanIfTxPduCanId=546 if post-build-variant-condition{matching-criterion=RDR_POS, value=2}, CanIfTxPduCanId=674 if post-build-variant-condition{matching-criterion=RDR_POS, value=3}, CanIfTxPduCanId=802 if post-build-variant-condition{matching-criterion=RDR_POS, value=4}, CanIfTxPduCanId=930 if post-build-variant-condition{matching-criterion=RDR_POS, value=5}, CanIfTxPduCanId=1058 if post-build-variant-condition{matching-criterion=RDR_POS, value=6}, CanIfTxPduCanId=1186 if post-build-variant-condition{matching-criterion=RDR_POS, value=7}, CanIfTxPduRef=RDR_DETECTION_137_140_oPCAN_RADAR_ea93c46f_Tx
        RDR_DETECTION_305_308_oPCAN_RADAR_5de34171_Tx: CanIfTxPduCanId=332 if post-build-variant-condition{matching-criterion=RDR_POS, value=0}, CanIfTxPduId=109, CanIfTxPduCanId=460 if post-build-variant-condition{matching-criterion=RDR_POS, value=1}, CanIfTxPduCanId=588 if post-build-variant-condition{matching-criterion=RDR_POS, value=2}, CanIfTxPduCanId=716 if post-build-variant-condition{matching-criterion=RDR_POS, value=3}, CanIfTxPduCanId=844 if post-build-variant-condition{matching-criterion=RDR_POS, value=4}, CanIfTxPduCanId=972 if post-build-variant-condition{matching-criterion=RDR_POS, value=5}, CanIfTxPduCanId=1100 if post-build-variant-condition{matching-criterion=RDR_POS, value=6}, CanIfTxPduCanId=1228 if post-build-variant-condition{matching-criterion=RDR_POS, value=7}, CanIfTxPduRef=RDR_DETECTION_305_308_oPCAN_RADAR_5a5917f5_Tx
        RDR_TRACKER_OBJ_052_oPCAN_RADAR_1ca2aaa6_Tx: CanIfTxPduCanId=1347 if post-build-variant-condition{matching-criterion=RDR_POS, value=0}, CanIfTxPduId=190, CanIfTxPduCanId=1411 if post-build-variant-condition{matching-criterion=RDR_POS, value=1}, CanIfTxPduCanId=1475 if post-build-variant-condition{matching-criterion=RDR_POS, value=2}, CanIfTxPduCanId=1539 if post-build-variant-condition{matching-criterion=RDR_POS, value=3}, CanIfTxPduCanId=1603 if post-build-variant-condition{matching-criterion=RDR_POS, value=4}, CanIfTxPduCanId=1667 if post-build-variant-condition{matching-criterion=RDR_POS, value=5}, CanIfTxPduCanId=1731 if post-build-variant-condition{matching-criterion=RDR_POS, value=6}, CanIfTxPduCanId=1795 if post-build-variant-condition{matching-criterion=RDR_POS, value=7}, CanIfTxPduRef=RDR_TRACKER_OBJ_052_oPCAN_RADAR_06d98cf9_Tx
        RDR_HEADER_001_oPCAN_RADAR_051a0060_Tx: CanIfTxPduCanId=128 if post-build-variant-condition{matching-criterion=RDR_POS, value=0}, CanIfTxPduId=133, CanIfTxPduCanId=136 if post-build-variant-condition{matching-criterion=RDR_POS, value=1}, CanIfTxPduCanId=144 if post-build-variant-condition{matching-criterion=RDR_POS, value=2}, CanIfTxPduCanId=152 if post-build-variant-condition{matching-criterion=RDR_POS, value=3}, CanIfTxPduCanId=160 if post-build-variant-condition{matching-criterion=RDR_POS, value=4}, CanIfTxPduCanId=168 if post-build-variant-condition{matching-criterion=RDR_POS, value=5}, CanIfTxPduCanId=176 if post-build-variant-condition{matching-criterion=RDR_POS, value=6}, CanIfTxPduCanId=184 if post-build-variant-condition{matching-criterion=RDR_POS, value=7}, CanIfTxPduRef=RDR_HEADER_001_oPCAN_RADAR_48304dbd_Tx
        RDR_DETECTION_125_128_oPCAN_RADAR_12b877a4_Tx: CanIfTxPduCanId=287 if post-build-variant-condition{matching-criterion=RDR_POS, value=0}, CanIfTxPduId=64, CanIfTxPduCanId=415 if post-build-variant-condition{matching-criterion=RDR_POS, value=1}, CanIfTxPduCanId=543 if post-build-variant-condition{matching-criterion=RDR_POS, value=2}, CanIfTxPduCanId=671 if post-build-variant-condition{matching-criterion=RDR_POS, value=3}, CanIfTxPduCanId=799 if post-build-variant-condition{matching-criterion=RDR_POS, value=4}, CanIfTxPduCanId=927 if post-build-variant-condition{matching-criterion=RDR_POS, value=5}, CanIfTxPduCanId=1055 if post-build-variant-condition{matching-criterion=RDR_POS, value=6}, CanIfTxPduCanId=1183 if post-build-variant-condition{matching-criterion=RDR_POS, value=7}, CanIfTxPduRef=RDR_DETECTION_125_128_oPCAN_RADAR_0a62769f_Tx
        RDR_DETECTION_161_164_oPCAN_RADAR_2693aab2_Tx: CanIfTxPduCanId=296 if post-build-variant-condition{matching-criterion=RDR_POS, value=0}, CanIfTxPduId=73, CanIfTxPduCanId=424 if post-build-variant-condition{matching-criterion=RDR_POS, value=1}, CanIfTxPduCanId=552 if post-build-variant-condition{matching-criterion=RDR_POS, value=2}, CanIfTxPduCanId=680 if post-build-variant-condition{matching-criterion=RDR_POS, value=3}, CanIfTxPduCanId=808 if post-build-variant-condition{matching-criterion=RDR_POS, value=4}, CanIfTxPduCanId=936 if post-build-variant-condition{matching-criterion=RDR_POS, value=5}, CanIfTxPduCanId=1064 if post-build-variant-condition{matching-criterion=RDR_POS, value=6}, CanIfTxPduCanId=1192 if post-build-variant-condition{matching-criterion=RDR_POS, value=7}, CanIfTxPduRef=RDR_DETECTION_161_164_oPCAN_RADAR_1aa75ba6_Tx
        RDR_TRACKER_OBJ_037_oPCAN_RADAR_69a1cb8f_Tx: CanIfTxPduCanId=1332 if post-build-variant-condition{matching-criterion=RDR_POS, value=0}, CanIfTxPduId=174, CanIfTxPduCanId=1396 if post-build-variant-condition{matching-criterion=RDR_POS, value=1}, CanIfTxPduCanId=1460 if post-build-variant-condition{matching-criterion=RDR_POS, value=2}, CanIfTxPduCanId=1524 if post-build-variant-condition{matching-criterion=RDR_POS, value=3}, CanIfTxPduCanId=1588 if post-build-variant-condition{matching-criterion=RDR_POS, value=4}, CanIfTxPduCanId=1652 if post-build-variant-condition{matching-criterion=RDR_POS, value=5}, CanIfTxPduCanId=1716 if post-build-variant-condition{matching-criterion=RDR_POS, value=6}, CanIfTxPduCanId=1780 if post-build-variant-condition{matching-criterion=RDR_POS, value=7}, CanIfTxPduRef=RDR_TRACKER_OBJ_037_oPCAN_RADAR_30ecb972_Tx
        RDR_DETECTION_209_212_oPCAN_RADAR_bc6133dd_Tx: CanIfTxPduCanId=308 if post-build-variant-condition{matching-criterion=RDR_POS, value=0}, CanIfTxPduId=85, CanIfTxPduCanId=436 if post-build-variant-condition{matching-criterion=RDR_POS, value=1}, CanIfTxPduCanId=564 if post-build-variant-condition{matching-criterion=RDR_POS, value=2}, CanIfTxPduCanId=692 if post-build-variant-condition{matching-criterion=RDR_POS, value=3}, CanIfTxPduCanId=820 if post-build-variant-condition{matching-criterion=RDR_POS, value=4}, CanIfTxPduCanId=948 if post-build-variant-condition{matching-criterion=RDR_POS, value=5}, CanIfTxPduCanId=1076 if post-build-variant-condition{matching-criterion=RDR_POS, value=6}, CanIfTxPduCanId=1204 if post-build-variant-condition{matching-criterion=RDR_POS, value=7}, CanIfTxPduRef=RDR_DETECTION_209_212_oPCAN_RADAR_4c39015c_Tx
        RDR_DETECTION_381_384_oPCAN_RADAR_91fe7df2_Tx: CanIfTxPduCanId=351 if post-build-variant-condition{matching-criterion=RDR_POS, value=0}, CanIfTxPduId=128, CanIfTxPduCanId=479 if post-build-variant-condition{matching-criterion=RDR_POS, value=1}, CanIfTxPduCanId=607 if post-build-variant-condition{matching-criterion=RDR_POS, value=2}, CanIfTxPduCanId=735 if post-build-variant-condition{matching-criterion=RDR_POS, value=3}, CanIfTxPduCanId=863 if post-build-variant-condition{matching-criterion=RDR_POS, value=4}, CanIfTxPduCanId=991 if post-build-variant-condition{matching-criterion=RDR_POS, value=5}, CanIfTxPduCanId=1119 if post-build-variant-condition{matching-criterion=RDR_POS, value=6}, CanIfTxPduCanId=1247 if post-build-variant-condition{matching-criterion=RDR_POS, value=7}, CanIfTxPduRef=RDR_DETECTION_381_384_oPCAN_RADAR_cb27f638_Tx
        RDR_TRACKER_OBJ_011_oPCAN_RADAR_d26c625a_Tx: CanIfTxPduCanId=1306 if post-build-variant-condition{matching-criterion=RDR_POS, value=0}, CanIfTxPduId=148, CanIfTxPduCanId=1370 if post-build-variant-condition{matching-criterion=RDR_POS, value=1}, CanIfTxPduCanId=1434 if post-build-variant-condition{matching-criterion=RDR_POS, value=2}, CanIfTxPduCanId=1498 if post-build-variant-condition{matching-criterion=RDR_POS, value=3}, CanIfTxPduCanId=1562 if post-build-variant-condition{matching-criterion=RDR_POS, value=4}, CanIfTxPduCanId=1626 if post-build-variant-condition{matching-criterion=RDR_POS, value=5}, CanIfTxPduCanId=1690 if post-build-variant-condition{matching-criterion=RDR_POS, value=6}, CanIfTxPduCanId=1754 if post-build-variant-condition{matching-criterion=RDR_POS, value=7}, CanIfTxPduRef=RDR_TRACKER_OBJ_011_oPCAN_RADAR_cfc77934_Tx
        RDR_DETECTION_029_032_oPCAN_RADAR_f33a0508_Tx: CanIfTxPduCanId=263 if post-build-variant-condition{matching-criterion=RDR_POS, value=0}, CanIfTxPduId=40, CanIfTxPduCanId=391 if post-build-variant-condition{matching-criterion=RDR_POS, value=1}, CanIfTxPduCanId=519 if post-build-variant-condition{matching-criterion=RDR_POS, value=2}, CanIfTxPduCanId=647 if post-build-variant-condition{matching-criterion=RDR_POS, value=3}, CanIfTxPduCanId=775 if post-build-variant-condition{matching-criterion=RDR_POS, value=4}, CanIfTxPduCanId=903 if post-build-variant-condition{matching-criterion=RDR_POS, value=5}, CanIfTxPduCanId=1031 if post-build-variant-condition{matching-criterion=RDR_POS, value=6}, CanIfTxPduCanId=1159 if post-build-variant-condition{matching-criterion=RDR_POS, value=7}, CanIfTxPduRef=RDR_DETECTION_029_032_oPCAN_RADAR_1c026036_Tx
        RDR_DETECTION_097_100_oPCAN_RADAR_9189e332_Tx: CanIfTxPduCanId=280 if post-build-variant-condition{matching-criterion=RDR_POS, value=0}, CanIfTxPduId=57, CanIfTxPduCanId=408 if post-build-variant-condition{matching-criterion=RDR_POS, value=1}, CanIfTxPduCanId=536 if post-build-variant-condition{matching-criterion=RDR_POS, value=2}, CanIfTxPduCanId=664 if post-build-variant-condition{matching-criterion=RDR_POS, value=3}, CanIfTxPduCanId=792 if post-build-variant-condition{matching-criterion=RDR_POS, value=4}, CanIfTxPduCanId=920 if post-build-variant-condition{matching-criterion=RDR_POS, value=5}, CanIfTxPduCanId=1048 if post-build-variant-condition{matching-criterion=RDR_POS, value=6}, CanIfTxPduCanId=1176 if post-build-variant-condition{matching-criterion=RDR_POS, value=7}, CanIfTxPduRef=RDR_DETECTION_097_100_oPCAN_RADAR_41128c0d_Tx
        RDR_ALIGNMENT_STATUS_001_oPCAN_RADAR_caaee0a2_Tx: CanIfTxPduCanId=133 if post-build-variant-condition{matching-criterion=RDR_POS, value=0}, CanIfTxPduId=29, CanIfTxPduCanId=141 if post-build-variant-condition{matching-criterion=RDR_POS, value=1}, CanIfTxPduCanId=149 if post-build-variant-condition{matching-criterion=RDR_POS, value=2}, CanIfTxPduCanId=157 if post-build-variant-condition{matching-criterion=RDR_POS, value=3}, CanIfTxPduCanId=165 if post-build-variant-condition{matching-criterion=RDR_POS, value=4}, CanIfTxPduCanId=173 if post-build-variant-condition{matching-criterion=RDR_POS, value=5}, CanIfTxPduCanId=181 if post-build-variant-condition{matching-criterion=RDR_POS, value=6}, CanIfTxPduCanId=189 if post-build-variant-condition{matching-criterion=RDR_POS, value=7}, CanIfTxPduRef=RDR_ALIGNMENT_STATUS_001_oPCAN_RADAR_4f94d655_Tx
        RDR_TRACKER_OBJ_027_oPCAN_RADAR_c6a11abe_Tx: CanIfTxPduCanId=1322 if post-build-variant-condition{matching-criterion=RDR_POS, value=0}, CanIfTxPduId=164, CanIfTxPduCanId=1386 if post-build-variant-condition{matching-criterion=RDR_POS, value=1}, CanIfTxPduCanId=1450 if post-build-variant-condition{matching-criterion=RDR_POS, value=2}, CanIfTxPduCanId=1514 if post-build-variant-condition{matching-criterion=RDR_POS, value=3}, CanIfTxPduCanId=1578 if post-build-variant-condition{matching-criterion=RDR_POS, value=4}, CanIfTxPduCanId=1642 if post-build-variant-condition{matching-criterion=RDR_POS, value=5}, CanIfTxPduCanId=1706 if post-build-variant-condition{matching-criterion=RDR_POS, value=6}, CanIfTxPduCanId=1770 if post-build-variant-condition{matching-criterion=RDR_POS, value=7}, CanIfTxPduRef=RDR_TRACKER_OBJ_027_oPCAN_RADAR_146ee844_Tx
        RDR_DETECTION_345_348_oPCAN_RADAR_bcde1c3d_Tx: CanIfTxPduCanId=342 if post-build-variant-condition{matching-criterion=RDR_POS, value=0}, CanIfTxPduId=119, CanIfTxPduCanId=470 if post-build-variant-condition{matching-criterion=RDR_POS, value=1}, CanIfTxPduCanId=598 if post-build-variant-condition{matching-criterion=RDR_POS, value=2}, CanIfTxPduCanId=726 if post-build-variant-condition{matching-criterion=RDR_POS, value=3}, CanIfTxPduCanId=854 if post-build-variant-condition{matching-criterion=RDR_POS, value=4}, CanIfTxPduCanId=982 if post-build-variant-condition{matching-criterion=RDR_POS, value=5}, CanIfTxPduCanId=1110 if post-build-variant-condition{matching-criterion=RDR_POS, value=6}, CanIfTxPduCanId=1238 if post-build-variant-condition{matching-criterion=RDR_POS, value=7}, CanIfTxPduRef=RDR_DETECTION_345_348_oPCAN_RADAR_93e0ae66_Tx
        RDR_DETECTION_333_336_oPCAN_RADAR_347e11db_Tx: CanIfTxPduCanId=339 if post-build-variant-condition{matching-criterion=RDR_POS, value=0}, CanIfTxPduId=116, CanIfTxPduCanId=467 if post-build-variant-condition{matching-criterion=RDR_POS, value=1}, CanIfTxPduCanId=595 if post-build-variant-condition{matching-criterion=RDR_POS, value=2}, CanIfTxPduCanId=723 if post-build-variant-condition{matching-criterion=RDR_POS, value=3}, CanIfTxPduCanId=851 if post-build-variant-condition{matching-criterion=RDR_POS, value=4}, CanIfTxPduCanId=979 if post-build-variant-condition{matching-criterion=RDR_POS, value=5}, CanIfTxPduCanId=1107 if post-build-variant-condition{matching-criterion=RDR_POS, value=6}, CanIfTxPduCanId=1235 if post-build-variant-condition{matching-criterion=RDR_POS, value=7}, CanIfTxPduRef=RDR_DETECTION_333_336_oPCAN_RADAR_143f79fb_Tx
        RDR_TRACKER_OBJ_055_oPCAN_RADAR_28d5daf9_Tx: CanIfTxPduCanId=1350 if post-build-variant-condition{matching-criterion=RDR_POS, value=0}, CanIfTxPduId=193, CanIfTxPduCanId=1414 if post-build-variant-condition{matching-criterion=RDR_POS, value=1}, CanIfTxPduCanId=1478 if post-build-variant-condition{matching-criterion=RDR_POS, value=2}, CanIfTxPduCanId=1542 if post-build-variant-condition{matching-criterion=RDR_POS, value=3}, CanIfTxPduCanId=1606 if post-build-variant-condition{matching-criterion=RDR_POS, value=4}, CanIfTxPduCanId=1670 if post-build-variant-condition{matching-criterion=RDR_POS, value=5}, CanIfTxPduCanId=1734 if post-build-variant-condition{matching-criterion=RDR_POS, value=6}, CanIfTxPduCanId=1798 if post-build-variant-condition{matching-criterion=RDR_POS, value=7}, CanIfTxPduRef=RDR_TRACKER_OBJ_055_oPCAN_RADAR_86047e20_Tx
        RDR_STATUS_002_oPCAN_RADAR_b26a35a7_Tx: CanIfTxPduCanId=132 if post-build-variant-condition{matching-criterion=RDR_POS, value=0}, CanIfTxPduId=137, CanIfTxPduCanId=140 if post-build-variant-condition{matching-criterion=RDR_POS, value=1}, CanIfTxPduCanId=148 if post-build-variant-condition{matching-criterion=RDR_POS, value=2}, CanIfTxPduCanId=156 if post-build-variant-condition{matching-criterion=RDR_POS, value=3}, CanIfTxPduCanId=164 if post-build-variant-condition{matching-criterion=RDR_POS, value=4}, CanIfTxPduCanId=172 if post-build-variant-condition{matching-criterion=RDR_POS, value=5}, CanIfTxPduCanId=180 if post-build-variant-condition{matching-criterion=RDR_POS, value=6}, CanIfTxPduCanId=188 if post-build-variant-condition{matching-criterion=RDR_POS, value=7}, CanIfTxPduRef=RDR_STATUS_002_oPCAN_RADAR_85a3c9df_Tx
        RDR_DETECTION_177_180_oPCAN_RADAR_a8559db3_Tx: CanIfTxPduCanId=300 if post-build-variant-condition{matching-criterion=RDR_POS, value=0}, CanIfTxPduId=77, CanIfTxPduCanId=428 if post-build-variant-condition{matching-criterion=RDR_POS, value=1}, CanIfTxPduCanId=556 if post-build-variant-condition{matching-criterion=RDR_POS, value=2}, CanIfTxPduCanId=684 if post-build-variant-condition{matching-criterion=RDR_POS, value=3}, CanIfTxPduCanId=812 if post-build-variant-condition{matching-criterion=RDR_POS, value=4}, CanIfTxPduCanId=940 if post-build-variant-condition{matching-criterion=RDR_POS, value=5}, CanIfTxPduCanId=1068 if post-build-variant-condition{matching-criterion=RDR_POS, value=6}, CanIfTxPduCanId=1196 if post-build-variant-condition{matching-criterion=RDR_POS, value=7}, CanIfTxPduRef=RDR_DETECTION_177_180_oPCAN_RADAR_dc49f20d_Tx
        RDR_DETECTION_077_080_oPCAN_RADAR_5a0fd2aa_Tx: CanIfTxPduCanId=275 if post-build-variant-condition{matching-criterion=RDR_POS, value=0}, CanIfTxPduId=52, CanIfTxPduCanId=403 if post-build-variant-condition{matching-criterion=RDR_POS, value=1}, CanIfTxPduCanId=531 if post-build-variant-condition{matching-criterion=RDR_POS, value=2}, CanIfTxPduCanId=659 if post-build-variant-condition{matching-criterion=RDR_POS, value=3}, CanIfTxPduCanId=787 if post-build-variant-condition{matching-criterion=RDR_POS, value=4}, CanIfTxPduCanId=915 if post-build-variant-condition{matching-criterion=RDR_POS, value=5}, CanIfTxPduCanId=1043 if post-build-variant-condition{matching-criterion=RDR_POS, value=6}, CanIfTxPduCanId=1171 if post-build-variant-condition{matching-criterion=RDR_POS, value=7}, CanIfTxPduRef=RDR_DETECTION_077_080_oPCAN_RADAR_5d5eee6c_Tx
        RDR_DETECTION_053_056_oPCAN_RADAR_6842355b_Tx: CanIfTxPduCanId=269 if post-build-variant-condition{matching-criterion=RDR_POS, value=0}, CanIfTxPduId=46, CanIfTxPduCanId=397 if post-build-variant-condition{matching-criterion=RDR_POS, value=1}, CanIfTxPduCanId=525 if post-build-variant-condition{matching-criterion=RDR_POS, value=2}, CanIfTxPduCanId=653 if post-build-variant-condition{matching-criterion=RDR_POS, value=3}, CanIfTxPduCanId=781 if post-build-variant-condition{matching-criterion=RDR_POS, value=4}, CanIfTxPduCanId=909 if post-build-variant-condition{matching-criterion=RDR_POS, value=5}, CanIfTxPduCanId=1037 if post-build-variant-condition{matching-criterion=RDR_POS, value=6}, CanIfTxPduCanId=1165 if post-build-variant-condition{matching-criterion=RDR_POS, value=7}, CanIfTxPduRef=RDR_DETECTION_053_056_oPCAN_RADAR_0caabd63_Tx
        RDR_DETECTION_273_276_oPCAN_RADAR_2719038e_Tx: CanIfTxPduCanId=324 if post-build-variant-condition{matching-criterion=RDR_POS, value=0}, CanIfTxPduId=101, CanIfTxPduCanId=452 if post-build-variant-condition{matching-criterion=RDR_POS, value=1}, CanIfTxPduCanId=580 if post-build-variant-condition{matching-criterion=RDR_POS, value=2}, CanIfTxPduCanId=708 if post-build-variant-condition{matching-criterion=RDR_POS, value=3}, CanIfTxPduCanId=836 if post-build-variant-condition{matching-criterion=RDR_POS, value=4}, CanIfTxPduCanId=964 if post-build-variant-condition{matching-criterion=RDR_POS, value=5}, CanIfTxPduCanId=1092 if post-build-variant-condition{matching-criterion=RDR_POS, value=6}, CanIfTxPduCanId=1220 if post-build-variant-condition{matching-criterion=RDR_POS, value=7}, CanIfTxPduRef=RDR_DETECTION_273_276_oPCAN_RADAR_5c91dc09_Tx
        RDR_TRACKER_OBJ_019_oPCAN_RADAR_843f8f12_Tx: CanIfTxPduCanId=1314 if post-build-variant-condition{matching-criterion=RDR_POS, value=0}, CanIfTxPduId=156, CanIfTxPduCanId=1378 if post-build-variant-condition{matching-criterion=RDR_POS, value=1}, CanIfTxPduCanId=1442 if post-build-variant-condition{matching-criterion=RDR_POS, value=2}, CanIfTxPduCanId=1506 if post-build-variant-condition{matching-criterion=RDR_POS, value=3}, CanIfTxPduCanId=1570 if post-build-variant-condition{matching-criterion=RDR_POS, value=4}, CanIfTxPduCanId=1634 if post-build-variant-condition{matching-criterion=RDR_POS, value=5}, CanIfTxPduCanId=1698 if post-build-variant-condition{matching-criterion=RDR_POS, value=6}, CanIfTxPduCanId=1762 if post-build-variant-condition{matching-criterion=RDR_POS, value=7}, CanIfTxPduRef=RDR_TRACKER_OBJ_019_oPCAN_RADAR_a322f8ed_Tx
        RDR_TRACKER_OBJ_028_oPCAN_RADAR_a48587a9_Tx: CanIfTxPduCanId=1323 if post-build-variant-condition{matching-criterion=RDR_POS, value=0}, CanIfTxPduId=165, CanIfTxPduCanId=1387 if post-build-variant-condition{matching-criterion=RDR_POS, value=1}, CanIfTxPduCanId=1451 if post-build-variant-condition{matching-criterion=RDR_POS, value=2}, CanIfTxPduCanId=1515 if post-build-variant-condition{matching-criterion=RDR_POS, value=3}, CanIfTxPduCanId=1579 if post-build-variant-condition{matching-criterion=RDR_POS, value=4}, CanIfTxPduCanId=1643 if post-build-variant-condition{matching-criterion=RDR_POS, value=5}, CanIfTxPduCanId=1707 if post-build-variant-condition{matching-criterion=RDR_POS, value=6}, CanIfTxPduCanId=1771 if post-build-variant-condition{matching-criterion=RDR_POS, value=7}, CanIfTxPduRef=RDR_TRACKER_OBJ_028_oPCAN_RADAR_f8569b44_Tx
        RDR_TRACKER_OBJ_015_oPCAN_RADAR_f94594fe_Tx: CanIfTxPduCanId=1310 if post-build-variant-condition{matching-criterion=RDR_POS, value=0}, CanIfTxPduId=152, CanIfTxPduCanId=1374 if post-build-variant-condition{matching-criterion=RDR_POS, value=1}, CanIfTxPduCanId=1438 if post-build-variant-condition{matching-criterion=RDR_POS, value=2}, CanIfTxPduCanId=1502 if post-build-variant-condition{matching-criterion=RDR_POS, value=3}, CanIfTxPduCanId=1566 if post-build-variant-condition{matching-criterion=RDR_POS, value=4}, CanIfTxPduCanId=1630 if post-build-variant-condition{matching-criterion=RDR_POS, value=5}, CanIfTxPduCanId=1694 if post-build-variant-condition{matching-criterion=RDR_POS, value=6}, CanIfTxPduCanId=1758 if post-build-variant-condition{matching-criterion=RDR_POS, value=7}, CanIfTxPduRef=RDR_TRACKER_OBJ_015_oPCAN_RADAR_140d3af8_Tx
        RDR_TRACKER_OBJ_010_oPCAN_RADAR_d8a61ff3_Tx: CanIfTxPduCanId=1305 if post-build-variant-condition{matching-criterion=RDR_POS, value=0}, CanIfTxPduId=147, CanIfTxPduCanId=1369 if post-build-variant-condition{matching-criterion=RDR_POS, value=1}, CanIfTxPduCanId=1433 if post-build-variant-condition{matching-criterion=RDR_POS, value=2}, CanIfTxPduCanId=1497 if post-build-variant-condition{matching-criterion=RDR_POS, value=3}, CanIfTxPduCanId=1561 if post-build-variant-condition{matching-criterion=RDR_POS, value=4}, CanIfTxPduCanId=1625 if post-build-variant-condition{matching-criterion=RDR_POS, value=5}, CanIfTxPduCanId=1689 if post-build-variant-condition{matching-criterion=RDR_POS, value=6}, CanIfTxPduCanId=1753 if post-build-variant-condition{matching-criterion=RDR_POS, value=7}, CanIfTxPduRef=RDR_TRACKER_OBJ_010_oPCAN_RADAR_f935e9c7_Tx
        RDR_DETECTION_165_168_oPCAN_RADAR_f3852ae8_Tx: CanIfTxPduCanId=297 if post-build-variant-condition{matching-criterion=RDR_POS, value=0}, CanIfTxPduId=74, CanIfTxPduCanId=425 if post-build-variant-condition{matching-criterion=RDR_POS, value=1}, CanIfTxPduCanId=553 if post-build-variant-condition{matching-criterion=RDR_POS, value=2}, CanIfTxPduCanId=681 if post-build-variant-condition{matching-criterion=RDR_POS, value=3}, CanIfTxPduCanId=809 if post-build-variant-condition{matching-criterion=RDR_POS, value=4}, CanIfTxPduCanId=937 if post-build-variant-condition{matching-criterion=RDR_POS, value=5}, CanIfTxPduCanId=1065 if post-build-variant-condition{matching-criterion=RDR_POS, value=6}, CanIfTxPduCanId=1193 if post-build-variant-condition{matching-criterion=RDR_POS, value=7}, CanIfTxPduRef=RDR_DETECTION_165_168_oPCAN_RADAR_c3dbcf0c_Tx
        RDR_DETECTION_397_400_oPCAN_RADAR_ec04aa3c_Tx: CanIfTxPduCanId=355 if post-build-variant-condition{matching-criterion=RDR_POS, value=0}, CanIfTxPduId=132, CanIfTxPduCanId=483 if post-build-variant-condition{matching-criterion=RDR_POS, value=1}, CanIfTxPduCanId=611 if post-build-variant-condition{matching-criterion=RDR_POS, value=2}, CanIfTxPduCanId=739 if post-build-variant-condition{matching-criterion=RDR_POS, value=3}, CanIfTxPduCanId=867 if post-build-variant-condition{matching-criterion=RDR_POS, value=4}, CanIfTxPduCanId=995 if post-build-variant-condition{matching-criterion=RDR_POS, value=5}, CanIfTxPduCanId=1123 if post-build-variant-condition{matching-criterion=RDR_POS, value=6}, CanIfTxPduCanId=1251 if post-build-variant-condition{matching-criterion=RDR_POS, value=7}, CanIfTxPduRef=RDR_DETECTION_397_400_oPCAN_RADAR_d58dd49c_Tx
        RDR_DETECTION_377_380_oPCAN_RADAR_979005c0_Tx: CanIfTxPduCanId=350 if post-build-variant-condition{matching-criterion=RDR_POS, value=0}, CanIfTxPduId=127, CanIfTxPduCanId=478 if post-build-variant-condition{matching-criterion=RDR_POS, value=1}, CanIfTxPduCanId=606 if post-build-variant-condition{matching-criterion=RDR_POS, value=2}, CanIfTxPduCanId=734 if post-build-variant-condition{matching-criterion=RDR_POS, value=3}, CanIfTxPduCanId=862 if post-build-variant-condition{matching-criterion=RDR_POS, value=4}, CanIfTxPduCanId=990 if post-build-variant-condition{matching-criterion=RDR_POS, value=5}, CanIfTxPduCanId=1118 if post-build-variant-condition{matching-criterion=RDR_POS, value=6}, CanIfTxPduCanId=1246 if post-build-variant-condition{matching-criterion=RDR_POS, value=7}, CanIfTxPduRef=RDR_DETECTION_377_380_oPCAN_RADAR_0516cc8e_Tx
        RDR_DETECTION_021_024_oPCAN_RADAR_35f4b8e7_Tx: CanIfTxPduCanId=261 if post-build-variant-condition{matching-criterion=RDR_POS, value=0}, CanIfTxPduId=38, CanIfTxPduCanId=389 if post-build-variant-condition{matching-criterion=RDR_POS, value=1}, CanIfTxPduCanId=517 if post-build-variant-condition{matching-criterion=RDR_POS, value=2}, CanIfTxPduCanId=645 if post-build-variant-condition{matching-criterion=RDR_POS, value=3}, CanIfTxPduCanId=773 if post-build-variant-condition{matching-criterion=RDR_POS, value=4}, CanIfTxPduCanId=901 if post-build-variant-condition{matching-criterion=RDR_POS, value=5}, CanIfTxPduCanId=1029 if post-build-variant-condition{matching-criterion=RDR_POS, value=6}, CanIfTxPduCanId=1157 if post-build-variant-condition{matching-criterion=RDR_POS, value=7}, CanIfTxPduRef=RDR_DETECTION_021_024_oPCAN_RADAR_5209fe54_Tx
        RDR_DETECTION_049_052_oPCAN_RADAR_6299f6e2_Tx: CanIfTxPduCanId=268 if post-build-variant-condition{matching-criterion=RDR_POS, value=0}, CanIfTxPduId=45, CanIfTxPduCanId=396 if post-build-variant-condition{matching-criterion=RDR_POS, value=1}, CanIfTxPduCanId=524 if post-build-variant-condition{matching-criterion=RDR_POS, value=2}, CanIfTxPduCanId=652 if post-build-variant-condition{matching-criterion=RDR_POS, value=3}, CanIfTxPduCanId=780 if post-build-variant-condition{matching-criterion=RDR_POS, value=4}, CanIfTxPduCanId=908 if post-build-variant-condition{matching-criterion=RDR_POS, value=5}, CanIfTxPduCanId=1036 if post-build-variant-condition{matching-criterion=RDR_POS, value=6}, CanIfTxPduCanId=1164 if post-build-variant-condition{matching-criterion=RDR_POS, value=7}, CanIfTxPduRef=RDR_DETECTION_049_052_oPCAN_RADAR_5cdf864c_Tx
        RDR_TRACKER_OBJ_057_oPCAN_RADAR_3d4121ab_Tx: CanIfTxPduCanId=1352 if post-build-variant-condition{matching-criterion=RDR_POS, value=0}, CanIfTxPduId=195, CanIfTxPduCanId=1416 if post-build-variant-condition{matching-criterion=RDR_POS, value=1}, CanIfTxPduCanId=1480 if post-build-variant-condition{matching-criterion=RDR_POS, value=2}, CanIfTxPduCanId=1544 if post-build-variant-condition{matching-criterion=RDR_POS, value=3}, CanIfTxPduCanId=1608 if post-build-variant-condition{matching-criterion=RDR_POS, value=4}, CanIfTxPduCanId=1672 if post-build-variant-condition{matching-criterion=RDR_POS, value=5}, CanIfTxPduCanId=1736 if post-build-variant-condition{matching-criterion=RDR_POS, value=6}, CanIfTxPduCanId=1800 if post-build-variant-condition{matching-criterion=RDR_POS, value=7}, CanIfTxPduRef=RDR_TRACKER_OBJ_057_oPCAN_RADAR_ebe15fc6_Tx
        RDR_DETECTION_001_004_oPCAN_RADAR_456a1641_Tx: CanIfTxPduCanId=256 if post-build-variant-condition{matching-criterion=RDR_POS, value=0}, CanIfTxPduId=33, CanIfTxPduCanId=384 if post-build-variant-condition{matching-criterion=RDR_POS, value=1}, CanIfTxPduCanId=512 if post-build-variant-condition{matching-criterion=RDR_POS, value=2}, CanIfTxPduCanId=640 if post-build-variant-condition{matching-criterion=RDR_POS, value=3}, CanIfTxPduCanId=768 if post-build-variant-condition{matching-criterion=RDR_POS, value=4}, CanIfTxPduCanId=896 if post-build-variant-condition{matching-criterion=RDR_POS, value=5}, CanIfTxPduCanId=1024 if post-build-variant-condition{matching-criterion=RDR_POS, value=6}, CanIfTxPduCanId=1152 if post-build-variant-condition{matching-criterion=RDR_POS, value=7}, CanIfTxPduRef=RDR_DETECTION_001_004_oPCAN_RADAR_db6da1bd_Tx
        RDR_DETECTION_109_112_oPCAN_RADAR_71fee4b7_Tx: CanIfTxPduCanId=283 if post-build-variant-condition{matching-criterion=RDR_POS, value=0}, CanIfTxPduId=60, CanIfTxPduCanId=411 if post-build-variant-condition{matching-criterion=RDR_POS, value=1}, CanIfTxPduCanId=539 if post-build-variant-condition{matching-criterion=RDR_POS, value=2}, CanIfTxPduCanId=667 if post-build-variant-condition{matching-criterion=RDR_POS, value=3}, CanIfTxPduCanId=795 if post-build-variant-condition{matching-criterion=RDR_POS, value=4}, CanIfTxPduCanId=923 if post-build-variant-condition{matching-criterion=RDR_POS, value=5}, CanIfTxPduCanId=1051 if post-build-variant-condition{matching-criterion=RDR_POS, value=6}, CanIfTxPduCanId=1179 if post-build-variant-condition{matching-criterion=RDR_POS, value=7}, CanIfTxPduRef=RDR_DETECTION_109_112_oPCAN_RADAR_147123be_Tx
        RDR_DETECTION_337_340_oPCAN_RADAR_1cfbabaa_Tx: CanIfTxPduCanId=340 if post-build-variant-condition{matching-criterion=RDR_POS, value=0}, CanIfTxPduId=117, CanIfTxPduCanId=468 if post-build-variant-condition{matching-criterion=RDR_POS, value=1}, CanIfTxPduCanId=596 if post-build-variant-condition{matching-criterion=RDR_POS, value=2}, CanIfTxPduCanId=724 if post-build-variant-condition{matching-criterion=RDR_POS, value=3}, CanIfTxPduCanId=852 if post-build-variant-condition{matching-criterion=RDR_POS, value=4}, CanIfTxPduCanId=980 if post-build-variant-condition{matching-criterion=RDR_POS, value=5}, CanIfTxPduCanId=1108 if post-build-variant-condition{matching-criterion=RDR_POS, value=6}, CanIfTxPduCanId=1236 if post-build-variant-condition{matching-criterion=RDR_POS, value=7}, CanIfTxPduRef=RDR_DETECTION_337_340_oPCAN_RADAR_33ccfaec_Tx
        RDR_DETECTION_117_120_oPCAN_RADAR_668be4ec_Tx: CanIfTxPduCanId=285 if post-build-variant-condition{matching-criterion=RDR_POS, value=0}, CanIfTxPduId=62, CanIfTxPduCanId=413 if post-build-variant-condition{matching-criterion=RDR_POS, value=1}, CanIfTxPduCanId=541 if post-build-variant-condition{matching-criterion=RDR_POS, value=2}, CanIfTxPduCanId=669 if post-build-variant-condition{matching-criterion=RDR_POS, value=3}, CanIfTxPduCanId=797 if post-build-variant-condition{matching-criterion=RDR_POS, value=4}, CanIfTxPduCanId=925 if post-build-variant-condition{matching-criterion=RDR_POS, value=5}, CanIfTxPduCanId=1053 if post-build-variant-condition{matching-criterion=RDR_POS, value=6}, CanIfTxPduCanId=1181 if post-build-variant-condition{matching-criterion=RDR_POS, value=7}, CanIfTxPduRef=RDR_DETECTION_117_120_oPCAN_RADAR_f1fedf5e_Tx
        RDR_DETECTION_257_260_oPCAN_RADAR_4a296eca_Tx: CanIfTxPduCanId=320 if post-build-variant-condition{matching-criterion=RDR_POS, value=0}, CanIfTxPduId=97, CanIfTxPduCanId=448 if post-build-variant-condition{matching-criterion=RDR_POS, value=1}, CanIfTxPduCanId=576 if post-build-variant-condition{matching-criterion=RDR_POS, value=2}, CanIfTxPduCanId=704 if post-build-variant-condition{matching-criterion=RDR_POS, value=3}, CanIfTxPduCanId=832 if post-build-variant-condition{matching-criterion=RDR_POS, value=4}, CanIfTxPduCanId=960 if post-build-variant-condition{matching-criterion=RDR_POS, value=5}, CanIfTxPduCanId=1088 if post-build-variant-condition{matching-criterion=RDR_POS, value=6}, CanIfTxPduCanId=1216 if post-build-variant-condition{matching-criterion=RDR_POS, value=7}, CanIfTxPduRef=RDR_DETECTION_257_260_oPCAN_RADAR_600f442f_Tx
        RDR_TRACKER_OBJ_034_oPCAN_RADAR_76ff4d74_Tx: CanIfTxPduCanId=1329 if post-build-variant-condition{matching-criterion=RDR_POS, value=0}, CanIfTxPduId=171, CanIfTxPduCanId=1393 if post-build-variant-condition{matching-criterion=RDR_POS, value=1}, CanIfTxPduCanId=1457 if post-build-variant-condition{matching-criterion=RDR_POS, value=2}, CanIfTxPduCanId=1521 if post-build-variant-condition{matching-criterion=RDR_POS, value=3}, CanIfTxPduCanId=1585 if post-build-variant-condition{matching-criterion=RDR_POS, value=4}, CanIfTxPduCanId=1649 if post-build-variant-condition{matching-criterion=RDR_POS, value=5}, CanIfTxPduCanId=1713 if post-build-variant-condition{matching-criterion=RDR_POS, value=6}, CanIfTxPduCanId=1777 if post-build-variant-condition{matching-criterion=RDR_POS, value=7}, CanIfTxPduRef=RDR_TRACKER_OBJ_034_oPCAN_RADAR_6bfb0867_Tx
        RDR_ALIGNMENT_STATUS_002_oPCAN_RADAR_899d4639_Tx: CanIfTxPduCanId=134 if post-build-variant-condition{matching-criterion=RDR_POS, value=0}, CanIfTxPduId=30, CanIfTxPduCanId=142 if post-build-variant-condition{matching-criterion=RDR_POS, value=1}, CanIfTxPduCanId=150 if post-build-variant-condition{matching-criterion=RDR_POS, value=2}, CanIfTxPduCanId=158 if post-build-variant-condition{matching-criterion=RDR_POS, value=3}, CanIfTxPduCanId=166 if post-build-variant-condition{matching-criterion=RDR_POS, value=4}, CanIfTxPduCanId=174 if post-build-variant-condition{matching-criterion=RDR_POS, value=5}, CanIfTxPduCanId=182 if post-build-variant-condition{matching-criterion=RDR_POS, value=6}, CanIfTxPduCanId=190 if post-build-variant-condition{matching-criterion=RDR_POS, value=7}, CanIfTxPduRef=RDR_ALIGNMENT_STATUS_002_oPCAN_RADAR_14836740_Tx
        RDR_DETECTION_037_040_oPCAN_RADAR_d1647cc0_Tx: CanIfTxPduCanId=265 if post-build-variant-condition{matching-criterion=RDR_POS, value=0}, CanIfTxPduId=42, CanIfTxPduCanId=393 if post-build-variant-condition{matching-criterion=RDR_POS, value=1}, CanIfTxPduCanId=521 if post-build-variant-condition{matching-criterion=RDR_POS, value=2}, CanIfTxPduCanId=649 if post-build-variant-condition{matching-criterion=RDR_POS, value=3}, CanIfTxPduCanId=777 if post-build-variant-condition{matching-criterion=RDR_POS, value=4}, CanIfTxPduCanId=905 if post-build-variant-condition{matching-criterion=RDR_POS, value=5}, CanIfTxPduCanId=1033 if post-build-variant-condition{matching-criterion=RDR_POS, value=6}, CanIfTxPduCanId=1161 if post-build-variant-condition{matching-criterion=RDR_POS, value=7}, CanIfTxPduRef=RDR_DETECTION_037_040_oPCAN_RADAR_6b84d80e_Tx
        RDR_TRACKER_OBJ_023_oPCAN_RADAR_ed88ec1a_Tx: CanIfTxPduCanId=1318 if post-build-variant-condition{matching-criterion=RDR_POS, value=0}, CanIfTxPduId=160, CanIfTxPduCanId=1382 if post-build-variant-condition{matching-criterion=RDR_POS, value=1}, CanIfTxPduCanId=1446 if post-build-variant-condition{matching-criterion=RDR_POS, value=2}, CanIfTxPduCanId=1510 if post-build-variant-condition{matching-criterion=RDR_POS, value=3}, CanIfTxPduCanId=1574 if post-build-variant-condition{matching-criterion=RDR_POS, value=4}, CanIfTxPduCanId=1638 if post-build-variant-condition{matching-criterion=RDR_POS, value=5}, CanIfTxPduCanId=1702 if post-build-variant-condition{matching-criterion=RDR_POS, value=6}, CanIfTxPduCanId=1766 if post-build-variant-condition{matching-criterion=RDR_POS, value=7}, CanIfTxPduRef=RDR_TRACKER_OBJ_023_oPCAN_RADAR_cfa4ab88_Tx
        RDR_DETECTION_089_092_oPCAN_RADAR_9aaf1777_Tx: CanIfTxPduCanId=278 if post-build-variant-condition{matching-criterion=RDR_POS, value=0}, CanIfTxPduId=55, CanIfTxPduCanId=406 if post-build-variant-condition{matching-criterion=RDR_POS, value=1}, CanIfTxPduCanId=534 if post-build-variant-condition{matching-criterion=RDR_POS, value=2}, CanIfTxPduCanId=662 if post-build-variant-condition{matching-criterion=RDR_POS, value=3}, CanIfTxPduCanId=790 if post-build-variant-condition{matching-criterion=RDR_POS, value=4}, CanIfTxPduCanId=918 if post-build-variant-condition{matching-criterion=RDR_POS, value=5}, CanIfTxPduCanId=1046 if post-build-variant-condition{matching-criterion=RDR_POS, value=6}, CanIfTxPduCanId=1174 if post-build-variant-condition{matching-criterion=RDR_POS, value=7}, CanIfTxPduRef=RDR_DETECTION_089_092_oPCAN_RADAR_dd644ab8_Tx
        RDR_TRACKER_OBJ_040_oPCAN_RADAR_a63680c5_Tx: CanIfTxPduCanId=1335 if post-build-variant-condition{matching-criterion=RDR_POS, value=0}, CanIfTxPduId=177, CanIfTxPduCanId=1399 if post-build-variant-condition{matching-criterion=RDR_POS, value=1}, CanIfTxPduCanId=1463 if post-build-variant-condition{matching-criterion=RDR_POS, value=2}, CanIfTxPduCanId=1527 if post-build-variant-condition{matching-criterion=RDR_POS, value=3}, CanIfTxPduCanId=1591 if post-build-variant-condition{matching-criterion=RDR_POS, value=4}, CanIfTxPduCanId=1655 if post-build-variant-condition{matching-criterion=RDR_POS, value=5}, CanIfTxPduCanId=1719 if post-build-variant-condition{matching-criterion=RDR_POS, value=6}, CanIfTxPduCanId=1783 if post-build-variant-condition{matching-criterion=RDR_POS, value=7}, CanIfTxPduRef=RDR_TRACKER_OBJ_040_oPCAN_RADAR_4fbefc29_Tx
        RDR_OBJ_STATUS_003_oPCAN_RADAR_24cf7f10_Tx: CanIfTxPduCanId=130 if post-build-variant-condition{matching-criterion=RDR_POS, value=0}, CanIfTxPduId=135, CanIfTxPduCanId=138 if post-build-variant-condition{matching-criterion=RDR_POS, value=1}, CanIfTxPduCanId=146 if post-build-variant-condition{matching-criterion=RDR_POS, value=2}, CanIfTxPduCanId=154 if post-build-variant-condition{matching-criterion=RDR_POS, value=3}, CanIfTxPduCanId=162 if post-build-variant-condition{matching-criterion=RDR_POS, value=4}, CanIfTxPduCanId=170 if post-build-variant-condition{matching-criterion=RDR_POS, value=5}, CanIfTxPduCanId=178 if post-build-variant-condition{matching-criterion=RDR_POS, value=6}, CanIfTxPduCanId=186 if post-build-variant-condition{matching-criterion=RDR_POS, value=7}, CanIfTxPduRef=RDR_OBJ_STATUS_003_oPCAN_RADAR_a1f801b3_Tx
        RDR_DETECTION_009_012_oPCAN_RADAR_83a4abae_Tx: CanIfTxPduCanId=258 if post-build-variant-condition{matching-criterion=RDR_POS, value=0}, CanIfTxPduId=35, CanIfTxPduCanId=386 if post-build-variant-condition{matching-criterion=RDR_POS, value=1}, CanIfTxPduCanId=514 if post-build-variant-condition{matching-criterion=RDR_POS, value=2}, CanIfTxPduCanId=642 if post-build-variant-condition{matching-criterion=RDR_POS, value=3}, CanIfTxPduCanId=770 if post-build-variant-condition{matching-criterion=RDR_POS, value=4}, CanIfTxPduCanId=898 if post-build-variant-condition{matching-criterion=RDR_POS, value=5}, CanIfTxPduCanId=1026 if post-build-variant-condition{matching-criterion=RDR_POS, value=6}, CanIfTxPduCanId=1154 if post-build-variant-condition{matching-criterion=RDR_POS, value=7}, CanIfTxPduRef=RDR_DETECTION_009_012_oPCAN_RADAR_95663fdf_Tx
        RDR_DETECTION_101_104_oPCAN_RADAR_b7305958_Tx: CanIfTxPduCanId=281 if post-build-variant-condition{matching-criterion=RDR_POS, value=0}, CanIfTxPduId=58, CanIfTxPduCanId=409 if post-build-variant-condition{matching-criterion=RDR_POS, value=1}, CanIfTxPduCanId=537 if post-build-variant-condition{matching-criterion=RDR_POS, value=2}, CanIfTxPduCanId=665 if post-build-variant-condition{matching-criterion=RDR_POS, value=3}, CanIfTxPduCanId=793 if post-build-variant-condition{matching-criterion=RDR_POS, value=4}, CanIfTxPduCanId=921 if post-build-variant-condition{matching-criterion=RDR_POS, value=5}, CanIfTxPduCanId=1049 if post-build-variant-condition{matching-criterion=RDR_POS, value=6}, CanIfTxPduCanId=1177 if post-build-variant-condition{matching-criterion=RDR_POS, value=7}, CanIfTxPduRef=RDR_DETECTION_101_104_oPCAN_RADAR_5a7abddc_Tx
        RDR_DETECTION_149_152_oPCAN_RADAR_90c3b9fb_Tx: CanIfTxPduCanId=293 if post-build-variant-condition{matching-criterion=RDR_POS, value=0}, CanIfTxPduId=70, CanIfTxPduCanId=421 if post-build-variant-condition{matching-criterion=RDR_POS, value=1}, CanIfTxPduCanId=549 if post-build-variant-condition{matching-criterion=RDR_POS, value=2}, CanIfTxPduCanId=677 if post-build-variant-condition{matching-criterion=RDR_POS, value=3}, CanIfTxPduCanId=805 if post-build-variant-condition{matching-criterion=RDR_POS, value=4}, CanIfTxPduCanId=933 if post-build-variant-condition{matching-criterion=RDR_POS, value=5}, CanIfTxPduCanId=1061 if post-build-variant-condition{matching-criterion=RDR_POS, value=6}, CanIfTxPduCanId=1189 if post-build-variant-condition{matching-criterion=RDR_POS, value=7}, CanIfTxPduRef=RDR_DETECTION_149_152_oPCAN_RADAR_ddc89a2d_Tx
        RDR_DETECTION_085_088_oPCAN_RADAR_89772ac2_Tx: CanIfTxPduCanId=277 if post-build-variant-condition{matching-criterion=RDR_POS, value=0}, CanIfTxPduId=54, CanIfTxPduCanId=405 if post-build-variant-condition{matching-criterion=RDR_POS, value=1}, CanIfTxPduCanId=533 if post-build-variant-condition{matching-criterion=RDR_POS, value=2}, CanIfTxPduCanId=661 if post-build-variant-condition{matching-criterion=RDR_POS, value=3}, CanIfTxPduCanId=789 if post-build-variant-condition{matching-criterion=RDR_POS, value=4}, CanIfTxPduCanId=917 if post-build-variant-condition{matching-criterion=RDR_POS, value=5}, CanIfTxPduCanId=1045 if post-build-variant-condition{matching-criterion=RDR_POS, value=6}, CanIfTxPduCanId=1173 if post-build-variant-condition{matching-criterion=RDR_POS, value=7}, CanIfTxPduRef=RDR_DETECTION_085_088_oPCAN_RADAR_4a134070_Tx
        RDR_DETECTION_237_240_oPCAN_RADAR_eea1e4b3_Tx: CanIfTxPduCanId=315 if post-build-variant-condition{matching-criterion=RDR_POS, value=0}, CanIfTxPduId=92, CanIfTxPduCanId=443 if post-build-variant-condition{matching-criterion=RDR_POS, value=1}, CanIfTxPduCanId=571 if post-build-variant-condition{matching-criterion=RDR_POS, value=2}, CanIfTxPduCanId=699 if post-build-variant-condition{matching-criterion=RDR_POS, value=3}, CanIfTxPduCanId=827 if post-build-variant-condition{matching-criterion=RDR_POS, value=4}, CanIfTxPduCanId=955 if post-build-variant-condition{matching-criterion=RDR_POS, value=5}, CanIfTxPduCanId=1083 if post-build-variant-condition{matching-criterion=RDR_POS, value=6}, CanIfTxPduCanId=1211 if post-build-variant-condition{matching-criterion=RDR_POS, value=7}, CanIfTxPduRef=RDR_DETECTION_237_240_oPCAN_RADAR_b2dbe68d_Tx
        RDR_DETECTION_065_068_oPCAN_RADAR_01df65f1_Tx: CanIfTxPduCanId=272 if post-build-variant-condition{matching-criterion=RDR_POS, value=0}, CanIfTxPduId=49, CanIfTxPduCanId=400 if post-build-variant-condition{matching-criterion=RDR_POS, value=1}, CanIfTxPduCanId=528 if post-build-variant-condition{matching-criterion=RDR_POS, value=2}, CanIfTxPduCanId=656 if post-build-variant-condition{matching-criterion=RDR_POS, value=3}, CanIfTxPduCanId=784 if post-build-variant-condition{matching-criterion=RDR_POS, value=4}, CanIfTxPduCanId=912 if post-build-variant-condition{matching-criterion=RDR_POS, value=5}, CanIfTxPduCanId=1040 if post-build-variant-condition{matching-criterion=RDR_POS, value=6}, CanIfTxPduCanId=1168 if post-build-variant-condition{matching-criterion=RDR_POS, value=7}, CanIfTxPduRef=RDR_DETECTION_065_068_oPCAN_RADAR_42ccd36d_Tx
        RDR_DETECTION_153_156_oPCAN_RADAR_9a187a42_Tx: CanIfTxPduCanId=294 if post-build-variant-condition{matching-criterion=RDR_POS, value=0}, CanIfTxPduId=71, CanIfTxPduCanId=422 if post-build-variant-condition{matching-criterion=RDR_POS, value=1}, CanIfTxPduCanId=550 if post-build-variant-condition{matching-criterion=RDR_POS, value=2}, CanIfTxPduCanId=678 if post-build-variant-condition{matching-criterion=RDR_POS, value=3}, CanIfTxPduCanId=806 if post-build-variant-condition{matching-criterion=RDR_POS, value=4}, CanIfTxPduCanId=934 if post-build-variant-condition{matching-criterion=RDR_POS, value=5}, CanIfTxPduCanId=1062 if post-build-variant-condition{matching-criterion=RDR_POS, value=6}, CanIfTxPduCanId=1190 if post-build-variant-condition{matching-criterion=RDR_POS, value=7}, CanIfTxPduRef=RDR_DETECTION_153_156_oPCAN_RADAR_8dbda102_Tx
        RDR_TRACKER_OBJ_029_oPCAN_RADAR_ae4ffa00_Tx: CanIfTxPduCanId=1324 if post-build-variant-condition{matching-criterion=RDR_POS, value=0}, CanIfTxPduId=166, CanIfTxPduCanId=1388 if post-build-variant-condition{matching-criterion=RDR_POS, value=1}, CanIfTxPduCanId=1452 if post-build-variant-condition{matching-criterion=RDR_POS, value=2}, CanIfTxPduCanId=1516 if post-build-variant-condition{matching-criterion=RDR_POS, value=3}, CanIfTxPduCanId=1580 if post-build-variant-condition{matching-criterion=RDR_POS, value=4}, CanIfTxPduCanId=1644 if post-build-variant-condition{matching-criterion=RDR_POS, value=5}, CanIfTxPduCanId=1708 if post-build-variant-condition{matching-criterion=RDR_POS, value=6}, CanIfTxPduCanId=1772 if post-build-variant-condition{matching-criterion=RDR_POS, value=7}, CanIfTxPduRef=RDR_TRACKER_OBJ_029_oPCAN_RADAR_cea40bb7_Tx
        RDR_DETECTION_317_320_oPCAN_RADAR_594e7c9f_Tx: CanIfTxPduCanId=335 if post-build-variant-condition{matching-criterion=RDR_POS, value=0}, CanIfTxPduId=112, CanIfTxPduCanId=463 if post-build-variant-condition{matching-criterion=RDR_POS, value=1}, CanIfTxPduCanId=591 if post-build-variant-condition{matching-criterion=RDR_POS, value=2}, CanIfTxPduCanId=719 if post-build-variant-condition{matching-criterion=RDR_POS, value=3}, CanIfTxPduCanId=847 if post-build-variant-condition{matching-criterion=RDR_POS, value=4}, CanIfTxPduCanId=975 if post-build-variant-condition{matching-criterion=RDR_POS, value=5}, CanIfTxPduCanId=1103 if post-build-variant-condition{matching-criterion=RDR_POS, value=6}, CanIfTxPduCanId=1231 if post-build-variant-condition{matching-criterion=RDR_POS, value=7}, CanIfTxPduRef=RDR_DETECTION_317_320_oPCAN_RADAR_28a1e1dd_Tx
      RDR_XCP_CTO_REQ_oPCAN_RADAR_90586adf_Rx (CanIfRxPduCfg):
        CanIfRxPduCanId = 16 if post-build-variant-condition{matching-criterion=RDR_POS, value=0}
        CanIfRxPduCanIdType = STANDARD_CAN
        CanIfRxPduDlc = 64
        CanIfRxPduUserRxIndicationName = Xcp_CanIfRxIndication
        CanIfRxPduUserRxIndicationUL = XCP
        CanIfRxPduId = 88
        CanIfRxPduReadData = false
        CanIfRxPduReadNotifyStatus = false
        CanIfRxPduDlcCheck = true
        CanIfRxPduType = STATIC
        CanIfRxPduCanId = 24 if post-build-variant-condition{matching-criterion=RDR_POS, value=1}
        CanIfRxPduCanId = 32 if post-build-variant-condition{matching-criterion=RDR_POS, value=2}
        CanIfRxPduCanId = 40 if post-build-variant-condition{matching-criterion=RDR_POS, value=3}
        CanIfRxPduCanId = 48 if post-build-variant-condition{matching-criterion=RDR_POS, value=4}
        CanIfRxPduCanId = 56 if post-build-variant-condition{matching-criterion=RDR_POS, value=5}
        CanIfRxPduCanId = 64 if post-build-variant-condition{matching-criterion=RDR_POS, value=6}
        CanIfRxPduCanId = 72 if post-build-variant-condition{matching-criterion=RDR_POS, value=7}
        CanIfRxPduHrhIdRef = CN_PCAN_RADAR_a729ccfc_Rx
        CanIfRxPduRef = RDR_XCP_CTO_REQ_oPCAN_RADAR_5b59bad2_Rx
      RDR_XCP_CTO_RESP_oPCAN_RADAR_ebd76419_Tx (CanIfTxPduCfg):
        CanIfTxPduCanId = 17 if post-build-variant-condition{matching-criterion=RDR_POS, value=0}
        CanIfTxPduCanIdType = STANDARD_FD_CAN
        CanIfTxPduDlc = 64
        CanIfTxPduUserTxConfirmationName = Xcp_CanIfTxConfirmation
        CanIfTxPduUserTxConfirmationUL = XCP
        CanIfTxPduId = 203
        CanIfTxPduReadNotifyStatus = false
        CanIfTxPduType = STATIC
        CanIfTxPduTruncation = true
        CanIfTxPduCanId = 25 if post-build-variant-condition{matching-criterion=RDR_POS, value=1}
        CanIfTxPduCanId = 33 if post-build-variant-condition{matching-criterion=RDR_POS, value=2}
        CanIfTxPduCanId = 41 if post-build-variant-condition{matching-criterion=RDR_POS, value=3}
        CanIfTxPduCanId = 49 if post-build-variant-condition{matching-criterion=RDR_POS, value=4}
        CanIfTxPduCanId = 57 if post-build-variant-condition{matching-criterion=RDR_POS, value=5}
        CanIfTxPduCanId = 65 if post-build-variant-condition{matching-criterion=RDR_POS, value=6}
        CanIfTxPduCanId = 73 if post-build-variant-condition{matching-criterion=RDR_POS, value=7}
        CanIfTxPduBufferRef = CHNL_2ad3227b_PCAN
        CanIfTxPduRef = RDR_XCP_CTO_RESP_oPCAN_RADAR_e3946380_Tx
      RDR_XCP_DAQ_RESP_oPCAN_RADAR_42f3f200_Tx (CanIfTxPduCfg):
        CanIfTxPduCanId = 18 if post-build-variant-condition{matching-criterion=RDR_POS, value=0}
        CanIfTxPduCanIdType = STANDARD_FD_CAN
        CanIfTxPduDlc = 64
        CanIfTxPduUserTxConfirmationName = Xcp_CanIfTxConfirmation
        CanIfTxPduUserTxConfirmationUL = XCP
        CanIfTxPduId = 204
        CanIfTxPduReadNotifyStatus = false
        CanIfTxPduType = STATIC
        CanIfTxPduTruncation = true
        CanIfTxPduCanId = 26 if post-build-variant-condition{matching-criterion=RDR_POS, value=1}
        CanIfTxPduCanId = 34 if post-build-variant-condition{matching-criterion=RDR_POS, value=2}
        CanIfTxPduCanId = 42 if post-build-variant-condition{matching-criterion=RDR_POS, value=3}
        CanIfTxPduCanId = 50 if post-build-variant-condition{matching-criterion=RDR_POS, value=4}
        CanIfTxPduCanId = 58 if post-build-variant-condition{matching-criterion=RDR_POS, value=5}
        CanIfTxPduCanId = 66 if post-build-variant-condition{matching-criterion=RDR_POS, value=6}
        CanIfTxPduCanId = 74 if post-build-variant-condition{matching-criterion=RDR_POS, value=7}
        CanIfTxPduBufferRef = CHNL_2ad3227b_PCAN
        CanIfTxPduRef = RDR_XCP_DAQ_RESP_oPCAN_RADAR_1cc015b8_Tx
      SYS_TIME_SYNC_oPCAN_RADAR_231d6bb9_Rx (CanIfRxPduCfg):
        CanIfRxPduCanId = 1
        CanIfRxPduCanIdType = STANDARD_CAN
        CanIfRxPduDlc = 8
        CanIfRxPduUserRxIndicationName = CanTSyn_RxIndication
        CanIfRxPduUserRxIndicationUL = CAN_TSYN
        CanIfRxPduId = 112
        CanIfRxPduReadData = false
        CanIfRxPduReadNotifyStatus = false
        CanIfRxPduDlcCheck = true
        CanIfRxPduType = STATIC
        CanIfRxPduHrhIdRef = CN_PCAN_RADAR_a729ccfc_Rx
        CanIfRxPduRef = SYS_TIME_SYNC_oPCAN_RADAR_ba7b9b28_Rx
        variation-point = post-build-variant-condition{matching-criterion=RDR_POS, value=0}
      CHNL_0829f689 (CanIfBufferCfg):
        CanIfBufferSize = 25 if post-build-variant-condition{matching-criterion=RDR_POS, value=3}
        CanIfBufferSize = 25 if post-build-variant-condition{matching-criterion=RDR_POS, value=1}
        CanIfBufferSize = 25 if post-build-variant-condition{matching-criterion=RDR_POS, value=0}
        CanIfBufferSize = 25 if post-build-variant-condition{matching-criterion=RDR_POS, value=7}
        CanIfBufferSize = 25 if post-build-variant-condition{matching-criterion=RDR_POS, value=5}
        CanIfBufferSize = 25 if post-build-variant-condition{matching-criterion=RDR_POS, value=2}
        CanIfBufferSize = 25 if post-build-variant-condition{matching-criterion=RDR_POS, value=4}
        CanIfBufferSize = 25 if post-build-variant-condition{matching-criterion=RDR_POS, value=6}
        CanIfTxBufferHandlingType = PRIO_BY_CANID
        CanIfTxBufferMappedTxPdus = 25 if post-build-variant-condition{matching-criterion=RDR_POS, value=0}
        CanIfTxBufferMappedTxPdus = 25 if post-build-variant-condition{matching-criterion=RDR_POS, value=1}
        CanIfTxBufferMappedTxPdus = 25 if post-build-variant-condition{matching-criterion=RDR_POS, value=3}
        CanIfTxBufferMappedTxPdus = 25 if post-build-variant-condition{matching-criterion=RDR_POS, value=7}
        CanIfTxBufferMappedTxPdus = 25 if post-build-variant-condition{matching-criterion=RDR_POS, value=5}
        CanIfTxBufferMappedTxPdus = 25 if post-build-variant-condition{matching-criterion=RDR_POS, value=2}
        CanIfTxBufferMappedTxPdus = 25 if post-build-variant-condition{matching-criterion=RDR_POS, value=4}
        CanIfTxBufferMappedTxPdus = 25 if post-build-variant-condition{matching-criterion=RDR_POS, value=6}
        CanIfTxBufferMaxPduLength = 8
        CanIfBufferHthRef = CN_VCAN_RADAR_489180b6_Tx
