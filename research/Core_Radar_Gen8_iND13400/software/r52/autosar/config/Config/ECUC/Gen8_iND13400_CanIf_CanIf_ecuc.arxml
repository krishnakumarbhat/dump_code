[part 2 of 2: package /ActiveEcuC]
AUTOSAR XML (schema 00053)
package /ActiveEcuC  (continued)
  module config CanIf: implementation-config-variant=VARIANT-POST-BUILD-SELECTABLE, module-description=CanIf_Impl  (continued)
    CanIfInitCfg  (continued)
      35 x CanIfRxPduCfg, all with CanIfRxPduUserRxIndicationName=PduR_CanIfRxIndication, CanIfRxPduUserRxIndicationUL=PDUR, CanIfRxPduReadData=false, CanIfRxPduReadNotifyStatus=false, CanIfRxPduDlcCheck=true, CanIfRxPduType=STATIC:
        RDR_FUSION_DET_029_032_oPCAN_RADAR_d4e9b638_Rx: CanIfRxPduCanId=647 if post-build-variant-condition{matching-criterion=RDR_POS, value=0}, CanIfRxPduCanIdType=STANDARD_CAN, CanIfRxPduDlc=64, CanIfRxPduId=60, CanIfRxPduCanId=519 if post-build-variant-condition{matching-criterion=RDR_POS, value=1}, CanIfRxPduCanId=391 if post-build-variant-condition{matching-criterion=RDR_POS, value=2}, CanIfRxPduCanId=263 if post-build-variant-condition{matching-criterion=RDR_POS, value=3}, CanIfRxPduCanId=263 if post-build-variant-condition{matching-criterion=RDR_POS, value=4}, CanIfRxPduCanId=775 if post-build-variant-condition{matching-criterion=RDR_POS, value=5}, CanIfRxPduCanId=1159 if post-build-variant-condition{matching-criterion=RDR_POS, value=6}, CanIfRxPduCanId=1031 if post-build-variant-condition{matching-criterion=RDR_POS, value=7}, CanIfRxPduHrhIdRef=CN_PCAN_RADAR_a729ccfc_Rx, CanIfRxPduRef=RDR_FUSION_DET_029_032_oPCAN_RADAR_1ec62a3f_Rx
        RDR_FUSION_DET_033_036_oPCAN_RADAR_835f8418_Rx: CanIfRxPduCanId=648 if post-build-variant-condition{matching-criterion=RDR_POS, value=0}, CanIfRxPduCanIdType=STANDARD_CAN, CanIfRxPduDlc=64, CanIfRxPduId=61, CanIfRxPduCanId=520 if post-build-variant-condition{matching-criterion=RDR_POS, value=1}, CanIfRxPduCanId=392 if post-build-variant-condition{matching-criterion=RDR_POS, value=2}, CanIfRxPduCanId=264 if post-build-variant-condition{matching-criterion=RDR_POS, value=3}, CanIfRxPduCanId=264 if post-build-variant-condition{matching-criterion=RDR_POS, value=4}, CanIfRxPduCanId=776 if post-build-variant-condition{matching-criterion=RDR_POS, value=5}, CanIfRxPduCanId=1160 if post-build-variant-condition{matching-criterion=RDR_POS, value=6}, CanIfRxPduCanId=1032 if post-build-variant-condition{matching-criterion=RDR_POS, value=7}, CanIfRxPduHrhIdRef=CN_PCAN_RADAR_a729ccfc_Rx, CanIfRxPduRef=RDR_FUSION_DET_033_036_oPCAN_RADAR_4eb31110_Rx
        RDR_FUSION_DET_013_016_oPCAN_RADAR_577f1aa5_Rx: CanIfRxPduCanId=643 if post-build-variant-condition{matching-criterion=RDR_POS, value=0}, CanIfRxPduCanIdType=STANDARD_CAN, CanIfRxPduDlc=64, CanIfRxPduId=56, CanIfRxPduCanId=515 if post-build-variant-condition{matching-criterion=RDR_POS, value=1}, CanIfRxPduCanId=387 if post-build-variant-condition{matching-criterion=RDR_POS, value=2}, CanIfRxPduCanId=259 if post-build-variant-condition{matching-criterion=RDR_POS, value=3}, CanIfRxPduCanId=259 if post-build-variant-condition{matching-criterion=RDR_POS, value=4}, CanIfRxPduCanId=771 if post-build-variant-condition{matching-criterion=RDR_POS, value=5}, CanIfRxPduCanId=1155 if post-build-variant-condition{matching-criterion=RDR_POS, value=6}, CanIfRxPduCanId=1027 if post-build-variant-condition{matching-criterion=RDR_POS, value=7}, CanIfRxPduHrhIdRef=CN_PCAN_RADAR_a729ccfc_Rx, CanIfRxPduRef=RDR_FUSION_DET_013_016_oPCAN_RADAR_c7d74ef9_Rx
        RDR_FUSION_DET_081_084_oPCAN_RADAR_ad19ffce_Rx: CanIfRxPduCanId=660 if post-build-variant-condition{matching-criterion=RDR_POS, value=0}, CanIfRxPduCanIdType=STANDARD_CAN, CanIfRxPduDlc=64, CanIfRxPduId=73, CanIfRxPduCanId=532 if post-build-variant-condition{matching-criterion=RDR_POS, value=1}, CanIfRxPduCanId=404 if post-build-variant-condition{matching-criterion=RDR_POS, value=2}, CanIfRxPduCanId=276 if post-build-variant-condition{matching-criterion=RDR_POS, value=3}, CanIfRxPduCanId=276 if post-build-variant-condition{matching-criterion=RDR_POS, value=4}, CanIfRxPduCanId=788 if post-build-variant-condition{matching-criterion=RDR_POS, value=5}, CanIfRxPduCanId=1172 if post-build-variant-condition{matching-criterion=RDR_POS, value=6}, CanIfRxPduCanId=1044 if post-build-variant-condition{matching-criterion=RDR_POS, value=7}, CanIfRxPduHrhIdRef=CN_PCAN_RADAR_a729ccfc_Rx, CanIfRxPduRef=RDR_FUSION_DET_081_084_oPCAN_RADAR_91ab9ed3_Rx
        RDR_FUSION_DET_085_088_oPCAN_RADAR_ed60b655_Rx: CanIfRxPduCanId=661 if post-build-variant-condition{matching-criterion=RDR_POS, value=0}, CanIfRxPduCanIdType=STANDARD_CAN, CanIfRxPduDlc=64, CanIfRxPduId=74, CanIfRxPduCanId=533 if post-build-variant-condition{matching-criterion=RDR_POS, value=1}, CanIfRxPduCanId=405 if post-build-variant-condition{matching-criterion=RDR_POS, value=2}, CanIfRxPduCanId=277 if post-build-variant-condition{matching-criterion=RDR_POS, value=3}, CanIfRxPduCanId=277 if post-build-variant-condition{matching-criterion=RDR_POS, value=4}, CanIfRxPduCanId=789 if post-build-variant-condition{matching-criterion=RDR_POS, value=5}, CanIfRxPduCanId=1173 if post-build-variant-condition{matching-criterion=RDR_POS, value=6}, CanIfRxPduCanId=1045 if post-build-variant-condition{matching-criterion=RDR_POS, value=7}, CanIfRxPduHrhIdRef=CN_PCAN_RADAR_a729ccfc_Rx, CanIfRxPduRef=RDR_FUSION_DET_085_088_oPCAN_RADAR_48d70a79_Rx
        RDR_FUSION_DET_005_008_oPCAN_RADAR_0b00c023_Rx: CanIfRxPduCanId=641 if post-build-variant-condition{matching-criterion=RDR_POS, value=0}, CanIfRxPduCanIdType=STANDARD_CAN, CanIfRxPduDlc=64, CanIfRxPduId=54, CanIfRxPduCanId=513 if post-build-variant-condition{matching-criterion=RDR_POS, value=1}, CanIfRxPduCanId=385 if post-build-variant-condition{matching-criterion=RDR_POS, value=2}, CanIfRxPduCanId=257 if post-build-variant-condition{matching-criterion=RDR_POS, value=3}, CanIfRxPduCanId=257 if post-build-variant-condition{matching-criterion=RDR_POS, value=4}, CanIfRxPduCanId=769 if post-build-variant-condition{matching-criterion=RDR_POS, value=5}, CanIfRxPduCanId=1153 if post-build-variant-condition{matching-criterion=RDR_POS, value=6}, CanIfRxPduCanId=1025 if post-build-variant-condition{matching-criterion=RDR_POS, value=7}, CanIfRxPduHrhIdRef=CN_PCAN_RADAR_a729ccfc_Rx, CanIfRxPduRef=RDR_FUSION_DET_005_008_oPCAN_RADAR_00d57f1e_Rx
        RDR_FUSION_DET_117_120_oPCAN_RADAR_561fc83a_Rx: CanIfRxPduCanId=669 if post-build-variant-condition{matching-criterion=RDR_POS, value=0}, CanIfRxPduCanIdType=STANDARD_CAN, CanIfRxPduDlc=64, CanIfRxPduId=82, CanIfRxPduCanId=541 if post-build-variant-condition{matching-criterion=RDR_POS, value=1}, CanIfRxPduCanId=413 if post-build-variant-condition{matching-criterion=RDR_POS, value=2}, CanIfRxPduCanId=285 if post-build-variant-condition{matching-criterion=RDR_POS, value=3}, CanIfRxPduCanId=285 if post-build-variant-condition{matching-criterion=RDR_POS, value=4}, CanIfRxPduCanId=797 if post-build-variant-condition{matching-criterion=RDR_POS, value=5}, CanIfRxPduCanId=1181 if post-build-variant-condition{matching-criterion=RDR_POS, value=6}, CanIfRxPduCanId=1053 if post-build-variant-condition{matching-criterion=RDR_POS, value=7}, CanIfRxPduHrhIdRef=CN_PCAN_RADAR_a729ccfc_Rx, CanIfRxPduRef=RDR_FUSION_DET_117_120_oPCAN_RADAR_f33a9557_Rx
        RDR_FUSION_DET_017_020_oPCAN_RADAR_e1253ccd_Rx: CanIfRxPduCanId=644 if post-build-variant-condition{matching-criterion=RDR_POS, value=0}, CanIfRxPduCanIdType=STANDARD_CAN, CanIfRxPduDlc=64, CanIfRxPduId=57, CanIfRxPduCanId=516 if post-build-variant-condition{matching-criterion=RDR_POS, value=1}, CanIfRxPduCanId=388 if post-build-variant-condition{matching-criterion=RDR_POS, value=2}, CanIfRxPduCanId=260 if post-build-variant-condition{matching-criterion=RDR_POS, value=3}, CanIfRxPduCanId=260 if post-build-variant-condition{matching-criterion=RDR_POS, value=4}, CanIfRxPduCanId=772 if post-build-variant-condition{matching-criterion=RDR_POS, value=5}, CanIfRxPduCanId=1156 if post-build-variant-condition{matching-criterion=RDR_POS, value=6}, CanIfRxPduCanId=1028 if post-build-variant-condition{matching-criterion=RDR_POS, value=7}, CanIfRxPduHrhIdRef=CN_PCAN_RADAR_a729ccfc_Rx, CanIfRxPduRef=RDR_FUSION_DET_017_020_oPCAN_RADAR_722d8936_Rx
        RDR_FUSION_STATUS_001_oPCAN_RADAR_5a3f0fa3_Rx: CanIfRxPduCanId=155 if post-build-variant-condition{matching-criterion=RDR_POS, value=0}, CanIfRxPduCanIdType=STANDARD_CAN, CanIfRxPduDlc=64, CanIfRxPduId=86, CanIfRxPduCanId=147 if post-build-variant-condition{matching-criterion=RDR_POS, value=1}, CanIfRxPduCanId=139 if post-build-variant-condition{matching-criterion=RDR_POS, value=2}, CanIfRxPduCanId=131 if post-build-variant-condition{matching-criterion=RDR_POS, value=3}, CanIfRxPduCanId=131 if post-build-variant-condition{matching-criterion=RDR_POS, value=4}, CanIfRxPduCanId=163 if post-build-variant-condition{matching-criterion=RDR_POS, value=5}, CanIfRxPduCanId=187 if post-build-variant-condition{matching-criterion=RDR_POS, value=6}, CanIfRxPduCanId=179 if post-build-variant-condition{matching-criterion=RDR_POS, value=7}, CanIfRxPduHrhIdRef=CN_PCAN_RADAR_a729ccfc_Rx, CanIfRxPduRef=RDR_FUSION_STATUS_001_oPCAN_RADAR_b6cfc045_Rx
        RDR_FUSION_DET_069_072_oPCAN_RADAR_a7d98d03_Rx: CanIfRxPduCanId=657 if post-build-variant-condition{matching-criterion=RDR_POS, value=0}, CanIfRxPduCanIdType=STANDARD_CAN, CanIfRxPduDlc=64, CanIfRxPduId=70, CanIfRxPduCanId=529 if post-build-variant-condition{matching-criterion=RDR_POS, value=1}, CanIfRxPduCanId=401 if post-build-variant-condition{matching-criterion=RDR_POS, value=2}, CanIfRxPduCanId=273 if post-build-variant-condition{matching-criterion=RDR_POS, value=3}, CanIfRxPduCanId=273 if post-build-variant-condition{matching-criterion=RDR_POS, value=4}, CanIfRxPduCanId=785 if post-build-variant-condition{matching-criterion=RDR_POS, value=5}, CanIfRxPduCanId=1169 if post-build-variant-condition{matching-criterion=RDR_POS, value=6}, CanIfRxPduCanId=1041 if post-build-variant-condition{matching-criterion=RDR_POS, value=7}, CanIfRxPduHrhIdRef=CN_PCAN_RADAR_a729ccfc_Rx, CanIfRxPduRef=RDR_FUSION_DET_069_072_oPCAN_RADAR_d77f93ac_Rx
        RDR_FUSION_DET_001_004_oPCAN_RADAR_4b7989b8_Rx: CanIfRxPduCanId=640 if post-build-variant-condition{matching-criterion=RDR_POS, value=0}, CanIfRxPduCanIdType=STANDARD_CAN, CanIfRxPduDlc=64, CanIfRxPduId=53, CanIfRxPduCanId=512 if post-build-variant-condition{matching-criterion=RDR_POS, value=1}, CanIfRxPduCanId=384 if post-build-variant-condition{matching-criterion=RDR_POS, value=2}, CanIfRxPduCanId=256 if post-build-variant-condition{matching-criterion=RDR_POS, value=3}, CanIfRxPduCanId=256 if post-build-variant-condition{matching-criterion=RDR_POS, value=4}, CanIfRxPduCanId=768 if post-build-variant-condition{matching-criterion=RDR_POS, value=5}, CanIfRxPduCanId=1152 if post-build-variant-condition{matching-criterion=RDR_POS, value=6}, CanIfRxPduCanId=1024 if post-build-variant-condition{matching-criterion=RDR_POS, value=7}, CanIfRxPduHrhIdRef=CN_PCAN_RADAR_a729ccfc_Rx, CanIfRxPduRef=RDR_FUSION_DET_001_004_oPCAN_RADAR_d9a9ebb4_Rx
        RDR_FUSION_DET_105_108_oPCAN_RADAR_bc3a34d4_Rx: CanIfRxPduCanId=666 if post-build-variant-condition{matching-criterion=RDR_POS, value=0}, CanIfRxPduCanIdType=STANDARD_CAN, CanIfRxPduDlc=64, CanIfRxPduId=79, CanIfRxPduCanId=538 if post-build-variant-condition{matching-criterion=RDR_POS, value=1}, CanIfRxPduCanId=410 if post-build-variant-condition{matching-criterion=RDR_POS, value=2}, CanIfRxPduCanId=282 if post-build-variant-condition{matching-criterion=RDR_POS, value=3}, CanIfRxPduCanId=282 if post-build-variant-condition{matching-criterion=RDR_POS, value=4}, CanIfRxPduCanId=794 if post-build-variant-condition{matching-criterion=RDR_POS, value=5}, CanIfRxPduCanId=1178 if post-build-variant-condition{matching-criterion=RDR_POS, value=6}, CanIfRxPduCanId=1050 if post-build-variant-condition{matching-criterion=RDR_POS, value=7}, CanIfRxPduHrhIdRef=CN_PCAN_RADAR_a729ccfc_Rx, CanIfRxPduRef=RDR_FUSION_DET_105_108_oPCAN_RADAR_81c2637f_Rx
        RDR_FUSION_DET_097_100_oPCAN_RADAR_b3504422_Rx: CanIfRxPduCanId=664 if post-build-variant-condition{matching-criterion=RDR_POS, value=0}, CanIfRxPduCanIdType=STANDARD_CAN, CanIfRxPduDlc=64, CanIfRxPduId=77, CanIfRxPduCanId=536 if post-build-variant-condition{matching-criterion=RDR_POS, value=1}, CanIfRxPduCanId=408 if post-build-variant-condition{matching-criterion=RDR_POS, value=2}, CanIfRxPduCanId=280 if post-build-variant-condition{matching-criterion=RDR_POS, value=3}, CanIfRxPduCanId=280 if post-build-variant-condition{matching-criterion=RDR_POS, value=4}, CanIfRxPduCanId=792 if post-build-variant-condition{matching-criterion=RDR_POS, value=5}, CanIfRxPduCanId=1176 if post-build-variant-condition{matching-criterion=RDR_POS, value=6}, CanIfRxPduCanId=1048 if post-build-variant-condition{matching-criterion=RDR_POS, value=7}, CanIfRxPduHrhIdRef=CN_PCAN_RADAR_a729ccfc_Rx, CanIfRxPduRef=RDR_FUSION_DET_097_100_oPCAN_RADAR_43d6c604_Rx
        RDR_FUSION_DET_109_112_oPCAN_RADAR_b7f3dc72_Rx: CanIfRxPduCanId=667 if post-build-variant-condition{matching-criterion=RDR_POS, value=0}, CanIfRxPduCanIdType=STANDARD_CAN, CanIfRxPduDlc=64, CanIfRxPduId=80, CanIfRxPduCanId=539 if post-build-variant-condition{matching-criterion=RDR_POS, value=1}, CanIfRxPduCanId=411 if post-build-variant-condition{matching-criterion=RDR_POS, value=2}, CanIfRxPduCanId=283 if post-build-variant-condition{matching-criterion=RDR_POS, value=3}, CanIfRxPduCanId=283 if post-build-variant-condition{matching-criterion=RDR_POS, value=4}, CanIfRxPduCanId=795 if post-build-variant-condition{matching-criterion=RDR_POS, value=5}, CanIfRxPduCanId=1179 if post-build-variant-condition{matching-criterion=RDR_POS, value=6}, CanIfRxPduCanId=1051 if post-build-variant-condition{matching-criterion=RDR_POS, value=7}, CanIfRxPduHrhIdRef=CN_PCAN_RADAR_a729ccfc_Rx, CanIfRxPduRef=RDR_FUSION_DET_109_112_oPCAN_RADAR_16b569b7_Rx
        RDR_FUSION_DET_121_124_oPCAN_RADAR_2863e3f2_Rx: CanIfRxPduCanId=670 if post-build-variant-condition{matching-criterion=RDR_POS, value=0}, CanIfRxPduCanIdType=STANDARD_CAN, CanIfRxPduDlc=64, CanIfRxPduId=83, CanIfRxPduCanId=542 if post-build-variant-condition{matching-criterion=RDR_POS, value=1}, CanIfRxPduCanId=414 if post-build-variant-condition{matching-criterion=RDR_POS, value=2}, CanIfRxPduCanId=286 if post-build-variant-condition{matching-criterion=RDR_POS, value=3}, CanIfRxPduCanId=286 if post-build-variant-condition{matching-criterion=RDR_POS, value=4}, CanIfRxPduCanId=798 if post-build-variant-condition{matching-criterion=RDR_POS, value=5}, CanIfRxPduCanId=1182 if post-build-variant-condition{matching-criterion=RDR_POS, value=6}, CanIfRxPduCanId=1054 if post-build-variant-condition{matching-criterion=RDR_POS, value=7}, CanIfRxPduHrhIdRef=CN_PCAN_RADAR_a729ccfc_Rx, CanIfRxPduRef=RDR_FUSION_DET_121_124_oPCAN_RADAR_d1daa83c_Rx
        RDR_FUSION_HEADER_001_oPCAN_RADAR_9f0679aa_Rx: CanIfRxPduCanId=152 if post-build-variant-condition{matching-criterion=RDR_POS, value=0}, CanIfRxPduCanIdType=STANDARD_CAN, CanIfRxPduDlc=64, CanIfRxPduId=85, CanIfRxPduCanId=144 if post-build-variant-condition{matching-criterion=RDR_POS, value=1}, CanIfRxPduCanId=136 if post-build-variant-condition{matching-criterion=RDR_POS, value=2}, CanIfRxPduCanId=128 if post-build-variant-condition{matching-criterion=RDR_POS, value=3}, CanIfRxPduCanId=128 if post-build-variant-condition{matching-criterion=RDR_POS, value=4}, CanIfRxPduCanId=160 if post-build-variant-condition{matching-criterion=RDR_POS, value=5}, CanIfRxPduCanId=184 if post-build-variant-condition{matching-criterion=RDR_POS, value=6}, CanIfRxPduCanId=176 if post-build-variant-condition{matching-criterion=RDR_POS, value=7}, CanIfRxPduHrhIdRef=CN_PCAN_RADAR_a729ccfc_Rx, CanIfRxPduRef=RDR_FUSION_HEADER_001_oPCAN_RADAR_204bf532_Rx
        RDR_FUSION_DET_101_104_oPCAN_RADAR_fc437d4f_Rx: CanIfRxPduCanId=665 if post-build-variant-condition{matching-criterion=RDR_POS, value=0}, CanIfRxPduCanIdType=STANDARD_CAN, CanIfRxPduDlc=64, CanIfRxPduId=78, CanIfRxPduCanId=537 if post-build-variant-condition{matching-criterion=RDR_POS, value=1}, CanIfRxPduCanId=409 if post-build-variant-condition{matching-criterion=RDR_POS, value=2}, CanIfRxPduCanId=281 if post-build-variant-condition{matching-criterion=RDR_POS, value=3}, CanIfRxPduCanId=281 if post-build-variant-condition{matching-criterion=RDR_POS, value=4}, CanIfRxPduCanId=793 if post-build-variant-condition{matching-criterion=RDR_POS, value=5}, CanIfRxPduCanId=1177 if post-build-variant-condition{matching-criterion=RDR_POS, value=6}, CanIfRxPduCanId=1049 if post-build-variant-condition{matching-criterion=RDR_POS, value=7}, CanIfRxPduHrhIdRef=CN_PCAN_RADAR_a729ccfc_Rx, CanIfRxPduRef=RDR_FUSION_DET_101_104_oPCAN_RADAR_58bef7d5_Rx
        RDR_FUSION_DET_049_052_oPCAN_RADAR_73f913be_Rx: CanIfRxPduCanId=652 if post-build-variant-condition{matching-criterion=RDR_POS, value=0}, CanIfRxPduCanIdType=STANDARD_CAN, CanIfRxPduDlc=64, CanIfRxPduId=65, CanIfRxPduCanId=524 if post-build-variant-condition{matching-criterion=RDR_POS, value=1}, CanIfRxPduCanId=396 if post-build-variant-condition{matching-criterion=RDR_POS, value=2}, CanIfRxPduCanId=268 if post-build-variant-condition{matching-criterion=RDR_POS, value=3}, CanIfRxPduCanId=268 if post-build-variant-condition{matching-criterion=RDR_POS, value=4}, CanIfRxPduCanId=780 if post-build-variant-condition{matching-criterion=RDR_POS, value=5}, CanIfRxPduCanId=1164 if post-build-variant-condition{matching-criterion=RDR_POS, value=6}, CanIfRxPduCanId=1036 if post-build-variant-condition{matching-criterion=RDR_POS, value=7}, CanIfRxPduHrhIdRef=CN_PCAN_RADAR_a729ccfc_Rx, CanIfRxPduRef=RDR_FUSION_DET_049_052_oPCAN_RADAR_5e1bcc45_Rx
        RDR_FUSION_DET_037_040_oPCAN_RADAR_3f53262f_Rx: CanIfRxPduCanId=649 if post-build-variant-condition{matching-criterion=RDR_POS, value=0}, CanIfRxPduCanIdType=STANDARD_CAN, CanIfRxPduDlc=64, CanIfRxPduId=62, CanIfRxPduCanId=521 if post-build-variant-condition{matching-criterion=RDR_POS, value=1}, CanIfRxPduCanId=393 if post-build-variant-condition{matching-criterion=RDR_POS, value=2}, CanIfRxPduCanId=265 if post-build-variant-condition{matching-criterion=RDR_POS, value=3}, CanIfRxPduCanId=265 if post-build-variant-condition{matching-criterion=RDR_POS, value=4}, CanIfRxPduCanId=777 if post-build-variant-condition{matching-criterion=RDR_POS, value=5}, CanIfRxPduCanId=1161 if post-build-variant-condition{matching-criterion=RDR_POS, value=6}, CanIfRxPduCanId=1033 if post-build-variant-condition{matching-criterion=RDR_POS, value=7}, CanIfRxPduHrhIdRef=CN_PCAN_RADAR_a729ccfc_Rx, CanIfRxPduRef=RDR_FUSION_DET_037_040_oPCAN_RADAR_69409207_Rx
        RDR_FUSION_DET_009_012_oPCAN_RADAR_00c92885_Rx: CanIfRxPduCanId=642 if post-build-variant-condition{matching-criterion=RDR_POS, value=0}, CanIfRxPduCanIdType=STANDARD_CAN, CanIfRxPduDlc=64, CanIfRxPduId=55, CanIfRxPduCanId=514 if post-build-variant-condition{matching-criterion=RDR_POS, value=1}, CanIfRxPduCanId=386 if post-build-variant-condition{matching-criterion=RDR_POS, value=2}, CanIfRxPduCanId=258 if post-build-variant-condition{matching-criterion=RDR_POS, value=3}, CanIfRxPduCanId=258 if post-build-variant-condition{matching-criterion=RDR_POS, value=4}, CanIfRxPduCanId=770 if post-build-variant-condition{matching-criterion=RDR_POS, value=5}, CanIfRxPduCanId=1154 if post-build-variant-condition{matching-criterion=RDR_POS, value=6}, CanIfRxPduCanId=1026 if post-build-variant-condition{matching-criterion=RDR_POS, value=7}, CanIfRxPduHrhIdRef=CN_PCAN_RADAR_a729ccfc_Rx, CanIfRxPduRef=RDR_FUSION_DET_009_012_oPCAN_RADAR_97a275d6_Rx
        RDR_FUSION_DET_057_060_oPCAN_RADAR_921507f6_Rx: CanIfRxPduCanId=654 if post-build-variant-condition{matching-criterion=RDR_POS, value=0}, CanIfRxPduCanIdType=STANDARD_CAN, CanIfRxPduDlc=64, CanIfRxPduId=67, CanIfRxPduCanId=526 if post-build-variant-condition{matching-criterion=RDR_POS, value=1}, CanIfRxPduCanId=398 if post-build-variant-condition{matching-criterion=RDR_POS, value=2}, CanIfRxPduCanId=270 if post-build-variant-condition{matching-criterion=RDR_POS, value=3}, CanIfRxPduCanId=270 if post-build-variant-condition{matching-criterion=RDR_POS, value=4}, CanIfRxPduCanId=782 if post-build-variant-condition{matching-criterion=RDR_POS, value=5}, CanIfRxPduCanId=1166 if post-build-variant-condition{matching-criterion=RDR_POS, value=6}, CanIfRxPduCanId=1038 if post-build-variant-condition{matching-criterion=RDR_POS, value=7}, CanIfRxPduHrhIdRef=CN_PCAN_RADAR_a729ccfc_Rx, CanIfRxPduRef=RDR_FUSION_DET_057_060_oPCAN_RADAR_bb9430a5_Rx
        RDR_FUSION_DET_065_068_oPCAN_RADAR_ac1065a5_Rx: CanIfRxPduCanId=656 if post-build-variant-condition{matching-criterion=RDR_POS, value=0}, CanIfRxPduCanIdType=STANDARD_CAN, CanIfRxPduDlc=64, CanIfRxPduId=69, CanIfRxPduCanId=528 if post-build-variant-condition{matching-criterion=RDR_POS, value=1}, CanIfRxPduCanId=400 if post-build-variant-condition{matching-criterion=RDR_POS, value=2}, CanIfRxPduCanId=272 if post-build-variant-condition{matching-criterion=RDR_POS, value=3}, CanIfRxPduCanId=272 if post-build-variant-condition{matching-criterion=RDR_POS, value=4}, CanIfRxPduCanId=784 if post-build-variant-condition{matching-criterion=RDR_POS, value=5}, CanIfRxPduCanId=1168 if post-build-variant-condition{matching-criterion=RDR_POS, value=6}, CanIfRxPduCanId=1040 if post-build-variant-condition{matching-criterion=RDR_POS, value=7}, CanIfRxPduHrhIdRef=CN_PCAN_RADAR_a729ccfc_Rx, CanIfRxPduRef=RDR_FUSION_DET_065_068_oPCAN_RADAR_40089964_Rx
        RDR_FUSION_DET_093_096_oPCAN_RADAR_b11f6cd3_Rx: CanIfRxPduCanId=663 if post-build-variant-condition{matching-criterion=RDR_POS, value=0}, CanIfRxPduCanIdType=STANDARD_CAN, CanIfRxPduDlc=64, CanIfRxPduId=76, CanIfRxPduCanId=535 if post-build-variant-condition{matching-criterion=RDR_POS, value=1}, CanIfRxPduCanId=407 if post-build-variant-condition{matching-criterion=RDR_POS, value=2}, CanIfRxPduCanId=279 if post-build-variant-condition{matching-criterion=RDR_POS, value=3}, CanIfRxPduCanId=279 if post-build-variant-condition{matching-criterion=RDR_POS, value=4}, CanIfRxPduCanId=791 if post-build-variant-condition{matching-criterion=RDR_POS, value=5}, CanIfRxPduCanId=1175 if post-build-variant-condition{matching-criterion=RDR_POS, value=6}, CanIfRxPduCanId=1047 if post-build-variant-condition{matching-criterion=RDR_POS, value=7}, CanIfRxPduHrhIdRef=CN_PCAN_RADAR_a729ccfc_Rx, CanIfRxPduRef=RDR_FUSION_DET_093_096_oPCAN_RADAR_8fd53b9e_Rx
        RDR_FUSION_DET_053_056_oPCAN_RADAR_244f219e_Rx: CanIfRxPduCanId=653 if post-build-variant-condition{matching-criterion=RDR_POS, value=0}, CanIfRxPduCanIdType=STANDARD_CAN, CanIfRxPduDlc=64, CanIfRxPduId=66, CanIfRxPduCanId=525 if post-build-variant-condition{matching-criterion=RDR_POS, value=1}, CanIfRxPduCanId=397 if post-build-variant-condition{matching-criterion=RDR_POS, value=2}, CanIfRxPduCanId=269 if post-build-variant-condition{matching-criterion=RDR_POS, value=3}, CanIfRxPduCanId=269 if post-build-variant-condition{matching-criterion=RDR_POS, value=4}, CanIfRxPduCanId=781 if post-build-variant-condition{matching-criterion=RDR_POS, value=5}, CanIfRxPduCanId=1165 if post-build-variant-condition{matching-criterion=RDR_POS, value=6}, CanIfRxPduCanId=1037 if post-build-variant-condition{matching-criterion=RDR_POS, value=7}, CanIfRxPduHrhIdRef=CN_PCAN_RADAR_a729ccfc_Rx, CanIfRxPduRef=RDR_FUSION_DET_053_056_oPCAN_RADAR_0e6ef76a_Rx
        RDR_FUSION_DET_061_064_oPCAN_RADAR_ec692c3e_Rx: CanIfRxPduCanId=655 if post-build-variant-condition{matching-criterion=RDR_POS, value=0}, CanIfRxPduCanIdType=STANDARD_CAN, CanIfRxPduDlc=64, CanIfRxPduId=68, CanIfRxPduCanId=527 if post-build-variant-condition{matching-criterion=RDR_POS, value=1}, CanIfRxPduCanId=399 if post-build-variant-condition{matching-criterion=RDR_POS, value=2}, CanIfRxPduCanId=271 if post-build-variant-condition{matching-criterion=RDR_POS, value=3}, CanIfRxPduCanId=271 if post-build-variant-condition{matching-criterion=RDR_POS, value=4}, CanIfRxPduCanId=783 if post-build-variant-condition{matching-criterion=RDR_POS, value=5}, CanIfRxPduCanId=1167 if post-build-variant-condition{matching-criterion=RDR_POS, value=6}, CanIfRxPduCanId=1039 if post-build-variant-condition{matching-criterion=RDR_POS, value=7}, CanIfRxPduHrhIdRef=CN_PCAN_RADAR_a729ccfc_Rx, CanIfRxPduRef=RDR_FUSION_DET_061_064_oPCAN_RADAR_99740dce_Rx
        RDR_FUSION_DET_073_076_oPCAN_RADAR_f06fbf23_Rx: CanIfRxPduCanId=658 if post-build-variant-condition{matching-criterion=RDR_POS, value=0}, CanIfRxPduCanIdType=STANDARD_CAN, CanIfRxPduDlc=64, CanIfRxPduId=71, CanIfRxPduCanId=530 if post-build-variant-condition{matching-criterion=RDR_POS, value=1}, CanIfRxPduCanId=402 if post-build-variant-condition{matching-criterion=RDR_POS, value=2}, CanIfRxPduCanId=274 if post-build-variant-condition{matching-criterion=RDR_POS, value=3}, CanIfRxPduCanId=274 if post-build-variant-condition{matching-criterion=RDR_POS, value=4}, CanIfRxPduCanId=786 if post-build-variant-condition{matching-criterion=RDR_POS, value=5}, CanIfRxPduCanId=1170 if post-build-variant-condition{matching-criterion=RDR_POS, value=6}, CanIfRxPduCanId=1042 if post-build-variant-condition{matching-criterion=RDR_POS, value=7}, CanIfRxPduHrhIdRef=CN_PCAN_RADAR_a729ccfc_Rx, CanIfRxPduRef=RDR_FUSION_DET_073_076_oPCAN_RADAR_870aa883_Rx
        RDR_FUSION_DET_089_092_oPCAN_RADAR_e6a95ef3_Rx: CanIfRxPduCanId=662 if post-build-variant-condition{matching-criterion=RDR_POS, value=0}, CanIfRxPduCanIdType=STANDARD_CAN, CanIfRxPduDlc=64, CanIfRxPduId=75, CanIfRxPduCanId=534 if post-build-variant-condition{matching-criterion=RDR_POS, value=1}, CanIfRxPduCanId=406 if post-build-variant-condition{matching-criterion=RDR_POS, value=2}, CanIfRxPduCanId=278 if post-build-variant-condition{matching-criterion=RDR_POS, value=3}, CanIfRxPduCanId=278 if post-build-variant-condition{matching-criterion=RDR_POS, value=4}, CanIfRxPduCanId=790 if post-build-variant-condition{matching-criterion=RDR_POS, value=5}, CanIfRxPduCanId=1174 if post-build-variant-condition{matching-criterion=RDR_POS, value=6}, CanIfRxPduCanId=1046 if post-build-variant-condition{matching-criterion=RDR_POS, value=7}, CanIfRxPduHrhIdRef=CN_PCAN_RADAR_a729ccfc_Rx, CanIfRxPduRef=RDR_FUSION_DET_089_092_oPCAN_RADAR_dfa000b1_Rx
        RDR_FUSION_DET_077_080_oPCAN_RADAR_58ce15aa_Rx: CanIfRxPduCanId=659 if post-build-variant-condition{matching-criterion=RDR_POS, value=0}, CanIfRxPduCanIdType=STANDARD_CAN, CanIfRxPduDlc=64, CanIfRxPduId=72, CanIfRxPduCanId=531 if post-build-variant-condition{matching-criterion=RDR_POS, value=1}, CanIfRxPduCanId=403 if post-build-variant-condition{matching-criterion=RDR_POS, value=2}, CanIfRxPduCanId=275 if post-build-variant-condition{matching-criterion=RDR_POS, value=3}, CanIfRxPduCanId=275 if post-build-variant-condition{matching-criterion=RDR_POS, value=4}, CanIfRxPduCanId=787 if post-build-variant-condition{matching-criterion=RDR_POS, value=5}, CanIfRxPduCanId=1171 if post-build-variant-condition{matching-criterion=RDR_POS, value=6}, CanIfRxPduCanId=1043 if post-build-variant-condition{matching-criterion=RDR_POS, value=7}, CanIfRxPduHrhIdRef=CN_PCAN_RADAR_a729ccfc_Rx, CanIfRxPduRef=RDR_FUSION_DET_077_080_oPCAN_RADAR_5f9aa465_Rx
        RDR_FUSION_DET_025_028_oPCAN_RADAR_df205e9e_Rx: CanIfRxPduCanId=646 if post-build-variant-condition{matching-criterion=RDR_POS, value=0}, CanIfRxPduCanIdType=STANDARD_CAN, CanIfRxPduDlc=64, CanIfRxPduId=59, CanIfRxPduCanId=518 if post-build-variant-condition{matching-criterion=RDR_POS, value=1}, CanIfRxPduCanId=390 if post-build-variant-condition{matching-criterion=RDR_POS, value=2}, CanIfRxPduCanId=262 if post-build-variant-condition{matching-criterion=RDR_POS, value=3}, CanIfRxPduCanId=262 if post-build-variant-condition{matching-criterion=RDR_POS, value=4}, CanIfRxPduCanId=774 if post-build-variant-condition{matching-criterion=RDR_POS, value=5}, CanIfRxPduCanId=1158 if post-build-variant-condition{matching-criterion=RDR_POS, value=6}, CanIfRxPduCanId=1030 if post-build-variant-condition{matching-criterion=RDR_POS, value=7}, CanIfRxPduHrhIdRef=CN_PCAN_RADAR_a729ccfc_Rx, CanIfRxPduRef=RDR_FUSION_DET_025_028_oPCAN_RADAR_89b120f7_Rx
        RDR_FUSION_DET_113_116_oPCAN_RADAR_e045ee52_Rx: CanIfRxPduCanId=668 if post-build-variant-condition{matching-criterion=RDR_POS, value=0}, CanIfRxPduCanIdType=STANDARD_CAN, CanIfRxPduDlc=64, CanIfRxPduId=81, CanIfRxPduCanId=540 if post-build-variant-condition{matching-criterion=RDR_POS, value=1}, CanIfRxPduCanId=412 if post-build-variant-condition{matching-criterion=RDR_POS, value=2}, CanIfRxPduCanId=284 if post-build-variant-condition{matching-criterion=RDR_POS, value=3}, CanIfRxPduCanId=284 if post-build-variant-condition{matching-criterion=RDR_POS, value=4}, CanIfRxPduCanId=796 if post-build-variant-condition{matching-criterion=RDR_POS, value=5}, CanIfRxPduCanId=1180 if post-build-variant-condition{matching-criterion=RDR_POS, value=6}, CanIfRxPduCanId=1052 if post-build-variant-condition{matching-criterion=RDR_POS, value=7}, CanIfRxPduHrhIdRef=CN_PCAN_RADAR_a729ccfc_Rx, CanIfRxPduRef=RDR_FUSION_DET_113_116_oPCAN_RADAR_46c05298_Rx
        RDR_FUSION_DET_125_128_oPCAN_RADAR_681aaa69_Rx: CanIfRxPduCanId=671 if post-build-variant-condition{matching-criterion=RDR_POS, value=0}, CanIfRxPduCanIdType=STANDARD_CAN, CanIfRxPduDlc=64, CanIfRxPduId=84, CanIfRxPduCanId=543 if post-build-variant-condition{matching-criterion=RDR_POS, value=1}, CanIfRxPduCanId=415 if post-build-variant-condition{matching-criterion=RDR_POS, value=2}, CanIfRxPduCanId=287 if post-build-variant-condition{matching-criterion=RDR_POS, value=3}, CanIfRxPduCanId=287 if post-build-variant-condition{matching-criterion=RDR_POS, value=4}, CanIfRxPduCanId=799 if post-build-variant-condition{matching-criterion=RDR_POS, value=5}, CanIfRxPduCanId=1183 if post-build-variant-condition{matching-criterion=RDR_POS, value=6}, CanIfRxPduCanId=1055 if post-build-variant-condition{matching-criterion=RDR_POS, value=7}, CanIfRxPduHrhIdRef=CN_PCAN_RADAR_a729ccfc_Rx, CanIfRxPduRef=RDR_FUSION_DET_125_128_oPCAN_RADAR_08a63c96_Rx
        RDR_FUSION_DET_021_024_oPCAN_RADAR_9f591705_Rx: CanIfRxPduCanId=645 if post-build-variant-condition{matching-criterion=RDR_POS, value=0}, CanIfRxPduCanIdType=STANDARD_CAN, CanIfRxPduDlc=64, CanIfRxPduId=58, CanIfRxPduCanId=517 if post-build-variant-condition{matching-criterion=RDR_POS, value=1}, CanIfRxPduCanId=389 if post-build-variant-condition{matching-criterion=RDR_POS, value=2}, CanIfRxPduCanId=261 if post-build-variant-condition{matching-criterion=RDR_POS, value=3}, CanIfRxPduCanId=261 if post-build-variant-condition{matching-criterion=RDR_POS, value=4}, CanIfRxPduCanId=773 if post-build-variant-condition{matching-criterion=RDR_POS, value=5}, CanIfRxPduCanId=1157 if post-build-variant-condition{matching-criterion=RDR_POS, value=6}, CanIfRxPduCanId=1029 if post-build-variant-condition{matching-criterion=RDR_POS, value=7}, CanIfRxPduHrhIdRef=CN_PCAN_RADAR_a729ccfc_Rx, CanIfRxPduRef=RDR_FUSION_DET_021_024_oPCAN_RADAR_50cdb45d_Rx
        RDR_FUSION_DET_045_048_oPCAN_RADAR_7830fb18_Rx: CanIfRxPduCanId=651 if post-build-variant-condition{matching-criterion=RDR_POS, value=0}, CanIfRxPduCanIdType=STANDARD_CAN, CanIfRxPduDlc=64, CanIfRxPduId=64, CanIfRxPduCanId=523 if post-build-variant-condition{matching-criterion=RDR_POS, value=1}, CanIfRxPduCanId=395 if post-build-variant-condition{matching-criterion=RDR_POS, value=2}, CanIfRxPduCanId=267 if post-build-variant-condition{matching-criterion=RDR_POS, value=3}, CanIfRxPduCanId=267 if post-build-variant-condition{matching-criterion=RDR_POS, value=4}, CanIfRxPduCanId=779 if post-build-variant-condition{matching-criterion=RDR_POS, value=5}, CanIfRxPduCanId=1163 if post-build-variant-condition{matching-criterion=RDR_POS, value=6}, CanIfRxPduCanId=1035 if post-build-variant-condition{matching-criterion=RDR_POS, value=7}, CanIfRxPduHrhIdRef=CN_PCAN_RADAR_a729ccfc_Rx, CanIfRxPduRef=RDR_FUSION_DET_045_048_oPCAN_RADAR_c96cc68d_Rx
        RDR_FUSION_DET_041_044_oPCAN_RADAR_3849b283_Rx: CanIfRxPduCanId=650 if post-build-variant-condition{matching-criterion=RDR_POS, value=0}, CanIfRxPduCanIdType=STANDARD_CAN, CanIfRxPduDlc=64, CanIfRxPduId=63, CanIfRxPduCanId=522 if post-build-variant-condition{matching-criterion=RDR_POS, value=1}, CanIfRxPduCanId=394 if post-build-variant-condition{matching-criterion=RDR_POS, value=2}, CanIfRxPduCanId=266 if post-build-variant-condition{matching-criterion=RDR_POS, value=3}, CanIfRxPduCanId=266 if post-build-variant-condition{matching-criterion=RDR_POS, value=4}, CanIfRxPduCanId=778 if post-build-variant-condition{matching-criterion=RDR_POS, value=5}, CanIfRxPduCanId=1162 if post-build-variant-condition{matching-criterion=RDR_POS, value=6}, CanIfRxPduCanId=1034 if post-build-variant-condition{matching-criterion=RDR_POS, value=7}, CanIfRxPduHrhIdRef=CN_PCAN_RADAR_a729ccfc_Rx, CanIfRxPduRef=RDR_FUSION_DET_041_044_oPCAN_RADAR_10105227_Rx
        ADAS_FN_Enable_disable_sts_oVCAN_RADAR_12bee21f_Rx: CanIfRxPduCanId=218073111, CanIfRxPduCanIdMask=67108863, CanIfRxPduCanIdType=EXTENDED_CAN, CanIfRxPduDlc=8, CanIfRxPduId=0, CanIfRxPduHrhIdRef=CN_VCAN_RADAR_0fbf9117_Rx, CanIfRxPduRef=ADAS_FN_Enable_disable_sts_oVCAN_RADAR_3f57de57_Rx
      BSD1_oVCAN_RADAR_64acbe01_Tx (CanIfTxPduCfg):
        CanIfTxPduCanId = 217188016
        CanIfTxPduCanIdType = EXTENDED_CAN
        CanIfTxPduDlc = 8
        CanIfTxPduUserTxConfirmationUL = NONE
        CanIfTxPduId = 0
        CanIfTxPduReadNotifyStatus = false
        CanIfTxPduType = STATIC
        CanIfTxPduTruncation = true
        CanIfTxPduUserTxConfirmationName = NULL_PTR
        CanIfTxPduBufferRef = CHNL_0829f689
        CanIfTxPduRef = BSD1_oVCAN_RADAR_aa49a410_Tx
      CLS_Tx_4_oVCAN_RADAR_86e16ec0_Rx (CanIfRxPduCfg):
        CanIfRxPduCanId = 419385367
        CanIfRxPduCanIdMask = 67108863
        CanIfRxPduCanIdType = EXTENDED_CAN
        CanIfRxPduDlc = 8
        CanIfRxPduUserRxIndicationName = PduR_CanIfRxIndication
        CanIfRxPduUserRxIndicationUL = PDUR
        CanIfRxPduId = 2
        CanIfRxPduReadData = false
        CanIfRxPduReadNotifyStatus = false
        CanIfRxPduDlcCheck = true
        CanIfRxPduType = STATIC
        CanIfRxPduHrhIdRef = CN_VCAN_RADAR_0fbf9117_Rx
        CanIfRxPduRef = CLS_Tx_4_oVCAN_RADAR_e4fced07_Rx
      TPCM_Tp_oVCAN_RADAR_229e257c_Tx (CanIfTxPduCfg):
        CanIfTxPduCanId = 485293822
        CanIfTxPduCanIdMask = 3825139712
        CanIfTxPduCanIdType = EXTENDED_CAN
        CanIfTxPduDlc = 8
        CanIfTxPduUserTxConfirmationName = J1939Tp_TxConfirmation
        CanIfTxPduUserTxConfirmationUL = J1939TP
        CanIfTxPduId = 223
        CanIfTxPduReadNotifyStatus = false
        CanIfTxPduType = STATIC
        CanIfTxPduTruncation = true
        CanIfTxPduBufferRef = CHNL_0829f689
        CanIfTxPduRef = TPCM_Tp_oVCAN_RADAR_a235016c_Tx
      TPDT_Tp_oVCAN_RADAR_95c1c45e_Tx (CanIfTxPduCfg):
        CanIfTxPduCanId = 485228286
        CanIfTxPduCanIdMask = 3825139712
        CanIfTxPduCanIdType = EXTENDED_CAN
        CanIfTxPduDlc = 8
        CanIfTxPduUserTxConfirmationName = J1939Tp_TxConfirmation
        CanIfTxPduUserTxConfirmationUL = J1939TP
        CanIfTxPduId = 226
        CanIfTxPduReadNotifyStatus = false
        CanIfTxPduType = STATIC
        CanIfTxPduTruncation = true
        CanIfTxPduBufferRef = CHNL_0829f689
        CanIfTxPduRef = TPDT_Tp_oVCAN_RADAR_92966f54_Tx
      7 x CanIfRxPduCfg, all with CanIfRxPduCanIdMask=67108863, CanIfRxPduCanIdType=EXTENDED_CAN, CanIfRxPduDlc=8, CanIfRxPduUserRxIndicationName=PduR_CanIfRxIndication, CanIfRxPduUserRxIndicationUL=PDUR, CanIfRxPduReadData=false, CanIfRxPduReadNotifyStatus=false, CanIfRxPduDlcCheck=true, CanIfRxPduType=STATIC, CanIfRxPduHrhIdRef=CN_VCAN_RADAR_0fbf9117_Rx:
        VDC2_oVCAN_RADAR_2417bb2a_Rx: CanIfRxPduCanId=418384139, CanIfRxPduId=109, CanIfRxPduRef=VDC2_oVCAN_RADAR_9b73b1bc_Rx
        OEL_oVCAN_RADAR_8850ccda_Rx: CanIfRxPduCanId=217959447, CanIfRxPduId=28, CanIfRxPduRef=OEL_oVCAN_RADAR_45092dcb_Rx
        VI_oVCAN_RADAR_3ac3c5b8_Rx: CanIfRxPduCanId=419359781, CanIfRxPduId=111, CanIfRxPduRef=VI_oVCAN_RADAR_b73d6113_Rx
        TD_oVCAN_RADAR_e2a191e5_Rx: CanIfRxPduCanId=419358231, CanIfRxPduId=108, CanIfRxPduRef=TD_oVCAN_RADAR_7fe49199_Rx
        ETC2_03_oVCAN_RADAR_6f7e9f8c_Rx: CanIfRxPduCanId=418383107, CanIfRxPduId=11, CanIfRxPduRef=ETC2_03_oVCAN_RADAR_a69b4dc5_Rx
        CLS_Tx_16_oVCAN_RADAR_b5bd9e87_Rx: CanIfRxPduCanId=419365143, CanIfRxPduId=3, CanIfRxPduRef=CLS_Tx_16_oVCAN_RADAR_afa2b499_Rx
        ETC2_00_oVCAN_RADAR_bceeb942_Rx: CanIfRxPduCanId=418383104, CanIfRxPduId=10, CanIfRxPduRef=ETC2_00_oVCAN_RADAR_fd8cfcd0_Rx
      MOIS_oVCAN_RADAR_edd3b80a_Tx (CanIfTxPduCfg):
        CanIfTxPduCanId = 218057424
        CanIfTxPduCanIdType = EXTENDED_CAN
        CanIfTxPduDlc = 8
        CanIfTxPduUserTxConfirmationName = NULL_PTR
        CanIfTxPduUserTxConfirmationUL = NONE
        CanIfTxPduId = 20
        CanIfTxPduReadNotifyStatus = false
        CanIfTxPduType = STATIC
        CanIfTxPduTruncation = true
        CanIfTxPduBufferRef = CHNL_0829f689
        CanIfTxPduRef = MOIS_oVCAN_RADAR_1658382d_Tx
      3 x CanIfRxPduCfg, all with CanIfRxPduCanIdMask=67108863, CanIfRxPduCanIdType=EXTENDED_CAN, CanIfRxPduDlc=8, CanIfRxPduUserRxIndicationName=PduR_CanIfRxIndication, CanIfRxPduUserRxIndicationUL=PDUR, CanIfRxPduReadData=false, CanIfRxPduReadNotifyStatus=false, CanIfRxPduDlcCheck=true, CanIfRxPduType=STATIC, CanIfRxPduHrhIdRef=CN_VCAN_RADAR_0fbf9117_Rx:
        VD_oVCAN_RADAR_4ccaa5be_Rx: CanIfRxPduCanId=419356672, CanIfRxPduId=110, CanIfRxPduRef=VD_oVCAN_RADAR_36e033f5_Rx
        CCVS1_oVCAN_RADAR_2823bd01_Rx: CanIfRxPduCanId=419361024, CanIfRxPduId=1, CanIfRxPduRef=CCVS1_oVCAN_RADAR_e4df8c5f_Rx
        SAS_oVCAN_RADAR_0befc4d7_Rx: CanIfRxPduCanId=418389476, CanIfRxPduId=90, CanIfRxPduRef=SAS_oVCAN_RADAR_efd6af4d_Rx
      TpDirectNPdu_DM1_D0_oVCAN_RADAR_51899be1_VCAN_RADAR_J1939_bd37ae49 (CanIfTxPduCfg):
        CanIfTxPduCanId = 419351294
        CanIfTxPduCanIdType = EXTENDED_CAN
        CanIfTxPduDlc = 8
        CanIfTxPduId = 179
        CanIfTxPduReadNotifyStatus = false
        CanIfTxPduType = STATIC
        CanIfTxPduUserTxConfirmationUL = NONE if post-build-variant-condition{matching-criterion=RDR_POS, value=0}
        CanIfTxPduUserTxConfirmationUL = NONE if post-build-variant-condition{matching-criterion=RDR_POS, value=7}
        CanIfTxPduUserTxConfirmationUL = NONE if post-build-variant-condition{matching-criterion=RDR_POS, value=6}
        CanIfTxPduUserTxConfirmationUL = NONE if post-build-variant-condition{matching-criterion=RDR_POS, value=4}
        CanIfTxPduUserTxConfirmationUL = NONE if post-build-variant-condition{matching-criterion=RDR_POS, value=1}
        CanIfTxPduUserTxConfirmationUL = NONE if post-build-variant-condition{matching-criterion=RDR_POS, value=3}
        CanIfTxPduUserTxConfirmationUL = NONE if post-build-variant-condition{matching-criterion=RDR_POS, value=2}
        CanIfTxPduUserTxConfirmationUL = NONE if post-build-variant-condition{matching-criterion=RDR_POS, value=5}
        CanIfTxPduTruncation = true
        CanIfTxPduCanIdMask = 3758096384
        CanIfTxPduUserTxConfirmationName = NULL_PTR if post-build-variant-condition{matching-criterion=RDR_POS, value=0}
        CanIfTxPduUserTxConfirmationName = NULL_PTR if post-build-variant-condition{matching-criterion=RDR_POS, value=7}
        CanIfTxPduUserTxConfirmationName = NULL_PTR if post-build-variant-condition{matching-criterion=RDR_POS, value=6}
        CanIfTxPduUserTxConfirmationName = NULL_PTR if post-build-variant-condition{matching-criterion=RDR_POS, value=4}
        CanIfTxPduUserTxConfirmationName = NULL_PTR if post-build-variant-condition{matching-criterion=RDR_POS, value=1}
        CanIfTxPduUserTxConfirmationName = NULL_PTR if post-build-variant-condition{matching-criterion=RDR_POS, value=3}
        CanIfTxPduUserTxConfirmationName = NULL_PTR if post-build-variant-condition{matching-criterion=RDR_POS, value=2}
        CanIfTxPduUserTxConfirmationName = NULL_PTR if post-build-variant-condition{matching-criterion=RDR_POS, value=5}
        CanIfTxPduBufferRef = CHNL_0829f689
        CanIfTxPduRef = TPCM_DirectTp_oVCAN_RADAR_a235016c_Tx
      GW_CLS_Tx_16_Tx_oPCAN_RADAR_9dad2921_Tx (CanIfTxPduCfg):
        CanIfTxPduCanId = 419365144 if post-build-variant-condition{matching-criterion=RDR_POS, value=0}
        CanIfTxPduCanIdType = EXTENDED_CAN
        CanIfTxPduDlc = 8
        CanIfTxPduUserTxConfirmationUL = NONE
        CanIfTxPduId = 10
        CanIfTxPduReadNotifyStatus = false
        CanIfTxPduType = STATIC
        CanIfTxPduTruncation = true
        CanIfTxPduUserTxConfirmationName = NULL_PTR
        CanIfTxPduCanId = 419365144 if post-build-variant-condition{matching-criterion=RDR_POS, value={1..3}}
        CanIfTxPduCanId = 419365143 if post-build-variant-condition{matching-criterion=RDR_POS, value=4}
        CanIfTxPduCanId = 419365144 if post-build-variant-condition{matching-criterion=RDR_POS, value={5..7}}
        CanIfTxPduBufferRef = CHNL_2ad3227b_PCAN
        CanIfTxPduRef = GW_CLS_Tx_16_Tx_oPCAN_RADAR_b30c42cc_Tx
      3 x CanIfRxPduCfg, all with CanIfRxPduCanIdType=EXTENDED_CAN, CanIfRxPduDlc=8, CanIfRxPduUserRxIndicationUL=PDUR, CanIfRxPduReadData=false, CanIfRxPduReadNotifyStatus=false, CanIfRxPduUserRxIndicationName=PduR_CanIfRxIndication, CanIfRxPduDlcCheck=true, CanIfRxPduType=STATIC, CanIfRxPduHrhIdRef=CN_PCAN_RADAR_a729ccfc_Rx:
        RDR_BSD1_oPCAN_RADAR_04bcead5_Rx: CanIfRxPduCanId=217188094 if post-build-variant-condition{matching-criterion=RDR_POS, value=0}, CanIfRxPduId=45, CanIfRxPduCanId=217188016 if post-build-variant-condition{matching-criterion=RDR_POS, value=4}, CanIfRxPduCanId=217188094 if post-build-variant-condition{matching-criterion=RDR_POS, value=1}, CanIfRxPduCanId=217188094 if post-build-variant-condition{matching-criterion=RDR_POS, value=2}, CanIfRxPduCanId=217188094 if post-build-variant-condition{matching-criterion=RDR_POS, value=3}, CanIfRxPduCanId=217188094 if post-build-variant-condition{matching-criterion=RDR_POS, value=5}, CanIfRxPduCanId=217188094 if post-build-variant-condition{matching-criterion=RDR_POS, value=6}, CanIfRxPduCanId=217188094 if post-build-variant-condition{matching-criterion=RDR_POS, value=7}, CanIfRxPduRef=RDR_BSD1_oPCAN_RADAR_03d8d8bd_Rx
        GW_CLS_Tx_16_oPCAN_RADAR_5cbae8ef_Rx: CanIfRxPduCanId=419365143 if post-build-variant-condition{matching-criterion=RDR_POS, value=0}, CanIfRxPduId=19, CanIfRxPduCanId=419365143 if post-build-variant-condition{matching-criterion=RDR_POS, value=1}, CanIfRxPduCanId=419365143 if post-build-variant-condition{matching-criterion=RDR_POS, value=2}, CanIfRxPduCanId=419365143 if post-build-variant-condition{matching-criterion=RDR_POS, value=3}, CanIfRxPduCanId=419365399 if post-build-variant-condition{matching-criterion=RDR_POS, value=4}, CanIfRxPduCanId=419365143 if post-build-variant-condition{matching-criterion=RDR_POS, value=5}, CanIfRxPduCanId=419365143 if post-build-variant-condition{matching-criterion=RDR_POS, value=6}, CanIfRxPduCanId=419365143 if post-build-variant-condition{matching-criterion=RDR_POS, value=7}, CanIfRxPduRef=GW_CLS_Tx_16_oPCAN_RADAR_c3f80567_Rx
        GW_ADAS_FN_Enable_disable_sts_oPCAN_RADAR_e7ed2761_Rx: CanIfRxPduCanId=218073111 if post-build-variant-condition{matching-criterion=RDR_POS, value=0}, CanIfRxPduId=16, CanIfRxPduCanId=218073111 if post-build-variant-condition{matching-criterion=RDR_POS, value=1}, CanIfRxPduCanId=218073111 if post-build-variant-condition{matching-criterion=RDR_POS, value=2}, CanIfRxPduCanId=218073111 if post-build-variant-condition{matching-criterion=RDR_POS, value=3}, CanIfRxPduCanId=218073127 if post-build-variant-condition{matching-criterion=RDR_POS, value=4}, CanIfRxPduCanId=218073111 if post-build-variant-condition{matching-criterion=RDR_POS, value=5}, CanIfRxPduCanId=218073111 if post-build-variant-condition{matching-criterion=RDR_POS, value=6}, CanIfRxPduCanId=218073111 if post-build-variant-condition{matching-criterion=RDR_POS, value=7}, CanIfRxPduRef=GW_ADAS_FN_Enable_disable_sts_oPCAN_RADAR_781ac753_Rx
      GW_TD_Tx_oPCAN_RADAR_2f7068b5_Tx (CanIfTxPduCfg):
        CanIfTxPduCanId = 419358232 if post-build-variant-condition{matching-criterion=RDR_POS, value=0}
        CanIfTxPduCanIdType = EXTENDED_CAN
        CanIfTxPduDlc = 8
        CanIfTxPduUserTxConfirmationUL = NONE
        CanIfTxPduId = 15
        CanIfTxPduReadNotifyStatus = false
        CanIfTxPduType = STATIC
        CanIfTxPduTruncation = true
        CanIfTxPduUserTxConfirmationName = NULL_PTR
        CanIfTxPduCanId = 419358232 if post-build-variant-condition{matching-criterion=RDR_POS, value={1..3}}
        CanIfTxPduCanId = 419358231 if post-build-variant-condition{matching-criterion=RDR_POS, value=4}
        CanIfTxPduCanId = 419358232 if post-build-variant-condition{matching-criterion=RDR_POS, value={5..7}}
        CanIfTxPduBufferRef = CHNL_2ad3227b_PCAN
        CanIfTxPduRef = GW_TD_Tx_oPCAN_RADAR_aa39de8f_Tx
      GW_OEL_oPCAN_RADAR_072b70f3_Rx (CanIfRxPduCfg):
        CanIfRxPduCanId = 217959447 if post-build-variant-condition{matching-criterion=RDR_POS, value=0}
        CanIfRxPduCanIdType = EXTENDED_CAN
        CanIfRxPduDlc = 8
        CanIfRxPduUserRxIndicationName = PduR_CanIfRxIndication
        CanIfRxPduUserRxIndicationUL = PDUR
        CanIfRxPduId = 22
        CanIfRxPduReadData = false
        CanIfRxPduReadNotifyStatus = false
        CanIfRxPduDlcCheck = true
        CanIfRxPduType = STATIC
        CanIfRxPduCanId = 217959447 if post-build-variant-condition{matching-criterion=RDR_POS, value={1..3}}
        CanIfRxPduCanId = 217959703 if post-build-variant-condition{matching-criterion=RDR_POS, value=4}
        CanIfRxPduCanId = 217959447 if post-build-variant-condition{matching-criterion=RDR_POS, value={5..7}}
        CanIfRxPduHrhIdRef = CN_PCAN_RADAR_a729ccfc_Rx
        CanIfRxPduRef = GW_OEL_oPCAN_RADAR_4c06edea_Rx
      GW_CCVS1_Tx_oPCAN_RADAR_de02a585_Tx (CanIfTxPduCfg):
        CanIfTxPduCanId = 419361025 if post-build-variant-condition{matching-criterion=RDR_POS, value=0}
        CanIfTxPduCanIdType = EXTENDED_CAN
        CanIfTxPduDlc = 8
        CanIfTxPduUserTxConfirmationUL = NONE
        CanIfTxPduId = 8
        CanIfTxPduReadNotifyStatus = false
        CanIfTxPduType = STATIC
        CanIfTxPduTruncation = true
        CanIfTxPduUserTxConfirmationName = NULL_PTR
        CanIfTxPduCanId = 419361025 if post-build-variant-condition{matching-criterion=RDR_POS, value={1..3}}
        CanIfTxPduCanId = 419361024 if post-build-variant-condition{matching-criterion=RDR_POS, value=4}
        CanIfTxPduCanId = 419361025 if post-build-variant-condition{matching-criterion=RDR_POS, value={5..7}}
        CanIfTxPduBufferRef = CHNL_2ad3227b_PCAN
        CanIfTxPduRef = GW_CCVS1_Tx_oPCAN_RADAR_7eaa671a_Tx
      GW_TD_oPCAN_RADAR_8d3696b8_Rx (CanIfRxPduCfg):
        CanIfRxPduCanId = 419358231 if post-build-variant-condition{matching-criterion=RDR_POS, value=0}
        CanIfRxPduCanIdType = EXTENDED_CAN
        CanIfRxPduDlc = 8
        CanIfRxPduUserRxIndicationName = PduR_CanIfRxIndication
        CanIfRxPduUserRxIndicationUL = PDUR
        CanIfRxPduId = 24
        CanIfRxPduReadData = false
        CanIfRxPduReadNotifyStatus = false
        CanIfRxPduDlcCheck = true
        CanIfRxPduType = STATIC
        CanIfRxPduCanId = 419358231 if post-build-variant-condition{matching-criterion=RDR_POS, value={1..3}}
        CanIfRxPduCanId = 419358487 if post-build-variant-condition{matching-criterion=RDR_POS, value=4}
        CanIfRxPduCanId = 419358231 if post-build-variant-condition{matching-criterion=RDR_POS, value={5..7}}
        CanIfRxPduHrhIdRef = CN_PCAN_RADAR_a729ccfc_Rx
        CanIfRxPduRef = GW_TD_oPCAN_RADAR_a04f08f1_Rx
      GW_VI_oPCAN_RADAR_50142625_Rx (CanIfRxPduCfg):
        CanIfRxPduCanId = 419359781 if post-build-variant-condition{matching-criterion=RDR_POS, value=0}
        CanIfRxPduCanIdType = EXTENDED_CAN
        CanIfRxPduDlc = 8
        CanIfRxPduUserRxIndicationName = PduR_CanIfRxIndication
        CanIfRxPduUserRxIndicationUL = PDUR
        CanIfRxPduId = 27
        CanIfRxPduReadData = false
        CanIfRxPduReadNotifyStatus = false
        CanIfRxPduDlcCheck = true
        CanIfRxPduType = STATIC
        CanIfRxPduCanId = 419359781 if post-build-variant-condition{matching-criterion=RDR_POS, value={1..3}}
        CanIfRxPduCanId = 419360037 if post-build-variant-condition{matching-criterion=RDR_POS, value=4}
        CanIfRxPduCanId = 419359781 if post-build-variant-condition{matching-criterion=RDR_POS, value={5..7}}
        CanIfRxPduHrhIdRef = CN_PCAN_RADAR_a729ccfc_Rx
        CanIfRxPduRef = GW_VI_oPCAN_RADAR_6896f87b_Rx
      6 x CanIfTxPduCfg, all with CanIfTxPduCanIdType=EXTENDED_CAN, CanIfTxPduDlc=8, CanIfTxPduUserTxConfirmationUL=NONE, CanIfTxPduReadNotifyStatus=false, CanIfTxPduType=STATIC, CanIfTxPduTruncation=true, CanIfTxPduUserTxConfirmationName=NULL_PTR, CanIfTxPduBufferRef=CHNL_2ad3227b_PCAN:
        GW_VI_Tx_oPCAN_RADAR_ba7d49ea_Tx: CanIfTxPduCanId=419359782 if post-build-variant-condition{matching-criterion=RDR_POS, value=0}, CanIfTxPduId=18, CanIfTxPduCanId=419359782 if post-build-variant-condition{matching-criterion=RDR_POS, value=1}, CanIfTxPduCanId=419359782 if post-build-variant-condition{matching-criterion=RDR_POS, value=2}, CanIfTxPduCanId=419359782 if post-build-variant-condition{matching-criterion=RDR_POS, value=3}, CanIfTxPduCanId=419359781 if post-build-variant-condition{matching-criterion=RDR_POS, value=4}, CanIfTxPduCanId=419359782 if post-build-variant-condition{matching-criterion=RDR_POS, value=5}, CanIfTxPduCanId=419359782 if post-build-variant-condition{matching-criterion=RDR_POS, value=6}, CanIfTxPduCanId=419359782 if post-build-variant-condition{matching-criterion=RDR_POS, value=7}, CanIfTxPduRef=GW_VI_Tx_oPCAN_RADAR_ad28cbdc_Tx
        GW_VDC2_Tx_oPCAN_RADAR_f54084fa_Tx: CanIfTxPduCanId=418384130 if post-build-variant-condition{matching-criterion=RDR_POS, value=0}, CanIfTxPduId=16, CanIfTxPduCanId=418384130 if post-build-variant-condition{matching-criterion=RDR_POS, value=1}, CanIfTxPduCanId=418384130 if post-build-variant-condition{matching-criterion=RDR_POS, value=2}, CanIfTxPduCanId=418384130 if post-build-variant-condition{matching-criterion=RDR_POS, value=3}, CanIfTxPduCanId=418384139 if post-build-variant-condition{matching-criterion=RDR_POS, value=4}, CanIfTxPduCanId=418384130 if post-build-variant-condition{matching-criterion=RDR_POS, value=5}, CanIfTxPduCanId=418384130 if post-build-variant-condition{matching-criterion=RDR_POS, value=6}, CanIfTxPduCanId=418384130 if post-build-variant-condition{matching-criterion=RDR_POS, value=7}, CanIfTxPduRef=GW_VDC2_Tx_oPCAN_RADAR_8a7343d4_Tx
        GW_CLS_Tx_4_Tx_oPCAN_RADAR_33bc88fd_Tx: CanIfTxPduCanId=419385368 if post-build-variant-condition{matching-criterion=RDR_POS, value=0}, CanIfTxPduId=9, CanIfTxPduCanId=419385368 if post-build-variant-condition{matching-criterion=RDR_POS, value=1}, CanIfTxPduCanId=419385368 if post-build-variant-condition{matching-criterion=RDR_POS, value=2}, CanIfTxPduCanId=419385368 if post-build-variant-condition{matching-criterion=RDR_POS, value=3}, CanIfTxPduCanId=419385367 if post-build-variant-condition{matching-criterion=RDR_POS, value=4}, CanIfTxPduCanId=419385368 if post-build-variant-condition{matching-criterion=RDR_POS, value=5}, CanIfTxPduCanId=419385368 if post-build-variant-condition{matching-criterion=RDR_POS, value=6}, CanIfTxPduCanId=419385368 if post-build-variant-condition{matching-criterion=RDR_POS, value=7}, CanIfTxPduRef=GW_CLS_Tx_4_Tx_oPCAN_RADAR_ecf0186d_Tx
        GW_OEL_Tx_oPCAN_RADAR_a8245947_Tx: CanIfTxPduCanId=217959448 if post-build-variant-condition{matching-criterion=RDR_POS, value=0}, CanIfTxPduId=13, CanIfTxPduCanId=217959448 if post-build-variant-condition{matching-criterion=RDR_POS, value=1}, CanIfTxPduCanId=217959448 if post-build-variant-condition{matching-criterion=RDR_POS, value=2}, CanIfTxPduCanId=217959448 if post-build-variant-condition{matching-criterion=RDR_POS, value=3}, CanIfTxPduCanId=217959447 if post-build-variant-condition{matching-criterion=RDR_POS, value=4}, CanIfTxPduCanId=217959448 if post-build-variant-condition{matching-criterion=RDR_POS, value=5}, CanIfTxPduCanId=217959448 if post-build-variant-condition{matching-criterion=RDR_POS, value=6}, CanIfTxPduCanId=217959448 if post-build-variant-condition{matching-criterion=RDR_POS, value=7}, CanIfTxPduRef=GW_OEL_Tx_oPCAN_RADAR_96436c6f_Tx
        GW_ETC2_Tx_oPCAN_RADAR_5963dc30_Tx: CanIfTxPduCanId=418383105 if post-build-variant-condition{matching-criterion=RDR_POS, value=0}, CanIfTxPduId=12, CanIfTxPduCanId=418383105 if post-build-variant-condition{matching-criterion=RDR_POS, value=1}, CanIfTxPduCanId=418383105 if post-build-variant-condition{matching-criterion=RDR_POS, value=2}, CanIfTxPduCanId=418383105 if post-build-variant-condition{matching-criterion=RDR_POS, value=3}, CanIfTxPduCanId=418383104 if post-build-variant-condition{matching-criterion=RDR_POS, value=4}, CanIfTxPduCanId=418383105 if post-build-variant-condition{matching-criterion=RDR_POS, value=5}, CanIfTxPduCanId=418383105 if post-build-variant-condition{matching-criterion=RDR_POS, value=6}, CanIfTxPduCanId=418383105 if post-build-variant-condition{matching-criterion=RDR_POS, value=7}, CanIfTxPduRef=GW_ETC2_Tx_oPCAN_RADAR_dfec0354_Tx
        GW_ADAS_FN_Enable_disable_sts_Tx_oPCAN_RADAR_b3ed1cbc_Tx: CanIfTxPduCanId=218073112 if post-build-variant-condition{matching-criterion=RDR_POS, value=0}, CanIfTxPduId=7, CanIfTxPduCanId=218073112 if post-build-variant-condition{matching-criterion=RDR_POS, value=1}, CanIfTxPduCanId=218073112 if post-build-variant-condition{matching-criterion=RDR_POS, value=2}, CanIfTxPduCanId=218073112 if post-build-variant-condition{matching-criterion=RDR_POS, value=3}, CanIfTxPduCanId=218073111 if post-build-variant-condition{matching-criterion=RDR_POS, value=4}, CanIfTxPduCanId=218073112 if post-build-variant-condition{matching-criterion=RDR_POS, value=5}, CanIfTxPduCanId=218073112 if post-build-variant-condition{matching-criterion=RDR_POS, value=6}, CanIfTxPduCanId=218073112 if post-build-variant-condition{matching-criterion=RDR_POS, value=7}, CanIfTxPduRef=GW_ADAS_FN_Enable_disable_sts_Tx_oPCAN_RADAR_27a639a3_Tx
      GW_VDC2_oPCAN_RADAR_aaaa415e_Rx (CanIfRxPduCfg):
        CanIfRxPduCanId = 418384139 if post-build-variant-condition{matching-criterion=RDR_POS, value=0}
        CanIfRxPduCanIdType = EXTENDED_CAN
        CanIfRxPduDlc = 8
        CanIfRxPduUserRxIndicationName = PduR_CanIfRxIndication
        CanIfRxPduUserRxIndicationUL = PDUR
        CanIfRxPduId = 25
        CanIfRxPduReadData = false
        CanIfRxPduReadNotifyStatus = false
        CanIfRxPduDlcCheck = true
        CanIfRxPduType = STATIC
        CanIfRxPduCanId = 418384139 if post-build-variant-condition{matching-criterion=RDR_POS, value={1..3}}
        CanIfRxPduCanId = 418384395 if post-build-variant-condition{matching-criterion=RDR_POS, value=4}
        CanIfRxPduCanId = 418384139 if post-build-variant-condition{matching-criterion=RDR_POS, value={5..7}}
        CanIfRxPduHrhIdRef = CN_PCAN_RADAR_a729ccfc_Rx
        CanIfRxPduRef = GW_VDC2_oPCAN_RADAR_9daa2cf0_Rx
      GW_VD_oPCAN_RADAR_c4632d82_Rx (CanIfRxPduCfg):
        CanIfRxPduCanId = 419356672 if post-build-variant-condition{matching-criterion=RDR_POS, value=0}
        CanIfRxPduCanIdType = EXTENDED_CAN
        CanIfRxPduDlc = 8
        CanIfRxPduUserRxIndicationName = PduR_CanIfRxIndication
        CanIfRxPduUserRxIndicationUL = PDUR
        CanIfRxPduId = 26
        CanIfRxPduReadData = false
        CanIfRxPduReadNotifyStatus = false
        CanIfRxPduDlcCheck = true
        CanIfRxPduType = STATIC
        CanIfRxPduCanId = 419356672 if post-build-variant-condition{matching-criterion=RDR_POS, value={1..3}}
        CanIfRxPduCanId = 419356928 if post-build-variant-condition{matching-criterion=RDR_POS, value=4}
        CanIfRxPduCanId = 419356672 if post-build-variant-condition{matching-criterion=RDR_POS, value={5..7}}
        CanIfRxPduHrhIdRef = CN_PCAN_RADAR_a729ccfc_Rx
        CanIfRxPduRef = GW_VD_oPCAN_RADAR_e94baa9d_Rx
      GW_SAS_Tx_oPCAN_RADAR_2217d6e9_Tx (CanIfTxPduCfg):
        CanIfTxPduCanId = 418389477 if post-build-variant-condition{matching-criterion=RDR_POS, value=0}
        CanIfTxPduCanIdType = EXTENDED_CAN
        CanIfTxPduDlc = 8
        CanIfTxPduUserTxConfirmationUL = NONE
        CanIfTxPduId = 14
        CanIfTxPduReadNotifyStatus = false
        CanIfTxPduType = STATIC
        CanIfTxPduTruncation = true
        CanIfTxPduUserTxConfirmationName = NULL_PTR
        CanIfTxPduCanId = 418389477 if post-build-variant-condition{matching-criterion=RDR_POS, value={1..3}}
        CanIfTxPduCanId = 418389476 if post-build-variant-condition{matching-criterion=RDR_POS, value=4}
        CanIfTxPduCanId = 418389477 if post-build-variant-condition{matching-criterion=RDR_POS, value={5..7}}
        CanIfTxPduBufferRef = CHNL_2ad3227b_PCAN
        CanIfTxPduRef = GW_SAS_Tx_oPCAN_RADAR_6c223e7b_Tx
      3 x CanIfRxPduCfg, all with CanIfRxPduCanIdType=EXTENDED_CAN, CanIfRxPduDlc=8, CanIfRxPduUserRxIndicationName=PduR_CanIfRxIndication, CanIfRxPduUserRxIndicationUL=PDUR, CanIfRxPduReadData=false, CanIfRxPduReadNotifyStatus=false, CanIfRxPduDlcCheck=true, CanIfRxPduType=STATIC, CanIfRxPduHrhIdRef=CN_PCAN_RADAR_a729ccfc_Rx:
        GW_CLS_Tx_4_oPCAN_RADAR_2550d3a5_Rx: CanIfRxPduCanId=419385367 if post-build-variant-condition{matching-criterion=RDR_POS, value=0}, CanIfRxPduId=18, CanIfRxPduCanId=419385367 if post-build-variant-condition{matching-criterion=RDR_POS, value=1}, CanIfRxPduCanId=419385367 if post-build-variant-condition{matching-criterion=RDR_POS, value=2}, CanIfRxPduCanId=419385367 if post-build-variant-condition{matching-criterion=RDR_POS, value=3}, CanIfRxPduCanId=419389463 if post-build-variant-condition{matching-criterion=RDR_POS, value=4}, CanIfRxPduCanId=419385367 if post-build-variant-condition{matching-criterion=RDR_POS, value=5}, CanIfRxPduCanId=419385367 if post-build-variant-condition{matching-criterion=RDR_POS, value=6}, CanIfRxPduCanId=419385367 if post-build-variant-condition{matching-criterion=RDR_POS, value=7}, CanIfRxPduRef=GW_CLS_Tx_4_oPCAN_RADAR_deff6d37_Rx
        GW_ETC2_oPCAN_RADAR_71fbc026_Rx: CanIfRxPduCanId=418383104 if post-build-variant-condition{matching-criterion=RDR_POS, value=0}, CanIfRxPduId=21, CanIfRxPduCanId=418383104 if post-build-variant-condition{matching-criterion=RDR_POS, value=1}, CanIfRxPduCanId=418383104 if post-build-variant-condition{matching-criterion=RDR_POS, value=2}, CanIfRxPduCanId=418383104 if post-build-variant-condition{matching-criterion=RDR_POS, value=3}, CanIfRxPduCanId=418383360 if post-build-variant-condition{matching-criterion=RDR_POS, value=4}, CanIfRxPduCanId=418383104 if post-build-variant-condition{matching-criterion=RDR_POS, value=5}, CanIfRxPduCanId=418383104 if post-build-variant-condition{matching-criterion=RDR_POS, value=6}, CanIfRxPduCanId=418383104 if post-build-variant-condition{matching-criterion=RDR_POS, value=7}, CanIfRxPduRef=GW_ETC2_oPCAN_RADAR_57f17119_Rx
        GW_SAS_oPCAN_RADAR_e942763a_Rx: CanIfRxPduCanId=418389476 if post-build-variant-condition{matching-criterion=RDR_POS, value=0}, CanIfRxPduId=23, CanIfRxPduCanId=418389476 if post-build-variant-condition{matching-criterion=RDR_POS, value=1}, CanIfRxPduCanId=418389476 if post-build-variant-condition{matching-criterion=RDR_POS, value=2}, CanIfRxPduCanId=418389476 if post-build-variant-condition{matching-criterion=RDR_POS, value=3}, CanIfRxPduCanId=418389732 if post-build-variant-condition{matching-criterion=RDR_POS, value=4}, CanIfRxPduCanId=418389476 if post-build-variant-condition{matching-criterion=RDR_POS, value=5}, CanIfRxPduCanId=418389476 if post-build-variant-condition{matching-criterion=RDR_POS, value=6}, CanIfRxPduCanId=418389476 if post-build-variant-condition{matching-criterion=RDR_POS, value=7}, CanIfRxPduRef=GW_SAS_oPCAN_RADAR_e6d96f6c_Rx
      GW_VD_Tx_oPCAN_RADAR_56fb68b9_Tx (CanIfTxPduCfg):
        CanIfTxPduCanId = 419356673 if post-build-variant-condition{matching-criterion=RDR_POS, value=0}
        CanIfTxPduCanIdType = EXTENDED_CAN
        CanIfTxPduDlc = 8
        CanIfTxPduUserTxConfirmationUL = NONE
        CanIfTxPduId = 17
        CanIfTxPduReadNotifyStatus = false
        CanIfTxPduType = STATIC
        CanIfTxPduTruncation = true
        CanIfTxPduUserTxConfirmationName = NULL_PTR
        CanIfTxPduCanId = 419356673 if post-build-variant-condition{matching-criterion=RDR_POS, value={1..3}}
        CanIfTxPduCanId = 419356672 if post-build-variant-condition{matching-criterion=RDR_POS, value=4}
        CanIfTxPduCanId = 419356673 if post-build-variant-condition{matching-criterion=RDR_POS, value={5..7}}
        CanIfTxPduBufferRef = CHNL_2ad3227b_PCAN
        CanIfTxPduRef = GW_VD_Tx_oPCAN_RADAR_70a8f6f0_Tx
      GW_CCVS1_oPCAN_RADAR_dee05550_Rx (CanIfRxPduCfg):
        CanIfRxPduCanId = 419361024 if post-build-variant-condition{matching-criterion=RDR_POS, value=0}
        CanIfRxPduCanIdType = EXTENDED_CAN
        CanIfRxPduDlc = 8
        CanIfRxPduUserRxIndicationName = PduR_CanIfRxIndication
        CanIfRxPduUserRxIndicationUL = PDUR
        CanIfRxPduId = 17
        CanIfRxPduReadData = false
        CanIfRxPduReadNotifyStatus = false
        CanIfRxPduDlcCheck = true
        CanIfRxPduType = STATIC
        CanIfRxPduCanId = 419361024 if post-build-variant-condition{matching-criterion=RDR_POS, value={1..3}}
        CanIfRxPduCanId = 419361280 if post-build-variant-condition{matching-criterion=RDR_POS, value=4}
        CanIfRxPduCanId = 419361024 if post-build-variant-condition{matching-criterion=RDR_POS, value={5..7}}
        CanIfRxPduHrhIdRef = CN_PCAN_RADAR_a729ccfc_Rx
        CanIfRxPduRef = GW_CCVS1_oPCAN_RADAR_d10adaab_Rx
      3 x CanIfTxPduCfg, all with CanIfTxPduUserTxConfirmationUL=NONE, CanIfTxPduReadNotifyStatus=false, CanIfTxPduType=STATIC, CanIfTxPduTruncation=true:
        RDR_BSD1_Tx_oPCAN_RADAR_ec8026a7_Tx: CanIfTxPduCanId=217188016 if post-build-variant-condition{matching-criterion=RDR_POS, value=0}, CanIfTxPduCanIdType=EXTENDED_CAN if post-build-variant-condition{matching-criterion=RDR_POS, value=0}, CanIfTxPduDlc=8, CanIfTxPduUserTxConfirmationName=NULL_PTR, CanIfTxPduId=31, CanIfTxPduCanId=217188046 if post-build-variant-condition{matching-criterion=RDR_POS, value=3}, CanIfTxPduCanId=217188016 if post-build-variant-condition{matching-criterion=RDR_POS, value=1}, CanIfTxPduCanId=217188016 if post-build-variant-condition{matching-criterion=RDR_POS, value=2}, CanIfTxPduCanId=217188032 if post-build-variant-condition{matching-criterion=RDR_POS, value=4}, CanIfTxPduCanIdType=EXTENDED_CAN if post-build-variant-condition{matching-criterion=RDR_POS, value=4}, CanIfTxPduCanIdType=EXTENDED_CAN if post-build-variant-condition{matching-criterion=RDR_POS, value=1}, CanIfTxPduCanIdType=EXTENDED_CAN if post-build-variant-condition{matching-criterion=RDR_POS, value=2}, CanIfTxPduCanIdType=EXTENDED_CAN if post-build-variant-condition{matching-criterion=RDR_POS, value=3}, CanIfTxPduCanId=217188017 if post-build-variant-condition{matching-criterion=RDR_POS, value=5}, CanIfTxPduCanIdType=EXTENDED_CAN if post-build-variant-condition{matching-criterion=RDR_POS, value=5}, CanIfTxPduCanId=217188017 if post-build-variant-condition{matching-criterion=RDR_POS, value=6}, CanIfTxPduCanIdType=EXTENDED_CAN if post-build-variant-condition{matching-criterion=RDR_POS, value=6}, CanIfTxPduCanId=217188017 if post-build-variant-condition{matching-criterion=RDR_POS, value=7}, CanIfTxPduCanIdType=EXTENDED_CAN if post-build-variant-condition{matching-criterion=RDR_POS, value=7}, CanIfTxPduBufferRef=CHNL_2ad3227b_PCAN, CanIfTxPduRef=RDR_BSD1_Tx_oPCAN_RADAR_3cea6970_Tx
        SR2_DIAG_RES_PHY_PLANT_oVCAN_RADAR_b3fa7e3b_Tx: CanIfTxPduCanId=417002928, CanIfTxPduCanIdMask=4294902015, CanIfTxPduCanIdType=EXTENDED_CAN, CanIfTxPduDlc=8, CanIfTxPduId=212, CanIfTxPduUserTxConfirmationName=NULL_PTR if post-build-variant-condition{matching-criterion=RDR_POS, value=7}, CanIfTxPduUserTxConfirmationName=NULL_PTR if post-build-variant-condition{matching-criterion=RDR_POS, value=5}, CanIfTxPduUserTxConfirmationName=NULL_PTR if post-build-variant-condition{matching-criterion=RDR_POS, value=6}, CanIfTxPduUserTxConfirmationName=NULL_PTR if post-build-variant-condition{matching-criterion=RDR_POS, value=4}, CanIfTxPduUserTxConfirmationName=NULL_PTR if post-build-variant-condition{matching-criterion=RDR_POS, value=1}, CanIfTxPduUserTxConfirmationName=NULL_PTR if post-build-variant-condition{matching-criterion=RDR_POS, value=2}, CanIfTxPduUserTxConfirmationName=NULL_PTR if post-build-variant-condition{matching-criterion=RDR_POS, value=3}, CanIfTxPduUserTxConfirmationName=NULL_PTR if post-build-variant-condition{matching-criterion=RDR_POS, value=0}, CanIfTxPduBufferRef=CHNL_0829f689, CanIfTxPduRef=SR2_DIAG_RES_PHY_PLANT_oVCAN_RADAR_20ab64b4_Tx
        SRR_FL_DIAG_REQ_PHYS_PLANT_Tx_oPCAN_RADAR_82406e1b_Tx: CanIfTxPduCanId=416985589, CanIfTxPduCanIdType=EXTENDED_CAN, CanIfTxPduDlc=64, CanIfTxPduId=216, CanIfTxPduUserTxConfirmationName=NULL_PTR if post-build-variant-condition{matching-criterion=RDR_POS, value=1}, CanIfTxPduUserTxConfirmationName=NULL_PTR if post-build-variant-condition{matching-criterion=RDR_POS, value=7}, CanIfTxPduUserTxConfirmationName=NULL_PTR if post-build-variant-condition{matching-criterion=RDR_POS, value=6}, CanIfTxPduUserTxConfirmationName=NULL_PTR if post-build-variant-condition{matching-criterion=RDR_POS, value=4}, CanIfTxPduUserTxConfirmationName=NULL_PTR if post-build-variant-condition{matching-criterion=RDR_POS, value=0}, CanIfTxPduUserTxConfirmationName=NULL_PTR if post-build-variant-condition{matching-criterion=RDR_POS, value=5}, CanIfTxPduUserTxConfirmationName=NULL_PTR if post-build-variant-condition{matching-criterion=RDR_POS, value=3}, CanIfTxPduUserTxConfirmationName=NULL_PTR if post-build-variant-condition{matching-criterion=RDR_POS, value=2}, CanIfTxPduBufferRef=CHNL_2ad3227b_PCAN, CanIfTxPduRef=SRR_FL_DIAG_REQ_PHYS_PLANT_Tx_oPCAN_RADAR_a38832c1_Tx
      PCAN_DIAG_REQ_PHYS_OBD2_Tp_oPCAN_RADAR_20_d1b6e80e_Rx (CanIfRxPduCfg):
        CanIfRxPduCanId = 416985329 if post-build-variant-condition{matching-criterion=RDR_POS, value=0}
        CanIfRxPduCanIdType = EXTENDED_NO_FD_CAN
        CanIfRxPduDlc = 8
        CanIfRxPduUserRxIndicationName = CanTp_RxIndication
        CanIfRxPduUserRxIndicationType = PDUID_PDUINFOPTR
        CanIfRxPduUserRxIndicationUL = CAN_TP
        CanIfRxPduId = 39
        CanIfRxPduReadData = false
        CanIfRxPduReadNotifyStatus = false
        CanIfRxPduDlcCheck = true
        CanIfRxPduType = STATIC
        CanIfRxPduCanId = 417001925 if post-build-variant-condition{matching-criterion=RDR_POS, value=1}
        CanIfRxPduCanId = 417001925 if post-build-variant-condition{matching-criterion=RDR_POS, value=2}
        CanIfRxPduCanId = 416985585 if post-build-variant-condition{matching-criterion=RDR_POS, value=3}
        CanIfRxPduCanId = 416993521 if post-build-variant-condition{matching-criterion=RDR_POS, value=4}
        CanIfRxPduCanId = 417001925 if post-build-variant-condition{matching-criterion=RDR_POS, value={5..7}}
        CanIfRxPduHrhIdRef = CN_PCAN_RADAR_a729ccfc_Rx
        CanIfRxPduRef = PCAN_DIAG_REQ_PHYS_OBD2_Tp_oPCAN_RADAR_20_65ff9201_Rx
      FR_DIAG_RES_PHY_OTA_Tp_oVCAN_RADAR_0ba1e84f_Tx (CanIfTxPduCfg):
        CanIfTxPduCanId = 417002704
        CanIfTxPduCanIdType = EXTENDED_CAN
        CanIfTxPduDlc = 8
        CanIfTxPduUserTxConfirmationName = CanTp_TxConfirmation
        CanIfTxPduUserTxConfirmationUL = CAN_TP
        CanIfTxPduId = 5
        CanIfTxPduReadNotifyStatus = false
        CanIfTxPduType = STATIC
        CanIfTxPduTruncation = true
        CanIfTxPduBufferRef = CHNL_0829f689
        CanIfTxPduRef = FR_DIAG_RES_PHY_OTA_Tp_oVCAN_RADAR_19b4e511_Tx
      PCAN_DIAG_RESP_PHYS_OBD2_Tp_oPCAN_RADAR_20_fc5af980_Tx (CanIfTxPduCfg):
        CanIfTxPduCanId = 417001904 if post-build-variant-condition{matching-criterion=RDR_POS, value=0}
        CanIfTxPduCanIdType = EXTENDED_CAN
        CanIfTxPduDlc = 8
        CanIfTxPduUserTxConfirmationName = CanTp_TxConfirmation
        CanIfTxPduUserTxConfirmationUL = CAN_TP
        CanIfTxPduId = 23
        CanIfTxPduReadNotifyStatus = false
        CanIfTxPduType = STATIC
        CanIfTxPduTruncation = true
        CanIfTxPduCanId = 417001915 if post-build-variant-condition{matching-criterion=RDR_POS, value=1}
        CanIfTxPduCanId = 417001915 if post-build-variant-condition{matching-criterion=RDR_POS, value=2}
        CanIfTxPduCanId = 417001905 if post-build-variant-condition{matching-criterion=RDR_POS, value=3}
        CanIfTxPduCanId = 417001936 if post-build-variant-condition{matching-criterion=RDR_POS, value=4}
        CanIfTxPduCanId = 417001915 if post-build-variant-condition{matching-criterion=RDR_POS, value={5..7}}
        CanIfTxPduBufferRef = CHNL_2ad3227b_PCAN
        CanIfTxPduRef = PCAN_DIAG_RESP_PHYS_OBD2_Tp_oPCAN_RADAR_20_25da435e_Tx
      PCAN_DIAG_REQ_PHYS_OBD1_Tp_oPCAN_RADAR_dcf5a9e3_Rx (CanIfRxPduCfg):
        CanIfRxPduCanId = 416985328 if post-build-variant-condition{matching-criterion=RDR_POS, value=0}
        CanIfRxPduCanIdType = EXTENDED_FD_CAN
        CanIfRxPduDlc = 64
        CanIfRxPduUserRxIndicationName = CanTp_RxIndication
        CanIfRxPduUserRxIndicationType = PDUID_PDUINFOPTR
        CanIfRxPduUserRxIndicationUL = CAN_TP
        CanIfRxPduId = 38
        CanIfRxPduReadData = false
        CanIfRxPduReadNotifyStatus = false
        CanIfRxPduDlcCheck = true
        CanIfRxPduType = STATIC
        CanIfRxPduCanId = 417001669 if post-build-variant-condition{matching-criterion=RDR_POS, value=1}
        CanIfRxPduCanId = 417001669 if post-build-variant-condition{matching-criterion=RDR_POS, value=2}
        CanIfRxPduCanId = 416985584 if post-build-variant-condition{matching-criterion=RDR_POS, value=3}
        CanIfRxPduCanId = 416993520 if post-build-variant-condition{matching-criterion=RDR_POS, value=4}
        CanIfRxPduCanId = 417001669 if post-build-variant-condition{matching-criterion=RDR_POS, value={5..7}}
        CanIfRxPduHrhIdRef = CN_PCAN_RADAR_a729ccfc_Rx
        CanIfRxPduRef = PCAN_DIAG_REQ_PHYS_OBD1_Tp_oPCAN_RADAR_6e232c89_Rx
      SR1_DIAG_RES_PHY_OTA_oVCAN_RADAR_b9a3928f_Tx (CanIfTxPduCfg):
        CanIfTxPduCanId = 417002673
        CanIfTxPduCanIdMask = 4294902015
        CanIfTxPduCanIdType = EXTENDED_CAN
        CanIfTxPduDlc = 8
        CanIfTxPduUserTxConfirmationUL = NONE
        CanIfTxPduId = 207
        CanIfTxPduReadNotifyStatus = false
        CanIfTxPduType = STATIC
        CanIfTxPduTruncation = true
        CanIfTxPduUserTxConfirmationName = NULL_PTR if post-build-variant-condition{matching-criterion=RDR_POS, value=1}
        CanIfTxPduUserTxConfirmationName = NULL_PTR if post-build-variant-condition{matching-criterion=RDR_POS, value=4}
        CanIfTxPduUserTxConfirmationName = NULL_PTR if post-build-variant-condition{matching-criterion=RDR_POS, value=7}
        CanIfTxPduUserTxConfirmationName = NULL_PTR if post-build-variant-condition{matching-criterion=RDR_POS, value=3}
        CanIfTxPduUserTxConfirmationName = NULL_PTR if post-build-variant-condition{matching-criterion=RDR_POS, value=5}
        CanIfTxPduUserTxConfirmationName = NULL_PTR if post-build-variant-condition{matching-criterion=RDR_POS, value=0}
        CanIfTxPduUserTxConfirmationName = NULL_PTR if post-build-variant-condition{matching-criterion=RDR_POS, value=6}
        CanIfTxPduUserTxConfirmationName = NULL_PTR if post-build-variant-condition{matching-criterion=RDR_POS, value=2}
        CanIfTxPduBufferRef = CHNL_0829f689
        CanIfTxPduRef = SR1_DIAG_RES_PHY_OTA_oVCAN_RADAR_349e32f6_Tx
      5 x CanIfRxPduCfg, all with CanIfRxPduReadData=false, CanIfRxPduReadNotifyStatus=false, CanIfRxPduDlcCheck=true, CanIfRxPduType=STATIC:
        FR_DIAG_REQ_PHY_OTA_Tp_oVCAN_RADAR_a23061a0_Rx: CanIfRxPduCanId=416993524, CanIfRxPduCanIdType=EXTENDED_CAN, CanIfRxPduDlc=8, CanIfRxPduUserRxIndicationName=CanTp_RxIndication, CanIfRxPduUserRxIndicationType=PDUID_PDUINFOPTR, CanIfRxPduUserRxIndicationUL=CAN_TP, CanIfRxPduId=14, CanIfRxPduHrhIdRef=CN_VCAN_RADAR_0fbf9117_Rx, CanIfRxPduRef=FR_DIAG_REQ_PHY_OTA_Tp_oVCAN_RADAR_4de495d5_Rx
        SR2_DIAG_REQ_PHY_PLANT_oVCAN_RADAR_fe78030d_Rx: CanIfRxPduCanId=416985333, CanIfRxPduCanIdMask=67108863, CanIfRxPduCanIdType=EXTENDED_CAN, CanIfRxPduDlc=8, CanIfRxPduUserRxIndicationUL=NONE, CanIfRxPduId=98, CanIfRxPduUserRxIndicationName=NULL_PTR, CanIfRxPduHrhIdRef=CN_VCAN_RADAR_0fbf9117_Rx, CanIfRxPduRef=SR2_DIAG_REQ_PHY_PLANT_oVCAN_RADAR_ae8c8942_Rx
        RDR_FUSION_ALIGNMENT_STATUS_002_oPCAN_RADAR_666234f7_Rx: CanIfRxPduCanId=158 if post-build-variant-condition{matching-criterion=RDR_POS, value=0}, CanIfRxPduCanIdType=STANDARD_CAN, CanIfRxPduDlc=64, CanIfRxPduUserRxIndicationName=PduR_CanIfRxIndication, CanIfRxPduUserRxIndicationUL=PDUR, CanIfRxPduId=51, CanIfRxPduCanId=150 if post-build-variant-condition{matching-criterion=RDR_POS, value=1}, CanIfRxPduCanId=142 if post-build-variant-condition{matching-criterion=RDR_POS, value=2}, CanIfRxPduCanId=134 if post-build-variant-condition{matching-criterion=RDR_POS, value=3}, CanIfRxPduCanId=134 if post-build-variant-condition{matching-criterion=RDR_POS, value=4}, CanIfRxPduCanId=166 if post-build-variant-condition{matching-criterion=RDR_POS, value=5}, CanIfRxPduCanId=190 if post-build-variant-condition{matching-criterion=RDR_POS, value=6}, CanIfRxPduCanId=182 if post-build-variant-condition{matching-criterion=RDR_POS, value=7}, CanIfRxPduHrhIdRef=CN_PCAN_RADAR_a729ccfc_Rx, CanIfRxPduRef=RDR_FUSION_ALIGNMENT_STATUS_002_oPCAN_RADAR_b952d80d_Rx
        DIAG_REQ_FNC_OBD1_Tp_oVCAN_RADAR_6a2825b2_Rx: CanIfRxPduCanId=417018864, CanIfRxPduCanIdType=EXTENDED_CAN, CanIfRxPduDlc=8, CanIfRxPduUserRxIndicationName=CanTp_RxIndication, CanIfRxPduUserRxIndicationType=PDUID_PDUINFOPTR, CanIfRxPduUserRxIndicationUL=CAN_TP, CanIfRxPduId=4, CanIfRxPduHrhIdRef=CN_VCAN_RADAR_0fbf9117_Rx, CanIfRxPduRef=DIAG_REQ_FNC_OBD1_Tp_oVCAN_RADAR_260cec9f_Rx
        FR_DIAG_REQ_PHY_OBD1_Tp_oVCAN_RADAR_ecc1c765_Rx: CanIfRxPduCanId=416993520, CanIfRxPduCanIdType=EXTENDED_CAN, CanIfRxPduDlc=8, CanIfRxPduUserRxIndicationName=CanTp_RxIndication, CanIfRxPduUserRxIndicationType=PDUID_PDUINFOPTR, CanIfRxPduUserRxIndicationUL=CAN_TP, CanIfRxPduId=12, CanIfRxPduHrhIdRef=CN_VCAN_RADAR_0fbf9117_Rx, CanIfRxPduRef=FR_DIAG_REQ_PHY_OBD1_Tp_oVCAN_RADAR_ddfa31cf_Rx
      SRR_RL_DIAG_REQ_PHYS_OBD2_Tx_oPCAN_RADAR_00ce0707_Tx (CanIfTxPduCfg):
        CanIfTxPduCanId = 416985329
        CanIfTxPduCanIdType = EXTENDED_CAN
        CanIfTxPduDlc = 64
        CanIfTxPduUserTxConfirmationUL = NONE
        CanIfTxPduId = 218
        CanIfTxPduReadNotifyStatus = false
        CanIfTxPduType = STATIC
        CanIfTxPduTruncation = true
        CanIfTxPduUserTxConfirmationName = NULL_PTR if post-build-variant-condition{matching-criterion=RDR_POS, value=7}
        CanIfTxPduUserTxConfirmationName = NULL_PTR if post-build-variant-condition{matching-criterion=RDR_POS, value=2}
        CanIfTxPduUserTxConfirmationName = NULL_PTR if post-build-variant-condition{matching-criterion=RDR_POS, value=0}
        CanIfTxPduUserTxConfirmationName = NULL_PTR if post-build-variant-condition{matching-criterion=RDR_POS, value=1}
        CanIfTxPduUserTxConfirmationName = NULL_PTR if post-build-variant-condition{matching-criterion=RDR_POS, value=3}
        CanIfTxPduUserTxConfirmationName = NULL_PTR if post-build-variant-condition{matching-criterion=RDR_POS, value=5}
        CanIfTxPduUserTxConfirmationName = NULL_PTR if post-build-variant-condition{matching-criterion=RDR_POS, value=4}
        CanIfTxPduUserTxConfirmationName = NULL_PTR if post-build-variant-condition{matching-criterion=RDR_POS, value=6}
        CanIfTxPduBufferRef = CHNL_2ad3227b_PCAN
        CanIfTxPduRef = SRR_RL_DIAG_REQ_PHYS_OBD2_Tx_oPCAN_RADAR_0d9bba27_Tx
      SRR_FL_DIAG_RESP_PHYS_OBD2_Rx_oPCAN_RADAR_e9ae0a47_Rx (CanIfRxPduCfg):
        CanIfRxPduCanId = 417001905
        CanIfRxPduCanIdType = EXTENDED_CAN if post-build-variant-condition{matching-criterion=RDR_POS, value=0}
        CanIfRxPduDlc = 64
        CanIfRxPduUserRxIndicationUL = NONE
        CanIfRxPduId = 100
        CanIfRxPduReadData = false
        CanIfRxPduReadNotifyStatus = false
        CanIfRxPduUserRxIndicationName = NULL_PTR
        CanIfRxPduDlcCheck = true
        CanIfRxPduType = STATIC
        CanIfRxPduCanIdType = EXTENDED_CAN if post-build-variant-condition{matching-criterion=RDR_POS, value={1..7}}
        CanIfRxPduHrhIdRef = CN_PCAN_RADAR_a729ccfc_Rx if post-build-variant-condition{matching-criterion=RDR_POS, value=0}
        CanIfRxPduRef = SRR_FL_DIAG_RESP_PHYS_OBD2_Rx_oPCAN_RADAR_7e9b2541_Rx
        CanIfRxPduHrhIdRef = CN_PCAN_RADAR_a729ccfc_Rx if post-build-variant-condition{matching-criterion=RDR_POS, value={1..7}}
      3 x CanIfTxPduCfg, all with CanIfTxPduCanIdType=EXTENDED_CAN, CanIfTxPduReadNotifyStatus=false, CanIfTxPduType=STATIC, CanIfTxPduTruncation=true, CanIfTxPduUserTxConfirmationName=NULL_PTR if post-build-variant-condition{matching-criterion=RDR_POS, value=2}, CanIfTxPduUserTxConfirmationName=NULL_PTR if post-build-variant-condition{matching-criterion=RDR_POS, value=4}, CanIfTxPduUserTxConfirmationName=NULL_PTR if post-build-variant-condition{matching-criterion=RDR_POS, value=1}, CanIfTxPduUserTxConfirmationName=NULL_PTR if post-build-variant-condition{matching-criterion=RDR_POS, value=0}, CanIfTxPduUserTxConfirmationName=NULL_PTR if post-build-variant-condition{matching-criterion=RDR_POS, value=5}, CanIfTxPduUserTxConfirmationName=NULL_PTR if post-build-variant-condition{matching-criterion=RDR_POS, value=6}, CanIfTxPduUserTxConfirmationName=NULL_PTR if post-build-variant-condition{matching-criterion=RDR_POS, value=7}, CanIfTxPduUserTxConfirmationName=NULL_PTR if post-build-variant-condition{matching-criterion=RDR_POS, value=3}:
        SR1_DIAG_RES_PHY_OBD1_oVCAN_RADAR_5315d9a7_Tx: CanIfTxPduCanId=417001649, CanIfTxPduCanIdMask=4294902015, CanIfTxPduDlc=8, CanIfTxPduUserTxConfirmationUL=NONE, CanIfTxPduId=205, CanIfTxPduBufferRef=CHNL_0829f689, CanIfTxPduRef=SR1_DIAG_RES_PHY_OBD1_oVCAN_RADAR_6638d82d_Tx
        DM1_B0_oVCAN_RADAR_8817cb52_Tx: CanIfTxPduCanId=419351216, CanIfTxPduDlc=8, CanIfTxPduId=1, CanIfTxPduUserTxConfirmationUL=NONE if post-build-variant-condition{matching-criterion=RDR_POS, value=0}, CanIfTxPduUserTxConfirmationUL=NONE if post-build-variant-condition{matching-criterion=RDR_POS, value=7}, CanIfTxPduUserTxConfirmationUL=NONE if post-build-variant-condition{matching-criterion=RDR_POS, value=6}, CanIfTxPduUserTxConfirmationUL=NONE if post-build-variant-condition{matching-criterion=RDR_POS, value=4}, CanIfTxPduUserTxConfirmationUL=NONE if post-build-variant-condition{matching-criterion=RDR_POS, value=1}, CanIfTxPduUserTxConfirmationUL=NONE if post-build-variant-condition{matching-criterion=RDR_POS, value=3}, CanIfTxPduUserTxConfirmationUL=NONE if post-build-variant-condition{matching-criterion=RDR_POS, value=2}, CanIfTxPduUserTxConfirmationUL=NONE if post-build-variant-condition{matching-criterion=RDR_POS, value=5}, CanIfTxPduBufferRef=CHNL_0829f689, CanIfTxPduRef=DM1_B0_oVCAN_RADAR_15753e9e_Tx
        SRR_FL_DIAG_REQ_PHYS_OTA_Tx_oPCAN_RADAR_2ec4d37f_Tx: CanIfTxPduCanId=416985588, CanIfTxPduDlc=64, CanIfTxPduUserTxConfirmationUL=NONE, CanIfTxPduId=215, CanIfTxPduBufferRef=CHNL_2ad3227b_PCAN, CanIfTxPduRef=SRR_FL_DIAG_REQ_PHYS_OTA_Tx_oPCAN_RADAR_ebda6543_Tx
      PCAN_DIAG_REQ_FUNC_OBD2_Tp_oPCAN_RADAR_20_5e2c4885_Rx (CanIfRxPduCfg):
        CanIfRxPduCanId = 417018865 if post-build-variant-condition{matching-criterion=RDR_POS, value=0}
        CanIfRxPduCanIdType = EXTENDED_NO_FD_CAN
        CanIfRxPduDlc = 8
        CanIfRxPduUserRxIndicationName = CanTp_RxIndication
        CanIfRxPduUserRxIndicationType = PDUID_PDUINFOPTR
        CanIfRxPduUserRxIndicationUL = CAN_TP
        CanIfRxPduId = 31
        CanIfRxPduReadData = false
        CanIfRxPduReadNotifyStatus = false
        CanIfRxPduDlcCheck = true
        CanIfRxPduType = STATIC
        CanIfRxPduCanId = 417018865 if post-build-variant-condition{matching-criterion=RDR_POS, value=4}
        CanIfRxPduCanId = 417018865 if post-build-variant-condition{matching-criterion=RDR_POS, value={1..3}}
        CanIfRxPduCanId = 417018865 if post-build-variant-condition{matching-criterion=RDR_POS, value={5..7}}
        CanIfRxPduHrhIdRef = CN_PCAN_RADAR_a729ccfc_Rx
        CanIfRxPduRef = PCAN_DIAG_REQ_FUNC_OBD2_Tp_oPCAN_RADAR_20_400c7f70_Rx
      PCAN_DIAG_REQ_PHYS_PLANT_Tp_oPCAN_RADAR_9297cde2_Rx (CanIfRxPduCfg):
        CanIfRxPduCanId = 416985333 if post-build-variant-condition{matching-criterion=RDR_POS, value=0}
        CanIfRxPduCanIdType = EXTENDED_FD_CAN
        CanIfRxPduDlc = 64
        CanIfRxPduUserRxIndicationName = CanTp_RxIndication
        CanIfRxPduUserRxIndicationType = PDUID_PDUINFOPTR
        CanIfRxPduUserRxIndicationUL = CAN_TP
        CanIfRxPduId = 44
        CanIfRxPduReadData = false
        CanIfRxPduReadNotifyStatus = false
        CanIfRxPduDlcCheck = true
        CanIfRxPduType = STATIC
        CanIfRxPduCanId = 417002949 if post-build-variant-condition{matching-criterion=RDR_POS, value=1}
        CanIfRxPduCanId = 417002949 if post-build-variant-condition{matching-criterion=RDR_POS, value=2}
        CanIfRxPduCanId = 416985589 if post-build-variant-condition{matching-criterion=RDR_POS, value=3}
        CanIfRxPduCanId = 416993525 if post-build-variant-condition{matching-criterion=RDR_POS, value=4}
        CanIfRxPduCanId = 417002949 if post-build-variant-condition{matching-criterion=RDR_POS, value={5..7}}
        CanIfRxPduHrhIdRef = CN_PCAN_RADAR_a729ccfc_Rx
        CanIfRxPduRef = PCAN_DIAG_REQ_PHYS_PLANT_Tp_oPCAN_RADAR_68155c61_Rx
      PCAN_DIAG_RESP_PHYS_PLANT_Tp_oPCAN_RADAR_20_656ccdb7_Tx (CanIfTxPduCfg):
        CanIfTxPduCanId = 417002928 if post-build-variant-condition{matching-criterion=RDR_POS, value=0}
        CanIfTxPduCanIdType = EXTENDED_CAN
        CanIfTxPduDlc = 8
        CanIfTxPduUserTxConfirmationName = CanTp_TxConfirmation
        CanIfTxPduUserTxConfirmationUL = CAN_TP
        CanIfTxPduId = 28
        CanIfTxPduReadNotifyStatus = false
        CanIfTxPduType = STATIC
        CanIfTxPduTruncation = true
        CanIfTxPduCanId = 417002939 if post-build-variant-condition{matching-criterion=RDR_POS, value=1}
        CanIfTxPduCanId = 417002939 if post-build-variant-condition{matching-criterion=RDR_POS, value=2}
        CanIfTxPduCanId = 417002929 if post-build-variant-condition{matching-criterion=RDR_POS, value=3}
        CanIfTxPduCanId = 417002960 if post-build-variant-condition{matching-criterion=RDR_POS, value=4}
        CanIfTxPduCanId = 417002939 if post-build-variant-condition{matching-criterion=RDR_POS, value={5..7}}
        CanIfTxPduBufferRef = CHNL_2ad3227b_PCAN
        CanIfTxPduRef = PCAN_DIAG_RESP_PHYS_PLANT_Tp_oPCAN_RADAR_20_0a848a3f_Tx
      PCAN_DIAG_REQ_PHYS_OBD2_Tp_oPCAN_RADAR_eaba503f_Rx (CanIfRxPduCfg):
        CanIfRxPduCanId = 416985329 if post-build-variant-condition{matching-criterion=RDR_POS, value=0}
        CanIfRxPduCanIdType = EXTENDED_FD_CAN
        CanIfRxPduDlc = 64
        CanIfRxPduUserRxIndicationName = CanTp_RxIndication
        CanIfRxPduUserRxIndicationType = PDUID_PDUINFOPTR
        CanIfRxPduUserRxIndicationUL = CAN_TP
        CanIfRxPduId = 40
        CanIfRxPduReadData = false
        CanIfRxPduReadNotifyStatus = false
        CanIfRxPduDlcCheck = true
        CanIfRxPduType = STATIC
        CanIfRxPduCanId = 417001925 if post-build-variant-condition{matching-criterion=RDR_POS, value=1}
        CanIfRxPduCanId = 417001925 if post-build-variant-condition{matching-criterion=RDR_POS, value=2}
        CanIfRxPduCanId = 416985585 if post-build-variant-condition{matching-criterion=RDR_POS, value=3}
        CanIfRxPduCanId = 416993521 if post-build-variant-condition{matching-criterion=RDR_POS, value=4}
        CanIfRxPduCanId = 417001925 if post-build-variant-condition{matching-criterion=RDR_POS, value={5..7}}
        CanIfRxPduHrhIdRef = CN_PCAN_RADAR_a729ccfc_Rx
        CanIfRxPduRef = PCAN_DIAG_REQ_PHYS_OBD2_Tp_oPCAN_RADAR_0ac35777_Rx
      PCAN_DIAG_RESP_PHYS_OBD1_Tp_oPCAN_RADAR_20_317d1888_Tx (CanIfTxPduCfg):
        CanIfTxPduCanId = 417001648 if post-build-variant-condition{matching-criterion=RDR_POS, value=0}
        CanIfTxPduCanIdType = EXTENDED_CAN
        CanIfTxPduDlc = 8
        CanIfTxPduUserTxConfirmationName = CanTp_TxConfirmation
        CanIfTxPduUserTxConfirmationUL = CAN_TP
        CanIfTxPduId = 22
        CanIfTxPduReadNotifyStatus = false
        CanIfTxPduType = STATIC
        CanIfTxPduTruncation = true
        CanIfTxPduCanId = 417001659 if post-build-variant-condition{matching-criterion=RDR_POS, value=1}
        CanIfTxPduCanId = 417001659 if post-build-variant-condition{matching-criterion=RDR_POS, value=2}
        CanIfTxPduCanId = 417001649 if post-build-variant-condition{matching-criterion=RDR_POS, value=3}
        CanIfTxPduCanId = 417001680 if post-build-variant-condition{matching-criterion=RDR_POS, value=4}
        CanIfTxPduCanId = 417001659 if post-build-variant-condition{matching-criterion=RDR_POS, value={5..7}}
        CanIfTxPduBufferRef = CHNL_2ad3227b_PCAN
        CanIfTxPduRef = PCAN_DIAG_RESP_PHYS_OBD1_Tp_oPCAN_RADAR_20_f6415fa5_Tx
      PCAN_DIAG_REQ_FUNC_OBD1_Tp_oPCAN_RADAR_a49340df_Rx (CanIfRxPduCfg):
        CanIfRxPduCanId = 417018864 if post-build-variant-condition{matching-criterion=RDR_POS, value=0}
        CanIfRxPduCanIdType = EXTENDED_FD_CAN
        CanIfRxPduDlc = 64
        CanIfRxPduUserRxIndicationName = CanTp_RxIndication
        CanIfRxPduUserRxIndicationType = PDUID_PDUINFOPTR
        CanIfRxPduUserRxIndicationUL = CAN_TP
        CanIfRxPduId = 30
        CanIfRxPduReadData = false
        CanIfRxPduReadNotifyStatus = false
        CanIfRxPduDlcCheck = true
        CanIfRxPduType = STATIC
        CanIfRxPduCanId = 417018864 if post-build-variant-condition{matching-criterion=RDR_POS, value=4}
        CanIfRxPduCanId = 417018864 if post-build-variant-condition{matching-criterion=RDR_POS, value={1..3}}
        CanIfRxPduCanId = 417018864 if post-build-variant-condition{matching-criterion=RDR_POS, value={5..7}}
        CanIfRxPduHrhIdRef = CN_PCAN_RADAR_a729ccfc_Rx
        CanIfRxPduRef = PCAN_DIAG_REQ_FUNC_OBD1_Tp_oPCAN_RADAR_ba721e23_Rx
      TPCM_SR1_oVCAN_RADAR_264f0b3c_Tx (CanIfTxPduCfg):
        CanIfTxPduCanId = 418219602
        CanIfTxPduCanIdMask = 4294902015
        CanIfTxPduCanIdType = EXTENDED_CAN
        CanIfTxPduDlc = 8
        CanIfTxPduUserTxConfirmationUL = NONE
        CanIfTxPduId = 221
        CanIfTxPduReadNotifyStatus = false
        CanIfTxPduType = STATIC
        CanIfTxPduTruncation = true
        CanIfTxPduUserTxConfirmationName = NULL_PTR if post-build-variant-condition{matching-criterion=RDR_POS, value=5}
        CanIfTxPduUserTxConfirmationName = NULL_PTR if post-build-variant-condition{matching-criterion=RDR_POS, value=2}
        CanIfTxPduUserTxConfirmationName = NULL_PTR if post-build-variant-condition{matching-criterion=RDR_POS, value=1}
        CanIfTxPduUserTxConfirmationName = NULL_PTR if post-build-variant-condition{matching-criterion=RDR_POS, value=0}
        CanIfTxPduUserTxConfirmationName = NULL_PTR if post-build-variant-condition{matching-criterion=RDR_POS, value=4}
        CanIfTxPduUserTxConfirmationName = NULL_PTR if post-build-variant-condition{matching-criterion=RDR_POS, value=3}
        CanIfTxPduUserTxConfirmationName = NULL_PTR if post-build-variant-condition{matching-criterion=RDR_POS, value=6}
        CanIfTxPduUserTxConfirmationName = NULL_PTR if post-build-variant-condition{matching-criterion=RDR_POS, value=7}
        CanIfTxPduBufferRef = CHNL_0829f689
        CanIfTxPduRef = TPCM_SR1_oVCAN_RADAR_42f3de03_Tx
      PCAN_DIAG_REQ_FUNC_PLANT_Tp_oPCAN_RADAR_20_f0f9d98a_Rx (CanIfRxPduCfg):
        CanIfRxPduCanId = 417018869 if post-build-variant-condition{matching-criterion=RDR_POS, value=0}
        CanIfRxPduCanIdType = EXTENDED_NO_FD_CAN
        CanIfRxPduDlc = 8
        CanIfRxPduUserRxIndicationName = CanTp_RxIndication
        CanIfRxPduUserRxIndicationType = PDUID_PDUINFOPTR
        CanIfRxPduUserRxIndicationUL = CAN_TP
        CanIfRxPduId = 36
        CanIfRxPduReadData = false
        CanIfRxPduReadNotifyStatus = false
        CanIfRxPduDlcCheck = true
        CanIfRxPduType = STATIC
        CanIfRxPduCanId = 417018869 if post-build-variant-condition{matching-criterion=RDR_POS, value=4}
        CanIfRxPduCanId = 417018869 if post-build-variant-condition{matching-criterion=RDR_POS, value={1..3}}
        CanIfRxPduCanId = 417018869 if post-build-variant-condition{matching-criterion=RDR_POS, value={5..7}}
        CanIfRxPduHrhIdRef = CN_PCAN_RADAR_a729ccfc_Rx
        CanIfRxPduRef = PCAN_DIAG_REQ_FUNC_PLANT_Tp_oPCAN_RADAR_20_d63751cc_Rx
      RDR_CM_B0_Rx_oPCAN_RADAR_e767bdf0_Rx (CanIfRxPduCfg):
        CanIfRxPduCanId = 417151126
        CanIfRxPduCanIdType = EXTENDED_CAN
        CanIfRxPduDlc = 8
        CanIfRxPduUserRxIndicationUL = NONE
        CanIfRxPduId = 46
        CanIfRxPduReadData = false
        CanIfRxPduReadNotifyStatus = false
        CanIfRxPduUserRxIndicationName = NULL_PTR
        CanIfRxPduDlcCheck = true
        CanIfRxPduType = STATIC
        CanIfRxPduHrhIdRef = CN_PCAN_RADAR_a729ccfc_Rx
        CanIfRxPduRef = RDR_CM_B0_Rx_oPCAN_RADAR_3544966f_Rx
      SR2_DIAG_RES_PHY_OBD2_oVCAN_RADAR_2eddf445_Tx (CanIfTxPduCfg):
        CanIfTxPduCanId = 417001904
        CanIfTxPduCanIdMask = 4294902015
        CanIfTxPduCanIdType = EXTENDED_CAN
        CanIfTxPduDlc = 8
        CanIfTxPduUserTxConfirmationUL = NONE
        CanIfTxPduId = 210
        CanIfTxPduReadNotifyStatus = false
        CanIfTxPduType = STATIC
        CanIfTxPduTruncation = true
        CanIfTxPduUserTxConfirmationName = NULL_PTR if post-build-variant-condition{matching-criterion=RDR_POS, value=1}
        CanIfTxPduUserTxConfirmationName = NULL_PTR if post-build-variant-condition{matching-criterion=RDR_POS, value=5}
        CanIfTxPduUserTxConfirmationName = NULL_PTR if post-build-variant-condition{matching-criterion=RDR_POS, value=2}
        CanIfTxPduUserTxConfirmationName = NULL_PTR if post-build-variant-condition{matching-criterion=RDR_POS, value=6}
        CanIfTxPduUserTxConfirmationName = NULL_PTR if post-build-variant-condition{matching-criterion=RDR_POS, value=3}
        CanIfTxPduUserTxConfirmationName = NULL_PTR if post-build-variant-condition{matching-criterion=RDR_POS, value=4}
        CanIfTxPduUserTxConfirmationName = NULL_PTR if post-build-variant-condition{matching-criterion=RDR_POS, value=0}
        CanIfTxPduUserTxConfirmationName = NULL_PTR if post-build-variant-condition{matching-criterion=RDR_POS, value=7}
        CanIfTxPduBufferRef = CHNL_0829f689
        CanIfTxPduRef = SR2_DIAG_RES_PHY_OBD2_oVCAN_RADAR_b81d7bcc_Tx
      GW_prop_ADAS_BSIS_info_oPCAN_RADAR_14d3ec96_Tx (CanIfTxPduCfg):
        CanIfTxPduCanId = 419407024
        CanIfTxPduCanIdType = EXTENDED_FD_CAN
        CanIfTxPduDlc = 8
        CanIfTxPduUserTxConfirmationName = NULL_PTR if post-build-variant-condition{matching-criterion=RDR_POS, value=6}
        CanIfTxPduUserTxConfirmationName = NULL_PTR if post-build-variant-condition{matching-criterion=RDR_POS, value=0}
        CanIfTxPduUserTxConfirmationName = NULL_PTR if post-build-variant-condition{matching-criterion=RDR_POS, value=7}
        CanIfTxPduUserTxConfirmationName = NULL_PTR if post-build-variant-condition{matching-criterion=RDR_POS, value=4}
        CanIfTxPduUserTxConfirmationName = NULL_PTR if post-build-variant-condition{matching-criterion=RDR_POS, value=1}
        CanIfTxPduUserTxConfirmationName = NULL_PTR if post-build-variant-condition{matching-criterion=RDR_POS, value=3}
        CanIfTxPduUserTxConfirmationName = NULL_PTR if post-build-variant-condition{matching-criterion=RDR_POS, value=2}
        CanIfTxPduUserTxConfirmationName = NULL_PTR if post-build-variant-condition{matching-criterion=RDR_POS, value=5}
        CanIfTxPduUserTxConfirmationUL = NONE
        CanIfTxPduId = 19
        CanIfTxPduReadNotifyStatus = false
        CanIfTxPduType = STATIC
        CanIfTxPduTruncation = true
        CanIfTxPduBufferRef = CHNL_2ad3227b_PCAN
        CanIfTxPduRef = GW_prop_ADAS_BSIS_info_oPCAN_RADAR_2b91b919_Tx
      5 x CanIfRxPduCfg, all with CanIfRxPduReadData=false, CanIfRxPduReadNotifyStatus=false, CanIfRxPduDlcCheck=true, CanIfRxPduType=STATIC, CanIfRxPduHrhIdRef=CN_PCAN_RADAR_a729ccfc_Rx:
        RDR_FUSION_STATUS_002_oPCAN_RADAR_32e3e17d_Rx: CanIfRxPduCanId=156 if post-build-variant-condition{matching-criterion=RDR_POS, value=0}, CanIfRxPduCanIdType=STANDARD_CAN, CanIfRxPduDlc=64, CanIfRxPduUserRxIndicationName=PduR_CanIfRxIndication, CanIfRxPduUserRxIndicationUL=PDUR, CanIfRxPduId=87, CanIfRxPduCanId=148 if post-build-variant-condition{matching-criterion=RDR_POS, value=1}, CanIfRxPduCanId=140 if post-build-variant-condition{matching-criterion=RDR_POS, value=2}, CanIfRxPduCanId=132 if post-build-variant-condition{matching-criterion=RDR_POS, value=3}, CanIfRxPduCanId=132 if post-build-variant-condition{matching-criterion=RDR_POS, value=4}, CanIfRxPduCanId=164 if post-build-variant-condition{matching-criterion=RDR_POS, value=5}, CanIfRxPduCanId=188 if post-build-variant-condition{matching-criterion=RDR_POS, value=6}, CanIfRxPduCanId=180 if post-build-variant-condition{matching-criterion=RDR_POS, value=7}, CanIfRxPduRef=RDR_FUSION_STATUS_002_oPCAN_RADAR_edd87150_Rx
        PCAN_DIAG_REQ_FUNC_OBD2_Tp_oPCAN_RADAR_92dcb903_Rx: CanIfRxPduCanId=417018865 if post-build-variant-condition{matching-criterion=RDR_POS, value=0}, CanIfRxPduCanIdType=EXTENDED_FD_CAN, CanIfRxPduDlc=64, CanIfRxPduUserRxIndicationName=CanTp_RxIndication, CanIfRxPduUserRxIndicationType=PDUID_PDUINFOPTR, CanIfRxPduUserRxIndicationUL=CAN_TP, CanIfRxPduId=32, CanIfRxPduCanId=417018865 if post-build-variant-condition{matching-criterion=RDR_POS, value=4}, CanIfRxPduCanId=417018865 if post-build-variant-condition{matching-criterion=RDR_POS, value=1}, CanIfRxPduCanId=417018865 if post-build-variant-condition{matching-criterion=RDR_POS, value=2}, CanIfRxPduCanId=417018865 if post-build-variant-condition{matching-criterion=RDR_POS, value=3}, CanIfRxPduCanId=417018865 if post-build-variant-condition{matching-criterion=RDR_POS, value=5}, CanIfRxPduCanId=417018865 if post-build-variant-condition{matching-criterion=RDR_POS, value=6}, CanIfRxPduCanId=417018865 if post-build-variant-condition{matching-criterion=RDR_POS, value=7}, CanIfRxPduRef=PCAN_DIAG_REQ_FUNC_OBD2_Tp_oPCAN_RADAR_de9265dd_Rx
        PCAN_DIAG_REQ_FUNC_OTA_Tp_oPCAN_RADAR_20_8f3fcd60_Rx: CanIfRxPduCanId=417018868 if post-build-variant-condition{matching-criterion=RDR_POS, value=0}, CanIfRxPduCanIdType=EXTENDED_NO_FD_CAN, CanIfRxPduDlc=8, CanIfRxPduUserRxIndicationName=CanTp_RxIndication, CanIfRxPduUserRxIndicationType=PDUID_PDUINFOPTR, CanIfRxPduUserRxIndicationUL=CAN_TP, CanIfRxPduId=34, CanIfRxPduCanId=417018868 if post-build-variant-condition{matching-criterion=RDR_POS, value=4}, CanIfRxPduCanId=417018868 if post-build-variant-condition{matching-criterion=RDR_POS, value=1}, CanIfRxPduCanId=417018868 if post-build-variant-condition{matching-criterion=RDR_POS, value=2}, CanIfRxPduCanId=417018868 if post-build-variant-condition{matching-criterion=RDR_POS, value=3}, CanIfRxPduCanId=417018868 if post-build-variant-condition{matching-criterion=RDR_POS, value=5}, CanIfRxPduCanId=417018868 if post-build-variant-condition{matching-criterion=RDR_POS, value=6}, CanIfRxPduCanId=417018868 if post-build-variant-condition{matching-criterion=RDR_POS, value=7}, CanIfRxPduRef=PCAN_DIAG_REQ_FUNC_OTA_Tp_oPCAN_RADAR_20_0a67f2f6_Rx
        RDR_prop_ADAS_BSIS_info_oPCAN_RADAR_1b1aa0fc_Rx: CanIfRxPduCanId=419407025 if post-build-variant-condition{matching-criterion=RDR_POS, value=0}, CanIfRxPduCanIdType=EXTENDED_CAN, CanIfRxPduDlc=8, CanIfRxPduUserRxIndicationUL=PDUR, CanIfRxPduId=89, CanIfRxPduUserRxIndicationName=PduR_CanIfRxIndication, CanIfRxPduCanId=419407025 if post-build-variant-condition{matching-criterion=RDR_POS, value=1}, CanIfRxPduCanId=419407025 if post-build-variant-condition{matching-criterion=RDR_POS, value=2}, CanIfRxPduCanId=419407025 if post-build-variant-condition{matching-criterion=RDR_POS, value=3}, CanIfRxPduCanId=419407024 if post-build-variant-condition{matching-criterion=RDR_POS, value=4}, CanIfRxPduCanId=419407025 if post-build-variant-condition{matching-criterion=RDR_POS, value=5}, CanIfRxPduCanId=419407025 if post-build-variant-condition{matching-criterion=RDR_POS, value=6}, CanIfRxPduCanId=419407025 if post-build-variant-condition{matching-criterion=RDR_POS, value=7}, CanIfRxPduRef=RDR_prop_ADAS_BSIS_info_oPCAN_RADAR_e19e3fbb_Rx
        PCAN_DIAG_REQ_PHYS_PLANT_Tp_oPCAN_RADAR_20_6343000b_Rx: CanIfRxPduCanId=416985333 if post-build-variant-condition{matching-criterion=RDR_POS, value=0}, CanIfRxPduCanIdType=EXTENDED_NO_FD_CAN, CanIfRxPduDlc=8, CanIfRxPduUserRxIndicationName=CanTp_RxIndication, CanIfRxPduUserRxIndicationType=PDUID_PDUINFOPTR, CanIfRxPduUserRxIndicationUL=CAN_TP, CanIfRxPduId=43, CanIfRxPduCanId=417002949 if post-build-variant-condition{matching-criterion=RDR_POS, value=1}, CanIfRxPduCanId=417002949 if post-build-variant-condition{matching-criterion=RDR_POS, value=2}, CanIfRxPduCanId=416985589 if post-build-variant-condition{matching-criterion=RDR_POS, value=3}, CanIfRxPduCanId=416993525 if post-build-variant-condition{matching-criterion=RDR_POS, value=4}, CanIfRxPduCanId=417002949 if post-build-variant-condition{matching-criterion=RDR_POS, value=5}, CanIfRxPduCanId=417002949 if post-build-variant-condition{matching-criterion=RDR_POS, value=6}, CanIfRxPduCanId=417002949 if post-build-variant-condition{matching-criterion=RDR_POS, value=7}, CanIfRxPduRef=PCAN_DIAG_REQ_PHYS_PLANT_Tp_oPCAN_RADAR_20_f110e38b_Rx
      PCAN_DIAG_RESP_PHYS_OTA_Tp_oPCAN_RADAR_20_07246a50_Tx (CanIfTxPduCfg):
        CanIfTxPduCanId = 417002672 if post-build-variant-condition{matching-criterion=RDR_POS, value=0}
        CanIfTxPduCanIdType = EXTENDED_CAN
        CanIfTxPduDlc = 8
        CanIfTxPduUserTxConfirmationName = CanTp_TxConfirmation
        CanIfTxPduUserTxConfirmationUL = CAN_TP
        CanIfTxPduId = 25
        CanIfTxPduReadNotifyStatus = false
        CanIfTxPduType = STATIC
        CanIfTxPduTruncation = true
        CanIfTxPduCanId = 417002683 if post-build-variant-condition{matching-criterion=RDR_POS, value=1}
        CanIfTxPduCanId = 417002683 if post-build-variant-condition{matching-criterion=RDR_POS, value=2}
        CanIfTxPduCanId = 417002673 if post-build-variant-condition{matching-criterion=RDR_POS, value=3}
        CanIfTxPduCanId = 417002704 if post-build-variant-condition{matching-criterion=RDR_POS, value=4}
        CanIfTxPduCanId = 417002683 if post-build-variant-condition{matching-criterion=RDR_POS, value={5..7}}
        CanIfTxPduBufferRef = CHNL_2ad3227b_PCAN
        CanIfTxPduRef = PCAN_DIAG_RESP_PHYS_OTA_Tp_oPCAN_RADAR_20_6c821aae_Tx
      DIAG_REQ_FNC_OTA_Tp_oVCAN_RADAR_99d98f80_Rx (CanIfRxPduCfg):
        CanIfRxPduCanId = 417018868
        CanIfRxPduCanIdType = EXTENDED_CAN
        CanIfRxPduDlc = 8
        CanIfRxPduUserRxIndicationName = CanTp_RxIndication
        CanIfRxPduUserRxIndicationType = PDUID_PDUINFOPTR
        CanIfRxPduUserRxIndicationUL = CAN_TP
        CanIfRxPduId = 6
        CanIfRxPduReadData = false
        CanIfRxPduReadNotifyStatus = false
        CanIfRxPduDlcCheck = true
        CanIfRxPduType = STATIC
        CanIfRxPduHrhIdRef = CN_VCAN_RADAR_0fbf9117_Rx
        CanIfRxPduRef = DIAG_REQ_FNC_OTA_Tp_oVCAN_RADAR_6f75a08a_Rx
      SR2_DIAG_RES_PHY_OTA_oVCAN_RADAR_8f2ed61e_Tx (CanIfTxPduCfg):
        CanIfTxPduCanId = 417002672
        CanIfTxPduCanIdMask = 4294902015
        CanIfTxPduCanIdType = EXTENDED_CAN
        CanIfTxPduDlc = 8
        CanIfTxPduUserTxConfirmationUL = NONE
        CanIfTxPduId = 211
        CanIfTxPduReadNotifyStatus = false
        CanIfTxPduType = STATIC
        CanIfTxPduTruncation = true
        CanIfTxPduUserTxConfirmationName = NULL_PTR if post-build-variant-condition{matching-criterion=RDR_POS, value=2}
        CanIfTxPduUserTxConfirmationName = NULL_PTR if post-build-variant-condition{matching-criterion=RDR_POS, value=4}
        CanIfTxPduUserTxConfirmationName = NULL_PTR if post-build-variant-condition{matching-criterion=RDR_POS, value=5}
        CanIfTxPduUserTxConfirmationName = NULL_PTR if post-build-variant-condition{matching-criterion=RDR_POS, value=1}
        CanIfTxPduUserTxConfirmationName = NULL_PTR if post-build-variant-condition{matching-criterion=RDR_POS, value=0}
        CanIfTxPduUserTxConfirmationName = NULL_PTR if post-build-variant-condition{matching-criterion=RDR_POS, value=7}
        CanIfTxPduUserTxConfirmationName = NULL_PTR if post-build-variant-condition{matching-criterion=RDR_POS, value=6}
        CanIfTxPduUserTxConfirmationName = NULL_PTR if post-build-variant-condition{matching-criterion=RDR_POS, value=3}
        CanIfTxPduBufferRef = CHNL_0829f689
        CanIfTxPduRef = SR2_DIAG_RES_PHY_OTA_oVCAN_RADAR_63bc1ea4_Tx
      FR_DIAG_REQ_PHY_PLANT_Tp_oVCAN_RADAR_4a486df0_Rx (CanIfRxPduCfg):
        CanIfRxPduCanId = 416993525
        CanIfRxPduCanIdType = EXTENDED_CAN
        CanIfRxPduDlc = 8
        CanIfRxPduUserRxIndicationName = CanTp_RxIndication
        CanIfRxPduUserRxIndicationType = PDUID_PDUINFOPTR
        CanIfRxPduUserRxIndicationUL = CAN_TP
        CanIfRxPduId = 15
        CanIfRxPduReadData = false
        CanIfRxPduReadNotifyStatus = false
        CanIfRxPduDlcCheck = true
        CanIfRxPduType = STATIC
        CanIfRxPduHrhIdRef = CN_VCAN_RADAR_0fbf9117_Rx
        CanIfRxPduRef = FR_DIAG_REQ_PHY_PLANT_Tp_oVCAN_RADAR_bda0e30b_Rx
      GW_ETC2_03_oPCAN_RADAR_c594f99d_Rx (CanIfRxPduCfg):
        CanIfRxPduCanId = 418383107 if post-build-variant-condition{matching-criterion=RDR_POS, value=0}
        CanIfRxPduCanIdType = EXTENDED_CAN
        CanIfRxPduDlc = 8
        CanIfRxPduUserRxIndicationName = PduR_CanIfRxIndication
        CanIfRxPduUserRxIndicationUL = PDUR
        CanIfRxPduId = 20
        CanIfRxPduReadData = false
        CanIfRxPduReadNotifyStatus = false
        CanIfRxPduDlcCheck = true
        CanIfRxPduType = STATIC
        CanIfRxPduCanId = 418383107 if post-build-variant-condition{matching-criterion=RDR_POS, value={1..3}}
        CanIfRxPduCanId = 418383363 if post-build-variant-condition{matching-criterion=RDR_POS, value=4}
        CanIfRxPduCanId = 418383107 if post-build-variant-condition{matching-criterion=RDR_POS, value={5..7}}
        CanIfRxPduHrhIdRef = CN_PCAN_RADAR_a729ccfc_Rx
        CanIfRxPduRef = GW_ETC2_03_oPCAN_RADAR_766d20c0_Rx
      prop_ADAS_BSIS_info_oVCAN_RADAR_42f884ce_Tx (CanIfTxPduCfg):
        CanIfTxPduCanId = 419407024
        CanIfTxPduCanIdType = EXTENDED_CAN
        CanIfTxPduDlc = 8
        CanIfTxPduUserTxConfirmationUL = NONE
        CanIfTxPduId = 227
        CanIfTxPduReadNotifyStatus = false
        CanIfTxPduType = STATIC
        CanIfTxPduTruncation = true
        CanIfTxPduUserTxConfirmationName = NULL_PTR if post-build-variant-condition{matching-criterion=RDR_POS, value=0}
        CanIfTxPduUserTxConfirmationName = NULL_PTR if post-build-variant-condition{matching-criterion=RDR_POS, value=6}
        CanIfTxPduUserTxConfirmationName = NULL_PTR if post-build-variant-condition{matching-criterion=RDR_POS, value=2}
        CanIfTxPduUserTxConfirmationName = NULL_PTR if post-build-variant-condition{matching-criterion=RDR_POS, value=3}
        CanIfTxPduUserTxConfirmationName = NULL_PTR if post-build-variant-condition{matching-criterion=RDR_POS, value=1}
        CanIfTxPduUserTxConfirmationName = NULL_PTR if post-build-variant-condition{matching-criterion=RDR_POS, value=4}
        CanIfTxPduUserTxConfirmationName = NULL_PTR if post-build-variant-condition{matching-criterion=RDR_POS, value=7}
        CanIfTxPduUserTxConfirmationName = NULL_PTR if post-build-variant-condition{matching-criterion=RDR_POS, value=5}
        CanIfTxPduBufferRef = CHNL_0829f689
        CanIfTxPduRef = prop_ADAS_BSIS_info_oVCAN_RADAR_a7fddec0_Tx
      PCAN_DIAG_RESP_PHYS_PLANT_Tp_oPCAN_RADAR_2ddb0a0a_Tx (CanIfTxPduCfg):
        CanIfTxPduCanId = 417002928 if post-build-variant-condition{matching-criterion=RDR_POS, value=0}
        CanIfTxPduCanIdType = EXTENDED_FD_CAN
        CanIfTxPduDlc = 64
        CanIfTxPduUserTxConfirmationName = CanTp_TxConfirmation
        CanIfTxPduUserTxConfirmationUL = CAN_TP
        CanIfTxPduId = 27
        CanIfTxPduReadNotifyStatus = false
        CanIfTxPduType = STATIC
        CanIfTxPduTruncation = true
        CanIfTxPduCanId = 417002939 if post-build-variant-condition{matching-criterion=RDR_POS, value=1}
        CanIfTxPduCanId = 417002939 if post-build-variant-condition{matching-criterion=RDR_POS, value=2}
        CanIfTxPduCanId = 417002929 if post-build-variant-condition{matching-criterion=RDR_POS, value=3}
        CanIfTxPduCanId = 417002960 if post-build-variant-condition{matching-criterion=RDR_POS, value=4}
        CanIfTxPduCanId = 417002939 if post-build-variant-condition{matching-criterion=RDR_POS, value={5..7}}
        CanIfTxPduBufferRef = CHNL_2ad3227b_PCAN
        CanIfTxPduRef = PCAN_DIAG_RESP_PHYS_PLANT_Tp_oPCAN_RADAR_bd11d57f_Tx
      4 x CanIfRxPduCfg, all with CanIfRxPduCanIdType=EXTENDED_CAN, CanIfRxPduReadData=false, CanIfRxPduReadNotifyStatus=false, CanIfRxPduDlcCheck=true, CanIfRxPduType=STATIC:
        SR1_DIAG_REQ_PHY_OBD1_oVCAN_RADAR_d087a8f3_Rx: CanIfRxPduCanId=416985584, CanIfRxPduCanIdMask=67108863, CanIfRxPduDlc=8, CanIfRxPduUserRxIndicationUL=NONE, CanIfRxPduId=91, CanIfRxPduUserRxIndicationName=NULL_PTR, CanIfRxPduHrhIdRef=CN_VCAN_RADAR_0fbf9117_Rx, CanIfRxPduRef=SR1_DIAG_REQ_PHY_OBD1_oVCAN_RADAR_ff3ad7b0_Rx
        RDR_DT_B1_Rx_oPCAN_RADAR_24380880_Rx: CanIfRxPduCanId=418219601, CanIfRxPduDlc=8, CanIfRxPduUserRxIndicationUL=NONE, CanIfRxPduId=49, CanIfRxPduUserRxIndicationName=NULL_PTR, CanIfRxPduHrhIdRef=CN_PCAN_RADAR_a729ccfc_Rx, CanIfRxPduRef=RDR_DT_B1_Rx_oPCAN_RADAR_3eed4299_Rx
        DIAG_REQ_FNC_OBD2_Tp_oVCAN_RADAR_f27c52d9_Rx: CanIfRxPduCanId=417018865, CanIfRxPduDlc=8, CanIfRxPduUserRxIndicationName=CanTp_RxIndication, CanIfRxPduUserRxIndicationType=PDUID_PDUINFOPTR, CanIfRxPduUserRxIndicationUL=CAN_TP, CanIfRxPduId=5, CanIfRxPduHrhIdRef=CN_VCAN_RADAR_0fbf9117_Rx, CanIfRxPduRef=DIAG_REQ_FNC_OBD2_Tp_oVCAN_RADAR_42ec9761_Rx
        DM1_B0_Rx_oPCAN_RADAR_a5672d71_Rx: CanIfRxPduCanId=419351216, CanIfRxPduDlc=22, CanIfRxPduUserRxIndicationUL=NONE, CanIfRxPduId=8, CanIfRxPduUserRxIndicationName=NULL_PTR, CanIfRxPduHrhIdRef=CN_PCAN_RADAR_a729ccfc_Rx, CanIfRxPduRef=DM1_B0_Rx_oPCAN_RADAR_6b6541a3_Rx
      SRR_RL_DIAG_REQ_PHYS_OBD1_Tx_oPCAN_RADAR_d15e4aba_Tx (CanIfTxPduCfg):
        CanIfTxPduCanId = 416985328
        CanIfTxPduCanIdType = EXTENDED_CAN
        CanIfTxPduDlc = 64
        CanIfTxPduUserTxConfirmationUL = NONE
        CanIfTxPduId = 217
        CanIfTxPduReadNotifyStatus = false
        CanIfTxPduType = STATIC
        CanIfTxPduTruncation = true
        CanIfTxPduUserTxConfirmationName = NULL_PTR if post-build-variant-condition{matching-criterion=RDR_POS, value=0}
        CanIfTxPduUserTxConfirmationName = NULL_PTR if post-build-variant-condition{matching-criterion=RDR_POS, value=7}
        CanIfTxPduUserTxConfirmationName = NULL_PTR if post-build-variant-condition{matching-criterion=RDR_POS, value=3}
        CanIfTxPduUserTxConfirmationName = NULL_PTR if post-build-variant-condition{matching-criterion=RDR_POS, value=4}
        CanIfTxPduUserTxConfirmationName = NULL_PTR if post-build-variant-condition{matching-criterion=RDR_POS, value=6}
        CanIfTxPduUserTxConfirmationName = NULL_PTR if post-build-variant-condition{matching-criterion=RDR_POS, value=5}
        CanIfTxPduUserTxConfirmationName = NULL_PTR if post-build-variant-condition{matching-criterion=RDR_POS, value=1}
        CanIfTxPduUserTxConfirmationName = NULL_PTR if post-build-variant-condition{matching-criterion=RDR_POS, value=2}
        CanIfTxPduBufferRef = CHNL_2ad3227b_PCAN
        CanIfTxPduRef = SRR_RL_DIAG_REQ_PHYS_OBD1_Tx_oPCAN_RADAR_697bc1d9_Tx
      PCAN_DIAG_REQ_PHYS_OBD1_Tp_oPCAN_RADAR_20_31a2624c_Rx (CanIfRxPduCfg):
        CanIfRxPduCanId = 416985328 if post-build-variant-condition{matching-criterion=RDR_POS, value=0}
        CanIfRxPduCanIdType = EXTENDED_NO_FD_CAN
        CanIfRxPduDlc = 8
        CanIfRxPduUserRxIndicationName = CanTp_RxIndication
        CanIfRxPduUserRxIndicationType = PDUID_PDUINFOPTR
        CanIfRxPduUserRxIndicationUL = CAN_TP
        CanIfRxPduId = 37
        CanIfRxPduReadData = false
        CanIfRxPduReadNotifyStatus = false
        CanIfRxPduDlcCheck = true
        CanIfRxPduType = STATIC
        CanIfRxPduCanId = 417001669 if post-build-variant-condition{matching-criterion=RDR_POS, value=1}
        CanIfRxPduCanId = 417001669 if post-build-variant-condition{matching-criterion=RDR_POS, value=2}
        CanIfRxPduCanId = 416985584 if post-build-variant-condition{matching-criterion=RDR_POS, value=3}
        CanIfRxPduCanId = 416993520 if post-build-variant-condition{matching-criterion=RDR_POS, value=4}
        CanIfRxPduCanId = 417001669 if post-build-variant-condition{matching-criterion=RDR_POS, value={5..7}}
        CanIfRxPduHrhIdRef = CN_PCAN_RADAR_a729ccfc_Rx
        CanIfRxPduRef = PCAN_DIAG_REQ_PHYS_OBD1_Tp_oPCAN_RADAR_20_b6648efa_Rx
      FR_DIAG_REQ_PHY_OBD2_Tp_oVCAN_RADAR_2f8767b4_Rx (CanIfRxPduCfg):
        CanIfRxPduCanId = 416993521
        CanIfRxPduCanIdType = EXTENDED_CAN
        CanIfRxPduDlc = 8
        CanIfRxPduUserRxIndicationName = CanTp_RxIndication
        CanIfRxPduUserRxIndicationType = PDUID_PDUINFOPTR
        CanIfRxPduUserRxIndicationUL = CAN_TP
        CanIfRxPduId = 13
        CanIfRxPduReadData = false
        CanIfRxPduReadNotifyStatus = false
        CanIfRxPduDlcCheck = true
        CanIfRxPduType = STATIC
        CanIfRxPduHrhIdRef = CN_VCAN_RADAR_0fbf9117_Rx
        CanIfRxPduRef = FR_DIAG_REQ_PHY_OBD2_Tp_oVCAN_RADAR_b91a4a31_Rx
      TPCM_SR2_oVCAN_RADAR_e86476d4_Tx (CanIfTxPduCfg):
        CanIfTxPduCanId = 418219603
        CanIfTxPduCanIdMask = 4294902015
        CanIfTxPduCanIdType = EXTENDED_CAN
        CanIfTxPduDlc = 8
        CanIfTxPduUserTxConfirmationUL = NONE
        CanIfTxPduId = 222
        CanIfTxPduReadNotifyStatus = false
        CanIfTxPduType = STATIC
        CanIfTxPduTruncation = true
        CanIfTxPduUserTxConfirmationName = NULL_PTR if post-build-variant-condition{matching-criterion=RDR_POS, value=0}
        CanIfTxPduUserTxConfirmationName = NULL_PTR if post-build-variant-condition{matching-criterion=RDR_POS, value=1}
        CanIfTxPduUserTxConfirmationName = NULL_PTR if post-build-variant-condition{matching-criterion=RDR_POS, value=7}
        CanIfTxPduUserTxConfirmationName = NULL_PTR if post-build-variant-condition{matching-criterion=RDR_POS, value=6}
        CanIfTxPduUserTxConfirmationName = NULL_PTR if post-build-variant-condition{matching-criterion=RDR_POS, value=4}
        CanIfTxPduUserTxConfirmationName = NULL_PTR if post-build-variant-condition{matching-criterion=RDR_POS, value=2}
        CanIfTxPduUserTxConfirmationName = NULL_PTR if post-build-variant-condition{matching-criterion=RDR_POS, value=3}
        CanIfTxPduUserTxConfirmationName = NULL_PTR if post-build-variant-condition{matching-criterion=RDR_POS, value=5}
        CanIfTxPduBufferRef = CHNL_0829f689
        CanIfTxPduRef = TPCM_SR2_oVCAN_RADAR_19e46f16_Tx
      PCAN_DIAG_REQ_FUNC_OTA_Tp_oPCAN_RADAR_0aa5e66e_Rx (CanIfRxPduCfg):
        CanIfRxPduCanId = 417018868 if post-build-variant-condition{matching-criterion=RDR_POS, value=0}
        CanIfRxPduCanIdType = EXTENDED_FD_CAN
        CanIfRxPduDlc = 64
        CanIfRxPduUserRxIndicationName = CanTp_RxIndication
        CanIfRxPduUserRxIndicationType = PDUID_PDUINFOPTR
        CanIfRxPduUserRxIndicationUL = CAN_TP
        CanIfRxPduId = 33
        CanIfRxPduReadData = false
        CanIfRxPduReadNotifyStatus = false
        CanIfRxPduDlcCheck = true
        CanIfRxPduType = STATIC
        CanIfRxPduCanId = 417018868 if post-build-variant-condition{matching-criterion=RDR_POS, value=4}
        CanIfRxPduCanId = 417018868 if post-build-variant-condition{matching-criterion=RDR_POS, value={1..3}}
        CanIfRxPduCanId = 417018868 if post-build-variant-condition{matching-criterion=RDR_POS, value={5..7}}
        CanIfRxPduHrhIdRef = CN_PCAN_RADAR_a729ccfc_Rx
        CanIfRxPduRef = PCAN_DIAG_REQ_FUNC_OTA_Tp_oPCAN_RADAR_7ea6262a_Rx
      GW_ETC2_03_Tx_oPCAN_RADAR_6fe44ee0_Tx (CanIfTxPduCfg):
        CanIfTxPduCanId = 418383107
        CanIfTxPduCanIdType = EXTENDED_CAN
        CanIfTxPduDlc = 8
        CanIfTxPduUserTxConfirmationUL = NONE
        CanIfTxPduId = 11
        CanIfTxPduReadNotifyStatus = false
        CanIfTxPduType = STATIC
        CanIfTxPduTruncation = true
        CanIfTxPduUserTxConfirmationName = NULL_PTR if post-build-variant-condition{matching-criterion=RDR_POS, value=4}
        CanIfTxPduUserTxConfirmationName = NULL_PTR if post-build-variant-condition{matching-criterion=RDR_POS, value=6}
        CanIfTxPduUserTxConfirmationName = NULL_PTR if post-build-variant-condition{matching-criterion=RDR_POS, value=3}
        CanIfTxPduUserTxConfirmationName = NULL_PTR if post-build-variant-condition{matching-criterion=RDR_POS, value=5}
        CanIfTxPduUserTxConfirmationName = NULL_PTR if post-build-variant-condition{matching-criterion=RDR_POS, value=1}
        CanIfTxPduUserTxConfirmationName = NULL_PTR if post-build-variant-condition{matching-criterion=RDR_POS, value=7}
        CanIfTxPduUserTxConfirmationName = NULL_PTR if post-build-variant-condition{matching-criterion=RDR_POS, value=2}
        CanIfTxPduUserTxConfirmationName = NULL_PTR if post-build-variant-condition{matching-criterion=RDR_POS, value=0}
        CanIfTxPduBufferRef = CHNL_2ad3227b_PCAN
        CanIfTxPduRef = GW_ETC2_03_Tx_oPCAN_RADAR_07adbeb0_Tx
      prop_ADAS_MOIS_info_oVCAN_RADAR_dba7da57_Tx (CanIfTxPduCfg):
        CanIfTxPduCanId = 419407056
        CanIfTxPduCanIdType = EXTENDED_CAN
        CanIfTxPduDlc = 8
        CanIfTxPduUserTxConfirmationName = NULL_PTR if post-build-variant-condition{matching-criterion=RDR_POS, value=6}
        CanIfTxPduUserTxConfirmationName = NULL_PTR if post-build-variant-condition{matching-criterion=RDR_POS, value=0}
        CanIfTxPduUserTxConfirmationName = NULL_PTR if post-build-variant-condition{matching-criterion=RDR_POS, value=7}
        CanIfTxPduUserTxConfirmationName = NULL_PTR if post-build-variant-condition{matching-criterion=RDR_POS, value=4}
        CanIfTxPduUserTxConfirmationName = NULL_PTR if post-build-variant-condition{matching-criterion=RDR_POS, value=1}
        CanIfTxPduUserTxConfirmationName = NULL_PTR if post-build-variant-condition{matching-criterion=RDR_POS, value=3}
        CanIfTxPduUserTxConfirmationName = NULL_PTR if post-build-variant-condition{matching-criterion=RDR_POS, value=2}
        CanIfTxPduUserTxConfirmationName = NULL_PTR if post-build-variant-condition{matching-criterion=RDR_POS, value=5}
        CanIfTxPduUserTxConfirmationUL = NONE
        CanIfTxPduId = 228
        CanIfTxPduReadNotifyStatus = false
        CanIfTxPduType = STATIC
        CanIfTxPduTruncation = true
        CanIfTxPduBufferRef = CHNL_0829f689
        CanIfTxPduRef = prop_ADAS_MOIS_info_oVCAN_RADAR_21657ab6_Tx
      RDR_FUSION_CAPABILITY_oPCAN_RADAR_11f796c7_Rx (CanIfRxPduCfg):
        CanIfRxPduCanId = 159 if post-build-variant-condition{matching-criterion=RDR_POS, value=0}
        CanIfRxPduCanIdType = STANDARD_CAN
        CanIfRxPduDlc = 64
        CanIfRxPduUserRxIndicationName = PduR_CanIfRxIndication
        CanIfRxPduUserRxIndicationUL = PDUR
        CanIfRxPduId = 52
        CanIfRxPduReadData = false
        CanIfRxPduReadNotifyStatus = false
        CanIfRxPduDlcCheck = true
        CanIfRxPduType = STATIC
        CanIfRxPduCanId = 151 if post-build-variant-condition{matching-criterion=RDR_POS, value=1}
        CanIfRxPduCanId = 143 if post-build-variant-condition{matching-criterion=RDR_POS, value=2}
        CanIfRxPduCanId = 135 if post-build-variant-condition{matching-criterion=RDR_POS, value=3}
        CanIfRxPduCanId = 135 if post-build-variant-condition{matching-criterion=RDR_POS, value=4}
        CanIfRxPduCanId = 167 if post-build-variant-condition{matching-criterion=RDR_POS, value=5}
        CanIfRxPduCanId = 191 if post-build-variant-condition{matching-criterion=RDR_POS, value=6}
        CanIfRxPduCanId = 183 if post-build-variant-condition{matching-criterion=RDR_POS, value=7}
        CanIfRxPduHrhIdRef = CN_PCAN_RADAR_a729ccfc_Rx
        CanIfRxPduRef = RDR_FUSION_CAPABILITY_oPCAN_RADAR_2f1662f1_Rx
      RDR_FUSION_ALIGNMENT_STATUS_001_oPCAN_RADAR_3c4e871e_Rx (CanIfRxPduCfg):
        CanIfRxPduCanId = 157 if post-build-variant-condition{matching-criterion=RDR_POS, value=0}
        CanIfRxPduCanIdType = STANDARD_CAN
        CanIfRxPduDlc = 64
        CanIfRxPduUserRxIndicationName = PduR_CanIfRxIndication
        CanIfRxPduUserRxIndicationUL = PDUR
        CanIfRxPduId = 50
        CanIfRxPduReadData = false
        CanIfRxPduReadNotifyStatus = false
        CanIfRxPduDlcCheck = true
        CanIfRxPduType = STATIC
        CanIfRxPduCanId = 149 if post-build-variant-condition{matching-criterion=RDR_POS, value=1}
        CanIfRxPduCanId = 141 if post-build-variant-condition{matching-criterion=RDR_POS, value=2}
        CanIfRxPduCanId = 133 if post-build-variant-condition{matching-criterion=RDR_POS, value=3}
        CanIfRxPduCanId = 133 if post-build-variant-condition{matching-criterion=RDR_POS, value=4}
        CanIfRxPduCanId = 165 if post-build-variant-condition{matching-criterion=RDR_POS, value=5}
        CanIfRxPduCanId = 189 if post-build-variant-condition{matching-criterion=RDR_POS, value=6}
        CanIfRxPduCanId = 181 if post-build-variant-condition{matching-criterion=RDR_POS, value=7}
        CanIfRxPduHrhIdRef = CN_PCAN_RADAR_a729ccfc_Rx
        CanIfRxPduRef = RDR_FUSION_ALIGNMENT_STATUS_001_oPCAN_RADAR_e2456918_Rx
      FR_DIAG_RES_PHY_PLANT_Tp_oVCAN_RADAR_d5d0b00c_Tx (CanIfTxPduCfg):
        CanIfTxPduCanId = 417002960
        CanIfTxPduCanIdType = EXTENDED_CAN
        CanIfTxPduDlc = 8
        CanIfTxPduUserTxConfirmationName = CanTp_TxConfirmation
        CanIfTxPduUserTxConfirmationUL = CAN_TP
        CanIfTxPduId = 6
        CanIfTxPduReadNotifyStatus = false
        CanIfTxPduType = STATIC
        CanIfTxPduTruncation = true
        CanIfTxPduBufferRef = CHNL_0829f689
        CanIfTxPduRef = FR_DIAG_RES_PHY_PLANT_Tp_oVCAN_RADAR_4233d42d_Tx
      SRR_RL_DIAG_RESP_PHYS_PLANT_Rx_oPCAN_RADAR_84988cb2_Rx (CanIfRxPduCfg):
        CanIfRxPduCanId = 417002928
        CanIfRxPduCanIdType = EXTENDED_CAN if post-build-variant-condition{matching-criterion=RDR_POS, value=0}
        CanIfRxPduDlc = 64
        CanIfRxPduUserRxIndicationUL = NONE
        CanIfRxPduId = 106
        CanIfRxPduReadData = false
        CanIfRxPduReadNotifyStatus = false
        CanIfRxPduUserRxIndicationName = NULL_PTR
        CanIfRxPduDlcCheck = true
        CanIfRxPduType = STATIC
        CanIfRxPduCanIdType = EXTENDED_CAN if post-build-variant-condition{matching-criterion=RDR_POS, value={1..7}}
        CanIfRxPduHrhIdRef = CN_PCAN_RADAR_a729ccfc_Rx if post-build-variant-condition{matching-criterion=RDR_POS, value=0}
        CanIfRxPduRef = SRR_RL_DIAG_RESP_PHYS_PLANT_Rx_oPCAN_RADAR_a4bcd7de_Rx
        CanIfRxPduHrhIdRef = CN_PCAN_RADAR_a729ccfc_Rx if post-build-variant-condition{matching-criterion=RDR_POS, value={1..7}}
      PCAN_DIAG_REQ_FUNC_PLANT_Tp_oPCAN_RADAR_7e247c91_Rx (CanIfRxPduCfg):
        CanIfRxPduCanId = 417018869 if post-build-variant-condition{matching-criterion=RDR_POS, value=0}
        CanIfRxPduCanIdType = EXTENDED_FD_CAN
        CanIfRxPduDlc = 64
        CanIfRxPduUserRxIndicationName = CanTp_RxIndication
        CanIfRxPduUserRxIndicationType = PDUID_PDUINFOPTR
        CanIfRxPduUserRxIndicationUL = CAN_TP
        CanIfRxPduId = 35
        CanIfRxPduReadData = false
        CanIfRxPduReadNotifyStatus = false
        CanIfRxPduDlcCheck = true
        CanIfRxPduType = STATIC
        CanIfRxPduCanId = 417018869 if post-build-variant-condition{matching-criterion=RDR_POS, value=4}
        CanIfRxPduCanId = 417018869 if post-build-variant-condition{matching-criterion=RDR_POS, value={1..3}}
        CanIfRxPduCanId = 417018869 if post-build-variant-condition{matching-criterion=RDR_POS, value={5..7}}
        CanIfRxPduHrhIdRef = CN_PCAN_RADAR_a729ccfc_Rx
        CanIfRxPduRef = PCAN_DIAG_REQ_FUNC_PLANT_Tp_oPCAN_RADAR_5ec247a5_Rx
      PCAN_DIAG_RESP_PHYS_OTA_Tp_oPCAN_RADAR_c2db48e7_Tx (CanIfTxPduCfg):
        CanIfTxPduCanId = 417002672 if post-build-variant-condition{matching-criterion=RDR_POS, value=0}
        CanIfTxPduCanIdType = EXTENDED_FD_CAN
        CanIfTxPduDlc = 64
        CanIfTxPduUserTxConfirmationName = CanTp_TxConfirmation
        CanIfTxPduUserTxConfirmationUL = CAN_TP
        CanIfTxPduId = 26
        CanIfTxPduReadNotifyStatus = false
        CanIfTxPduType = STATIC
        CanIfTxPduTruncation = true
        CanIfTxPduCanId = 417002683 if post-build-variant-condition{matching-criterion=RDR_POS, value=1}
        CanIfTxPduCanId = 417002683 if post-build-variant-condition{matching-criterion=RDR_POS, value=2}
        CanIfTxPduCanId = 417002673 if post-build-variant-condition{matching-criterion=RDR_POS, value=3}
        CanIfTxPduCanId = 417002704 if post-build-variant-condition{matching-criterion=RDR_POS, value=4}
        CanIfTxPduCanId = 417002683 if post-build-variant-condition{matching-criterion=RDR_POS, value={5..7}}
        CanIfTxPduBufferRef = CHNL_2ad3227b_PCAN
        CanIfTxPduRef = PCAN_DIAG_RESP_PHYS_OTA_Tp_oPCAN_RADAR_37f68c50_Tx
      SRR_FL_DIAG_RESP_PHYS_OTA_Rx_oPCAN_RADAR_f82256d0_Rx (CanIfRxPduCfg):
        CanIfRxPduCanId = 417002673
        CanIfRxPduCanIdType = STANDARD_CAN if post-build-variant-condition{matching-criterion=RDR_POS, value=0}
        CanIfRxPduDlc = 64
        CanIfRxPduUserRxIndicationUL = NONE
        CanIfRxPduId = 101
        CanIfRxPduReadData = false
        CanIfRxPduReadNotifyStatus = false
        CanIfRxPduUserRxIndicationName = NULL_PTR
        CanIfRxPduDlcCheck = true
        CanIfRxPduType = STATIC
        CanIfRxPduCanIdType = EXTENDED_CAN if post-build-variant-condition{matching-criterion=RDR_POS, value={1..7}}
        CanIfRxPduHrhIdRef = CN_PCAN_RADAR_a729ccfc_Rx if post-build-variant-condition{matching-criterion=RDR_POS, value=0}
        CanIfRxPduRef = SRR_FL_DIAG_RESP_PHYS_OTA_Rx_oPCAN_RADAR_9fd7f3d9_Rx
        CanIfRxPduHrhIdRef = CN_PCAN_RADAR_a729ccfc_Rx if post-build-variant-condition{matching-criterion=RDR_POS, value={1..7}}
      FR_DIAG_RES_PHY_OBD1_Tp_oVCAN_RADAR_fddad3af_Tx (CanIfTxPduCfg):
        CanIfTxPduCanId = 417001680
        CanIfTxPduCanIdType = EXTENDED_CAN
        CanIfTxPduDlc = 8
        CanIfTxPduUserTxConfirmationName = CanTp_TxConfirmation
        CanIfTxPduUserTxConfirmationUL = CAN_TP
        CanIfTxPduId = 3
        CanIfTxPduReadNotifyStatus = false
        CanIfTxPduType = STATIC
        CanIfTxPduTruncation = true
        CanIfTxPduBufferRef = CHNL_0829f689
        CanIfTxPduRef = FR_DIAG_RES_PHY_OBD1_Tp_oVCAN_RADAR_41a76716_Tx
      PCAN_DIAG_REQ_PHYS_OTA_Tp_oPCAN_RADAR_bab5b90f_Rx (CanIfRxPduCfg):
        CanIfRxPduCanId = 416985332 if post-build-variant-condition{matching-criterion=RDR_POS, value=0}
        CanIfRxPduCanIdType = EXTENDED_FD_CAN
        CanIfRxPduDlc = 64
        CanIfRxPduUserRxIndicationName = CanTp_RxIndication
        CanIfRxPduUserRxIndicationType = PDUID_PDUINFOPTR
        CanIfRxPduUserRxIndicationUL = CAN_TP
        CanIfRxPduId = 42
        CanIfRxPduReadData = false
        CanIfRxPduReadNotifyStatus = false
        CanIfRxPduDlcCheck = true
        CanIfRxPduType = STATIC
        CanIfRxPduCanId = 417002693 if post-build-variant-condition{matching-criterion=RDR_POS, value=1}
        CanIfRxPduCanId = 417002693 if post-build-variant-condition{matching-criterion=RDR_POS, value=2}
        CanIfRxPduCanId = 416985588 if post-build-variant-condition{matching-criterion=RDR_POS, value=3}
        CanIfRxPduCanId = 416993524 if post-build-variant-condition{matching-criterion=RDR_POS, value=4}
        CanIfRxPduCanId = 417002693 if post-build-variant-condition{matching-criterion=RDR_POS, value={5..7}}
        CanIfRxPduHrhIdRef = CN_PCAN_RADAR_a729ccfc_Rx
        CanIfRxPduRef = PCAN_DIAG_REQ_PHYS_OTA_Tp_oPCAN_RADAR_94a46e49_Rx
      DIAG_REQ_FNC_PLANT_Tp_oVCAN_RADAR_db883021_Rx (CanIfRxPduCfg):
        CanIfRxPduCanId = 417018869
        CanIfRxPduCanIdType = EXTENDED_CAN
        CanIfRxPduDlc = 8
        CanIfRxPduUserRxIndicationName = CanTp_RxIndication
        CanIfRxPduUserRxIndicationType = PDUID_PDUINFOPTR
        CanIfRxPduUserRxIndicationUL = CAN_TP
        CanIfRxPduId = 7
        CanIfRxPduReadData = false
        CanIfRxPduReadNotifyStatus = false
        CanIfRxPduDlcCheck = true
        CanIfRxPduType = STATIC
        CanIfRxPduHrhIdRef = CN_VCAN_RADAR_0fbf9117_Rx
        CanIfRxPduRef = DIAG_REQ_FNC_PLANT_Tp_oVCAN_RADAR_d6304422_Rx
      TPDT_B0_oVCAN_RADAR_d6e4df39_Tx (CanIfTxPduCfg):
        CanIfTxPduCanId = 418219600
        CanIfTxPduCanIdMask = 4294902015
        CanIfTxPduCanIdType = EXTENDED_CAN
        CanIfTxPduDlc = 8
        CanIfTxPduUserTxConfirmationUL = NONE
        CanIfTxPduId = 224
        CanIfTxPduReadNotifyStatus = false
        CanIfTxPduType = STATIC
        CanIfTxPduTruncation = true
        CanIfTxPduUserTxConfirmationName = NULL_PTR if post-build-variant-condition{matching-criterion=RDR_POS, value=5}
        CanIfTxPduUserTxConfirmationName = NULL_PTR if post-build-variant-condition{matching-criterion=RDR_POS, value=0}
        CanIfTxPduUserTxConfirmationName = NULL_PTR if post-build-variant-condition{matching-criterion=RDR_POS, value=3}
        CanIfTxPduUserTxConfirmationName = NULL_PTR if post-build-variant-condition{matching-criterion=RDR_POS, value=6}
        CanIfTxPduUserTxConfirmationName = NULL_PTR if post-build-variant-condition{matching-criterion=RDR_POS, value=7}
        CanIfTxPduUserTxConfirmationName = NULL_PTR if post-build-variant-condition{matching-criterion=RDR_POS, value=4}
        CanIfTxPduUserTxConfirmationName = NULL_PTR if post-build-variant-condition{matching-criterion=RDR_POS, value=2}
        CanIfTxPduUserTxConfirmationName = NULL_PTR if post-build-variant-condition{matching-criterion=RDR_POS, value=1}
        CanIfTxPduBufferRef = CHNL_0829f689
        CanIfTxPduRef = TPDT_B0_oVCAN_RADAR_bde39209_Tx
      SRR_RL_DIAG_REQ_PHYS_PLANT_Tx_oPCAN_RADAR_b38606fa_Tx (CanIfTxPduCfg):
        CanIfTxPduCanId = 416985333
        CanIfTxPduCanIdType = EXTENDED_CAN
        CanIfTxPduDlc = 64
        CanIfTxPduUserTxConfirmationUL = NONE
        CanIfTxPduId = 220
        CanIfTxPduReadNotifyStatus = false
        CanIfTxPduType = STATIC
        CanIfTxPduTruncation = true
        CanIfTxPduUserTxConfirmationName = NULL_PTR if post-build-variant-condition{matching-criterion=RDR_POS, value=5}
        CanIfTxPduUserTxConfirmationName = NULL_PTR if post-build-variant-condition{matching-criterion=RDR_POS, value=3}
        CanIfTxPduUserTxConfirmationName = NULL_PTR if post-build-variant-condition{matching-criterion=RDR_POS, value=2}
        CanIfTxPduUserTxConfirmationName = NULL_PTR if post-build-variant-condition{matching-criterion=RDR_POS, value=4}
        CanIfTxPduUserTxConfirmationName = NULL_PTR if post-build-variant-condition{matching-criterion=RDR_POS, value=7}
        CanIfTxPduUserTxConfirmationName = NULL_PTR if post-build-variant-condition{matching-criterion=RDR_POS, value=0}
        CanIfTxPduUserTxConfirmationName = NULL_PTR if post-build-variant-condition{matching-criterion=RDR_POS, value=1}
        CanIfTxPduUserTxConfirmationName = NULL_PTR if post-build-variant-condition{matching-criterion=RDR_POS, value=6}
        CanIfTxPduBufferRef = CHNL_2ad3227b_PCAN
        CanIfTxPduRef = SRR_RL_DIAG_REQ_PHYS_PLANT_Tx_oPCAN_RADAR_90ff5b50_Tx
      SRR_RL_DIAG_RESP_PHYS_OBD2_Rx_oPCAN_RADAR_d86862a6_Rx (CanIfRxPduCfg):
        CanIfRxPduCanId = 417001904
        CanIfRxPduCanIdType = EXTENDED_CAN if post-build-variant-condition{matching-criterion=RDR_POS, value=0}
        CanIfRxPduDlc = 64
        CanIfRxPduUserRxIndicationUL = NONE
        CanIfRxPduId = 104
        CanIfRxPduReadData = false
        CanIfRxPduReadNotifyStatus = false
        CanIfRxPduUserRxIndicationName = NULL_PTR
        CanIfRxPduDlcCheck = true
        CanIfRxPduType = STATIC
        CanIfRxPduCanIdType = EXTENDED_CAN if post-build-variant-condition{matching-criterion=RDR_POS, value={1..7}}
        CanIfRxPduHrhIdRef = CN_PCAN_RADAR_a729ccfc_Rx if post-build-variant-condition{matching-criterion=RDR_POS, value=0}
        CanIfRxPduRef = SRR_RL_DIAG_RESP_PHYS_OBD2_Rx_oPCAN_RADAR_4dec4cd0_Rx
        CanIfRxPduHrhIdRef = CN_PCAN_RADAR_a729ccfc_Rx if post-build-variant-condition{matching-criterion=RDR_POS, value={1..7}}
      FR_DIAG_RES_PHY_OBD2_Tp_oVCAN_RADAR_3e9c737e_Tx (CanIfTxPduCfg):
        CanIfTxPduCanId = 417001936
        CanIfTxPduCanIdType = EXTENDED_CAN
        CanIfTxPduDlc = 8
        CanIfTxPduUserTxConfirmationName = CanTp_TxConfirmation
        CanIfTxPduUserTxConfirmationUL = CAN_TP
        CanIfTxPduId = 4
        CanIfTxPduReadNotifyStatus = false
        CanIfTxPduType = STATIC
        CanIfTxPduTruncation = true
        CanIfTxPduBufferRef = CHNL_0829f689
        CanIfTxPduRef = FR_DIAG_RES_PHY_OBD2_Tp_oVCAN_RADAR_25471ce8_Tx
      SR2_DIAG_REQ_PHY_OBD2_oVCAN_RADAR_ad4f8511_Rx (CanIfRxPduCfg):
        CanIfRxPduCanId = 416985329
        CanIfRxPduCanIdMask = 67108863
        CanIfRxPduCanIdType = EXTENDED_CAN
        CanIfRxPduDlc = 8
        CanIfRxPduUserRxIndicationUL = NONE
        CanIfRxPduId = 96
        CanIfRxPduReadData = false
        CanIfRxPduReadNotifyStatus = false
        CanIfRxPduUserRxIndicationName = NULL_PTR
        CanIfRxPduDlcCheck = true
        CanIfRxPduType = STATIC
        CanIfRxPduHrhIdRef = CN_VCAN_RADAR_0fbf9117_Rx
        CanIfRxPduRef = SR2_DIAG_REQ_PHY_OBD2_oVCAN_RADAR_211f7451_Rx
      SRR_FL_DIAG_RESP_PHYS_OBD1_Rx_oPCAN_RADAR_09ba8005_Rx (CanIfRxPduCfg):
        CanIfRxPduCanId = 417001649
        CanIfRxPduCanIdType = EXTENDED_CAN
        CanIfRxPduDlc = 64
        CanIfRxPduUserRxIndicationUL = NONE
        CanIfRxPduId = 99
        CanIfRxPduReadData = false
        CanIfRxPduReadNotifyStatus = false
        CanIfRxPduUserRxIndicationName = NULL_PTR
        CanIfRxPduDlcCheck = true
        CanIfRxPduType = STATIC
        CanIfRxPduHrhIdRef = CN_PCAN_RADAR_a729ccfc_Rx
        CanIfRxPduRef = SRR_FL_DIAG_RESP_PHYS_OBD1_Rx_oPCAN_RADAR_1a7b5ebf_Rx
      TPDT_B1_oVCAN_RADAR_2ebbc0bc_Tx (CanIfTxPduCfg):
        CanIfTxPduCanId = 418219601
        CanIfTxPduCanIdMask = 4294902015
        CanIfTxPduCanIdType = EXTENDED_CAN
        CanIfTxPduDlc = 8
        CanIfTxPduUserTxConfirmationUL = NONE
        CanIfTxPduId = 225
        CanIfTxPduReadNotifyStatus = false
        CanIfTxPduType = STATIC
        CanIfTxPduTruncation = true
        CanIfTxPduUserTxConfirmationName = NULL_PTR if post-build-variant-condition{matching-criterion=RDR_POS, value=2}
        CanIfTxPduUserTxConfirmationName = NULL_PTR if post-build-variant-condition{matching-criterion=RDR_POS, value=1}
        CanIfTxPduUserTxConfirmationName = NULL_PTR if post-build-variant-condition{matching-criterion=RDR_POS, value=7}
        CanIfTxPduUserTxConfirmationName = NULL_PTR if post-build-variant-condition{matching-criterion=RDR_POS, value=0}
        CanIfTxPduUserTxConfirmationName = NULL_PTR if post-build-variant-condition{matching-criterion=RDR_POS, value=5}
        CanIfTxPduUserTxConfirmationName = NULL_PTR if post-build-variant-condition{matching-criterion=RDR_POS, value=6}
        CanIfTxPduUserTxConfirmationName = NULL_PTR if post-build-variant-condition{matching-criterion=RDR_POS, value=3}
        CanIfTxPduUserTxConfirmationName = NULL_PTR if post-build-variant-condition{matching-criterion=RDR_POS, value=4}
        CanIfTxPduBufferRef = CHNL_0829f689
        CanIfTxPduRef = TPDT_B1_oVCAN_RADAR_8b1102fa_Tx
      SR1_DIAG_REQ_PHY_PLANT_oVCAN_RADAR_5b5133c5_Rx (CanIfRxPduCfg):
        CanIfRxPduCanId = 416985589
        CanIfRxPduCanIdMask = 67108863
        CanIfRxPduCanIdType = EXTENDED_CAN
        CanIfRxPduDlc = 8
        CanIfRxPduUserRxIndicationUL = NONE
        CanIfRxPduId = 94
        CanIfRxPduReadData = false
        CanIfRxPduReadNotifyStatus = false
        CanIfRxPduUserRxIndicationName = NULL_PTR
        CanIfRxPduDlcCheck = true
        CanIfRxPduType = STATIC
        CanIfRxPduHrhIdRef = CN_VCAN_RADAR_0fbf9117_Rx
        CanIfRxPduRef = SR1_DIAG_REQ_PHY_PLANT_oVCAN_RADAR_14d98d55_Rx
      SR1_DIAG_RES_PHY_PLANT_oVCAN_RADAR_16d34ef3_Tx (CanIfTxPduCfg):
        CanIfTxPduCanId = 417002929
        CanIfTxPduCanIdMask = 4294902015
        CanIfTxPduCanIdType = EXTENDED_CAN
        CanIfTxPduDlc = 8
        CanIfTxPduUserTxConfirmationUL = NONE
        CanIfTxPduId = 208
        CanIfTxPduReadNotifyStatus = false
        CanIfTxPduType = STATIC
        CanIfTxPduTruncation = true
        CanIfTxPduUserTxConfirmationName = NULL_PTR if post-build-variant-condition{matching-criterion=RDR_POS, value=7}
        CanIfTxPduUserTxConfirmationName = NULL_PTR if post-build-variant-condition{matching-criterion=RDR_POS, value=5}
        CanIfTxPduUserTxConfirmationName = NULL_PTR if post-build-variant-condition{matching-criterion=RDR_POS, value=2}
        CanIfTxPduUserTxConfirmationName = NULL_PTR if post-build-variant-condition{matching-criterion=RDR_POS, value=3}
        CanIfTxPduUserTxConfirmationName = NULL_PTR if post-build-variant-condition{matching-criterion=RDR_POS, value=1}
        CanIfTxPduUserTxConfirmationName = NULL_PTR if post-build-variant-condition{matching-criterion=RDR_POS, value=4}
        CanIfTxPduUserTxConfirmationName = NULL_PTR if post-build-variant-condition{matching-criterion=RDR_POS, value=0}
        CanIfTxPduUserTxConfirmationName = NULL_PTR if post-build-variant-condition{matching-criterion=RDR_POS, value=6}
        CanIfTxPduBufferRef = CHNL_0829f689
        CanIfTxPduRef = SR1_DIAG_RES_PHY_PLANT_oVCAN_RADAR_9afe60a3_Tx
      3 x CanIfRxPduCfg, all with CanIfRxPduCanIdType=EXTENDED_CAN, CanIfRxPduUserRxIndicationUL=NONE, CanIfRxPduReadData=false, CanIfRxPduReadNotifyStatus=false, CanIfRxPduUserRxIndicationName=NULL_PTR, CanIfRxPduDlcCheck=true, CanIfRxPduType=STATIC:
        RDR_DT_B0_Rx_oPCAN_RADAR_842ebd81_Rx: CanIfRxPduCanId=418219600, CanIfRxPduDlc=8, CanIfRxPduId=48, CanIfRxPduHrhIdRef=CN_PCAN_RADAR_a729ccfc_Rx, CanIfRxPduRef=RDR_DT_B0_Rx_oPCAN_RADAR_ab9d960c_Rx
        SR1_DIAG_REQ_PHY_OBD2_oVCAN_RADAR_b85b462d_Rx: CanIfRxPduCanId=416985585, CanIfRxPduCanIdMask=67108863, CanIfRxPduDlc=8, CanIfRxPduId=92, CanIfRxPduHrhIdRef=CN_VCAN_RADAR_0fbf9117_Rx, CanIfRxPduRef=SR1_DIAG_REQ_PHY_OBD2_oVCAN_RADAR_a42d66a5_Rx
        DM1_B1_Rx_oPCAN_RADAR_1c7ee3a2_Rx: CanIfRxPduCanId=419351217, CanIfRxPduDlc=22, CanIfRxPduId=9, CanIfRxPduHrhIdRef=CN_PCAN_RADAR_a729ccfc_Rx, CanIfRxPduRef=DM1_B1_Rx_oPCAN_RADAR_fe159536_Rx
      SRR_FL_DIAG_REQ_PHYS_OBD1_Tx_oPCAN_RADAR_47cc77aa_Tx (CanIfTxPduCfg):
        CanIfTxPduCanId = 416985584
        CanIfTxPduCanIdType = EXTENDED_CAN
        CanIfTxPduDlc = 64
        CanIfTxPduUserTxConfirmationUL = NONE
        CanIfTxPduId = 213
        CanIfTxPduReadNotifyStatus = false
        CanIfTxPduType = STATIC
        CanIfTxPduTruncation = true
        CanIfTxPduUserTxConfirmationName = NULL_PTR if post-build-variant-condition{matching-criterion=RDR_POS, value=6}
        CanIfTxPduUserTxConfirmationName = NULL_PTR if post-build-variant-condition{matching-criterion=RDR_POS, value=3}
        CanIfTxPduUserTxConfirmationName = NULL_PTR if post-build-variant-condition{matching-criterion=RDR_POS, value=4}
        CanIfTxPduUserTxConfirmationName = NULL_PTR if post-build-variant-condition{matching-criterion=RDR_POS, value=2}
        CanIfTxPduUserTxConfirmationName = NULL_PTR if post-build-variant-condition{matching-criterion=RDR_POS, value=5}
        CanIfTxPduUserTxConfirmationName = NULL_PTR if post-build-variant-condition{matching-criterion=RDR_POS, value=1}
        CanIfTxPduUserTxConfirmationName = NULL_PTR if post-build-variant-condition{matching-criterion=RDR_POS, value=0}
        CanIfTxPduUserTxConfirmationName = NULL_PTR if post-build-variant-condition{matching-criterion=RDR_POS, value=7}
        CanIfTxPduBufferRef = CHNL_2ad3227b_PCAN
        CanIfTxPduRef = SRR_FL_DIAG_REQ_PHYS_OBD1_Tx_oPCAN_RADAR_1d0fb5b4_Tx
      3 x CanIfRxPduCfg, all with CanIfRxPduUserRxIndicationUL=NONE, CanIfRxPduReadData=false, CanIfRxPduReadNotifyStatus=false, CanIfRxPduUserRxIndicationName=NULL_PTR, CanIfRxPduDlcCheck=true, CanIfRxPduType=STATIC:
        SRR_FL_DIAG_RESP_PHYS_PLANT_Rx_oPCAN_RADAR_3f679b05_Rx: CanIfRxPduCanId=417002929, CanIfRxPduCanIdType=EXTENDED_CAN if post-build-variant-condition{matching-criterion=RDR_POS, value=0}, CanIfRxPduDlc=64, CanIfRxPduId=102, CanIfRxPduCanIdType=EXTENDED_CAN if post-build-variant-condition{matching-criterion=RDR_POS, value=1}, CanIfRxPduCanIdType=EXTENDED_CAN if post-build-variant-condition{matching-criterion=RDR_POS, value=2}, CanIfRxPduCanIdType=EXTENDED_CAN if post-build-variant-condition{matching-criterion=RDR_POS, value=3}, CanIfRxPduCanIdType=EXTENDED_CAN if post-build-variant-condition{matching-criterion=RDR_POS, value=4}, CanIfRxPduCanIdType=EXTENDED_CAN if post-build-variant-condition{matching-criterion=RDR_POS, value=5}, CanIfRxPduCanIdType=EXTENDED_CAN if post-build-variant-condition{matching-criterion=RDR_POS, value=6}, CanIfRxPduCanIdType=EXTENDED_CAN if post-build-variant-condition{matching-criterion=RDR_POS, value=7}, CanIfRxPduHrhIdRef=CN_PCAN_RADAR_a729ccfc_Rx if post-build-variant-condition{matching-criterion=RDR_POS, value=0}, CanIfRxPduRef=SRR_FL_DIAG_RESP_PHYS_PLANT_Rx_oPCAN_RADAR_23870365_Rx, CanIfRxPduHrhIdRef=CN_PCAN_RADAR_a729ccfc_Rx if post-build-variant-condition{matching-criterion=RDR_POS, value=1}, CanIfRxPduHrhIdRef=CN_PCAN_RADAR_a729ccfc_Rx if post-build-variant-condition{matching-criterion=RDR_POS, value=2}, CanIfRxPduHrhIdRef=CN_PCAN_RADAR_a729ccfc_Rx if post-build-variant-condition{matching-criterion=RDR_POS, value=3}, CanIfRxPduHrhIdRef=CN_PCAN_RADAR_a729ccfc_Rx if post-build-variant-condition{matching-criterion=RDR_POS, value=4}, CanIfRxPduHrhIdRef=CN_PCAN_RADAR_a729ccfc_Rx if post-build-variant-condition{matching-criterion=RDR_POS, value=5}, CanIfRxPduHrhIdRef=CN_PCAN_RADAR_a729ccfc_Rx if post-build-variant-condition{matching-criterion=RDR_POS, value=6}, CanIfRxPduHrhIdRef=CN_PCAN_RADAR_a729ccfc_Rx if post-build-variant-condition{matching-criterion=RDR_POS, value=7}
        SR1_DIAG_REQ_PHY_OTA_oVCAN_RADAR_2599cadf_Rx: CanIfRxPduCanId=416985588, CanIfRxPduCanIdMask=67108863, CanIfRxPduCanIdType=EXTENDED_CAN, CanIfRxPduDlc=8, CanIfRxPduId=93, CanIfRxPduHrhIdRef=CN_VCAN_RADAR_0fbf9117_Rx, CanIfRxPduRef=SR1_DIAG_REQ_PHY_OTA_oVCAN_RADAR_3fc015f5_Rx
        SR2_DIAG_REQ_PHY_OBD1_oVCAN_RADAR_c5936bcf_Rx: CanIfRxPduCanId=416985328, CanIfRxPduCanIdMask=67108863, CanIfRxPduCanIdType=EXTENDED_CAN, CanIfRxPduDlc=8, CanIfRxPduId=95, CanIfRxPduHrhIdRef=CN_VCAN_RADAR_0fbf9117_Rx, CanIfRxPduRef=SR2_DIAG_REQ_PHY_OBD1_oVCAN_RADAR_7a08c544_Rx
      SR1_DIAG_RES_PHY_OBD2_oVCAN_RADAR_3bc93779_Tx (CanIfTxPduCfg):
        CanIfTxPduCanId = 417001905
        CanIfTxPduCanIdMask = 4294902015
        CanIfTxPduCanIdType = EXTENDED_CAN
        CanIfTxPduDlc = 8
        CanIfTxPduUserTxConfirmationUL = NONE
        CanIfTxPduId = 206
        CanIfTxPduReadNotifyStatus = false
        CanIfTxPduType = STATIC
        CanIfTxPduTruncation = true
        CanIfTxPduUserTxConfirmationName = NULL_PTR if post-build-variant-condition{matching-criterion=RDR_POS, value=4}
        CanIfTxPduUserTxConfirmationName = NULL_PTR if post-build-variant-condition{matching-criterion=RDR_POS, value=0}
        CanIfTxPduUserTxConfirmationName = NULL_PTR if post-build-variant-condition{matching-criterion=RDR_POS, value=3}
        CanIfTxPduUserTxConfirmationName = NULL_PTR if post-build-variant-condition{matching-criterion=RDR_POS, value=2}
        CanIfTxPduUserTxConfirmationName = NULL_PTR if post-build-variant-condition{matching-criterion=RDR_POS, value={5..7}}
        CanIfTxPduUserTxConfirmationName = NULL_PTR if post-build-variant-condition{matching-criterion=RDR_POS, value=1}
        CanIfTxPduBufferRef = CHNL_0829f689
        CanIfTxPduRef = SR1_DIAG_RES_PHY_OBD2_oVCAN_RADAR_3d2f6938_Tx
      PCAN_DIAG_REQ_FUNC_OBD1_Tp_oPCAN_RADAR_20_be38c2c7_Rx (CanIfRxPduCfg):
        CanIfRxPduCanId = 417018864 if post-build-variant-condition{matching-criterion=RDR_POS, value=0}
        CanIfRxPduCanIdType = EXTENDED_NO_FD_CAN
        CanIfRxPduDlc = 8
        CanIfRxPduUserRxIndicationName = CanTp_RxIndication
        CanIfRxPduUserRxIndicationType = PDUID_PDUINFOPTR
        CanIfRxPduUserRxIndicationUL = CAN_TP
        CanIfRxPduId = 29
        CanIfRxPduReadData = false
        CanIfRxPduReadNotifyStatus = false
        CanIfRxPduDlcCheck = true
        CanIfRxPduType = STATIC
        CanIfRxPduCanId = 417018864 if post-build-variant-condition{matching-criterion=RDR_POS, value=4}
        CanIfRxPduCanId = 417018864 if post-build-variant-condition{matching-criterion=RDR_POS, value={1..3}}
        CanIfRxPduCanId = 417018864 if post-build-variant-condition{matching-criterion=RDR_POS, value={5..7}}
        CanIfRxPduHrhIdRef = CN_PCAN_RADAR_a729ccfc_Rx
        CanIfRxPduRef = PCAN_DIAG_REQ_FUNC_OBD1_Tp_oPCAN_RADAR_20_9397638b_Rx
      SR2_DIAG_RES_PHY_OBD1_oVCAN_RADAR_46011a9b_Tx (CanIfTxPduCfg):
        CanIfTxPduCanId = 417001648
        CanIfTxPduCanIdMask = 4294902015
        CanIfTxPduCanIdType = EXTENDED_CAN
        CanIfTxPduDlc = 8
        CanIfTxPduUserTxConfirmationUL = NONE
        CanIfTxPduId = 209
        CanIfTxPduReadNotifyStatus = false
        CanIfTxPduType = STATIC
        CanIfTxPduTruncation = true
        CanIfTxPduUserTxConfirmationName = NULL_PTR if post-build-variant-condition{matching-criterion=RDR_POS, value=5}
        CanIfTxPduUserTxConfirmationName = NULL_PTR if post-build-variant-condition{matching-criterion=RDR_POS, value=3}
        CanIfTxPduUserTxConfirmationName = NULL_PTR if post-build-variant-condition{matching-criterion=RDR_POS, value=1}
        CanIfTxPduUserTxConfirmationName = NULL_PTR if post-build-variant-condition{matching-criterion=RDR_POS, value=7}
        CanIfTxPduUserTxConfirmationName = NULL_PTR if post-build-variant-condition{matching-criterion=RDR_POS, value=6}
        CanIfTxPduUserTxConfirmationName = NULL_PTR if post-build-variant-condition{matching-criterion=RDR_POS, value=2}
        CanIfTxPduUserTxConfirmationName = NULL_PTR if post-build-variant-condition{matching-criterion=RDR_POS, value=4}
        CanIfTxPduUserTxConfirmationName = NULL_PTR if post-build-variant-condition{matching-criterion=RDR_POS, value=0}
        CanIfTxPduBufferRef = CHNL_0829f689
        CanIfTxPduRef = SR2_DIAG_RES_PHY_OBD1_oVCAN_RADAR_e30acad9_Tx
      SR2_DIAG_REQ_PHY_OTA_oVCAN_RADAR_13148e4e_Rx (CanIfRxPduCfg):
        CanIfRxPduCanId = 416985332
        CanIfRxPduCanIdMask = 67108863
        CanIfRxPduCanIdType = EXTENDED_CAN
        CanIfRxPduDlc = 8
        CanIfRxPduUserRxIndicationUL = NONE
        CanIfRxPduId = 97
        CanIfRxPduReadData = false
        CanIfRxPduReadNotifyStatus = false
        CanIfRxPduUserRxIndicationName = NULL_PTR
        CanIfRxPduDlcCheck = true
        CanIfRxPduType = STATIC
        CanIfRxPduHrhIdRef = CN_VCAN_RADAR_0fbf9117_Rx
        CanIfRxPduRef = SR2_DIAG_REQ_PHY_OTA_oVCAN_RADAR_68e239a7_Rx
      SRR_FL_DIAG_REQ_PHYS_OBD2_Tx_oPCAN_RADAR_965c3a17_Tx (CanIfTxPduCfg):
        CanIfTxPduCanId = 416985585
        CanIfTxPduCanIdType = EXTENDED_CAN
        CanIfTxPduDlc = 64
        CanIfTxPduUserTxConfirmationUL = NONE
        CanIfTxPduId = 214
        CanIfTxPduReadNotifyStatus = false
        CanIfTxPduType = STATIC
        CanIfTxPduTruncation = true
        CanIfTxPduUserTxConfirmationName = NULL_PTR if post-build-variant-condition{matching-criterion=RDR_POS, value=0}
        CanIfTxPduUserTxConfirmationName = NULL_PTR if post-build-variant-condition{matching-criterion=RDR_POS, value=4}
        CanIfTxPduUserTxConfirmationName = NULL_PTR if post-build-variant-condition{matching-criterion=RDR_POS, value=5}
        CanIfTxPduUserTxConfirmationName = NULL_PTR if post-build-variant-condition{matching-criterion=RDR_POS, value=7}
        CanIfTxPduUserTxConfirmationName = NULL_PTR if post-build-variant-condition{matching-criterion=RDR_POS, value=2}
        CanIfTxPduUserTxConfirmationName = NULL_PTR if post-build-variant-condition{matching-criterion=RDR_POS, value=6}
        CanIfTxPduUserTxConfirmationName = NULL_PTR if post-build-variant-condition{matching-criterion=RDR_POS, value=1}
        CanIfTxPduUserTxConfirmationName = NULL_PTR if post-build-variant-condition{matching-criterion=RDR_POS, value=3}
        CanIfTxPduBufferRef = CHNL_2ad3227b_PCAN
        CanIfTxPduRef = SRR_FL_DIAG_REQ_PHYS_OBD2_Tx_oPCAN_RADAR_79efce4a_Tx
      PCAN_DIAG_RESP_PHYS_OBD1_Tp_oPCAN_RADAR_8c240349_Tx (CanIfTxPduCfg):
        CanIfTxPduCanId = 417001648 if post-build-variant-condition{matching-criterion=RDR_POS, value=0}
        CanIfTxPduCanIdType = EXTENDED_FD_CAN
        CanIfTxPduDlc = 64
        CanIfTxPduUserTxConfirmationName = CanTp_TxConfirmation
        CanIfTxPduUserTxConfirmationUL = CAN_TP
        CanIfTxPduId = 21
        CanIfTxPduReadNotifyStatus = false
        CanIfTxPduType = STATIC
        CanIfTxPduTruncation = true
        CanIfTxPduCanId = 417001659 if post-build-variant-condition{matching-criterion=RDR_POS, value=1}
        CanIfTxPduCanId = 417001659 if post-build-variant-condition{matching-criterion=RDR_POS, value=2}
        CanIfTxPduCanId = 417001649 if post-build-variant-condition{matching-criterion=RDR_POS, value=3}
        CanIfTxPduCanId = 417001680 if post-build-variant-condition{matching-criterion=RDR_POS, value=4}
        CanIfTxPduCanId = 417001659 if post-build-variant-condition{matching-criterion=RDR_POS, value={5..7}}
        CanIfTxPduBufferRef = CHNL_2ad3227b_PCAN
        CanIfTxPduRef = PCAN_DIAG_RESP_PHYS_OBD1_Tp_oPCAN_RADAR_0aebd6ab_Tx
      PCAN_DIAG_REQ_PHYS_OTA_Tp_oPCAN_RADAR_20_f8b78b8f_Rx (CanIfRxPduCfg):
        CanIfRxPduCanId = 416985332 if post-build-variant-condition{matching-criterion=RDR_POS, value=0}
        CanIfRxPduCanIdType = EXTENDED_NO_FD_CAN
        CanIfRxPduDlc = 8
        CanIfRxPduUserRxIndicationName = CanTp_RxIndication
        CanIfRxPduUserRxIndicationType = PDUID_PDUINFOPTR
        CanIfRxPduUserRxIndicationUL = CAN_TP
        CanIfRxPduId = 41
        CanIfRxPduReadData = false
        CanIfRxPduReadNotifyStatus = false
        CanIfRxPduDlcCheck = true
        CanIfRxPduType = STATIC
        CanIfRxPduCanId = 417002693 if post-build-variant-condition{matching-criterion=RDR_POS, value=1}
        CanIfRxPduCanId = 417002693 if post-build-variant-condition{matching-criterion=RDR_POS, value=2}
        CanIfRxPduCanId = 416985588 if post-build-variant-condition{matching-criterion=RDR_POS, value=3}
        CanIfRxPduCanId = 416993524 if post-build-variant-condition{matching-criterion=RDR_POS, value=4}
        CanIfRxPduCanId = 417002693 if post-build-variant-condition{matching-criterion=RDR_POS, value={5..7}}
        CanIfRxPduHrhIdRef = CN_PCAN_RADAR_a729ccfc_Rx
        CanIfRxPduRef = PCAN_DIAG_REQ_PHYS_OTA_Tp_oPCAN_RADAR_20_96582344_Rx
      SRR_RL_DIAG_REQ_PHYS_OTA_Tx_oPCAN_RADAR_2be0d721_Tx (CanIfTxPduCfg):
        CanIfTxPduCanId = 416985332
        CanIfTxPduCanIdType = EXTENDED_CAN
        CanIfTxPduDlc = 64
        CanIfTxPduUserTxConfirmationUL = NONE
        CanIfTxPduId = 219
        CanIfTxPduReadNotifyStatus = false
        CanIfTxPduType = STATIC
        CanIfTxPduTruncation = true
        CanIfTxPduUserTxConfirmationName = NULL_PTR if post-build-variant-condition{matching-criterion=RDR_POS, value=6}
        CanIfTxPduUserTxConfirmationName = NULL_PTR if post-build-variant-condition{matching-criterion=RDR_POS, value=4}
        CanIfTxPduUserTxConfirmationName = NULL_PTR if post-build-variant-condition{matching-criterion=RDR_POS, value=3}
        CanIfTxPduUserTxConfirmationName = NULL_PTR if post-build-variant-condition{matching-criterion=RDR_POS, value=0}
        CanIfTxPduUserTxConfirmationName = NULL_PTR if post-build-variant-condition{matching-criterion=RDR_POS, value=5}
        CanIfTxPduUserTxConfirmationName = NULL_PTR if post-build-variant-condition{matching-criterion=RDR_POS, value=2}
        CanIfTxPduUserTxConfirmationName = NULL_PTR if post-build-variant-condition{matching-criterion=RDR_POS, value=7}
        CanIfTxPduUserTxConfirmationName = NULL_PTR if post-build-variant-condition{matching-criterion=RDR_POS, value=1}
        CanIfTxPduBufferRef = CHNL_2ad3227b_PCAN
        CanIfTxPduRef = SRR_RL_DIAG_REQ_PHYS_OTA_Tx_oPCAN_RADAR_2e7c92c0_Tx
      SRR_RL_DIAG_RESP_PHYS_OTA_Rx_oPCAN_RADAR_6eb06bc0_Rx (CanIfRxPduCfg):
        CanIfRxPduCanId = 417002672
        CanIfRxPduCanIdType = EXTENDED_CAN if post-build-variant-condition{matching-criterion=RDR_POS, value=0}
        CanIfRxPduDlc = 64
        CanIfRxPduUserRxIndicationUL = NONE
        CanIfRxPduId = 105
        CanIfRxPduReadData = false
        CanIfRxPduReadNotifyStatus = false
        CanIfRxPduUserRxIndicationName = NULL_PTR
        CanIfRxPduDlcCheck = true
        CanIfRxPduType = STATIC
        CanIfRxPduCanIdType = EXTENDED_CAN if post-build-variant-condition{matching-criterion=RDR_POS, value={1..7}}
        CanIfRxPduHrhIdRef = CN_PCAN_RADAR_a729ccfc_Rx if post-build-variant-condition{matching-criterion=RDR_POS, value=0}
        CanIfRxPduRef = SRR_RL_DIAG_RESP_PHYS_OTA_Rx_oPCAN_RADAR_eba387b4_Rx
        CanIfRxPduHrhIdRef = CN_PCAN_RADAR_a729ccfc_Rx if post-build-variant-condition{matching-criterion=RDR_POS, value={1..7}}
      DM1_B1_oVCAN_RADAR_c2a11718_Tx (CanIfTxPduCfg):
        CanIfTxPduCanId = 419351217
        CanIfTxPduCanIdType = EXTENDED_CAN
        CanIfTxPduDlc = 8
        CanIfTxPduId = 2
        CanIfTxPduReadNotifyStatus = false
        CanIfTxPduType = STATIC
        CanIfTxPduUserTxConfirmationUL = NONE
        CanIfTxPduTruncation = true
        CanIfTxPduUserTxConfirmationName = NULL_PTR if post-build-variant-condition{matching-criterion=RDR_POS, value=1}
        CanIfTxPduUserTxConfirmationName = NULL_PTR if post-build-variant-condition{matching-criterion=RDR_POS, value=4}
        CanIfTxPduUserTxConfirmationName = NULL_PTR if post-build-variant-condition{matching-criterion=RDR_POS, value=2}
        CanIfTxPduUserTxConfirmationName = NULL_PTR if post-build-variant-condition{matching-criterion=RDR_POS, value=6}
        CanIfTxPduUserTxConfirmationName = NULL_PTR if post-build-variant-condition{matching-criterion=RDR_POS, value=0}
        CanIfTxPduUserTxConfirmationName = NULL_PTR if post-build-variant-condition{matching-criterion=RDR_POS, value=5}
        CanIfTxPduUserTxConfirmationName = NULL_PTR if post-build-variant-condition{matching-criterion=RDR_POS, value=7}
        CanIfTxPduUserTxConfirmationName = NULL_PTR if post-build-variant-condition{matching-criterion=RDR_POS, value=3}
        CanIfTxPduBufferRef = CHNL_0829f689
        CanIfTxPduRef = DM1_B1_oVCAN_RADAR_2387ae6d_Tx
      SRR_RL_DIAG_RESP_PHYS_OBD1_Rx_oPCAN_RADAR_387ce8e4_Rx (CanIfRxPduCfg):
        CanIfRxPduCanId = 417001648
        CanIfRxPduCanIdType = EXTENDED_CAN
        CanIfRxPduDlc = 64
        CanIfRxPduUserRxIndicationUL = NONE
        CanIfRxPduId = 103
        CanIfRxPduReadData = false
        CanIfRxPduReadNotifyStatus = false
        CanIfRxPduUserRxIndicationName = NULL_PTR
        CanIfRxPduDlcCheck = true
        CanIfRxPduType = STATIC
        CanIfRxPduHrhIdRef = CN_PCAN_RADAR_a729ccfc_Rx
        CanIfRxPduRef = SRR_RL_DIAG_RESP_PHYS_OBD1_Rx_oPCAN_RADAR_290c372e_Rx
      RDR_CM_B1_Rx_oPCAN_RADAR_477108f1_Rx (CanIfRxPduCfg):
        CanIfRxPduCanId = 417151125
        CanIfRxPduCanIdType = EXTENDED_CAN
        CanIfRxPduDlc = 8
        CanIfRxPduUserRxIndicationUL = NONE
        CanIfRxPduId = 47
        CanIfRxPduReadData = false
        CanIfRxPduReadNotifyStatus = false
        CanIfRxPduUserRxIndicationName = NULL_PTR
        CanIfRxPduDlcCheck = true
        CanIfRxPduType = STATIC
        CanIfRxPduCanIdMask = 536870911 if post-build-variant-condition{matching-criterion=RDR_POS, value=0}
        CanIfRxPduHrhIdRef = CN_PCAN_RADAR_a729ccfc_Rx
        CanIfRxPduRef = RDR_CM_B1_Rx_oPCAN_RADAR_a03442fa_Rx
      PCAN_DIAG_RESP_PHYS_OBD2_Tp_oPCAN_RADAR_b153d036_Tx (CanIfTxPduCfg):
        CanIfTxPduCanId = 417001904 if post-build-variant-condition{matching-criterion=RDR_POS, value=0}
        CanIfTxPduCanIdType = EXTENDED_FD_CAN
        CanIfTxPduDlc = 64
        CanIfTxPduUserTxConfirmationName = CanTp_TxConfirmation
        CanIfTxPduUserTxConfirmationUL = CAN_TP
        CanIfTxPduId = 24
        CanIfTxPduReadNotifyStatus = false
        CanIfTxPduType = STATIC
        CanIfTxPduTruncation = true
        CanIfTxPduCanId = 417001915 if post-build-variant-condition{matching-criterion=RDR_POS, value=1}
        CanIfTxPduCanId = 417001915 if post-build-variant-condition{matching-criterion=RDR_POS, value=2}
        CanIfTxPduCanId = 417001905 if post-build-variant-condition{matching-criterion=RDR_POS, value=3}
        CanIfTxPduCanId = 417001936 if post-build-variant-condition{matching-criterion=RDR_POS, value=4}
        CanIfTxPduCanId = 417001915 if post-build-variant-condition{matching-criterion=RDR_POS, value={5..7}}
        CanIfTxPduBufferRef = CHNL_2ad3227b_PCAN
        CanIfTxPduRef = PCAN_DIAG_RESP_PHYS_OBD2_Tp_oPCAN_RADAR_6e0bad55_Tx
      SYS_TIME_SYNC_oPCAN_RADAR_231d6bb9_Tx (CanIfTxPduCfg):
        CanIfTxPduCanId = 1
        CanIfTxPduCanIdType = STANDARD_FD_CAN
        CanIfTxPduDlc = 8
        CanIfTxPduUserTxConfirmationName = CanTSyn_TxConfirmation
        CanIfTxPduUserTxConfirmationUL = CAN_TSYN
        CanIfTxPduId = 229
        CanIfTxPduReadNotifyStatus = false
        CanIfTxPduType = STATIC
        CanIfTxPduTruncation = true
        CanIfTxPduBufferRef = CHNL_2ad3227b_PCAN
        CanIfTxPduRef = SYS_TIME_SYNC_oPCAN_RADAR_ba7b9b28_Tx
        variation-point = post-build-variant-condition{matching-criterion=RDR_POS, value=4}
      6 x CanIfRxPduCfg, all with CanIfRxPduCanId=1, CanIfRxPduCanIdType=STANDARD_CAN, CanIfRxPduDlc=8, CanIfRxPduUserRxIndicationName=CanTSyn_RxIndication, CanIfRxPduUserRxIndicationUL=CAN_TSYN, CanIfRxPduId=112, CanIfRxPduReadData=false, CanIfRxPduReadNotifyStatus=false, CanIfRxPduDlcCheck=true, CanIfRxPduType=STATIC, CanIfRxPduHrhIdRef=CN_PCAN_RADAR_a729ccfc_Rx, CanIfRxPduRef=SYS_TIME_SYNC_oPCAN_RADAR_ba7b9b28_Rx:
        SYS_TIME_SYNC_oPCAN_RADAR_231d6bb9_Rx: variation-point=post-build-variant-condition{matching-criterion=RDR_POS, value={1..3}}
        SYS_TIME_SYNC_oPCAN_RADAR_231d6bb9_Rx: variation-point=post-build-variant-condition{matching-criterion=RDR_POS, value={5..7}}
    CanIfPrivateCfg:
      CanIfPrivateSoftwareFilterType = LINEAR
      CanIfPrivateDlcCheck = true
      CanIfSupportTTCAN = false
      CanIfTransceiverMapping = false
      CanIfTransceiverHandling = false
      CanIfSupportExtendedIds = true
      CanIfSupportNmOsek = false
      CanIfWakeupSupport = false
      CanIfStaticFdTxBufferSupport = false
      CanIfRxSearchConsiderMsgType = true
      CanIfTxBufferFifoSupport = true
      CanIfSetPduReceptionModeSupport = false
      CanIfTxBufferPrioByCanIdSupport = true
      CanIfSupportCanXL = false
      CanIfDataChecksumRxSupport = false
      CanIfDataChecksumTxSupport = false
    CanIfPublicCfg:
      CanIfPublicPnSupport = false
      CanIfPublicCancelTransmitSupport = false
      CanIfPublicDevErrorDetect = false
      CanIfPublicHandleTypeEnum = UINT8
      CanIfPublicMultipleDrvSupport = false
      CanIfPublicNumberOfCanHwUnits = 1
      CanIfPublicReadRxPduDataApi = false
      CanIfPublicReadRxPduNotifyStatusApi = false
      CanIfPublicReadTxPduNotifyStatusApi = false
      CanIfPublicSetDynamicTxIdApi = false
      CanIfPublicTxBuffering = true
      CanIfPublicTxConfirmPollingSupport = false
      CanIfPublicVersionInfoApi = false
      CanIfPublicWakeupCheckValidSupport = false
      CanIfPnWakeupTxPduFilterSupport = false
      CanIfPnTrcvHandlingSupport = false
      CanIfJ1939DynAddrSupport = DISABLED
      CanIfSafeBswChecks = true
      CanIfBusMirroringSupport = false
      CanIfEnableSecurityEventReporting = false
      CanIfSupportMultipartition = false
      CanIfPublicSetDynamicRxIdApi = false
      CanIfBusloadMeasurementSupport = false
      CanIfBusloadMeasurementStuffBitProbability = 0.1
      CanIfSetBaudrateApi = false
      CanIfExtendedRamCheckSupport = false
