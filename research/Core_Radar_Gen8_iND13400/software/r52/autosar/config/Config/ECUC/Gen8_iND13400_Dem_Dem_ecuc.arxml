AUTOSAR XML (schema 00053)
package /ActiveEcuC
  module config Dem: implementation-config-variant=VARIANT-POST-BUILD-SELECTABLE, module-description=Dem_Impl
    DemGeneral:
      DemOBDSupport = DEM_OBD_NO_OBD_SUPPORT
      DemAgingCycleCounterProcessing = DEM_PROCESS_AGINGCTR_INTERN
      DemDebounceCounterBasedSupport = true
      DemPTOSupport = false
      DemDtcStatusAvailabilityMask = 255
      DemGeneralInterfaceSupport = false
      DemDataElementDefaultEndianness = LITTLE_ENDIAN
      DemAgingRequieresTestedCycle = false
      DemMaxNumberEventEntryMirror = 0
      DemTriggerMonitorInitBeforeClearOk = true
      DemExtendedDataCapture = DEM_TRIGGER_EVENT_MEMORY_STORAGE
      DemFreezeFrameCapture = DEM_TRIGGER_EVENT_MEMORY_STORAGE
      DemOperationCycleProcessing = DEM_PROCESS_OPCYC_STATE
      DemAvailabilitySupport = DEM_NO_AVAILABILITY
      DemAvailabilityStorage = false
      DemBswErrorBufferSize = 0
      DemClearDTCBehavior = DEM_CLRRESP_VOLATILE
      DemClearDTCLimitation = DEM_ALL_SUPPORTED_DTCS
      DemDebounceTimeBasedSupport = false
      DemDevErrorDetect = true
      DemEnableConditionSupport = false
      DemEventCombinationSupport = DEM_EVCOMB_DISABLED
      DemEventDisplacementStrategy = DEM_DISPLACEMENT_LEGACY_403
      DemMaxNumberEventEntryOBDFreezeFrame = 0
      DemMaxNumberEventEntryPermanent = 0
      DemMaxNumberPrestoredFF = 0
      DemOccurrenceCounterProcessing = DEM_PROCESS_OCCCTR_CDTC
      DemOperationCycleStatusStorage = true
      DemResetConfirmedBitOnOverflow = true
      DemStatusBitHandlingTestFailedSinceLastClear = DEM_STATUS_BIT_AGING
      DemStatusBitStorageTestFailed = true
      DemStorageConditionSupport = false
      DemSuppressionSupport = DEM_NO_SUPPRESSION
      DemTaskTime = 0.01
      DemTriggerDcmReports = false
      DemTriggerDltReports = false
      DemTriggerFiMReports = false
      DemTriggerFiMReportsExtended = false
      DemTriggerMonitorInitForEnableConditions = false
      DemTypeOfDTCSupported = DEM_DTC_TRANSLATION_SAEJ1939_73
      DemVersionInfoApi = false
      DemBswApiVersion = DEM_BSW_API_4_XX_XX
      DemBswApiVersionNvM = DEM_BSW_API_4_XX_XX
      DemBswApiVersionFiM = DEM_BSW_API_4_XX_XX
      DemAgingAfterHealing = DEM_AGING_WHILE_HEALING
      DemAgingBehavior = DEM_AGING_TYPE_6
      DemAgingCounterBehavior = DEM_AGING_COUNT_ONLY_AGEABLE
      DemAgingCounterReporting = DEM_AGING_NORMAL_REPORTING
      DemAgingRetainEnvironmentalData = false
      DemCompiledPostbuildCrc = 4068642032 if post-build-variant-condition{matching-criterion=RDR_POS, value=0}
      DemCompiledPostbuildCrcMode = DEM_POSTBUILD_CRC_AUTOMATIC
      DemEventDisplacementFallbackStrategy = DEM_FALLBACK_DISPLACE_OLDEST_EVENT
      DemGeneralDiagnosticInfoSupport = true
      DemJ1939Support = true
      DemNvSynchronizeSupport = true
      DemPendingDtcProcessing = DEM_PROCESS_PDTC_STOREDONLY
      DemResetDebounceBehavior = DEM_RESET_DEBOUNCE_ON_DISABLE_ENABLE_CONDITIONS
      DemResetTestFailedOnOperationCycleStart = false
      DemRetryStorageSupport = false
      DemSafeBswChecks = true
      DemUseMemcopyMacros = false
      DemUseRte = true
      DemUserControlledWirBehavior = DEM_ENABLED_DURING_CONTROLDTCSETTING
      DemUserDefinedCompareAndSwap = false
      DemWarningIndicatorRequestedProcessing = DEM_PROCESS_WIR_STOREDONLY
      DemUseMultiPartitionFiM = false
      DemReportSuppressedDTCsInService19x0A = false
      DemSupportAgingForAllDTCs = false
      DemLatchTestFailedBehavior = DEM_LATCH_TF_CONFIRMED_AND_THIS_CYCLE
      DemSupportService19x04DIDLength = false
      DemTriggerFiMFDCReport = false
      DemSupportRestoreMonitorStatus = false
      DemPerIndicatorActivation = false
      DemCompiledConfigId = 1 if post-build-variant-condition{matching-criterion=RDR_POS, value=0}
      DemExtendedDataVisibility = DEM_VISIBILITY_STOREDONLY
      DemImmediateNvStorageSupport = true
      DemTriggerDtcStatusChangedCallback = true
      DemUseNvm = true
      DemCompiledPostbuildCrc = 31854438 if post-build-variant-condition{matching-criterion=RDR_POS, value=1}
      DemCompiledConfigId = 2 if post-build-variant-condition{matching-criterion=RDR_POS, value=1}
      DemCompiledPostbuildCrc = 31854438 if post-build-variant-condition{matching-criterion=RDR_POS, value=2}
      DemCompiledConfigId = 3 if post-build-variant-condition{matching-criterion=RDR_POS, value=2}
      DemCompiledPostbuildCrc = 3618527238 if post-build-variant-condition{matching-criterion=RDR_POS, value=3}
      DemCompiledConfigId = 4 if post-build-variant-condition{matching-criterion=RDR_POS, value=3}
      DemCompiledPostbuildCrc = 31854438 if post-build-variant-condition{matching-criterion=RDR_POS, value=4}
      DemCompiledConfigId = 5 if post-build-variant-condition{matching-criterion=RDR_POS, value=4}
      DemCompiledPostbuildCrc = 31854438 if post-build-variant-condition{matching-criterion=RDR_POS, value=5}
      DemCompiledConfigId = 6 if post-build-variant-condition{matching-criterion=RDR_POS, value=5}
      DemCompiledPostbuildCrc = 31854438 if post-build-variant-condition{matching-criterion=RDR_POS, value=6}
      DemCompiledConfigId = 7 if post-build-variant-condition{matching-criterion=RDR_POS, value=6}
      DemCompiledPostbuildCrc = 31854438 if post-build-variant-condition{matching-criterion=RDR_POS, value=7}
      DemCompiledConfigId = 8 if post-build-variant-condition{matching-criterion=RDR_POS, value=7}
      DemHeaderFileInclusion = SWC_PRJ_Appl_FaultMgr.h
      DemClient: DemClientId=0
      DemEventMemorySet
        PrimaryMemory (DemPrimaryMemory):
          DemTypeOfFreezeFrameRecordNumeration = DEM_FF_RECNUM_CONFIGURED
          DemMaxNumberEventEntryPrimary = 10
          DemEventMemoryEntryStorageTrigger = DEM_STORAGE_ON_TEST_FAILED
          DemMaxNumberTimeSeriesSnapshots = 0
          DemTimeSeriesSnapshotFifoSupport = false
          DemMaxNumberCustomTriggeredSnapshots = 0
      DemPostbuild:
        DemEventAvailableDefaultSupport = true
        DemMaxSizeFreezeFramePrimary = 13
        DemMaxNumberDtr = 0
        DemMaxSizeGlobalFreezeFrame = 0
        DemMaxSizeOBDonUDSFreezeFrame = 0
        DemMaxNumberEventsWithMonitorActivityData = 0
        DemMaxNumberEventsPtoTimer = 0
      3 x DemNvRamBlockId:
        Dem_AdminData: DemNvRamBlockIdType=DEM_NVBLOCK_ADMIN, DemNvRamBlockIdRef=DemAdminDataBlock
        Dem_StatusData: DemNvRamBlockIdType=DEM_NVBLOCK_STATUS, DemNvRamBlockIdRef=DemStatusDataBlock
        Dem_PrimaryEntry0: DemNvRamBlockIdType=DEM_NVBLOCK_PRIMARY, DemNvRamBlockIdIndex=0, DemNvRamBlockIdRef=DemPrimaryDataBlock0, DemNvRamBlockIdEventMemoryRef=PrimaryMemory
      Data_DID_0x1117_Sensor_Availability_Flag_Information (DemDataClass):
        DemDataElementDataSize = 1
        DemDataElementDataType = UINT8_N
        DemDataElementEndianness = opaque
        DemDataElementUsePort = USE_DATA_CLIENT_SERVER_PORT
        DemDataElementStoreNonVolatile = true
      Power_On_Off (DemOperationCycle): DemOperationCycleAutostart=true, DemOperationCycleType=DEM_OPCYC_POWER, DemOperationCycleAutomaticEnd=false
      Data_DID_0x1112_VehicleSpeed (DemDataClass):
        DemDataElementDataSize = 2
        DemDataElementDataType = UINT8_N
        DemDataElementEndianness = opaque
        DemDataElementUsePort = USE_DATA_CLIENT_SERVER_PORT
        DemDataElementStoreNonVolatile = true
      FreezeFrame_d41460f8 (DemFreezeFrameClass):
        DemDidClassRef = DID_ECUVoltage_Read_0x1111
        DemDidClassRef = DID_VehicleSpeed_Read_0x1112
        DemDidClassRef = DID_DateandTime_Read_0x1116
        DemDidClassRef = DID_Sensor_Availability_Flag_Read_0x1117
        DemDidClassRef = DID_Ego_Acceleration_Read_0xa004
      Data_AgingCounter_Aging_Counter (DemDataClass):
        DemDataElementDataSize = 1
        DemDataElementInternalData = DEM_AGINGCTR_UPCNT
        DemDataElementUsePort = USE_DATA_INTERNAL
        DemDataElementStoreNonVolatile = true
      ExtendedDataClass_6d15841f (DemExtendedDataClass): DemExtendedDataRecordClassRef=ExtendedDataRecord_OccurrenceCounter, DemExtendedDataRecordClassRef=ExtendedDataRecord_AgingCounter
      DID_Ego_Acceleration_Read_0xa004 (DemDidClass): DemDidIdentifier=40964, DemDidDataClassRef=Data_DID_0xa004_Ego_Acceleration
      Data_OccurrenceCounter_Occurrence_Counter (DemDataClass): DemDataElementDataSize=1, DemDataElementInternalData=DEM_OCCCTR, DemDataElementUsePort=USE_DATA_INTERNAL, DemDataElementStoreNonVolatile=true
      DID_Sensor_Availability_Flag_Read_0x1117 (DemDidClass): DemDidIdentifier=4375, DemDidDataClassRef=Data_DID_0x1117_Sensor_Availability_Flag_Information
      ExtendedDataRecord_OccurrenceCounter (DemExtendedDataRecordClass):
        DemExtendedDataRecordNumber = 1
        DemExtendedDataRecordTrigger = DEM_TRIGGER_ON_CONFIRMED
        DemExtendedDataRecordUpdate = DEM_UPDATE_RECORD_YES
        DemDataClassRef = Data_OccurrenceCounter_Occurrence_Counter
      ExtendedDataRecord_AgingCounter (DemExtendedDataRecordClass):
        DemExtendedDataRecordNumber = 2
        DemExtendedDataRecordTrigger = DEM_TRIGGER_ON_CONFIRMED
        DemExtendedDataRecordUpdate = DEM_UPDATE_RECORD_YES
        DemDataClassRef = Data_AgingCounter_Aging_Counter
      Data_DID_0xa004_Ego_Acceleration (DemDataClass):
        DemDataElementDataSize = 1
        DemDataElementDataType = UINT8_N
        DemDataElementEndianness = opaque
        DemDataElementUsePort = USE_DATA_CLIENT_SERVER_PORT
        DemDataElementStoreNonVolatile = true
      Data_DID_0x1111_ECUVoltage (DemDataClass):
        DemDataElementDataSize = 2
        DemDataElementDataType = UINT8_N
        DemDataElementEndianness = opaque
        DemDataElementUsePort = USE_DATA_CLIENT_SERVER_PORT
        DemDataElementStoreNonVolatile = true
      DID_DateandTime_Read_0x1116 (DemDidClass): DemDidIdentifier=4374, DemDidDataClassRef=Data_DID_0x1116_CombinedSignal
      Data_DID_0x1116_CombinedSignal (DemDataClass):
        DemDataElementDataSize = 7
        DemDataElementDataType = UINT8_N
        DemDataElementEndianness = opaque
        DemDataElementUsePort = USE_DATA_CLIENT_SERVER_PORT
        DemDataElementStoreNonVolatile = true
      DID_ECUVoltage_Read_0x1111 (DemDidClass): DemDidIdentifier=4369, DemDidDataClassRef=Data_DID_0x1111_ECUVoltage
      Last_Occurrence (DemFreezeFrameRecordClass): DemFreezeFrameRecordNumber=1, DemFreezeFrameRecordTrigger=DEM_TRIGGER_ON_TEST_FAILED, DemFreezeFrameRecordUpdate=DEM_UPDATE_RECORD_YES
      FreezeFrameRecNum_8514b953 (DemFreezeFrameRecNumClass): DemFreezeFrameRecordClassRef=Last_Occurrence
      DID_VehicleSpeed_Read_0x1112 (DemDidClass): DemDidIdentifier=4370, DemDidDataClassRef=Data_DID_0x1112_VehicleSpeed
      DemGeneralJ1939:
        DemJ1939ClearDtcSupport = false
        DemJ1939Dm31Support = false
        DemJ1939ExpandedFreezeFrameSupport = false
        DemJ1939FreezeFrameSupport = false
        DemJ1939RatioSupport = false
        DemJ1939Readiness{1..3}Support = false
        DemJ1939ReadingDtcSupport = true
        DemTriggerJ1939DcmReports = true
        DemJ1939ExcludeConfirmedObdDtcsFromPendingDTCFilter = false
        DemJ1939DtcExplicitObdRelevanceAssignment = false
      9 x DemNvRamBlockId, all with DemNvRamBlockIdType=DEM_NVBLOCK_PRIMARY, DemNvRamBlockIdEventMemoryRef=PrimaryMemory:
        Dem_PrimaryEntry{1..9}: DemNvRamBlockIdIndex={1..9}, DemNvRamBlockIdRef=DemPrimaryDataBlock{1..9}
      DemCallbackDTCStatusChanged
    DemConfigSet
      DemDTCAttributes: DemMemoryDestinationRef=PrimaryMemory
      SAS_message_Steering_Wheel_Angle_Invalid_Serial_Data_Received (DemEventParameter):
        DemEventKind = DEM_EVENT_KIND_SWC
        DemEventReportingType = STANDARD_REPORTING
        DemEventAvailable = true
        DemEventId = 55
        DemEventAvailableInVariant = true
        DemEventLatchTestFailed = false
        DemEventCreateInfoPort = true
        DemDTCClassRef = DTCClass_DtcClass_DTC_0xD43281
        DemExtendedDataClassRef = ExtendedDataClass_6d15841f
        DemFreezeFrameClassRef = FreezeFrame_d41460f8
        DemFreezeFrameRecNumClassRef = FreezeFrameRecNum_8514b953
        DemEventClass:
          DemAgingAllowed = true
          DemAgingCycleCounterThreshold = 40
          DemEventPriority = 2
          DemEventSignificance = DEM_EVENT_SIGNIFICANCE_FAULT
          DemFFPrestorageSupported = false
          DemConsiderPtoStatus = false
          DemAgingCycleRef = Power_On_Off
          DemOperationCycleRef = Power_On_Off
        DemDebounceAlgorithmClass
          DemDebounceCounterBased: DemDebounceCounterBasedClassRef=Counter_Based_Debouncing
      DTCClass_DtcClass_DTC_0xD43781 (DemDTCClass): DemDTCSeverity=DEM_DTC_SEV_NO_SEVERITY, DemUdsDTC=13907841, DemImmediateNvStorage=false, DemDTCAttributesRef=DtcAttributes_41914fb7
      DTCClass_DtcClass_DTC_0xD41087 (DemDTCClass): DemDTCSeverity=DEM_DTC_SEV_NO_SEVERITY, DemUdsDTC=13897863, DemImmediateNvStorage=false, DemDTCAttributesRef=DtcAttributes_41914fb7
      5 x DemEventParameter, all with DemEventKind=DEM_EVENT_KIND_SWC, DemEventReportingType=STANDARD_REPORTING, DemEventAvailable=true, DemEventAvailableInVariant=true, DemEventLatchTestFailed=false, DemEventCreateInfoPort=true, DemExtendedDataClassRef=ExtendedDataClass_6d15841f, DemFreezeFrameClassRef=FreezeFrame_d41460f8, DemFreezeFrameRecNumClassRef=FreezeFrameRecNum_8514b953:
        AT_AMT_ETC2_message_Transcurrent_gear_Invalid_Serial_Data_Received: DemEventId=5, DemDTCClassRef=DTCClass_DtcClass_DTC_0xD43081
          DemEventClass:
            DemAgingAllowed = true
            DemAgingCycleCounterThreshold = 40
            DemEventPriority = 2
            DemEventSignificance = DEM_EVENT_SIGNIFICANCE_FAULT
            DemFFPrestorageSupported = false
            DemConsiderPtoStatus = false
            DemAgingCycleRef = Power_On_Off
            DemOperationCycleRef = Power_On_Off
          DemDebounceAlgorithmClass
            DemDebounceCounterBased: DemDebounceCounterBasedClassRef=Counter_Based_Debouncing
        Radar_AutoAlignment_Algorithm_Signal_Calculation_Failure: DemEventId=35, DemDTCClassRef=DTCClass_DtcClass_DTC_0x560C61
          DemEventClass:
            DemAgingAllowed = true
            DemAgingCycleCounterThreshold = 40
            DemEventPriority = 2
            DemEventSignificance = DEM_EVENT_SIGNIFICANCE_FAULT
            DemFFPrestorageSupported = false
            DemConsiderPtoStatus = false
            DemAgingCycleRef = Power_On_Off
            DemOperationCycleRef = Power_On_Off
          DemDebounceAlgorithmClass
            DemDebounceCounterBased: DemDebounceCounterBasedClassRef=Counter_Based_Debouncing
        Vehicle_DataSet_Not_Configured: DemEventId=60, DemDTCClassRef=DTCClass_DtcClass_DTC_0x561655
          DemEventClass:
            DemAgingAllowed = true
            DemAgingCycleCounterThreshold = 40
            DemEventPriority = 2
            DemEventSignificance = DEM_EVENT_SIGNIFICANCE_FAULT
            DemFFPrestorageSupported = false
            DemConsiderPtoStatus = false
            DemAgingCycleRef = Power_On_Off
            DemOperationCycleRef = Power_On_Off
          DemDebounceAlgorithmClass
            DemDebounceCounterBased: DemDebounceCounterBasedClassRef=Counter_Based_Debouncing
        Radar_Module_System_Internal_Failure: DemEventId=43, DemDTCClassRef=DTCClass_DtcClass_DTC_0x560004
          DemEventClass:
            DemAgingAllowed = true
            DemAgingCycleCounterThreshold = 40
            DemEventPriority = 2
            DemEventSignificance = DEM_EVENT_SIGNIFICANCE_FAULT
            DemFFPrestorageSupported = false
            DemConsiderPtoStatus = false
            DemAgingCycleRef = Power_On_Off
            DemOperationCycleRef = Power_On_Off
          DemDebounceAlgorithmClass
            DemDebounceCounterBased: DemDebounceCounterBasedClassRef=Counter_Based_Debouncing
        Radar_MMIC_Component_Failure: DemEventId=39, DemDTCClassRef=DTCClass_DtcClass_DTC_0x560209
          DemEventClass:
            DemAgingAllowed = true
            DemAgingCycleCounterThreshold = 40
            DemEventPriority = 2
            DemEventSignificance = DEM_EVENT_SIGNIFICANCE_FAULT
            DemFFPrestorageSupported = false
            DemConsiderPtoStatus = false
            DemAgingCycleRef = Power_On_Off
            DemOperationCycleRef = Power_On_Off
          DemDebounceAlgorithmClass
            DemDebounceCounterBased: DemDebounceCounterBasedClassRef=Counter_Based_Debouncing
      DTCClass_DtcClass_DTC_0xD44083 (DemDTCClass): DemDTCSeverity=DEM_DTC_SEV_NO_SEVERITY, DemUdsDTC=13910147, DemImmediateNvStorage=false, DemDTCAttributesRef=DtcAttributes_41914fb7
      DTCClass_DtcClass_DTC_0x561195 (DemDTCClass): DemDTCSeverity=DEM_DTC_SEV_NO_SEVERITY, DemUdsDTC=5640597, DemImmediateNvStorage=false, DemDTCAttributesRef=DtcAttributes_41914fb7
      Radar_Module_General_Memory_Failure (DemEventParameter):
        DemEventKind = DEM_EVENT_KIND_SWC
        DemEventReportingType = STANDARD_REPORTING
        DemEventAvailable = true
        DemEventId = 41
        DemEventAvailableInVariant = true
        DemEventLatchTestFailed = false
        DemEventCreateInfoPort = true
        DemDTCClassRef = DTCClass_DtcClass_DTC_0x560642
        DemExtendedDataClassRef = ExtendedDataClass_6d15841f
        DemFreezeFrameClassRef = FreezeFrame_d41460f8
        DemFreezeFrameRecNumClassRef = FreezeFrameRecNum_8514b953
        DemEventClass:
          DemAgingAllowed = true
          DemAgingCycleCounterThreshold = 40
          DemEventPriority = 2
          DemEventSignificance = DEM_EVENT_SIGNIFICANCE_FAULT
          DemFFPrestorageSupported = false
          DemConsiderPtoStatus = false
          DemAgingCycleRef = Power_On_Off
          DemOperationCycleRef = Power_On_Off
        DemDebounceAlgorithmClass
          DemDebounceCounterBased: DemDebounceCounterBasedClassRef=Counter_Based_Debouncing
      3 x DemDTCClass, all with DemDTCSeverity=DEM_DTC_SEV_NO_SEVERITY, DemImmediateNvStorage=false, DemDTCAttributesRef=DtcAttributes_41914fb7:
        DTCClass_DtcClass_DTC_0xD4188F: DemUdsDTC=13899919
        DTCClass_DtcClass_DTC_0xD40387: DemUdsDTC=13894535
        DTCClass_DtcClass_DTC_0x560C61: DemUdsDTC=5639265
      Radar_System_Battery_High_Voltage_System_Voltage_High (DemEventParameter):
        DemEventKind = DEM_EVENT_KIND_SWC
        DemEventReportingType = STANDARD_REPORTING
        DemEventAvailable = true
        DemEventId = 50
        DemEventAvailableInVariant = true
        DemEventLatchTestFailed = false
        DemEventCreateInfoPort = true
        DemDTCClassRef = DTCClass_DtcClass_DTC_0x5609A3
        DemExtendedDataClassRef = ExtendedDataClass_6d15841f
        DemFreezeFrameClassRef = FreezeFrame_d41460f8
        DemFreezeFrameRecNumClassRef = FreezeFrameRecNum_8514b953
        DemEventClass:
          DemAgingAllowed = true
          DemAgingCycleCounterThreshold = 40
          DemEventPriority = 2
          DemEventSignificance = DEM_EVENT_SIGNIFICANCE_FAULT
          DemFFPrestorageSupported = false
          DemConsiderPtoStatus = false
          DemAgingCycleRef = Power_On_Off
          DemOperationCycleRef = Power_On_Off
        DemDebounceAlgorithmClass
          DemDebounceCounterBased: DemDebounceCounterBasedClassRef=Counter_Based_Debouncing
      DTCClass_DtcClass_DTC_0xD44187 (DemDTCClass): DemDTCSeverity=DEM_DTC_SEV_NO_SEVERITY, DemUdsDTC=13910407, DemImmediateNvStorage=false, DemDTCAttributesRef=DtcAttributes_41914fb7
      DTCClass_DtcClass_DTC_0xD42681 (DemDTCClass): DemDTCSeverity=DEM_DTC_SEV_NO_SEVERITY, DemUdsDTC=13903489, DemImmediateNvStorage=false, DemDTCAttributesRef=DtcAttributes_41914fb7
      CCVS1_message_Vehicle_Speed_Invalid_Serial_Data_Received (DemEventParameter):
        DemEventKind = DEM_EVENT_KIND_SWC
        DemEventReportingType = STANDARD_REPORTING
        DemEventAvailable = true
        DemEventId = 7
        DemEventAvailableInVariant = true
        DemEventLatchTestFailed = false
        DemEventCreateInfoPort = true
        DemDTCClassRef = DTCClass_DtcClass_DTC_0xD42681
        DemExtendedDataClassRef = ExtendedDataClass_6d15841f
        DemFreezeFrameClassRef = FreezeFrame_d41460f8
        DemFreezeFrameRecNumClassRef = FreezeFrameRecNum_8514b953
        DemEventClass:
          DemAgingAllowed = true
          DemAgingCycleCounterThreshold = 40
          DemEventPriority = 2
          DemEventSignificance = DEM_EVENT_SIGNIFICANCE_FAULT
          DemFFPrestorageSupported = false
          DemConsiderPtoStatus = false
          DemAgingCycleRef = Power_On_Off
          DemOperationCycleRef = Power_On_Off
        DemDebounceAlgorithmClass
          DemDebounceCounterBased: DemDebounceCounterBasedClassRef=Counter_Based_Debouncing
      DTCClass_DtcClass_DTC_0x5608A2 (DemDTCClass): DemDTCSeverity=DEM_DTC_SEV_NO_SEVERITY, DemUdsDTC=5638306, DemImmediateNvStorage=false, DemDTCAttributesRef=DtcAttributes_41914fb7
      3 x DemEventParameter, all with DemEventKind=DEM_EVENT_KIND_SWC, DemEventReportingType=STANDARD_REPORTING, DemEventAvailable=true, DemEventAvailableInVariant=true, DemEventLatchTestFailed=false, DemEventCreateInfoPort=true, DemExtendedDataClassRef=ExtendedDataClass_6d15841f, DemFreezeFrameClassRef=FreezeFrame_d41460f8, DemFreezeFrameRecNumClassRef=FreezeFrameRecNum_8514b953:
        EMS_ECU_VD_erratic_communication_Erratic: DemEventId=24, DemDTCClassRef=DTCClass_DtcClass_DTC_0xD4178F
          DemEventClass:
            DemAgingAllowed = true
            DemAgingCycleCounterThreshold = 40
            DemEventPriority = 2
            DemEventSignificance = DEM_EVENT_SIGNIFICANCE_FAULT
            DemFFPrestorageSupported = false
            DemConsiderPtoStatus = false
            DemAgingCycleRef = Power_On_Off
            DemOperationCycleRef = Power_On_Off
          DemDebounceAlgorithmClass
            DemDebounceCounterBased: DemDebounceCounterBasedClassRef=Counter_Based_Debouncing
        EMS_ECU_ETC2_00_message_Missing_Message: DemEventId=22, DemDTCClassRef=DTCClass_DtcClass_DTC_0xD40487
          DemEventClass:
            DemAgingAllowed = true
            DemAgingCycleCounterThreshold = 40
            DemEventPriority = 2
            DemEventSignificance = DEM_EVENT_SIGNIFICANCE_FAULT
            DemFFPrestorageSupported = false
            DemConsiderPtoStatus = false
            DemAgingCycleRef = Power_On_Off
            DemOperationCycleRef = Power_On_Off
          DemDebounceAlgorithmClass
            DemDebounceCounterBased: DemDebounceCounterBasedClassRef=Counter_Based_Debouncing
        Cluster_ECU_CLS_Tx_16_message_Missing_Message: DemEventId=14, DemDTCClassRef=DTCClass_DtcClass_DTC_0xD40987
          DemEventClass:
            DemAgingAllowed = true
            DemAgingCycleCounterThreshold = 40
            DemEventPriority = 2
            DemEventSignificance = DEM_EVENT_SIGNIFICANCE_FAULT
            DemFFPrestorageSupported = false
            DemConsiderPtoStatus = false
            DemAgingCycleRef = Power_On_Off
            DemOperationCycleRef = Power_On_Off
          DemDebounceAlgorithmClass
            DemDebounceCounterBased: DemDebounceCounterBasedClassRef=Counter_Based_Debouncing
      DTCClass_DtcClass_DTC_0xD40787 (DemDTCClass): DemDTCSeverity=DEM_DTC_SEV_NO_SEVERITY, DemUdsDTC=13895559, DemImmediateNvStorage=false, DemDTCAttributesRef=DtcAttributes_41914fb7
      3 x DemEventParameter, all with DemEventKind=DEM_EVENT_KIND_SWC, DemEventReportingType=STANDARD_REPORTING, DemEventAvailable=true, DemEventLatchTestFailed=false, DemEventCreateInfoPort=true, DemExtendedDataClassRef=ExtendedDataClass_6d15841f, DemFreezeFrameClassRef=FreezeFrame_d41460f8, DemFreezeFrameRecNumClassRef=FreezeFrameRecNum_8514b953:
        Exceeded_Security_Access_0x27_Attempt_Threshold_Authentication_Failure: DemEventId=28, DemEventAvailableInVariant=true, DemDTCClassRef=DTCClass_DtcClass_DTC_0xD4438A
          DemEventClass:
            DemAgingAllowed = true
            DemAgingCycleCounterThreshold = 40
            DemEventPriority = 2
            DemEventSignificance = DEM_EVENT_SIGNIFICANCE_FAULT
            DemFFPrestorageSupported = false
            DemConsiderPtoStatus = false
            DemAgingCycleRef = Power_On_Off
            DemOperationCycleRef = Power_On_Off
          DemDebounceAlgorithmClass
            DemDebounceCounterBased: DemDebounceCounterBasedClassRef=Counter_Based_Debouncing
        Front_Left_Side_Radar_value_of_signal_protection_calculation_Incorrect: DemEventId=30, DemEventAvailableInVariant=true if post-build-variant-condition{matching-criterion=RDR_POS, value=0}, DemEventAvailableInVariant=false if post-build-variant-condition{matching-criterion=RDR_POS, value=1}, DemEventAvailableInVariant=false if post-build-variant-condition{matching-criterion=RDR_POS, value=2}, DemEventAvailableInVariant=false if post-build-variant-condition{matching-criterion=RDR_POS, value=3}, DemEventAvailableInVariant=false if post-build-variant-condition{matching-criterion=RDR_POS, value=4}, DemEventAvailableInVariant=false if post-build-variant-condition{matching-criterion=RDR_POS, value=5}, DemEventAvailableInVariant=false if post-build-variant-condition{matching-criterion=RDR_POS, value=6}, DemEventAvailableInVariant=false if post-build-variant-condition{matching-criterion=RDR_POS, value=7}, DemDTCClassRef=DTCClass_DtcClass_DTC_0xD44083
          DemEventClass:
            DemAgingAllowed = true
            DemAgingCycleCounterThreshold = 40
            DemEventPriority = 2
            DemEventSignificance = DEM_EVENT_SIGNIFICANCE_FAULT
            DemFFPrestorageSupported = false
            DemConsiderPtoStatus = false
            DemAgingCycleRef = Power_On_Off
            DemOperationCycleRef = Power_On_Off
          DemDebounceAlgorithmClass
            DemDebounceCounterBased: DemDebounceCounterBasedClassRef=Counter_Based_Debouncing
        AT_AMT_ETC2_erratic_communication_Erratic: DemEventId=4, DemEventAvailableInVariant=true, DemDTCClassRef=DTCClass_DtcClass_DTC_0xD4198F
          DemEventClass:
            DemAgingAllowed = true
            DemAgingCycleCounterThreshold = 40
            DemEventPriority = 2
            DemEventSignificance = DEM_EVENT_SIGNIFICANCE_FAULT
            DemFFPrestorageSupported = false
            DemConsiderPtoStatus = false
            DemAgingCycleRef = Power_On_Off
            DemOperationCycleRef = Power_On_Off
          DemDebounceAlgorithmClass
            DemDebounceCounterBased: DemDebounceCounterBasedClassRef=Counter_Based_Debouncing
      DtcAttributes_41914fb7 (DemDTCAttributes): DemMemoryDestinationRef=PrimaryMemory
      VCAN_Communication_Bus_Off (DemEventParameter):
        DemEventKind = DEM_EVENT_KIND_SWC
        DemEventReportingType = STANDARD_REPORTING
        DemEventAvailable = true
        DemEventId = 56
        DemEventAvailableInVariant = true
        DemEventLatchTestFailed = false
        DemEventCreateInfoPort = true
        DemDTCClassRef = DTCClass_DtcClass_DTC_0xD40188
        DemExtendedDataClassRef = ExtendedDataClass_6d15841f
        DemFreezeFrameClassRef = FreezeFrame_d41460f8
        DemFreezeFrameRecNumClassRef = FreezeFrameRecNum_8514b953
        DemEventClass:
          DemAgingAllowed = true
          DemAgingCycleCounterThreshold = 40
          DemEventPriority = 2
          DemEventSignificance = DEM_EVENT_SIGNIFICANCE_FAULT
          DemFFPrestorageSupported = false
          DemConsiderPtoStatus = false
          DemAgingCycleRef = Power_On_Off
          DemOperationCycleRef = Power_On_Off
        DemDebounceAlgorithmClass
          DemDebounceCounterBased: DemDebounceCounterBasedClassRef=Counter_Based_Debouncing
        DemCallbackEventStatusChanged: DemCallbackEventStatusChangedFnc=App_DemCbkEventStatus_VCAN_BusOffFault
      VDC2_message_LongitudinalAcceleration_Invalid_Serial_Data_Received (DemEventParameter):
        DemEventKind = DEM_EVENT_KIND_SWC
        DemEventReportingType = STANDARD_REPORTING
        DemEventAvailable = true
        DemEventId = 58
        DemEventAvailableInVariant = true
        DemEventLatchTestFailed = false
        DemEventCreateInfoPort = true
        DemDTCClassRef = DTCClass_DtcClass_DTC_0xD43581
        DemExtendedDataClassRef = ExtendedDataClass_6d15841f
        DemFreezeFrameClassRef = FreezeFrame_d41460f8
        DemFreezeFrameRecNumClassRef = FreezeFrameRecNum_8514b953
        DemEventClass:
          DemAgingAllowed = true
          DemAgingCycleCounterThreshold = 40
          DemEventPriority = 2
          DemEventSignificance = DEM_EVENT_SIGNIFICANCE_FAULT
          DemFFPrestorageSupported = false
          DemConsiderPtoStatus = false
          DemAgingCycleRef = Power_On_Off
          DemOperationCycleRef = Power_On_Off
        DemDebounceAlgorithmClass
          DemDebounceCounterBased: DemDebounceCounterBasedClassRef=Counter_Based_Debouncing
      3 x DemDTCClass, all with DemDTCSeverity=DEM_DTC_SEV_NO_SEVERITY, DemImmediateNvStorage=false, DemDTCAttributesRef=DtcAttributes_41914fb7:
        DTCClass_DtcClass_DTC_0x561745: DemUdsDTC=5642565
        DTCClass_DtcClass_DTC_0xD4228F: DemUdsDTC=13902479
        DTCClass_DtcClass_DTC_0xD43381: DemUdsDTC=13906817
      Radar_MMIC_RFBIST_Component_Internal_Failure (DemEventParameter):
        DemEventKind = DEM_EVENT_KIND_SWC
        DemEventReportingType = STANDARD_REPORTING
        DemEventAvailable = true
        DemEventId = 40
        DemEventAvailableInVariant = true
        DemEventLatchTestFailed = false
        DemEventCreateInfoPort = true
        DemDTCClassRef = DTCClass_DtcClass_DTC_0x561792
        DemExtendedDataClassRef = ExtendedDataClass_6d15841f
        DemFreezeFrameClassRef = FreezeFrame_d41460f8
        DemFreezeFrameRecNumClassRef = FreezeFrameRecNum_8514b953
        DemEventClass:
          DemAgingAllowed = true
          DemAgingCycleCounterThreshold = 40
          DemEventPriority = 2
          DemEventSignificance = DEM_EVENT_SIGNIFICANCE_FAULT
          DemFFPrestorageSupported = false
          DemConsiderPtoStatus = false
          DemAgingCycleRef = Power_On_Off
          DemOperationCycleRef = Power_On_Off
        DemDebounceAlgorithmClass
          DemDebounceCounterBased: DemDebounceCounterBasedClassRef=Counter_Based_Debouncing
      DTCClass_DtcClass_DTC_0x561583 (DemDTCClass): DemDTCSeverity=DEM_DTC_SEV_NO_SEVERITY, DemUdsDTC=5641603, DemImmediateNvStorage=false, DemDTCAttributesRef=DtcAttributes_41914fb7
      DTCClass_DtcClass_DTC_0xD41187 (DemDTCClass): DemDTCSeverity=DEM_DTC_SEV_NO_SEVERITY, DemUdsDTC=13898119, DemImmediateNvStorage=false, DemDTCAttributesRef=DtcAttributes_41914fb7
      3 x DemEventParameter, all with DemEventKind=DEM_EVENT_KIND_SWC, DemEventReportingType=STANDARD_REPORTING, DemEventAvailable=true, DemEventAvailableInVariant=true, DemEventLatchTestFailed=false, DemEventCreateInfoPort=true, DemExtendedDataClassRef=ExtendedDataClass_6d15841f, DemFreezeFrameClassRef=FreezeFrame_d41460f8, DemFreezeFrameRecNumClassRef=FreezeFrameRecNum_8514b953:
        Radar_Initial_Alignment_Missing_Calibration: DemEventId=38, DemDTCClassRef=DTCClass_DtcClass_DTC_0x560A54
          DemEventClass:
            DemAgingAllowed = true
            DemAgingCycleCounterThreshold = 40
            DemEventPriority = 2
            DemEventSignificance = DEM_EVENT_SIGNIFICANCE_FAULT
            DemFFPrestorageSupported = false
            DemConsiderPtoStatus = false
            DemAgingCycleRef = Power_On_Off
            DemOperationCycleRef = Power_On_Off
          DemDebounceAlgorithmClass
            DemDebounceCounterBased: DemDebounceCounterBasedClassRef=Counter_Based_Debouncing
        Cluster_ECU_OEL_message_Missing_Message: DemEventId=16, DemDTCClassRef=DTCClass_DtcClass_DTC_0xD41187
          DemEventClass:
            DemAgingAllowed = true
            DemAgingCycleCounterThreshold = 40
            DemEventPriority = 2
            DemEventSignificance = DEM_EVENT_SIGNIFICANCE_FAULT
            DemFFPrestorageSupported = false
            DemConsiderPtoStatus = false
            DemAgingCycleRef = Power_On_Off
            DemOperationCycleRef = Power_On_Off
          DemDebounceAlgorithmClass
            DemDebounceCounterBased: DemDebounceCounterBasedClassRef=Counter_Based_Debouncing
        AT_AMT_ECU_ETC2_03_message_Missing_Message: DemEventId=3, DemDTCClassRef=DTCClass_DtcClass_DTC_0xD40787
          DemEventClass:
            DemAgingAllowed = true
            DemAgingCycleCounterThreshold = 40
            DemEventPriority = 2
            DemEventSignificance = DEM_EVENT_SIGNIFICANCE_FAULT
            DemFFPrestorageSupported = false
            DemConsiderPtoStatus = false
            DemAgingCycleRef = Power_On_Off
            DemOperationCycleRef = Power_On_Off
          DemDebounceAlgorithmClass
            DemDebounceCounterBased: DemDebounceCounterBasedClassRef=Counter_Based_Debouncing
      DTCClass_DtcClass_DTC_0xD4158F (DemDTCClass): DemDTCSeverity=DEM_DTC_SEV_NO_SEVERITY, DemUdsDTC=13899151, DemImmediateNvStorage=false, DemDTCAttributesRef=DtcAttributes_41914fb7
      ADAS_FN_STS_message_MOIS_FN_Switch_STS_Invalid_Serial_Data_Received (DemEventParameter):
        DemEventKind = DEM_EVENT_KIND_SWC
        DemEventReportingType = STANDARD_REPORTING
        DemEventAvailable = true
        DemEventId = 2
        DemEventAvailableInVariant = true
        DemEventLatchTestFailed = false
        DemEventCreateInfoPort = true
        DemDTCClassRef = DTCClass_DtcClass_DTC_0xD43781
        DemExtendedDataClassRef = ExtendedDataClass_6d15841f
        DemFreezeFrameClassRef = FreezeFrame_d41460f8
        DemFreezeFrameRecNumClassRef = FreezeFrameRecNum_8514b953
        DemEventClass:
          DemAgingAllowed = true
          DemAgingCycleCounterThreshold = 40
          DemEventPriority = 2
          DemEventSignificance = DEM_EVENT_SIGNIFICANCE_FAULT
          DemFFPrestorageSupported = false
          DemConsiderPtoStatus = false
          DemAgingCycleRef = Power_On_Off
          DemOperationCycleRef = Power_On_Off
        DemDebounceAlgorithmClass
          DemDebounceCounterBased: DemDebounceCounterBasedClassRef=Counter_Based_Debouncing
      7 x DemDTCClass, all with DemDTCSeverity=DEM_DTC_SEV_NO_SEVERITY, DemImmediateNvStorage=false, DemDTCAttributesRef=DtcAttributes_41914fb7:
        DTCClass_DtcClass_DTC_0x560642: DemUdsDTC=5637698
        DTCClass_DtcClass_DTC_0x560004: DemUdsDTC=5636100
        DTCClass_DtcClass_DTC_0xD4198F: DemUdsDTC=13900175
        DTCClass_DtcClass_DTC_0xD42781: DemUdsDTC=13903745
        DTCClass_DtcClass_DTC_0x560747: DemUdsDTC=5637959
        DTCClass_DtcClass_DTC_0xD40887: DemUdsDTC=13895815
        DTCClass_DtcClass_DTC_0xD40487: DemUdsDTC=13894791
      Radar_Module_Over_Temperature (DemEventParameter):
        DemEventKind = DEM_EVENT_KIND_SWC
        DemEventReportingType = STANDARD_REPORTING
        DemEventAvailable = true
        DemEventId = 42
        DemEventAvailableInVariant = true
        DemEventLatchTestFailed = false
        DemEventCreateInfoPort = true
        DemDTCClassRef = DTCClass_DtcClass_DTC_0xD4004B
        DemExtendedDataClassRef = ExtendedDataClass_6d15841f
        DemFreezeFrameClassRef = FreezeFrame_d41460f8
        DemFreezeFrameRecNumClassRef = FreezeFrameRecNum_8514b953
        DemEventClass:
          DemAgingAllowed = true
          DemAgingCycleCounterThreshold = 40
          DemEventPriority = 2
          DemEventSignificance = DEM_EVENT_SIGNIFICANCE_FAULT
          DemFFPrestorageSupported = false
          DemConsiderPtoStatus = false
          DemAgingCycleRef = Power_On_Off
          DemOperationCycleRef = Power_On_Off
        DemDebounceAlgorithmClass
          DemDebounceCounterBased: DemDebounceCounterBasedClassRef=Counter_Based_Debouncing
      DTCClass_DtcClass_DTC_0xD4238F (DemDTCClass): DemDTCSeverity=DEM_DTC_SEV_NO_SEVERITY, DemUdsDTC=13902735, DemImmediateNvStorage=false, DemDTCAttributesRef=DtcAttributes_41914fb7
      DTCClass_DtcClass_DTC_0x5609A3 (DemDTCClass): DemDTCSeverity=DEM_DTC_SEV_NO_SEVERITY, DemUdsDTC=5638563, DemImmediateNvStorage=false, DemDTCAttributesRef=DtcAttributes_41914fb7
      PCAN_TimeSync_Missing_Message (DemEventParameter):
        DemEventKind = DEM_EVENT_KIND_SWC
        DemEventReportingType = STANDARD_REPORTING
        DemEventAvailable = true
        DemEventId = 34
        DemEventAvailableInVariant = true if post-build-variant-condition{matching-criterion=RDR_POS, value=0}
        DemEventLatchTestFailed = false
        DemEventCreateInfoPort = true
        DemEventAvailableInVariant = false if post-build-variant-condition{matching-criterion=RDR_POS, value=1}
        DemEventAvailableInVariant = false if post-build-variant-condition{matching-criterion=RDR_POS, value=2}
        DemEventAvailableInVariant = true if post-build-variant-condition{matching-criterion=RDR_POS, value=3}
        DemEventAvailableInVariant = false if post-build-variant-condition{matching-criterion=RDR_POS, value={4..7}}
        DemDTCClassRef = DTCClass_DtcClass_DTC_0xD44187
        DemExtendedDataClassRef = ExtendedDataClass_6d15841f
        DemFreezeFrameClassRef = FreezeFrame_d41460f8
        DemFreezeFrameRecNumClassRef = FreezeFrameRecNum_8514b953
        DemEventClass:
          DemAgingAllowed = true
          DemAgingCycleCounterThreshold = 40
          DemEventPriority = 2
          DemEventSignificance = DEM_EVENT_SIGNIFICANCE_FAULT
          DemFFPrestorageSupported = false
          DemConsiderPtoStatus = false
          DemAgingCycleRef = Power_On_Off
          DemOperationCycleRef = Power_On_Off
        DemDebounceAlgorithmClass
          DemDebounceCounterBased: DemDebounceCounterBasedClassRef=Counter_Based_Debouncing
      DTCClass_DtcClass_DTC_0xD43481 (DemDTCClass): DemDTCSeverity=DEM_DTC_SEV_NO_SEVERITY, DemUdsDTC=13907073, DemImmediateNvStorage=false, DemDTCAttributesRef=DtcAttributes_41914fb7
      DTCClass_DtcClass_DTC_0xD43081 (DemDTCClass): DemDTCSeverity=DEM_DTC_SEV_NO_SEVERITY, DemUdsDTC=13906049, DemImmediateNvStorage=false, DemDTCAttributesRef=DtcAttributes_41914fb7
      Radar_Module_Watchdog_Failure (DemEventParameter):
        DemEventKind = DEM_EVENT_KIND_SWC
        DemEventReportingType = STANDARD_REPORTING
        DemEventAvailable = true
        DemEventId = 44
        DemEventAvailableInVariant = true
        DemEventLatchTestFailed = false
        DemEventCreateInfoPort = true
        DemDTCClassRef = DTCClass_DtcClass_DTC_0x560747
        DemExtendedDataClassRef = ExtendedDataClass_6d15841f
        DemFreezeFrameClassRef = FreezeFrame_d41460f8
        DemFreezeFrameRecNumClassRef = FreezeFrameRecNum_8514b953
        DemEventClass:
          DemAgingAllowed = true
          DemAgingCycleCounterThreshold = 40
          DemEventPriority = 2
          DemEventSignificance = DEM_EVENT_SIGNIFICANCE_FAULT
          DemFFPrestorageSupported = false
          DemConsiderPtoStatus = false
          DemAgingCycleRef = Power_On_Off
          DemOperationCycleRef = Power_On_Off
        DemDebounceAlgorithmClass
          DemDebounceCounterBased: DemDebounceCounterBasedClassRef=Counter_Based_Debouncing
      DTCClass_DtcClass_DTC_0xD41287 (DemDTCClass): DemDTCSeverity=DEM_DTC_SEV_NO_SEVERITY, DemUdsDTC=13898375, DemImmediateNvStorage=false, DemDTCAttributesRef=DtcAttributes_41914fb7
      SAS_ECU_SAS_message_Missing_Message (DemEventParameter):
        DemEventKind = DEM_EVENT_KIND_SWC
        DemEventReportingType = STANDARD_REPORTING
        DemEventAvailable = true
        DemEventId = 53
        DemEventAvailableInVariant = true
        DemEventLatchTestFailed = false
        DemEventCreateInfoPort = true
        DemDTCClassRef = DTCClass_DtcClass_DTC_0xD41387
        DemExtendedDataClassRef = ExtendedDataClass_6d15841f
        DemFreezeFrameClassRef = FreezeFrame_d41460f8
        DemFreezeFrameRecNumClassRef = FreezeFrameRecNum_8514b953
        DemEventClass:
          DemAgingAllowed = true
          DemAgingCycleCounterThreshold = 40
          DemEventPriority = 2
          DemEventSignificance = DEM_EVENT_SIGNIFICANCE_FAULT
          DemFFPrestorageSupported = false
          DemConsiderPtoStatus = false
          DemAgingCycleRef = Power_On_Off
          DemOperationCycleRef = Power_On_Off
        DemDebounceAlgorithmClass
          DemDebounceCounterBased: DemDebounceCounterBasedClassRef=Counter_Based_Debouncing
      DTCClass_DtcClass_DTC_0xD43581 (DemDTCClass): DemDTCSeverity=DEM_DTC_SEV_NO_SEVERITY, DemUdsDTC=13907329, DemImmediateNvStorage=false, DemDTCAttributesRef=DtcAttributes_41914fb7
      5 x DemEventParameter, all with DemEventKind=DEM_EVENT_KIND_SWC, DemEventReportingType=STANDARD_REPORTING, DemEventAvailable=true, DemEventLatchTestFailed=false, DemEventCreateInfoPort=true, DemExtendedDataClassRef=ExtendedDataClass_6d15841f, DemFreezeFrameClassRef=FreezeFrame_d41460f8, DemFreezeFrameRecNumClassRef=FreezeFrameRecNum_8514b953:
        ECU_NVM_Corruption_Program_memory_Failure: DemEventId=19, DemEventAvailableInVariant=true, DemDTCClassRef=DTCClass_DtcClass_DTC_0x561745
          DemEventClass:
            DemAgingAllowed = true
            DemAgingCycleCounterThreshold = 40
            DemEventPriority = 2
            DemEventSignificance = DEM_EVENT_SIGNIFICANCE_FAULT
            DemFFPrestorageSupported = false
            DemConsiderPtoStatus = false
            DemAgingCycleRef = Power_On_Off
            DemOperationCycleRef = Power_On_Off
          DemDebounceAlgorithmClass
            DemDebounceCounterBased: DemDebounceCounterBasedClassRef=Counter_Based_Debouncing
        Cluster_ECU_TD_message_Missing_Message: DemEventId=18, DemEventAvailableInVariant=true, DemDTCClassRef=DTCClass_DtcClass_DTC_0xD41287
          DemEventClass:
            DemAgingAllowed = true
            DemAgingCycleCounterThreshold = 40
            DemEventPriority = 2
            DemEventSignificance = DEM_EVENT_SIGNIFICANCE_FAULT
            DemFFPrestorageSupported = false
            DemConsiderPtoStatus = false
            DemAgingCycleRef = Power_On_Off
            DemOperationCycleRef = Power_On_Off
          DemDebounceAlgorithmClass
            DemDebounceCounterBased: DemDebounceCounterBasedClassRef=Counter_Based_Debouncing
        PCAN_Communication_Bus_Off: DemEventId=33, DemEventAvailableInVariant=true, DemDTCClassRef=DTCClass_DtcClass_DTC_0xD40288
          DemEventClass:
            DemAgingAllowed = true
            DemAgingCycleCounterThreshold = 40
            DemEventPriority = 2
            DemEventSignificance = DEM_EVENT_SIGNIFICANCE_FAULT
            DemFFPrestorageSupported = false
            DemConsiderPtoStatus = false
            DemAgingCycleRef = Power_On_Off
            DemOperationCycleRef = Power_On_Off
          DemDebounceAlgorithmClass
            DemDebounceCounterBased: DemDebounceCounterBasedClassRef=Counter_Based_Debouncing
          DemCallbackEventStatusChanged: DemCallbackEventStatusChangedFnc=App_DemCbkEventStatus_PCAN_BusOffFault
        Front_Left_Side_Radar_Missing_Message: DemEventId=29, DemEventAvailableInVariant=true if post-build-variant-condition{matching-criterion=RDR_POS, value=0}, DemEventAvailableInVariant=false if post-build-variant-condition{matching-criterion=RDR_POS, value=1}, DemEventAvailableInVariant=false if post-build-variant-condition{matching-criterion=RDR_POS, value=2}, DemEventAvailableInVariant=false if post-build-variant-condition{matching-criterion=RDR_POS, value=3}, DemEventAvailableInVariant=false if post-build-variant-condition{matching-criterion=RDR_POS, value=4}, DemEventAvailableInVariant=false if post-build-variant-condition{matching-criterion=RDR_POS, value=5}, DemEventAvailableInVariant=false if post-build-variant-condition{matching-criterion=RDR_POS, value=6}, DemEventAvailableInVariant=false if post-build-variant-condition{matching-criterion=RDR_POS, value=7}, DemDTCClassRef=DTCClass_DtcClass_DTC_0xD43987
          DemEventClass:
            DemAgingAllowed = true
            DemAgingCycleCounterThreshold = 40
            DemEventPriority = 2
            DemEventSignificance = DEM_EVENT_SIGNIFICANCE_FAULT
            DemFFPrestorageSupported = false
            DemConsiderPtoStatus = false
            DemAgingCycleRef = Power_On_Off
            DemOperationCycleRef = Power_On_Off
          DemDebounceAlgorithmClass
            DemDebounceCounterBased: DemDebounceCounterBasedClassRef=Counter_Based_Debouncing
        Manual_ETC2_message_Transcurrent_gear_Invalid_Serial_Data_Received: DemEventId=31, DemEventAvailableInVariant=true, DemDTCClassRef=DTCClass_DtcClass_DTC_0xD42981
          DemEventClass:
            DemAgingAllowed = true
            DemAgingCycleCounterThreshold = 40
            DemEventPriority = 2
            DemEventSignificance = DEM_EVENT_SIGNIFICANCE_FAULT
            DemFFPrestorageSupported = false
            DemConsiderPtoStatus = false
            DemAgingCycleRef = Power_On_Off
            DemOperationCycleRef = Power_On_Off
          DemDebounceAlgorithmClass
            DemDebounceCounterBased: DemDebounceCounterBasedClassRef=Counter_Based_Debouncing
      DTCClass_DtcClass_DTC_0xD43987 (DemDTCClass): DemDTCSeverity=DEM_DTC_SEV_NO_SEVERITY, DemUdsDTC=13908359, DemImmediateNvStorage=false, DemDTCAttributesRef=DtcAttributes_41914fb7
      5 x DemEventParameter, all with DemEventKind=DEM_EVENT_KIND_SWC, DemEventReportingType=STANDARD_REPORTING, DemEventAvailable=true, DemEventAvailableInVariant=true, DemEventLatchTestFailed=false, DemEventCreateInfoPort=true, DemExtendedDataClassRef=ExtendedDataClass_6d15841f, DemFreezeFrameClassRef=FreezeFrame_d41460f8, DemFreezeFrameRecNumClassRef=FreezeFrameRecNum_8514b953:
        SAS_ECU_erratic_communication_Erratic: DemEventId=54, DemDTCClassRef=DTCClass_DtcClass_DTC_0xD4258F
          DemEventClass:
            DemAgingAllowed = true
            DemAgingCycleCounterThreshold = 40
            DemEventPriority = 2
            DemEventSignificance = DEM_EVENT_SIGNIFICANCE_FAULT
            DemFFPrestorageSupported = false
            DemConsiderPtoStatus = false
            DemAgingCycleRef = Power_On_Off
            DemOperationCycleRef = Power_On_Off
          DemDebounceAlgorithmClass
            DemDebounceCounterBased: DemDebounceCounterBasedClassRef=Counter_Based_Debouncing
        VDC2_message_Yaw_rate_Invalid_Serial_Data_Received: DemEventId=59, DemDTCClassRef=DTCClass_DtcClass_DTC_0xD43381
          DemEventClass:
            DemAgingAllowed = true
            DemAgingCycleCounterThreshold = 40
            DemEventPriority = 2
            DemEventSignificance = DEM_EVENT_SIGNIFICANCE_FAULT
            DemFFPrestorageSupported = false
            DemConsiderPtoStatus = false
            DemAgingCycleRef = Power_On_Off
            DemOperationCycleRef = Power_On_Off
          DemDebounceAlgorithmClass
            DemDebounceCounterBased: DemDebounceCounterBasedClassRef=Counter_Based_Debouncing
        Cluster_ECU_TD_erratic_communication_Erratic: DemEventId=17, DemDTCClassRef=DTCClass_DtcClass_DTC_0xD4248F
          DemEventClass:
            DemAgingAllowed = true
            DemAgingCycleCounterThreshold = 40
            DemEventPriority = 2
            DemEventSignificance = DEM_EVENT_SIGNIFICANCE_FAULT
            DemFFPrestorageSupported = false
            DemConsiderPtoStatus = false
            DemAgingCycleRef = Power_On_Off
            DemOperationCycleRef = Power_On_Off
          DemDebounceAlgorithmClass
            DemDebounceCounterBased: DemDebounceCounterBasedClassRef=Counter_Based_Debouncing
        EMS_ECU_CCVS1_message_Missing_Message: DemEventId=21, DemDTCClassRef=DTCClass_DtcClass_DTC_0xD40387
          DemEventClass:
            DemAgingAllowed = true
            DemAgingCycleCounterThreshold = 40
            DemEventPriority = 2
            DemEventSignificance = DEM_EVENT_SIGNIFICANCE_FAULT
            DemFFPrestorageSupported = false
            DemConsiderPtoStatus = false
            DemAgingCycleRef = Power_On_Off
            DemOperationCycleRef = Power_On_Off
          DemDebounceAlgorithmClass
            DemDebounceCounterBased: DemDebounceCounterBasedClassRef=Counter_Based_Debouncing
        Radar_Mounting_Orientation_Incorrect_Assembly: DemEventId=45, DemDTCClassRef=DTCClass_DtcClass_DTC_0x561195
          DemEventClass:
            DemAgingAllowed = true
            DemAgingCycleCounterThreshold = 40
            DemEventPriority = 2
            DemEventSignificance = DEM_EVENT_SIGNIFICANCE_FAULT
            DemFFPrestorageSupported = false
            DemConsiderPtoStatus = false
            DemAgingCycleRef = Power_On_Off
            DemOperationCycleRef = Power_On_Off
          DemDebounceAlgorithmClass
            DemDebounceCounterBased: DemDebounceCounterBasedClassRef=Counter_Based_Debouncing
      DTCClass_DtcClass_DTC_0x560106 (DemDTCClass): DemDTCSeverity=DEM_DTC_SEV_NO_SEVERITY, DemUdsDTC=5636358, DemImmediateNvStorage=false, DemDTCAttributesRef=DtcAttributes_41914fb7
      EMS_ECU_ETC2_erratic_communication_Erractic (DemEventParameter):
        DemEventKind = DEM_EVENT_KIND_SWC
        DemEventReportingType = STANDARD_REPORTING
        DemEventAvailable = true
        DemEventId = 23
        DemEventAvailableInVariant = true
        DemEventLatchTestFailed = false
        DemEventCreateInfoPort = true
        DemDTCClassRef = DTCClass_DtcClass_DTC_0xD4168F
        DemExtendedDataClassRef = ExtendedDataClass_6d15841f
        DemFreezeFrameClassRef = FreezeFrame_d41460f8
        DemFreezeFrameRecNumClassRef = FreezeFrameRecNum_8514b953
        DemEventClass:
          DemAgingAllowed = true
          DemAgingCycleCounterThreshold = 40
          DemEventPriority = 2
          DemEventSignificance = DEM_EVENT_SIGNIFICANCE_FAULT
          DemFFPrestorageSupported = false
          DemConsiderPtoStatus = false
          DemAgingCycleRef = Power_On_Off
          DemOperationCycleRef = Power_On_Off
        DemDebounceAlgorithmClass
          DemDebounceCounterBased: DemDebounceCounterBasedClassRef=Counter_Based_Debouncing
      DTCClass_DtcClass_DTC_0xD4168F (DemDTCClass): DemDTCSeverity=DEM_DTC_SEV_NO_SEVERITY, DemUdsDTC=13899407, DemImmediateNvStorage=false, DemDTCAttributesRef=DtcAttributes_41914fb7
      Cluster_ECU_ADAS_FN_STS_erratic_communication_Erratic (DemEventParameter):
        DemEventKind = DEM_EVENT_KIND_SWC
        DemEventReportingType = STANDARD_REPORTING
        DemEventAvailable = true
        DemEventId = 9
        DemEventAvailableInVariant = true
        DemEventLatchTestFailed = false
        DemEventCreateInfoPort = true
        DemDTCClassRef = DTCClass_DtcClass_DTC_0xD4238F
        DemExtendedDataClassRef = ExtendedDataClass_6d15841f
        DemFreezeFrameClassRef = FreezeFrame_d41460f8
        DemFreezeFrameRecNumClassRef = FreezeFrameRecNum_8514b953
        DemEventClass:
          DemAgingAllowed = true
          DemAgingCycleCounterThreshold = 40
          DemEventPriority = 2
          DemEventSignificance = DEM_EVENT_SIGNIFICANCE_FAULT
          DemFFPrestorageSupported = false
          DemConsiderPtoStatus = false
          DemAgingCycleRef = Power_On_Off
          DemOperationCycleRef = Power_On_Off
        DemDebounceAlgorithmClass
          DemDebounceCounterBased: DemDebounceCounterBasedClassRef=Counter_Based_Debouncing
      3 x DemDTCClass, all with DemDTCSeverity=DEM_DTC_SEV_NO_SEVERITY, DemImmediateNvStorage=false, DemDTCAttributesRef=DtcAttributes_41914fb7:
        DTCClass_DtcClass_DTC_0x561792: DemUdsDTC=5637014
        DTCClass_DtcClass_DTC_0xD40188: DemUdsDTC=13894024
        DTCClass_DtcClass_DTC_0x560209: DemUdsDTC=5636617
      Counter_Based_Debouncing (DemDebounceCounterBasedClass):
        DemDebounceCounterDecrementStepSize = 20
        DemDebounceCounterIncrementStepSize = 20
        DemDebounceCounterJumpDown = true
        DemDebounceCounterJumpDownValue = 0
        DemDebounceCounterJumpUp = false
        DemDebounceCounterJumpUpValue = 0
        DemDebounceCounterFailedThreshold = 127
        DemDebounceCounterPassedThreshold = -128
        DemDebounceBehavior = DEM_DEBOUNCE_FREEZE
        DemDebounceCounterStorage = false
        DemDebounceContinuous = false
      3 x DemDTCClass, all with DemDTCSeverity=DEM_DTC_SEV_NO_SEVERITY, DemImmediateNvStorage=false, DemDTCAttributesRef=DtcAttributes_41914fb7:
        DTCClass_DtcClass_DTC_0xD40987: DemUdsDTC=13896071
        DTCClass_DtcClass_DTC_0xD4438A: DemUdsDTC=13910922
        DTCClass_DtcClass_DTC_0x560D46: DemUdsDTC=5639494
      ESC_ECU_VDC2_message_Missing_Message (DemEventParameter):
        DemEventKind = DEM_EVENT_KIND_SWC
        DemEventReportingType = STANDARD_REPORTING
        DemEventAvailable = true
        DemEventId = 27
        DemEventAvailableInVariant = true
        DemEventLatchTestFailed = false
        DemEventCreateInfoPort = true
        DemDTCClassRef = DTCClass_DtcClass_DTC_0xD40687
        DemExtendedDataClassRef = ExtendedDataClass_6d15841f
        DemFreezeFrameClassRef = FreezeFrame_d41460f8
        DemFreezeFrameRecNumClassRef = FreezeFrameRecNum_8514b953
        DemEventClass:
          DemAgingAllowed = true
          DemAgingCycleCounterThreshold = 40
          DemEventPriority = 2
          DemEventSignificance = DEM_EVENT_SIGNIFICANCE_FAULT
          DemFFPrestorageSupported = false
          DemConsiderPtoStatus = false
          DemAgingCycleRef = Power_On_Off
          DemOperationCycleRef = Power_On_Off
        DemDebounceAlgorithmClass
          DemDebounceCounterBased: DemDebounceCounterBasedClassRef=Counter_Based_Debouncing
      DTCClass_DtcClass_DTC_0xD40587 (DemDTCClass): DemDTCSeverity=DEM_DTC_SEV_NO_SEVERITY, DemUdsDTC=13895047, DemImmediateNvStorage=false, DemDTCAttributesRef=DtcAttributes_41914fb7
      DTCClass_DtcClass_DTC_0xD4248F (DemDTCClass): DemDTCSeverity=DEM_DTC_SEV_NO_SEVERITY, DemUdsDTC=13902991, DemImmediateNvStorage=false, DemDTCAttributesRef=DtcAttributes_41914fb7
      CLS_TX_16_message_Transmission_Type_info_Invalid_Serial_Data_Received (DemEventParameter):
        DemEventKind = DEM_EVENT_KIND_SWC
        DemEventReportingType = STANDARD_REPORTING
        DemEventAvailable = true
        DemEventId = 8
        DemEventAvailableInVariant = true
        DemEventLatchTestFailed = false
        DemEventCreateInfoPort = true
        DemDTCClassRef = DTCClass_DtcClass_DTC_0xD42781
        DemExtendedDataClassRef = ExtendedDataClass_6d15841f
        DemFreezeFrameClassRef = FreezeFrame_d41460f8
        DemFreezeFrameRecNumClassRef = FreezeFrameRecNum_8514b953
        DemEventClass:
          DemAgingAllowed = true
          DemAgingCycleCounterThreshold = 40
          DemEventPriority = 2
          DemEventSignificance = DEM_EVENT_SIGNIFICANCE_FAULT
          DemFFPrestorageSupported = false
          DemConsiderPtoStatus = false
          DemAgingCycleRef = Power_On_Off
          DemOperationCycleRef = Power_On_Off
        DemDebounceAlgorithmClass
          DemDebounceCounterBased: DemDebounceCounterBasedClassRef=Counter_Based_Debouncing
      DTCClass_DtcClass_DTC_0xD4208F (DemDTCClass): DemDTCSeverity=DEM_DTC_SEV_NO_SEVERITY, DemUdsDTC=13901967, DemImmediateNvStorage=false, DemDTCAttributesRef=DtcAttributes_41914fb7
      Cluster_ECU_CLS_Tx_4_erratic_communication_Erratic (DemEventParameter):
        DemEventKind = DEM_EVENT_KIND_SWC
        DemEventReportingType = STANDARD_REPORTING
        DemEventAvailable = true
        DemEventId = 11
        DemEventAvailableInVariant = true
        DemEventLatchTestFailed = false
        DemEventCreateInfoPort = true
        DemDTCClassRef = DTCClass_DtcClass_DTC_0xD4208F
        DemExtendedDataClassRef = ExtendedDataClass_6d15841f
        DemFreezeFrameClassRef = FreezeFrame_d41460f8
        DemFreezeFrameRecNumClassRef = FreezeFrameRecNum_8514b953
        DemEventClass:
          DemAgingAllowed = true
          DemAgingCycleCounterThreshold = 40
          DemEventPriority = 2
          DemEventSignificance = DEM_EVENT_SIGNIFICANCE_FAULT
          DemFFPrestorageSupported = false
          DemConsiderPtoStatus = false
          DemAgingCycleRef = Power_On_Off
          DemOperationCycleRef = Power_On_Off
        DemDebounceAlgorithmClass
          DemDebounceCounterBased: DemDebounceCounterBasedClassRef=Counter_Based_Debouncing
      DTCClass_DtcClass_DTC_0x561305 (DemDTCClass): DemDTCSeverity=DEM_DTC_SEV_NO_SEVERITY, DemUdsDTC=5640965, DemImmediateNvStorage=false, DemDTCAttributesRef=DtcAttributes_41914fb7
      Cluster_ECU_ADAS_FN_STS_message_Missing_Message (DemEventParameter):
        DemEventKind = DEM_EVENT_KIND_SWC
        DemEventReportingType = STANDARD_REPORTING
        DemEventAvailable = true
        DemEventId = 10
        DemEventAvailableInVariant = true
        DemEventLatchTestFailed = false
        DemEventCreateInfoPort = true
        DemDTCClassRef = DTCClass_DtcClass_DTC_0xD40887
        DemExtendedDataClassRef = ExtendedDataClass_6d15841f
        DemFreezeFrameClassRef = FreezeFrame_d41460f8
        DemFreezeFrameRecNumClassRef = FreezeFrameRecNum_8514b953
        DemEventClass:
          DemAgingAllowed = true
          DemAgingCycleCounterThreshold = 40
          DemEventPriority = 2
          DemEventSignificance = DEM_EVENT_SIGNIFICANCE_FAULT
          DemFFPrestorageSupported = false
          DemConsiderPtoStatus = false
          DemAgingCycleRef = Power_On_Off
          DemOperationCycleRef = Power_On_Off
        DemDebounceAlgorithmClass
          DemDebounceCounterBased: DemDebounceCounterBasedClassRef=Counter_Based_Debouncing
      DTCClass_DtcClass_DTC_0xD43181 (DemDTCClass): DemDTCSeverity=DEM_DTC_SEV_NO_SEVERITY, DemUdsDTC=13906305, DemImmediateNvStorage=false, DemDTCAttributesRef=DtcAttributes_41914fb7
      Vehicle_Dataset_value_of_signal_protection_calculation_Incorrect (DemEventParameter):
        DemEventKind = DEM_EVENT_KIND_SWC
        DemEventReportingType = STANDARD_REPORTING
        DemEventAvailable = true
        DemEventId = 61
        DemEventAvailableInVariant = true
        DemEventLatchTestFailed = false
        DemEventCreateInfoPort = true
        DemDTCClassRef = DTCClass_DtcClass_DTC_0x561583
        DemExtendedDataClassRef = ExtendedDataClass_6d15841f
        DemFreezeFrameClassRef = FreezeFrame_d41460f8
        DemFreezeFrameRecNumClassRef = FreezeFrameRecNum_8514b953
        DemEventClass:
          DemAgingAllowed = true
          DemAgingCycleCounterThreshold = 40
          DemEventPriority = 2
          DemEventSignificance = DEM_EVENT_SIGNIFICANCE_FAULT
          DemFFPrestorageSupported = false
          DemConsiderPtoStatus = false
          DemAgingCycleRef = Power_On_Off
          DemOperationCycleRef = Power_On_Off
        DemDebounceAlgorithmClass
          DemDebounceCounterBased: DemDebounceCounterBasedClassRef=Counter_Based_Debouncing
      DTCClass_DtcClass_DTC_0x560A54 (DemDTCClass): DemDTCSeverity=DEM_DTC_SEV_NO_SEVERITY, DemUdsDTC=5638740, DemImmediateNvStorage=false, DemDTCAttributesRef=DtcAttributes_41914fb7
      Cluster_ECU_CLS_Tx_16_erratic_communication_Erratic (DemEventParameter):
        DemEventKind = DEM_EVENT_KIND_SWC
        DemEventReportingType = STANDARD_REPORTING
        DemEventAvailable = true
        DemEventId = 13
        DemEventAvailableInVariant = true
        DemEventLatchTestFailed = false
        DemEventCreateInfoPort = true
        DemDTCClassRef = DTCClass_DtcClass_DTC_0xD4218F
        DemExtendedDataClassRef = ExtendedDataClass_6d15841f
        DemFreezeFrameClassRef = FreezeFrame_d41460f8
        DemFreezeFrameRecNumClassRef = FreezeFrameRecNum_8514b953
        DemEventClass:
          DemAgingAllowed = true
          DemAgingCycleCounterThreshold = 40
          DemEventPriority = 2
          DemEventSignificance = DEM_EVENT_SIGNIFICANCE_FAULT
          DemFFPrestorageSupported = false
          DemConsiderPtoStatus = false
          DemAgingCycleRef = Power_On_Off
          DemOperationCycleRef = Power_On_Off
        DemDebounceAlgorithmClass
          DemDebounceCounterBased: DemDebounceCounterBasedClassRef=Counter_Based_Debouncing
      DTCClass_DtcClass_DTC_0xD41387 (DemDTCClass): DemDTCSeverity=DEM_DTC_SEV_NO_SEVERITY, DemUdsDTC=13898631, DemImmediateNvStorage=false, DemDTCAttributesRef=DtcAttributes_41914fb7
      Cluster_ECU_OEL_erratic_communication_Erratic (DemEventParameter):
        DemEventKind = DEM_EVENT_KIND_SWC
        DemEventReportingType = STANDARD_REPORTING
        DemEventAvailable = true
        DemEventId = 15
        DemEventAvailableInVariant = true
        DemEventLatchTestFailed = false
        DemEventCreateInfoPort = true
        DemDTCClassRef = DTCClass_DtcClass_DTC_0xD4228F
        DemExtendedDataClassRef = ExtendedDataClass_6d15841f
        DemFreezeFrameClassRef = FreezeFrame_d41460f8
        DemFreezeFrameRecNumClassRef = FreezeFrameRecNum_8514b953
        DemEventClass:
          DemAgingAllowed = true
          DemAgingCycleCounterThreshold = 40
          DemEventPriority = 2
          DemEventSignificance = DEM_EVENT_SIGNIFICANCE_FAULT
          DemFFPrestorageSupported = false
          DemConsiderPtoStatus = false
          DemAgingCycleRef = Power_On_Off
          DemOperationCycleRef = Power_On_Off
        DemDebounceAlgorithmClass
          DemDebounceCounterBased: DemDebounceCounterBasedClassRef=Counter_Based_Debouncing
      DTCClass_DtcClass_DTC_0x560F76 (DemDTCClass): DemDTCSeverity=DEM_DTC_SEV_NO_SEVERITY, DemUdsDTC=5640054, DemImmediateNvStorage=false, DemDTCAttributesRef=DtcAttributes_41914fb7
      DTCClass_DtcClass_DTC_0xD43681 (DemDTCClass): DemDTCSeverity=DEM_DTC_SEV_NO_SEVERITY, DemUdsDTC=13907585, DemImmediateNvStorage=false, DemDTCAttributesRef=DtcAttributes_41914fb7
      Cluster_ECU_CLS_Tx_4_message_Missing_Message (DemEventParameter):
        DemEventKind = DEM_EVENT_KIND_SWC
        DemEventReportingType = STANDARD_REPORTING
        DemEventAvailable = true
        DemEventId = 12
        DemEventAvailableInVariant = true
        DemEventLatchTestFailed = false
        DemEventCreateInfoPort = true
        DemDTCClassRef = DTCClass_DtcClass_DTC_0xD41087
        DemExtendedDataClassRef = ExtendedDataClass_6d15841f
        DemFreezeFrameClassRef = FreezeFrame_d41460f8
        DemFreezeFrameRecNumClassRef = FreezeFrameRecNum_8514b953
        DemEventClass:
          DemAgingAllowed = true
          DemAgingCycleCounterThreshold = 40
          DemEventPriority = 2
          DemEventSignificance = DEM_EVENT_SIGNIFICANCE_FAULT
          DemFFPrestorageSupported = false
          DemConsiderPtoStatus = false
          DemAgingCycleRef = Power_On_Off
          DemOperationCycleRef = Power_On_Off
        DemDebounceAlgorithmClass
          DemDebounceCounterBased: DemDebounceCounterBasedClassRef=Counter_Based_Debouncing
      DTCClass_DtcClass_DTC_0x561092 (DemDTCClass): DemDTCSeverity=DEM_DTC_SEV_NO_SEVERITY, DemUdsDTC=5640338, DemImmediateNvStorage=false, DemDTCAttributesRef=DtcAttributes_41914fb7
      4 x DemEventParameter, all with DemEventKind=DEM_EVENT_KIND_SWC, DemEventReportingType=STANDARD_REPORTING, DemEventAvailable=true, DemEventAvailableInVariant=true, DemEventLatchTestFailed=false, DemEventCreateInfoPort=true, DemExtendedDataClassRef=ExtendedDataClass_6d15841f, DemFreezeFrameClassRef=FreezeFrame_d41460f8, DemFreezeFrameRecNumClassRef=FreezeFrameRecNum_8514b953:
        Radar_Performance_Capability_Algorithm_Based_Failure: DemEventId=46, DemDTCClassRef=DTCClass_DtcClass_DTC_0x560106
          DemEventClass:
            DemAgingAllowed = true
            DemAgingCycleCounterThreshold = 40
            DemEventPriority = 2
            DemEventSignificance = DEM_EVENT_SIGNIFICANCE_FAULT
            DemFFPrestorageSupported = false
            DemConsiderPtoStatus = false
            DemAgingCycleRef = Power_On_Off
            DemOperationCycleRef = Power_On_Off
          DemDebounceAlgorithmClass
            DemDebounceCounterBased: DemDebounceCounterBasedClassRef=Counter_Based_Debouncing
        Radar_AutoAlignment_Range_Alignment_or_Adjustement_Incorrect: DemEventId=37, DemDTCClassRef=DTCClass_DtcClass_DTC_0x560B78
          DemEventClass:
            DemAgingAllowed = true
            DemAgingCycleCounterThreshold = 40
            DemEventPriority = 2
            DemEventSignificance = DEM_EVENT_SIGNIFICANCE_FAULT
            DemFFPrestorageSupported = false
            DemConsiderPtoStatus = false
            DemAgingCycleRef = Power_On_Off
            DemOperationCycleRef = Power_On_Off
          DemDebounceAlgorithmClass
            DemDebounceCounterBased: DemDebounceCounterBasedClassRef=Counter_Based_Debouncing
        EMS_ECU_CCVS1_erratic_communication_Erractic: DemEventId=20, DemDTCClassRef=DTCClass_DtcClass_DTC_0xD4158F
          DemEventClass:
            DemAgingAllowed = true
            DemAgingCycleCounterThreshold = 40
            DemEventPriority = 2
            DemEventSignificance = DEM_EVENT_SIGNIFICANCE_FAULT
            DemFFPrestorageSupported = false
            DemConsiderPtoStatus = false
            DemAgingCycleRef = Power_On_Off
            DemOperationCycleRef = Power_On_Off
          DemDebounceAlgorithmClass
            DemDebounceCounterBased: DemDebounceCounterBasedClassRef=Counter_Based_Debouncing
        Radar_System_Battery_Low_Voltage_System_Voltage_Low: DemEventId=51, DemDTCClassRef=DTCClass_DtcClass_DTC_0x5608A2
          DemEventClass:
            DemAgingAllowed = true
            DemAgingCycleCounterThreshold = 40
            DemEventPriority = 2
            DemEventSignificance = DEM_EVENT_SIGNIFICANCE_FAULT
            DemFFPrestorageSupported = false
            DemConsiderPtoStatus = false
            DemAgingCycleRef = Power_On_Off
            DemOperationCycleRef = Power_On_Off
          DemDebounceAlgorithmClass
            DemDebounceCounterBased: DemDebounceCounterBasedClassRef=Counter_Based_Debouncing
      3 x DemDTCClass, all with DemDTCSeverity=DEM_DTC_SEV_NO_SEVERITY, DemImmediateNvStorage=false, DemDTCAttributesRef=DtcAttributes_41914fb7:
        DTCClass_DtcClass_DTC_0x560B78: DemUdsDTC=5639032
        DTCClass_DtcClass_DTC_0x561792_001: DemUdsDTC=5637266
        DTCClass_DtcClass_DTC_0x561655: DemUdsDTC=5641813
      Radar_SMC_General_Checksum_Failure (DemEventParameter):
        DemEventKind = DEM_EVENT_KIND_SWC
        DemEventReportingType = STANDARD_REPORTING
        DemEventAvailable = true
        DemEventId = 49
        DemEventAvailableInVariant = true
        DemEventLatchTestFailed = false
        DemEventCreateInfoPort = true
        DemDTCClassRef = DTCClass_DtcClass_DTC_0x560E41
        DemExtendedDataClassRef = ExtendedDataClass_6d15841f
        DemFreezeFrameClassRef = FreezeFrame_d41460f8
        DemFreezeFrameRecNumClassRef = FreezeFrameRecNum_8514b953
        DemEventClass:
          DemAgingAllowed = true
          DemAgingCycleCounterThreshold = 40
          DemEventPriority = 2
          DemEventSignificance = DEM_EVENT_SIGNIFICANCE_FAULT
          DemFFPrestorageSupported = false
          DemConsiderPtoStatus = false
          DemAgingCycleRef = Power_On_Off
          DemOperationCycleRef = Power_On_Off
        DemDebounceAlgorithmClass
          DemDebounceCounterBased: DemDebounceCounterBasedClassRef=Counter_Based_Debouncing
      DTCClass_DtcClass_DTC_0xD4178F (DemDTCClass): DemDTCSeverity=DEM_DTC_SEV_NO_SEVERITY, DemUdsDTC=13899663, DemImmediateNvStorage=false, DemDTCAttributesRef=DtcAttributes_41914fb7
      Radar_Pin_Position_Wrong_Mounting_Position (DemEventParameter):
        DemEventKind = DEM_EVENT_KIND_SWC
        DemEventReportingType = STANDARD_REPORTING
        DemEventAvailable = true
        DemEventId = 47
        DemEventAvailableInVariant = true
        DemEventLatchTestFailed = false
        DemEventCreateInfoPort = true
        DemDTCClassRef = DTCClass_DtcClass_DTC_0x560F76
        DemExtendedDataClassRef = ExtendedDataClass_6d15841f
        DemFreezeFrameClassRef = FreezeFrame_d41460f8
        DemFreezeFrameRecNumClassRef = FreezeFrameRecNum_8514b953
        DemEventClass:
          DemAgingAllowed = true
          DemAgingCycleCounterThreshold = 40
          DemEventPriority = 2
          DemEventSignificance = DEM_EVENT_SIGNIFICANCE_FAULT
          DemFFPrestorageSupported = false
          DemConsiderPtoStatus = false
          DemAgingCycleRef = Power_On_Off
          DemOperationCycleRef = Power_On_Off
        DemDebounceAlgorithmClass
          DemDebounceCounterBased: DemDebounceCounterBasedClassRef=Counter_Based_Debouncing
      VDC2_message_Lateral_Accleration_Invalid_Serial_Data_Received (DemEventParameter):
        DemEventKind = DEM_EVENT_KIND_SWC
        DemEventReportingType = STANDARD_REPORTING
        DemEventAvailable = true
        DemEventId = 57
        DemEventAvailableInVariant = true
        DemEventLatchTestFailed = false
        DemEventCreateInfoPort = true
        DemDTCClassRef = DTCClass_DtcClass_DTC_0xD43481
        DemExtendedDataClassRef = ExtendedDataClass_6d15841f
        DemFreezeFrameClassRef = FreezeFrame_d41460f8
        DemFreezeFrameRecNumClassRef = FreezeFrameRecNum_8514b953
        DemEventClass:
          DemAgingAllowed = true
          DemAgingCycleCounterThreshold = 40
          DemEventPriority = 2
          DemEventSignificance = DEM_EVENT_SIGNIFICANCE_FAULT
          DemFFPrestorageSupported = false
          DemConsiderPtoStatus = false
          DemAgingCycleRef = Power_On_Off
          DemOperationCycleRef = Power_On_Off
        DemDebounceAlgorithmClass
          DemDebounceCounterBased: DemDebounceCounterBasedClassRef=Counter_Based_Debouncing
      3 x DemDTCClass, all with DemDTCSeverity=DEM_DTC_SEV_NO_SEVERITY, DemImmediateNvStorage=false, DemDTCAttributesRef=DtcAttributes_41914fb7:
        DTCClass_DtcClass_DTC_0xD42981: DemUdsDTC=13904257
        DTCClass_DtcClass_DTC_0x560E41: DemUdsDTC=5639745
        DTCClass_DtcClass_DTC_0xD40288: DemUdsDTC=13894280
      ADAS_FN_STS_message_BSIS_FN_Switch_STS_Invalid_Serial_Data_Received (DemEventParameter):
        DemEventKind = DEM_EVENT_KIND_SWC
        DemEventReportingType = STANDARD_REPORTING
        DemEventAvailable = true
        DemEventId = 1
        DemEventAvailableInVariant = true
        DemEventLatchTestFailed = false
        DemEventCreateInfoPort = true
        DemDTCClassRef = DTCClass_DtcClass_DTC_0xD43681
        DemExtendedDataClassRef = ExtendedDataClass_6d15841f
        DemFreezeFrameClassRef = FreezeFrame_d41460f8
        DemFreezeFrameRecNumClassRef = FreezeFrameRecNum_8514b953
        DemEventClass:
          DemAgingAllowed = true
          DemAgingCycleCounterThreshold = 40
          DemEventPriority = 2
          DemEventSignificance = DEM_EVENT_SIGNIFICANCE_FAULT
          DemFFPrestorageSupported = false
          DemConsiderPtoStatus = false
          DemAgingCycleRef = Power_On_Off
          DemOperationCycleRef = Power_On_Off
        DemDebounceAlgorithmClass
          DemDebounceCounterBased: DemDebounceCounterBasedClassRef=Counter_Based_Debouncing
      DTCClass_DtcClass_DTC_0xD40687 (DemDTCClass): DemDTCSeverity=DEM_DTC_SEV_NO_SEVERITY, DemUdsDTC=13895303, DemImmediateNvStorage=false, DemDTCAttributesRef=DtcAttributes_41914fb7
      DTCClass_DtcClass_DTC_0xD4258F (DemDTCClass): DemDTCSeverity=DEM_DTC_SEV_NO_SEVERITY, DemUdsDTC=13903247, DemImmediateNvStorage=false, DemDTCAttributesRef=DtcAttributes_41914fb7
      Radar_AutoAlignment_Misalignment_Performance_or_Incorrect_Operation (DemEventParameter):
        DemEventKind = DEM_EVENT_KIND_SWC
        DemEventReportingType = STANDARD_REPORTING
        DemEventAvailable = true
        DemEventId = 36
        DemEventAvailableInVariant = true
        DemEventLatchTestFailed = false
        DemEventCreateInfoPort = true
        DemDTCClassRef = DTCClass_DtcClass_DTC_0x561092
        DemExtendedDataClassRef = ExtendedDataClass_6d15841f
        DemFreezeFrameClassRef = FreezeFrame_d41460f8
        DemFreezeFrameRecNumClassRef = FreezeFrameRecNum_8514b953
        DemEventClass:
          DemAgingAllowed = true
          DemAgingCycleCounterThreshold = 40
          DemEventPriority = 2
          DemEventSignificance = DEM_EVENT_SIGNIFICANCE_FAULT
          DemFFPrestorageSupported = false
          DemConsiderPtoStatus = false
          DemAgingCycleRef = Power_On_Off
          DemOperationCycleRef = Power_On_Off
        DemDebounceAlgorithmClass
          DemDebounceCounterBased: DemDebounceCounterBasedClassRef=Counter_Based_Debouncing
      3 x DemDTCClass, all with DemDTCSeverity=DEM_DTC_SEV_NO_SEVERITY, DemImmediateNvStorage=false, DemDTCAttributesRef=DtcAttributes_41914fb7:
        DTCClass_DtcClass_DTC_0xD4218F: DemUdsDTC=13902223
        DTCClass_DtcClass_DTC_0xD4004B: DemUdsDTC=13893707
        DTCClass_DtcClass_DTC_0xD43281: DemUdsDTC=13906561
      6 x DemEventParameter, all with DemEventKind=DEM_EVENT_KIND_SWC, DemEventReportingType=STANDARD_REPORTING, DemEventAvailable=true, DemEventAvailableInVariant=true, DemEventLatchTestFailed=false, DemEventCreateInfoPort=true, DemExtendedDataClassRef=ExtendedDataClass_6d15841f, DemFreezeFrameClassRef=FreezeFrame_d41460f8, DemFreezeFrameRecNumClassRef=FreezeFrameRecNum_8514b953:
        ESC_ECU_VDC2_erratic_communication_Erratic: DemEventId=26, DemDTCClassRef=DTCClass_DtcClass_DTC_0xD4188F
          DemEventClass:
            DemAgingAllowed = true
            DemAgingCycleCounterThreshold = 40
            DemEventPriority = 2
            DemEventSignificance = DEM_EVENT_SIGNIFICANCE_FAULT
            DemFFPrestorageSupported = false
            DemConsiderPtoStatus = false
            DemAgingCycleRef = Power_On_Off
            DemOperationCycleRef = Power_On_Off
          DemDebounceAlgorithmClass
            DemDebounceCounterBased: DemDebounceCounterBasedClassRef=Counter_Based_Debouncing
        Application_Interface_Lookup_Performance_or_Incorrect_Operation: DemEventId=6, DemDTCClassRef=DTCClass_DtcClass_DTC_0x561792_001
          DemEventClass:
            DemAgingAllowed = true
            DemAgingCycleCounterThreshold = 40
            DemEventPriority = 2
            DemEventSignificance = DEM_EVENT_SIGNIFICANCE_FAULT
            DemFFPrestorageSupported = false
            DemConsiderPtoStatus = false
            DemAgingCycleRef = Power_On_Off
            DemOperationCycleRef = Power_On_Off
          DemDebounceAlgorithmClass
            DemDebounceCounterBased: DemDebounceCounterBasedClassRef=Counter_Based_Debouncing
        EMS_ECU_VD_message_Missing_Message: DemEventId=25, DemDTCClassRef=DTCClass_DtcClass_DTC_0xD40587
          DemEventClass:
            DemAgingAllowed = true
            DemAgingCycleCounterThreshold = 40
            DemEventPriority = 2
            DemEventSignificance = DEM_EVENT_SIGNIFICANCE_FAULT
            DemFFPrestorageSupported = false
            DemConsiderPtoStatus = false
            DemAgingCycleRef = Power_On_Off
            DemOperationCycleRef = Power_On_Off
          DemDebounceAlgorithmClass
            DemDebounceCounterBased: DemDebounceCounterBasedClassRef=Counter_Based_Debouncing
        Radar_Platform_Time_System_Programming_Failure: DemEventId=48, DemDTCClassRef=DTCClass_DtcClass_DTC_0x561305
          DemEventClass:
            DemAgingAllowed = true
            DemAgingCycleCounterThreshold = 40
            DemEventPriority = 2
            DemEventSignificance = DEM_EVENT_SIGNIFICANCE_FAULT
            DemFFPrestorageSupported = false
            DemConsiderPtoStatus = false
            DemAgingCycleRef = Power_On_Off
            DemOperationCycleRef = Power_On_Off
          DemDebounceAlgorithmClass
            DemDebounceCounterBased: DemDebounceCounterBasedClassRef=Counter_Based_Debouncing
        OEL_message_Turn_Signal_Switch_Invalid_Serial_Data_Received: DemEventId=32, DemDTCClassRef=DTCClass_DtcClass_DTC_0xD43181
          DemEventClass:
            DemAgingAllowed = true
            DemAgingCycleCounterThreshold = 40
            DemEventPriority = 2
            DemEventSignificance = DEM_EVENT_SIGNIFICANCE_FAULT
            DemFFPrestorageSupported = false
            DemConsiderPtoStatus = false
            DemAgingCycleRef = Power_On_Off
            DemOperationCycleRef = Power_On_Off
          DemDebounceAlgorithmClass
            DemDebounceCounterBased: DemDebounceCounterBasedClassRef=Counter_Based_Debouncing
        Radar_calibration_Calibration_or_Paramater_Memory_Failure: DemEventId=52, DemDTCClassRef=DTCClass_DtcClass_DTC_0x560D46
          DemEventClass:
            DemAgingAllowed = true
            DemAgingCycleCounterThreshold = 40
            DemEventPriority = 2
            DemEventSignificance = DEM_EVENT_SIGNIFICANCE_FAULT
            DemFFPrestorageSupported = false
            DemConsiderPtoStatus = false
            DemAgingCycleRef = Power_On_Off
            DemOperationCycleRef = Power_On_Off
          DemDebounceAlgorithmClass
            DemDebounceCounterBased: DemDebounceCounterBasedClassRef=Counter_Based_Debouncing
      DemJ1939NodeAddress: DemJ1939NmNodeRef=J1939NmNode
      DemEventParameter:
        DemEventReportingType = STANDARD_REPORTING
        DemEventAvailable = true
        DemEventId = 62
        DemEventKind = DEM_EVENT_KIND_SWC
        DemEventAvailableInVariant = true
        DemEventLatchTestFailed = false
        DemEventCreateInfoPort = true
        DemDTCClassRef = DemDTCClass
        DemEventClass:
          DemAgingAllowed = false
          DemConsiderPtoStatus = false
          DemEventPriority = 2
          DemFFPrestorageSupported = false
          DemOperationCycleRef = Power_On_Off
          DemAgingCycleRef = Power_On_Off
        DemDebounceAlgorithmClass
          DemDebounceMonitorInternal
      DemDTCClass: DemImmediateNvStorage=false, DemUdsDTC=1193046, DemDTCAttributesRef=DemDTCAttributes, DemJ1939DTC_NodeAddressRef=DemJ1939NodeAddress
