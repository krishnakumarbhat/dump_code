AUTOSAR XML (schema 00053)
package /ActiveEcuC
  module config Cdd: implementation-config-variant=VARIANT-PRE-COMPILE, module-description=Cdd_Impl
    CddComStackContribution
      CddSoAdUpperLayerContribution
        RDR_LOGGING_TX (CddSoAdUpperLayerTxPdu): CddPduRApiType=IF, CddSoAdUpperLayerHandleId=1, CddSoAdUpperLayerPduRef=RDR_LOGGING_TX
        RDR_VEH_UDP_STREAM_RX (CddSoAdUpperLayerRxPdu): CddPduRApiType=IF, CddSoAdUpperLayerHandleId=1, CddSoAdUpperLayerPduRef=RDR_VEH_UDP_STREAM_RX
        RDR_LOGGING_TX_FAST (CddSoAdUpperLayerTxPdu): CddPduRApiType=IF, CddSoAdUpperLayerHandleId=2, CddSoAdUpperLayerPduRef=RDR_LOGGING_TX_FAST
        RDR_HIL_Req_RX (CddSoAdUpperLayerRxPdu): CddPduRApiType=IF, CddSoAdUpperLayerHandleId=0, CddSoAdUpperLayerPduRef=RDR_HIL_Req_RX
        RDR_HIL_Res_Tx (CddSoAdUpperLayerTxPdu): CddPduRApiType=IF, CddSoAdUpperLayerHandleId=0, CddSoAdUpperLayerPduRef=RDR_HIL_Res_Tx
