AUTOSAR XML (schema 00053)
package /ActiveEcuC
  module config CanSM: implementation-config-variant=VARIANT-PRE-COMPILE, module-description=CanSM_Impl
    CanSMGeneral:
      CanSMDevErrorDetect = false
      CanSMMainFunctionTimePeriod = 0.01
      CanSMVersionInfoApi = false
      CanSMBorCheckLevel = false
      CanSMSafeBswChecks = false
      CanSMSetBaudrateApi = false
      CanSmChangeBaudrateApi = false
      CanSMEcuPassiveMode = false
      CanSMExtendedRamCheck = false
      CanSMBusOffEnd = J1939Nm_BusOffEnd
      CanSMGetBusOffDelayFunction = J1939Nm_GetBusOffDelay
      CanSMGeneration: CanSMOutOfBoundsWriteSanitizer=false, CanSMOutOfBoundsReadSanitizer=false
    CanSMConfiguration: CanSMModeRequestRepetitionMax=10, CanSMModeRequestRepetitionTime=0.1
      CanSMManagerNetwork:
        CanSMBorCounterL1ToL2 = 5
        CanSMBorTimeL1 = 0.05
        CanSMBorTimeL2 = 0.2
        CanSMBorTimeTxEnsured = 0.07
        CanSMBorTxConfirmationPolling = false
        CanSMComMNetworkHandleRef = CN_PCAN_RADAR_458ff0f1
        CanSMController: CanSMControllerId=CT_PCAN_RADAR_a3a0f56c
        CanSMDemEventParameterRefs: CANSM_E_BUS_OFF=PCAN_Communication_Bus_Off
      CHNL_0829f689 (CanSMManagerNetwork):
        CanSMBorCounterL1ToL2 = 5
        CanSMBorTimeL1 = 0.05
        CanSMBorTimeL2 = 0.2
        CanSMBorTimeTxEnsured = 0.07
        CanSMBorTxConfirmationPolling = false
        CanSMComMNetworkHandleRef = CN_VCAN_RADAR_489180b6
        CT_VCAN_RADAR_a6a4a2e0 (CanSMController): CanSMControllerId=CT_VCAN_RADAR_a3a0f56c
        CanSMDemEventParameterRefs: CANSM_E_BUS_OFF=VCAN_Communication_Bus_Off
