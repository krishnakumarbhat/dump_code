AUTOSAR XML (schema 00053)
package /ActiveEcuC
  module config TcpIp: implementation-config-variant=VARIANT-PRE-COMPILE, module-description=TcpIp_Impl
    TcpIpConfig
      TcpIpSocketOwnerConfig
        SoAd (TcpIpSocketOwner):
          TcpIpSocketOwnerUpperLayerType = SOAD
          TcpIpSocketOwnerId = 0
          TcpIpSocketOwnerTcpIpEventName = SoAd_TcpIpEvent
          TcpIpSocketOwnerTcpListenSocketMax = 0
          TcpIpSocketOwnerCopyTxDataDynamicLengthEnabled = false
          TcpIpSocketOwnerLocalIpAddrAssignmentChgName = SoAd_LocalIpAddrAssignmentChg
          TcpIpSocketOwnerCopyTxDataName = SoAd_CopyTxData
          TcpIpSocketOwnerTxConfirmationName = SoAd_TxConfirmation
          TcpIpSocketOwnerRxIndicationName = SoAd_RxIndication
          TcpIpSocketOwnerTcpAcceptedName = SoAd_TcpAccepted
          TcpIpSocketOwnerHeaderFileName = SoAd_Cbk.h
          TcpIpSocketOwnerTcpConnectedName = SoAd_TcpConnected
      TcpIpUdpConfig: TcpIpUdpTtl=64, TcpIpUdpPortMin=49152, TcpIpUdpPortMax=65535, TcpIpUdpTxRetryQueueSize=1
      TcpIpIpConfig
        TcpIpIpV4Config
          TcpIpArpConfig:
            TcpIpArpNumGratuitousARPonStartup = 0
            TcpIpArpPacketQueueEnabled = true
            TcpIpArpTableEntryTimeout = 0
            TcpIpArpTableSizeMax = 10
            TcpIpArpRetryTime = 600
            TcpIpArpRetryInterval = 2
            TcpIpArpRequestTimeout = 2
          TcpIpIcmpConfig: TcpIpIcmpTtl=64, TcpIpIcmpEchoReplyMaxLen=32, TcpIpIcmpDestinationUnreachableEnabled=false, TcpIpIcmpEchoReplyEnabled=true
      TcpIpV4LocalAddr_RDR_EthConnector1_fbdc15b4_Broadcast (TcpIpLocalAddr):
        TcpIpAddrId = 3
        TcpIpAddressType = TCPIP_IPV4_BROADCAST
        TcpIpDomainType = TCPIP_AF_INET
        TcpIpIpAddrReceiveAllNotConfiguredMulticasts = false
        TcpIpCtrlRef = cnctr_RDR_RdrNet_1bd20df5
        TcpIpAddrAssignment: TcpIpAssignmentMethod=TCPIP_STATIC, TcpIpAssignmentPriority=1, TcpIpAssignmentTrigger=TCPIP_AUTOMATIC
      NEP_SRR_1_RdrNet_Unicast_48476027 (TcpIpLocalAddr):
        TcpIpAddressType = TCPIP_UNICAST
        TcpIpDomainType = TCPIP_AF_INET
        TcpIpAddrId = 0
        TcpIpIpAddrReceiveAllNotConfiguredMulticasts = false
        TcpIpCtrlRef = cnctr_RDR_RdrNet_1bd20df5
        TcpIpStaticIpAddressConfig: TcpIpNetmask=24, TcpIpStaticIpAddress=192.168.1.71
        NEP_SRR_1_RdrNet_Unicast_18741e21 (TcpIpAddrAssignment): TcpIpAssignmentMethod=TCPIP_STATIC, TcpIpAssignmentPriority=1, TcpIpAssignmentTrigger=TCPIP_MANUAL
      cnctr_RDR_RdrNet_1bd20df5 (TcpIpCtrl): TcpIpIpFramePrioDefault=0, TcpIpEthIfCtrlRef=cnctr_RDR_RdrNet_5172a59b
        TcpIpIpVXCtrl
          TcpIpIpV4Ctrl: TcpIpIpTypeOfServiceDefault=0, TcpIpIpCtrlIdx=0, TcpIpIpDefaultTtl=255, TcpIpIpDisableDhcpIfTcpConnected=false, TcpIpArpConfigRef=TcpIpArpConfig
      NEP_ADAS_RdrNet_CtrlRxMulticast_91909614 (TcpIpLocalAddr):
        TcpIpAddressType = TCPIP_MULTICAST
        TcpIpDomainType = TCPIP_AF_INET
        TcpIpAddrId = 1
        TcpIpIpAddrReceiveAllNotConfiguredMulticasts = false
        TcpIpCtrlRef = cnctr_RDR_RdrNet_1bd20df5
        NEP_ADAS_RdrNet_CtrlRxMulticast_64354140 (TcpIpAddrAssignment): TcpIpAssignmentMethod=TCPIP_STATIC, TcpIpAssignmentPriority=1, TcpIpAssignmentTrigger=TCPIP_AUTOMATIC
        TcpIpStaticIpAddressConfig: TcpIpStaticIpAddress=239.192.255.251
      NEP_ANY_IP_c7cdbb5a (TcpIpLocalAddr):
        TcpIpDomainType = TCPIP_AF_INET
        TcpIpAddrId = 2
        TcpIpAddressType = TCPIP_MULTICAST
        TcpIpIpAddrReceiveAllNotConfiguredMulticasts = false
        TcpIpCtrlRef = cnctr_RDR_RdrNet_1bd20df5
        NEP_ANY_IP_39604494 (TcpIpAddrAssignment): TcpIpAssignmentMethod=TCPIP_STATIC, TcpIpAssignmentPriority=1, TcpIpAssignmentTrigger=TCPIP_MANUAL
    TcpIpGeneral:
      TcpIpUdpEnabled = true
      TcpIpBufferMemory = 0
      TcpIpDevErrorDetect = true
      TcpIpDhcpServerEnabled = false
      TcpIpMainFunctionPeriod = 0.005
      TcpIpResetIpAssignmentApi = false
      TcpIpScalabilityClass = SC1
      TcpIpTcpEnabled = false
      TcpIpTcpSocketMax = 0
      TcpIpUdpSocketMax = 7
      TcpIpVersionInfoApi = false
      TcpIpRandNoFct = Appl_Crypto_GetRandNo
      TcpIpRandNoFctIncludeFile = Appl_Rand.h
      TcpIpDiagExtensionsEnabled = false
      TcpIpLowerLayerName = EthIf
      TcpIpMainFunctionSplitEnabled = false
      TcpIpSafeBswChecks = true
      TcpIpGetDhcpStatusApi = false
      TcpIpIpSecEnabled = false
      TcpIpGetAndResetMeasurementDataApi = false
      TcpIpAsrTlsEnabled = false
      TcpIpMultiCoreSupportEnabled = false
      TcpIpCsmAccessIndirectionPrefix = Csm
      TcpIpEnableSecurityEventReporting = false
      TcpIpGeneration:
        TcpIpOutOfBoundsWriteProtectionStrategy = NONE
        TcpIpOutOfBoundsWriteSanitizer = false
        TcpIpOutOfBoundsReadSanitizer = false
        TcpIpReduceConstantData2Define = false
        TcpIpBoolDataInArrayOfStructStrategy = BITMASKING
        TcpIpDeduplicateIndirectedData = true
        TcpIpDataDeduplicationStrategy = NONE
        TcpIpReduceBoolDataByNegationThreshold = 2
        TcpIpReduceBoolDataByNumericalComparisonThreshold = 2
        TcpIpReduceBoolDataByNumericalRelationThreshold = 2
        TcpIpReduceBoolDataByNumericalOperandStrategy = DEDUPLICATE_DATA_WITH_ANY_VALUE
        TcpIpReduceNumericalDataByOffsetThreshold = 0
        TcpIpReduceNumericalDataByArraySubtractionThreshold = 2
        TcpIpReduceDataByStreaming = false
        TcpIpShortSymbols = false
        TcpIpInterfacesForDeactivatedData = false
        TcpIpReferringKeysInComments = false
        TcpIpEnableAdditionalRAMDebugData = false
      TcpIpIpV6General:
        TcpIpDhcpV6ClientEnabled = false
        TcpIpIpV6Enabled = false
        TcpIpIpV6PathMtuDiscoveryEnabled = false
        TcpIpLocalAddrIpv6EntriesMax = 0
        TcpIpNdpAddressResolutionUnrechabilityDetectionEnabled = true
        TcpIpNdpPrefixAndRouterDiscoveryEnabled = true
        TcpIpIpV6EthIfUpdatePhysAddrFilterApiEnabled = true
        TcpIpIpV6SetTrafficClassAndFlowLabelApiEnabled = false
        TcpIpIpV6ExtendedDestAddrValidationEnabled = false
        TcpIpIpV6CacheLookupOptimizationEnabled = true
      TcpIpIpV4General:
        TcpIpIpV4Enabled = true
        TcpIpArpEnabled = true
        TcpIpAutoIpEnabled = false
        TcpIpDhcpClientEnabled = false
        TcpIpIcmpEnabled = false
        TcpIpLocalAddrIpv4EntriesMax = 4
        TcpIpPathMtuDiscoveryEnabled = false
        TcpIpIpV4EthIfUpdatePhysAddrFilterApiEnabled = true
        TcpIpArpDiscardedEntryHandling = false
