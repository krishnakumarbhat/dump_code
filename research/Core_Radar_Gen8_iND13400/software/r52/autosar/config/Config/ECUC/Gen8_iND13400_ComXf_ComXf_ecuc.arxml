AUTOSAR XML (schema 00053)
package /ActiveEcuC
  module config ComXf: implementation-config-variant=VARIANT-PRE-COMPILE, module-description=ComXf_Impl
    XfrmGeneral: XfrmDevErrorDetect=true, XfrmVersionInfoApi=false
