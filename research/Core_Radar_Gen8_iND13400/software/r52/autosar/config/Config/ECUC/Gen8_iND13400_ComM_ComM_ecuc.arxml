AUTOSAR XML (schema 00053)
package /ActiveEcuC
  module config ComM: implementation-config-variant=VARIANT-PRE-COMPILE, module-description=ComM_Impl
    ComMGeneral:
      ComMPncIdCounting = COMM_PNC_ID_COUNT_FROM_NM_MESSAGE
      ComMPncSupport = false
      ComMDevErrorDetect = true
      ComMEcuGroupClassification = 3
      ComMModeLimitationEnabled = false
      ComMSynchronousWakeUp = false
      ComMTMinFullComModeDuration = 5
      ComMVersionInfoApi = false
      ComMWakeupInhibitionEnabled = false
      ComMSafeBswChecks = true
      ComMExtendedRamCheck = false
      ComMGeneration: ComMOutOfBoundsWriteSanitizer=false, ComMOutOfBoundsReadSanitizer=false
    ComMConfigSet: ComMPncEnabled=false
      CN_PCAN_RADAR_d6cf874b (ComMUser): ComMUserIdentifier=1, ComMUserModeNotification=false
      CN_PCAN_RADAR_458ff0f1 (ComMChannel):
        ComMBusType = COMM_BUS_TYPE_CAN
        ComMChannelId = 1
        ComMFullCommRequestNotificationEnabled = false
        ComMMainFunctionPeriod = 0.02
        ComMNoCom = false
        ComMNoWakeup = false
        CN_PCAN_RADAR_5dcc26a8 (ComMUserPerChannel): ComMUserChannel=CN_PCAN_RADAR_d6cf874b
        ComMNetworkManagement: ComMNmVariant=NONE, ComMPncNmRequest=false
      cnctr_RDR_RdrNet_5172a59b (ComMChannel):
        ComMBusType = COMM_BUS_TYPE_ETH
        ComMChannelId = 0
        ComMPncGatewayType = COMM_GATEWAY_TYPE_NONE
        ComMFullCommRequestNotificationEnabled = false
        ComMMainFunctionPeriod = 0.02
        ComMNoCom = false
        ComMNoWakeup = false
        ComMNetworkManagement: ComMNmVariant=NONE, ComMPncNmRequest=false
        cnctr_RDR_RdrNet_c5113eef (ComMUserPerChannel): ComMUserChannel=cnctr_RDR_RdrNet_9faa6a47
      cnctr_RDR_RdrNet_9faa6a47 (ComMUser): ComMUserIdentifier=0, ComMUserModeNotification=false
      CN_VCAN_RADAR_489180b6 (ComMChannel):
        ComMBusType = COMM_BUS_TYPE_CAN
        ComMChannelId = 2
        ComMFullCommRequestNotificationEnabled = false
        ComMMainFunctionPeriod = 0.02
        ComMNoCom = false
        ComMNoWakeup = false
        ComMNetworkManagement: ComMNmVariant=NONE, ComMPncNmRequest=false
        CN_VCAN_RADAR_ccadf631 (ComMUserPerChannel): ComMUserChannel=CN_VCAN_RADAR_4b138c58
      CN_VCAN_RADAR_4b138c58 (ComMUser): ComMUserIdentifier=2, ComMUserModeNotification=false
