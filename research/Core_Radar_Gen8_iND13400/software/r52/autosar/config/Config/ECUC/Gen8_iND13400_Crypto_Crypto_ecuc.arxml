AUTOSAR XML (schema 00053)
package /ActiveEcuC
  module config Crypto: implementation-config-variant=VARIANT-PRE-COMPILE, module-description=Crypto_Impl
    CryptoDriverObjects
      Crypto_182_iND13400_SymmetricDriverObject (CryptoDriverObject):
        CryptoDriverObjectId = 0
        CryptoQueueSize = 0
        CryptoPrimitiveRef = AesEncrypt
        CryptoPrimitiveRef = RNG
        CryptoPrimitiveRef = AesDecrypt
        CryptoPrimitiveRef = AEADGCMDecrypt
        CryptoPrimitiveRef = AEADGCMEncrypt
        CryptoPrimitiveRef = AesEncrypt
        CryptoPrimitiveRef = MacGenerate
        CryptoPrimitiveRef = MacVerify
      Crypto_182_iND13400_AsymmetricDriverObject (CryptoDriverObject):
        CryptoDriverObjectId = 1
        CryptoQueueSize = 0
        CryptoPrimitiveRef = SHA2_224
        CryptoPrimitiveRef = SHA2_256
        CryptoPrimitiveRef = SHA2_384
        CryptoPrimitiveRef = SHA2_512
        CryptoPrimitiveRef = SHA2_512_224
        CryptoPrimitiveRef = SHA2_512_256
        CryptoPrimitiveRef = RNG
        CryptoPrimitiveRef = HMAC_Generate
        CryptoPrimitiveRef = HMAC_Verify
        CryptoPrimitiveRef = RSADecrypt
        CryptoPrimitiveRef = RSADecrypt_SHA2
        CryptoPrimitiveRef = RSAEncrypt
        CryptoPrimitiveRef = RSAEncryptSHA2
        CryptoPrimitiveRef = SignatureGenerate
        CryptoPrimitiveRef = SignatureVerify
        CryptoPrimitiveRef = KeyExchangeCalcPubVal
        CryptoPrimitiveRef = KeyExchangeCalcSecret
        CryptoPrimitiveRef = KeyGenerate
    CryptoGeneral:
      CryptoDevErrorDetect = true
      CryptoInstanceId = 0
      CryptoVersionInfoApi = true
      CryptoMainFunctionPeriod = 0.01
      UsePolling = true
      UseFusaCalloutFunction = false
      FusaAlarmCalloutFunction = 
      NumberOfIpcChannels = 2
      CryptoNvCustomCalloutSupport = false
    CryptoKeyElements
      101 x CryptoKeyElement, all with CryptoKeyElementFormat=CRYPTO_KE_FORMAT_BIN_OCTET:
        CRYPTO_KE_RSA_PUB_EXPONENT: CryptoKeyElementAllowPartialAccess=false, CryptoKeyElementId=161, CryptoKeyElementPersist=false, CryptoKeyElementReadAccess=CRYPTO_RA_ALLOWED, CryptoKeyElementSize=32, CryptoKeyElementWriteAccess=CRYPTO_WA_ALLOWED, CryptoKeyElementInitValue=0x01, 0x00, 0x01, 0x00
        CRYPTO_KE_RSA_SALT: CryptoKeyElementAllowPartialAccess=false, CryptoKeyElementId=163, CryptoKeyElementPersist=false, CryptoKeyElementReadAccess=CRYPTO_RA_ALLOWED, CryptoKeyElementWriteAccess=CRYPTO_WA_ALLOWED, CryptoKeyElementSize=32
        CRYPTO_KE_RSA_SALT_LENGTH: CryptoKeyElementAllowPartialAccess=false, CryptoKeyElementId=164, CryptoKeyElementPersist=false, CryptoKeyElementReadAccess=CRYPTO_RA_ALLOWED, CryptoKeyElementSize=4, CryptoKeyElementWriteAccess=CRYPTO_WA_ALLOWED
        CRYPTO_KE_RSA_LABEL: CryptoKeyElementAllowPartialAccess=false, CryptoKeyElementId=3058, CryptoKeyElementPersist=false, CryptoKeyElementReadAccess=CRYPTO_RA_ALLOWED, CryptoKeyElementSize=16, CryptoKeyElementWriteAccess=CRYPTO_WA_ALLOWED
        Hash_KeyElement: CryptoKeyElementAllowPartialAccess=true, CryptoKeyElementId=1, CryptoKeyElementInitValue=, CryptoKeyElementPersist=true, CryptoKeyElementReadAccess=CRYPTO_RA_ALLOWED, CryptoKeyElementSize=64, CryptoKeyElementWriteAccess=CRYPTO_WA_ALLOWED
        MKA_KE_CAK_KEY_CUSTOM: CryptoKeyElementAllowPartialAccess=false, CryptoKeyElementId=1, CryptoKeyElementInitValue=0x13, 0x5B, 0xD7, 0x58, 0xB0, 0xEE, 0x5C, 0x11, 0xC5, 0x5F, 0xF6, 0xAB,0x19, 0xFD, 0xB1, 0x99, CryptoKeyElementReadAccess=CRYPTO_RA_ALLOWED, CryptoKeyElementSize=16, CryptoKeyElementWriteAccess=CRYPTO_WA_ALLOWED, CryptoKeyElementPersist=false
        MKA_KE_CAK_CKN: CryptoKeyElementAllowPartialAccess=true, CryptoKeyElementId=2, CryptoKeyElementInitValue=0xE9, 0xE7, 0xEC, 0x3E, 0x44, 0x25, 0xB0, 0x5B, 0x8D, 0xC0, 0x66, 0xC8,0xC0, 0x33, 0x7D, 0xC8, 0x19, 0x46, 0x43, 0x0C, 0xDB, 0xC9, 0x6A, 0x1F,0x7D, 0xD3, 0x92, 0xA9, 0xE0, 0x89, 0x32, 0x77, CryptoKeyElementReadAccess=CRYPTO_RA_ALLOWED, CryptoKeyElementSize=32, CryptoKeyElementWriteAccess=CRYPTO_WA_ALLOWED, CryptoKeyElementPersist=false
        MKA_Random_KeyElement: CryptoKeyElementAllowPartialAccess=true, CryptoKeyElementId=1, CryptoKeyElementInitValue=, CryptoKeyElementPersist=false, CryptoKeyElementReadAccess=CRYPTO_RA_ALLOWED, CryptoKeyElementSize=32, CryptoKeyElementWriteAccess=CRYPTO_WA_ALLOWED
        MKA_ICK_KeyElement: CryptoKeyElementAllowPartialAccess=false, CryptoKeyElementId=1, CryptoKeyElementInitValue=, CryptoKeyElementPersist=false, CryptoKeyElementReadAccess=CRYPTO_RA_ALLOWED, CryptoKeyElementSize=16, CryptoKeyElementWriteAccess=CRYPTO_WA_ALLOWED
        MKA_KEK_KeyElement: CryptoKeyElementAllowPartialAccess=false, CryptoKeyElementId=1, CryptoKeyElementInitValue=, CryptoKeyElementPersist=false, CryptoKeyElementReadAccess=CRYPTO_RA_ALLOWED, CryptoKeyElementSize=16, CryptoKeyElementWriteAccess=CRYPTO_WA_ALLOWED
        MKA_SAK_KeyElement: CryptoKeyElementAllowPartialAccess=true, CryptoKeyElementId=1, CryptoKeyElementInitValue=, CryptoKeyElementPersist=false, CryptoKeyElementReadAccess=CRYPTO_RA_ALLOWED, CryptoKeyElementSize=16, CryptoKeyElementWriteAccess=CRYPTO_WA_ALLOWED
        MKA_MAC_KeyElement: CryptoKeyElementAllowPartialAccess=false, CryptoKeyElementId=1, CryptoKeyElementInitValue=, CryptoKeyElementPersist=false, CryptoKeyElementReadAccess=CRYPTO_RA_ALLOWED, CryptoKeyElementSize=16, CryptoKeyElementWriteAccess=CRYPTO_WA_ALLOWED
        MKA_SAK_Data_KeyElement: CryptoKeyElementAllowPartialAccess=true, CryptoKeyElementId=1, CryptoKeyElementInitValue=, CryptoKeyElementPersist=false, CryptoKeyElementReadAccess=CRYPTO_RA_ALLOWED, CryptoKeyElementSize=36, CryptoKeyElementWriteAccess=CRYPTO_WA_ALLOWED
        KeyGen_192_KeyElement: CryptoKeyElementAllowPartialAccess=true, CryptoKeyElementId=1, CryptoKeyElementInitValue=, CryptoKeyElementPersist=false, CryptoKeyElementReadAccess=CRYPTO_RA_ALLOWED, CryptoKeyElementSize=24, CryptoKeyElementWriteAccess=CRYPTO_WA_ALLOWED
        KeyGen_224_KeyElement: CryptoKeyElementAllowPartialAccess=true, CryptoKeyElementId=1, CryptoKeyElementInitValue=, CryptoKeyElementPersist=false, CryptoKeyElementReadAccess=CRYPTO_RA_ALLOWED, CryptoKeyElementSize=28, CryptoKeyElementWriteAccess=CRYPTO_WA_ALLOWED
        KeyGen_256_KeyElement: CryptoKeyElementAllowPartialAccess=true, CryptoKeyElementId=1, CryptoKeyElementInitValue=, CryptoKeyElementPersist=false, CryptoKeyElementReadAccess=CRYPTO_RA_ALLOWED, CryptoKeyElementSize=32, CryptoKeyElementWriteAccess=CRYPTO_WA_ALLOWED
        KeyGen_384_KeyElement: CryptoKeyElementAllowPartialAccess=true, CryptoKeyElementId=1, CryptoKeyElementInitValue=, CryptoKeyElementPersist=false, CryptoKeyElementReadAccess=CRYPTO_RA_ALLOWED, CryptoKeyElementSize=48, CryptoKeyElementWriteAccess=CRYPTO_WA_ALLOWED
        KeyGen_512_KeyElement: CryptoKeyElementAllowPartialAccess=true, CryptoKeyElementId=1, CryptoKeyElementInitValue=, CryptoKeyElementPersist=false, CryptoKeyElementReadAccess=CRYPTO_RA_ALLOWED, CryptoKeyElementSize=64, CryptoKeyElementWriteAccess=CRYPTO_WA_ALLOWED
        KeyGen_521_KeyElement: CryptoKeyElementAllowPartialAccess=true, CryptoKeyElementId=1, CryptoKeyElementInitValue=, CryptoKeyElementPersist=false, CryptoKeyElementReadAccess=CRYPTO_RA_ALLOWED, CryptoKeyElementSize=66, CryptoKeyElementWriteAccess=CRYPTO_WA_ALLOWED
        KeyGen_320_KeyElement: CryptoKeyElementAllowPartialAccess=true, CryptoKeyElementId=1, CryptoKeyElementInitValue=, CryptoKeyElementPersist=false, CryptoKeyElementReadAccess=CRYPTO_RA_ALLOWED, CryptoKeyElementSize=40, CryptoKeyElementWriteAccess=CRYPTO_WA_ALLOWED
        CRYPTO_KE_MAC_KEY: CryptoKeyElementAllowPartialAccess=true, CryptoKeyElementId=1, CryptoKeyElementPersist=false, CryptoKeyElementReadAccess=CRYPTO_RA_ALLOWED, CryptoKeyElementSize=64, CryptoKeyElementWriteAccess=CRYPTO_WA_ALLOWED
        CRYPTO_KE_KEYGENERATE_SEED: CryptoKeyElementAllowPartialAccess=true, CryptoKeyElementId=16, CryptoKeyElementPersist=false, CryptoKeyElementReadAccess=CRYPTO_RA_ALLOWED, CryptoKeyElementSize=4, CryptoKeyElementWriteAccess=CRYPTO_WA_ALLOWED
        CRYPTO_KE_MAC_PROOF: CryptoKeyElementAllowPartialAccess=true, CryptoKeyElementId=2, CryptoKeyElementPersist=false, CryptoKeyElementReadAccess=CRYPTO_RA_ALLOWED, CryptoKeyElementSize=4, CryptoKeyElementWriteAccess=CRYPTO_WA_ALLOWED
        CRYPTO_KE_SIGNATURE_KEY: CryptoKeyElementAllowPartialAccess=true, CryptoKeyElementId=1, CryptoKeyElementPersist=false, CryptoKeyElementReadAccess=CRYPTO_RA_ALLOWED, CryptoKeyElementSize=512, CryptoKeyElementWriteAccess=CRYPTO_WA_ALLOWED
        CRYPTO_KE_SIGNATURE_CURVETYPE: CryptoKeyElementAllowPartialAccess=true, CryptoKeyElementId=29, CryptoKeyElementPersist=false, CryptoKeyElementReadAccess=CRYPTO_RA_ALLOWED, CryptoKeyElementSize=4, CryptoKeyElementWriteAccess=CRYPTO_WA_ALLOWED
        CRYPTO_KE_RANDOM_SEED_STATE: CryptoKeyElementAllowPartialAccess=true, CryptoKeyElementId=3, CryptoKeyElementPersist=false, CryptoKeyElementReadAccess=CRYPTO_RA_ALLOWED, CryptoKeyElementSize=32, CryptoKeyElementWriteAccess=CRYPTO_WA_ALLOWED
        CRYPTO_KE_RANDOM_ALGORITHM: CryptoKeyElementAllowPartialAccess=true, CryptoKeyElementId=4, CryptoKeyElementPersist=false, CryptoKeyElementReadAccess=CRYPTO_RA_ALLOWED, CryptoKeyElementSize=4, CryptoKeyElementWriteAccess=CRYPTO_WA_ALLOWED
        CRYPTO_KE_CIPHER_KEY: CryptoKeyElementAllowPartialAccess=true, CryptoKeyElementId=1, CryptoKeyElementPersist=false, CryptoKeyElementReadAccess=CRYPTO_RA_ALLOWED, CryptoKeyElementWriteAccess=CRYPTO_WA_ALLOWED, CryptoKeyElementInitValue=0xa6, 0x49, 0x8d, 0x37, 0xa1, 0xf1, 0x23, 0x93, 0x4c, 0x42, 0xc7, 0x56, 0x55, 0xcf, 0x72, 0xb1, CryptoKeyElementSize=64
        CRYPTO_KE_CIPHER_PROOF: CryptoKeyElementAllowPartialAccess=true, CryptoKeyElementId=2, CryptoKeyElementPersist=false, CryptoKeyElementReadAccess=CRYPTO_RA_ALLOWED, CryptoKeyElementSize=48, CryptoKeyElementWriteAccess=CRYPTO_WA_ENCRYPTED
        CRYPTO_KE_CIPHER_IV: CryptoKeyElementAllowPartialAccess=true, CryptoKeyElementId=5, CryptoKeyElementPersist=false, CryptoKeyElementReadAccess=CRYPTO_RA_ALLOWED, CryptoKeyElementSize=32, CryptoKeyElementWriteAccess=CRYPTO_WA_ALLOWED, CryptoKeyElementInitValue=0x83, 0xe5, 0xbf, 0x1f, 0x49, 0x79, 0xd9, 0xef, 0xd1, 0xb5, 0xdb, 0x8a, 0x6f, 0x9c, 0x89, 0xaa
        CRYPTO_KE_CIPHER_2NDKEY: CryptoKeyElementAllowPartialAccess=true, CryptoKeyElementId=7, CryptoKeyElementPersist=false, CryptoKeyElementReadAccess=CRYPTO_RA_ALLOWED, CryptoKeyElementSize=64, CryptoKeyElementWriteAccess=CRYPTO_WA_ALLOWED
        CRYPTO_KE_KEYEXCHANGE_BASE: CryptoKeyElementAllowPartialAccess=true, CryptoKeyElementId=8, CryptoKeyElementPersist=false, CryptoKeyElementReadAccess=CRYPTO_RA_ALLOWED, CryptoKeyElementSize=4, CryptoKeyElementWriteAccess=CRYPTO_WA_ALLOWED
        CRYPTO_KE_KEYEXCHANGE_PRIVKEY: CryptoKeyElementAllowPartialAccess=true, CryptoKeyElementId=9, CryptoKeyElementPersist=false, CryptoKeyElementReadAccess=CRYPTO_RA_ALLOWED, CryptoKeyElementSize=68, CryptoKeyElementWriteAccess=CRYPTO_WA_ALLOWED
        CRYPTO_KE_KEYEXCHANGE_OWNPUBKEY: CryptoKeyElementAllowPartialAccess=true, CryptoKeyElementId=10, CryptoKeyElementPersist=false, CryptoKeyElementReadAccess=CRYPTO_RA_ALLOWED, CryptoKeyElementSize=136, CryptoKeyElementWriteAccess=CRYPTO_WA_ALLOWED
        CRYPTO_KE_KEYEXCHANGE_SHAREDVALUE: CryptoKeyElementAllowPartialAccess=true, CryptoKeyElementId=1, CryptoKeyElementPersist=false, CryptoKeyElementReadAccess=CRYPTO_RA_ALLOWED, CryptoKeyElementSize=68, CryptoKeyElementWriteAccess=CRYPTO_WA_ALLOWED
        CRYPTO_KE_KEYEXCHANGE_ALGORITHM: CryptoKeyElementAllowPartialAccess=true, CryptoKeyElementId=12, CryptoKeyElementPersist=false, CryptoKeyElementReadAccess=CRYPTO_RA_ALLOWED, CryptoKeyElementSize=4, CryptoKeyElementWriteAccess=CRYPTO_WA_ALLOWED
        CRYPTO_KE_KEYEXCHANGE_CURVETYPE: CryptoKeyElementAllowPartialAccess=true, CryptoKeyElementId=29, CryptoKeyElementPersist=false, CryptoKeyElementReadAccess=CRYPTO_RA_ALLOWED, CryptoKeyElementSize=4, CryptoKeyElementWriteAccess=CRYPTO_WA_ALLOWED
        CRYPTO_KE_KEYDERIVATION_PASSWORD: CryptoKeyElementAllowPartialAccess=true, CryptoKeyElementId=1, CryptoKeyElementPersist=false, CryptoKeyElementReadAccess=CRYPTO_RA_ALLOWED, CryptoKeyElementSize=4, CryptoKeyElementWriteAccess=CRYPTO_WA_ALLOWED
        CRYPTO_KE_KEYDERIVATION_SALT: CryptoKeyElementAllowPartialAccess=true, CryptoKeyElementId=13, CryptoKeyElementPersist=false, CryptoKeyElementReadAccess=CRYPTO_RA_ALLOWED, CryptoKeyElementSize=4, CryptoKeyElementWriteAccess=CRYPTO_WA_ALLOWED
        CRYPTO_KE_KEYDERIVATION_ITERATIONS: CryptoKeyElementAllowPartialAccess=true, CryptoKeyElementId=14, CryptoKeyElementPersist=false, CryptoKeyElementReadAccess=CRYPTO_RA_ALLOWED, CryptoKeyElementSize=4, CryptoKeyElementWriteAccess=CRYPTO_WA_ALLOWED
        CRYPTO_KE_KEYDERIVATION_ALGORITHM: CryptoKeyElementAllowPartialAccess=true, CryptoKeyElementId=15, CryptoKeyElementPersist=false, CryptoKeyElementReadAccess=CRYPTO_RA_ALLOWED, CryptoKeyElementSize=4, CryptoKeyElementWriteAccess=CRYPTO_WA_ALLOWED
        CRYPTO_KE_KEYDERIVATION_CURVETYPE: CryptoKeyElementAllowPartialAccess=true, CryptoKeyElementId=29, CryptoKeyElementPersist=false, CryptoKeyElementReadAccess=CRYPTO_RA_ALLOWED, CryptoKeyElementSize=4, CryptoKeyElementWriteAccess=CRYPTO_WA_ALLOWED
        CRYPTO_KE_KEYGENERATE_KEY: CryptoKeyElementAllowPartialAccess=true, CryptoKeyElementId=1, CryptoKeyElementPersist=false, CryptoKeyElementReadAccess=CRYPTO_RA_ALLOWED, CryptoKeyElementSize=4, CryptoKeyElementWriteAccess=CRYPTO_WA_ALLOWED
        CRYPTO_KE_KEYGENERATE_ALGORITHM: CryptoKeyElementAllowPartialAccess=true, CryptoKeyElementId=17, CryptoKeyElementPersist=false, CryptoKeyElementReadAccess=CRYPTO_RA_ALLOWED, CryptoKeyElementSize=4, CryptoKeyElementWriteAccess=CRYPTO_WA_ALLOWED
        CRYPTO_KE_KEYGENERATE_CURVETYPE: CryptoKeyElementAllowPartialAccess=true, CryptoKeyElementId=29, CryptoKeyElementPersist=false, CryptoKeyElementReadAccess=CRYPTO_RA_ALLOWED, CryptoKeyElementSize=4, CryptoKeyElementWriteAccess=CRYPTO_WA_ALLOWED
        CUSTOM_KE_KDF: CryptoKeyElementAllowPartialAccess=true, CryptoKeyElementId=1000, CryptoKeyElementPersist=false, CryptoKeyElementReadAccess=CRYPTO_RA_ALLOWED, CryptoKeyElementSize=4, CryptoKeyElementWriteAccess=CRYPTO_WA_ALLOWED
        CUSTOM_KE_KUW: CryptoKeyElementAllowPartialAccess=true, CryptoKeyElementId=1001, CryptoKeyElementPersist=false, CryptoKeyElementReadAccess=CRYPTO_RA_ALLOWED, CryptoKeyElementSize=4, CryptoKeyElementWriteAccess=CRYPTO_WA_ALLOWED
        CUSTOM_KE_VER: CryptoKeyElementAllowPartialAccess=true, CryptoKeyElementId=1011, CryptoKeyElementPersist=false, CryptoKeyElementReadAccess=CRYPTO_RA_ALLOWED, CryptoKeyElementSize=4, CryptoKeyElementWriteAccess=CRYPTO_WA_ALLOWED
        CUSTOM_KE_DUAL_BOOT_BOOT_STATUS: CryptoKeyElementAllowPartialAccess=true, CryptoKeyElementId=1002, CryptoKeyElementPersist=false, CryptoKeyElementReadAccess=CRYPTO_RA_ALLOWED, CryptoKeyElementSize=4, CryptoKeyElementWriteAccess=CRYPTO_WA_ALLOWED
        CUSTOM_KE_DUAL_BOOT_RESET_STATUS: CryptoKeyElementAllowPartialAccess=true, CryptoKeyElementId=1003, CryptoKeyElementPersist=false, CryptoKeyElementReadAccess=CRYPTO_RA_ALLOWED, CryptoKeyElementSize=4, CryptoKeyElementWriteAccess=CRYPTO_WA_ALLOWED
        MC_KE_COUNTER1: CryptoKeyElementAllowPartialAccess=false, CryptoKeyElementId=1000, CryptoKeyElementPersist=false, CryptoKeyElementReadAccess=CRYPTO_RA_ALLOWED, CryptoKeyElementSize=4, CryptoKeyElementWriteAccess=CRYPTO_WA_ALLOWED
        MC_KE_COUNTER2: CryptoKeyElementAllowPartialAccess=false, CryptoKeyElementId=1001, CryptoKeyElementPersist=false, CryptoKeyElementReadAccess=CRYPTO_RA_ALLOWED, CryptoKeyElementSize=4, CryptoKeyElementWriteAccess=CRYPTO_WA_ALLOWED
        MC_KE_COUNTER3: CryptoKeyElementAllowPartialAccess=false, CryptoKeyElementId=1002, CryptoKeyElementPersist=false, CryptoKeyElementReadAccess=CRYPTO_RA_ALLOWED, CryptoKeyElementSize=4, CryptoKeyElementWriteAccess=CRYPTO_WA_ALLOWED
        MC_KE_COUNTER4: CryptoKeyElementAllowPartialAccess=false, CryptoKeyElementId=1003, CryptoKeyElementPersist=false, CryptoKeyElementReadAccess=CRYPTO_RA_ALLOWED, CryptoKeyElementSize=4, CryptoKeyElementWriteAccess=CRYPTO_WA_ALLOWED
        MC_KE_COUNTER5: CryptoKeyElementAllowPartialAccess=false, CryptoKeyElementId=1004, CryptoKeyElementPersist=false, CryptoKeyElementReadAccess=CRYPTO_RA_ALLOWED, CryptoKeyElementSize=4, CryptoKeyElementWriteAccess=CRYPTO_WA_ALLOWED
        MC_KE_COUNTER6: CryptoKeyElementAllowPartialAccess=false, CryptoKeyElementId=1005, CryptoKeyElementPersist=false, CryptoKeyElementReadAccess=CRYPTO_RA_ALLOWED, CryptoKeyElementSize=4, CryptoKeyElementWriteAccess=CRYPTO_WA_ALLOWED
        MC_KE_COUNTER7: CryptoKeyElementAllowPartialAccess=false, CryptoKeyElementId=1006, CryptoKeyElementPersist=false, CryptoKeyElementReadAccess=CRYPTO_RA_ALLOWED, CryptoKeyElementSize=4, CryptoKeyElementWriteAccess=CRYPTO_WA_ALLOWED
        MC_KE_COUNTER8: CryptoKeyElementAllowPartialAccess=false, CryptoKeyElementId=1007, CryptoKeyElementPersist=false, CryptoKeyElementReadAccess=CRYPTO_RA_ALLOWED, CryptoKeyElementSize=4, CryptoKeyElementWriteAccess=CRYPTO_WA_ALLOWED
        MC_KE_COUNTER9: CryptoKeyElementAllowPartialAccess=false, CryptoKeyElementId=1008, CryptoKeyElementPersist=false, CryptoKeyElementReadAccess=CRYPTO_RA_ALLOWED, CryptoKeyElementSize=4, CryptoKeyElementWriteAccess=CRYPTO_WA_ALLOWED
        MC_KE_COUNTER10: CryptoKeyElementAllowPartialAccess=false, CryptoKeyElementId=1009, CryptoKeyElementPersist=false, CryptoKeyElementReadAccess=CRYPTO_RA_ALLOWED, CryptoKeyElementSize=4, CryptoKeyElementWriteAccess=CRYPTO_WA_ALLOWED
        MC_KE_COUNTER11: CryptoKeyElementAllowPartialAccess=false, CryptoKeyElementId=1010, CryptoKeyElementPersist=false, CryptoKeyElementReadAccess=CRYPTO_RA_ALLOWED, CryptoKeyElementSize=4, CryptoKeyElementWriteAccess=CRYPTO_WA_ALLOWED
        MC_KE_COUNTER12: CryptoKeyElementAllowPartialAccess=false, CryptoKeyElementId=1011, CryptoKeyElementPersist=false, CryptoKeyElementReadAccess=CRYPTO_RA_ALLOWED, CryptoKeyElementSize=4, CryptoKeyElementWriteAccess=CRYPTO_WA_ALLOWED
        CUSTOM_KE_SWD_UNLOCK: CryptoKeyElementAllowPartialAccess=true, CryptoKeyElementId=1004, CryptoKeyElementPersist=false, CryptoKeyElementReadAccess=CRYPTO_RA_ALLOWED, CryptoKeyElementSize=4, CryptoKeyElementWriteAccess=CRYPTO_WA_ALLOWED, CryptoKeyElementInitValue=0x0,0x01,0x02,0x03,0x04,0x05,0x06,0x07,0x08,0x09,0x0a,0x0b,0x0c,0x0d,0x0e,0x0f
        CUSTOM_KE_SWD_LOCK: CryptoKeyElementAllowPartialAccess=true, CryptoKeyElementId=1005, CryptoKeyElementPersist=false, CryptoKeyElementReadAccess=CRYPTO_RA_ALLOWED, CryptoKeyElementSize=4, CryptoKeyElementWriteAccess=CRYPTO_WA_ALLOWED
        CRYPTO_KE_KEYGENERATE_ECC_PUBLIC_KEY: CryptoKeyElementAllowPartialAccess=true, CryptoKeyElementId=10, CryptoKeyElementPersist=false, CryptoKeyElementReadAccess=CRYPTO_RA_ALLOWED, CryptoKeyElementSize=136, CryptoKeyElementWriteAccess=CRYPTO_WA_ALLOWED
        CRYPTO_KE_KEYGENERATE_ECC_PRIVATE_KEY: CryptoKeyElementAllowPartialAccess=true, CryptoKeyElementId=9, CryptoKeyElementPersist=false, CryptoKeyElementReadAccess=CRYPTO_RA_ALLOWED, CryptoKeyElementSize=68, CryptoKeyElementWriteAccess=CRYPTO_WA_ALLOWED
        CRYPTO_KE_CIPHER_KEY_AES_128: CryptoKeyElementAllowPartialAccess=true, CryptoKeyElementId=1, CryptoKeyElementPersist=false, CryptoKeyElementReadAccess=CRYPTO_RA_ALLOWED, CryptoKeyElementSize=64, CryptoKeyElementWriteAccess=CRYPTO_WA_ALLOWED, CryptoKeyElementInitValue=0xa6, 0x49, 0x8d, 0x37, 0xa1, 0xf1, 0x23, 0x93, 0x4c, 0x42, 0xc7, 0x56, 0x55, 0xcf, 0x72, 0xb1
        CRYPTO_KE_CIPHER_KEY_AES_256: CryptoKeyElementAllowPartialAccess=true, CryptoKeyElementId=1, CryptoKeyElementPersist=true, CryptoKeyElementReadAccess=CRYPTO_RA_ALLOWED, CryptoKeyElementSize=64, CryptoKeyElementWriteAccess=CRYPTO_WA_ALLOWED, CryptoKeyElementInitValue=0xfe, 0xcd, 0x8e, 0x33, 0xb0, 0xd5, 0xcc, 0x75, 0xf3, 0x07, 0xba, 0xfa,0x86, 0x3c, 0x4a, 0xbe, 0x81, 0xf6, 0xd7, 0xbc, 0x95, 0x88, 0xb5, 0xf5,0x68, 0x54, 0x20, 0x0c, 0xb0, 0xc2, 0x95, 0x48
        CRYPTO_KE_RSA_MODULUS_1024: CryptoKeyElementAllowPartialAccess=false, CryptoKeyElementId=160, CryptoKeyElementPersist=false, CryptoKeyElementReadAccess=CRYPTO_RA_ALLOWED, CryptoKeyElementSize=128, CryptoKeyElementWriteAccess=CRYPTO_WA_ALLOWED, CryptoKeyElementInitValue=0x09, 0xD6, 0xE9, 0x30, 0x7B, 0xD9, 0xA1, 0x1B, 0x3B, 0x91, 0xCF, 0x32, 0x34, 0x7D, 0xC9, 0xD8, 0x07, 0xBB, 0x31, 0x67, 0xEC, 0x72, 0x51, 0xF6, 0x6E, 0xA0, 0x95, 0x0B, 0x8F, 0x29, 0x12, 0x76, 0x6D, 0x62, 0xFA, 0x9B, 0x53, 0x35, 0x37, 0x3D, 0xD0, 0xC7, 0x1B, 0xAB, 0x6C, 0x34, 0x83, 0x31, 0xAE, 0x5C, 0x0F, 0xC6, 0xFA, 0x4F, 0xE5, 0xC8, 0x02, 0x8F, 0x04, 0x5C, 0x3E, 0x90, 0xAF, 0x76, 0x7D, 0xA3, 0x0A, 0xA8, 0x6C, 0xED, 0x48, 0xC2, 0xFD, 0xF9, 0x9A, 0x28, 0x78, 0x84, 0x0C, 0x82, 0xA9, 0x79, 0xC1, 0x5A, 0xE0, 0x4F, 0x2A, 0x14, 0xDD, 0x3A, 0x0E, 0xED, 0x03, 0x57, 0x18, 0xFC, 0xDB, 0x22, 0x5B, 0x2E, 0x83, 0x96, 0xAC, 0x02, 0x9A, 0x33, 0xE1, 0x43, 0xC1, 0xFF, 0x79, 0x73, 0xB2, 0xD1, 0x24, 0x5D, 0x3E, 0x42, 0x81, 0x7F, 0xE7, 0x65, 0x1C, 0x59, 0x05, 0x29, 0xEF, 0xD2
        CRYPTO_KE_RSA_MODULUS_2048: CryptoKeyElementAllowPartialAccess=false, CryptoKeyElementId=160, CryptoKeyElementPersist=false, CryptoKeyElementReadAccess=CRYPTO_RA_ALLOWED, CryptoKeyElementSize=256, CryptoKeyElementWriteAccess=CRYPTO_WA_ALLOWED, CryptoKeyElementInitValue=0xB5, 0x02, 0x97, 0x83, 0x0C, 0xFE, 0x9E, 0x60, 0xDD, 0x0C, 0x92, 0xDF, 0x72, 0x99, 0xDE, 0x23, 0xE7, 0x48, 0x9D, 0x04, 0x4D, 0xFC, 0xEF, 0x3D, 0x48, 0xC6, 0x4A, 0x04, 0xF1, 0x73, 0x83, 0x05, 0x76, 0x9B, 0x11, 0xEE, 0xFE, 0xCF, 0x35, 0xE2, 0x36, 0x21, 0x58, 0xD9, 0xB3, 0x98, 0xDF, 0xCF, 0x65, 0x79, 0xD5, 0x5B, 0x11, 0x7B, 0x15, 0x13, 0x55, 0x26, 0x77, 0xFA, 0x29, 0xF3, 0x5D, 0x2B, 0xA8, 0xA1, 0xAA, 0x62, 0xAF, 0x05, 0x57, 0xF3, 0xA3, 0xE5, 0x6B, 0x7C, 0x78, 0x6B, 0xA4, 0xDC, 0x94, 0x18, 0x37, 0xFA, 0xFA, 0x21, 0xFD, 0xDD, 0xBA, 0x94, 0x21, 0xF6, 0xFC, 0xE5, 0xF3, 0x36, 0x45, 0x5E, 0xC8, 0x84, 0x3F, 0x63, 0x81, 0x33, 0xAB, 0x95, 0x85, 0xA7, 0x95, 0xE2, 0x74, 0xE5, 0x26, 0xD6, 0x47, 0xCC, 0x6C, 0xBD, 0x75, 0xC2, 0xF7, 0x31, 0x95, 0x2F, 0xCF, 0x5D, 0xAD, 0x5B, 0x59, 0xEF, 0xCC, 0x98, 0x0F, 0xE1, 0x30, 0x87, 0x99, 0xE8, 0x8A, 0x95, 0x9F, 0xCC, 0x2D, 0x76, 0x81, 0x42, 0x96, 0x22, 0xD2, 0x66, 0x07, 0xE2, 0xDE, 0x12, 0xE6, 0x9F, 0x5B, 0x4B, 0x7A, 0x3D, 0xD6, 0x2D, 0x32, 0x74, 0xA7, 0x66, 0x96, 0xBC, 0x7A, 0x84, 0x16, 0x7D, 0xF0, 0x5C, 0xC3, 0xD9, 0x1F, 0xEE, 0x02, 0x99, 0xF8, 0x58, 0x3F, 0xD6, 0x3C, 0x45, 0x7C, 0x21, 0xE6, 0xC3, 0x07, 0x0B, 0x60, 0x0B, 0x37, 0x41, 0xA3, 0x4C, 0xFC, 0xBF, 0x4E, 0xDE, 0xAA, 0xCE, 0x05, 0x9C, 0xC2, 0x79, 0xD0, 0xB1, 0xCE, 0x1F, 0xF6, 0x15, 0x95, 0xF3, 0x7D, 0xD1, 0xEC, 0xE2, 0x16, 0x62, 0x66, 0x76, 0xF8, 0x52, 0xF6, 0xD5, 0x21, 0xA0, 0x22, 0x3E, 0xD3, 0x37, 0x37, 0x5F, 0xA8, 0xC2, 0xD2, 0x88, 0xC0, 0xF2, 0x0C, 0xC3, 0x0D, 0x8E, 0x53, 0x88, 0x1B, 0x80, 0xB2, 0x25, 0x6F, 0xA0, 0x1B, 0xA6
        CRYPTO_KE_RSA_MODULUS_3072: CryptoKeyElementAllowPartialAccess=false, CryptoKeyElementId=160, CryptoKeyElementPersist=false, CryptoKeyElementReadAccess=CRYPTO_RA_ALLOWED, CryptoKeyElementSize=384, CryptoKeyElementWriteAccess=CRYPTO_WA_ALLOWED, CryptoKeyElementInitValue=0x5D, 0x49, 0x37, 0x69, 0xFA, 0xC0, 0x30, 0xE4, 0x79, 0x90, 0x44, 0x96, 0xDE, 0x16, 0x72, 0x42, 0x05, 0x76, 0xB5, 0x67, 0x3D, 0x4E, 0x05, 0x7D, 0xE0, 0x39, 0xF5, 0x2A, 0x14, 0xF9, 0xE7, 0xBA, 0xAC, 0x46, 0x05, 0x76, 0x77, 0x90, 0xA8, 0x65, 0x8E, 0x85, 0x77, 0x48, 0x53, 0x69, 0x26, 0x72, 0x44, 0x44, 0x8F, 0x99, 0x93, 0x1D, 0xAD, 0x17, 0x63, 0x2A, 0x89, 0x94, 0x89, 0x82, 0xB8, 0xD7, 0x87, 0x7B, 0xE5, 0xB3, 0xF6, 0x47, 0x45, 0x43, 0xD0, 0xD6, 0xD5, 0x8E, 0x84, 0x6E, 0x9C, 0xD2, 0xD4, 0x89, 0x8F, 0x7E, 0xF6, 0x0F, 0xA9, 0x0B, 0xF3, 0xF9, 0x78, 0x9F, 0x22, 0x45, 0x79, 0x96, 0x4B, 0x91, 0x49, 0x79, 0xD8, 0xDA, 0x37, 0xBA, 0x12, 0xD0, 0x5A, 0x0A, 0xD0, 0x3B, 0x19, 0x28, 0xC9, 0x72, 0xF9, 0x12, 0xD6, 0x16, 0xB5, 0x80, 0x42, 0xF5, 0x92, 0xC1, 0x25, 0xCB, 0xCB, 0x4F, 0x36, 0x6A, 0x53, 0x7A, 0x3F, 0xDC, 0xC1, 0x6E, 0xE2, 0xBC, 0xC7, 0xD6, 0xBF, 0x76, 0xD4, 0xB4, 0xB3, 0xD7, 0x9E, 0xC7, 0xE9, 0x8A, 0x95, 0x48, 0x3F, 0xED, 0xED, 0x6E, 0xF2, 0x45, 0xC2, 0x47, 0x93, 0xEF, 0x97, 0x6F, 0x0C, 0xBA, 0x00, 0x30, 0x25, 0xA0, 0x00, 0x54, 0x5A, 0xCB, 0xCC, 0x1B, 0xD3, 0x21, 0x86, 0xB8, 0xB5, 0x99, 0x26, 0xF8, 0x94, 0x6C, 0xC0, 0xA5, 0xAB, 0x79, 0x18, 0xB7, 0x49, 0xBE, 0xD2, 0x00, 0xF2, 0xDF, 0xFF, 0x61, 0x7F, 0x67, 0xED, 0x89, 0x35, 0x1D, 0x6C, 0x2D, 0xF0, 0x67, 0x24, 0xA4, 0xCB, 0xF4, 0xC7, 0x9A, 0x94, 0x81, 0x07, 0xDA, 0x08, 0x7B, 0xDD, 0x12, 0x1E, 0xA7, 0xB7, 0x5A, 0xFE, 0xF8, 0xD6, 0x7C, 0x2C, 0x18, 0x5D, 0xC1, 0xFC, 0xE1, 0x44, 0x0F, 0x5B, 0x96, 0x4B, 0x68, 0xD1, 0xEA, 0x84, 0xF0, 0xB7, 0xFC, 0xD7, 0x49, 0x5C, 0xC1, 0x79, 0x66, 0x8E, 0xC8, 0x0F, 0xAB, 0x03, 0x82, 0x7C, 0x0C, 0x2D, 0x1D, 0x8E, 0x96, 0x6D, 0x44, 0xAC, 0xDB, 0x88, 0x7E, 0x45, 0xE2, 0x8F, 0x77, 0xA3, 0x4A, 0xED, 0xF1, 0x08, 0xAC, 0x5A, 0x11, 0xE6, 0xE7, 0x60, 0x12, 0x04, 0x13, 0x2A, 0x2F, 0x7A, 0x06, 0xA2, 0x01, 0x45, 0x4B, 0x0D, 0x01, 0xB9, 0x06, 0xE5, 0x10, 0x22, 0xC7, 0xE7, 0xCA, 0x7C, 0xA1, 0x5D, 0x50, 0x5D, 0x93, 0xC7, 0x2C, 0x70, 0xA2, 0x21, 0x84, 0xDE, 0xDC, 0x99, 0x2B, 0xA8, 0x70, 0x43, 0x97, 0xAC, 0x6C, 0x4E, 0xF5, 0x49, 0x1E, 0xE7, 0x8D, 0x5D, 0xFA, 0x5D, 0x5A, 0x94, 0xF4, 0xF6, 0x25, 0x8B, 0x9D, 0x72, 0xF2, 0x8A, 0x40, 0xE8, 0xCA, 0x1A, 0xBD, 0xC8, 0x8E, 0x7E, 0xC8, 0x5F, 0xEB, 0x24, 0xE7, 0x3B, 0x55, 0x0E, 0x10, 0x37, 0x43, 0x6A, 0xC8, 0xA3, 0xE7, 0x5F, 0xDA, 0x95, 0x44, 0x57, 0xEC, 0x1B, 0x45, 0x99, 0xA1
        CRYPTO_KE_RSA_MODULUS_4096: CryptoKeyElementAllowPartialAccess=false, CryptoKeyElementId=160, CryptoKeyElementPersist=false, CryptoKeyElementReadAccess=CRYPTO_RA_ALLOWED, CryptoKeyElementSize=512, CryptoKeyElementWriteAccess=CRYPTO_WA_ALLOWED, CryptoKeyElementInitValue=0x45, 0x10, 0x25, 0x78, 0x33, 0xF3, 0x9E, 0x5D, 0x6C, 0x58, 0xC9, 0xDC, 0x30, 0x2C, 0x73, 0x2C, 0x9A, 0x09, 0xCF, 0x19, 0x84, 0x1B, 0x1B, 0x2B, 0xAE, 0xA1, 0x6B, 0xE4, 0xA7, 0xA4, 0xE8, 0xE5, 0x62, 0xB9, 0x2F, 0x82, 0x96, 0x70, 0x1B, 0xC6, 0x7A, 0xD9, 0x09, 0x21, 0xB0, 0x3C, 0x89, 0x39, 0x7D, 0xE3, 0x40, 0xDE, 0xF3, 0x8E, 0x9A, 0x2A, 0x92, 0x85, 0x99, 0x19, 0x4C, 0x70, 0x13, 0x68, 0xAD, 0x76, 0xC9, 0x8E, 0xD0, 0xCE, 0x23, 0xAF, 0x72, 0x60, 0x95, 0x93, 0xC8, 0x90, 0x26, 0xCF, 0x1F, 0x91, 0x4A, 0x2D, 0x72, 0x43, 0x5E, 0xA5, 0x3E, 0x6A, 0x0C, 0xFB, 0xAA, 0x1F, 0xAE, 0xA0, 0xB7, 0xAC, 0x65, 0xCB, 0xCC, 0x76, 0xCF, 0xC9, 0xA3, 0x5A, 0x57, 0xAB, 0xED, 0x58, 0x94, 0x9C, 0xF6, 0x77, 0xE9, 0x69, 0x68, 0xAD, 0x24, 0xCB, 0x6A, 0x77, 0x87, 0x67, 0x02, 0xEC, 0x16, 0xAA, 0x4C, 0xD6, 0xA6, 0x93, 0x45, 0xE6, 0xDD, 0x97, 0x4B, 0x43, 0x41, 0xE6, 0xFD, 0xC7, 0x55, 0xB1, 0x55, 0x72, 0x63, 0x02, 0x34, 0x74, 0xD2, 0x8D, 0x36, 0xF5, 0xD2, 0xB6, 0x91, 0x24, 0x38, 0x86, 0x39, 0xEA, 0xE9, 0xD9, 0xF5, 0x4A, 0x5B, 0x7E, 0xD4, 0xE1, 0x30, 0x67, 0x83, 0x4B, 0xA0, 0x7E, 0xBE, 0xC9, 0x45, 0x20, 0xB3, 0x8F, 0x5C, 0x38, 0x0A, 0xFC, 0x19, 0x8E, 0x34, 0xFE, 0xD6, 0xBF, 0x32, 0x46, 0xBA, 0xE2, 0x55, 0xBE, 0xEA, 0x34, 0xFD, 0x67, 0xCE, 0xB0, 0x3B, 0x3D, 0x68, 0x2F, 0xFD, 0x0C, 0xA5, 0xFD, 0xA5, 0x7A, 0x93, 0xF5, 0x8C, 0xFF, 0xBF, 0x47, 0xE1, 0xD4, 0x93, 0xFA, 0x0C, 0x89, 0xE6, 0x8D, 0x30, 0x29, 0x7B, 0x87, 0x62, 0xB6, 0xEE, 0x17, 0x9C, 0xE6, 0x6D, 0x11, 0x9C, 0x7E, 0xD0, 0x04, 0x0D, 0x9C, 0x94, 0x79, 0xF3, 0x68, 0x70, 0xE0, 0x0D, 0x1F, 0x07, 0xAF, 0x93, 0xD7, 0x44, 0xA5, 0x59, 0x06, 0xCF, 0xA7, 0x5C, 0xB2, 0xC9, 0xF2, 0xED, 0xC1, 0x0A, 0xB6, 0x53, 0xAF, 0x22, 0xC5, 0xF7, 0x74, 0x19, 0xFD, 0x14, 0x1F, 0xE7, 0xAC, 0xF5, 0xC3, 0xC4, 0x3B, 0xCC, 0x53, 0x92, 0xE9, 0x3C, 0x85, 0x5D, 0x96, 0x2F, 0x9F, 0x97, 0x72, 0x55, 0x10, 0x66, 0x1F, 0x7F, 0xC2, 0x3C, 0x8F, 0x47, 0x82, 0x34, 0xDC, 0x2D, 0x6D, 0x8A, 0x92, 0xDF, 0xA1, 0x5F, 0x26, 0x63, 0xEE, 0x37, 0xC8, 0x49, 0x59, 0x27, 0xC0, 0x86, 0x31, 0x9B, 0xA0, 0x6D, 0x1A, 0x28, 0x10, 0x68, 0xFC, 0x71, 0xBF, 0x7A, 0xA6, 0xE5, 0xE3, 0xB7, 0xC0, 0x1F, 0x41, 0xF4, 0xB4, 0xF8, 0x78, 0x2A, 0x86, 0x44, 0x3F, 0x1C, 0x72, 0x61, 0x9E, 0xEA, 0x73, 0x2A, 0x0D, 0xEF, 0x13, 0xA4, 0x5C, 0xF2, 0xD7, 0x02, 0x3C, 0xCE, 0xBD, 0xA9, 0xE9, 0x64, 0xE6, 0xEB, 0x66, 0x6F, 0xB2, 0xD3, 0x70, 0x5A, 0xCD, 0x6A, 0xC2, 0xC1, 0xAD, 0x1B, 0x8B, 0x87, 0x77, 0x6D, 0xD0, 0x2E, 0x19, 0x07, 0xA7, 0x52, 0x8B, 0x5F, 0x7F, 0xAF, 0xCF, 0x40, 0x09, 0xD8, 0x2C, 0x0B, 0x5D, 0xE9, 0x51, 0x35, 0x1D, 0xAD, 0x3F, 0x0D, 0x5F, 0x83, 0x0B, 0x6A, 0xBC, 0xBA, 0x14, 0xC4, 0x08, 0x12, 0xD8, 0x06, 0xDA, 0x18, 0x2C, 0x68, 0x7C, 0x01, 0xA7, 0xF5, 0x65, 0x0A, 0x20, 0x0F, 0xB2, 0x3A, 0xC0, 0xD6, 0x0D, 0x9B, 0x6D, 0xBC, 0xF1, 0x4E, 0x27, 0xD3, 0x64, 0x95, 0x30, 0x31, 0x0A, 0x63, 0xB2, 0xAA, 0x15, 0xCB, 0x60, 0x9C, 0x9D, 0x06, 0xD6, 0xE1, 0x52, 0x3C, 0xF4, 0xF7, 0xFF, 0x10, 0x7B, 0x8C, 0xEF, 0x8A, 0xC8, 0x07, 0x29, 0x0D, 0x76, 0x5E, 0x22, 0x40, 0x66, 0xCF, 0x96, 0x5B, 0x3F, 0xC3, 0x7D, 0x45, 0x6C, 0x72, 0x55, 0xCE, 0x82, 0x3B, 0xFD, 0x7D, 0x5C, 0x5C, 0x40, 0xD5, 0x7A, 0x94, 0xA8
        CRYPTO_KE_RSA_PRIV_EXPONENT_1024: CryptoKeyElementAllowPartialAccess=false, CryptoKeyElementId=162, CryptoKeyElementPersist=false, CryptoKeyElementReadAccess=CRYPTO_RA_ALLOWED, CryptoKeyElementSize=128, CryptoKeyElementWriteAccess=CRYPTO_WA_ALLOWED, CryptoKeyElementInitValue=0x21, 0x30, 0xEB, 0x9D, 0x09, 0x58, 0x54, 0xB3, 0x86, 0x48, 0xF9, 0xF1, 0x65, 0x08, 0x78, 0x8D, 0x53, 0x84, 0x82, 0x0C, 0x54, 0x78, 0x4B, 0x80, 0x8E, 0xEB, 0x16, 0xE6, 0x7F, 0x32, 0x3F, 0x3E, 0xD6, 0xC9, 0x87, 0xF4, 0x81, 0x42, 0x50, 0x2C, 0x96, 0xAD, 0xD6, 0x2B, 0x8C, 0xC7, 0x33, 0x1E, 0x7C, 0xD4, 0xCD, 0xFD, 0x61, 0x6F, 0xD1, 0xD8, 0x58, 0x22, 0xE0, 0xFC, 0x77, 0x63, 0x6B, 0x3E, 0xD9, 0xA5, 0x77, 0x90, 0xC9, 0x65, 0x34, 0x6E, 0x32, 0x16, 0xF8, 0x72, 0xB8, 0x38, 0xF1, 0x6D, 0x5F, 0xCA, 0xC7, 0x03, 0x8D, 0xB9, 0xC4, 0x22, 0x6B, 0x8B, 0xB9, 0x5F, 0x10, 0xCD, 0x45, 0xED, 0x47, 0x7E, 0xF2, 0xB3, 0xE4, 0x6B, 0x2F, 0xE4, 0x9F, 0xA9, 0xD9, 0x98, 0x37, 0x24, 0x3B, 0x7B, 0xF1, 0xA8, 0x7D, 0x4B, 0x24, 0x9B, 0x29, 0x47, 0x27, 0xBB, 0xC0, 0xAB, 0xD7, 0x7A, 0x62, 0x62
        CRYPTO_KE_RSA_PRIV_EXPONENT_2048: CryptoKeyElementAllowPartialAccess=false, CryptoKeyElementId=162, CryptoKeyElementPersist=false, CryptoKeyElementReadAccess=CRYPTO_RA_ALLOWED, CryptoKeyElementSize=256, CryptoKeyElementWriteAccess=CRYPTO_WA_ALLOWED, CryptoKeyElementInitValue=0x2D, 0xBA, 0x15, 0xB9, 0x3A, 0xF3, 0xA2, 0x44, 0xC7, 0xF7, 0x03, 0x3E, 0x8E, 0x6B, 0x56, 0x63, 0x87, 0x26, 0xEE, 0x37, 0x74, 0x2E, 0xF6, 0xDA, 0x5D, 0xDB, 0x7A, 0xF3, 0xF6, 0x6A, 0x72, 0xF9, 0xBA, 0xE6, 0x1F, 0x14, 0x91, 0xF7, 0xDB, 0xEF, 0x55, 0x6A, 0x94, 0xA2, 0xE3, 0x82, 0xB2, 0xBF, 0x8D, 0x85, 0x7E, 0x80, 0x61, 0xBB, 0xCE, 0x43, 0x33, 0x83, 0x0D, 0x5E, 0x04, 0x95, 0x80, 0xB7, 0x20, 0xE2, 0xFD, 0x8A, 0xE2, 0xD4, 0x87, 0x33, 0xFE, 0x00, 0x42, 0xC4, 0xEB, 0x4A, 0x43, 0x12, 0xA6, 0xB1, 0x8E, 0x00, 0xD7, 0x48, 0x34, 0x41, 0xBC, 0xE2, 0x65, 0xE9, 0xA1, 0xB6, 0x23, 0x1D, 0x39, 0xF3, 0xE1, 0xBA, 0x18, 0xF5, 0x92, 0x25, 0x16, 0xB9, 0xC0, 0x1E, 0x38, 0x6E, 0x35, 0x05, 0x02, 0x52, 0x1A, 0xCC, 0x8C, 0x62, 0xF7, 0x70, 0x9D, 0xD4, 0x64, 0xB4, 0xAC, 0x09, 0xD1, 0x6A, 0x48, 0xB4, 0x49, 0x62, 0xD0, 0x48, 0x0C, 0x7D, 0x87, 0x34, 0x28, 0x2E, 0x9D, 0xC2, 0x0C, 0x2B, 0xA1, 0x88, 0xEC, 0x8D, 0x62, 0xA7, 0x66, 0xEF, 0xF1, 0x5B, 0xAB, 0x22, 0x76, 0x30, 0xAD, 0x18, 0x85, 0xBA, 0x85, 0xE8, 0x80, 0x25, 0x6A, 0x1F, 0x65, 0xD6, 0x9F, 0xA6, 0xEA, 0x1E, 0xC9, 0xF8, 0xB8, 0x7D, 0xD9, 0x1D, 0x58, 0xFE, 0xBC, 0x6D, 0xBD, 0xB7, 0x7A, 0x52, 0xE6, 0xF1, 0x1F, 0x01, 0x95, 0x9A, 0xD9, 0x33, 0x61, 0xAE, 0x3B, 0x9F, 0xF0, 0xF0, 0xA0, 0x2E, 0xE0, 0x80, 0x88, 0x1F, 0x7B, 0x25, 0x7B, 0x06, 0x42, 0xCE, 0x01, 0x5D, 0x2C, 0x11, 0xEB, 0x38, 0x81, 0xBC, 0x2C, 0x06, 0xD7, 0x9B, 0x13, 0xFF, 0xCA, 0xB6, 0x7C, 0xE5, 0x0E, 0xAB, 0xBD, 0x76, 0xA9, 0x6F, 0xF9, 0xCA, 0x4B, 0xB6, 0xEF, 0x54, 0x72, 0x92, 0x3F, 0x4C, 0xC9, 0x86, 0xB0, 0xB3, 0xE3, 0x57, 0x0E, 0x14
        CRYPTO_KE_RSA_PRIV_EXPONENT_3072: CryptoKeyElementAllowPartialAccess=false, CryptoKeyElementId=162, CryptoKeyElementPersist=false, CryptoKeyElementReadAccess=CRYPTO_RA_ALLOWED, CryptoKeyElementSize=384, CryptoKeyElementWriteAccess=CRYPTO_WA_ALLOWED, CryptoKeyElementInitValue=0xCD, 0x58, 0x2B, 0x2C, 0x80, 0xCA, 0x5F, 0x83, 0x35, 0xFE, 0xC9, 0x13, 0x96, 0x25, 0x94, 0xCC, 0x83, 0xA3, 0x95, 0x31, 0x30, 0x46, 0x9F, 0xDC, 0x26, 0xA2, 0xA8, 0x60, 0x8A, 0x3C, 0x48, 0xF1, 0x30, 0xD1, 0x21, 0x46, 0xE1, 0x71, 0x25, 0xD9, 0x0F, 0x10, 0x0B, 0x78, 0x62, 0x51, 0xB3, 0xB8, 0x00, 0x86, 0xE8, 0xB3, 0xEB, 0x21, 0x9B, 0x7C, 0x6A, 0xC3, 0xB8, 0x06, 0x07, 0xDA, 0x7B, 0x40, 0x85, 0x06, 0x47, 0xD8, 0x1F, 0x27, 0x39, 0x55, 0x6F, 0xBB, 0x2E, 0x10, 0x94, 0x7C, 0x29, 0x9F, 0x75, 0x22, 0x2A, 0x4F, 0xDE, 0xC1, 0x3D, 0x92, 0x32, 0xD3, 0x0D, 0xE7, 0x98, 0xF8, 0x17, 0x7D, 0xEB, 0xC9, 0x64, 0x30, 0xA1, 0x70, 0x04, 0x7C, 0x56, 0x09, 0xE7, 0x55, 0x9A, 0x82, 0xA2, 0x66, 0xFC, 0x63, 0xD4, 0xB5, 0x8D, 0x87, 0x55, 0x48, 0x0D, 0x95, 0x86, 0xEC, 0xFD, 0x17, 0x9C, 0x9C, 0xC8, 0x24, 0x0D, 0x29, 0x5F, 0x57, 0xBC, 0x5F, 0x43, 0x7F, 0x4D, 0xFD, 0xA5, 0x64, 0x47, 0x1F, 0x1D, 0x28, 0x10, 0x4B, 0xA0, 0xF3, 0xD4, 0xA3, 0xF9, 0x7B, 0x42, 0xFE, 0x83, 0x8E, 0x24, 0x95, 0x69, 0x1C, 0x93, 0x8D, 0xDB, 0xCA, 0x12, 0x4D, 0xD0, 0xD8, 0x44, 0x96, 0xD6, 0xF5, 0x78, 0x72, 0x0D, 0xC3, 0x1E, 0xE3, 0xDB, 0x02, 0x62, 0x52, 0xC6, 0x72, 0xF0, 0x3E, 0x03, 0xB2, 0x7C, 0xA9, 0xA9, 0xF5, 0x91, 0xE4, 0xEC, 0x28, 0x56, 0x80, 0x86, 0x91, 0xDC, 0x72, 0xB9, 0xB9, 0x8E, 0x04, 0x2D, 0xA6, 0x6B, 0xE4, 0xF2, 0x0F, 0xB3, 0x4C, 0x41, 0x84, 0xFD, 0xA9, 0x2F, 0x91, 0x56, 0xA2, 0xEE, 0x71, 0x9D, 0x4A, 0xAF, 0x68, 0x7A, 0x76, 0xC1, 0x07, 0xFE, 0xC1, 0xE1, 0x54, 0x26, 0xAC, 0x9A, 0x9A, 0xF2, 0x2A, 0x69, 0xF9, 0x12, 0xC6, 0x29, 0xE2, 0xFA, 0x63, 0x04, 0x61, 0xAC, 0xAA, 0xB5, 0x84, 0x53, 0xCF, 0x4B, 0x90, 0x9E, 0x09, 0xEC, 0xF0, 0xC5, 0x82, 0x32, 0xD7, 0x3C, 0x07, 0x7A, 0xD5, 0x28, 0xEE, 0xF7, 0xD4, 0x97, 0x20, 0x21, 0xEB, 0x98, 0x25, 0xDF, 0x25, 0x45, 0xC9, 0xF1, 0x8B, 0x0E, 0x8B, 0xF3, 0x77, 0x44, 0xB6, 0xCB, 0xE9, 0xF6, 0xC3, 0x65, 0x6F, 0x1D, 0x31, 0xE3, 0x64, 0xEA, 0x66, 0x4E, 0xA1, 0x49, 0x43, 0x9F, 0x74, 0x6B, 0x30, 0xFC, 0xC3, 0x3B, 0xBB, 0x06, 0x1F, 0x9A, 0xCC, 0x58, 0x35, 0xF0, 0xD9, 0x96, 0xC6, 0xC0, 0xCE, 0x85, 0x28, 0x6D, 0x61, 0xE8, 0x11, 0x8D, 0xB7, 0x67, 0xF4, 0x10, 0xBA, 0x9E, 0x0E, 0x98, 0x96, 0x02, 0x87, 0x04, 0xEC, 0xFF, 0x1E, 0xEE, 0x8F, 0x54, 0x15, 0xAB, 0xBC, 0xED, 0xAE, 0xB1, 0xCD, 0x67, 0x9C, 0x14, 0x08, 0x7D, 0x2B, 0xE1, 0x2E, 0x8B, 0x39, 0xC5, 0xFD, 0x8A, 0x49, 0xDC, 0xD4, 0xBB, 0x88, 0xB8, 0x03
        CRYPTO_KE_RSA_PRIV_EXPONENT_4096: CryptoKeyElementAllowPartialAccess=false, CryptoKeyElementId=162, CryptoKeyElementPersist=false, CryptoKeyElementReadAccess=CRYPTO_RA_ALLOWED, CryptoKeyElementSize=512, CryptoKeyElementWriteAccess=CRYPTO_WA_ALLOWED, CryptoKeyElementInitValue=0xB1, 0x1D, 0x28, 0x13, 0xBC, 0xB2, 0x85, 0xA1, 0x14, 0x4B, 0xFA, 0x88, 0x64, 0x3A, 0xD1, 0xDC, 0xFC, 0x6B, 0xD4, 0xB7, 0x35, 0xDE, 0xDF, 0xEB, 0x48, 0x19, 0x9F, 0xAB, 0x30, 0xF4, 0x2B, 0xC0, 0x6F, 0x63, 0xBE, 0xAE, 0x31, 0x41, 0xB1, 0x17, 0xC8, 0xED, 0x6F, 0x6E, 0x6E, 0xC2, 0xCC, 0x38, 0x1D, 0xF7, 0x0C, 0x06, 0xE5, 0x95, 0x57, 0xC2, 0x57, 0x70, 0xB3, 0x37, 0x1F, 0x86, 0xAC, 0xBF, 0x70, 0x69, 0xE0, 0x8E, 0x75, 0x2B, 0xF4, 0xBC, 0x44, 0xA7, 0x47, 0xDA, 0x65, 0x6A, 0x2F, 0x39, 0xC5, 0x8F, 0xE3, 0xD9, 0x1D, 0xCC, 0xB1, 0xE8, 0x97, 0x73, 0x16, 0x0B, 0x70, 0x86, 0xA8, 0xFE, 0x12, 0xCB, 0x9C, 0x44, 0xEC, 0x5D, 0x2C, 0x03, 0xEC, 0xC1, 0x0E, 0x9A, 0x0D, 0xC0, 0x87, 0xB9, 0xA1, 0xFE, 0x9D, 0xE6, 0x43, 0xD3, 0xFD, 0x53, 0xE3, 0x15, 0x4D, 0xE6, 0x04, 0x25, 0x3F, 0x7E, 0x47, 0xAF, 0x6C, 0xD6, 0x52, 0x5A, 0x31, 0x41, 0x06, 0x2C, 0x14, 0x7B, 0xEB, 0x34, 0xB5, 0xF9, 0x76, 0x8B, 0x75, 0xD3, 0xE6, 0xF1, 0x81, 0xDE, 0x53, 0x1E, 0x29, 0xC0, 0x19, 0x37, 0xF4, 0xF9, 0x7F, 0xB3, 0xB9, 0xAC, 0xD5, 0xAE, 0x1E, 0x2A, 0x09, 0x1D, 0x96, 0x75, 0x69, 0xB6, 0x16, 0x01, 0xB3, 0x2C, 0x94, 0x68, 0x2F, 0xCE, 0xDD, 0x39, 0x1D, 0x13, 0x32, 0xAE, 0x36, 0xA1, 0x4D, 0xDB, 0xCD, 0x71, 0xE3, 0x67, 0x27, 0xEC, 0xE2, 0x1F, 0xF6, 0x5F, 0x52, 0x49, 0x52, 0xC4, 0x94, 0x3C, 0xEE, 0xF5, 0xCA, 0x84, 0x24, 0x7C, 0x62, 0x33, 0x84, 0x83, 0x0F, 0x52, 0x6E, 0x22, 0x91, 0x79, 0x0B, 0x0D, 0xDE, 0xE6, 0xE8, 0x8A, 0x07, 0x17, 0x32, 0xD9, 0xEF, 0x32, 0x5D, 0xF8, 0x89, 0x95, 0x08, 0x81, 0xFE, 0x5F, 0x03, 0xCF, 0x57, 0x82, 0xD0, 0x89, 0x00, 0x85, 0xD3, 0x66, 0xE5, 0x71, 0x15, 0x8F, 0x6E, 0x3C, 0x32, 0xAF, 0x3A, 0x03, 0xCC, 0xBB, 0x0E, 0x97, 0x54, 0x5E, 0x8F, 0x27, 0x6D, 0x94, 0x88, 0xC6, 0xBE, 0xB6, 0x8B, 0x6D, 0x1D, 0x14, 0x5D, 0xB1, 0xE4, 0xD1, 0x6E, 0xB2, 0xA4, 0xBD, 0xD6, 0x88, 0x54, 0xCF, 0xC8, 0xC1, 0x5F, 0x10, 0x24, 0x5E, 0x81, 0xC7, 0xA7, 0xCA, 0x79, 0x6A, 0x71, 0xB3, 0xD7, 0xCD, 0xA9, 0x28, 0xEE, 0x9D, 0xAC, 0xBF, 0xE1, 0x1B, 0x1D, 0x8F, 0x31, 0x51, 0x3E, 0xD5, 0xC4, 0x9A, 0xBA, 0xE2, 0x0A, 0x5E, 0xEA, 0x29, 0x70, 0x15, 0x5A, 0x51, 0x6F, 0x55, 0xF2, 0x2F, 0x84, 0x3F, 0xDC, 0xB7, 0x61, 0x77, 0xA6, 0xC1, 0xBE, 0xA6, 0xBD, 0x38, 0xB3, 0x59, 0x76, 0x52, 0xEE, 0xF7, 0xFA, 0x29, 0x40, 0x68, 0xC2, 0xE1, 0x23, 0x13, 0x65, 0xAE, 0x56, 0xBD, 0xB9, 0x30, 0x58, 0x68, 0x0A, 0x64, 0xD5, 0xE7, 0xE8, 0xB5, 0xA9, 0x77, 0x29, 0xD7, 0xE3, 0x82, 0x83, 0xE2, 0x49, 0x87, 0x8F, 0x07, 0x1B, 0x43, 0x3E, 0xF0, 0x6A, 0xDC, 0x63, 0x98, 0x0B, 0x26, 0x2F, 0x35, 0xD2, 0x7A, 0x38, 0xD8, 0x43, 0xB4, 0x56, 0x6B, 0x3B, 0xC5, 0x44, 0x4B, 0xE9, 0x0D, 0xFB, 0xAA, 0x81, 0xC7, 0xFD, 0x9B, 0xD0, 0xE1, 0xEA, 0x1C, 0xCC, 0x11, 0xF0, 0x15, 0x8B, 0xE2, 0xBB, 0xDC, 0xB3, 0xAC, 0x62, 0x19, 0xE4, 0x83, 0x0D, 0x46, 0xAD, 0x2C, 0x69, 0x23, 0x44, 0x59, 0x3E, 0xF4, 0x1C, 0x7A, 0xC3, 0xAA, 0xD0, 0x07, 0xE9, 0xFD, 0xB1, 0x59, 0x12, 0x79, 0x37, 0x09, 0x90, 0x5C, 0xEE, 0x07, 0x8F, 0xF3, 0x86, 0x3C, 0x09, 0xB6, 0x93, 0x3C, 0xFB, 0x41, 0xE5, 0xA5, 0x9E, 0x30, 0x6C, 0x70, 0xC5, 0xA3, 0x5A, 0x6B, 0x21, 0xF7, 0x9A, 0xEC, 0x19, 0x0B, 0x16, 0x0E, 0x59, 0x71, 0x04, 0x32, 0xAF, 0xCB, 0x1B, 0x93, 0xE6, 0x61, 0xB7, 0x31, 0xC3, 0x93
        MC_KE_COUNTER13: CryptoKeyElementAllowPartialAccess=false, CryptoKeyElementId=1012, CryptoKeyElementPersist=false, CryptoKeyElementReadAccess=CRYPTO_RA_ALLOWED, CryptoKeyElementSize=4, CryptoKeyElementWriteAccess=CRYPTO_WA_ALLOWED
        MC_KE_COUNTER14: CryptoKeyElementAllowPartialAccess=false, CryptoKeyElementId=1013, CryptoKeyElementPersist=false, CryptoKeyElementReadAccess=CRYPTO_RA_ALLOWED, CryptoKeyElementSize=4, CryptoKeyElementWriteAccess=CRYPTO_WA_ALLOWED
        MC_KE_COUNTER15: CryptoKeyElementAllowPartialAccess=false, CryptoKeyElementId=1014, CryptoKeyElementPersist=false, CryptoKeyElementReadAccess=CRYPTO_RA_ALLOWED, CryptoKeyElementSize=4, CryptoKeyElementWriteAccess=CRYPTO_WA_ALLOWED
        MC_KE_COUNTER16: CryptoKeyElementAllowPartialAccess=false, CryptoKeyElementId=1015, CryptoKeyElementPersist=false, CryptoKeyElementReadAccess=CRYPTO_RA_ALLOWED, CryptoKeyElementSize=4, CryptoKeyElementWriteAccess=CRYPTO_WA_ALLOWED
        CUSTOM_KE_ADVANCE_LIFE_CYCLE: CryptoKeyElementAllowPartialAccess=true, CryptoKeyElementId=1007, CryptoKeyElementPersist=false, CryptoKeyElementReadAccess=CRYPTO_RA_ALLOWED, CryptoKeyElementSize=1, CryptoKeyElementWriteAccess=CRYPTO_WA_ALLOWED
        CUSTOM_KE_DEVICE_ID: CryptoKeyElementAllowPartialAccess=true, CryptoKeyElementId=1006, CryptoKeyElementPersist=false, CryptoKeyElementReadAccess=CRYPTO_RA_ALLOWED, CryptoKeyElementSize=96, CryptoKeyElementWriteAccess=CRYPTO_WA_ALLOWED
        CRYPTO_KE_CIPHER_SHE_KEY: CryptoKeyElementAllowPartialAccess=false, CryptoKeyElementId=1, CryptoKeyElementPersist=true, CryptoKeyElementReadAccess=CRYPTO_RA_ENCRYPTED, CryptoKeyElementSize=16, CryptoKeyElementWriteAccess=CRYPTO_WA_ENCRYPTED
        CRYPTO_KE_MAC_SHE: CryptoKeyElementAllowPartialAccess=false, CryptoKeyElementId=1, CryptoKeyElementPersist=false, CryptoKeyElementReadAccess=CRYPTO_RA_ENCRYPTED, CryptoKeyElementSize=16, CryptoKeyElementWriteAccess=CRYPTO_WA_ENCRYPTED
        CRYPTO_KE_SHE_BOOT_MAC: CryptoKeyElementAllowPartialAccess=false, CryptoKeyElementId=1, CryptoKeyElementPersist=false, CryptoKeyElementReadAccess=CRYPTO_RA_ENCRYPTED, CryptoKeyElementSize=16, CryptoKeyElementWriteAccess=CRYPTO_WA_ENCRYPTED
        CRYPTO_KE_SHE_BOOT_MAC_KEY: CryptoKeyElementAllowPartialAccess=false, CryptoKeyElementId=1, CryptoKeyElementPersist=false, CryptoKeyElementReadAccess=CRYPTO_RA_ENCRYPTED, CryptoKeyElementSize=16, CryptoKeyElementWriteAccess=CRYPTO_WA_ENCRYPTED
        CRYPTO_KE_SHE_MASTER_ECU: CryptoKeyElementAllowPartialAccess=false, CryptoKeyElementId=1, CryptoKeyElementPersist=false, CryptoKeyElementReadAccess=CRYPTO_RA_ENCRYPTED, CryptoKeyElementSize=16, CryptoKeyElementWriteAccess=CRYPTO_WA_ENCRYPTED
        CRYPTO_KE_SIGNATURE_KEY_ECC_192: CryptoKeyElementAllowPartialAccess=true, CryptoKeyElementId=1, CryptoKeyElementPersist=false, CryptoKeyElementReadAccess=CRYPTO_RA_ALLOWED, CryptoKeyElementSize=49, CryptoKeyElementWriteAccess=CRYPTO_WA_ALLOWED
        CRYPTO_KE_SIGNATURE_KEY_ECC_224: CryptoKeyElementAllowPartialAccess=true, CryptoKeyElementId=1, CryptoKeyElementPersist=false, CryptoKeyElementReadAccess=CRYPTO_RA_ALLOWED, CryptoKeyElementSize=57, CryptoKeyElementWriteAccess=CRYPTO_WA_ALLOWED
        CRYPTO_KE_SIGNATURE_KEY_ECC_256: CryptoKeyElementAllowPartialAccess=true, CryptoKeyElementId=1, CryptoKeyElementPersist=false, CryptoKeyElementReadAccess=CRYPTO_RA_ALLOWED, CryptoKeyElementSize=65, CryptoKeyElementWriteAccess=CRYPTO_WA_ALLOWED
        CRYPTO_KE_SIGNATURE_KEY_ECC_320: CryptoKeyElementAllowPartialAccess=true, CryptoKeyElementId=1, CryptoKeyElementPersist=false, CryptoKeyElementReadAccess=CRYPTO_RA_ALLOWED, CryptoKeyElementSize=81, CryptoKeyElementWriteAccess=CRYPTO_WA_ALLOWED
        CRYPTO_KE_SIGNATURE_KEY_ECC_384: CryptoKeyElementAllowPartialAccess=true, CryptoKeyElementId=1, CryptoKeyElementPersist=false, CryptoKeyElementReadAccess=CRYPTO_RA_ALLOWED, CryptoKeyElementSize=97, CryptoKeyElementWriteAccess=CRYPTO_WA_ALLOWED
        CRYPTO_KE_SIGNATURE_KEY_ECC_512: CryptoKeyElementAllowPartialAccess=true, CryptoKeyElementId=1, CryptoKeyElementPersist=false, CryptoKeyElementReadAccess=CRYPTO_RA_ALLOWED, CryptoKeyElementSize=129, CryptoKeyElementWriteAccess=CRYPTO_WA_ALLOWED
        CRYPTO_KE_SIGNATURE_KEY_ECC_521: CryptoKeyElementAllowPartialAccess=true, CryptoKeyElementId=1, CryptoKeyElementPersist=false, CryptoKeyElementReadAccess=CRYPTO_RA_ALLOWED, CryptoKeyElementSize=133, CryptoKeyElementWriteAccess=CRYPTO_WA_ALLOWED
        CRYPTO_KE_SIGNATURE_KEY_ECDH_128: CryptoKeyElementAllowPartialAccess=true, CryptoKeyElementId=1, CryptoKeyElementPersist=false, CryptoKeyElementReadAccess=CRYPTO_RA_ALLOWED, CryptoKeyElementSize=33, CryptoKeyElementWriteAccess=CRYPTO_WA_ALLOWED
        CRYPTO_KE_SIGNATURE_KEY_ECDH_224: CryptoKeyElementAllowPartialAccess=true, CryptoKeyElementId=1, CryptoKeyElementPersist=false, CryptoKeyElementReadAccess=CRYPTO_RA_ALLOWED, CryptoKeyElementSize=57, CryptoKeyElementWriteAccess=CRYPTO_WA_ALLOWED
        CRYPTO_KE_SIGNATURE_KEY_ECDH_256: CryptoKeyElementAllowPartialAccess=true, CryptoKeyElementId=1, CryptoKeyElementPersist=false, CryptoKeyElementReadAccess=CRYPTO_RA_ALLOWED, CryptoKeyElementSize=65, CryptoKeyElementWriteAccess=CRYPTO_WA_ALLOWED
        CRYPTO_KE_SIGNATURE_KEY_ECDH_384: CryptoKeyElementAllowPartialAccess=true, CryptoKeyElementId=1, CryptoKeyElementPersist=false, CryptoKeyElementReadAccess=CRYPTO_RA_ALLOWED, CryptoKeyElementSize=97, CryptoKeyElementWriteAccess=CRYPTO_WA_ALLOWED
        CRYPTO_KE_SIGNATURE_KEY_ECDH_512: CryptoKeyElementAllowPartialAccess=true, CryptoKeyElementId=1, CryptoKeyElementPersist=false, CryptoKeyElementReadAccess=CRYPTO_RA_ALLOWED, CryptoKeyElementSize=129, CryptoKeyElementWriteAccess=CRYPTO_WA_ALLOWED
        CRYPTO_KE_SIGNATURE_KEY_ED_448: CryptoKeyElementAllowPartialAccess=true, CryptoKeyElementId=1, CryptoKeyElementPersist=false, CryptoKeyElementReadAccess=CRYPTO_RA_ALLOWED, CryptoKeyElementSize=57, CryptoKeyElementWriteAccess=CRYPTO_WA_ALLOWED
        CRYPTO_KE_SIGNATURE_KEY_ED_25519: CryptoKeyElementAllowPartialAccess=true, CryptoKeyElementId=1, CryptoKeyElementPersist=false, CryptoKeyElementReadAccess=CRYPTO_RA_ALLOWED, CryptoKeyElementSize=32, CryptoKeyElementWriteAccess=CRYPTO_WA_ALLOWED
    CryptoKeyTypes
      40 x CryptoKeyType:
        CryptoKeyType_Hash: CryptoKeyElementRef=Hash_KeyElement
        CryptoKeyType_MKA_CAK: CryptoKeyElementRef=MKA_KE_CAK_CKN, CryptoKeyElementRef=MKA_KE_CAK_KEY_CUSTOM
        CryptoKeyType_MKA_Random: CryptoKeyElementRef=MKA_Random_KeyElement
        CryptoKeyType_MKA_ICK: CryptoKeyElementRef=MKA_ICK_KeyElement
        CryptoKeyType_RNG: CryptoKeyElementRef=CRYPTO_KE_RANDOM_ALGORITHM, CryptoKeyElementRef=CRYPTO_KE_RANDOM_SEED_STATE
        CryptoKeyType_MKA_KEK: CryptoKeyElementRef=MKA_KEK_KeyElement
        CryptoKeyType_MKA_SAK: CryptoKeyElementRef=CRYPTO_KE_CIPHER_2NDKEY, CryptoKeyElementRef=CRYPTO_KE_CIPHER_IV, CryptoKeyElementRef=CRYPTO_KE_CIPHER_KEY, CryptoKeyElementRef=CRYPTO_KE_CIPHER_PROOF
        CryptoKeyType_MKA_MAC: CryptoKeyElementRef=MKA_MAC_KeyElement
        CryptoKeyType_MKA_SAK_Data: CryptoKeyElementRef=MKA_SAK_Data_KeyElement
        CryptoKeyType_KeyGenerate: CryptoKeyElementRef=CRYPTO_KE_KEYGENERATE_ALGORITHM, CryptoKeyElementRef=CRYPTO_KE_KEYGENERATE_CURVETYPE, CryptoKeyElementRef=CRYPTO_KE_KEYGENERATE_KEY, CryptoKeyElementRef=CRYPTO_KE_KEYGENERATE_SEED
        CryptoKeyType_Custom_Operations: CryptoKeyElementRef=CUSTOM_KE_KDF, CryptoKeyElementRef=CUSTOM_KE_KUW, CryptoKeyElementRef=CUSTOM_KE_VER, CryptoKeyElementRef=CUSTOM_KE_DUAL_BOOT_BOOT_STATUS, CryptoKeyElementRef=CUSTOM_KE_DUAL_BOOT_RESET_STATUS, CryptoKeyElementRef=CUSTOM_KE_SWD_UNLOCK, CryptoKeyElementRef=CUSTOM_KE_SWD_LOCK, CryptoKeyElementRef=CUSTOM_KE_ADVANCE_LIFE_CYCLE, CryptoKeyElementRef=CUSTOM_KE_DEVICE_ID
        CryptoKeyType_KeyExchange: CryptoKeyElementRef=CRYPTO_KE_KEYEXCHANGE_ALGORITHM, CryptoKeyElementRef=CRYPTO_KE_KEYEXCHANGE_BASE, CryptoKeyElementRef=CRYPTO_KE_KEYEXCHANGE_CURVETYPE, CryptoKeyElementRef=CRYPTO_KE_KEYEXCHANGE_OWNPUBKEY, CryptoKeyElementRef=CRYPTO_KE_KEYEXCHANGE_PRIVKEY, CryptoKeyElementRef=CRYPTO_KE_KEYEXCHANGE_SHAREDVALUE
        CryptoKeyType_Monotonic_Counters: CryptoKeyElementRef=MC_KE_COUNTER1, CryptoKeyElementRef=MC_KE_COUNTER2, CryptoKeyElementRef=MC_KE_COUNTER3, CryptoKeyElementRef=MC_KE_COUNTER4, CryptoKeyElementRef=MC_KE_COUNTER5, CryptoKeyElementRef=MC_KE_COUNTER6, CryptoKeyElementRef=MC_KE_COUNTER7, CryptoKeyElementRef=MC_KE_COUNTER8, CryptoKeyElementRef=MC_KE_COUNTER9, CryptoKeyElementRef=MC_KE_COUNTER10, CryptoKeyElementRef=MC_KE_COUNTER11, CryptoKeyElementRef=MC_KE_COUNTER12, CryptoKeyElementRef=MC_KE_COUNTER13, CryptoKeyElementRef=MC_KE_COUNTER14, CryptoKeyElementRef=MC_KE_COUNTER15, CryptoKeyElementRef=MC_KE_COUNTER16
        CryptoKeyType_KeyGenerate_ECC: CryptoKeyElementRef=CRYPTO_KE_KEYGENERATE_ALGORITHM, CryptoKeyElementRef=CRYPTO_KE_KEYGENERATE_CURVETYPE, CryptoKeyElementRef=CRYPTO_KE_KEYGENERATE_SEED, CryptoKeyElementRef=CRYPTO_KE_KEYGENERATE_ECC_PRIVATE_KEY, CryptoKeyElementRef=CRYPTO_KE_KEYGENERATE_ECC_PUBLIC_KEY
        CryptoKeyType_Cipher_AES_128: CryptoKeyElementRef=CRYPTO_KE_CIPHER_KEY_AES_128, CryptoKeyElementRef=CRYPTO_KE_CIPHER_IV, CryptoKeyElementRef=CRYPTO_KE_CIPHER_2NDKEY, CryptoKeyElementRef=CRYPTO_KE_CIPHER_PROOF
        CryptoKeyType_Cipher_AES_256: CryptoKeyElementRef=CRYPTO_KE_CIPHER_KEY_AES_256, CryptoKeyElementRef=CRYPTO_KE_CIPHER_IV, CryptoKeyElementRef=CRYPTO_KE_CIPHER_2NDKEY, CryptoKeyElementRef=CRYPTO_KE_CIPHER_PROOF
        CryptoKeyType_Cipher_RSA_1024: CryptoKeyElementRef=CRYPTO_KE_RSA_LABEL, CryptoKeyElementRef=CRYPTO_KE_RSA_MODULUS_1024, CryptoKeyElementRef=CRYPTO_KE_RSA_PRIV_EXPONENT_1024, CryptoKeyElementRef=CRYPTO_KE_RSA_PUB_EXPONENT, CryptoKeyElementRef=CRYPTO_KE_RSA_SALT, CryptoKeyElementRef=CRYPTO_KE_RSA_SALT_LENGTH
        CryptoKeyType_Cipher_RSA_2048: CryptoKeyElementRef=CRYPTO_KE_RSA_LABEL, CryptoKeyElementRef=CRYPTO_KE_RSA_MODULUS_2048, CryptoKeyElementRef=CRYPTO_KE_RSA_PRIV_EXPONENT_2048, CryptoKeyElementRef=CRYPTO_KE_RSA_PUB_EXPONENT, CryptoKeyElementRef=CRYPTO_KE_RSA_SALT, CryptoKeyElementRef=CRYPTO_KE_RSA_SALT_LENGTH
        CryptoKeyType_Cipher_RSA_3072: CryptoKeyElementRef=CRYPTO_KE_RSA_LABEL, CryptoKeyElementRef=CRYPTO_KE_RSA_MODULUS_3072, CryptoKeyElementRef=CRYPTO_KE_RSA_PRIV_EXPONENT_3072, CryptoKeyElementRef=CRYPTO_KE_RSA_PUB_EXPONENT, CryptoKeyElementRef=CRYPTO_KE_RSA_SALT, CryptoKeyElementRef=CRYPTO_KE_RSA_SALT_LENGTH
        CryptoKeyType_Cipher_RSA_4096: CryptoKeyElementRef=CRYPTO_KE_RSA_LABEL, CryptoKeyElementRef=CRYPTO_KE_RSA_MODULUS_4096, CryptoKeyElementRef=CRYPTO_KE_RSA_PRIV_EXPONENT_4096, CryptoKeyElementRef=CRYPTO_KE_RSA_PUB_EXPONENT, CryptoKeyElementRef=CRYPTO_KE_RSA_SALT, CryptoKeyElementRef=CRYPTO_KE_RSA_SALT_LENGTH
        CryptoKeyType_Cipher_SHE: CryptoKeyElementRef=CRYPTO_KE_CIPHER_SHE_KEY, CryptoKeyElementRef=CRYPTO_KE_CIPHER_PROOF, CryptoKeyElementRef=CRYPTO_KE_CIPHER_IV
        CryptoKeyType_MAC_SHE: CryptoKeyElementRef=CRYPTO_KE_MAC_SHE, CryptoKeyElementRef=CRYPTO_KE_MAC_PROOF
        CryptoKeyType_SHE_Boot_MAC: CryptoKeyElementRef=CRYPTO_KE_SHE_BOOT_MAC, CryptoKeyElementRef=CRYPTO_KE_CIPHER_PROOF
        CryptoKeyType_SHE_Boot_MAC_Key: CryptoKeyElementRef=CRYPTO_KE_SHE_BOOT_MAC_KEY, CryptoKeyElementRef=CRYPTO_KE_CIPHER_PROOF
        CryptoKeyType_SHE_Master_ECU: CryptoKeyElementRef=CRYPTO_KE_SHE_MASTER_ECU, CryptoKeyElementRef=CRYPTO_KE_CIPHER_PROOF
        CryptoKeyType_Signature_key: CryptoKeyElementRef=CRYPTO_KE_SIGNATURE_CURVETYPE, CryptoKeyElementRef=CRYPTO_KE_SIGNATURE_KEY
        CryptoKeyType_Signature_key_ECC_192: CryptoKeyElementRef=CRYPTO_KE_SIGNATURE_CURVETYPE, CryptoKeyElementRef=CRYPTO_KE_SIGNATURE_KEY_ECC_192
        CryptoKeyType_Signature_key_ECC_224: CryptoKeyElementRef=CRYPTO_KE_SIGNATURE_CURVETYPE, CryptoKeyElementRef=CRYPTO_KE_SIGNATURE_KEY_ECC_224
        CryptoKeyType_Signature_key_ECC_256: CryptoKeyElementRef=CRYPTO_KE_SIGNATURE_CURVETYPE, CryptoKeyElementRef=CRYPTO_KE_SIGNATURE_KEY_ECC_256
        CryptoKeyType_Signature_key_ECC_320: CryptoKeyElementRef=CRYPTO_KE_SIGNATURE_CURVETYPE, CryptoKeyElementRef=CRYPTO_KE_SIGNATURE_KEY_ECC_320
        CryptoKeyType_Signature_key_ECC_384: CryptoKeyElementRef=CRYPTO_KE_SIGNATURE_CURVETYPE, CryptoKeyElementRef=CRYPTO_KE_SIGNATURE_KEY_ECC_384
        CryptoKeyType_Signature_key_ECC_512: CryptoKeyElementRef=CRYPTO_KE_SIGNATURE_CURVETYPE, CryptoKeyElementRef=CRYPTO_KE_SIGNATURE_KEY_ECC_512
        CryptoKeyType_Signature_key_ECC_521: CryptoKeyElementRef=CRYPTO_KE_SIGNATURE_CURVETYPE, CryptoKeyElementRef=CRYPTO_KE_SIGNATURE_KEY_ECC_521
        CryptoKeyType_Signature_key_ECDH_128: CryptoKeyElementRef=CRYPTO_KE_SIGNATURE_CURVETYPE, CryptoKeyElementRef=CRYPTO_KE_SIGNATURE_KEY_ECDH_128
        CryptoKeyType_Signature_key_ECDH_224: CryptoKeyElementRef=CRYPTO_KE_SIGNATURE_CURVETYPE, CryptoKeyElementRef=CRYPTO_KE_SIGNATURE_KEY_ECDH_224
        CryptoKeyType_Signature_key_ECDH_256: CryptoKeyElementRef=CRYPTO_KE_SIGNATURE_CURVETYPE, CryptoKeyElementRef=CRYPTO_KE_SIGNATURE_KEY_ECDH_256
        CryptoKeyType_Signature_key_ECDH_384: CryptoKeyElementRef=CRYPTO_KE_SIGNATURE_CURVETYPE, CryptoKeyElementRef=CRYPTO_KE_SIGNATURE_KEY_ECDH_384
        CryptoKeyType_Signature_key_ECDH_512: CryptoKeyElementRef=CRYPTO_KE_SIGNATURE_CURVETYPE, CryptoKeyElementRef=CRYPTO_KE_SIGNATURE_KEY_ECDH_512
        CryptoKeyType_Signature_key_ED_448: CryptoKeyElementRef=CRYPTO_KE_SIGNATURE_CURVETYPE, CryptoKeyElementRef=CRYPTO_KE_SIGNATURE_KEY_ED_448
        CryptoKeyType_Signature_key_ED_25519: CryptoKeyElementRef=CRYPTO_KE_SIGNATURE_CURVETYPE, CryptoKeyElementRef=CRYPTO_KE_SIGNATURE_KEY_ED_25519
    CryptoKeys
      62 x CryptoKey:
        Hash_Key: CryptoKeyId=15, CryptoKeyTypeRef=CryptoKeyType_Hash
        AES_128_Key: CryptoKeyId=16, CryptoKeyTypeRef=CryptoKeyType_Cipher_AES_128
        MKA_CAK_Key: CryptoKeyId=17, CryptoKeyTypeRef=CryptoKeyType_MKA_CAK
        MKA_Random_Key: CryptoKeyId=18, CryptoKeyTypeRef=CryptoKeyType_MKA_Random
        MKA_ICK_Key: CryptoKeyId=19, CryptoKeyTypeRef=CryptoKeyType_MKA_ICK
        RNG_Key: CryptoKeyId=20, CryptoKeyTypeRef=CryptoKeyType_RNG
        MKA_KEK_Key: CryptoKeyId=21, CryptoKeyTypeRef=CryptoKeyType_MKA_KEK
        MKA_SAK_Key: CryptoKeyId=22, CryptoKeyTypeRef=CryptoKeyType_MKA_SAK
        MKA_MAC_Key: CryptoKeyId=23, CryptoKeyTypeRef=CryptoKeyType_MKA_MAC
        MKA_SAK_Data_Key: CryptoKeyId=24, CryptoKeyTypeRef=CryptoKeyType_MKA_SAK_Data
        AES_256_Key: CryptoKeyId=27, CryptoKeyTypeRef=CryptoKeyType_Cipher_AES_256
        RSA_1024_Key: CryptoKeyId=28, CryptoKeyTypeRef=CryptoKeyType_Cipher_RSA_1024
        RSA_2048_Key: CryptoKeyId=29, CryptoKeyTypeRef=CryptoKeyType_Cipher_RSA_2048
        RSA_3072_Key: CryptoKeyId=30, CryptoKeyTypeRef=CryptoKeyType_Cipher_RSA_3072
        RSA_4096_Key: CryptoKeyId=31, CryptoKeyTypeRef=CryptoKeyType_Cipher_RSA_4096
        ECC_192_Key_SigGenerate: CryptoKeyId=32, CryptoKeyTypeRef=CryptoKeyType_Signature_key_ECC_192
        ECC_224_Key_SigGenerate: CryptoKeyId=33, CryptoKeyTypeRef=CryptoKeyType_Signature_key_ECC_224
        ECC_256_Key_SigGenerate: CryptoKeyId=34, CryptoKeyTypeRef=CryptoKeyType_Signature_key_ECC_256
        ECC_384_Key_SigGenerate: CryptoKeyId=35, CryptoKeyTypeRef=CryptoKeyType_Signature_key_ECC_384
        ECC_512_Key_SigGenerate: CryptoKeyId=38, CryptoKeyTypeRef=CryptoKeyType_Signature_key_ECC_512
        ECC_521_Key_SigGenerate: CryptoKeyId=36, CryptoKeyTypeRef=CryptoKeyType_Signature_key_ECC_521
        ECC_320_Key_SigGenerate: CryptoKeyId=37, CryptoKeyTypeRef=CryptoKeyType_Signature_key_ECC_320
        Custom_Operations: CryptoKeyId=25, CryptoKeyTypeRef=CryptoKeyType_Custom_Operations
        ECDH_128_Key_SigGenerate: CryptoKeyId=39, CryptoKeyTypeRef=CryptoKeyType_Signature_key_ECDH_128
        ECDH_224_Key_SigGenerate: CryptoKeyId=40, CryptoKeyTypeRef=CryptoKeyType_Signature_key_ECDH_224
        ECDH_256_Key_SigGenerate: CryptoKeyId=41, CryptoKeyTypeRef=CryptoKeyType_Signature_key_ECDH_256
        ECDH_384_Key_SigGenerate: CryptoKeyId=42, CryptoKeyTypeRef=CryptoKeyType_Signature_key_ECDH_384
        ECDH_512_Key_SigGenerate: CryptoKeyId=43, CryptoKeyTypeRef=CryptoKeyType_Signature_key_ECDH_512
        Monotonic_Counter: CryptoKeyId=26, CryptoKeyTypeRef=CryptoKeyType_Monotonic_Counters
        ED448_Key_SigGenerate: CryptoKeyId=44, CryptoKeyTypeRef=CryptoKeyType_Signature_key_ED_448
        ECC_256_Key_Generate: CryptoKeyId=45, CryptoKeyTypeRef=CryptoKeyType_KeyGenerate_ECC
        Boot_MAC: CryptoKeyId=3, CryptoKeyTypeRef=CryptoKeyType_SHE_Boot_MAC
        Boot_MAC_Key: CryptoKeyId=2, CryptoKeyTypeRef=CryptoKeyType_SHE_Boot_MAC_Key
        Master_ECU_Key: CryptoKeyId=1, CryptoKeyTypeRef=CryptoKeyType_SHE_Master_ECU
        SHE_KEY_1: CryptoKeyId=4, CryptoKeyTypeRef=CryptoKeyType_Cipher_SHE
        SHE_KEY_2: CryptoKeyId=5, CryptoKeyTypeRef=CryptoKeyType_Cipher_SHE
        SHE_KEY_3: CryptoKeyId=6, CryptoKeyTypeRef=CryptoKeyType_Cipher_SHE
        SHE_KEY_4: CryptoKeyId=7, CryptoKeyTypeRef=CryptoKeyType_Cipher_SHE
        SHE_KEY_5: CryptoKeyId=8, CryptoKeyTypeRef=CryptoKeyType_Cipher_SHE
        SHE_KEY_6: CryptoKeyId=9, CryptoKeyTypeRef=CryptoKeyType_Cipher_SHE
        SHE_KEY_7: CryptoKeyId=10, CryptoKeyTypeRef=CryptoKeyType_MAC_SHE
        SHE_KEY_8: CryptoKeyId=11, CryptoKeyTypeRef=CryptoKeyType_MAC_SHE
        SHE_KEY_9: CryptoKeyId=12, CryptoKeyTypeRef=CryptoKeyType_MAC_SHE
        SHE_KEY_10: CryptoKeyId=13, CryptoKeyTypeRef=CryptoKeyType_MAC_SHE
        SHE_RAM_KEY: CryptoKeyId=14, CryptoKeyTypeRef=CryptoKeyType_Cipher_SHE
        ED25519_Key_SigGenerate: CryptoKeyId=46, CryptoKeyTypeRef=CryptoKeyType_Signature_key_ED_25519
        ECC_192_Key_SigVerify: CryptoKeyId=47, CryptoKeyTypeRef=CryptoKeyType_Signature_key_ECC_192
        ECC_224_Key_SigVerify: CryptoKeyId=48, CryptoKeyTypeRef=CryptoKeyType_Signature_key_ECC_224
        ECC_256_Key_SigVerify: CryptoKeyId=49, CryptoKeyTypeRef=CryptoKeyType_Signature_key_ECC_256
        ECC_320_Key_SigVerify: CryptoKeyId=50, CryptoKeyTypeRef=CryptoKeyType_Signature_key_ECC_320
        ECC_384_Key_SigVerify: CryptoKeyId=51, CryptoKeyTypeRef=CryptoKeyType_Signature_key_ECC_384
        ECC_512_Key_SigVerify: CryptoKeyId=52, CryptoKeyTypeRef=CryptoKeyType_Signature_key_ECC_512
        ECC_521_Key_SigVerify: CryptoKeyId=53, CryptoKeyTypeRef=CryptoKeyType_Signature_key_ECC_521
        ECDH_128_Key_SigVerify: CryptoKeyId=54, CryptoKeyTypeRef=CryptoKeyType_Signature_key_ECDH_128
        ECDH_224_Key_SigVerify: CryptoKeyId=55, CryptoKeyTypeRef=CryptoKeyType_Signature_key_ECDH_224
        ECDH_256_Key_SigVerify: CryptoKeyId=56, CryptoKeyTypeRef=CryptoKeyType_Signature_key_ECDH_256
        ECDH_384_Key_SigVerify: CryptoKeyId=57, CryptoKeyTypeRef=CryptoKeyType_Signature_key_ECDH_384
        ECDH_512_Key_SigVerify: CryptoKeyId=58, CryptoKeyTypeRef=CryptoKeyType_Signature_key_ECDH_512
        ED448_Key_SigVerify: CryptoKeyId=59, CryptoKeyTypeRef=CryptoKeyType_Signature_key_ED_448
        ED25519_Key_SigVerify: CryptoKeyId=60, CryptoKeyTypeRef=CryptoKeyType_Signature_key_ED_25519
        ECC_256_Key_Generate_2: CryptoKeyId=61, CryptoKeyTypeRef=CryptoKeyType_KeyGenerate_ECC
        ECC_224_Key_Exchange: CryptoKeyId=62, CryptoKeyTypeRef=CryptoKeyType_KeyExchange
    CryptoPrimitives
      6 x CryptoPrimitiveAlgorithmModeCustom:
        CRYPTO_ALGOMODE_CUSTOM_ECCNIST_P192R1: CryptoPrimitiveAlgorithmModeCustomId=128
        CRYPTO_ALGOMODE_CUSTOM_ECCNIST_P224R1: CryptoPrimitiveAlgorithmModeCustomId=129
        CRYPTO_ALGOMODE_CUSTOM_ECCNIST_P256R1: CryptoPrimitiveAlgorithmModeCustomId=130
        CRYPTO_ALGOMODE_CUSTOM_ECCNIST_P384R1: CryptoPrimitiveAlgorithmModeCustomId=131
        CRYPTO_ALGOMODE_CUSTOM_ECCNIST_P521R1: CryptoPrimitiveAlgorithmModeCustomId=132
        CRYPTO_ALGOMODE_CUSTOM_ECCBRAINPOOL_P192R1: CryptoPrimitiveAlgorithmModeCustomId=133
      25 x CryptoPrimitive:
        SHA2_256: CryptoPrimitiveAlgorithmSecondaryFamily=CRYPTO_ALGOFAM_NOT_SET, CryptoPrimitiveService=CRYPTO_HASH, CryptoPrimitiveAlgorithmMode=CRYPTO_ALGOMODE_NOT_SET, CryptoPrimitiveAlgorithmFamily=CRYPTO_ALGOFAM_SHA2_256
        AesEncrypt: CryptoPrimitiveAlgorithmFamily=CRYPTO_ALGOFAM_AES, CryptoPrimitiveAlgorithmMode=CRYPTO_ALGOMODE_ECB, CryptoPrimitiveAlgorithmSecondaryFamily=CRYPTO_ALGOFAM_NOT_SET, CryptoPrimitiveService=CRYPTO_ENCRYPT, CryptoPrimitiveAlgorithmMode=CRYPTO_ALGOMODE_CBC, CryptoPrimitiveAlgorithmMode=CRYPTO_ALGOMODE_CFB, CryptoPrimitiveAlgorithmMode=CRYPTO_ALGOMODE_CTR, CryptoPrimitiveAlgorithmMode=CRYPTO_ALGOMODE_GCM, CryptoPrimitiveAlgorithmSecondaryFamily=CRYPTO_ALGOFAM_PADDING_PKCS7
        AesDecrypt: CryptoPrimitiveAlgorithmFamily=CRYPTO_ALGOFAM_AES, CryptoPrimitiveAlgorithmMode=CRYPTO_ALGOMODE_ECB, CryptoPrimitiveAlgorithmSecondaryFamily=CRYPTO_ALGOFAM_NOT_SET, CryptoPrimitiveService=CRYPTO_DECRYPT, CryptoPrimitiveAlgorithmMode=CRYPTO_ALGOMODE_CBC, CryptoPrimitiveAlgorithmMode=CRYPTO_ALGOMODE_CFB, CryptoPrimitiveAlgorithmMode=CRYPTO_ALGOMODE_CTR, CryptoPrimitiveAlgorithmMode=CRYPTO_ALGOMODE_GCM, CryptoPrimitiveAlgorithmSecondaryFamily=CRYPTO_ALGOFAM_PADDING_PKCS7
        MacGenerate: CryptoPrimitiveAlgorithmFamily=CRYPTO_ALGOFAM_AES, CryptoPrimitiveAlgorithmMode=CRYPTO_ALGOMODE_CMAC, CryptoPrimitiveAlgorithmSecondaryFamily=CRYPTO_ALGOFAM_NOT_SET, CryptoPrimitiveService=CRYPTO_MACGENERATE
        MacVerify: CryptoPrimitiveAlgorithmFamily=CRYPTO_ALGOFAM_AES, CryptoPrimitiveAlgorithmMode=CRYPTO_ALGOMODE_CMAC, CryptoPrimitiveAlgorithmSecondaryFamily=CRYPTO_ALGOFAM_NOT_SET, CryptoPrimitiveService=CRYPTO_MACVERIFY
        SHA2_224: CryptoPrimitiveAlgorithmFamily=CRYPTO_ALGOFAM_SHA2_224, CryptoPrimitiveAlgorithmMode=CRYPTO_ALGOMODE_NOT_SET, CryptoPrimitiveAlgorithmSecondaryFamily=CRYPTO_ALGOFAM_NOT_SET, CryptoPrimitiveService=CRYPTO_HASH
        SHA2_384: CryptoPrimitiveAlgorithmSecondaryFamily=CRYPTO_ALGOFAM_NOT_SET, CryptoPrimitiveService=CRYPTO_HASH, CryptoPrimitiveAlgorithmMode=CRYPTO_ALGOMODE_NOT_SET, CryptoPrimitiveAlgorithmFamily=CRYPTO_ALGOFAM_SHA2_384
        SHA2_512: CryptoPrimitiveAlgorithmSecondaryFamily=CRYPTO_ALGOFAM_NOT_SET, CryptoPrimitiveService=CRYPTO_HASH, CryptoPrimitiveAlgorithmMode=CRYPTO_ALGOMODE_NOT_SET, CryptoPrimitiveAlgorithmFamily=CRYPTO_ALGOFAM_SHA2_512
        SHA2_512_224: CryptoPrimitiveAlgorithmSecondaryFamily=CRYPTO_ALGOFAM_NOT_SET, CryptoPrimitiveService=CRYPTO_HASH, CryptoPrimitiveAlgorithmMode=CRYPTO_ALGOMODE_NOT_SET, CryptoPrimitiveAlgorithmFamily=CRYPTO_ALGOFAM_SHA2_512_224
        SHA2_512_256: CryptoPrimitiveAlgorithmSecondaryFamily=CRYPTO_ALGOFAM_NOT_SET, CryptoPrimitiveService=CRYPTO_HASH, CryptoPrimitiveAlgorithmMode=CRYPTO_ALGOMODE_NOT_SET, CryptoPrimitiveAlgorithmFamily=CRYPTO_ALGOFAM_SHA2_512_256
        SHA1: CryptoPrimitiveAlgorithmSecondaryFamily=CRYPTO_ALGOFAM_NOT_SET, CryptoPrimitiveService=CRYPTO_HASH, CryptoPrimitiveAlgorithmMode=CRYPTO_ALGOMODE_NOT_SET, CryptoPrimitiveAlgorithmFamily=CRYPTO_ALGOFAM_SHA1
        RNG: CryptoPrimitiveAlgorithmFamily=CRYPTO_ALGOFAM_RNG, CryptoPrimitiveAlgorithmMode=CRYPTO_ALGOMODE_NOT_SET, CryptoPrimitiveAlgorithmSecondaryFamily=CRYPTO_ALGOFAM_NOT_SET, CryptoPrimitiveService=CRYPTO_RANDOMGENERATE, CryptoPrimitiveAlgorithmMode=CRYPTO_ALGOMODE_CTRDRBG
        AEADGCMDecrypt: CryptoPrimitiveAlgorithmFamily=CRYPTO_ALGOFAM_AES, CryptoPrimitiveAlgorithmMode=CRYPTO_ALGOMODE_GCM, CryptoPrimitiveService=CRYPTO_AEADDECRYPT, CryptoPrimitiveAlgorithmSecondaryFamily=CRYPTO_ALGOFAM_NOT_SET
        AEADGCMEncrypt: CryptoPrimitiveAlgorithmFamily=CRYPTO_ALGOFAM_AES, CryptoPrimitiveAlgorithmMode=CRYPTO_ALGOMODE_GCM, CryptoPrimitiveService=CRYPTO_AEADENCRYPT, CryptoPrimitiveAlgorithmSecondaryFamily=CRYPTO_ALGOFAM_NOT_SET
        HMAC_Generate: CryptoPrimitiveAlgorithmFamily=CRYPTO_ALGOFAM_SHA2_224, CryptoPrimitiveAlgorithmMode=CRYPTO_ALGOMODE_HMAC, CryptoPrimitiveAlgorithmSecondaryFamily=CRYPTO_ALGOFAM_NOT_SET, CryptoPrimitiveService=CRYPTO_MACGENERATE, CryptoPrimitiveAlgorithmFamily=CRYPTO_ALGOFAM_SHA2_256, CryptoPrimitiveAlgorithmFamily=CRYPTO_ALGOFAM_SHA2_384, CryptoPrimitiveAlgorithmFamily=CRYPTO_ALGOFAM_SHA2_512, CryptoPrimitiveAlgorithmFamily=CRYPTO_ALGOFAM_SHA2_512_224, CryptoPrimitiveAlgorithmFamily=CRYPTO_ALGOFAM_SHA2_512_256
        HMAC_Verify: CryptoPrimitiveAlgorithmFamily=CRYPTO_ALGOFAM_SHA2_224, CryptoPrimitiveAlgorithmMode=CRYPTO_ALGOMODE_HMAC, CryptoPrimitiveAlgorithmSecondaryFamily=CRYPTO_ALGOFAM_NOT_SET, CryptoPrimitiveService=CRYPTO_MACVERIFY, CryptoPrimitiveAlgorithmFamily=CRYPTO_ALGOFAM_SHA2_256, CryptoPrimitiveAlgorithmFamily=CRYPTO_ALGOFAM_SHA2_384, CryptoPrimitiveAlgorithmFamily=CRYPTO_ALGOFAM_SHA2_512, CryptoPrimitiveAlgorithmFamily=CRYPTO_ALGOFAM_SHA2_512_224, CryptoPrimitiveAlgorithmFamily=CRYPTO_ALGOFAM_SHA2_512_256
        RSAEncrypt: CryptoPrimitiveAlgorithmFamily=CRYPTO_ALGOFAM_RSA, CryptoPrimitiveAlgorithmMode=CRYPTO_ALGOMODE_RSAES_OAEP, CryptoPrimitiveService=CRYPTO_ENCRYPT, CryptoPrimitiveAlgorithmMode=CRYPTO_ALGOMODE_RSAES_PKCS1_v1_5, CryptoPrimitiveAlgorithmSecondaryFamily=CRYPTO_ALGOFAM_NOT_SET
        RSADecrypt: CryptoPrimitiveAlgorithmFamily=CRYPTO_ALGOFAM_RSA, CryptoPrimitiveService=CRYPTO_DECRYPT, CryptoPrimitiveAlgorithmMode=CRYPTO_ALGOMODE_RSAES_OAEP, CryptoPrimitiveAlgorithmMode=CRYPTO_ALGOMODE_RSAES_PKCS1_v1_5, CryptoPrimitiveAlgorithmSecondaryFamily=CRYPTO_ALGOFAM_NOT_SET
        SignatureGenerate: CryptoPrimitiveAlgorithmFamily=CRYPTO_ALGOFAM_RSA, CryptoPrimitiveAlgorithmMode=CRYPTO_ALGOMODE_RSASSA_PKCS1_v1_5, CryptoPrimitiveAlgorithmSecondaryFamily=CRYPTO_ALGOFAM_NOT_SET, CryptoPrimitiveService=CRYPTO_SIGNATUREGENERATE, CryptoPrimitiveAlgorithmFamily=CRYPTO_ALGOFAM_ECCNIST, CryptoPrimitiveAlgorithmFamily=CRYPTO_ALGOFAM_BRAINPOOL, CryptoPrimitiveAlgorithmMode=CRYPTO_ALGOMODE_NOT_SET, CryptoPrimitiveAlgorithmFamily=CRYPTO_ALGOFAM_ED25519, CryptoPrimitiveAlgorithmSecondaryFamily=CRYPTO_ALGOFAM_SHA2_224, CryptoPrimitiveAlgorithmSecondaryFamily=CRYPTO_ALGOFAM_SHA2_256, CryptoPrimitiveAlgorithmSecondaryFamily=CRYPTO_ALGOFAM_SHA2_384, CryptoPrimitiveAlgorithmSecondaryFamily=CRYPTO_ALGOFAM_SHA2_512, CryptoPrimitiveAlgorithmSecondaryFamily=CRYPTO_ALGOFAM_SHA2_512_224, CryptoPrimitiveAlgorithmSecondaryFamily=CRYPTO_ALGOFAM_SHA2_512_256, CryptoPrimitiveAlgorithmMode=CRYPTO_ALGOMODE_RSASSA_PSS, CryptoPrimitiveAlgorithmModeCustomRef=CRYPTO_ALGOMODE_CUSTOM_ECCBRAINPOOL_P192R1, CryptoPrimitiveAlgorithmModeCustomRef=CRYPTO_ALGOMODE_CUSTOM_ECCNIST_P192R1, CryptoPrimitiveAlgorithmModeCustomRef=CRYPTO_ALGOMODE_CUSTOM_ECCNIST_P224R1, CryptoPrimitiveAlgorithmModeCustomRef=CRYPTO_ALGOMODE_CUSTOM_ECCNIST_P256R1, CryptoPrimitiveAlgorithmModeCustomRef=CRYPTO_ALGOMODE_CUSTOM_ECCNIST_P384R1, CryptoPrimitiveAlgorithmModeCustomRef=CRYPTO_ALGOMODE_CUSTOM_ECCNIST_P521R1, CryptoPrimitiveAlgorithmModeCustomRef=CRYPTO_ALGOMODE_CUSTOM_ECCBRAINPOOL_P224R1, CryptoPrimitiveAlgorithmModeCustomRef=CRYPTO_ALGOMODE_CUSTOM_ECCBRAINPOOL_P256R1, CryptoPrimitiveAlgorithmModeCustomRef=CRYPTO_ALGOMODE_CUSTOM_ECCBRAINPOOL_P320R1, CryptoPrimitiveAlgorithmModeCustomRef=CRYPTO_ALGOMODE_CUSTOM_ECCBRAINPOOL_P384R1, CryptoPrimitiveAlgorithmModeCustomRef=CRYPTO_ALGOMODE_CUSTOM_ECCBRAINPOOL_P512R1, CryptoPrimitiveAlgorithmModeCustomRef=CRYPTO_ALGOMODE_CUSTOM_ECCBRAINPOOL_P192T1, CryptoPrimitiveAlgorithmModeCustomRef=CRYPTO_ALGOMODE_CUSTOM_ECCBRAINPOOL_P224T1, CryptoPrimitiveAlgorithmModeCustomRef=CRYPTO_ALGOMODE_CUSTOM_ECCBRAINPOOL_P256T1, CryptoPrimitiveAlgorithmModeCustomRef=CRYPTO_ALGOMODE_CUSTOM_ECCBRAINPOOL_P320T1, CryptoPrimitiveAlgorithmFamilyCustomRef=CRYPTO_ALGOFAM_ED448, CryptoPrimitiveAlgorithmModeCustomRef=CRYPTO_ALGOMODE_CUSTOM_EDDSA_ED448, CryptoPrimitiveAlgorithmModeCustomRef=CRYPTO_ALGOMODE_CUSTOM_EDDSA_ED25519
        SignatureVerify: CryptoPrimitiveAlgorithmFamily=CRYPTO_ALGOFAM_RSA, CryptoPrimitiveAlgorithmMode=CRYPTO_ALGOMODE_RSASSA_PKCS1_v1_5, CryptoPrimitiveAlgorithmSecondaryFamily=CRYPTO_ALGOFAM_NOT_SET, CryptoPrimitiveService=CRYPTO_SIGNATUREVERIFY, CryptoPrimitiveAlgorithmFamily=CRYPTO_ALGOFAM_ECCNIST, CryptoPrimitiveAlgorithmFamily=CRYPTO_ALGOFAM_BRAINPOOL, CryptoPrimitiveAlgorithmFamily=CRYPTO_ALGOFAM_ED25519, CryptoPrimitiveAlgorithmMode=CRYPTO_ALGOMODE_NOT_SET, CryptoPrimitiveAlgorithmSecondaryFamily=CRYPTO_ALGOFAM_SHA2_256, CryptoPrimitiveAlgorithmSecondaryFamily=CRYPTO_ALGOFAM_SHA2_224, CryptoPrimitiveAlgorithmSecondaryFamily=CRYPTO_ALGOFAM_SHA2_384, CryptoPrimitiveAlgorithmSecondaryFamily=CRYPTO_ALGOFAM_SHA2_512, CryptoPrimitiveAlgorithmSecondaryFamily=CRYPTO_ALGOFAM_SHA2_512_224, CryptoPrimitiveAlgorithmSecondaryFamily=CRYPTO_ALGOFAM_SHA2_512_256, CryptoPrimitiveAlgorithmMode=CRYPTO_ALGOMODE_RSASSA_PSS, CryptoPrimitiveAlgorithmFamilyCustomRef=CRYPTO_ALGOFAM_ED448, CryptoPrimitiveAlgorithmModeCustomRef=CRYPTO_ALGOMODE_CUSTOM_ECCBRAINPOOL_P192R1, CryptoPrimitiveAlgorithmModeCustomRef=CRYPTO_ALGOMODE_CUSTOM_ECCBRAINPOOL_P192T1, CryptoPrimitiveAlgorithmModeCustomRef=CRYPTO_ALGOMODE_CUSTOM_ECCBRAINPOOL_P224R1, CryptoPrimitiveAlgorithmModeCustomRef=CRYPTO_ALGOMODE_CUSTOM_ECCBRAINPOOL_P224T1, CryptoPrimitiveAlgorithmModeCustomRef=CRYPTO_ALGOMODE_CUSTOM_ECCBRAINPOOL_P256R1, CryptoPrimitiveAlgorithmModeCustomRef=CRYPTO_ALGOMODE_CUSTOM_ECCBRAINPOOL_P256T1, CryptoPrimitiveAlgorithmModeCustomRef=CRYPTO_ALGOMODE_CUSTOM_ECCBRAINPOOL_P320R1, CryptoPrimitiveAlgorithmModeCustomRef=CRYPTO_ALGOMODE_CUSTOM_ECCBRAINPOOL_P320T1, CryptoPrimitiveAlgorithmModeCustomRef=CRYPTO_ALGOMODE_CUSTOM_ECCBRAINPOOL_P384R1, CryptoPrimitiveAlgorithmModeCustomRef=CRYPTO_ALGOMODE_CUSTOM_ECCBRAINPOOL_P512R1, CryptoPrimitiveAlgorithmModeCustomRef=CRYPTO_ALGOMODE_CUSTOM_ECCNIST_P192R1, CryptoPrimitiveAlgorithmModeCustomRef=CRYPTO_ALGOMODE_CUSTOM_ECCNIST_P224R1, CryptoPrimitiveAlgorithmModeCustomRef=CRYPTO_ALGOMODE_CUSTOM_ECCNIST_P256R1, CryptoPrimitiveAlgorithmModeCustomRef=CRYPTO_ALGOMODE_CUSTOM_ECCNIST_P384R1, CryptoPrimitiveAlgorithmModeCustomRef=CRYPTO_ALGOMODE_CUSTOM_ECCNIST_P521R1, CryptoPrimitiveAlgorithmModeCustomRef=CRYPTO_ALGOMODE_CUSTOM_EDDSA_ED448, CryptoPrimitiveAlgorithmModeCustomRef=CRYPTO_ALGOMODE_CUSTOM_EDDSA_ED25519
        RSAEncryptSHA2: CryptoPrimitiveAlgorithmFamily=CRYPTO_ALGOFAM_RSA, CryptoPrimitiveAlgorithmMode=CRYPTO_ALGOMODE_RSAES_OAEP, CryptoPrimitiveService=CRYPTO_ENCRYPT, CryptoPrimitiveAlgorithmMode=CRYPTO_ALGOMODE_RSAES_PKCS1_v1_5, CryptoPrimitiveAlgorithmSecondaryFamily=CRYPTO_ALGOFAM_SHA2_256, CryptoPrimitiveAlgorithmSecondaryFamily=CRYPTO_ALGOFAM_SHA2_224, CryptoPrimitiveAlgorithmSecondaryFamily=CRYPTO_ALGOFAM_SHA2_384, CryptoPrimitiveAlgorithmSecondaryFamily=CRYPTO_ALGOFAM_SHA2_512, CryptoPrimitiveAlgorithmSecondaryFamily=CRYPTO_ALGOFAM_SHA2_512_224, CryptoPrimitiveAlgorithmSecondaryFamily=CRYPTO_ALGOFAM_SHA2_512_256
        RSADecrypt_SHA2: CryptoPrimitiveAlgorithmFamily=CRYPTO_ALGOFAM_RSA, CryptoPrimitiveService=CRYPTO_DECRYPT, CryptoPrimitiveAlgorithmMode=CRYPTO_ALGOMODE_RSAES_OAEP, CryptoPrimitiveAlgorithmMode=CRYPTO_ALGOMODE_RSAES_PKCS1_v1_5, CryptoPrimitiveAlgorithmSecondaryFamily=CRYPTO_ALGOFAM_SHA2_256, CryptoPrimitiveAlgorithmSecondaryFamily=CRYPTO_ALGOFAM_SHA2_224, CryptoPrimitiveAlgorithmSecondaryFamily=CRYPTO_ALGOFAM_SHA2_384, CryptoPrimitiveAlgorithmSecondaryFamily=CRYPTO_ALGOFAM_SHA2_512, CryptoPrimitiveAlgorithmSecondaryFamily=CRYPTO_ALGOFAM_SHA2_512_224, CryptoPrimitiveAlgorithmSecondaryFamily=CRYPTO_ALGOFAM_SHA2_512_256
        KeyGenerate: CryptoPrimitiveAlgorithmMode=CRYPTO_ALGOMODE_RSAES_OAEP, CryptoPrimitiveAlgorithmSecondaryFamily=CRYPTO_ALGOFAM_NOT_SET, CryptoPrimitiveService=CRYPTO_KEYGENERATE, CryptoPrimitiveSupportContext=false, CryptoPrimitiveAlgorithmMode=CRYPTO_ALGOMODE_RSASSA_PKCS1_v1_5, CryptoPrimitiveAlgorithmMode=CRYPTO_ALGOMODE_NOT_SET, CryptoPrimitiveAlgorithmFamily=CRYPTO_ALGOFAM_ECCANSI, CryptoPrimitiveAlgorithmFamily=CRYPTO_ALGOFAM_ECCNIST, CryptoPrimitiveAlgorithmFamily=CRYPTO_ALGOFAM_ECDH, CryptoPrimitiveAlgorithmFamily=CRYPTO_ALGOFAM_ED25519, CryptoPrimitiveAlgorithmFamily=CRYPTO_ALGOFAM_X25519
        KeyExchangeCalcPubVal: CryptoPrimitiveAlgorithmFamily=CRYPTO_ALGOFAM_RSA, CryptoPrimitiveAlgorithmSecondaryFamily=CRYPTO_ALGOFAM_NOT_SET, CryptoPrimitiveService=CRYPTO_KEYEXCHANGECALCPUBVAL, CryptoPrimitiveSupportContext=false, CryptoPrimitiveAlgorithmMode=CRYPTO_ALGOMODE_NOT_SET, CryptoPrimitiveAlgorithmFamily=CRYPTO_ALGOFAM_ECDH, CryptoPrimitiveAlgorithmFamily=CRYPTO_ALGOFAM_DH, CryptoPrimitiveAlgorithmSecondaryFamily=CRYPTO_ALGOFAM_ECCANSI, CryptoPrimitiveAlgorithmSecondaryFamily=CRYPTO_ALGOFAM_ECCNIST, CryptoPrimitiveAlgorithmSecondaryFamily=CRYPTO_ALGOFAM_ECCSEC, CryptoPrimitiveAlgorithmSecondaryFamily=CRYPTO_ALGOFAM_X25519
        KeyExchangeCalcSecret: CryptoPrimitiveAlgorithmFamily=CRYPTO_ALGOFAM_RSA, CryptoPrimitiveService=CRYPTO_KEYEXCHANGECALCSECRET, CryptoPrimitiveSupportContext=false, CryptoPrimitiveAlgorithmMode=CRYPTO_ALGOMODE_NOT_SET, CryptoPrimitiveAlgorithmFamily=CRYPTO_ALGOFAM_ECDH, CryptoPrimitiveAlgorithmFamily=CRYPTO_ALGOFAM_DH, CryptoPrimitiveAlgorithmSecondaryFamily=CRYPTO_ALGOFAM_NOT_SET, CryptoPrimitiveAlgorithmSecondaryFamily=CRYPTO_ALGOFAM_ECCANSI, CryptoPrimitiveAlgorithmSecondaryFamily=CRYPTO_ALGOFAM_ECCNIST, CryptoPrimitiveAlgorithmSecondaryFamily=CRYPTO_ALGOFAM_ECCSEC, CryptoPrimitiveAlgorithmSecondaryFamily=CRYPTO_ALGOFAM_X25519
      9 x CryptoPrimitiveAlgorithmModeCustom:
        CRYPTO_ALGOMODE_CUSTOM_ECCBRAINPOOL_P224R1: CryptoPrimitiveAlgorithmModeCustomId=134
        CRYPTO_ALGOMODE_CUSTOM_ECCBRAINPOOL_P256R1: CryptoPrimitiveAlgorithmModeCustomId=135
        CRYPTO_ALGOMODE_CUSTOM_ECCBRAINPOOL_P320R1: CryptoPrimitiveAlgorithmModeCustomId=136
        CRYPTO_ALGOMODE_CUSTOM_ECCBRAINPOOL_P384R1: CryptoPrimitiveAlgorithmModeCustomId=137
        CRYPTO_ALGOMODE_CUSTOM_ECCBRAINPOOL_P512R1: CryptoPrimitiveAlgorithmModeCustomId=138
        CRYPTO_ALGOMODE_CUSTOM_ECCBRAINPOOL_P192T1: CryptoPrimitiveAlgorithmModeCustomId=139
        CRYPTO_ALGOMODE_CUSTOM_ECCBRAINPOOL_P224T1: CryptoPrimitiveAlgorithmModeCustomId=140
        CRYPTO_ALGOMODE_CUSTOM_ECCBRAINPOOL_P256T1: CryptoPrimitiveAlgorithmModeCustomId=141
        CRYPTO_ALGOMODE_CUSTOM_ECCBRAINPOOL_P320T1: CryptoPrimitiveAlgorithmModeCustomId=142
      CRYPTO_ALGOFAM_ED448 (CryptoPrimitiveAlgorithmFamilyCustom): CryptoPrimitiveAlgorithmFamilyCustomId=129
      CRYPTO_ALGOMODE_CUSTOM_EDDSA_ED448 (CryptoPrimitiveAlgorithmModeCustom): CryptoPrimitiveAlgorithmModeCustomId=146
      CRYPTO_ALGOMODE_CUSTOM_EDDSA_ED25519 (CryptoPrimitiveAlgorithmModeCustom): CryptoPrimitiveAlgorithmModeCustomId=147
