AUTOSAR XML (schema 00053)
package /ActiveEcuC
  module config Os: implementation-config-variant=VARIANT-PRE-COMPILE, module-description=Os_Impl
    OsPublishedInformation: OsKernelVersion=7, OsPlatformName=Arm
      Generic_CortexR52_ASIMD (OsDerivativeInformation):
        OsMpuAlignment = 64
        OsStackAlignment = 8
        OsExceptionVectorTableAlignment = 32
        OsInterruptVectorTableAlignment = 0
        OsHardwareManuals = Arm Cortex-R52 Processor, Revision: Technical Reference Manual, r1p2, 18 January 2019 ARM Architecture Reference Manual, ARMv8, for ARMv8-A architecture profile, ARM DDI 0487D.b (ID042519), 29 April 2019 ARM Architecture Reference Manual Supplement ARMv8, for the ARMv8-R AArch32 architecture profile, DDI0568A.b, 31 Mar 2017 Arm Generic Interrupt Controller, Architecture Specification, GIC architecture version 3 and version 4, Arm IHI 0069E (ID012119), January 2019
        OsMpuEndAddressAccessible = true
        OsMpuPrivilegedRegionsConfigurable = true
        Core0 (OsPhysicalCore):
          OsPhysicalCoreId = 0
          OsPhysicalCoreDefaultEntrySymbol = _start
          OsPhysicalCoreType = Cortex-R52
          OsPhysicalCoreExceptionSources = 8
          OsPhysicalCoreIsAutostart = true
          OsPhysicalCoreMasterStartAllowed = false
          OsPhysicalCorePrivelegedHwAccess = true
          OsPhysicalCoreStackProtectionUnit = Core0_MPU
          Core0_MPU (OsPhysicalCoreMpu): OsPhysicalCoreMpuMaxRegions=24, OsPhysicalCoreMpuId=0, OsPhysicalCoreMpuType=CoreMpuv8
        INTC (OsSystemIntCtrl):
          OsSystemIntCtrlMaxPrios = 248
          OsSystemIntCtrlMaxSources = 991
          OsSystemIntCtrlPrioOrder = DESC
          OsSystemIntCtrlType = GICv3
          OsSystemIntCtrlBaseAddress = 0
          OsSystemIntCtrlLockLevelSupport = MultiLevelSupport
        OsMemoryRegionSpecifics
          4 x OsMemoryRegionAccess, all with OsMemoryRegionAccessType=USERANDSUPERVISOR:
            SUPERVISOR_RW_USER_NONE: OsMemoryRegionAccessRights=S_RW_U_NONE
            SUPERVISOR_RW_USER_RW: OsMemoryRegionAccessRights=S_RW_U_RW
            SUPERVISOR_R_USER_NONE: OsMemoryRegionAccessRights=S_R_U_NONE
            SUPERVISOR_R_USER_R: OsMemoryRegionAccessRights=S_R_U_R
          TYPE_INNER_SHAREABLE (OsMemoryRegionFlag)
          TYPE_OUTER_SHAREABLE (OsMemoryRegionFlag)
          EXECUTE_ALLOWED (OsMemoryRegionAccess): OsMemoryRegionAccessRights=X, OsMemoryRegionAccessType=EXECUTION
          32 x OsMemoryRegionFlag:
            TYPE_DEVICE_GRE_MEMORY
            TYPE_DEVICE_nGRE_MEMORY
            TYPE_DEVICE_nGnRE_MEMORY
            TYPE_DEVICE_nGnRnE_MEMORY
            TYPE_NORMAL_MEMORY_OUTER_WRITETHROUGH_TRANSIENT_READALLOCATE
            TYPE_NORMAL_MEMORY_OUTER_WRITETHROUGH_TRANSIENT_WRITEALLOCATE
            TYPE_NORMAL_MEMORY_OUTER_WRITETHROUGH_TRANSIENT_READALLOCATE_WRITEALLOCATE
            TYPE_NORMAL_MEMORY_OUTER_NON_CACHEABLE
            TYPE_NORMAL_MEMORY_OUTER_WRITEBACK_TRANSIENT_READALLOCATE
            TYPE_NORMAL_MEMORY_OUTER_WRITEBACK_TRANSIENT_WRITEALLOCATE
            TYPE_NORMAL_MEMORY_OUTER_WRITEBACK_TRANSIENT_READALLOCATE_WRITEALLOCATE
            TYPE_NORMAL_MEMORY_OUTER_WRITETHROUGH_NONTRANSIENT_READALLOCATE
            TYPE_NORMAL_MEMORY_OUTER_WRITETHROUGH_NONTRANSIENT_WRITEALLOCATE
            TYPE_NORMAL_MEMORY_OUTER_WRITETHROUGH_NONTRANSIENT_READALLOCATE_WRITEALLOCATE
            TYPE_NORMAL_MEMORY_OUTER_WRITEBACK_NONTRANSIENT_READALLOCATE
            TYPE_NORMAL_MEMORY_OUTER_WRITEBACK_NONTRANSIENT_WRITEALLOCATE
            TYPE_NORMAL_MEMORY_OUTER_WRITEBACK_NONTRANSIENT_READALLOCATE_WRITEALLOCATE
            TYPE_NORMAL_MEMORY_INNER_WRITETHROUGH_TRANSIENT_READALLOCATE
            TYPE_NORMAL_MEMORY_INNER_WRITETHROUGH_TRANSIENT_WRITEALLOCATE
            TYPE_NORMAL_MEMORY_INNER_WRITETHROUGH_TRANSIENT_READALLOCATE_WRITEALLOCATE
            TYPE_NORMAL_MEMORY_INNER_NON_CACHEABLE
            TYPE_NORMAL_MEMORY_INNER_WRITEBACK_TRANSIENT_READALLOCATE
            TYPE_NORMAL_MEMORY_INNER_WRITEBACK_TRANSIENT_WRITEALLOCATE
            TYPE_NORMAL_MEMORY_INNER_WRITEBACK_TRANSIENT_READALLOCATE_WRITEALLOCATE
            TYPE_NORMAL_MEMORY_INNER_WRITETHROUGH_NONTRANSIENT
            TYPE_NORMAL_MEMORY_INNER_WRITETHROUGH_NONTRANSIENT_READALLOCATE
            TYPE_NORMAL_MEMORY_INNER_WRITETHROUGH_NONTRANSIENT_WRITEALLOCATE
            TYPE_NORMAL_MEMORY_INNER_WRITETHROUGH_NONTRANSIENT_READALLOCATE_WRITEALLOCATE
            TYPE_NORMAL_MEMORY_INNER_WRITEBACK_NONTRANSIENT
            TYPE_NORMAL_MEMORY_INNER_WRITEBACK_NONTRANSIENT_READALLOCATE
            TYPE_NORMAL_MEMORY_INNER_WRITEBACK_NONTRANSIENT_WRITEALLOCATE
            TYPE_NORMAL_MEMORY_INNER_WRITEBACK_NONTRANSIENT_READALLOCATE_WRITEALLOCATE
        OsMemoryRegionDefaults_AppT (OsMemoryRegionDefaults):
          OsMemoryRegionDefIdentifier = 1
          OsMemoryRegionDefType = APPLICATION_PRIVILEGED
          OsMemoryRegionDefAccessRights = SUPERVISOR_RW_USER_NONE
          OsMemoryRegionDefFlags = TYPE_NORMAL_MEMORY_INNER_WRITEBACK_TRANSIENT_READALLOCATE_WRITEALLOCATE
          OsMemoryRegionDefFlags = TYPE_NORMAL_MEMORY_OUTER_WRITEBACK_TRANSIENT_READALLOCATE_WRITEALLOCATE
        OsMemoryRegionDefaults_AppNT (OsMemoryRegionDefaults):
          OsMemoryRegionDefIdentifier = 1
          OsMemoryRegionDefType = APPLICATION_NONPRIVILEGED
          OsMemoryRegionDefAccessRights = SUPERVISOR_RW_USER_RW
          OsMemoryRegionDefFlags = TYPE_NORMAL_MEMORY_INNER_WRITEBACK_TRANSIENT_READALLOCATE_WRITEALLOCATE
          OsMemoryRegionDefFlags = TYPE_NORMAL_MEMORY_OUTER_WRITEBACK_TRANSIENT_READALLOCATE_WRITEALLOCATE
        Generic_Timer_Core0 (OsHardwareTimer): OsHardwareTimerSize=64, OsHardwareTimerUnit=FRT, OsHardwareTimerId=0, OsHardwareTimerType=V8R_GenericTimer, OsHardwareTimerBaseAddress=0
          EL1_PhysicalTimer_Core0 (OsHardwareTimerChannel): OsHardwareTimerChannelOffset=0, OsHardwareTimerChannelIntSource=30, OsHardwareTimerChannelId=0
          VirtualTimer_Core0 (OsHardwareTimerChannel): OsHardwareTimerChannelOffset=0, OsHardwareTimerChannelIntSource=27, OsHardwareTimerChannelId=1
        3 x OsPhysicalCore, all with OsPhysicalCoreType=Cortex-R52, OsPhysicalCoreExceptionSources=8, OsPhysicalCoreIsAutostart=true, OsPhysicalCoreMasterStartAllowed=false, OsPhysicalCorePrivelegedHwAccess=true:
          Core1: OsPhysicalCoreId=1, OsPhysicalCoreDefaultEntrySymbol=_start_c1, OsPhysicalCoreStackProtectionUnit=Core1_MPU
            Core1_MPU (OsPhysicalCoreMpu): OsPhysicalCoreMpuMaxRegions=24, OsPhysicalCoreMpuId=0, OsPhysicalCoreMpuType=CoreMpuv8
          Core2: OsPhysicalCoreId=2, OsPhysicalCoreDefaultEntrySymbol=_start_c2, OsPhysicalCoreStackProtectionUnit=Core2_MPU
            Core2_MPU (OsPhysicalCoreMpu): OsPhysicalCoreMpuMaxRegions=24, OsPhysicalCoreMpuId=0, OsPhysicalCoreMpuType=CoreMpuv8
          Core3: OsPhysicalCoreId=3, OsPhysicalCoreDefaultEntrySymbol=_start_c3, OsPhysicalCoreStackProtectionUnit=Core3_MPU
            Core3_MPU (OsPhysicalCoreMpu): OsPhysicalCoreMpuMaxRegions=24, OsPhysicalCoreMpuId=0, OsPhysicalCoreMpuType=CoreMpuv8
        3 x OsHardwareTimer, all with OsHardwareTimerSize=64, OsHardwareTimerUnit=FRT, OsHardwareTimerType=V8R_GenericTimer, OsHardwareTimerBaseAddress=0:
          Generic_Timer_Core1: OsHardwareTimerId=1
            EL1_PhysicalTimer_Core1 (OsHardwareTimerChannel): OsHardwareTimerChannelOffset=0, OsHardwareTimerChannelIntSource=30, OsHardwareTimerChannelId=0
            VirtualTimer_Core1 (OsHardwareTimerChannel): OsHardwareTimerChannelOffset=0, OsHardwareTimerChannelIntSource=27, OsHardwareTimerChannelId=1
          Generic_Timer_Core2: OsHardwareTimerId=2
            EL1_PhysicalTimer_Core2 (OsHardwareTimerChannel): OsHardwareTimerChannelOffset=0, OsHardwareTimerChannelIntSource=30, OsHardwareTimerChannelId=0
            VirtualTimer_Core2 (OsHardwareTimerChannel): OsHardwareTimerChannelOffset=0, OsHardwareTimerChannelIntSource=27, OsHardwareTimerChannelId=1
          Generic_Timer_Core3: OsHardwareTimerId=3
            EL1_PhysicalTimer_Core3 (OsHardwareTimerChannel): OsHardwareTimerChannelOffset=0, OsHardwareTimerChannelIntSource=30, OsHardwareTimerChannelId=0
            VirtualTimer_Core3 (OsHardwareTimerChannel): OsHardwareTimerChannelOffset=0, OsHardwareTimerChannelIntSource=27, OsHardwareTimerChannelId=1
        EDGE_TRIGGERED (OsInterruptSupportedType):
          OsInterruptSupportedTypeIsMapped = false
          OsInterruptSupportedTypePostActionRequired = false
          OsInterruptSupportedTypeSeparatePriority = false
          OsInterruptSupportedTypeSeparateSources = false
    OS_APPMODE_ANY (OsAppMode)
    OSDEFAULTAPPMODE (OsAppMode)
    OsOS:
      OsGenerateMemMapForNearAddressing = false
      OsStackMonitoring = true
      OsStatus = EXTENDED
      OsUseArti = false
      OsUseGetServiceId = false
      OsUseParameterAccess = false
      OsUseResScheduler = false
      OsForcibleTermination = false
      OsGenerateCalloutStubs = true
      OsGenerateMemMap = COMPLETE
      OsGenerateMemMapForThreads = false
      OsServiceProtection = false
      OsStackUsageMeasurement = true
      OsUseXSignalAsyncApiCalls = false
      OsFpuUsage = NONE
      OsUseCase = STANDARD
      OsScalabilityClass = SC3
      OsNumberOfCores = 1
      OsInterruptLockOptimization = false
      OsStackModel = STANDARD
      OsMasterCore = OsCore0
      OsStackSummary
        20 x OsStack, all with OsStackCore=OsCore0:
          OsCore0_Kernel: OsStackSize=4096, OsStackType=CORE_KERNEL_STACK, OsStackUserName=OsCore0, OsStackUser=OsCore0
          OsCore0_Init: OsStackSize=4096, OsStackType=CORE_INIT_STACK, OsStackUserName=OsCore0, OsStackUser=OsCore0
          OsCore0_Error: OsStackSize=4096, OsStackType=CORE_ERROR_STACK, OsStackUserName=OsCore0, OsStackUserName=ErrorHook_OsCore0, OsStackUser=OsCore0, OsStackUser=OsHooks
          OsCore0_Task_Prio4294967295: OsStackSize=512, OsStackType=TASK_SHARED_PRIORITY_STACK, OsStackUserName=IdleTask_OsCore0, OsStackUser=IdleTask_OsCore0
          OsCore0_Isr_Core: OsStackSize=2048, OsStackType=ISR_SHARED_CORE_STACK, OsStackUserName=BBE_SP_FUSA_IRQ_Handler, OsStackUserName=dsp_ctrl_err_fusa_irq_handler, OsStackUserName=Ethernet2_IRQ, OsStackUserName=MIPI_FRM_START_Handler, OsStackUserName=MIPI_CHP_FUSA_Handler, OsStackUserName=mipi_err_fusa_handler, OsStackUserName=Ethernet3_IRQ, OsStackUserName=BBE_SP_GPIO0_Handler, OsStackUserName=TIMER1_Handler_Isr, OsStackUserName=Ethernet7_IRQ, OsStackUserName=CounterIsr_OsCounter, OsStackUserName=RA_Clock_Monitor_Handler, OsStackUserName=MIPI_Clock_Monitor_Handler, OsStackUserName=RA_FUSA_IRQ_Handler, OsStackUserName=MIPI_CHP_END_Handler, OsStackUserName=TIMER4_Handler_Isr, OsStackUserName=Ethernet4_IRQ, OsStackUserName=RA_ERROR_IRQ_Handler, OsStackUserName=Artie_Mem_Fusa_Handler, OsStackUserName=Ethernet0_IRQ, OsStackUserName=Serial_Clock_Monitor_Handler, OsStackUserName=Ethernet5_IRQ, OsStackUserName=MIPI_CHP_START_Handler, OsStackUserName=MIPI_FRM_END_Handler, OsStackUserName=Ethernet1_IRQ, OsStackUserName=Ethernet6_IRQ, OsStackUserName=GPADC_Handler_Isr, OsStackUserName=CMRT_ISR, OsStackUserName=MM_INTF0_Handler, OsStackUserName=Sysmem0_Fusa_Handler, OsStackUserName=Sysmem1_Fusa_Handler, OsStackUserName=DSP_Clock_Monitor_Handler, OsStackUserName=ANOC_Latent_Fusa_Handler, OsStackUserName=AA1_FUSA_IRQ_Handler, OsStackUserName=AA0_FUSA_IRQ_Handler, OsStackUserName=SNOC_Latent_Fusa_Handler, OsStackUserName=CNOC_Latent_Fusa_Handler, OsStackUserName=CRG_RMON_SWS_IRQ_Handler, OsStackUserName=HSM_FUSA_ALARM_ISR, OsStackUserName=HSM_DMB_ISR, OsStackUserName=I2C_Handler_Isr, OsStackUserName=WATCHDOG_Handler_Isr, OsStackUserName=DMA_Handler_Isr, OsStackUserName=CANFD0_Handler_Isr, OsStackUserName=CANFD1_Handler_Isr, OsStackUserName=TIMER2_Handler_Isr, OsStackUserName=TIMER3_Handler_Isr, OsStackUserName=TIMER5_Handler_Isr, OsStackUser=TIMER1_Handler_Isr, OsStackUser=MM_INTF0_Handler, OsStackUser=BBE_SP_GPIO0_Handler, OsStackUser=Ethernet0_IRQ, OsStackUser=Ethernet1_IRQ, OsStackUser=Ethernet2_IRQ, OsStackUser=Ethernet3_IRQ, OsStackUser=Ethernet4_IRQ, OsStackUser=Ethernet5_IRQ, OsStackUser=Ethernet6_IRQ, OsStackUser=Ethernet7_IRQ, OsStackUser=GPADC_Handler_Isr, OsStackUser=MIPI_FRM_START_Handler, OsStackUser=MIPI_FRM_END_Handler, OsStackUser=MIPI_CHP_START_Handler, OsStackUser=MIPI_CHP_END_Handler, OsStackUser=MIPI_CHP_FUSA_Handler, OsStackUser=TIMER4_Handler_Isr, OsStackUser=CounterIsr_OsCounter, OsStackUser=BBE_SP_FUSA_IRQ_Handler, OsStackUser=RA_ERROR_IRQ_Handler, OsStackUser=RA_FUSA_IRQ_Handler, OsStackUser=Artie_Mem_Fusa_Handler, OsStackUser=mipi_err_fusa_handler, OsStackUser=dsp_ctrl_err_fusa_irq_handler, OsStackUser=Sysmem0_Fusa_Handler, OsStackUser=Sysmem1_Fusa_Handler, OsStackUser=Serial_Clock_Monitor_Handler, OsStackUser=DSP_Clock_Monitor_Handler, OsStackUser=MIPI_Clock_Monitor_Handler, OsStackUser=RA_Clock_Monitor_Handler, OsStackUser=CMRT_ISR, OsStackUser=AA0_FUSA_IRQ_Handler, OsStackUser=AA1_FUSA_IRQ_Handler, OsStackUser=CNOC_Latent_Fusa_Handler, OsStackUser=ANOC_Latent_Fusa_Handler, OsStackUser=SNOC_Latent_Fusa_Handler, OsStackUser=CRG_RMON_SWS_IRQ_Handler, OsStackUser=HSM_FUSA_ALARM_ISR, OsStackUser=HSM_DMB_ISR, OsStackUser=I2C_Handler_Isr, OsStackUser=WATCHDOG_Handler_Isr, OsStackUser=DMA_Handler_Isr, OsStackUser=CANFD0_Handler_Isr, OsStackUser=CANFD1_Handler_Isr, OsStackUser=TIMER2_Handler_Isr, OsStackUser=TIMER3_Handler_Isr, OsStackUser=TIMER5_Handler_Isr
          OsCore0_Startup: OsStackSize=4096, OsStackType=CORE_STARTUP_STACK, OsStackUserName=OsCore0, OsStackUserName=StartupHook_OsCore0, OsStackUser=OsCore0, OsStackUser=OsHooks
          OsCore0_Shutdown: OsStackSize=4096, OsStackType=CORE_SHUTDOWN_STACK, OsStackUserName=OsCore0, OsStackUserName=ShutdownHook_OsCore0, OsStackUser=OsCore0, OsStackUser=OsHooks
          BSW_Task: OsStackSize=2048, OsStackType=TASK_EXTENDED_STACK, OsStackUserName=BSW_Task, OsStackUser=Os/BSW_Task
          OsCore0_Task_Prio200: OsStackSize=1024, OsStackType=TASK_SHARED_PRIORITY_STACK, OsStackUserName=Init_Task, OsStackUser=Init_Task
          OsCore0_Task_Prio190: OsStackSize=1024, OsStackType=TASK_SHARED_PRIORITY_STACK, OsStackUserName=Appl_Init, OsStackUser=Appl_Init
          Appl_Task: OsStackSize=4096, OsStackType=TASK_EXTENDED_STACK, OsStackUserName=Appl_Task, OsStackUser=Os/Appl_Task
          Radar_Ctrl_Task: OsStackSize=4096, OsStackType=TASK_EXTENDED_STACK, OsStackUserName=Radar_Ctrl_Task, OsStackUser=Os/Radar_Ctrl_Task
          Appl_Task_Logging: OsStackSize=2048, OsStackType=TASK_EXTENDED_STACK, OsStackUserName=Appl_Task_Logging, OsStackUser=Os/Appl_Task_Logging
          Appl_Task_Communication: OsStackSize=2048, OsStackType=TASK_EXTENDED_STACK, OsStackUserName=Appl_Task_Communication, OsStackUser=Os/Appl_Task_Communication
          OsCore0_Task_Prio210: OsStackSize=1024, OsStackType=TASK_SHARED_PRIORITY_STACK, OsStackUserName=Init_Task_Qm, OsStackUser=Init_Task_Qm
          Appl_Task_High_Prio: OsStackSize=1024, OsStackType=TASK_EXTENDED_STACK, OsStackUserName=Appl_Task_High_Prio, OsStackUser=Os/Appl_Task_High_Prio
          Appl_IPC_Task: OsStackSize=4096, OsStackType=TASK_EXTENDED_STACK, OsStackUserName=Appl_IPC_Task, OsStackUser=Os/Appl_IPC_Task
          Appl_Task_Fast: OsStackSize=2048, OsStackType=TASK_EXTENDED_STACK, OsStackUserName=Appl_Task_Fast, OsStackUser=Os/Appl_Task_Fast
          OsCore0_Protection: OsStackSize=4096, OsStackType=CORE_PROTECTION_STACK, OsStackUserName=OsCore0, OsStackUser=OsCore0
          Appl_BackgroundTask: OsStackSize=1024, OsStackType=TASK_EXTENDED_STACK, OsStackUserName=Appl_BackgroundTask, OsStackUser=Os/Appl_BackgroundTask
      OsHooks: OsErrorHook=true, OsPostTaskHook=false, OsPreTaskHook=false, OsShutdownHook=true, OsStartupHook=true, OsProtectionHook=true, OsPanicHook=true
      OsDebug: OsAssertions=false, OsORTIDebugSupport=ORTI_23_STANDARD, OsTimingHooksIncludeHeader=Rtm.h
    OsCore0 (OsCore):
      OsCoreIsAutostart = true
      OsCoreIsAutosar = true
      OsCoreEntrySymbol = _start
      OsCorePhysicalCoreRef = Core0
      OsCoreEcucCoreRef = EcucCoreDefinition_Core0
      OsCoreIdleTask = IdleTask_OsCore0
      OsCoreSystemApplication = SystemApplication_OsCore0
      OsCoreStacks:
        OsCoreKernelStackSize = 4096
        OsCoreStartupStackSize = 4096
        OsCoreShutdownStackSize = 4096
        OsCoreErrorStackSize = 4096
        OsCoreProtectionStackSize = 4096
        OsCoreInitStackSize = 4096
    IdleTask_OsCore0 (OsTask):
      OsTaskActivation = 1
      OsTaskPriority = 4294967295
      OsTaskSchedule = FULL
      OsTaskStackSharing = false
      OsTaskStackSize = 512
      OsTaskType = AUTO
      OsTaskUsesFpu = false
      OsTaskAccessingApplication = SystemApplication_OsCore0
      OsTaskResourceRef = OsResource
      OsTaskAutostart: OsTaskAppModeRef=OS_APPMODE_ANY
    SystemApplication_OsCore0 (OsApplication):
      OsTrusted = true
      OsTrustedApplicationDelayTimingViolationCall = false
      OsTrustedApplicationWithProtection = false
      OsApplicationIsPrivileged = true
      OsAppUseTrustedFunctionStubs = false
      OsApplicationCoreRef = EcucCoreDefinition_Core0
      OsAppTaskRef = IdleTask_OsCore0
      OsAppCounterRef = OsCounter
      OsAppEcucPartitionRef = EcucPartition_SystemApplication_OsCore0
      OsAppIsrRef = CounterIsr_OsCounter
      OsApplicationHooks: OsAppErrorHook=false, OsAppShutdownHook=false, OsAppStartupHook=false
    OsResource:
      OsResourceProperty = STANDARD
      OsResourceAccessingApplication = SystemApplication_OsCore0
      OsResourceAccessingApplication = OsCore0_ASIL
      OsResourceAccessingApplication = OsCore_Qm
    Init_Task (OsTask):
      OsTaskActivation = 1
      OsTaskPriority = 200
      OsTaskSchedule = NON
      OsTaskStackSharing = false
      OsTaskStackSize = 1024
      OsTaskType = AUTO
      OsTaskUsesFpu = false
      OsTaskAccessingApplication = SystemApplication_OsCore0
      OsTaskResourceRef = OsResource
      OsTaskAutostart: OsTaskAppModeRef=OSDEFAULTAPPMODE
    OsCounter:
      OsCounterMaxAllowedValue = 2147483647
      OsCounterMinCycle = 1
      OsCounterTicksPerBase = 499999
      OsCounterType = HARDWARE
      OsSecondsPerTick = 0.001
      OsCounterAlgorithm = LIST
      OsCounterAccessingApplication = SystemApplication_OsCore0
      OsDriver: OsDriverHighResolution=false, OsDriverHardwareTimerChannelRef=EL1_PhysicalTimer_Core0, OsDriverIsrRef=CounterIsr_OsCounter
    Appl_Task (OsTask):
      OsTaskActivation = 1
      OsTaskPriority = 40
      OsTaskSchedule = FULL
      OsTaskStackSharing = false
      OsTaskStackSize = 4096
      OsTaskType = AUTO
      OsTaskUsesFpu = false
      OsTaskAccessingApplication = SystemApplication_OsCore0
      OsTaskEventRef = Rte_Ev_Cyclic_Appl_Task_0_50ms
      OsTaskEventRef = Rte_Ev_Cyclic_Appl_Task_0_10ms
      OsTaskEventRef = Rte_Ev_Cyclic_Appl_Task_0_5ms
      OsTaskAccessingApplication = OsCore_Qm
      OsTaskEventRef = Rte_Ev_Run_SWC_PLT_Appl_IntWDG_RE_PLT_WDG_INTERNAL_WDG_PLT_Appl_Task
    TIMER1_Handler_Isr (OsIsr):  # /ActiveEcuC/Gpt PLAIN_TEXT GPT channel ISR. Created automatically based on GptChannelId
      OsIsrCategory = CATEGORY_2
      OsIsrInterruptType = EXTERNAL
      OsIsrInterruptSource = 44
      OsIsrInterruptPriority = 5
      OsIsrStackSize = 1024
      OsIsrEnableNesting = false
      OsIsrUsesFpu = false
      OsIsrInitialEnableInterruptSource = true
      OsIsrSpecialFunctionName = TIMER1_Handler
    BSW_Task (OsTask):
      OsTaskActivation = 1
      OsTaskPriority = 50
      OsTaskSchedule = FULL
      OsTaskStackSharing = false
      OsTaskStackSize = 2048
      OsTaskType = AUTO
      OsTaskUsesFpu = false
      OsTaskAccessingApplication = SystemApplication_OsCore0
      OsTaskEventRef = Rte_Ev_Cyclic2_BSW_Task_0_10ms
      OsTaskEventRef = Rte_Ev_Cyclic2_BSW_Task_0_20ms
      OsTaskEventRef = Rte_Ev_Cyclic2_BSW_Task_0_5ms
      OsTaskEventRef = Rte_Ev_Run_SWC_PLT_CDD_TimeSync_DRE_StatusNotification_Callback
      OsTaskAccessingApplication = OsCore_Qm
      OsTaskEventRef = Rte_Ev_Run_SWC_PLT_Appl_IntWDG_RE_PLT_WDG_INTERNAL_WDG_BSW_Task
      OsTaskEventRef = Rte_Ev_Run_SWC_PLT_Appl_NvMHandler_RE_PLT_Appl_NvMHandler_5ms
    Rte_Al_TE2_BSW_Task_0_10ms (OsAlarm): OsAlarmCounterRef=OsCounter, OsAlarmAccessingApplication=SystemApplication_OsCore0
      OsAlarmAction
        OsAlarmSetEvent: OsAlarmSetEventRef=Rte_Ev_Cyclic2_BSW_Task_0_10ms, OsAlarmSetEventTaskRef=Os/BSW_Task
    Rte_Al_TE2_BSW_Task_0_20ms (OsAlarm): OsAlarmCounterRef=OsCounter, OsAlarmAccessingApplication=SystemApplication_OsCore0
      OsAlarmAction
        OsAlarmSetEvent: OsAlarmSetEventRef=Rte_Ev_Cyclic2_BSW_Task_0_20ms, OsAlarmSetEventTaskRef=Os/BSW_Task
    Rte_Ev_Cyclic2_BSW_Task_0_10ms (OsEvent)
    Rte_Ev_Cyclic2_BSW_Task_0_20ms (OsEvent)
    3 x OsTask, all with OsTaskActivation=1, OsTaskStackSharing=false, OsTaskUsesFpu=false, OsTaskAccessingApplication=SystemApplication_OsCore0, OsTaskAccessingApplication=OsCore_Qm:
      Appl_BackgroundTask: OsTaskPriority=1, OsTaskSchedule=FULL, OsTaskStackSize=1024, OsTaskType=EXTENDED, OsTaskAccessingApplication=OsCore0_ASIL, OsTaskEventRef=Rte_Ev_Cyclic2_Appl_BackgroundTask_0_5ms
      Radar_Ctrl_Task: OsTaskPriority=100, OsTaskSchedule=FULL, OsTaskStackSize=4096, OsTaskType=AUTO, OsTaskEventRef=Rte_Ev_Run_SWC_PLT_CDD_Radar_Control_RE_Radar_Control_10ms, OsTaskEventRef=Rte_Ev_Cyclic_Radar_Ctrl_Task_0_50ms, OsTaskEventRef=Rte_Ev_Run_SWC_PLT_CDD_Radar_Control_RE_Radar_Ctl_Look_Complete_Rp_Radar_Ctl_Look_Complete_Trigger, OsTaskEventRef=Rte_Ev_Run_SWC_PLT_CDD_Radar_Control_RE_Radar_Ctl_Look_Trigger, OsTaskEventRef=Rte_Ev_Run_Rtm_Rtm_MainFunction, OsTaskEventRef=Rte_Ev_Run_SWC_PLT_CDD_Radar_Control_RE_Radar_Ctl_Look_Complete_Post_RFBIST
      Appl_Init: OsTaskPriority=190, OsTaskSchedule=NON, OsTaskStackSize=1024, OsTaskType=AUTO
    Rte_Al_TE2_BSW_Task_0_5ms (OsAlarm): OsAlarmCounterRef=OsCounter, OsAlarmAccessingApplication=SystemApplication_OsCore0
      OsAlarmAction
        OsAlarmSetEvent: OsAlarmSetEventRef=Rte_Ev_Cyclic2_BSW_Task_0_5ms, OsAlarmSetEventTaskRef=Os/BSW_Task
    Rte_Ev_Cyclic2_BSW_Task_0_5ms (OsEvent)
    Rte_Al_TE_Appl_Task_0_50ms (OsAlarm): OsAlarmCounterRef=OsCounter, OsAlarmAccessingApplication=SystemApplication_OsCore0
      OsAlarmAction
        OsAlarmSetEvent: OsAlarmSetEventRef=Rte_Ev_Cyclic_Appl_Task_0_50ms, OsAlarmSetEventTaskRef=Os/Appl_Task
    Rte_Ev_Cyclic_Appl_Task_0_50ms (OsEvent)
    Rte_Al_TE_SWC_PLT_CDD_Radar_Control_RE_Radar_Control_10ms (OsAlarm): OsAlarmCounterRef=OsCounter, OsAlarmAccessingApplication=SystemApplication_OsCore0
      OsAlarmAction
        OsAlarmSetEvent: OsAlarmSetEventRef=Rte_Ev_Run_SWC_PLT_CDD_Radar_Control_RE_Radar_Control_10ms, OsAlarmSetEventTaskRef=Os/Radar_Ctrl_Task
    Rte_Ev_Run_SWC_PLT_CDD_Radar_Control_RE_Radar_Control_10ms (OsEvent)
    11 x OsIsr, all with OsIsrCategory=CATEGORY_2, OsIsrInterruptType=EXTERNAL, OsIsrEnableNesting=false, OsIsrUsesFpu=false:
      MM_INTF0_Handler: OsIsrInterruptSource=90, OsIsrInterruptPriority=9, OsIsrStackSize=1024, OsIsrInitialEnableInterruptSource=false, OsIsrSpecialFunctionName=mm_intf0_handler
      BBE_SP_GPIO0_Handler: OsIsrInterruptSource=73, OsIsrInterruptPriority=4, OsIsrStackSize=1024, OsIsrInitialEnableInterruptSource=true
      Ethernet0_IRQ: OsIsrInterruptSource=47, OsIsrInterruptPriority=7, OsIsrStackSize=2048, OsIsrInitialEnableInterruptSource=true, OsIsrSpecialFunctionName=ETHERNET0_Handler, OsIsrInterruptMapping=EDGE_TRIGGERED
      Ethernet1_IRQ: OsIsrInterruptSource=48, OsIsrInterruptPriority=7, OsIsrStackSize=2048, OsIsrInitialEnableInterruptSource=true, OsIsrSpecialFunctionName=ETHERNET1_Handler, OsIsrInterruptMapping=EDGE_TRIGGERED
      Ethernet2_IRQ: OsIsrInterruptSource=49, OsIsrInterruptPriority=7, OsIsrStackSize=2048, OsIsrInitialEnableInterruptSource=true, OsIsrSpecialFunctionName=ETHERNET2_Handler, OsIsrInterruptMapping=EDGE_TRIGGERED
      Ethernet3_IRQ: OsIsrInterruptSource=50, OsIsrInterruptPriority=7, OsIsrStackSize=2048, OsIsrInitialEnableInterruptSource=true, OsIsrSpecialFunctionName=ETHERNET3_Handler, OsIsrInterruptMapping=EDGE_TRIGGERED
      Ethernet4_IRQ: OsIsrInterruptSource=51, OsIsrInterruptPriority=7, OsIsrStackSize=2048, OsIsrInitialEnableInterruptSource=true, OsIsrSpecialFunctionName=ETHERNET4_Handler, OsIsrInterruptMapping=EDGE_TRIGGERED
      Ethernet5_IRQ: OsIsrInterruptSource=52, OsIsrInterruptPriority=7, OsIsrStackSize=2048, OsIsrInitialEnableInterruptSource=true, OsIsrSpecialFunctionName=ETHERNET5_Handler, OsIsrInterruptMapping=EDGE_TRIGGERED
      Ethernet6_IRQ: OsIsrInterruptSource=53, OsIsrInterruptPriority=7, OsIsrStackSize=2048, OsIsrInitialEnableInterruptSource=true, OsIsrSpecialFunctionName=ETHERNET6_Handler, OsIsrInterruptMapping=EDGE_TRIGGERED
      Ethernet7_IRQ: OsIsrInterruptSource=54, OsIsrInterruptPriority=7, OsIsrStackSize=2048, OsIsrInitialEnableInterruptSource=true, OsIsrSpecialFunctionName=ETHERNET7_Handler, OsIsrInterruptMapping=EDGE_TRIGGERED
      GPADC_Handler_Isr: OsIsrInterruptSource=67, OsIsrInterruptPriority=10, OsIsrStackSize=1024, OsIsrInitialEnableInterruptSource=false, OsIsrSpecialFunctionName=GPADC_Handler  # /ActiveEcuC/Adc PLAIN_TEXT ADC GP-ADC conversion ISR. Created automatically based on Adc existance
    Rte_Al_TE_Appl_Task_0_10ms (OsAlarm): OsAlarmCounterRef=OsCounter, OsAlarmAccessingApplication=SystemApplication_OsCore0
      OsAlarmAction
        OsAlarmSetEvent: OsAlarmSetEventRef=Rte_Ev_Cyclic_Appl_Task_0_10ms, OsAlarmSetEventTaskRef=Os/Appl_Task
    Rte_Al_TE_Appl_Task_0_5ms (OsAlarm): OsAlarmCounterRef=OsCounter, OsAlarmAccessingApplication=SystemApplication_OsCore0
      OsAlarmAction
        OsAlarmSetEvent: OsAlarmSetEventRef=Rte_Ev_Cyclic_Appl_Task_0_5ms, OsAlarmSetEventTaskRef=Os/Appl_Task
    Rte_Ev_Cyclic_Appl_Task_0_10ms (OsEvent)
    Rte_Ev_Cyclic_Appl_Task_0_5ms (OsEvent)
    Appl_Task_Logging (OsTask):
      OsTaskActivation = 1
      OsTaskPriority = 90
      OsTaskSchedule = FULL
      OsTaskStackSharing = false
      OsTaskStackSize = 2048
      OsTaskType = AUTO
      OsTaskUsesFpu = false
      OsTaskAccessingApplication = SystemApplication_OsCore0
      OsTaskEventRef = Rte_Ev_Run_SWC_PLT_CDD_Logging_PostRadarProcessing_Debug_Populate_Debug_Stream
      OsTaskEventRef = Rte_Ev_Run_SWC_PLT_CDD_Logging_PostRadarProcessing_Detection_Populate_Detection_Stream
      OsTaskEventRef = Rte_Ev_Run_SWC_PLT_CDD_Logging_PostRadarProcessing_Header_Populate_Header_Stream
      OsTaskEventRef = Rte_Ev_Run_SWC_PLT_CDD_Logging_PostRadarProcessing_MMIC_Populate_MMIC_Stream
      OsTaskEventRef = Rte_Ev_Run_SWC_PLT_CDD_Logging_PostRadarProcessing_Radar_Capability_Populate_Radar_Capability_Stream
      OsTaskEventRef = Rte_Ev_Run_SWC_PLT_CDD_Logging_PostRadarProcessing_Status_Populate_Status_Stream
      OsTaskResourceRef = OsResource
      OsTaskEventRef = Rte_Ev_Run_SWC_PLT_CDD_Logging_PostRadarProcessing_ADC_Populate_ADC_Stream
      OsTaskEventRef = Rte_Ev_Run_SWC_PLT_CDD_Logging_PostRadarProcessing_RDD_Populate_RDD_Stream
      OsTaskEventRef = Rte_Ev_Run_SWC_PLT_CDD_HIL_RE_HIL_Periodic_Handler_Rp_HIL_Periodic_Handler_Trigger
      OsTaskEventRef = Rte_Ev_Run_SWC_PLT_CDD_Logging_StbM_MeasurementNotification_StbMSynchronizedTimeBase_TimeRecordBlock_Callback
      OsTaskAccessingApplication = OsCore0_ASIL
      OsTaskEventRef = Rte_Ev_Run_SWC_CMP_PRJ_UDSHandler_RE_SWC_CMP_PRJ_UDSHandler_Main_50ms
    7 x OsEvent:
      Rte_Ev_Run_SWC_PLT_CDD_Logging_PostRadarProcessing_Debug_Populate_Debug_Stream
      Rte_Ev_Run_SWC_PLT_CDD_Logging_PostRadarProcessing_Detection_Populate_Detection_Stream
      Rte_Ev_Run_SWC_PLT_CDD_Logging_PostRadarProcessing_Header_Populate_Header_Stream
      Rte_Ev_Run_SWC_PLT_CDD_Logging_PostRadarProcessing_MMIC_Populate_MMIC_Stream
      Rte_Ev_Run_SWC_PLT_CDD_Logging_PostRadarProcessing_RDD_Populate_RDD_Stream
      Rte_Ev_Run_SWC_PLT_CDD_Logging_PostRadarProcessing_Radar_Capability_Populate_Radar_Capability_Stream
      Rte_Ev_Run_SWC_PLT_CDD_Logging_PostRadarProcessing_Status_Populate_Status_Stream
    Rte_Al_TE_Radar_Ctrl_Task_0_50ms (OsAlarm): OsAlarmCounterRef=OsCounter, OsAlarmAccessingApplication=SystemApplication_OsCore0
      OsAlarmAction
        OsAlarmSetEvent: OsAlarmSetEventRef=Rte_Ev_Cyclic_Radar_Ctrl_Task_0_50ms, OsAlarmSetEventTaskRef=Os/Radar_Ctrl_Task
    4 x OsEvent:
      Rte_Ev_Cyclic_Radar_Ctrl_Task_0_50ms
      Rte_Ev_Run_SWC_PLT_CDD_Radar_Control_RE_Radar_Ctl_Look_Complete_Rp_Radar_Ctl_Look_Complete_Trigger
      Rte_Ev_Run_SWC_PLT_CDD_Radar_Control_RE_Radar_Ctl_Look_Trigger
      Rte_Ev_Run_SWC_PLT_CDD_Logging_PostRadarProcessing_ADC_Populate_ADC_Stream
    Appl_Task_Communication (OsTask):
      OsTaskActivation = 1
      OsTaskPriority = 80
      OsTaskSchedule = FULL
      OsTaskStackSharing = false
      OsTaskStackSize = 2048
      OsTaskType = AUTO
      OsTaskUsesFpu = false
      OsTaskAccessingApplication = SystemApplication_OsCore0
      OsTaskResourceRef = OsResource
      OsTaskEventRef = Rte_Ev_Cyclic_Appl_Task_Communication_0_50ms
      OsTaskEventRef = Rte_Ev_Run_SWC_PLT_Appl_Communication_RE_Communication_Tx_50ms
      OsTaskEventRef = Rte_Ev_Cyclic2_Appl_Task_Communication_0_10ms
      OsTaskEventRef = Rte_Ev_Run_Com_Com_MainFunctionTx_ComMainFunctionTx_Periodic
      OsTaskEventRef = Rte_Ev_Run_SWC_PLT_Appl_Communication_PostRadarProcessing_CAN_Tx_RE_Communication_Tx
      OsTaskEventRef = Rte_Ev_Run_SWC_PRJ_Appl_FaultMgr_RE_PCAN_Timeout_Faults_Event
      OsTaskEventRef = Rte_Ev_Run_SWC_PRJ_Appl_FaultMgr_RE_VCAN_Timeout_Faults_100ms_1000ms_Event
      OsTaskEventRef = Rte_Ev_Run_SWC_PRJ_Appl_FaultMgr_RE_VCAN_Timeout_Faults_10ms_20ms_50ms_Event
      OsTaskAccessingApplication = OsCore_Qm
      OsTaskEventRef = Rte_Ev_Cyclic_Appl_Task_Communication_0_25ms
    Rte_Ev_Cyclic_Appl_Task_Communication_0_50ms (OsEvent)
    4 x OsIsr, all with OsIsrCategory=CATEGORY_2, OsIsrInterruptType=EXTERNAL, OsIsrInterruptPriority=10, OsIsrStackSize=1024, OsIsrEnableNesting=false, OsIsrUsesFpu=false:
      MIPI_FRM_START_Handler: OsIsrInterruptSource=81, OsIsrInitialEnableInterruptSource=true, OsIsrSpecialFunctionName=mipi_frm_start_handler
      MIPI_FRM_END_Handler: OsIsrInterruptSource=82, OsIsrInitialEnableInterruptSource=true, OsIsrSpecialFunctionName=mipi_frm_end_handler
      MIPI_CHP_START_Handler: OsIsrInterruptSource=83, OsIsrInitialEnableInterruptSource=false, OsIsrSpecialFunctionName=mipi_chp_start_handler
      MIPI_CHP_END_Handler: OsIsrInterruptSource=84, OsIsrInitialEnableInterruptSource=false, OsIsrSpecialFunctionName=mipi_chp_end_handler
    Rte_Al_TE_Rtm_Rtm_MainFunction (OsAlarm): OsAlarmCounterRef=OsCounter, OsAlarmAccessingApplication=SystemApplication_OsCore0
      OsAlarmAction
        OsAlarmSetEvent: OsAlarmSetEventRef=Rte_Ev_Run_Rtm_Rtm_MainFunction, OsAlarmSetEventTaskRef=Os/Radar_Ctrl_Task
    Rte_Ev_Run_Rtm_Rtm_MainFunction (OsEvent)
    Rte_Al_TE_SWC_PLT_CDD_Logging_RE_Logging_2ms (OsAlarm): OsAlarmCounterRef=OsCounter, OsAlarmAccessingApplication=SystemApplication_OsCore0, OsAlarmAccessingApplication=OsCore0_ASIL
      OsAlarmAction
        OsAlarmSetEvent: OsAlarmSetEventRef=Rte_Ev_Run_SWC_PLT_CDD_Logging_RE_Logging_2ms, OsAlarmSetEventTaskRef=Os/Appl_Task_Fast
    Rte_Ev_Run_SWC_PLT_CDD_Logging_RE_Logging_2ms (OsEvent)
    Rte_Al_TE_SWC_PLT_Appl_Communication_RE_Communication_Tx_50ms (OsAlarm): OsAlarmCounterRef=OsCounter, OsAlarmAccessingApplication=SystemApplication_OsCore0
      OsAlarmAction
        OsAlarmSetEvent: OsAlarmSetEventRef=Rte_Ev_Run_SWC_PLT_Appl_Communication_RE_Communication_Tx_50ms, OsAlarmSetEventTaskRef=Os/Appl_Task_Communication
    Rte_Ev_Run_SWC_PLT_Appl_Communication_RE_Communication_Tx_50ms (OsEvent)
    Rte_Ev_Run_SWC_CDD_IPC_Dsp_sp_post_processing_complete (OsEvent)
    4 x OsIsr, all with OsIsrStackSize=1024, OsIsrEnableNesting=false, OsIsrUsesFpu=false:
      Illegal_Instruction_Exception: OsIsrCategory=CATEGORY_1, OsIsrInterruptType=EXCEPTION, OsIsrInterruptSource=1, OsIsrInterruptPriority=0, OsIsrInitialEnableInterruptSource=false, OsIsrSpecialFunctionName=ExceptionHandler_Illegal_Instruction, OsIsrInterruptMapping=EDGE_TRIGGERED
      DataAbort_Exception: OsIsrCategory=CATEGORY_1, OsIsrInterruptType=EXCEPTION, OsIsrInterruptSource=4, OsIsrInterruptPriority=0, OsIsrInitialEnableInterruptSource=false, OsIsrSpecialFunctionName=ExceptionHandler_Abort_Data, OsIsrInterruptMapping=EDGE_TRIGGERED
      PrefetchAbort_Exception: OsIsrCategory=CATEGORY_1, OsIsrInterruptType=EXCEPTION, OsIsrInterruptSource=3, OsIsrInterruptPriority=0, OsIsrInitialEnableInterruptSource=false, OsIsrSpecialFunctionName=ExceptionHandler_Abort_Prefetch, OsIsrInterruptMapping=EDGE_TRIGGERED
      MIPI_CHP_FUSA_Handler: OsIsrCategory=CATEGORY_2, OsIsrInterruptType=EXTERNAL, OsIsrInterruptSource=85, OsIsrInterruptPriority=10, OsIsrInitialEnableInterruptSource=true, OsIsrSpecialFunctionName=mipi_chp_fusa_handler
    Rte_Ev_Cyclic2_Appl_Task_Communication_0_10ms (OsEvent)
    Rte_Al_TE2_Appl_Task_Communication_0_10ms (OsAlarm): OsAlarmCounterRef=OsCounter, OsAlarmAccessingApplication=SystemApplication_OsCore0
      OsAlarmAction
        OsAlarmSetEvent: OsAlarmSetEventRef=Rte_Ev_Cyclic2_Appl_Task_Communication_0_10ms, OsAlarmSetEventTaskRef=Os/Appl_Task_Communication
    Rte_Ev_Run_SWC_PLT_CDD_HIL_RE_HIL_Periodic_Handler_Rp_HIL_Periodic_Handler_Trigger (OsEvent)
    Appl_Task_Fast (OsTask):
      OsTaskActivation = 1
      OsTaskPriority = 50
      OsTaskSchedule = FULL
      OsTaskStackSharing = false
      OsTaskStackSize = 2048
      OsTaskType = AUTO
      OsTaskUsesFpu = false
      OsTaskAccessingApplication = SystemApplication_OsCore0
      OsTaskEventRef = Rte_Ev_Run_SWC_PLT_CDD_Logging_PostRadarProcessing_RDD_Populate_RDD_Stream
      OsTaskEventRef = Rte_Ev_Run_SWC_PLT_CDD_Logging_RE_Logging_10ms
      OsTaskEventRef = Rte_Ev_Run_SWC_PLT_CDD_Logging_RE_Logging_2ms
      OsTaskEventRef = Rte_Ev_Run_SWC_PLT_CDD_Logging_RE_Logging_50ms
      OsTaskEventRef = Rte_Ev_Run_SWC_PLT_CDD_Logging_RE_Logging_5ms
      OsTaskAccessingApplication = OsCore0_ASIL
    Rte_Al_TE_Com_Com_MainFunctionTx_ComMainFunctionTx_Periodic (OsAlarm): OsAlarmCounterRef=OsCounter, OsAlarmAccessingApplication=SystemApplication_OsCore0
      OsAlarmAction
        OsAlarmSetEvent: OsAlarmSetEventRef=Rte_Ev_Run_Com_Com_MainFunctionTx_ComMainFunctionTx_Periodic, OsAlarmSetEventTaskRef=Os/Appl_Task_Communication
    Rte_Ev_Run_Com_Com_MainFunctionTx_ComMainFunctionTx_Periodic (OsEvent)
    13 x OsIsr, all with OsIsrCategory=CATEGORY_2, OsIsrInterruptType=EXTERNAL, OsIsrStackSize=1024, OsIsrEnableNesting=false, OsIsrUsesFpu=false:
      TIMER4_Handler_Isr: OsIsrInterruptSource=156, OsIsrInterruptPriority=9, OsIsrInitialEnableInterruptSource=true, OsIsrSpecialFunctionName=TIMER4_Handler  # /ActiveEcuC/Gpt PLAIN_TEXT GPT channel ISR. Created automatically based on GptChannelId
      CounterIsr_OsCounter: OsIsrInterruptSource=30, OsIsrInterruptPriority=1, OsIsrInitialEnableInterruptSource=false, OsIsrSpecialFunctionName=Os_TimerPfrtIsr
      BBE_SP_FUSA_IRQ_Handler: OsIsrInterruptSource=72, OsIsrInterruptPriority=4, OsIsrInitialEnableInterruptSource=true
      RA_ERROR_IRQ_Handler: OsIsrInterruptSource=77, OsIsrInterruptPriority=4, OsIsrInitialEnableInterruptSource=true
      RA_FUSA_IRQ_Handler: OsIsrInterruptSource=78, OsIsrInterruptPriority=4, OsIsrInitialEnableInterruptSource=true
      Artie_Mem_Fusa_Handler: OsIsrInterruptSource=66, OsIsrInterruptPriority=1, OsIsrInitialEnableInterruptSource=true
      mipi_err_fusa_handler: OsIsrInterruptSource=110, OsIsrInterruptPriority=0, OsIsrInitialEnableInterruptSource=true
      dsp_ctrl_err_fusa_irq_handler: OsIsrInterruptSource=108, OsIsrInterruptPriority=4, OsIsrInitialEnableInterruptSource=true
      Sysmem0_Fusa_Handler: OsIsrInterruptSource=79, OsIsrInterruptPriority=1, OsIsrInitialEnableInterruptSource=true
      Sysmem1_Fusa_Handler: OsIsrInterruptSource=80, OsIsrInterruptPriority=1, OsIsrInitialEnableInterruptSource=true
      Serial_Clock_Monitor_Handler: OsIsrInterruptSource=143, OsIsrInterruptPriority=1, OsIsrInitialEnableInterruptSource=true
      DSP_Clock_Monitor_Handler: OsIsrInterruptSource=140, OsIsrInterruptPriority=1, OsIsrInitialEnableInterruptSource=true
      MIPI_Clock_Monitor_Handler: OsIsrInterruptSource=142, OsIsrInterruptPriority=1, OsIsrInitialEnableInterruptSource=true
    OsCore0_ASIL (OsApplication):
      OsTrusted = true
      OsTrustedApplicationDelayTimingViolationCall = false
      OsTrustedApplicationWithProtection = false
      OsApplicationIsPrivileged = true
      OsAppUseTrustedFunctionStubs = false
      OsApplicationCoreRef = EcucCoreDefinition_Core0
      OsAppEcucPartitionRef = EcucPartition_Core0_ASIL
      OsAppAlarmRef = Rte_Al_TE2_Appl_Task_Communication_0_10ms
      OsAppAlarmRef = Rte_Al_TE2_BSW_Task_0_5ms
      OsAppAlarmRef = Rte_Al_TE2_BSW_Task_0_10ms
      OsAppAlarmRef = Rte_Al_TE2_BSW_Task_0_20ms
      OsAppAlarmRef = Rte_Al_TE_Appl_Task_0_5ms
      OsAppAlarmRef = Rte_Al_TE_Appl_Task_0_10ms
      OsAppAlarmRef = Rte_Al_TE_Appl_Task_0_50ms
      OsAppAlarmRef = Rte_Al_TE_Com_Com_MainFunctionTx_ComMainFunctionTx_Periodic
      OsAppAlarmRef = Rte_Al_TE_Radar_Ctrl_Task_0_50ms
      OsAppAlarmRef = Rte_Al_TE_Rtm_Rtm_MainFunction
      OsAppAlarmRef = Rte_Al_TE_SWC_PLT_Appl_Communication_RE_Communication_Tx_50ms
      OsAppAlarmRef = Rte_Al_TE_SWC_PLT_CDD_Radar_Control_RE_Radar_Control_10ms
      OsAppIsrRef = Artie_Mem_Fusa_Handler
      OsAppIsrRef = BBE_SP_FUSA_IRQ_Handler
      OsAppIsrRef = BBE_SP_GPIO0_Handler
      OsAppIsrRef = DataAbort_Exception
      OsAppIsrRef = DSP_Clock_Monitor_Handler
      OsAppIsrRef = dsp_ctrl_err_fusa_irq_handler
      OsAppIsrRef = Ethernet{0..7}_IRQ
      OsAppIsrRef = GPADC_Handler_Isr
      OsAppIsrRef = Illegal_Instruction_Exception
      OsAppIsrRef = MIPI_CHP_END_Handler
      OsAppIsrRef = MIPI_CHP_FUSA_Handler
      OsAppIsrRef = MIPI_CHP_START_Handler
      OsAppIsrRef = MIPI_Clock_Monitor_Handler
      OsAppIsrRef = mipi_err_fusa_handler
      OsAppIsrRef = MIPI_FRM_END_Handler
      OsAppIsrRef = MIPI_FRM_START_Handler
      OsAppIsrRef = MM_INTF0_Handler
      OsAppIsrRef = PrefetchAbort_Exception
      OsAppIsrRef = RA_ERROR_IRQ_Handler
      OsAppIsrRef = RA_FUSA_IRQ_Handler
      OsAppIsrRef = Serial_Clock_Monitor_Handler
      OsAppIsrRef = Sysmem0_Fusa_Handler
      OsAppIsrRef = Sysmem1_Fusa_Handler
      OsAppIsrRef = TIMER1_Handler_Isr
      OsAppIsrRef = TIMER4_Handler_Isr
      OsAppTaskRef = Appl_Init
      OsAppTaskRef = Os/Appl_Task
      OsAppTaskRef = Os/Appl_Task_Communication
      OsAppTaskRef = Os/Appl_BackgroundTask
      OsAppTaskRef = Os/BSW_Task
      OsAppTaskRef = Init_Task
      OsAppTaskRef = Os/Radar_Ctrl_Task
      OsAppAlarmRef = Rte_Al_TE_SWC_PLT_Appl_IntWDG_RE_PLT_WDG_Main_5ms
      OsAppAlarmRef = Rte_Al_TE2_Appl_Task_High_Prio_0_5ms
      OsAppTaskRef = Os/Appl_Task_High_Prio
      OsAppIsrRef = RA_Clock_Monitor_Handler
      OsAppAlarmRef = Rte_Al_TE_SWC_PLT_Appl_Diag_RE_PLT_Diag_PlatformTime_50ms
      OsAppIsrRef = CMRT_ISR
      OsAppTaskRef = Os/Appl_IPC_Task
      OsAppAlarmRef = Rte_Al_TE_Appl_IPC_Task_0_50ms
      OsAppIsrRef = AA0_FUSA_IRQ_Handler
      OsAppIsrRef = AA1_FUSA_IRQ_Handler
      OsAppIsrRef = CNOC_Latent_Fusa_Handler
      OsAppIsrRef = ANOC_Latent_Fusa_Handler
      OsAppIsrRef = SNOC_Latent_Fusa_Handler
      OsAppIsrRef = CRG_RMON_SWS_IRQ_Handler
      OsAppAlarmRef = Rte_Al_TE_SWC_PLT_CDD_Radar_Control_RE_Radar_Ctl_Look_Complete_Post_RFBIST
      OsAppIsrRef = I2C_Handler_Isr
      OsAppAlarmRef = Rte_Al_TE_SWC_CDD_IPC_RE_IPC_VSE_Handler_10ms
      OsAppIsrRef = HSM_FUSA_ALARM_ISR
      OsAppIsrRef = HSM_DMB_ISR
      OsAppAlarmRef = Rte_Al_TE_SWC_PLT_Appl_IntWDG_RE_PLT_WDG_INTERNAL_WDG_PLT_Appl_Task
      OsAppAlarmRef = Rte_Al_TE_Appl_Task_Communication_0_25ms
      OsAppAlarmRef = Rte_Al_TE_SWC_PLT_Appl_IntWDG_RE_PLT_WDG_INTERNAL_WDG_BSW_Task
      OsAppAlarmRef = Rte_Al_TE2_Appl_BackgroundTask_0_5ms
      OsAppAlarmRef = Rte_Al_TE_SWC_PLT_Appl_NvMHandler_RE_PLT_Appl_NvMHandler_5ms
      OsAppIsrRef = WATCHDOG_Handler_Isr
      OsAppIsrRef = CANFD0_Handler_Isr
      OsAppIsrRef = CANFD1_Handler_Isr
      OsAppIsrRef = TIMER2_Handler_Isr
      OsAppIsrRef = TIMER3_Handler_Isr
      OsAppIsrRef = DMA_Handler_Isr
      OsAppIsrRef = TIMER5_Handler_Isr
      OsAppAlarmRef = Rte_Al_TE2_Appl_Task_High_Prio_0_10ms
      OsApplicationHooks: OsAppErrorHook=false, OsAppShutdownHook=false, OsAppStartupHook=false
    Init_Task_Qm (OsTask):
      OsTaskActivation = 1
      OsTaskPriority = 210
      OsTaskSchedule = FULL
      OsTaskStackSharing = false
      OsTaskStackSize = 1024
      OsTaskType = AUTO
      OsTaskUsesFpu = false
      OsTaskAccessingApplication = SystemApplication_OsCore0
      OsTaskAccessingApplication = OsCore0_ASIL
      OsTaskAccessingApplication = OsCore_Qm
      OsTaskResourceRef = OsResource
    OsCore_Qm (OsApplication):
      OsTrusted = true
      OsTrustedApplicationDelayTimingViolationCall = false
      OsTrustedApplicationWithProtection = false
      OsApplicationIsPrivileged = true
      OsAppUseTrustedFunctionStubs = false
      OsApplicationCoreRef = EcucCoreDefinition_Core0
      OsAppEcucPartitionRef = EcucPartition_OsCore0_QM
      OsAppAlarmRef = Rte_Al_TE_SWC_PLT_CDD_Logging_RE_Logging_2ms
      OsAppTaskRef = Os/Appl_Task_Logging
      OsAppTaskRef = Init_Task_Qm
      OsAppAlarmRef = Rte_Al_TE_SWC_PLT_CDD_Logging_RE_Logging_5ms
      OsAppAlarmRef = Rte_Al_TE_SWC_PLT_CDD_Logging_RE_Logging_10ms
      OsAppAlarmRef = Rte_Al_TE_SWC_PLT_CDD_Logging_RE_Logging_50ms
      OsAppTaskRef = Os/Appl_Task_Fast
      OsAppAlarmRef = Rte_Al_TE_SWC_CMP_PRJ_UDSHandler_RE_SWC_CMP_PRJ_UDSHandler_Main_50ms
      OsApplicationHooks: OsAppErrorHook=false, OsAppShutdownHook=false, OsAppStartupHook=false
    Appl_Task_High_Prio (OsTask):
      OsTaskActivation = 1
      OsTaskPriority = 150
      OsTaskSchedule = FULL
      OsTaskStackSharing = false
      OsTaskStackSize = 1024
      OsTaskType = AUTO
      OsTaskUsesFpu = false
      OsTaskAccessingApplication = SystemApplication_OsCore0
      OsTaskAccessingApplication = OsCore0_ASIL
      OsTaskEventRef = Rte_Ev_Cyclic2_Appl_Task_High_Prio_0_5ms
      OsTaskEventRef = Rte_Ev_Run_SWC_PLT_Appl_IntWDG_RE_PLT_WDG_Main_5ms
      OsTaskEventRef = Rte_Ev_Run_SWC_PLT_Appl_Diag_RE_PLT_Diag_PlatformTime_50ms
      OsTaskEventRef = Rte_Ev_Cyclic2_Appl_Task_High_Prio_0_10ms
      OsTaskEventRef = Rte_Ev_WP_Appl_Task_High_Prio
      OsTaskAccessingApplication = OsCore_Qm
    Rte_Al_TE2_Appl_Task_High_Prio_0_5ms (OsAlarm): OsAlarmCounterRef=OsCounter, OsAlarmAccessingApplication=SystemApplication_OsCore0
      OsAlarmAction
        OsAlarmSetEvent: OsAlarmSetEventRef=Rte_Ev_Cyclic2_Appl_Task_High_Prio_0_5ms, OsAlarmSetEventTaskRef=Os/Appl_Task_High_Prio
    Rte_Al_TE_SWC_PLT_Appl_IntWDG_RE_PLT_WDG_Main_5ms (OsAlarm): OsAlarmCounterRef=OsCounter, OsAlarmAccessingApplication=SystemApplication_OsCore0
      OsAlarmAction
        OsAlarmSetEvent: OsAlarmSetEventRef=Rte_Ev_Run_SWC_PLT_Appl_IntWDG_RE_PLT_WDG_Main_5ms, OsAlarmSetEventTaskRef=Os/Appl_Task_High_Prio
    Rte_Ev_Cyclic2_Appl_Task_High_Prio_0_5ms (OsEvent)
    Rte_Ev_Run_SWC_PLT_Appl_IntWDG_RE_PLT_WDG_Main_5ms (OsEvent)
    RA_Clock_Monitor_Handler (OsIsr):
      OsIsrCategory = CATEGORY_2
      OsIsrInterruptType = EXTERNAL
      OsIsrInterruptSource = 141
      OsIsrInterruptPriority = 4
      OsIsrStackSize = 1024
      OsIsrEnableNesting = false
      OsIsrUsesFpu = false
      OsIsrInitialEnableInterruptSource = true
    Rte_Al_TE_SWC_PLT_Appl_Diag_RE_PLT_Diag_PlatformTime_50ms (OsAlarm): OsAlarmCounterRef=OsCounter, OsAlarmAccessingApplication=SystemApplication_OsCore0
      OsAlarmAction
        OsAlarmSetEvent: OsAlarmSetEventRef=Rte_Ev_Run_SWC_PLT_Appl_Diag_RE_PLT_Diag_PlatformTime_50ms, OsAlarmSetEventTaskRef=Os/Appl_Task_High_Prio
    Rte_Ev_Run_SWC_PLT_Appl_Diag_RE_PLT_Diag_PlatformTime_50ms (OsEvent)
    CMRT_ISR (OsIsr):
      OsIsrCategory = CATEGORY_2
      OsIsrInterruptType = EXTERNAL
      OsIsrInterruptSource = 57
      OsIsrInterruptPriority = 0
      OsIsrStackSize = 1024
      OsIsrEnableNesting = false
      OsIsrUsesFpu = false
      OsIsrInitialEnableInterruptSource = true
      OsIsrSpecialFunctionName = HSM0_Handler
      OsIsrResourceRef = OsResource
    Appl_IPC_Task (OsTask):
      OsTaskActivation = 1
      OsTaskPriority = 130
      OsTaskSchedule = FULL
      OsTaskStackSharing = false
      OsTaskStackSize = 4096
      OsTaskType = AUTO
      OsTaskUsesFpu = false
      OsTaskAccessingApplication = SystemApplication_OsCore0
      OsTaskAccessingApplication = OsCore0_ASIL
      OsTaskAccessingApplication = OsCore_Qm
      OsTaskEventRef = Rte_Ev_Run_SWC_CDD_IPC_Dsp_sp_post_processing_complete
      OsTaskEventRef = Rte_Ev_Cyclic_Appl_IPC_Task_0_50ms
      OsTaskEventRef = Rte_Ev_Run_SWC_CDD_IPC_RE_IPC_VSE_Handler_10ms
    Rte_Al_TE_Appl_IPC_Task_0_50ms (OsAlarm): OsAlarmCounterRef=OsCounter, OsAlarmAccessingApplication=SystemApplication_OsCore0
      OsAlarmAction
        OsAlarmSetEvent: OsAlarmSetEventRef=Rte_Ev_Cyclic_Appl_IPC_Task_0_50ms, OsAlarmSetEventTaskRef=Os/Appl_IPC_Task
    Rte_Ev_Cyclic_Appl_IPC_Task_0_50ms (OsEvent)
    5 x OsIsr, all with OsIsrCategory=CATEGORY_2, OsIsrInterruptType=EXTERNAL, OsIsrInterruptPriority=0, OsIsrStackSize=1024, OsIsrEnableNesting=false, OsIsrUsesFpu=false, OsIsrInitialEnableInterruptSource=true:
      AA0_FUSA_IRQ_Handler: OsIsrInterruptSource=88, OsIsrSpecialFunctionName=AA0_Fusa_Handler
      AA1_FUSA_IRQ_Handler: OsIsrInterruptSource=89, OsIsrSpecialFunctionName=AA1_Fusa_Handler
      CNOC_Latent_Fusa_Handler: OsIsrInterruptSource=121, OsIsrSpecialFunctionName=CNOC_Latent_Fusa_Handler, OsIsrInterruptMapping=EDGE_TRIGGERED
      ANOC_Latent_Fusa_Handler: OsIsrInterruptSource=124, OsIsrSpecialFunctionName=ANOC_Latent_Fusa_Handler, OsIsrInterruptMapping=EDGE_TRIGGERED
      SNOC_Latent_Fusa_Handler: OsIsrInterruptSource=127, OsIsrSpecialFunctionName=SNOC_Latent_Fusa_Handler, OsIsrInterruptMapping=EDGE_TRIGGERED
    3 x OsAlarm, all with OsAlarmCounterRef=OsCounter, OsAlarmAccessingApplication=SystemApplication_OsCore0, OsAlarmAccessingApplication=OsCore0_ASIL:
      Rte_Al_TE_SWC_PLT_CDD_Logging_RE_Logging_10ms
        OsAlarmAction
          OsAlarmSetEvent: OsAlarmSetEventRef=Rte_Ev_Run_SWC_PLT_CDD_Logging_RE_Logging_10ms, OsAlarmSetEventTaskRef=Os/Appl_Task_Fast
      Rte_Al_TE_SWC_PLT_CDD_Logging_RE_Logging_50ms
        OsAlarmAction
          OsAlarmSetEvent: OsAlarmSetEventRef=Rte_Ev_Run_SWC_PLT_CDD_Logging_RE_Logging_50ms, OsAlarmSetEventTaskRef=Os/Appl_Task_Fast
      Rte_Al_TE_SWC_PLT_CDD_Logging_RE_Logging_5ms
        OsAlarmAction
          OsAlarmSetEvent: OsAlarmSetEventRef=Rte_Ev_Run_SWC_PLT_CDD_Logging_RE_Logging_5ms, OsAlarmSetEventTaskRef=Os/Appl_Task_Fast
    5 x OsEvent:
      Rte_Ev_Run_SWC_PLT_CDD_Logging_RE_Logging_10ms
      Rte_Ev_Run_SWC_PLT_CDD_Logging_RE_Logging_50ms
      Rte_Ev_Run_SWC_PLT_CDD_Logging_RE_Logging_5ms
      Rte_Ev_Run_SWC_PLT_CDD_Logging_StbM_MeasurementNotification_StbMSynchronizedTimeBase_TimeRecordBlock_Callback
      Rte_Ev_Run_SWC_PLT_Appl_Communication_PostRadarProcessing_CAN_Tx_RE_Communication_Tx
    CRG_RMON_SWS_IRQ_Handler (OsIsr):
      OsIsrCategory = CATEGORY_2
      OsIsrInterruptType = EXTERNAL
      OsIsrInterruptSource = 148
      OsIsrInterruptPriority = 0
      OsIsrStackSize = 1024
      OsIsrEnableNesting = false
      OsIsrUsesFpu = false
      OsIsrInitialEnableInterruptSource = true
      OsIsrSpecialFunctionName = Reset_Monitor_Handler
      OsIsrInterruptMapping = EDGE_TRIGGERED
    Rte_Ev_Run_SWC_PLT_CDD_TimeSync_DRE_StatusNotification_Callback (OsEvent)
    Rte_Al_TE_SWC_CMP_PRJ_UDSHandler_RE_SWC_CMP_PRJ_UDSHandler_Main_50ms (OsAlarm): OsAlarmCounterRef=OsCounter, OsAlarmAccessingApplication=OsCore0_ASIL, OsAlarmAccessingApplication=SystemApplication_OsCore0
      OsAlarmAction
        OsAlarmSetEvent: OsAlarmSetEventRef=Rte_Ev_Run_SWC_CMP_PRJ_UDSHandler_RE_SWC_CMP_PRJ_UDSHandler_Main_50ms, OsAlarmSetEventTaskRef=Os/Appl_Task_Logging
    Rte_Ev_Run_SWC_CMP_PRJ_UDSHandler_RE_SWC_CMP_PRJ_UDSHandler_Main_50ms (OsEvent)
    Rte_Al_TE_SWC_PLT_CDD_Radar_Control_RE_Radar_Ctl_Look_Complete_Post_RFBIST (OsAlarm): OsAlarmCounterRef=OsCounter, OsAlarmAccessingApplication=SystemApplication_OsCore0
      OsAlarmAction
        OsAlarmSetEvent: OsAlarmSetEventRef=Rte_Ev_Run_SWC_PLT_CDD_Radar_Control_RE_Radar_Ctl_Look_Complete_Post_RFBIST, OsAlarmSetEventTaskRef=Os/Radar_Ctrl_Task
    Rte_Ev_Run_SWC_PLT_CDD_Radar_Control_RE_Radar_Ctl_Look_Complete_Post_RFBIST (OsEvent)
    OsMemoryProtection
      11 x OsMemoryRegion, all with OsMemoryRegionProtectionUnit=Core0_MPU, OsMemoryRegionFlags=TYPE_NORMAL_MEMORY_INNER_NON_CACHEABLE, OsMemoryRegionFlags=TYPE_NORMAL_MEMORY_OUTER_NON_CACHEABLE:
        OsMemoryRegionStackProtectionCoreOsCore0Region0: OsMemoryRegionStartAddress=_OS_CORE0_STACKS_START, OsMemoryRegionEndAddress=_OS_CORE0_STACKS_LIMIT, OsMemoryRegionProtectionUnitSlot=0, OsMemoryRegionAccessRights=SUPERVISOR_RW_USER_RW
        OsMemoryRegionStackProtectionCoreOsCore0Region1: OsMemoryRegionStartAddress=_OS_CORE0_STACKS_START, OsMemoryRegionEndAddress=_OS_CORE0_STACKS_START, OsMemoryRegionProtectionUnitSlot=1, OsMemoryRegionAccessRights=SUPERVISOR_RW_USER_RW
        OsMemoryRegionStackProtectionCoreOsCore0Region2: OsMemoryRegionStartAddress=_OS_CORE0_STACKS_LIMIT, OsMemoryRegionEndAddress=_OS_CORE0_STACKS_LIMIT, OsMemoryRegionProtectionUnitSlot=2, OsMemoryRegionAccessRights=SUPERVISOR_RW_USER_RW
        R52_TCMBC: OsMemoryRegionStartAddress=__R52_TCMBC_BASE__, OsMemoryRegionEndAddress=__R52_TCMBC_LIMIT__, OsMemoryRegionProtectionUnitSlot=3, OsMemoryRegionAccessRights=EXECUTE_ALLOWED, OsMemoryRegionAccessRights=SUPERVISOR_RW_USER_RW
        R52_TCMA_NULL_GUARD: OsMemoryRegionStartAddress=__R52_TCMA_NULL_GUARD_BASE__, OsMemoryRegionEndAddress=__R52_TCMA_NULL_GUARD_LIMIT__, OsMemoryRegionProtectionUnitSlot=4, OsMemoryRegionAccessRights=SUPERVISOR_R_USER_NONE
        R52_TCMA: OsMemoryRegionStartAddress=__R52_TCMA_BASE__, OsMemoryRegionEndAddress=__R52_TCMA_LIMIT__, OsMemoryRegionProtectionUnitSlot=5, OsMemoryRegionAccessRights=EXECUTE_ALLOWED, OsMemoryRegionAccessRights=SUPERVISOR_RW_USER_RW
        SYSMEM0_R52_TCM: OsMemoryRegionStartAddress=__SYSMEM0_R52_SYSMEM_BASE__, OsMemoryRegionEndAddress=__SYSMEM0_R52_SYSMEM_LIMIT__, OsMemoryRegionProtectionUnitSlot=6, OsMemoryRegionAccessRights=EXECUTE_ALLOWED, OsMemoryRegionAccessRights=SUPERVISOR_RW_USER_RW
        SYSMEM0_R52_DATA: OsMemoryRegionStartAddress=__SYSMEM0_R52_DATA_BASE__, OsMemoryRegionEndAddress=__SYSMEM0_R52_DATA_LIMIT__, OsMemoryRegionProtectionUnitSlot=7, OsMemoryRegionAccessRights=SUPERVISOR_RW_USER_RW
        ARTIE_MEM: OsMemoryRegionStartAddress=__ARTIE_MEM_BASE__, OsMemoryRegionEndAddress=__ARTIE_MEM_LIMIT__, OsMemoryRegionProtectionUnitSlot=8, OsMemoryRegionAccessRights=SUPERVISOR_RW_USER_RW
        SYSMEM1_R52_DATA: OsMemoryRegionStartAddress=__SYSMEM1_R52_DATA_BASE__, OsMemoryRegionEndAddress=__SYSMEM1_R52_DATA_LIMIT__, OsMemoryRegionProtectionUnitSlot=9, OsMemoryRegionAccessRights=SUPERVISOR_RW_USER_RW
        SYSMEM0_R52_QM: OsMemoryRegionStartAddress=__SYSMEM0_R52_QM_BASE__, OsMemoryRegionEndAddress=__SYSMEM0_R52_QM_LIMIT__, OsMemoryRegionProtectionUnitSlot=10, OsMemoryRegionAccessRights=EXECUTE_ALLOWED, OsMemoryRegionAccessRights=SUPERVISOR_RW_USER_RW
    Rte_Al_TE_SWC_CDD_IPC_RE_IPC_VSE_Handler_10ms (OsAlarm): OsAlarmCounterRef=OsCounter, OsAlarmAccessingApplication=SystemApplication_OsCore0
      OsAlarmAction
        OsAlarmSetEvent: OsAlarmSetEventRef=Rte_Ev_Run_SWC_CDD_IPC_RE_IPC_VSE_Handler_10ms, OsAlarmSetEventTaskRef=Os/Appl_IPC_Task
    Rte_Ev_Run_SWC_CDD_IPC_RE_IPC_VSE_Handler_10ms (OsEvent)
    HSM_DMB_ISR (OsIsr):
      OsIsrCategory = CATEGORY_2
      OsIsrInterruptType = EXTERNAL
      OsIsrInterruptSource = 130
      OsIsrInterruptPriority = 0
      OsIsrStackSize = 1024
      OsIsrEnableNesting = false
      OsIsrUsesFpu = false
      OsIsrInitialEnableInterruptSource = true
      OsIsrSpecialFunctionName = DMB_Handler
      OsIsrResourceRef = OsResource
      OsIsrInterruptMapping = EDGE_TRIGGERED
    HSM_FUSA_ALARM_ISR (OsIsr):
      OsIsrCategory = CATEGORY_2
      OsIsrInterruptType = EXTERNAL
      OsIsrInterruptSource = 117
      OsIsrInterruptPriority = 0
      OsIsrStackSize = 1024
      OsIsrEnableNesting = false
      OsIsrUsesFpu = false
      OsIsrInitialEnableInterruptSource = true
      OsIsrSpecialFunctionName = HSM_ALARM_FUSA_Handler
      OsIsrResourceRef = OsResource
      OsIsrInterruptMapping = EDGE_TRIGGERED
    3 x OsEvent:
      Rte_Ev_Run_SWC_PRJ_Appl_FaultMgr_RE_PCAN_Timeout_Faults_Event
      Rte_Ev_Run_SWC_PRJ_Appl_FaultMgr_RE_VCAN_Timeout_Faults_100ms_1000ms_Event
      Rte_Ev_Run_SWC_PRJ_Appl_FaultMgr_RE_VCAN_Timeout_Faults_10ms_20ms_50ms_Event
    3 x OsAlarm, all with OsAlarmCounterRef=OsCounter, OsAlarmAccessingApplication=SystemApplication_OsCore0:
      Rte_Al_TE_SWC_PLT_Appl_IntWDG_RE_PLT_WDG_INTERNAL_WDG_PLT_Appl_Task
        OsAlarmAction
          OsAlarmSetEvent: OsAlarmSetEventRef=Rte_Ev_Run_SWC_PLT_Appl_IntWDG_RE_PLT_WDG_INTERNAL_WDG_PLT_Appl_Task, OsAlarmSetEventTaskRef=Os/Appl_Task
      Rte_Al_TE_Appl_Task_Communication_0_25ms
        OsAlarmAction
          OsAlarmSetEvent: OsAlarmSetEventRef=Rte_Ev_Cyclic_Appl_Task_Communication_0_25ms, OsAlarmSetEventTaskRef=Os/Appl_Task_Communication
      Rte_Al_TE_SWC_PLT_Appl_IntWDG_RE_PLT_WDG_INTERNAL_WDG_BSW_Task
        OsAlarmAction
          OsAlarmSetEvent: OsAlarmSetEventRef=Rte_Ev_Run_SWC_PLT_Appl_IntWDG_RE_PLT_WDG_INTERNAL_WDG_BSW_Task, OsAlarmSetEventTaskRef=Os/BSW_Task
    3 x OsEvent:
      Rte_Ev_Cyclic_Appl_Task_Communication_0_25ms
      Rte_Ev_Run_SWC_PLT_Appl_IntWDG_RE_PLT_WDG_INTERNAL_WDG_BSW_Task
      Rte_Ev_Run_SWC_PLT_Appl_IntWDG_RE_PLT_WDG_INTERNAL_WDG_PLT_Appl_Task
    Rte_Al_TE2_Appl_BackgroundTask_0_5ms (OsAlarm): OsAlarmCounterRef=OsCounter, OsAlarmAccessingApplication=SystemApplication_OsCore0
      OsAlarmAction
        OsAlarmSetEvent: OsAlarmSetEventRef=Rte_Ev_Cyclic2_Appl_BackgroundTask_0_5ms, OsAlarmSetEventTaskRef=Os/Appl_BackgroundTask
    Rte_Ev_Cyclic2_Appl_BackgroundTask_0_5ms (OsEvent)
    8 x OsIsr, all with OsIsrCategory=CATEGORY_2, OsIsrInterruptType=EXTERNAL, OsIsrStackSize=1024, OsIsrEnableNesting=false, OsIsrUsesFpu=false:
      I2C_Handler_Isr: OsIsrInterruptSource=43, OsIsrInterruptPriority=2, OsIsrInitialEnableInterruptSource=true, OsIsrSpecialFunctionName=I2CM_Handler, OsIsrInterruptMapping=EDGE_TRIGGERED  # /ActiveEcuC/I2c PLAIN_TEXT I2C interrupt ISR. Created automatically based on I2c configuration
      WATCHDOG_Handler_Isr: OsIsrInterruptSource=34, OsIsrInterruptPriority=2, OsIsrInitialEnableInterruptSource=true, OsIsrSpecialFunctionName=WATCHDOG_FUSA_Handler  # /ActiveEcuC/Wdg PLAIN_TEXT WDG interrupt ISR. Created automatically based on Wdg configuration
      DMA_Handler_Isr: OsIsrInterruptSource=65, OsIsrInterruptPriority=0, OsIsrInitialEnableInterruptSource=false, OsIsrSpecialFunctionName=MCDMA_Handler  # /ActiveEcuC/Dma PLAIN_TEXT DMA interrupt ISR. Created automatically
      CANFD1_Handler_Isr: OsIsrInterruptSource=33, OsIsrInterruptPriority=6, OsIsrInitialEnableInterruptSource=true, OsIsrSpecialFunctionName=CANFD1_Handler, OsIsrInterruptMapping=EDGE_TRIGGERED  # /ActiveEcuC/Can PLAIN_TEXT Can interrupt ISR. Created automatically
      CANFD0_Handler_Isr: OsIsrInterruptSource=32, OsIsrInterruptPriority=6, OsIsrInitialEnableInterruptSource=true, OsIsrSpecialFunctionName=CANFD0_Handler, OsIsrInterruptMapping=EDGE_TRIGGERED  # /ActiveEcuC/Can PLAIN_TEXT Can interrupt ISR. Created automatically
      TIMER2_Handler_Isr: OsIsrInterruptSource=45, OsIsrInterruptPriority=3, OsIsrInitialEnableInterruptSource=true, OsIsrSpecialFunctionName=TIMER2_Handler  # /ActiveEcuC/Gpt PLAIN_TEXT GPT channel ISR. Created automatically based on GptChannelId
      TIMER5_Handler_Isr: OsIsrInterruptSource=157, OsIsrInterruptPriority=0, OsIsrInitialEnableInterruptSource=false, OsIsrSpecialFunctionName=TIMER5_Handler  # /ActiveEcuC/Gpt PLAIN_TEXT GPT channel ISR. Created automatically based on GptChannelId
      TIMER3_Handler_Isr: OsIsrInterruptSource=46, OsIsrInterruptPriority=6, OsIsrInitialEnableInterruptSource=true, OsIsrSpecialFunctionName=TIMER3_Handler  # /ActiveEcuC/Gpt PLAIN_TEXT GPT channel ISR. Created automatically based on GptChannelId
    Rte_Al_TE_SWC_PLT_Appl_NvMHandler_RE_PLT_Appl_NvMHandler_5ms (OsAlarm): OsAlarmCounterRef=OsCounter, OsAlarmAccessingApplication=SystemApplication_OsCore0
      OsAlarmAction
        OsAlarmSetEvent: OsAlarmSetEventRef=Rte_Ev_Run_SWC_PLT_Appl_NvMHandler_RE_PLT_Appl_NvMHandler_5ms, OsAlarmSetEventTaskRef=Os/BSW_Task
    Rte_Ev_Run_SWC_PLT_Appl_NvMHandler_RE_PLT_Appl_NvMHandler_5ms (OsEvent)
    Rte_Al_TE2_Appl_Task_High_Prio_0_10ms (OsAlarm): OsAlarmCounterRef=OsCounter, OsAlarmAccessingApplication=SystemApplication_OsCore0
      OsAlarmAction
        OsAlarmSetEvent: OsAlarmSetEventRef=Rte_Ev_Cyclic2_Appl_Task_High_Prio_0_10ms, OsAlarmSetEventTaskRef=Os/Appl_Task_High_Prio
    Rte_Ev_Cyclic2_Appl_Task_High_Prio_0_10ms (OsEvent)
    Rte_Ev_WP_Appl_Task_High_Prio (OsEvent): OsEventMask=2
