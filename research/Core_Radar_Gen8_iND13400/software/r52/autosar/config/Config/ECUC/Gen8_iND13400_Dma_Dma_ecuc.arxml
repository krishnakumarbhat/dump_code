AUTOSAR XML (schema 00053)
package /ActiveEcuC
  module config Dma: implementation-config-variant=VARIANT-PRE-COMPILE, module-description=Dma_Impl
    DmaChannelConfigSet
      DmaChannel_1 (DmaChannel):
        DmaChannelID = CHANNEL_ID_1
        Arlen = 7
        ArlenEn = true
        Awlen = 7
        AwlenEn = true
        ChannelPriority = CH_PRIORITY_3
        ChannelTransferType = DMA_TRANSFER_M2M
        DstBurstsize = DMA_ITEM_NUM_16
        DstDataWidth = DMA_TR_WIDTH_32
        DstMultiBlockTransferType = DMA_MULTBLK_CONTIGUOUS
        SrcBurstsize = DMA_ITEM_NUM_16
        SrcDataWidth = DMA_TR_WIDTH_32
        SrcMultiBlockTransferType = DMA_MULTBLK_CONTIGUOUS
        TransferEnableEndNotification = true
        TransferEndNotificationCallback = Channel1_EndNotification
    DmaConfigurationOfOptApiServices: DmaGetVersionInfo=true, DmaChannelSuspend=true, DmaChannelAbort=true
    DmaGeneral: DmaDevErrorDetect=false, DmaDemErrorReporting=false, DmaReTransferOnFailure=true, DmaHardwareVariant=DMA_HARDWARE_B0_VARIANT
