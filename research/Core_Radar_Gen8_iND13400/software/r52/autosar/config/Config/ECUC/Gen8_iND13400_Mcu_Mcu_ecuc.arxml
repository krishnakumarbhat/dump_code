AUTOSAR XML (schema 00053)
package /ActiveEcuC
  module config Mcu: implementation-config-variant=VARIANT-PRE-COMPILE, module-description=Mcu_Impl
    McuModuleConfiguration:
      McuNumberOfMcuModes = 1
      McuRamSectors = 2
      McuResetSetting = 1
      McuClockSrcFailureNotification = DISABLED
      McuClockFailureCallout = NULL_PTR
      McuPreResetCallout = NULL_PTR
      McuClockSettingConfig: McuClockSettingId=0
        27 x McuClockReferencePoint:
          McuClockReferencePoint: McuClockReferencePointFrequency=500
          VCO: McuClockReferencePointFrequency=2500000000
          CLKREF: McuClockReferencePointFrequency=40000000
          clk_ref_src: McuClockReferencePointFrequency=40000000
          CLK_TEST_1P8: McuClockReferencePointFrequency=0
          clk_dsp: McuClockReferencePointFrequency=833000000
          clk_sys_src: McuClockReferencePointFrequency=500000000
          clk_sys: McuClockReferencePointFrequency=500000000
          clk_gpadc: McuClockReferencePointFrequency=250000000
          clk_sd2_top: McuClockReferencePointFrequency=250000000
          clk_serial: McuClockReferencePointFrequency=100000000
          clk_mipi_esc: McuClockReferencePointFrequency=100000000
          clk_sys_ra: McuClockReferencePointFrequency=500000000
          clk_sys_mipi: McuClockReferencePointFrequency=500000000
          clk_ref_buf: McuClockReferencePointFrequency=40000000
          clk_can: McuClockReferencePointFrequency=40000000
          clk_srds_tx1: McuClockReferencePointFrequency=0
          clk_srds_rx0_src: McuClockReferencePointFrequency=0
          clk_srds_tx0_src: McuClockReferencePointFrequency=625000000
          clk_hsst: McuClockReferencePointFrequency=0
          clk_e_rx_125: McuClockReferencePointFrequency=0
          clk_e_rx: McuClockReferencePointFrequency=625000000
          clk_macsec_rx: McuClockReferencePointFrequency=625000000
          clk_e_tx_125: McuClockReferencePointFrequency=0
          clk_e_tx: McuClockReferencePointFrequency=625000000
          clk_macsec_tx: McuClockReferencePointFrequency=625000000
          clk_SWD_interface: McuClockReferencePointFrequency=50000000
      McuModeSettingConf: McuMode=0
      SYSMEM0 (McuRamSectorSettingConf): McuRamDefaultValue=0, McuRamSectionBaseAddress=2147483648, McuRamSectionSize=33554432, McuRamSectionWriteSize=8, McuRamSectorId=0
      SYSMEM1 (McuRamSectorSettingConf): McuRamDefaultValue=0, McuRamSectionBaseAddress=2181038080, McuRamSectionSize=33554432, McuRamSectionWriteSize=8, McuRamSectorId=1
    McuPublishedInformation
      5 x McuResetReasonConf:
        MCU_POWER_ON_RESET: McuResetReason=0
        MCU_SW_RESET: McuResetReason=1
        MCU_FCRU_RESET: McuResetReason=2
        MCU_RESET_UNDEFINED: McuResetReason=4
        MCU_RSTN_RESET: McuResetReason=3
    McuGeneralConfiguration:
      McuDevErrorDetect = false
      McuGetRamStateApi = false
      McuInitClock = true
      McuNoPll = false
      McuPerformResetApi = true
      McuVersionInfoApi = true
      McuHardwareVariant = MCU_HARDWARE_B0_VARIANT
      McuGetFcruStickyRegApi = false
