AUTOSAR XML (schema 00053)
package /ActiveEcuC
  module config Xcp: implementation-config-variant=VARIANT-PRE-COMPILE, module-description=Xcp_Impl
    XcpConfig
      XcpTransportLayer
        XcpOnEth:
          XcpOnEthMaxCto = 255
          XcpOnEthMaxDto = 1444
          XcpOnEthConfirmationTimeout = 10
          XcpOnEthMultiConnectionProtection = false
          XcpOnEthOptimizedCopy = false
          XcpOnEthConcatenationMode = true
          XcpOnEthBurstMode = true
          XcpBurstSize = 10
          XcpPduMode = false
        XcpOnCan:
          XcpOnCanMaxCto = 64
          XcpOnCanMaxDto = 64
          XcpOnCanConfirmationTimeout = 10
          XcpOnCanMultiConnectionProtection = false
          XcpOnCanVariableDlc = true
          XcpPduMode = false
      XcpPdu_Eth_Req_Rx (XcpPdu)
        XcpRxPdu: XcpRxPduId=0, XcpRxPduRef=RDR_XCP_ETH_RX, XcpTxPduContRef=XcpTxPdu
      XcpPdu_Eth_Req_Tx (XcpPdu)
        XcpTxPdu: XcpTxPduId=0, XcpTxPduRef=RDR_XCP_ETH_TX
      Xcp_Daq_Event_0_Post_RDD (XcpEventChannel):
        XcpEventChannelMaxDaqList = 1
        XcpEventChannelNumber = 1
        XcpEventChannelTimeCycle = 0
        XcpEventChannelTimeUnit = TIMESTAMP_UNIT_1US
        XcpEventChannelType = DAQ
        XcpEventChannelCoreRef = XcpCoreDefinition
      XcpCoreDefinition: XcpSendQueueSize=20480
      3 x XcpEventChannel, all with XcpEventChannelMaxDaqList=1, XcpEventChannelTimeCycle=0, XcpEventChannelType=DAQ, XcpEventChannelCoreRef=XcpCoreDefinition:
        Xcp_Daq_Event_1_ADC: XcpEventChannelNumber=2, XcpEventChannelTimeUnit=TIMESTAMP_UNIT_1US
        Xcp_Daq_Event_2_MMIC: XcpEventChannelNumber=3, XcpEventChannelTimeUnit=TIMESTAMP_UNIT_1US
        Rtm_Evt: XcpEventChannelNumber=0, XcpEventChannelTimeUnit=TIMESTAMP_UNIT_1MS  # /ActiveEcuC/Rtm PLAIN_TEXT XcpEventChannel for Rtm Measurement
      3 x XcpPdu:
        RDR_XCP_CTO_REQ
          XcpRxPdu_001 (XcpRxPdu): XcpRxPduId=0, XcpRxPduRef=RDR_XCP_CTO_REQ_oPCAN_RADAR_5b59bad2_Rx, XcpTxPduContRef=XcpTxPdu_001
        RDR_XCP_CTO_RESP
          XcpTxPdu_001 (XcpTxPdu): XcpTxPduId=0, XcpTxPduRef=RDR_XCP_CTO_RESP_oPCAN_RADAR_e3946380_Tx
        RDR_XCP_DAQ_RESP
          XcpTxPdu_002 (XcpTxPdu): XcpTxPduId=1, XcpTxPduRef=RDR_XCP_DAQ_RESP_oPCAN_RADAR_1cc015b8_Tx
    XcpCmdConfig: XcpOpenCommandInterface=false
      XcpStandard: XcpBlockUpload=true, XcpCommunicationModeInfo=true, XcpGetIdGeneric=true, XcpMemoryReadProtection=false, XcpSeedKey=true, XcpUserDefinedCommand=true
        XcpCRC: XcpAUTOSARCRCModuleSupport=true, XcpCRCBlockSize=256, XcpCRCCalculationMethod=ADD_14, XcpCustomCRC=false
      XcpAsynchMessage: XcpEventCodes=true, XcpServiceRequestMessage=false
      XcpCalibration: XcpBlockDownload=true, XcpMIN_STForBlockDownload=0, XcpModifyBits=false, XcpShortDownload=false
      XcpDaqAndStim:
        XcpFixedTimestamp = false
        XcpGetDAQEventInfo = true
        XcpMaxNumberOfOdtDaq = 123
        XcpMaxNumberOfOdtEntries = 255
        XcpMaxNumberOfOdtStim = 18
        XcpOverrunIndication = true
        XcpResolutionInfo = false
        XcpResumeMode = false
        XcpSynchronousDataStimulation = true
        XcpWriteDAQMultiple = true
        XcpDAQMessageHeader = ODT
        XcpComplementaryDAQ = false
      XcpProgramming: XcpMinStPgm=0, XcpProgrammingWriteProtection=false
        XcpSector_SMC_FLASH (XcpSector): XcpStartAddress=524288, XcpEndAddress=786431
        XcpSector_USC_FLASH (XcpSector): XcpStartAddress=458752, XcpEndAddress=524287
    XcpGeneral:
      XcpDevErrorDetect = true
      XcpMainFunctionPeriod = 0.005
      XcpMaxEventChannel = 255
      XcpOnCanEnabled = true
      XcpOnCddEnabled = false
      XcpOnEthernetEnabled = true
      XcpOnFlexRayEnabled = false
      XcpPrescalerSupported = false
      XcpVersionInfoApi = false
      XcpBootloaderDownload = false
      XcpControl = true
      XcpMultiClientSupport = false
      XcpRuntimeMeasurementSupport = true
      XcpSafeBswChecks = true
      XcpSessionStatusAPI = true
      XcpTypeSafeCopy = false
      XcpDAQMemAccessByApplication = true
      XcpA2L: XcpTimeoutT1=2000, XcpTimeoutT2=10000, XcpTimeoutT3=2000, XcpTimeoutT4=2000, XcpTimeoutT5=2000, XcpTimeoutT6=2000, XcpTimeoutT7=0
