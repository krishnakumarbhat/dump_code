AUTOSAR XML (schema 00053)
package /ActiveEcuC
  module config vSet: implementation-config-variant=VARIANT-PRE-COMPILE, module-description=vSet_Impl
    vSetCalibration
    vSetGeneral: vSetDummyStatementKind=SelfAssignment
    vSetPlatform:
      vSetCPUType = CPU32Bit
      vSetByteOrder = LITTLE_ENDIAN
      vSetBitOrder = LSB_to_MSB
      vSetSizeOfInt = Size32Bit
      vSetSizeOfEnum = Size32Bit
      vSetSizeOfRAMPointer = Size32Bit
      vSetSizeOfROMPointer = Size32Bit
    vSetBswInitialization
      249 x vSetInitFunction:
        BswM_PreInit: vSetHeader=BswM.h, vSetConfigType=BswM_ConfigType, vSetConfigPtrClass=BSWM_INIT_DATA, vSetModuleRef=BswM  # /ActiveEcuC/BswM PLAIN_TEXT PreInit function description of BswM in PostBuildPredefinedVariantView (RDR_01) .
          vSetInitFunctionInstance:
            vSetInitPhase = INIT_ONE
            vSetConfigPtrName = BswM_Config_RDR_01_Ptr if post-build-variant-condition{matching-criterion=RDR_POS, value=0}
            vSetConfigPtrName = BswM_Config_RDR_02_Ptr if post-build-variant-condition{matching-criterion=RDR_POS, value=1}
            vSetConfigPtrName = BswM_Config_RDR_03_Ptr if post-build-variant-condition{matching-criterion=RDR_POS, value=2}
            vSetConfigPtrName = BswM_Config_RDR_04_Ptr if post-build-variant-condition{matching-criterion=RDR_POS, value=3}
            vSetConfigPtrName = BswM_Config_RDR_05_Ptr if post-build-variant-condition{matching-criterion=RDR_POS, value=4}
            vSetConfigPtrName = BswM_Config_RDR_06_Ptr if post-build-variant-condition{matching-criterion=RDR_POS, value=5}
            vSetConfigPtrName = BswM_Config_RDR_07_Ptr if post-build-variant-condition{matching-criterion=RDR_POS, value=6}
            vSetConfigPtrName = BswM_Config_RDR_08_Ptr if post-build-variant-condition{matching-criterion=RDR_POS, value=7}
        BswM_Init: vSetHeader=BswM.h, vSetConfigType=BswM_ConfigType, vSetConfigPtrClass=BSWM_INIT_DATA, vSetModuleRef=BswM  # /ActiveEcuC/BswM PLAIN_TEXT Init function description of BswM in PostBuildPredefinedVariantView (RDR_01) .
          vSetInitFunctionInstance:
            vSetInitPhase = NO_INIT
            vSetConfigPtrName = BswM_Config_RDR_01_Ptr if post-build-variant-condition{matching-criterion=RDR_POS, value=0}
            vSetConfigPtrName = BswM_Config_RDR_02_Ptr if post-build-variant-condition{matching-criterion=RDR_POS, value=1}
            vSetConfigPtrName = BswM_Config_RDR_03_Ptr if post-build-variant-condition{matching-criterion=RDR_POS, value=2}
            vSetConfigPtrName = BswM_Config_RDR_04_Ptr if post-build-variant-condition{matching-criterion=RDR_POS, value=3}
            vSetConfigPtrName = BswM_Config_RDR_05_Ptr if post-build-variant-condition{matching-criterion=RDR_POS, value=4}
            vSetConfigPtrName = BswM_Config_RDR_06_Ptr if post-build-variant-condition{matching-criterion=RDR_POS, value=5}
            vSetConfigPtrName = BswM_Config_RDR_07_Ptr if post-build-variant-condition{matching-criterion=RDR_POS, value=6}
            vSetConfigPtrName = BswM_Config_RDR_08_Ptr if post-build-variant-condition{matching-criterion=RDR_POS, value=7}
        BswM_InitMemory: vSetHeader=BswM.h, vSetModuleRef=BswM  # /ActiveEcuC/BswM PLAIN_TEXT InitMemory function description of BswM in UnfilteredViewInInvariantProject (UnfilteredInvariantProjectModelView) .
          vSetInitFunctionInstance: vSetInitPhase=INIT_MEMORY
        ComM_Init: vSetHeader=ComM.h, vSetConfigType=ComM_ConfigType, vSetConfigPtrClass=COMM_INIT_DATA, vSetModuleRef=ComM  # /ActiveEcuC/ComM PLAIN_TEXT Init function description of ComM in UnfilteredViewInInvariantProject (UnfilteredInvariantProjectModelView) .
          vSetInitFunctionInstance: vSetInitPhase=INIT_TWO_POST_NVMREADALL, vSetConfigPtrName=ComM_Config_Ptr
        ComM_PreInit: vSetHeader=ComM.h, vSetConfigType=ComM_ConfigType, vSetConfigPtrClass=COMM_INIT_DATA, vSetModuleRef=ComM  # /ActiveEcuC/ComM PLAIN_TEXT PreInit function description of ComM in UnfilteredViewInInvariantProject (UnfilteredInvariantProjectModelView) .
          vSetInitFunctionInstance: vSetInitPhase=INIT_ONE, vSetConfigPtrName=ComM_Config_Ptr
        ComM_InitMemory: vSetHeader=ComM.h, vSetModuleRef=ComM  # /ActiveEcuC/ComM PLAIN_TEXT InitMemory function description of ComM in UnfilteredViewInInvariantProject (UnfilteredInvariantProjectModelView) .
          vSetInitFunctionInstance: vSetInitPhase=INIT_MEMORY
        ComM_PostInit: vSetHeader=ComM.h, vSetModuleRef=ComM  # /ActiveEcuC/ComM PLAIN_TEXT Post-Initialization of the ComM and its internal state machine
          vSetInitFunctionInstance: vSetInitPhase=INIT_THREE
        Com_Init: vSetHeader=Com.h, vSetConfigType=Com_ConfigType, vSetConfigPtrClass=COM_INIT_DATA, vSetModuleRef=Com  # /ActiveEcuC/Com PLAIN_TEXT Init function description of Com in PostBuildPredefinedVariantView (RDR_01) .
          vSetInitFunctionInstance:
            vSetInitPhase = INIT_TWO_COM
            vSetConfigPtrName = Com_Config_RDR_01_Ptr if post-build-variant-condition{matching-criterion=RDR_POS, value=0}
            vSetConfigPtrName = Com_Config_RDR_02_Ptr if post-build-variant-condition{matching-criterion=RDR_POS, value=1}
            vSetConfigPtrName = Com_Config_RDR_03_Ptr if post-build-variant-condition{matching-criterion=RDR_POS, value=2}
            vSetConfigPtrName = Com_Config_RDR_04_Ptr if post-build-variant-condition{matching-criterion=RDR_POS, value=3}
            vSetConfigPtrName = Com_Config_RDR_05_Ptr if post-build-variant-condition{matching-criterion=RDR_POS, value=4}
            vSetConfigPtrName = Com_Config_RDR_06_Ptr if post-build-variant-condition{matching-criterion=RDR_POS, value=5}
            vSetConfigPtrName = Com_Config_RDR_07_Ptr if post-build-variant-condition{matching-criterion=RDR_POS, value=6}
            vSetConfigPtrName = Com_Config_RDR_08_Ptr if post-build-variant-condition{matching-criterion=RDR_POS, value=7}
        Com_InitMemory: vSetHeader=Com.h, vSetModuleRef=Com  # /ActiveEcuC/Com PLAIN_TEXT InitMemory function description of Com in UnfilteredViewInInvariantProject (UnfilteredInvariantProjectModelView) .
          vSetInitFunctionInstance: vSetInitPhase=INIT_MEMORY
        Det_InitMemory: vSetHeader=Det.h, vSetModuleRef=Det  # /ActiveEcuC/Det PLAIN_TEXT InitMemory function description of Det in UnfilteredViewInInvariantProject (UnfilteredInvariantProjectModelView) .
          vSetInitFunctionInstance: vSetInitPhase=INIT_MEMORY
        Det_Init: vSetHeader=Det.h, vSetConfigType=Det_ConfigType, vSetConfigPtrClass=DET_INIT_DATA, vSetModuleRef=Det  # /ActiveEcuC/Det PLAIN_TEXT Init function description of Det in UnfilteredViewInInvariantProject (UnfilteredInvariantProjectModelView) .
          vSetInitFunctionInstance: vSetInitPhase=INIT_ZERO, vSetConfigPtrName=Det_Config_Ptr
        EcuM_Init: vSetHeader=EcuM.h, vSetConfigType=EcuM_PbConfigType, vSetConfigPtrClass=ECUM_INIT_DATA, vSetModuleRef=EcuM  # /ActiveEcuC/EcuM PLAIN_TEXT Init function description of EcuM in PostBuildPredefinedVariantView (RDR_01) .
          vSetInitFunctionInstance:
            vSetInitPhase = NO_INIT
            vSetConfigPtrName = EcuM_Config_RDR_01_Ptr if post-build-variant-condition{matching-criterion=RDR_POS, value=0}
            vSetConfigPtrName = EcuM_Config_RDR_02_Ptr if post-build-variant-condition{matching-criterion=RDR_POS, value=1}
            vSetConfigPtrName = EcuM_Config_RDR_03_Ptr if post-build-variant-condition{matching-criterion=RDR_POS, value=2}
            vSetConfigPtrName = EcuM_Config_RDR_04_Ptr if post-build-variant-condition{matching-criterion=RDR_POS, value=3}
            vSetConfigPtrName = EcuM_Config_RDR_05_Ptr if post-build-variant-condition{matching-criterion=RDR_POS, value=4}
            vSetConfigPtrName = EcuM_Config_RDR_06_Ptr if post-build-variant-condition{matching-criterion=RDR_POS, value=5}
            vSetConfigPtrName = EcuM_Config_RDR_07_Ptr if post-build-variant-condition{matching-criterion=RDR_POS, value=6}
            vSetConfigPtrName = EcuM_Config_RDR_08_Ptr if post-build-variant-condition{matching-criterion=RDR_POS, value=7}
        EthIf_InitMemory: vSetHeader=EthIf.h, vSetModuleRef=EthIf  # /ActiveEcuC/EthIf PLAIN_TEXT InitMemory function description of EthIf in UnfilteredViewInInvariantProject (UnfilteredInvariantProjectModelView) .
          vSetInitFunctionInstance: vSetInitPhase=INIT_MEMORY
        EthIf_Init: vSetHeader=EthIf.h, vSetConfigType=EthIf_ConfigType, vSetConfigPtrClass=ETHIF_INIT_DATA, vSetModuleRef=EthIf, variation-point=post-build-variant-condition{matching-criterion=RDR_POS, value=4}  # /ActiveEcuC/EthIf PLAIN_TEXT Init function description of EthIf in PostBuildPredefinedVariantView (RDR_05) .
          vSetInitFunctionInstance: vSetInitPhase=INIT_TWO_IF, vSetConfigPtrName=EthIf_Config_RDR_05_Ptr
        EthIf_Init: vSetHeader=EthIf.h, vSetConfigType=EthIf_ConfigType, vSetConfigPtrClass=ETHIF_INIT_DATA, vSetModuleRef=EthIf, variation-point=post-build-variant-condition{matching-criterion=RDR_POS, value=5}  # /ActiveEcuC/EthIf PLAIN_TEXT Init function description of EthIf in PostBuildPredefinedVariantView (RDR_06) .
          vSetInitFunctionInstance: vSetInitPhase=INIT_TWO_IF, vSetConfigPtrName=EthIf_Config_RDR_06_Ptr
        EthIf_Init: vSetHeader=EthIf.h, vSetConfigType=EthIf_ConfigType, vSetConfigPtrClass=ETHIF_INIT_DATA, vSetModuleRef=EthIf, variation-point=post-build-variant-condition{matching-criterion=RDR_POS, value=1}  # /ActiveEcuC/EthIf PLAIN_TEXT Init function description of EthIf in PostBuildPredefinedVariantView (RDR_02) .
          vSetInitFunctionInstance: vSetInitPhase=INIT_TWO_IF, vSetConfigPtrName=EthIf_Config_RDR_02_Ptr
        EthIf_Init: vSetHeader=EthIf.h, vSetConfigType=EthIf_ConfigType, vSetConfigPtrClass=ETHIF_INIT_DATA, vSetModuleRef=EthIf, variation-point=post-build-variant-condition{matching-criterion=RDR_POS, value=3}  # /ActiveEcuC/EthIf PLAIN_TEXT Init function description of EthIf in PostBuildPredefinedVariantView (RDR_04) .
          vSetInitFunctionInstance: vSetInitPhase=INIT_TWO_IF, vSetConfigPtrName=EthIf_Config_RDR_04_Ptr
        EthIf_Init: vSetHeader=EthIf.h, vSetConfigType=EthIf_ConfigType, vSetConfigPtrClass=ETHIF_INIT_DATA, vSetModuleRef=EthIf, variation-point=post-build-variant-condition{matching-criterion=RDR_POS, value=6}  # /ActiveEcuC/EthIf PLAIN_TEXT Init function description of EthIf in PostBuildPredefinedVariantView (RDR_07) .
          vSetInitFunctionInstance: vSetInitPhase=INIT_TWO_IF, vSetConfigPtrName=EthIf_Config_RDR_07_Ptr
        EthIf_Init: vSetHeader=EthIf.h, vSetConfigType=EthIf_ConfigType, vSetConfigPtrClass=ETHIF_INIT_DATA, vSetModuleRef=EthIf, variation-point=post-build-variant-condition{matching-criterion=RDR_POS, value=0}  # /ActiveEcuC/EthIf PLAIN_TEXT Init function description of EthIf in PostBuildPredefinedVariantView (RDR_01) .
          vSetInitFunctionInstance: vSetInitPhase=INIT_TWO_IF, vSetConfigPtrName=EthIf_Config_RDR_01_Ptr
        EthIf_Init: vSetHeader=EthIf.h, vSetConfigType=EthIf_ConfigType, vSetConfigPtrClass=ETHIF_INIT_DATA, vSetModuleRef=EthIf, variation-point=post-build-variant-condition{matching-criterion=RDR_POS, value=7}  # /ActiveEcuC/EthIf PLAIN_TEXT Init function description of EthIf in PostBuildPredefinedVariantView (RDR_08) .
          vSetInitFunctionInstance: vSetInitPhase=INIT_TWO_IF, vSetConfigPtrName=EthIf_Config_RDR_08_Ptr
        EthIf_Init: vSetHeader=EthIf.h, vSetConfigType=EthIf_ConfigType, vSetConfigPtrClass=ETHIF_INIT_DATA, vSetModuleRef=EthIf, variation-point=post-build-variant-condition{matching-criterion=RDR_POS, value=2}  # /ActiveEcuC/EthIf PLAIN_TEXT Init function description of EthIf in PostBuildPredefinedVariantView (RDR_03) .
          vSetInitFunctionInstance: vSetInitPhase=INIT_TWO_IF, vSetConfigPtrName=EthIf_Config_RDR_03_Ptr
        EthSM_InitMemory: vSetHeader=EthSM.h, vSetModuleRef=EthSM  # /ActiveEcuC/EthSM PLAIN_TEXT InitMemory function description of EthSM in UnfilteredViewInInvariantProject (UnfilteredInvariantProjectModelView) .
          vSetInitFunctionInstance: vSetInitPhase=INIT_MEMORY
        EthSM_Init: vSetHeader=EthSM.h, vSetConfigType=EthSM_ConfigType, vSetConfigPtrClass=ETHSM_INIT_DATA, vSetModuleRef=EthSM  # /ActiveEcuC/EthSM PLAIN_TEXT Init function description of EthSM in UnfilteredViewInInvariantProject (UnfilteredInvariantProjectModelView) .
          vSetInitFunctionInstance: vSetInitPhase=INIT_TWO_SM, vSetConfigPtrName=EthSM_Config_Ptr
        PduR_Init: vSetHeader=PduR.h, vSetConfigType=PduR_PBConfigType, vSetConfigPtrClass=PDUR_INIT_DATA, vSetModuleRef=PduR  # /ActiveEcuC/PduR PLAIN_TEXT Init function description of PduR in PostBuildPredefinedVariantView (RDR_01) .
          vSetInitFunctionInstance:
            vSetInitPhase = INIT_TWO_COM
            vSetConfigPtrName = PduR_Config_RDR_01_Ptr if post-build-variant-condition{matching-criterion=RDR_POS, value=0}
            vSetConfigPtrName = PduR_Config_RDR_02_Ptr if post-build-variant-condition{matching-criterion=RDR_POS, value=1}
            vSetConfigPtrName = PduR_Config_RDR_03_Ptr if post-build-variant-condition{matching-criterion=RDR_POS, value=2}
            vSetConfigPtrName = PduR_Config_RDR_04_Ptr if post-build-variant-condition{matching-criterion=RDR_POS, value=3}
            vSetConfigPtrName = PduR_Config_RDR_05_Ptr if post-build-variant-condition{matching-criterion=RDR_POS, value=4}
            vSetConfigPtrName = PduR_Config_RDR_06_Ptr if post-build-variant-condition{matching-criterion=RDR_POS, value=5}
            vSetConfigPtrName = PduR_Config_RDR_07_Ptr if post-build-variant-condition{matching-criterion=RDR_POS, value=6}
            vSetConfigPtrName = PduR_Config_RDR_08_Ptr if post-build-variant-condition{matching-criterion=RDR_POS, value=7}
        PduR_InitMemory: vSetHeader=PduR.h, vSetModuleRef=PduR  # /ActiveEcuC/PduR PLAIN_TEXT InitMemory function description of PduR in UnfilteredViewInInvariantProject (UnfilteredInvariantProjectModelView) .
          vSetInitFunctionInstance: vSetInitPhase=INIT_MEMORY
        PduR_PreInit: vSetHeader=PduR.h, vSetConfigType=PduR_PBConfigType, vSetConfigPtrClass=PDUR_INIT_DATA, vSetModuleRef=PduR  # /ActiveEcuC/PduR PLAIN_TEXT PreInit function description of PduR in PostBuildPredefinedVariantView (RDR_01) .
          vSetInitFunctionInstance:
            vSetInitPhase = INIT_ONE
            vSetConfigPtrName = PduR_Config_RDR_01_Ptr if post-build-variant-condition{matching-criterion=RDR_POS, value=0}
            vSetConfigPtrName = PduR_Config_RDR_02_Ptr if post-build-variant-condition{matching-criterion=RDR_POS, value=1}
            vSetConfigPtrName = PduR_Config_RDR_03_Ptr if post-build-variant-condition{matching-criterion=RDR_POS, value=2}
            vSetConfigPtrName = PduR_Config_RDR_04_Ptr if post-build-variant-condition{matching-criterion=RDR_POS, value=3}
            vSetConfigPtrName = PduR_Config_RDR_05_Ptr if post-build-variant-condition{matching-criterion=RDR_POS, value=4}
            vSetConfigPtrName = PduR_Config_RDR_06_Ptr if post-build-variant-condition{matching-criterion=RDR_POS, value=5}
            vSetConfigPtrName = PduR_Config_RDR_07_Ptr if post-build-variant-condition{matching-criterion=RDR_POS, value=6}
            vSetConfigPtrName = PduR_Config_RDR_08_Ptr if post-build-variant-condition{matching-criterion=RDR_POS, value=7}
        SchM_Start: vSetHeader=Rte_Main.h, vSetModuleRef=Rte  # /ActiveEcuC/Rte PLAIN_TEXT Automatically generated by BswInitFctConfigurationService.
          vSetInitFunctionInstance: vSetInitPhase=NO_INIT
        Rte_Start: vSetHeader=Rte_Main.h, vSetModuleRef=Rte  # /ActiveEcuC/Rte PLAIN_TEXT Automatically generated by BswInitFctConfigurationService.
          vSetInitFunctionInstance: vSetInitPhase=INIT_THREE
        Rte_InitMemory: vSetHeader=Rte_Main.h, vSetModuleRef=Rte  # /ActiveEcuC/Rte PLAIN_TEXT Automatically generated by BswInitFctConfigurationService.
          vSetInitFunctionInstance: vSetInitPhase=INIT_MEMORY
        Rte_StartTiming: vSetHeader=Rte_Main.h, vSetModuleRef=Rte  # /ActiveEcuC/Rte PLAIN_TEXT Automatically generated by BswInitFctConfigurationService.
          vSetInitFunctionInstance: vSetInitPhase=NO_INIT
        SchM_Init: vSetHeader=Rte_Main.h, vSetConfigType=SchM_ConfigType, vSetConfigPtrClass=RTE_CONST, vSetModuleRef=Rte  # /ActiveEcuC/Rte PLAIN_TEXT Automatically generated by BswInitFctConfigurationService.
          vSetInitFunctionInstance:
            vSetInitPhase = NO_INIT
            vSetConfigPtrName = &Rte_Config_RDR_01 if post-build-variant-condition{matching-criterion=RDR_POS, value=0}
            vSetConfigPtrName = &Rte_Config_RDR_02 if post-build-variant-condition{matching-criterion=RDR_POS, value=1}
            vSetConfigPtrName = &Rte_Config_RDR_03 if post-build-variant-condition{matching-criterion=RDR_POS, value=2}
            vSetConfigPtrName = &Rte_Config_RDR_04 if post-build-variant-condition{matching-criterion=RDR_POS, value=3}
            vSetConfigPtrName = &Rte_Config_RDR_05 if post-build-variant-condition{matching-criterion=RDR_POS, value=4}
            vSetConfigPtrName = &Rte_Config_RDR_06 if post-build-variant-condition{matching-criterion=RDR_POS, value=5}
            vSetConfigPtrName = &Rte_Config_RDR_07 if post-build-variant-condition{matching-criterion=RDR_POS, value=6}
            vSetConfigPtrName = &Rte_Config_RDR_08 if post-build-variant-condition{matching-criterion=RDR_POS, value=7}
        SchM_StartTiming: vSetHeader=Rte_Main.h, vSetModuleRef=Rte  # /ActiveEcuC/Rte PLAIN_TEXT Automatically generated by BswInitFctConfigurationService.
          vSetInitFunctionInstance: vSetInitPhase=NO_INIT
        SoAd_Init: vSetHeader=SoAd.h, vSetConfigType=SoAd_ConfigType, vSetConfigPtrClass=SOAD_INIT_DATA, vSetModuleRef=SoAd  # /ActiveEcuC/SoAd PLAIN_TEXT Init function description of SoAd in UnfilteredViewInInvariantProject (UnfilteredInvariantProjectModelView) .
          vSetInitFunctionInstance: vSetInitPhase=INIT_TWO_IF, vSetConfigPtrName=SoAd_Config_Ptr
        SoAd_InitMemory: vSetHeader=SoAd.h, vSetModuleRef=SoAd  # /ActiveEcuC/SoAd PLAIN_TEXT InitMemory function description of SoAd in UnfilteredViewInInvariantProject (UnfilteredInvariantProjectModelView) .
          vSetInitFunctionInstance: vSetInitPhase=INIT_MEMORY
        SoAd_PreInit: vSetHeader=SoAd.h, vSetConfigType=SoAd_ConfigType, vSetConfigPtrClass=SOAD_INIT_DATA, vSetModuleRef=SoAd  # /ActiveEcuC/SoAd PLAIN_TEXT PreInit function description of SoAd in UnfilteredViewInInvariantProject (UnfilteredInvariantProjectModelView) .
          vSetInitFunctionInstance: vSetInitPhase=INIT_ONE, vSetConfigPtrName=SoAd_Config_Ptr
        SoAd_PostInit: vSetHeader=SoAd.h, vSetModuleRef=SoAd  # /ActiveEcuC/SoAd PLAIN_TEXT PostInit function description of SoAd in UnfilteredViewInInvariantProject (UnfilteredInvariantProjectModelView) .
          vSetInitFunctionInstance: vSetInitPhase=INIT_THREE
        TcpIp_Init: vSetHeader=TcpIp.h, vSetConfigType=TcpIp_ConfigType, vSetConfigPtrClass=TCPIP_INIT_DATA, vSetModuleRef=TcpIp  # /ActiveEcuC/TcpIp PLAIN_TEXT Init function description of TcpIp in UnfilteredViewInInvariantProject (UnfilteredInvariantProjectModelView) .
          vSetInitFunctionInstance: vSetInitPhase=INIT_TWO_TP, vSetConfigPtrName=TcpIp_Config_Ptr
        TcpIp_InitMemory: vSetHeader=TcpIp.h, vSetModuleRef=TcpIp  # /ActiveEcuC/TcpIp PLAIN_TEXT InitMemory function description of TcpIp in UnfilteredViewInInvariantProject (UnfilteredInvariantProjectModelView) .
          vSetInitFunctionInstance: vSetInitPhase=INIT_MEMORY
        EthTrcv_30_Rtl9010_InitMemory: vSetHeader=EthTrcv_30_Rtl9010.h, vSetModuleRef=EthTrcv_RTL, variation-point=post-build-variant-condition{matching-criterion=RDR_POS, value=5}  # /ActiveEcuC/EthTrcv_RTL PLAIN_TEXT Memory Initialization function of module EthTrcv_30_Rtl9010.
          vSetInitFunctionInstance: vSetInitPhase=INIT_MEMORY
        EthTrcv_30_Rtl9010_InitMemory: vSetHeader=EthTrcv_30_Rtl9010.h, vSetModuleRef=EthTrcv_RTL, variation-point=post-build-variant-condition{matching-criterion=RDR_POS, value=1}  # /ActiveEcuC/EthTrcv PLAIN_TEXT Memory Initialization function of module EthTrcv_30_Rtl9010.
          vSetInitFunctionInstance: vSetInitPhase=INIT_MEMORY
        EthTrcv_30_Rtl9010_InitMemory: vSetHeader=EthTrcv_30_Rtl9010.h, vSetModuleRef=EthTrcv_RTL, variation-point=post-build-variant-condition{matching-criterion=RDR_POS, value=3}  # /ActiveEcuC/EthTrcv PLAIN_TEXT Memory Initialization function of module EthTrcv_30_Rtl9010.
          vSetInitFunctionInstance: vSetInitPhase=INIT_MEMORY
        EthTrcv_30_Rtl9010_InitMemory: vSetHeader=EthTrcv_30_Rtl9010.h, vSetModuleRef=EthTrcv_RTL, variation-point=post-build-variant-condition{matching-criterion=RDR_POS, value=6}  # /ActiveEcuC/EthTrcv PLAIN_TEXT Memory Initialization function of module EthTrcv_30_Rtl9010.
          vSetInitFunctionInstance: vSetInitPhase=INIT_MEMORY
        EthTrcv_30_Rtl9010_InitMemory: vSetHeader=EthTrcv_30_Rtl9010.h, vSetModuleRef=EthTrcv_RTL, variation-point=post-build-variant-condition{matching-criterion=RDR_POS, value=0}  # /ActiveEcuC/EthTrcv PLAIN_TEXT Memory Initialization function of module EthTrcv_30_Rtl9010.
          vSetInitFunctionInstance: vSetInitPhase=INIT_MEMORY
        EthTrcv_30_Rtl9010_InitMemory: vSetHeader=EthTrcv_30_Rtl9010.h, vSetModuleRef=EthTrcv_RTL, variation-point=post-build-variant-condition{matching-criterion=RDR_POS, value=4}  # /ActiveEcuC/EthTrcv PLAIN_TEXT Memory Initialization function of module EthTrcv_30_Rtl9010.
          vSetInitFunctionInstance: vSetInitPhase=INIT_MEMORY
        EthTrcv_30_Rtl9010_InitMemory: vSetHeader=EthTrcv_30_Rtl9010.h, vSetModuleRef=EthTrcv_RTL, variation-point=post-build-variant-condition{matching-criterion=RDR_POS, value=7}  # /ActiveEcuC/EthTrcv PLAIN_TEXT Memory Initialization function of module EthTrcv_30_Rtl9010.
          vSetInitFunctionInstance: vSetInitPhase=INIT_MEMORY
        EthTrcv_30_Rtl9010_InitMemory: vSetHeader=EthTrcv_30_Rtl9010.h, vSetModuleRef=EthTrcv_RTL, variation-point=post-build-variant-condition{matching-criterion=RDR_POS, value=2}  # /ActiveEcuC/EthTrcv PLAIN_TEXT Memory Initialization function of module EthTrcv_30_Rtl9010.
          vSetInitFunctionInstance: vSetInitPhase=INIT_MEMORY
        EthTrcv_30_Rtl9010_Init: vSetHeader=EthTrcv_30_Rtl9010.h, vSetConfigType=EthTrcv_30_Rtl9010_ConfigType, vSetConfigPtrClass=ETHTRCV_30_RTL9010_INIT_DATA, vSetModuleRef=EthTrcv_RTL, variation-point=post-build-variant-condition{matching-criterion=RDR_POS, value=5}  # /ActiveEcuC/EthTrcv_RTL PLAIN_TEXT Module Initialization function of module EthTrcv_30_Rtl9010.
          vSetInitFunctionInstance: vSetInitPhase=INIT_TWO_TRCV, vSetConfigPtrName=EthTrcv_30_Rtl9010_Config_Ptr
        EthTrcv_30_Rtl9010_Init: vSetHeader=EthTrcv_30_Rtl9010.h, vSetConfigType=EthTrcv_30_Rtl9010_ConfigType, vSetConfigPtrClass=ETHTRCV_30_RTL9010_INIT_DATA, vSetModuleRef=EthTrcv_RTL, variation-point=post-build-variant-condition{matching-criterion=RDR_POS, value=1}  # /ActiveEcuC/EthTrcv PLAIN_TEXT Module Initialization function of module EthTrcv_30_Rtl9010.
          vSetInitFunctionInstance: vSetInitPhase=INIT_TWO_TRCV, vSetConfigPtrName=EthTrcv_30_Rtl9010_Config_Ptr
        EthTrcv_30_Rtl9010_Init: vSetHeader=EthTrcv_30_Rtl9010.h, vSetConfigType=EthTrcv_30_Rtl9010_ConfigType, vSetConfigPtrClass=ETHTRCV_30_RTL9010_INIT_DATA, vSetModuleRef=EthTrcv_RTL, variation-point=post-build-variant-condition{matching-criterion=RDR_POS, value=3}  # /ActiveEcuC/EthTrcv PLAIN_TEXT Module Initialization function of module EthTrcv_30_Rtl9010.
          vSetInitFunctionInstance: vSetInitPhase=INIT_TWO_TRCV, vSetConfigPtrName=EthTrcv_30_Rtl9010_Config_Ptr
        EthTrcv_30_Rtl9010_Init: vSetHeader=EthTrcv_30_Rtl9010.h, vSetConfigType=EthTrcv_30_Rtl9010_ConfigType, vSetConfigPtrClass=ETHTRCV_30_RTL9010_INIT_DATA, vSetModuleRef=EthTrcv_RTL, variation-point=post-build-variant-condition{matching-criterion=RDR_POS, value=6}  # /ActiveEcuC/EthTrcv PLAIN_TEXT Module Initialization function of module EthTrcv_30_Rtl9010.
          vSetInitFunctionInstance: vSetInitPhase=INIT_TWO_TRCV, vSetConfigPtrName=EthTrcv_30_Rtl9010_Config_Ptr
        EthTrcv_30_Rtl9010_Init: vSetHeader=EthTrcv_30_Rtl9010.h, vSetConfigType=EthTrcv_30_Rtl9010_ConfigType, vSetConfigPtrClass=ETHTRCV_30_RTL9010_INIT_DATA, vSetModuleRef=EthTrcv_RTL, variation-point=post-build-variant-condition{matching-criterion=RDR_POS, value=0}  # /ActiveEcuC/EthTrcv PLAIN_TEXT Module Initialization function of module EthTrcv_30_Rtl9010.
          vSetInitFunctionInstance: vSetInitPhase=INIT_TWO_TRCV, vSetConfigPtrName=EthTrcv_30_Rtl9010_Config_Ptr
        EthTrcv_30_Rtl9010_Init: vSetHeader=EthTrcv_30_Rtl9010.h, vSetConfigType=EthTrcv_30_Rtl9010_ConfigType, vSetConfigPtrClass=ETHTRCV_30_RTL9010_INIT_DATA, vSetModuleRef=EthTrcv_RTL, variation-point=post-build-variant-condition{matching-criterion=RDR_POS, value=4}  # /ActiveEcuC/EthTrcv PLAIN_TEXT Module Initialization function of module EthTrcv_30_Rtl9010.
          vSetInitFunctionInstance: vSetInitPhase=INIT_TWO_TRCV, vSetConfigPtrName=EthTrcv_30_Rtl9010_Config_Ptr
        EthTrcv_30_Rtl9010_Init: vSetHeader=EthTrcv_30_Rtl9010.h, vSetConfigType=EthTrcv_30_Rtl9010_ConfigType, vSetConfigPtrClass=ETHTRCV_30_RTL9010_INIT_DATA, vSetModuleRef=EthTrcv_RTL, variation-point=post-build-variant-condition{matching-criterion=RDR_POS, value=7}  # /ActiveEcuC/EthTrcv PLAIN_TEXT Module Initialization function of module EthTrcv_30_Rtl9010.
          vSetInitFunctionInstance: vSetInitPhase=INIT_TWO_TRCV, vSetConfigPtrName=EthTrcv_30_Rtl9010_Config_Ptr
        EthTrcv_30_Rtl9010_Init: vSetHeader=EthTrcv_30_Rtl9010.h, vSetConfigType=EthTrcv_30_Rtl9010_ConfigType, vSetConfigPtrClass=ETHTRCV_30_RTL9010_INIT_DATA, vSetModuleRef=EthTrcv_RTL, variation-point=post-build-variant-condition{matching-criterion=RDR_POS, value=2}  # /ActiveEcuC/EthTrcv PLAIN_TEXT Module Initialization function of module EthTrcv_30_Rtl9010.
          vSetInitFunctionInstance: vSetInitPhase=INIT_TWO_TRCV, vSetConfigPtrName=EthTrcv_30_Rtl9010_Config_Ptr
        Eth_30_Wrapper_Init: vSetHeader=Eth_30_Wrapper.h, vSetConfigType=Eth_30_Wrapper_ConfigType, vSetConfigPtrClass=ETH_30_WRAPPER_INIT_DATA, vSetModuleRef=Eth  # /ActiveEcuC/Eth PLAIN_TEXT Init function description of Eth_30_Wrapper in PostBuildInvariantValuesModelView (PostBuildInvariantValuesModelView) .
          vSetInitFunctionInstance: vSetInitPhase=INIT_TWO_IF, vSetConfigPtrName=Eth_30_Wrapper_Config_Ptr
        CanIf_Init: vSetHeader=CanIf.h, vSetConfigType=CanIf_ConfigType, vSetConfigPtrClass=CANIF_INIT_DATA, vSetModuleRef=CanIf  # /ActiveEcuC/CanIf PLAIN_TEXT Init function description of CanIf in PostBuildPredefinedVariantView (RDR_01) .
          vSetInitFunctionInstance:
            vSetInitPhase = INIT_TWO_IF
            vSetConfigPtrName = CanIf_Config_RDR_01_Ptr if post-build-variant-condition{matching-criterion=RDR_POS, value=0}
            vSetConfigPtrName = CanIf_Config_RDR_02_Ptr if post-build-variant-condition{matching-criterion=RDR_POS, value=1}
            vSetConfigPtrName = CanIf_Config_RDR_03_Ptr if post-build-variant-condition{matching-criterion=RDR_POS, value=2}
            vSetConfigPtrName = CanIf_Config_RDR_04_Ptr if post-build-variant-condition{matching-criterion=RDR_POS, value=3}
            vSetConfigPtrName = CanIf_Config_RDR_05_Ptr if post-build-variant-condition{matching-criterion=RDR_POS, value=4}
            vSetConfigPtrName = CanIf_Config_RDR_06_Ptr if post-build-variant-condition{matching-criterion=RDR_POS, value=5}
            vSetConfigPtrName = CanIf_Config_RDR_07_Ptr if post-build-variant-condition{matching-criterion=RDR_POS, value=6}
            vSetConfigPtrName = CanIf_Config_RDR_08_Ptr if post-build-variant-condition{matching-criterion=RDR_POS, value=7}
        CanIf_InitMemory: vSetHeader=CanIf.h, vSetModuleRef=CanIf  # /ActiveEcuC/CanIf PLAIN_TEXT InitMemory function description of CanIf in UnfilteredViewInInvariantProject (UnfilteredInvariantProjectModelView) .
          vSetInitFunctionInstance: vSetInitPhase=INIT_MEMORY
        CanSM_Init: vSetHeader=CanSM_EcuM.h, vSetConfigType=CanSM_ConfigType, vSetConfigPtrClass=CANSM_INIT_DATA, vSetModuleRef=CanSM  # /ActiveEcuC/CanSM PLAIN_TEXT Init function description of CanSM in UnfilteredViewInInvariantProject (UnfilteredInvariantProjectModelView) .
          vSetInitFunctionInstance: vSetInitPhase=INIT_TWO_SM, vSetConfigPtrName=CanSM_Config_Ptr
        CanSM_InitMemory: vSetHeader=CanSM_EcuM.h, vSetModuleRef=CanSM  # /ActiveEcuC/CanSM PLAIN_TEXT InitMemory function description of CanSM in UnfilteredViewInInvariantProject (UnfilteredInvariantProjectModelView) .
          vSetInitFunctionInstance: vSetInitPhase=INIT_MEMORY
        Xcp_InitMemory: vSetHeader=Xcp.h, vSetModuleRef=Xcp  # /ActiveEcuC/Xcp PLAIN_TEXT Memory Initialization function of module Xcp.
          vSetInitFunctionInstance: vSetInitPhase=INIT_MEMORY
        Xcp_Init: vSetHeader=Xcp.h, vSetModuleRef=Xcp  # /ActiveEcuC/Xcp PLAIN_TEXT Module Initialization function of module Xcp.
          vSetInitFunctionInstance: vSetInitPhase=INIT_TWO_TP
        TcpIpXcp_InitMemory: vSetHeader=TcpIpXcp.h, vSetModuleRef=Xcp  # /ActiveEcuC/Xcp PLAIN_TEXT Memory Initialization function of module TcpIpXcp.
          vSetInitFunctionInstance: vSetInitPhase=INIT_MEMORY
        TcpIpXcp_Init: vSetHeader=TcpIpXcp.h, vSetConfigType=TcpIpXcp_ConfigType, vSetConfigPtrClass=TCPIPXCP_CONST, vSetModuleRef=Xcp  # /ActiveEcuC/Xcp PLAIN_TEXT Module Initialization function of module TcpIpXcp.
          vSetInitFunctionInstance: vSetInitPhase=INIT_TWO_TP, vSetConfigPtrName=NULL_PTR
        StbM_Init: vSetHeader=StbM.h, vSetConfigType=StbM_ConfigType, vSetConfigPtrClass=STBM_INIT_DATA, vSetModuleRef=StbM  # /ActiveEcuC/StbM PLAIN_TEXT Init function description of StbM in PostBuildPredefinedVariantView (RDR_01) .
          vSetInitFunctionInstance:
            vSetInitPhase = INIT_TWO_SYS
            vSetConfigPtrName = StbM_Config_RDR_01_Ptr if post-build-variant-condition{matching-criterion=RDR_POS, value=0}
            vSetConfigPtrName = StbM_Config_RDR_02_Ptr if post-build-variant-condition{matching-criterion=RDR_POS, value=1}
            vSetConfigPtrName = StbM_Config_RDR_03_Ptr if post-build-variant-condition{matching-criterion=RDR_POS, value=2}
            vSetConfigPtrName = StbM_Config_RDR_04_Ptr if post-build-variant-condition{matching-criterion=RDR_POS, value=3}
            vSetConfigPtrName = StbM_Config_RDR_05_Ptr if post-build-variant-condition{matching-criterion=RDR_POS, value=4}
            vSetConfigPtrName = StbM_Config_RDR_06_Ptr if post-build-variant-condition{matching-criterion=RDR_POS, value=5}
            vSetConfigPtrName = StbM_Config_RDR_07_Ptr if post-build-variant-condition{matching-criterion=RDR_POS, value=6}
            vSetConfigPtrName = StbM_Config_RDR_08_Ptr if post-build-variant-condition{matching-criterion=RDR_POS, value=7}
        StbM_PreInit: vSetHeader=StbM.h, vSetConfigType=StbM_ConfigType, vSetConfigPtrClass=STBM_INIT_DATA, vSetModuleRef=StbM  # /ActiveEcuC/StbM PLAIN_TEXT PreInit function description of StbM in PostBuildPredefinedVariantView (RDR_01) .
          vSetInitFunctionInstance:
            vSetInitPhase = INIT_ONE
            vSetConfigPtrName = StbM_Config_RDR_01_Ptr if post-build-variant-condition{matching-criterion=RDR_POS, value=0}
            vSetConfigPtrName = StbM_Config_RDR_02_Ptr if post-build-variant-condition{matching-criterion=RDR_POS, value=1}
            vSetConfigPtrName = StbM_Config_RDR_03_Ptr if post-build-variant-condition{matching-criterion=RDR_POS, value=2}
            vSetConfigPtrName = StbM_Config_RDR_04_Ptr if post-build-variant-condition{matching-criterion=RDR_POS, value=3}
            vSetConfigPtrName = StbM_Config_RDR_05_Ptr if post-build-variant-condition{matching-criterion=RDR_POS, value=4}
            vSetConfigPtrName = StbM_Config_RDR_06_Ptr if post-build-variant-condition{matching-criterion=RDR_POS, value=5}
            vSetConfigPtrName = StbM_Config_RDR_07_Ptr if post-build-variant-condition{matching-criterion=RDR_POS, value=6}
            vSetConfigPtrName = StbM_Config_RDR_08_Ptr if post-build-variant-condition{matching-criterion=RDR_POS, value=7}
        StbM_PostInit: vSetHeader=StbM.h, vSetModuleRef=StbM  # /ActiveEcuC/StbM PLAIN_TEXT PostInit function description of StbM in UnfilteredViewInInvariantProject (UnfilteredInvariantProjectModelView) .
          vSetInitFunctionInstance: vSetInitPhase=INIT_THREE
        StbM_InitMemory: vSetHeader=StbM.h, vSetModuleRef=StbM  # /ActiveEcuC/StbM PLAIN_TEXT InitMemory function description of StbM in UnfilteredViewInInvariantProject (UnfilteredInvariantProjectModelView) .
          vSetInitFunctionInstance: vSetInitPhase=INIT_MEMORY
        EthTSyn_Init: vSetHeader=EthTSyn.h, vSetConfigType=EthTSyn_ConfigType, vSetConfigPtrClass=ETHTSYN_INIT_DATA, vSetModuleRef=EthTSyn  # /ActiveEcuC/EthTSyn PLAIN_TEXT Init function description of EthTSyn in UnfilteredViewInInvariantProject (UnfilteredInvariantProjectModelView) .
          vSetInitFunctionInstance: vSetInitPhase=INIT_TWO_SYS, vSetConfigPtrName=EthTSyn_Config_Ptr
        EthTSyn_InitMemory: vSetHeader=EthTSyn.h, vSetModuleRef=EthTSyn  # /ActiveEcuC/EthTSyn PLAIN_TEXT InitMemory function description of EthTSyn in UnfilteredViewInInvariantProject (UnfilteredInvariantProjectModelView) .
          vSetInitFunctionInstance: vSetInitPhase=INIT_MEMORY
        Adc_Init: vSetHeader=Adc.h, vSetConfigType=Adc_ConfigType, vSetConfigPtrClass=ADC_CONST, vSetModuleRef=Adc, variation-point=post-build-variant-condition{matching-criterion=RDR_POS, value=4}  # /ActiveEcuC/Adc PLAIN_TEXT Initializes Adc module
          vSetInitFunctionInstance: vSetInitPhase=INIT_ONE_LATE, vSetConfigPtrName=NULL_PTR
        Adc_Init: vSetHeader=Adc.h, vSetConfigType=Adc_ConfigType, vSetConfigPtrClass=ADC_CONST, vSetModuleRef=Adc, variation-point=post-build-variant-condition{matching-criterion=RDR_POS, value=6}  # /ActiveEcuC/Adc PLAIN_TEXT Initializes Adc module Created Adc_Init by Extended Init XML Service
          vSetInitFunctionInstance: vSetInitPhase=INIT_ONE_LATE, vSetConfigPtrName=NULL_PTR
        Adc_Init: vSetHeader=Adc.h, vSetConfigType=Adc_ConfigType, vSetConfigPtrClass=ADC_CONST, vSetModuleRef=Adc, variation-point=post-build-variant-condition{matching-criterion=RDR_POS, value=3}  # /ActiveEcuC/Adc PLAIN_TEXT Initializes Adc module Created Adc_Init by Extended Init XML Service
          vSetInitFunctionInstance: vSetInitPhase=INIT_ONE_LATE, vSetConfigPtrName=NULL_PTR
        Adc_Init: vSetHeader=Adc.h, vSetConfigType=Adc_ConfigType, vSetConfigPtrClass=ADC_CONST, vSetModuleRef=Adc, variation-point=post-build-variant-condition{matching-criterion=RDR_POS, value=1}  # /ActiveEcuC/Adc PLAIN_TEXT Initializes Adc module Created Adc_Init by Extended Init XML Service
          vSetInitFunctionInstance: vSetInitPhase=INIT_ONE_LATE, vSetConfigPtrName=NULL_PTR
        Adc_Init: vSetHeader=Adc.h, vSetConfigType=Adc_ConfigType, vSetConfigPtrClass=ADC_CONST, vSetModuleRef=Adc, variation-point=post-build-variant-condition{matching-criterion=RDR_POS, value=7}  # /ActiveEcuC/Adc PLAIN_TEXT Initializes Adc module Created Adc_Init by Extended Init XML Service
          vSetInitFunctionInstance: vSetInitPhase=INIT_ONE_LATE, vSetConfigPtrName=NULL_PTR
        Adc_Init: vSetHeader=Adc.h, vSetConfigType=Adc_ConfigType, vSetConfigPtrClass=ADC_CONST, vSetModuleRef=Adc, variation-point=post-build-variant-condition{matching-criterion=RDR_POS, value=0}  # /ActiveEcuC/Adc PLAIN_TEXT Initializes Adc module
          vSetInitFunctionInstance: vSetInitPhase=INIT_ONE_LATE, vSetConfigPtrName=NULL_PTR
        Adc_Init: vSetHeader=Adc.h, vSetConfigType=Adc_ConfigType, vSetConfigPtrClass=ADC_CONST, vSetModuleRef=Adc, variation-point=post-build-variant-condition{matching-criterion=RDR_POS, value=5}  # /ActiveEcuC/Adc PLAIN_TEXT Initializes Adc module Created Adc_Init by Extended Init XML Service
          vSetInitFunctionInstance: vSetInitPhase=INIT_ONE_LATE, vSetConfigPtrName=NULL_PTR
        Adc_Init: vSetHeader=Adc.h, vSetConfigType=Adc_ConfigType, vSetConfigPtrClass=ADC_CONST, vSetModuleRef=Adc, variation-point=post-build-variant-condition{matching-criterion=RDR_POS, value=2}  # /ActiveEcuC/Adc PLAIN_TEXT Initializes Adc module Created Adc_Init by Extended Init XML Service
          vSetInitFunctionInstance: vSetInitPhase=INIT_ONE_LATE, vSetConfigPtrName=NULL_PTR
        Can_Init: vSetHeader=Can.h, vSetConfigType=Can_ConfigType, vSetConfigPtrClass=CAN_CONST, vSetModuleRef=Can, variation-point=post-build-variant-condition{matching-criterion=RDR_POS, value=1}  # /ActiveEcuC/Can PLAIN_TEXT Created Can_Init by Extended Init XML Service
          vSetInitFunctionInstance: vSetInitPhase=INIT_TWO_DRV, vSetConfigPtrName=NULL_PTR
        Can_Init: vSetHeader=Can.h, vSetConfigType=Can_ConfigType, vSetConfigPtrClass=CAN_CONST, vSetModuleRef=Can, variation-point=post-build-variant-condition{matching-criterion=RDR_POS, value=6}  # /ActiveEcuC/Can PLAIN_TEXT Initializes Can module
          vSetInitFunctionInstance: vSetInitPhase=INIT_TWO_DRV, vSetConfigPtrName=NULL_PTR
        Can_Init: vSetHeader=Can.h, vSetConfigType=Can_ConfigType, vSetConfigPtrClass=CAN_CONST, vSetModuleRef=Can, variation-point=post-build-variant-condition{matching-criterion=RDR_POS, value=4}  # /ActiveEcuC/Can PLAIN_TEXT Initializes Can module
          vSetInitFunctionInstance: vSetInitPhase=INIT_TWO_DRV, vSetConfigPtrName=NULL_PTR
        Dio_Init: vSetHeader=Dio.h, vSetConfigType=Dio_ConfigType, vSetConfigPtrClass=DIO_CONST, vSetModuleRef=Dio, variation-point=post-build-variant-condition{matching-criterion=RDR_POS, value=6}  # /ActiveEcuC/Dio PLAIN_TEXT Created Dio_Init by Extended Init XML Service
          vSetInitFunctionInstance: vSetInitPhase=NO_INIT, vSetConfigPtrName=NULL_PTR
        Dio_Init: vSetHeader=Dio.h, vSetConfigType=Dio_ConfigType, vSetConfigPtrClass=DIO_CONST, vSetModuleRef=Dio, variation-point=post-build-variant-condition{matching-criterion=RDR_POS, value=3}  # /ActiveEcuC/Dio PLAIN_TEXT Created Dio_Init by Extended Init XML Service
          vSetInitFunctionInstance: vSetInitPhase=NO_INIT, vSetConfigPtrName=NULL_PTR
        Dio_Init: vSetHeader=Dio.h, vSetConfigType=Dio_ConfigType, vSetConfigPtrClass=DIO_CONST, vSetModuleRef=Dio, variation-point=post-build-variant-condition{matching-criterion=RDR_POS, value=1}  # /ActiveEcuC/Dio PLAIN_TEXT Created Dio_Init by Extended Init XML Service
          vSetInitFunctionInstance: vSetInitPhase=NO_INIT, vSetConfigPtrName=NULL_PTR
        Dio_Init: vSetHeader=Dio.h, vSetConfigType=Dio_ConfigType, vSetConfigPtrClass=DIO_CONST, vSetModuleRef=Dio, variation-point=post-build-variant-condition{matching-criterion=RDR_POS, value=7}  # /ActiveEcuC/Dio PLAIN_TEXT Created Dio_Init by Extended Init XML Service
          vSetInitFunctionInstance: vSetInitPhase=NO_INIT, vSetConfigPtrName=NULL_PTR
        Dio_Init: vSetHeader=Dio.h, vSetConfigType=Dio_ConfigType, vSetConfigPtrClass=DIO_CONST, vSetModuleRef=Dio, variation-point=post-build-variant-condition{matching-criterion=RDR_POS, value=5}  # /ActiveEcuC/Dio PLAIN_TEXT Created Dio_Init by Extended Init XML Service
          vSetInitFunctionInstance: vSetInitPhase=NO_INIT, vSetConfigPtrName=NULL_PTR
        Dio_Init: vSetHeader=Dio.h, vSetConfigType=Dio_ConfigType, vSetConfigPtrClass=DIO_CONST, vSetModuleRef=Dio, variation-point=post-build-variant-condition{matching-criterion=RDR_POS, value=2}  # /ActiveEcuC/Dio PLAIN_TEXT Created Dio_Init by Extended Init XML Service
          vSetInitFunctionInstance: vSetInitPhase=NO_INIT, vSetConfigPtrName=NULL_PTR
        Dma_Init: vSetHeader=Dma.h, vSetConfigType=Dma_ConfigType, vSetConfigPtrClass=DMA_CONST, vSetModuleRef=Dma, variation-point=post-build-variant-condition{matching-criterion=RDR_POS, value=4}  # /ActiveEcuC/Dma PLAIN_TEXT Created Dma_Init by Extended Init XML Service
          vSetInitFunctionInstance: vSetInitPhase=INIT_ONE_LATE, vSetConfigPtrName=NULL_PTR
        Dma_Init: vSetHeader=Dma.h, vSetConfigType=Dma_ConfigType, vSetConfigPtrClass=DMA_CONST, vSetModuleRef=Dma, variation-point=post-build-variant-condition{matching-criterion=RDR_POS, value=6}  # /ActiveEcuC/Dma PLAIN_TEXT Initializes Dma module
          vSetInitFunctionInstance: vSetInitPhase=INIT_ONE_LATE, vSetConfigPtrName=NULL_PTR
        Dma_Init: vSetHeader=Dma.h, vSetConfigType=Dma_ConfigType, vSetConfigPtrClass=DMA_CONST, vSetModuleRef=Dma, variation-point=post-build-variant-condition{matching-criterion=RDR_POS, value=3}  # /ActiveEcuC/Dma PLAIN_TEXT Initializes Dma module
          vSetInitFunctionInstance: vSetInitPhase=INIT_ONE_LATE, vSetConfigPtrName=NULL_PTR
        Dma_Init: vSetHeader=Dma.h, vSetConfigType=Dma_ConfigType, vSetConfigPtrClass=DMA_CONST, vSetModuleRef=Dma, variation-point=post-build-variant-condition{matching-criterion=RDR_POS, value=1}  # /ActiveEcuC/Dma PLAIN_TEXT Initializes Dma module
          vSetInitFunctionInstance: vSetInitPhase=INIT_ONE_LATE, vSetConfigPtrName=NULL_PTR
        Dma_Init: vSetHeader=Dma.h, vSetConfigType=Dma_ConfigType, vSetConfigPtrClass=DMA_CONST, vSetModuleRef=Dma, variation-point=post-build-variant-condition{matching-criterion=RDR_POS, value=7}  # /ActiveEcuC/Dma PLAIN_TEXT Initializes Dma module
          vSetInitFunctionInstance: vSetInitPhase=INIT_ONE_LATE, vSetConfigPtrName=NULL_PTR
        Dma_Init: vSetHeader=Dma.h, vSetConfigType=Dma_ConfigType, vSetConfigPtrClass=DMA_CONST, vSetModuleRef=Dma, variation-point=post-build-variant-condition{matching-criterion=RDR_POS, value=0}  # /ActiveEcuC/Dma PLAIN_TEXT Initializes Dma module
          vSetInitFunctionInstance: vSetInitPhase=INIT_ONE_LATE, vSetConfigPtrName=NULL_PTR
        Dma_Init: vSetHeader=Dma.h, vSetConfigType=Dma_ConfigType, vSetConfigPtrClass=DMA_CONST, vSetModuleRef=Dma, variation-point=post-build-variant-condition{matching-criterion=RDR_POS, value=5}  # /ActiveEcuC/Dma PLAIN_TEXT Initializes Dma module
          vSetInitFunctionInstance: vSetInitPhase=INIT_ONE_LATE, vSetConfigPtrName=NULL_PTR
        Dma_Init: vSetHeader=Dma.h, vSetConfigType=Dma_ConfigType, vSetConfigPtrClass=DMA_CONST, vSetModuleRef=Dma, variation-point=post-build-variant-condition{matching-criterion=RDR_POS, value=2}  # /ActiveEcuC/Dma PLAIN_TEXT Initializes Dma module
          vSetInitFunctionInstance: vSetInitPhase=INIT_ONE_LATE, vSetConfigPtrName=NULL_PTR
        Eth_Init: vSetHeader=Eth.h, vSetConfigType=Eth_ConfigType, vSetConfigPtrClass=AUTOMATIC, vSetModuleRef=Eth_Indie  # /ActiveEcuC/Eth_Indie PLAIN_TEXT Created Eth_Init by Extended Init XML Service
          vSetInitFunctionInstance: vSetInitPhase=INIT_TWO_DRV, vSetConfigPtrName=NULL_PTR
        Fls_Init: vSetHeader=Fls.h, vSetConfigType=Fls_ConfigType, vSetConfigPtrClass=FLS_CONST, vSetModuleRef=Fls, variation-point=post-build-variant-condition{matching-criterion=RDR_POS, value=5}  # /ActiveEcuC/Fls PLAIN_TEXT Created Fls_Init by Extended Init XML Service
          vSetInitFunctionInstance: vSetInitPhase=INIT_TWO_MCAL, vSetConfigPtrName=&Fls_Config
        Fls_Init: vSetHeader=Fls.h, vSetConfigType=Fls_ConfigType, vSetConfigPtrClass=FLS_CONST, vSetModuleRef=Fls, variation-point=post-build-variant-condition{matching-criterion=RDR_POS, value=6}  # /ActiveEcuC/Fls PLAIN_TEXT Initializes Fls module
          vSetInitFunctionInstance: vSetInitPhase=INIT_TWO_MCAL, vSetConfigPtrName=&Fls_Config
        Fls_Init: vSetHeader=Fls.h, vSetConfigType=Fls_ConfigType, vSetConfigPtrClass=FLS_CONST, vSetModuleRef=Fls, variation-point=post-build-variant-condition{matching-criterion=RDR_POS, value=3}  # /ActiveEcuC/Fls PLAIN_TEXT Initializes Fls module
          vSetInitFunctionInstance: vSetInitPhase=INIT_TWO_MCAL, vSetConfigPtrName=&Fls_Config
        Fls_Init: vSetHeader=Fls.h, vSetConfigType=Fls_ConfigType, vSetConfigPtrClass=FLS_CONST, vSetModuleRef=Fls, variation-point=post-build-variant-condition{matching-criterion=RDR_POS, value=1}  # /ActiveEcuC/Fls PLAIN_TEXT Initializes Fls module
          vSetInitFunctionInstance: vSetInitPhase=INIT_TWO_MCAL, vSetConfigPtrName=&Fls_Config
        Fls_Init: vSetHeader=Fls.h, vSetConfigType=Fls_ConfigType, vSetConfigPtrClass=FLS_CONST, vSetModuleRef=Fls, variation-point=post-build-variant-condition{matching-criterion=RDR_POS, value=4}  # /ActiveEcuC/Fls PLAIN_TEXT Initializes Fls module
          vSetInitFunctionInstance: vSetInitPhase=INIT_TWO_MCAL, vSetConfigPtrName=&Fls_Config
        Fls_Init: vSetHeader=Fls.h, vSetConfigType=Fls_ConfigType, vSetConfigPtrClass=FLS_CONST, vSetModuleRef=Fls, variation-point=post-build-variant-condition{matching-criterion=RDR_POS, value=7}  # /ActiveEcuC/Fls PLAIN_TEXT Initializes Fls module
          vSetInitFunctionInstance: vSetInitPhase=INIT_TWO_MCAL, vSetConfigPtrName=&Fls_Config
        Fls_Init: vSetHeader=Fls.h, vSetConfigType=Fls_ConfigType, vSetConfigPtrClass=FLS_CONST, vSetModuleRef=Fls, variation-point=post-build-variant-condition{matching-criterion=RDR_POS, value=0}  # /ActiveEcuC/Fls PLAIN_TEXT Initializes Fls module
          vSetInitFunctionInstance: vSetInitPhase=INIT_TWO_MCAL, vSetConfigPtrName=&Fls_Config
        Fls_Init: vSetHeader=Fls.h, vSetConfigType=Fls_ConfigType, vSetConfigPtrClass=FLS_CONST, vSetModuleRef=Fls, variation-point=post-build-variant-condition{matching-criterion=RDR_POS, value=2}  # /ActiveEcuC/Fls PLAIN_TEXT Initializes Fls module
          vSetInitFunctionInstance: vSetInitPhase=INIT_TWO_MCAL, vSetConfigPtrName=&Fls_Config
        Gpt_Init: vSetHeader=Gpt.h, vSetConfigType=Gpt_ConfigType, vSetConfigPtrClass=GPT_CONST, vSetModuleRef=Gpt, variation-point=post-build-variant-condition{matching-criterion=RDR_POS, value=4}  # /ActiveEcuC/Gpt PLAIN_TEXT Created Gpt_Init by Extended Init XML Service
          vSetInitFunctionInstance: vSetInitPhase=INIT_ONE_LATE, vSetConfigPtrName=NULL_PTR
        Gpt_Init: vSetHeader=Gpt.h, vSetConfigType=Gpt_ConfigType, vSetConfigPtrClass=GPT_CONST, vSetModuleRef=Gpt, variation-point=post-build-variant-condition{matching-criterion=RDR_POS, value=6}  # /ActiveEcuC/Gpt PLAIN_TEXT Initializes Gpt module
          vSetInitFunctionInstance: vSetInitPhase=INIT_ONE_LATE, vSetConfigPtrName=NULL_PTR
        Gpt_Init: vSetHeader=Gpt.h, vSetConfigType=Gpt_ConfigType, vSetConfigPtrClass=GPT_CONST, vSetModuleRef=Gpt, variation-point=post-build-variant-condition{matching-criterion=RDR_POS, value=3}  # /ActiveEcuC/Gpt PLAIN_TEXT Initializes Gpt module
          vSetInitFunctionInstance: vSetInitPhase=INIT_ONE_LATE, vSetConfigPtrName=NULL_PTR
        Gpt_Init: vSetHeader=Gpt.h, vSetConfigType=Gpt_ConfigType, vSetConfigPtrClass=GPT_CONST, vSetModuleRef=Gpt, variation-point=post-build-variant-condition{matching-criterion=RDR_POS, value=1}  # /ActiveEcuC/Gpt PLAIN_TEXT Initializes Gpt module
          vSetInitFunctionInstance: vSetInitPhase=INIT_ONE_LATE, vSetConfigPtrName=NULL_PTR
        Gpt_Init: vSetHeader=Gpt.h, vSetConfigType=Gpt_ConfigType, vSetConfigPtrClass=GPT_CONST, vSetModuleRef=Gpt, variation-point=post-build-variant-condition{matching-criterion=RDR_POS, value=7}  # /ActiveEcuC/Gpt PLAIN_TEXT Initializes Gpt module
          vSetInitFunctionInstance: vSetInitPhase=INIT_ONE_LATE, vSetConfigPtrName=NULL_PTR
        Gpt_Init: vSetHeader=Gpt.h, vSetConfigType=Gpt_ConfigType, vSetConfigPtrClass=GPT_CONST, vSetModuleRef=Gpt, variation-point=post-build-variant-condition{matching-criterion=RDR_POS, value=0}  # /ActiveEcuC/Gpt PLAIN_TEXT Initializes Gpt module
          vSetInitFunctionInstance: vSetInitPhase=INIT_ONE_LATE, vSetConfigPtrName=NULL_PTR
        Gpt_Init: vSetHeader=Gpt.h, vSetConfigType=Gpt_ConfigType, vSetConfigPtrClass=GPT_CONST, vSetModuleRef=Gpt, variation-point=post-build-variant-condition{matching-criterion=RDR_POS, value=5}  # /ActiveEcuC/Gpt PLAIN_TEXT Initializes Gpt module
          vSetInitFunctionInstance: vSetInitPhase=INIT_ONE_LATE, vSetConfigPtrName=NULL_PTR
        Gpt_Init: vSetHeader=Gpt.h, vSetConfigType=Gpt_ConfigType, vSetConfigPtrClass=GPT_CONST, vSetModuleRef=Gpt, variation-point=post-build-variant-condition{matching-criterion=RDR_POS, value=2}  # /ActiveEcuC/Gpt PLAIN_TEXT Initializes Gpt module
          vSetInitFunctionInstance: vSetInitPhase=INIT_ONE_LATE, vSetConfigPtrName=NULL_PTR
        I2c_Init: vSetHeader=I2c.h, vSetConfigType=I2c_ConfigType, vSetConfigPtrClass=I2C_CONST, vSetModuleRef=I2c, variation-point=post-build-variant-condition{matching-criterion=RDR_POS, value=5}  # /ActiveEcuC/I2c PLAIN_TEXT Created I2c_Init by Extended Init XML Service
          vSetInitFunctionInstance: vSetInitPhase=INIT_ONE_LATE, vSetConfigPtrName=NULL_PTR
        I2c_Init: vSetHeader=I2c.h, vSetConfigType=I2c_ConfigType, vSetConfigPtrClass=I2C_CONST, vSetModuleRef=I2c, variation-point=post-build-variant-condition{matching-criterion=RDR_POS, value=6}  # /ActiveEcuC/I2c PLAIN_TEXT Initializes I2c module
          vSetInitFunctionInstance: vSetInitPhase=INIT_ONE_LATE, vSetConfigPtrName=NULL_PTR
        I2c_Init: vSetHeader=I2c.h, vSetConfigType=I2c_ConfigType, vSetConfigPtrClass=I2C_CONST, vSetModuleRef=I2c, variation-point=post-build-variant-condition{matching-criterion=RDR_POS, value=3}  # /ActiveEcuC/I2c PLAIN_TEXT Initializes I2c module
          vSetInitFunctionInstance: vSetInitPhase=INIT_ONE_LATE, vSetConfigPtrName=NULL_PTR
        I2c_Init: vSetHeader=I2c.h, vSetConfigType=I2c_ConfigType, vSetConfigPtrClass=I2C_CONST, vSetModuleRef=I2c, variation-point=post-build-variant-condition{matching-criterion=RDR_POS, value=1}  # /ActiveEcuC/I2c PLAIN_TEXT Initializes I2c module
          vSetInitFunctionInstance: vSetInitPhase=INIT_ONE_LATE, vSetConfigPtrName=NULL_PTR
        I2c_Init: vSetHeader=I2c.h, vSetConfigType=I2c_ConfigType, vSetConfigPtrClass=I2C_CONST, vSetModuleRef=I2c, variation-point=post-build-variant-condition{matching-criterion=RDR_POS, value=4}  # /ActiveEcuC/I2c PLAIN_TEXT Initializes I2c module
          vSetInitFunctionInstance: vSetInitPhase=INIT_ONE_LATE, vSetConfigPtrName=NULL_PTR
        I2c_Init: vSetHeader=I2c.h, vSetConfigType=I2c_ConfigType, vSetConfigPtrClass=I2C_CONST, vSetModuleRef=I2c, variation-point=post-build-variant-condition{matching-criterion=RDR_POS, value=7}  # /ActiveEcuC/I2c PLAIN_TEXT Initializes I2c module
          vSetInitFunctionInstance: vSetInitPhase=INIT_ONE_LATE, vSetConfigPtrName=NULL_PTR
        I2c_Init: vSetHeader=I2c.h, vSetConfigType=I2c_ConfigType, vSetConfigPtrClass=I2C_CONST, vSetModuleRef=I2c, variation-point=post-build-variant-condition{matching-criterion=RDR_POS, value=0}  # /ActiveEcuC/I2c PLAIN_TEXT Initializes I2c module
          vSetInitFunctionInstance: vSetInitPhase=INIT_ONE_LATE, vSetConfigPtrName=NULL_PTR
        I2c_Init: vSetHeader=I2c.h, vSetConfigType=I2c_ConfigType, vSetConfigPtrClass=I2C_CONST, vSetModuleRef=I2c, variation-point=post-build-variant-condition{matching-criterion=RDR_POS, value=2}  # /ActiveEcuC/I2c PLAIN_TEXT Initializes I2c module
          vSetInitFunctionInstance: vSetInitPhase=INIT_ONE_LATE, vSetConfigPtrName=NULL_PTR
        Mcu_Init: vSetHeader=Mcu.h, vSetConfigType=Mcu_ConfigType, vSetConfigPtrClass=MCU_CONST, vSetModuleRef=Mcu, variation-point=post-build-variant-condition{matching-criterion=RDR_POS, value=7}  # /ActiveEcuC/Mcu PLAIN_TEXT Created Mcu_Init by Extended Init XML Service
          vSetInitFunctionInstance: vSetInitPhase=INIT_ONE_EARLY, vSetConfigPtrName=NULL_PTR
        Mcu_Init: vSetHeader=Mcu.h, vSetConfigType=Mcu_ConfigType, vSetConfigPtrClass=MCU_CONST, vSetModuleRef=Mcu, variation-point=post-build-variant-condition{matching-criterion=RDR_POS, value=6}  # /ActiveEcuC/Mcu PLAIN_TEXT Initializes Mcu module
          vSetInitFunctionInstance: vSetInitPhase=INIT_ONE_EARLY, vSetConfigPtrName=NULL_PTR
        Mcu_Init: vSetHeader=Mcu.h, vSetConfigType=Mcu_ConfigType, vSetConfigPtrClass=MCU_CONST, vSetModuleRef=Mcu, variation-point=post-build-variant-condition{matching-criterion=RDR_POS, value=3}  # /ActiveEcuC/Mcu PLAIN_TEXT Initializes Mcu module
          vSetInitFunctionInstance: vSetInitPhase=INIT_ONE_EARLY, vSetConfigPtrName=NULL_PTR
        Mcu_Init: vSetHeader=Mcu.h, vSetConfigType=Mcu_ConfigType, vSetConfigPtrClass=MCU_CONST, vSetModuleRef=Mcu, variation-point=post-build-variant-condition{matching-criterion=RDR_POS, value=1}  # /ActiveEcuC/Mcu PLAIN_TEXT Initializes Mcu module
          vSetInitFunctionInstance: vSetInitPhase=INIT_ONE_EARLY, vSetConfigPtrName=NULL_PTR
        Mcu_Init: vSetHeader=Mcu.h, vSetConfigType=Mcu_ConfigType, vSetConfigPtrClass=MCU_CONST, vSetModuleRef=Mcu, variation-point=post-build-variant-condition{matching-criterion=RDR_POS, value=4}  # /ActiveEcuC/Mcu PLAIN_TEXT Initializes Mcu module
          vSetInitFunctionInstance: vSetInitPhase=INIT_ONE_EARLY, vSetConfigPtrName=NULL_PTR
        Mcu_Init: vSetHeader=Mcu.h, vSetConfigType=Mcu_ConfigType, vSetConfigPtrClass=MCU_CONST, vSetModuleRef=Mcu, variation-point=post-build-variant-condition{matching-criterion=RDR_POS, value=0}  # /ActiveEcuC/Mcu PLAIN_TEXT Initializes Mcu module
          vSetInitFunctionInstance: vSetInitPhase=INIT_ONE_EARLY, vSetConfigPtrName=NULL_PTR
        Mcu_Init: vSetHeader=Mcu.h, vSetConfigType=Mcu_ConfigType, vSetConfigPtrClass=MCU_CONST, vSetModuleRef=Mcu, variation-point=post-build-variant-condition{matching-criterion=RDR_POS, value=5}  # /ActiveEcuC/Mcu PLAIN_TEXT Initializes Mcu module
          vSetInitFunctionInstance: vSetInitPhase=INIT_ONE_EARLY, vSetConfigPtrName=NULL_PTR
        Mcu_Init: vSetHeader=Mcu.h, vSetConfigType=Mcu_ConfigType, vSetConfigPtrClass=MCU_CONST, vSetModuleRef=Mcu, variation-point=post-build-variant-condition{matching-criterion=RDR_POS, value=2}  # /ActiveEcuC/Mcu PLAIN_TEXT Initializes Mcu module
          vSetInitFunctionInstance: vSetInitPhase=INIT_ONE_EARLY, vSetConfigPtrName=NULL_PTR
        Port_Init: vSetHeader=Port.h, vSetConfigType=Port_ConfigType, vSetConfigPtrClass=PORT_CONST, vSetModuleRef=Port, variation-point=post-build-variant-condition{matching-criterion=RDR_POS, value=6}  # /ActiveEcuC/Port PLAIN_TEXT Created Port_Init by Extended Init XML Service
          vSetInitFunctionInstance: vSetInitPhase=INIT_ONE, vSetConfigPtrName=NULL_PTR
        Port_Init: vSetHeader=Port.h, vSetConfigType=Port_ConfigType, vSetConfigPtrClass=PORT_CONST, vSetModuleRef=Port, variation-point=post-build-variant-condition{matching-criterion=RDR_POS, value=3}  # /ActiveEcuC/Port PLAIN_TEXT Created Port_Init by Extended Init XML Service Initializes Port driver
          vSetInitFunctionInstance: vSetInitPhase=INIT_ONE, vSetConfigPtrName=NULL_PTR
        Port_Init: vSetHeader=Port.h, vSetConfigType=Port_ConfigType, vSetConfigPtrClass=PORT_CONST, vSetModuleRef=Port, variation-point=post-build-variant-condition{matching-criterion=RDR_POS, value=1}  # /ActiveEcuC/Port PLAIN_TEXT Initializes Port driver
          vSetInitFunctionInstance: vSetInitPhase=INIT_ONE, vSetConfigPtrName=NULL_PTR
        Port_Init: vSetHeader=Port.h, vSetConfigType=Port_ConfigType, vSetConfigPtrClass=PORT_CONST, vSetModuleRef=Port, variation-point=post-build-variant-condition{matching-criterion=RDR_POS, value=4}  # /ActiveEcuC/Port PLAIN_TEXT Created Port_Init by Extended Init XML Service Initializes Port driver
          vSetInitFunctionInstance: vSetInitPhase=INIT_ONE, vSetConfigPtrName=NULL_PTR
        Port_Init: vSetHeader=Port.h, vSetConfigType=Port_ConfigType, vSetConfigPtrClass=PORT_CONST, vSetModuleRef=Port, variation-point=post-build-variant-condition{matching-criterion=RDR_POS, value=0}  # /ActiveEcuC/Port PLAIN_TEXT Created Port_Init by Extended Init XML Service Initializes Port driver
          vSetInitFunctionInstance: vSetInitPhase=INIT_ONE, vSetConfigPtrName=NULL_PTR
        Port_Init: vSetHeader=Port.h, vSetConfigType=Port_ConfigType, vSetConfigPtrClass=PORT_CONST, vSetModuleRef=Port, variation-point=post-build-variant-condition{matching-criterion=RDR_POS, value=5}  # /ActiveEcuC/Port PLAIN_TEXT Created Port_Init by Extended Init XML Service Initializes Port driver
          vSetInitFunctionInstance: vSetInitPhase=INIT_ONE, vSetConfigPtrName=NULL_PTR
        Port_Init: vSetHeader=Port.h, vSetConfigType=Port_ConfigType, vSetConfigPtrClass=PORT_CONST, vSetModuleRef=Port, variation-point=post-build-variant-condition{matching-criterion=RDR_POS, value=2}  # /ActiveEcuC/Port PLAIN_TEXT Created Port_Init by Extended Init XML Service Initializes Port driver
          vSetInitFunctionInstance: vSetInitPhase=INIT_ONE, vSetConfigPtrName=NULL_PTR
        Pwm_Init: vSetHeader=Pwm.h, vSetConfigType=Pwm_ConfigType, vSetConfigPtrClass=PWM_CONST, vSetModuleRef=Pwm, variation-point=post-build-variant-condition{matching-criterion=RDR_POS, value=6}  # /ActiveEcuC/Pwm PLAIN_TEXT Created Pwm_Init by Extended Init XML Service
          vSetInitFunctionInstance: vSetInitPhase=INIT_ONE_LATE, vSetConfigPtrName=&Pwm_Config
        Pwm_Init: vSetHeader=Pwm.h, vSetConfigType=Pwm_ConfigType, vSetConfigPtrClass=PWM_CONST, vSetModuleRef=Pwm, variation-point=post-build-variant-condition{matching-criterion=RDR_POS, value=3}  # /ActiveEcuC/Pwm PLAIN_TEXT Initializes Pwm module
          vSetInitFunctionInstance: vSetInitPhase=INIT_ONE_LATE, vSetConfigPtrName=&Pwm_Config
        Pwm_Init: vSetHeader=Pwm.h, vSetConfigType=Pwm_ConfigType, vSetConfigPtrClass=PWM_CONST, vSetModuleRef=Pwm, variation-point=post-build-variant-condition{matching-criterion=RDR_POS, value=1}  # /ActiveEcuC/Pwm PLAIN_TEXT Initializes Pwm module
          vSetInitFunctionInstance: vSetInitPhase=INIT_ONE_LATE, vSetConfigPtrName=&Pwm_Config
        Pwm_Init: vSetHeader=Pwm.h, vSetConfigType=Pwm_ConfigType, vSetConfigPtrClass=PWM_CONST, vSetModuleRef=Pwm, variation-point=post-build-variant-condition{matching-criterion=RDR_POS, value=4}  # /ActiveEcuC/Pwm PLAIN_TEXT Initializes Pwm module
          vSetInitFunctionInstance: vSetInitPhase=INIT_ONE_LATE, vSetConfigPtrName=&Pwm_Config
        Pwm_Init: vSetHeader=Pwm.h, vSetConfigType=Pwm_ConfigType, vSetConfigPtrClass=PWM_CONST, vSetModuleRef=Pwm, variation-point=post-build-variant-condition{matching-criterion=RDR_POS, value=7}  # /ActiveEcuC/Pwm PLAIN_TEXT Initializes Pwm module
          vSetInitFunctionInstance: vSetInitPhase=INIT_ONE_LATE, vSetConfigPtrName=&Pwm_Config
        Pwm_Init: vSetHeader=Pwm.h, vSetConfigType=Pwm_ConfigType, vSetConfigPtrClass=PWM_CONST, vSetModuleRef=Pwm, variation-point=post-build-variant-condition{matching-criterion=RDR_POS, value=0}  # /ActiveEcuC/Pwm PLAIN_TEXT Initializes Pwm module
          vSetInitFunctionInstance: vSetInitPhase=INIT_ONE_LATE, vSetConfigPtrName=&Pwm_Config
        Pwm_Init: vSetHeader=Pwm.h, vSetConfigType=Pwm_ConfigType, vSetConfigPtrClass=PWM_CONST, vSetModuleRef=Pwm, variation-point=post-build-variant-condition{matching-criterion=RDR_POS, value=5}  # /ActiveEcuC/Pwm PLAIN_TEXT Initializes Pwm module
          vSetInitFunctionInstance: vSetInitPhase=INIT_ONE_LATE, vSetConfigPtrName=&Pwm_Config
        Pwm_Init: vSetHeader=Pwm.h, vSetConfigType=Pwm_ConfigType, vSetConfigPtrClass=PWM_CONST, vSetModuleRef=Pwm, variation-point=post-build-variant-condition{matching-criterion=RDR_POS, value=2}  # /ActiveEcuC/Pwm PLAIN_TEXT Initializes Pwm module
          vSetInitFunctionInstance: vSetInitPhase=INIT_ONE_LATE, vSetConfigPtrName=&Pwm_Config
        Spi_Init: vSetHeader=Spi.h, vSetConfigType=Spi_ConfigType, vSetConfigPtrClass=SPI_CONST, vSetModuleRef=Spi, variation-point=post-build-variant-condition{matching-criterion=RDR_POS, value=5}  # /ActiveEcuC/Spi PLAIN_TEXT Created Spi_Init by Extended Init XML Service
          vSetInitFunctionInstance: vSetInitPhase=INIT_TWO_MCAL, vSetConfigPtrName=NULL_PTR
        Spi_Init: vSetHeader=Spi.h, vSetConfigType=Spi_ConfigType, vSetConfigPtrClass=SPI_CONST, vSetModuleRef=Spi, variation-point=post-build-variant-condition{matching-criterion=RDR_POS, value=6}  # /ActiveEcuC/Spi PLAIN_TEXT Initializes Spi module
          vSetInitFunctionInstance: vSetInitPhase=INIT_TWO_MCAL, vSetConfigPtrName=NULL_PTR
        Spi_Init: vSetHeader=Spi.h, vSetConfigType=Spi_ConfigType, vSetConfigPtrClass=SPI_CONST, vSetModuleRef=Spi, variation-point=post-build-variant-condition{matching-criterion=RDR_POS, value=3}  # /ActiveEcuC/Spi PLAIN_TEXT Initializes Spi module
          vSetInitFunctionInstance: vSetInitPhase=INIT_TWO_MCAL, vSetConfigPtrName=NULL_PTR
        Spi_Init: vSetHeader=Spi.h, vSetConfigType=Spi_ConfigType, vSetConfigPtrClass=SPI_CONST, vSetModuleRef=Spi, variation-point=post-build-variant-condition{matching-criterion=RDR_POS, value=1}  # /ActiveEcuC/Spi PLAIN_TEXT Initializes Spi module
          vSetInitFunctionInstance: vSetInitPhase=INIT_TWO_MCAL, vSetConfigPtrName=NULL_PTR
        Spi_Init: vSetHeader=Spi.h, vSetConfigType=Spi_ConfigType, vSetConfigPtrClass=SPI_CONST, vSetModuleRef=Spi, variation-point=post-build-variant-condition{matching-criterion=RDR_POS, value=4}  # /ActiveEcuC/Spi PLAIN_TEXT Initializes Spi module
          vSetInitFunctionInstance: vSetInitPhase=INIT_TWO_MCAL, vSetConfigPtrName=NULL_PTR
        Spi_Init: vSetHeader=Spi.h, vSetConfigType=Spi_ConfigType, vSetConfigPtrClass=SPI_CONST, vSetModuleRef=Spi, variation-point=post-build-variant-condition{matching-criterion=RDR_POS, value=7}  # /ActiveEcuC/Spi PLAIN_TEXT Initializes Spi module
          vSetInitFunctionInstance: vSetInitPhase=INIT_TWO_MCAL, vSetConfigPtrName=NULL_PTR
        Spi_Init: vSetHeader=Spi.h, vSetConfigType=Spi_ConfigType, vSetConfigPtrClass=SPI_CONST, vSetModuleRef=Spi, variation-point=post-build-variant-condition{matching-criterion=RDR_POS, value=0}  # /ActiveEcuC/Spi PLAIN_TEXT Initializes Spi module
          vSetInitFunctionInstance: vSetInitPhase=INIT_TWO_MCAL, vSetConfigPtrName=NULL_PTR
        Spi_Init: vSetHeader=Spi.h, vSetConfigType=Spi_ConfigType, vSetConfigPtrClass=SPI_CONST, vSetModuleRef=Spi, variation-point=post-build-variant-condition{matching-criterion=RDR_POS, value=2}  # /ActiveEcuC/Spi PLAIN_TEXT Initializes Spi module
          vSetInitFunctionInstance: vSetInitPhase=INIT_TWO_MCAL, vSetConfigPtrName=NULL_PTR
        Rtm_InitMemory: vSetHeader=Rtm.h, vSetModuleRef=Rtm  # /ActiveEcuC/Rtm PLAIN_TEXT Memory Initialization function of module Rtm.
          vSetInitFunctionInstance: vSetInitPhase=INIT_MEMORY
        Rtm_Init: vSetHeader=Rtm.h, vSetModuleRef=Rtm  # /ActiveEcuC/Rtm PLAIN_TEXT Module Initialization function of module Rtm.
          vSetInitFunctionInstance: vSetInitPhase=INIT_TWO_POST_NVMREADALL
        Fee_30_FlexNor_Init: vSetHeader=Fee_30_FlexNor.h, vSetModuleRef=Fee  # /ActiveEcuC/Fee PLAIN_TEXT Initialization of FEE FlexNor
          vSetInitFunctionInstance: vSetInitPhase=INIT_TWO_IF
        NvM_Init: vSetHeader=NvM.h, vSetModuleRef=NvM  # /ActiveEcuC/NvM PLAIN_TEXT Initialization of the NVRAM Manager, to make it ready for NvM_ReadAll being requested
          vSetInitFunctionInstance: vSetInitPhase=INIT_TWO_SYS
        LdCom_Init: vSetHeader=LdCom.h, vSetConfigType=LdCom_ConfigType, vSetConfigPtrClass=LDCOM_INIT_DATA, vSetModuleRef=LdCom  # /ActiveEcuC/LdCom PLAIN_TEXT Init function description of LdCom in PostBuildPredefinedVariantView (RDR_01) .
          vSetInitFunctionInstance: vSetConfigPtrName=LdCom_Config_Ptr, vSetInitPhase=INIT_TWO_COM
        LdCom_InitMemory: vSetHeader=LdCom.h, vSetModuleRef=LdCom  # /ActiveEcuC/LdCom PLAIN_TEXT InitMemory function description of LdCom in PostBuildPredefinedVariantView (RDR_01) .
          vSetInitFunctionInstance: vSetInitPhase=INIT_MEMORY
        Sd_Init: vSetHeader=Sd.h, vSetConfigType=Sd_ConfigType, vSetConfigPtrClass=SD_INIT_DATA, vSetModuleRef=Sd  # /ActiveEcuC/Sd PLAIN_TEXT Init function description of Sd in PostBuildPredefinedVariantView (RDR_01) .
          vSetInitFunctionInstance: vSetConfigPtrName=Sd_Config_Ptr, vSetInitPhase=INIT_TWO_SYS
        Sd_PreInit: vSetHeader=Sd.h, vSetConfigType=Sd_ConfigType, vSetConfigPtrClass=SD_INIT_DATA, vSetModuleRef=Sd  # /ActiveEcuC/Sd PLAIN_TEXT PreInit function description of Sd in PostBuildPredefinedVariantView (RDR_01) .
          vSetInitFunctionInstance: vSetConfigPtrName=Sd_Config_Ptr, vSetInitPhase=INIT_ONE
        Sd_PostInit: vSetHeader=Sd.h, vSetModuleRef=Sd  # /ActiveEcuC/Sd PLAIN_TEXT PostInit function description of Sd in PostBuildPredefinedVariantView (RDR_01) .
          vSetInitFunctionInstance: vSetInitPhase=INIT_THREE
        Sd_InitMemory: vSetHeader=Sd.h, vSetModuleRef=Sd  # /ActiveEcuC/Sd PLAIN_TEXT InitMemory function description of Sd in PostBuildPredefinedVariantView (RDR_01) .
          vSetInitFunctionInstance: vSetInitPhase=INIT_MEMORY
        SomeIpTp_Init: vSetHeader=SomeIpTp.h, vSetConfigType=SomeIpTp_ConfigType, vSetConfigPtrClass=SOMEIPTP_INIT_DATA, vSetModuleRef=SomeIpTp  # /ActiveEcuC/SomeIpTp PLAIN_TEXT Init function description of SomeIpTp in PostBuildPredefinedVariantView (RDR_01) .
          vSetInitFunctionInstance: vSetConfigPtrName=SomeIpTp_Config_Ptr, vSetInitPhase=INIT_TWO_TP
        SomeIpTp_InitMemory: vSetHeader=SomeIpTp.h, vSetModuleRef=SomeIpTp  # /ActiveEcuC/SomeIpTp PLAIN_TEXT InitMemory function description of SomeIpTp in PostBuildPredefinedVariantView (RDR_01) .
          vSetInitFunctionInstance: vSetInitPhase=INIT_MEMORY
        SomeIpXf_InitMemory: vSetHeader=SomeIpXf.h, vSetModuleRef=SomeIpXf  # /ActiveEcuC/SomeIpXf PLAIN_TEXT Automatically generated by BswInitFctConfigurationService.
          vSetInitFunctionInstance: vSetInitPhase=INIT_MEMORY
        SomeIpXf_Init: vSetHeader=SomeIpXf.h, vSetModuleRef=SomeIpXf  # /ActiveEcuC/SomeIpXf PLAIN_TEXT Automatically generated by BswInitFctConfigurationService.
          vSetInitFunctionInstance: vSetInitPhase=NO_INIT
        ComXf_Init: vSetHeader=ComXf.h, vSetModuleRef=ComXf  # /ActiveEcuC/ComXf PLAIN_TEXT Automatically generated by BswInitFctConfigurationService.
          vSetInitFunctionInstance: vSetInitPhase=NO_INIT
        WdgM_Init: vSetHeader=WdgM.h, vSetConfigType=WdgM_ConfigType, vSetConfigPtrClass=WDGM_APPL_CONST, vSetModuleRef=WdgM  # /ActiveEcuC/WdgM PLAIN_TEXT Initialization of WdgM Module
          vSetInitFunctionInstance: vSetInitPhase=INIT_TWO_IF, vSetConfigPtrName=&WdgMConfig_Mode0_core0
        CanXcp_InitMemory: vSetHeader=CanXcp.h, vSetModuleRef=Xcp  # /ActiveEcuC/Xcp PLAIN_TEXT Memory Initialization function of module CanXcp.
          vSetInitFunctionInstance: vSetInitPhase=INIT_MEMORY
        CanXcp_Init: vSetHeader=CanXcp.h, vSetConfigType=CanXcp_ConfigType, vSetConfigPtrClass=CANXCP_CONST, vSetModuleRef=Xcp  # /ActiveEcuC/Xcp PLAIN_TEXT Module Initialization function of module CanXcp.
          vSetInitFunctionInstance: vSetConfigPtrName=NULL_PTR, vSetInitPhase=INIT_TWO_TP
        CanTSyn_Init: vSetHeader=CanTSyn.h, vSetConfigType=CanTSyn_ConfigType, vSetConfigPtrClass=CANTSYN_INIT_DATA, vSetModuleRef=CanTSyn  # /ActiveEcuC/CanTSyn PLAIN_TEXT Init function description of CanTSyn in PostBuildPredefinedVariantView (RDR_01) .
          vSetInitFunctionInstance:
            vSetConfigPtrName = CanTSyn_Config_RDR_01_Ptr if post-build-variant-condition{matching-criterion=RDR_POS, value=0}
            vSetInitPhase = INIT_TWO_SYS
            vSetConfigPtrName = CanTSyn_Config_RDR_02_Ptr if post-build-variant-condition{matching-criterion=RDR_POS, value=1}
            vSetConfigPtrName = CanTSyn_Config_RDR_03_Ptr if post-build-variant-condition{matching-criterion=RDR_POS, value=2}
            vSetConfigPtrName = CanTSyn_Config_RDR_04_Ptr if post-build-variant-condition{matching-criterion=RDR_POS, value=3}
            vSetConfigPtrName = CanTSyn_Config_RDR_05_Ptr if post-build-variant-condition{matching-criterion=RDR_POS, value=4}
            vSetConfigPtrName = CanTSyn_Config_RDR_06_Ptr if post-build-variant-condition{matching-criterion=RDR_POS, value=5}
            vSetConfigPtrName = CanTSyn_Config_RDR_07_Ptr if post-build-variant-condition{matching-criterion=RDR_POS, value=6}
            vSetConfigPtrName = CanTSyn_Config_RDR_08_Ptr if post-build-variant-condition{matching-criterion=RDR_POS, value=7}
        CanTSyn_PreInit: vSetHeader=CanTSyn.h, vSetConfigType=CanTSyn_ConfigType, vSetConfigPtrClass=CANTSYN_INIT_DATA, vSetModuleRef=CanTSyn  # /ActiveEcuC/CanTSyn PLAIN_TEXT PreInit function description of CanTSyn in PostBuildPredefinedVariantView (RDR_01) .
          vSetInitFunctionInstance:
            vSetConfigPtrName = CanTSyn_Config_RDR_01_Ptr if post-build-variant-condition{matching-criterion=RDR_POS, value=0}
            vSetInitPhase = INIT_ONE
            vSetConfigPtrName = CanTSyn_Config_RDR_02_Ptr if post-build-variant-condition{matching-criterion=RDR_POS, value=1}
            vSetConfigPtrName = CanTSyn_Config_RDR_03_Ptr if post-build-variant-condition{matching-criterion=RDR_POS, value=2}
            vSetConfigPtrName = CanTSyn_Config_RDR_04_Ptr if post-build-variant-condition{matching-criterion=RDR_POS, value=3}
            vSetConfigPtrName = CanTSyn_Config_RDR_05_Ptr if post-build-variant-condition{matching-criterion=RDR_POS, value=4}
            vSetConfigPtrName = CanTSyn_Config_RDR_06_Ptr if post-build-variant-condition{matching-criterion=RDR_POS, value=5}
            vSetConfigPtrName = CanTSyn_Config_RDR_07_Ptr if post-build-variant-condition{matching-criterion=RDR_POS, value=6}
            vSetConfigPtrName = CanTSyn_Config_RDR_08_Ptr if post-build-variant-condition{matching-criterion=RDR_POS, value=7}
        CanTSyn_InitMemory: vSetHeader=CanTSyn.h, vSetModuleRef=CanTSyn  # /ActiveEcuC/CanTSyn PLAIN_TEXT InitMemory function description of CanTSyn in PostBuildPredefinedVariantView (RDR_01) .
          vSetInitFunctionInstance: vSetInitPhase=INIT_MEMORY
        CryIf_InitMemory: vSetHeader=CryIf.h, vSetModuleRef=CryIf  # /ActiveEcuC/CryIf PLAIN_TEXT Initializes variables of the Crypto Interface
          vSetInitFunctionInstance: vSetInitPhase=INIT_MEMORY
        CryIf_Init: vSetHeader=CryIf.h, vSetModuleRef=CryIf  # /ActiveEcuC/CryIf PLAIN_TEXT Initializes the Crypto Interface
          vSetInitFunctionInstance: vSetInitPhase=INIT_TWO_IF
        Csm_InitMemory: vSetHeader=Csm.h, vSetModuleRef=Csm  # /ActiveEcuC/Csm PLAIN_TEXT Initializes variables of the Crypto Service Manager
          vSetInitFunctionInstance: vSetInitPhase=INIT_MEMORY
        Csm_Init: vSetHeader=Csm.h, vSetModuleRef=Csm  # /ActiveEcuC/Csm PLAIN_TEXT Initializes the Crypto Service Manager
          vSetInitFunctionInstance: vSetInitPhase=INIT_TWO_SYS
        CanSM_PreInit: vSetHeader=CanSM_EcuM.h, vSetConfigType=CanSM_ConfigType, vSetConfigPtrClass=CANSM_INIT_DATA, vSetModuleRef=CanSM  # /ActiveEcuC/CanSM PLAIN_TEXT PreInit function description of CanSM in PostBuildPredefinedVariantView (RDR_01) .
          vSetInitFunctionInstance: vSetConfigPtrName=CanSM_Config_Ptr, vSetInitPhase=INIT_ONE
        Crypto_182_iND13400_Init: vSetHeader=Crypto_182_iND13400.h, vSetConfigType=Crypto_ConfigType, vSetConfigPtrClass=CRYPTO_CONST, vSetModuleRef=Crypto, variation-point=post-build-variant-condition{matching-criterion=RDR_POS, value=3}  # /ActiveEcuC/Crypto PLAIN_TEXT Created Crypto_182_iND13400_Init by Extended Init XML Service
          vSetInitFunctionInstance: vSetConfigPtrName=NULL_PTR, vSetInitPhase=INIT_TWO_POST_NVMREADALL
        Crypto_182_iND13400_Init: vSetHeader=Crypto_182_iND13400.h, vSetConfigType=Crypto_ConfigType, vSetConfigPtrClass=CRYPTO_CONST, vSetModuleRef=Crypto, variation-point=post-build-variant-condition{matching-criterion=RDR_POS, value=6}  # /ActiveEcuC/Crypto PLAIN_TEXT Created Crypto_182_iND13400_Init by Extended Init XML Service
          vSetInitFunctionInstance: vSetConfigPtrName=NULL_PTR, vSetInitPhase=INIT_TWO_POST_NVMREADALL
        Crypto_182_iND13400_Init: vSetHeader=Crypto_182_iND13400.h, vSetConfigType=Crypto_ConfigType, vSetConfigPtrClass=CRYPTO_CONST, vSetModuleRef=Crypto, variation-point=post-build-variant-condition{matching-criterion=RDR_POS, value=4}  # /ActiveEcuC/Crypto PLAIN_TEXT Created Crypto_182_iND13400_Init by Extended Init XML Service
          vSetInitFunctionInstance: vSetConfigPtrName=NULL_PTR, vSetInitPhase=INIT_TWO_POST_NVMREADALL
        Crypto_182_iND13400_Init: vSetHeader=Crypto_182_iND13400.h, vSetConfigType=Crypto_ConfigType, vSetConfigPtrClass=CRYPTO_CONST, vSetModuleRef=Crypto, variation-point=post-build-variant-condition{matching-criterion=RDR_POS, value=1}  # /ActiveEcuC/Crypto PLAIN_TEXT Created Crypto_182_iND13400_Init by Extended Init XML Service
          vSetInitFunctionInstance: vSetConfigPtrName=NULL_PTR, vSetInitPhase=INIT_TWO_POST_NVMREADALL
        Crypto_182_iND13400_Init: vSetHeader=Crypto_182_iND13400.h, vSetConfigType=Crypto_ConfigType, vSetConfigPtrClass=CRYPTO_CONST, vSetModuleRef=Crypto, variation-point=post-build-variant-condition{matching-criterion=RDR_POS, value=7}  # /ActiveEcuC/Crypto PLAIN_TEXT Created Crypto_182_iND13400_Init by Extended Init XML Service
          vSetInitFunctionInstance: vSetConfigPtrName=NULL_PTR, vSetInitPhase=INIT_TWO_POST_NVMREADALL
        Crypto_182_iND13400_Init: vSetHeader=Crypto_182_iND13400.h, vSetConfigType=Crypto_ConfigType, vSetConfigPtrClass=CRYPTO_CONST, vSetModuleRef=Crypto, variation-point=post-build-variant-condition{matching-criterion=RDR_POS, value=0}  # /ActiveEcuC/Crypto PLAIN_TEXT Initializes Crypto module
          vSetInitFunctionInstance: vSetConfigPtrName=NULL_PTR, vSetInitPhase=INIT_TWO_POST_NVMREADALL
        Crypto_182_iND13400_Init: vSetHeader=Crypto_182_iND13400.h, vSetConfigType=Crypto_ConfigType, vSetConfigPtrClass=CRYPTO_CONST, vSetModuleRef=Crypto, variation-point=post-build-variant-condition{matching-criterion=RDR_POS, value=5}  # /ActiveEcuC/Crypto PLAIN_TEXT Created Crypto_182_iND13400_Init by Extended Init XML Service
          vSetInitFunctionInstance: vSetConfigPtrName=NULL_PTR, vSetInitPhase=INIT_TWO_POST_NVMREADALL
        Crypto_182_iND13400_Init: vSetHeader=Crypto_182_iND13400.h, vSetConfigType=Crypto_ConfigType, vSetConfigPtrClass=CRYPTO_CONST, vSetModuleRef=Crypto, variation-point=post-build-variant-condition{matching-criterion=RDR_POS, value=2}  # /ActiveEcuC/Crypto PLAIN_TEXT Created Crypto_182_iND13400_Init by Extended Init XML Service
          vSetInitFunctionInstance: vSetConfigPtrName=NULL_PTR, vSetInitPhase=INIT_TWO_POST_NVMREADALL
        Det_Start: vSetHeader=Det.h, vSetModuleRef=Det  # /ActiveEcuC/Det PLAIN_TEXT PostInit function description of Det in PostBuildInvariantValuesModelView (PostBuildInvariantValuesModelView) .
          vSetInitFunctionInstance: vSetInitPhase=INIT_ONE
        Eth_30_Wrapper_InitMemory: vSetHeader=Eth_30_Wrapper.h, vSetModuleRef=Eth  # /ActiveEcuC/Eth PLAIN_TEXT InitMemory function description of Eth_30_Wrapper in PostBuildInvariantValuesModelView (PostBuildInvariantValuesModelView) .
          vSetInitFunctionInstance: vSetInitPhase=INIT_MEMORY
        vLinkGen_Init: vSetHeader=vLinkGen_Lcfg.h, vSetModuleRef=vLinkGen  # /ActiveEcuC/vLinkGen PLAIN_TEXT Dummy initialization of the vLinkGen
          vSetInitFunctionInstance: vSetInitPhase=NO_INIT
        vBaseEnv_Init: vSetHeader=, vSetModuleRef=vBaseEnv  # /ActiveEcuC/vBaseEnv PLAIN_TEXT Created vBaseEnv_Init by Extended Init XML Service
          vSetInitFunctionInstance: vSetInitPhase=NO_INIT
        Uart_Init: vSetHeader=Uart.h, vSetConfigType=Uart_ConfigType, vSetConfigPtrClass=UART_CONST, vSetModuleRef=Uart, variation-point=post-build-variant-condition{matching-criterion=RDR_POS, value=7}  # /ActiveEcuC/Uart PLAIN_TEXT Created Uart_Init by Extended Init XML Service
          vSetInitFunctionInstance: vSetConfigPtrName=NULL_PTR, vSetInitPhase=INIT_ONE_LATE
        Uart_Init: vSetHeader=Uart.h, vSetConfigType=Uart_ConfigType, vSetConfigPtrClass=UART_CONST, vSetModuleRef=Uart, variation-point=post-build-variant-condition{matching-criterion=RDR_POS, value=6}  # /ActiveEcuC/Uart PLAIN_TEXT Initializes Uart module
          vSetInitFunctionInstance: vSetConfigPtrName=NULL_PTR, vSetInitPhase=INIT_ONE_LATE
        Uart_Init: vSetHeader=Uart.h, vSetConfigType=Uart_ConfigType, vSetConfigPtrClass=UART_CONST, vSetModuleRef=Uart, variation-point=post-build-variant-condition{matching-criterion=RDR_POS, value=3}  # /ActiveEcuC/Uart PLAIN_TEXT Initializes Uart module
          vSetInitFunctionInstance: vSetConfigPtrName=NULL_PTR, vSetInitPhase=INIT_ONE_LATE
        Uart_Init: vSetHeader=Uart.h, vSetConfigType=Uart_ConfigType, vSetConfigPtrClass=UART_CONST, vSetModuleRef=Uart, variation-point=post-build-variant-condition{matching-criterion=RDR_POS, value=1}  # /ActiveEcuC/Uart PLAIN_TEXT Initializes Uart module
          vSetInitFunctionInstance: vSetConfigPtrName=NULL_PTR, vSetInitPhase=INIT_ONE_LATE
        Uart_Init: vSetHeader=Uart.h, vSetConfigType=Uart_ConfigType, vSetConfigPtrClass=UART_CONST, vSetModuleRef=Uart, variation-point=post-build-variant-condition{matching-criterion=RDR_POS, value=4}  # /ActiveEcuC/Uart PLAIN_TEXT Initializes Uart module
          vSetInitFunctionInstance: vSetConfigPtrName=NULL_PTR, vSetInitPhase=INIT_ONE_LATE
        Uart_Init: vSetHeader=Uart.h, vSetConfigType=Uart_ConfigType, vSetConfigPtrClass=UART_CONST, vSetModuleRef=Uart, variation-point=post-build-variant-condition{matching-criterion=RDR_POS, value=0}  # /ActiveEcuC/Uart PLAIN_TEXT Initializes Uart module
          vSetInitFunctionInstance: vSetConfigPtrName=NULL_PTR, vSetInitPhase=INIT_ONE_LATE
        Uart_Init: vSetHeader=Uart.h, vSetConfigType=Uart_ConfigType, vSetConfigPtrClass=UART_CONST, vSetModuleRef=Uart, variation-point=post-build-variant-condition{matching-criterion=RDR_POS, value=5}  # /ActiveEcuC/Uart PLAIN_TEXT Initializes Uart module
          vSetInitFunctionInstance: vSetConfigPtrName=NULL_PTR, vSetInitPhase=INIT_ONE_LATE
        Uart_Init: vSetHeader=Uart.h, vSetConfigType=Uart_ConfigType, vSetConfigPtrClass=UART_CONST, vSetModuleRef=Uart, variation-point=post-build-variant-condition{matching-criterion=RDR_POS, value=2}  # /ActiveEcuC/Uart PLAIN_TEXT Initializes Uart module
          vSetInitFunctionInstance: vSetConfigPtrName=NULL_PTR, vSetInitPhase=INIT_ONE_LATE
        J1939Tp_Init: vSetHeader=J1939Tp.h, vSetConfigType=J1939Tp_ConfigType, vSetConfigPtrClass=J1939TP_INIT_DATA, vSetModuleRef=J1939Tp  # /ActiveEcuC/J1939Tp PLAIN_TEXT Init function description of J1939Tp in PostBuildPredefinedVariantView (RDR_01) .
          vSetInitFunctionInstance:
            vSetConfigPtrName = J1939Tp_Config_RDR_01_Ptr if post-build-variant-condition{matching-criterion=RDR_POS, value=0}
            vSetInitPhase = INIT_TWO_TP
            vSetConfigPtrName = J1939Tp_Config_RDR_02_Ptr if post-build-variant-condition{matching-criterion=RDR_POS, value=1}
            vSetConfigPtrName = J1939Tp_Config_RDR_03_Ptr if post-build-variant-condition{matching-criterion=RDR_POS, value=2}
            vSetConfigPtrName = J1939Tp_Config_RDR_04_Ptr if post-build-variant-condition{matching-criterion=RDR_POS, value=3}
            vSetConfigPtrName = J1939Tp_Config_RDR_05_Ptr if post-build-variant-condition{matching-criterion=RDR_POS, value=4}
            vSetConfigPtrName = J1939Tp_Config_RDR_06_Ptr if post-build-variant-condition{matching-criterion=RDR_POS, value=5}
            vSetConfigPtrName = J1939Tp_Config_RDR_07_Ptr if post-build-variant-condition{matching-criterion=RDR_POS, value=6}
            vSetConfigPtrName = J1939Tp_Config_RDR_08_Ptr if post-build-variant-condition{matching-criterion=RDR_POS, value=7}
        J1939Tp_InitMemory: vSetHeader=J1939Tp.h, vSetModuleRef=J1939Tp  # /ActiveEcuC/J1939Tp PLAIN_TEXT InitMemory function description of J1939Tp in PostBuildPredefinedVariantView (RDR_01) .
          vSetInitFunctionInstance: vSetInitPhase=INIT_MEMORY
        Dem_Init: vSetHeader=Dem.h, vSetConfigType=Dem_ConfigType, vSetConfigPtrClass=DEM_INIT_DATA, vSetModuleRef=Dem  # /ActiveEcuC/Dem PLAIN_TEXT Init function description of Dem in PostBuildPredefinedVariantView (RDR_01) . Init function description of Dem in PostBuildPredefinedVariantView (RDR_02) . Init function description of Dem in PostBuildPredefinedVariantView (RDR_03) . Init function description of Dem in PostBuildPredefinedVariantView (RDR_04) . Init function description of Dem in PostBuildPredefinedVariantView (RDR_05) . Init function description of Dem in PostBuildPredefinedVariantView (RDR_06) . Init function description of Dem in PostBuildPredefinedVariantView (RDR_07) . Init function description of Dem in PostBuildPredefinedVariantView (RDR_08) .
          vSetInitFunctionInstance:
            vSetConfigPtrName = Dem_Config_RDR_01_Ptr if post-build-variant-condition{matching-criterion=RDR_POS, value=0}
            vSetInitPhase = INIT_TWO_POST_NVMREADALL
            vSetConfigPtrName = Dem_Config_RDR_02_Ptr if post-build-variant-condition{matching-criterion=RDR_POS, value=1}
            vSetConfigPtrName = Dem_Config_RDR_03_Ptr if post-build-variant-condition{matching-criterion=RDR_POS, value=2}
            vSetConfigPtrName = Dem_Config_RDR_04_Ptr if post-build-variant-condition{matching-criterion=RDR_POS, value=3}
            vSetConfigPtrName = Dem_Config_RDR_05_Ptr if post-build-variant-condition{matching-criterion=RDR_POS, value=4}
            vSetConfigPtrName = Dem_Config_RDR_06_Ptr if post-build-variant-condition{matching-criterion=RDR_POS, value=5}
            vSetConfigPtrName = Dem_Config_RDR_07_Ptr if post-build-variant-condition{matching-criterion=RDR_POS, value=6}
            vSetConfigPtrName = Dem_Config_RDR_08_Ptr if post-build-variant-condition{matching-criterion=RDR_POS, value=7}
        Dem_PreInit: vSetHeader=Dem.h, vSetConfigType=Dem_ConfigType, vSetConfigPtrClass=DEM_INIT_DATA, vSetModuleRef=Dem  # /ActiveEcuC/Dem PLAIN_TEXT PreInit function description of Dem in PostBuildPredefinedVariantView (RDR_01) . PreInit function description of Dem in PostBuildPredefinedVariantView (RDR_02) . PreInit function description of Dem in PostBuildPredefinedVariantView (RDR_03) . PreInit function description of Dem in PostBuildPredefinedVariantView (RDR_04) . PreInit function description of Dem in PostBuildPredefinedVariantView (RDR_05) . PreInit function description of Dem in PostBuildPredefinedVariantView (RDR_06) . PreInit function description of Dem in PostBuildPredefinedVariantView (RDR_07) . PreInit function description of Dem in PostBuildPredefinedVariantView (RDR_08) .
          vSetInitFunctionInstance:
            vSetConfigPtrName = Dem_Config_RDR_01_Ptr if post-build-variant-condition{matching-criterion=RDR_POS, value=0}
            vSetInitPhase = INIT_ZERO
            vSetConfigPtrName = Dem_Config_RDR_02_Ptr if post-build-variant-condition{matching-criterion=RDR_POS, value=1}
            vSetConfigPtrName = Dem_Config_RDR_03_Ptr if post-build-variant-condition{matching-criterion=RDR_POS, value=2}
            vSetConfigPtrName = Dem_Config_RDR_04_Ptr if post-build-variant-condition{matching-criterion=RDR_POS, value=3}
            vSetConfigPtrName = Dem_Config_RDR_05_Ptr if post-build-variant-condition{matching-criterion=RDR_POS, value=4}
            vSetConfigPtrName = Dem_Config_RDR_06_Ptr if post-build-variant-condition{matching-criterion=RDR_POS, value=5}
            vSetConfigPtrName = Dem_Config_RDR_07_Ptr if post-build-variant-condition{matching-criterion=RDR_POS, value=6}
            vSetConfigPtrName = Dem_Config_RDR_08_Ptr if post-build-variant-condition{matching-criterion=RDR_POS, value=7}
        Dem_InitMemory: vSetHeader=Dem.h, vSetModuleRef=Dem  # /ActiveEcuC/Dem PLAIN_TEXT InitMemory function description of Dem in PostBuildPredefinedVariantView (RDR_01) .
          vSetInitFunctionInstance: vSetInitPhase=INIT_MEMORY
        J1939Dcm_Init: vSetHeader=J1939Dcm.h, vSetConfigType=J1939Dcm_ConfigType, vSetConfigPtrClass=J1939DCM_INIT_DATA, vSetModuleRef=J1939Dcm  # /ActiveEcuC/J1939Dcm PLAIN_TEXT Init function description of J1939Dcm in PostBuildPredefinedVariantView (RDR_01) .
          vSetInitFunctionInstance: vSetConfigPtrName=J1939Dcm_Config_Ptr, vSetInitPhase=INIT_TWO_POST_NVMREADALL
        J1939Dcm_InitMemory: vSetHeader=J1939Dcm.h, vSetModuleRef=J1939Dcm  # /ActiveEcuC/J1939Dcm PLAIN_TEXT InitMemory function description of J1939Dcm in PostBuildPredefinedVariantView (RDR_01) .
          vSetInitFunctionInstance: vSetInitPhase=INIT_MEMORY
        CanTp_Init: vSetHeader=CanTp.h, vSetConfigType=CanTp_PBConfigType, vSetConfigPtrClass=CANTP_INIT_DATA, vSetModuleRef=CanTp  # /ActiveEcuC/CanTp PLAIN_TEXT Init function description of CanTp in PostBuildPredefinedVariantView (RDR_01) .
          vSetInitFunctionInstance:
            vSetConfigPtrName = CanTp_Config_RDR_01_Ptr if post-build-variant-condition{matching-criterion=RDR_POS, value=0}
            vSetInitPhase = INIT_TWO_TP
            vSetConfigPtrName = CanTp_Config_RDR_02_Ptr if post-build-variant-condition{matching-criterion=RDR_POS, value=1}
            vSetConfigPtrName = CanTp_Config_RDR_03_Ptr if post-build-variant-condition{matching-criterion=RDR_POS, value=2}
            vSetConfigPtrName = CanTp_Config_RDR_04_Ptr if post-build-variant-condition{matching-criterion=RDR_POS, value=3}
            vSetConfigPtrName = CanTp_Config_RDR_05_Ptr if post-build-variant-condition{matching-criterion=RDR_POS, value=4}
            vSetConfigPtrName = CanTp_Config_RDR_06_Ptr if post-build-variant-condition{matching-criterion=RDR_POS, value=5}
            vSetConfigPtrName = CanTp_Config_RDR_07_Ptr if post-build-variant-condition{matching-criterion=RDR_POS, value=6}
            vSetConfigPtrName = CanTp_Config_RDR_08_Ptr if post-build-variant-condition{matching-criterion=RDR_POS, value=7}
        CanTp_PreInit: vSetHeader=CanTp.h, vSetConfigType=CanTp_PBConfigType, vSetConfigPtrClass=CANTP_INIT_DATA, vSetModuleRef=CanTp  # /ActiveEcuC/CanTp PLAIN_TEXT PreInit function description of CanTp in PostBuildPredefinedVariantView (RDR_01) .
          vSetInitFunctionInstance:
            vSetConfigPtrName = CanTp_Config_RDR_01_Ptr if post-build-variant-condition{matching-criterion=RDR_POS, value=0}
            vSetInitPhase = INIT_ONE
            vSetConfigPtrName = CanTp_Config_RDR_02_Ptr if post-build-variant-condition{matching-criterion=RDR_POS, value=1}
            vSetConfigPtrName = CanTp_Config_RDR_03_Ptr if post-build-variant-condition{matching-criterion=RDR_POS, value=2}
            vSetConfigPtrName = CanTp_Config_RDR_04_Ptr if post-build-variant-condition{matching-criterion=RDR_POS, value=3}
            vSetConfigPtrName = CanTp_Config_RDR_05_Ptr if post-build-variant-condition{matching-criterion=RDR_POS, value=4}
            vSetConfigPtrName = CanTp_Config_RDR_06_Ptr if post-build-variant-condition{matching-criterion=RDR_POS, value=5}
            vSetConfigPtrName = CanTp_Config_RDR_07_Ptr if post-build-variant-condition{matching-criterion=RDR_POS, value=6}
            vSetConfigPtrName = CanTp_Config_RDR_08_Ptr if post-build-variant-condition{matching-criterion=RDR_POS, value=7}
        CanTp_InitMemory: vSetHeader=CanTp.h, vSetModuleRef=CanTp  # /ActiveEcuC/CanTp PLAIN_TEXT InitMemory function description of CanTp in PostBuildPredefinedVariantView (RDR_01) .
          vSetInitFunctionInstance: vSetInitPhase=INIT_MEMORY
        Dcm_Init: vSetHeader=Dcm.h, vSetConfigType=Dcm_ConfigType, vSetConfigPtrClass=DCM_CONST, vSetModuleRef=Dcm  # /ActiveEcuC/Dcm PLAIN_TEXT Dcm_Init function description
          vSetInitFunctionInstance:
            vSetInitPhase = INIT_TWO_POST_NVMREADALL
            vSetConfigPtrName = &Dcm_CfgConfig_RDR_01 if post-build-variant-condition{matching-criterion=RDR_POS, value=0}
            vSetConfigPtrName = &Dcm_CfgConfig_RDR_02 if post-build-variant-condition{matching-criterion=RDR_POS, value=1}
            vSetConfigPtrName = &Dcm_CfgConfig_RDR_03 if post-build-variant-condition{matching-criterion=RDR_POS, value=2}
            vSetConfigPtrName = &Dcm_CfgConfig_RDR_04 if post-build-variant-condition{matching-criterion=RDR_POS, value=3}
            vSetConfigPtrName = &Dcm_CfgConfig_RDR_05 if post-build-variant-condition{matching-criterion=RDR_POS, value=4}
            vSetConfigPtrName = &Dcm_CfgConfig_RDR_06 if post-build-variant-condition{matching-criterion=RDR_POS, value=5}
            vSetConfigPtrName = &Dcm_CfgConfig_RDR_07 if post-build-variant-condition{matching-criterion=RDR_POS, value=6}
            vSetConfigPtrName = &Dcm_CfgConfig_RDR_08 if post-build-variant-condition{matching-criterion=RDR_POS, value=7}
        Dcm_InitMemory: vSetHeader=Dcm.h, vSetModuleRef=Dcm  # /ActiveEcuC/Dcm PLAIN_TEXT Dcm_InitMemory function description
          vSetInitFunctionInstance: vSetInitPhase=INIT_MEMORY
        EthTrcv_30_Tja1103_InitMemory: vSetHeader=EthTrcv_30_Tja1103.h, vSetModuleRef=EthTrcv_NXP, variation-point=post-build-variant-condition{matching-criterion=RDR_POS, value=3}  # /ActiveEcuC/EthTrcv_001 PLAIN_TEXT Memory Initialization function of module EthTrcv_30_Tja1103.
          vSetInitFunctionInstance: vSetInitPhase=INIT_MEMORY
        EthTrcv_30_Tja1103_InitMemory: vSetHeader=EthTrcv_30_Tja1103.h, vSetModuleRef=EthTrcv_NXP, variation-point=post-build-variant-condition{matching-criterion=RDR_POS, value=6}  # /ActiveEcuC/EthTrcv_NXP PLAIN_TEXT Memory Initialization function of module EthTrcv_30_Tja1103.
          vSetInitFunctionInstance: vSetInitPhase=INIT_MEMORY
        EthTrcv_30_Tja1103_InitMemory: vSetHeader=EthTrcv_30_Tja1103.h, vSetModuleRef=EthTrcv_NXP, variation-point=post-build-variant-condition{matching-criterion=RDR_POS, value=4}  # /ActiveEcuC/EthTrcv_001 PLAIN_TEXT Memory Initialization function of module EthTrcv_30_Tja1103.
          vSetInitFunctionInstance: vSetInitPhase=INIT_MEMORY
        EthTrcv_30_Tja1103_InitMemory: vSetHeader=EthTrcv_30_Tja1103.h, vSetModuleRef=EthTrcv_NXP, variation-point=post-build-variant-condition{matching-criterion=RDR_POS, value=1}  # /ActiveEcuC/EthTrcv_001 PLAIN_TEXT Memory Initialization function of module EthTrcv_30_Tja1103.
          vSetInitFunctionInstance: vSetInitPhase=INIT_MEMORY
        EthTrcv_30_Tja1103_InitMemory: vSetHeader=EthTrcv_30_Tja1103.h, vSetModuleRef=EthTrcv_NXP, variation-point=post-build-variant-condition{matching-criterion=RDR_POS, value=7}  # /ActiveEcuC/EthTrcv_001 PLAIN_TEXT Memory Initialization function of module EthTrcv_30_Tja1103.
          vSetInitFunctionInstance: vSetInitPhase=INIT_MEMORY
        EthTrcv_30_Tja1103_InitMemory: vSetHeader=EthTrcv_30_Tja1103.h, vSetModuleRef=EthTrcv_NXP, variation-point=post-build-variant-condition{matching-criterion=RDR_POS, value=0}  # /ActiveEcuC/EthTrcv_001 PLAIN_TEXT Memory Initialization function of module EthTrcv_30_Tja1103.
          vSetInitFunctionInstance: vSetInitPhase=INIT_MEMORY
        EthTrcv_30_Tja1103_InitMemory: vSetHeader=EthTrcv_30_Tja1103.h, vSetModuleRef=EthTrcv_NXP, variation-point=post-build-variant-condition{matching-criterion=RDR_POS, value=5}  # /ActiveEcuC/EthTrcv_001 PLAIN_TEXT Memory Initialization function of module EthTrcv_30_Tja1103.
          vSetInitFunctionInstance: vSetInitPhase=INIT_MEMORY
        EthTrcv_30_Tja1103_InitMemory: vSetHeader=EthTrcv_30_Tja1103.h, vSetModuleRef=EthTrcv_NXP, variation-point=post-build-variant-condition{matching-criterion=RDR_POS, value=2}  # /ActiveEcuC/EthTrcv_001 PLAIN_TEXT Memory Initialization function of module EthTrcv_30_Tja1103.
          vSetInitFunctionInstance: vSetInitPhase=INIT_MEMORY
        EthTrcv_30_Tja1103_Init: vSetHeader=EthTrcv_30_Tja1103.h, vSetConfigType=EthTrcv_30_Tja1103_ConfigType, vSetConfigPtrClass=ETHTRCV_30_TJA1103_INIT_DATA, vSetModuleRef=EthTrcv_NXP, variation-point=post-build-variant-condition{matching-criterion=RDR_POS, value=3}  # /ActiveEcuC/EthTrcv_001 PLAIN_TEXT Module Initialization function of module EthTrcv_30_Tja1103.
          vSetInitFunctionInstance: vSetInitPhase=INIT_TWO_TRCV, vSetConfigPtrName=EthTrcv_30_Tja1103_Config_Ptr
        EthTrcv_30_Tja1103_Init: vSetHeader=EthTrcv_30_Tja1103.h, vSetConfigType=EthTrcv_30_Tja1103_ConfigType, vSetConfigPtrClass=ETHTRCV_30_TJA1103_INIT_DATA, vSetModuleRef=EthTrcv_NXP, variation-point=post-build-variant-condition{matching-criterion=RDR_POS, value=6}  # /ActiveEcuC/EthTrcv_NXP PLAIN_TEXT Module Initialization function of module EthTrcv_30_Tja1103.
          vSetInitFunctionInstance: vSetConfigPtrName=EthTrcv_30_Tja1103_Config_Ptr, vSetInitPhase=INIT_TWO_TRCV
        EthTrcv_30_Tja1103_Init: vSetHeader=EthTrcv_30_Tja1103.h, vSetConfigType=EthTrcv_30_Tja1103_ConfigType, vSetConfigPtrClass=ETHTRCV_30_TJA1103_INIT_DATA, vSetModuleRef=EthTrcv_NXP, variation-point=post-build-variant-condition{matching-criterion=RDR_POS, value=4}  # /ActiveEcuC/EthTrcv_001 PLAIN_TEXT Module Initialization function of module EthTrcv_30_Tja1103.
          vSetInitFunctionInstance: vSetConfigPtrName=EthTrcv_30_Tja1103_Config_Ptr, vSetInitPhase=INIT_TWO_TRCV
        EthTrcv_30_Tja1103_Init: vSetHeader=EthTrcv_30_Tja1103.h, vSetConfigType=EthTrcv_30_Tja1103_ConfigType, vSetConfigPtrClass=ETHTRCV_30_TJA1103_INIT_DATA, vSetModuleRef=EthTrcv_NXP, variation-point=post-build-variant-condition{matching-criterion=RDR_POS, value=1}  # /ActiveEcuC/EthTrcv_001 PLAIN_TEXT Module Initialization function of module EthTrcv_30_Tja1103.
          vSetInitFunctionInstance: vSetConfigPtrName=EthTrcv_30_Tja1103_Config_Ptr, vSetInitPhase=INIT_TWO_TRCV
        EthTrcv_30_Tja1103_Init: vSetHeader=EthTrcv_30_Tja1103.h, vSetConfigType=EthTrcv_30_Tja1103_ConfigType, vSetConfigPtrClass=ETHTRCV_30_TJA1103_INIT_DATA, vSetModuleRef=EthTrcv_NXP, variation-point=post-build-variant-condition{matching-criterion=RDR_POS, value=7}  # /ActiveEcuC/EthTrcv_001 PLAIN_TEXT Module Initialization function of module EthTrcv_30_Tja1103.
          vSetInitFunctionInstance: vSetConfigPtrName=EthTrcv_30_Tja1103_Config_Ptr, vSetInitPhase=INIT_TWO_TRCV
        EthTrcv_30_Tja1103_Init: vSetHeader=EthTrcv_30_Tja1103.h, vSetConfigType=EthTrcv_30_Tja1103_ConfigType, vSetConfigPtrClass=ETHTRCV_30_TJA1103_INIT_DATA, vSetModuleRef=EthTrcv_NXP, variation-point=post-build-variant-condition{matching-criterion=RDR_POS, value=0}  # /ActiveEcuC/EthTrcv_001 PLAIN_TEXT Module Initialization function of module EthTrcv_30_Tja1103.
          vSetInitFunctionInstance: vSetConfigPtrName=EthTrcv_30_Tja1103_Config_Ptr, vSetInitPhase=INIT_TWO_TRCV
        EthTrcv_30_Tja1103_Init: vSetHeader=EthTrcv_30_Tja1103.h, vSetConfigType=EthTrcv_30_Tja1103_ConfigType, vSetConfigPtrClass=ETHTRCV_30_TJA1103_INIT_DATA, vSetModuleRef=EthTrcv_NXP, variation-point=post-build-variant-condition{matching-criterion=RDR_POS, value=5}  # /ActiveEcuC/EthTrcv_001 PLAIN_TEXT Module Initialization function of module EthTrcv_30_Tja1103.
          vSetInitFunctionInstance: vSetConfigPtrName=EthTrcv_30_Tja1103_Config_Ptr, vSetInitPhase=INIT_TWO_TRCV
        EthTrcv_30_Tja1103_Init: vSetHeader=EthTrcv_30_Tja1103.h, vSetConfigType=EthTrcv_30_Tja1103_ConfigType, vSetConfigPtrClass=ETHTRCV_30_TJA1103_INIT_DATA, vSetModuleRef=EthTrcv_NXP, variation-point=post-build-variant-condition{matching-criterion=RDR_POS, value=2}  # /ActiveEcuC/EthTrcv_001 PLAIN_TEXT Module Initialization function of module EthTrcv_30_Tja1103.
          vSetInitFunctionInstance: vSetConfigPtrName=EthTrcv_30_Tja1103_Config_Ptr, vSetInitPhase=INIT_TWO_TRCV
        Wdg_182_iND13400_Init: vSetHeader=Wdg_182_iND13400.h, vSetConfigType=Wdg_182_iND13400_ConfigType, vSetConfigPtrClass=WDG_CONST, vSetModuleRef=Wdg  # /ActiveEcuC/Wdg PLAIN_TEXT Initializes Wdg module
          vSetInitFunctionInstance: vSetInitPhase=INIT_ONE_LATE, vSetConfigPtrName=NULL_PTR
        E2EXf_InitMemory: vSetHeader=E2EXf.h, vSetModuleRef=E2EXf, variation-point=post-build-variant-condition{matching-criterion=RDR_POS, value=2}  # /ActiveEcuC/E2EXf PLAIN_TEXT Automatically generated by BswInitFctConfigurationService.
          vSetInitFunctionInstance: vSetInitPhase=INIT_MEMORY
        E2EXf_InitMemory: vSetHeader=E2EXf.h, vSetModuleRef=E2EXf, variation-point=post-build-variant-condition{matching-criterion=RDR_POS, value=1}  # /ActiveEcuC/E2EXf PLAIN_TEXT Automatically generated by BswInitFctConfigurationService.
          vSetInitFunctionInstance: vSetInitPhase=INIT_MEMORY
        E2EXf_InitMemory: vSetHeader=E2EXf.h, vSetModuleRef=E2EXf, variation-point=post-build-variant-condition{matching-criterion=RDR_POS, value=5}  # /ActiveEcuC/E2EXf PLAIN_TEXT Automatically generated by BswInitFctConfigurationService.
          vSetInitFunctionInstance: vSetInitPhase=INIT_MEMORY
        E2EXf_InitMemory: vSetHeader=E2EXf.h, vSetModuleRef=E2EXf, variation-point=post-build-variant-condition{matching-criterion=RDR_POS, value=3}  # /ActiveEcuC/E2EXf PLAIN_TEXT Automatically generated by BswInitFctConfigurationService.
          vSetInitFunctionInstance: vSetInitPhase=INIT_MEMORY
        E2EXf_InitMemory: vSetHeader=E2EXf.h, vSetModuleRef=E2EXf, variation-point=post-build-variant-condition{matching-criterion=RDR_POS, value=0}  # /ActiveEcuC/E2EXf PLAIN_TEXT Automatically generated by BswInitFctConfigurationService.
          vSetInitFunctionInstance: vSetInitPhase=INIT_MEMORY
        E2EXf_InitMemory: vSetHeader=E2EXf.h, vSetModuleRef=E2EXf, variation-point=post-build-variant-condition{matching-criterion=RDR_POS, value=7}  # /ActiveEcuC/E2EXf PLAIN_TEXT Automatically generated by BswInitFctConfigurationService.
          vSetInitFunctionInstance: vSetInitPhase=INIT_MEMORY
        E2EXf_InitMemory: vSetHeader=E2EXf.h, vSetModuleRef=E2EXf, variation-point=post-build-variant-condition{matching-criterion=RDR_POS, value=6}  # /ActiveEcuC/E2EXf PLAIN_TEXT Automatically generated by BswInitFctConfigurationService.
          vSetInitFunctionInstance: vSetInitPhase=INIT_MEMORY
        E2EXf_InitMemory: vSetHeader=E2EXf.h, vSetModuleRef=E2EXf, variation-point=post-build-variant-condition{matching-criterion=RDR_POS, value=4}  # /ActiveEcuC/E2EXf PLAIN_TEXT Automatically generated by BswInitFctConfigurationService.
          vSetInitFunctionInstance: vSetInitPhase=INIT_MEMORY
        E2EXf_Init: vSetHeader=E2EXf.h, vSetConfigType=E2EXf_ConfigType, vSetConfigPtrClass=E2EXF_PBCFG, vSetModuleRef=E2EXf, variation-point=post-build-variant-condition{matching-criterion=RDR_POS, value=2}  # /ActiveEcuC/E2EXf PLAIN_TEXT Automatically generated by BswInitFctConfigurationService.
          vSetInitFunctionInstance: vSetInitPhase=INIT_ONE, vSetConfigPtrName=NULL_PTR
        E2EXf_Init: vSetHeader=E2EXf.h, vSetConfigType=E2EXf_ConfigType, vSetConfigPtrClass=E2EXF_PBCFG, vSetModuleRef=E2EXf, variation-point=post-build-variant-condition{matching-criterion=RDR_POS, value=1}  # /ActiveEcuC/E2EXf PLAIN_TEXT Automatically generated by BswInitFctConfigurationService.
          vSetInitFunctionInstance: vSetConfigPtrName=NULL_PTR, vSetInitPhase=INIT_ONE
        E2EXf_Init: vSetHeader=E2EXf.h, vSetConfigType=E2EXf_ConfigType, vSetConfigPtrClass=E2EXF_PBCFG, vSetModuleRef=E2EXf, variation-point=post-build-variant-condition{matching-criterion=RDR_POS, value=5}  # /ActiveEcuC/E2EXf PLAIN_TEXT Automatically generated by BswInitFctConfigurationService.
          vSetInitFunctionInstance: vSetConfigPtrName=NULL_PTR, vSetInitPhase=INIT_ONE
        E2EXf_Init: vSetHeader=E2EXf.h, vSetConfigType=E2EXf_ConfigType, vSetConfigPtrClass=E2EXF_PBCFG, vSetModuleRef=E2EXf, variation-point=post-build-variant-condition{matching-criterion=RDR_POS, value=3}  # /ActiveEcuC/E2EXf PLAIN_TEXT Automatically generated by BswInitFctConfigurationService.
          vSetInitFunctionInstance: vSetConfigPtrName=NULL_PTR, vSetInitPhase=INIT_ONE
        E2EXf_Init: vSetHeader=E2EXf.h, vSetConfigType=E2EXf_ConfigType, vSetConfigPtrClass=E2EXF_PBCFG, vSetModuleRef=E2EXf, variation-point=post-build-variant-condition{matching-criterion=RDR_POS, value=0}  # /ActiveEcuC/E2EXf PLAIN_TEXT Automatically generated by BswInitFctConfigurationService.
          vSetInitFunctionInstance: vSetConfigPtrName=NULL_PTR, vSetInitPhase=INIT_ONE
        E2EXf_Init: vSetHeader=E2EXf.h, vSetConfigType=E2EXf_ConfigType, vSetConfigPtrClass=E2EXF_PBCFG, vSetModuleRef=E2EXf, variation-point=post-build-variant-condition{matching-criterion=RDR_POS, value=7}  # /ActiveEcuC/E2EXf PLAIN_TEXT Automatically generated by BswInitFctConfigurationService.
          vSetInitFunctionInstance: vSetConfigPtrName=NULL_PTR, vSetInitPhase=INIT_ONE
        E2EXf_Init: vSetHeader=E2EXf.h, vSetConfigType=E2EXf_ConfigType, vSetConfigPtrClass=E2EXF_PBCFG, vSetModuleRef=E2EXf, variation-point=post-build-variant-condition{matching-criterion=RDR_POS, value=6}  # /ActiveEcuC/E2EXf PLAIN_TEXT Automatically generated by BswInitFctConfigurationService.
          vSetInitFunctionInstance: vSetConfigPtrName=NULL_PTR, vSetInitPhase=INIT_ONE
        E2EXf_Init: vSetHeader=E2EXf.h, vSetConfigType=E2EXf_ConfigType, vSetConfigPtrClass=E2EXF_PBCFG, vSetModuleRef=E2EXf, variation-point=post-build-variant-condition{matching-criterion=RDR_POS, value=4}  # /ActiveEcuC/E2EXf PLAIN_TEXT Automatically generated by BswInitFctConfigurationService.
          vSetInitFunctionInstance: vSetConfigPtrName=NULL_PTR, vSetInitPhase=INIT_ONE
        Can_Init: vSetHeader=Can.h, vSetConfigType=Can_ConfigType, vSetConfigPtrClass=CAN_CONST, vSetModuleRef=Can, variation-point=post-build-variant-condition{matching-criterion=RDR_POS, value=0}  # /ActiveEcuC/Can PLAIN_TEXT Initializes Can module
          vSetInitFunctionInstance: vSetInitPhase=INIT_TWO_DRV, vSetConfigPtrName=NULL_PTR
        Can_Init: vSetHeader=Can.h, vSetConfigType=Can_ConfigType, vSetConfigPtrClass=CAN_CONST, vSetModuleRef=Can, variation-point=post-build-variant-condition{matching-criterion=RDR_POS, value=2}
          vSetInitFunctionInstance: vSetInitPhase=INIT_TWO_DRV, vSetConfigPtrName=NULL_PTR
        Can_Init: vSetHeader=Can.h, vSetConfigType=Can_ConfigType, vSetConfigPtrClass=CAN_CONST, vSetModuleRef=Can, variation-point=post-build-variant-condition{matching-criterion=RDR_POS, value=3}
          vSetInitFunctionInstance: vSetInitPhase=INIT_TWO_DRV, vSetConfigPtrName=NULL_PTR
        Can_Init: vSetHeader=Can.h, vSetConfigType=Can_ConfigType, vSetConfigPtrClass=CAN_CONST, vSetModuleRef=Can, variation-point=post-build-variant-condition{matching-criterion=RDR_POS, value=5}
          vSetInitFunctionInstance: vSetInitPhase=INIT_TWO_DRV, vSetConfigPtrName=NULL_PTR
        Can_Init: vSetHeader=Can.h, vSetConfigType=Can_ConfigType, vSetConfigPtrClass=CAN_CONST, vSetModuleRef=Can, variation-point=post-build-variant-condition{matching-criterion=RDR_POS, value=7}
          vSetInitFunctionInstance: vSetInitPhase=INIT_TWO_DRV, vSetConfigPtrName=NULL_PTR
        Dio_Init: vSetHeader=Dio.h, vSetConfigType=Dio_ConfigType, vSetConfigPtrClass=DIO_CONST, vSetModuleRef=Dio, variation-point=post-build-variant-condition{matching-criterion=RDR_POS, value=0}  # /ActiveEcuC/Dio PLAIN_TEXT Initializes Dio module
          vSetInitFunctionInstance: vSetInitPhase=NO_INIT, vSetConfigPtrName=NULL_PTR
        Dio_Init: vSetHeader=Dio.h, vSetConfigType=Dio_ConfigType, vSetConfigPtrClass=DIO_CONST, vSetModuleRef=Dio, variation-point=post-build-variant-condition{matching-criterion=RDR_POS, value=4}
          vSetInitFunctionInstance: vSetInitPhase=NO_INIT, vSetConfigPtrName=NULL_PTR
        Port_Init: vSetHeader=Port.h, vSetConfigType=Port_ConfigType, vSetConfigPtrClass=PORT_CONST, vSetModuleRef=Port, variation-point=post-build-variant-condition{matching-criterion=RDR_POS, value=7}  # /ActiveEcuC/Port PLAIN_TEXT Initializes Port driver
          vSetInitFunctionInstance: vSetInitPhase=INIT_ONE, vSetConfigPtrName=NULL_PTR
