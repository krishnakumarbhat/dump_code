AUTOSAR XML (schema 00053)
package /ActiveEcuC
  module config StbM: implementation-config-variant=VARIANT-PRE-COMPILE, module-description=StbM_Impl
    StbMGeneral: StbMSafeBswChecks=true, StbMDevErrorDetect=true, StbMMainFunctionPeriod=0.01, StbMTimeRecordingSupport=true, StbMVersionInfoApi=false
    StbMSynchronizedTimeBase:
      StbMIsSystemWideGlobalTimeMaster = false
      StbMSynchronizedTimeBaseIdentifier = 0
      StbMStatusNotificationCallback = StbMStatusNotificationCallback_StbMSynchronizedTimeBase
      StbMStatusNotificationMask = 514
      StbMStoreTimebaseNonVolatile = NO_STORAGE
      StbMSyncLossTimeout = 3
      StbMTimeLeapFutureThreshold = 0.01
      StbMTimeLeapPastThreshold = 0.01
      StbMClearTimeleapCount = 1
      StbMOsApplicationRef = OsCore0_ASIL
      StbMLocalTimeClock: StbMClockFrequency=100000000, StbMClockPrescaler=1, StbMLocalTimeHardware=StbM_Local_Timer_Ch
      StbMTimeCorrection: StbMOffsetCorrectionAdaptionInterval=0.005, StbMOffsetCorrectionJumpThreshold=0, StbMRateCorrectionMeasurementDuration=0
      StbMTimeRecording: StbMOffsetTimeRecordTableBlockCount=0, StbMSyncTimeRecordTableBlockCount=1, StbMSyncTimeRecordBlockCallback=TimeRecordBlock_Callback
    StbMSynchronizedTimeBase_CanTsync (StbMSynchronizedTimeBase):
      StbMSynchronizedTimeBaseIdentifier = 1
      StbMClearTimeleapCount = 1
      StbMStatusNotificationMask = 514
      StbMStoreTimebaseNonVolatile = NO_STORAGE
      StbMSyncLossTimeout = 10
      StbMTimeLeapFutureThreshold = 0.01
      StbMTimeLeapPastThreshold = 0.01
      StbMIsSystemWideGlobalTimeMaster = false if post-build-variant-condition{matching-criterion=RDR_POS, value=0}
      StbMIsSystemWideGlobalTimeMaster = true if post-build-variant-condition{matching-criterion=RDR_POS, value=4}
      StbMIsSystemWideGlobalTimeMaster = false if post-build-variant-condition{matching-criterion=RDR_POS, value={1..3}}
      StbMIsSystemWideGlobalTimeMaster = false if post-build-variant-condition{matching-criterion=RDR_POS, value={5..7}}
      StbMOsApplicationRef = OsCore0_ASIL
      StbMLocalTimeClock: StbMClockFrequency=100000000, StbMClockPrescaler=1, StbMLocalTimeHardware=StbM_Local_Timer_Ch
      StbMTimeCorrection: StbMOffsetCorrectionAdaptionInterval=0.005, StbMOffsetCorrectionJumpThreshold=0, StbMRateCorrectionMeasurementDuration=0
      StbMTimeRecording: StbMOffsetTimeRecordTableBlockCount=0, StbMSyncTimeRecordTableBlockCount=1, StbMSyncTimeRecordBlockCallback=TimeRecordTsync_Callback
