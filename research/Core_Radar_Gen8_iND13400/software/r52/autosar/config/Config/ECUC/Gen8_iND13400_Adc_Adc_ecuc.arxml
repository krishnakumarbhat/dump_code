AUTOSAR XML (schema 00053)
package /ActiveEcuC
  module config Adc: implementation-config-variant=VARIANT-PRE-COMPILE, module-description=Adc_Impl
    AdcConfigSet
      AdcHwUnit: AdcHwUnitId=AdcHwUnit_0, AdcPrescale=2, AdcClockSource=clk_gpadc
        BOARD_REV (AdcChannel):
          AdcChannelId = 0
          AdcChannelSampTime = 255
          AdcChannelHighLimit = 4095
          AdcChannelLowLimit = 0
          AdcChannelRangeSelect = ADC_RANGE_ALWAYS
          AdcChannelLimitCheck = false
          AdcChannelResolution = 12
        AdcGroup:
          AdcGroupAccessMode = ADC_ACCESS_MODE_SINGLE
          AdcGroupConversionMode = ADC_CONV_MODE_CONTINUOUS
          AdcGroupId = 0
          AdcGroupTriggSrc = ADC_TRIGG_SRC_SW
          AdcStreamingBufferMode = ADC_STREAM_BUFFER_LINEAR
          AdcStreamingNumSamples = 1
          AdcNotification = IoHwAb_AdcNotification
          AdcGroupDefinition = ADC_BATT
          AdcGroupDefinition = ADC_POS_GND_B
          AdcGroupDefinition = BOARD_REV
          AdcGroupDefinition = ADC_POS_GND_A
          AdcGroupDefinition = ADC_BATT_I_SENSE
          AdcGroupDefinition = ADC_IGN
          AdcGroupDefinition = ADC_POS_GND_D
          AdcGroupDefinition = ADC_MCU_TEMP
          AdcGroupDefinition = ADC_POS_GND_C
          AdcGroupDefinition = ADC_RDI_DETECT
        9 x AdcChannel, all with AdcChannelSampTime=255, AdcChannelHighLimit=4095, AdcChannelLowLimit=0, AdcChannelRangeSelect=ADC_RANGE_ALWAYS, AdcChannelLimitCheck=false, AdcChannelResolution=12:
          ADC_BATT: AdcChannelId=1
          ADC_POS_GND_A: AdcChannelId=2
          ADC_POS_GND_B: AdcChannelId=3
          ADC_IGN: AdcChannelId=4
          ADC_POS_GND_D: AdcChannelId=5
          ADC_BATT_I_SENSE: AdcChannelId=6
          ADC_RDI_DETECT: AdcChannelId=7
          ADC_POS_GND_C: AdcChannelId=8
          ADC_MCU_TEMP: AdcChannelId=9
    AdcGeneral:
      AdcDeInitApi = true
      AdcDevErrorDetect = false
      AdcEnableLimitCheck = true
      AdcEnableStartStopGroupApi = true
      AdcGrpNotifCapability = true
      AdcReadGroupApi = true
      AdcResultAlignment = ADC_ALIGN_RIGHT
      AdcVersionInfoApi = true
      AdcBaseAddressSYSMEM0 = 2147483648
      AdcBaseAddressSYSMEM1 = 2181038080
      AdcBaseAddressARTIEMEM = 2441084928
      AdcHwMemoryAllocation = ARTIEMEM
      AdcHwMemoryOffset = 0
      AdcOffsetCorrectionCalculation = true
      AdcEnableQueuing = false
      AdcPriorityImplementation = ADC_PRIORITY_NONE
      AdcLowPowerStatesSupport = false
      AdcHwTriggerApi = false
      AdcPowerStateAsynchTransitionMode = false
      AdcBaseAddressDRAM0 = 2214592512
      AdcBaseAddressDRAM1 = 2214658048
      AdcBuiltInTestEnable = false
      AdcBuiltInTestAPI = true
      AdcBuiltInTestInitEnable = false
      AdcSafetyEnable = false
      AdcSafetyUserCallOut = NULL_PTR
      AdcSafetyFUSAEnable = false
      AdcSafetyAHBEnable = false
    AdcPublishedInformation: AdcChannelValueSigned=false, AdcGroupFirstChannelFixed=false, AdcMaxChannelResolution=12
