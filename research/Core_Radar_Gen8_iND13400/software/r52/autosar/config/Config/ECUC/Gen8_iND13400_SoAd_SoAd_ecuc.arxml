AUTOSAR XML (schema 00053)
package /ActiveEcuC
  module config SoAd: implementation-config-variant=VARIANT-PRE-COMPILE, module-description=SoAd_Impl
    SoAdConfig
      SoAdInstance:
        SoAdSocketConnectionGroupRef = ConnectionBundle2_4159d201
        SoAdSocketConnectionGroupRef = ConnectionBundle4_a83a7734
        SoAdSocketConnectionGroupRef = ConnectionBundle_ADAS_6b786f6d
        SoAdSocketConnectionGroupRef = ConnectionBundle_RDR_1_1c1a30fe
        SoAdSocketConnectionGroupRef = ConnectionBundle_RDR_Logging
        SoAdSocketConnectionGroupRef = SoAdSocketConnectionGroup_XCP
        SoAdSocketConnectionGroupRef = SoAdSocketConnectionGroup_HIL
      RDR_LOGGING_TX (SoAdPduRoute):
        SoAdTxPduId = 2
        SoAdTxUpperLayerType = IF
        SoAdTxPduCollectionSemantics = SOAD_COLLECT_QUEUED
        SoAdTxIfOptimisticTransmit = false
        SoAdTxIfOptimized = false
        SoAdTxIfTriggerTransmit = false
        SoAdTxPduRef = RDR_LOGGING_TX
        SoAdPduRouteDest:
          SoAdTxUdpTriggerMode = TRIGGER_ALWAYS
          SoAdTxSocketConnOrSocketConnBundleRef = ConnectionBundle_RDR_1_94fef815_001
          SoAdTxRoutingGroupRef = SoAdRoutingGroup
      RDR_ETH_XCP_TX (SoAdPduRoute):
        SoAdTxPduId = 1
        SoAdTxUpperLayerType = IF
        SoAdTxPduCollectionSemantics = SOAD_COLLECT_QUEUED
        SoAdTxIfOptimisticTransmit = false
        SoAdTxIfOptimized = false
        SoAdTxIfTriggerTransmit = false
        SoAdTxPduRef = RDR_XCP_ETH_TX
        SoAdPduRouteDest: SoAdTxUdpTriggerMode=TRIGGER_ALWAYS, SoAdTxSocketConnOrSocketConnBundleRef=SoAdSocketConnection_XCP, SoAdTxRoutingGroupRef=SoAdRoutingGroup
      SoAdSocketConnectionGroup_XCP (SoAdSocketConnectionGroup):
        SoAdPduHeaderEnable = false
        SoAdSocketAutomaticSoConSetup = true
        SoAdSocketIpAddrAssignmentChgNotification = false
        SoAdSocketLocalPort = 5557
        SoAdSocketMsgAcceptanceFilterEnabled = true
        SoAdSocketSoConModeChgNotification = true
        SoAdBestMatchWithSockRouteEnabled = true
        SoAdBestMatchWithPduHeaderEnabled = false
        SoAdSocketAutomaticSoConSetupKeepOnline = true
        SoAdSocketLocalAddressRef = NEP_SRR_1_RdrNet_Unicast_48476027
        SoAdSocketConnection_XCP (SoAdSocketConnection): SoAdSocketId=8, SoAdSocketGetReceivedRemoteAddressEnabled=false, SoAdVerifyRxPduEnable=false
          SoAdSocketRemoteAddress: SoAdSocketRemoteIpAddress=, SoAdSocketRemotePort=65000, SoAdSocketRemoteIpAddressNotSet=false, SoAdSocketRemotePortNotSet=false
        SoAdSocketProtocol
          SoAdSocketUdp:
            SoAdSocketUdpListenOnly = false
            SoAdSocketUdpStrictHeaderLenCheckEnabled = false
            SoAdSocketUdpChecksumEnabled = false
            SoAdSocketUdpAddressResolutionRetryEnabled = true
            SoAdSocketUdpImmediateIfTxConfirmation = false
            SoAdSocketUdpAddressResolutionRetryQueueLimit = 1
            SoAdSocketUdpChecksumChangeEnabled = false
            SoAdSocketUdpAliveSupervisionTimeout = 5
      SoAdSocketRoute_XCP_BSW (SoAdSocketRoute): SoAdRxSocketConnOrSocketConnBundleRef=SoAdSocketConnection_XCP
        SoAdSocketRouteDest_XCP_RX_Eth (SoAdSocketRouteDest): SoAdRxUpperLayerType=IF, SoAdRxPduId=5, SoAdRxPduRef=RDR_XCP_ETH_RX, SoAdRxRoutingGroupRef=SoAdRoutingGroup
      SoAdRoutingGroup: SoAdRoutingGroupId=0, SoAdRoutingGroupIsEnabledAtInit=true, SoAdRoutingGroupTxTriggerable=false
      SoAdSocketRoute_VEH_UDP_RX (SoAdSocketRoute): SoAdRxSocketConnOrSocketConnBundleRef=SoAdSocketConnection_Veh_Rx_001
        SoAdSocketRouteDest_Veh_UDP_Rx (SoAdSocketRouteDest): SoAdRxUpperLayerType=IF, SoAdRxPduId=4, SoAdRxPduRef=RDR_VEH_UDP_STREAM_RX
      signalPdu_RDR_1_Detections_Transport_d322aa23_Tx (SoAdPduRoute):
        SoAdTxPduId = 5
        SoAdTxUpperLayerType = IF
        SoAdTxPduCollectionSemantics = SOAD_COLLECT_QUEUED
        SoAdTxIfOptimisticTransmit = true
        SoAdTxIfOptimized = true
        SoAdTxIfTriggerTransmit = true
        SoAdTxIfTriggerTransmitForceSingleCall = true
        SoAdTxPduRef = signalPdu_RDR_1_Detections_Transport_d322aa23_Tx
        ConnectionBundle_RDR_1_94fef815 (SoAdPduRouteDest):
          SoAdTxPduHeaderId = 1081345
          SoAdTxRoutingGroupRef = SoAdRoutingGroup2_be5f5f2f
          SoAdTxSocketConnOrSocketConnBundleRef = ConnectionBundle_RDR_1_1c1a30fe/ConnectionBundle_RDR_1_94fef815
      SoAdRoutingGroup4_573cfa1a (SoAdRoutingGroup): SoAdRoutingGroupId=4, SoAdRoutingGroupIsEnabledAtInit=false, SoAdRoutingGroupTxTriggerable=false
      ConnectionBundle2_4159d201 (SoAdSocketConnectionGroup):
        SoAdPduHeaderEnable = true
        SoAdSocketLocalPort = 30490
        SoAdSocketAutomaticSoConSetup = false
        SoAdSocketIpAddrAssignmentChgNotification = true
        SoAdSocketMsgAcceptanceFilterEnabled = false
        SoAdSocketSoConModeChgNotification = true
        SoAdBestMatchWithSockRouteEnabled = true
        SoAdBestMatchWithPduHeaderEnabled = true
        SoAdSocketAutomaticSoConSetupKeepOnline = false
        SoAdSocketLocalAddressRef = NEP_SRR_1_RdrNet_Unicast_48476027
        ConnectionBundle2_14f4c9c7 (SoAdSocketConnection): SoAdSocketId=0, SoAdSocketGetReceivedRemoteAddressEnabled=true, SoAdVerifyRxPduEnable=false
          SoAdSocketRemoteAddress: SoAdSocketRemotePort=0, SoAdSocketRemoteIpAddress=, SoAdSocketRemoteIpAddressNotSet=false, SoAdSocketRemotePortNotSet=false
        SoAdSocketProtocol
          SoAdSocketUdp:
            SoAdSocketUdpListenOnly = false
            SoAdSocketUdpStrictHeaderLenCheckEnabled = false
            SoAdSocketUdpChecksumEnabled = true
            SoAdSocketUdpAddressResolutionRetryEnabled = true
            SoAdSocketUdpImmediateIfTxConfirmation = false
            SoAdSocketUdpAddressResolutionRetryQueueLimit = 1
            SoAdSocketUdpChecksumChangeEnabled = false
      ConnectionBundle_ADAS_81eeb70b_Rx (SoAdSocketRoute): SoAdRxPduHeaderId=16809985, SoAdRxSocketConnOrSocketConnBundleRef=ConnectionBundle_ADAS_53ce198e
        ConnectionBundle_ADAS_f656ca1d (SoAdSocketRouteDest): SoAdRxUpperLayerType=IF, SoAdRxPduId=2, SoAdRxPduRef=signalPdu_ADAS_Vehicle_Status_71b7c213_Rx, SoAdRxRoutingGroupRef=SoAdRoutingGroup1_27560e95
      signalPdu_RDR_1_Status_67c6fd21_Tx (SoAdPduRoute):
        SoAdTxUpperLayerType = IF
        SoAdTxPduId = 7
        SoAdTxPduCollectionSemantics = SOAD_COLLECT_QUEUED
        SoAdTxIfOptimisticTransmit = false
        SoAdTxIfOptimized = false
        SoAdTxIfTriggerTransmit = false
        SoAdTxPduRef = signalPdu_RDR_1_Status_67c6fd21_Tx
        ConnectionBundle_RDR_1_94fef815 (SoAdPduRouteDest):
          SoAdTxPduHeaderId = 1146883
          SoAdTxRoutingGroupRef = SoAdRoutingGroup4_573cfa1a
          SoAdTxSocketConnOrSocketConnBundleRef = ConnectionBundle_RDR_1_1c1a30fe/ConnectionBundle_RDR_1_94fef815
      ConnectionBundle_RDR_1_1c1a30fe (SoAdSocketConnectionGroup):
        SoAdPduHeaderEnable = true
        SoAdSocketLocalPort = 34501
        SoAdSocketAutomaticSoConSetup = false
        SoAdSocketIpAddrAssignmentChgNotification = true
        SoAdSocketMsgAcceptanceFilterEnabled = true
        SoAdSocketSoConModeChgNotification = true
        SoAdBestMatchWithSockRouteEnabled = false
        SoAdBestMatchWithPduHeaderEnabled = false
        SoAdSocketAutomaticSoConSetupKeepOnline = false
        SoAdSocketLocalAddressRef = NEP_SRR_1_RdrNet_Unicast_48476027
        ConnectionBundle_RDR_1_94fef815 (SoAdSocketConnection): SoAdSocketId=3, SoAdSocketGetReceivedRemoteAddressEnabled=false, SoAdVerifyRxPduEnable=false, SoAdAdditionalChgNotificationRef=Sd
          SoAdSocketRemoteAddress: SoAdSocketRemoteIpAddress=192.168.1.100, SoAdSocketRemotePort=30501, SoAdSocketRemoteIpAddressNotSet=false, SoAdSocketRemotePortNotSet=false
        SoAdSocketProtocol
          SoAdSocketUdp:
            SoAdSocketUdpListenOnly = false
            SoAdSocketUdpStrictHeaderLenCheckEnabled = false
            SoAdSocketUdpChecksumEnabled = true
            SoAdSocketUdpAddressResolutionRetryEnabled = true
            SoAdSocketUdpImmediateIfTxConfirmation = false
            SoAdSocketUdpAddressResolutionRetryQueueLimit = 1
            SoAdSocketUdpChecksumChangeEnabled = false
            SoAdSocketUdpAliveSupervisionTimeout = 1
      GenerelPurposePDU3_a3a5c5ac_Tx (SoAdPduRoute):
        SoAdTxUpperLayerType = IF
        SoAdTxPduId = 0
        SoAdTxPduCollectionSemantics = SOAD_COLLECT_QUEUED
        SoAdTxIfTriggerTransmit = false
        SoAdTxIfOptimisticTransmit = false
        SoAdTxIfOptimized = false
        SoAdTxPduRef = GenerelPurposePDU3_a3a5c5ac_Tx
        ConnectionBundle2_14f4c9c7 (SoAdPduRouteDest): SoAdTxPduHeaderId=4294934784, SoAdTxSocketConnOrSocketConnBundleRef=ConnectionBundle2_4159d201/ConnectionBundle2_14f4c9c7
      ConnectionBundle4_a83a7734 (SoAdSocketConnectionGroup):
        SoAdPduHeaderEnable = true
        SoAdSocketLocalPort = 30490
        SoAdSocketAutomaticSoConSetup = false
        SoAdSocketIpAddrAssignmentChgNotification = true
        SoAdSocketMsgAcceptanceFilterEnabled = false
        SoAdSocketSoConModeChgNotification = true
        SoAdBestMatchWithSockRouteEnabled = true
        SoAdBestMatchWithPduHeaderEnabled = true
        SoAdSocketAutomaticSoConSetupKeepOnline = false
        SoAdSocketLocalAddressRef = NEP_ADAS_RdrNet_CtrlRxMulticast_91909614
        SoAdSocketProtocol
          SoAdSocketUdp:
            SoAdSocketUdpListenOnly = false
            SoAdSocketUdpStrictHeaderLenCheckEnabled = false
            SoAdSocketUdpChecksumEnabled = true
            SoAdSocketUdpAddressResolutionRetryEnabled = true
            SoAdSocketUdpImmediateIfTxConfirmation = false
            SoAdSocketUdpAddressResolutionRetryQueueLimit = 1
            SoAdSocketUdpChecksumChangeEnabled = false
        ConnectionBundle4_81a0ef65 (SoAdSocketConnection): SoAdSocketId=1, SoAdSocketGetReceivedRemoteAddressEnabled=true, SoAdVerifyRxPduEnable=false
          SoAdSocketRemoteAddress: SoAdSocketRemotePort=0, SoAdSocketRemoteIpAddress=, SoAdSocketRemoteIpAddressNotSet=false, SoAdSocketRemotePortNotSet=false
      ConnectionBundle2_44e6ad83_Rx (SoAdSocketRoute): SoAdRxPduHeaderId=4294934784, SoAdRxSocketConnOrSocketConnBundleRef=ConnectionBundle2_4159d201/ConnectionBundle2_14f4c9c7
        ConnectionBundle2_5528fe66 (SoAdSocketRouteDest): SoAdRxUpperLayerType=IF, SoAdRxPduId=0, SoAdRxPduRef=GenerelPurposePDU4_a7ac36ff_Rx
      ConnectionBundle_ADAS_6b786f6d (SoAdSocketConnectionGroup):
        SoAdPduHeaderEnable = true
        SoAdSocketLocalPort = 30501
        SoAdSocketAutomaticSoConSetup = false
        SoAdSocketIpAddrAssignmentChgNotification = false
        SoAdSocketMsgAcceptanceFilterEnabled = true
        SoAdSocketSoConModeChgNotification = true
        SoAdBestMatchWithSockRouteEnabled = true
        SoAdBestMatchWithPduHeaderEnabled = false
        SoAdSocketAutomaticSoConSetupKeepOnline = false
        SoAdSocketLocalAddressRef = NEP_SRR_1_RdrNet_Unicast_48476027
        ConnectionBundle_ADAS_53ce198e (SoAdSocketConnection): SoAdSocketId=2, SoAdSocketGetReceivedRemoteAddressEnabled=false, SoAdVerifyRxPduEnable=false, SoAdAdditionalChgNotificationRef=Sd
          SoAdSocketRemoteAddress: SoAdSocketRemoteIpAddress=192.168.1.100, SoAdSocketRemotePort=34501, SoAdSocketRemoteIpAddressNotSet=false, SoAdSocketRemotePortNotSet=false
        SoAdSocketProtocol
          SoAdSocketUdp:
            SoAdSocketUdpListenOnly = false
            SoAdSocketUdpStrictHeaderLenCheckEnabled = false
            SoAdSocketUdpChecksumEnabled = true
            SoAdSocketUdpAddressResolutionRetryEnabled = true
            SoAdSocketUdpImmediateIfTxConfirmation = false
            SoAdSocketUdpAddressResolutionRetryQueueLimit = 1
            SoAdSocketUdpChecksumChangeEnabled = false
            SoAdSocketUdpAliveSupervisionTimeout = 1
      SoAdRoutingGroup3_c9586fb9 (SoAdRoutingGroup): SoAdRoutingGroupId=3, SoAdRoutingGroupIsEnabledAtInit=false, SoAdRoutingGroupTxTriggerable=false
      ConnectionBundle4_91e79f8a_Rx (SoAdSocketRoute): SoAdRxPduHeaderId=4294934784, SoAdRxSocketConnOrSocketConnBundleRef=ConnectionBundle4_81a0ef65
        ConnectionBundle4_f5688455 (SoAdSocketRouteDest): SoAdRxUpperLayerType=IF, SoAdRxPduId=1, SoAdRxPduRef=GenerelPurposePDU7_a57231d8_Rx
      signalPdu_RDR_1_SW_Info_14232baa_Tx (SoAdPduRoute):
        SoAdTxUpperLayerType = IF
        SoAdTxPduId = 6
        SoAdTxPduCollectionSemantics = SOAD_COLLECT_QUEUED
        SoAdTxIfOptimisticTransmit = false
        SoAdTxIfOptimized = false
        SoAdTxIfTriggerTransmit = false
        SoAdTxPduRef = signalPdu_RDR_1_SW_Info_14232baa_Tx
        ConnectionBundle_RDR_1_94fef815 (SoAdPduRouteDest):
          SoAdTxPduHeaderId = 1212418
          SoAdTxRoutingGroupRef = SoAdRoutingGroup3_c9586fb9
          SoAdTxSocketConnOrSocketConnBundleRef = ConnectionBundle_RDR_1_1c1a30fe/ConnectionBundle_RDR_1_94fef815
      SoAdRoutingGroup1_27560e95 (SoAdRoutingGroup): SoAdRoutingGroupId=1, SoAdRoutingGroupIsEnabledAtInit=false, SoAdRoutingGroupTxTriggerable=false
      SoAdRoutingGroup2_be5f5f2f (SoAdRoutingGroup): SoAdRoutingGroupId=2, SoAdRoutingGroupIsEnabledAtInit=false, SoAdRoutingGroupTxTriggerable=false
      ConnectionBundle_RDR_Logging (SoAdSocketConnectionGroup):
        SoAdPduHeaderEnable = false
        SoAdSocketAutomaticSoConSetup = false
        SoAdSocketIpAddrAssignmentChgNotification = false
        SoAdSocketLocalPort = 5050
        SoAdSocketMsgAcceptanceFilterEnabled = true
        SoAdSocketSoConModeChgNotification = false
        SoAdBestMatchWithSockRouteEnabled = true
        SoAdBestMatchWithPduHeaderEnabled = false
        SoAdSocketAutomaticSoConSetupKeepOnline = false
        SoAdSocketLocalAddressRef = NEP_SRR_1_RdrNet_Unicast_48476027
        ConnectionBundle_RDR_1_94fef815_001 (SoAdSocketConnection): SoAdSocketId=4, SoAdSocketGetReceivedRemoteAddressEnabled=false, SoAdVerifyRxPduEnable=false
          SoAdSocketRemoteAddress: SoAdSocketRemoteIpAddress=192.168.1.40, SoAdSocketRemotePort=5555, SoAdSocketRemoteIpAddressNotSet=false, SoAdSocketRemotePortNotSet=false
        SoAdSocketProtocol
          SoAdSocketUdp:
            SoAdSocketUdpListenOnly = false
            SoAdSocketUdpStrictHeaderLenCheckEnabled = false
            SoAdSocketUdpChecksumEnabled = true
            SoAdSocketUdpAddressResolutionRetryEnabled = false
            SoAdSocketUdpImmediateIfTxConfirmation = false
            SoAdSocketUdpAddressResolutionRetryQueueLimit = 0
            SoAdSocketUdpChecksumChangeEnabled = false
        SoAdSocketConnection_Veh_Rx_001 (SoAdSocketConnection): SoAdSocketId=5, SoAdSocketGetReceivedRemoteAddressEnabled=false, SoAdVerifyRxPduEnable=false
          SoAdSocketRemoteAddress: SoAdSocketRemoteIpAddress=, SoAdSocketRemotePort=0, SoAdSocketRemoteIpAddressNotSet=false, SoAdSocketRemotePortNotSet=false
      RDR_LOGGING_TX_FAST (SoAdPduRoute):
        SoAdTxPduId = 3
        SoAdTxUpperLayerType = IF
        SoAdTxPduCollectionSemantics = SOAD_COLLECT_QUEUED
        SoAdTxIfOptimisticTransmit = false
        SoAdTxIfOptimized = false
        SoAdTxIfTriggerTransmit = false
        SoAdTxPduRef = RDR_LOGGING_TX_FAST
        SoAdPduRouteDest:
          SoAdTxUdpTriggerMode = TRIGGER_ALWAYS
          SoAdTxSocketConnOrSocketConnBundleRef = ConnectionBundle_RDR_1_94fef815_001
          SoAdTxRoutingGroupRef = SoAdRoutingGroup
      SoAdSocketRoute_HIL (SoAdSocketRoute): SoAdRxSocketConnOrSocketConnBundleRef=SoAdSocketConnection_HIL_Rx
        SoAdSocketRouteDest_HIL (SoAdSocketRouteDest): SoAdRxUpperLayerType=IF, SoAdRxPduId=3, SoAdRxPduRef=RDR_HIL_Req_RX, SoAdRxRoutingGroupRef=SoAdRoutingGroup
      RDR_HIL_TX (SoAdPduRoute):
        SoAdTxPduId = 4
        SoAdTxUpperLayerType = IF
        SoAdTxPduCollectionSemantics = SOAD_COLLECT_QUEUED
        SoAdTxIfOptimisticTransmit = false
        SoAdTxIfOptimized = false
        SoAdTxIfTriggerTransmit = false
        SoAdTxPduRef = RDR_HIL_Res_Tx
        SoAdPduRouteDest: SoAdTxUdpTriggerMode=TRIGGER_ALWAYS, SoAdTxSocketConnOrSocketConnBundleRef=SoAdSocketConnection_HIL_Tx, SoAdTxRoutingGroupRef=SoAdRoutingGroup
      SoAdSocketConnectionGroup_HIL (SoAdSocketConnectionGroup):
        SoAdPduHeaderEnable = false
        SoAdSocketAutomaticSoConSetup = true
        SoAdSocketIpAddrAssignmentChgNotification = false
        SoAdSocketLocalPort = 5556
        SoAdSocketMsgAcceptanceFilterEnabled = true
        SoAdSocketSoConModeChgNotification = false
        SoAdBestMatchWithSockRouteEnabled = false
        SoAdBestMatchWithPduHeaderEnabled = false
        SoAdSocketAutomaticSoConSetupKeepOnline = true
        SoAdSocketLocalAddressRef = NEP_SRR_1_RdrNet_Unicast_48476027
        SoAdSocketConnection_HIL_Rx (SoAdSocketConnection): SoAdSocketId=7, SoAdSocketGetReceivedRemoteAddressEnabled=false, SoAdVerifyRxPduEnable=false
          SoAdSocketRemoteAddress: SoAdSocketRemoteIpAddress=, SoAdSocketRemotePort=0, SoAdSocketRemoteIpAddressNotSet=false, SoAdSocketRemotePortNotSet=false
        SoAdSocketProtocol
          SoAdSocketUdp:
            SoAdSocketUdpListenOnly = false
            SoAdSocketUdpStrictHeaderLenCheckEnabled = false
            SoAdSocketUdpChecksumEnabled = false
            SoAdSocketUdpAddressResolutionRetryEnabled = true
            SoAdSocketUdpImmediateIfTxConfirmation = false
            SoAdSocketUdpAddressResolutionRetryQueueLimit = 1
            SoAdSocketUdpChecksumChangeEnabled = false
            SoAdSocketUdpAliveSupervisionTimeout = 5
        SoAdSocketConnection_HIL_Tx (SoAdSocketConnection): SoAdSocketId=6, SoAdSocketGetReceivedRemoteAddressEnabled=false, SoAdVerifyRxPduEnable=false
          SoAdSocketRemoteAddress: SoAdSocketRemoteIpAddress=192.168.1.40, SoAdSocketRemotePort=5557, SoAdSocketRemoteIpAddressNotSet=false, SoAdSocketRemotePortNotSet=false
    SoAdGeneral:
      SoAdDevErrorDetect = true
      SoAdIPv6AddressEnabled = false
      SoAdMainFunctionPeriod = 0.005
      SoAdRoutingGroupMax = 5
      SoAdSoConMax = 9
      SoAdVersionInfoApi = false
      SoAdShutdownFinishedWaitTime = 2
      SoAdTxDynamicLengthEnabled = false
      SoAdMainFunctionSplitEnabled = false
      SoAdSafeBswChecks = true
      SoAdGetAndResetMeasurementDataApi = false
      SoAdGetAndResetMeasurementDataSomeIpSd = false
      SoAdEnableSecurityEventReporting = false
      SoAdRuntimeErrorReport = true
      SoAdSoConModeChgQueueSize = 0
      SoAdResetForForceReleaseEnabled = true
      SoAdSocketApi: SoAdSocketApiPrefix=TcpIp, SoAdVBsdAdUsed=false
      SoAdGeneration:
        SoAdOutOfBoundsWriteProtectionStrategy = NONE
        SoAdOutOfBoundsWriteSanitizer = false
        SoAdOutOfBoundsReadSanitizer = false
        SoAdReduceConstantData2Define = false
        SoAdBoolDataInArrayOfStructStrategy = BOOLEAN
        SoAdDeduplicateIndirectedData = false
        SoAdDataDeduplicationStrategy = NONE
        SoAdReduceBoolDataByNegationThreshold = 0
        SoAdReduceBoolDataByNumericalComparisonThreshold = 0
        SoAdReduceBoolDataByNumericalRelationThreshold = 0
        SoAdReduceBoolDataByNumericalOperandStrategy = NONE
        SoAdReduceNumericalDataByOffsetThreshold = 0
        SoAdReduceNumericalDataByArraySubtractionThreshold = 0
        SoAdShortSymbols = false
        SoAdInterfacesForDeactivatedData = false
        SoAdReferringKeysInComments = false
        SoAdEnableAdditionalRAMDebugData = false
    4 x SoAdBswModules, all with SoAdIf=true, SoAdTp=false:
      PduR: SoAdIfTriggerTransmit=true, SoAdIfTxConfirmation=true, SoAdLocalIpAddrAssigmentChg=false, SoAdSoConModeChg=false, SoAdUseCallerInfix=true, SoAdUseTypeInfix=true, SoAdBswModuleRef=PduR
      Cdd: SoAdIfTriggerTransmit=false, SoAdIfTxConfirmation=false, SoAdLocalIpAddrAssigmentChg=false, SoAdSoConModeChg=false, SoAdUseCallerInfix=true, SoAdUseTypeInfix=true, SoAdBswModuleRef=Cdd
      Xcp: SoAdIfTriggerTransmit=false, SoAdIfTxConfirmation=false, SoAdLocalIpAddrAssigmentChg=false, SoAdSoConModeChg=true, SoAdUseCallerInfix=true, SoAdUseTypeInfix=false, SoAdBswModuleRef=Xcp
      Sd: SoAdIfTriggerTransmit=false, SoAdIfTxConfirmation=false, SoAdLocalIpAddrAssigmentChg=true, SoAdSoConModeChg=true, SoAdUseCallerInfix=false, SoAdUseTypeInfix=false, SoAdBswModuleRef=Sd
