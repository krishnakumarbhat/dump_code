AUTOSAR XML (schema 00053)
package /ActiveEcuC
  module config Spi: implementation-config-variant=VARIANT-PRE-COMPILE, module-description=Spi_Impl
    SpiDriver: SpiMaxChannel=2, SpiMaxJob=1, SpiMaxSequence=1
      SpiExternalDevice_MMIC (SpiExternalDevice):
        SpiBaudrate = 50000000
        SpiCsIdentifier = NULL_PTR
        SpiCsPolarity = LOW
        SpiDataShiftEdge = LEADING
        SpiEnableCs = false
        SpiHwUnit = CSIB0
        SpiShiftClockIdleLevel = LOW
        SpiTimeClk2Cs = 0
        SpiCsSelection = CS_VIA_PERIPHERAL_ENGINE
        SpiDrvModel = MASTER
        SpiRxDelay = 0
      SpiSequence_MMIC (SpiSequence): SpiInterruptibleSequence=true, SpiSequenceId=0, SpiSeqEndNotification=NULL, SpiJobAssignment=SpiJob_MMIC
      SpiChannel_2 (SpiChannel): SpiChannelId=1, SpiChannelType=EB, SpiDataWidth=16, SpiEbMaxLength=400, SpiIbNBuffers=8, SpiTransferStart=MSB, SpiDefaultData=0
      SpiJob_MMIC (SpiJob):
        SpiJobId = 0
        SpiJobPriority = 1
        SpiOperationMode = SPI_Mode
        SpiJobEndNotification = NULL
        QspiAddressLength = QSPI_ADDR_L32
        SpiDeviceAssignment = SpiExternalDevice_MMIC
        SpiChannelList_MMIC (SpiChannelList): SpiChannelIndex=0, SpiChannelAssignment=SpiChannel_2
      SpiChannel_1 (SpiChannel): SpiChannelId=0, SpiChannelType=IB, SpiDataWidth=16, SpiEbMaxLength=1, SpiIbNBuffers=2, SpiTransferStart=MSB, SpiDefaultData=0
    SpiGeneral:
      SpiCancelApi = false
      SpiChannelBuffersAllowed = 2
      SpiDevErrorDetect = true
      SpiHwStatusApi = false
      SpiInterruptibleSeqAllowed = false
      SpiLevelDelivered = 1
      SpiSupportConcurrentSyncTransmit = false
      SpiVersionInfoApi = true
      SpiMainFunctionPeriod = 0.01
      SpiEnableInitCheck = true
      SpiKernelEcucPartitionRef = EcucPartition_SystemApplication_OsCore0
    SpiPublishedInformation: SpiMaxHwUnit=2
