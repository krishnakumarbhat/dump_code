AUTOSAR XML (schema 00053)
package /ActiveEcuC
  module config IpBase: implementation-config-variant=VARIANT-PRE-COMPILE, module-description=IpBase_Impl
    IpBaseGeneral: IpBaseDevErrorReport=true, IpBaseEnableInlineFunctions=true, IpBaseOneStepChecksumCopy=false, IpBaseSizeOfRamPointer=uint32
