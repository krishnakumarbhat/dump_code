AUTOSAR XML (schema 00053)
package /ActiveEcuC
  module config vLinkGen: implementation-config-variant=VARIANT-PRE-COMPILE, module-description=vLinkGen_Impl
    vLinkGenMemLayout
      vLinkGenLinkerSections
        18 x vLinkGenLinkerStackSection, all with vLinkGenLinkerStackSectionAlignment=64, vLinkGenLinkerStackSectionModule=Os:
          OS_STACK_OsCore0_Kernel_VAR_NOINIT: vLinkGenLinkerStackSectionName=OS_STACK_OsCore0_Kernel_VAR_NOINIT
          OS_STACK_OsCore0_Init_VAR_NOINIT: vLinkGenLinkerStackSectionName=OS_STACK_OsCore0_Init_VAR_NOINIT
          OS_STACK_OsCore0_Error_VAR_NOINIT: vLinkGenLinkerStackSectionName=OS_STACK_OsCore0_Error_VAR_NOINIT
          OS_STACK_OsCore0_Task_Prio4294967295_VAR_NOINIT: vLinkGenLinkerStackSectionName=OS_STACK_OsCore0_Task_Prio4294967295_VAR_NOINIT
          OS_STACK_OsCore0_Isr_Core_VAR_NOINIT: vLinkGenLinkerStackSectionName=OS_STACK_OsCore0_Isr_Core_VAR_NOINIT
          OS_STACK_OsCore0_Startup_VAR_NOINIT: vLinkGenLinkerStackSectionName=OS_STACK_OsCore0_Startup_VAR_NOINIT
          OS_STACK_OsCore0_Shutdown_VAR_NOINIT: vLinkGenLinkerStackSectionName=OS_STACK_OsCore0_Shutdown_VAR_NOINIT
          OS_STACK_BSW_Task_VAR_NOINIT: vLinkGenLinkerStackSectionName=OS_STACK_BSW_Task_VAR_NOINIT
          OS_STACK_OsCore0_Task_Prio200_VAR_NOINIT: vLinkGenLinkerStackSectionName=OS_STACK_OsCore0_Task_Prio200_VAR_NOINIT
          OS_STACK_OsCore0_Task_Prio190_VAR_NOINIT: vLinkGenLinkerStackSectionName=OS_STACK_OsCore0_Task_Prio190_VAR_NOINIT
          OS_STACK_Appl_Task_VAR_NOINIT: vLinkGenLinkerStackSectionName=OS_STACK_Appl_Task_VAR_NOINIT
          OS_STACK_Radar_Ctrl_Task_VAR_NOINIT: vLinkGenLinkerStackSectionName=OS_STACK_Radar_Ctrl_Task_VAR_NOINIT
          OS_STACK_Appl_Task_Logging_VAR_NOINIT: vLinkGenLinkerStackSectionName=OS_STACK_Appl_Task_Logging_VAR_NOINIT
          OS_STACK_Appl_Task_Communication_VAR_NOINIT: vLinkGenLinkerStackSectionName=OS_STACK_Appl_Task_Communication_VAR_NOINIT
          OS_STACK_OsCore0_Task_Prio210_VAR_NOINIT: vLinkGenLinkerStackSectionName=OS_STACK_OsCore0_Task_Prio210_VAR_NOINIT
          OS_STACK_Appl_Task_High_Prio_VAR_NOINIT: vLinkGenLinkerStackSectionName=OS_STACK_Appl_Task_High_Prio_VAR_NOINIT
          OS_STACK_Appl_IPC_Task_VAR_NOINIT: vLinkGenLinkerStackSectionName=OS_STACK_Appl_IPC_Task_VAR_NOINIT
          OS_STACK_Appl_Task_Fast_VAR_NOINIT: vLinkGenLinkerStackSectionName=OS_STACK_Appl_Task_Fast_VAR_NOINIT
        10 x vLinkGenLinkerCodeSection, all with vLinkGenLinkerCodeSectionFast=false, vLinkGenLinkerCodeSectionModule=Os:
          OS_CODE: vLinkGenLinkerCodeSectionName=OS_CODE
          OS_OS_COREINITHOOK_CODE: vLinkGenLinkerCodeSectionName=OS_OS_COREINITHOOK_CODE
          OS_INTVEC_CODE: vLinkGenLinkerCodeSectionName=OS_INTVEC_CODE, vLinkGenLinkerCodeSectionAlignment=0, vLinkGenLinkerCodeSectionFlag=vLinkGenConstSectionFlags/KEEP
          OS_EXCVEC_CORE0_CODE: vLinkGenLinkerCodeSectionName=OS_EXCVEC_CORE0_CODE, vLinkGenLinkerCodeSectionAlignment=32, vLinkGenLinkerCodeSectionFlag=vLinkGenConstSectionFlags/KEEP
          OS_INTVEC_CORE0_CODE: vLinkGenLinkerCodeSectionName=OS_INTVEC_CORE0_CODE, vLinkGenLinkerCodeSectionAlignment=0, vLinkGenLinkerCodeSectionFlag=vLinkGenConstSectionFlags/KEEP
          OS_USER_CORE0_CODE: vLinkGenLinkerCodeSectionName=OS_USER_CORE0_CODE
          OS_ERRORHOOK_CODE: vLinkGenLinkerCodeSectionName=OS_ERRORHOOK_CODE
          OS_PANICHOOK_CODE: vLinkGenLinkerCodeSectionName=OS_PANICHOOK_CODE
          OS_SHUTDOWNHOOK_CODE: vLinkGenLinkerCodeSectionName=OS_SHUTDOWNHOOK_CODE
          OS_STARTUPHOOK_CODE: vLinkGenLinkerCodeSectionName=OS_STARTUPHOOK_CODE
        9 x vLinkGenLinkerConstSection, all with vLinkGenLinkerConstSectionFast=false, vLinkGenLinkerConstSectionModule=Os:
          OS_CONST: vLinkGenLinkerConstSectionName=OS_CONST
          OS_INTVEC_CONST: vLinkGenLinkerConstSectionName=OS_INTVEC_CONST, vLinkGenLinkerConstSectionAlignment=0, vLinkGenLinkerConstSectionFlag=vLinkGenConstSectionFlags/KEEP
          OS_GLOBALSHARED_CONST: vLinkGenLinkerConstSectionName=OS_GLOBALSHARED_CONST
          OS_CORE0_CONST: vLinkGenLinkerConstSectionName=OS_CORE0_CONST
          OS_EXCVEC_CORE0_CONST: vLinkGenLinkerConstSectionName=OS_EXCVEC_CORE0_CONST, vLinkGenLinkerConstSectionAlignment=32, vLinkGenLinkerConstSectionFlag=vLinkGenConstSectionFlags/KEEP
          OS_INTVEC_CORE0_CONST: vLinkGenLinkerConstSectionName=OS_INTVEC_CORE0_CONST, vLinkGenLinkerConstSectionAlignment=0, vLinkGenLinkerConstSectionFlag=vLinkGenConstSectionFlags/KEEP
          OS_SystemApplication_OsCore0_CONST: vLinkGenLinkerConstSectionName=OS_SystemApplication_OsCore0_CONST
          OS_OsCore0_ASIL_CONST: vLinkGenLinkerConstSectionName=OS_OsCore0_ASIL_CONST
          OS_OsCore_Qm_CONST: vLinkGenLinkerConstSectionName=OS_OsCore_Qm_CONST
        60 x vLinkGenLinkerVarSection, all with vLinkGenLinkerVarSectionFast=false, vLinkGenLinkerVarSectionModule=Os:
          OS_VAR_NOCACHE: vLinkGenLinkerVarSectionName=OS_VAR_NOCACHE
          OS_VAR_NOCACHE_NOINIT: vLinkGenLinkerVarSectionName=OS_VAR_NOCACHE_NOINIT
          OS_VAR_NOCACHE_CLEARED: vLinkGenLinkerVarSectionName=OS_VAR_NOCACHE_CLEARED
          OS_GLOBALSHARED_VAR: vLinkGenLinkerVarSectionName=OS_GLOBALSHARED_VAR
          OS_GLOBALSHARED_VAR_NOINIT: vLinkGenLinkerVarSectionName=OS_GLOBALSHARED_VAR_NOINIT
          OS_GLOBALSHARED_VAR_CLEARED: vLinkGenLinkerVarSectionName=OS_GLOBALSHARED_VAR_CLEARED
          OS_GLOBALSHARED_VAR_POWER_ON_INIT: vLinkGenLinkerVarSectionName=OS_GLOBALSHARED_VAR_POWER_ON_INIT
          OS_GLOBALSHARED_VAR_POWER_ON_CLEARED: vLinkGenLinkerVarSectionName=OS_GLOBALSHARED_VAR_POWER_ON_CLEARED
          OS_GLOBALSHARED_VAR_NOCACHE: vLinkGenLinkerVarSectionName=OS_GLOBALSHARED_VAR_NOCACHE
          OS_GLOBALSHARED_VAR_NOCACHE_NOINIT: vLinkGenLinkerVarSectionName=OS_GLOBALSHARED_VAR_NOCACHE_NOINIT
          OS_GLOBALSHARED_VAR_NOCACHE_CLEARED: vLinkGenLinkerVarSectionName=OS_GLOBALSHARED_VAR_NOCACHE_CLEARED
          OS_GLOBALSHARED_VAR_NOCACHE_POWER_ON_INIT: vLinkGenLinkerVarSectionName=OS_GLOBALSHARED_VAR_NOCACHE_POWER_ON_INIT
          OS_GLOBALSHARED_VAR_NOCACHE_POWER_ON_CLEARED: vLinkGenLinkerVarSectionName=OS_GLOBALSHARED_VAR_NOCACHE_POWER_ON_CLEARED
          OS_GLOBALSHARED_VAR_SAVED_ZONE_POWER_ON_INIT: vLinkGenLinkerVarSectionName=OS_GLOBALSHARED_VAR_SAVED_ZONE_POWER_ON_INIT
          OS_GLOBALSHARED_VAR_SAVED_ZONE_POWER_ON_CLEARED: vLinkGenLinkerVarSectionName=OS_GLOBALSHARED_VAR_SAVED_ZONE_POWER_ON_CLEARED
          OS_CORESTATUS_CORE0_VAR_NOCACHE_NOINIT: vLinkGenLinkerVarSectionName=OS_CORESTATUS_CORE0_VAR_NOCACHE_NOINIT
          OS_CORE0_VAR: vLinkGenLinkerVarSectionName=OS_CORE0_VAR
          OS_CORE0_VAR_NOCACHE: vLinkGenLinkerVarSectionName=OS_CORE0_VAR_NOCACHE
          OS_CORE0_VAR_NOINIT: vLinkGenLinkerVarSectionName=OS_CORE0_VAR_NOINIT
          OS_CORE0_VAR_NOCACHE_NOINIT: vLinkGenLinkerVarSectionName=OS_CORE0_VAR_NOCACHE_NOINIT
          OS_CORE0_VAR_CLEARED: vLinkGenLinkerVarSectionName=OS_CORE0_VAR_CLEARED
          OS_CORE0_VAR_NOCACHE_CLEARED: vLinkGenLinkerVarSectionName=OS_CORE0_VAR_NOCACHE_CLEARED
          OS_PUBLIC_CORE0_VAR_NOINIT: vLinkGenLinkerVarSectionName=OS_PUBLIC_CORE0_VAR_NOINIT
          OS_BARRIER_CORE0_VAR_NOCACHE_NOINIT: vLinkGenLinkerVarSectionName=OS_BARRIER_CORE0_VAR_NOCACHE_NOINIT
          OS_SystemApplication_OsCore0_VAR: vLinkGenLinkerVarSectionName=OS_SystemApplication_OsCore0_VAR
          OS_SystemApplication_OsCore0_VAR_NOINIT: vLinkGenLinkerVarSectionName=OS_SystemApplication_OsCore0_VAR_NOINIT
          OS_SystemApplication_OsCore0_VAR_CLEARED: vLinkGenLinkerVarSectionName=OS_SystemApplication_OsCore0_VAR_CLEARED
          OS_SystemApplication_OsCore0_VAR_POWER_ON_INIT: vLinkGenLinkerVarSectionName=OS_SystemApplication_OsCore0_VAR_POWER_ON_INIT
          OS_SystemApplication_OsCore0_VAR_POWER_ON_CLEARED: vLinkGenLinkerVarSectionName=OS_SystemApplication_OsCore0_VAR_POWER_ON_CLEARED
          OS_SystemApplication_OsCore0_VAR_NOCACHE: vLinkGenLinkerVarSectionName=OS_SystemApplication_OsCore0_VAR_NOCACHE
          OS_SystemApplication_OsCore0_VAR_NOCACHE_NOINIT: vLinkGenLinkerVarSectionName=OS_SystemApplication_OsCore0_VAR_NOCACHE_NOINIT
          OS_SystemApplication_OsCore0_VAR_NOCACHE_CLEARED: vLinkGenLinkerVarSectionName=OS_SystemApplication_OsCore0_VAR_NOCACHE_CLEARED
          OS_SystemApplication_OsCore0_VAR_NOCACHE_POWER_ON_INIT: vLinkGenLinkerVarSectionName=OS_SystemApplication_OsCore0_VAR_NOCACHE_POWER_ON_INIT
          OS_SystemApplication_OsCore0_VAR_NOCACHE_POWER_ON_CLEARED: vLinkGenLinkerVarSectionName=OS_SystemApplication_OsCore0_VAR_NOCACHE_POWER_ON_CLEARED
          OS_SystemApplication_OsCore0_VAR_SAVED_ZONE_POWER_ON_INIT: vLinkGenLinkerVarSectionName=OS_SystemApplication_OsCore0_VAR_SAVED_ZONE_POWER_ON_INIT
          OS_SystemApplication_OsCore0_VAR_SAVED_ZONE_POWER_ON_CLEARED: vLinkGenLinkerVarSectionName=OS_SystemApplication_OsCore0_VAR_SAVED_ZONE_POWER_ON_CLEARED
          OS_OsCore0_ASIL_VAR: vLinkGenLinkerVarSectionName=OS_OsCore0_ASIL_VAR
          OS_OsCore0_ASIL_VAR_NOINIT: vLinkGenLinkerVarSectionName=OS_OsCore0_ASIL_VAR_NOINIT
          OS_OsCore0_ASIL_VAR_CLEARED: vLinkGenLinkerVarSectionName=OS_OsCore0_ASIL_VAR_CLEARED
          OS_OsCore0_ASIL_VAR_POWER_ON_INIT: vLinkGenLinkerVarSectionName=OS_OsCore0_ASIL_VAR_POWER_ON_INIT
          OS_OsCore0_ASIL_VAR_POWER_ON_CLEARED: vLinkGenLinkerVarSectionName=OS_OsCore0_ASIL_VAR_POWER_ON_CLEARED
          OS_OsCore0_ASIL_VAR_NOCACHE: vLinkGenLinkerVarSectionName=OS_OsCore0_ASIL_VAR_NOCACHE
          OS_OsCore0_ASIL_VAR_NOCACHE_NOINIT: vLinkGenLinkerVarSectionName=OS_OsCore0_ASIL_VAR_NOCACHE_NOINIT
          OS_OsCore0_ASIL_VAR_NOCACHE_CLEARED: vLinkGenLinkerVarSectionName=OS_OsCore0_ASIL_VAR_NOCACHE_CLEARED
          OS_OsCore0_ASIL_VAR_NOCACHE_POWER_ON_INIT: vLinkGenLinkerVarSectionName=OS_OsCore0_ASIL_VAR_NOCACHE_POWER_ON_INIT
          OS_OsCore0_ASIL_VAR_NOCACHE_POWER_ON_CLEARED: vLinkGenLinkerVarSectionName=OS_OsCore0_ASIL_VAR_NOCACHE_POWER_ON_CLEARED
          OS_OsCore0_ASIL_VAR_SAVED_ZONE_POWER_ON_INIT: vLinkGenLinkerVarSectionName=OS_OsCore0_ASIL_VAR_SAVED_ZONE_POWER_ON_INIT
          OS_OsCore0_ASIL_VAR_SAVED_ZONE_POWER_ON_CLEARED: vLinkGenLinkerVarSectionName=OS_OsCore0_ASIL_VAR_SAVED_ZONE_POWER_ON_CLEARED
          OS_OsCore_Qm_VAR: vLinkGenLinkerVarSectionName=OS_OsCore_Qm_VAR
          OS_OsCore_Qm_VAR_NOINIT: vLinkGenLinkerVarSectionName=OS_OsCore_Qm_VAR_NOINIT
          OS_OsCore_Qm_VAR_CLEARED: vLinkGenLinkerVarSectionName=OS_OsCore_Qm_VAR_CLEARED
          OS_OsCore_Qm_VAR_POWER_ON_INIT: vLinkGenLinkerVarSectionName=OS_OsCore_Qm_VAR_POWER_ON_INIT
          OS_OsCore_Qm_VAR_POWER_ON_CLEARED: vLinkGenLinkerVarSectionName=OS_OsCore_Qm_VAR_POWER_ON_CLEARED
          OS_OsCore_Qm_VAR_NOCACHE: vLinkGenLinkerVarSectionName=OS_OsCore_Qm_VAR_NOCACHE
          OS_OsCore_Qm_VAR_NOCACHE_NOINIT: vLinkGenLinkerVarSectionName=OS_OsCore_Qm_VAR_NOCACHE_NOINIT
          OS_OsCore_Qm_VAR_NOCACHE_CLEARED: vLinkGenLinkerVarSectionName=OS_OsCore_Qm_VAR_NOCACHE_CLEARED
          OS_OsCore_Qm_VAR_NOCACHE_POWER_ON_INIT: vLinkGenLinkerVarSectionName=OS_OsCore_Qm_VAR_NOCACHE_POWER_ON_INIT
          OS_OsCore_Qm_VAR_NOCACHE_POWER_ON_CLEARED: vLinkGenLinkerVarSectionName=OS_OsCore_Qm_VAR_NOCACHE_POWER_ON_CLEARED
          OS_OsCore_Qm_VAR_SAVED_ZONE_POWER_ON_INIT: vLinkGenLinkerVarSectionName=OS_OsCore_Qm_VAR_SAVED_ZONE_POWER_ON_INIT
          OS_OsCore_Qm_VAR_SAVED_ZONE_POWER_ON_CLEARED: vLinkGenLinkerVarSectionName=OS_OsCore_Qm_VAR_SAVED_ZONE_POWER_ON_CLEARED
        OS_PROTECTIONHOOK_CODE (vLinkGenLinkerCodeSection): vLinkGenLinkerCodeSectionName=OS_PROTECTIONHOOK_CODE, vLinkGenLinkerCodeSectionFast=false, vLinkGenLinkerCodeSectionModule=Os
        OS_STACK_OsCore0_Protection_VAR_NOINIT (vLinkGenLinkerStackSection):
          vLinkGenLinkerStackSectionName = OS_STACK_OsCore0_Protection_VAR_NOINIT
          vLinkGenLinkerStackSectionAlignment = 64
          vLinkGenLinkerStackSectionModule = Os
        OS_STACK_Appl_BackgroundTask_VAR_NOINIT (vLinkGenLinkerStackSection):
          vLinkGenLinkerStackSectionName = OS_STACK_Appl_BackgroundTask_VAR_NOINIT
          vLinkGenLinkerStackSectionAlignment = 64
          vLinkGenLinkerStackSectionModule = Os
      SYSTEM_RAM (vLinkGenMemoryRegion):
        vLinkGenMemoryRegionAddrOffset = 0
        vLinkGenMemoryRegionSize = 1048576
        vLinkGenMemoryRegionAddress = 268435456
        vLinkGenMemoryRegionAvailable = true
        vLinkGenMemoryRegionHwRegion = SystemRAM
        SYSTEM_RAM (vLinkGenMemoryRegionBlock):
          vLinkGenMemoryRegionBlockPosition = 0
          vLinkGenMemoryRegionBlockSize = 1060
          vLinkGenMemoryRegionBlockAddress = 268435456
          vLinkGenMemoryRegionBlockBoundary = LOWER
          vLinkGenMemoryRegionBlockInitStage = NONE
          vLinkGenMemoryRegionBlockContentType = STACKS
          vLinkGenMemoryRegionBlockContentType = GLOBAL_DATA
          vLinkGenMemoryRegionBlockContentType = LOCAL_DATA
          vLinkGenMemoryRegionBlockContentType = RAM_CODE_COPY
          vLinkGenMemoryRegionBlockContentType = RAM_CONST_COPY
          vLinkGenMemoryRegionBlockContentType = RETENTION_DATA
        SYSMEM0_R52_DATA (vLinkGenMemoryRegionBlock):
          vLinkGenMemoryRegionBlockPosition = 1
          vLinkGenMemoryRegionBlockSize = 1047516
          vLinkGenMemoryRegionBlockAddress = 268436516
          vLinkGenMemoryRegionBlockBoundary = LOWER
          vLinkGenMemoryRegionBlockInitStage = NONE
          vLinkGenMemoryRegionBlockContentType = STACKS
          vLinkGenMemoryRegionBlockContentType = GLOBAL_DATA
          vLinkGenMemoryRegionBlockContentType = LOCAL_DATA
          vLinkGenMemoryRegionBlockContentType = RAM_CODE_COPY
          vLinkGenMemoryRegionBlockContentType = RAM_CONST_COPY
          vLinkGenMemoryRegionBlockContentType = RETENTION_DATA
      SYSTEM_ROM (vLinkGenMemoryRegion):
        vLinkGenMemoryRegionAddrOffset = 0
        vLinkGenMemoryRegionSize = 1048576
        vLinkGenMemoryRegionAddress = 0
        vLinkGenMemoryRegionAvailable = true
        vLinkGenMemoryRegionHwRegion = SystemROM
        6 x vLinkGenMemoryRegionBlock, all with vLinkGenMemoryRegionBlockBoundary=LOWER, vLinkGenMemoryRegionBlockInitStage=NONE:
          CoreExceptions_FirstExecInst: vLinkGenMemoryRegionBlockSize=128, vLinkGenMemoryRegionBlockPosition=0, vLinkGenMemoryRegionBlockAddress=0, vLinkGenMemoryRegionBlockContentType=GLOBAL_EXCVEC_CODE, vLinkGenMemoryRegionBlockContentType=GLOBAL_EXCVEC_CONST
          StartupCode_FirstExecInst: vLinkGenMemoryRegionBlockPosition=1, vLinkGenMemoryRegionBlockSize=1408, vLinkGenMemoryRegionBlockAddress=128, vLinkGenMemoryRegionBlockContentType=STARTUP_CODE
          ApplicationEntry: vLinkGenMemoryRegionBlockPosition=2, vLinkGenMemoryRegionBlockSize=512, vLinkGenMemoryRegionBlockAddress=1536, vLinkGenMemoryRegionBlockContentType=APPLICATION_ENTRY
          R52_SYSMEM: vLinkGenMemoryRegionBlockPosition=3, vLinkGenMemoryRegionBlockSize=915456, vLinkGenMemoryRegionBlockAddress=2048, vLinkGenMemoryRegionBlockContentType=LOCAL_EXCVEC_CODE, vLinkGenMemoryRegionBlockContentType=LOCAL_EXCVEC_CONST, vLinkGenMemoryRegionBlockContentType=LOCAL_INTVEC_CODE, vLinkGenMemoryRegionBlockContentType=LOCAL_INTVEC_CONST, vLinkGenMemoryRegionBlockContentType=GLOBAL_INTVEC_CODE, vLinkGenMemoryRegionBlockContentType=GLOBAL_INTVEC_CONST, vLinkGenMemoryRegionBlockContentType=GLOBAL_CODE, vLinkGenMemoryRegionBlockContentType=GLOBAL_CONST, vLinkGenMemoryRegionBlockContentType=LOCAL_CODE, vLinkGenMemoryRegionBlockContentType=LOCAL_CONST, vLinkGenMemoryRegionBlockContentType=RAM_CODE, vLinkGenMemoryRegionBlockContentType=RAM_CONST
          R52_TCM: vLinkGenMemoryRegionBlockPosition=4, vLinkGenMemoryRegionBlockSize=77824, vLinkGenMemoryRegionBlockAddress=917504
          R52_TCM_STACK: vLinkGenMemoryRegionBlockPosition=5, vLinkGenMemoryRegionBlockSize=53248, vLinkGenMemoryRegionBlockAddress=995328
      19 x vLinkGenLogicalVarGroup, all with vLinkGenVarGroupPosition=0, vLinkGenVarGroupCore=0, vLinkGenVarGroupRegion=R52_TCM_STACK, vLinkGenVarGroupModule=Os, vLinkGenVarGroupContentType=STACKS:
        OS_STACK_OsCore0_Kernel_VAR
          OS_STACK_OsCore0_Kernel_VAR_NOINIT (vLinkGenVarSectionGroup):
            vLinkGenVarSectionGroupPosition = 0
            vLinkGenVarSectionGroupInit = NONE
            vLinkGenVarSectionGroupInitStage = ONE
            vLinkGenVarSectionGroupAlignment = 64
            vLinkGenVarSectionGroupEndAlignment = 64
            vLinkGenVarSectionGroupRef = vLinkGenLinkerSections/OS_STACK_OsCore0_Kernel_VAR_NOINIT
        OS_STACK_OsCore0_Init_VAR
          OS_STACK_OsCore0_Init_VAR_NOINIT (vLinkGenVarSectionGroup):
            vLinkGenVarSectionGroupPosition = 0
            vLinkGenVarSectionGroupInit = NONE
            vLinkGenVarSectionGroupInitStage = ONE
            vLinkGenVarSectionGroupAlignment = 64
            vLinkGenVarSectionGroupEndAlignment = 64
            vLinkGenVarSectionGroupRef = vLinkGenLinkerSections/OS_STACK_OsCore0_Init_VAR_NOINIT
        OS_STACK_OsCore0_Error_VAR
          OS_STACK_OsCore0_Error_VAR_NOINIT (vLinkGenVarSectionGroup):
            vLinkGenVarSectionGroupPosition = 0
            vLinkGenVarSectionGroupInit = NONE
            vLinkGenVarSectionGroupInitStage = ONE
            vLinkGenVarSectionGroupAlignment = 64
            vLinkGenVarSectionGroupEndAlignment = 64
            vLinkGenVarSectionGroupRef = vLinkGenLinkerSections/OS_STACK_OsCore0_Error_VAR_NOINIT
        OS_STACK_OsCore0_Task_Prio4294967295_VAR
          OS_STACK_OsCore0_Task_Prio4294967295_VAR_NOINIT (vLinkGenVarSectionGroup):
            vLinkGenVarSectionGroupPosition = 0
            vLinkGenVarSectionGroupInit = NONE
            vLinkGenVarSectionGroupInitStage = ONE
            vLinkGenVarSectionGroupAlignment = 64
            vLinkGenVarSectionGroupEndAlignment = 64
            vLinkGenVarSectionGroupRef = vLinkGenLinkerSections/OS_STACK_OsCore0_Task_Prio4294967295_VAR_NOINIT
        OS_STACK_OsCore0_Isr_Core_VAR
          OS_STACK_OsCore0_Isr_Core_VAR_NOINIT (vLinkGenVarSectionGroup):
            vLinkGenVarSectionGroupPosition = 0
            vLinkGenVarSectionGroupInit = NONE
            vLinkGenVarSectionGroupInitStage = ONE
            vLinkGenVarSectionGroupAlignment = 64
            vLinkGenVarSectionGroupEndAlignment = 64
            vLinkGenVarSectionGroupRef = vLinkGenLinkerSections/OS_STACK_OsCore0_Isr_Core_VAR_NOINIT
        OS_STACK_OsCore0_Startup_VAR
          OS_STACK_OsCore0_Startup_VAR_NOINIT (vLinkGenVarSectionGroup):
            vLinkGenVarSectionGroupPosition = 0
            vLinkGenVarSectionGroupInit = NONE
            vLinkGenVarSectionGroupInitStage = ONE
            vLinkGenVarSectionGroupAlignment = 64
            vLinkGenVarSectionGroupEndAlignment = 64
            vLinkGenVarSectionGroupRef = vLinkGenLinkerSections/OS_STACK_OsCore0_Startup_VAR_NOINIT
        OS_STACK_OsCore0_Shutdown_VAR
          OS_STACK_OsCore0_Shutdown_VAR_NOINIT (vLinkGenVarSectionGroup):
            vLinkGenVarSectionGroupPosition = 0
            vLinkGenVarSectionGroupInit = NONE
            vLinkGenVarSectionGroupInitStage = ONE
            vLinkGenVarSectionGroupAlignment = 64
            vLinkGenVarSectionGroupEndAlignment = 64
            vLinkGenVarSectionGroupRef = vLinkGenLinkerSections/OS_STACK_OsCore0_Shutdown_VAR_NOINIT
        OS_STACK_BSW_Task_VAR
          OS_STACK_BSW_Task_VAR_NOINIT (vLinkGenVarSectionGroup):
            vLinkGenVarSectionGroupPosition = 0
            vLinkGenVarSectionGroupInit = NONE
            vLinkGenVarSectionGroupInitStage = ONE
            vLinkGenVarSectionGroupAlignment = 64
            vLinkGenVarSectionGroupEndAlignment = 64
            vLinkGenVarSectionGroupRef = vLinkGenLinkerSections/OS_STACK_BSW_Task_VAR_NOINIT
        OS_STACK_OsCore0_Task_Prio0_VAR
          OS_STACK_OsCore0_Task_Prio0_VAR_NOINIT (vLinkGenVarSectionGroup):
            vLinkGenVarSectionGroupPosition = 0
            vLinkGenVarSectionGroupInit = NONE
            vLinkGenVarSectionGroupInitStage = ONE
            vLinkGenVarSectionGroupAlignment = 64
            vLinkGenVarSectionGroupEndAlignment = 64
        OS_STACK_OsCore0_Task_Prio200_VAR
          OS_STACK_OsCore0_Task_Prio200_VAR_NOINIT (vLinkGenVarSectionGroup):
            vLinkGenVarSectionGroupPosition = 0
            vLinkGenVarSectionGroupInit = NONE
            vLinkGenVarSectionGroupInitStage = ONE
            vLinkGenVarSectionGroupAlignment = 64
            vLinkGenVarSectionGroupEndAlignment = 64
            vLinkGenVarSectionGroupRef = vLinkGenLinkerSections/OS_STACK_OsCore0_Task_Prio200_VAR_NOINIT
        OS_STACK_OsCore0_Task_Prio190_VAR
          OS_STACK_OsCore0_Task_Prio190_VAR_NOINIT (vLinkGenVarSectionGroup):
            vLinkGenVarSectionGroupPosition = 0
            vLinkGenVarSectionGroupInit = NONE
            vLinkGenVarSectionGroupInitStage = ONE
            vLinkGenVarSectionGroupAlignment = 64
            vLinkGenVarSectionGroupEndAlignment = 64
            vLinkGenVarSectionGroupRef = vLinkGenLinkerSections/OS_STACK_OsCore0_Task_Prio190_VAR_NOINIT
        OS_STACK_Appl_Task_VAR
          OS_STACK_Appl_Task_VAR_NOINIT (vLinkGenVarSectionGroup):
            vLinkGenVarSectionGroupPosition = 0
            vLinkGenVarSectionGroupInit = NONE
            vLinkGenVarSectionGroupInitStage = ONE
            vLinkGenVarSectionGroupAlignment = 64
            vLinkGenVarSectionGroupEndAlignment = 64
            vLinkGenVarSectionGroupRef = vLinkGenLinkerSections/OS_STACK_Appl_Task_VAR_NOINIT
        OS_STACK_Radar_Ctrl_Task_VAR
          OS_STACK_Radar_Ctrl_Task_VAR_NOINIT (vLinkGenVarSectionGroup):
            vLinkGenVarSectionGroupPosition = 0
            vLinkGenVarSectionGroupInit = NONE
            vLinkGenVarSectionGroupInitStage = ONE
            vLinkGenVarSectionGroupAlignment = 64
            vLinkGenVarSectionGroupEndAlignment = 64
            vLinkGenVarSectionGroupRef = vLinkGenLinkerSections/OS_STACK_Radar_Ctrl_Task_VAR_NOINIT
        OS_STACK_Appl_Task_Logging_VAR
          OS_STACK_Appl_Task_Logging_VAR_NOINIT (vLinkGenVarSectionGroup):
            vLinkGenVarSectionGroupPosition = 0
            vLinkGenVarSectionGroupInit = NONE
            vLinkGenVarSectionGroupInitStage = ONE
            vLinkGenVarSectionGroupAlignment = 64
            vLinkGenVarSectionGroupEndAlignment = 64
            vLinkGenVarSectionGroupRef = vLinkGenLinkerSections/OS_STACK_Appl_Task_Logging_VAR_NOINIT
        OS_STACK_Appl_Task_Communication_VAR
          OS_STACK_Appl_Task_Communication_VAR_NOINIT (vLinkGenVarSectionGroup):
            vLinkGenVarSectionGroupPosition = 0
            vLinkGenVarSectionGroupInit = NONE
            vLinkGenVarSectionGroupInitStage = ONE
            vLinkGenVarSectionGroupAlignment = 64
            vLinkGenVarSectionGroupEndAlignment = 64
            vLinkGenVarSectionGroupRef = vLinkGenLinkerSections/OS_STACK_Appl_Task_Communication_VAR_NOINIT
        OS_STACK_OsCore0_Task_Prio210_VAR
          OS_STACK_OsCore0_Task_Prio210_VAR_NOINIT (vLinkGenVarSectionGroup):
            vLinkGenVarSectionGroupPosition = 0
            vLinkGenVarSectionGroupInit = NONE
            vLinkGenVarSectionGroupInitStage = ONE
            vLinkGenVarSectionGroupAlignment = 64
            vLinkGenVarSectionGroupEndAlignment = 64
            vLinkGenVarSectionGroupRef = vLinkGenLinkerSections/OS_STACK_OsCore0_Task_Prio210_VAR_NOINIT
        OS_STACK_Appl_Task_High_Prio_VAR
          OS_STACK_Appl_Task_High_Prio_VAR_NOINIT (vLinkGenVarSectionGroup):
            vLinkGenVarSectionGroupPosition = 0
            vLinkGenVarSectionGroupInit = NONE
            vLinkGenVarSectionGroupInitStage = ONE
            vLinkGenVarSectionGroupAlignment = 64
            vLinkGenVarSectionGroupEndAlignment = 64
            vLinkGenVarSectionGroupRef = vLinkGenLinkerSections/OS_STACK_Appl_Task_High_Prio_VAR_NOINIT
        OS_STACK_Appl_IPC_Task_VAR
          OS_STACK_Appl_IPC_Task_VAR_NOINIT (vLinkGenVarSectionGroup):
            vLinkGenVarSectionGroupPosition = 0
            vLinkGenVarSectionGroupInit = NONE
            vLinkGenVarSectionGroupInitStage = ONE
            vLinkGenVarSectionGroupAlignment = 64
            vLinkGenVarSectionGroupEndAlignment = 64
            vLinkGenVarSectionGroupRef = vLinkGenLinkerSections/OS_STACK_Appl_IPC_Task_VAR_NOINIT
        OS_STACK_Appl_Task_Fast_VAR
          OS_STACK_Appl_Task_Fast_VAR_NOINIT (vLinkGenVarSectionGroup):
            vLinkGenVarSectionGroupPosition = 0
            vLinkGenVarSectionGroupInit = NONE
            vLinkGenVarSectionGroupInitStage = ONE
            vLinkGenVarSectionGroupAlignment = 64
            vLinkGenVarSectionGroupEndAlignment = 64
            vLinkGenVarSectionGroupRef = vLinkGenLinkerSections/OS_STACK_Appl_Task_Fast_VAR_NOINIT
      11 x vLinkGenLogicalConstGroup, all with vLinkGenConstGroupPosition=5, vLinkGenConstGroupRegion=R52_TCM, vLinkGenConstGroupModule=Os:
        OS_CODE: vLinkGenConstGroupContentType=GLOBAL_CODE
          OS_CODE (vLinkGenConstSectionGroup):
            vLinkGenConstSectionGroupPosition = 0
            vLinkGenConstSectionGroupInit = NONE
            vLinkGenConstSectionGroupInitStage = ONE
            vLinkGenConstSectionGroupRef = vLinkGenLinkerSections/OS_CODE
            vLinkGenConstSectionGroupRef = OS_OS_COREINITHOOK_CODE
        OS_USER_CODE: vLinkGenConstGroupContentType=GLOBAL_CODE
          OS_USER_CODE (vLinkGenConstSectionGroup):
            vLinkGenConstSectionGroupPosition = 0
            vLinkGenConstSectionGroupInit = NONE
            vLinkGenConstSectionGroupInitStage = ONE
            vLinkGenConstSectionGroupRef = OS_USER_CORE0_CODE
            vLinkGenConstSectionGroupRef = OS_ERRORHOOK_CODE
            vLinkGenConstSectionGroupRef = OS_PANICHOOK_CODE
            vLinkGenConstSectionGroupRef = OS_SHUTDOWNHOOK_CODE
            vLinkGenConstSectionGroupRef = OS_STARTUPHOOK_CODE
            vLinkGenConstSectionGroupRef = OS_PROTECTIONHOOK_CODE
        OS_EXCVEC_CORE0_CODE: vLinkGenConstGroupCore=0, vLinkGenConstGroupContentType=LOCAL_EXCVEC_CODE
          OS_EXCVEC_CORE0_CODE (vLinkGenConstSectionGroup):
            vLinkGenConstSectionGroupPosition = 0
            vLinkGenConstSectionGroupInit = NONE
            vLinkGenConstSectionGroupInitStage = ONE
            vLinkGenConstSectionGroupAlignment = 32
            vLinkGenConstSectionGroupEndAlignment = 64
            vLinkGenConstSectionGroupRef = vLinkGenLinkerSections/OS_EXCVEC_CORE0_CODE
        OS_INTVEC_CORE0_CODE: vLinkGenConstGroupCore=0, vLinkGenConstGroupContentType=LOCAL_INTVEC_CODE
          OS_INTVEC_CORE0_CODE (vLinkGenConstSectionGroup):
            vLinkGenConstSectionGroupPosition = 0
            vLinkGenConstSectionGroupInit = NONE
            vLinkGenConstSectionGroupInitStage = ONE
            vLinkGenConstSectionGroupAlignment = 0
            vLinkGenConstSectionGroupEndAlignment = 64
            vLinkGenConstSectionGroupRef = vLinkGenLinkerSections/OS_INTVEC_CORE0_CODE
        OS_INTVEC_CODE: vLinkGenConstGroupContentType=GLOBAL_INTVEC_CODE
          OS_INTVEC_CODE (vLinkGenConstSectionGroup):
            vLinkGenConstSectionGroupPosition = 0
            vLinkGenConstSectionGroupInit = NONE
            vLinkGenConstSectionGroupInitStage = ONE
            vLinkGenConstSectionGroupAlignment = 0
            vLinkGenConstSectionGroupEndAlignment = 64
            vLinkGenConstSectionGroupRef = vLinkGenLinkerSections/OS_INTVEC_CODE
        OS_CONST: vLinkGenConstGroupContentType=GLOBAL_CONST
          OS_CONST (vLinkGenConstSectionGroup):
            vLinkGenConstSectionGroupPosition = 0
            vLinkGenConstSectionGroupInit = NONE
            vLinkGenConstSectionGroupInitStage = ONE
            vLinkGenConstSectionGroupRef = vLinkGenLinkerSections/OS_CONST
            vLinkGenConstSectionGroupRef = OS_CORE0_CONST
            vLinkGenConstSectionGroupRef = OS_SystemApplication_OsCore0_CONST
        OS_USER_CONST: vLinkGenConstGroupContentType=GLOBAL_CONST
          OS_USER_CONST (vLinkGenConstSectionGroup):
            vLinkGenConstSectionGroupPosition = 0
            vLinkGenConstSectionGroupInit = NONE
            vLinkGenConstSectionGroupInitStage = ONE
            vLinkGenConstSectionGroupRef = OS_OsCore0_ASIL_CONST
            vLinkGenConstSectionGroupRef = OS_OsCore_Qm_CONST
        OS_GLOBALSHARED_CONST: vLinkGenConstGroupContentType=GLOBAL_CONST
          OS_GLOBALSHARED_CONST (vLinkGenConstSectionGroup):
            vLinkGenConstSectionGroupPosition = 0
            vLinkGenConstSectionGroupInit = NONE
            vLinkGenConstSectionGroupInitStage = ONE
            vLinkGenConstSectionGroupRef = vLinkGenLinkerSections/OS_GLOBALSHARED_CONST
        OS_INTVEC_CONST: vLinkGenConstGroupContentType=GLOBAL_INTVEC_CONST
          OS_INTVEC_CONST (vLinkGenConstSectionGroup):
            vLinkGenConstSectionGroupPosition = 0
            vLinkGenConstSectionGroupInit = NONE
            vLinkGenConstSectionGroupInitStage = ONE
            vLinkGenConstSectionGroupAlignment = 0
            vLinkGenConstSectionGroupEndAlignment = 64
            vLinkGenConstSectionGroupRef = vLinkGenLinkerSections/OS_INTVEC_CONST
        OS_EXCVEC_CORE0_CONST: vLinkGenConstGroupCore=0, vLinkGenConstGroupContentType=LOCAL_EXCVEC_CONST
          OS_EXCVEC_CORE0_CONST (vLinkGenConstSectionGroup):
            vLinkGenConstSectionGroupPosition = 0
            vLinkGenConstSectionGroupInit = NONE
            vLinkGenConstSectionGroupInitStage = ONE
            vLinkGenConstSectionGroupAlignment = 32
            vLinkGenConstSectionGroupEndAlignment = 64
            vLinkGenConstSectionGroupRef = vLinkGenLinkerSections/OS_EXCVEC_CORE0_CONST
        OS_INTVEC_CORE0_CONST: vLinkGenConstGroupCore=0, vLinkGenConstGroupContentType=LOCAL_INTVEC_CONST
          OS_INTVEC_CORE0_CONST (vLinkGenConstSectionGroup):
            vLinkGenConstSectionGroupPosition = 0
            vLinkGenConstSectionGroupInit = NONE
            vLinkGenConstSectionGroupInitStage = ONE
            vLinkGenConstSectionGroupAlignment = 0
            vLinkGenConstSectionGroupEndAlignment = 64
            vLinkGenConstSectionGroupRef = vLinkGenLinkerSections/OS_INTVEC_CORE0_CONST
      11 x vLinkGenLogicalVarGroup, all with vLinkGenVarGroupModule=Os:
        OS_OsCore0_ASIL_VAR: vLinkGenVarGroupPosition=5, vLinkGenVarGroupCore=0, vLinkGenVarGroupInitCore=0, vLinkGenVarGroupRegion=R52_TCM, vLinkGenVarGroupContentType=LOCAL_DATA, vLinkGenVarGroupRomRegion=R52_TCM
          5 x vLinkGenVarSectionGroup, all with vLinkGenVarSectionGroupPosition=0, vLinkGenVarSectionGroupAlignment=64, vLinkGenVarSectionGroupEndAlignment=64:
            OS_OsCore0_ASIL_VAR_INIT: vLinkGenVarSectionGroupInit=INIT, vLinkGenVarSectionGroupInitStage=ONE, vLinkGenVarSectionGroupRef=vLinkGenLinkerSections/OS_OsCore0_ASIL_VAR, vLinkGenVarSectionGroupRef=OS_OsCore0_ASIL_VAR_NOCACHE
            OS_OsCore0_ASIL_VAR_NOINIT: vLinkGenVarSectionGroupInit=NONE, vLinkGenVarSectionGroupInitStage=NONE, vLinkGenVarSectionGroupRef=vLinkGenLinkerSections/OS_OsCore0_ASIL_VAR_NOINIT, vLinkGenVarSectionGroupRef=OS_OsCore0_ASIL_VAR_NOCACHE_NOINIT
            OS_OsCore0_ASIL_VAR_CLEARED: vLinkGenVarSectionGroupInit=ZERO_INIT, vLinkGenVarSectionGroupInitStage=ONE, vLinkGenVarSectionGroupRef=vLinkGenLinkerSections/OS_OsCore0_ASIL_VAR_CLEARED, vLinkGenVarSectionGroupRef=OS_OsCore0_ASIL_VAR_NOCACHE_CLEARED
            OS_OsCore0_ASIL_VAR_POWER_ON_INIT: vLinkGenVarSectionGroupInit=INIT, vLinkGenVarSectionGroupInitStage=POWER_ON, vLinkGenVarSectionGroupRef=vLinkGenLinkerSections/OS_OsCore0_ASIL_VAR_POWER_ON_INIT, vLinkGenVarSectionGroupRef=OS_OsCore0_ASIL_VAR_NOCACHE_POWER_ON_INIT
            OS_OsCore0_ASIL_VAR_POWER_ON_CLEARED: vLinkGenVarSectionGroupInit=ZERO_INIT, vLinkGenVarSectionGroupInitStage=POWER_ON, vLinkGenVarSectionGroupRef=vLinkGenLinkerSections/OS_OsCore0_ASIL_VAR_POWER_ON_CLEARED, vLinkGenVarSectionGroupRef=OS_OsCore0_ASIL_VAR_NOCACHE_POWER_ON_CLEARED
        OS_OsCore_Qm_VAR: vLinkGenVarGroupPosition=5, vLinkGenVarGroupCore=0, vLinkGenVarGroupInitCore=0, vLinkGenVarGroupRegion=R52_TCM, vLinkGenVarGroupContentType=LOCAL_DATA, vLinkGenVarGroupRomRegion=R52_TCM
          5 x vLinkGenVarSectionGroup, all with vLinkGenVarSectionGroupPosition=0, vLinkGenVarSectionGroupAlignment=64, vLinkGenVarSectionGroupEndAlignment=64:
            OS_OsCore_Qm_VAR_INIT: vLinkGenVarSectionGroupInit=INIT, vLinkGenVarSectionGroupInitStage=ONE, vLinkGenVarSectionGroupRef=vLinkGenLinkerSections/OS_OsCore_Qm_VAR, vLinkGenVarSectionGroupRef=OS_OsCore_Qm_VAR_NOCACHE
            OS_OsCore_Qm_VAR_NOINIT: vLinkGenVarSectionGroupInit=NONE, vLinkGenVarSectionGroupInitStage=NONE, vLinkGenVarSectionGroupRef=vLinkGenLinkerSections/OS_OsCore_Qm_VAR_NOINIT, vLinkGenVarSectionGroupRef=OS_OsCore_Qm_VAR_NOCACHE_NOINIT
            OS_OsCore_Qm_VAR_CLEARED: vLinkGenVarSectionGroupInit=ZERO_INIT, vLinkGenVarSectionGroupInitStage=ONE, vLinkGenVarSectionGroupRef=vLinkGenLinkerSections/OS_OsCore_Qm_VAR_CLEARED, vLinkGenVarSectionGroupRef=OS_OsCore_Qm_VAR_NOCACHE_CLEARED
            OS_OsCore_Qm_VAR_POWER_ON_INIT: vLinkGenVarSectionGroupInit=INIT, vLinkGenVarSectionGroupInitStage=POWER_ON, vLinkGenVarSectionGroupRef=vLinkGenLinkerSections/OS_OsCore_Qm_VAR_POWER_ON_INIT, vLinkGenVarSectionGroupRef=OS_OsCore_Qm_VAR_NOCACHE_POWER_ON_INIT
            OS_OsCore_Qm_VAR_POWER_ON_CLEARED: vLinkGenVarSectionGroupInit=ZERO_INIT, vLinkGenVarSectionGroupInitStage=POWER_ON, vLinkGenVarSectionGroupRef=vLinkGenLinkerSections/OS_OsCore_Qm_VAR_POWER_ON_CLEARED, vLinkGenVarSectionGroupRef=OS_OsCore_Qm_VAR_NOCACHE_POWER_ON_CLEARED
        OS_GLOBALSHARED_VAR: vLinkGenVarGroupPosition=5, vLinkGenVarGroupInitCore=0, vLinkGenVarGroupRegion=R52_TCM, vLinkGenVarGroupContentType=GLOBAL_DATA, vLinkGenVarGroupRomRegion=R52_TCM
          5 x vLinkGenVarSectionGroup, all with vLinkGenVarSectionGroupPosition=0, vLinkGenVarSectionGroupAlignment=64, vLinkGenVarSectionGroupEndAlignment=64:
            OS_GLOBALSHARED_VAR_INIT: vLinkGenVarSectionGroupInit=INIT, vLinkGenVarSectionGroupInitStage=ONE, vLinkGenVarSectionGroupRef=vLinkGenLinkerSections/OS_GLOBALSHARED_VAR, vLinkGenVarSectionGroupRef=OS_GLOBALSHARED_VAR_NOCACHE
            OS_GLOBALSHARED_VAR_NOINIT: vLinkGenVarSectionGroupInit=NONE, vLinkGenVarSectionGroupInitStage=NONE, vLinkGenVarSectionGroupRef=vLinkGenLinkerSections/OS_GLOBALSHARED_VAR_NOINIT, vLinkGenVarSectionGroupRef=OS_GLOBALSHARED_VAR_NOCACHE_NOINIT
            OS_GLOBALSHARED_VAR_CLEARED: vLinkGenVarSectionGroupInit=ZERO_INIT, vLinkGenVarSectionGroupInitStage=ONE, vLinkGenVarSectionGroupRef=vLinkGenLinkerSections/OS_GLOBALSHARED_VAR_CLEARED, vLinkGenVarSectionGroupRef=OS_GLOBALSHARED_VAR_NOCACHE_CLEARED
            OS_GLOBALSHARED_VAR_POWER_ON_INIT: vLinkGenVarSectionGroupInit=INIT, vLinkGenVarSectionGroupInitStage=POWER_ON, vLinkGenVarSectionGroupRef=vLinkGenLinkerSections/OS_GLOBALSHARED_VAR_POWER_ON_INIT, vLinkGenVarSectionGroupRef=OS_GLOBALSHARED_VAR_NOCACHE_POWER_ON_INIT
            OS_GLOBALSHARED_VAR_POWER_ON_CLEARED: vLinkGenVarSectionGroupInit=ZERO_INIT, vLinkGenVarSectionGroupInitStage=POWER_ON, vLinkGenVarSectionGroupRef=vLinkGenLinkerSections/OS_GLOBALSHARED_VAR_POWER_ON_CLEARED, vLinkGenVarSectionGroupRef=OS_GLOBALSHARED_VAR_NOCACHE_POWER_ON_CLEARED
        OS_OsCore_Qm_VAR_SAVED_ZONE: vLinkGenVarGroupPosition=5, vLinkGenVarGroupCore=0, vLinkGenVarGroupInitCore=0, vLinkGenVarGroupRegion=R52_TCM, vLinkGenVarGroupContentType=RETENTION_DATA, vLinkGenVarGroupRomRegion=R52_TCM
          OS_OsCore_Qm_VAR_SAVED_ZONE_POWER_ON_INIT (vLinkGenVarSectionGroup):
            vLinkGenVarSectionGroupPosition = 0
            vLinkGenVarSectionGroupInit = INIT
            vLinkGenVarSectionGroupInitStage = POWER_ON
            vLinkGenVarSectionGroupAlignment = 64
            vLinkGenVarSectionGroupEndAlignment = 64
            vLinkGenVarSectionGroupRef = vLinkGenLinkerSections/OS_OsCore_Qm_VAR_SAVED_ZONE_POWER_ON_INIT
          OS_OsCore_Qm_VAR_SAVED_ZONE_POWER_ON_CLEARED (vLinkGenVarSectionGroup):
            vLinkGenVarSectionGroupPosition = 0
            vLinkGenVarSectionGroupInit = ZERO_INIT
            vLinkGenVarSectionGroupInitStage = POWER_ON
            vLinkGenVarSectionGroupAlignment = 64
            vLinkGenVarSectionGroupEndAlignment = 64
            vLinkGenVarSectionGroupRef = vLinkGenLinkerSections/OS_OsCore_Qm_VAR_SAVED_ZONE_POWER_ON_CLEARED
        OS_OsCore0_ASIL_VAR_SAVED_ZONE: vLinkGenVarGroupPosition=5, vLinkGenVarGroupCore=0, vLinkGenVarGroupInitCore=0, vLinkGenVarGroupRegion=R52_TCM, vLinkGenVarGroupContentType=RETENTION_DATA, vLinkGenVarGroupRomRegion=R52_TCM
          OS_OsCore0_ASIL_VAR_SAVED_ZONE_POWER_ON_INIT (vLinkGenVarSectionGroup):
            vLinkGenVarSectionGroupPosition = 0
            vLinkGenVarSectionGroupInit = INIT
            vLinkGenVarSectionGroupInitStage = POWER_ON
            vLinkGenVarSectionGroupAlignment = 64
            vLinkGenVarSectionGroupEndAlignment = 64
            vLinkGenVarSectionGroupRef = vLinkGenLinkerSections/OS_OsCore0_ASIL_VAR_SAVED_ZONE_POWER_ON_INIT
          OS_OsCore0_ASIL_VAR_SAVED_ZONE_POWER_ON_CLEARED (vLinkGenVarSectionGroup):
            vLinkGenVarSectionGroupPosition = 0
            vLinkGenVarSectionGroupInit = ZERO_INIT
            vLinkGenVarSectionGroupInitStage = POWER_ON
            vLinkGenVarSectionGroupAlignment = 64
            vLinkGenVarSectionGroupEndAlignment = 64
            vLinkGenVarSectionGroupRef = vLinkGenLinkerSections/OS_OsCore0_ASIL_VAR_SAVED_ZONE_POWER_ON_CLEARED
        OS_GLOBALSHARED_VAR_SAVED_ZONE: vLinkGenVarGroupPosition=5, vLinkGenVarGroupInitCore=0, vLinkGenVarGroupRegion=R52_TCM, vLinkGenVarGroupContentType=RETENTION_DATA, vLinkGenVarGroupRomRegion=R52_TCM
          OS_GLOBALSHARED_VAR_SAVED_ZONE_POWER_ON_INIT (vLinkGenVarSectionGroup):
            vLinkGenVarSectionGroupPosition = 0
            vLinkGenVarSectionGroupInit = INIT
            vLinkGenVarSectionGroupInitStage = POWER_ON
            vLinkGenVarSectionGroupAlignment = 64
            vLinkGenVarSectionGroupEndAlignment = 64
            vLinkGenVarSectionGroupRef = vLinkGenLinkerSections/OS_GLOBALSHARED_VAR_SAVED_ZONE_POWER_ON_INIT
          OS_GLOBALSHARED_VAR_SAVED_ZONE_POWER_ON_CLEARED (vLinkGenVarSectionGroup):
            vLinkGenVarSectionGroupPosition = 0
            vLinkGenVarSectionGroupInit = ZERO_INIT
            vLinkGenVarSectionGroupInitStage = POWER_ON
            vLinkGenVarSectionGroupAlignment = 64
            vLinkGenVarSectionGroupEndAlignment = 64
            vLinkGenVarSectionGroupRef = vLinkGenLinkerSections/OS_GLOBALSHARED_VAR_SAVED_ZONE_POWER_ON_CLEARED
        OS_DATA_CORE0_VAR: vLinkGenVarGroupPosition=5, vLinkGenVarGroupCore=0, vLinkGenVarGroupInitCore=0, vLinkGenVarGroupRegion=R52_TCM, vLinkGenVarGroupContentType=LOCAL_DATA, vLinkGenVarGroupRomRegion=R52_TCM
          5 x vLinkGenVarSectionGroup, all with vLinkGenVarSectionGroupPosition=0, vLinkGenVarSectionGroupAlignment=64, vLinkGenVarSectionGroupEndAlignment=64:
            OS_DATA_CORE0_VAR_INIT: vLinkGenVarSectionGroupInit=INIT, vLinkGenVarSectionGroupInitStage=ONE, vLinkGenVarSectionGroupRef=OS_CORE0_VAR, vLinkGenVarSectionGroupRef=OS_CORE0_VAR_NOCACHE, vLinkGenVarSectionGroupRef=OS_SystemApplication_OsCore0_VAR, vLinkGenVarSectionGroupRef=OS_SystemApplication_OsCore0_VAR_NOCACHE
            OS_DATA_CORE0_VAR_NOINIT: vLinkGenVarSectionGroupInit=NONE, vLinkGenVarSectionGroupInitStage=NONE, vLinkGenVarSectionGroupRef=OS_CORE0_VAR_NOINIT, vLinkGenVarSectionGroupRef=OS_CORE0_VAR_NOCACHE_NOINIT, vLinkGenVarSectionGroupRef=OS_SystemApplication_OsCore0_VAR_NOINIT, vLinkGenVarSectionGroupRef=OS_SystemApplication_OsCore0_VAR_NOCACHE_NOINIT
            OS_DATA_CORE0_VAR_CLEARED: vLinkGenVarSectionGroupInit=ZERO_INIT, vLinkGenVarSectionGroupInitStage=ONE, vLinkGenVarSectionGroupRef=OS_CORE0_VAR_CLEARED, vLinkGenVarSectionGroupRef=OS_CORE0_VAR_NOCACHE_CLEARED, vLinkGenVarSectionGroupRef=OS_SystemApplication_OsCore0_VAR_CLEARED, vLinkGenVarSectionGroupRef=OS_SystemApplication_OsCore0_VAR_NOCACHE_CLEARED
            OS_DATA_CORE0_VAR_POWER_ON_INIT: vLinkGenVarSectionGroupInit=INIT, vLinkGenVarSectionGroupInitStage=POWER_ON, vLinkGenVarSectionGroupRef=OS_SystemApplication_OsCore0_VAR_POWER_ON_INIT, vLinkGenVarSectionGroupRef=OS_SystemApplication_OsCore0_VAR_NOCACHE_POWER_ON_INIT, vLinkGenVarSectionGroupRef=OS_SystemApplication_OsCore0_VAR_SAVED_ZONE_POWER_ON_INIT
            OS_DATA_CORE0_VAR_POWER_ON_CLEARED: vLinkGenVarSectionGroupInit=ZERO_INIT, vLinkGenVarSectionGroupInitStage=POWER_ON, vLinkGenVarSectionGroupRef=OS_SystemApplication_OsCore0_VAR_POWER_ON_CLEARED, vLinkGenVarSectionGroupRef=OS_SystemApplication_OsCore0_VAR_NOCACHE_POWER_ON_CLEARED, vLinkGenVarSectionGroupRef=OS_SystemApplication_OsCore0_VAR_SAVED_ZONE_POWER_ON_CLEARED
        OS_DATA_SHARED_VAR: vLinkGenVarGroupPosition=5, vLinkGenVarGroupInitCore=0, vLinkGenVarGroupRegion=R52_TCM, vLinkGenVarGroupContentType=GLOBAL_DATA, vLinkGenVarGroupRomRegion=R52_TCM
          3 x vLinkGenVarSectionGroup, all with vLinkGenVarSectionGroupPosition=0, vLinkGenVarSectionGroupAlignment=64, vLinkGenVarSectionGroupEndAlignment=64:
            OS_DATA_SHARED_VAR_INIT: vLinkGenVarSectionGroupInit=INIT, vLinkGenVarSectionGroupInitStage=ONE, vLinkGenVarSectionGroupRef=OS_VAR_NOCACHE
            OS_DATA_SHARED_VAR_NOINIT: vLinkGenVarSectionGroupInit=NONE, vLinkGenVarSectionGroupInitStage=NONE, vLinkGenVarSectionGroupRef=OS_VAR_NOCACHE_NOINIT, vLinkGenVarSectionGroupRef=OS_CORESTATUS_CORE0_VAR_NOCACHE_NOINIT, vLinkGenVarSectionGroupRef=OS_PUBLIC_CORE0_VAR_NOINIT, vLinkGenVarSectionGroupRef=OS_BARRIER_CORE0_VAR_NOCACHE_NOINIT
            OS_DATA_SHARED_VAR_CLEARED: vLinkGenVarSectionGroupInit=ZERO_INIT, vLinkGenVarSectionGroupInitStage=ONE, vLinkGenVarSectionGroupRef=OS_VAR_NOCACHE_CLEARED
        OS_STACK_OsCore0_Protection_VAR: vLinkGenVarGroupPosition=0, vLinkGenVarGroupCore=0, vLinkGenVarGroupRegion=R52_TCM_STACK, vLinkGenVarGroupContentType=STACKS
          OS_STACK_OsCore0_Protection_VAR_NOINIT (vLinkGenVarSectionGroup):
            vLinkGenVarSectionGroupPosition = 0
            vLinkGenVarSectionGroupInit = NONE
            vLinkGenVarSectionGroupInitStage = ONE
            vLinkGenVarSectionGroupAlignment = 64
            vLinkGenVarSectionGroupEndAlignment = 64
            vLinkGenVarSectionGroupRef = vLinkGenLinkerSections/OS_STACK_OsCore0_Protection_VAR_NOINIT
        OS_STACK_OsCore0_Task_Prio1_VAR: vLinkGenVarGroupPosition=0, vLinkGenVarGroupCore=0, vLinkGenVarGroupRegion=SYSTEM_RAM/SYSTEM_RAM, vLinkGenVarGroupContentType=STACKS
          OS_STACK_OsCore0_Task_Prio1_VAR_NOINIT (vLinkGenVarSectionGroup):
            vLinkGenVarSectionGroupPosition = 0
            vLinkGenVarSectionGroupInit = NONE
            vLinkGenVarSectionGroupInitStage = ONE
            vLinkGenVarSectionGroupAlignment = 64
            vLinkGenVarSectionGroupEndAlignment = 64
        OS_STACK_Appl_BackgroundTask_VAR: vLinkGenVarGroupPosition=0, vLinkGenVarGroupCore=0, vLinkGenVarGroupRegion=R52_TCM_STACK, vLinkGenVarGroupContentType=STACKS
          OS_STACK_Appl_BackgroundTask_VAR_NOINIT (vLinkGenVarSectionGroup):
            vLinkGenVarSectionGroupPosition = 0
            vLinkGenVarSectionGroupInit = NONE
            vLinkGenVarSectionGroupInitStage = ONE
            vLinkGenVarSectionGroupAlignment = 64
            vLinkGenVarSectionGroupEndAlignment = 64
            vLinkGenVarSectionGroupRef = vLinkGenLinkerSections/OS_STACK_Appl_BackgroundTask_VAR_NOINIT
    vLinkGenContentTypes
      vHsmGlobalRamBuffer (vLinkGenVarContentType): vLinkGenVarContentTypeLocal=false, vLinkGenVarContentTypeCopyRef=GLOBAL_CONST
      vHsmIpcMemory (vLinkGenVarContentType): vLinkGenVarContentTypeLocal=false, vLinkGenVarContentTypeCopyRef=GLOBAL_CONST
      RAM_CODE (vLinkGenConstContentType): vLinkGenConstContentTypeLocal=false, vLinkGenConstContentTypeCopyRef=RAM_CODE_COPY
      RAM_CONST (vLinkGenConstContentType): vLinkGenConstContentTypeLocal=false, vLinkGenConstContentTypeCopyRef=RAM_CONST_COPY
      3 x vLinkGenVarContentType:
        GLOBAL_DATA: vLinkGenVarContentTypeLocal=false, vLinkGenVarContentTypeCopyRef=GLOBAL_CONST
        LOCAL_DATA: vLinkGenVarContentTypeLocal=true, vLinkGenVarContentTypeCopyRef=LOCAL_CONST
        RETENTION_DATA: vLinkGenVarContentTypeLocal=false, vLinkGenVarContentTypeCopyRef=GLOBAL_CONST
      13 x vLinkGenConstContentType:
        GLOBAL_CODE: vLinkGenConstContentTypeLocal=false
        LOCAL_CODE: vLinkGenConstContentTypeLocal=true
        GLOBAL_CONST: vLinkGenConstContentTypeLocal=false
        LOCAL_CONST: vLinkGenConstContentTypeLocal=true
        GLOBAL_EXCVEC_CODE: vLinkGenConstContentTypeLocal=false
        LOCAL_EXCVEC_CODE: vLinkGenConstContentTypeLocal=true
        GLOBAL_EXCVEC_CONST: vLinkGenConstContentTypeLocal=false
        LOCAL_EXCVEC_CONST: vLinkGenConstContentTypeLocal=true
        GLOBAL_INTVEC_CODE: vLinkGenConstContentTypeLocal=false
        LOCAL_INTVEC_CODE: vLinkGenConstContentTypeLocal=true
        GLOBAL_INTVEC_CONST: vLinkGenConstContentTypeLocal=false
        LOCAL_INTVEC_CONST: vLinkGenConstContentTypeLocal=true
        STARTUP_CODE: vLinkGenConstContentTypeLocal=false
      5 x vLinkGenVarContentType:
        STARTUP_STACK: vLinkGenVarContentTypeLocal=true
        STACKS: vLinkGenVarContentTypeLocal=true
        RAM_CODE_COPY: vLinkGenVarContentTypeLocal=false
        RAM_CONST_COPY: vLinkGenVarContentTypeLocal=false
        SHARED_DATA: vLinkGenVarContentTypeLocal=false
      APPLICATION_ENTRY (vLinkGenConstContentType): vLinkGenConstContentTypeLocal=false
    vLinkGenVariantHandling
      vLinkGenVariant
    vLinkGenPublishedInformation: vLinkGenGeneration=2, vLinkGenDuplicatedLabels=false
      vLinkGenConstSectionFlags
        KEEP (vLinkGenConstSectionFlag)
        NOLOAD (vLinkGenConstSectionFlag)
      vLinkGenVarSectionFlags
        KEEP (vLinkGenVarSectionFlag)
        NOLOAD (vLinkGenVarSectionFlag)
      vLinkGenSpecSectionFlags
        KEEP (vLinkGenSpecSectionFlag)
        NOLOAD (vLinkGenSpecSectionFlag)
    vLinkGenGeneral: vLinkGenFileGeneration=LOGICAL_GROUP_SNIPPETS, vLinkGen64BitMemoryMode=false
