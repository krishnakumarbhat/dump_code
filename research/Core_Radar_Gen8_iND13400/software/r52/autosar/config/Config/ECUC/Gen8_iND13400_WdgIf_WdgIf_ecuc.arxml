AUTOSAR XML (schema 00053)
package /ActiveEcuC
  module config WdgIf: implementation-config-variant=VARIANT-PRE-COMPILE, module-description=WdgIf_Impl
    WdgIfDevice:
      WdgIfDeviceIndex = 0
      WdgIfDeviceIncludeFile = SWC_PLT_CDD_WdgHandler_cfg.h
      WdgIfDeviceSetMode = Internal_Wdg_Instance_SetMode
      WdgIfDeviceSetTriggerCondition = Internal_Wdg_Instance_SetTriggerCondition
      WdgIfDriverRef = WdgGeneral
    WdgIfGeneral: WdgIfDevErrorDetect=true, WdgIfVersionInfoApi=false, WdgIfUseStateCombiner=false
