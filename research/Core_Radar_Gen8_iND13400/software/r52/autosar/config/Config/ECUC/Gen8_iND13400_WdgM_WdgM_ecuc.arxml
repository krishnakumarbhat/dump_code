AUTOSAR XML (schema 00053)
package /ActiveEcuC
  module config WdgM: implementation-config-variant=VARIANT-PRE-COMPILE, module-description=WdgM_Impl
    WdgMConfigSet: WdgMInitialMode=WdgMMode
      WdgMMode:
        WdgMExpiredSupervisionCycleTol = 0
        WdgMModeId = 0
        WdgMSupervisionCycle = 0.005
        WdgMInitialTriggerModeId = 1
        WdgMModeCoreAssignment = 0
        WdgMTicksPerSecond = 200
        WdgMReportStatusViaRte = true
        WdgMGlobalMemoryAppTaskRef = OsCore0_ASIL
        3 x WdgMTrigger, all with WdgMTriggerWatchdogRef=WdgMWatchdog:
          WdgMTrigger_FastMode: WdgMWatchdogMode=WDGIF_FAST_MODE, WdgMTriggerConditionValue=105, WdgMTriggerModeId=2
          WdgMTrigger_OffMode: WdgMWatchdogMode=WDGIF_OFF_MODE, WdgMTriggerConditionValue=500, WdgMTriggerModeId=0
          WdgMTrigger_SlowMode: WdgMWatchdogMode=WDGIF_SLOW_MODE, WdgMTriggerConditionValue=4480, WdgMTriggerModeId=1
        WdgMLocalStatusParams_Internal_Wdg (WdgMLocalStatusParams):
          WdgMFailedAliveSupervisionRefCycleTol = 0
          WdgMSupervisedEntityInitialMode = WDGM_LOCAL_STATUS_OK
          WdgMFailedDeadlineRefCycleTol = 0
          WdgMDeadlineReferenceCycle = 0
          WdgMFailedProgramFlowRefCycleTol = 0
          WdgMProgramFlowReferenceCycle = 0
          WdgMLocalStatusSupervisedEntityRef = SE_Internal_Wdg
        Alive_Supervision_Internal_Wdg (WdgMAliveSupervision):
          WdgMExpectedAliveIndications = 10
          WdgMMaxMargin = 1
          WdgMMinMargin = 1
          WdgMSupervisionReferenceCycle = 10
          WdgMAliveSupervisionCheckpointRef = CP_Internal_Wdg
        WdgMLocalStatusParams_Internal_Wdg_Dummy (WdgMLocalStatusParams):
          WdgMFailedAliveSupervisionRefCycleTol = 0
          WdgMSupervisedEntityInitialMode = WDGM_LOCAL_STATUS_DEACTIVATED
          WdgMFailedDeadlineRefCycleTol = 0
          WdgMDeadlineReferenceCycle = 0
          WdgMFailedProgramFlowRefCycleTol = 0
          WdgMProgramFlowReferenceCycle = 0
          WdgMLocalStatusSupervisedEntityRef = SE_Internal_Wdg_Dummy
        Alive_Program_Flow_Monitoring (WdgMAliveSupervision):
          WdgMExpectedAliveIndications = 3
          WdgMMaxMargin = 1
          WdgMMinMargin = 1
          WdgMSupervisionReferenceCycle = 30
          WdgMAliveSupervisionCheckpointRef = CP_Alive_Program_Flow_Monitoring
        WdgMLocalStatusParams_Alive_Program_Flow_Monitoring (WdgMLocalStatusParams):
          WdgMFailedAliveSupervisionRefCycleTol = 0
          WdgMSupervisedEntityInitialMode = WDGM_LOCAL_STATUS_DEACTIVATED
          WdgMFailedDeadlineRefCycleTol = 0
          WdgMDeadlineReferenceCycle = 0
          WdgMFailedProgramFlowRefCycleTol = 0
          WdgMProgramFlowReferenceCycle = 0
          WdgMLocalStatusSupervisedEntityRef = SE_Alive_Program_Flow_Monitoring
        5 x WdgMAliveSupervision, all with WdgMMaxMargin=1, WdgMMinMargin=1, WdgMSupervisionReferenceCycle=20:
          WdgMAliveSupervision_Internal_Wdg_Appl_IPC_Task: WdgMExpectedAliveIndications=2, WdgMAliveSupervisionCheckpointRef=CP_Internal_Wdg_Appl_IPC_Task
          WdgMAliveSupervision_Internal_Wdg_Appl_Task_Communication: WdgMExpectedAliveIndications=4, WdgMAliveSupervisionCheckpointRef=CP_Internal_Wdg_Appl_Task_Communication
          WdgMAliveSupervision_Internal_Wdg_Appl_Task_Radar_Control: WdgMExpectedAliveIndications=2, WdgMAliveSupervisionCheckpointRef=CP_Internal_Wdg_Appl_Task_Radar_Control
          WdgMAliveSupervision_Internal_Wdg_BSW_Task: WdgMExpectedAliveIndications=4, WdgMAliveSupervisionCheckpointRef=CP_Internal_Wdg_BSW_Task
          WdgMAliveSupervision_Internal_Wdg_PLT_Appl_Task: WdgMExpectedAliveIndications=4, WdgMAliveSupervisionCheckpointRef=SE_Internal_Wdg_PLT_Appl_Task/SE_Internal_Wdg_PLT_Appl_Task
        5 x WdgMLocalStatusParams, all with WdgMFailedAliveSupervisionRefCycleTol=0, WdgMSupervisedEntityInitialMode=WDGM_LOCAL_STATUS_DEACTIVATED, WdgMFailedDeadlineRefCycleTol=0, WdgMDeadlineReferenceCycle=0, WdgMFailedProgramFlowRefCycleTol=0, WdgMProgramFlowReferenceCycle=0:
          WdgMLocalStatusParams_Internal_Wdg_Appl_IPC_Task: WdgMLocalStatusSupervisedEntityRef=SE_Internal_Wdg_Appl_IPC_Task
          WdgMLocalStatusParams_Internal_Wdg_Appl_Task_Communication: WdgMLocalStatusSupervisedEntityRef=SE_Internal_Wdg_Appl_Task_Communication
          WdgMLocalStatusParams_Internal_Wdg_Appl_Task_Radar_Control: WdgMLocalStatusSupervisedEntityRef=SE_Internal_Wdg_Appl_Task_Radar_Control
          WdgMLocalStatusParams_Internal_Wdg_BSW_Task: WdgMLocalStatusSupervisedEntityRef=SE_Internal_Wdg_BSW_Task
          WdgMLocalStatusParams_Internal_Wdg_PLT_Appl_Task: WdgMLocalStatusSupervisedEntityRef=WdgMGeneral/SE_Internal_Wdg_PLT_Appl_Task
    WdgMGeneral:
      WdgMDevErrorDetect = true
      WdgMDemReport = false
      WdgMImmediateReset = true
      WdgMOffModeEnabled = true
      WdgMVersionInfoApi = false
      WdgMDefensiveBehavior = false
      WdgMUseRte = true
      WdgMDemSupervisionReport = false
      WdgMFirstCycleAliveCounterReset = false
      WdgMAutosarDebugging = false
      WdgMUseOsSuspendInterrupt = true
      WdgMTimebaseSource = WDGM_INTERNAL_SOFTWARE_TICK
      WdgMSecondResetPath = true
      WdgMTickOverrunCorrection = false
      WdgMEntityDeactivationEnabled = true
      WdgMGenerateCPIdAsPortDefinedArgument = false
      WdgMStatusReportingMechanism = WDGM_USE_MODE_SWITCH_PORTS
      WdgMCallerIds: WdgMCallerId=0
      SE_Internal_Wdg (WdgMSupervisedEntity):
        WdgMSupervisedEntityId = 1
        WdgMEnableEntityDeactivation = true
        WdgMReportStatusViaRte = true
        WdgMInternalCheckpointInitialRef = CP_Internal_Wdg
        WdgMAppTaskRef = OsCore0_ASIL
        CP_Internal_Wdg (WdgMCheckpoint): WdgMCheckpointId=0
      WdgMWatchdog: WdgMWatchdogName=WDG, WdgMWatchdogDeviceRef=WdgIfDevice
      7 x WdgMSupervisedEntity, all with WdgMEnableEntityDeactivation=true, WdgMReportStatusViaRte=true, WdgMAppTaskRef=OsCore0_ASIL:
        SE_Internal_Wdg_Dummy: WdgMSupervisedEntityId=0, WdgMInternalCheckpointInitialRef=CP_Internal_Wdg_Dummy
          CP_Internal_Wdg_Dummy (WdgMCheckpoint): WdgMCheckpointId=0
        SE_Alive_Program_Flow_Monitoring: WdgMSupervisedEntityId=2, WdgMInternalCheckpointInitialRef=CP_Alive_Program_Flow_Monitoring
          CP_Alive_Program_Flow_Monitoring (WdgMCheckpoint): WdgMCheckpointId=0
        SE_Internal_Wdg_Appl_IPC_Task: WdgMSupervisedEntityId=3, WdgMInternalCheckpointInitialRef=CP_Internal_Wdg_Appl_IPC_Task
          CP_Internal_Wdg_Appl_IPC_Task (WdgMCheckpoint): WdgMCheckpointId=0
        SE_Internal_Wdg_Appl_Task_Communication: WdgMSupervisedEntityId=5, WdgMInternalCheckpointInitialRef=CP_Internal_Wdg_Appl_Task_Communication
          CP_Internal_Wdg_Appl_Task_Communication (WdgMCheckpoint): WdgMCheckpointId=0
        SE_Internal_Wdg_Appl_Task_Radar_Control: WdgMSupervisedEntityId=6, WdgMInternalCheckpointInitialRef=CP_Internal_Wdg_Appl_Task_Radar_Control
          CP_Internal_Wdg_Appl_Task_Radar_Control (WdgMCheckpoint): WdgMCheckpointId=0
        SE_Internal_Wdg_BSW_Task: WdgMSupervisedEntityId=7, WdgMInternalCheckpointInitialRef=CP_Internal_Wdg_BSW_Task
          CP_Internal_Wdg_BSW_Task (WdgMCheckpoint): WdgMCheckpointId=0
        SE_Internal_Wdg_PLT_Appl_Task: WdgMSupervisedEntityId=4, WdgMInternalCheckpointInitialRef=SE_Internal_Wdg_PLT_Appl_Task/SE_Internal_Wdg_PLT_Appl_Task
          SE_Internal_Wdg_PLT_Appl_Task (WdgMCheckpoint): WdgMCheckpointId=0
