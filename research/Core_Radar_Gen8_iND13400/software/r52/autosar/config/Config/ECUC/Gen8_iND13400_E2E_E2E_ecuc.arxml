AUTOSAR XML (schema 00053)
package /ActiveEcuC
  module config E2E: implementation-config-variant=VARIANT-PRE-COMPILE, module-description=E2E_Impl
