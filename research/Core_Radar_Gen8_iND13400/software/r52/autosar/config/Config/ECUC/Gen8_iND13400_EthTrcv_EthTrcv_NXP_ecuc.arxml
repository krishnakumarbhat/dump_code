AUTOSAR XML (schema 00053)
package /ActiveEcuC
  module config EthTrcv_NXP: definition=EthTrcv, implementation-config-variant=VARIANT-PRE-COMPILE, module-description=EthTrcv_Impl
    EthTrcvGeneral:
      EthTrcvDevErrorDetect = true
      EthTrcvGetBaudRateApi = true
      EthTrcvGetDuplexModeApi = true
      EthTrcvGetLinkStateApi = true
      EthTrcvGetTransceiverModeApi = true
      EthTrcvMaxTrcvsSupported = 1
      EthTrcvSetTransceiverModeApi = true
      EthTrcvStartAutoNegotiationApi = false
      EthTrcvVersionInfoApi = false
      EthTrcvIndex = 1
      EthTrcvRuntimeMeasurementSupport = true
      EthTrcvWakeUpSupport = ETHTRCV_WAKEUP_NOT_SUPPORTED
      EthTrcvMainFunctionPeriod = 1
      EthTrcvHwAccessLoopCount = 100
      EthTrcvSafeBswChecks = true
      EthTrcvCableDiagLoopCount = 10000
      EthTrcvPostTrcvInitUserCallout = TJA1103_PHY_Post_Init
      EthTrcvPreTrcvInitUserCallout = TJA1103_PHY_Pre_Init
      EthTrcvRunCableDiagnosticApi = true
      EthTrcvMacSecApi = false
      EthTrcvCalloutIncludeFiles = PHY_User_Cbk.h
    EthTrcvConfigSet
      EthTrcvConfig_TJA1103B (EthTrcvConfig):
        EthTrcvIdx = 0
        EthTrcvSpeed = TRCV_SPEED_100
        EthTrcvConnNeg = ETHTRCV_CONN_NEG_SLAVE
        EthTrcvPhySignalQualityMeanValueLength = 100
        EthTrcvSoftResetOnInit = true
        EthTrcvAutoNegotiationEnabled = false
        EthTrcvDerivative = Tja1103B
        EthTrcvPolaritySwap = POL_NO_CORRECTION
        EthTrcvHwAccessMonitorEnabled = false
        EthTrcvMacSecEnabled = false
        EthTrcvMacSecVctEnabled = false
        EthTrcvMacSecS0IEnabled = false
        EthTrcvSoftResetWaitCycles = 100
        EthTrcvMgmtInterface
          EthTrcvMiiInterface: EthTrcvMiiIdx=27, EthTrcvMiiSelection=ETHTRCV_STRAPPING_CONFIG_ONLY, EthTrcvSGMIIMode=SGMII4WIRE, EthTrcvCtrlRef=RDR_1_Eth_Controller_1_6addc1bb
        EthTrcvSmiConfiguration: EthTrcvSmiIdlePreCharge=true
