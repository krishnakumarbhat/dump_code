AUTOSAR XML (schema 00053)
package /ActiveEcuC
  module config J1939Dcm: implementation-config-variant=VARIANT-PRE-COMPILE, module-description=J1939Dcm_Impl
    J1939DcmConfigSet
      J1939DcmChannel: J1939DcmBusType=J1939DCM_J1939_NETWORK_1, J1939DcmComMChannelRef=CN_VCAN_RADAR_489180b6
      J1939DcmNode: J1939DcmNmNodeRef=J1939NmNode, J1939DcmRmUserRef=J1939RmUser, J1939DcmDemClientRef=DemClient
        J1939DcmDiagnosticMessageSupport: J1939DcmDmxSupport=J1939DCM_DM1_SUPPORT, J1939DcmDiagnosticMessageSupportChannelRef=J1939DcmChannel
          J1939DcmTxPdu: J1939DcmTxPduId=0, J1939DcmTxPduRef=DM1_D0_oVCAN_RADAR_94793fbe_Tx
    J1939DcmGeneral:
      J1939DcmCommonBufferSize = 1785
      J1939DcmDevErrorDetect = true
      J1939DcmMainFunctionPeriod = 0.01
      J1939DcmVersionInfoApi = false
      J1939DcmDM01MaxDTCs = 20
      J1939DcmSafeBswChecks = true
