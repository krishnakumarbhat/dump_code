AUTOSAR XML (schema 00053)
package /ActiveEcuC
  module config SomeIpTp: implementation-config-variant=VARIANT-PRE-COMPILE, module-description=SomeIpTp_Impl
    SomeIpTpGeneral:
      SomeIpTpDevErrorDetect = true
      SomeIpTpRxMainFunctionPeriod = 0.005
      SomeIpTpTxMainFunctionPeriod = 0.005
      SomeIpTpVersionInfoApi = false
      SomeIpTpRuntimeErrorReport = true
      SomeIpTpSafeBswChecks = true
    signalPdu_RDR_1_Detections_52b391ee (SomeIpTpChannel): SomeIpTpNPduSeparationTime=0.001, SomeIpTpRxTimeoutTime=0.5, SomeIpTpTxConfTimeoutTime=0.5
      PDUTriggering14_Detections_RDR1_to_ADAS_de104d9b (SomeIpTpTxNSdu): SomeIpTpTxNSduHandleId=0, SomeIpTpTxBurstSize=8, SomeIpTpTxNSduRef=signalPdu_RDR_1_Detections_52b391ee_Tx
        PDUTriggering14_Detections_RDR1_to_ADAS_Transport_3817dced (SomeIpTpTxNPdu): SomeIpTpTxNPduHandleId=0, SomeIpTpTxNPduRef=signalPdu_RDR_1_Detections_Transport_d322aa23_Tx
