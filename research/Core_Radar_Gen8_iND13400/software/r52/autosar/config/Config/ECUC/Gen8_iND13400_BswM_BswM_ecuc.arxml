AUTOSAR XML (schema 00053)
package /ActiveEcuC
  module config BswM: implementation-config-variant=VARIANT-PRE-COMPILE, module-description=BswM_Impl
    BswMGeneral:
      BswMCanSMEnabled = true
      BswMComMEnabled = true
      BswMDcmEnabled = true
      BswMDevErrorDetect = true
      BswMEcuMEnabled = true
      BswMEthIfEnabled = true
      BswMEthSMEnabled = true
      BswMFrSMEnabled = false
      BswMGenericRequestEnabled = true
      BswMJ1939DcmEnabled = true
      BswMJ1939NmEnabled = false
      BswMLinSMEnabled = false
      BswMLinTPEnabled = false
      BswMNmEnabled = false
      BswMNvMEnabled = true
      BswMPduREnabled = true
      BswMRuleControlEnabled = false
      BswMSdEnabled = true
      BswMVersionInfoApi = false
      BswMWdgMEnabled = true
      BswMModeCheck = true
      BswMActionListQueueSearchAlgorithm = LINEAR_SEARCH
      BswMSafeBswChecks = true
      BswMMainFunctionPeriod = 0.01
      BswMDoIPEnabled = false
      BswMDoIPIntEnabled = false
      BswMCanSMIcomEnabled = false
      BswMJ1939KaEnabled = false
      BswMSchMEnabled = false
      BswMCommonData_RDR_01 (BswMCommonData): variation-point=post-build-variant-condition{matching-criterion=RDR_POS, value=0}
      BswMGeneration:
        BswMOutOfBoundsWriteSanitizer = false
        BswMOutOfBoundsReadSanitizer = false
        BswMReduceConstantData2Define = true
        BswMBoolDataInArrayOfStructStrategy = BITMASKING
      BswMUserIncludeFiles: BswMUserIncludeFile=EcuM_Init_PBcfg.h
      7 x BswMCommonData:
        BswMCommonData_RDR_02: variation-point=post-build-variant-condition{matching-criterion=RDR_POS, value=1}
        BswMCommonData_RDR_03: variation-point=post-build-variant-condition{matching-criterion=RDR_POS, value=2}
        BswMCommonData_RDR_04: variation-point=post-build-variant-condition{matching-criterion=RDR_POS, value=3}
        BswMCommonData_RDR_05: variation-point=post-build-variant-condition{matching-criterion=RDR_POS, value=4}
        BswMCommonData_RDR_06: variation-point=post-build-variant-condition{matching-criterion=RDR_POS, value=5}
        BswMCommonData_RDR_07: variation-point=post-build-variant-condition{matching-criterion=RDR_POS, value=6}
        BswMCommonData_RDR_08: variation-point=post-build-variant-condition{matching-criterion=RDR_POS, value=7}
    BswMConfig
      BswMArbitration
        ESH_RunToPostRun (BswMRule):
          BswMNestedExecutionOnly = false
          BswMRuleId = 12
          BswMRuleInitState = BSWM_FALSE
          BswMRuleExpressionRef = ESH_LE_RunToPostRunTransition
          BswMRuleTrueActionList = ESH_AL_RunToPostRun
        ESH_LE_RunToPostRunTransition (BswMLogicalExpression): BswMLogicalOperator=BSWM_AND, BswMArgumentRef=ESH_LE_RunReached, BswMArgumentRef=ESH_LE_NoRunAndNoKillAllRequest
        ESH_LE_RunReached (BswMLogicalExpression): BswMLogicalOperator=BSWM_AND, BswMArgumentRef=ESH_Cond_StateIsRun
        ESH_Cond_StateIsRun (BswMModeCondition): BswMConditionType=BSWM_EQUALS, BswMConditionMode=ESH_State
          BswMConditionValue
            BswMBswMode: BswMBswRequestedMode=ESH_RUN
        ESH_State (BswMModeRequestPort): BswMArbitrateOnInit=true, BswMRequestProcessing=BSWM_IMMEDIATE
          BswMModeRequestSource
            BswMGenericRequest: BswMModeRequesterId=230, BswMRequestedModeMax=0
              7 x BswMGenericRequestMode:
                ESH_INIT: BswMGenericRequestModeValue=0
                ESH_RUN: BswMGenericRequestModeValue=1
                ESH_POST_RUN: BswMGenericRequestModeValue=2
                ESH_PREP_SHUTDOWN: BswMGenericRequestModeValue=3
                ESH_WAIT_FOR_NVM: BswMGenericRequestModeValue=4
                ESH_SHUTDOWN: BswMGenericRequestModeValue=5
                ESH_WAKEUP: BswMGenericRequestModeValue=6
          BswMModeInitValue: BswMBswModeInitValue=ESH_INIT
        3 x BswMLogicalExpression:
          ESH_LE_NoRunAndNoKillAllRequest: BswMLogicalOperator=BSWM_OR, BswMArgumentRef=ESH_LE_NoRunReasons
          ESH_LE_NoRunReasons: BswMLogicalOperator=BSWM_AND, BswMArgumentRef=ESH_LE_RunReleased, BswMArgumentRef=ESH_Cond_SelfRunReqTimerExpired
          ESH_LE_RunReleased: BswMLogicalOperator=BSWM_AND, BswMArgumentRef=ESH_Cond_RunRequest0IsReleased, BswMArgumentRef=ESH_Cond_RunRequest1IsReleased
        ESH_Cond_RunRequest0IsReleased (BswMModeCondition): BswMConditionType=BSWM_EQUALS, BswMConditionMode=ESH_RunRequest_0
          BswMConditionValue
            BswMModeDeclaration: BswMModeValueRef=RELEASED
        ESH_RunRequest_0 (BswMModeRequestPort): BswMArbitrateOnInit=false, BswMRequestProcessing=BSWM_DEFERRED
          BswMModeRequestSource
            BswMSwcModeRequest: BswMModeRequestDataElementPrototypeName=requestedMode, BswMSwcModeRequestModeDeclarationGroupPrototypeRef=BswM_MDGP_ESH_RunRequest
          BswMModeInitValue: BswMSwcModeInitValueRef=RELEASED
        ESH_Cond_RunRequest1IsReleased (BswMModeCondition): BswMConditionType=BSWM_EQUALS, BswMConditionMode=ESH_RunRequest_1
          BswMConditionValue
            BswMModeDeclaration: BswMModeValueRef=RELEASED
        ESH_RunRequest_1 (BswMModeRequestPort): BswMArbitrateOnInit=false, BswMRequestProcessing=BSWM_DEFERRED
          BswMModeRequestSource
            BswMSwcModeRequest: BswMModeRequestDataElementPrototypeName=requestedMode, BswMSwcModeRequestModeDeclarationGroupPrototypeRef=BswM_MDGP_ESH_RunRequest
          BswMModeInitValue: BswMSwcModeInitValueRef=RELEASED
        ESH_Cond_SelfRunReqTimerExpired (BswMModeCondition): BswMConditionType=BSWM_EQUALS, BswMConditionMode=ESH_SelfRunRequestTimer
          BswMConditionValue
            BswMBswMode: BswMBswRequestedMode=BSWM_TIMER_EXPIRED
        ESH_SelfRunRequestTimer (BswMModeRequestPort): BswMArbitrateOnInit=false, BswMRequestProcessing=BSWM_DEFERRED
          BswMModeRequestSource
            BswMTimer
          BswMModeInitValue: BswMBswModeInitValue=BSWM_TIMER_STOPPED
        ESH_LE_WaitForNvMToShutdown (BswMLogicalExpression):
          BswMLogicalOperator = BSWM_AND
          BswMArgumentRef = ESH_Cond_StateIsWaitForNvm
          BswMArgumentRef = ESH_LE_WriteNotPending
          BswMArgumentRef = ESH_LE_NoWakeupOrKillAll
        ESH_Cond_StateIsWaitForNvm (BswMModeCondition): BswMConditionType=BSWM_EQUALS, BswMConditionMode=ESH_State
          BswMConditionValue
            BswMBswMode: BswMBswRequestedMode=ESH_WAIT_FOR_NVM
        ESH_LE_NoWakeupOrKillAll (BswMLogicalExpression): BswMArgumentRef=ESH_LE_NoWakeup
        ESH_LE_NoWakeup (BswMLogicalExpression): BswMLogicalOperator=BSWM_AND, BswMArgumentRef=BswMModeCondition, BswMArgumentRef=ESH_Cond_NoValidatedWakeups
        ESH_Cond_NoValidatedWakeups (BswMModeCondition): BswMConditionType=BSWM_EQUALS, BswMConditionMode=ESH_EcuM_GetValidatedWakeupEvents
          BswMConditionValue
            BswMBswMode: BswMBswRequestedMode=0
        ESH_EcuM_GetValidatedWakeupEvents (BswMModeRequestPort): BswMArbitrateOnInit=false, BswMRequestProcessing=BSWM_DEFERRED
          BswMModeRequestSource
            BswMUserConditionRequest: BswMUserCondition=EcuM_GetValidatedWakeupEvents()
        ESH_WakeupToPrep (BswMRule):
          BswMNestedExecutionOnly = false
          BswMRuleId = 14
          BswMRuleInitState = BSWM_FALSE
          BswMRuleExpressionRef = ESH_LE_WakeupToPrepShutdown
          BswMRuleTrueActionList = ESH_AL_WakeupToPrep
        ESH_LE_WakeupToPrepShutdown (BswMLogicalExpression):
          BswMLogicalOperator = BSWM_AND
          BswMArgumentRef = ESH_Cond_StateIsWakeup
          BswMArgumentRef = ESH_LE_CancelNotPending
          BswMArgumentRef = ESH_Cond_NoPendingWakeups
          BswMArgumentRef = ESH_LE_NoWakeup
        ESH_Cond_StateIsWakeup (BswMModeCondition): BswMConditionType=BSWM_EQUALS, BswMConditionMode=ESH_State
          BswMConditionValue
            BswMBswMode: BswMBswRequestedMode=ESH_WAKEUP
        ESH_Cond_NoPendingWakeups (BswMModeCondition): BswMConditionType=BSWM_EQUALS, BswMConditionMode=ESH_EcuM_GetPendingWakeupEvents
          BswMConditionValue
            BswMBswMode: BswMBswRequestedMode=0
        ESH_EcuM_GetPendingWakeupEvents (BswMModeRequestPort): BswMArbitrateOnInit=false, BswMRequestProcessing=BSWM_DEFERRED
          BswMModeRequestSource
            BswMUserConditionRequest: BswMUserCondition=EcuM_GetPendingWakeupEvents()
        ESH_WaitToWakeup (BswMRule):
          BswMNestedExecutionOnly = false
          BswMRuleId = 13
          BswMRuleInitState = BSWM_FALSE
          BswMRuleExpressionRef = ESH_LE_WaitForNvMToWakeup
          BswMRuleTrueActionList = ESH_AL_WaitForNvMWakeup
        ESH_LE_WaitForNvMToWakeup (BswMLogicalExpression): BswMLogicalOperator=BSWM_AND, BswMArgumentRef=ESH_Cond_StateIsWaitForNvm, BswMArgumentRef=ESH_LE_ValidWakeup
        ESH_LE_ValidWakeup (BswMLogicalExpression): BswMLogicalOperator=BSWM_OR, BswMArgumentRef=ESH_Cond_ValidatedWakeups
        ESH_Cond_ValidatedWakeups (BswMModeCondition): BswMConditionType=BSWM_EQUALS_NOT, BswMConditionMode=ESH_EcuM_GetValidatedWakeupEvents
          BswMConditionValue
            BswMBswMode: BswMBswRequestedMode=0
        ESH_WakeupToRun (BswMRule):
          BswMNestedExecutionOnly = false
          BswMRuleId = 15
          BswMRuleInitState = BSWM_FALSE
          BswMRuleExpressionRef = ESH_LE_WakeupToRun
          BswMRuleTrueActionList = ESH_AL_WakeupToRun
        ESH_LE_WakeupToRun (BswMLogicalExpression): BswMLogicalOperator=BSWM_AND, BswMArgumentRef=ESH_Cond_StateIsWakeup, BswMArgumentRef=ESH_LE_ValidWakeup, BswMArgumentRef=ESH_LE_CancelNotPending
        ESH_InitToWakeup (BswMRule):
          BswMNestedExecutionOnly = false
          BswMRuleId = 7
          BswMRuleInitState = BSWM_FALSE
          BswMRuleExpressionRef = ESH_LE_InitToWakeup
          BswMRuleTrueActionList = ESH_AL_InitToWakeup
        ESH_LE_InitToWakeup (BswMLogicalExpression): BswMLogicalOperator=BSWM_AND, BswMArgumentRef=ESH_Cond_StateIsInit
        ESH_Cond_StateIsInit (BswMModeCondition): BswMConditionType=BSWM_EQUALS, BswMConditionMode=ESH_State
          BswMConditionValue
            BswMBswMode: BswMBswRequestedMode=ESH_INIT
        ESH_PostRunToPrepNested (BswMRule):
          BswMNestedExecutionOnly = true
          BswMRuleId = 10
          BswMRuleInitState = BSWM_FALSE
          BswMRuleExpressionRef = ESH_LE_Dem_PostRunRequested
          BswMRuleTrueActionList = ESH_AL_PostRunToPrepShutdown
        3 x BswMLogicalExpression:
          ESH_LE_Dem_PostRunRequested: BswMLogicalOperator=BSWM_AND, BswMArgumentRef=ESH_LE_PostRunToPrep
          ESH_LE_PostRunToPrep: BswMLogicalOperator=BSWM_OR, BswMArgumentRef=ESH_LE_PostRunReleased
          ESH_LE_PostRunReleased: BswMLogicalOperator=BSWM_AND, BswMArgumentRef=ESH_Cond_PostRunRequest0IsReleased, BswMArgumentRef=ESH_Cond_PostRunRequest1IsReleased
        ESH_Cond_PostRunRequest0IsReleased (BswMModeCondition): BswMConditionType=BSWM_EQUALS, BswMConditionMode=ESH_PostRunRequest_0
          BswMConditionValue
            BswMModeDeclaration: BswMModeValueRef=RELEASED
        ESH_PostRunRequest_0 (BswMModeRequestPort): BswMArbitrateOnInit=false, BswMRequestProcessing=BSWM_DEFERRED
          BswMModeRequestSource
            BswMSwcModeRequest: BswMModeRequestDataElementPrototypeName=requestedMode, BswMSwcModeRequestModeDeclarationGroupPrototypeRef=BswM_MDGP_ESH_RunRequest
          BswMModeInitValue: BswMSwcModeInitValueRef=RELEASED
        ESH_Cond_PostRunRequest1IsReleased (BswMModeCondition): BswMConditionType=BSWM_EQUALS, BswMConditionMode=ESH_PostRunRequest_1
          BswMConditionValue
            BswMModeDeclaration: BswMModeValueRef=RELEASED
        ESH_PostRunRequest_1 (BswMModeRequestPort): BswMArbitrateOnInit=false, BswMRequestProcessing=BSWM_DEFERRED
          BswMModeRequestSource
            BswMSwcModeRequest: BswMModeRequestDataElementPrototypeName=requestedMode, BswMSwcModeRequestModeDeclarationGroupPrototypeRef=BswM_MDGP_ESH_RunRequest
          BswMModeInitValue: BswMSwcModeInitValueRef=RELEASED
        ESH_PostRunNested (BswMRule):
          BswMNestedExecutionOnly = true
          BswMRuleId = 9
          BswMRuleInitState = BSWM_FALSE
          BswMRuleExpressionRef = ESH_LE_PostRunToRun
          BswMRuleFalseActionList = ESH_AL_ESH_PostRunToPrepCheck
          BswMRuleTrueActionList = ESH_AL_PostRunToRun
        3 x BswMLogicalExpression:
          ESH_LE_PostRunToRun: BswMLogicalOperator=BSWM_AND, BswMArgumentRef=ESH_LE_RunRequestsOrWakeup
          ESH_LE_RunRequestsOrWakeup: BswMLogicalOperator=BSWM_OR, BswMArgumentRef=ESH_LE_ValidWakeup, BswMArgumentRef=ESH_LE_RunRequested
          ESH_LE_RunRequested: BswMLogicalOperator=BSWM_OR, BswMArgumentRef=ESH_Cond_RunRequest0IsRequested, BswMArgumentRef=ESH_Cond_RunRequest1IsRequested
        ESH_Cond_RunRequest0IsRequested (BswMModeCondition): BswMConditionType=BSWM_EQUALS, BswMConditionMode=ESH_RunRequest_0
          BswMConditionValue
            BswMModeDeclaration: BswMModeValueRef=REQUESTED
        ESH_Cond_RunRequest1IsRequested (BswMModeCondition): BswMConditionType=BSWM_EQUALS, BswMConditionMode=ESH_RunRequest_1
          BswMConditionValue
            BswMModeDeclaration: BswMModeValueRef=REQUESTED
        ESH_PostRun (BswMRule):
          BswMNestedExecutionOnly = false
          BswMRuleId = 8
          BswMRuleInitState = BSWM_FALSE
          BswMRuleExpressionRef = ESH_LE_PostRun
          BswMRuleTrueActionList = ESH_AL_ExitPostRun
        ESH_LE_PostRun (BswMLogicalExpression): BswMLogicalOperator=BSWM_AND, BswMArgumentRef=ESH_Cond_StateIsPostRun, BswMArgumentRef=ESH_Cond_SelfRunReqTimerExpired
        ESH_Cond_StateIsPostRun (BswMModeCondition): BswMConditionType=BSWM_EQUALS, BswMConditionMode=ESH_State
          BswMConditionValue
            BswMBswMode: BswMBswRequestedMode=ESH_POST_RUN
        ESH_PrepToWait (BswMRule):
          BswMNestedExecutionOnly = false
          BswMRuleId = 11
          BswMRuleInitState = BSWM_FALSE
          BswMRuleExpressionRef = ESH_LE_PrepShutdownToWaitForNvM
          BswMRuleTrueActionList = ESH_AL_PrepShutdownToWaitForNvM
        ESH_LE_PrepShutdownToWaitForNvM (BswMLogicalExpression): BswMLogicalOperator=BSWM_AND, BswMArgumentRef=ESH_Cond_StateIsPrepShutdown
        ESH_Cond_StateIsPrepShutdown (BswMModeCondition): BswMConditionType=BSWM_EQUALS, BswMConditionMode=ESH_State
          BswMConditionValue
            BswMBswMode: BswMBswRequestedMode=ESH_PREP_SHUTDOWN
        ComMIndication_RDR_EthConnector1_de653f65 (BswMModeRequestPort): BswMArbitrateOnInit=false, BswMRequestProcessing=BSWM_DEFERRED
          BswMModeRequestSource
            BswMComMIndication: BswMComMChannelRef=cnctr_RDR_RdrNet_5172a59b
          BswMModeInitValue: BswMBswModeInitValue=COMM_NO_COMMUNICATION
        BswMModeCondition: BswMConditionType=BSWM_EQUALS, BswMConditionMode=ComMIndication_RDR_EthConnector1_de653f65
          BswMConditionValue
            BswMBswMode: BswMBswRequestedMode=COMM_NO_COMMUNICATION
        SDC_ApplRequest_S_provService_RDR_1_Detections_89f78c9f (BswMRule):
          BswMNestedExecutionOnly = false
          BswMRuleId = 18
          BswMRuleInitState = BSWM_FALSE
          BswMRuleExpressionRef = SDC_LE_ApplRequest_S_provService_RDR_1_Detections_89f78c9f
          BswMRuleFalseActionList = SDC_AL_ApplRelease_S_provService_RDR_1_Detections_89f78c9f
          BswMRuleTrueActionList = SDC_AL_ApplRequest_S_provService_RDR_1_Detections_89f78c9f
        SDC_LE_ApplRequest_S_provService_RDR_1_Detections_89f78c9f (BswMLogicalExpression): BswMLogicalOperator=BSWM_AND, BswMArgumentRef=SDC_Cond_S_provService_RDR_1_Detections_89f78c9f_EQ_SDC_SERVER_AVAILABE
        SDC_Cond_S_provService_RDR_1_Detections_89f78c9f_EQ_SDC_SERVER_AVAILABE (BswMModeCondition): BswMConditionType=BSWM_EQUALS, BswMConditionMode=SDC_S_provService_RDR_1_Detections_89f78c9f
          BswMConditionValue
            BswMModeDeclaration: BswMModeValueRef=SDC_SERVER_AVAILABE
        SDC_S_provService_RDR_1_Detections_89f78c9f (BswMModeRequestPort): BswMArbitrateOnInit=false, BswMRequestProcessing=BSWM_DEFERRED
          BswMModeRequestSource
            BswMSwcModeRequest: BswMModeRequestDataElementPrototypeName=requestedMode, BswMSwcModeRequestModeDeclarationGroupPrototypeRef=BswM_MDGP_SDC_SdServerServiceRequest
          BswMModeInitValue: BswMSwcModeInitValueRef=SDC_SERVER_DOWN
        SDC_SdStateChange_S_provService_RDR_1_SW_Info_c2745ec9_EH_EventGroup_RDR_1_653e2581 (BswMRule):
          BswMNestedExecutionOnly = false
          BswMRuleId = 24
          BswMRuleInitState = BSWM_FALSE
          BswMRuleExpressionRef = SDC_LE_S_provService_RDR_1_SW_Info_c2745ec9_EH_EventGroup_RDR_1_653e2581IsRequested
          BswMRuleFalseActionList = SDC_AL_SdRelease_S_provService_RDR_1_SW_Info_c2745ec9_EH_EventGroup_RDR_1_653e2581
          BswMRuleTrueActionList = SDC_AL_SdRequest_S_provService_RDR_1_SW_Info_c2745ec9_EH_EventGroup_RDR_1_653e2581
        SDC_LE_S_provService_RDR_1_SW_Info_c2745ec9_EH_EventGroup_RDR_1_653e2581IsRequested (BswMLogicalExpression):
          BswMLogicalOperator = BSWM_AND
          BswMArgumentRef = SDC_Cond_SdEHState_S_provService_RDR_1_SW_Info_c2745ec9_EH_EventGroup_RDR_1_653e2581_EQ_SD_EVENT_HANDLER_REQUESTED
        SDC_Cond_SdEHState_S_provService_RDR_1_SW_Info_c2745ec9_EH_EventGroup_RDR_1_653e2581_EQ_SD_EVENT_HANDLER_REQUESTED (BswMModeCondition): BswMConditionType=BSWM_EQUALS, BswMConditionMode=SDC_SdEHState_S_provService_RDR_1_SW_Info_c2745ec9_EH_EventGroup_RDR_1_653e2581
          BswMConditionValue
            BswMBswMode: BswMBswRequestedMode=SD_EVENT_HANDLER_REQUESTED
        SDC_SdEHState_S_provService_RDR_1_SW_Info_c2745ec9_EH_EventGroup_RDR_1_653e2581 (BswMModeRequestPort): BswMArbitrateOnInit=false, BswMRequestProcessing=BSWM_DEFERRED
          BswMModeRequestSource
            BswMSdEventHandlerCurrentState: BswMSdEventHandlerRef=EventGroup_RDR_1_653e2581
          BswMModeInitValue: BswMBswModeInitValue=SD_EVENT_HANDLER_RELEASED
        SDC_ApplRequest_C_consService_RDR_1_ADAS_Vehicle_Status_2b1e055b_CEG_consServiceGrp_RDR_1_ADAS_Vehicle_Status_4b79da85 (BswMRule):
          BswMNestedExecutionOnly = false
          BswMRuleId = 17
          BswMRuleInitState = BSWM_FALSE
          BswMRuleExpressionRef = SDC_LE_ApplRequest_C_consService_RDR_1_ADAS_Vehicle_Status_2b1e055b_CEG_consServiceGrp_RDR_1_ADAS_Vehicle_Status_4b79da85
          BswMRuleFalseActionList = SDC_AL_ApplRelease_C_consService_RDR_1_ADAS_Vehicle_Status_2b1e055b_CEG_consServiceGrp_RDR_1_ADAS_Vehicle_Status_4b79da85
          BswMRuleTrueActionList = SDC_AL_ApplRequest_C_consService_RDR_1_ADAS_Vehicle_Status_2b1e055b_CEG_consServiceGrp_RDR_1_ADAS_Vehicle_Status_4b79da85
        SDC_LE_ApplRequest_C_consService_RDR_1_ADAS_Vehicle_Status_2b1e055b_CEG_consServiceGrp_RDR_1_ADAS_Vehicle_Status_4b79da85 (BswMLogicalExpression):
          BswMLogicalOperator = BSWM_AND
          BswMArgumentRef = SDC_Cond_C_consService_RDR_1_ADAS_Vehicle_Status_2b1e055b_CEG_consServiceGrp_RDR_1_ADAS_Vehicle_Status_4b79da85_EQ_SDC_84c0800a
        SDC_Cond_C_consService_RDR_1_ADAS_Vehicle_Status_2b1e055b_CEG_consServiceGrp_RDR_1_ADAS_Vehicle_Status_4b79da85_EQ_SDC_84c0800a (BswMModeCondition):
          BswMConditionType = BSWM_EQUALS
          BswMConditionMode = SDC_C_consService_RDR_1_ADAS_Vehicle_Status_2b1e055b_CEG_consServiceGrp_RDR_1_ADAS_Vehicle_Status_4b79da85
          BswMConditionValue
            BswMModeDeclaration: BswMModeValueRef=SDC_CEG_REQUESTED
        SDC_C_consService_RDR_1_ADAS_Vehicle_Status_2b1e055b_CEG_consServiceGrp_RDR_1_ADAS_Vehicle_Status_4b79da85 (BswMModeRequestPort): BswMArbitrateOnInit=false, BswMRequestProcessing=BSWM_DEFERRED
          BswMModeRequestSource
            BswMSwcModeRequest:
              BswMModeRequestDataElementPrototypeName = requestedMode
              BswMSwcModeRequestModeDeclarationGroupPrototypeRef = BswM_MDGP_SDC_SdConsumedEventGroupRequest
          BswMModeInitValue: BswMSwcModeInitValueRef=SDC_CEG_RELEASED
        SDC_ApplRequest_C_consService_RDR_1_ADAS_Vehicle_Status_2b1e055b (BswMRule):
          BswMNestedExecutionOnly = false
          BswMRuleId = 16
          BswMRuleInitState = BSWM_FALSE
          BswMRuleExpressionRef = SDC_LE_ApplRequest_C_consService_RDR_1_ADAS_Vehicle_Status_2b1e055b
          BswMRuleFalseActionList = SDC_AL_ApplRelease_C_consService_RDR_1_ADAS_Vehicle_Status_2b1e055b
          BswMRuleTrueActionList = SDC_AL_ApplRequest_C_consService_RDR_1_ADAS_Vehicle_Status_2b1e055b
        SDC_LE_ApplRequest_C_consService_RDR_1_ADAS_Vehicle_Status_2b1e055b (BswMLogicalExpression): BswMLogicalOperator=BSWM_AND, BswMArgumentRef=SDC_Cond_C_consService_RDR_1_ADAS_Vehicle_Status_2b1e055b_EQ_SDC_CLIENT_REQUESTED
        SDC_Cond_C_consService_RDR_1_ADAS_Vehicle_Status_2b1e055b_EQ_SDC_CLIENT_REQUESTED (BswMModeCondition): BswMConditionType=BSWM_EQUALS, BswMConditionMode=SDC_C_consService_RDR_1_ADAS_Vehicle_Status_2b1e055b
          BswMConditionValue
            BswMModeDeclaration: BswMModeValueRef=SDC_CLIENT_REQUESTED
        SDC_C_consService_RDR_1_ADAS_Vehicle_Status_2b1e055b (BswMModeRequestPort): BswMArbitrateOnInit=false, BswMRequestProcessing=BSWM_DEFERRED
          BswMModeRequestSource
            BswMSwcModeRequest: BswMModeRequestDataElementPrototypeName=requestedMode, BswMSwcModeRequestModeDeclarationGroupPrototypeRef=BswM_MDGP_SDC_SdClientServiceRequest
          BswMModeInitValue: BswMSwcModeInitValueRef=SDC_CLIENT_RELEASED
        SDC_SdStateChange_C_consService_RDR_1_ADAS_Vehicle_Status_2b1e055b_CEG_consServiceGrp_RDR_1_ADAS_Vehicle_Status_4b79da85 (BswMRule):
          BswMNestedExecutionOnly = false
          BswMRuleId = 22
          BswMRuleInitState = BSWM_FALSE
          BswMRuleExpressionRef = SDC_LE_C_consService_RDR_1_ADAS_Vehicle_Status_2b1e055b_CEG_consServiceGrp_RDR_1_ADAS_Vehicle_Status_4b79da85IsAvailable
          BswMRuleFalseActionList = SDC_AL_SdDown_C_consService_RDR_1_ADAS_Vehicle_Status_2b1e055b_CEG_consServiceGrp_RDR_1_ADAS_Vehicle_Status_4b79da85_DOWN
          BswMRuleTrueActionList = SDC_AL_SdAvailable_C_consService_RDR_1_ADAS_Vehicle_Status_2b1e055b_CEG_consServiceGrp_RDR_1_ADAS_Vehicle_Status_4b79da_028f42eb
        SDC_LE_C_consService_RDR_1_ADAS_Vehicle_Status_2b1e055b_CEG_consServiceGrp_RDR_1_ADAS_Vehicle_Status_4b79da85IsAvailable (BswMLogicalExpression):
          BswMLogicalOperator = BSWM_AND
          BswMArgumentRef = SDC_Cond_SdCEGState_C_consService_RDR_1_ADAS_Vehicle_Status_2b1e055b_CEG_consServiceGrp_RDR_1_ADAS_Vehicle_Status_4b79d_6a9ac975
        SDC_Cond_SdCEGState_C_consService_RDR_1_ADAS_Vehicle_Status_2b1e055b_CEG_consServiceGrp_RDR_1_ADAS_Vehicle_Status_4b79d_6a9ac975 (BswMModeCondition):
          BswMConditionType = BSWM_EQUALS
          BswMConditionMode = SDC_SdCEGState_C_consService_RDR_1_ADAS_Vehicle_Status_2b1e055b_CEG_consServiceGrp_RDR_1_ADAS_Vehicle_Status_4b79da85
          BswMConditionValue
            BswMBswMode: BswMBswRequestedMode=SD_CONSUMED_EVENTGROUP_AVAILABLE
        SDC_SdCEGState_C_consService_RDR_1_ADAS_Vehicle_Status_2b1e055b_CEG_consServiceGrp_RDR_1_ADAS_Vehicle_Status_4b79da85 (BswMModeRequestPort): BswMArbitrateOnInit=false, BswMRequestProcessing=BSWM_DEFERRED
          BswMModeRequestSource
            BswMSdConsumedEventGroupCurrentState: BswMSdConsumedEventGroupRef=consServiceGrp_RDR_1_ADAS_Vehicle_Status_4b79da85
          BswMModeInitValue: BswMBswModeInitValue=SD_CONSUMED_EVENTGROUP_DOWN
        SDC_ApplRequest_S_provService_RDR_1_SW_Info_c2745ec9 (BswMRule):
          BswMNestedExecutionOnly = false
          BswMRuleId = 19
          BswMRuleInitState = BSWM_FALSE
          BswMRuleExpressionRef = SDC_LE_ApplRequest_S_provService_RDR_1_SW_Info_c2745ec9
          BswMRuleFalseActionList = SDC_AL_ApplRelease_S_provService_RDR_1_SW_Info_c2745ec9
          BswMRuleTrueActionList = SDC_AL_ApplRequest_S_provService_RDR_1_SW_Info_c2745ec9
        SDC_LE_ApplRequest_S_provService_RDR_1_SW_Info_c2745ec9 (BswMLogicalExpression): BswMLogicalOperator=BSWM_AND, BswMArgumentRef=SDC_Cond_S_provService_RDR_1_SW_Info_c2745ec9_EQ_SDC_SERVER_AVAILABE
        SDC_Cond_S_provService_RDR_1_SW_Info_c2745ec9_EQ_SDC_SERVER_AVAILABE (BswMModeCondition): BswMConditionType=BSWM_EQUALS, BswMConditionMode=SDC_S_provService_RDR_1_SW_Info_c2745ec9
          BswMConditionValue
            BswMModeDeclaration: BswMModeValueRef=SDC_SERVER_AVAILABE
        SDC_S_provService_RDR_1_SW_Info_c2745ec9 (BswMModeRequestPort): BswMArbitrateOnInit=false, BswMRequestProcessing=BSWM_DEFERRED
          BswMModeRequestSource
            BswMSwcModeRequest: BswMModeRequestDataElementPrototypeName=requestedMode, BswMSwcModeRequestModeDeclarationGroupPrototypeRef=BswM_MDGP_SDC_SdServerServiceRequest
          BswMModeInitValue: BswMSwcModeInitValueRef=SDC_SERVER_DOWN
        SDC_SdStateChange_S_provService_RDR_1_Status_d2069d01_EH_EventGroup_RDR_1_f7c73cae (BswMRule):
          BswMNestedExecutionOnly = false
          BswMRuleId = 25
          BswMRuleInitState = BSWM_FALSE
          BswMRuleExpressionRef = SDC_LE_S_provService_RDR_1_Status_d2069d01_EH_EventGroup_RDR_1_f7c73caeIsRequested
          BswMRuleFalseActionList = SDC_AL_SdRelease_S_provService_RDR_1_Status_d2069d01_EH_EventGroup_RDR_1_f7c73cae
          BswMRuleTrueActionList = SDC_AL_SdRequest_S_provService_RDR_1_Status_d2069d01_EH_EventGroup_RDR_1_f7c73cae
        SDC_LE_S_provService_RDR_1_Status_d2069d01_EH_EventGroup_RDR_1_f7c73caeIsRequested (BswMLogicalExpression):
          BswMLogicalOperator = BSWM_AND
          BswMArgumentRef = SDC_Cond_SdEHState_S_provService_RDR_1_Status_d2069d01_EH_EventGroup_RDR_1_f7c73cae_EQ_SD_EVENT_HANDLER_REQUESTED
        SDC_Cond_SdEHState_S_provService_RDR_1_Status_d2069d01_EH_EventGroup_RDR_1_f7c73cae_EQ_SD_EVENT_HANDLER_REQUESTED (BswMModeCondition): BswMConditionType=BSWM_EQUALS, BswMConditionMode=SDC_SdEHState_S_provService_RDR_1_Status_d2069d01_EH_EventGroup_RDR_1_f7c73cae
          BswMConditionValue
            BswMBswMode: BswMBswRequestedMode=SD_EVENT_HANDLER_REQUESTED
        SDC_SdEHState_S_provService_RDR_1_Status_d2069d01_EH_EventGroup_RDR_1_f7c73cae (BswMModeRequestPort): BswMArbitrateOnInit=false, BswMRequestProcessing=BSWM_DEFERRED
          BswMModeRequestSource
            BswMSdEventHandlerCurrentState: BswMSdEventHandlerRef=EventGroup_RDR_1_f7c73cae
          BswMModeInitValue: BswMBswModeInitValue=SD_EVENT_HANDLER_RELEASED
        SDC_ApplRequest_S_provService_RDR_1_Status_d2069d01 (BswMRule):
          BswMNestedExecutionOnly = false
          BswMRuleId = 20
          BswMRuleInitState = BSWM_FALSE
          BswMRuleExpressionRef = SDC_LE_ApplRequest_S_provService_RDR_1_Status_d2069d01
          BswMRuleFalseActionList = SDC_AL_ApplRelease_S_provService_RDR_1_Status_d2069d01
          BswMRuleTrueActionList = SDC_AL_ApplRequest_S_provService_RDR_1_Status_d2069d01
        SDC_LE_ApplRequest_S_provService_RDR_1_Status_d2069d01 (BswMLogicalExpression): BswMLogicalOperator=BSWM_AND, BswMArgumentRef=SDC_Cond_S_provService_RDR_1_Status_d2069d01_EQ_SDC_SERVER_AVAILABE
        SDC_Cond_S_provService_RDR_1_Status_d2069d01_EQ_SDC_SERVER_AVAILABE (BswMModeCondition): BswMConditionType=BSWM_EQUALS, BswMConditionMode=SDC_S_provService_RDR_1_Status_d2069d01
          BswMConditionValue
            BswMModeDeclaration: BswMModeValueRef=SDC_SERVER_AVAILABE
        SDC_S_provService_RDR_1_Status_d2069d01 (BswMModeRequestPort): BswMArbitrateOnInit=false, BswMRequestProcessing=BSWM_DEFERRED
          BswMModeRequestSource
            BswMSwcModeRequest: BswMModeRequestDataElementPrototypeName=requestedMode, BswMSwcModeRequestModeDeclarationGroupPrototypeRef=BswM_MDGP_SDC_SdServerServiceRequest
          BswMModeInitValue: BswMSwcModeInitValueRef=SDC_SERVER_DOWN
        SDC_SdStateChange_S_provService_RDR_1_Detections_89f78c9f_EH_EventGroup_RDR_1_ca62382d (BswMRule):
          BswMNestedExecutionOnly = false
          BswMRuleId = 23
          BswMRuleInitState = BSWM_FALSE
          BswMRuleExpressionRef = SDC_LE_S_provService_RDR_1_Detections_89f78c9f_EH_EventGroup_RDR_1_ca62382dIsRequested
          BswMRuleFalseActionList = SDC_AL_SdRelease_S_provService_RDR_1_Detections_89f78c9f_EH_EventGroup_RDR_1_ca62382d
          BswMRuleTrueActionList = SDC_AL_SdRequest_S_provService_RDR_1_Detections_89f78c9f_EH_EventGroup_RDR_1_ca62382d
        SDC_LE_S_provService_RDR_1_Detections_89f78c9f_EH_EventGroup_RDR_1_ca62382dIsRequested (BswMLogicalExpression):
          BswMLogicalOperator = BSWM_AND
          BswMArgumentRef = SDC_Cond_SdEHState_S_provService_RDR_1_Detections_89f78c9f_EH_EventGroup_RDR_1_ca62382d_EQ_SD_EVENT_HANDLER_REQUESTED
        SDC_Cond_SdEHState_S_provService_RDR_1_Detections_89f78c9f_EH_EventGroup_RDR_1_ca62382d_EQ_SD_EVENT_HANDLER_REQUESTED (BswMModeCondition): BswMConditionType=BSWM_EQUALS, BswMConditionMode=SDC_SdEHState_S_provService_RDR_1_Detections_89f78c9f_EH_EventGroup_RDR_1_ca62382d
          BswMConditionValue
            BswMBswMode: BswMBswRequestedMode=SD_EVENT_HANDLER_REQUESTED
        SDC_SdEHState_S_provService_RDR_1_Detections_89f78c9f_EH_EventGroup_RDR_1_ca62382d (BswMModeRequestPort): BswMArbitrateOnInit=false, BswMRequestProcessing=BSWM_DEFERRED
          BswMModeRequestSource
            BswMSdEventHandlerCurrentState: BswMSdEventHandlerRef=EventGroup_RDR_1_ca62382d
          BswMModeInitValue: BswMBswModeInitValue=SD_EVENT_HANDLER_RELEASED
        SDC_SdStateChange_C_consService_RDR_1_ADAS_Vehicle_Status_2b1e055b (BswMRule):
          BswMNestedExecutionOnly = false
          BswMRuleId = 21
          BswMRuleInitState = BSWM_FALSE
          BswMRuleExpressionRef = SDC_LE_C_consService_RDR_1_ADAS_Vehicle_Status_2b1e055bIsAvailable
          BswMRuleFalseActionList = SDC_AL_SdDown_C_consService_RDR_1_ADAS_Vehicle_Status_2b1e055b_DOWN
          BswMRuleTrueActionList = SDC_AL_SdAvailable_C_consService_RDR_1_ADAS_Vehicle_Status_2b1e055b_AVAILABLE
        SDC_LE_C_consService_RDR_1_ADAS_Vehicle_Status_2b1e055bIsAvailable (BswMLogicalExpression):
          BswMLogicalOperator = BSWM_AND
          BswMArgumentRef = SDC_Cond_SdClientState_C_consService_RDR_1_ADAS_Vehicle_Status_2b1e055b_EQ_SD_CLIENT_SERVICE_AVAILABLE
        SDC_Cond_SdClientState_C_consService_RDR_1_ADAS_Vehicle_Status_2b1e055b_EQ_SD_CLIENT_SERVICE_AVAILABLE (BswMModeCondition): BswMConditionType=BSWM_EQUALS, BswMConditionMode=SDC_SdClientState_C_consService_RDR_1_ADAS_Vehicle_Status_2b1e055b
          BswMConditionValue
            BswMBswMode: BswMBswRequestedMode=SD_CLIENT_SERVICE_AVAILABLE
        SDC_SdClientState_C_consService_RDR_1_ADAS_Vehicle_Status_2b1e055b (BswMModeRequestPort): BswMArbitrateOnInit=false, BswMRequestProcessing=BSWM_DEFERRED
          BswMModeRequestSource
            BswMSdClientServiceCurrentState: BswMSdClientMethodsRef=consService_RDR_1_ADAS_Vehicle_Status_2b1e055b
          BswMModeInitValue: BswMBswModeInitValue=SD_CLIENT_SERVICE_DOWN
        CC_Cond_CanSMIndication_CN_VCAN_RADAR_489180b6_EQ_CANSM_BSWM_FULL_COMMUNICATION (BswMModeCondition): BswMConditionType=BSWM_EQUALS, BswMConditionMode=CC_CanSMIndication_CN_VCAN_RADAR_489180b6
          BswMConditionValue
            BswMBswMode: BswMBswRequestedMode=CANSM_BSWM_FULL_COMMUNICATION
        CC_CanSMIndication_CN_VCAN_RADAR_489180b6 (BswMModeRequestPort): BswMArbitrateOnInit=false, BswMRequestProcessing=BSWM_IMMEDIATE
          BswMModeRequestSource
            BswMCanSMIndication: BswMCanSMChannelRef=CN_VCAN_RADAR_489180b6
          BswMModeInitValue: BswMBswModeInitValue=CANSM_BSWM_NO_COMMUNICATION
        CC_CN_PCAN_RADAR_458ff0f1_TX (BswMRule):
          BswMNestedExecutionOnly = false
          BswMRuleId = 4
          BswMRuleInitState = BSWM_FALSE
          BswMRuleExpressionRef = CC_LE_CN_PCAN_RADAR_458ff0f1_TX
          BswMRuleFalseActionList = CC_AL_CN_PCAN_RADAR_458ff0f1_TX_Disable
          BswMRuleTrueActionList = CC_AL_CN_PCAN_RADAR_458ff0f1_TX_Enable
        CC_LE_CN_PCAN_RADAR_458ff0f1_TX (BswMLogicalExpression): BswMLogicalOperator=BSWM_AND, BswMArgumentRef=CC_Cond_CanSMIndication_CN_PCAN_RADAR_458ff0f1_EQ_CANSM_BSWM_FULL_COMMUNICATION
        CC_Cond_CanSMIndication_CN_PCAN_RADAR_458ff0f1_EQ_CANSM_BSWM_FULL_COMMUNICATION (BswMModeCondition): BswMConditionType=BSWM_EQUALS, BswMConditionMode=CC_CanSMIndication_CN_PCAN_RADAR_458ff0f1
          BswMConditionValue
            BswMBswMode: BswMBswRequestedMode=CANSM_BSWM_FULL_COMMUNICATION
        CC_CanSMIndication_CN_PCAN_RADAR_458ff0f1 (BswMModeRequestPort): BswMArbitrateOnInit=false, BswMRequestProcessing=BSWM_IMMEDIATE
          BswMModeRequestSource
            BswMCanSMIndication: BswMCanSMChannelRef=CN_PCAN_RADAR_458ff0f1
          BswMModeInitValue: BswMBswModeInitValue=CANSM_BSWM_NO_COMMUNICATION
        CC_CN_VCAN_RADAR_489180b6_RX_DM (BswMRule):
          BswMNestedExecutionOnly = false
          BswMRuleId = 6
          BswMRuleInitState = BSWM_FALSE
          BswMRuleExpressionRef = CC_LE_CN_VCAN_RADAR_489180b6_RX_DM
          BswMRuleFalseActionList = CC_AL_CN_VCAN_RADAR_489180b6_Disable_DM
          BswMRuleTrueActionList = CC_AL_CN_VCAN_RADAR_489180b6_Enable_DM
        CC_LE_CN_VCAN_RADAR_489180b6_RX_DM (BswMLogicalExpression): BswMLogicalOperator=BSWM_AND, BswMArgumentRef=CC_Cond_CanSMIndication_CN_VCAN_RADAR_489180b6_EQ_CANSM_BSWM_FULL_COMMUNICATION
        CC_CN_PCAN_RADAR_458ff0f1_RX_DM (BswMRule):
          BswMNestedExecutionOnly = false
          BswMRuleId = 3
          BswMRuleInitState = BSWM_FALSE
          BswMRuleExpressionRef = CC_LE_CN_PCAN_RADAR_458ff0f1_RX_DM
          BswMRuleFalseActionList = CC_AL_CN_PCAN_RADAR_458ff0f1_Disable_DM
          BswMRuleTrueActionList = CC_AL_CN_PCAN_RADAR_458ff0f1_Enable_DM
        CC_LE_CN_PCAN_RADAR_458ff0f1_RX_DM (BswMLogicalExpression): BswMLogicalOperator=BSWM_AND, BswMArgumentRef=CC_Cond_CanSMIndication_CN_PCAN_RADAR_458ff0f1_EQ_CANSM_BSWM_FULL_COMMUNICATION
        CC_CN_VCAN_RADAR_489180b6_RX (BswMRule):
          BswMNestedExecutionOnly = false
          BswMRuleId = 5
          BswMRuleInitState = BSWM_FALSE
          BswMRuleExpressionRef = CC_LE_CN_VCAN_RADAR_489180b6_RX
          BswMRuleFalseActionList = CC_AL_CN_VCAN_RADAR_489180b6_RX_Disable
          BswMRuleTrueActionList = CC_AL_CN_VCAN_RADAR_489180b6_RX_Enable
        CC_LE_CN_VCAN_RADAR_489180b6_RX (BswMLogicalExpression): BswMLogicalOperator=BSWM_AND, BswMArgumentRef=CC_Cond_CanSMIndication_CN_VCAN_RADAR_489180b6_NEQ_CANSM_BSWM_NO_COMMUNICATION
        CC_Cond_CanSMIndication_CN_VCAN_RADAR_489180b6_NEQ_CANSM_BSWM_NO_COMMUNICATION (BswMModeCondition): BswMConditionType=BSWM_EQUALS_NOT, BswMConditionMode=CC_CanSMIndication_CN_VCAN_RADAR_489180b6
          BswMConditionValue
            BswMBswMode: BswMBswRequestedMode=CANSM_BSWM_NO_COMMUNICATION
        CC_CN_PCAN_RADAR_458ff0f1_RX (BswMRule):
          BswMNestedExecutionOnly = false
          BswMRuleId = 2
          BswMRuleInitState = BSWM_FALSE
          BswMRuleExpressionRef = CC_LE_CN_PCAN_RADAR_458ff0f1_RX
          BswMRuleFalseActionList = CC_AL_CN_PCAN_RADAR_458ff0f1_RX_Disable
          BswMRuleTrueActionList = CC_AL_CN_PCAN_RADAR_458ff0f1_RX_Enable
        CC_LE_CN_PCAN_RADAR_458ff0f1_RX (BswMLogicalExpression): BswMLogicalOperator=BSWM_AND, BswMArgumentRef=CC_Cond_CanSMIndication_CN_PCAN_RADAR_458ff0f1_NEQ_CANSM_BSWM_NO_COMMUNICATION
        CC_Cond_CanSMIndication_CN_PCAN_RADAR_458ff0f1_NEQ_CANSM_BSWM_NO_COMMUNICATION (BswMModeCondition): BswMConditionType=BSWM_EQUALS_NOT, BswMConditionMode=CC_CanSMIndication_CN_PCAN_RADAR_458ff0f1
          BswMConditionValue
            BswMBswMode: BswMBswRequestedMode=CANSM_BSWM_NO_COMMUNICATION
        ESH_LE_CancelNotPending (BswMLogicalExpression): BswMLogicalOperator=BSWM_OR, BswMArgumentRef=ESH_Cond_NvMWAIsNotPending, BswMArgumentRef=ESH_Cond_NvWCancelTimerNotRunning
        ESH_Cond_NvMWAIsNotPending (BswMModeCondition): BswMConditionType=BSWM_EQUALS_NOT, BswMConditionMode=ESH_NvMIndication
          BswMConditionValue
            BswMBswMode: BswMBswRequestedMode=NVM_REQ_PENDING
        ESH_NvMIndication (BswMModeRequestPort): BswMArbitrateOnInit=false, BswMRequestProcessing=BSWM_DEFERRED
          BswMModeRequestSource
            BswMNvMJobModeIndication: BswMNvmService=NvmWriteAll
          BswMModeInitValue: BswMBswModeInitValue=NVM_REQ_OK
        ESH_Cond_NvWCancelTimerNotRunning (BswMModeCondition): BswMConditionType=BSWM_EQUALS_NOT, BswMConditionMode=ESH_NvM_CancelWriteAllTimer
          BswMConditionValue
            BswMBswMode: BswMBswRequestedMode=BSWM_TIMER_STARTED
        ESH_NvM_CancelWriteAllTimer (BswMModeRequestPort): BswMArbitrateOnInit=false, BswMRequestProcessing=BSWM_DEFERRED
          BswMModeRequestSource
            BswMTimer
          BswMModeInitValue: BswMBswModeInitValue=BSWM_TIMER_STOPPED
        ESH_NvM_WriteAllTimer (BswMModeRequestPort): BswMArbitrateOnInit=false, BswMRequestProcessing=BSWM_DEFERRED
          BswMModeRequestSource
            BswMTimer
          BswMModeInitValue: BswMBswModeInitValue=BSWM_TIMER_STOPPED
        ESH_LE_WriteNotPending (BswMLogicalExpression): BswMLogicalOperator=BSWM_OR, BswMArgumentRef=ESH_Cond_NvMWAIsNotPending, BswMArgumentRef=ESH_Cond_NvWWriteAllTimerNotRunning
        ESH_Cond_NvWWriteAllTimerNotRunning (BswMModeCondition): BswMConditionType=BSWM_EQUALS_NOT, BswMConditionMode=ESH_NvM_WriteAllTimer
          BswMConditionValue
            BswMBswMode: BswMBswRequestedMode=BSWM_TIMER_STARTED
        BswMModeRequestPort_DCMECUReset (BswMModeRequestPort): BswMArbitrateOnInit=true, BswMRequestProcessing=BSWM_DEFERRED
          BswMModeRequestSource
            BswMSwcModeNotification: BswMSwcModeNotificationModeDeclarationGroupPrototypeRef=DcmEcuReset
          BswMModeInitValue: BswMSwcModeInitValueRef=NONE
        BswMModeCondition_AckModeTransition (BswMModeCondition): BswMConditionType=BSWM_EQUALS, BswMConditionMode=BswMModeRequestPort_DCMECUReset
          BswMConditionValue
            BswMModeDeclaration: BswMModeValueRef=EXECUTE
        LE_AckModeTransition_Execute (BswMLogicalExpression): BswMArgumentRef=BswMModeCondition_AckModeTransition
        BswMRule_AckModeTransition_Execute (BswMRule):
          BswMNestedExecutionOnly = false
          BswMRuleId = 0
          BswMRuleInitState = BSWM_FALSE
          BswMRuleExpressionRef = LE_AckModeTransition_Execute
          BswMRuleTrueActionList = AL_AckModeTransition_Execute
        BswMModeCondition_EcuSoftReset (BswMModeCondition): BswMConditionType=BSWM_EQUALS, BswMConditionMode=BswMModeRequestPort_DCMECUReset
          BswMConditionValue
            BswMModeDeclaration: BswMModeValueRef=SOFT
        LE_EcuSoftReset (BswMLogicalExpression): BswMArgumentRef=BswMModeCondition_EcuSoftReset
        BswMRule_EcuSoftReset (BswMRule):
          BswMNestedExecutionOnly = false
          BswMRuleId = 1
          BswMRuleInitState = BSWM_FALSE
          BswMRuleExpressionRef = LE_EcuSoftReset
          BswMRuleTrueActionList = AL_EcuSoftReset
      BswMModeControl: BswMInitActionListRef=INIT_AL_Initialize
        ESH_AL_RunToPostRun (BswMActionList): BswMActionListExecution=BSWM_CONDITION
          5 x BswMActionListItem, all with BswMAbortOnFail=false:
            ESH_Action_EcuMClearValidatedWakeupEvents: BswMActionListItemIndex=2, BswMActionListItemRef=BswMModeControl/ESH_Action_EcuMClearValidatedWakeupEvents
            ESH_Action_ESH_PostRun: BswMActionListItemIndex=4, BswMActionListItemRef=BswMModeControl/ESH_Action_ESH_PostRun
            ESH_Action_OnEnterPostRun: BswMActionListItemIndex=3, BswMActionListItemRef=BswMModeControl/ESH_Action_OnEnterPostRun
            ESH_Action_ComMDisallow_CN_PCAN_RADAR_458ff0f1: BswMActionListItemIndex=0, BswMActionListItemRef=BswMModeControl/ESH_Action_ComMDisallow_CN_PCAN_RADAR_458ff0f1
            ESH_Action_ComMDisallow_cnctr_RDR_RdrNet_5172a59b: BswMActionListItemIndex=1, BswMActionListItemRef=BswMModeControl/ESH_Action_ComMDisallow_cnctr_RDR_RdrNet_5172a59b
        ESH_Action_EcuMClearValidatedWakeupEvents (BswMAction)
          BswMAvailableActions
            BswMUserCallout: BswMUserCalloutFunction=EcuM_ClearValidatedWakeupEvent(ECUM_WKSOURCE_ALL_SOURCES), BswMCreateCallout=false, BswMUserIncludeFile=EcuM.h
        ESH_Action_ESH_PostRun (BswMAction)
          BswMAvailableActions
            BswMGenericModeSwitch: BswMGenericRequestRef=ESH_State, BswMGenericRequestModeRef=ESH_POST_RUN
        ESH_AL_WaitForNvMToShutdown (BswMActionList): BswMActionListExecution=BSWM_CONDITION
          3 x BswMActionListItem, all with BswMAbortOnFail=false:
            ESH_Action_EcuMGoToSelectedShutdownTarget: BswMActionListItemIndex=2, BswMActionListItemRef=BswMModeControl/ESH_Action_EcuMGoToSelectedShutdownTarget
            ESH_Action_OnEnterShutdown: BswMActionListItemIndex=1, BswMActionListItemRef=BswMModeControl/ESH_Action_OnEnterShutdown
            ESH_Action_WriteAllTimer_Stop: BswMActionListItemIndex=0, BswMActionListItemRef=BswMModeControl/ESH_Action_WriteAllTimer_Stop
        ESH_Action_EcuMGoToSelectedShutdownTarget (BswMAction)
          BswMAvailableActions
            BswMUserCallout: BswMUserCalloutFunction=(void)EcuM_GoToSelectedShutdownTarget(), BswMCreateCallout=false, BswMUserIncludeFile=EcuM.h
        ESH_AL_WakeupToPrep (BswMActionList): BswMActionListExecution=BSWM_CONDITION
          ESH_Action_ESH_PrepShutdown (BswMActionListItem): BswMAbortOnFail=false, BswMActionListItemIndex=1, BswMActionListItemRef=BswMModeControl/ESH_Action_ESH_PrepShutdown
          ESH_Action_OnEnterPrepShutdown (BswMActionListItem): BswMAbortOnFail=false, BswMActionListItemIndex=0, BswMActionListItemRef=BswMModeControl/ESH_Action_OnEnterPrepShutdown
        ESH_Action_ESH_PrepShutdown (BswMAction)
          BswMAvailableActions
            BswMGenericModeSwitch: BswMGenericRequestRef=ESH_State, BswMGenericRequestModeRef=ESH_PREP_SHUTDOWN
        ESH_AL_WaitForNvMWakeup (BswMActionList): BswMActionListExecution=BSWM_CONDITION
          5 x BswMActionListItem, all with BswMAbortOnFail=false:
            ESH_Action_ESH_Wakeup: BswMActionListItemIndex=4, BswMActionListItemRef=BswMModeControl/ESH_Action_ESH_Wakeup
            ESH_Action_OnEnterWakeup: BswMActionListItemIndex=3, BswMActionListItemRef=BswMModeControl/ESH_Action_OnEnterWakeup
            ESH_Action_WriteAllTimer_Stop: BswMActionListItemIndex=0, BswMActionListItemRef=BswMModeControl/ESH_Action_WriteAllTimer_Stop
            ESH_Action_CancelWriteAllTimer_Start: BswMActionListItemIndex=1, BswMActionListItemRef=BswMModeControl/ESH_Action_CancelWriteAllTimer_Start
            ESH_Action_CancelNvMWriteAll: BswMActionListItemIndex=2, BswMActionListItemRef=BswMModeControl/ESH_Action_CancelNvMWriteAll
        ESH_Action_ESH_Wakeup (BswMAction)
          BswMAvailableActions
            BswMGenericModeSwitch: BswMGenericRequestRef=ESH_State, BswMGenericRequestModeRef=ESH_WAKEUP
        ESH_AL_WakeupToRun (BswMActionList): BswMActionListExecution=BSWM_CONDITION
          6 x BswMActionListItem, all with BswMAbortOnFail=false:
            ESH_Action_SelfRunRequestTimer_Start: BswMActionListItemIndex=3, BswMActionListItemRef=BswMModeControl/ESH_Action_SelfRunRequestTimer_Start
            ESH_Action_ESH_Run: BswMActionListItemIndex=5, BswMActionListItemRef=BswMModeControl/ESH_Action_ESH_Run
            ESH_Action_OnEnterRun: BswMActionListItemIndex=4, BswMActionListItemRef=BswMModeControl/ESH_Action_OnEnterRun
            ESH_Action_ComMAllow_CN_PCAN_RADAR_458ff0f1: BswMActionListItemIndex=1, BswMActionListItemRef=BswMModeControl/ESH_Action_ComMAllow_CN_PCAN_RADAR_458ff0f1
            ESH_Action_ComMAllow_cnctr_RDR_RdrNet_5172a59b: BswMActionListItemIndex=2, BswMActionListItemRef=BswMModeControl/ESH_Action_ComMAllow_cnctr_RDR_RdrNet_5172a59b
            ESH_Action_CancelWriteAllTimer_Stop: BswMActionListItemIndex=0, BswMActionListItemRef=BswMModeControl/ESH_Action_CancelWriteAllTimer_Stop
        ESH_Action_SelfRunRequestTimer_Start (BswMAction)
          BswMAvailableActions
            BswMTimerControl: BswMTimerAction=BSWM_TIMER_START, BswMTimerValue=0.1, BswMTimerRef=ESH_SelfRunRequestTimer
        ESH_Action_ESH_Run (BswMAction)
          BswMAvailableActions
            BswMGenericModeSwitch: BswMGenericRequestRef=ESH_State, BswMGenericRequestModeRef=ESH_RUN
        6 x BswMActionList, all with BswMActionListExecution=BSWM_CONDITION:
          ESH_AL_InitToWakeup
            ESH_Action_ESH_Wakeup (BswMActionListItem): BswMAbortOnFail=false, BswMActionListItemIndex=1, BswMActionListItemRef=BswMModeControl/ESH_Action_ESH_Wakeup
            ESH_Action_OnEnterWakeup (BswMActionListItem): BswMAbortOnFail=false, BswMActionListItemIndex=0, BswMActionListItemRef=BswMModeControl/ESH_Action_OnEnterWakeup
          ESH_AL_PostRunToPrepShutdown
            ESH_Action_ESH_PrepShutdown (BswMActionListItem): BswMAbortOnFail=false, BswMActionListItemIndex=1, BswMActionListItemRef=BswMModeControl/ESH_Action_ESH_PrepShutdown
            ESH_Action_OnEnterPrepShutdown (BswMActionListItem): BswMAbortOnFail=false, BswMActionListItemIndex=0, BswMActionListItemRef=BswMModeControl/ESH_Action_OnEnterPrepShutdown
          ESH_AL_ESH_PostRunToPrepCheck
            ESH_PostRunToPrepNested (BswMActionListItem): BswMAbortOnFail=false, BswMActionListItemIndex=0, BswMActionListItemRef=BswMArbitration/ESH_PostRunToPrepNested
          ESH_AL_PostRunToRun
            5 x BswMActionListItem, all with BswMAbortOnFail=false:
              ESH_Action_SelfRunRequestTimer_Start: BswMActionListItemIndex=2, BswMActionListItemRef=BswMModeControl/ESH_Action_SelfRunRequestTimer_Start
              ESH_Action_ESH_Run: BswMActionListItemIndex=4, BswMActionListItemRef=BswMModeControl/ESH_Action_ESH_Run
              ESH_Action_OnEnterRun: BswMActionListItemIndex=3, BswMActionListItemRef=BswMModeControl/ESH_Action_OnEnterRun
              ESH_Action_ComMAllow_CN_PCAN_RADAR_458ff0f1: BswMActionListItemIndex=0, BswMActionListItemRef=BswMModeControl/ESH_Action_ComMAllow_CN_PCAN_RADAR_458ff0f1
              ESH_Action_ComMAllow_cnctr_RDR_RdrNet_5172a59b: BswMActionListItemIndex=1, BswMActionListItemRef=BswMModeControl/ESH_Action_ComMAllow_cnctr_RDR_RdrNet_5172a59b
          ESH_AL_ExitPostRun
            ESH_PostRunNested (BswMActionListItem): BswMAbortOnFail=false, BswMActionListItemIndex=0, BswMActionListItemRef=BswMArbitration/ESH_PostRunNested
          ESH_AL_PrepShutdownToWaitForNvM
            4 x BswMActionListItem, all with BswMAbortOnFail=false:
              ESH_Action_ESH_WaitForNvm: BswMActionListItemIndex=3, BswMActionListItemRef=BswMModeControl/ESH_Action_ESH_WaitForNvm
              ESH_Action_OnEnterWaitForNvm: BswMActionListItemIndex=2, BswMActionListItemRef=BswMModeControl/ESH_Action_OnEnterWaitForNvm
              ESH_Action_WriteAllTimer_Start: BswMActionListItemIndex=0, BswMActionListItemRef=BswMModeControl/ESH_Action_WriteAllTimer_Start
              ESH_Action_NvMWriteAll: BswMActionListItemIndex=1, BswMActionListItemRef=BswMModeControl/ESH_Action_NvMWriteAll
        ESH_Action_ESH_WaitForNvm (BswMAction)
          BswMAvailableActions
            BswMGenericModeSwitch: BswMGenericRequestRef=ESH_State, BswMGenericRequestModeRef=ESH_WAIT_FOR_NVM
        INIT_AL_Initialize (BswMActionList): BswMActionListExecution=BSWM_CONDITION
          58 x BswMActionListItem, all with BswMAbortOnFail=false:
            INIT_Action_SoAd_Init: BswMActionListItemIndex=23 if post-build-variant-condition{matching-criterion=RDR_POS, value=0}, BswMActionListItemIndex=23 if post-build-variant-condition{matching-criterion=RDR_POS, value=1}, BswMActionListItemIndex=23 if post-build-variant-condition{matching-criterion=RDR_POS, value=2}, BswMActionListItemIndex=23 if post-build-variant-condition{matching-criterion=RDR_POS, value=3}, BswMActionListItemIndex=23 if post-build-variant-condition{matching-criterion=RDR_POS, value=4}, BswMActionListItemIndex=23 if post-build-variant-condition{matching-criterion=RDR_POS, value=5}, BswMActionListItemIndex=23 if post-build-variant-condition{matching-criterion=RDR_POS, value=6}, BswMActionListItemIndex=23 if post-build-variant-condition{matching-criterion=RDR_POS, value=7}, BswMActionListItemRef=BswMModeControl/INIT_Action_SoAd_Init
            INIT_Action_Com_Init: BswMActionListItemIndex=15 if post-build-variant-condition{matching-criterion=RDR_POS, value=0}, BswMActionListItemIndex=15 if post-build-variant-condition{matching-criterion=RDR_POS, value=2}, BswMActionListItemIndex=15 if post-build-variant-condition{matching-criterion=RDR_POS, value=1}, BswMActionListItemIndex=15 if post-build-variant-condition{matching-criterion=RDR_POS, value=3}, BswMActionListItemIndex=15 if post-build-variant-condition{matching-criterion=RDR_POS, value=4}, BswMActionListItemIndex=15 if post-build-variant-condition{matching-criterion=RDR_POS, value=5}, BswMActionListItemIndex=15 if post-build-variant-condition{matching-criterion=RDR_POS, value=6}, BswMActionListItemIndex=15 if post-build-variant-condition{matching-criterion=RDR_POS, value=7}, BswMActionListItemRef=BswMModeControl/INIT_Action_Com_Init
            INIT_Action_PduR_Init: BswMActionListItemIndex=14 if post-build-variant-condition{matching-criterion=RDR_POS, value=0}, BswMActionListItemIndex=14 if post-build-variant-condition{matching-criterion=RDR_POS, value=1}, BswMActionListItemIndex=14 if post-build-variant-condition{matching-criterion=RDR_POS, value=2}, BswMActionListItemIndex=14 if post-build-variant-condition{matching-criterion=RDR_POS, value=3}, BswMActionListItemIndex=14 if post-build-variant-condition{matching-criterion=RDR_POS, value=4}, BswMActionListItemIndex=14 if post-build-variant-condition{matching-criterion=RDR_POS, value=5}, BswMActionListItemIndex=14 if post-build-variant-condition{matching-criterion=RDR_POS, value=6}, BswMActionListItemIndex=14 if post-build-variant-condition{matching-criterion=RDR_POS, value=7}, BswMActionListItemRef=BswMModeControl/INIT_Action_PduR_Init
            INIT_Action_EthSM_Init: BswMActionListItemIndex=28 if post-build-variant-condition{matching-criterion=RDR_POS, value=0}, BswMActionListItemIndex=28 if post-build-variant-condition{matching-criterion=RDR_POS, value=1}, BswMActionListItemIndex=28 if post-build-variant-condition{matching-criterion=RDR_POS, value=2}, BswMActionListItemIndex=28 if post-build-variant-condition{matching-criterion=RDR_POS, value=3}, BswMActionListItemIndex=28 if post-build-variant-condition{matching-criterion=RDR_POS, value=4}, BswMActionListItemIndex=28 if post-build-variant-condition{matching-criterion=RDR_POS, value=5}, BswMActionListItemIndex=28 if post-build-variant-condition{matching-criterion=RDR_POS, value=6}, BswMActionListItemIndex=28 if post-build-variant-condition{matching-criterion=RDR_POS, value=7}, BswMActionListItemRef=BswMModeControl/INIT_Action_EthSM_Init
            INIT_Action_TcpIp_Init: BswMActionListItemIndex=22 if post-build-variant-condition{matching-criterion=RDR_POS, value=0}, BswMActionListItemIndex=22 if post-build-variant-condition{matching-criterion=RDR_POS, value=1}, BswMActionListItemIndex=22 if post-build-variant-condition{matching-criterion=RDR_POS, value=2}, BswMActionListItemIndex=22 if post-build-variant-condition{matching-criterion=RDR_POS, value=3}, BswMActionListItemIndex=22 if post-build-variant-condition{matching-criterion=RDR_POS, value=4}, BswMActionListItemIndex=22 if post-build-variant-condition{matching-criterion=RDR_POS, value=5}, BswMActionListItemIndex=22 if post-build-variant-condition{matching-criterion=RDR_POS, value=6}, BswMActionListItemIndex=22 if post-build-variant-condition{matching-criterion=RDR_POS, value=7}, BswMActionListItemRef=BswMModeControl/INIT_Action_TcpIp_Init
            INIT_Action_EnableInterrupts: BswMActionListItemIndex=36 if post-build-variant-condition{matching-criterion=RDR_POS, value=0}, BswMActionListItemIndex=36 if post-build-variant-condition{matching-criterion=RDR_POS, value=1}, BswMActionListItemIndex=36 if post-build-variant-condition{matching-criterion=RDR_POS, value=2}, BswMActionListItemIndex=36 if post-build-variant-condition{matching-criterion=RDR_POS, value=3}, BswMActionListItemIndex=36 if post-build-variant-condition{matching-criterion=RDR_POS, value=4}, BswMActionListItemIndex=36 if post-build-variant-condition{matching-criterion=RDR_POS, value=5}, BswMActionListItemIndex=36 if post-build-variant-condition{matching-criterion=RDR_POS, value=6}, BswMActionListItemIndex=36 if post-build-variant-condition{matching-criterion=RDR_POS, value=7}, BswMActionListItemRef=BswMModeControl/INIT_Action_EnableInterrupts
            INIT_Action_ComM_Init: BswMActionListItemIndex=33 if post-build-variant-condition{matching-criterion=RDR_POS, value=0}, BswMActionListItemIndex=33 if post-build-variant-condition{matching-criterion=RDR_POS, value=1}, BswMActionListItemIndex=33 if post-build-variant-condition{matching-criterion=RDR_POS, value=2}, BswMActionListItemIndex=33 if post-build-variant-condition{matching-criterion=RDR_POS, value=3}, BswMActionListItemIndex=33 if post-build-variant-condition{matching-criterion=RDR_POS, value=4}, BswMActionListItemIndex=33 if post-build-variant-condition{matching-criterion=RDR_POS, value=5}, BswMActionListItemIndex=33 if post-build-variant-condition{matching-criterion=RDR_POS, value=6}, BswMActionListItemIndex=33 if post-build-variant-condition{matching-criterion=RDR_POS, value=7}, BswMActionListItemRef=BswMModeControl/INIT_Action_ComM_Init
            INIT_Action_ComM_PostInit: BswMActionListItemIndex=34 if post-build-variant-condition{matching-criterion=RDR_POS, value=0}, BswMActionListItemIndex=34 if post-build-variant-condition{matching-criterion=RDR_POS, value=1}, BswMActionListItemIndex=34 if post-build-variant-condition{matching-criterion=RDR_POS, value=2}, BswMActionListItemIndex=34 if post-build-variant-condition{matching-criterion=RDR_POS, value=3}, BswMActionListItemIndex=34 if post-build-variant-condition{matching-criterion=RDR_POS, value=4}, BswMActionListItemIndex=34 if post-build-variant-condition{matching-criterion=RDR_POS, value=5}, BswMActionListItemIndex=34 if post-build-variant-condition{matching-criterion=RDR_POS, value=6}, BswMActionListItemIndex=34 if post-build-variant-condition{matching-criterion=RDR_POS, value=7}, BswMActionListItemRef=BswMModeControl/INIT_Action_ComM_PostInit
            INIT_Action_Rte_Start: BswMActionListItemIndex=50 if post-build-variant-condition{matching-criterion=RDR_POS, value=0}, BswMActionListItemIndex=50 if post-build-variant-condition{matching-criterion=RDR_POS, value=1}, BswMActionListItemIndex=50 if post-build-variant-condition{matching-criterion=RDR_POS, value=2}, BswMActionListItemIndex=50 if post-build-variant-condition{matching-criterion=RDR_POS, value=3}, BswMActionListItemIndex=50 if post-build-variant-condition{matching-criterion=RDR_POS, value=4}, BswMActionListItemIndex=50 if post-build-variant-condition{matching-criterion=RDR_POS, value=5}, BswMActionListItemIndex=50 if post-build-variant-condition{matching-criterion=RDR_POS, value=6}, BswMActionListItemIndex=50 if post-build-variant-condition{matching-criterion=RDR_POS, value=7}, BswMActionListItemRef=BswMModeControl/INIT_Action_Rte_Start
            INIT_Action_SoAd_PostInit: BswMActionListItemIndex=44 if post-build-variant-condition{matching-criterion=RDR_POS, value=0}, BswMActionListItemIndex=44 if post-build-variant-condition{matching-criterion=RDR_POS, value=2}, BswMActionListItemIndex=44 if post-build-variant-condition{matching-criterion=RDR_POS, value=1}, BswMActionListItemIndex=44 if post-build-variant-condition{matching-criterion=RDR_POS, value=3}, BswMActionListItemIndex=44 if post-build-variant-condition{matching-criterion=RDR_POS, value=4}, BswMActionListItemIndex=44 if post-build-variant-condition{matching-criterion=RDR_POS, value=5}, BswMActionListItemIndex=44 if post-build-variant-condition{matching-criterion=RDR_POS, value=6}, BswMActionListItemIndex=44 if post-build-variant-condition{matching-criterion=RDR_POS, value=7}, BswMActionListItemRef=BswMModeControl/INIT_Action_SoAd_PostInit
            INIT_Action_CanIf_Init: BswMActionListItemIndex=8 if post-build-variant-condition{matching-criterion=RDR_POS, value=0}, BswMActionListItemIndex=8 if post-build-variant-condition{matching-criterion=RDR_POS, value=2}, BswMActionListItemIndex=8 if post-build-variant-condition{matching-criterion=RDR_POS, value=1}, BswMActionListItemIndex=8 if post-build-variant-condition{matching-criterion=RDR_POS, value=3}, BswMActionListItemIndex=8 if post-build-variant-condition{matching-criterion=RDR_POS, value=4}, BswMActionListItemIndex=8 if post-build-variant-condition{matching-criterion=RDR_POS, value=5}, BswMActionListItemIndex=8 if post-build-variant-condition{matching-criterion=RDR_POS, value=6}, BswMActionListItemIndex=8 if post-build-variant-condition{matching-criterion=RDR_POS, value=7}, BswMActionListItemRef=BswMModeControl/INIT_Action_CanIf_Init
            INIT_Action_CanSM_Init: BswMActionListItemIndex=17 if post-build-variant-condition{matching-criterion=RDR_POS, value=0}, BswMActionListItemIndex=17 if post-build-variant-condition{matching-criterion=RDR_POS, value=1}, BswMActionListItemIndex=17 if post-build-variant-condition{matching-criterion=RDR_POS, value=2}, BswMActionListItemIndex=17 if post-build-variant-condition{matching-criterion=RDR_POS, value=3}, BswMActionListItemIndex=17 if post-build-variant-condition{matching-criterion=RDR_POS, value=4}, BswMActionListItemIndex=17 if post-build-variant-condition{matching-criterion=RDR_POS, value=5}, BswMActionListItemIndex=17 if post-build-variant-condition{matching-criterion=RDR_POS, value=6}, BswMActionListItemIndex=17 if post-build-variant-condition{matching-criterion=RDR_POS, value=7}, BswMActionListItemRef=BswMModeControl/INIT_Action_CanSM_Init
            Action_ALLOW_COM_RDR_EthConnector1_de653f65: BswMActionListItemIndex=41 if post-build-variant-condition{matching-criterion=RDR_POS, value=0}, BswMActionListItemIndex=41 if post-build-variant-condition{matching-criterion=RDR_POS, value=1}, BswMActionListItemIndex=41 if post-build-variant-condition{matching-criterion=RDR_POS, value=2}, BswMActionListItemIndex=41 if post-build-variant-condition{matching-criterion=RDR_POS, value=3}, BswMActionListItemIndex=41 if post-build-variant-condition{matching-criterion=RDR_POS, value=4}, BswMActionListItemIndex=41 if post-build-variant-condition{matching-criterion=RDR_POS, value=5}, BswMActionListItemIndex=41 if post-build-variant-condition{matching-criterion=RDR_POS, value=6}, BswMActionListItemIndex=41 if post-build-variant-condition{matching-criterion=RDR_POS, value=7}, BswMActionListItemRef=BswMModeControl/Action_ALLOW_COM_RDR_EthConnector1_de653f65
            INIT_Action_ETH_ComM_Init: BswMActionListItemIndex=35 if post-build-variant-condition{matching-criterion=RDR_POS, value=0}, BswMActionListItemIndex=35 if post-build-variant-condition{matching-criterion=RDR_POS, value=1}, BswMActionListItemIndex=35 if post-build-variant-condition{matching-criterion=RDR_POS, value=2}, BswMActionListItemIndex=35 if post-build-variant-condition{matching-criterion=RDR_POS, value=3}, BswMActionListItemIndex=35 if post-build-variant-condition{matching-criterion=RDR_POS, value=4}, BswMActionListItemIndex=35 if post-build-variant-condition{matching-criterion=RDR_POS, value=5}, BswMActionListItemIndex=35 if post-build-variant-condition{matching-criterion=RDR_POS, value=6}, BswMActionListItemIndex=35 if post-build-variant-condition{matching-criterion=RDR_POS, value=7}, BswMActionListItemRef=BswMModeControl/INIT_Action_ETH_ComM_Init
            INIT_Action_TcpIpXcp_Init: BswMActionListItemIndex=25 if post-build-variant-condition{matching-criterion=RDR_POS, value=0}, BswMActionListItemIndex=25 if post-build-variant-condition{matching-criterion=RDR_POS, value=1}, BswMActionListItemIndex=25 if post-build-variant-condition{matching-criterion=RDR_POS, value=2}, BswMActionListItemIndex=25 if post-build-variant-condition{matching-criterion=RDR_POS, value=3}, BswMActionListItemIndex=25 if post-build-variant-condition{matching-criterion=RDR_POS, value=4}, BswMActionListItemIndex=25 if post-build-variant-condition{matching-criterion=RDR_POS, value=5}, BswMActionListItemIndex=25 if post-build-variant-condition{matching-criterion=RDR_POS, value=6}, BswMActionListItemIndex=25 if post-build-variant-condition{matching-criterion=RDR_POS, value=7}, BswMActionListItemRef=BswMModeControl/INIT_Action_TcpIpXcp_Init
            INIT_Action_Xcp_Init: BswMActionListItemIndex=27 if post-build-variant-condition{matching-criterion=RDR_POS, value=0}, BswMActionListItemIndex=27 if post-build-variant-condition{matching-criterion=RDR_POS, value=1}, BswMActionListItemIndex=27 if post-build-variant-condition{matching-criterion=RDR_POS, value=2}, BswMActionListItemIndex=27 if post-build-variant-condition{matching-criterion=RDR_POS, value=3}, BswMActionListItemIndex=27 if post-build-variant-condition{matching-criterion=RDR_POS, value=4}, BswMActionListItemIndex=27 if post-build-variant-condition{matching-criterion=RDR_POS, value=5}, BswMActionListItemIndex=27 if post-build-variant-condition{matching-criterion=RDR_POS, value=6}, BswMActionListItemIndex=27 if post-build-variant-condition{matching-criterion=RDR_POS, value=7}, BswMActionListItemRef=BswMModeControl/INIT_Action_Xcp_Init
            INIT_Action_StbM_PreInit: BswMActionListItemIndex=6 if post-build-variant-condition{matching-criterion=RDR_POS, value=0}, BswMActionListItemIndex=6 if post-build-variant-condition{matching-criterion=RDR_POS, value=1}, BswMActionListItemIndex=6 if post-build-variant-condition{matching-criterion=RDR_POS, value=2}, BswMActionListItemIndex=6 if post-build-variant-condition{matching-criterion=RDR_POS, value=3}, BswMActionListItemIndex=6 if post-build-variant-condition{matching-criterion=RDR_POS, value=4}, BswMActionListItemIndex=6 if post-build-variant-condition{matching-criterion=RDR_POS, value=5}, BswMActionListItemIndex=6 if post-build-variant-condition{matching-criterion=RDR_POS, value=6}, BswMActionListItemIndex=6 if post-build-variant-condition{matching-criterion=RDR_POS, value=7}, BswMActionListItemRef=BswMModeControl/INIT_Action_StbM_PreInit
            INIT_Action_EthTSyn_Init: BswMActionListItemIndex=31 if post-build-variant-condition{matching-criterion=RDR_POS, value=0}, BswMActionListItemIndex=31 if post-build-variant-condition{matching-criterion=RDR_POS, value=1}, BswMActionListItemIndex=31 if post-build-variant-condition{matching-criterion=RDR_POS, value=2}, BswMActionListItemIndex=31 if post-build-variant-condition{matching-criterion=RDR_POS, value=3}, BswMActionListItemIndex=31 if post-build-variant-condition{matching-criterion=RDR_POS, value=4}, BswMActionListItemIndex=31 if post-build-variant-condition{matching-criterion=RDR_POS, value=5}, BswMActionListItemIndex=31 if post-build-variant-condition{matching-criterion=RDR_POS, value=6}, BswMActionListItemIndex=31 if post-build-variant-condition{matching-criterion=RDR_POS, value=7}, BswMActionListItemRef=BswMModeControl/INIT_Action_EthTSyn_Init
            INIT_Action_StbM_Init: BswMActionListItemIndex=29 if post-build-variant-condition{matching-criterion=RDR_POS, value=0}, BswMActionListItemIndex=29 if post-build-variant-condition{matching-criterion=RDR_POS, value=1}, BswMActionListItemIndex=29 if post-build-variant-condition{matching-criterion=RDR_POS, value=2}, BswMActionListItemIndex=29 if post-build-variant-condition{matching-criterion=RDR_POS, value=3}, BswMActionListItemIndex=29 if post-build-variant-condition{matching-criterion=RDR_POS, value=4}, BswMActionListItemIndex=29 if post-build-variant-condition{matching-criterion=RDR_POS, value=5}, BswMActionListItemIndex=29 if post-build-variant-condition{matching-criterion=RDR_POS, value=6}, BswMActionListItemIndex=29 if post-build-variant-condition{matching-criterion=RDR_POS, value=7}, BswMActionListItemRef=BswMModeControl/INIT_Action_StbM_Init
            INIT_Action_StbM_PostInit: BswMActionListItemIndex=45 if post-build-variant-condition{matching-criterion=RDR_POS, value=0}, BswMActionListItemIndex=45 if post-build-variant-condition{matching-criterion=RDR_POS, value=2}, BswMActionListItemIndex=45 if post-build-variant-condition{matching-criterion=RDR_POS, value=1}, BswMActionListItemIndex=45 if post-build-variant-condition{matching-criterion=RDR_POS, value=3}, BswMActionListItemIndex=45 if post-build-variant-condition{matching-criterion=RDR_POS, value=4}, BswMActionListItemIndex=45 if post-build-variant-condition{matching-criterion=RDR_POS, value=5}, BswMActionListItemIndex=45 if post-build-variant-condition{matching-criterion=RDR_POS, value=6}, BswMActionListItemIndex=45 if post-build-variant-condition{matching-criterion=RDR_POS, value=7}, BswMActionListItemRef=BswMModeControl/INIT_Action_StbM_PostInit
            BswMUserCallout: BswMActionListItemIndex=1 if post-build-variant-condition{matching-criterion=RDR_POS, value=0}, BswMActionListItemIndex=1 if post-build-variant-condition{matching-criterion=RDR_POS, value=2}, BswMActionListItemIndex=1 if post-build-variant-condition{matching-criterion=RDR_POS, value=1}, BswMActionListItemIndex=1 if post-build-variant-condition{matching-criterion=RDR_POS, value=3}, BswMActionListItemIndex=1 if post-build-variant-condition{matching-criterion=RDR_POS, value=4}, BswMActionListItemIndex=1 if post-build-variant-condition{matching-criterion=RDR_POS, value=5}, BswMActionListItemIndex=1 if post-build-variant-condition{matching-criterion=RDR_POS, value=6}, BswMActionListItemIndex=1 if post-build-variant-condition{matching-criterion=RDR_POS, value=7}, BswMActionListItemRef=BswMModeControl/BswMUserCallout
            INIT_Action_Can_Init: BswMActionListItemIndex=7 if post-build-variant-condition{matching-criterion=RDR_POS, value=0}, BswMActionListItemIndex=7 if post-build-variant-condition{matching-criterion=RDR_POS, value=2}, BswMActionListItemIndex=7 if post-build-variant-condition{matching-criterion=RDR_POS, value=1}, BswMActionListItemIndex=7 if post-build-variant-condition{matching-criterion=RDR_POS, value=3}, BswMActionListItemIndex=7 if post-build-variant-condition{matching-criterion=RDR_POS, value=4}, BswMActionListItemIndex=7 if post-build-variant-condition{matching-criterion=RDR_POS, value=5}, BswMActionListItemIndex=7 if post-build-variant-condition{matching-criterion=RDR_POS, value=6}, BswMActionListItemIndex=7 if post-build-variant-condition{matching-criterion=RDR_POS, value=7}, BswMActionListItemRef=BswMModeControl/INIT_Action_Can_Init
            Action_ALLOW_COM_CN_PCAN_RADAR_458ff0f1: BswMActionListItemIndex=39 if post-build-variant-condition{matching-criterion=RDR_POS, value=1}, BswMActionListItemIndex=39 if post-build-variant-condition{matching-criterion=RDR_POS, value=3}, BswMActionListItemIndex=39 if post-build-variant-condition{matching-criterion=RDR_POS, value=2}, BswMActionListItemIndex=39 if post-build-variant-condition{matching-criterion=RDR_POS, value=5}, BswMActionListItemIndex=39 if post-build-variant-condition{matching-criterion=RDR_POS, value=6}, BswMActionListItemIndex=39 if post-build-variant-condition{matching-criterion=RDR_POS, value=0}, BswMActionListItemIndex=39 if post-build-variant-condition{matching-criterion=RDR_POS, value=4}, BswMActionListItemIndex=39 if post-build-variant-condition{matching-criterion=RDR_POS, value=7}, BswMActionListItemRef=BswMModeControl/Action_ALLOW_COM_CN_PCAN_RADAR_458ff0f1
            Action_BSWM_FULL_COM_CN_PCAN_RADAR_d6cf874b: BswMActionListItemIndex=37 if post-build-variant-condition{matching-criterion=RDR_POS, value=0}, BswMActionListItemIndex=37 if post-build-variant-condition{matching-criterion=RDR_POS, value=1}, BswMActionListItemIndex=37 if post-build-variant-condition{matching-criterion=RDR_POS, value=2}, BswMActionListItemIndex=37 if post-build-variant-condition{matching-criterion=RDR_POS, value=3}, BswMActionListItemIndex=37 if post-build-variant-condition{matching-criterion=RDR_POS, value=4}, BswMActionListItemIndex=37 if post-build-variant-condition{matching-criterion=RDR_POS, value=5}, BswMActionListItemIndex=37 if post-build-variant-condition{matching-criterion=RDR_POS, value=6}, BswMActionListItemIndex=37 if post-build-variant-condition{matching-criterion=RDR_POS, value=7}, BswMActionListItemRef=BswMModeControl/Action_BSWM_FULL_COM_CN_PCAN_RADAR_d6cf874b
            INIT_Action_Fee_30_FlexNor_Init: BswMActionListItemIndex=12 if post-build-variant-condition{matching-criterion=RDR_POS, value=0}, BswMActionListItemIndex=12 if post-build-variant-condition{matching-criterion=RDR_POS, value=1}, BswMActionListItemIndex=12 if post-build-variant-condition{matching-criterion=RDR_POS, value=2}, BswMActionListItemIndex=12 if post-build-variant-condition{matching-criterion=RDR_POS, value=3}, BswMActionListItemIndex=12 if post-build-variant-condition{matching-criterion=RDR_POS, value=4}, BswMActionListItemIndex=12 if post-build-variant-condition{matching-criterion=RDR_POS, value=5}, BswMActionListItemIndex=12 if post-build-variant-condition{matching-criterion=RDR_POS, value=6}, BswMActionListItemIndex=12 if post-build-variant-condition{matching-criterion=RDR_POS, value=7}, BswMActionListItemRef=BswMModeControl/INIT_Action_Fee_30_FlexNor_Init
            INIT_Action_NvM_Init: BswMActionListItemIndex=13 if post-build-variant-condition{matching-criterion=RDR_POS, value=0}, BswMActionListItemIndex=13 if post-build-variant-condition{matching-criterion=RDR_POS, value=1}, BswMActionListItemIndex=13 if post-build-variant-condition{matching-criterion=RDR_POS, value=2}, BswMActionListItemIndex=13 if post-build-variant-condition{matching-criterion=RDR_POS, value=3}, BswMActionListItemIndex=13 if post-build-variant-condition{matching-criterion=RDR_POS, value=4}, BswMActionListItemIndex=13 if post-build-variant-condition{matching-criterion=RDR_POS, value=5}, BswMActionListItemIndex=13 if post-build-variant-condition{matching-criterion=RDR_POS, value=6}, BswMActionListItemIndex=13 if post-build-variant-condition{matching-criterion=RDR_POS, value=7}, BswMActionListItemRef=BswMModeControl/INIT_Action_NvM_Init
            INIT_Action_NvMReadAll: BswMActionListItemIndex=19 if post-build-variant-condition{matching-criterion=RDR_POS, value=0}, BswMActionListItemIndex=19 if post-build-variant-condition{matching-criterion=RDR_POS, value=1}, BswMActionListItemIndex=19 if post-build-variant-condition{matching-criterion=RDR_POS, value=2}, BswMActionListItemIndex=19 if post-build-variant-condition{matching-criterion=RDR_POS, value=3}, BswMActionListItemIndex=19 if post-build-variant-condition{matching-criterion=RDR_POS, value=4}, BswMActionListItemIndex=19 if post-build-variant-condition{matching-criterion=RDR_POS, value=5}, BswMActionListItemIndex=19 if post-build-variant-condition{matching-criterion=RDR_POS, value=6}, BswMActionListItemIndex=19 if post-build-variant-condition{matching-criterion=RDR_POS, value=7}, BswMActionListItemRef=BswMModeControl/INIT_Action_NvMReadAll
            User_CAN_ComPduGroupHandling: BswMActionListItemIndex=42 if post-build-variant-condition{matching-criterion=RDR_POS, value=0}, BswMActionListItemIndex=42 if post-build-variant-condition{matching-criterion=RDR_POS, value=1}, BswMActionListItemIndex=42 if post-build-variant-condition{matching-criterion=RDR_POS, value=2}, BswMActionListItemIndex=42 if post-build-variant-condition{matching-criterion=RDR_POS, value=3}, BswMActionListItemIndex=42 if post-build-variant-condition{matching-criterion=RDR_POS, value=4}, BswMActionListItemIndex=42 if post-build-variant-condition{matching-criterion=RDR_POS, value=5}, BswMActionListItemIndex=42 if post-build-variant-condition{matching-criterion=RDR_POS, value=6}, BswMActionListItemIndex=42 if post-build-variant-condition{matching-criterion=RDR_POS, value=7}, BswMActionListItemRef=BswMModeControl/User_CAN_ComPduGroupHandling
            INIT_Action_Sd_PreInit: BswMActionListItemIndex=5 if post-build-variant-condition{matching-criterion=RDR_POS, value=0}, BswMActionListItemIndex=5 if post-build-variant-condition{matching-criterion=RDR_POS, value=1}, BswMActionListItemIndex=5 if post-build-variant-condition{matching-criterion=RDR_POS, value=2}, BswMActionListItemIndex=5 if post-build-variant-condition{matching-criterion=RDR_POS, value=3}, BswMActionListItemIndex=5 if post-build-variant-condition{matching-criterion=RDR_POS, value=4}, BswMActionListItemIndex=5 if post-build-variant-condition{matching-criterion=RDR_POS, value=5}, BswMActionListItemIndex=5 if post-build-variant-condition{matching-criterion=RDR_POS, value=6}, BswMActionListItemIndex=5 if post-build-variant-condition{matching-criterion=RDR_POS, value=7}, BswMActionListItemRef=BswMModeControl/INIT_Action_Sd_PreInit
            INIT_Action_Sd_Init: BswMActionListItemIndex=32 if post-build-variant-condition{matching-criterion=RDR_POS, value=0}, BswMActionListItemIndex=32 if post-build-variant-condition{matching-criterion=RDR_POS, value=1}, BswMActionListItemIndex=32 if post-build-variant-condition{matching-criterion=RDR_POS, value=2}, BswMActionListItemIndex=32 if post-build-variant-condition{matching-criterion=RDR_POS, value=3}, BswMActionListItemIndex=32 if post-build-variant-condition{matching-criterion=RDR_POS, value=4}, BswMActionListItemIndex=32 if post-build-variant-condition{matching-criterion=RDR_POS, value=5}, BswMActionListItemIndex=32 if post-build-variant-condition{matching-criterion=RDR_POS, value=6}, BswMActionListItemIndex=32 if post-build-variant-condition{matching-criterion=RDR_POS, value=7}, BswMActionListItemRef=BswMModeControl/INIT_Action_Sd_Init
            INIT_Action_Sd_PostInit: BswMActionListItemIndex=43 if post-build-variant-condition{matching-criterion=RDR_POS, value=0}, BswMActionListItemIndex=43 if post-build-variant-condition{matching-criterion=RDR_POS, value=2}, BswMActionListItemIndex=43 if post-build-variant-condition{matching-criterion=RDR_POS, value=1}, BswMActionListItemIndex=43 if post-build-variant-condition{matching-criterion=RDR_POS, value=3}, BswMActionListItemIndex=43 if post-build-variant-condition{matching-criterion=RDR_POS, value=4}, BswMActionListItemIndex=43 if post-build-variant-condition{matching-criterion=RDR_POS, value=5}, BswMActionListItemIndex=43 if post-build-variant-condition{matching-criterion=RDR_POS, value=6}, BswMActionListItemIndex=43 if post-build-variant-condition{matching-criterion=RDR_POS, value=7}, BswMActionListItemRef=BswMModeControl/INIT_Action_Sd_PostInit
            INIT_Action_LdCom_Init: BswMActionListItemIndex=16 if post-build-variant-condition{matching-criterion=RDR_POS, value=0}, BswMActionListItemIndex=16 if post-build-variant-condition{matching-criterion=RDR_POS, value=2}, BswMActionListItemIndex=16 if post-build-variant-condition{matching-criterion=RDR_POS, value=1}, BswMActionListItemIndex=16 if post-build-variant-condition{matching-criterion=RDR_POS, value=3}, BswMActionListItemIndex=16 if post-build-variant-condition{matching-criterion=RDR_POS, value=4}, BswMActionListItemIndex=16 if post-build-variant-condition{matching-criterion=RDR_POS, value=5}, BswMActionListItemIndex=16 if post-build-variant-condition{matching-criterion=RDR_POS, value=6}, BswMActionListItemIndex=16 if post-build-variant-condition{matching-criterion=RDR_POS, value=7}, BswMActionListItemRef=BswMModeControl/INIT_Action_LdCom_Init
            INIT_Action_SomeIpTp_Init: BswMActionListItemIndex=24 if post-build-variant-condition{matching-criterion=RDR_POS, value=0}, BswMActionListItemIndex=24 if post-build-variant-condition{matching-criterion=RDR_POS, value=1}, BswMActionListItemIndex=24 if post-build-variant-condition{matching-criterion=RDR_POS, value=2}, BswMActionListItemIndex=24 if post-build-variant-condition{matching-criterion=RDR_POS, value=3}, BswMActionListItemIndex=24 if post-build-variant-condition{matching-criterion=RDR_POS, value=4}, BswMActionListItemIndex=24 if post-build-variant-condition{matching-criterion=RDR_POS, value=5}, BswMActionListItemIndex=24 if post-build-variant-condition{matching-criterion=RDR_POS, value=6}, BswMActionListItemIndex=24 if post-build-variant-condition{matching-criterion=RDR_POS, value=7}, BswMActionListItemRef=BswMModeControl/INIT_Action_SomeIpTp_Init
            INIT_Action_CanXcp_Init: BswMActionListItemIndex=26 if post-build-variant-condition{matching-criterion=RDR_POS, value=0}, BswMActionListItemIndex=26 if post-build-variant-condition{matching-criterion=RDR_POS, value=1}, BswMActionListItemIndex=26 if post-build-variant-condition{matching-criterion=RDR_POS, value=2}, BswMActionListItemIndex=26 if post-build-variant-condition{matching-criterion=RDR_POS, value=3}, BswMActionListItemIndex=26 if post-build-variant-condition{matching-criterion=RDR_POS, value=4}, BswMActionListItemIndex=26 if post-build-variant-condition{matching-criterion=RDR_POS, value=5}, BswMActionListItemIndex=26 if post-build-variant-condition{matching-criterion=RDR_POS, value=6}, BswMActionListItemIndex=26 if post-build-variant-condition{matching-criterion=RDR_POS, value=7}, BswMActionListItemRef=BswMModeControl/INIT_Action_CanXcp_Init
            Action_BSWM_FULL_COM_CN_PCAN_RADAR_CAN2_d7b79076: BswMActionListItemIndex=38 if post-build-variant-condition{matching-criterion=RDR_POS, value=0}, BswMActionListItemIndex=38 if post-build-variant-condition{matching-criterion=RDR_POS, value=1}, BswMActionListItemIndex=38 if post-build-variant-condition{matching-criterion=RDR_POS, value=2}, BswMActionListItemIndex=38 if post-build-variant-condition{matching-criterion=RDR_POS, value=3}, BswMActionListItemIndex=38 if post-build-variant-condition{matching-criterion=RDR_POS, value=4}, BswMActionListItemIndex=38 if post-build-variant-condition{matching-criterion=RDR_POS, value=5}, BswMActionListItemIndex=38 if post-build-variant-condition{matching-criterion=RDR_POS, value=6}, BswMActionListItemIndex=38 if post-build-variant-condition{matching-criterion=RDR_POS, value=7}, BswMActionListItemRef=BswMModeControl/Action_BSWM_FULL_COM_CN_PCAN_RADAR_CAN2_d7b79076
            Action_ALLOW_COM_CN_PCAN_RADAR_CAN2_b6e0049f: BswMActionListItemIndex=40 if post-build-variant-condition{matching-criterion=RDR_POS, value=0}, BswMActionListItemIndex=40 if post-build-variant-condition{matching-criterion=RDR_POS, value=1}, BswMActionListItemIndex=40 if post-build-variant-condition{matching-criterion=RDR_POS, value=2}, BswMActionListItemIndex=40 if post-build-variant-condition{matching-criterion=RDR_POS, value=3}, BswMActionListItemIndex=40 if post-build-variant-condition{matching-criterion=RDR_POS, value=4}, BswMActionListItemIndex=40 if post-build-variant-condition{matching-criterion=RDR_POS, value=5}, BswMActionListItemIndex=40 if post-build-variant-condition{matching-criterion=RDR_POS, value=6}, BswMActionListItemIndex=40 if post-build-variant-condition{matching-criterion=RDR_POS, value=7}, BswMActionListItemRef=BswMModeControl/Action_ALLOW_COM_CN_PCAN_RADAR_CAN2_b6e0049f
            INIT_Action_CanTSyn_PreInit: BswMActionListItemIndex=4 if post-build-variant-condition{matching-criterion=RDR_POS, value=0}, BswMActionListItemIndex=4 if post-build-variant-condition{matching-criterion=RDR_POS, value=1}, BswMActionListItemIndex=4 if post-build-variant-condition{matching-criterion=RDR_POS, value=2}, BswMActionListItemIndex=4 if post-build-variant-condition{matching-criterion=RDR_POS, value=3}, BswMActionListItemIndex=4 if post-build-variant-condition{matching-criterion=RDR_POS, value=4}, BswMActionListItemIndex=4 if post-build-variant-condition{matching-criterion=RDR_POS, value=5}, BswMActionListItemIndex=4 if post-build-variant-condition{matching-criterion=RDR_POS, value=6}, BswMActionListItemIndex=4 if post-build-variant-condition{matching-criterion=RDR_POS, value=7}, BswMActionListItemRef=BswMModeControl/INIT_Action_CanTSyn_PreInit
            INIT_Action_CanTSyn_Init: BswMActionListItemIndex=30 if post-build-variant-condition{matching-criterion=RDR_POS, value=0}, BswMActionListItemIndex=30 if post-build-variant-condition{matching-criterion=RDR_POS, value=1}, BswMActionListItemIndex=30 if post-build-variant-condition{matching-criterion=RDR_POS, value=2}, BswMActionListItemIndex=30 if post-build-variant-condition{matching-criterion=RDR_POS, value=3}, BswMActionListItemIndex=30 if post-build-variant-condition{matching-criterion=RDR_POS, value=4}, BswMActionListItemIndex=30 if post-build-variant-condition{matching-criterion=RDR_POS, value=5}, BswMActionListItemIndex=30 if post-build-variant-condition{matching-criterion=RDR_POS, value=6}, BswMActionListItemIndex=30 if post-build-variant-condition{matching-criterion=RDR_POS, value=7}, BswMActionListItemRef=BswMModeControl/INIT_Action_CanTSyn_Init
            INIT_Action_CryIf_Init: BswMActionListItemIndex=10 if post-build-variant-condition{matching-criterion=RDR_POS, value=0}, BswMActionListItemIndex=10 if post-build-variant-condition{matching-criterion=RDR_POS, value=1}, BswMActionListItemIndex=10 if post-build-variant-condition{matching-criterion=RDR_POS, value=2}, BswMActionListItemIndex=10 if post-build-variant-condition{matching-criterion=RDR_POS, value=3}, BswMActionListItemIndex=10 if post-build-variant-condition{matching-criterion=RDR_POS, value=4}, BswMActionListItemIndex=10 if post-build-variant-condition{matching-criterion=RDR_POS, value=5}, BswMActionListItemIndex=10 if post-build-variant-condition{matching-criterion=RDR_POS, value=6}, BswMActionListItemIndex=10 if post-build-variant-condition{matching-criterion=RDR_POS, value=7}, BswMActionListItemRef=BswMModeControl/INIT_Action_CryIf_Init
            INIT_Action_Crypto_Init: BswMActionListItemIndex=9 if post-build-variant-condition{matching-criterion=RDR_POS, value=0}, BswMActionListItemIndex=9 if post-build-variant-condition{matching-criterion=RDR_POS, value=1}, BswMActionListItemIndex=9 if post-build-variant-condition{matching-criterion=RDR_POS, value=2}, BswMActionListItemIndex=9 if post-build-variant-condition{matching-criterion=RDR_POS, value=3}, BswMActionListItemIndex=9 if post-build-variant-condition{matching-criterion=RDR_POS, value=4}, BswMActionListItemIndex=9 if post-build-variant-condition{matching-criterion=RDR_POS, value=5}, BswMActionListItemIndex=9 if post-build-variant-condition{matching-criterion=RDR_POS, value=6}, BswMActionListItemIndex=9 if post-build-variant-condition{matching-criterion=RDR_POS, value=7}, BswMActionListItemRef=BswMModeControl/INIT_Action_Crypto_Init
            INIT_Action_Csm_Init: BswMActionListItemIndex=11 if post-build-variant-condition{matching-criterion=RDR_POS, value=0}, BswMActionListItemIndex=11 if post-build-variant-condition{matching-criterion=RDR_POS, value=1}, BswMActionListItemIndex=11 if post-build-variant-condition{matching-criterion=RDR_POS, value=2}, BswMActionListItemIndex=11 if post-build-variant-condition{matching-criterion=RDR_POS, value=3}, BswMActionListItemIndex=11 if post-build-variant-condition{matching-criterion=RDR_POS, value=4}, BswMActionListItemIndex=11 if post-build-variant-condition{matching-criterion=RDR_POS, value=5}, BswMActionListItemIndex=11 if post-build-variant-condition{matching-criterion=RDR_POS, value=6}, BswMActionListItemIndex=11 if post-build-variant-condition{matching-criterion=RDR_POS, value=7}, BswMActionListItemRef=BswMModeControl/INIT_Action_Csm_Init
            INIT_Action_CanSM_PreInit: BswMActionListItemIndex=2 if post-build-variant-condition{matching-criterion=RDR_POS, value=0}, BswMActionListItemIndex=2 if post-build-variant-condition{matching-criterion=RDR_POS, value=1}, BswMActionListItemIndex=2 if post-build-variant-condition{matching-criterion=RDR_POS, value=2}, BswMActionListItemIndex=2 if post-build-variant-condition{matching-criterion=RDR_POS, value=3}, BswMActionListItemIndex=2 if post-build-variant-condition{matching-criterion=RDR_POS, value=4}, BswMActionListItemIndex=2 if post-build-variant-condition{matching-criterion=RDR_POS, value=5}, BswMActionListItemIndex=2 if post-build-variant-condition{matching-criterion=RDR_POS, value=6}, BswMActionListItemIndex=2 if post-build-variant-condition{matching-criterion=RDR_POS, value=7}, BswMActionListItemRef=BswMModeControl/INIT_Action_CanSM_PreInit
            INIT_Action_CanTp_PreInit: BswMActionListItemIndex=3 if post-build-variant-condition{matching-criterion=RDR_POS, value=0}, BswMActionListItemIndex=3 if post-build-variant-condition{matching-criterion=RDR_POS, value=2}, BswMActionListItemIndex=3 if post-build-variant-condition{matching-criterion=RDR_POS, value=1}, BswMActionListItemIndex=3 if post-build-variant-condition{matching-criterion=RDR_POS, value=3}, BswMActionListItemIndex=3 if post-build-variant-condition{matching-criterion=RDR_POS, value=4}, BswMActionListItemIndex=3 if post-build-variant-condition{matching-criterion=RDR_POS, value=5}, BswMActionListItemIndex=3 if post-build-variant-condition{matching-criterion=RDR_POS, value=6}, BswMActionListItemIndex=3 if post-build-variant-condition{matching-criterion=RDR_POS, value=7}, BswMActionListItemRef=BswMModeControl/INIT_Action_CanTp_PreInit
            INIT_Action_CanTp_Init: BswMActionListItemIndex=18 if post-build-variant-condition{matching-criterion=RDR_POS, value=0}, BswMActionListItemIndex=18 if post-build-variant-condition{matching-criterion=RDR_POS, value=1}, BswMActionListItemIndex=18 if post-build-variant-condition{matching-criterion=RDR_POS, value=2}, BswMActionListItemIndex=18 if post-build-variant-condition{matching-criterion=RDR_POS, value=3}, BswMActionListItemIndex=18 if post-build-variant-condition{matching-criterion=RDR_POS, value=4}, BswMActionListItemIndex=18 if post-build-variant-condition{matching-criterion=RDR_POS, value=5}, BswMActionListItemIndex=18 if post-build-variant-condition{matching-criterion=RDR_POS, value=6}, BswMActionListItemIndex=18 if post-build-variant-condition{matching-criterion=RDR_POS, value=7}, BswMActionListItemRef=BswMModeControl/INIT_Action_CanTp_Init
            INIT_Action_Dcm_Init: BswMActionListItemIndex=20 if post-build-variant-condition{matching-criterion=RDR_POS, value=0}, BswMActionListItemIndex=20 if post-build-variant-condition{matching-criterion=RDR_POS, value=1}, BswMActionListItemIndex=20 if post-build-variant-condition{matching-criterion=RDR_POS, value=2}, BswMActionListItemIndex=20 if post-build-variant-condition{matching-criterion=RDR_POS, value=3}, BswMActionListItemIndex=20 if post-build-variant-condition{matching-criterion=RDR_POS, value=4}, BswMActionListItemIndex=20 if post-build-variant-condition{matching-criterion=RDR_POS, value=5}, BswMActionListItemIndex=20 if post-build-variant-condition{matching-criterion=RDR_POS, value=6}, BswMActionListItemIndex=20 if post-build-variant-condition{matching-criterion=RDR_POS, value=7}, BswMActionListItemRef=BswMModeControl/INIT_Action_Dcm_Init
            INIT_Action_Det_Init: BswMActionListItemIndex=0 if post-build-variant-condition{matching-criterion=RDR_POS, value=0}, BswMActionListItemIndex=0 if post-build-variant-condition{matching-criterion=RDR_POS, value=1}, BswMActionListItemIndex=0 if post-build-variant-condition{matching-criterion=RDR_POS, value=2}, BswMActionListItemIndex=0 if post-build-variant-condition{matching-criterion=RDR_POS, value=3}, BswMActionListItemIndex=0 if post-build-variant-condition{matching-criterion=RDR_POS, value=4}, BswMActionListItemIndex=0 if post-build-variant-condition{matching-criterion=RDR_POS, value=5}, BswMActionListItemIndex=0 if post-build-variant-condition{matching-criterion=RDR_POS, value=6}, BswMActionListItemIndex=0 if post-build-variant-condition{matching-criterion=RDR_POS, value=7}, BswMActionListItemRef=BswMModeControl/INIT_Action_Det_Init
            INIT_Action_Dem_Init: BswMActionListItemIndex=48 if post-build-variant-condition{matching-criterion=RDR_POS, value=0}, BswMActionListItemIndex=48 if post-build-variant-condition{matching-criterion=RDR_POS, value=1}, BswMActionListItemIndex=48 if post-build-variant-condition{matching-criterion=RDR_POS, value=2}, BswMActionListItemIndex=48 if post-build-variant-condition{matching-criterion=RDR_POS, value=3}, BswMActionListItemIndex=48 if post-build-variant-condition{matching-criterion=RDR_POS, value=4}, BswMActionListItemIndex=48 if post-build-variant-condition{matching-criterion=RDR_POS, value=5}, BswMActionListItemIndex=48 if post-build-variant-condition{matching-criterion=RDR_POS, value=6}, BswMActionListItemIndex=48 if post-build-variant-condition{matching-criterion=RDR_POS, value=7}, BswMActionListItemRef=BswMModeControl/INIT_Action_Dem_Init
            Init_Action_Dem_PreInit: BswMActionListItemIndex=47 if post-build-variant-condition{matching-criterion=RDR_POS, value=0}, BswMActionListItemIndex=47 if post-build-variant-condition{matching-criterion=RDR_POS, value=1}, BswMActionListItemIndex=47 if post-build-variant-condition{matching-criterion=RDR_POS, value=2}, BswMActionListItemIndex=47 if post-build-variant-condition{matching-criterion=RDR_POS, value=3}, BswMActionListItemIndex=47 if post-build-variant-condition{matching-criterion=RDR_POS, value=4}, BswMActionListItemIndex=47 if post-build-variant-condition{matching-criterion=RDR_POS, value=5}, BswMActionListItemIndex=47 if post-build-variant-condition{matching-criterion=RDR_POS, value=6}, BswMActionListItemIndex=47 if post-build-variant-condition{matching-criterion=RDR_POS, value=7}, BswMActionListItemRef=BswMModeControl/Init_Action_Dem_PreInit
            INIT_Action_E2EXf_Init: BswMActionListItemIndex=46 if post-build-variant-condition{matching-criterion=RDR_POS, value=1}, BswMActionListItemIndex=46 if post-build-variant-condition{matching-criterion=RDR_POS, value=3}, BswMActionListItemIndex=46 if post-build-variant-condition{matching-criterion=RDR_POS, value=2}, BswMActionListItemIndex=46 if post-build-variant-condition{matching-criterion=RDR_POS, value=5}, BswMActionListItemIndex=46 if post-build-variant-condition{matching-criterion=RDR_POS, value=6}, BswMActionListItemIndex=46 if post-build-variant-condition{matching-criterion=RDR_POS, value=0}, BswMActionListItemIndex=46 if post-build-variant-condition{matching-criterion=RDR_POS, value=4}, BswMActionListItemIndex=46 if post-build-variant-condition{matching-criterion=RDR_POS, value=7}, BswMActionListItemRef=BswMModeControl/INIT_Action_E2EXf_Init
            SetOperationCycle_UserCallOut: BswMActionListItemIndex=49 if post-build-variant-condition{matching-criterion=RDR_POS, value=0}, BswMActionListItemIndex=49 if post-build-variant-condition{matching-criterion=RDR_POS, value=3}, BswMActionListItemIndex=49 if post-build-variant-condition{matching-criterion=RDR_POS, value=5}, BswMActionListItemIndex=49 if post-build-variant-condition{matching-criterion=RDR_POS, value=6}, BswMActionListItemIndex=49 if post-build-variant-condition{matching-criterion=RDR_POS, value=2}, BswMActionListItemIndex=49 if post-build-variant-condition{matching-criterion=RDR_POS, value=4}, BswMActionListItemIndex=49 if post-build-variant-condition{matching-criterion=RDR_POS, value=7}, BswMActionListItemIndex=49 if post-build-variant-condition{matching-criterion=RDR_POS, value=1}, BswMActionListItemRef=BswMModeControl/SetOperationCycle_UserCallOut
            Action_User_EthIf_Init: BswMActionListItemIndex=21, BswMActionListItemRef=BswMModeControl/Action_User_EthIf_Init, variation-point=post-build-variant-condition{matching-criterion=RDR_POS, value=1}
            Action_User_EthIf_Init: BswMActionListItemIndex=21, BswMActionListItemRef=BswMModeControl/Action_User_EthIf_Init, variation-point=post-build-variant-condition{matching-criterion=RDR_POS, value=0}
            Action_User_EthIf_Init: BswMActionListItemIndex=21, BswMActionListItemRef=BswMModeControl/Action_User_EthIf_Init, variation-point=post-build-variant-condition{matching-criterion=RDR_POS, value=4}
            Action_User_EthIf_Init: BswMActionListItemIndex=21, BswMActionListItemRef=BswMModeControl/Action_User_EthIf_Init, variation-point=post-build-variant-condition{matching-criterion=RDR_POS, value=5}
            Action_User_EthIf_Init: BswMActionListItemIndex=21, BswMActionListItemRef=BswMModeControl/Action_User_EthIf_Init, variation-point=post-build-variant-condition{matching-criterion=RDR_POS, value=7}
            Action_User_EthIf_Init: BswMActionListItemIndex=21, BswMActionListItemRef=BswMModeControl/Action_User_EthIf_Init, variation-point=post-build-variant-condition{matching-criterion=RDR_POS, value=6}
            Action_User_EthIf_Init: BswMActionListItemIndex=21, BswMActionListItemRef=BswMModeControl/Action_User_EthIf_Init, variation-point=post-build-variant-condition{matching-criterion=RDR_POS, value=3}
            Action_User_EthIf_Init: BswMActionListItemIndex=21, BswMActionListItemRef=BswMModeControl/Action_User_EthIf_Init, variation-point=post-build-variant-condition{matching-criterion=RDR_POS, value=2}
        38 x BswMAction:
          INIT_Action_EthIf_Init
            BswMAvailableActions
              BswMUserCallout:
                BswMUserCalloutFunction = EthIf_Init(EcuM_GlobalPCConfig_Ptr->CfgPtr_EthIf_Init) if post-build-variant-condition{matching-criterion=RDR_POS, value=1}
                BswMUserCalloutFunction = EthIf_Init(EcuM_GlobalPCConfig_Ptr->CfgPtr_EthIf_Init) if post-build-variant-condition{matching-criterion=RDR_POS, value=7}
                BswMUserCalloutFunction = EthIf_Init(EcuM_GlobalPCConfig_Ptr->CfgPtr_EthIf_Init) if post-build-variant-condition{matching-criterion=RDR_POS, value=5}
                BswMUserCalloutFunction = EthIf_Init(EcuM_GlobalPCConfig_Ptr->CfgPtr_EthIf_Init) if post-build-variant-condition{matching-criterion=RDR_POS, value=2}
                BswMUserCalloutFunction = EthIf_Init(EcuM_GlobalPCConfig_Ptr->CfgPtr_EthIf_Init) if post-build-variant-condition{matching-criterion=RDR_POS, value=0}
                BswMUserCalloutFunction = EthIf_Init(EcuM_GlobalPCConfig_Ptr->CfgPtr_EthIf_Init) if post-build-variant-condition{matching-criterion=RDR_POS, value=4}
                BswMUserCalloutFunction = EthIf_Init(EcuM_GlobalPCConfig_Ptr->CfgPtr_EthIf_Init) if post-build-variant-condition{matching-criterion=RDR_POS, value=6}
                BswMUserCalloutFunction = EthIf_Init(EcuM_GlobalPCConfig_Ptr->CfgPtr_EthIf_Init) if post-build-variant-condition{matching-criterion=RDR_POS, value=3}
                BswMCreateCallout = false
                BswMUserIncludeFile = EthIf.h
          INIT_Action_SoAd_Init
            BswMAvailableActions
              BswMUserCallout: BswMUserCalloutFunction=SoAd_Init(SoAd_Config_Ptr), BswMCreateCallout=false, BswMUserIncludeFile=SoAd.h
          INIT_Action_Com_Init
            BswMAvailableActions
              BswMUserCallout:
                BswMUserCalloutFunction = User_Com_Init()
                BswMCreateCallout = true if post-build-variant-condition{matching-criterion=RDR_POS, value=0}
                BswMCreateCallout = true if post-build-variant-condition{matching-criterion=RDR_POS, value=5}
                BswMCreateCallout = true if post-build-variant-condition{matching-criterion=RDR_POS, value=7}
                BswMCreateCallout = true if post-build-variant-condition{matching-criterion=RDR_POS, value=3}
                BswMCreateCallout = true if post-build-variant-condition{matching-criterion=RDR_POS, value=1}
                BswMCreateCallout = true if post-build-variant-condition{matching-criterion=RDR_POS, value=4}
                BswMCreateCallout = true if post-build-variant-condition{matching-criterion=RDR_POS, value=6}
                BswMCreateCallout = true if post-build-variant-condition{matching-criterion=RDR_POS, value=2}
                BswMUserIncludeFile = Com.h
          INIT_Action_PduR_Init
            BswMAvailableActions
              BswMUserCallout: BswMUserCalloutFunction=PduR_Init(EcuM_GlobalPCConfig_Ptr->CfgPtr_PduR_Init), BswMCreateCallout=false, BswMUserIncludeFile=PduR.h
          INIT_Action_EthSM_Init
            BswMAvailableActions
              BswMUserCallout: BswMUserCalloutFunction=EthSM_Init(EthSM_Config_Ptr), BswMCreateCallout=false, BswMUserIncludeFile=EthSM.h
          INIT_Action_TcpIp_Init
            BswMAvailableActions
              BswMUserCallout: BswMUserCalloutFunction=TcpIp_Init(TcpIp_Config_Ptr), BswMCreateCallout=false, BswMUserIncludeFile=TcpIp.h
          INIT_Action_EnableInterrupts
            BswMAvailableActions
              BswMUserCallout: BswMUserCalloutFunction=BswM_AL_SetProgrammableInterrupts(), BswMCreateCallout=true
          INIT_Action_ComM_Init
            BswMAvailableActions
              BswMUserCallout: BswMUserCalloutFunction=ComM_Init(ComM_Config_Ptr), BswMCreateCallout=false, BswMUserIncludeFile=ComM.h
          INIT_Action_ComM_PostInit
            BswMAvailableActions
              BswMUserCallout: BswMUserCalloutFunction=ComM_PostInit(), BswMCreateCallout=false, BswMUserIncludeFile=ComM.h
          INIT_Action_Rte_Start
            BswMAvailableActions
              BswMUserCallout: BswMUserCalloutFunction=Rte_Start(), BswMCreateCallout=false, BswMUserIncludeFile=Rte_Main.h
          INIT_Action_SoAd_PostInit
            BswMAvailableActions
              BswMUserCallout: BswMUserCalloutFunction=SoAd_PostInit(), BswMCreateCallout=false, BswMUserIncludeFile=SoAd.h
          INIT_Action_CanIf_Init
            BswMAvailableActions
              BswMUserCallout: BswMUserCalloutFunction=CanIf_Init(EcuM_GlobalPCConfig_Ptr->CfgPtr_CanIf_Init), BswMCreateCallout=false, BswMUserIncludeFile=CanIf.h
          INIT_Action_CanSM_Init
            BswMAvailableActions
              BswMUserCallout: BswMUserCalloutFunction=CanSM_Init(CanSM_Config_Ptr), BswMCreateCallout=false, BswMUserIncludeFile=CanSM_EcuM.h
          Action_ALLOW_COM_RDR_EthConnector1_de653f65
            BswMAvailableActions
              BswMComMAllowCom: BswMComAllowed=true, BswMComMAllowChannelRef=cnctr_RDR_RdrNet_5172a59b
          INIT_Action_ETH_ComM_Init
            BswMAvailableActions
              Eth_ComM_Init (BswMUserCallout): BswMUserCalloutFunction=Eth_ComM_Init(), BswMCreateCallout=true, BswMUserIncludeFile=ComM.h
          ESH_Action_OnEnterPrepShutdown
            BswMAvailableActions
              BswMUserCallout: BswMUserCalloutFunction=BswM_ESH_OnEnterPrepShutdown(), BswMCreateCallout=true
          ESH_Action_OnEnterWakeup
            BswMAvailableActions
              BswMUserCallout: BswMUserCalloutFunction=BswM_ESH_OnEnterWakeup(), BswMCreateCallout=true
          ESH_Action_OnEnterRun
            BswMAvailableActions
              BswMUserCallout: BswMUserCalloutFunction=BswM_ESH_OnEnterRun(), BswMCreateCallout=true
          ESH_Action_OnEnterShutdown
            BswMAvailableActions
              BswMUserCallout: BswMUserCalloutFunction=BswM_ESH_OnEnterShutdown(), BswMCreateCallout=true
          ESH_Action_OnEnterWaitForNvm
            BswMAvailableActions
              BswMUserCallout: BswMUserCalloutFunction=BswM_ESH_OnEnterWaitForNvm(), BswMCreateCallout=true
          ESH_Action_OnEnterPostRun
            BswMAvailableActions
              BswMUserCallout: BswMUserCalloutFunction=BswM_ESH_OnEnterPostRun(), BswMCreateCallout=true
          INIT_Action_TcpIpXcp_Init
            BswMAvailableActions
              BswMUserCallout: BswMUserCalloutFunction=TcpIpXcp_Init(NULL_PTR), BswMCreateCallout=false, BswMUserIncludeFile=TcpIpXcp.h
          INIT_Action_Xcp_Init
            BswMAvailableActions
              BswMUserCallout: BswMUserCalloutFunction=Xcp_Init(), BswMCreateCallout=false, BswMUserIncludeFile=Xcp.h
          INIT_Action_StbM_PreInit
            BswMAvailableActions
              BswMUserCallout: BswMUserCalloutFunction=StbM_PreInit(EcuM_GlobalPCConfig_Ptr->CfgPtr_StbM_PreInit), BswMCreateCallout=false, BswMUserIncludeFile=StbM.h
          INIT_Action_EthTSyn_Init
            BswMAvailableActions
              BswMUserCallout: BswMUserCalloutFunction=EthTSyn_Init(EthTSyn_Config_Ptr), BswMCreateCallout=false, BswMUserIncludeFile=EthTSyn.h
          INIT_Action_StbM_Init
            BswMAvailableActions
              BswMUserCallout: BswMUserCalloutFunction=StbM_Init(EcuM_GlobalPCConfig_Ptr->CfgPtr_StbM_Init), BswMCreateCallout=false, BswMUserIncludeFile=StbM.h
          INIT_Action_StbM_PostInit
            BswMAvailableActions
              BswMUserCallout: BswMUserCalloutFunction=StbM_PostInit(), BswMCreateCallout=false, BswMUserIncludeFile=StbM.h
          BswMUserCallout
            BswMAvailableActions
              BswMUserCallout: BswMUserCalloutFunction=ComM_PreInit(ComM_Config_Ptr), BswMCreateCallout=false, BswMUserIncludeFile=ComM.h, BswMCalloutParameterList=
          INIT_Action_Can_Init
            BswMAvailableActions
              BswMUserCallout: BswMUserCalloutFunction=Can_Init(&Can_Config), BswMCreateCallout=false, BswMUserIncludeFile=Can.h
          Action_ALLOW_COM_CN_PCAN_RADAR_458ff0f1
            BswMAvailableActions
              BswMComMAllowCom: BswMComAllowed=true, BswMComMAllowChannelRef=CN_PCAN_RADAR_458ff0f1
          Action_BSWM_FULL_COM_CN_PCAN_RADAR_d6cf874b
            BswMAvailableActions
              BswMComMModeSwitch: BswMComMRequestedMode=BSWM_FULL_COM, BswMComMUserRef=CN_PCAN_RADAR_d6cf874b
          Action_ENABLE_G5_RDR01_oPCAN_RADAR_Tx_83b3265e_G5_RDR01_oPCAN_RADAR_Rx_d5e981d8
            BswMAvailableActions
              BswMPduGroupSwitch:
                BswMPduGroupSwitchReinit = true
                BswMEnabledPduGroupRef = RDR01_oPCAN_RADAR_Rx_e0e717e1 if post-build-variant-condition{matching-criterion=RDR_POS, value=0}
                BswMEnabledPduGroupRef = RDR01_oPCAN_RADAR_Tx_b6bdb067 if post-build-variant-condition{matching-criterion=RDR_POS, value=0}
                BswMEnabledPduGroupRef = RDR02_oPCAN_RADAR_Rx_c92fa313 if post-build-variant-condition{matching-criterion=RDR_POS, value=1}
                BswMEnabledPduGroupRef = RDR02_oPCAN_RADAR_Tx_9f750495 if post-build-variant-condition{matching-criterion=RDR_POS, value=1}
                BswMEnabledPduGroupRef = RDR03_oPCAN_RADAR_Rx_67473282 if post-build-variant-condition{matching-criterion=RDR_POS, value=2}
                BswMEnabledPduGroupRef = RDR03_oPCAN_RADAR_Tx_311d9504 if post-build-variant-condition{matching-criterion=RDR_POS, value=2}
                BswMEnabledPduGroupRef = RDR04_oPCAN_RADAR_Rx_9abecaf7 if post-build-variant-condition{matching-criterion=RDR_POS, value=3}
                BswMEnabledPduGroupRef = RDR04_oPCAN_RADAR_Tx_cce46d71 if post-build-variant-condition{matching-criterion=RDR_POS, value=3}
                BswMEnabledPduGroupRef = RDR05_oPCAN_RADAR_Rx_34d65b66 if post-build-variant-condition{matching-criterion=RDR_POS, value=4}
                BswMEnabledPduGroupRef = RDR05_oPCAN_RADAR_Tx_628cfce0 if post-build-variant-condition{matching-criterion=RDR_POS, value=4}
                BswMEnabledPduGroupRef = RDR06_oPCAN_RADAR_Rx_1d1eef94 if post-build-variant-condition{matching-criterion=RDR_POS, value=5}
                BswMEnabledPduGroupRef = RDR06_oPCAN_RADAR_Tx_4b444812 if post-build-variant-condition{matching-criterion=RDR_POS, value=5}
                BswMEnabledPduGroupRef = RDR07_oPCAN_RADAR_Rx_b3767e05 if post-build-variant-condition{matching-criterion=RDR_POS, value=6}
                BswMEnabledPduGroupRef = RDR07_oPCAN_RADAR_Tx_e52cd983 if post-build-variant-condition{matching-criterion=RDR_POS, value=6}
                BswMEnabledPduGroupRef = RDR08_oPCAN_RADAR_Rx_3d9c193f if post-build-variant-condition{matching-criterion=RDR_POS, value=7}
                BswMEnabledPduGroupRef = RDR08_oPCAN_RADAR_Tx_6bc6beb9 if post-build-variant-condition{matching-criterion=RDR_POS, value=7}
          ESH_Action_ComMAllow_CN_PCAN_RADAR_458ff0f1
            BswMAvailableActions
              BswMComMAllowCom: BswMComAllowed=true, BswMComMAllowChannelRef=CN_PCAN_RADAR_458ff0f1
          ESH_Action_ComMDisallow_CN_PCAN_RADAR_458ff0f1
            BswMAvailableActions
              BswMComMAllowCom: BswMComAllowed=false, BswMComMAllowChannelRef=CN_PCAN_RADAR_458ff0f1
          INIT_Action_Fee_30_FlexNor_Init
            BswMAvailableActions
              BswMUserCallout: BswMUserCalloutFunction=Fee_30_FlexNor_Init(), BswMCreateCallout=false, BswMUserIncludeFile=Fee_30_FlexNor.h
          INIT_Action_NvM_Init
            BswMAvailableActions
              BswMUserCallout: BswMUserCalloutFunction=NvM_Init(), BswMCreateCallout=false, BswMUserIncludeFile=NvM.h
          INIT_Action_NvMReadAll
            BswMAvailableActions
              BswMUserCallout: BswMUserCalloutFunction=BswM_INIT_NvMReadAll(), BswMCreateCallout=true
          User_CAN_ComPduGroupHandling
            BswMAvailableActions
              User_CAN_ComPduGroupHandling (BswMUserCallout): BswMUserCalloutFunction=User_CAN_ComPduGroupHandling(), BswMCreateCallout=true, BswMUserIncludeFile=ComM.h
        SDC_AL_ApplRelease_S_provService_RDR_1_Detections_89f78c9f (BswMActionList): BswMActionListExecution=BSWM_TRIGGER
          SDC_SdServerServiceModeRequest_provService_RDR_1_Detections_89f78c9f_BSWM_SD_SERVER_SERVICE_DOWN (BswMActionListItem):
            BswMAbortOnFail = false
            BswMActionListItemIndex = 0
            BswMActionListItemRef = BswMModeControl/SDC_SdServerServiceModeRequest_provService_RDR_1_Detections_89f78c9f_BSWM_SD_SERVER_SERVICE_DOWN
        SDC_SdServerServiceModeRequest_provService_RDR_1_Detections_89f78c9f_BSWM_SD_SERVER_SERVICE_DOWN (BswMAction)
          BswMAvailableActions
            BswMSdServerServiceModeRequest: BswMSdServerServiceState=BSWM_SD_SERVER_SERVICE_DOWN, BswMSdServerMethodsRef=provService_RDR_1_Detections_89f78c9f
        SDC_AL_ApplRequest_S_provService_RDR_1_Detections_89f78c9f (BswMActionList): BswMActionListExecution=BSWM_TRIGGER
          SDC_SdServerServiceModeRequest_provService_RDR_1_Detections_89f78c9f_BSWM_SD_SERVER_SERVICE_AVAILABLE (BswMActionListItem):
            BswMAbortOnFail = false
            BswMActionListItemIndex = 0
            BswMActionListItemRef = BswMModeControl/SDC_SdServerServiceModeRequest_provService_RDR_1_Detections_89f78c9f_BSWM_SD_SERVER_SERVICE_AVAILABLE
        SDC_SdServerServiceModeRequest_provService_RDR_1_Detections_89f78c9f_BSWM_SD_SERVER_SERVICE_AVAILABLE (BswMAction)
          BswMAvailableActions
            BswMSdServerServiceModeRequest: BswMSdServerServiceState=BSWM_SD_SERVER_SERVICE_AVAILABLE, BswMSdServerMethodsRef=provService_RDR_1_Detections_89f78c9f
        SDC_AL_SdRelease_S_provService_RDR_1_SW_Info_c2745ec9_EH_EventGroup_RDR_1_653e2581 (BswMActionList): BswMActionListExecution=BSWM_TRIGGER
          SDC_Mode_S_provService_RDR_1_SW_Info_c2745ec9_EH_EventGroup_RDR_1_653e2581_SDC_EH_RELEASED (BswMActionListItem):
            BswMAbortOnFail = false
            BswMActionListItemIndex = 0
            BswMActionListItemRef = BswMModeControl/SDC_Mode_S_provService_RDR_1_SW_Info_c2745ec9_EH_EventGroup_RDR_1_653e2581_SDC_EH_RELEASED
        SDC_Mode_S_provService_RDR_1_SW_Info_c2745ec9_EH_EventGroup_RDR_1_653e2581_SDC_EH_RELEASED (BswMAction)
          BswMAvailableActions
            BswMRteSwitch: BswMSwitchedMode=SDC_EH_RELEASED, BswMRteSwitchPortRef=SDC_Mode_S_provService_RDR_1_SW_Info_c2745ec9_EH_EventGroup_RDR_1_653e2581
        SDC_Mode_S_provService_RDR_1_SW_Info_c2745ec9_EH_EventGroup_RDR_1_653e2581 (BswMSwitchPort): BswMModeSwitchInterfaceRef=BswM_MSI_SDC_SdEventHandlerState
        SDC_AL_SdRequest_S_provService_RDR_1_SW_Info_c2745ec9_EH_EventGroup_RDR_1_653e2581 (BswMActionList): BswMActionListExecution=BSWM_TRIGGER
          SDC_Mode_S_provService_RDR_1_SW_Info_c2745ec9_EH_EventGroup_RDR_1_653e2581_SDC_EH_REQUESTED (BswMActionListItem):
            BswMAbortOnFail = false
            BswMActionListItemIndex = 0
            BswMActionListItemRef = BswMModeControl/SDC_Mode_S_provService_RDR_1_SW_Info_c2745ec9_EH_EventGroup_RDR_1_653e2581_SDC_EH_REQUESTED
        SDC_Mode_S_provService_RDR_1_SW_Info_c2745ec9_EH_EventGroup_RDR_1_653e2581_SDC_EH_REQUESTED (BswMAction)
          BswMAvailableActions
            BswMRteSwitch: BswMSwitchedMode=SDC_EH_REQUESTED, BswMRteSwitchPortRef=SDC_Mode_S_provService_RDR_1_SW_Info_c2745ec9_EH_EventGroup_RDR_1_653e2581
        SDC_AL_ApplRelease_C_consService_RDR_1_ADAS_Vehicle_Status_2b1e055b_CEG_consServiceGrp_RDR_1_ADAS_Vehicle_Status_4b79da85 (BswMActionList): BswMActionListExecution=BSWM_TRIGGER
          SDC_SdCEGModeRequest_C_consService_RDR_1_ADAS_Vehicle_Status_2b1e055b_CEG_consServiceGrp_RDR_1_ADAS_Vehicle_Status_4b79_84c0fea4 (BswMActionListItem):
            BswMAbortOnFail = false
            BswMActionListItemIndex = 0
            BswMActionListItemRef = BswMModeControl/SDC_SdCEGModeRequest_C_consService_RDR_1_ADAS_Vehicle_Status_2b1e055b_CEG_consServiceGrp_RDR_1_ADAS_Vehicle_Status_4b79_84c0fea4
        SDC_SdCEGModeRequest_C_consService_RDR_1_ADAS_Vehicle_Status_2b1e055b_CEG_consServiceGrp_RDR_1_ADAS_Vehicle_Status_4b79_84c0fea4 (BswMAction)
          BswMAvailableActions
            BswMSdConsumedEventGroupModeRequest:
              BswMSdConsumedEventGroupState = BSWM_SD_CONSUMED_EVENTGROUP_RELEASED
              BswMSdConsumedEventGroupRef = consServiceGrp_RDR_1_ADAS_Vehicle_Status_4b79da85
        SDC_AL_ApplRequest_C_consService_RDR_1_ADAS_Vehicle_Status_2b1e055b_CEG_consServiceGrp_RDR_1_ADAS_Vehicle_Status_4b79da85 (BswMActionList): BswMActionListExecution=BSWM_TRIGGER
          SDC_SdCEGModeRequest_C_consService_RDR_1_ADAS_Vehicle_Status_2b1e055b_CEG_consServiceGrp_RDR_1_ADAS_Vehicle_Status_4b79_862c6c58 (BswMActionListItem):
            BswMAbortOnFail = false
            BswMActionListItemIndex = 0
            BswMActionListItemRef = BswMModeControl/SDC_SdCEGModeRequest_C_consService_RDR_1_ADAS_Vehicle_Status_2b1e055b_CEG_consServiceGrp_RDR_1_ADAS_Vehicle_Status_4b79_862c6c58
        SDC_SdCEGModeRequest_C_consService_RDR_1_ADAS_Vehicle_Status_2b1e055b_CEG_consServiceGrp_RDR_1_ADAS_Vehicle_Status_4b79_862c6c58 (BswMAction)
          BswMAvailableActions
            BswMSdConsumedEventGroupModeRequest:
              BswMSdConsumedEventGroupState = BSWM_SD_CONSUMED_EVENTGROUP_REQUESTED
              BswMSdConsumedEventGroupRef = consServiceGrp_RDR_1_ADAS_Vehicle_Status_4b79da85
        SDC_AL_ApplRelease_C_consService_RDR_1_ADAS_Vehicle_Status_2b1e055b (BswMActionList): BswMActionListExecution=BSWM_TRIGGER
          SDC_SdClientServiceModeRequetst_C_consService_RDR_1_ADAS_Vehicle_Status_2b1e055b_RELEASED (BswMActionListItem):
            BswMAbortOnFail = false
            BswMActionListItemIndex = 0
            BswMActionListItemRef = BswMModeControl/SDC_SdClientServiceModeRequetst_C_consService_RDR_1_ADAS_Vehicle_Status_2b1e055b_RELEASED
        SDC_SdClientServiceModeRequetst_C_consService_RDR_1_ADAS_Vehicle_Status_2b1e055b_RELEASED (BswMAction)
          BswMAvailableActions
            BswMSdClientServiceModeRequest: BswMSdClientServiceState=BSWM_SD_CLIENT_SERVICE_RELEASED, BswMSdClientMethodsRef=consService_RDR_1_ADAS_Vehicle_Status_2b1e055b
        SDC_AL_ApplRequest_C_consService_RDR_1_ADAS_Vehicle_Status_2b1e055b (BswMActionList): BswMActionListExecution=BSWM_TRIGGER
          SDC_SdClientServiceModeRequest_consService_RDR_1_ADAS_Vehicle_Status_2b1e055b_BSWM_SD_CLIENT_SERVICE_REQUESTED (BswMActionListItem):
            BswMAbortOnFail = false
            BswMActionListItemIndex = 0
            BswMActionListItemRef = BswMModeControl/SDC_SdClientServiceModeRequest_consService_RDR_1_ADAS_Vehicle_Status_2b1e055b_BSWM_SD_CLIENT_SERVICE_REQUESTED
        SDC_SdClientServiceModeRequest_consService_RDR_1_ADAS_Vehicle_Status_2b1e055b_BSWM_SD_CLIENT_SERVICE_REQUESTED (BswMAction)
          BswMAvailableActions
            BswMSdClientServiceModeRequest: BswMSdClientServiceState=BSWM_SD_CLIENT_SERVICE_REQUESTED, BswMSdClientMethodsRef=consService_RDR_1_ADAS_Vehicle_Status_2b1e055b
        SDC_AL_SdDown_C_consService_RDR_1_ADAS_Vehicle_Status_2b1e055b_CEG_consServiceGrp_RDR_1_ADAS_Vehicle_Status_4b79da85_DOWN (BswMActionList): BswMActionListExecution=BSWM_TRIGGER
          SDC_Mode_C_consService_RDR_1_ADAS_Vehicle_Status_2b1e055b_CEG_consServiceGrp_RDR_1_ADAS_Vehicle_Status_4b79da85_SDC_CEG_DOWN (BswMActionListItem):
            BswMAbortOnFail = false
            BswMActionListItemIndex = 0
            BswMActionListItemRef = BswMModeControl/SDC_Mode_C_consService_RDR_1_ADAS_Vehicle_Status_2b1e055b_CEG_consServiceGrp_RDR_1_ADAS_Vehicle_Status_4b79da85_SDC_CEG_DOWN
        SDC_Mode_C_consService_RDR_1_ADAS_Vehicle_Status_2b1e055b_CEG_consServiceGrp_RDR_1_ADAS_Vehicle_Status_4b79da85_SDC_CEG_DOWN (BswMAction)
          BswMAvailableActions
            BswMRteSwitch:
              BswMSwitchedMode = SDC_CEG_DOWN
              BswMRteSwitchPortRef = SDC_Mode_C_consService_RDR_1_ADAS_Vehicle_Status_2b1e055b_CEG_consServiceGrp_RDR_1_ADAS_Vehicle_Status_4b79da85
        SDC_Mode_C_consService_RDR_1_ADAS_Vehicle_Status_2b1e055b_CEG_consServiceGrp_RDR_1_ADAS_Vehicle_Status_4b79da85 (BswMSwitchPort): BswMModeSwitchInterfaceRef=BswM_MSI_SDC_SdConsumedEventGroupState
        SDC_AL_SdAvailable_C_consService_RDR_1_ADAS_Vehicle_Status_2b1e055b_CEG_consServiceGrp_RDR_1_ADAS_Vehicle_Status_4b79da_028f42eb (BswMActionList): BswMActionListExecution=BSWM_TRIGGER
          SDC_Mode_C_consService_RDR_1_ADAS_Vehicle_Status_2b1e055b_CEG_consServiceGrp_RDR_1_ADAS_Vehicle_Status_4b79da85_SDC_CEG_0469f0b9 (BswMActionListItem):
            BswMAbortOnFail = false
            BswMActionListItemIndex = 0
            BswMActionListItemRef = BswMModeControl/SDC_Mode_C_consService_RDR_1_ADAS_Vehicle_Status_2b1e055b_CEG_consServiceGrp_RDR_1_ADAS_Vehicle_Status_4b79da85_SDC_CEG_0469f0b9
        SDC_Mode_C_consService_RDR_1_ADAS_Vehicle_Status_2b1e055b_CEG_consServiceGrp_RDR_1_ADAS_Vehicle_Status_4b79da85_SDC_CEG_0469f0b9 (BswMAction)
          BswMAvailableActions
            BswMRteSwitch:
              BswMSwitchedMode = SDC_CEG_AVAILABLE
              BswMRteSwitchPortRef = SDC_Mode_C_consService_RDR_1_ADAS_Vehicle_Status_2b1e055b_CEG_consServiceGrp_RDR_1_ADAS_Vehicle_Status_4b79da85
        SDC_AL_ApplRelease_S_provService_RDR_1_SW_Info_c2745ec9 (BswMActionList): BswMActionListExecution=BSWM_TRIGGER
          SDC_SdServerServiceModeRequest_provService_RDR_1_SW_Info_c2745ec9_BSWM_SD_SERVER_SERVICE_DOWN (BswMActionListItem):
            BswMAbortOnFail = false
            BswMActionListItemIndex = 0
            BswMActionListItemRef = BswMModeControl/SDC_SdServerServiceModeRequest_provService_RDR_1_SW_Info_c2745ec9_BSWM_SD_SERVER_SERVICE_DOWN
        SDC_SdServerServiceModeRequest_provService_RDR_1_SW_Info_c2745ec9_BSWM_SD_SERVER_SERVICE_DOWN (BswMAction)
          BswMAvailableActions
            BswMSdServerServiceModeRequest: BswMSdServerServiceState=BSWM_SD_SERVER_SERVICE_DOWN, BswMSdServerMethodsRef=provService_RDR_1_SW_Info_c2745ec9
        SDC_AL_ApplRequest_S_provService_RDR_1_SW_Info_c2745ec9 (BswMActionList): BswMActionListExecution=BSWM_TRIGGER
          SDC_SdServerServiceModeRequest_provService_RDR_1_SW_Info_c2745ec9_BSWM_SD_SERVER_SERVICE_AVAILABLE (BswMActionListItem):
            BswMAbortOnFail = false
            BswMActionListItemIndex = 0
            BswMActionListItemRef = BswMModeControl/SDC_SdServerServiceModeRequest_provService_RDR_1_SW_Info_c2745ec9_BSWM_SD_SERVER_SERVICE_AVAILABLE
        SDC_SdServerServiceModeRequest_provService_RDR_1_SW_Info_c2745ec9_BSWM_SD_SERVER_SERVICE_AVAILABLE (BswMAction)
          BswMAvailableActions
            BswMSdServerServiceModeRequest: BswMSdServerServiceState=BSWM_SD_SERVER_SERVICE_AVAILABLE, BswMSdServerMethodsRef=provService_RDR_1_SW_Info_c2745ec9
        SDC_AL_SdRelease_S_provService_RDR_1_Status_d2069d01_EH_EventGroup_RDR_1_f7c73cae (BswMActionList): BswMActionListExecution=BSWM_TRIGGER
          SDC_Mode_S_provService_RDR_1_Status_d2069d01_EH_EventGroup_RDR_1_f7c73cae_SDC_EH_RELEASED (BswMActionListItem):
            BswMAbortOnFail = false
            BswMActionListItemIndex = 0
            BswMActionListItemRef = BswMModeControl/SDC_Mode_S_provService_RDR_1_Status_d2069d01_EH_EventGroup_RDR_1_f7c73cae_SDC_EH_RELEASED
        SDC_Mode_S_provService_RDR_1_Status_d2069d01_EH_EventGroup_RDR_1_f7c73cae_SDC_EH_RELEASED (BswMAction)
          BswMAvailableActions
            BswMRteSwitch: BswMSwitchedMode=SDC_EH_RELEASED, BswMRteSwitchPortRef=SDC_Mode_S_provService_RDR_1_Status_d2069d01_EH_EventGroup_RDR_1_f7c73cae
        SDC_Mode_S_provService_RDR_1_Status_d2069d01_EH_EventGroup_RDR_1_f7c73cae (BswMSwitchPort): BswMModeSwitchInterfaceRef=BswM_MSI_SDC_SdEventHandlerState
        SDC_AL_SdRequest_S_provService_RDR_1_Status_d2069d01_EH_EventGroup_RDR_1_f7c73cae (BswMActionList): BswMActionListExecution=BSWM_TRIGGER
          SDC_Mode_S_provService_RDR_1_Status_d2069d01_EH_EventGroup_RDR_1_f7c73cae_SDC_EH_REQUESTED (BswMActionListItem):
            BswMAbortOnFail = false
            BswMActionListItemIndex = 0
            BswMActionListItemRef = BswMModeControl/SDC_Mode_S_provService_RDR_1_Status_d2069d01_EH_EventGroup_RDR_1_f7c73cae_SDC_EH_REQUESTED
        SDC_Mode_S_provService_RDR_1_Status_d2069d01_EH_EventGroup_RDR_1_f7c73cae_SDC_EH_REQUESTED (BswMAction)
          BswMAvailableActions
            BswMRteSwitch: BswMSwitchedMode=SDC_EH_REQUESTED, BswMRteSwitchPortRef=SDC_Mode_S_provService_RDR_1_Status_d2069d01_EH_EventGroup_RDR_1_f7c73cae
        SDC_AL_ApplRelease_S_provService_RDR_1_Status_d2069d01 (BswMActionList): BswMActionListExecution=BSWM_TRIGGER
          SDC_SdServerServiceModeRequest_provService_RDR_1_Status_d2069d01_BSWM_SD_SERVER_SERVICE_DOWN (BswMActionListItem):
            BswMAbortOnFail = false
            BswMActionListItemIndex = 0
            BswMActionListItemRef = BswMModeControl/SDC_SdServerServiceModeRequest_provService_RDR_1_Status_d2069d01_BSWM_SD_SERVER_SERVICE_DOWN
        SDC_SdServerServiceModeRequest_provService_RDR_1_Status_d2069d01_BSWM_SD_SERVER_SERVICE_DOWN (BswMAction)
          BswMAvailableActions
            BswMSdServerServiceModeRequest: BswMSdServerServiceState=BSWM_SD_SERVER_SERVICE_DOWN, BswMSdServerMethodsRef=provService_RDR_1_Status_d2069d01
        SDC_AL_ApplRequest_S_provService_RDR_1_Status_d2069d01 (BswMActionList): BswMActionListExecution=BSWM_TRIGGER
          SDC_SdServerServiceModeRequest_provService_RDR_1_Status_d2069d01_BSWM_SD_SERVER_SERVICE_AVAILABLE (BswMActionListItem):
            BswMAbortOnFail = false
            BswMActionListItemIndex = 0
            BswMActionListItemRef = BswMModeControl/SDC_SdServerServiceModeRequest_provService_RDR_1_Status_d2069d01_BSWM_SD_SERVER_SERVICE_AVAILABLE
        SDC_SdServerServiceModeRequest_provService_RDR_1_Status_d2069d01_BSWM_SD_SERVER_SERVICE_AVAILABLE (BswMAction)
          BswMAvailableActions
            BswMSdServerServiceModeRequest: BswMSdServerServiceState=BSWM_SD_SERVER_SERVICE_AVAILABLE, BswMSdServerMethodsRef=provService_RDR_1_Status_d2069d01
        SDC_AL_SdRelease_S_provService_RDR_1_Detections_89f78c9f_EH_EventGroup_RDR_1_ca62382d (BswMActionList): BswMActionListExecution=BSWM_TRIGGER
          SDC_Mode_S_provService_RDR_1_Detections_89f78c9f_EH_EventGroup_RDR_1_ca62382d_SDC_EH_RELEASED (BswMActionListItem):
            BswMAbortOnFail = false
            BswMActionListItemIndex = 0
            BswMActionListItemRef = BswMModeControl/SDC_Mode_S_provService_RDR_1_Detections_89f78c9f_EH_EventGroup_RDR_1_ca62382d_SDC_EH_RELEASED
        SDC_Mode_S_provService_RDR_1_Detections_89f78c9f_EH_EventGroup_RDR_1_ca62382d_SDC_EH_RELEASED (BswMAction)
          BswMAvailableActions
            BswMRteSwitch: BswMSwitchedMode=SDC_EH_RELEASED, BswMRteSwitchPortRef=SDC_Mode_S_provService_RDR_1_Detections_89f78c9f_EH_EventGroup_RDR_1_ca62382d
        SDC_Mode_S_provService_RDR_1_Detections_89f78c9f_EH_EventGroup_RDR_1_ca62382d (BswMSwitchPort): BswMModeSwitchInterfaceRef=BswM_MSI_SDC_SdEventHandlerState
        SDC_AL_SdRequest_S_provService_RDR_1_Detections_89f78c9f_EH_EventGroup_RDR_1_ca62382d (BswMActionList): BswMActionListExecution=BSWM_TRIGGER
          SDC_Mode_S_provService_RDR_1_Detections_89f78c9f_EH_EventGroup_RDR_1_ca62382d_SDC_EH_REQUESTED (BswMActionListItem):
            BswMAbortOnFail = false
            BswMActionListItemIndex = 0
            BswMActionListItemRef = BswMModeControl/SDC_Mode_S_provService_RDR_1_Detections_89f78c9f_EH_EventGroup_RDR_1_ca62382d_SDC_EH_REQUESTED
        SDC_Mode_S_provService_RDR_1_Detections_89f78c9f_EH_EventGroup_RDR_1_ca62382d_SDC_EH_REQUESTED (BswMAction)
          BswMAvailableActions
            BswMRteSwitch: BswMSwitchedMode=SDC_EH_REQUESTED, BswMRteSwitchPortRef=SDC_Mode_S_provService_RDR_1_Detections_89f78c9f_EH_EventGroup_RDR_1_ca62382d
        SDC_AL_SdDown_C_consService_RDR_1_ADAS_Vehicle_Status_2b1e055b_DOWN (BswMActionList): BswMActionListExecution=BSWM_TRIGGER
          SDC_Mode_C_consService_RDR_1_ADAS_Vehicle_Status_2b1e055b_SDC_CLIENT_DOWN (BswMActionListItem):
            BswMAbortOnFail = false
            BswMActionListItemIndex = 0
            BswMActionListItemRef = BswMModeControl/SDC_Mode_C_consService_RDR_1_ADAS_Vehicle_Status_2b1e055b_SDC_CLIENT_DOWN
        SDC_Mode_C_consService_RDR_1_ADAS_Vehicle_Status_2b1e055b_SDC_CLIENT_DOWN (BswMAction)
          BswMAvailableActions
            BswMRteSwitch: BswMSwitchedMode=SDC_CLIENT_DOWN, BswMRteSwitchPortRef=SDC_Mode_C_consService_RDR_1_ADAS_Vehicle_Status_2b1e055b
        SDC_Mode_C_consService_RDR_1_ADAS_Vehicle_Status_2b1e055b (BswMSwitchPort): BswMModeSwitchInterfaceRef=BswM_MSI_SDC_SdClientServiceState
        SDC_AL_SdAvailable_C_consService_RDR_1_ADAS_Vehicle_Status_2b1e055b_AVAILABLE (BswMActionList): BswMActionListExecution=BSWM_TRIGGER
          SDC_Mode_C_consService_RDR_1_ADAS_Vehicle_Status_2b1e055b_SDC_CLIENT_AVAILABLE (BswMActionListItem):
            BswMAbortOnFail = false
            BswMActionListItemIndex = 0
            BswMActionListItemRef = BswMModeControl/SDC_Mode_C_consService_RDR_1_ADAS_Vehicle_Status_2b1e055b_SDC_CLIENT_AVAILABLE
        17 x BswMAction:
          SDC_Mode_C_consService_RDR_1_ADAS_Vehicle_Status_2b1e055b_SDC_CLIENT_AVAILABLE
            BswMAvailableActions
              BswMRteSwitch: BswMSwitchedMode=SDC_CLIENT_AVAILABLE, BswMRteSwitchPortRef=SDC_Mode_C_consService_RDR_1_ADAS_Vehicle_Status_2b1e055b
          INIT_Action_Sd_PreInit
            BswMAvailableActions
              BswMUserCallout: BswMUserCalloutFunction=Sd_PreInit(Sd_Config_Ptr), BswMCreateCallout=false, BswMUserIncludeFile=Sd.h
          INIT_Action_Sd_Init
            BswMAvailableActions
              BswMUserCallout: BswMUserCalloutFunction=Sd_Init(Sd_Config_Ptr), BswMCreateCallout=false, BswMUserIncludeFile=Sd.h
          INIT_Action_Sd_PostInit
            BswMAvailableActions
              BswMUserCallout: BswMUserCalloutFunction=Sd_PostInit(), BswMCreateCallout=false, BswMUserIncludeFile=Sd.h
          ESH_Action_ComMAllow_cnctr_RDR_RdrNet_5172a59b
            BswMAvailableActions
              BswMComMAllowCom: BswMComAllowed=true, BswMComMAllowChannelRef=cnctr_RDR_RdrNet_5172a59b
          ESH_Action_ComMDisallow_cnctr_RDR_RdrNet_5172a59b
            BswMAvailableActions
              BswMComMAllowCom: BswMComAllowed=false, BswMComMAllowChannelRef=cnctr_RDR_RdrNet_5172a59b
          INIT_Action_LdCom_Init
            BswMAvailableActions
              BswMUserCallout: BswMUserCalloutFunction=LdCom_Init(LdCom_Config_Ptr), BswMCreateCallout=false, BswMUserIncludeFile=LdCom.h
          INIT_Action_SomeIpTp_Init
            BswMAvailableActions
              BswMUserCallout: BswMUserCalloutFunction=SomeIpTp_Init(SomeIpTp_Config_Ptr), BswMCreateCallout=false, BswMUserIncludeFile=SomeIpTp.h
          INIT_Action_CanXcp_Init
            BswMAvailableActions
              BswMUserCallout: BswMUserCalloutFunction=CanXcp_Init(NULL_PTR), BswMCreateCallout=false, BswMUserIncludeFile=CanXcp.h
          Action_BLOCK_COM_CN_PCAN_RADAR_CAN2_b6e0049f
            BswMAvailableActions
              BswMComMAllowCom: BswMComAllowed=false, BswMComMAllowChannelRef=CN_VCAN_RADAR_489180b6
          Action_BSWM_FULL_COM_CN_PCAN_RADAR_CAN2_d7b79076
            BswMAvailableActions
              BswMComMModeSwitch: BswMComMRequestedMode=BSWM_FULL_COM, BswMComMUserRef=CN_VCAN_RADAR_4b138c58
          Action_ALLOW_COM_CN_PCAN_RADAR_CAN2_b6e0049f
            BswMAvailableActions
              BswMComMAllowCom: BswMComAllowed=true, BswMComMAllowChannelRef=CN_VCAN_RADAR_489180b6
          INIT_Action_CanTSyn_PreInit
            BswMAvailableActions
              BswMUserCallout: BswMUserCalloutFunction=CanTSyn_PreInit(EcuM_GlobalPCConfig_Ptr->CfgPtr_CanTSyn_PreInit), BswMCreateCallout=false, BswMUserIncludeFile=CanTSyn.h
          INIT_Action_CanTSyn_Init
            BswMAvailableActions
              BswMUserCallout: BswMUserCalloutFunction=CanTSyn_Init(EcuM_GlobalPCConfig_Ptr->CfgPtr_CanTSyn_Init), BswMCreateCallout=false, BswMUserIncludeFile=CanTSyn.h
          INIT_Action_CryIf_Init
            BswMAvailableActions
              BswMUserCallout: BswMUserCalloutFunction=CryIf_Init(), BswMCreateCallout=false, BswMUserIncludeFile=CryIf.h
          INIT_Action_Crypto_Init
            BswMAvailableActions
              BswMUserCallout: BswMUserCalloutFunction=Crypto_182_iND13400_Init(NULL_PTR), BswMCreateCallout=false, BswMUserIncludeFile=Crypto_182_iND13400.h
          INIT_Action_Csm_Init
            BswMAvailableActions
              BswMUserCallout: BswMUserCalloutFunction=Csm_Init(), BswMCreateCallout=false, BswMUserIncludeFile=Csm.h
        CC_AL_CN_PCAN_RADAR_458ff0f1_TX_Disable (BswMActionList): BswMActionListExecution=BSWM_TRIGGER
          8 x BswMActionListItem, all with BswMAbortOnFail=false, BswMActionListItemIndex=0:
            CC_DisablePDUGroup_RDR01_oPCAN_RADAR_Tx_b6bdb067: BswMActionListItemRef=BswMModeControl/CC_DisablePDUGroup_RDR01_oPCAN_RADAR_Tx_b6bdb067, variation-point=post-build-variant-condition{matching-criterion=RDR_POS, value=0}
            CC_DisablePDUGroup_RDR02_oPCAN_RADAR_Tx_9f750495: BswMActionListItemRef=BswMModeControl/CC_DisablePDUGroup_RDR02_oPCAN_RADAR_Tx_9f750495, variation-point=post-build-variant-condition{matching-criterion=RDR_POS, value=1}
            CC_DisablePDUGroup_RDR03_oPCAN_RADAR_Tx_311d9504: BswMActionListItemRef=BswMModeControl/CC_DisablePDUGroup_RDR03_oPCAN_RADAR_Tx_311d9504, variation-point=post-build-variant-condition{matching-criterion=RDR_POS, value=2}
            CC_DisablePDUGroup_RDR04_oPCAN_RADAR_Tx_cce46d71: BswMActionListItemRef=BswMModeControl/CC_DisablePDUGroup_RDR04_oPCAN_RADAR_Tx_cce46d71, variation-point=post-build-variant-condition{matching-criterion=RDR_POS, value=3}
            CC_DisablePDUGroup_RDR05_oPCAN_RADAR_Tx_628cfce0: BswMActionListItemRef=BswMModeControl/CC_DisablePDUGroup_RDR05_oPCAN_RADAR_Tx_628cfce0, variation-point=post-build-variant-condition{matching-criterion=RDR_POS, value=4}
            CC_DisablePDUGroup_RDR06_oPCAN_RADAR_Tx_4b444812: BswMActionListItemRef=BswMModeControl/CC_DisablePDUGroup_RDR06_oPCAN_RADAR_Tx_4b444812, variation-point=post-build-variant-condition{matching-criterion=RDR_POS, value=5}
            CC_DisablePDUGroup_RDR07_oPCAN_RADAR_Tx_e52cd983: BswMActionListItemRef=BswMModeControl/CC_DisablePDUGroup_RDR07_oPCAN_RADAR_Tx_e52cd983, variation-point=post-build-variant-condition{matching-criterion=RDR_POS, value=6}
            CC_DisablePDUGroup_RDR08_oPCAN_RADAR_Tx_6bc6beb9: BswMActionListItemRef=BswMModeControl/CC_DisablePDUGroup_RDR08_oPCAN_RADAR_Tx_6bc6beb9, variation-point=post-build-variant-condition{matching-criterion=RDR_POS, value=7}
        CC_DisablePDUGroup_RDR01_oPCAN_RADAR_Tx_b6bdb067 (BswMAction): variation-point=post-build-variant-condition{matching-criterion=RDR_POS, value=0}
          BswMAvailableActions
            BswMPduGroupSwitch: BswMPduGroupSwitchReinit=false, BswMDisabledPduGroupRef=RDR01_oPCAN_RADAR_Tx_b6bdb067
        CC_AL_CN_PCAN_RADAR_458ff0f1_TX_Enable (BswMActionList): BswMActionListExecution=BSWM_TRIGGER
          9 x BswMActionListItem, all with BswMAbortOnFail=false:
            CC_EnablePDUGroup_NoReinit_RDR01_oPCAN_RADAR_Tx_b6bdb067: BswMActionListItemIndex=0, BswMActionListItemRef=BswMModeControl/CC_EnablePDUGroup_NoReinit_RDR01_oPCAN_RADAR_Tx_b6bdb067, variation-point=post-build-variant-condition{matching-criterion=RDR_POS, value=0}
            CC_EnablePDUGroup_NoReinit_RDR02_oPCAN_RADAR_Tx_9f750495: BswMActionListItemIndex=0, BswMActionListItemRef=BswMModeControl/CC_EnablePDUGroup_NoReinit_RDR02_oPCAN_RADAR_Tx_9f750495, variation-point=post-build-variant-condition{matching-criterion=RDR_POS, value=1}
            CC_EnablePDUGroup_NoReinit_RDR03_oPCAN_RADAR_Tx_311d9504: BswMActionListItemIndex=0, BswMActionListItemRef=BswMModeControl/CC_EnablePDUGroup_NoReinit_RDR03_oPCAN_RADAR_Tx_311d9504, variation-point=post-build-variant-condition{matching-criterion=RDR_POS, value=2}
            CC_EnablePDUGroup_NoReinit_RDR04_oPCAN_RADAR_Tx_cce46d71: BswMActionListItemIndex=0, BswMActionListItemRef=BswMModeControl/CC_EnablePDUGroup_NoReinit_RDR04_oPCAN_RADAR_Tx_cce46d71, variation-point=post-build-variant-condition{matching-criterion=RDR_POS, value=3}
            CC_EnablePDUGroup_NoReinit_RDR05_oPCAN_RADAR_Tx_628cfce0: BswMActionListItemIndex=0, BswMActionListItemRef=BswMModeControl/CC_EnablePDUGroup_NoReinit_RDR05_oPCAN_RADAR_Tx_628cfce0, variation-point=post-build-variant-condition{matching-criterion=RDR_POS, value=4}
            CC_EnablePDUGroup_NoReinit_RDR06_oPCAN_RADAR_Tx_4b444812: BswMActionListItemIndex=0, BswMActionListItemRef=BswMModeControl/CC_EnablePDUGroup_NoReinit_RDR06_oPCAN_RADAR_Tx_4b444812, variation-point=post-build-variant-condition{matching-criterion=RDR_POS, value=5}
            CC_EnablePDUGroup_NoReinit_RDR07_oPCAN_RADAR_Tx_e52cd983: BswMActionListItemIndex=0, BswMActionListItemRef=BswMModeControl/CC_EnablePDUGroup_NoReinit_RDR07_oPCAN_RADAR_Tx_e52cd983, variation-point=post-build-variant-condition{matching-criterion=RDR_POS, value=6}
            CC_EnablePDUGroup_NoReinit_RDR08_oPCAN_RADAR_Tx_6bc6beb9: BswMActionListItemIndex=0, BswMActionListItemRef=BswMModeControl/CC_EnablePDUGroup_NoReinit_RDR08_oPCAN_RADAR_Tx_6bc6beb9, variation-point=post-build-variant-condition{matching-criterion=RDR_POS, value=7}
            Ipdu_Mode_PCAN: BswMActionListItemIndex=1 if post-build-variant-condition{matching-criterion=RDR_POS, value=5}, BswMActionListItemIndex=1 if post-build-variant-condition{matching-criterion=RDR_POS, value=2}, BswMActionListItemIndex=1 if post-build-variant-condition{matching-criterion=RDR_POS, value=4}, BswMActionListItemIndex=1 if post-build-variant-condition{matching-criterion=RDR_POS, value=6}, BswMActionListItemIndex=1 if post-build-variant-condition{matching-criterion=RDR_POS, value=1}, BswMActionListItemIndex=1 if post-build-variant-condition{matching-criterion=RDR_POS, value=3}, BswMActionListItemIndex=1 if post-build-variant-condition{matching-criterion=RDR_POS, value=0}, BswMActionListItemIndex=1 if post-build-variant-condition{matching-criterion=RDR_POS, value=7}, BswMActionListItemRef=BswMModeControl/Ipdu_Mode_PCAN
        CC_EnablePDUGroup_NoReinit_RDR01_oPCAN_RADAR_Tx_b6bdb067 (BswMAction): variation-point=post-build-variant-condition{matching-criterion=RDR_POS, value=0}
          BswMAvailableActions
            BswMPduGroupSwitch: BswMPduGroupSwitchReinit=false, BswMEnabledPduGroupRef=RDR01_oPCAN_RADAR_Tx_b6bdb067
        3 x BswMActionList, all with BswMActionListExecution=BSWM_TRIGGER:
          CC_AL_CN_VCAN_RADAR_489180b6_Disable_DM
            8 x BswMActionListItem, all with BswMAbortOnFail=false, BswMActionListItemIndex=0:
              CC_DisableDM_RDR01_oVCAN_RADAR_Rx_BC_7567adec: BswMActionListItemRef=BswMModeControl/CC_DisableDM_RDR01_oVCAN_RADAR_Rx_BC_7567adec, variation-point=post-build-variant-condition{matching-criterion=RDR_POS, value=0}
              CC_DisableDM_RDR02_oVCAN_RADAR_Rx_BC_d6312b45: BswMActionListItemRef=BswMModeControl/CC_DisableDM_RDR02_oVCAN_RADAR_Rx_BC_d6312b45, variation-point=post-build-variant-condition{matching-criterion=RDR_POS, value=1}
              CC_DisableDM_RDR03_oVCAN_RADAR_Rx_BC_01d3ab1d: BswMActionListItemRef=BswMModeControl/CC_DisableDM_RDR03_oVCAN_RADAR_Rx_BC_01d3ab1d, variation-point=post-build-variant-condition{matching-criterion=RDR_POS, value=2}
              CC_DisableDM_RDR04_oVCAN_RADAR_Rx_BC_4bed2056: BswMActionListItemRef=BswMModeControl/CC_DisableDM_RDR04_oVCAN_RADAR_Rx_BC_4bed2056, variation-point=post-build-variant-condition{matching-criterion=RDR_POS, value=3}
              CC_DisableDM_RDR05_oVCAN_RADAR_Rx_BC_9c0fa00e: BswMActionListItemRef=BswMModeControl/CC_DisableDM_RDR05_oVCAN_RADAR_Rx_BC_9c0fa00e, variation-point=post-build-variant-condition{matching-criterion=RDR_POS, value=4}
              CC_DisableDM_RDR06_oVCAN_RADAR_Rx_BC_3f5926a7: BswMActionListItemRef=BswMModeControl/CC_DisableDM_RDR06_oVCAN_RADAR_Rx_BC_3f5926a7, variation-point=post-build-variant-condition{matching-criterion=RDR_POS, value=5}
              CC_DisableDM_RDR07_oVCAN_RADAR_Rx_BC_e8bba6ff: BswMActionListItemRef=BswMModeControl/CC_DisableDM_RDR07_oVCAN_RADAR_Rx_BC_e8bba6ff, variation-point=post-build-variant-condition{matching-criterion=RDR_POS, value=6}
              CC_DisableDM_RDR08_oVCAN_RADAR_Rx_BC_ab243031: BswMActionListItemRef=BswMModeControl/CC_DisableDM_RDR08_oVCAN_RADAR_Rx_BC_ab243031, variation-point=post-build-variant-condition{matching-criterion=RDR_POS, value=7}
          CC_AL_CN_VCAN_RADAR_489180b6_Enable_DM
            8 x BswMActionListItem, all with BswMAbortOnFail=false, BswMActionListItemIndex=0:
              CC_EnableDM_RDR01_oVCAN_RADAR_Rx_BC_7567adec: BswMActionListItemRef=BswMModeControl/CC_EnableDM_RDR01_oVCAN_RADAR_Rx_BC_7567adec, variation-point=post-build-variant-condition{matching-criterion=RDR_POS, value=0}
              CC_EnableDM_RDR02_oVCAN_RADAR_Rx_BC_d6312b45: BswMActionListItemRef=BswMModeControl/CC_EnableDM_RDR02_oVCAN_RADAR_Rx_BC_d6312b45, variation-point=post-build-variant-condition{matching-criterion=RDR_POS, value=1}
              CC_EnableDM_RDR03_oVCAN_RADAR_Rx_BC_01d3ab1d: BswMActionListItemRef=BswMModeControl/CC_EnableDM_RDR03_oVCAN_RADAR_Rx_BC_01d3ab1d, variation-point=post-build-variant-condition{matching-criterion=RDR_POS, value=2}
              CC_EnableDM_RDR04_oVCAN_RADAR_Rx_BC_4bed2056: BswMActionListItemRef=BswMModeControl/CC_EnableDM_RDR04_oVCAN_RADAR_Rx_BC_4bed2056, variation-point=post-build-variant-condition{matching-criterion=RDR_POS, value=3}
              CC_EnableDM_RDR05_oVCAN_RADAR_Rx_BC_9c0fa00e: BswMActionListItemRef=BswMModeControl/CC_EnableDM_RDR05_oVCAN_RADAR_Rx_BC_9c0fa00e, variation-point=post-build-variant-condition{matching-criterion=RDR_POS, value=4}
              CC_EnableDM_RDR06_oVCAN_RADAR_Rx_BC_3f5926a7: BswMActionListItemRef=BswMModeControl/CC_EnableDM_RDR06_oVCAN_RADAR_Rx_BC_3f5926a7, variation-point=post-build-variant-condition{matching-criterion=RDR_POS, value=5}
              CC_EnableDM_RDR07_oVCAN_RADAR_Rx_BC_e8bba6ff: BswMActionListItemRef=BswMModeControl/CC_EnableDM_RDR07_oVCAN_RADAR_Rx_BC_e8bba6ff, variation-point=post-build-variant-condition{matching-criterion=RDR_POS, value=6}
              CC_EnableDM_RDR08_oVCAN_RADAR_Rx_BC_ab243031: BswMActionListItemRef=BswMModeControl/CC_EnableDM_RDR08_oVCAN_RADAR_Rx_BC_ab243031, variation-point=post-build-variant-condition{matching-criterion=RDR_POS, value=7}
          CC_AL_CN_PCAN_RADAR_458ff0f1_Disable_DM
            8 x BswMActionListItem, all with BswMAbortOnFail=false, BswMActionListItemIndex=0:
              CC_DisableDM_RDR01_oPCAN_RADAR_Rx_e0e717e1: BswMActionListItemRef=BswMModeControl/CC_DisableDM_RDR01_oPCAN_RADAR_Rx_e0e717e1, variation-point=post-build-variant-condition{matching-criterion=RDR_POS, value=0}
              CC_DisableDM_RDR02_oPCAN_RADAR_Rx_c92fa313: BswMActionListItemRef=BswMModeControl/CC_DisableDM_RDR02_oPCAN_RADAR_Rx_c92fa313, variation-point=post-build-variant-condition{matching-criterion=RDR_POS, value=1}
              CC_DisableDM_RDR03_oPCAN_RADAR_Rx_67473282: BswMActionListItemRef=BswMModeControl/CC_DisableDM_RDR03_oPCAN_RADAR_Rx_67473282, variation-point=post-build-variant-condition{matching-criterion=RDR_POS, value=2}
              CC_DisableDM_RDR04_oPCAN_RADAR_Rx_9abecaf7: BswMActionListItemRef=BswMModeControl/CC_DisableDM_RDR04_oPCAN_RADAR_Rx_9abecaf7, variation-point=post-build-variant-condition{matching-criterion=RDR_POS, value=3}
              CC_DisableDM_RDR05_oPCAN_RADAR_Rx_34d65b66: BswMActionListItemRef=BswMModeControl/CC_DisableDM_RDR05_oPCAN_RADAR_Rx_34d65b66, variation-point=post-build-variant-condition{matching-criterion=RDR_POS, value=4}
              CC_DisableDM_RDR06_oPCAN_RADAR_Rx_1d1eef94: BswMActionListItemRef=BswMModeControl/CC_DisableDM_RDR06_oPCAN_RADAR_Rx_1d1eef94, variation-point=post-build-variant-condition{matching-criterion=RDR_POS, value=5}
              CC_DisableDM_RDR07_oPCAN_RADAR_Rx_b3767e05: BswMActionListItemRef=BswMModeControl/CC_DisableDM_RDR07_oPCAN_RADAR_Rx_b3767e05, variation-point=post-build-variant-condition{matching-criterion=RDR_POS, value=6}
              CC_DisableDM_RDR08_oPCAN_RADAR_Rx_3d9c193f: BswMActionListItemRef=BswMModeControl/CC_DisableDM_RDR08_oPCAN_RADAR_Rx_3d9c193f, variation-point=post-build-variant-condition{matching-criterion=RDR_POS, value=7}
        CC_DisableDM_RDR01_oPCAN_RADAR_Rx_e0e717e1 (BswMAction): variation-point=post-build-variant-condition{matching-criterion=RDR_POS, value=0}
          BswMAvailableActions
            BswMDeadlineMonitoringControl: BswMDisabledDMPduGroupRef=RDR01_oPCAN_RADAR_Rx_e0e717e1
        CC_AL_CN_PCAN_RADAR_458ff0f1_Enable_DM (BswMActionList): BswMActionListExecution=BSWM_TRIGGER
          8 x BswMActionListItem, all with BswMAbortOnFail=false, BswMActionListItemIndex=0:
            CC_EnableDM_RDR01_oPCAN_RADAR_Rx_e0e717e1: BswMActionListItemRef=BswMModeControl/CC_EnableDM_RDR01_oPCAN_RADAR_Rx_e0e717e1, variation-point=post-build-variant-condition{matching-criterion=RDR_POS, value=0}
            CC_EnableDM_RDR02_oPCAN_RADAR_Rx_c92fa313: BswMActionListItemRef=BswMModeControl/CC_EnableDM_RDR02_oPCAN_RADAR_Rx_c92fa313, variation-point=post-build-variant-condition{matching-criterion=RDR_POS, value=1}
            CC_EnableDM_RDR03_oPCAN_RADAR_Rx_67473282: BswMActionListItemRef=BswMModeControl/CC_EnableDM_RDR03_oPCAN_RADAR_Rx_67473282, variation-point=post-build-variant-condition{matching-criterion=RDR_POS, value=2}
            CC_EnableDM_RDR04_oPCAN_RADAR_Rx_9abecaf7: BswMActionListItemRef=BswMModeControl/CC_EnableDM_RDR04_oPCAN_RADAR_Rx_9abecaf7, variation-point=post-build-variant-condition{matching-criterion=RDR_POS, value=3}
            CC_EnableDM_RDR05_oPCAN_RADAR_Rx_34d65b66: BswMActionListItemRef=BswMModeControl/CC_EnableDM_RDR05_oPCAN_RADAR_Rx_34d65b66, variation-point=post-build-variant-condition{matching-criterion=RDR_POS, value=4}
            CC_EnableDM_RDR06_oPCAN_RADAR_Rx_1d1eef94: BswMActionListItemRef=BswMModeControl/CC_EnableDM_RDR06_oPCAN_RADAR_Rx_1d1eef94, variation-point=post-build-variant-condition{matching-criterion=RDR_POS, value=5}
            CC_EnableDM_RDR07_oPCAN_RADAR_Rx_b3767e05: BswMActionListItemRef=BswMModeControl/CC_EnableDM_RDR07_oPCAN_RADAR_Rx_b3767e05, variation-point=post-build-variant-condition{matching-criterion=RDR_POS, value=6}
            CC_EnableDM_RDR08_oPCAN_RADAR_Rx_3d9c193f: BswMActionListItemRef=BswMModeControl/CC_EnableDM_RDR08_oPCAN_RADAR_Rx_3d9c193f, variation-point=post-build-variant-condition{matching-criterion=RDR_POS, value=7}
        CC_EnableDM_RDR01_oPCAN_RADAR_Rx_e0e717e1 (BswMAction): variation-point=post-build-variant-condition{matching-criterion=RDR_POS, value=0}
          BswMAvailableActions
            BswMDeadlineMonitoringControl: BswMEnabledDMPduGroupRef=RDR01_oPCAN_RADAR_Rx_e0e717e1
        3 x BswMActionList, all with BswMActionListExecution=BSWM_TRIGGER:
          CC_AL_CN_VCAN_RADAR_489180b6_RX_Disable
            8 x BswMActionListItem, all with BswMAbortOnFail=false, BswMActionListItemIndex=0:
              CC_DisablePDUGroup_RDR01_oVCAN_RADAR_Rx_BC_7567adec: BswMActionListItemRef=BswMModeControl/CC_DisablePDUGroup_RDR01_oVCAN_RADAR_Rx_BC_7567adec, variation-point=post-build-variant-condition{matching-criterion=RDR_POS, value=0}
              CC_DisablePDUGroup_RDR02_oVCAN_RADAR_Rx_BC_d6312b45: BswMActionListItemRef=BswMModeControl/CC_DisablePDUGroup_RDR02_oVCAN_RADAR_Rx_BC_d6312b45, variation-point=post-build-variant-condition{matching-criterion=RDR_POS, value=1}
              CC_DisablePDUGroup_RDR03_oVCAN_RADAR_Rx_BC_01d3ab1d: BswMActionListItemRef=BswMModeControl/CC_DisablePDUGroup_RDR03_oVCAN_RADAR_Rx_BC_01d3ab1d, variation-point=post-build-variant-condition{matching-criterion=RDR_POS, value=2}
              CC_DisablePDUGroup_RDR04_oVCAN_RADAR_Rx_BC_4bed2056: BswMActionListItemRef=BswMModeControl/CC_DisablePDUGroup_RDR04_oVCAN_RADAR_Rx_BC_4bed2056, variation-point=post-build-variant-condition{matching-criterion=RDR_POS, value=3}
              CC_DisablePDUGroup_RDR05_oVCAN_RADAR_Rx_BC_9c0fa00e: BswMActionListItemRef=BswMModeControl/CC_DisablePDUGroup_RDR05_oVCAN_RADAR_Rx_BC_9c0fa00e, variation-point=post-build-variant-condition{matching-criterion=RDR_POS, value=4}
              CC_DisablePDUGroup_RDR06_oVCAN_RADAR_Rx_BC_3f5926a7: BswMActionListItemRef=BswMModeControl/CC_DisablePDUGroup_RDR06_oVCAN_RADAR_Rx_BC_3f5926a7, variation-point=post-build-variant-condition{matching-criterion=RDR_POS, value=5}
              CC_DisablePDUGroup_RDR07_oVCAN_RADAR_Rx_BC_e8bba6ff: BswMActionListItemRef=BswMModeControl/CC_DisablePDUGroup_RDR07_oVCAN_RADAR_Rx_BC_e8bba6ff, variation-point=post-build-variant-condition{matching-criterion=RDR_POS, value=6}
              CC_DisablePDUGroup_RDR08_oVCAN_RADAR_Rx_BC_ab243031: BswMActionListItemRef=BswMModeControl/CC_DisablePDUGroup_RDR08_oVCAN_RADAR_Rx_BC_ab243031, variation-point=post-build-variant-condition{matching-criterion=RDR_POS, value=7}
          CC_AL_CN_VCAN_RADAR_489180b6_RX_Enable
            8 x BswMActionListItem, all with BswMAbortOnFail=false, BswMActionListItemIndex=0:
              CC_EnablePDUGroup_NoReinit_RDR01_oVCAN_RADAR_Rx_BC_7567adec: BswMActionListItemRef=BswMModeControl/CC_EnablePDUGroup_NoReinit_RDR01_oVCAN_RADAR_Rx_BC_7567adec, variation-point=post-build-variant-condition{matching-criterion=RDR_POS, value=0}
              CC_EnablePDUGroup_NoReinit_RDR02_oVCAN_RADAR_Rx_BC_d6312b45: BswMActionListItemRef=BswMModeControl/CC_EnablePDUGroup_NoReinit_RDR02_oVCAN_RADAR_Rx_BC_d6312b45, variation-point=post-build-variant-condition{matching-criterion=RDR_POS, value=1}
              CC_EnablePDUGroup_NoReinit_RDR03_oVCAN_RADAR_Rx_BC_01d3ab1d: BswMActionListItemRef=BswMModeControl/CC_EnablePDUGroup_NoReinit_RDR03_oVCAN_RADAR_Rx_BC_01d3ab1d, variation-point=post-build-variant-condition{matching-criterion=RDR_POS, value=2}
              CC_EnablePDUGroup_NoReinit_RDR04_oVCAN_RADAR_Rx_BC_4bed2056: BswMActionListItemRef=BswMModeControl/CC_EnablePDUGroup_NoReinit_RDR04_oVCAN_RADAR_Rx_BC_4bed2056, variation-point=post-build-variant-condition{matching-criterion=RDR_POS, value=3}
              CC_EnablePDUGroup_NoReinit_RDR05_oVCAN_RADAR_Rx_BC_9c0fa00e: BswMActionListItemRef=BswMModeControl/CC_EnablePDUGroup_NoReinit_RDR05_oVCAN_RADAR_Rx_BC_9c0fa00e, variation-point=post-build-variant-condition{matching-criterion=RDR_POS, value=4}
              CC_EnablePDUGroup_NoReinit_RDR06_oVCAN_RADAR_Rx_BC_3f5926a7: BswMActionListItemRef=BswMModeControl/CC_EnablePDUGroup_NoReinit_RDR06_oVCAN_RADAR_Rx_BC_3f5926a7, variation-point=post-build-variant-condition{matching-criterion=RDR_POS, value=5}
              CC_EnablePDUGroup_NoReinit_RDR07_oVCAN_RADAR_Rx_BC_e8bba6ff: BswMActionListItemRef=BswMModeControl/CC_EnablePDUGroup_NoReinit_RDR07_oVCAN_RADAR_Rx_BC_e8bba6ff, variation-point=post-build-variant-condition{matching-criterion=RDR_POS, value=6}
              CC_EnablePDUGroup_NoReinit_RDR08_oVCAN_RADAR_Rx_BC_ab243031: BswMActionListItemRef=BswMModeControl/CC_EnablePDUGroup_NoReinit_RDR08_oVCAN_RADAR_Rx_BC_ab243031, variation-point=post-build-variant-condition{matching-criterion=RDR_POS, value=7}
          CC_AL_CN_PCAN_RADAR_458ff0f1_RX_Disable
            8 x BswMActionListItem, all with BswMAbortOnFail=false, BswMActionListItemIndex=0:
              CC_DisablePDUGroup_RDR01_oPCAN_RADAR_Rx_e0e717e1: BswMActionListItemRef=BswMModeControl/CC_DisablePDUGroup_RDR01_oPCAN_RADAR_Rx_e0e717e1, variation-point=post-build-variant-condition{matching-criterion=RDR_POS, value=0}
              CC_DisablePDUGroup_RDR02_oPCAN_RADAR_Rx_c92fa313: BswMActionListItemRef=BswMModeControl/CC_DisablePDUGroup_RDR02_oPCAN_RADAR_Rx_c92fa313, variation-point=post-build-variant-condition{matching-criterion=RDR_POS, value=1}
              CC_DisablePDUGroup_RDR03_oPCAN_RADAR_Rx_67473282: BswMActionListItemRef=BswMModeControl/CC_DisablePDUGroup_RDR03_oPCAN_RADAR_Rx_67473282, variation-point=post-build-variant-condition{matching-criterion=RDR_POS, value=2}
              CC_DisablePDUGroup_RDR04_oPCAN_RADAR_Rx_9abecaf7: BswMActionListItemRef=BswMModeControl/CC_DisablePDUGroup_RDR04_oPCAN_RADAR_Rx_9abecaf7, variation-point=post-build-variant-condition{matching-criterion=RDR_POS, value=3}
              CC_DisablePDUGroup_RDR05_oPCAN_RADAR_Rx_34d65b66: BswMActionListItemRef=BswMModeControl/CC_DisablePDUGroup_RDR05_oPCAN_RADAR_Rx_34d65b66, variation-point=post-build-variant-condition{matching-criterion=RDR_POS, value=4}
              CC_DisablePDUGroup_RDR06_oPCAN_RADAR_Rx_1d1eef94: BswMActionListItemRef=BswMModeControl/CC_DisablePDUGroup_RDR06_oPCAN_RADAR_Rx_1d1eef94, variation-point=post-build-variant-condition{matching-criterion=RDR_POS, value=5}
              CC_DisablePDUGroup_RDR07_oPCAN_RADAR_Rx_b3767e05: BswMActionListItemRef=BswMModeControl/CC_DisablePDUGroup_RDR07_oPCAN_RADAR_Rx_b3767e05, variation-point=post-build-variant-condition{matching-criterion=RDR_POS, value=6}
              CC_DisablePDUGroup_RDR08_oPCAN_RADAR_Rx_3d9c193f: BswMActionListItemRef=BswMModeControl/CC_DisablePDUGroup_RDR08_oPCAN_RADAR_Rx_3d9c193f, variation-point=post-build-variant-condition{matching-criterion=RDR_POS, value=7}
        CC_DisablePDUGroup_RDR01_oPCAN_RADAR_Rx_e0e717e1 (BswMAction): variation-point=post-build-variant-condition{matching-criterion=RDR_POS, value=0}
          BswMAvailableActions
            BswMPduGroupSwitch: BswMPduGroupSwitchReinit=false, BswMDisabledPduGroupRef=RDR01_oPCAN_RADAR_Rx_e0e717e1
        CC_AL_CN_PCAN_RADAR_458ff0f1_RX_Enable (BswMActionList): BswMActionListExecution=BSWM_TRIGGER
          8 x BswMActionListItem, all with BswMAbortOnFail=false, BswMActionListItemIndex=0:
            CC_EnablePDUGroup_NoReinit_RDR01_oPCAN_RADAR_Rx_e0e717e1: BswMActionListItemRef=BswMModeControl/CC_EnablePDUGroup_NoReinit_RDR01_oPCAN_RADAR_Rx_e0e717e1, variation-point=post-build-variant-condition{matching-criterion=RDR_POS, value=0}
            CC_EnablePDUGroup_NoReinit_RDR02_oPCAN_RADAR_Rx_c92fa313: BswMActionListItemRef=BswMModeControl/CC_EnablePDUGroup_NoReinit_RDR02_oPCAN_RADAR_Rx_c92fa313, variation-point=post-build-variant-condition{matching-criterion=RDR_POS, value=1}
            CC_EnablePDUGroup_NoReinit_RDR03_oPCAN_RADAR_Rx_67473282: BswMActionListItemRef=BswMModeControl/CC_EnablePDUGroup_NoReinit_RDR03_oPCAN_RADAR_Rx_67473282, variation-point=post-build-variant-condition{matching-criterion=RDR_POS, value=2}
            CC_EnablePDUGroup_NoReinit_RDR04_oPCAN_RADAR_Rx_9abecaf7: BswMActionListItemRef=BswMModeControl/CC_EnablePDUGroup_NoReinit_RDR04_oPCAN_RADAR_Rx_9abecaf7, variation-point=post-build-variant-condition{matching-criterion=RDR_POS, value=3}
            CC_EnablePDUGroup_NoReinit_RDR05_oPCAN_RADAR_Rx_34d65b66: BswMActionListItemRef=BswMModeControl/CC_EnablePDUGroup_NoReinit_RDR05_oPCAN_RADAR_Rx_34d65b66, variation-point=post-build-variant-condition{matching-criterion=RDR_POS, value=4}
            CC_EnablePDUGroup_NoReinit_RDR06_oPCAN_RADAR_Rx_1d1eef94: BswMActionListItemRef=BswMModeControl/CC_EnablePDUGroup_NoReinit_RDR06_oPCAN_RADAR_Rx_1d1eef94, variation-point=post-build-variant-condition{matching-criterion=RDR_POS, value=5}
            CC_EnablePDUGroup_NoReinit_RDR07_oPCAN_RADAR_Rx_b3767e05: BswMActionListItemRef=BswMModeControl/CC_EnablePDUGroup_NoReinit_RDR07_oPCAN_RADAR_Rx_b3767e05, variation-point=post-build-variant-condition{matching-criterion=RDR_POS, value=6}
            CC_EnablePDUGroup_NoReinit_RDR08_oPCAN_RADAR_Rx_3d9c193f: BswMActionListItemRef=BswMModeControl/CC_EnablePDUGroup_NoReinit_RDR08_oPCAN_RADAR_Rx_3d9c193f, variation-point=post-build-variant-condition{matching-criterion=RDR_POS, value=7}
        19 x BswMAction:
          CC_EnablePDUGroup_NoReinit_RDR01_oPCAN_RADAR_Rx_e0e717e1: variation-point=post-build-variant-condition{matching-criterion=RDR_POS, value=0}
            BswMAvailableActions
              BswMPduGroupSwitch: BswMPduGroupSwitchReinit=false, BswMEnabledPduGroupRef=RDR01_oPCAN_RADAR_Rx_e0e717e1
          INIT_Action_CanSM_PreInit
            BswMAvailableActions
              BswMUserCallout: BswMUserCalloutFunction=CanSM_PreInit(CanSM_Config_Ptr), BswMCreateCallout=false, BswMUserIncludeFile=CanSM_EcuM.h
          INIT_Action_Crypto_182_iND13400_Init
            BswMAvailableActions
              BswMUserCallout: BswMUserCalloutFunction=Crypto_182_iND13400_Init(NULL_PTR), BswMCreateCallout=false, BswMUserIncludeFile=Crypto_182_iND13400.h
          CC_DisablePDUGroup_RDR01_oVCAN_RADAR_Tx_0xD0_2361e9dc: variation-point=post-build-variant-condition{matching-criterion=RDR_POS, value=0}
            BswMAvailableActions
              BswMPduGroupSwitch: BswMPduGroupSwitchReinit=false, BswMDisabledPduGroupRef=RDR01_oVCAN_RADAR_Tx_0xD0_2361e9dc
          CC_EnablePDUGroup_NoReinit_RDR01_oVCAN_RADAR_Tx_0xD0_2361e9dc: variation-point=post-build-variant-condition{matching-criterion=RDR_POS, value=0}
            BswMAvailableActions
              BswMPduGroupSwitch: BswMPduGroupSwitchReinit=false, BswMEnabledPduGroupRef=RDR01_oVCAN_RADAR_Tx_0xD0_2361e9dc
          CC_DisableDM_RDR01_oVCAN_RADAR_Rx_BC_7567adec: variation-point=post-build-variant-condition{matching-criterion=RDR_POS, value=0}
            BswMAvailableActions
              BswMDeadlineMonitoringControl: BswMDisabledDMPduGroupRef=RDR01_oVCAN_RADAR_Rx_BC_7567adec
          CC_EnableDM_RDR01_oVCAN_RADAR_Rx_BC_7567adec: variation-point=post-build-variant-condition{matching-criterion=RDR_POS, value=0}
            BswMAvailableActions
              BswMDeadlineMonitoringControl: BswMEnabledDMPduGroupRef=RDR01_oVCAN_RADAR_Rx_BC_7567adec
          CC_DisablePDUGroup_RDR01_oVCAN_RADAR_Rx_BC_7567adec: variation-point=post-build-variant-condition{matching-criterion=RDR_POS, value=0}
            BswMAvailableActions
              BswMPduGroupSwitch: BswMPduGroupSwitchReinit=false, BswMDisabledPduGroupRef=RDR01_oVCAN_RADAR_Rx_BC_7567adec
          CC_EnablePDUGroup_NoReinit_RDR01_oVCAN_RADAR_Rx_BC_7567adec: variation-point=post-build-variant-condition{matching-criterion=RDR_POS, value=0}
            BswMAvailableActions
              BswMPduGroupSwitch: BswMPduGroupSwitchReinit=false, BswMEnabledPduGroupRef=RDR01_oVCAN_RADAR_Rx_BC_7567adec
          ESH_Action_CancelWriteAllTimer_Stop
            BswMAvailableActions
              BswMTimerControl: BswMTimerAction=BSWM_TIMER_STOP, BswMTimerValue=0, BswMTimerRef=ESH_NvM_CancelWriteAllTimer
          ESH_Action_WriteAllTimer_Start
            BswMAvailableActions
              BswMTimerControl: BswMTimerAction=BSWM_TIMER_START, BswMTimerValue=2, BswMTimerRef=ESH_NvM_WriteAllTimer
          ESH_Action_NvMWriteAll
            BswMAvailableActions
              BswMUserCallout: BswMUserCalloutFunction=NvM_WriteAll(), BswMCreateCallout=false, BswMUserIncludeFile=NvM.h
          ESH_Action_WriteAllTimer_Stop
            BswMAvailableActions
              BswMTimerControl: BswMTimerAction=BSWM_TIMER_STOP, BswMTimerValue=0, BswMTimerRef=ESH_NvM_WriteAllTimer
          ESH_Action_CancelWriteAllTimer_Start
            BswMAvailableActions
              BswMTimerControl: BswMTimerAction=BSWM_TIMER_START, BswMTimerValue=2, BswMTimerRef=ESH_NvM_CancelWriteAllTimer
          ESH_Action_CancelNvMWriteAll
            BswMAvailableActions
              BswMUserCallout: BswMUserCalloutFunction=NvM_CancelWriteAll(), BswMCreateCallout=false, BswMUserIncludeFile=NvM.h
          INIT_Action_CanTp_PreInit
            BswMAvailableActions
              BswMUserCallout: BswMUserCalloutFunction=CanTp_PreInit(EcuM_GlobalPCConfig_Ptr->CfgPtr_CanTp_PreInit), BswMCreateCallout=false, BswMUserIncludeFile=CanTp.h
          INIT_Action_CanTp_Init
            BswMAvailableActions
              BswMUserCallout: BswMUserCalloutFunction=CanTp_Init(EcuM_GlobalPCConfig_Ptr->CfgPtr_CanTp_Init), BswMCreateCallout=false, BswMUserIncludeFile=CanTp.h
          INIT_Action_Dcm_Init
            BswMAvailableActions
              BswMUserCallout: BswMUserCalloutFunction=Dcm_Init(EcuM_GlobalPCConfig_Ptr->CfgPtr_Dcm_Init), BswMCreateCallout=false, BswMUserIncludeFile=Dcm.h
          Action_AckModeTransition_Execute
            BswMAvailableActions
              BswMUserCallout: BswMUserCalloutFunction=UserCalloutFunc_AckModeTransition_Execute(), BswMCreateCallout=true
        AL_AckModeTransition_Execute (BswMActionList): BswMActionListExecution=BSWM_TRIGGER
          Action_AckModeTransition_Execute (BswMActionListItem): BswMAbortOnFail=false, BswMActionListItemIndex=0, BswMActionListItemRef=BswMModeControl/Action_AckModeTransition_Execute
        Action_EcuSoftReset (BswMAction)
          BswMAvailableActions
            BswMUserCallout: BswMUserCalloutFunction=Ecu_PerformSoftReset(), BswMCreateCallout=true
        AL_EcuSoftReset (BswMActionList): BswMActionListExecution=BSWM_TRIGGER
          Action_EcuSoftReset (BswMActionListItem): BswMAbortOnFail=false, BswMActionListItemIndex=0, BswMActionListItemRef=BswMModeControl/Action_EcuSoftReset
        98 x BswMAction:
          INIT_Action_Det_Init
            BswMAvailableActions
              BswMUserCallout: BswMUserCalloutFunction=UserCallout_Det_Init();, BswMCreateCallout=true, BswMUserIncludeFile=Det.h
          INIT_Action_Dem_Init
            BswMAvailableActions
              BswMUserCallout: BswMUserCalloutFunction=Dem_Init(EcuM_GlobalPCConfig_Ptr->CfgPtr_Dem_Init), BswMCreateCallout=false, BswMUserIncludeFile=Dem.h
          Init_Action_Dem_PreInit
            BswMAvailableActions
              BswMUserCallout: BswMUserCalloutFunction=Dem_PreInit(EcuM_GlobalPCConfig_Ptr->CfgPtr_Dem_PreInit), BswMCreateCallout=false, BswMUserIncludeFile=Dem.h
          CC_DisablePDUGroup_RDR02_oPCAN_RADAR_Tx_9f750495: variation-point=post-build-variant-condition{matching-criterion=RDR_POS, value=1}
            BswMAvailableActions
              BswMPduGroupSwitch: BswMPduGroupSwitchReinit=false, BswMDisabledPduGroupRef=RDR02_oPCAN_RADAR_Tx_9f750495
          CC_EnablePDUGroup_NoReinit_RDR02_oPCAN_RADAR_Tx_9f750495: variation-point=post-build-variant-condition{matching-criterion=RDR_POS, value=1}
            BswMAvailableActions
              BswMPduGroupSwitch: BswMPduGroupSwitchReinit=false, BswMEnabledPduGroupRef=RDR02_oPCAN_RADAR_Tx_9f750495
          CC_DisableDM_RDR02_oPCAN_RADAR_Rx_c92fa313: variation-point=post-build-variant-condition{matching-criterion=RDR_POS, value=1}
            BswMAvailableActions
              BswMDeadlineMonitoringControl: BswMDisabledDMPduGroupRef=RDR02_oPCAN_RADAR_Rx_c92fa313
          CC_EnableDM_RDR02_oPCAN_RADAR_Rx_c92fa313: variation-point=post-build-variant-condition{matching-criterion=RDR_POS, value=1}
            BswMAvailableActions
              BswMDeadlineMonitoringControl: BswMEnabledDMPduGroupRef=RDR02_oPCAN_RADAR_Rx_c92fa313
          CC_DisablePDUGroup_RDR02_oPCAN_RADAR_Rx_c92fa313: variation-point=post-build-variant-condition{matching-criterion=RDR_POS, value=1}
            BswMAvailableActions
              BswMPduGroupSwitch: BswMPduGroupSwitchReinit=false, BswMDisabledPduGroupRef=RDR02_oPCAN_RADAR_Rx_c92fa313
          CC_EnablePDUGroup_NoReinit_RDR02_oPCAN_RADAR_Rx_c92fa313: variation-point=post-build-variant-condition{matching-criterion=RDR_POS, value=1}
            BswMAvailableActions
              BswMPduGroupSwitch: BswMPduGroupSwitchReinit=false, BswMEnabledPduGroupRef=RDR02_oPCAN_RADAR_Rx_c92fa313
          CC_DisablePDUGroup_RDR02_oVCAN_RADAR_Tx_0xD0_587f6b3f: variation-point=post-build-variant-condition{matching-criterion=RDR_POS, value=1}
            BswMAvailableActions
              BswMPduGroupSwitch: BswMPduGroupSwitchReinit=false, BswMDisabledPduGroupRef=RDR02_oVCAN_RADAR_Tx_0xD0_587f6b3f
          CC_EnablePDUGroup_NoReinit_RDR02_oVCAN_RADAR_Tx_0xD0_587f6b3f: variation-point=post-build-variant-condition{matching-criterion=RDR_POS, value=1}
            BswMAvailableActions
              BswMPduGroupSwitch: BswMPduGroupSwitchReinit=false, BswMEnabledPduGroupRef=RDR02_oVCAN_RADAR_Tx_0xD0_587f6b3f
          CC_DisablePDUGroup_RDR02_oVCAN_RADAR_Rx_BC_d6312b45: variation-point=post-build-variant-condition{matching-criterion=RDR_POS, value=1}
            BswMAvailableActions
              BswMPduGroupSwitch: BswMPduGroupSwitchReinit=false, BswMDisabledPduGroupRef=RDR02_oVCAN_RADAR_Rx_BC_d6312b45
          CC_EnablePDUGroup_NoReinit_RDR02_oVCAN_RADAR_Rx_BC_d6312b45: variation-point=post-build-variant-condition{matching-criterion=RDR_POS, value=1}
            BswMAvailableActions
              BswMPduGroupSwitch: BswMPduGroupSwitchReinit=false, BswMEnabledPduGroupRef=RDR02_oVCAN_RADAR_Rx_BC_d6312b45
          CC_DisableDM_RDR02_oVCAN_RADAR_Rx_BC_d6312b45: variation-point=post-build-variant-condition{matching-criterion=RDR_POS, value=1}
            BswMAvailableActions
              BswMDeadlineMonitoringControl: BswMDisabledDMPduGroupRef=RDR02_oVCAN_RADAR_Rx_BC_d6312b45
          CC_EnableDM_RDR02_oVCAN_RADAR_Rx_BC_d6312b45: variation-point=post-build-variant-condition{matching-criterion=RDR_POS, value=1}
            BswMAvailableActions
              BswMDeadlineMonitoringControl: BswMEnabledDMPduGroupRef=RDR02_oVCAN_RADAR_Rx_BC_d6312b45
          CC_DisablePDUGroup_RDR03_oPCAN_RADAR_Tx_311d9504: variation-point=post-build-variant-condition{matching-criterion=RDR_POS, value=2}
            BswMAvailableActions
              BswMPduGroupSwitch: BswMPduGroupSwitchReinit=false, BswMDisabledPduGroupRef=RDR03_oPCAN_RADAR_Tx_311d9504
          CC_EnablePDUGroup_NoReinit_RDR03_oPCAN_RADAR_Tx_311d9504: variation-point=post-build-variant-condition{matching-criterion=RDR_POS, value=2}
            BswMAvailableActions
              BswMPduGroupSwitch: BswMPduGroupSwitchReinit=false, BswMEnabledPduGroupRef=RDR03_oPCAN_RADAR_Tx_311d9504
          CC_DisablePDUGroup_RDR03_oPCAN_RADAR_Rx_67473282: variation-point=post-build-variant-condition{matching-criterion=RDR_POS, value=2}
            BswMAvailableActions
              BswMPduGroupSwitch: BswMPduGroupSwitchReinit=false, BswMDisabledPduGroupRef=RDR03_oPCAN_RADAR_Rx_67473282
          CC_EnablePDUGroup_NoReinit_RDR03_oPCAN_RADAR_Rx_67473282: variation-point=post-build-variant-condition{matching-criterion=RDR_POS, value=2}
            BswMAvailableActions
              BswMPduGroupSwitch: BswMPduGroupSwitchReinit=false, BswMEnabledPduGroupRef=RDR03_oPCAN_RADAR_Rx_67473282
          CC_DisableDM_RDR03_oPCAN_RADAR_Rx_67473282: variation-point=post-build-variant-condition{matching-criterion=RDR_POS, value=2}
            BswMAvailableActions
              BswMDeadlineMonitoringControl: BswMDisabledDMPduGroupRef=RDR03_oPCAN_RADAR_Rx_67473282
          CC_EnableDM_RDR03_oPCAN_RADAR_Rx_67473282: variation-point=post-build-variant-condition{matching-criterion=RDR_POS, value=2}
            BswMAvailableActions
              BswMDeadlineMonitoringControl: BswMEnabledDMPduGroupRef=RDR03_oPCAN_RADAR_Rx_67473282
          CC_DisablePDUGroup_RDR03_oVCAN_RADAR_Rx_BC_01d3ab1d: variation-point=post-build-variant-condition{matching-criterion=RDR_POS, value=2}
            BswMAvailableActions
              BswMPduGroupSwitch: BswMPduGroupSwitchReinit=false, BswMDisabledPduGroupRef=RDR03_oVCAN_RADAR_Rx_BC_01d3ab1d
          CC_EnablePDUGroup_NoReinit_RDR03_oVCAN_RADAR_Rx_BC_01d3ab1d: variation-point=post-build-variant-condition{matching-criterion=RDR_POS, value=2}
            BswMAvailableActions
              BswMPduGroupSwitch: BswMPduGroupSwitchReinit=false, BswMEnabledPduGroupRef=RDR03_oVCAN_RADAR_Rx_BC_01d3ab1d
          CC_DisableDM_RDR03_oVCAN_RADAR_Rx_BC_01d3ab1d: variation-point=post-build-variant-condition{matching-criterion=RDR_POS, value=2}
            BswMAvailableActions
              BswMDeadlineMonitoringControl: BswMDisabledDMPduGroupRef=RDR03_oVCAN_RADAR_Rx_BC_01d3ab1d
          CC_EnableDM_RDR03_oVCAN_RADAR_Rx_BC_01d3ab1d: variation-point=post-build-variant-condition{matching-criterion=RDR_POS, value=2}
            BswMAvailableActions
              BswMDeadlineMonitoringControl: BswMEnabledDMPduGroupRef=RDR03_oVCAN_RADAR_Rx_BC_01d3ab1d
          CC_DisablePDUGroup_RDR03_oVCAN_RADAR_Tx_0xD0_c7a5e8a1: variation-point=post-build-variant-condition{matching-criterion=RDR_POS, value=2}
            BswMAvailableActions
              BswMPduGroupSwitch: BswMPduGroupSwitchReinit=false, BswMDisabledPduGroupRef=RDR03_oVCAN_RADAR_Tx_0xD0_c7a5e8a1
          CC_EnablePDUGroup_NoReinit_RDR03_oVCAN_RADAR_Tx_0xD0_c7a5e8a1: variation-point=post-build-variant-condition{matching-criterion=RDR_POS, value=2}
            BswMAvailableActions
              BswMPduGroupSwitch: BswMPduGroupSwitchReinit=false, BswMEnabledPduGroupRef=RDR03_oVCAN_RADAR_Tx_0xD0_c7a5e8a1
          CC_DisablePDUGroup_RDR04_oPCAN_RADAR_Tx_cce46d71: variation-point=post-build-variant-condition{matching-criterion=RDR_POS, value=3}
            BswMAvailableActions
              BswMPduGroupSwitch: BswMPduGroupSwitchReinit=false, BswMDisabledPduGroupRef=RDR04_oPCAN_RADAR_Tx_cce46d71
          CC_EnablePDUGroup_NoReinit_RDR04_oPCAN_RADAR_Tx_cce46d71: variation-point=post-build-variant-condition{matching-criterion=RDR_POS, value=3}
            BswMAvailableActions
              BswMPduGroupSwitch: BswMPduGroupSwitchReinit=false, BswMEnabledPduGroupRef=RDR04_oPCAN_RADAR_Tx_cce46d71
          CC_DisableDM_RDR04_oPCAN_RADAR_Rx_9abecaf7: variation-point=post-build-variant-condition{matching-criterion=RDR_POS, value=3}
            BswMAvailableActions
              BswMDeadlineMonitoringControl: BswMDisabledDMPduGroupRef=RDR04_oPCAN_RADAR_Rx_9abecaf7
          CC_EnableDM_RDR04_oPCAN_RADAR_Rx_9abecaf7: variation-point=post-build-variant-condition{matching-criterion=RDR_POS, value=3}
            BswMAvailableActions
              BswMDeadlineMonitoringControl: BswMEnabledDMPduGroupRef=RDR04_oPCAN_RADAR_Rx_9abecaf7
          CC_DisablePDUGroup_RDR04_oPCAN_RADAR_Rx_9abecaf7: variation-point=post-build-variant-condition{matching-criterion=RDR_POS, value=3}
            BswMAvailableActions
              BswMPduGroupSwitch: BswMPduGroupSwitchReinit=false, BswMDisabledPduGroupRef=RDR04_oPCAN_RADAR_Rx_9abecaf7
          CC_EnablePDUGroup_NoReinit_RDR04_oPCAN_RADAR_Rx_9abecaf7: variation-point=post-build-variant-condition{matching-criterion=RDR_POS, value=3}
            BswMAvailableActions
              BswMPduGroupSwitch: BswMPduGroupSwitchReinit=false, BswMEnabledPduGroupRef=RDR04_oPCAN_RADAR_Rx_9abecaf7
          CC_DisablePDUGroup_RDR04_oVCAN_RADAR_Rx_BC_4bed2056: variation-point=post-build-variant-condition{matching-criterion=RDR_POS, value=3}
            BswMAvailableActions
              BswMPduGroupSwitch: BswMPduGroupSwitchReinit=false, BswMDisabledPduGroupRef=RDR04_oVCAN_RADAR_Rx_BC_4bed2056
          CC_EnablePDUGroup_NoReinit_RDR04_oVCAN_RADAR_Rx_BC_4bed2056: variation-point=post-build-variant-condition{matching-criterion=RDR_POS, value=3}
            BswMAvailableActions
              BswMPduGroupSwitch: BswMPduGroupSwitchReinit=false, BswMEnabledPduGroupRef=RDR04_oVCAN_RADAR_Rx_BC_4bed2056
          CC_DisablePDUGroup_RDR04_oVCAN_RADAR_Tx_0xD0_ae426ef9: variation-point=post-build-variant-condition{matching-criterion=RDR_POS, value=3}
            BswMAvailableActions
              BswMPduGroupSwitch: BswMPduGroupSwitchReinit=false, BswMDisabledPduGroupRef=RDR04_oVCAN_RADAR_Tx_0xD0_ae426ef9
          CC_EnablePDUGroup_NoReinit_RDR04_oVCAN_RADAR_Tx_0xD0_ae426ef9: variation-point=post-build-variant-condition{matching-criterion=RDR_POS, value=3}
            BswMAvailableActions
              BswMPduGroupSwitch: BswMPduGroupSwitchReinit=false, BswMEnabledPduGroupRef=RDR04_oVCAN_RADAR_Tx_0xD0_ae426ef9
          CC_DisableDM_RDR04_oVCAN_RADAR_Rx_BC_4bed2056: variation-point=post-build-variant-condition{matching-criterion=RDR_POS, value=3}
            BswMAvailableActions
              BswMDeadlineMonitoringControl: BswMDisabledDMPduGroupRef=RDR04_oVCAN_RADAR_Rx_BC_4bed2056
          CC_EnableDM_RDR04_oVCAN_RADAR_Rx_BC_4bed2056: variation-point=post-build-variant-condition{matching-criterion=RDR_POS, value=3}
            BswMAvailableActions
              BswMDeadlineMonitoringControl: BswMEnabledDMPduGroupRef=RDR04_oVCAN_RADAR_Rx_BC_4bed2056
          CC_DisablePDUGroup_RDR05_oPCAN_RADAR_Rx_34d65b66: variation-point=post-build-variant-condition{matching-criterion=RDR_POS, value=4}
            BswMAvailableActions
              BswMPduGroupSwitch: BswMPduGroupSwitchReinit=false, BswMDisabledPduGroupRef=RDR05_oPCAN_RADAR_Rx_34d65b66
          CC_EnablePDUGroup_NoReinit_RDR05_oPCAN_RADAR_Rx_34d65b66: variation-point=post-build-variant-condition{matching-criterion=RDR_POS, value=4}
            BswMAvailableActions
              BswMPduGroupSwitch: BswMPduGroupSwitchReinit=false, BswMEnabledPduGroupRef=RDR05_oPCAN_RADAR_Rx_34d65b66
          CC_DisablePDUGroup_RDR05_oPCAN_RADAR_Tx_628cfce0: variation-point=post-build-variant-condition{matching-criterion=RDR_POS, value=4}
            BswMAvailableActions
              BswMPduGroupSwitch: BswMPduGroupSwitchReinit=false, BswMDisabledPduGroupRef=RDR05_oPCAN_RADAR_Tx_628cfce0
          CC_EnablePDUGroup_NoReinit_RDR05_oPCAN_RADAR_Tx_628cfce0: variation-point=post-build-variant-condition{matching-criterion=RDR_POS, value=4}
            BswMAvailableActions
              BswMPduGroupSwitch: BswMPduGroupSwitchReinit=false, BswMEnabledPduGroupRef=RDR05_oPCAN_RADAR_Tx_628cfce0
          CC_DisableDM_RDR05_oPCAN_RADAR_Rx_34d65b66: variation-point=post-build-variant-condition{matching-criterion=RDR_POS, value=4}
            BswMAvailableActions
              BswMDeadlineMonitoringControl: BswMDisabledDMPduGroupRef=RDR05_oPCAN_RADAR_Rx_34d65b66
          CC_EnableDM_RDR05_oPCAN_RADAR_Rx_34d65b66: variation-point=post-build-variant-condition{matching-criterion=RDR_POS, value=4}
            BswMAvailableActions
              BswMDeadlineMonitoringControl: BswMEnabledDMPduGroupRef=RDR05_oPCAN_RADAR_Rx_34d65b66
          CC_DisablePDUGroup_RDR05_oVCAN_RADAR_Rx_BC_9c0fa00e: variation-point=post-build-variant-condition{matching-criterion=RDR_POS, value=4}
            BswMAvailableActions
              BswMPduGroupSwitch: BswMPduGroupSwitchReinit=false, BswMDisabledPduGroupRef=RDR05_oVCAN_RADAR_Rx_BC_9c0fa00e
          CC_EnablePDUGroup_NoReinit_RDR05_oVCAN_RADAR_Rx_BC_9c0fa00e: variation-point=post-build-variant-condition{matching-criterion=RDR_POS, value=4}
            BswMAvailableActions
              BswMPduGroupSwitch: BswMPduGroupSwitchReinit=false, BswMEnabledPduGroupRef=RDR05_oVCAN_RADAR_Rx_BC_9c0fa00e
          CC_DisablePDUGroup_RDR05_oVCAN_RADAR_Tx_0xD0_3198ed67: variation-point=post-build-variant-condition{matching-criterion=RDR_POS, value=4}
            BswMAvailableActions
              BswMPduGroupSwitch: BswMPduGroupSwitchReinit=false, BswMDisabledPduGroupRef=RDR05_oVCAN_RADAR_Tx_0xD0_3198ed67
          CC_EnablePDUGroup_NoReinit_RDR05_oVCAN_RADAR_Tx_0xD0_3198ed67: variation-point=post-build-variant-condition{matching-criterion=RDR_POS, value=4}
            BswMAvailableActions
              BswMPduGroupSwitch: BswMPduGroupSwitchReinit=false, BswMEnabledPduGroupRef=RDR05_oVCAN_RADAR_Tx_0xD0_3198ed67
          CC_DisableDM_RDR05_oVCAN_RADAR_Rx_BC_9c0fa00e: variation-point=post-build-variant-condition{matching-criterion=RDR_POS, value=4}
            BswMAvailableActions
              BswMDeadlineMonitoringControl: BswMDisabledDMPduGroupRef=RDR05_oVCAN_RADAR_Rx_BC_9c0fa00e
          CC_EnableDM_RDR05_oVCAN_RADAR_Rx_BC_9c0fa00e: variation-point=post-build-variant-condition{matching-criterion=RDR_POS, value=4}
            BswMAvailableActions
              BswMDeadlineMonitoringControl: BswMEnabledDMPduGroupRef=RDR05_oVCAN_RADAR_Rx_BC_9c0fa00e
          CC_DisableDM_RDR06_oPCAN_RADAR_Rx_1d1eef94: variation-point=post-build-variant-condition{matching-criterion=RDR_POS, value=5}
            BswMAvailableActions
              BswMDeadlineMonitoringControl: BswMDisabledDMPduGroupRef=RDR06_oPCAN_RADAR_Rx_1d1eef94
          CC_EnableDM_RDR06_oPCAN_RADAR_Rx_1d1eef94: variation-point=post-build-variant-condition{matching-criterion=RDR_POS, value=5}
            BswMAvailableActions
              BswMDeadlineMonitoringControl: BswMEnabledDMPduGroupRef=RDR06_oPCAN_RADAR_Rx_1d1eef94
          CC_DisablePDUGroup_RDR06_oPCAN_RADAR_Tx_4b444812: variation-point=post-build-variant-condition{matching-criterion=RDR_POS, value=5}
            BswMAvailableActions
              BswMPduGroupSwitch: BswMPduGroupSwitchReinit=false, BswMDisabledPduGroupRef=RDR06_oPCAN_RADAR_Tx_4b444812
          CC_EnablePDUGroup_NoReinit_RDR06_oPCAN_RADAR_Tx_4b444812: variation-point=post-build-variant-condition{matching-criterion=RDR_POS, value=5}
            BswMAvailableActions
              BswMPduGroupSwitch: BswMPduGroupSwitchReinit=false, BswMEnabledPduGroupRef=RDR06_oPCAN_RADAR_Tx_4b444812
          CC_DisablePDUGroup_RDR06_oPCAN_RADAR_Rx_1d1eef94: variation-point=post-build-variant-condition{matching-criterion=RDR_POS, value=5}
            BswMAvailableActions
              BswMPduGroupSwitch: BswMPduGroupSwitchReinit=false, BswMDisabledPduGroupRef=RDR06_oPCAN_RADAR_Rx_1d1eef94
          CC_EnablePDUGroup_NoReinit_RDR06_oPCAN_RADAR_Rx_1d1eef94: variation-point=post-build-variant-condition{matching-criterion=RDR_POS, value=5}
            BswMAvailableActions
              BswMPduGroupSwitch: BswMPduGroupSwitchReinit=false, BswMEnabledPduGroupRef=RDR06_oPCAN_RADAR_Rx_1d1eef94
          CC_DisableDM_RDR06_oVCAN_RADAR_Rx_BC_3f5926a7: variation-point=post-build-variant-condition{matching-criterion=RDR_POS, value=5}
            BswMAvailableActions
              BswMDeadlineMonitoringControl: BswMDisabledDMPduGroupRef=RDR06_oVCAN_RADAR_Rx_BC_3f5926a7
          CC_EnableDM_RDR06_oVCAN_RADAR_Rx_BC_3f5926a7: variation-point=post-build-variant-condition{matching-criterion=RDR_POS, value=5}
            BswMAvailableActions
              BswMDeadlineMonitoringControl: BswMEnabledDMPduGroupRef=RDR06_oVCAN_RADAR_Rx_BC_3f5926a7
          CC_DisablePDUGroup_RDR06_oVCAN_RADAR_Rx_BC_3f5926a7: variation-point=post-build-variant-condition{matching-criterion=RDR_POS, value=5}
            BswMAvailableActions
              BswMPduGroupSwitch: BswMPduGroupSwitchReinit=false, BswMDisabledPduGroupRef=RDR06_oVCAN_RADAR_Rx_BC_3f5926a7
          CC_EnablePDUGroup_NoReinit_RDR06_oVCAN_RADAR_Rx_BC_3f5926a7: variation-point=post-build-variant-condition{matching-criterion=RDR_POS, value=5}
            BswMAvailableActions
              BswMPduGroupSwitch: BswMPduGroupSwitchReinit=false, BswMEnabledPduGroupRef=RDR06_oVCAN_RADAR_Rx_BC_3f5926a7
          CC_DisablePDUGroup_RDR06_oVCAN_RADAR_Tx_0xD0_4a866f84: variation-point=post-build-variant-condition{matching-criterion=RDR_POS, value=5}
            BswMAvailableActions
              BswMPduGroupSwitch: BswMPduGroupSwitchReinit=false, BswMDisabledPduGroupRef=RDR06_oVCAN_RADAR_Tx_0xD0_4a866f84
          CC_EnablePDUGroup_NoReinit_RDR06_oVCAN_RADAR_Tx_0xD0_4a866f84: variation-point=post-build-variant-condition{matching-criterion=RDR_POS, value=5}
            BswMAvailableActions
              BswMPduGroupSwitch: BswMPduGroupSwitchReinit=false, BswMEnabledPduGroupRef=RDR06_oVCAN_RADAR_Tx_0xD0_4a866f84
          CC_DisableDM_RDR07_oPCAN_RADAR_Rx_b3767e05: variation-point=post-build-variant-condition{matching-criterion=RDR_POS, value=6}
            BswMAvailableActions
              BswMDeadlineMonitoringControl: BswMDisabledDMPduGroupRef=RDR07_oPCAN_RADAR_Rx_b3767e05
          CC_EnableDM_RDR07_oPCAN_RADAR_Rx_b3767e05: variation-point=post-build-variant-condition{matching-criterion=RDR_POS, value=6}
            BswMAvailableActions
              BswMDeadlineMonitoringControl: BswMEnabledDMPduGroupRef=RDR07_oPCAN_RADAR_Rx_b3767e05
          CC_DisablePDUGroup_RDR07_oPCAN_RADAR_Rx_b3767e05: variation-point=post-build-variant-condition{matching-criterion=RDR_POS, value=6}
            BswMAvailableActions
              BswMPduGroupSwitch: BswMPduGroupSwitchReinit=false, BswMDisabledPduGroupRef=RDR07_oPCAN_RADAR_Rx_b3767e05
          CC_EnablePDUGroup_NoReinit_RDR07_oPCAN_RADAR_Rx_b3767e05: variation-point=post-build-variant-condition{matching-criterion=RDR_POS, value=6}
            BswMAvailableActions
              BswMPduGroupSwitch: BswMPduGroupSwitchReinit=false, BswMEnabledPduGroupRef=RDR07_oPCAN_RADAR_Rx_b3767e05
          CC_DisablePDUGroup_RDR07_oPCAN_RADAR_Tx_e52cd983: variation-point=post-build-variant-condition{matching-criterion=RDR_POS, value=6}
            BswMAvailableActions
              BswMPduGroupSwitch: BswMPduGroupSwitchReinit=false, BswMDisabledPduGroupRef=RDR07_oPCAN_RADAR_Tx_e52cd983
          CC_EnablePDUGroup_NoReinit_RDR07_oPCAN_RADAR_Tx_e52cd983: variation-point=post-build-variant-condition{matching-criterion=RDR_POS, value=6}
            BswMAvailableActions
              BswMPduGroupSwitch: BswMPduGroupSwitchReinit=false, BswMEnabledPduGroupRef=RDR07_oPCAN_RADAR_Tx_e52cd983
          CC_DisablePDUGroup_RDR07_oVCAN_RADAR_Rx_BC_e8bba6ff: variation-point=post-build-variant-condition{matching-criterion=RDR_POS, value=6}
            BswMAvailableActions
              BswMPduGroupSwitch: BswMPduGroupSwitchReinit=false, BswMDisabledPduGroupRef=RDR07_oVCAN_RADAR_Rx_BC_e8bba6ff
          CC_EnablePDUGroup_NoReinit_RDR07_oVCAN_RADAR_Rx_BC_e8bba6ff: variation-point=post-build-variant-condition{matching-criterion=RDR_POS, value=6}
            BswMAvailableActions
              BswMPduGroupSwitch: BswMPduGroupSwitchReinit=false, BswMEnabledPduGroupRef=RDR07_oVCAN_RADAR_Rx_BC_e8bba6ff
          CC_DisableDM_RDR07_oVCAN_RADAR_Rx_BC_e8bba6ff: variation-point=post-build-variant-condition{matching-criterion=RDR_POS, value=6}
            BswMAvailableActions
              BswMDeadlineMonitoringControl: BswMDisabledDMPduGroupRef=RDR07_oVCAN_RADAR_Rx_BC_e8bba6ff
          CC_EnableDM_RDR07_oVCAN_RADAR_Rx_BC_e8bba6ff: variation-point=post-build-variant-condition{matching-criterion=RDR_POS, value=6}
            BswMAvailableActions
              BswMDeadlineMonitoringControl: BswMEnabledDMPduGroupRef=RDR07_oVCAN_RADAR_Rx_BC_e8bba6ff
          CC_DisablePDUGroup_RDR07_oVCAN_RADAR_Tx_0xD0_d55cec1a: variation-point=post-build-variant-condition{matching-criterion=RDR_POS, value=6}
            BswMAvailableActions
              BswMPduGroupSwitch: BswMPduGroupSwitchReinit=false, BswMDisabledPduGroupRef=RDR07_oVCAN_RADAR_Tx_0xD0_d55cec1a
          CC_EnablePDUGroup_NoReinit_RDR07_oVCAN_RADAR_Tx_0xD0_d55cec1a: variation-point=post-build-variant-condition{matching-criterion=RDR_POS, value=6}
            BswMAvailableActions
              BswMPduGroupSwitch: BswMPduGroupSwitchReinit=false, BswMEnabledPduGroupRef=RDR07_oVCAN_RADAR_Tx_0xD0_d55cec1a
          CC_DisablePDUGroup_RDR08_oPCAN_RADAR_Rx_3d9c193f: variation-point=post-build-variant-condition{matching-criterion=RDR_POS, value=7}
            BswMAvailableActions
              BswMPduGroupSwitch: BswMPduGroupSwitchReinit=false, BswMDisabledPduGroupRef=RDR08_oPCAN_RADAR_Rx_3d9c193f
          CC_EnablePDUGroup_NoReinit_RDR08_oPCAN_RADAR_Rx_3d9c193f: variation-point=post-build-variant-condition{matching-criterion=RDR_POS, value=7}
            BswMAvailableActions
              BswMPduGroupSwitch: BswMPduGroupSwitchReinit=false, BswMEnabledPduGroupRef=RDR08_oPCAN_RADAR_Rx_3d9c193f
          CC_DisableDM_RDR08_oPCAN_RADAR_Rx_3d9c193f: variation-point=post-build-variant-condition{matching-criterion=RDR_POS, value=7}
            BswMAvailableActions
              BswMDeadlineMonitoringControl: BswMDisabledDMPduGroupRef=RDR08_oPCAN_RADAR_Rx_3d9c193f
          CC_EnableDM_RDR08_oPCAN_RADAR_Rx_3d9c193f: variation-point=post-build-variant-condition{matching-criterion=RDR_POS, value=7}
            BswMAvailableActions
              BswMDeadlineMonitoringControl: BswMEnabledDMPduGroupRef=RDR08_oPCAN_RADAR_Rx_3d9c193f
          CC_DisablePDUGroup_RDR08_oPCAN_RADAR_Tx_6bc6beb9: variation-point=post-build-variant-condition{matching-criterion=RDR_POS, value=7}
            BswMAvailableActions
              BswMPduGroupSwitch: BswMPduGroupSwitchReinit=false, BswMDisabledPduGroupRef=RDR08_oPCAN_RADAR_Tx_6bc6beb9
          CC_EnablePDUGroup_NoReinit_RDR08_oPCAN_RADAR_Tx_6bc6beb9: variation-point=post-build-variant-condition{matching-criterion=RDR_POS, value=7}
            BswMAvailableActions
              BswMPduGroupSwitch: BswMPduGroupSwitchReinit=false, BswMEnabledPduGroupRef=RDR08_oPCAN_RADAR_Tx_6bc6beb9
          CC_DisablePDUGroup_RDR08_oVCAN_RADAR_Rx_BC_ab243031: variation-point=post-build-variant-condition{matching-criterion=RDR_POS, value=7}
            BswMAvailableActions
              BswMPduGroupSwitch: BswMPduGroupSwitchReinit=false, BswMDisabledPduGroupRef=RDR08_oVCAN_RADAR_Rx_BC_ab243031
          CC_EnablePDUGroup_NoReinit_RDR08_oVCAN_RADAR_Rx_BC_ab243031: variation-point=post-build-variant-condition{matching-criterion=RDR_POS, value=7}
            BswMAvailableActions
              BswMPduGroupSwitch: BswMPduGroupSwitchReinit=false, BswMEnabledPduGroupRef=RDR08_oVCAN_RADAR_Rx_BC_ab243031
          CC_DisablePDUGroup_RDR08_oVCAN_RADAR_Tx_0xD0_99496334: variation-point=post-build-variant-condition{matching-criterion=RDR_POS, value=7}
            BswMAvailableActions
              BswMPduGroupSwitch: BswMPduGroupSwitchReinit=false, BswMDisabledPduGroupRef=RDR08_oVCAN_RADAR_Tx_0xD0_99496334
          CC_EnablePDUGroup_NoReinit_RDR08_oVCAN_RADAR_Tx_0xD0_99496334: variation-point=post-build-variant-condition{matching-criterion=RDR_POS, value=7}
            BswMAvailableActions
              BswMPduGroupSwitch: BswMPduGroupSwitchReinit=false, BswMEnabledPduGroupRef=RDR08_oVCAN_RADAR_Tx_0xD0_99496334
          CC_DisableDM_RDR08_oVCAN_RADAR_Rx_BC_ab243031: variation-point=post-build-variant-condition{matching-criterion=RDR_POS, value=7}
            BswMAvailableActions
              BswMDeadlineMonitoringControl: BswMDisabledDMPduGroupRef=RDR08_oVCAN_RADAR_Rx_BC_ab243031
          CC_EnableDM_RDR08_oVCAN_RADAR_Rx_BC_ab243031: variation-point=post-build-variant-condition{matching-criterion=RDR_POS, value=7}
            BswMAvailableActions
              BswMDeadlineMonitoringControl: BswMEnabledDMPduGroupRef=RDR08_oVCAN_RADAR_Rx_BC_ab243031
          INIT_Action_E2EXf_Init: variation-point=post-build-variant-condition{matching-criterion=RDR_POS, value=0}
            BswMAvailableActions
              BswMUserCallout: BswMUserCalloutFunction=E2EXf_Init(NULL_PTR), BswMCreateCallout=false, BswMUserIncludeFile=E2EXf.h
          INIT_Action_E2EXf_Init: variation-point=post-build-variant-condition{matching-criterion=RDR_POS, value=1}
            BswMAvailableActions
              BswMUserCallout: BswMUserCalloutFunction=E2EXf_Init(NULL_PTR), BswMCreateCallout=false, BswMUserIncludeFile=E2EXf.h
          INIT_Action_E2EXf_Init: variation-point=post-build-variant-condition{matching-criterion=RDR_POS, value=2}
            BswMAvailableActions
              BswMUserCallout: BswMUserCalloutFunction=E2EXf_Init(NULL_PTR), BswMCreateCallout=false, BswMUserIncludeFile=E2EXf.h
          INIT_Action_E2EXf_Init: variation-point=post-build-variant-condition{matching-criterion=RDR_POS, value=3}
            BswMAvailableActions
              BswMUserCallout: BswMUserCalloutFunction=E2EXf_Init(NULL_PTR), BswMCreateCallout=false, BswMUserIncludeFile=E2EXf.h
          INIT_Action_E2EXf_Init: variation-point=post-build-variant-condition{matching-criterion=RDR_POS, value=4}
            BswMAvailableActions
              BswMUserCallout: BswMUserCalloutFunction=E2EXf_Init(NULL_PTR), BswMCreateCallout=false, BswMUserIncludeFile=E2EXf.h
          INIT_Action_E2EXf_Init: variation-point=post-build-variant-condition{matching-criterion=RDR_POS, value=5}
            BswMAvailableActions
              BswMUserCallout: BswMUserCalloutFunction=E2EXf_Init(NULL_PTR), BswMCreateCallout=false, BswMUserIncludeFile=E2EXf.h
          INIT_Action_E2EXf_Init: variation-point=post-build-variant-condition{matching-criterion=RDR_POS, value=6}
            BswMAvailableActions
              BswMUserCallout: BswMUserCalloutFunction=E2EXf_Init(NULL_PTR), BswMCreateCallout=false, BswMUserIncludeFile=E2EXf.h
          INIT_Action_E2EXf_Init: variation-point=post-build-variant-condition{matching-criterion=RDR_POS, value=7}
            BswMAvailableActions
              BswMUserCallout: BswMUserCalloutFunction=E2EXf_Init(NULL_PTR), BswMCreateCallout=false, BswMUserIncludeFile=E2EXf.h
          SetOperationCycle_UserCallOut
            BswMAvailableActions
              BswMUserCallout:
                BswMUserCalloutFunction = (void)Dem_SetOperationCycleState(DemConf_DemOperationCycle_Power_On_Off , DEM_CYCLE_STATE_START)
                BswMCreateCallout = false
          Ipdu_Mode_PCAN
            BswMAvailableActions
              BswMUserCallout: BswMUserCalloutFunction=Ipdu_Mode(), BswMCreateCallout=true
          Action_User_EthIf_Init
            BswMAvailableActions
              User_EthIf_Init (BswMUserCallout): BswMUserCalloutFunction=User_EthIf_Init(), BswMCreateCallout=true, BswMUserIncludeFile=PHY_User_Cbk.h
      ESH_RunRequest (BswMRteModeDclGroup): BswMInitMode=RELEASED
        RELEASED (BswMRteMode): BswMModePhysicalValue=0
        REQUESTED (BswMRteMode): BswMModePhysicalValue=1
      BswMDataTypeMappingSets: BswMDataTypeMappingSetRef=BswMMappingSet
      6 x BswMRteModeDclGroup:
        SDC_SdEventHandlerState: BswMInitMode=SDC_EH_RELEASED
          SDC_EH_RELEASED (BswMRteMode): BswMModePhysicalValue=0
          SDC_EH_REQUESTED (BswMRteMode): BswMModePhysicalValue=1
        SDC_SdClientServiceState: BswMInitMode=SDC_CLIENT_DOWN
          SDC_CLIENT_DOWN (BswMRteMode): BswMModePhysicalValue=0
          SDC_CLIENT_AVAILABLE (BswMRteMode): BswMModePhysicalValue=1
        SDC_SdConsumedEventGroupRequest: BswMInitMode=SDC_CEG_RELEASED
          SDC_CEG_RELEASED (BswMRteMode): BswMModePhysicalValue=0
          SDC_CEG_REQUESTED (BswMRteMode): BswMModePhysicalValue=1
        SDC_SdServerServiceRequest: BswMInitMode=SDC_SERVER_DOWN
          SDC_SERVER_DOWN (BswMRteMode): BswMModePhysicalValue=0
          SDC_SERVER_AVAILABE (BswMRteMode): BswMModePhysicalValue=1
        SDC_SdConsumedEventGroupState: BswMInitMode=SDC_CEG_DOWN
          SDC_CEG_DOWN (BswMRteMode): BswMModePhysicalValue=0
          SDC_CEG_AVAILABLE (BswMRteMode): BswMModePhysicalValue=1
        SDC_SdClientServiceRequest: BswMInitMode=SDC_CLIENT_RELEASED
          SDC_CLIENT_RELEASED (BswMRteMode): BswMModePhysicalValue=0
          SDC_CLIENT_REQUESTED (BswMRteMode): BswMModePhysicalValue=1
