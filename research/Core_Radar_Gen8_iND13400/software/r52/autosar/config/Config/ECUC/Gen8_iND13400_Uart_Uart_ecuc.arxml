AUTOSAR XML (schema 00053)
package /ActiveEcuC
  module config Uart: implementation-config-variant=VARIANT-PRE-COMPILE, module-description=Uart_Impl
    UartChannelConfigSet
      UartChannel:
        UartSynMode = UART_ASYNC_MODE
        UartDataSize = UART_DATA_SIZE_8BIT
        UartStopBit = UART_STOP_1BIT
        UartParityBit = UART_PARITY_NONE
        UartFlowControl = UART_FLOW_NONE
        UartBaudRate = BAUDRATE_115200
        UartIrqChannelMode = UART_POLLING_MODE
        UartFlagInit = true
        UartId = 0
        UartLoopBackEnable = false
        UartBreakEnable = false
        UartStickyParityEnable = false
        UartCallBackNotification = NULL_PTR
        UartFifoEnable = true
        UartFifoReceiverTriggerLevel = FIFO_CHAR_1
        UartRegTimeoutValue = 8
    UartConfigurationOfOptApiServices:
      UartGetVersionInfo = true
      UartSetConfiguration = true
      UartGetConfiguration = true
      UartDeInit = true
      UartGetStatus = true
      UartSendData = true
      UartGetTxCount = true
      UartGetRxCount = true
    UartGeneral: UartDevErrorDetect=true, UartIndex=0, UartMainFunctionPeriod=0.05, UartOperationMode=UART_POLLING_MODE
