AUTOSAR XML (schema 00053)
package /ActiveEcuC
  module config EthTrcv_RTL: definition=EthTrcv, implementation-config-variant=VARIANT-PRE-COMPILE, module-description=EthTrcv_Impl
    EthTrcvGeneral:
      EthTrcvDevErrorDetect = true
      EthTrcvGetBaudRateApi = true
      EthTrcvGetDuplexModeApi = true
      EthTrcvGetLinkStateApi = true
      EthTrcvGetTransceiverModeApi = true
      EthTrcvMaxTrcvsSupported = 2
      EthTrcvSetTransceiverModeApi = true
      EthTrcvStartAutoNegotiationApi = true
      EthTrcvVersionInfoApi = false
      EthTrcvVersionInfoApiMacro = false
      EthTrcvIndex = 0
      EthTrcvRuntimeMeasurementSupport = true
      EthTrcvWakeUpSupport = ETHTRCV_WAKEUP_NOT_SUPPORTED
      EthTrcvMainFunctionPeriod = 1
      EthTrcvHwAccessLoopCount = 100
      EthTrcvSafeBswChecks = true
      EthTrcvCableDiagLoopCount = 10000
      EthTrcvPreTrcvInitUserCallout = RTL_PHY_Pre_Init
      EthTrcvPostTrcvInitUserCallout = RTL_PHY_Post_Init
      EthTrcvRunCableDiagnosticApi = true
      EthTrcvMacSecApi = false
      EthTrcvCalloutIncludeFiles = PHY_User_Cbk.h
    EthTrcvConfigSet
      EthTrcvConfig_9010BSA (EthTrcvConfig):
        EthTrcvSpeed = TRCV_SPEED_1000
        EthTrcvIdx = 0
        EthTrcvConnNeg = ETHTRCV_CONN_NEG_SLAVE
        EthTrcvPhySignalQualityMeanValueLength = 100
        EthTrcvSoftResetOnInit = true
        EthTrcvAutoNegotiationEnabled = false
        EthTrcvDerivative = TRCV_RTL9010BX
        EthTrcvHwAccessMonitorEnabled = false
        EthTrcvMacSecEnabled = false
        EthTrcvSoftResetWaitCycles = 100
        EthTrcvMgmtInterface
          EthTrcvMiiInterface: EthTrcvMiiIdx=0, EthTrcvMiiSelection=ETHTRCV_STRAPPING_CONFIG_ONLY, EthTrcvCtrlRef=RDR_1_Eth_Controller_1_6addc1bb
        EthTrcvErrata
          EthTrcvRtl9010BxErrata
      EthTrcvConfig_9010BSA_100Mb (EthTrcvConfig):
        EthTrcvSpeed = TRCV_SPEED_100
        EthTrcvIdx = 1
        EthTrcvConnNeg = ETHTRCV_CONN_NEG_SLAVE
        EthTrcvPhySignalQualityMeanValueLength = 100
        EthTrcvSoftResetOnInit = true
        EthTrcvAutoNegotiationEnabled = false
        EthTrcvDerivative = TRCV_RTL9010BX
        EthTrcvHwAccessMonitorEnabled = false
        EthTrcvMacSecEnabled = false
        EthTrcvSoftResetWaitCycles = 100
        EthTrcvMgmtInterface
          EthTrcvMiiInterface: EthTrcvMiiIdx=0, EthTrcvMiiSelection=ETHTRCV_STRAPPING_CONFIG_ONLY, EthTrcvCtrlRef=RDR_1_Eth_Controller_1_6addc1bb
        EthTrcvErrata
          EthTrcvRtl9010BxErrata
