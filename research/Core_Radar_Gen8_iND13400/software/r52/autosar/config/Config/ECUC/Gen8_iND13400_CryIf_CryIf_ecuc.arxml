AUTOSAR XML (schema 00053)
package /ActiveEcuC
  module config CryIf: implementation-config-variant=VARIANT-PRE-COMPILE, module-description=CryIf_Impl
    CryIfGeneral:
      CryIfDevErrorDetect = true
      CryIfVersionInfoApi = false
      CryIfMaxNumberOfKeyElements = 10
      CryIfMaxSizeOfKeyElement = 32
      CryIfRedirection = false
      CryIfSafeBswChecks = true
    CryIfChannel_Crypto_AESDriverObject (CryIfChannel): CryIfChannelId=1, CryIfDriverObjectRef=Crypto_182_iND13400_SymmetricDriverObject
    CryIfChannel_Crypto_HashDriverObject (CryIfChannel): CryIfChannelId=2, CryIfDriverObjectRef=Crypto_182_iND13400_AsymmetricDriverObject
    CryIfKey_Crypto_AES_128 (CryIfKey): CryIfKeyId=2, CryIfKeyRef=AES_128_Key
    CryIfKey_Crypto_Hash (CryIfKey): CryIfKeyId=4, CryIfKeyRef=Hash_Key
    Crypto_182_iND13400 (CryIfCryptoModule):
      CryIfSupportsKeyElementCopyPartial = true
      CryIfCancelJobApiUsesJobType = true
      CryIfSupportsCertificateAPI = false
      CryIfSupportsKeyStatusAPI = true
      CryIfCryptoMip = Crypto_182_iND13400
      CryIfCryptoKeySetValidAPI = KeySetValid
      CryIfSupportsCustomSyncService = false
      CryIfCryptoModuleRef = Crypto
    CryIfKey_MKA_CAK (CryIfKey): CryIfKeyId=42, CryIfKeyRef=MKA_CAK_Key
    CryIfKey_MKA_Random (CryIfKey): CryIfKeyId=46, CryIfKeyRef=MKA_Random_Key
    CryIfChannel_MKA (CryIfChannel): CryIfChannelId=3, CryIfDriverObjectRef=Crypto_182_iND13400_SymmetricDriverObject
    11 x CryIfKey:
      CryIfKey_MKA_ICK: CryIfKeyId=43, CryIfKeyRef=MKA_ICK_Key
      CryIfKey_Crypto_RNG: CryIfKeyId=5, CryIfKeyRef=RNG_Key
      CryIfKey_MKA_KEK: CryIfKeyId=44, CryIfKeyRef=MKA_KEK_Key
      CryIfKey_MKA_SAK: CryIfKeyId=47, CryIfKeyRef=MKA_SAK_Key
      CryIfKey_MKA_MAC: CryIfKeyId=45, CryIfKeyRef=MKA_MAC_Key
      CryIfKey_MKA_SAK_Data: CryIfKeyId=48, CryIfKeyRef=MKA_SAK_Data_Key
      CryIfKey_Crypto_AES_256: CryIfKeyId=3, CryIfKeyRef=AES_256_Key
      CryIfKey_Crypto_RSA_1024_Key: CryIfKeyId=6, CryIfKeyRef=RSA_1024_Key
      CryIfKey_Crypto_RSA_2048_Key: CryIfKeyId=7, CryIfKeyRef=RSA_2048_Key
      CryIfKey_Crypto_RSA_3072_Key: CryIfKeyId=8, CryIfKeyRef=RSA_3072_Key
      CryIfKey_Crypto_RSA_4096_Key: CryIfKeyId=9, CryIfKeyRef=RSA_4096_Key
    CryIfChannel_Crypto_PublicKeyObject (CryIfChannel): CryIfChannelId=0, CryIfDriverObjectRef=Crypto_182_iND13400_AsymmetricDriverObject
    47 x CryIfKey:
      CryIfKey_ECC_192_Key_SigGenerate: CryIfKeyId=11, CryIfKeyRef=ECC_192_Key_SigGenerate
      CryIfKey_ECC_224_Key_SigGenerate: CryIfKeyId=13, CryIfKeyRef=ECC_224_Key_SigGenerate
      CryIfKey_ECC_256_Key_SigGenerate: CryIfKeyId=18, CryIfKeyRef=ECC_256_Key_SigGenerate
      CryIfKey_ECC_384_Key_SigGenerate: CryIfKeyId=22, CryIfKeyRef=ECC_384_Key_SigGenerate
      CryIfKey_ECC_512_Key_SigGenerate: CryIfKeyId=24, CryIfKeyRef=ECC_512_Key_SigGenerate
      CryIfKey_ECC_521_Key_SigGenerate: CryIfKeyId=26, CryIfKeyRef=ECC_521_Key_SigGenerate
      CryIfKey_ECC_320_Key_SigGenerate: CryIfKeyId=20, CryIfKeyRef=ECC_320_Key_SigGenerate
      CryIfKey_Custom_Operations: CryIfKeyId=10, CryIfKeyRef=Custom_Operations
      CryIfKey_ECDH_128_Key_SigGenerate: CryIfKeyId=28, CryIfKeyRef=ECDH_128_Key_SigGenerate
      CryIfKey_ECDH_224_Key_SigGenerate: CryIfKeyId=30, CryIfKeyRef=ECDH_224_Key_SigGenerate
      CryIfKey_ECDH_256_Key_SigGenerate: CryIfKeyId=32, CryIfKeyRef=ECDH_256_Key_SigGenerate
      CryIfKey_ECDH_384_Key_SigGenerate: CryIfKeyId=34, CryIfKeyRef=ECDH_384_Key_SigGenerate
      CryIfKey_ECDH_512_Key_SigGenerate: CryIfKeyId=36, CryIfKeyRef=ECDH_512_Key_SigGenerate
      CryIfKey_Monotonic_Counter: CryIfKeyId=50, CryIfKeyRef=Monotonic_Counter
      CryIfKey_ED448_Key_SigGenerate: CryIfKeyId=38, CryIfKeyRef=ED448_Key_SigGenerate
      CryIfKey_ECC_256_Key_Generate: CryIfKeyId=16, CryIfKeyRef=ECC_256_Key_Generate
      CryIfKey_SHE_KEY_1: CryIfKeyId=51, CryIfKeyRef=SHE_KEY_1
      CryIfKey_SHE_KEY_2: CryIfKeyId=52, CryIfKeyRef=SHE_KEY_2
      CryIfKey_SHE_KEY_3: CryIfKeyId=53, CryIfKeyRef=SHE_KEY_3
      CryIfKey_SHE_KEY_4: CryIfKeyId=54, CryIfKeyRef=SHE_KEY_4
      CryIfKey_SHE_KEY_5: CryIfKeyId=55, CryIfKeyRef=SHE_KEY_5
      CryIfKey_SHE_KEY_6: CryIfKeyId=56, CryIfKeyRef=SHE_KEY_6
      CryIfKey_SHE_KEY_7: CryIfKeyId=57, CryIfKeyRef=SHE_KEY_7
      CryIfKey_SHE_KEY_8: CryIfKeyId=58, CryIfKeyRef=SHE_KEY_8
      CryIfKey_SHE_KEY_9: CryIfKeyId=59, CryIfKeyRef=SHE_KEY_9
      CryIfKey_SHE_KEY_10: CryIfKeyId=60, CryIfKeyRef=SHE_KEY_10
      CryIfKey_SHE_RAM_KEY: CryIfKeyId=61, CryIfKeyRef=SHE_RAM_KEY
      CryIfKey_Boot_MAC: CryIfKeyId=0, CryIfKeyRef=Boot_MAC
      CryIfKey_Boot_MAC_Key: CryIfKeyId=1, CryIfKeyRef=Boot_MAC_Key
      CryIfKey_Master_ECU_Key: CryIfKeyId=49, CryIfKeyRef=Master_ECU_Key
      CryIfKey_ED25519_Key_SigGenerate: CryIfKeyId=40, CryIfKeyRef=ED25519_Key_SigGenerate
      CryIfKey_ECC_192_Key_SigVerify: CryIfKeyId=12, CryIfKeyRef=ECC_192_Key_SigVerify
      CryIfKey_ECC_224_Key_SigVerify: CryIfKeyId=14, CryIfKeyRef=ECC_224_Key_SigVerify
      CryIfKey_ECC_256_Key_SigVerify: CryIfKeyId=19, CryIfKeyRef=ECC_256_Key_SigVerify
      CryIfKey_ECC_320_Key_SigVerify: CryIfKeyId=21, CryIfKeyRef=ECC_320_Key_SigVerify
      CryIfKey_ECC_384_Key_SigVerify: CryIfKeyId=23, CryIfKeyRef=ECC_384_Key_SigVerify
      CryIfKey_ECC_512_Key_SigVerify: CryIfKeyId=25, CryIfKeyRef=ECC_512_Key_SigVerify
      CryIfKey_ECC_521_Key_SigVerify: CryIfKeyId=27, CryIfKeyRef=ECC_521_Key_SigVerify
      CryIfKey_ECDH_128_Key_SigVerify: CryIfKeyId=29, CryIfKeyRef=ECDH_128_Key_SigVerify
      CryIfKey_ECDH_224_Key_SigVerify: CryIfKeyId=31, CryIfKeyRef=ECDH_224_Key_SigVerify
      CryIfKey_ECDH_256_Key_SigVerify: CryIfKeyId=33, CryIfKeyRef=ECDH_256_Key_SigVerify
      CryIfKey_ECDH_384_Key_SigVerify: CryIfKeyId=35, CryIfKeyRef=ECDH_384_Key_SigVerify
      CryIfKey_ECDH_512_Key_SigVerify: CryIfKeyId=37, CryIfKeyRef=ECDH_512_Key_SigVerify
      CryIfKey_ED448_Key_SigVerify: CryIfKeyId=39, CryIfKeyRef=ED448_Key_SigVerify
      CryIfKey_ED25519_Key_SigVerify: CryIfKeyId=41, CryIfKeyRef=ED25519_Key_SigVerify
      CryIfKey_ECC_256_Key_Generate_2: CryIfKeyId=17, CryIfKeyRef=ECC_256_Key_Generate
      CryIfKey_ECC_224_Key_Exchange: CryIfKeyId=15, CryIfKeyRef=ECC_224_Key_Exchange
