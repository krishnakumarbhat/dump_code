AUTOSAR XML (schema 00053)
package /ActiveEcuC
  module config VTTMemMap: implementation-config-variant=VARIANT-PRE-COMPILE, module-description=VTTMemMap_Impl
    MemMapGeneral:
      MemMapGeneration = FULL
      MemMapCompatibilityGeneration = FULL
      MemMapTypedPragmas = false
      MemMapGeneratePragmas = true
      MemMapErrorChecks = ALL
      MemMapGeneratePragmasForNearAddressing = false
    14 x MemMapModule, all with MemMapGenerateAdditionalMemorySections=true:
      Eth: MemMapModuleRef=Eth
        7 x MemMapAdditionalMemorySection, all with MemMapMemorySectionFileName=Eth_MemMap.h, MemMapMemorySectionPrefix=ETH:
          VAR_NO_INIT_UNSPECIFIED: MemMapMemorySectionSymbol=VAR_NOINIT_UNSPECIFIED, MemMapMemorySectionAlignment=UNSPECIFIED, MemMapMemorySectionSwAddrMethodRef=VAR_NOINIT_UNSPECIFIED
          EthernetBufferTx: MemMapMemorySectionSymbol=BUFFER_INIT_TX_UNSPECIFIED, MemMapMemorySectionSwAddrMethodRef=VAR_NO_INIT_UNSPECIFIED
          EthernetDescriptorRx: MemMapMemorySectionSymbol=DESCRIPTOR_INIT_RX_UNSPECIFIED, MemMapMemorySectionAlignment=UNSPECIFIED, MemMapMemorySectionSwAddrMethodRef=VAR_FAST_NO_INIT_UNSPECIFIED
          CONST_UNSPECIFIED: MemMapMemorySectionSwAddrMethodRef=CONST_UNSPECIFIED
          EthernetDescriptorTx: MemMapMemorySectionAlignment=UNSPECIFIED, MemMapMemorySectionSymbol=DESCRIPTOR_INIT_TX_UNSPECIFIED, MemMapMemorySectionSwAddrMethodRef=VAR_FAST_NO_INIT_UNSPECIFIED
          EthernetBufferRx: MemMapMemorySectionSymbol=BUFFER_INIT_RX_UNSPECIFIED, MemMapMemorySectionSwAddrMethodRef=VAR_NO_INIT_UNSPECIFIED
          VAR_INIT_UNSPECIFIED: MemMapMemorySectionSwAddrMethodRef=VAR_INIT_UNSPECIFIED
      MemMap_Common
        113 x MemMapAdditionalMemorySection, all with MemMapMemorySectionFileName=MemMap_Common.h, MemMapMemorySectionPrefix=:
          CONST_PBCFG: MemMapMemorySectionSymbol=CONST_PBCFG, MemMapMemorySectionSwAddrMethodRef=CONST_PBCFG
          VAR_FAST_NO_INIT_8: MemMapMemorySectionSymbol=VAR_FAST_NO_INIT_8, MemMapMemorySectionAlignment=8, MemMapMemorySectionSwAddrMethodRef=VAR_FAST_NO_INIT
          VAR_NOCACHE_INIT_16BIT: MemMapMemorySectionSymbol=VAR_NOCACHE_INIT_16BIT, MemMapMemorySectionAlignment=16, MemMapMemorySectionSwAddrMethodRef=VAR_NOCACHE_INIT
          VAR_FAST_INIT_16: MemMapMemorySectionSymbol=VAR_FAST_INIT_16, MemMapMemorySectionAlignment=16, MemMapMemorySectionSwAddrMethodRef=VAR_FAST_INIT
          VAR_FAST_NO_INIT_32: MemMapMemorySectionSymbol=VAR_FAST_NO_INIT_32, MemMapMemorySectionAlignment=32, MemMapMemorySectionSwAddrMethodRef=VAR_FAST_NO_INIT
          VAR_FAST_CLEARED_8: MemMapMemorySectionAlignment=8, MemMapMemorySectionSymbol=VAR_FAST_CLEARED_8, MemMapMemorySectionSwAddrMethodRef=VAR_FAST_CLEARED
          VAR_NO_INIT_UNSPECIFIED: MemMapMemorySectionSymbol=VAR_NO_INIT_UNSPECIFIED, MemMapMemorySectionAlignment=UNSPECIFIED, MemMapMemorySectionSwAddrMethodRef=VAR_NO_INIT
          VAR_NOCACHE_INIT_64: MemMapMemorySectionSymbol=VAR_NOCACHE_INIT_64, MemMapMemorySectionAlignment=64, MemMapMemorySectionSwAddrMethodRef=VAR_NOCACHE_INIT
          VAR_NOCACHE_CLEARED_64: MemMapMemorySectionSymbol=VAR_NOCACHE_CLEARED_64, MemMapMemorySectionAlignment=64, MemMapMemorySectionSwAddrMethodRef=VAR_NOCACHE_CLEARED
          VAR_INIT_32: MemMapMemorySectionAlignment=32, MemMapMemorySectionSymbol=VAR_INIT_32, MemMapMemorySectionSwAddrMethodRef=VAR_INIT
          VAR_FAST_NOINIT_UNSPECIFIED: MemMapMemorySectionAlignment=UNSPECIFIED, MemMapMemorySectionSymbol=VAR_FAST_NOINIT_UNSPECIFIED, MemMapMemorySectionSwAddrMethodRef=VAR_FAST_NO_INIT
          VAR_PBCFG: MemMapMemorySectionAlignment=UNSPECIFIED, MemMapMemorySectionSymbol=VAR_PBCFG, MemMapMemorySectionSwAddrMethodRef=VAR_PBCFG
          CONST_FAST_8: MemMapMemorySectionSymbol=CONST_FAST_8, MemMapMemorySectionAlignment=8, MemMapMemorySectionSwAddrMethodRef=CONST_FAST
          VAR_FAST_NO_INIT_UNSPECIFIED: MemMapMemorySectionAlignment=UNSPECIFIED, MemMapMemorySectionSymbol=VAR_FAST_NO_INIT_UNSPECIFIED, MemMapMemorySectionSwAddrMethodRef=VAR_FAST_NO_INIT
          CONST_FAST_UNSPECIFIED: MemMapMemorySectionAlignment=UNSPECIFIED, MemMapMemorySectionSymbol=CONST_FAST_UNSPECIFIED, MemMapMemorySectionSwAddrMethodRef=CONST_FAST
          VAR_INIT_32BIT: MemMapMemorySectionAlignment=32, MemMapMemorySectionSymbol=VAR_INIT_32BIT, MemMapMemorySectionSwAddrMethodRef=VAR_INIT
          VAR_FAST_INIT_64BIT: MemMapMemorySectionAlignment=64, MemMapMemorySectionSymbol=VAR_FAST_INIT_64BIT, MemMapMemorySectionSwAddrMethodRef=VAR_FAST_INIT
          VAR_NOCACHE_NOINIT_32BIT: MemMapMemorySectionAlignment=32, MemMapMemorySectionSymbol=VAR_NOCACHE_NOINIT_32BIT, MemMapMemorySectionSwAddrMethodRef=VAR_NOCACHE_NO_INIT
          CONST_32BIT: MemMapMemorySectionAlignment=32, MemMapMemorySectionSymbol=CONST_32BIT, MemMapMemorySectionSwAddrMethodRef=CONST
          VAR_NOCACHE_CLEARED_16: MemMapMemorySectionAlignment=16, MemMapMemorySectionSymbol=VAR_NOCACHE_CLEARED_16, MemMapMemorySectionSwAddrMethodRef=VAR_NOCACHE_CLEARED
          VAR_NOCACHE_NO_INIT_16: MemMapMemorySectionSymbol=VAR_NOCACHE_NO_INIT_16, MemMapMemorySectionAlignment=16, MemMapMemorySectionSwAddrMethodRef=VAR_NOCACHE_NO_INIT
          VAR_CLEARED_64: MemMapMemorySectionAlignment=64, MemMapMemorySectionSymbol=VAR_CLEARED_64, MemMapMemorySectionSwAddrMethodRef=VAR_CLEARED
          VAR_INIT_UNSPECIFIED: MemMapMemorySectionAlignment=UNSPECIFIED, MemMapMemorySectionSymbol=VAR_INIT_UNSPECIFIED, MemMapMemorySectionSwAddrMethodRef=VAR_INIT
          VAR_CLEARED_16: MemMapMemorySectionSymbol=VAR_CLEARED_16, MemMapMemorySectionAlignment=16, MemMapMemorySectionSwAddrMethodRef=VAR_CLEARED
          VAR_NOCACHE_INIT_32: MemMapMemorySectionSymbol=VAR_NOCACHE_INIT_32, MemMapMemorySectionAlignment=32, MemMapMemorySectionSwAddrMethodRef=VAR_NOCACHE_INIT
          VAR_NOCACHE_NOINIT_64BIT: MemMapMemorySectionSymbol=VAR_NOCACHE_NOINIT_64BIT, MemMapMemorySectionAlignment=64, MemMapMemorySectionSwAddrMethodRef=VAR_NOCACHE_NO_INIT
          CODE_FAST: MemMapMemorySectionSymbol=CODE_FAST, MemMapMemorySectionSwAddrMethodRef=CODE_FAST
          VAR_FAST_INIT_32: MemMapMemorySectionAlignment=32, MemMapMemorySectionSymbol=VAR_FAST_INIT_32, MemMapMemorySectionSwAddrMethodRef=VAR_FAST_INIT
          VAR_NOCACHE_INIT_8: MemMapMemorySectionAlignment=8, MemMapMemorySectionSymbol=VAR_NOCACHE_INIT_8, MemMapMemorySectionSwAddrMethodRef=VAR_NOCACHE_INIT
          VAR_INIT_64: MemMapMemorySectionSymbol=VAR_INIT_64, MemMapMemorySectionAlignment=64, MemMapMemorySectionSwAddrMethodRef=VAR_INIT
          VAR_NOINIT_UNSPECIFIED: MemMapMemorySectionSymbol=VAR_NOINIT_UNSPECIFIED, MemMapMemorySectionAlignment=UNSPECIFIED, MemMapMemorySectionSwAddrMethodRef=VAR_NO_INIT
          VAR_NOCACHE_CLEARED_UNSPECIFIED: MemMapMemorySectionAlignment=UNSPECIFIED, MemMapMemorySectionSymbol=VAR_NOCACHE_CLEARED_UNSPECIFIED, MemMapMemorySectionSwAddrMethodRef=VAR_NOCACHE_CLEARED
          VAR_FAST_NO_INIT_16: MemMapMemorySectionAlignment=16, MemMapMemorySectionSymbol=VAR_FAST_NO_INIT_16, MemMapMemorySectionSwAddrMethodRef=VAR_FAST_NO_INIT
          VAR_FAST_ZERO_INIT_64BIT: MemMapMemorySectionSymbol=VAR_FAST_ZERO_INIT_64BIT, MemMapMemorySectionAlignment=64, MemMapMemorySectionSwAddrMethodRef=VAR_FAST_CLEARED
          VAR_FAST_CLEARED_16: MemMapMemorySectionAlignment=16, MemMapMemorySectionSymbol=VAR_FAST_CLEARED_16, MemMapMemorySectionSwAddrMethodRef=VAR_FAST_CLEARED
          VAR_NOCACHE_ZERO_INIT_UNSPECIFIED: MemMapMemorySectionSymbol=VAR_NOCACHE_ZERO_INIT_UNSPECIFIED, MemMapMemorySectionAlignment=UNSPECIFIED, MemMapMemorySectionSwAddrMethodRef=VAR_NOCACHE_CLEARED
          VAR_FAST_NOINIT_8BIT: MemMapMemorySectionSymbol=VAR_FAST_NOINIT_8BIT, MemMapMemorySectionAlignment=8, MemMapMemorySectionSwAddrMethodRef=VAR_FAST_NO_INIT
          VAR_NOINIT_64BIT: MemMapMemorySectionAlignment=64, MemMapMemorySectionSymbol=VAR_NOINIT_64BIT, MemMapMemorySectionSwAddrMethodRef=VAR_NO_INIT
          VAR_ZERO_INIT_32BIT: MemMapMemorySectionSymbol=VAR_ZERO_INIT_32BIT, MemMapMemorySectionAlignment=32, MemMapMemorySectionSwAddrMethodRef=VAR_CLEARED
          VAR_NOCACHE_NO_INIT_32: MemMapMemorySectionSymbol=VAR_NOCACHE_NO_INIT_32, MemMapMemorySectionAlignment=32, MemMapMemorySectionSwAddrMethodRef=VAR_NOCACHE_NO_INIT
          VAR: MemMapMemorySectionAlignment=UNSPECIFIED, MemMapMemorySectionSymbol=VAR, MemMapMemorySectionSwAddrMethodRef=VAR_INIT
          CONST_8: MemMapMemorySectionSymbol=CONST_8, MemMapMemorySectionAlignment=8, MemMapMemorySectionSwAddrMethodRef=CONST
          VAR_FAST_NOINIT_32BIT: MemMapMemorySectionAlignment=32, MemMapMemorySectionSymbol=VAR_FAST_NOINIT_32BIT, MemMapMemorySectionSwAddrMethodRef=VAR_FAST_NO_INIT
          VAR_INIT_8: MemMapMemorySectionSymbol=VAR_INIT_8, MemMapMemorySectionAlignment=8, MemMapMemorySectionSwAddrMethodRef=VAR_INIT
          CONST_FAST_64: MemMapMemorySectionSymbol=CONST_FAST_64, MemMapMemorySectionAlignment=64, MemMapMemorySectionSwAddrMethodRef=CONST_FAST
          VAR_NOINIT_8BIT: MemMapMemorySectionSymbol=VAR_NOINIT_8BIT, MemMapMemorySectionAlignment=8, MemMapMemorySectionSwAddrMethodRef=VAR_NO_INIT
          VAR_FAST_CLEARED_64: MemMapMemorySectionAlignment=64, MemMapMemorySectionSymbol=VAR_FAST_CLEARED_64, MemMapMemorySectionSwAddrMethodRef=VAR_FAST_CLEARED
          VAR_NOCACHE_NO_INIT_64: MemMapMemorySectionSymbol=VAR_NOCACHE_NO_INIT_64, MemMapMemorySectionAlignment=64, MemMapMemorySectionSwAddrMethodRef=VAR_NOCACHE_NO_INIT
          CONST: MemMapMemorySectionAlignment=UNSPECIFIED, MemMapMemorySectionSymbol=CONST, MemMapMemorySectionSwAddrMethodRef=CONST
          VAR_ZERO_INIT_16BIT: MemMapMemorySectionSymbol=VAR_ZERO_INIT_16BIT, MemMapMemorySectionAlignment=16, MemMapMemorySectionSwAddrMethodRef=VAR_CLEARED
          CONST_64BIT: MemMapMemorySectionAlignment=64, MemMapMemorySectionSymbol=CONST_64BIT, MemMapMemorySectionSwAddrMethodRef=CONST
          VAR_NO_INIT_16: MemMapMemorySectionSymbol=VAR_NO_INIT_16, MemMapMemorySectionAlignment=16, MemMapMemorySectionSwAddrMethodRef=VAR_NO_INIT
          VAR_ZERO_INIT_8BIT: MemMapMemorySectionSymbol=VAR_ZERO_INIT_8BIT, MemMapMemorySectionAlignment=8, MemMapMemorySectionSwAddrMethodRef=VAR_CLEARED
          CONST_64: MemMapMemorySectionAlignment=64, MemMapMemorySectionSymbol=CONST_64, MemMapMemorySectionSwAddrMethodRef=CONST
          VAR_FAST_ZERO_INIT_8BIT: MemMapMemorySectionAlignment=8, MemMapMemorySectionSymbol=VAR_FAST_ZERO_INIT_8BIT, MemMapMemorySectionSwAddrMethodRef=VAR_FAST_CLEARED
          CONST_FAST_16BIT: MemMapMemorySectionAlignment=16, MemMapMemorySectionSymbol=CONST_FAST_16BIT, MemMapMemorySectionSwAddrMethodRef=CONST_FAST
          VAR_NO_INIT_8: MemMapMemorySectionAlignment=8, MemMapMemorySectionSymbol=VAR_NO_INIT_8, MemMapMemorySectionSwAddrMethodRef=VAR_NO_INIT
          VAR_FAST_INIT_8: MemMapMemorySectionSymbol=VAR_FAST_INIT_8, MemMapMemorySectionAlignment=8, MemMapMemorySectionSwAddrMethodRef=VAR_FAST_INIT
          VAR_FAST_INIT_UNSPECIFIED: MemMapMemorySectionAlignment=UNSPECIFIED, MemMapMemorySectionSymbol=VAR_FAST_INIT_UNSPECIFIED, MemMapMemorySectionSwAddrMethodRef=VAR_FAST_INIT
          VAR_ZERO_INIT_UNSPECIFIED: MemMapMemorySectionSymbol=VAR_ZERO_INIT_UNSPECIFIED, MemMapMemorySectionAlignment=UNSPECIFIED, MemMapMemorySectionSwAddrMethodRef=VAR_CLEARED
          VAR_NOCACHE_ZERO_INIT_16BIT: MemMapMemorySectionSymbol=VAR_NOCACHE_ZERO_INIT_16BIT, MemMapMemorySectionAlignment=16, MemMapMemorySectionSwAddrMethodRef=VAR_NOCACHE_CLEARED
          VAR_NOINIT_16BIT: MemMapMemorySectionAlignment=16, MemMapMemorySectionSymbol=VAR_NOINIT_16BIT, MemMapMemorySectionSwAddrMethodRef=VAR_NO_INIT
          VAR_NOCACHE_CLEARED_8: MemMapMemorySectionAlignment=8, MemMapMemorySectionSymbol=VAR_NOCACHE_CLEARED_8, MemMapMemorySectionSwAddrMethodRef=VAR_NOCACHE_CLEARED
          VAR_NOCACHE_ZERO_INIT_32BIT: MemMapMemorySectionSymbol=VAR_NOCACHE_ZERO_INIT_32BIT, MemMapMemorySectionAlignment=32, MemMapMemorySectionSwAddrMethodRef=VAR_NOCACHE_CLEARED
          VAR_INIT_16: MemMapMemorySectionSymbol=VAR_INIT_16, MemMapMemorySectionAlignment=16, MemMapMemorySectionSwAddrMethodRef=VAR_INIT
          PBCFG_GLOBALROOT: MemMapMemorySectionSymbol=PBCFG_GLOBALROOT, MemMapMemorySectionSwAddrMethodRef=PBCFG_GLOBALROOT
          VAR_FAST_ZERO_INIT_16BIT: MemMapMemorySectionAlignment=16, MemMapMemorySectionSymbol=VAR_FAST_ZERO_INIT_16BIT, MemMapMemorySectionSwAddrMethodRef=VAR_FAST_CLEARED
          VAR_FAST_CLEARED_UNSPECIFIED: MemMapMemorySectionAlignment=UNSPECIFIED, MemMapMemorySectionSymbol=VAR_FAST_CLEARED_UNSPECIFIED, MemMapMemorySectionSwAddrMethodRef=VAR_FAST_CLEARED
          VAR_FAST_INIT_16BIT: MemMapMemorySectionAlignment=16, MemMapMemorySectionSymbol=VAR_FAST_INIT_16BIT, MemMapMemorySectionSwAddrMethodRef=VAR_FAST_INIT
          VAR_FAST_INIT_8BIT: MemMapMemorySectionAlignment=8, MemMapMemorySectionSymbol=VAR_FAST_INIT_8BIT, MemMapMemorySectionSwAddrMethodRef=VAR_FAST_INIT
          VAR_NOCACHE_NO_INIT_8: MemMapMemorySectionAlignment=8, MemMapMemorySectionSymbol=VAR_NOCACHE_NO_INIT_8, MemMapMemorySectionSwAddrMethodRef=VAR_NOCACHE_NO_INIT
          CONST_8BIT: MemMapMemorySectionAlignment=8, MemMapMemorySectionSymbol=CONST_8BIT, MemMapMemorySectionSwAddrMethodRef=CONST
          VAR_FAST_NOINIT_16BIT: MemMapMemorySectionAlignment=16, MemMapMemorySectionSymbol=VAR_FAST_NOINIT_16BIT, MemMapMemorySectionSwAddrMethodRef=VAR_FAST_NO_INIT
          CONST_FAST_16: MemMapMemorySectionSymbol=CONST_FAST_16, MemMapMemorySectionAlignment=16, MemMapMemorySectionSwAddrMethodRef=CONST_FAST
          VAR_ZERO_INIT_64BIT: MemMapMemorySectionAlignment=64, MemMapMemorySectionSymbol=VAR_ZERO_INIT_64BIT, MemMapMemorySectionSwAddrMethodRef=VAR_CLEARED
          VAR_NO_INIT_32: MemMapMemorySectionAlignment=32, MemMapMemorySectionSymbol=VAR_NO_INIT_32, MemMapMemorySectionSwAddrMethodRef=VAR_NO_INIT
          VAR_NOCACHE_INIT_64BIT: MemMapMemorySectionAlignment=64, MemMapMemorySectionSymbol=VAR_NOCACHE_INIT_64BIT, MemMapMemorySectionSwAddrMethodRef=VAR_NOCACHE_INIT
          CONST_UNSPECIFIED: MemMapMemorySectionSymbol=CONST_UNSPECIFIED, MemMapMemorySectionAlignment=UNSPECIFIED, MemMapMemorySectionSwAddrMethodRef=CONST
          VAR_INIT_16BIT: MemMapMemorySectionSymbol=VAR_INIT_16BIT, MemMapMemorySectionAlignment=16, MemMapMemorySectionSwAddrMethodRef=VAR_INIT
          VAR_FAST_ZERO_INIT_32BIT: MemMapMemorySectionSymbol=VAR_FAST_ZERO_INIT_32BIT, MemMapMemorySectionAlignment=32, MemMapMemorySectionSwAddrMethodRef=VAR_FAST_CLEARED
          CONST_FAST_32BIT: MemMapMemorySectionSymbol=CONST_FAST_32BIT, MemMapMemorySectionAlignment=32, MemMapMemorySectionSwAddrMethodRef=CONST_FAST
          VAR_CLEARED_8: MemMapMemorySectionAlignment=8, MemMapMemorySectionSymbol=VAR_CLEARED_8, MemMapMemorySectionSwAddrMethodRef=VAR_CLEARED
          CONST_16: MemMapMemorySectionAlignment=16, MemMapMemorySectionSymbol=CONST_16, MemMapMemorySectionSwAddrMethodRef=CONST
          VAR_FAST_NOINIT_64BIT: MemMapMemorySectionSymbol=VAR_FAST_NOINIT_64BIT, MemMapMemorySectionAlignment=64, MemMapMemorySectionSwAddrMethodRef=VAR_FAST_NO_INIT
          VAR_CLEARED_32: MemMapMemorySectionSymbol=VAR_CLEARED_32, MemMapMemorySectionAlignment=32, MemMapMemorySectionSwAddrMethodRef=VAR_CLEARED
          VAR_FAST_CLEARED_32: MemMapMemorySectionSymbol=VAR_FAST_CLEARED_32, MemMapMemorySectionAlignment=32, MemMapMemorySectionSwAddrMethodRef=VAR_FAST_CLEARED
          CONST_FAST_32: MemMapMemorySectionSymbol=CONST_FAST_32, MemMapMemorySectionAlignment=32, MemMapMemorySectionSwAddrMethodRef=CONST_FAST
          VAR_CLEARED_UNSPECIFIED: MemMapMemorySectionAlignment=UNSPECIFIED, MemMapMemorySectionSymbol=VAR_CLEARED_UNSPECIFIED, MemMapMemorySectionSwAddrMethodRef=VAR_CLEARED
          VAR_NOCACHE_INIT_UNSPECIFIED: MemMapMemorySectionAlignment=UNSPECIFIED, MemMapMemorySectionSymbol=VAR_NOCACHE_INIT_UNSPECIFIED, MemMapMemorySectionSwAddrMethodRef=VAR_NOCACHE_INIT
          VAR_NOCACHE_NOINIT_UNSPECIFIED: MemMapMemorySectionSymbol=VAR_NOCACHE_NOINIT_UNSPECIFIED, MemMapMemorySectionAlignment=UNSPECIFIED, MemMapMemorySectionSwAddrMethodRef=VAR_NOCACHE_NO_INIT
          VAR_INIT_64BIT: MemMapMemorySectionSymbol=VAR_INIT_64BIT, MemMapMemorySectionAlignment=64, MemMapMemorySectionSwAddrMethodRef=VAR_INIT
          VAR_FAST_ZERO_INIT_UNSPECIFIED: MemMapMemorySectionAlignment=UNSPECIFIED, MemMapMemorySectionSymbol=VAR_FAST_ZERO_INIT_UNSPECIFIED, MemMapMemorySectionSwAddrMethodRef=VAR_FAST_CLEARED
          VAR_NOCACHE_ZERO_INIT_64BIT: MemMapMemorySectionAlignment=64, MemMapMemorySectionSymbol=VAR_NOCACHE_ZERO_INIT_64BIT, MemMapMemorySectionSwAddrMethodRef=VAR_NOCACHE_CLEARED
          VAR_NOCACHE_INIT_16: MemMapMemorySectionAlignment=16, MemMapMemorySectionSymbol=VAR_NOCACHE_INIT_16, MemMapMemorySectionSwAddrMethodRef=VAR_NOCACHE_INIT
          VAR_NOCACHE_NOINIT_16BIT: MemMapMemorySectionAlignment=16, MemMapMemorySectionSymbol=VAR_NOCACHE_NOINIT_16BIT, MemMapMemorySectionSwAddrMethodRef=VAR_NOCACHE_NO_INIT
          CODE_ISR: MemMapMemorySectionSymbol=CODE_ISR, MemMapMemorySectionSwAddrMethodRef=CODE_ISR
          VAR_NOCACHE_NOINIT_8BIT: MemMapMemorySectionSymbol=VAR_NOCACHE_NOINIT_8BIT, MemMapMemorySectionAlignment=8, MemMapMemorySectionSwAddrMethodRef=VAR_NOCACHE_NO_INIT
          VAR_NOINIT_32BIT: MemMapMemorySectionSymbol=VAR_NOINIT_32BIT, MemMapMemorySectionAlignment=32, MemMapMemorySectionSwAddrMethodRef=VAR_NO_INIT
          CODE: MemMapMemorySectionSymbol=CODE, MemMapMemorySectionSwAddrMethodRef=CODE
          CONST_FAST_8BIT: MemMapMemorySectionAlignment=8, MemMapMemorySectionSymbol=CONST_FAST_8BIT, MemMapMemorySectionSwAddrMethodRef=CONST_FAST
          VAR_FAST_INIT_64: MemMapMemorySectionAlignment=64, MemMapMemorySectionSymbol=VAR_FAST_INIT_64, MemMapMemorySectionSwAddrMethodRef=VAR_FAST_INIT
          VAR_NO_INIT_64: MemMapMemorySectionSymbol=VAR_NO_INIT_64, MemMapMemorySectionAlignment=64, MemMapMemorySectionSwAddrMethodRef=VAR_NO_INIT
          VAR_INIT_8BIT: MemMapMemorySectionAlignment=8, MemMapMemorySectionSymbol=VAR_INIT_8BIT, MemMapMemorySectionSwAddrMethodRef=VAR_INIT
          CONST_FAST_64BIT: MemMapMemorySectionAlignment=64, MemMapMemorySectionSymbol=CONST_FAST_64BIT, MemMapMemorySectionSwAddrMethodRef=CONST_FAST
          VAR_FAST_INIT_32BIT: MemMapMemorySectionAlignment=32, MemMapMemorySectionSymbol=VAR_FAST_INIT_32BIT, MemMapMemorySectionSwAddrMethodRef=VAR_FAST_INIT
          VAR_NOCACHE_INIT_32BIT: MemMapMemorySectionAlignment=32, MemMapMemorySectionSymbol=VAR_NOCACHE_INIT_32BIT, MemMapMemorySectionSwAddrMethodRef=VAR_NOCACHE_INIT
          VAR_NOCACHE_CLEARED_32: MemMapMemorySectionSymbol=VAR_NOCACHE_CLEARED_32, MemMapMemorySectionAlignment=32, MemMapMemorySectionSwAddrMethodRef=VAR_NOCACHE_CLEARED
          CONST_32: MemMapMemorySectionSymbol=CONST_32, MemMapMemorySectionAlignment=32, MemMapMemorySectionSwAddrMethodRef=CONST
          VAR_NOCACHE_INIT_8BIT: MemMapMemorySectionAlignment=8, MemMapMemorySectionSymbol=VAR_NOCACHE_INIT_8BIT, MemMapMemorySectionSwAddrMethodRef=VAR_NOCACHE_INIT
          VAR_NOCACHE_NO_INIT_UNSPECIFIED: MemMapMemorySectionSymbol=VAR_NOCACHE_NO_INIT_UNSPECIFIED, MemMapMemorySectionAlignment=UNSPECIFIED, MemMapMemorySectionSwAddrMethodRef=VAR_NOCACHE_NO_INIT
          CONST_16BIT: MemMapMemorySectionSymbol=CONST_16BIT, MemMapMemorySectionAlignment=16, MemMapMemorySectionSwAddrMethodRef=CONST
          VAR_FAST_NO_INIT_64: MemMapMemorySectionSymbol=VAR_FAST_NO_INIT_64, MemMapMemorySectionAlignment=64, MemMapMemorySectionSwAddrMethodRef=VAR_FAST_NO_INIT
          VAR_NOCACHE_ZERO_INIT_8BIT: MemMapMemorySectionSymbol=VAR_NOCACHE_ZERO_INIT_8BIT, MemMapMemorySectionAlignment=8, MemMapMemorySectionSwAddrMethodRef=VAR_NOCACHE_CLEARED
      Adc: MemMapModuleRef=Adc
        5 x MemMapAdditionalMemorySection, all with MemMapMemorySectionPrefix=ADC:
          CONST_UNSPECIFIED: MemMapMemorySectionSwAddrMethodRef=CONST_UNSPECIFIED
          VAR_INIT_16BIT: MemMapMemorySectionSwAddrMethodRef=VAR_INIT_16
          VAR_INIT_UNSPECIFIED: MemMapMemorySectionSwAddrMethodRef=VAR_INIT_UNSPECIFIED
          CONFIG_DATA_POSTBUILD: MemMapMemorySectionSwAddrMethodRef=CONFIG_DATA
          VAR_INIT_8BIT: MemMapMemorySectionSwAddrMethodRef=VAR_INIT_8
      Can: MemMapModuleRef=Can
        5 x MemMapAdditionalMemorySection, all with MemMapMemorySectionPrefix=CAN:
          VAR_INIT_16BIT: MemMapMemorySectionSwAddrMethodRef=VAR_INIT_16
          CONFIG_DATA_POSTBUILD: MemMapMemorySectionSwAddrMethodRef=CONFIG_DATA
          VAR_INIT_UNSPECIFIED: MemMapMemorySectionSwAddrMethodRef=VAR_INIT_UNSPECIFIED
          CONST_UNSPECIFIED: MemMapMemorySectionSwAddrMethodRef=CONST_UNSPECIFIED
          VAR_INIT_8BIT: MemMapMemorySectionSwAddrMethodRef=VAR_INIT_8
      Wdg: MemMapModuleRef=Wdg
        6 x MemMapAdditionalMemorySection, all with MemMapMemorySectionPrefix=WDG:
          VAR_INIT_8BIT: MemMapMemorySectionSwAddrMethodRef=VAR_INIT_8
          VAR_NO_INIT_UNSPECIFIED: MemMapMemorySectionSwAddrMethodRef=VAR_NO_INIT_UNSPECIFIED
          CONST_UNSPECIFIED: MemMapMemorySectionSwAddrMethodRef=CONST_UNSPECIFIED
          CONFIG_DATA_POSTBUILD: MemMapMemorySectionSwAddrMethodRef=CONFIG_DATA
          VAR_INIT_16BIT: MemMapMemorySectionSwAddrMethodRef=VAR_INIT_16
          VAR_INIT_UNSPECIFIED: MemMapMemorySectionSwAddrMethodRef=VAR_INIT_UNSPECIFIED
      Pwm: MemMapModuleRef=Pwm
        6 x MemMapAdditionalMemorySection, all with MemMapMemorySectionPrefix=PWM:
          CONFIG_DATA_POSTBUILD: MemMapMemorySectionSwAddrMethodRef=CONFIG_DATA
          VAR_INIT_16BIT: MemMapMemorySectionSwAddrMethodRef=VAR_INIT_16
          VAR_INIT_8BIT: MemMapMemorySectionSwAddrMethodRef=VAR_INIT_8
          CONST_UNSPECIFIED: MemMapMemorySectionSwAddrMethodRef=CONST_UNSPECIFIED
          VAR_INIT_UNSPECIFIED: MemMapMemorySectionSwAddrMethodRef=VAR_INIT_UNSPECIFIED
          CODE: MemMapMemorySectionSwAddrMethodRef=CODE
      Mcu: MemMapModuleRef=Mcu
        6 x MemMapAdditionalMemorySection, all with MemMapMemorySectionPrefix=MCU:
          VAR_INIT_8BIT: MemMapMemorySectionSwAddrMethodRef=VAR_INIT_8
          VAR_INIT_16BIT: MemMapMemorySectionSwAddrMethodRef=VAR_INIT_16
          VAR_NO_INIT_UNSPECIFIED: MemMapMemorySectionSwAddrMethodRef=VAR_NOINIT_UNSPECIFIED
          CODE_ISR: MemMapMemorySectionSwAddrMethodRef=CODE_ISR
          CONFIG_DATA_POSTBUILD: MemMapMemorySectionSwAddrMethodRef=CONFIG_DATA
          CONST_UNSPECIFIED: MemMapMemorySectionSwAddrMethodRef=CONST_UNSPECIFIED
      Port: MemMapModuleRef=Port
        6 x MemMapAdditionalMemorySection, all with MemMapMemorySectionPrefix=PORT:
          VAR_INIT_UNSPECIFIED: MemMapMemorySectionSwAddrMethodRef=VAR_INIT_UNSPECIFIED
          CONST_UNSPECIFIED: MemMapMemorySectionSwAddrMethodRef=CONST_UNSPECIFIED
          VAR_NO_INIT_UNSPECIFIED: MemMapMemorySectionSwAddrMethodRef=VAR_NO_INIT_UNSPECIFIED
          CONFIG_DATA_POSTBUILD: MemMapMemorySectionSwAddrMethodRef=CONFIG_DATA
          VAR_INIT_16BIT: MemMapMemorySectionSwAddrMethodRef=VAR_INIT_16
          VAR_INIT_8BIT: MemMapMemorySectionSwAddrMethodRef=VAR_INIT_8
      Dio: MemMapModuleRef=Dio
        5 x MemMapAdditionalMemorySection, all with MemMapMemorySectionPrefix=DIO:
          VAR_INIT_16BIT: MemMapMemorySectionSwAddrMethodRef=VAR_INIT_16
          CONFIG_DATA_POSTBUILD: MemMapMemorySectionSwAddrMethodRef=CONFIG_DATA
          CONST_UNSPECIFIED: MemMapMemorySectionSwAddrMethodRef=CONST_UNSPECIFIED
          VAR_INIT_8BIT: MemMapMemorySectionSwAddrMethodRef=VAR_INIT_8
          VAR_INIT_UNSPECIFIED: MemMapMemorySectionSwAddrMethodRef=VAR_INIT_UNSPECIFIED
      Dma: MemMapModuleRef=Dma
        5 x MemMapAdditionalMemorySection, all with MemMapMemorySectionPrefix=DMA:
          VAR_INIT_8BIT: MemMapMemorySectionSwAddrMethodRef=VAR_INIT_8
          VAR_INIT_16BIT: MemMapMemorySectionSwAddrMethodRef=VAR_INIT_16
          CONST_UNSPECIFIED: MemMapMemorySectionSwAddrMethodRef=CONST_UNSPECIFIED
          VAR_INIT_UNSPECIFIED: MemMapMemorySectionSwAddrMethodRef=VAR_INIT_UNSPECIFIED
          CONFIG_DATA_POSTBUILD: MemMapMemorySectionSwAddrMethodRef=CONFIG_DATA
      Spi: MemMapModuleRef=Spi
        6 x MemMapAdditionalMemorySection, all with MemMapMemorySectionPrefix=SPI:
          VAR_INIT_8BIT: MemMapMemorySectionSwAddrMethodRef=VAR_INIT_8
          VAR_NO_INIT_UNSPECIFIED: MemMapMemorySectionSwAddrMethodRef=VAR_NO_INIT_UNSPECIFIED
          CONFIG_DATA_POSTBUILD: MemMapMemorySectionSwAddrMethodRef=CONFIG_DATA
          CONST_UNSPECIFIED: MemMapMemorySectionSwAddrMethodRef=CONST_UNSPECIFIED
          VAR_INIT_UNSPECIFIED: MemMapMemorySectionSwAddrMethodRef=VAR_INIT_UNSPECIFIED
          VAR_INIT_16BIT: MemMapMemorySectionSwAddrMethodRef=VAR_INIT_16
      Gpt: MemMapModuleRef=Gpt
        7 x MemMapAdditionalMemorySection, all with MemMapMemorySectionPrefix=GPT:
          VAR_NO_INIT_UNSPECIFIED: MemMapMemorySectionSwAddrMethodRef=VAR_NO_INIT_UNSPECIFIED
          CONST_UNSPECIFIED: MemMapMemorySectionSwAddrMethodRef=CONST_UNSPECIFIED
          VAR_INIT_UNSPECIFIED: MemMapMemorySectionSwAddrMethodRef=VAR_INIT_UNSPECIFIED
          VAR_INIT_16BIT: MemMapMemorySectionSwAddrMethodRef=VAR_INIT_16
          VAR_INIT_32BIT: MemMapMemorySectionSwAddrMethodRef=VAR_INIT_32
          CONFIG_DATA_POSTBUILD: MemMapMemorySectionSwAddrMethodRef=CONFIG_DATA
          VAR_INIT_8BIT: MemMapMemorySectionSwAddrMethodRef=VAR_INIT_8
      Fls: MemMapModuleRef=Fls
        6 x MemMapAdditionalMemorySection, all with MemMapMemorySectionPrefix=FLS:
          CONST_UNSPECIFIED: MemMapMemorySectionSwAddrMethodRef=CONST_UNSPECIFIED
          VAR_INIT_32BIT: MemMapMemorySectionSwAddrMethodRef=VAR_INIT_32
          CONFIG_DATA_POSTBUILD: MemMapMemorySectionSwAddrMethodRef=CONFIG_DATA
          VAR_INIT_UNSPECIFIED: MemMapMemorySectionSwAddrMethodRef=VAR_INIT_UNSPECIFIED
          VAR_INIT_8BIT: MemMapMemorySectionSwAddrMethodRef=VAR_INIT_8
          VAR_INIT_16BIT: MemMapMemorySectionSwAddrMethodRef=VAR_INIT_16
      I2c: MemMapModuleRef=I2c
        6 x MemMapAdditionalMemorySection, all with MemMapMemorySectionPrefix=I2C:
          VAR_INIT_16BIT: MemMapMemorySectionSwAddrMethodRef=VAR_INIT_16
          CONFIG_DATA_POSTBUILD: MemMapMemorySectionSwAddrMethodRef=CONFIG_DATA
          VAR_INIT_UNSPECIFIED: MemMapMemorySectionSwAddrMethodRef=VAR_INIT_UNSPECIFIED
          CODE: MemMapMemorySectionSwAddrMethodRef=CODE
          CONST_UNSPECIFIED: MemMapMemorySectionSwAddrMethodRef=CONST_UNSPECIFIED
          VAR_INIT_8BIT: MemMapMemorySectionSwAddrMethodRef=VAR_INIT_8
    6 x MemMapAllocation:
      CRYPTO_MemMap
        12 x MemMapSectionSpecificMapping:
          MemMapIPCDataBuffer: MemMapAddressingModeSetRef=MSR_CRYPTO_IPC_DataBuffer, MemMapMemorySectionRef=CRYPTO_IPC_DATA_BUFFER_128BIT
          MemMapIPCLengthBuffer: MemMapAddressingModeSetRef=MSR_CRYPTO_IPC_LengthBuffer, MemMapMemorySectionRef=CRYPTO_IPC_LENGTH_BUFFER_128BIT
          MemMapKeyStructMetadata: MemMapAddressingModeSetRef=MSR_CRYPTO_KeyStruct_MetaData, MemMapMemorySectionRef=CRYPTO_KEYSTRUCT_METADATA_128BIT
          MemMapKeyStructInitdata: MemMapAddressingModeSetRef=MSR_CRYPTO_KeyStruct_InitData, MemMapMemorySectionRef=CRYPTO_KEYSTRUCT_INITDATA_8BIT
          MemMapSectionSpecificMapping_Code: MemMapAddressingModeSetRef=MSR_MCAL_CODE, MemMapMemorySectionRef=CRYPTO_CODE
          MemMapSectionSpecificMapping_VarInit: MemMapAddressingModeSetRef=MSR_MCAL_VAR_INIT, MemMapMemorySectionRef=CRYPTO_VAR_INIT_UNSPECIFIED
          MemMapSectionSpecificMapping_VarNoInit_32BIT: MemMapAddressingModeSetRef=MSR_MCAL_VAR_NO_INIT, MemMapMemorySectionRef=CRYPTO_VAR_NOINIT_32BIT
          MemMapSectionSpecificMapping_VarNoInit_8BIT: MemMapAddressingModeSetRef=MSR_MCAL_VAR_NO_INIT, MemMapMemorySectionRef=CRYPTO_VAR_NOINIT_8BIT
          MemMapSectionSpecificMapping_VarNoInit_16BIT: MemMapAddressingModeSetRef=MSR_MCAL_VAR_NO_INIT, MemMapMemorySectionRef=CRYPTO_VAR_NOINIT_16BIT
          MemMapSectionSpecificMapping_Const: MemMapAddressingModeSetRef=MSR_MCAL_CONST, MemMapMemorySectionRef=CRYPTO_CONST_8BIT, MemMapMemorySectionRef=CRYPTO_CONST_16BIT, MemMapMemorySectionRef=CRYPTO_CONST_32BIT
          MemMapTestData: MemMapAddressingModeSetRef=MSR_CRYPTO_TestData, MemMapMemorySectionRef=CRYPTO_TESTDATA_128BIT
          MemMapSectionSpecificMapping_VarNoInit_Unspecified: MemMapAddressingModeSetRef=MSR_MCAL_VAR_NO_INIT, MemMapMemorySectionRef=CRYPTO_VAR_NOINIT_UNSPECIFIED
      MCAL_SpecificAllocation
        5 x MemMapAdditionalSpecificMapping:
          AdditionalMcalConfigDataPostBuild: MemMapAddressingModeSetRef=MSR_MCAL_CONFIG_DATA_POSTBUILD, MemMapAdditionalMemorySectionRef=Mcu/CONFIG_DATA_POSTBUILD, MemMapAdditionalMemorySectionRef=Adc/CONFIG_DATA_POSTBUILD, MemMapAdditionalMemorySectionRef=Port/CONFIG_DATA_POSTBUILD, MemMapAdditionalMemorySectionRef=Can/CONFIG_DATA_POSTBUILD, MemMapAdditionalMemorySectionRef=Pwm/CONFIG_DATA_POSTBUILD, MemMapAdditionalMemorySectionRef=I2c/CONFIG_DATA_POSTBUILD, MemMapAdditionalMemorySectionRef=Dma/CONFIG_DATA_POSTBUILD, MemMapAdditionalMemorySectionRef=Fls/CONFIG_DATA_POSTBUILD, MemMapAdditionalMemorySectionRef=Gpt/CONFIG_DATA_POSTBUILD, MemMapAdditionalMemorySectionRef=Dio/CONFIG_DATA_POSTBUILD
          AdditionalMcalVarNoInit: MemMapAddressingModeSetRef=MSR_MCAL_VAR_NO_INIT, MemMapAdditionalMemorySectionRef=Mcu/VAR_NO_INIT_UNSPECIFIED, MemMapAdditionalMemorySectionRef=Port/VAR_NO_INIT_UNSPECIFIED, MemMapAdditionalMemorySectionRef=Spi/VAR_NO_INIT_UNSPECIFIED, MemMapAdditionalMemorySectionRef=Eth/VAR_NO_INIT_UNSPECIFIED
          AdditionalMcalCode: MemMapAddressingModeSetRef=MSR_MCAL_CODE, MemMapAdditionalMemorySectionRef=Mcu/CODE_ISR, MemMapAdditionalMemorySectionRef=I2c/CODE, MemMapAdditionalMemorySectionRef=Pwm/CODE
          AdditionalMcalConst: MemMapAddressingModeSetRef=MSR_MCAL_CONST, MemMapAdditionalMemorySectionRef=Mcu/CONST_UNSPECIFIED, MemMapAdditionalMemorySectionRef=Adc/CONST_UNSPECIFIED, MemMapAdditionalMemorySectionRef=Port/CONST_UNSPECIFIED, MemMapAdditionalMemorySectionRef=Can/CONST_UNSPECIFIED, MemMapAdditionalMemorySectionRef=Dio/CONST_UNSPECIFIED, MemMapAdditionalMemorySectionRef=Dma/CONST_UNSPECIFIED, MemMapAdditionalMemorySectionRef=Fls/CONST_UNSPECIFIED, MemMapAdditionalMemorySectionRef=Gpt/CONST_UNSPECIFIED, MemMapAdditionalMemorySectionRef=I2c/CONST_UNSPECIFIED, MemMapAdditionalMemorySectionRef=Pwm/CONST_UNSPECIFIED, MemMapAdditionalMemorySectionRef=Spi/CONST_UNSPECIFIED, MemMapAdditionalMemorySectionRef=Eth/CONST_UNSPECIFIED
          AdditionalMcalVarInit: MemMapAddressingModeSetRef=MSR_MCAL_VAR_INIT, MemMapAdditionalMemorySectionRef=Mcu/VAR_INIT_8BIT, MemMapAdditionalMemorySectionRef=Mcu/VAR_INIT_16BIT, MemMapAdditionalMemorySectionRef=Adc/VAR_INIT_8BIT, MemMapAdditionalMemorySectionRef=Adc/VAR_INIT_16BIT, MemMapAdditionalMemorySectionRef=Port/VAR_INIT_8BIT, MemMapAdditionalMemorySectionRef=Port/VAR_INIT_16BIT, MemMapAdditionalMemorySectionRef=Adc/VAR_INIT_UNSPECIFIED, MemMapAdditionalMemorySectionRef=Can/VAR_INIT_UNSPECIFIED, MemMapAdditionalMemorySectionRef=Port/VAR_INIT_UNSPECIFIED, MemMapAdditionalMemorySectionRef=Dio/VAR_INIT_8BIT, MemMapAdditionalMemorySectionRef=Dio/VAR_INIT_16BIT, MemMapAdditionalMemorySectionRef=Dio/VAR_INIT_UNSPECIFIED, MemMapAdditionalMemorySectionRef=Dma/VAR_INIT_8BIT, MemMapAdditionalMemorySectionRef=Dma/VAR_INIT_16BIT, MemMapAdditionalMemorySectionRef=Dma/VAR_INIT_UNSPECIFIED, MemMapAdditionalMemorySectionRef=Fls/VAR_INIT_8BIT, MemMapAdditionalMemorySectionRef=Fls/VAR_INIT_16BIT, MemMapAdditionalMemorySectionRef=Fls/VAR_INIT_UNSPECIFIED, MemMapAdditionalMemorySectionRef=Gpt/VAR_INIT_8BIT, MemMapAdditionalMemorySectionRef=Gpt/VAR_INIT_16BIT, MemMapAdditionalMemorySectionRef=Gpt/VAR_INIT_UNSPECIFIED, MemMapAdditionalMemorySectionRef=I2c/VAR_INIT_8BIT, MemMapAdditionalMemorySectionRef=I2c/VAR_INIT_16BIT, MemMapAdditionalMemorySectionRef=I2c/VAR_INIT_UNSPECIFIED, MemMapAdditionalMemorySectionRef=Pwm/VAR_INIT_8BIT, MemMapAdditionalMemorySectionRef=Pwm/VAR_INIT_16BIT, MemMapAdditionalMemorySectionRef=Pwm/VAR_INIT_UNSPECIFIED, MemMapAdditionalMemorySectionRef=Fls/VAR_INIT_32BIT, MemMapAdditionalMemorySectionRef=Spi/VAR_INIT_8BIT, MemMapAdditionalMemorySectionRef=Spi/VAR_INIT_16BIT, MemMapAdditionalMemorySectionRef=Spi/VAR_INIT_UNSPECIFIED, MemMapAdditionalMemorySectionRef=Eth/VAR_INIT_UNSPECIFIED, MemMapAdditionalMemorySectionRef=Gpt/VAR_INIT_32BIT
      MSR_Generic
        8 x MemMapGenericMapping:
          MSR_PBCFG_CONST: MemMapAddressingModeSetRef=VTTMemMap/MSR_PBCFG_CONST, MemMapSwAddressMethodRef=CONST_PBCFG, MemMapSwAddressMethodRef=PBCFG_GLOBALROOT, MemMapSwAddressMethodRef=CONFIG_DATA_POSTBUILD, MemMapSwAddressMethodRef=CONFIG_DATA_PREBUILD_ASIL_D
          MSR_CODE: MemMapAddressingModeSetRef=VTTMemMap/MSR_CODE, MemMapSwAddressMethodRef=CODE, MemMapSwAddressMethodRef=CALLOUT_CODE, MemMapSwAddressMethodRef=CODE_FAST, MemMapSwAddressMethodRef=CODE_ISR, MemMapSwAddressMethodRef=CALLOUT_CODE_ASIL_D, MemMapSwAddressMethodRef=CODE_ASIL_B, MemMapSwAddressMethodRef=CODE_ASIL_D, MemMapSwAddressMethodRef=CODE_QM
          MSR_PBCFG_VAR: MemMapAddressingModeSetRef=VTTMemMap/MSR_PBCFG_VAR, MemMapSwAddressMethodRef=VAR_PBCFG
          MSR_VAR_SAVED_ZONE: MemMapAddressingModeSetRef=VTTMemMap/MSR_VAR_SAVED_ZONE, MemMapSwAddressMethodRef=VAR_SAVED_ZONE_BOOLEAN, MemMapSwAddressMethodRef=VAR_SAVED_ZONE_8, MemMapSwAddressMethodRef=VAR_SAVED_ZONE_16, MemMapSwAddressMethodRef=VAR_SAVED_ZONE_32, MemMapSwAddressMethodRef=VAR_SAVED_ZONE_64, MemMapSwAddressMethodRef=VAR_SAVED_ZONE_UNSPECIFIED, MemMapSwAddressMethodRef=VAR_SAVED_ZONE, MemMapSwAddressMethodRef=VAR_SAVED_ZONE_QM, MemMapSwAddressMethodRef=VAR_SAVED_ZONE_ASIL_D
          MSR_CONST: MemMapAddressingModeSetRef=VTTMemMap/MSR_CONST, MemMapSwAddressMethodRef=CONST_8, MemMapSwAddressMethodRef=CONST_16, MemMapSwAddressMethodRef=CONST_32, MemMapSwAddressMethodRef=CONST_64, MemMapSwAddressMethodRef=CONST_BOOLEAN, MemMapSwAddressMethodRef=CONST_FAST_8, MemMapSwAddressMethodRef=CONST_FAST_16, MemMapSwAddressMethodRef=CONST_FAST_32, MemMapSwAddressMethodRef=CONST_FAST_64, MemMapSwAddressMethodRef=CONST_FAST_BOOLEAN, MemMapSwAddressMethodRef=CONST_FAST_UNSPECIFIED, MemMapSwAddressMethodRef=CONST_UNSPECIFIED, MemMapSwAddressMethodRef=CONFIG_DATA, MemMapSwAddressMethodRef=CONST, MemMapSwAddressMethodRef=CONST_FAST, MemMapSwAddressMethodRef=CONST_ASIL_D, MemMapSwAddressMethodRef=CONST_ASIL_C, MemMapSwAddressMethodRef=CONST_ASIL_B, MemMapSwAddressMethodRef=CONST_ASIL_A, MemMapSwAddressMethodRef=CONST_QM, MemMapSwAddressMethodRef=CONFIG_DATA_PREBUILD_QM
          MSR_VAR_CLEARED: MemMapAddressingModeSetRef=VTTMemMap/MSR_VAR_CLEARED, MemMapSwAddressMethodRef=VAR_ZERO_INIT_8, MemMapSwAddressMethodRef=VAR_ZERO_INIT_16, MemMapSwAddressMethodRef=VAR_ZERO_INIT_32, MemMapSwAddressMethodRef=VAR_ZERO_INIT_64, MemMapSwAddressMethodRef=VAR_ZERO_INIT_UNSPECIFIED, MemMapSwAddressMethodRef=VAR_ZERO_INIT_BOOLEAN, MemMapSwAddressMethodRef=VAR_FAST_ZERO_INIT_8, MemMapSwAddressMethodRef=VAR_FAST_ZERO_INIT_16, MemMapSwAddressMethodRef=VAR_FAST_ZERO_INIT_32, MemMapSwAddressMethodRef=VAR_FAST_ZERO_INIT_64, MemMapSwAddressMethodRef=VAR_FAST_ZERO_INIT_BOOLEAN, MemMapSwAddressMethodRef=VAR_FAST_ZERO_INIT_UNSPECIFIED, MemMapSwAddressMethodRef=VAR_NOCACHE_ZERO_INIT_8, MemMapSwAddressMethodRef=VAR_NOCACHE_ZERO_INIT_16, MemMapSwAddressMethodRef=VAR_NOCACHE_ZERO_INIT_32, MemMapSwAddressMethodRef=VAR_NOCACHE_ZERO_INIT_64, MemMapSwAddressMethodRef=VAR_NOCACHE_ZERO_INIT_BOOLEAN, MemMapSwAddressMethodRef=VAR_NOCACHE_ZERO_INIT_UNSPECIFIED, MemMapSwAddressMethodRef=VAR_CLEARED_BOOLEAN, MemMapSwAddressMethodRef=VAR_CLEARED_8, MemMapSwAddressMethodRef=VAR_CLEARED_16, MemMapSwAddressMethodRef=VAR_CLEARED_32, MemMapSwAddressMethodRef=VAR_CLEARED_64, MemMapSwAddressMethodRef=VAR_CLEARED_UNSPECIFIED, MemMapSwAddressMethodRef=VAR_FAST_CLEARED_BOOLEAN, MemMapSwAddressMethodRef=VAR_FAST_CLEARED_8, MemMapSwAddressMethodRef=VAR_FAST_CLEARED_16, MemMapSwAddressMethodRef=VAR_FAST_CLEARED_32, MemMapSwAddressMethodRef=VAR_FAST_CLEARED_64, MemMapSwAddressMethodRef=VAR_FAST_CLEARED_UNSPECIFIED, MemMapSwAddressMethodRef=VAR_NOCACHE_CLEARED_BOOLEAN, MemMapSwAddressMethodRef=VAR_NOCACHE_CLEARED_8, MemMapSwAddressMethodRef=VAR_NOCACHE_CLEARED_16, MemMapSwAddressMethodRef=VAR_NOCACHE_CLEARED_32, MemMapSwAddressMethodRef=VAR_NOCACHE_CLEARED_64, MemMapSwAddressMethodRef=VAR_NOCACHE_CLEARED_UNSPECIFIED, MemMapSwAddressMethodRef=VAR_CLEARED, MemMapSwAddressMethodRef=VAR_FAST_CLEARED, MemMapSwAddressMethodRef=VAR_NOCACHE_CLEARED, MemMapSwAddressMethodRef=VAR_ZERO_INIT, MemMapSwAddressMethodRef=VAR_CLEARED_ASIL_D, MemMapSwAddressMethodRef=VAR_FAST_CLEARED_ASIL_D, MemMapSwAddressMethodRef=VAR_SLOW_CLEARED_ASIL_D, MemMapSwAddressMethodRef=VAR_FAST_CLEARED_QM, MemMapSwAddressMethodRef=VAR_SLOW_CLEARED_QM
          MSR_VAR_INIT: MemMapAddressingModeSetRef=VTTMemMap/MSR_VAR_INIT, MemMapSwAddressMethodRef=VAR_INIT_8, MemMapSwAddressMethodRef=VAR_INIT_16, MemMapSwAddressMethodRef=VAR_INIT_32, MemMapSwAddressMethodRef=VAR_INIT_64, MemMapSwAddressMethodRef=VAR_INIT_BOOLEAN, MemMapSwAddressMethodRef=VAR_INIT_UNSPECIFIED, MemMapSwAddressMethodRef=VAR_NOCACHE_INIT_8, MemMapSwAddressMethodRef=VAR_NOCACHE_INIT_16, MemMapSwAddressMethodRef=VAR_NOCACHE_INIT_32, MemMapSwAddressMethodRef=VAR_NOCACHE_INIT_64, MemMapSwAddressMethodRef=VAR_NOCACHE_INIT_BOOLEAN, MemMapSwAddressMethodRef=VAR_NOCACHE_INIT_UNSPECIFIED, MemMapSwAddressMethodRef=VAR_INIT, MemMapSwAddressMethodRef=VAR_NOCACHE_INIT, MemMapSwAddressMethodRef=VAR_POWER_ON_CLEARED, MemMapSwAddressMethodRef=VAR_INIT_ASIL_D, MemMapSwAddressMethodRef=VAR_SLOW_INIT_ASIL_D, MemMapSwAddressMethodRef=VAR_FAST_INIT, MemMapSwAddressMethodRef=VAR_FAST_INIT_8, MemMapSwAddressMethodRef=VAR_FAST_INIT_16, MemMapSwAddressMethodRef=VAR_FAST_INIT_32, MemMapSwAddressMethodRef=VAR_FAST_INIT_64, MemMapSwAddressMethodRef=VAR_FAST_INIT_ASIL_A, MemMapSwAddressMethodRef=VAR_FAST_INIT_ASIL_B, MemMapSwAddressMethodRef=VAR_FAST_INIT_ASIL_C, MemMapSwAddressMethodRef=VAR_FAST_INIT_ASIL_D, MemMapSwAddressMethodRef=VAR_FAST_INIT_BOOLEAN, MemMapSwAddressMethodRef=VAR_FAST_INIT_QM, MemMapSwAddressMethodRef=VAR_FAST_INIT_UNSPECIFIED, MemMapSwAddressMethodRef=VAR_INIT_QM, MemMapSwAddressMethodRef=VAR_SLOW_INIT_QM
          MSR_VAR_NO_INIT: MemMapAddressingModeSetRef=VTTMemMap/MSR_VAR_NO_INIT, MemMapSwAddressMethodRef=VAR_FAST_NO_INIT_8, MemMapSwAddressMethodRef=VAR_FAST_NO_INIT_16, MemMapSwAddressMethodRef=VAR_FAST_NO_INIT_32, MemMapSwAddressMethodRef=VAR_FAST_NO_INIT_64, MemMapSwAddressMethodRef=VAR_FAST_NO_INIT_UNSPECIFIED, MemMapSwAddressMethodRef=VAR_NO_INIT_8, MemMapSwAddressMethodRef=VAR_NO_INIT_16, MemMapSwAddressMethodRef=VAR_NO_INIT_32, MemMapSwAddressMethodRef=VAR_NO_INIT_64, MemMapSwAddressMethodRef=VAR_NO_INIT_UNSPECIFIED, MemMapSwAddressMethodRef=VAR_NO_INIT_BOOLEAN, MemMapSwAddressMethodRef=VAR_FAST_NO_INIT_BOOLEAN, MemMapSwAddressMethodRef=VAR_NOCACHE_NO_INIT_8, MemMapSwAddressMethodRef=VAR_NOCACHE_NO_INIT_16, MemMapSwAddressMethodRef=VAR_NOCACHE_NO_INIT_32, MemMapSwAddressMethodRef=VAR_NOCACHE_NO_INIT_64, MemMapSwAddressMethodRef=VAR_NOCACHE_NO_INIT_BOOLEAN, MemMapSwAddressMethodRef=VAR_NOCACHE_NO_INIT_UNSPECIFIED, MemMapSwAddressMethodRef=VAR_FAST_NOINIT_8, MemMapSwAddressMethodRef=VAR_FAST_NOINIT_16, MemMapSwAddressMethodRef=VAR_FAST_NOINIT_32, MemMapSwAddressMethodRef=VAR_FAST_NOINIT_64, MemMapSwAddressMethodRef=VAR_FAST_NOINIT_UNSPECIFIED, MemMapSwAddressMethodRef=VAR_NOINIT_8, MemMapSwAddressMethodRef=VAR_NOINIT_16, MemMapSwAddressMethodRef=VAR_NOINIT_32, MemMapSwAddressMethodRef=VAR_NOINIT_64, MemMapSwAddressMethodRef=VAR_NOINIT_UNSPECIFIED, MemMapSwAddressMethodRef=VAR_NOINIT_BOOLEAN, MemMapSwAddressMethodRef=VAR_FAST_NOINIT_BOOLEAN, MemMapSwAddressMethodRef=VAR_NOCACHE_NOINIT_8, MemMapSwAddressMethodRef=VAR_NOCACHE_NOINIT_16, MemMapSwAddressMethodRef=VAR_NOCACHE_NOINIT_32, MemMapSwAddressMethodRef=VAR_NOCACHE_NOINIT_64, MemMapSwAddressMethodRef=VAR_NOCACHE_NOINIT_BOOLEAN, MemMapSwAddressMethodRef=VAR_NOCACHE_NOINIT_UNSPECIFIED, MemMapSwAddressMethodRef=VAR_NO_INIT, MemMapSwAddressMethodRef=VAR_FAST_NO_INIT, MemMapSwAddressMethodRef=VAR_NOCACHE_NO_INIT, MemMapSwAddressMethodRef=INTERNAL_VAR_CLEARED_QM, MemMapSwAddressMethodRef=VAR_CLEARED_ASIL_A, MemMapSwAddressMethodRef=VAR_CLEARED_ASIL_B, MemMapSwAddressMethodRef=VAR_CLEARED_ASIL_C, MemMapSwAddressMethodRef=VAR_CLEARED_QM
      QM_Generic
        4 x MemMapSectionSpecificMapping:
          VAR_OsCore0_Qm_INIT_UNSPECIFIED: MemMapAddressingModeSetRef=VTTMemMap/OS_OsCore_Qm_VAR_INIT, MemMapMemorySectionRef=VAR_INIT_UNSPECIFIED, MemMapMemorySectionRef=VAR_INIT_UNSPECIFIED
          VAR_OsCore0_Qm_ZERO_INIT_UNSPECIFIED: MemMapAddressingModeSetRef=VTTMemMap/OS_OsCore_Qm_VAR_ZERO_INIT, MemMapMemorySectionRef=VAR_ZERO_INIT_UNSPECIFIED, MemMapMemorySectionRef=VAR_ZERO_INIT_UNSPECIFIED
          VAR_OsCore0_Qm_VAR_SAVED_ZONE: MemMapAddressingModeSetRef=VTTMemMap/OS_OsCore_Qm_VAR_SAVED_ZONE, MemMapMemorySectionRef=VAR_SAVED_ZONE, MemMapMemorySectionRef=VAR_SAVED_ZONE
          VAR_OsCore_Qm_NOINIT_UNSPECIFIED: MemMapAddressingModeSetRef=VTTMemMap/OS_OsCore_Qm_VAR_NOINIT, MemMapMemorySectionRef=VAR_NOINIT_UNSPECIFIED, MemMapMemorySectionRef=VAR_NOINIT_UNSPECIFIED
      OS_Generic
        59 x MemMapGenericMapping:
          OS_GLOBALSHARED_VAR_NOINIT: MemMapAddressingModeSetRef=VTTMemMap/OS_GLOBALSHARED_VAR_NOINIT, MemMapSwAddressMethodRef=GLOBALSHARED_VAR_NO_INIT, MemMapSwAddressMethodRef=GLOBALSHARED_VAR_FAST_NO_INIT, MemMapSwAddressMethodRef=GLOBALSHARED_VAR_NOCACHE_NO_INIT
          OS_OsCore0_ASIL_VAR_POWER_ON_INIT: MemMapAddressingModeSetRef=VTTMemMap/OS_OsCore0_ASIL_VAR_POWER_ON_INIT, MemMapSwAddressMethodRef=OsCore0_ASIL_VAR_POWER_ON_INIT, MemMapSwAddressMethodRef=OsCore0_ASIL_VAR_FAST_POWER_ON_INIT, MemMapSwAddressMethodRef=OsCore0_ASIL_VAR_NOCACHE_POWER_ON_INIT, MemMapSwAddressMethodRef=OsCore0_ASIL_VAR_SLOW_POWER_ON_INIT
          OS_STACK_OsCore0_Task_Prio200_VAR_CLEARED: MemMapAddressingModeSetRef=VTTMemMap/OS_STACK_OsCore0_Task_Prio200_VAR_CLEARED, MemMapSwAddressMethodRef=STACK_OsCore0_Task_Prio200_VAR_CLEARED
          OS_SystemApplication_OsCore0_VAR_CLEARED: MemMapAddressingModeSetRef=VTTMemMap/OS_SystemApplication_OsCore0_VAR_CLEARED, MemMapSwAddressMethodRef=SystemApplication_OsCore0_VAR_SLOW_CLEARED, MemMapSwAddressMethodRef=SystemApplication_OsCore0_VAR_SLOW_NO_INIT, MemMapSwAddressMethodRef=SystemApplication_OsCore0_VAR_NOINIT, MemMapSwAddressMethodRef=SystemApplication_OsCore0_VAR_FAST_NOINIT, MemMapSwAddressMethodRef=SystemApplication_OsCore0_VAR_NOCACHE_NOINIT, MemMapSwAddressMethodRef=SystemApplication_OsCore0_VAR_SLOW_NOINIT
          OS_STACK_OsCore0_Task_Prio210_VAR_CLEARED: MemMapAddressingModeSetRef=VTTMemMap/OS_STACK_OsCore0_Task_Prio210_VAR_CLEARED, MemMapSwAddressMethodRef=STACK_OsCore0_Task_Prio210_VAR_CLEARED
          OS_INTVEC_CONST: MemMapAddressingModeSetRef=VTTMemMap/OS_INTVEC_CONST, MemMapSwAddressMethodRef=INTVEC_CONST
          OS_EXCVEC_OsCore0_CONST: MemMapAddressingModeSetRef=VTTMemMap/OS_EXCVEC_OsCore0_CONST, MemMapSwAddressMethodRef=EXCVEC_OsCore0_CONST
          OS_STACK_Appl_Task_Logging_VAR_CLEARED: MemMapAddressingModeSetRef=VTTMemMap/OS_STACK_Appl_Task_Logging_VAR_CLEARED, MemMapSwAddressMethodRef=STACK_Appl_Task_Logging_VAR_CLEARED
          OS_GLOBALSHARED_VAR_ZERO_INIT: MemMapAddressingModeSetRef=VTTMemMap/OS_GLOBALSHARED_VAR_ZERO_INIT, MemMapSwAddressMethodRef=GLOBALSHARED_VAR_CLEARED, MemMapSwAddressMethodRef=GLOBALSHARED_VAR_FAST_CLEARED, MemMapSwAddressMethodRef=GLOBALSHARED_VAR_NOCACHE_CLEARED
          OS_OsCore0_ASIL_VAR_NOINIT: MemMapAddressingModeSetRef=VTTMemMap/OS_OsCore0_ASIL_VAR_NOINIT, MemMapSwAddressMethodRef=OsCore0_ASIL_VAR_NO_INIT, MemMapSwAddressMethodRef=OsCore0_ASIL_VAR_FAST_NO_INIT, MemMapSwAddressMethodRef=OsCore0_ASIL_VAR_NOCACHE_NO_INIT
          OS_SystemApplication_OsCore0_VAR_NOINIT: MemMapAddressingModeSetRef=VTTMemMap/OS_SystemApplication_OsCore0_VAR_NOINIT, MemMapSwAddressMethodRef=SystemApplication_OsCore0_VAR_NO_INIT, MemMapSwAddressMethodRef=SystemApplication_OsCore0_VAR_FAST_NO_INIT, MemMapSwAddressMethodRef=SystemApplication_OsCore0_VAR_NOCACHE_NO_INIT
          OS_OsCore_Qm_VAR_CLEARED: MemMapAddressingModeSetRef=VTTMemMap/OS_OsCore_Qm_VAR_CLEARED, MemMapSwAddressMethodRef=OsCore_Qm_VAR_SLOW_CLEARED, MemMapSwAddressMethodRef=OsCore_Qm_VAR_SLOW_NO_INIT, MemMapSwAddressMethodRef=OsCore_Qm_VAR_NOINIT, MemMapSwAddressMethodRef=OsCore_Qm_VAR_FAST_NOINIT, MemMapSwAddressMethodRef=OsCore_Qm_VAR_NOCACHE_NOINIT, MemMapSwAddressMethodRef=OsCore_Qm_VAR_SLOW_NOINIT
          OS_STACK_Appl_Task_VAR_CLEARED: MemMapAddressingModeSetRef=VTTMemMap/OS_STACK_Appl_Task_VAR_CLEARED, MemMapSwAddressMethodRef=STACK_Appl_Task_VAR_CLEARED
          OS_EXCVEC_OsCore0_CODE: MemMapAddressingModeSetRef=VTTMemMap/OS_EXCVEC_OsCore0_CODE, MemMapSwAddressMethodRef=EXCVEC_OsCore0_CODE
          OS_STACK_Appl_Task_High_Prio_VAR_CLEARED: MemMapAddressingModeSetRef=VTTMemMap/OS_STACK_Appl_Task_High_Prio_VAR_CLEARED, MemMapSwAddressMethodRef=STACK_Appl_Task_High_Prio_VAR_CLEARED
          OS_SystemApplication_OsCore0_CONST: MemMapAddressingModeSetRef=VTTMemMap/MSR_CONST, MemMapSwAddressMethodRef=SystemApplication_OsCore0_CONST, MemMapSwAddressMethodRef=SystemApplication_OsCore0_CONST_FAST, MemMapSwAddressMethodRef=SystemApplication_OsCore0_CONFIG_DATA_PREBUILD, MemMapSwAddressMethodRef=SystemApplication_OsCore0_CONFIG_DATA_POSTBUILD
          OS_OsCore_Qm_VAR_ZERO_INIT: MemMapAddressingModeSetRef=VTTMemMap/OS_OsCore_Qm_VAR_ZERO_INIT, MemMapSwAddressMethodRef=OsCore_Qm_VAR_CLEARED, MemMapSwAddressMethodRef=OsCore_Qm_VAR_FAST_CLEARED, MemMapSwAddressMethodRef=OsCore_Qm_VAR_NOCACHE_CLEARED
          OS_STACK_OsCore0_Shutdown_VAR_CLEARED: MemMapAddressingModeSetRef=VTTMemMap/OS_STACK_OsCore0_Shutdown_VAR_CLEARED, MemMapSwAddressMethodRef=STACK_OsCore0_Shutdown_VAR_CLEARED
          OS_CODE: MemMapAddressingModeSetRef=VTTMemMap/OS_CODE, MemMapSwAddressMethodRef=OS_CODE
          OS_INTVEC_OsCore0_CODE: MemMapAddressingModeSetRef=VTTMemMap/OS_INTVEC_OsCore0_CODE, MemMapSwAddressMethodRef=INTVEC_OsCore0_CODE
          OS_GLOBALSHARED_VAR_POWER_ON_INIT: MemMapAddressingModeSetRef=VTTMemMap/OS_GLOBALSHARED_VAR_POWER_ON_INIT, MemMapSwAddressMethodRef=GLOBALSHARED_VAR_POWER_ON_INIT, MemMapSwAddressMethodRef=GLOBALSHARED_VAR_FAST_POWER_ON_INIT, MemMapSwAddressMethodRef=GLOBALSHARED_VAR_NOCACHE_POWER_ON_INIT, MemMapSwAddressMethodRef=GLOBALSHARED_VAR_SLOW_POWER_ON_INIT
          OS_OsCore_Qm_CONST: MemMapAddressingModeSetRef=VTTMemMap/MSR_CONST, MemMapSwAddressMethodRef=OsCore_Qm_CONST, MemMapSwAddressMethodRef=OsCore_Qm_CONST_FAST, MemMapSwAddressMethodRef=OsCore_Qm_CONFIG_DATA_PREBUILD, MemMapSwAddressMethodRef=OsCore_Qm_CONFIG_DATA_POSTBUILD
          OS_GLOBALSHARED_VAR_CLEARED: MemMapAddressingModeSetRef=VTTMemMap/OS_GLOBALSHARED_VAR_CLEARED, MemMapSwAddressMethodRef=GLOBALSHARED_VAR_SLOW_CLEARED, MemMapSwAddressMethodRef=GLOBALSHARED_VAR_SLOW_NO_INIT, MemMapSwAddressMethodRef=GLOBALSHARED_VAR_NOINIT, MemMapSwAddressMethodRef=GLOBALSHARED_VAR_FAST_NOINIT, MemMapSwAddressMethodRef=GLOBALSHARED_VAR_NOCACHE_NOINIT, MemMapSwAddressMethodRef=GLOBALSHARED_VAR_SLOW_NOINIT
          OS_STACK_Appl_Task_Fast_VAR_CLEARED: MemMapAddressingModeSetRef=VTTMemMap/OS_STACK_Appl_Task_Fast_VAR_CLEARED, MemMapSwAddressMethodRef=STACK_Appl_Task_Fast_VAR_CLEARED
          OS_OsCore0_ASIL_VAR_INIT: MemMapAddressingModeSetRef=VTTMemMap/OS_OsCore0_ASIL_VAR_INIT, MemMapSwAddressMethodRef=OsCore0_ASIL_VAR_INIT, MemMapSwAddressMethodRef=OsCore0_ASIL_VAR_FAST_INIT, MemMapSwAddressMethodRef=OsCore0_ASIL_VAR_NOCACHE_INIT, MemMapSwAddressMethodRef=OsCore0_ASIL_VAR_SLOW_INIT
          OS_OsCore0_ASIL_VAR_POWER_ON_CLEARED: MemMapAddressingModeSetRef=VTTMemMap/OS_OsCore0_ASIL_VAR_POWER_ON_CLEARED, MemMapSwAddressMethodRef=OsCore0_ASIL_VAR_POWER_ON_CLEARED, MemMapSwAddressMethodRef=OsCore0_ASIL_VAR_FAST_POWER_ON_CLEARED, MemMapSwAddressMethodRef=OsCore0_ASIL_VAR_NOCACHE_POWER_ON_CLEARED, MemMapSwAddressMethodRef=OsCore0_ASIL_VAR_SLOW_POWER_ON_CLEARED
          OS_STACK_Appl_Task_Communication_VAR_CLEARED: MemMapAddressingModeSetRef=VTTMemMap/OS_STACK_Appl_Task_Communication_VAR_CLEARED, MemMapSwAddressMethodRef=STACK_Appl_Task_Communication_VAR_CLEARED
          OS_OsCore_Qm_VAR_NOINIT: MemMapAddressingModeSetRef=VTTMemMap/OS_OsCore_Qm_VAR_NOINIT, MemMapSwAddressMethodRef=OsCore_Qm_VAR_NO_INIT, MemMapSwAddressMethodRef=OsCore_Qm_VAR_FAST_NO_INIT, MemMapSwAddressMethodRef=OsCore_Qm_VAR_NOCACHE_NO_INIT
          OS_OsCore0_ASIL_VAR_CLEARED: MemMapAddressingModeSetRef=VTTMemMap/OS_OsCore0_ASIL_VAR_CLEARED, MemMapSwAddressMethodRef=OsCore0_ASIL_VAR_SLOW_CLEARED, MemMapSwAddressMethodRef=OsCore0_ASIL_VAR_SLOW_NO_INIT, MemMapSwAddressMethodRef=OsCore0_ASIL_VAR_NOINIT, MemMapSwAddressMethodRef=OsCore0_ASIL_VAR_FAST_NOINIT, MemMapSwAddressMethodRef=OsCore0_ASIL_VAR_NOCACHE_NOINIT, MemMapSwAddressMethodRef=OsCore0_ASIL_VAR_SLOW_NOINIT
          OS_STACK_OsCore0_Init_VAR_CLEARED: MemMapAddressingModeSetRef=VTTMemMap/OS_STACK_OsCore0_Init_VAR_CLEARED, MemMapSwAddressMethodRef=STACK_OsCore0_Init_VAR_CLEARED
          OS_STACK_OsCore0_Isr_Core_VAR_CLEARED: MemMapAddressingModeSetRef=VTTMemMap/OS_STACK_OsCore0_Isr_Core_VAR_CLEARED, MemMapSwAddressMethodRef=STACK_OsCore0_Isr_Core_VAR_CLEARED
          OS_INTVEC_OsCore0_CONST: MemMapAddressingModeSetRef=VTTMemMap/OS_INTVEC_OsCore0_CONST, MemMapSwAddressMethodRef=INTVEC_OsCore0_CONST
          OS_OsCore0_ASIL_CONST: MemMapAddressingModeSetRef=VTTMemMap/MSR_CONST, MemMapSwAddressMethodRef=OsCore0_ASIL_CONST, MemMapSwAddressMethodRef=OsCore0_ASIL_CONST_FAST, MemMapSwAddressMethodRef=OsCore0_ASIL_CONFIG_DATA_PREBUILD, MemMapSwAddressMethodRef=OsCore0_ASIL_CONFIG_DATA_POSTBUILD
          OS_SystemApplication_OsCore0_VAR_POWER_ON_CLEARED: MemMapAddressingModeSetRef=VTTMemMap/OS_SystemApplication_OsCore0_VAR_POWER_ON_CLEARED, MemMapSwAddressMethodRef=SystemApplication_OsCore0_VAR_POWER_ON_CLEARED, MemMapSwAddressMethodRef=SystemApplication_OsCore0_VAR_FAST_POWER_ON_CLEARED, MemMapSwAddressMethodRef=SystemApplication_OsCore0_VAR_NOCACHE_POWER_ON_CLEARED, MemMapSwAddressMethodRef=SystemApplication_OsCore0_VAR_SLOW_POWER_ON_CLEARED
          OS_OsCore0_ASIL_VAR_SAVED_ZONE: MemMapAddressingModeSetRef=VTTMemMap/OS_OsCore0_ASIL_VAR_SAVED_ZONE, MemMapSwAddressMethodRef=OsCore0_ASIL_VAR_SAVED_ZONE
          OS_GLOBALSHARED_CONST: MemMapAddressingModeSetRef=VTTMemMap/MSR_CONST, MemMapSwAddressMethodRef=GLOBALSHARED_CONST, MemMapSwAddressMethodRef=GLOBALSHARED_CONST_FAST, MemMapSwAddressMethodRef=GLOBALSHARED_CONFIG_DATA_PREBUILD, MemMapSwAddressMethodRef=GLOBALSHARED_CONFIG_DATA_POSTBUILD
          OS_OsCore_Qm_VAR_POWER_ON_CLEARED: MemMapAddressingModeSetRef=VTTMemMap/OS_OsCore_Qm_VAR_POWER_ON_CLEARED, MemMapSwAddressMethodRef=OsCore_Qm_VAR_POWER_ON_CLEARED, MemMapSwAddressMethodRef=OsCore_Qm_VAR_FAST_POWER_ON_CLEARED, MemMapSwAddressMethodRef=OsCore_Qm_VAR_NOCACHE_POWER_ON_CLEARED, MemMapSwAddressMethodRef=OsCore_Qm_VAR_SLOW_POWER_ON_CLEARED
          OS_STACK_OsCore0_Error_VAR_CLEARED: MemMapAddressingModeSetRef=VTTMemMap/OS_STACK_OsCore0_Error_VAR_CLEARED, MemMapSwAddressMethodRef=STACK_OsCore0_Error_VAR_CLEARED
          OS_GLOBALSHARED_VAR_SAVED_ZONE: MemMapAddressingModeSetRef=VTTMemMap/OS_GLOBALSHARED_VAR_SAVED_ZONE, MemMapSwAddressMethodRef=GLOBALSHARED_VAR_SAVED_ZONE
          OS_SystemApplication_OsCore0_VAR_POWER_ON_INIT: MemMapAddressingModeSetRef=VTTMemMap/OS_SystemApplication_OsCore0_VAR_POWER_ON_INIT, MemMapSwAddressMethodRef=SystemApplication_OsCore0_VAR_POWER_ON_INIT, MemMapSwAddressMethodRef=SystemApplication_OsCore0_VAR_FAST_POWER_ON_INIT, MemMapSwAddressMethodRef=SystemApplication_OsCore0_VAR_NOCACHE_POWER_ON_INIT, MemMapSwAddressMethodRef=SystemApplication_OsCore0_VAR_SLOW_POWER_ON_INIT
          OS_GLOBALSHARED_VAR_POWER_ON_CLEARED: MemMapAddressingModeSetRef=VTTMemMap/OS_GLOBALSHARED_VAR_POWER_ON_CLEARED, MemMapSwAddressMethodRef=GLOBALSHARED_VAR_POWER_ON_CLEARED, MemMapSwAddressMethodRef=GLOBALSHARED_VAR_FAST_POWER_ON_CLEARED, MemMapSwAddressMethodRef=GLOBALSHARED_VAR_NOCACHE_POWER_ON_CLEARED, MemMapSwAddressMethodRef=GLOBALSHARED_VAR_SLOW_POWER_ON_CLEARED
          OS_STACK_OsCore0_Task_Prio4294967295_VAR_CLEARED: MemMapAddressingModeSetRef=VTTMemMap/OS_STACK_OsCore0_Task_Prio4294967295_VAR_CLEARED, MemMapSwAddressMethodRef=STACK_OsCore0_Task_Prio4294967295_VAR_CLEARED
          OS_STACK_OsCore0_Task_Prio190_VAR_CLEARED: MemMapAddressingModeSetRef=VTTMemMap/OS_STACK_OsCore0_Task_Prio190_VAR_CLEARED, MemMapSwAddressMethodRef=STACK_OsCore0_Task_Prio190_VAR_CLEARED
          OS_OsCore_Qm_VAR_INIT: MemMapAddressingModeSetRef=VTTMemMap/OS_OsCore_Qm_VAR_INIT, MemMapSwAddressMethodRef=OsCore_Qm_VAR_INIT, MemMapSwAddressMethodRef=OsCore_Qm_VAR_FAST_INIT, MemMapSwAddressMethodRef=OsCore_Qm_VAR_NOCACHE_INIT, MemMapSwAddressMethodRef=OsCore_Qm_VAR_SLOW_INIT
          OS_STACK_Radar_Ctrl_Task_VAR_CLEARED: MemMapAddressingModeSetRef=VTTMemMap/OS_STACK_Radar_Ctrl_Task_VAR_CLEARED, MemMapSwAddressMethodRef=STACK_Radar_Ctrl_Task_VAR_CLEARED
          OS_SystemApplication_OsCore0_VAR_INIT: MemMapAddressingModeSetRef=VTTMemMap/OS_SystemApplication_OsCore0_VAR_INIT, MemMapSwAddressMethodRef=SystemApplication_OsCore0_VAR_INIT, MemMapSwAddressMethodRef=SystemApplication_OsCore0_VAR_FAST_INIT, MemMapSwAddressMethodRef=SystemApplication_OsCore0_VAR_NOCACHE_INIT, MemMapSwAddressMethodRef=SystemApplication_OsCore0_VAR_SLOW_INIT
          OS_GLOBALSHARED_VAR_INIT: MemMapAddressingModeSetRef=VTTMemMap/OS_GLOBALSHARED_VAR_INIT, MemMapSwAddressMethodRef=GLOBALSHARED_VAR_INIT, MemMapSwAddressMethodRef=GLOBALSHARED_VAR_FAST_INIT, MemMapSwAddressMethodRef=GLOBALSHARED_VAR_NOCACHE_INIT, MemMapSwAddressMethodRef=GLOBALSHARED_VAR_SLOW_INIT
          OS_STACK_BSW_Task_VAR_CLEARED: MemMapAddressingModeSetRef=VTTMemMap/OS_STACK_BSW_Task_VAR_CLEARED, MemMapSwAddressMethodRef=STACK_BSW_Task_VAR_CLEARED
          OS_OsCore_Qm_VAR_SAVED_ZONE: MemMapAddressingModeSetRef=VTTMemMap/OS_OsCore_Qm_VAR_SAVED_ZONE, MemMapSwAddressMethodRef=OsCore_Qm_VAR_SAVED_ZONE
          OS_STACK_OsCore0_Kernel_VAR_CLEARED: MemMapAddressingModeSetRef=VTTMemMap/OS_STACK_OsCore0_Kernel_VAR_CLEARED, MemMapSwAddressMethodRef=STACK_OsCore0_Kernel_VAR_CLEARED
          OS_OsCore0_ASIL_VAR_ZERO_INIT: MemMapAddressingModeSetRef=VTTMemMap/OS_OsCore0_ASIL_VAR_ZERO_INIT, MemMapSwAddressMethodRef=OsCore0_ASIL_VAR_CLEARED, MemMapSwAddressMethodRef=OsCore0_ASIL_VAR_FAST_CLEARED, MemMapSwAddressMethodRef=OsCore0_ASIL_VAR_NOCACHE_CLEARED
          OS_STACK_OsCore0_Startup_VAR_CLEARED: MemMapAddressingModeSetRef=VTTMemMap/OS_STACK_OsCore0_Startup_VAR_CLEARED, MemMapSwAddressMethodRef=STACK_OsCore0_Startup_VAR_CLEARED
          OS_SystemApplication_OsCore0_VAR_ZERO_INIT: MemMapAddressingModeSetRef=VTTMemMap/OS_SystemApplication_OsCore0_VAR_ZERO_INIT, MemMapSwAddressMethodRef=SystemApplication_OsCore0_VAR_CLEARED, MemMapSwAddressMethodRef=SystemApplication_OsCore0_VAR_FAST_CLEARED, MemMapSwAddressMethodRef=SystemApplication_OsCore0_VAR_NOCACHE_CLEARED
          OS_OsCore_Qm_VAR_POWER_ON_INIT: MemMapAddressingModeSetRef=VTTMemMap/OS_OsCore_Qm_VAR_POWER_ON_INIT, MemMapSwAddressMethodRef=OsCore_Qm_VAR_POWER_ON_INIT, MemMapSwAddressMethodRef=OsCore_Qm_VAR_FAST_POWER_ON_INIT, MemMapSwAddressMethodRef=OsCore_Qm_VAR_NOCACHE_POWER_ON_INIT, MemMapSwAddressMethodRef=OsCore_Qm_VAR_SLOW_POWER_ON_INIT
          OS_INTVEC_CODE: MemMapAddressingModeSetRef=VTTMemMap/OS_INTVEC_CODE, MemMapSwAddressMethodRef=INTVEC_CODE
          OS_SystemApplication_OsCore0_VAR_SAVED_ZONE: MemMapAddressingModeSetRef=VTTMemMap/OS_SystemApplication_OsCore0_VAR_SAVED_ZONE, MemMapSwAddressMethodRef=SystemApplication_OsCore0_VAR_SAVED_ZONE
          OS_STACK_Appl_IPC_Task_VAR_CLEARED: MemMapAddressingModeSetRef=VTTMemMap/OS_STACK_Appl_IPC_Task_VAR_CLEARED, MemMapSwAddressMethodRef=STACK_Appl_IPC_Task_VAR_CLEARED
          OS_STACK_OsCore0_Protection_VAR_CLEARED: MemMapAddressingModeSetRef=VTTMemMap/OS_STACK_OsCore0_Protection_VAR_CLEARED, MemMapSwAddressMethodRef=STACK_OsCore0_Protection_VAR_CLEARED
          OS_STACK_Appl_BackgroundTask_VAR_CLEARED: MemMapAddressingModeSetRef=VTTMemMap/OS_STACK_Appl_BackgroundTask_VAR_CLEARED, MemMapSwAddressMethodRef=STACK_Appl_BackgroundTask_VAR_CLEARED
      Eth_MemMap
        4 x MemMapAdditionalSpecificMapping:
          MemMapEthBufferTx: MemMapAddressingModeSetRef=MSR_ETH_BUF_TX, MemMapAdditionalMemorySectionRef=EthernetBufferTx
          MemMapEthDescriptorTx: MemMapAddressingModeSetRef=MSR_ETH_DESC_TX, MemMapAdditionalMemorySectionRef=EthernetDescriptorTx
          MemMapEthDescriptorRx: MemMapAddressingModeSetRef=MSR_ETH_DESC_RX, MemMapAdditionalMemorySectionRef=EthernetDescriptorRx
          MemMapEthBufferRx: MemMapAddressingModeSetRef=MSR_ETH_BUF_RX, MemMapAdditionalMemorySectionRef=EthernetBufferRx
    77 x MemMapAddressingModeSet:
      OS_STACK_Appl_Task_Logging_VAR_CLEARED
        OS_STACK_Appl_Task_Logging_VAR_CLEARED (MemMapAddressingMode):
          MemMapAlignmentSelector = BOOLEAN
          MemMapAlignmentSelector = 8
          MemMapAlignmentSelector = 16
          MemMapAlignmentSelector = 32
          MemMapAlignmentSelector = 64
          MemMapAlignmentSelector = PTR
          MemMapAlignmentSelector = UNSPECIFIED
      OS_STACK_Appl_Task_High_Prio_VAR_CLEARED
        OS_STACK_Appl_Task_High_Prio_VAR_CLEARED (MemMapAddressingMode):
          MemMapAlignmentSelector = BOOLEAN
          MemMapAlignmentSelector = 8
          MemMapAlignmentSelector = 16
          MemMapAlignmentSelector = 32
          MemMapAlignmentSelector = 64
          MemMapAlignmentSelector = PTR
          MemMapAlignmentSelector = UNSPECIFIED
      OS_OsApplication_VAR_ZERO_INIT
        OS_OsApplication_VAR_ZERO_INIT (MemMapAddressingMode):
          MemMapAlignmentSelector = BOOLEAN
          MemMapAlignmentSelector = 8
          MemMapAlignmentSelector = 16
          MemMapAlignmentSelector = 32
          MemMapAlignmentSelector = 64
          MemMapAlignmentSelector = UNSPECIFIED
      OS_GLOBALSHARED_VAR_CLEARED
        OS_GLOBALSHARED_VAR_CLEARED (MemMapAddressingMode):
          MemMapAlignmentSelector = BOOLEAN
          MemMapAlignmentSelector = 8
          MemMapAlignmentSelector = 16
          MemMapAlignmentSelector = 32
          MemMapAlignmentSelector = 64
          MemMapAlignmentSelector = PTR
          MemMapAlignmentSelector = UNSPECIFIED
      OS_GLOBALSHARED_VAR_NOINIT
        OS_GLOBALSHARED_VAR_NOINIT (MemMapAddressingMode):
          MemMapAlignmentSelector = BOOLEAN
          MemMapAlignmentSelector = 8
          MemMapAlignmentSelector = 16
          MemMapAlignmentSelector = 32
          MemMapAlignmentSelector = 64
          MemMapAlignmentSelector = UNSPECIFIED
      OS_INTVEC_CODE
        OS_INTVEC_CODE (MemMapAddressingMode):
          MemMapAlignmentSelector = BOOLEAN
          MemMapAlignmentSelector = 8
          MemMapAlignmentSelector = 16
          MemMapAlignmentSelector = 32
          MemMapAlignmentSelector = 64
          MemMapAlignmentSelector = PTR
          MemMapAlignmentSelector = UNSPECIFIED
      MSR_PBCFG_VAR
        MSR_PBCFG_VAR (MemMapAddressingMode):
          MemMapAlignmentSelector = UNSPECIFIED
          MemMapAlignmentSelector = 8
          MemMapAlignmentSelector = 16
          MemMapAlignmentSelector = 32
          MemMapAlignmentSelector = 64
          MemMapAlignmentSelector = BOOLEAN
      MSR_VAR_INIT
        MSR_VAR_INIT (MemMapAddressingMode):
          MemMapAlignmentSelector = UNSPECIFIED
          MemMapAlignmentSelector = 8
          MemMapAlignmentSelector = 16
          MemMapAlignmentSelector = 32
          MemMapAlignmentSelector = 64
          MemMapAlignmentSelector = BOOLEAN
          MemMapAlignmentSelector = PTR
      MSR_MCAL_VAR_INIT
        MemMapAddressingMode:
          MemMapAlignmentSelector = 8
          MemMapAlignmentSelector = 16
          MemMapAlignmentSelector = 32
          MemMapAlignmentSelector = 64
          MemMapAlignmentSelector = BOOLEAN
          MemMapAlignmentSelector = UNSPECIFIED
      OS_STACK_OsCore0_Error_VAR_CLEARED
        OS_STACK_OsCore0_Error_VAR_CLEARED (MemMapAddressingMode):
          MemMapAlignmentSelector = BOOLEAN
          MemMapAlignmentSelector = 8
          MemMapAlignmentSelector = 16
          MemMapAlignmentSelector = 32
          MemMapAlignmentSelector = 64
          MemMapAlignmentSelector = PTR
          MemMapAlignmentSelector = UNSPECIFIED
      OS_STACK_OsCore0_Task_Prio190_VAR_CLEARED
        OS_STACK_OsCore0_Task_Prio190_VAR_CLEARED (MemMapAddressingMode):
          MemMapAlignmentSelector = BOOLEAN
          MemMapAlignmentSelector = 8
          MemMapAlignmentSelector = 16
          MemMapAlignmentSelector = 32
          MemMapAlignmentSelector = 64
          MemMapAlignmentSelector = PTR
          MemMapAlignmentSelector = UNSPECIFIED
      OS_EXCVEC_OsCore0_CONST
        OS_EXCVEC_OsCore0_CONST (MemMapAddressingMode):
          MemMapAlignmentSelector = BOOLEAN
          MemMapAlignmentSelector = 8
          MemMapAlignmentSelector = 16
          MemMapAlignmentSelector = 32
          MemMapAlignmentSelector = 64
          MemMapAlignmentSelector = PTR
          MemMapAlignmentSelector = UNSPECIFIED
      MSR_VAR_SAVED_ZONE
        MSR_VAR_SAVED_ZONE (MemMapAddressingMode):
          MemMapAlignmentSelector = UNSPECIFIED
          MemMapAlignmentSelector = 8
          MemMapAlignmentSelector = 16
          MemMapAlignmentSelector = 32
          MemMapAlignmentSelector = 64
          MemMapAlignmentSelector = BOOLEAN
          MemMapAlignmentSelector = PTR
      MSR_MCAL_CONFIG_DATA_POSTBUILD
        MemMapAddressingMode:
          MemMapAlignmentSelector = UNSPECIFIED
          MemMapAlignmentSelector = 8
          MemMapAlignmentSelector = 16
          MemMapAlignmentSelector = 32
          MemMapAlignmentSelector = 64
          MemMapAlignmentSelector = BOOLEAN
      OS_SystemApplication_OsCore0_VAR_POWER_ON_INIT
        OS_SystemApplication_OsCore0_VAR_POWER_ON_INIT (MemMapAddressingMode):
          MemMapAlignmentSelector = BOOLEAN
          MemMapAlignmentSelector = 8
          MemMapAlignmentSelector = 16
          MemMapAlignmentSelector = 32
          MemMapAlignmentSelector = 64
          MemMapAlignmentSelector = PTR
          MemMapAlignmentSelector = UNSPECIFIED
      OS_INTVEC_OsCore0_CONST
        OS_INTVEC_OsCore0_CONST (MemMapAddressingMode):
          MemMapAlignmentSelector = BOOLEAN
          MemMapAlignmentSelector = 8
          MemMapAlignmentSelector = 16
          MemMapAlignmentSelector = 32
          MemMapAlignmentSelector = 64
          MemMapAlignmentSelector = PTR
          MemMapAlignmentSelector = UNSPECIFIED
      OS_CODE
        OS_CODE (MemMapAddressingMode):
          MemMapAlignmentSelector = BOOLEAN
          MemMapAlignmentSelector = 8
          MemMapAlignmentSelector = 16
          MemMapAlignmentSelector = 32
          MemMapAlignmentSelector = 64
          MemMapAlignmentSelector = PTR
          MemMapAlignmentSelector = UNSPECIFIED
      MSR_VAR_CLEARED
        MSR_VAR_CLEARED (MemMapAddressingMode):
          MemMapAlignmentSelector = UNSPECIFIED
          MemMapAlignmentSelector = 8
          MemMapAlignmentSelector = 16
          MemMapAlignmentSelector = 32
          MemMapAlignmentSelector = 64
          MemMapAlignmentSelector = BOOLEAN
          MemMapAlignmentSelector = PTR
      MSR_ETH_BUF_TX
        MemMapAddressingMode: MemMapAlignmentSelector=UNSPECIFIED
      MSR_CRYPTO_IPC_DataBuffer
        MemMapAddressingMode: MemMapAlignmentSelector=32, MemMapAlignmentSelector=128, MemMapAlignmentSelector=UNSPECIFIED
      OS_SystemApplication_OsCore0_VAR_NOINIT
        OS_SystemApplication_OsCore0_VAR_NOINIT (MemMapAddressingMode):
          MemMapAlignmentSelector = BOOLEAN
          MemMapAlignmentSelector = 8
          MemMapAlignmentSelector = 16
          MemMapAlignmentSelector = 32
          MemMapAlignmentSelector = 64
          MemMapAlignmentSelector = UNSPECIFIED
      OS_SystemApplication_OsCore0_VAR_ZERO_INIT
        OS_SystemApplication_OsCore0_VAR_ZERO_INIT (MemMapAddressingMode):
          MemMapAlignmentSelector = BOOLEAN
          MemMapAlignmentSelector = 8
          MemMapAlignmentSelector = 16
          MemMapAlignmentSelector = 32
          MemMapAlignmentSelector = 64
          MemMapAlignmentSelector = UNSPECIFIED
      OS_GLOBALSHARED_VAR_POWER_ON_CLEARED
        OS_GLOBALSHARED_VAR_POWER_ON_CLEARED (MemMapAddressingMode):
          MemMapAlignmentSelector = BOOLEAN
          MemMapAlignmentSelector = 8
          MemMapAlignmentSelector = 16
          MemMapAlignmentSelector = 32
          MemMapAlignmentSelector = 64
          MemMapAlignmentSelector = PTR
          MemMapAlignmentSelector = UNSPECIFIED
      OS_OsCore_Qm_VAR_POWER_ON_CLEARED
        OS_OsCore_Qm_VAR_POWER_ON_CLEARED (MemMapAddressingMode):
          MemMapAlignmentSelector = BOOLEAN
          MemMapAlignmentSelector = 8
          MemMapAlignmentSelector = 16
          MemMapAlignmentSelector = 32
          MemMapAlignmentSelector = 64
          MemMapAlignmentSelector = PTR
          MemMapAlignmentSelector = UNSPECIFIED
      OS_SystemApplication_OsCore0_VAR_CLEARED
        OS_SystemApplication_OsCore0_VAR_CLEARED (MemMapAddressingMode):
          MemMapAlignmentSelector = BOOLEAN
          MemMapAlignmentSelector = 8
          MemMapAlignmentSelector = 16
          MemMapAlignmentSelector = 32
          MemMapAlignmentSelector = 64
          MemMapAlignmentSelector = PTR
          MemMapAlignmentSelector = UNSPECIFIED
      MSR_MCAL_VAR_NO_INIT
        MemMapAddressingMode:
          MemMapAlignmentSelector = 8
          MemMapAlignmentSelector = 16
          MemMapAlignmentSelector = 32
          MemMapAlignmentSelector = 64
          MemMapAlignmentSelector = BOOLEAN
          MemMapAlignmentSelector = UNSPECIFIED
      OS_OsApplication_VAR_SAVED_ZONE
        OS_OsApplication_VAR_SAVED_ZONE (MemMapAddressingMode):
          MemMapAlignmentSelector = BOOLEAN
          MemMapAlignmentSelector = 8
          MemMapAlignmentSelector = 16
          MemMapAlignmentSelector = 32
          MemMapAlignmentSelector = 64
          MemMapAlignmentSelector = UNSPECIFIED
      OS_SystemApplication_OsCore0_VAR_POWER_ON_CLEARED
        OS_SystemApplication_OsCore0_VAR_POWER_ON_CLEARED (MemMapAddressingMode):
          MemMapAlignmentSelector = BOOLEAN
          MemMapAlignmentSelector = 8
          MemMapAlignmentSelector = 16
          MemMapAlignmentSelector = 32
          MemMapAlignmentSelector = 64
          MemMapAlignmentSelector = PTR
          MemMapAlignmentSelector = UNSPECIFIED
      OS_STACK_Appl_Task_Fast_VAR_CLEARED
        OS_STACK_Appl_Task_Fast_VAR_CLEARED (MemMapAddressingMode):
          MemMapAlignmentSelector = BOOLEAN
          MemMapAlignmentSelector = 8
          MemMapAlignmentSelector = 16
          MemMapAlignmentSelector = 32
          MemMapAlignmentSelector = 64
          MemMapAlignmentSelector = PTR
          MemMapAlignmentSelector = UNSPECIFIED
      OS_OsCore0_ASIL_VAR_INIT
        OS_OsCore0_ASIL_VAR_INIT (MemMapAddressingMode):
          MemMapAlignmentSelector = BOOLEAN
          MemMapAlignmentSelector = 8
          MemMapAlignmentSelector = 16
          MemMapAlignmentSelector = 32
          MemMapAlignmentSelector = 64
          MemMapAlignmentSelector = UNSPECIFIED
      MSR_ETH_DESC_RX
        MemMapAddressingMode: MemMapAlignmentSelector=UNSPECIFIED
      MSR_ETH_DESC_TX
        MemMapAddressingMode: MemMapAlignmentSelector=UNSPECIFIED
      OS_OsCore_Qm_VAR_CLEARED
        OS_OsCore_Qm_VAR_CLEARED (MemMapAddressingMode):
          MemMapAlignmentSelector = BOOLEAN
          MemMapAlignmentSelector = 8
          MemMapAlignmentSelector = 16
          MemMapAlignmentSelector = 32
          MemMapAlignmentSelector = 64
          MemMapAlignmentSelector = PTR
          MemMapAlignmentSelector = UNSPECIFIED
      OS_OsCore0_ASIL_VAR_POWER_ON_CLEARED
        OS_OsCore0_ASIL_VAR_POWER_ON_CLEARED (MemMapAddressingMode):
          MemMapAlignmentSelector = BOOLEAN
          MemMapAlignmentSelector = 8
          MemMapAlignmentSelector = 16
          MemMapAlignmentSelector = 32
          MemMapAlignmentSelector = 64
          MemMapAlignmentSelector = PTR
          MemMapAlignmentSelector = UNSPECIFIED
      OS_GLOBALSHARED_VAR_INIT
        OS_GLOBALSHARED_VAR_INIT (MemMapAddressingMode):
          MemMapAlignmentSelector = BOOLEAN
          MemMapAlignmentSelector = 8
          MemMapAlignmentSelector = 16
          MemMapAlignmentSelector = 32
          MemMapAlignmentSelector = 64
          MemMapAlignmentSelector = UNSPECIFIED
      OS_OsCore_Qm_VAR_INIT
        OS_OsCore_Qm_VAR_INIT (MemMapAddressingMode):
          MemMapAlignmentSelector = BOOLEAN
          MemMapAlignmentSelector = 8
          MemMapAlignmentSelector = 16
          MemMapAlignmentSelector = 32
          MemMapAlignmentSelector = 64
          MemMapAlignmentSelector = UNSPECIFIED
      OS_GLOBALSHARED_VAR_POWER_ON_INIT
        OS_GLOBALSHARED_VAR_POWER_ON_INIT (MemMapAddressingMode):
          MemMapAlignmentSelector = BOOLEAN
          MemMapAlignmentSelector = 8
          MemMapAlignmentSelector = 16
          MemMapAlignmentSelector = 32
          MemMapAlignmentSelector = 64
          MemMapAlignmentSelector = PTR
          MemMapAlignmentSelector = UNSPECIFIED
      OS_OsCore_Qm_VAR_ZERO_INIT
        OS_OsCore_Qm_VAR_ZERO_INIT (MemMapAddressingMode):
          MemMapAlignmentSelector = BOOLEAN
          MemMapAlignmentSelector = 8
          MemMapAlignmentSelector = 16
          MemMapAlignmentSelector = 32
          MemMapAlignmentSelector = 64
          MemMapAlignmentSelector = UNSPECIFIED
      MSR_VAR_NO_INIT
        MSR_VAR_NO_INIT (MemMapAddressingMode):
          MemMapAlignmentSelector = UNSPECIFIED
          MemMapAlignmentSelector = 8
          MemMapAlignmentSelector = 16
          MemMapAlignmentSelector = 32
          MemMapAlignmentSelector = 64
          MemMapAlignmentSelector = BOOLEAN
          MemMapAlignmentSelector = PTR
          MemMapAlignmentSelector = 128
      OS_INTVEC_OsCore0_CODE
        OS_INTVEC_OsCore0_CODE (MemMapAddressingMode):
          MemMapAlignmentSelector = BOOLEAN
          MemMapAlignmentSelector = 8
          MemMapAlignmentSelector = 16
          MemMapAlignmentSelector = 32
          MemMapAlignmentSelector = 64
          MemMapAlignmentSelector = PTR
          MemMapAlignmentSelector = UNSPECIFIED
      OS_STACK_BSW_Task_VAR_CLEARED
        OS_STACK_BSW_Task_VAR_CLEARED (MemMapAddressingMode):
          MemMapAlignmentSelector = BOOLEAN
          MemMapAlignmentSelector = 8
          MemMapAlignmentSelector = 16
          MemMapAlignmentSelector = 32
          MemMapAlignmentSelector = 64
          MemMapAlignmentSelector = PTR
          MemMapAlignmentSelector = UNSPECIFIED
      OS_STACK_OsCore0_Isr_Core_VAR_CLEARED
        OS_STACK_OsCore0_Isr_Core_VAR_CLEARED (MemMapAddressingMode):
          MemMapAlignmentSelector = BOOLEAN
          MemMapAlignmentSelector = 8
          MemMapAlignmentSelector = 16
          MemMapAlignmentSelector = 32
          MemMapAlignmentSelector = 64
          MemMapAlignmentSelector = PTR
          MemMapAlignmentSelector = UNSPECIFIED
      OS_INTVEC_CONST
        OS_INTVEC_CONST (MemMapAddressingMode):
          MemMapAlignmentSelector = BOOLEAN
          MemMapAlignmentSelector = 8
          MemMapAlignmentSelector = 16
          MemMapAlignmentSelector = 32
          MemMapAlignmentSelector = 64
          MemMapAlignmentSelector = PTR
          MemMapAlignmentSelector = UNSPECIFIED
      OS_STACK_OsCore0_Startup_VAR_CLEARED
        OS_STACK_OsCore0_Startup_VAR_CLEARED (MemMapAddressingMode):
          MemMapAlignmentSelector = BOOLEAN
          MemMapAlignmentSelector = 8
          MemMapAlignmentSelector = 16
          MemMapAlignmentSelector = 32
          MemMapAlignmentSelector = 64
          MemMapAlignmentSelector = PTR
          MemMapAlignmentSelector = UNSPECIFIED
      OS_STACK_OsCore0_Init_VAR_CLEARED
        OS_STACK_OsCore0_Init_VAR_CLEARED (MemMapAddressingMode):
          MemMapAlignmentSelector = BOOLEAN
          MemMapAlignmentSelector = 8
          MemMapAlignmentSelector = 16
          MemMapAlignmentSelector = 32
          MemMapAlignmentSelector = 64
          MemMapAlignmentSelector = PTR
          MemMapAlignmentSelector = UNSPECIFIED
      OS_OsCore0_ASIL_VAR_NOINIT
        OS_OsCore0_ASIL_VAR_NOINIT (MemMapAddressingMode):
          MemMapAlignmentSelector = BOOLEAN
          MemMapAlignmentSelector = 8
          MemMapAlignmentSelector = 16
          MemMapAlignmentSelector = 32
          MemMapAlignmentSelector = 64
          MemMapAlignmentSelector = UNSPECIFIED
      OS_STACK_OsCore0_Task_Prio4294967295_VAR_CLEARED
        OS_STACK_OsCore0_Task_Prio4294967295_VAR_CLEARED (MemMapAddressingMode):
          MemMapAlignmentSelector = BOOLEAN
          MemMapAlignmentSelector = 8
          MemMapAlignmentSelector = 16
          MemMapAlignmentSelector = 32
          MemMapAlignmentSelector = 64
          MemMapAlignmentSelector = PTR
          MemMapAlignmentSelector = UNSPECIFIED
      OS_GLOBALSHARED_VAR_SAVED_ZONE
        OS_GLOBALSHARED_VAR_SAVED_ZONE (MemMapAddressingMode):
          MemMapAlignmentSelector = BOOLEAN
          MemMapAlignmentSelector = 8
          MemMapAlignmentSelector = 16
          MemMapAlignmentSelector = 32
          MemMapAlignmentSelector = 64
          MemMapAlignmentSelector = UNSPECIFIED
      OS_STACK_OsCore0_Task_Prio210_VAR_CLEARED
        OS_STACK_OsCore0_Task_Prio210_VAR_CLEARED (MemMapAddressingMode):
          MemMapAlignmentSelector = BOOLEAN
          MemMapAlignmentSelector = 8
          MemMapAlignmentSelector = 16
          MemMapAlignmentSelector = 32
          MemMapAlignmentSelector = 64
          MemMapAlignmentSelector = PTR
          MemMapAlignmentSelector = UNSPECIFIED
      OS_STACK_Radar_Ctrl_Task_VAR_CLEARED
        OS_STACK_Radar_Ctrl_Task_VAR_CLEARED (MemMapAddressingMode):
          MemMapAlignmentSelector = BOOLEAN
          MemMapAlignmentSelector = 8
          MemMapAlignmentSelector = 16
          MemMapAlignmentSelector = 32
          MemMapAlignmentSelector = 64
          MemMapAlignmentSelector = PTR
          MemMapAlignmentSelector = UNSPECIFIED
      OS_STACK_OsCore0_Task_Prio200_VAR_CLEARED
        OS_STACK_OsCore0_Task_Prio200_VAR_CLEARED (MemMapAddressingMode):
          MemMapAlignmentSelector = BOOLEAN
          MemMapAlignmentSelector = 8
          MemMapAlignmentSelector = 16
          MemMapAlignmentSelector = 32
          MemMapAlignmentSelector = 64
          MemMapAlignmentSelector = PTR
          MemMapAlignmentSelector = UNSPECIFIED
      OS_GLOBALSHARED_VAR_ZERO_INIT
        OS_GLOBALSHARED_VAR_ZERO_INIT (MemMapAddressingMode):
          MemMapAlignmentSelector = BOOLEAN
          MemMapAlignmentSelector = 8
          MemMapAlignmentSelector = 16
          MemMapAlignmentSelector = 32
          MemMapAlignmentSelector = 64
          MemMapAlignmentSelector = UNSPECIFIED
      OS_SystemApplication_OsCore0_VAR_SAVED_ZONE
        OS_SystemApplication_OsCore0_VAR_SAVED_ZONE (MemMapAddressingMode):
          MemMapAlignmentSelector = BOOLEAN
          MemMapAlignmentSelector = 8
          MemMapAlignmentSelector = 16
          MemMapAlignmentSelector = 32
          MemMapAlignmentSelector = 64
          MemMapAlignmentSelector = UNSPECIFIED
      MSR_MCAL_CONST
        MemMapAddressingMode:
          MemMapAlignmentSelector = 8
          MemMapAlignmentSelector = 16
          MemMapAlignmentSelector = 32
          MemMapAlignmentSelector = 64
          MemMapAlignmentSelector = BOOLEAN
          MemMapAlignmentSelector = UNSPECIFIED
      OS_OsApplication_VAR_INIT
        OS_OsApplication_VAR_INIT (MemMapAddressingMode):
          MemMapAlignmentSelector = BOOLEAN
          MemMapAlignmentSelector = 8
          MemMapAlignmentSelector = 16
          MemMapAlignmentSelector = 32
          MemMapAlignmentSelector = 64
          MemMapAlignmentSelector = UNSPECIFIED
      MSR_CONST
        MSR_CONST (MemMapAddressingMode):
          MemMapAlignmentSelector = UNSPECIFIED
          MemMapAlignmentSelector = 8
          MemMapAlignmentSelector = 16
          MemMapAlignmentSelector = 32
          MemMapAlignmentSelector = 64
          MemMapAlignmentSelector = BOOLEAN
          MemMapAlignmentSelector = PTR
      OS_OsApplication_VAR_NOINIT
        OS_OsApplication_VAR_NOINIT (MemMapAddressingMode):
          MemMapAlignmentSelector = BOOLEAN
          MemMapAlignmentSelector = 8
          MemMapAlignmentSelector = 16
          MemMapAlignmentSelector = 32
          MemMapAlignmentSelector = 64
          MemMapAlignmentSelector = UNSPECIFIED
      OS_OsCore0_ASIL_VAR_CLEARED
        OS_OsCore0_ASIL_VAR_CLEARED (MemMapAddressingMode):
          MemMapAlignmentSelector = BOOLEAN
          MemMapAlignmentSelector = 8
          MemMapAlignmentSelector = 16
          MemMapAlignmentSelector = 32
          MemMapAlignmentSelector = 64
          MemMapAlignmentSelector = PTR
          MemMapAlignmentSelector = UNSPECIFIED
      OS_OsCore_Qm_VAR_SAVED_ZONE
        OS_OsCore_Qm_VAR_SAVED_ZONE (MemMapAddressingMode):
          MemMapAlignmentSelector = BOOLEAN
          MemMapAlignmentSelector = 8
          MemMapAlignmentSelector = 16
          MemMapAlignmentSelector = 32
          MemMapAlignmentSelector = 64
          MemMapAlignmentSelector = UNSPECIFIED
      OS_OsCore0_ASIL_VAR_POWER_ON_INIT
        OS_OsCore0_ASIL_VAR_POWER_ON_INIT (MemMapAddressingMode):
          MemMapAlignmentSelector = BOOLEAN
          MemMapAlignmentSelector = 8
          MemMapAlignmentSelector = 16
          MemMapAlignmentSelector = 32
          MemMapAlignmentSelector = 64
          MemMapAlignmentSelector = PTR
          MemMapAlignmentSelector = UNSPECIFIED
      MSR_CODE
        MSR_CODE (MemMapAddressingMode):
          MemMapAlignmentSelector = UNSPECIFIED
          MemMapAlignmentSelector = 8
          MemMapAlignmentSelector = 16
          MemMapAlignmentSelector = 32
          MemMapAlignmentSelector = 64
          MemMapAlignmentSelector = BOOLEAN
      OS_SystemApplication_OsCore0_VAR_INIT
        OS_SystemApplication_OsCore0_VAR_INIT (MemMapAddressingMode):
          MemMapAlignmentSelector = BOOLEAN
          MemMapAlignmentSelector = 8
          MemMapAlignmentSelector = 16
          MemMapAlignmentSelector = 32
          MemMapAlignmentSelector = 64
          MemMapAlignmentSelector = UNSPECIFIED
      OS_STACK_Appl_Task_Communication_VAR_CLEARED
        OS_STACK_Appl_Task_Communication_VAR_CLEARED (MemMapAddressingMode):
          MemMapAlignmentSelector = BOOLEAN
          MemMapAlignmentSelector = 8
          MemMapAlignmentSelector = 16
          MemMapAlignmentSelector = 32
          MemMapAlignmentSelector = 64
          MemMapAlignmentSelector = PTR
          MemMapAlignmentSelector = UNSPECIFIED
      OS_STACK_OsCore0_Shutdown_VAR_CLEARED
        OS_STACK_OsCore0_Shutdown_VAR_CLEARED (MemMapAddressingMode):
          MemMapAlignmentSelector = BOOLEAN
          MemMapAlignmentSelector = 8
          MemMapAlignmentSelector = 16
          MemMapAlignmentSelector = 32
          MemMapAlignmentSelector = 64
          MemMapAlignmentSelector = PTR
          MemMapAlignmentSelector = UNSPECIFIED
      OS_OsCore0_ASIL_VAR_ZERO_INIT
        OS_OsCore0_ASIL_VAR_ZERO_INIT (MemMapAddressingMode):
          MemMapAlignmentSelector = BOOLEAN
          MemMapAlignmentSelector = 8
          MemMapAlignmentSelector = 16
          MemMapAlignmentSelector = 32
          MemMapAlignmentSelector = 64
          MemMapAlignmentSelector = UNSPECIFIED
      OS_STACK_OsCore0_Task_Prio0_VAR_CLEARED
        OS_STACK_OsCore0_Task_Prio0_VAR_CLEARED (MemMapAddressingMode):
          MemMapAlignmentSelector = BOOLEAN
          MemMapAlignmentSelector = 8
          MemMapAlignmentSelector = 16
          MemMapAlignmentSelector = 32
          MemMapAlignmentSelector = 64
          MemMapAlignmentSelector = PTR
          MemMapAlignmentSelector = UNSPECIFIED
      MSR_CRYPTO_IPC_LengthBuffer
        MemMapAddressingMode: MemMapAlignmentSelector=32, MemMapAlignmentSelector=128, MemMapAlignmentSelector=UNSPECIFIED
      OS_STACK_Appl_Task_VAR_CLEARED
        OS_STACK_Appl_Task_VAR_CLEARED (MemMapAddressingMode):
          MemMapAlignmentSelector = BOOLEAN
          MemMapAlignmentSelector = 8
          MemMapAlignmentSelector = 16
          MemMapAlignmentSelector = 32
          MemMapAlignmentSelector = 64
          MemMapAlignmentSelector = PTR
          MemMapAlignmentSelector = UNSPECIFIED
      OS_OsCore0_ASIL_VAR_SAVED_ZONE
        OS_OsCore0_ASIL_VAR_SAVED_ZONE (MemMapAddressingMode):
          MemMapAlignmentSelector = BOOLEAN
          MemMapAlignmentSelector = 8
          MemMapAlignmentSelector = 16
          MemMapAlignmentSelector = 32
          MemMapAlignmentSelector = 64
          MemMapAlignmentSelector = UNSPECIFIED
      MSR_ETH_BUF_RX
        MemMapAddressingMode: MemMapAlignmentSelector=UNSPECIFIED
      MSR_MCAL_BSS
        MemMapAddressingMode: MemMapAlignmentSelector=
      MSR_PBCFG_CONST
        MSR_PBCFG_CONST (MemMapAddressingMode):
          MemMapAlignmentSelector = UNSPECIFIED
          MemMapAlignmentSelector = 8
          MemMapAlignmentSelector = 16
          MemMapAlignmentSelector = 32
          MemMapAlignmentSelector = 64
          MemMapAlignmentSelector = BOOLEAN
          MemMapAlignmentSelector = PTR
      OS_OsCore_Qm_VAR_POWER_ON_INIT
        OS_OsCore_Qm_VAR_POWER_ON_INIT (MemMapAddressingMode):
          MemMapAlignmentSelector = BOOLEAN
          MemMapAlignmentSelector = 8
          MemMapAlignmentSelector = 16
          MemMapAlignmentSelector = 32
          MemMapAlignmentSelector = 64
          MemMapAlignmentSelector = PTR
          MemMapAlignmentSelector = UNSPECIFIED
      OS_STACK_OsCore0_Kernel_VAR_CLEARED
        OS_STACK_OsCore0_Kernel_VAR_CLEARED (MemMapAddressingMode):
          MemMapAlignmentSelector = BOOLEAN
          MemMapAlignmentSelector = 8
          MemMapAlignmentSelector = 16
          MemMapAlignmentSelector = 32
          MemMapAlignmentSelector = 64
          MemMapAlignmentSelector = PTR
          MemMapAlignmentSelector = UNSPECIFIED
      MSR_MCAL_CODE
        MemMapAddressingMode:
          MemMapAlignmentSelector = 8
          MemMapAlignmentSelector = 16
          MemMapAlignmentSelector = 32
          MemMapAlignmentSelector = 64
          MemMapAlignmentSelector = UNSPECIFIED
          MemMapAlignmentSelector = BOOLEAN
      OS_OsCore_Qm_VAR_NOINIT
        OS_OsCore_Qm_VAR_NOINIT (MemMapAddressingMode):
          MemMapAlignmentSelector = BOOLEAN
          MemMapAlignmentSelector = 8
          MemMapAlignmentSelector = 16
          MemMapAlignmentSelector = 32
          MemMapAlignmentSelector = 64
          MemMapAlignmentSelector = UNSPECIFIED
      OS_EXCVEC_OsCore0_CODE
        OS_EXCVEC_OsCore0_CODE (MemMapAddressingMode):
          MemMapAlignmentSelector = BOOLEAN
          MemMapAlignmentSelector = 8
          MemMapAlignmentSelector = 16
          MemMapAlignmentSelector = 32
          MemMapAlignmentSelector = 64
          MemMapAlignmentSelector = PTR
          MemMapAlignmentSelector = UNSPECIFIED
    3 x MemMapAllocation:
      SWC_ComM
        3 x MemMapSectionSpecificMapping:
          ComM_VAR_ZERO_INIT_UNSPECIFIED: MemMapAddressingModeSetRef=VTTMemMap/OS_OsCore0_ASIL_VAR_ZERO_INIT, MemMapMemorySectionRef=ComM_VAR_ZERO_INIT_UNSPECIFIED
          ComM_VAR_INIT_UNSPECIFIED: MemMapAddressingModeSetRef=VTTMemMap/OS_OsCore0_ASIL_VAR_INIT, MemMapMemorySectionRef=ComM_VAR_INIT_UNSPECIFIED
          ComM_VAR_NOINIT_UNSPECIFIED: MemMapAddressingModeSetRef=VTTMemMap/OS_OsCore0_ASIL_VAR_NOINIT, MemMapMemorySectionRef=ComM_VAR_NOINIT_UNSPECIFIED
      SWC_StbM
        3 x MemMapSectionSpecificMapping:
          StbM_VAR_INIT_UNSPECIFIED: MemMapAddressingModeSetRef=VTTMemMap/OS_OsCore0_ASIL_VAR_INIT, MemMapMemorySectionRef=StbM_VAR_INIT_UNSPECIFIED
          StbM_VAR_ZERO_INIT_UNSPECIFIED: MemMapAddressingModeSetRef=VTTMemMap/OS_OsCore0_ASIL_VAR_ZERO_INIT, MemMapMemorySectionRef=StbM_VAR_ZERO_INIT_UNSPECIFIED
          StbM_VAR_NOINIT_UNSPECIFIED: MemMapAddressingModeSetRef=VTTMemMap/OS_OsCore0_ASIL_VAR_NOINIT, MemMapMemorySectionRef=StbM_VAR_NOINIT_UNSPECIFIED
      SWC_EcuM
        3 x MemMapSectionSpecificMapping:
          EcuM_VAR_INIT_UNSPECIFIED: MemMapAddressingModeSetRef=VTTMemMap/OS_OsCore0_ASIL_VAR_INIT, MemMapMemorySectionRef=EcuM_VAR_INIT_UNSPECIFIED
          EcuM_VAR_NOINIT_UNSPECIFIED: MemMapAddressingModeSetRef=VTTMemMap/OS_OsCore0_ASIL_VAR_NOINIT, MemMapMemorySectionRef=EcuM_VAR_NOINIT_UNSPECIFIED
          EcuM_VAR_ZERO_INIT_UNSPECIFIED: MemMapAddressingModeSetRef=VTTMemMap/OS_OsCore0_ASIL_VAR_ZERO_INIT, MemMapMemorySectionRef=EcuM_VAR_ZERO_INIT_UNSPECIFIED
    OS_STACK_Appl_IPC_Task_VAR_CLEARED (MemMapAddressingModeSet)
      OS_STACK_Appl_IPC_Task_VAR_CLEARED (MemMapAddressingMode):
        MemMapAlignmentSelector = BOOLEAN
        MemMapAlignmentSelector = 8
        MemMapAlignmentSelector = 16
        MemMapAlignmentSelector = 32
        MemMapAlignmentSelector = 64
        MemMapAlignmentSelector = PTR
        MemMapAlignmentSelector = UNSPECIFIED
    Uart (MemMapModule): MemMapGenerateAdditionalMemorySections=true, MemMapModuleRef=Uart
      CONST_UNSPECIFIED (MemMapAdditionalMemorySection): MemMapMemorySectionPrefix=UART, MemMapMemorySectionSwAddrMethodRef=CONST_UNSPECIFIED
    SWC_Dcm (MemMapAllocation)
      3 x MemMapSectionSpecificMapping:
        Dcm_VAR_NOINIT_UNSPECIFIED: MemMapAddressingModeSetRef=VTTMemMap/OS_OsCore0_ASIL_VAR_NOINIT, MemMapMemorySectionRef=Dcm_VAR_NOINIT_UNSPECIFIED
        Dcm_VAR_INIT_UNSPECIFIED: MemMapAddressingModeSetRef=VTTMemMap/OS_OsCore0_ASIL_VAR_INIT, MemMapMemorySectionRef=Dcm_VAR_INIT_UNSPECIFIED
        Dcm_VAR_ZERO_INIT_UNSPECIFIED: MemMapAddressingModeSetRef=VTTMemMap/OS_OsCore0_ASIL_VAR_ZERO_INIT, MemMapMemorySectionRef=Dcm_VAR_ZERO_INIT_UNSPECIFIED
    6 x MemMapAddressingModeSet:
      MSR_CRYPTO_KeyStruct_MetaData
        MemMapAddressingMode: MemMapAlignmentSelector=32, MemMapAlignmentSelector=128, MemMapAlignmentSelector=UNSPECIFIED
      MSR_CRYPTO_TestData
        MemMapAddressingMode: MemMapAlignmentSelector=32, MemMapAlignmentSelector=128, MemMapAlignmentSelector=UNSPECIFIED
      MSR_CRYPTO_KeyStruct_InitData
        MemMapAddressingMode: MemMapAlignmentSelector=8
      OS_STACK_OsCore0_Protection_VAR_CLEARED
        OS_STACK_OsCore0_Protection_VAR_CLEARED (MemMapAddressingMode):
          MemMapAlignmentSelector = BOOLEAN
          MemMapAlignmentSelector = 8
          MemMapAlignmentSelector = 16
          MemMapAlignmentSelector = 32
          MemMapAlignmentSelector = 64
          MemMapAlignmentSelector = PTR
          MemMapAlignmentSelector = UNSPECIFIED
      OS_STACK_OsCore0_Task_Prio1_VAR_CLEARED
        OS_STACK_OsCore0_Task_Prio1_VAR_CLEARED (MemMapAddressingMode):
          MemMapAlignmentSelector = BOOLEAN
          MemMapAlignmentSelector = 8
          MemMapAlignmentSelector = 16
          MemMapAlignmentSelector = 32
          MemMapAlignmentSelector = 64
          MemMapAlignmentSelector = PTR
          MemMapAlignmentSelector = UNSPECIFIED
      OS_STACK_Appl_BackgroundTask_VAR_CLEARED
        OS_STACK_Appl_BackgroundTask_VAR_CLEARED (MemMapAddressingMode):
          MemMapAlignmentSelector = BOOLEAN
          MemMapAlignmentSelector = 8
          MemMapAlignmentSelector = 16
          MemMapAlignmentSelector = 32
          MemMapAlignmentSelector = 64
          MemMapAlignmentSelector = PTR
          MemMapAlignmentSelector = UNSPECIFIED
