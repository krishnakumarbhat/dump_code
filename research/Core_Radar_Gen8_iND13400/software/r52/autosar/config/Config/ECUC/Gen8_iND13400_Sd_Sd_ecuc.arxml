AUTOSAR XML (schema 00053)
package /ActiveEcuC
  module config Sd: implementation-config-variant=VARIANT-PRE-COMPILE, module-description=Sd_Impl
    SdConfig
      cnctr_RDR_RdrNet_5172a59b (SdInstance): SdMaxNrDestAddr=16, SdInOutQueueSize=96, SdInQueueProcessLimit=0
        provService_RDR_1_SW_Info_c2745ec9 (SdServerService):
          SdServerServiceId = 18
          SdServerServiceInstanceId = 1
          SdServerServiceMajorVersion = 1
          SdServerServiceMinorVersion = 0
          SdServerServiceAutoAvailable = false
          SdServerServiceHandleId = 1
          SdServerServiceTimerRef = provService_RDR_1_SW_Info_3b034188
          SdServerServiceUdpRef = ConnectionBundle_RDR_1_1c1a30fe
          EventGroup_RDR_1_653e2581 (SdEventHandler):
            SdEventHandlerEventGroupId = 1
            SdEventHandlerHandleId = 1
            SdEventHandlerMulticastThreshold = 0
            SdEventHandlerMaxRemoteClients = 0
            SdEventHandlerTimerRef = EventGroup_RDR_1_92448352
            SdEventHandlerUdp: SdEventActivationRef=SoAdRoutingGroup3_c9586fb9
        SdInstanceTxPdu: SdTxPduRef=GenerelPurposePDU3_a3a5c5ac_Tx
        consService_RDR_1_ADAS_Vehicle_Status_2b1e055b (SdClientService):
          SdClientServiceId = 256
          SdClientServiceInstanceId = 1
          SdClientServiceMajorVersion = 1
          SdClientServiceMinorVersion = 0
          SdClientServiceAutoRequire = false
          SdClientServiceHandleId = 0
          SdClientServiceTimerRef = consService_RDR_1_ADAS_Vehicle_Status_fb9772e0
          SdClientServiceUdpRef = ConnectionBundle_ADAS_6b786f6d
          consServiceGrp_RDR_1_ADAS_Vehicle_Status_4b79da85 (SdConsumedEventGroup):
            SdConsumedEventGroupId = 1
            SdConsumedEventGroupAutoRequire = false
            SdConsumedEventGroupHandleId = 0
            SdConsumedEventGroupTimerRef = consServiceGrp_RDR_1_ADAS_Vehicle_Status_0dbda357
            SdConsumedEventGroupUdpActivationRef = SoAdRoutingGroup1_27560e95
        4 x SdServerTimer, all with SdServerTimerInitialOfferDelayMax=0.01, SdServerTimerInitialOfferDelayMin=0.01, SdServerTimerInitialOfferRepetitionBaseDelay=0.03, SdServerTimerInitialOfferRepetitionsMax=3, SdServerTimerOfferCyclicDelay=1, SdServerTimerRequestResponseMaxDelay=0.01, SdServerTimerRequestResponseMinDelay=0.01, SdServerTimerTTL=3:
          EventGroup_RDR_1_0937cbe9
          EventGroup_RDR_1_a30b5032
          provService_RDR_1_SW_Info_3b034188
          EventGroup_RDR_1_92448352
        provService_RDR_1_Status_d2069d01 (SdServerService):
          SdServerServiceId = 17
          SdServerServiceInstanceId = 1
          SdServerServiceMajorVersion = 1
          SdServerServiceMinorVersion = 0
          SdServerServiceAutoAvailable = false
          SdServerServiceHandleId = 2
          SdServerServiceTimerRef = provService_RDR_1_Status_4d7443dc
          SdServerServiceUdpRef = ConnectionBundle_RDR_1_1c1a30fe
          EventGroup_RDR_1_f7c73cae (SdEventHandler):
            SdEventHandlerEventGroupId = 1
            SdEventHandlerHandleId = 2
            SdEventHandlerMulticastThreshold = 0
            SdEventHandlerMaxRemoteClients = 0
            SdEventHandlerTimerRef = EventGroup_RDR_1_a30b5032
            SdEventHandlerUdp: SdEventActivationRef=SoAdRoutingGroup4_573cfa1a
        consService_RDR_1_ADAS_Vehicle_Status_fb9772e0 (SdClientTimer):
          SdClientTimerInitialFindDelayMax = 0.01
          SdClientTimerInitialFindDelayMin = 0.01
          SdClientTimerInitialFindRepetitionsBaseDelay = 0.03
          SdClientTimerInitialFindRepetitionsMax = 3
          SdClientTimerRequestResponseMaxDelay = 0.01
          SdClientTimerRequestResponseMinDelay = 0.01
          SdClientTimerTTL = 3
        provService_RDR_1_Status_4d7443dc (SdServerTimer):
          SdServerTimerInitialOfferDelayMax = 0.01
          SdServerTimerInitialOfferDelayMin = 0.01
          SdServerTimerInitialOfferRepetitionBaseDelay = 0.03
          SdServerTimerInitialOfferRepetitionsMax = 3
          SdServerTimerOfferCyclicDelay = 1
          SdServerTimerRequestResponseMaxDelay = 0.01
          SdServerTimerRequestResponseMinDelay = 0.01
          SdServerTimerTTL = 3
        provService_RDR_1_Detections_5ab771e8 (SdServerTimer):
          SdServerTimerInitialOfferDelayMax = 0.01
          SdServerTimerInitialOfferDelayMin = 0.01
          SdServerTimerInitialOfferRepetitionBaseDelay = 0.03
          SdServerTimerInitialOfferRepetitionsMax = 3
          SdServerTimerOfferCyclicDelay = 1
          SdServerTimerRequestResponseMaxDelay = 0.01
          SdServerTimerRequestResponseMinDelay = 0.01
          SdServerTimerTTL = 3
        provService_RDR_1_Detections_89f78c9f (SdServerService):
          SdServerServiceId = 16
          SdServerServiceInstanceId = 1
          SdServerServiceMajorVersion = 1
          SdServerServiceMinorVersion = 0
          SdServerServiceAutoAvailable = false
          SdServerServiceHandleId = 0
          SdServerServiceTimerRef = provService_RDR_1_Detections_5ab771e8
          SdServerServiceUdpRef = ConnectionBundle_RDR_1_1c1a30fe
          EventGroup_RDR_1_ca62382d (SdEventHandler):
            SdEventHandlerEventGroupId = 1
            SdEventHandlerHandleId = 0
            SdEventHandlerMulticastThreshold = 0
            SdEventHandlerMaxRemoteClients = 0
            SdEventHandlerTimerRef = EventGroup_RDR_1_0937cbe9
            SdEventHandlerUdp: SdEventActivationRef=SoAdRoutingGroup2_be5f5f2f
        SdInstanceMulticastRxPdu: SdRxPduId=0, SdRxPduRef=GenerelPurposePDU7_a57231d8_Rx
        SdInstanceUnicastRxPdu: SdRxPduId=1, SdRxPduRef=GenerelPurposePDU4_a7ac36ff_Rx
        consServiceGrp_RDR_1_ADAS_Vehicle_Status_0dbda357 (SdClientTimer):
          SdClientTimerInitialFindDelayMax = 0.01
          SdClientTimerInitialFindDelayMin = 0.01
          SdClientTimerInitialFindRepetitionsBaseDelay = 0.03
          SdClientTimerInitialFindRepetitionsMax = 3
          SdClientTimerRequestResponseMaxDelay = 0.01
          SdClientTimerRequestResponseMinDelay = 0.01
          SdClientTimerTTL = 3
    SdGeneral:
      SdDevErrorDetect = true
      SdMainFunctionCycleTime = 0.005
      SdVersionInfoApi = false
      SdMaxNrOptionsPerMsg = 10
      SdRandomNumberFunctionIncludeFile = Appl_Rand.h
      SdRandomNumberFunction = Appl_Crypto_GetRandNo
      SdSafeBswChecks = true
      SdSetRemAddrOfClientRxMulticastSoCon = true
      SdSubscribeEventgroupRetryEnable = false
      SdGetAndResetMeasurementDataApi = false
      SdRuntimeMeasurementSupport = true
      SdRuntimeErrorReport = true
      SdFastSubscriptionRecoveryAfterReboot = false
      SdEnableAclPolicyCheck = false
      SdEnableSecurityEventReporting = false
      SdTxBufferSize = 1464
      SdGeneration:
        SdOutOfBoundsWriteProtectionStrategy = NONE
        SdOutOfBoundsWriteSanitizer = false
        SdOutOfBoundsReadSanitizer = false
        SdReduceConstantData2Define = false
        SdBoolDataInArrayOfStructStrategy = BOOLEAN
        SdDeduplicateIndirectedData = false
        SdDataDeduplicationStrategy = NONE
        SdReduceBoolDataByNegationThreshold = 0
        SdReduceBoolDataByNumericalComparisonThreshold = 0
        SdReduceBoolDataByNumericalRelationThreshold = 0
        SdReduceBoolDataByNumericalOperandStrategy = NONE
        SdReduceNumericalDataByOffsetThreshold = 0
        SdReduceNumericalDataByArraySubtractionThreshold = 0
        SdShortSymbols = false
        SdInterfacesForDeactivatedData = false
        SdReferringKeysInComments = false
        SdEnableAdditionalRAMDebugData = false
