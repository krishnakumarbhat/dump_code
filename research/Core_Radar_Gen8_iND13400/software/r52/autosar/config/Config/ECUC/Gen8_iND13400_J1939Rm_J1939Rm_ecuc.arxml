AUTOSAR XML (schema 00053)
package /ActiveEcuC
  module config J1939Rm: implementation-config-variant=VARIANT-PRE-COMPILE
    J1939RmConfigSet
      J1939RmChannel:
        J1939RmAckQueueSize = (unset)
        J1939RmRequestQueueSize = (unset)
        J1939RmRequestTimeoutMonitors = (unset)
        J1939RmComMNetworkHandleRef = CN_VCAN_RADAR_489180b6
      J1939RmNode: J1939RmNodeChannelRef=(unset), J1939RmNmNodeRef=(unset)
        J1939RmUser:
          J1939RmUserAckIndication = (unset)
          J1939RmUserRequestIndication = (unset)
          J1939RmUserSendAck = (unset)
          J1939RmUserSendRequest = (unset)
          J1939RmUserTimeoutSupervision = (unset)
          J1939RmUserType = J1939RM_USER_J1939DCM
          J1939RmUserId = 1
      VCAN_RADAR_J1939_0bcb74f6 (J1939RmChannel):
        J1939RmAckQueueSize = (unset)
        J1939RmRequestQueueSize = (unset)
        J1939RmRequestTimeoutMonitors = (unset)
        J1939RmComMNetworkHandleRef = CN_VCAN_RADAR_489180b6
    J1939RmGeneral:
      J1939RmDevErrorDetect = (unset)
      J1939RmMainFunctionPeriod = (unset)
      J1939RmSupportAckIndication = (unset)
      J1939RmSupportAckTransmission = (unset)
      J1939RmSupportRequestIndication = (unset)
      J1939RmSupportRequestTransmission = (unset)
      J1939RmSupportTimeoutSupervision = (unset)
      J1939RmTxConfirmationTimeout = (unset)
      J1939RmVersionInfoApi = (unset)
