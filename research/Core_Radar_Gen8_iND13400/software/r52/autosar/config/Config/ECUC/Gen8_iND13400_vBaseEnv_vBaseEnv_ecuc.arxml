AUTOSAR XML (schema 00053)
package /ActiveEcuC
  module config vBaseEnv: implementation-config-variant=VARIANT-PRE-COMPILE, module-description=vBaseEnv_Impl
    vBaseEnvGeneral: vBaseEnvTestedDerivativeRef=Generic_Derivative
      Canoeemu (vBaseEnvDerivativeInformation):
        vBaseEnvTestedDerivative = VTT
        vBaseEnvTestedDerivativeDescription = vVirtualTarget VTTonly environment
        vBaseEnvCpuCore = OTHER
        vBaseEnvCpuCoreAmount = 1
        vBaseEnvCpuMaxFrequency = 100000000
        vBaseEnvAvailableChannels_Flexray = 0
        vBaseEnvAvailableChannels_Can = 0
        vBaseEnvAvailableChannels_Lin = 0
        vBaseEnvAvailableChannels_Ethernet = 0
        vBaseEnvAvailableChannels_Hyperbus = 0
        vBaseEnvAvailableChannels_I2c = 0
        vBaseEnvAvailableChannels_Spi = 0
        vBaseEnvAvailableChannels_EthernetSwitch = 0
      Generic_Derivative (vBaseEnvDerivativeInformation):
        vBaseEnvTestedDerivative = Generic_Deivative
        vBaseEnvTestedDerivativeDescription = This is just a placeholder! Please create a suitable derivative configuration.
        vBaseEnvCpuCore = OTHER
        vBaseEnvCpuCoreAmount = 1
        vBaseEnvCpuMaxFrequency = 100000000
        vBaseEnvAvailableChannels_Flexray = 0
        vBaseEnvAvailableChannels_Can = 0
        vBaseEnvAvailableChannels_Lin = 0
        vBaseEnvAvailableChannels_Ethernet = 0
        vBaseEnvAvailableChannels_Hyperbus = 0
        vBaseEnvAvailableChannels_I2c = 0
        vBaseEnvAvailableChannels_Spi = 0
        vBaseEnvAvailableChannels_EthernetSwitch = 0
        SystemRAM (vBaseEnvMemLayoutHwRegion): vBaseEnvHwRegionSize=1048576, vBaseEnvHwRegionStartAddress=268435456, vBaseEnvHwRegionType=RAM
        SystemROM (vBaseEnvMemLayoutHwRegion): vBaseEnvHwRegionSize=1048576, vBaseEnvHwRegionStartAddress=0, vBaseEnvHwRegionType=ROM
      SystemRAM (vBaseEnvMemLayoutHwRegion)
      SystemROM (vBaseEnvMemLayoutHwRegion)
