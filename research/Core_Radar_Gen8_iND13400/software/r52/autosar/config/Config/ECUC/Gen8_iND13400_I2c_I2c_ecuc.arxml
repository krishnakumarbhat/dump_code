AUTOSAR XML (schema 00049)
package /ActiveEcuC
  module config I2c: implementation-config-variant=VARIANT-PRE-COMPILE, module-description=I2c_Impl
    I2cDeviceConfig:
      I2cDeviceMode = I2C_DEVICE_MASTER_MODE
      I2cBaudRate = I2C_BUS_SPEED_FAST
      I2cOperationMode = I2C_INTERRUPT_MODE
      I2cJobEndNotification = Pmic_I2c_JobEndNotification
      I2cCallCycle = 0.1
      I2cSlaveConfig: I2cTenBitsAddress=false, I2cAllowGeneralCall=false, I2cAddressSlave=105
    I2cGeneral: I2cDevErrorDetect=false, I2cVersionInfoApi=false, I2cBusFaultCallout=NULL_PTR, I2cEnableBusRecovery=true, I2c_BusStuckTimeout=0.05
