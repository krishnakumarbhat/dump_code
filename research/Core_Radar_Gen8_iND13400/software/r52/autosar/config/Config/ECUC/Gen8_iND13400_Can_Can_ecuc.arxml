AUTOSAR XML (schema 00053)
package /ActiveEcuC
  module config Can: implementation-config-variant=VARIANT-PRE-COMPILE, module-description=Can_Impl
    CanConfigSet
      CN_PCAN_RADAR_458ff0f1_Tx (CanHardwareObject):
        CanHandleType = BASIC
        CanObjectType = TRANSMIT
        CanTriggerTransmitEnable = false
        CanHwObjectCount = 1
        CanIdType = MIXED
        CanObjectId = 0
        CanFdPaddingValue = 0
        CanHardwareObjectUsesPolling = false
        CanControllerRef = CT_PCAN_RADAR_a3a0f56c
      CN_PCAN_RADAR_a729ccfc_Rx (CanHardwareObject):
        CanHandleType = BASIC
        CanIdType = MIXED
        CanObjectType = RECEIVE
        CanTriggerTransmitEnable = false
        CanHwObjectCount = 1
        CanObjectId = 1
        CanFdPaddingValue = 0
        CanHardwareObjectUsesPolling = false
        CanControllerRef = CT_PCAN_RADAR_a3a0f56c
        CanMainFunctionRWPeriodRef = CanMainFunctionRWPeriods
        7 x CanHwFilter:
          CanHwFilter_FL_Radar_Msgs: CanHwFilterCode=152, CanHwFilterMask=2040
          CanHwFilter_Extended: CanHwFilterCode=2147483648, CanHwFilterMask=2147483648
          CanHwFilter_FL_Radar_Detections: CanHwFilterCode=640, CanHwFilterMask=2016
          CanHwFilter_Timesync: CanHwFilterCode=1, CanHwFilterMask=2047
          CanHwFilter_RL_Xcp: CanHwFilterCode=16, CanHwFilterMask=2047
          CanHwFilter_FL_Xcp: CanHwFilterCode=40, CanHwFilterMask=2047
          CanHwFilter_FC_Xcp: CanHwFilterCode=48, CanHwFilterMask=2047
      CanController2_VCAN (CanController):
        CanWakeupFunctionalityAPI = false
        CanWakeupProcessing = INTERRUPT
        CanWakeupSupport = false
        CanBusoffProcessing = INTERRUPT
        CanControllerActivation = true
        CanControllerBaseAddress = 0
        CanRxProcessing = MIXED
        CanTxProcessing = INTERRUPT
        CanControllerId = 0
        CanControllerDefaultBaudrate = CanController2_VCAN/CanControllerBaudrateConfig
        CanCpuClockRef = clk_can
        CanControllerBaudrateConfig:
          CanControllerBaudRate = 500
          CanControllerBaudRateConfigID = 0
          CanControllerPropSeg = 8
          CanControllerSeg1 = 7
          CanControllerSeg2 = 4
          CanControllerSyncJumpWidth = 2
      CT_PCAN_RADAR_a3a0f56c (CanController):
        CanControllerActivation = true
        CanWakeupFunctionalityAPI = false
        CanWakeupProcessing = INTERRUPT
        CanWakeupSupport = false
        CanBusoffProcessing = INTERRUPT
        CanControllerBaseAddress = 0
        CanControllerId = 1
        CanRxProcessing = MIXED
        CanTxProcessing = INTERRUPT
        CanControllerDefaultBaudrate = CT_PCAN_RADAR_a3a0f56c/CanControllerBaudrateConfig
        CanCpuClockRef = clk_can
        CanControllerBaudrateConfig:
          CanControllerBaudRate = 500
          CanControllerBaudRateConfigID = 0
          CanControllerPropSeg = 16
          CanControllerSeg1 = 13
          CanControllerSeg2 = 10
          CanControllerSyncJumpWidth = 5
          CanControllerFdBaudrateConfig:
            CanControllerFdBaudRate = 5000
            CanControllerPropSeg = 1
            CanControllerSeg1 = 1
            CanControllerSeg2 = 1
            CanControllerSyncJumpWidth = 1
            CanControllerTxBitRateSwitch = true
            CanControllerSspOffset = 2
      CanController2_VCAN_Tx (CanHardwareObject):
        CanTriggerTransmitEnable = false
        CanHandleType = BASIC
        CanHwObjectCount = 1
        CanIdType = EXTENDED
        CanObjectId = 2
        CanObjectType = TRANSMIT
        CanFdPaddingValue = 0
        CanHardwareObjectUsesPolling = false
        CanControllerRef = CanController2_VCAN
      CanController2_VCAN_Rx (CanHardwareObject):
        CanTriggerTransmitEnable = false
        CanHandleType = BASIC
        CanHwObjectCount = 1
        CanIdType = EXTENDED
        CanObjectId = 3
        CanObjectType = RECEIVE
        CanFdPaddingValue = 0
        Can_InternalRxBufferSize = 1
        CanHardwareObjectUsesPolling = false
        CanControllerRef = CanController2_VCAN
        CanHwFilter: CanHwFilterCode=0, CanHwFilterMask=2147483648
    CanGeneral:
      CanIndex = 0
      CanMainFunctionWakeupPeriod = 0
      CanLPduReceiveCalloutFunction = GenericUserCallout
      CanMultiplexedTransmission = false
      CanTimeoutDuration = 1
      CanDevErrorDetect = false
      CanMainFunctionModePeriod = 0.05
      CanVersionInfoApi = false
      CanAcfErrorThreshold = 1
      CanEccCorrectableErrorThreshold = 10
      CanSetBaudrateApi = false
      CanMainFunctionBusoffPeriod = 0.05
      CanEnableECCProtection = false
      CanEnableSpatialRedundancy = false
      CanTrcvEnableStandbyControl = false
      CanSafetyErrorCallout = NULL_PTR
      CanMainFunctionRWPeriods: CanMainFunctionReadPeriod=0.01, CanMainFunctionWritePeriod=0.01
