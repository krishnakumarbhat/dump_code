AUTOSAR XML (schema 00053)
package /ActiveEcuC
  module config EthSM: implementation-config-variant=VARIANT-PRE-COMPILE, module-description=EthSM_Impl
    EthSMGeneral: EthSMDevErrorDetect=true, EthSMMainFunctionPeriod=0.02, EthSMVersionInfoApi=false, EthSMEnableEthIfApiTimeout=false, EthSMSafeBswChecks=true
      EthSMGeneration: EthSMOutOfBoundsWriteSanitizer=false, EthSMOutOfBoundsReadSanitizer=false, EthSMShortSymbols=false
    cnctr_RDR_RdrNet_5172a59b (EthSMNetwork):
      EthSMConfirmationTimeout = 0.1
      EthSMMaxNumRetry = 0
      EthSMStackType = TcpIp
      EthSMComMNetworkHandleRef = cnctr_RDR_RdrNet_5172a59b
      EthSMEthIfControllerRef = cnctr_RDR_RdrNet_5172a59b
