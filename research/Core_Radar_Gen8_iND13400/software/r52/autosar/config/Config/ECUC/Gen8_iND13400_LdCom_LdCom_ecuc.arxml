AUTOSAR XML (schema 00053)
package /ActiveEcuC
  module config LdCom: implementation-config-variant=VARIANT-PRE-COMPILE, module-description=LdCom_Impl
    LdComGeneral: LdComDevErrorDetect=true, LdComVersionInfoApi=false, LdComSafeBswChecks=true
      LdComGeneration:
        LdComReduceConstantData2Define = false
        LdComReduceBoolDataByNumericalComparisonThreshold = 2
        LdComReduceDataByStreaming = false
        LdComReduceBoolDataByNumericalRelationThreshold = 2
        LdComOutOfBoundsReadSanitizer = false
        LdComShortSymbols = false
        LdComInterfacesForDeactivatedData = false
        LdComReferringKeysInComments = false
        LdComEnableAdditionalRAMDebugData = false
    LdComConfig
      4 x LdComIPdu, all with LdComSystemTemplateSignalRef=Mapping1:
        signalPdu_RDR_1_SW_Info_b4e751e3_Tx: LdComApiType=LDCOM_IF, LdComIPduDirection=LDCOM_SEND, LdComHandleId=2, LdComPduRef=signalPdu_RDR_1_SW_Info_b4e751e3_Tx
        signalPdu_ADAS_Vehicle_Status_638dcd82_Rx: LdComApiType=LDCOM_IF, LdComIPduDirection=LDCOM_RECEIVE, LdComHandleId=0, LdComRxIndication=Rte_LdComCbkRxIndication_signalPdu_ADAS_Vehicle_Status_638dcd82_Rx, LdComPduRef=signalPdu_ADAS_Vehicle_Status_638dcd82_Rx
        signalPdu_RDR_1_Detections_52b391ee_Tx: LdComApiType=LDCOM_TP, LdComIPduDirection=LDCOM_SEND, LdComHandleId=1, LdComTxCopyTxData=Rte_LdComCbkCopyTxData_signalPdu_RDR_1_Detections_52b391ee_Tx, LdComTpTxConfirmation=Rte_LdComCbkTpTxConfirmation_signalPdu_RDR_1_Detections_52b391ee_Tx, LdComPduRef=signalPdu_RDR_1_Detections_52b391ee_Tx
        signalPdu_RDR_1_Status_9d482741_Tx: LdComApiType=LDCOM_IF, LdComIPduDirection=LDCOM_SEND, LdComHandleId=3, LdComPduRef=signalPdu_RDR_1_Status_9d482741_Tx
