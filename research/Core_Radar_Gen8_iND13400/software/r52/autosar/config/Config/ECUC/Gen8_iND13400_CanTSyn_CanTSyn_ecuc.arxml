AUTOSAR XML (schema 00053)
package /ActiveEcuC
  module config CanTSyn: implementation-config-variant=VARIANT-PRE-COMPILE, module-description=CanTSyn_Impl
    CanTSynGeneral:
      CanTSynDevErrorDetect = true
      CanTSynMainFunctionPeriod = 0.01
      CanTSynVersionInfoApi = false
      CanTSynMessageCompatibility = AR_4_3_X
      CanTSynSafeBswChecks = true
    CanTSynGlobalTimeDomain: CanTSynGlobalTimeDomainId=1, CanTSynUseExtendedMsgFormat=false, CanTSynSynchronizedTimeBaseRef=StbMSynchronizedTimeBase_CanTsync
      CanTSynGlobalTimeFupDataIDList
        16 x CanTSynGlobalTimeFupDataIDListElement:
          CanTSynGlobalTimeFupDataIDListElement: CanTSynGlobalTimeFupDataIDListIndex=0, CanTSynGlobalTimeFupDataIDListValue=149
          CanTSynGlobalTimeFupDataIDListElement_1: CanTSynGlobalTimeFupDataIDListIndex=1, CanTSynGlobalTimeFupDataIDListValue=178
          CanTSynGlobalTimeFupDataIDListElement_2: CanTSynGlobalTimeFupDataIDListIndex=2, CanTSynGlobalTimeFupDataIDListValue=48
          CanTSynGlobalTimeFupDataIDListElement_3: CanTSynGlobalTimeFupDataIDListIndex=3, CanTSynGlobalTimeFupDataIDListValue=27
          CanTSynGlobalTimeFupDataIDListElement_4: CanTSynGlobalTimeFupDataIDListIndex=4, CanTSynGlobalTimeFupDataIDListValue=29
          CanTSynGlobalTimeFupDataIDListElement_5: CanTSynGlobalTimeFupDataIDListIndex=5, CanTSynGlobalTimeFupDataIDListValue=185
          CanTSynGlobalTimeFupDataIDListElement_6: CanTSynGlobalTimeFupDataIDListIndex=6, CanTSynGlobalTimeFupDataIDListValue=17
          CanTSynGlobalTimeFupDataIDListElement_7: CanTSynGlobalTimeFupDataIDListIndex=7, CanTSynGlobalTimeFupDataIDListValue=203
          CanTSynGlobalTimeFupDataIDListElement_8: CanTSynGlobalTimeFupDataIDListIndex=8, CanTSynGlobalTimeFupDataIDListValue=148
          CanTSynGlobalTimeFupDataIDListElement_9: CanTSynGlobalTimeFupDataIDListIndex=9, CanTSynGlobalTimeFupDataIDListValue=68
          CanTSynGlobalTimeFupDataIDListElement_10: CanTSynGlobalTimeFupDataIDListIndex=10, CanTSynGlobalTimeFupDataIDListValue=204
          CanTSynGlobalTimeFupDataIDListElement_11: CanTSynGlobalTimeFupDataIDListIndex=11, CanTSynGlobalTimeFupDataIDListValue=36
          CanTSynGlobalTimeFupDataIDListElement_12: CanTSynGlobalTimeFupDataIDListIndex=12, CanTSynGlobalTimeFupDataIDListValue=101
          CanTSynGlobalTimeFupDataIDListElement_13: CanTSynGlobalTimeFupDataIDListIndex=13, CanTSynGlobalTimeFupDataIDListValue=195
          CanTSynGlobalTimeFupDataIDListElement_14: CanTSynGlobalTimeFupDataIDListIndex=14, CanTSynGlobalTimeFupDataIDListValue=44
          CanTSynGlobalTimeFupDataIDListElement_15: CanTSynGlobalTimeFupDataIDListIndex=15, CanTSynGlobalTimeFupDataIDListValue=16
      CanTSynGlobalTimeSyncDataIDList
        16 x CanTSynGlobalTimeSyncDataIDListElement:
          CanTSynGlobalTimeSyncDataIDListElement: CanTSynGlobalTimeSyncDataIDListIndex=0, CanTSynGlobalTimeSyncDataIDListValue=246
          CanTSynGlobalTimeSyncDataIDListElement_1: CanTSynGlobalTimeSyncDataIDListIndex=1, CanTSynGlobalTimeSyncDataIDListValue=35
          CanTSynGlobalTimeSyncDataIDListElement_2: CanTSynGlobalTimeSyncDataIDListIndex=2, CanTSynGlobalTimeSyncDataIDListValue=39
          CanTSynGlobalTimeSyncDataIDListElement_3: CanTSynGlobalTimeSyncDataIDListIndex=3, CanTSynGlobalTimeSyncDataIDListValue=72
          CanTSynGlobalTimeSyncDataIDListElement_4: CanTSynGlobalTimeSyncDataIDListIndex=4, CanTSynGlobalTimeSyncDataIDListValue=84
          CanTSynGlobalTimeSyncDataIDListElement_5: CanTSynGlobalTimeSyncDataIDListIndex=5, CanTSynGlobalTimeSyncDataIDListValue=175
          CanTSynGlobalTimeSyncDataIDListElement_6: CanTSynGlobalTimeSyncDataIDListIndex=6, CanTSynGlobalTimeSyncDataIDListValue=138
          CanTSynGlobalTimeSyncDataIDListElement_7: CanTSynGlobalTimeSyncDataIDListIndex=7, CanTSynGlobalTimeSyncDataIDListValue=251
          CanTSynGlobalTimeSyncDataIDListElement_8: CanTSynGlobalTimeSyncDataIDListIndex=8, CanTSynGlobalTimeSyncDataIDListValue=13
          CanTSynGlobalTimeSyncDataIDListElement_9: CanTSynGlobalTimeSyncDataIDListIndex=9, CanTSynGlobalTimeSyncDataIDListValue=135
          CanTSynGlobalTimeSyncDataIDListElement_10: CanTSynGlobalTimeSyncDataIDListIndex=10, CanTSynGlobalTimeSyncDataIDListValue=106
          CanTSynGlobalTimeSyncDataIDListElement_11: CanTSynGlobalTimeSyncDataIDListIndex=11, CanTSynGlobalTimeSyncDataIDListValue=15
          CanTSynGlobalTimeSyncDataIDListElement_12: CanTSynGlobalTimeSyncDataIDListIndex=12, CanTSynGlobalTimeSyncDataIDListValue=71
          CanTSynGlobalTimeSyncDataIDListElement_13: CanTSynGlobalTimeSyncDataIDListIndex=13, CanTSynGlobalTimeSyncDataIDListValue=120
          CanTSynGlobalTimeSyncDataIDListElement_14: CanTSynGlobalTimeSyncDataIDListIndex=14, CanTSynGlobalTimeSyncDataIDListValue=49
          CanTSynGlobalTimeSyncDataIDListElement_15: CanTSynGlobalTimeSyncDataIDListIndex=15, CanTSynGlobalTimeSyncDataIDListValue=79
      CanTSynGlobalTimeSlave:
        CanTSynGlobalTimeFollowUpTimeout = 1
        CanTSynGlobalTimeSequenceCounterJumpWidth = 1
        CanTSynRxCrcValidated = CRC_VALIDATED
        variation-point = post-build-variant-condition{matching-criterion=RDR_POS, value=0}
        CanTSynGlobalTimeSlavePdu: CanTSynGlobalTimeSlaveHandleId=0, CanTSynGlobalTimePduRef=SYS_TIME_SYNC_oPCAN_RADAR_ba7b9b28_Rx
      CanTSynGlobalTimeMaster:
        CanTSynGlobalTimeDebounceTime = 0.01
        CanTSynGlobalTimeTxCrcSecured = CRC_SUPPORTED
        CanTSynGlobalTimeTxPeriod = 1
        CanTSynImmediateTimeSync = false
        CanTSynMasterConfirmationTimeout = 1
        variation-point = post-build-variant-condition{matching-criterion=RDR_POS, value=4}
        CanTSynGlobalTimeMasterPdu: CanTSynGlobalTimeMasterConfirmationHandleId=0, CanTSynGlobalTimePduRef=SYS_TIME_SYNC_oPCAN_RADAR_ba7b9b28_Tx
      6 x CanTSynGlobalTimeSlave, all with CanTSynGlobalTimeFollowUpTimeout=1, CanTSynGlobalTimeSequenceCounterJumpWidth=1, CanTSynRxCrcValidated=CRC_VALIDATED:
        CanTSynGlobalTimeSlave: variation-point=post-build-variant-condition{matching-criterion=RDR_POS, value=1}
          CanTSynGlobalTimeSlavePdu: CanTSynGlobalTimeSlaveHandleId=0, CanTSynGlobalTimePduRef=SYS_TIME_SYNC_oPCAN_RADAR_ba7b9b28_Rx
        CanTSynGlobalTimeSlave: variation-point=post-build-variant-condition{matching-criterion=RDR_POS, value=2}
          CanTSynGlobalTimeSlavePdu: CanTSynGlobalTimeSlaveHandleId=0, CanTSynGlobalTimePduRef=SYS_TIME_SYNC_oPCAN_RADAR_ba7b9b28_Rx
        CanTSynGlobalTimeSlave: variation-point=post-build-variant-condition{matching-criterion=RDR_POS, value=3}
          CanTSynGlobalTimeSlavePdu: CanTSynGlobalTimeSlaveHandleId=0, CanTSynGlobalTimePduRef=SYS_TIME_SYNC_oPCAN_RADAR_ba7b9b28_Rx
        CanTSynGlobalTimeSlave: variation-point=post-build-variant-condition{matching-criterion=RDR_POS, value=5}
          CanTSynGlobalTimeSlavePdu: CanTSynGlobalTimeSlaveHandleId=0, CanTSynGlobalTimePduRef=SYS_TIME_SYNC_oPCAN_RADAR_ba7b9b28_Rx
        CanTSynGlobalTimeSlave: variation-point=post-build-variant-condition{matching-criterion=RDR_POS, value=6}
          CanTSynGlobalTimeSlavePdu: CanTSynGlobalTimeSlaveHandleId=0, CanTSynGlobalTimePduRef=SYS_TIME_SYNC_oPCAN_RADAR_ba7b9b28_Rx
        CanTSynGlobalTimeSlave: variation-point=post-build-variant-condition{matching-criterion=RDR_POS, value=7}
          CanTSynGlobalTimeSlavePdu: CanTSynGlobalTimeSlaveHandleId=0, CanTSynGlobalTimePduRef=SYS_TIME_SYNC_oPCAN_RADAR_ba7b9b28_Rx
