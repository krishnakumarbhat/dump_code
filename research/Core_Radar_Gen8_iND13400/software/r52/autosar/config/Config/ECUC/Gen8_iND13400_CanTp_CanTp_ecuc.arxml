[part 1 of 2: package /ActiveEcuC]
AUTOSAR XML (schema 00053)
package /ActiveEcuC
  module config CanTp: implementation-config-variant=VARIANT-POST-BUILD-SELECTABLE, module-description=CanTp_Impl
    CanTpGeneral:
      CanTpChangeParameterApi = false
      CanTpDevErrorDetect = true
      CanTpPaddingByte = 204
      CanTpReadParameterApi = false
      CanTpVersionInfoApi = false
      CanTpPaddingActive = true
      CanTpHavePaddingByte = true
      CanTpEnableSplitMainFunction = false
      CanTpSupportStandardAddressing = true
      CanTpSupportExtendedAddressing = true
      CanTpSupportMixed11Addressing = true
      CanTpSupportMixed29Addressing = true
      CanTpSupportNormalFixedAddressing = true
      CanTpSupportCustomAddressing = false
      CanTpOnlyNotifyInformedAppl = true
      CanTpRc = false
      CanTpTc = true
      CanTpSafeBswChecks = true
      CanTpRuntimeErrorReport = false
      CanTpUseOnlyFirstFc = true
      CanTpFlexibleDataRateSupport = true
      CanTpSupportLongFirstFrames = true
    CanTpConfig: CanTpMainFunctionPeriod=0.005
      192 x CanTpChannel, all with CanTpChannelMode=CANTP_MODE_FULL_DUPLEX:
        TPCH_636ba87a: variation-point=post-build-variant-condition{matching-criterion=RDR_POS, value=0}
          CanTpRxNSdu_6a4050a8 (CanTpRxNSdu):
            CanTpRxAddressingFormat = CANTP_STANDARD
            CanTpRxDl = 8
            CanTpRxTaType = CANTP_FUNCTIONAL
            CanTpNbr = 0.1
            CanTpRxNSduId = 8
            CanTpRxPaddingActivation = CANTP_ON
            CanTpRxNSduRef = PCAN_DIAG_REQ_FUNC_OBD1_oPCAN_RADAR_20_25c43a7c_Rx
            CanTpRxNPdu_007a5691 (CanTpRxNPdu): CanTpRxNPduId=16, CanTpRxNPduRef=PCAN_DIAG_REQ_FUNC_OBD1_Tp_oPCAN_RADAR_20_9397638b_Rx
        TPCH_a6a7d371: variation-point=post-build-variant-condition{matching-criterion=RDR_POS, value=0}
          CanTpRxNSdu_d603b303 (CanTpRxNSdu):
            CanTpRxAddressingFormat = CANTP_STANDARD
            CanTpRxDl = 8
            CanTpRxTaType = CANTP_FUNCTIONAL
            CanTpNbr = 0.1
            CanTpRxNSduId = 13
            CanTpRxPaddingActivation = CANTP_ON
            CanTpRxNSduRef = PCAN_DIAG_REQ_FUNC_OTA_oPCAN_RADAR_20_e1100275_Rx
            CanTpRxNPdu_7236ae3d (CanTpRxNPdu): CanTpRxNPduId=21, CanTpRxNPduRef=PCAN_DIAG_REQ_FUNC_OTA_Tp_oPCAN_RADAR_20_0a67f2f6_Rx
        TPCH_d25c1521: variation-point=post-build-variant-condition{matching-criterion=RDR_POS, value=0}
          CanTpRxNSdu_b509cdf9 (CanTpRxNSdu):
            CanTpRxAddressingFormat = CANTP_STANDARD
            CanTpRxDl = 64
            CanTpRxTaType = CANTP_CANFD_FUNCTIONAL
            CanTpNbr = 0.1
            CanTpRxNSduId = 19
            CanTpRxPaddingActivation = CANTP_ON
            CanTpRxNSduRef = PCAN_DIAG_REQ_FUNC_OTA_oPCAN_RADAR_a013523e_Rx
            CanTpRxNPdu_6f50186e (CanTpRxNPdu): CanTpRxNPduId=20, CanTpRxNPduRef=PCAN_DIAG_REQ_FUNC_OTA_Tp_oPCAN_RADAR_7ea6262a_Rx
        TPCH_e216a5fe: variation-point=post-build-variant-condition{matching-criterion=RDR_POS, value=0}
          CanTpRxNSdu_6b1dcdd5 (CanTpRxNSdu):
            CanTpRxAddressingFormat = CANTP_STANDARD
            CanTpRxDl = 8
            CanTpRxTaType = CANTP_PHYSICAL
            CanTpNbr = 0.01
            CanTpRxNSduId = 20
            CanTpRxPaddingActivation = CANTP_ON
            CanTpBs = 8
            CanTpNar = 1
            CanTpNcr = 1
            CanTpRxWftMax = 15
            CanTpSTmin = 0.02
            CanTpRxNSduRef = FR_DIAG_REQ_PHY_PLANT_oVCAN_RADAR_d1c8c991_Rx
            CanTpRxNPdu_11900290 (CanTpRxNPdu): CanTpRxNPduId=3, CanTpRxNPduRef=FR_DIAG_REQ_PHY_PLANT_Tp_oVCAN_RADAR_bda0e30b_Rx
            CanTpTxFcNPdu_11900290 (CanTpTxFcNPdu): CanTpTxFcNPduConfirmationPduId=3, CanTpTxFcNPduRef=FR_DIAG_RES_PHY_PLANT_Tp_oVCAN_RADAR_4233d42d_Tx
          CanTpTxNSdu_6b1dcdd5 (CanTpTxNSdu):
            CanTpTxAddressingFormat = CANTP_STANDARD
            CanTpTxDl = 8
            CanTpTxTaType = CANTP_PHYSICAL
            CanTpNas = 1
            CanTpNcs = 0.01
            CanTpTc = false
            CanTpTxNSduId = 9
            CanTpTxPaddingActivation = CANTP_ON
            CanTpNbs = 1
            CanTpTxNSduRef = FR_DIAG_RES_PHY_PLANT_oVCAN_RADAR_5fef2467_Tx
            CanTpRxFcNPdu_336ad662 (CanTpRxFcNPdu): CanTpRxFcNPduId=3, CanTpRxFcNPduRef=FR_DIAG_REQ_PHY_PLANT_Tp_oVCAN_RADAR_bda0e30b_Rx
            CanTpTxNPdu_336ad662 (CanTpTxNPdu): CanTpTxNPduConfirmationPduId=3, CanTpTxNPduRef=FR_DIAG_RES_PHY_PLANT_Tp_oVCAN_RADAR_4233d42d_Tx
        TPCH_9592843e: variation-point=post-build-variant-condition{matching-criterion=RDR_POS, value=0}
          CanTpRxNSdu_c5ebb271 (CanTpRxNSdu):
            CanTpRxAddressingFormat = CANTP_STANDARD
            CanTpRxDl = 8
            CanTpRxTaType = CANTP_FUNCTIONAL
            CanTpNbr = 0.1
            CanTpRxNSduId = 11
            CanTpRxPaddingActivation = CANTP_ON
            CanTpRxNSduRef = DIAG_REQ_FNC_OTA_oVCAN_RADAR_e787ed21_Rx
            CanTpRxNPdu_25d1c137 (CanTpRxNPdu): CanTpRxNPduId=14, CanTpRxNPduRef=DIAG_REQ_FNC_OTA_Tp_oVCAN_RADAR_6f75a08a_Rx
        TPCH_a9725309: variation-point=post-build-variant-condition{matching-criterion=RDR_POS, value=0}
          CanTpTxNSdu_0057d142 (CanTpTxNSdu):
            CanTpTxAddressingFormat = CANTP_STANDARD
            CanTpTxDl = 64
            CanTpTxTaType = CANTP_CANFD_PHYSICAL
            CanTpNas = 1
            CanTpNcs = 0.01
            CanTpTc = false
            CanTpTxNSduId = 7
            CanTpTxPaddingActivation = CANTP_ON
            CanTpNbs = 1
            CanTpTxNSduRef = PCAN_DIAG_RESP_PHYS_OTA_oPCAN_RADAR_2a569d3c_Tx
            CanTpRxFcNPdu_7f531fd8 (CanTpRxFcNPdu): CanTpRxFcNPduId=9, CanTpRxFcNPduRef=PCAN_DIAG_REQ_PHYS_OTA_Tp_oPCAN_RADAR_94a46e49_Rx
            CanTpTxNPdu_7f531fd8 (CanTpTxNPdu): CanTpTxNPduConfirmationPduId=9, CanTpTxNPduRef=PCAN_DIAG_RESP_PHYS_OTA_Tp_oPCAN_RADAR_37f68c50_Tx
          CanTpRxNSdu_0057d142 (CanTpRxNSdu):
            CanTpRxAddressingFormat = CANTP_STANDARD
            CanTpRxDl = 64
            CanTpRxTaType = CANTP_CANFD_PHYSICAL
            CanTpNbr = 0.01
            CanTpRxNSduId = 14
            CanTpRxPaddingActivation = CANTP_ON
            CanTpBs = 8
            CanTpNar = 1
            CanTpNcr = 1
            CanTpRxWftMax = 15
            CanTpSTmin = 0.02
            CanTpRxNSduRef = PCAN_DIAG_REQ_PHYS_OTA_oPCAN_RADAR_45eab9fd_Rx
            CanTpTxFcNPdu_5da9cb2a (CanTpTxFcNPdu): CanTpTxFcNPduConfirmationPduId=9, CanTpTxFcNPduRef=PCAN_DIAG_RESP_PHYS_OTA_Tp_oPCAN_RADAR_37f68c50_Tx
            CanTpRxNPdu_5da9cb2a (CanTpRxNPdu): CanTpRxNPduId=9, CanTpRxNPduRef=PCAN_DIAG_REQ_PHYS_OTA_Tp_oPCAN_RADAR_94a46e49_Rx
        TPCH_c9a12f24: variation-point=post-build-variant-condition{matching-criterion=RDR_POS, value=0}
          CanTpRxNSdu_64228dd8 (CanTpRxNSdu):
            CanTpRxAddressingFormat = CANTP_STANDARD
            CanTpRxDl = 64
            CanTpRxTaType = CANTP_CANFD_PHYSICAL
            CanTpNbr = 0.01
            CanTpRxNSduId = 16
            CanTpRxPaddingActivation = CANTP_ON
            CanTpBs = 8
            CanTpNar = 1
            CanTpNcr = 1
            CanTpRxWftMax = 15
            CanTpSTmin = 0.02
            CanTpRxNSduRef = PCAN_DIAG_REQ_PHYS_OBD2_oPCAN_RADAR_e03546e9_Rx
            CanTpTxFcNPdu_1fe0333b (CanTpTxFcNPdu): CanTpTxFcNPduConfirmationPduId=6, CanTpTxFcNPduRef=PCAN_DIAG_RESP_PHYS_OBD2_Tp_oPCAN_RADAR_6e0bad55_Tx
            CanTpRxNPdu_1fe0333b (CanTpRxNPdu): CanTpRxNPduId=6, CanTpRxNPduRef=PCAN_DIAG_REQ_PHYS_OBD2_Tp_oPCAN_RADAR_0ac35777_Rx
          CanTpTxNSdu_64228dd8 (CanTpTxNSdu):
            CanTpTxAddressingFormat = CANTP_STANDARD
            CanTpTxDl = 64
            CanTpTxTaType = CANTP_CANFD_PHYSICAL
            CanTpNas = 1
            CanTpNcs = 0.01
            CanTpTc = false
            CanTpTxNSduId = 8
            CanTpTxPaddingActivation = CANTP_ON
            CanTpNbs = 1
            CanTpTxNSduRef = PCAN_DIAG_RESP_PHYS_OBD2_oPCAN_RADAR_0c3908eb_Tx
            CanTpTxNPdu_3d1ae7c9 (CanTpTxNPdu): CanTpTxNPduConfirmationPduId=6, CanTpTxNPduRef=PCAN_DIAG_RESP_PHYS_OBD2_Tp_oPCAN_RADAR_6e0bad55_Tx
            CanTpRxFcNPdu_3d1ae7c9 (CanTpRxFcNPdu): CanTpRxFcNPduId=6, CanTpRxFcNPduRef=PCAN_DIAG_REQ_PHYS_OBD2_Tp_oPCAN_RADAR_0ac35777_Rx
        TPCH_02987720: variation-point=post-build-variant-condition{matching-criterion=RDR_POS, value=0}
          CanTpRxNSdu_0d8cb540 (CanTpRxNSdu):
            CanTpRxAddressingFormat = CANTP_STANDARD
            CanTpRxDl = 8
            CanTpRxTaType = CANTP_FUNCTIONAL
            CanTpNbr = 0.1
            CanTpRxNSduId = 12
            CanTpRxPaddingActivation = CANTP_ON
            CanTpRxNSduRef = PCAN_DIAG_REQ_FUNC_OBD2_oPCAN_RADAR_20_41244182_Rx
            CanTpRxNPdu_2f78abfb (CanTpRxNPdu): CanTpRxNPduId=18, CanTpRxNPduRef=PCAN_DIAG_REQ_FUNC_OBD2_Tp_oPCAN_RADAR_20_400c7f70_Rx
        TPCH_308e4c57: variation-point=post-build-variant-condition{matching-criterion=RDR_POS, value=0}
          CanTpRxNSdu_b76651b3 (CanTpRxNSdu):
            CanTpRxAddressingFormat = CANTP_STANDARD
            CanTpRxDl = 8
            CanTpRxTaType = CANTP_FUNCTIONAL
            CanTpNbr = 0.1
            CanTpRxNSduId = 7
            CanTpRxPaddingActivation = CANTP_ON
            CanTpRxNSduRef = DIAG_REQ_FNC_PLANT_oVCAN_RADAR_42eb2f27_Rx
            CanTpRxNPdu_ec7f19dd (CanTpRxNPdu): CanTpRxNPduId=15, CanTpRxNPduRef=DIAG_REQ_FNC_PLANT_Tp_oVCAN_RADAR_d6304422_Rx
        TPCH_5e8efa28: variation-point=post-build-variant-condition{matching-criterion=RDR_POS, value=0}
          CanTpRxNSdu_bd9a0635 (CanTpRxNSdu):
            CanTpRxAddressingFormat = CANTP_STANDARD
            CanTpRxDl = 8
            CanTpRxTaType = CANTP_PHYSICAL
            CanTpNbr = 0.01
            CanTpRxNSduId = 2
            CanTpRxPaddingActivation = CANTP_ON
            CanTpBs = 8
            CanTpNar = 1
            CanTpNcr = 1
            CanTpRxWftMax = 15
            CanTpSTmin = 0.02
            CanTpRxNSduRef = PCAN_DIAG_REQ_PHYS_OTA_oPCAN_RADAR_20_0b124a16_Rx
            CanTpTxFcNPdu_1d12fd25 (CanTpTxFcNPdu): CanTpTxFcNPduConfirmationPduId=8, CanTpTxFcNPduRef=PCAN_DIAG_RESP_PHYS_OTA_Tp_oPCAN_RADAR_20_6c821aae_Tx
            CanTpRxNPdu_1d12fd25 (CanTpRxNPdu): CanTpRxNPduId=8, CanTpRxNPduRef=PCAN_DIAG_REQ_PHYS_OTA_Tp_oPCAN_RADAR_20_96582344_Rx
          CanTpTxNSdu_bd9a0635 (CanTpTxNSdu):
            CanTpTxAddressingFormat = CANTP_STANDARD
            CanTpTxDl = 8
            CanTpTxTaType = CANTP_PHYSICAL
            CanTpNas = 1
            CanTpNcs = 0.01
            CanTpTc = false
            CanTpTxNSduId = 1
            CanTpTxPaddingActivation = CANTP_ON
            CanTpNbs = 1
            CanTpTxNSduRef = PCAN_DIAG_RESP_PHYS_OTA_oPCAN_RADAR_20_a840a80f_Tx
            CanTpRxFcNPdu_3fe829d7 (CanTpRxFcNPdu): CanTpRxFcNPduId=8, CanTpRxFcNPduRef=PCAN_DIAG_REQ_PHYS_OTA_Tp_oPCAN_RADAR_20_96582344_Rx
            CanTpTxNPdu_3fe829d7 (CanTpTxNPdu): CanTpTxNPduConfirmationPduId=8, CanTpTxNPduRef=PCAN_DIAG_RESP_PHYS_OTA_Tp_oPCAN_RADAR_20_6c821aae_Tx
        TPCH_8fe3d063: variation-point=post-build-variant-condition{matching-criterion=RDR_POS, value=0}
          CanTpRxNSdu_24fdb8bb (CanTpRxNSdu):
            CanTpRxAddressingFormat = CANTP_STANDARD
            CanTpRxDl = 8
            CanTpRxTaType = CANTP_PHYSICAL
            CanTpNbr = 0.01
            CanTpRxNSduId = 4
            CanTpRxPaddingActivation = CANTP_ON
            CanTpBs = 8
            CanTpNar = 1
            CanTpNcr = 1
            CanTpRxWftMax = 15
            CanTpSTmin = 0.02
            CanTpRxNSduRef = PCAN_DIAG_REQ_PHYS_OBD1_oPCAN_RADAR_20_f19508d6_Rx
            CanTpTxFcNPdu_53da4212 (CanTpTxFcNPdu): CanTpTxFcNPduConfirmationPduId=5, CanTpTxFcNPduRef=PCAN_DIAG_RESP_PHYS_OBD1_Tp_oPCAN_RADAR_20_f6415fa5_Tx
            CanTpRxNPdu_53da4212 (CanTpRxNPdu): CanTpRxNPduId=5, CanTpRxNPduRef=PCAN_DIAG_REQ_PHYS_OBD1_Tp_oPCAN_RADAR_20_b6648efa_Rx
          CanTpTxNSdu_24fdb8bb (CanTpTxNSdu):
            CanTpTxAddressingFormat = CANTP_STANDARD
            CanTpTxDl = 8
            CanTpTxTaType = CANTP_PHYSICAL
            CanTpNas = 1
            CanTpNcs = 0.01
            CanTpTc = false
            CanTpTxNSduId = 2
            CanTpTxPaddingActivation = CANTP_ON
            CanTpNbs = 1
            CanTpTxNSduRef = PCAN_DIAG_RESP_PHYS_OBD1_oPCAN_RADAR_20_955df2f4_Tx
            CanTpRxFcNPdu_712096e0 (CanTpRxFcNPdu): CanTpRxFcNPduId=5, CanTpRxFcNPduRef=PCAN_DIAG_REQ_PHYS_OBD1_Tp_oPCAN_RADAR_20_b6648efa_Rx
            CanTpTxNPdu_712096e0 (CanTpTxNPdu): CanTpTxNPduConfirmationPduId=5, CanTpTxNPduRef=PCAN_DIAG_RESP_PHYS_OBD1_Tp_oPCAN_RADAR_20_f6415fa5_Tx
        TPCH_c8085a38: variation-point=post-build-variant-condition{matching-criterion=RDR_POS, value=0}
          CanTpRxNSdu_80a26c19 (CanTpRxNSdu):
            CanTpRxAddressingFormat = CANTP_STANDARD
            CanTpRxDl = 8
            CanTpRxTaType = CANTP_FUNCTIONAL
            CanTpNbr = 0.1
            CanTpRxNSduId = 18
            CanTpRxPaddingActivation = CANTP_ON
            CanTpRxNSduRef = DIAG_REQ_FNC_OBD1_oVCAN_RADAR_7e5c8685_Rx
            CanTpRxNPdu_81677e4e (CanTpRxNPdu): CanTpRxNPduId=12, CanTpRxNPduRef=DIAG_REQ_FNC_OBD1_Tp_oVCAN_RADAR_260cec9f_Rx
        TPCH_481339a9: variation-point=post-build-variant-condition{matching-criterion=RDR_POS, value=0}
          CanTpTxNSdu_db835be6 (CanTpTxNSdu):
            CanTpTxAddressingFormat = CANTP_STANDARD
            CanTpTxDl = 8
            CanTpTxTaType = CANTP_PHYSICAL
            CanTpNas = 1
            CanTpNcs = 0.01
            CanTpTc = false
            CanTpTxNSduId = 5
            CanTpTxPaddingActivation = CANTP_ON
            CanTpNbs = 1
            CanTpTxNSduRef = PCAN_DIAG_RESP_PHYS_OBD2_oPCAN_RADAR_20_f1bd890a_Tx
            CanTpRxFcNPdu_8b2a1893 (CanTpRxFcNPdu): CanTpRxFcNPduId=7, CanTpRxFcNPduRef=PCAN_DIAG_REQ_PHYS_OBD2_Tp_oPCAN_RADAR_20_65ff9201_Rx
            CanTpTxNPdu_8b2a1893 (CanTpTxNPdu): CanTpTxNPduConfirmationPduId=7, CanTpTxNPduRef=PCAN_DIAG_RESP_PHYS_OBD2_Tp_oPCAN_RADAR_20_25da435e_Tx
          CanTpRxNSdu_db835be6 (CanTpRxNSdu):
            CanTpRxAddressingFormat = CANTP_STANDARD
            CanTpRxDl = 8
            CanTpRxTaType = CANTP_PHYSICAL
            CanTpNbr = 0.01
            CanTpRxNSduId = 9
            CanTpRxPaddingActivation = CANTP_ON
            CanTpBs = 8
            CanTpNar = 1
            CanTpNcr = 1
            CanTpRxWftMax = 15
            CanTpSTmin = 0.02
            CanTpRxNSduRef = PCAN_DIAG_REQ_PHYS_OBD2_oPCAN_RADAR_20_95757328_Rx
            CanTpTxFcNPdu_a9d0cc61 (CanTpTxFcNPdu): CanTpTxFcNPduConfirmationPduId=7, CanTpTxFcNPduRef=PCAN_DIAG_RESP_PHYS_OBD2_Tp_oPCAN_RADAR_20_25da435e_Tx
            CanTpRxNPdu_a9d0cc61 (CanTpRxNPdu): CanTpRxNPduId=7, CanTpRxNPduRef=PCAN_DIAG_REQ_PHYS_OBD2_Tp_oPCAN_RADAR_20_65ff9201_Rx
        TPCH_4ac61397: variation-point=post-build-variant-condition{matching-criterion=RDR_POS, value=0}
          CanTpRxNSdu_d62c6608 (CanTpRxNSdu):
            CanTpRxAddressingFormat = CANTP_STANDARD
            CanTpRxDl = 64
            CanTpRxTaType = CANTP_CANFD_FUNCTIONAL
            CanTpNbr = 0.1
            CanTpRxNSduId = 0
            CanTpRxPaddingActivation = CANTP_ON
            CanTpRxNSduRef = PCAN_DIAG_REQ_FUNC_OBD2_oPCAN_RADAR_e2bd2c08_Rx
            CanTpRxNPdu_7c29b324 (CanTpRxNPdu): CanTpRxNPduId=19, CanTpRxNPduRef=PCAN_DIAG_REQ_FUNC_OBD2_Tp_oPCAN_RADAR_de9265dd_Rx
        TPCH_8a355ab8: variation-point=post-build-variant-condition{matching-criterion=RDR_POS, value=0}
          CanTpRxNSdu_e307f5e7 (CanTpRxNSdu):
            CanTpRxAddressingFormat = CANTP_STANDARD
            CanTpRxDl = 8
            CanTpRxTaType = CANTP_FUNCTIONAL
            CanTpNbr = 0.1
            CanTpRxNSduId = 3
            CanTpRxPaddingActivation = CANTP_ON
            CanTpRxNSduRef = PCAN_DIAG_REQ_FUNC_PLANT_oPCAN_RADAR_20_c17463fa_Rx
            CanTpRxNPdu_dea5e5f6 (CanTpRxNPdu): CanTpRxNPduId=23, CanTpRxNPduRef=PCAN_DIAG_REQ_FUNC_PLANT_Tp_oPCAN_RADAR_20_d63751cc_Rx
        TPCH_1466068d: variation-point=post-build-variant-condition{matching-criterion=RDR_POS, value=0}
          CanTpTxNSdu_e66ca3b9 (CanTpTxNSdu):
            CanTpTxAddressingFormat = CANTP_STANDARD
            CanTpTxDl = 64
            CanTpTxTaType = CANTP_CANFD_PHYSICAL
            CanTpNas = 1
            CanTpNcs = 0.01
            CanTpTc = false
            CanTpTxNSduId = 6
            CanTpTxPaddingActivation = CANTP_ON
            CanTpNbs = 1
            CanTpTxNSduRef = PCAN_DIAG_RESP_PHYS_OBD1_oPCAN_RADAR_572eb9fe_Tx
            CanTpRxFcNPdu_9c58cec2 (CanTpRxFcNPdu): CanTpRxFcNPduId=4, CanTpRxFcNPduRef=PCAN_DIAG_REQ_PHYS_OBD1_Tp_oPCAN_RADAR_6e232c89_Rx
            CanTpTxNPdu_9c58cec2 (CanTpTxNPdu): CanTpTxNPduConfirmationPduId=4, CanTpTxNPduRef=PCAN_DIAG_RESP_PHYS_OBD1_Tp_oPCAN_RADAR_0aebd6ab_Tx
          CanTpRxNSdu_e66ca3b9 (CanTpRxNSdu):
            CanTpRxAddressingFormat = CANTP_STANDARD
            CanTpRxDl = 64
            CanTpRxTaType = CANTP_CANFD_PHYSICAL
            CanTpNbr = 0.01
            CanTpRxNSduId = 10
            CanTpRxPaddingActivation = CANTP_ON
            CanTpBs = 8
            CanTpNar = 1
            CanTpNcr = 1
            CanTpRxWftMax = 15
            CanTpSTmin = 0.02
            CanTpRxNSduRef = PCAN_DIAG_REQ_PHYS_OBD1_oPCAN_RADAR_bb22f7fc_Rx
            CanTpTxFcNPdu_bea21a30 (CanTpTxFcNPdu): CanTpTxFcNPduConfirmationPduId=4, CanTpTxFcNPduRef=PCAN_DIAG_RESP_PHYS_OBD1_Tp_oPCAN_RADAR_0aebd6ab_Tx
            CanTpRxNPdu_bea21a30 (CanTpRxNPdu): CanTpRxNPduId=4, CanTpRxNPduRef=PCAN_DIAG_REQ_PHYS_OBD1_Tp_oPCAN_RADAR_6e232c89_Rx
        TPCH_fa4054ff: variation-point=post-build-variant-condition{matching-criterion=RDR_POS, value=0}
          CanTpTxNSdu_f486fe77 (CanTpTxNSdu):
            CanTpTxAddressingFormat = CANTP_STANDARD
            CanTpTxDl = 64
            CanTpTxTaType = CANTP_CANFD_PHYSICAL
            CanTpNas = 1
            CanTpNcs = 0.01
            CanTpTc = false
            CanTpTxNSduId = 11
            CanTpTxPaddingActivation = CANTP_ON
            CanTpNbs = 1
            CanTpTxNSduRef = PCAN_DIAG_RESP_PHYS_PLANT_oPCAN_RADAR_cfac777e_Tx
            CanTpRxFcNPdu_4b2ea891 (CanTpRxFcNPdu): CanTpRxFcNPduId=11, CanTpRxFcNPduRef=PCAN_DIAG_REQ_PHYS_PLANT_Tp_oPCAN_RADAR_68155c61_Rx
            CanTpTxNPdu_4b2ea891 (CanTpTxNPdu): CanTpTxNPduConfirmationPduId=11, CanTpTxNPduRef=PCAN_DIAG_RESP_PHYS_PLANT_Tp_oPCAN_RADAR_bd11d57f_Tx
          CanTpRxNSdu_f486fe77 (CanTpRxNSdu):
            CanTpRxAddressingFormat = CANTP_STANDARD
            CanTpRxDl = 64
            CanTpRxTaType = CANTP_CANFD_PHYSICAL
            CanTpNbr = 0.01
            CanTpRxNSduId = 23
            CanTpRxPaddingActivation = CANTP_ON
            CanTpNar = 1
            CanTpBs = 8
            CanTpNcr = 1
            CanTpRxWftMax = 15
            CanTpSTmin = 0.02
            CanTpRxNSduRef = PCAN_DIAG_REQ_PHYS_PLANT_oPCAN_RADAR_214e1a1c_Rx
            CanTpTxFcNPdu_69d47c63 (CanTpTxFcNPdu): CanTpTxFcNPduConfirmationPduId=11, CanTpTxFcNPduRef=PCAN_DIAG_RESP_PHYS_PLANT_Tp_oPCAN_RADAR_bd11d57f_Tx
            CanTpRxNPdu_69d47c63 (CanTpRxNPdu): CanTpRxNPduId=11, CanTpRxNPduRef=PCAN_DIAG_REQ_PHYS_PLANT_Tp_oPCAN_RADAR_68155c61_Rx
        TPCH_4dce67f4: variation-point=post-build-variant-condition{matching-criterion=RDR_POS, value=0}
          CanTpRxNSdu_c5537cf0 (CanTpRxNSdu):
            CanTpRxAddressingFormat = CANTP_STANDARD
            CanTpRxDl = 8
            CanTpRxTaType = CANTP_PHYSICAL
            CanTpNbr = 0.01
            CanTpRxNSduId = 1
            CanTpRxPaddingActivation = CANTP_ON
            CanTpBs = 8
            CanTpNar = 1
            CanTpNcr = 1
            CanTpRxWftMax = 15
            CanTpSTmin = 0.02
            CanTpRxNSduRef = FR_DIAG_REQ_PHY_OBD2_oVCAN_RADAR_0f521c1d_Rx
            CanTpRxNPdu_25c8f584 (CanTpRxNPdu): CanTpRxNPduId=1, CanTpRxNPduRef=FR_DIAG_REQ_PHY_OBD2_Tp_oVCAN_RADAR_b91a4a31_Rx
            CanTpTxFcNPdu_25c8f584 (CanTpTxFcNPdu): CanTpTxFcNPduConfirmationPduId=1, CanTpTxFcNPduRef=FR_DIAG_RES_PHY_OBD2_Tp_oVCAN_RADAR_25471ce8_Tx
          CanTpTxNSdu_c5537cf0 (CanTpTxNSdu):
            CanTpTxAddressingFormat = CANTP_STANDARD
            CanTpTxDl = 8
            CanTpTxTaType = CANTP_PHYSICAL
            CanTpNas = 1
            CanTpNcs = 0.01
            CanTpTc = false
            CanTpTxNSduId = 0
            CanTpTxPaddingActivation = CANTP_ON
            CanTpNbs = 1
            CanTpTxNSduRef = FR_DIAG_RES_PHY_OBD2_oVCAN_RADAR_96501380_Tx
            CanTpRxFcNPdu_07322176 (CanTpRxFcNPdu): CanTpRxFcNPduId=1, CanTpRxFcNPduRef=FR_DIAG_REQ_PHY_OBD2_Tp_oVCAN_RADAR_b91a4a31_Rx
            CanTpTxNPdu_07322176 (CanTpTxNPdu): CanTpTxNPduConfirmationPduId=1, CanTpTxNPduRef=FR_DIAG_RES_PHY_OBD2_Tp_oVCAN_RADAR_25471ce8_Tx
        TPCH_ee74934f: variation-point=post-build-variant-condition{matching-criterion=RDR_POS, value=0}
          CanTpRxNSdu_3a469f02 (CanTpRxNSdu):
            CanTpRxAddressingFormat = CANTP_STANDARD
            CanTpRxDl = 8
            CanTpRxTaType = CANTP_PHYSICAL
            CanTpNbr = 0.01
            CanTpRxNSduId = 21
            CanTpRxPaddingActivation = CANTP_ON
            CanTpBs = 8
            CanTpNar = 1
            CanTpNcr = 1
            CanTpRxWftMax = 15
            CanTpSTmin = 0.02
            CanTpRxNSduRef = PCAN_DIAG_REQ_PHYS_PLANT_oPCAN_RADAR_20_f7a3783e_Rx
            CanTpTxFcNPdu_e961c2e4 (CanTpTxFcNPdu): CanTpTxFcNPduConfirmationPduId=10, CanTpTxFcNPduRef=PCAN_DIAG_RESP_PHYS_PLANT_Tp_oPCAN_RADAR_20_0a848a3f_Tx
            CanTpRxNPdu_e961c2e4 (CanTpRxNPdu): CanTpRxNPduId=10, CanTpRxNPduRef=PCAN_DIAG_REQ_PHYS_PLANT_Tp_oPCAN_RADAR_20_f110e38b_Rx
          CanTpTxNSdu_3a469f02 (CanTpTxNSdu):
            CanTpTxAddressingFormat = CANTP_STANDARD
            CanTpTxDl = 8
            CanTpTxTaType = CANTP_PHYSICAL
            CanTpNas = 1
            CanTpNcs = 0.01
            CanTpTc = false
            CanTpTxNSduId = 10
            CanTpTxPaddingActivation = CANTP_ON
            CanTpNbs = 1
            CanTpTxNSduRef = PCAN_DIAG_RESP_PHYS_PLANT_oPCAN_RADAR_20_22a7f120_Tx
            CanTpTxNPdu_cb9b1616 (CanTpTxNPdu): CanTpTxNPduConfirmationPduId=10, CanTpTxNPduRef=PCAN_DIAG_RESP_PHYS_PLANT_Tp_oPCAN_RADAR_20_0a848a3f_Tx
            CanTpRxFcNPdu_cb9b1616 (CanTpRxFcNPdu): CanTpRxFcNPduId=10, CanTpRxFcNPduRef=PCAN_DIAG_REQ_PHYS_PLANT_Tp_oPCAN_RADAR_20_f110e38b_Rx
        TPCH_f33d22d7: variation-point=post-build-variant-condition{matching-criterion=RDR_POS, value=0}
          CanTpRxNSdu_275a18b1 (CanTpRxNSdu):
            CanTpRxAddressingFormat = CANTP_STANDARD
            CanTpRxDl = 8
            CanTpRxTaType = CANTP_FUNCTIONAL
            CanTpNbr = 0.1
            CanTpRxNSduId = 22
            CanTpRxPaddingActivation = CANTP_ON
            CanTpRxNSduRef = DIAG_REQ_FNC_OBD2_oVCAN_RADAR_254b3790_Rx
            CanTpRxNPdu_a704ede5 (CanTpRxNPdu): CanTpRxNPduId=13, CanTpRxNPduRef=DIAG_REQ_FNC_OBD2_Tp_oVCAN_RADAR_42ec9761_Rx
        TPCH_54b76144: variation-point=post-build-variant-condition{matching-criterion=RDR_POS, value=0}
          CanTpTxNSdu_2fa399b3 (CanTpTxNSdu):
            CanTpTxAddressingFormat = CANTP_STANDARD
            CanTpTxDl = 8
            CanTpTxTaType = CANTP_PHYSICAL
            CanTpNas = 1
            CanTpNcs = 0.01
            CanTpTc = false
            CanTpTxNSduId = 3
            CanTpTxPaddingActivation = CANTP_ON
            CanTpNbs = 1
            CanTpTxNSduRef = FR_DIAG_RES_PHY_OTA_oVCAN_RADAR_9ad9d3d9_Tx
            CanTpTxNPdu_3e771e0a (CanTpTxNPdu): CanTpTxNPduConfirmationPduId=2, CanTpTxNPduRef=FR_DIAG_RES_PHY_OTA_Tp_oVCAN_RADAR_19b4e511_Tx
            CanTpRxFcNPdu_3e771e0a (CanTpRxFcNPdu): CanTpRxFcNPduId=2, CanTpRxFcNPduRef=FR_DIAG_REQ_PHY_OTA_Tp_oVCAN_RADAR_4de495d5_Rx
          CanTpRxNSdu_2fa399b3 (CanTpRxNSdu):
            CanTpRxAddressingFormat = CANTP_STANDARD
            CanTpRxDl = 8
            CanTpRxTaType = CANTP_PHYSICAL
            CanTpNbr = 0.01
            CanTpRxNSduId = 5
            CanTpRxPaddingActivation = CANTP_ON
            CanTpBs = 8
            CanTpNar = 1
            CanTpNcr = 1
            CanTpRxWftMax = 15
            CanTpSTmin = 0.02
            CanTpRxNSduRef = FR_DIAG_REQ_PHY_OTA_oVCAN_RADAR_9187f4da_Rx
            CanTpRxNPdu_1c8dcaf8 (CanTpRxNPdu): CanTpRxNPduId=2, CanTpRxNPduRef=FR_DIAG_REQ_PHY_OTA_Tp_oVCAN_RADAR_4de495d5_Rx
            CanTpTxFcNPdu_1c8dcaf8 (CanTpTxFcNPdu): CanTpTxFcNPduConfirmationPduId=2, CanTpTxFcNPduRef=FR_DIAG_RES_PHY_OTA_Tp_oVCAN_RADAR_19b4e511_Tx
        TPCH_b747c4e0: variation-point=post-build-variant-condition{matching-criterion=RDR_POS, value=0}
          CanTpRxNSdu_c5aa076c (CanTpRxNSdu):
            CanTpRxAddressingFormat = CANTP_STANDARD
            CanTpRxDl = 64
            CanTpRxTaType = CANTP_CANFD_FUNCTIONAL
            CanTpNbr = 0.1
            CanTpRxNSduId = 15
            CanTpRxPaddingActivation = CANTP_ON
            CanTpRxNSduRef = PCAN_DIAG_REQ_FUNC_PLANT_oPCAN_RADAR_f6414098_Rx
            CanTpRxNPdu_c1cf6678 (CanTpRxNPdu): CanTpRxNPduId=22, CanTpRxNPduRef=PCAN_DIAG_REQ_FUNC_PLANT_Tp_oPCAN_RADAR_5ec247a5_Rx
        TPCH_c3135cc4: variation-point=post-build-variant-condition{matching-criterion=RDR_POS, value=0}
          CanTpRxNSdu_8ea01f46 (CanTpRxNSdu):
            CanTpRxAddressingFormat = CANTP_STANDARD
            CanTpRxDl = 64
            CanTpRxTaType = CANTP_CANFD_FUNCTIONAL
            CanTpNbr = 0.1
            CanTpRxNSduId = 17
            CanTpRxPaddingActivation = CANTP_ON
            CanTpRxNSduRef = PCAN_DIAG_REQ_FUNC_OBD1_oPCAN_RADAR_b9aa9d1d_Rx
            CanTpRxNPdu_027c2a01 (CanTpRxNPdu): CanTpRxNPduId=17, CanTpRxNPduRef=PCAN_DIAG_REQ_FUNC_OBD1_Tp_oPCAN_RADAR_ba721e23_Rx
        TPCH_88d405ee: variation-point=post-build-variant-condition{matching-criterion=RDR_POS, value=0}
          CanTpRxNSdu_7f5185ac (CanTpRxNSdu):
            CanTpRxAddressingFormat = CANTP_STANDARD
            CanTpRxDl = 8
            CanTpRxTaType = CANTP_PHYSICAL
            CanTpNbr = 0.01
            CanTpRxNSduId = 6
            CanTpRxPaddingActivation = CANTP_ON
            CanTpBs = 8
            CanTpNar = 1
            CanTpNcr = 1
            CanTpRxWftMax = 15
            CanTpSTmin = 0.02
            CanTpRxNSduRef = FR_DIAG_REQ_PHY_OBD1_oVCAN_RADAR_5445ad08_Rx
            CanTpRxNPdu_7e1619c8 (CanTpRxNPdu): CanTpRxNPduId=0, CanTpRxNPduRef=FR_DIAG_REQ_PHY_OBD1_Tp_oVCAN_RADAR_ddfa31cf_Rx
            CanTpTxFcNPdu_7e1619c8 (CanTpTxFcNPdu): CanTpTxFcNPduConfirmationPduId=0, CanTpTxFcNPduRef=FR_DIAG_RES_PHY_OBD1_Tp_oVCAN_RADAR_41a76716_Tx
          CanTpTxNSdu_7f5185ac (CanTpTxNSdu):
            CanTpTxAddressingFormat = CANTP_STANDARD
            CanTpTxDl = 8
            CanTpTxTaType = CANTP_PHYSICAL
            CanTpNas = 1
            CanTpNcs = 0.01
            CanTpTc = false
            CanTpTxNSduId = 4
            CanTpTxPaddingActivation = CANTP_ON
            CanTpNbs = 1
            CanTpTxNSduRef = FR_DIAG_RES_PHY_OBD1_oVCAN_RADAR_cd47a295_Tx
            CanTpTxNPdu_5ceccd3a (CanTpTxNPdu): CanTpTxNPduConfirmationPduId=0, CanTpTxNPduRef=FR_DIAG_RES_PHY_OBD1_Tp_oVCAN_RADAR_41a76716_Tx
            CanTpRxFcNPdu_5ceccd3a (CanTpRxFcNPdu): CanTpRxFcNPduId=0, CanTpRxFcNPduRef=FR_DIAG_REQ_PHY_OBD1_Tp_oVCAN_RADAR_ddfa31cf_Rx
        TPCH_64d46b60: variation-point=post-build-variant-condition{matching-criterion=RDR_POS, value=1}
          CanTpRxNSdu_6b7431ef (CanTpRxNSdu):
            CanTpRxAddressingFormat = CANTP_STANDARD
            CanTpRxDl = 8
            CanTpRxTaType = CANTP_PHYSICAL
            CanTpNbr = 0.01
            CanTpRxNSduId = 5
            CanTpRxPaddingActivation = CANTP_ON
            CanTpBs = 8
            CanTpNar = 1
            CanTpNcr = 1
            CanTpRxWftMax = 15
            CanTpSTmin = 0.02
            CanTpRxNSduRef = PCAN_DIAG_REQ_PHYS_OBD1_oPCAN_RADAR_20_f19508d6_Rx
            CanTpTxFcNPdu_6a09e291 (CanTpTxFcNPdu): CanTpTxFcNPduConfirmationPduId=5, CanTpTxFcNPduRef=PCAN_DIAG_RESP_PHYS_OBD1_Tp_oPCAN_RADAR_20_f6415fa5_Tx
            CanTpRxNPdu_6a09e291 (CanTpRxNPdu): CanTpRxNPduId=5, CanTpRxNPduRef=PCAN_DIAG_REQ_PHYS_OBD1_Tp_oPCAN_RADAR_20_b6648efa_Rx
          CanTpTxNSdu_6b7431ef (CanTpTxNSdu):
            CanTpTxAddressingFormat = CANTP_STANDARD
            CanTpTxDl = 8
            CanTpTxTaType = CANTP_PHYSICAL
            CanTpNas = 1
            CanTpNcs = 0.01
            CanTpTc = false
            CanTpTxNSduId = 3
            CanTpTxPaddingActivation = CANTP_ON
            CanTpNbs = 1
            CanTpTxNSduRef = PCAN_DIAG_RESP_PHYS_OBD1_oPCAN_RADAR_20_955df2f4_Tx
            CanTpRxFcNPdu_48f33663 (CanTpRxFcNPdu): CanTpRxFcNPduId=5, CanTpRxFcNPduRef=PCAN_DIAG_REQ_PHYS_OBD1_Tp_oPCAN_RADAR_20_b6648efa_Rx
            CanTpTxNPdu_48f33663 (CanTpTxNPdu): CanTpTxNPduConfirmationPduId=5, CanTpTxNPduRef=PCAN_DIAG_RESP_PHYS_OBD1_Tp_oPCAN_RADAR_20_f6415fa5_Tx
        TPCH_a32482aa: variation-point=post-build-variant-condition{matching-criterion=RDR_POS, value=1}
          CanTpTxNSdu_4e12ed26 (CanTpTxNSdu):
            CanTpTxAddressingFormat = CANTP_STANDARD
            CanTpTxDl = 8
            CanTpTxTaType = CANTP_PHYSICAL
            CanTpNas = 1
            CanTpNcs = 0.01
            CanTpTc = false
            CanTpTxNSduId = 8
            CanTpTxPaddingActivation = CANTP_ON
            CanTpNbs = 1
            CanTpTxNSduRef = PCAN_DIAG_RESP_PHYS_OBD2_oPCAN_RADAR_20_f1bd890a_Tx
            CanTpRxFcNPdu_d2875bd9 (CanTpRxFcNPdu): CanTpRxFcNPduId=7, CanTpRxFcNPduRef=PCAN_DIAG_REQ_PHYS_OBD2_Tp_oPCAN_RADAR_20_65ff9201_Rx
            CanTpTxNPdu_d2875bd9 (CanTpTxNPdu): CanTpTxNPduConfirmationPduId=7, CanTpTxNPduRef=PCAN_DIAG_RESP_PHYS_OBD2_Tp_oPCAN_RADAR_20_25da435e_Tx
          CanTpRxNSdu_4e12ed26 (CanTpRxNSdu):
            CanTpRxAddressingFormat = CANTP_STANDARD
            CanTpRxDl = 8
            CanTpRxTaType = CANTP_PHYSICAL
            CanTpNbr = 0.01
            CanTpRxNSduId = 14
            CanTpRxPaddingActivation = CANTP_ON
            CanTpBs = 8
            CanTpNar = 1
            CanTpNcr = 1
            CanTpRxWftMax = 15
            CanTpSTmin = 0.02
            CanTpRxNSduRef = PCAN_DIAG_REQ_PHYS_OBD2_oPCAN_RADAR_20_95757328_Rx
            CanTpRxNPdu_f07d8f2b (CanTpRxNPdu): CanTpRxNPduId=7, CanTpRxNPduRef=PCAN_DIAG_REQ_PHYS_OBD2_Tp_oPCAN_RADAR_20_65ff9201_Rx
            CanTpTxFcNPdu_f07d8f2b (CanTpTxFcNPdu): CanTpTxFcNPduConfirmationPduId=7, CanTpTxFcNPduRef=PCAN_DIAG_RESP_PHYS_OBD2_Tp_oPCAN_RADAR_20_25da435e_Tx
        TPCH_a6f9dcf7: variation-point=post-build-variant-condition{matching-criterion=RDR_POS, value=1}
          CanTpTxNSdu_5249da4a (CanTpTxNSdu):
            CanTpTxAddressingFormat = CANTP_STANDARD
            CanTpTxDl = 8
            CanTpTxTaType = CANTP_PHYSICAL
            CanTpNas = 1
            CanTpNcs = 0.01
            CanTpTc = false
            CanTpTxNSduId = 7
            CanTpTxPaddingActivation = CANTP_ON
            CanTpNbs = 1
            CanTpTxNSduRef = FR_DIAG_RES_PHY_OBD2_oVCAN_RADAR_96501380_Tx
            CanTpRxFcNPdu_4bdbbbc6 (CanTpRxFcNPdu): CanTpRxFcNPduId=1, CanTpRxFcNPduRef=FR_DIAG_REQ_PHY_OBD2_Tp_oVCAN_RADAR_b91a4a31_Rx
            CanTpTxNPdu_4bdbbbc6 (CanTpTxNPdu): CanTpTxNPduConfirmationPduId=1, CanTpTxNPduRef=FR_DIAG_RES_PHY_OBD2_Tp_oVCAN_RADAR_25471ce8_Tx
          CanTpRxNSdu_5249da4a (CanTpRxNSdu):
            CanTpRxAddressingFormat = CANTP_STANDARD
            CanTpRxDl = 8
            CanTpRxTaType = CANTP_PHYSICAL
            CanTpNbr = 0.01
            CanTpRxNSduId = 13
            CanTpRxPaddingActivation = CANTP_ON
            CanTpBs = 8
            CanTpNar = 1
            CanTpNcr = 1
            CanTpRxWftMax = 15
            CanTpSTmin = 0.02
            CanTpRxNSduRef = FR_DIAG_REQ_PHY_OBD2_oVCAN_RADAR_0f521c1d_Rx
            CanTpRxNPdu_69216f34 (CanTpRxNPdu): CanTpRxNPduId=1, CanTpRxNPduRef=FR_DIAG_REQ_PHY_OBD2_Tp_oVCAN_RADAR_b91a4a31_Rx
            CanTpTxFcNPdu_69216f34 (CanTpTxFcNPdu): CanTpTxFcNPduConfirmationPduId=1, CanTpTxFcNPduRef=FR_DIAG_RES_PHY_OBD2_Tp_oVCAN_RADAR_25471ce8_Tx
        TPCH_0543284c: variation-point=post-build-variant-condition{matching-criterion=RDR_POS, value=1}
          CanTpRxNSdu_9bdfb9c6 (CanTpRxNSdu):
            CanTpRxAddressingFormat = CANTP_STANDARD
            CanTpRxDl = 8
            CanTpRxTaType = CANTP_PHYSICAL
            CanTpNbr = 0.01
            CanTpRxNSduId = 12
            CanTpRxPaddingActivation = CANTP_ON
            CanTpBs = 8
            CanTpNar = 1
            CanTpNcr = 1
            CanTpRxWftMax = 15
            CanTpSTmin = 0.02
            CanTpRxNSduRef = PCAN_DIAG_REQ_PHYS_PLANT_oPCAN_RADAR_20_f7a3783e_Rx
            CanTpTxFcNPdu_91d8a7cd (CanTpTxFcNPdu): CanTpTxFcNPduConfirmationPduId=10, CanTpTxFcNPduRef=PCAN_DIAG_RESP_PHYS_PLANT_Tp_oPCAN_RADAR_20_0a848a3f_Tx
            CanTpRxNPdu_91d8a7cd (CanTpRxNPdu): CanTpRxNPduId=10, CanTpRxNPduRef=PCAN_DIAG_REQ_PHYS_PLANT_Tp_oPCAN_RADAR_20_f110e38b_Rx
          CanTpTxNSdu_9bdfb9c6 (CanTpTxNSdu):
            CanTpTxAddressingFormat = CANTP_STANDARD
            CanTpTxDl = 8
            CanTpTxTaType = CANTP_PHYSICAL
            CanTpNas = 1
            CanTpNcs = 0.01
            CanTpTc = false
            CanTpTxNSduId = 6
            CanTpTxPaddingActivation = CANTP_ON
            CanTpNbs = 1
            CanTpTxNSduRef = PCAN_DIAG_RESP_PHYS_PLANT_oPCAN_RADAR_20_22a7f120_Tx
            CanTpRxFcNPdu_b322733f (CanTpRxFcNPdu): CanTpRxFcNPduId=10, CanTpRxFcNPduRef=PCAN_DIAG_REQ_PHYS_PLANT_Tp_oPCAN_RADAR_20_f110e38b_Rx
            CanTpTxNPdu_b322733f (CanTpTxNPdu): CanTpTxNPduConfirmationPduId=10, CanTpTxNPduRef=PCAN_DIAG_RESP_PHYS_PLANT_Tp_oPCAN_RADAR_20_0a848a3f_Tx
        TPCH_14f57a8a: variation-point=post-build-variant-condition{matching-criterion=RDR_POS, value=1}
          CanTpRxNSdu_290c259d (CanTpRxNSdu):
            CanTpRxAddressingFormat = CANTP_STANDARD
            CanTpRxDl = 8
            CanTpRxTaType = CANTP_FUNCTIONAL
            CanTpNbr = 0.1
            CanTpRxNSduId = 2
            CanTpRxPaddingActivation = CANTP_ON
            CanTpRxNSduRef = PCAN_DIAG_REQ_FUNC_OBD1_oPCAN_RADAR_20_25c43a7c_Rx
            CanTpRxNPdu_b306521c (CanTpRxNPdu): CanTpRxNPduId=16, CanTpRxNPduRef=PCAN_DIAG_REQ_FUNC_OBD1_Tp_oPCAN_RADAR_20_9397638b_Rx
        TPCH_84a3f027: variation-point=post-build-variant-condition{matching-criterion=RDR_POS, value=1}
          CanTpRxNSdu_c22ecba5 (CanTpRxNSdu):
            CanTpRxAddressingFormat = CANTP_STANDARD
            CanTpRxDl = 8
            CanTpRxTaType = CANTP_FUNCTIONAL
            CanTpNbr = 0.1
            CanTpRxNSduId = 7
            CanTpRxPaddingActivation = CANTP_ON
            CanTpRxNSduRef = DIAG_REQ_FNC_OBD2_oVCAN_RADAR_254b3790_Rx
            CanTpRxNPdu_dcddaf97 (CanTpRxNPdu): CanTpRxNPduId=13, CanTpRxNPduRef=DIAG_REQ_FNC_OBD2_Tp_oVCAN_RADAR_42ec9761_Rx
        TPCH_bbcf4b47: variation-point=post-build-variant-condition{matching-criterion=RDR_POS, value=1}
          CanTpTxNSdu_a39083e7 (CanTpTxNSdu):
            CanTpTxAddressingFormat = CANTP_STANDARD
            CanTpTxDl = 64
            CanTpTxTaType = CANTP_CANFD_PHYSICAL
            CanTpNas = 1
            CanTpNcs = 0.01
            CanTpTc = false
            CanTpTxNSduId = 10
            CanTpTxPaddingActivation = CANTP_ON
            CanTpNbs = 1
            CanTpTxNSduRef = PCAN_DIAG_RESP_PHYS_OBD1_oPCAN_RADAR_572eb9fe_Tx
            CanTpTxNPdu_f0646899 (CanTpTxNPdu): CanTpTxNPduConfirmationPduId=4, CanTpTxNPduRef=PCAN_DIAG_RESP_PHYS_OBD1_Tp_oPCAN_RADAR_0aebd6ab_Tx
            CanTpRxFcNPdu_f0646899 (CanTpRxFcNPdu): CanTpRxFcNPduId=4, CanTpRxFcNPduRef=PCAN_DIAG_REQ_PHYS_OBD1_Tp_oPCAN_RADAR_6e232c89_Rx
          CanTpRxNSdu_a39083e7 (CanTpRxNSdu):
            CanTpRxAddressingFormat = CANTP_STANDARD
            CanTpRxDl = 64
            CanTpRxTaType = CANTP_CANFD_PHYSICAL
            CanTpNbr = 0.01
            CanTpRxNSduId = 16
            CanTpRxPaddingActivation = CANTP_ON
            CanTpBs = 8
            CanTpNar = 1
            CanTpNcr = 1
            CanTpRxWftMax = 15
            CanTpSTmin = 0.02
            CanTpRxNSduRef = PCAN_DIAG_REQ_PHYS_OBD1_oPCAN_RADAR_bb22f7fc_Rx
            CanTpTxFcNPdu_d29ebc6b (CanTpTxFcNPdu): CanTpTxFcNPduConfirmationPduId=4, CanTpTxFcNPduRef=PCAN_DIAG_RESP_PHYS_OBD1_Tp_oPCAN_RADAR_0aebd6ab_Tx
            CanTpRxNPdu_d29ebc6b (CanTpRxNPdu): CanTpRxNPduId=4, CanTpRxNPduRef=PCAN_DIAG_REQ_PHYS_OBD1_Tp_oPCAN_RADAR_6e232c89_Rx
        TPCH_fdab8848: variation-point=post-build-variant-condition{matching-criterion=RDR_POS, value=1}
          CanTpRxNSdu_4700b6a3 (CanTpRxNSdu):
            CanTpRxAddressingFormat = CANTP_STANDARD
            CanTpRxDl = 8
            CanTpRxTaType = CANTP_FUNCTIONAL
            CanTpNbr = 0.1
            CanTpRxNSduId = 23
            CanTpRxPaddingActivation = CANTP_ON
            CanTpRxNSduRef = PCAN_DIAG_REQ_FUNC_PLANT_oPCAN_RADAR_20_c17463fa_Rx
            CanTpRxNPdu_219160d4 (CanTpRxNPdu): CanTpRxNPduId=23, CanTpRxNPduRef=PCAN_DIAG_REQ_FUNC_PLANT_Tp_oPCAN_RADAR_20_d63751cc_Rx
        TPCH_63e3beed: variation-point=post-build-variant-condition{matching-criterion=RDR_POS, value=1}
          CanTpRxNSdu_6b1f15de (CanTpRxNSdu):
            CanTpRxAddressingFormat = CANTP_STANDARD
            CanTpRxDl = 8
            CanTpRxTaType = CANTP_PHYSICAL
            CanTpNbr = 0.01
            CanTpRxNSduId = 4
            CanTpRxPaddingActivation = CANTP_ON
            CanTpBs = 8
            CanTpNar = 1
            CanTpNcr = 1
            CanTpRxWftMax = 15
            CanTpSTmin = 0.02
            CanTpRxNSduRef = FR_DIAG_REQ_PHY_OBD1_oVCAN_RADAR_5445ad08_Rx
            CanTpTxFcNPdu_050d9363 (CanTpTxFcNPdu): CanTpTxFcNPduConfirmationPduId=0, CanTpTxFcNPduRef=FR_DIAG_RES_PHY_OBD1_Tp_oVCAN_RADAR_41a76716_Tx
            CanTpRxNPdu_050d9363 (CanTpRxNPdu): CanTpRxNPduId=0, CanTpRxNPduRef=FR_DIAG_REQ_PHY_OBD1_Tp_oVCAN_RADAR_ddfa31cf_Rx
          CanTpTxNSdu_6b1f15de (CanTpTxNSdu):
            CanTpTxAddressingFormat = CANTP_STANDARD
            CanTpTxDl = 8
            CanTpTxTaType = CANTP_PHYSICAL
            CanTpNas = 1
            CanTpNcs = 0.01
            CanTpTc = false
            CanTpTxNSduId = 2
            CanTpTxPaddingActivation = CANTP_ON
            CanTpNbs = 1
            CanTpTxNSduRef = FR_DIAG_RES_PHY_OBD1_oVCAN_RADAR_cd47a295_Tx
            CanTpRxFcNPdu_27f74791 (CanTpRxFcNPdu): CanTpRxFcNPduId=0, CanTpRxFcNPduRef=FR_DIAG_REQ_PHY_OBD1_Tp_oVCAN_RADAR_ddfa31cf_Rx
            CanTpTxNPdu_27f74791 (CanTpTxNPdu): CanTpTxNPduConfirmationPduId=0, CanTpTxNPduRef=FR_DIAG_RES_PHY_OBD1_Tp_oVCAN_RADAR_41a76716_Tx
        TPCH_eb24b861: variation-point=post-build-variant-condition{matching-criterion=RDR_POS, value=1}
          CanTpRxNSdu_784cf1a8 (CanTpRxNSdu):
            CanTpRxAddressingFormat = CANTP_STANDARD
            CanTpRxDl = 64
            CanTpRxTaType = CANTP_CANFD_FUNCTIONAL
            CanTpNbr = 0.1
            CanTpRxNSduId = 21
            CanTpRxPaddingActivation = CANTP_ON
            CanTpRxNSduRef = PCAN_DIAG_REQ_FUNC_OTA_oPCAN_RADAR_a013523e_Rx
            CanTpRxNPdu_02808996 (CanTpRxNPdu): CanTpRxNPduId=20, CanTpRxNPduRef=PCAN_DIAG_REQ_FUNC_OTA_Tp_oPCAN_RADAR_7ea6262a_Rx
        TPCH_47109ea7: variation-point=post-build-variant-condition{matching-criterion=RDR_POS, value=1}
          CanTpRxNSdu_87c84b68 (CanTpRxNSdu):
            CanTpRxAddressingFormat = CANTP_STANDARD
            CanTpRxDl = 8
            CanTpRxTaType = CANTP_FUNCTIONAL
            CanTpNbr = 0.1
            CanTpRxNSduId = 10
            CanTpRxPaddingActivation = CANTP_ON
            CanTpRxNSduRef = DIAG_REQ_FNC_PLANT_oVCAN_RADAR_42eb2f27_Rx
            CanTpRxNPdu_6b2d7968 (CanTpRxNPdu): CanTpRxNPduId=15, CanTpRxNPduRef=DIAG_REQ_FNC_PLANT_Tp_oVCAN_RADAR_d6304422_Rx
        TPCH_55e91935: variation-point=post-build-variant-condition{matching-criterion=RDR_POS, value=1}
          CanTpRxNSdu_8063d38e (CanTpRxNSdu):
            CanTpRxAddressingFormat = CANTP_STANDARD
            CanTpRxDl = 64
            CanTpRxTaType = CANTP_CANFD_PHYSICAL
            CanTpNbr = 0.01
            CanTpRxNSduId = 3
            CanTpRxPaddingActivation = CANTP_ON
            CanTpBs = 8
            CanTpNar = 1
            CanTpNcr = 1
            CanTpRxWftMax = 15
            CanTpSTmin = 0.02
            CanTpRxNSduRef = PCAN_DIAG_REQ_PHYS_PLANT_oPCAN_RADAR_214e1a1c_Rx
            CanTpRxNPdu_ee3456aa (CanTpRxNPdu): CanTpRxNPduId=11, CanTpRxNPduRef=PCAN_DIAG_REQ_PHYS_PLANT_Tp_oPCAN_RADAR_68155c61_Rx
            CanTpTxFcNPdu_ee3456aa (CanTpTxFcNPdu): CanTpTxFcNPduConfirmationPduId=11, CanTpTxFcNPduRef=PCAN_DIAG_RESP_PHYS_PLANT_Tp_oPCAN_RADAR_bd11d57f_Tx
          CanTpTxNSdu_8063d38e (CanTpTxNSdu):
            CanTpTxAddressingFormat = CANTP_STANDARD
            CanTpTxDl = 64
            CanTpTxTaType = CANTP_CANFD_PHYSICAL
            CanTpNas = 1
            CanTpNcs = 0.01
            CanTpTc = false
            CanTpTxNSduId = 1
            CanTpTxPaddingActivation = CANTP_ON
            CanTpNbs = 1
            CanTpTxNSduRef = PCAN_DIAG_RESP_PHYS_PLANT_oPCAN_RADAR_cfac777e_Tx
            CanTpRxFcNPdu_ccce8258 (CanTpRxFcNPdu): CanTpRxFcNPduId=11, CanTpRxFcNPduRef=PCAN_DIAG_REQ_PHYS_PLANT_Tp_oPCAN_RADAR_68155c61_Rx
            CanTpTxNPdu_ccce8258 (CanTpTxNPdu): CanTpTxNPduConfirmationPduId=11, CanTpTxNPduRef=PCAN_DIAG_RESP_PHYS_PLANT_Tp_oPCAN_RADAR_bd11d57f_Tx
        TPCH_7506a5d0: variation-point=post-build-variant-condition{matching-criterion=RDR_POS, value=1}
          CanTpRxNSdu_5bd213bc (CanTpRxNSdu):
            CanTpRxAddressingFormat = CANTP_STANDARD
            CanTpRxDl = 8
            CanTpRxTaType = CANTP_FUNCTIONAL
            CanTpNbr = 0.1
            CanTpRxNSduId = 8
            CanTpRxPaddingActivation = CANTP_ON
            CanTpRxNSduRef = PCAN_DIAG_REQ_FUNC_OBD2_oPCAN_RADAR_20_41244182_Rx
            CanTpRxNPdu_31ffae20 (CanTpRxNPdu): CanTpRxNPduId=18, CanTpRxNPduRef=PCAN_DIAG_REQ_FUNC_OBD2_Tp_oPCAN_RADAR_20_400c7f70_Rx
        TPCH_bf9688c8: variation-point=post-build-variant-condition{matching-criterion=RDR_POS, value=1}
          CanTpRxNSdu_8c618172 (CanTpRxNSdu):
            CanTpRxAddressingFormat = CANTP_STANDARD
            CanTpRxDl = 8
            CanTpRxTaType = CANTP_FUNCTIONAL
            CanTpNbr = 0.1
            CanTpRxNSduId = 18
            CanTpRxPaddingActivation = CANTP_ON
            CanTpRxNSduRef = DIAG_REQ_FNC_OBD1_oVCAN_RADAR_7e5c8685_Rx
            CanTpRxNPdu_2cc9a2e3 (CanTpRxNPdu): CanTpRxNPduId=12, CanTpRxNPduRef=DIAG_REQ_FNC_OBD1_Tp_oVCAN_RADAR_260cec9f_Rx
        TPCH_fa6bf184: variation-point=post-build-variant-condition{matching-criterion=RDR_POS, value=1}
          CanTpRxNSdu_85b3e172 (CanTpRxNSdu):
            CanTpRxAddressingFormat = CANTP_STANDARD
            CanTpRxDl = 64
            CanTpRxTaType = CANTP_CANFD_FUNCTIONAL
            CanTpNbr = 0.1
            CanTpRxNSduId = 22
            CanTpRxPaddingActivation = CANTP_ON
            CanTpRxNSduRef = PCAN_DIAG_REQ_FUNC_OBD1_oPCAN_RADAR_b9aa9d1d_Rx
            CanTpRxNPdu_df9c51e3 (CanTpRxNPdu): CanTpRxNPduId=17, CanTpRxNPduRef=PCAN_DIAG_REQ_FUNC_OBD1_Tp_oPCAN_RADAR_ba721e23_Rx
        TPCH_d1390181: variation-point=post-build-variant-condition{matching-criterion=RDR_POS, value=1}
          CanTpRxNSdu_6541c420 (CanTpRxNSdu):
            CanTpRxAddressingFormat = CANTP_STANDARD
            CanTpRxDl = 8
            CanTpRxTaType = CANTP_FUNCTIONAL
            CanTpNbr = 0.1
            CanTpRxNSduId = 19
            CanTpRxPaddingActivation = CANTP_ON
            CanTpRxNSduRef = PCAN_DIAG_REQ_FUNC_OTA_oPCAN_RADAR_20_e1100275_Rx
            CanTpRxNPdu_6fa47c37 (CanTpRxNPdu): CanTpRxNPduId=21, CanTpRxNPduRef=PCAN_DIAG_REQ_FUNC_OTA_Tp_oPCAN_RADAR_20_0a67f2f6_Rx
        TPCH_09211efd: variation-point=post-build-variant-condition{matching-criterion=RDR_POS, value=1}
          CanTpRxNSdu_90dedbb7 (CanTpRxNSdu):
            CanTpRxAddressingFormat = CANTP_STANDARD
            CanTpRxDl = 8
            CanTpRxTaType = CANTP_PHYSICAL
            CanTpNbr = 0.01
            CanTpRxNSduId = 9
            CanTpRxPaddingActivation = CANTP_ON
            CanTpBs = 8
            CanTpNar = 1
            CanTpNcr = 1
            CanTpRxWftMax = 15
            CanTpSTmin = 0.02
            CanTpRxNSduRef = FR_DIAG_REQ_PHY_PLANT_oVCAN_RADAR_d1c8c991_Rx
            CanTpRxNPdu_31443625 (CanTpRxNPdu): CanTpRxNPduId=3, CanTpRxNPduRef=FR_DIAG_REQ_PHY_PLANT_Tp_oVCAN_RADAR_bda0e30b_Rx
            CanTpTxFcNPdu_31443625 (CanTpTxFcNPdu): CanTpTxFcNPduConfirmationPduId=3, CanTpTxFcNPduRef=FR_DIAG_RES_PHY_PLANT_Tp_oVCAN_RADAR_4233d42d_Tx
          CanTpTxNSdu_90dedbb7 (CanTpTxNSdu):
            CanTpTxAddressingFormat = CANTP_STANDARD
            CanTpTxDl = 8
            CanTpTxTaType = CANTP_PHYSICAL
            CanTpNas = 1
            CanTpNcs = 0.01
            CanTpTc = false
            CanTpTxNSduId = 4
            CanTpTxPaddingActivation = CANTP_ON
            CanTpNbs = 1
            CanTpTxNSduRef = FR_DIAG_RES_PHY_PLANT_oVCAN_RADAR_5fef2467_Tx
            CanTpRxFcNPdu_13bee2d7 (CanTpRxFcNPdu): CanTpRxFcNPduId=3, CanTpRxFcNPduRef=FR_DIAG_REQ_PHY_PLANT_Tp_oVCAN_RADAR_bda0e30b_Rx
            CanTpTxNPdu_13bee2d7 (CanTpTxNPdu): CanTpTxNPduConfirmationPduId=3, CanTpTxNPduRef=FR_DIAG_RES_PHY_PLANT_Tp_oVCAN_RADAR_4233d42d_Tx
        TPCH_e20c56ce: variation-point=post-build-variant-condition{matching-criterion=RDR_POS, value=1}
          CanTpRxNSdu_6bec8c22 (CanTpRxNSdu):
            CanTpRxAddressingFormat = CANTP_STANDARD
            CanTpRxDl = 8
            CanTpRxTaType = CANTP_FUNCTIONAL
            CanTpNbr = 0.1
            CanTpRxNSduId = 20
            CanTpRxPaddingActivation = CANTP_ON
            CanTpRxNSduRef = DIAG_REQ_FNC_OTA_oVCAN_RADAR_e787ed21_Rx
            CanTpRxNPdu_49526666 (CanTpRxNPdu): CanTpRxNPduId=14, CanTpRxNPduRef=DIAG_REQ_FNC_OTA_Tp_oVCAN_RADAR_6f75a08a_Rx
        TPCH_06db1ec3: variation-point=post-build-variant-condition{matching-criterion=RDR_POS, value=1}
          CanTpTxNSdu_4b8ac5bd (CanTpTxNSdu):
            CanTpTxAddressingFormat = CANTP_STANDARD
            CanTpTxDl = 64
            CanTpTxTaType = CANTP_CANFD_PHYSICAL
            CanTpNas = 1
            CanTpNcs = 0.01
            CanTpTc = false
            CanTpTxNSduId = 0
            CanTpTxPaddingActivation = CANTP_ON
            CanTpNbs = 1
            CanTpTxNSduRef = PCAN_DIAG_RESP_PHYS_OTA_oPCAN_RADAR_2a569d3c_Tx
            CanTpRxFcNPdu_fcc3ea08 (CanTpRxFcNPdu): CanTpRxFcNPduId=9, CanTpRxFcNPduRef=PCAN_DIAG_REQ_PHYS_OTA_Tp_oPCAN_RADAR_94a46e49_Rx
            CanTpTxNPdu_fcc3ea08 (CanTpTxNPdu): CanTpTxNPduConfirmationPduId=9, CanTpTxNPduRef=PCAN_DIAG_RESP_PHYS_OTA_Tp_oPCAN_RADAR_37f68c50_Tx
          CanTpRxNSdu_4b8ac5bd (CanTpRxNSdu):
            CanTpRxAddressingFormat = CANTP_STANDARD
            CanTpRxDl = 64
            CanTpRxTaType = CANTP_CANFD_PHYSICAL
            CanTpNbr = 0.01
            CanTpRxNSduId = 1
            CanTpRxPaddingActivation = CANTP_ON
            CanTpBs = 8
            CanTpNar = 1
            CanTpNcr = 1
            CanTpRxWftMax = 15
            CanTpSTmin = 0.02
            CanTpRxNSduRef = PCAN_DIAG_REQ_PHYS_OTA_oPCAN_RADAR_45eab9fd_Rx
            CanTpRxNPdu_de393efa (CanTpRxNPdu): CanTpRxNPduId=9, CanTpRxNPduRef=PCAN_DIAG_REQ_PHYS_OTA_Tp_oPCAN_RADAR_94a46e49_Rx
            CanTpTxFcNPdu_de393efa (CanTpTxFcNPdu): CanTpTxFcNPduConfirmationPduId=9, CanTpTxFcNPduRef=PCAN_DIAG_RESP_PHYS_OTA_Tp_oPCAN_RADAR_37f68c50_Tx
        TPCH_660862ee: variation-point=post-build-variant-condition{matching-criterion=RDR_POS, value=1}
          CanTpTxNSdu_482f027a (CanTpTxNSdu):
            CanTpTxAddressingFormat = CANTP_STANDARD
            CanTpTxDl = 64
            CanTpTxTaType = CANTP_CANFD_PHYSICAL
            CanTpNas = 1
            CanTpNcs = 0.01
            CanTpTc = false
            CanTpTxNSduId = 5
            CanTpTxPaddingActivation = CANTP_ON
            CanTpNbs = 1
            CanTpTxNSduRef = PCAN_DIAG_RESP_PHYS_OBD2_oPCAN_RADAR_0c3908eb_Tx
            CanTpTxNPdu_7beda6ef (CanTpTxNPdu): CanTpTxNPduConfirmationPduId=6, CanTpTxNPduRef=PCAN_DIAG_RESP_PHYS_OBD2_Tp_oPCAN_RADAR_6e0bad55_Tx
            CanTpRxFcNPdu_7beda6ef (CanTpRxFcNPdu): CanTpRxFcNPduId=6, CanTpRxFcNPduRef=PCAN_DIAG_REQ_PHYS_OBD2_Tp_oPCAN_RADAR_0ac35777_Rx
          CanTpRxNSdu_482f027a (CanTpRxNSdu):
            CanTpRxAddressingFormat = CANTP_STANDARD
            CanTpRxDl = 64
            CanTpRxTaType = CANTP_CANFD_PHYSICAL
            CanTpNbr = 0.01
            CanTpRxNSduId = 11
            CanTpRxPaddingActivation = CANTP_ON
            CanTpBs = 8
            CanTpNar = 1
            CanTpNcr = 1
            CanTpRxWftMax = 15
            CanTpSTmin = 0.02
            CanTpRxNSduRef = PCAN_DIAG_REQ_PHYS_OBD2_oPCAN_RADAR_e03546e9_Rx
            CanTpTxFcNPdu_5917721d (CanTpTxFcNPdu): CanTpTxFcNPduConfirmationPduId=6, CanTpTxFcNPduRef=PCAN_DIAG_RESP_PHYS_OBD2_Tp_oPCAN_RADAR_6e0bad55_Tx
            CanTpRxNPdu_5917721d (CanTpRxNPdu): CanTpRxNPduId=6, CanTpRxNPduRef=PCAN_DIAG_REQ_PHYS_OBD2_Tp_oPCAN_RADAR_0ac35777_Rx
        TPCH_8e3f69a0: variation-point=post-build-variant-condition{matching-criterion=RDR_POS, value=1}
          CanTpRxNSdu_3d176ff8 (CanTpRxNSdu):
            CanTpRxAddressingFormat = CANTP_STANDARD
            CanTpRxDl = 64
            CanTpRxTaType = CANTP_CANFD_FUNCTIONAL
            CanTpNbr = 0.1
            CanTpRxNSduId = 0
            CanTpRxPaddingActivation = CANTP_ON
            CanTpRxNSduRef = PCAN_DIAG_REQ_FUNC_PLANT_oPCAN_RADAR_f6414098_Rx
            CanTpRxNPdu_955effbd (CanTpRxNPdu): CanTpRxNPduId=22, CanTpRxNPduRef=PCAN_DIAG_REQ_FUNC_PLANT_Tp_oPCAN_RADAR_5ec247a5_Rx
        TPCH_bf80da47: variation-point=post-build-variant-condition{matching-criterion=RDR_POS, value=1}
          CanTpTxNSdu_4f8ed450 (CanTpTxNSdu):
            CanTpTxAddressingFormat = CANTP_STANDARD
            CanTpTxDl = 8
            CanTpTxTaType = CANTP_PHYSICAL
            CanTpNas = 1
            CanTpNcs = 0.01
            CanTpTc = false
            CanTpTxNSduId = 11
            CanTpTxPaddingActivation = CANTP_ON
            CanTpNbs = 1
            CanTpTxNSduRef = FR_DIAG_RES_PHY_OTA_oVCAN_RADAR_9ad9d3d9_Tx
            CanTpTxNPdu_66cf5575 (CanTpTxNPdu): CanTpTxNPduConfirmationPduId=2, CanTpTxNPduRef=FR_DIAG_RES_PHY_OTA_Tp_oVCAN_RADAR_19b4e511_Tx
            CanTpRxFcNPdu_66cf5575 (CanTpRxFcNPdu): CanTpRxFcNPduId=2, CanTpRxFcNPduRef=FR_DIAG_REQ_PHY_OTA_Tp_oVCAN_RADAR_4de495d5_Rx
          CanTpRxNSdu_4f8ed450 (CanTpRxNSdu):
            CanTpRxAddressingFormat = CANTP_STANDARD
            CanTpRxDl = 8
            CanTpRxTaType = CANTP_PHYSICAL
            CanTpNbr = 0.01
            CanTpRxNSduId = 17
            CanTpRxPaddingActivation = CANTP_ON
            CanTpBs = 8
            CanTpNar = 1
            CanTpNcr = 1
            CanTpRxWftMax = 15
            CanTpSTmin = 0.02
            CanTpRxNSduRef = FR_DIAG_REQ_PHY_OTA_oVCAN_RADAR_9187f4da_Rx
            CanTpRxNPdu_44358187 (CanTpRxNPdu): CanTpRxNPduId=2, CanTpRxNPduRef=FR_DIAG_REQ_PHY_OTA_Tp_oVCAN_RADAR_4de495d5_Rx
            CanTpTxFcNPdu_44358187 (CanTpTxFcNPdu): CanTpTxFcNPduConfirmationPduId=2, CanTpTxFcNPduRef=FR_DIAG_RES_PHY_OTA_Tp_oVCAN_RADAR_19b4e511_Tx
        TPCH_b5b9412b: variation-point=post-build-variant-condition{matching-criterion=RDR_POS, value=1}
          CanTpTxNSdu_175c4d75 (CanTpTxNSdu):
            CanTpTxAddressingFormat = CANTP_STANDARD
            CanTpTxDl = 8
            CanTpTxTaType = CANTP_PHYSICAL
            CanTpNas = 1
            CanTpNcs = 0.01
            CanTpTc = false
            CanTpTxNSduId = 9
            CanTpTxPaddingActivation = CANTP_ON
            CanTpNbs = 1
            CanTpTxNSduRef = PCAN_DIAG_RESP_PHYS_OTA_oPCAN_RADAR_20_a840a80f_Tx
            CanTpTxNPdu_274ec784 (CanTpTxNPdu): CanTpTxNPduConfirmationPduId=8, CanTpTxNPduRef=PCAN_DIAG_RESP_PHYS_OTA_Tp_oPCAN_RADAR_20_6c821aae_Tx
            CanTpRxFcNPdu_274ec784 (CanTpRxFcNPdu): CanTpRxFcNPduId=8, CanTpRxFcNPduRef=PCAN_DIAG_REQ_PHYS_OTA_Tp_oPCAN_RADAR_20_96582344_Rx
          CanTpRxNSdu_175c4d75 (CanTpRxNSdu):
            CanTpRxAddressingFormat = CANTP_STANDARD
            CanTpRxDl = 8
            CanTpRxTaType = CANTP_PHYSICAL
            CanTpNbr = 0.01
            CanTpRxNSduId = 15
            CanTpRxPaddingActivation = CANTP_ON
            CanTpBs = 8
            CanTpNar = 1
            CanTpNcr = 1
            CanTpRxWftMax = 15
            CanTpSTmin = 0.02
            CanTpRxNSduRef = PCAN_DIAG_REQ_PHYS_OTA_oPCAN_RADAR_20_0b124a16_Rx
            CanTpRxNPdu_05b41376 (CanTpRxNPdu): CanTpRxNPduId=8, CanTpRxNPduRef=PCAN_DIAG_REQ_PHYS_OTA_Tp_oPCAN_RADAR_20_96582344_Rx
            CanTpTxFcNPdu_05b41376 (CanTpTxFcNPdu): CanTpTxFcNPduConfirmationPduId=8, CanTpTxFcNPduRef=PCAN_DIAG_RESP_PHYS_OTA_Tp_oPCAN_RADAR_20_6c821aae_Tx
        TPCH_73bebed7: variation-point=post-build-variant-condition{matching-criterion=RDR_POS, value=1}
          CanTpRxNSdu_e69a2e9c (CanTpRxNSdu):
            CanTpRxAddressingFormat = CANTP_STANDARD
            CanTpRxDl = 64
            CanTpRxTaType = CANTP_CANFD_FUNCTIONAL
            CanTpNbr = 0.1
            CanTpRxNSduId = 6
            CanTpRxPaddingActivation = CANTP_ON
            CanTpRxNSduRef = PCAN_DIAG_REQ_FUNC_OBD2_oPCAN_RADAR_e2bd2c08_Rx
            CanTpRxNPdu_ee04a3b7 (CanTpRxNPdu): CanTpRxNPduId=19, CanTpRxNPduRef=PCAN_DIAG_REQ_FUNC_OBD2_Tp_oPCAN_RADAR_de9265dd_Rx
        TPCH_660ec427: variation-point=post-build-variant-condition{matching-criterion=RDR_POS, value=2}
          CanTpRxNSdu_006d7169 (CanTpRxNSdu):
            CanTpRxAddressingFormat = CANTP_STANDARD
            CanTpRxDl = 8
            CanTpRxTaType = CANTP_FUNCTIONAL
            CanTpNbr = 0.1
            CanTpRxNSduId = 12
            CanTpRxPaddingActivation = CANTP_ON
            CanTpRxNSduRef = PCAN_DIAG_REQ_FUNC_PLANT_oPCAN_RADAR_20_c17463fa_Rx
            CanTpRxNPdu_2828ffd9 (CanTpRxNPdu): CanTpRxNPduId=23, CanTpRxNPduRef=PCAN_DIAG_REQ_FUNC_PLANT_Tp_oPCAN_RADAR_20_d63751cc_Rx
        TPCH_79a91aa1: variation-point=post-build-variant-condition{matching-criterion=RDR_POS, value=2}
          CanTpRxNSdu_73387856 (CanTpRxNSdu):
            CanTpRxAddressingFormat = CANTP_STANDARD
            CanTpRxDl = 8
            CanTpRxTaType = CANTP_FUNCTIONAL
            CanTpNbr = 0.1
            CanTpRxNSduId = 8
            CanTpRxPaddingActivation = CANTP_ON
            CanTpRxNSduRef = DIAG_REQ_FNC_OTA_oVCAN_RADAR_e787ed21_Rx
            CanTpRxNPdu_21c36ca5 (CanTpRxNPdu): CanTpRxNPduId=14, CanTpRxNPduRef=DIAG_REQ_FNC_OTA_Tp_oVCAN_RADAR_6f75a08a_Rx
        TPCH_8f5036e5: variation-point=post-build-variant-condition{matching-criterion=RDR_POS, value=2}
          CanTpRxNSdu_45712a97 (CanTpRxNSdu):
            CanTpRxAddressingFormat = CANTP_STANDARD
            CanTpRxDl = 8
            CanTpRxTaType = CANTP_FUNCTIONAL
            CanTpNbr = 0.1
            CanTpRxNSduId = 6
            CanTpRxPaddingActivation = CANTP_ON
            CanTpRxNSduRef = PCAN_DIAG_REQ_FUNC_OBD1_oPCAN_RADAR_20_25c43a7c_Rx
            CanTpRxNPdu_7db6e3a7 (CanTpRxNPdu): CanTpRxNPduId=16, CanTpRxNPduRef=PCAN_DIAG_REQ_FUNC_OBD1_Tp_oPCAN_RADAR_20_9397638b_Rx
        TPCH_99170d60: variation-point=post-build-variant-condition{matching-criterion=RDR_POS, value=2}
          CanTpRxNSdu_e9868279 (CanTpRxNSdu):
            CanTpRxAddressingFormat = CANTP_STANDARD
            CanTpRxDl = 64
            CanTpRxTaType = CANTP_CANFD_FUNCTIONAL
            CanTpNbr = 0.1
            CanTpRxNSduId = 16
            CanTpRxPaddingActivation = CANTP_ON
            CanTpRxNSduRef = PCAN_DIAG_REQ_FUNC_PLANT_oPCAN_RADAR_f6414098_Rx
            CanTpRxNPdu_31268e73 (CanTpRxNPdu): CanTpRxNPduId=22, CanTpRxNPduRef=PCAN_DIAG_REQ_FUNC_PLANT_Tp_oPCAN_RADAR_5ec247a5_Rx
        TPCH_dea87001: variation-point=post-build-variant-condition{matching-criterion=RDR_POS, value=2}
          CanTpTxNSdu_9a31514e (CanTpTxNSdu):
            CanTpTxAddressingFormat = CANTP_STANDARD
            CanTpTxDl = 64
            CanTpTxTaType = CANTP_CANFD_PHYSICAL
            CanTpNas = 1
            CanTpNcs = 0.01
            CanTpTc = false
            CanTpTxNSduId = 9
            CanTpTxPaddingActivation = CANTP_ON
            CanTpNbs = 1
            CanTpTxNSduRef = PCAN_DIAG_RESP_PHYS_OBD1_oPCAN_RADAR_572eb9fe_Tx
            CanTpRxFcNPdu_02feff05 (CanTpRxFcNPdu): CanTpRxFcNPduId=4, CanTpRxFcNPduRef=PCAN_DIAG_REQ_PHYS_OBD1_Tp_oPCAN_RADAR_6e232c89_Rx
            CanTpTxNPdu_02feff05 (CanTpTxNPdu): CanTpTxNPduConfirmationPduId=4, CanTpTxNPduRef=PCAN_DIAG_RESP_PHYS_OBD1_Tp_oPCAN_RADAR_0aebd6ab_Tx
          CanTpRxNSdu_9a31514e (CanTpRxNSdu):
            CanTpRxAddressingFormat = CANTP_STANDARD
            CanTpRxDl = 64
            CanTpRxTaType = CANTP_CANFD_PHYSICAL
            CanTpNbr = 0.01
            CanTpRxNSduId = 18
            CanTpRxPaddingActivation = CANTP_ON
            CanTpBs = 8
            CanTpNar = 1
            CanTpNcr = 1
            CanTpRxWftMax = 15
            CanTpSTmin = 0.02
            CanTpRxNSduRef = PCAN_DIAG_REQ_PHYS_OBD1_oPCAN_RADAR_bb22f7fc_Rx
            CanTpTxFcNPdu_20042bf7 (CanTpTxFcNPdu): CanTpTxFcNPduConfirmationPduId=4, CanTpTxFcNPduRef=PCAN_DIAG_RESP_PHYS_OBD1_Tp_oPCAN_RADAR_0aebd6ab_Tx
            CanTpRxNPdu_20042bf7 (CanTpRxNPdu): CanTpRxNPduId=4, CanTpRxNPduRef=PCAN_DIAG_REQ_PHYS_OBD1_Tp_oPCAN_RADAR_6e232c89_Rx
        TPCH_1f06bc48: variation-point=post-build-variant-condition{matching-criterion=RDR_POS, value=2}
          CanTpRxNSdu_4164c19b (CanTpRxNSdu):
            CanTpRxAddressingFormat = CANTP_STANDARD
            CanTpRxDl = 8
            CanTpRxTaType = CANTP_FUNCTIONAL
            CanTpNbr = 0.1
            CanTpRxNSduId = 0
            CanTpRxPaddingActivation = CANTP_ON
            CanTpRxNSduRef = DIAG_REQ_FNC_OBD2_oVCAN_RADAR_254b3790_Rx
            CanTpRxNPdu_e9a53f5f (CanTpRxNPdu): CanTpRxNPduId=13, CanTpRxNPduRef=DIAG_REQ_FNC_OBD2_Tp_oVCAN_RADAR_42ec9761_Rx
        TPCH_ed439544: variation-point=post-build-variant-condition{matching-criterion=RDR_POS, value=2}
          CanTpRxNSdu_296d7662 (CanTpRxNSdu):
            CanTpRxAddressingFormat = CANTP_STANDARD
            CanTpRxDl = 64
            CanTpRxTaType = CANTP_CANFD_FUNCTIONAL
            CanTpNbr = 0.1
            CanTpRxNSduId = 21
            CanTpRxPaddingActivation = CANTP_ON
            CanTpRxNSduRef = PCAN_DIAG_REQ_FUNC_OBD1_oPCAN_RADAR_b9aa9d1d_Rx
            CanTpRxNPdu_77e5ffa1 (CanTpRxNPdu): CanTpRxNPduId=17, CanTpRxNPduRef=PCAN_DIAG_REQ_FUNC_OBD1_Tp_oPCAN_RADAR_ba721e23_Rx
        TPCH_63bc2585: variation-point=post-build-variant-condition{matching-criterion=RDR_POS, value=2}
          CanTpRxNSdu_fac189c4 (CanTpRxNSdu):
            CanTpRxAddressingFormat = CANTP_STANDARD
            CanTpRxDl = 64
            CanTpRxTaType = CANTP_CANFD_PHYSICAL
            CanTpNbr = 0.01
            CanTpRxNSduId = 7
            CanTpRxPaddingActivation = CANTP_ON
            CanTpBs = 8
            CanTpNar = 1
            CanTpNcr = 1
            CanTpRxWftMax = 15
            CanTpSTmin = 0.02
            CanTpRxNSduRef = PCAN_DIAG_REQ_PHYS_OTA_oPCAN_RADAR_45eab9fd_Rx
            CanTpRxNPdu_60e658cd (CanTpRxNPdu): CanTpRxNPduId=9, CanTpRxNPduRef=PCAN_DIAG_REQ_PHYS_OTA_Tp_oPCAN_RADAR_94a46e49_Rx
            CanTpTxFcNPdu_60e658cd (CanTpTxFcNPdu): CanTpTxFcNPduConfirmationPduId=9, CanTpTxFcNPduRef=PCAN_DIAG_RESP_PHYS_OTA_Tp_oPCAN_RADAR_37f68c50_Tx
          CanTpTxNSdu_fac189c4 (CanTpTxNSdu):
            CanTpTxAddressingFormat = CANTP_STANDARD
            CanTpTxDl = 64
            CanTpTxTaType = CANTP_CANFD_PHYSICAL
            CanTpNas = 1
            CanTpNcs = 0.01
            CanTpTc = false
            CanTpTxNSduId = 4
            CanTpTxPaddingActivation = CANTP_ON
            CanTpNbs = 1
            CanTpTxNSduRef = PCAN_DIAG_RESP_PHYS_OTA_oPCAN_RADAR_2a569d3c_Tx
            CanTpRxFcNPdu_421c8c3f (CanTpRxFcNPdu): CanTpRxFcNPduId=9, CanTpRxFcNPduRef=PCAN_DIAG_REQ_PHYS_OTA_Tp_oPCAN_RADAR_94a46e49_Rx
            CanTpTxNPdu_421c8c3f (CanTpTxNPdu): CanTpTxNPduConfirmationPduId=9, CanTpTxNPduRef=PCAN_DIAG_RESP_PHYS_OTA_Tp_oPCAN_RADAR_37f68c50_Tx
        TPCH_036f59a8: variation-point=post-build-variant-condition{matching-criterion=RDR_POS, value=2}
          CanTpRxNSdu_e2541eaf (CanTpRxNSdu):
            CanTpRxAddressingFormat = CANTP_STANDARD
            CanTpRxDl = 64
            CanTpRxTaType = CANTP_CANFD_PHYSICAL
            CanTpNbr = 0.01
            CanTpRxNSduId = 9
            CanTpRxPaddingActivation = CANTP_ON
            CanTpBs = 8
            CanTpNar = 1
            CanTpNcr = 1
            CanTpRxWftMax = 15
            CanTpSTmin = 0.02
            CanTpRxNSduRef = PCAN_DIAG_REQ_PHYS_OBD2_oPCAN_RADAR_e03546e9_Rx
            CanTpTxFcNPdu_98033048 (CanTpTxFcNPdu): CanTpTxFcNPduConfirmationPduId=6, CanTpTxFcNPduRef=PCAN_DIAG_RESP_PHYS_OBD2_Tp_oPCAN_RADAR_6e0bad55_Tx
            CanTpRxNPdu_98033048 (CanTpRxNPdu): CanTpRxNPduId=6, CanTpRxNPduRef=PCAN_DIAG_REQ_PHYS_OBD2_Tp_oPCAN_RADAR_0ac35777_Rx
          CanTpTxNSdu_e2541eaf (CanTpTxNSdu):
            CanTpTxAddressingFormat = CANTP_STANDARD
            CanTpTxDl = 64
            CanTpTxTaType = CANTP_CANFD_PHYSICAL
            CanTpNas = 1
            CanTpNcs = 0.01
            CanTpTc = false
            CanTpTxNSduId = 5
            CanTpTxPaddingActivation = CANTP_ON
            CanTpNbs = 1
            CanTpTxNSduRef = PCAN_DIAG_RESP_PHYS_OBD2_oPCAN_RADAR_0c3908eb_Tx
            CanTpRxFcNPdu_baf9e4ba (CanTpRxFcNPdu): CanTpRxFcNPduId=6, CanTpRxFcNPduRef=PCAN_DIAG_REQ_PHYS_OBD2_Tp_oPCAN_RADAR_0ac35777_Rx
            CanTpTxNPdu_baf9e4ba (CanTpTxNPdu): CanTpTxNPduConfirmationPduId=6, CanTpTxNPduRef=PCAN_DIAG_RESP_PHYS_OBD2_Tp_oPCAN_RADAR_6e0bad55_Tx
        TPCH_ea814372: variation-point=post-build-variant-condition{matching-criterion=RDR_POS, value=2}
          CanTpTxNSdu_42fe9847 (CanTpTxNSdu):
            CanTpTxAddressingFormat = CANTP_STANDARD
            CanTpTxDl = 8
            CanTpTxTaType = CANTP_PHYSICAL
            CanTpNas = 1
            CanTpNcs = 0.01
            CanTpTc = false
            CanTpTxNSduId = 11
            CanTpTxPaddingActivation = CANTP_ON
            CanTpNbs = 1
            CanTpTxNSduRef = PCAN_DIAG_RESP_PHYS_PLANT_oPCAN_RADAR_20_22a7f120_Tx
            CanTpRxFcNPdu_7f7b1c3b (CanTpRxFcNPdu): CanTpRxFcNPduId=10, CanTpRxFcNPduRef=PCAN_DIAG_REQ_PHYS_PLANT_Tp_oPCAN_RADAR_20_f110e38b_Rx
            CanTpTxNPdu_7f7b1c3b (CanTpTxNPdu): CanTpTxNPduConfirmationPduId=10, CanTpTxNPduRef=PCAN_DIAG_RESP_PHYS_PLANT_Tp_oPCAN_RADAR_20_0a848a3f_Tx
          CanTpRxNSdu_42fe9847 (CanTpRxNSdu):
            CanTpRxAddressingFormat = CANTP_STANDARD
            CanTpRxDl = 8
            CanTpRxTaType = CANTP_PHYSICAL
            CanTpNbr = 0.01
            CanTpRxNSduId = 20
            CanTpRxPaddingActivation = CANTP_ON
            CanTpBs = 8
            CanTpNar = 1
            CanTpNcr = 1
            CanTpRxWftMax = 15
            CanTpSTmin = 0.02
            CanTpRxNSduRef = PCAN_DIAG_REQ_PHYS_PLANT_oPCAN_RADAR_20_f7a3783e_Rx
            CanTpRxNPdu_5d81c8c9 (CanTpRxNPdu): CanTpRxNPduId=10, CanTpRxNPduRef=PCAN_DIAG_REQ_PHYS_PLANT_Tp_oPCAN_RADAR_20_f110e38b_Rx
            CanTpTxFcNPdu_5d81c8c9 (CanTpTxFcNPdu): CanTpTxFcNPduConfirmationPduId=10, CanTpTxFcNPduRef=PCAN_DIAG_RESP_PHYS_PLANT_Tp_oPCAN_RADAR_20_0a848a3f_Tx
        TPCH_eea3e9bf: variation-point=post-build-variant-condition{matching-criterion=RDR_POS, value=2}
          CanTpRxNSdu_321c67e6 (CanTpRxNSdu):
            CanTpRxAddressingFormat = CANTP_STANDARD
            CanTpRxDl = 8
            CanTpRxTaType = CANTP_FUNCTIONAL
            CanTpNbr = 0.1
            CanTpRxNSduId = 22
            CanTpRxPaddingActivation = CANTP_ON
            CanTpRxNSduRef = PCAN_DIAG_REQ_FUNC_OBD2_oPCAN_RADAR_20_41244182_Rx
            CanTpRxNPdu_e05b87d2 (CanTpRxNPdu): CanTpRxNPduId=18, CanTpRxNPduRef=PCAN_DIAG_REQ_FUNC_OBD2_Tp_oPCAN_RADAR_20_400c7f70_Rx
        TPCH_5042b179: variation-point=post-build-variant-condition{matching-criterion=RDR_POS, value=2}
          CanTpTxNSdu_d8286eb1 (CanTpTxNSdu):
            CanTpTxAddressingFormat = CANTP_STANDARD
            CanTpTxDl = 8
            CanTpTxTaType = CANTP_PHYSICAL
            CanTpNas = 1
            CanTpNcs = 0.01
            CanTpTc = false
            CanTpTxNSduId = 8
            CanTpTxPaddingActivation = CANTP_ON
            CanTpNbs = 1
            CanTpTxNSduRef = FR_DIAG_RES_PHY_OTA_oVCAN_RADAR_9ad9d3d9_Tx
            CanTpTxNPdu_e7ad1c6c (CanTpTxNPdu): CanTpTxNPduConfirmationPduId=2, CanTpTxNPduRef=FR_DIAG_RES_PHY_OTA_Tp_oVCAN_RADAR_19b4e511_Tx
            CanTpRxFcNPdu_e7ad1c6c (CanTpRxFcNPdu): CanTpRxFcNPduId=2, CanTpRxFcNPduRef=FR_DIAG_REQ_PHY_OTA_Tp_oVCAN_RADAR_4de495d5_Rx
          CanTpRxNSdu_d8286eb1 (CanTpRxNSdu):
            CanTpRxAddressingFormat = CANTP_STANDARD
            CanTpRxDl = 8
            CanTpRxTaType = CANTP_PHYSICAL
            CanTpNbr = 0.01
            CanTpRxNSduId = 14
            CanTpRxPaddingActivation = CANTP_ON
            CanTpBs = 8
            CanTpNar = 1
            CanTpNcr = 1
            CanTpRxWftMax = 15
            CanTpSTmin = 0.02
            CanTpRxNSduRef = FR_DIAG_REQ_PHY_OTA_oVCAN_RADAR_9187f4da_Rx
            CanTpTxFcNPdu_c557c89e (CanTpTxFcNPdu): CanTpTxFcNPduConfirmationPduId=2, CanTpTxFcNPduRef=FR_DIAG_RES_PHY_OTA_Tp_oVCAN_RADAR_19b4e511_Tx
            CanTpRxNPdu_c557c89e (CanTpRxNPdu): CanTpRxNPduId=2, CanTpRxNPduRef=FR_DIAG_REQ_PHY_OTA_Tp_oVCAN_RADAR_4de495d5_Rx
        TPCH_5a7b2a15: variation-point=post-build-variant-condition{matching-criterion=RDR_POS, value=2}
          CanTpRxNSdu_1b50fb68 (CanTpRxNSdu):
            CanTpRxAddressingFormat = CANTP_STANDARD
            CanTpRxDl = 8
            CanTpRxTaType = CANTP_PHYSICAL
            CanTpNbr = 0.01
            CanTpRxNSduId = 3
            CanTpRxPaddingActivation = CANTP_ON
            CanTpBs = 8
            CanTpNar = 1
            CanTpNcr = 1
            CanTpRxWftMax = 15
            CanTpSTmin = 0.02
            CanTpRxNSduRef = PCAN_DIAG_REQ_PHYS_OTA_oPCAN_RADAR_20_0b124a16_Rx
            CanTpRxNPdu_0324451f (CanTpRxNPdu): CanTpRxNPduId=8, CanTpRxNPduRef=PCAN_DIAG_REQ_PHYS_OTA_Tp_oPCAN_RADAR_20_96582344_Rx
            CanTpTxFcNPdu_0324451f (CanTpTxFcNPdu): CanTpTxFcNPduConfirmationPduId=8, CanTpTxFcNPduRef=PCAN_DIAG_RESP_PHYS_OTA_Tp_oPCAN_RADAR_20_6c821aae_Tx
          CanTpTxNSdu_1b50fb68 (CanTpTxNSdu):
            CanTpTxAddressingFormat = CANTP_STANDARD
            CanTpTxDl = 8
            CanTpTxTaType = CANTP_PHYSICAL
            CanTpNas = 1
            CanTpNcs = 0.01
            CanTpTc = false
            CanTpTxNSduId = 1
            CanTpTxPaddingActivation = CANTP_ON
            CanTpNbs = 1
            CanTpTxNSduRef = PCAN_DIAG_RESP_PHYS_OTA_oPCAN_RADAR_20_a840a80f_Tx
            CanTpTxNPdu_21de91ed (CanTpTxNPdu): CanTpTxNPduConfirmationPduId=8, CanTpTxNPduRef=PCAN_DIAG_RESP_PHYS_OTA_Tp_oPCAN_RADAR_20_6c821aae_Tx
            CanTpRxFcNPdu_21de91ed (CanTpRxFcNPdu): CanTpRxFcNPduId=8, CanTpRxFcNPduRef=PCAN_DIAG_REQ_PHYS_OTA_Tp_oPCAN_RADAR_20_96582344_Rx
        TPCH_493bb7c9: variation-point=post-build-variant-condition{matching-criterion=RDR_POS, value=2}
          CanTpRxNSdu_7e56306d (CanTpRxNSdu):
            CanTpRxAddressingFormat = CANTP_STANDARD
            CanTpRxDl = 8
            CanTpRxTaType = CANTP_PHYSICAL
            CanTpNbr = 0.01
            CanTpRxNSduId = 11
            CanTpRxPaddingActivation = CANTP_ON
            CanTpBs = 8
            CanTpNar = 1
            CanTpNcr = 1
            CanTpRxWftMax = 15
            CanTpSTmin = 0.02
            CanTpRxNSduRef = FR_DIAG_REQ_PHY_OBD2_oVCAN_RADAR_0f521c1d_Rx
            CanTpTxFcNPdu_012fc1e4 (CanTpTxFcNPdu): CanTpTxFcNPduConfirmationPduId=1, CanTpTxFcNPduRef=FR_DIAG_RES_PHY_OBD2_Tp_oVCAN_RADAR_25471ce8_Tx
            CanTpRxNPdu_012fc1e4 (CanTpRxNPdu): CanTpRxNPduId=1, CanTpRxNPduRef=FR_DIAG_REQ_PHY_OBD2_Tp_oVCAN_RADAR_b91a4a31_Rx
          CanTpTxNSdu_7e56306d (CanTpTxNSdu):
            CanTpTxAddressingFormat = CANTP_STANDARD
            CanTpTxDl = 8
            CanTpTxTaType = CANTP_PHYSICAL
            CanTpNas = 1
            CanTpNcs = 0.01
            CanTpTc = false
            CanTpTxNSduId = 7
            CanTpTxPaddingActivation = CANTP_ON
            CanTpNbs = 1
            CanTpTxNSduRef = FR_DIAG_RES_PHY_OBD2_oVCAN_RADAR_96501380_Tx
            CanTpTxNPdu_23d51516 (CanTpTxNPdu): CanTpTxNPduConfirmationPduId=1, CanTpTxNPduRef=FR_DIAG_RES_PHY_OBD2_Tp_oVCAN_RADAR_25471ce8_Tx
            CanTpRxFcNPdu_23d51516 (CanTpRxFcNPdu): CanTpRxFcNPduId=1, CanTpRxFcNPduRef=FR_DIAG_REQ_PHY_OBD2_Tp_oVCAN_RADAR_b91a4a31_Rx
        TPCH_e6e375c3: variation-point=post-build-variant-condition{matching-criterion=RDR_POS, value=2}
          CanTpTxNSdu_d1b47cad (CanTpTxNSdu):
            CanTpTxAddressingFormat = CANTP_STANDARD
            CanTpTxDl = 8
            CanTpTxTaType = CANTP_PHYSICAL
            CanTpNas = 1
            CanTpNcs = 0.01
            CanTpTc = false
            CanTpTxNSduId = 10
            CanTpTxPaddingActivation = CANTP_ON
            CanTpNbs = 1
            CanTpTxNSduRef = FR_DIAG_RES_PHY_PLANT_oVCAN_RADAR_5fef2467_Tx
            CanTpTxNPdu_f028787e (CanTpTxNPdu): CanTpTxNPduConfirmationPduId=3, CanTpTxNPduRef=FR_DIAG_RES_PHY_PLANT_Tp_oVCAN_RADAR_4233d42d_Tx
            CanTpRxFcNPdu_f028787e (CanTpRxFcNPdu): CanTpRxFcNPduId=3, CanTpRxFcNPduRef=FR_DIAG_REQ_PHY_PLANT_Tp_oVCAN_RADAR_bda0e30b_Rx
          CanTpRxNSdu_d1b47cad (CanTpRxNSdu):
            CanTpRxAddressingFormat = CANTP_STANDARD
            CanTpRxDl = 8
            CanTpRxTaType = CANTP_PHYSICAL
            CanTpNbr = 0.01
            CanTpRxNSduId = 19
            CanTpRxPaddingActivation = CANTP_ON
            CanTpBs = 8
            CanTpNar = 1
            CanTpNcr = 1
            CanTpRxWftMax = 15
            CanTpSTmin = 0.02
            CanTpRxNSduRef = FR_DIAG_REQ_PHY_PLANT_oVCAN_RADAR_d1c8c991_Rx
            CanTpTxFcNPdu_d2d2ac8c (CanTpTxFcNPdu): CanTpTxFcNPduConfirmationPduId=3, CanTpTxFcNPduRef=FR_DIAG_RES_PHY_PLANT_Tp_oVCAN_RADAR_4233d42d_Tx
            CanTpRxNPdu_d2d2ac8c (CanTpRxNPdu): CanTpRxNPduId=3, CanTpRxNPduRef=FR_DIAG_REQ_PHY_PLANT_Tp_oVCAN_RADAR_bda0e30b_Rx
        TPCH_dcb5d2c8: variation-point=post-build-variant-condition{matching-criterion=RDR_POS, value=2}
          CanTpRxNSdu_b593107a (CanTpRxNSdu):
            CanTpRxAddressingFormat = CANTP_STANDARD
            CanTpRxDl = 8
            CanTpRxTaType = CANTP_FUNCTIONAL
            CanTpNbr = 0.1
            CanTpRxNSduId = 17
            CanTpRxPaddingActivation = CANTP_ON
            CanTpRxNSduRef = DIAG_REQ_FNC_PLANT_oVCAN_RADAR_42eb2f27_Rx
            CanTpRxNPdu_7b3b0f4d (CanTpRxNPdu): CanTpRxNPduId=15, CanTpRxNPduRef=DIAG_REQ_FNC_PLANT_Tp_oVCAN_RADAR_d6304422_Rx
        TPCH_308e2273: variation-point=post-build-variant-condition{matching-criterion=RDR_POS, value=2}
          CanTpTxNSdu_ca28ec73 (CanTpTxNSdu):
            CanTpTxAddressingFormat = CANTP_STANDARD
            CanTpTxDl = 64
            CanTpTxTaType = CANTP_CANFD_PHYSICAL
            CanTpNas = 1
            CanTpNcs = 0.01
            CanTpTc = false
            CanTpTxNSduId = 6
            CanTpTxPaddingActivation = CANTP_ON
            CanTpNbs = 1
            CanTpTxNSduRef = PCAN_DIAG_RESP_PHYS_PLANT_oPCAN_RADAR_cfac777e_Tx
            CanTpRxFcNPdu_070c7dc6 (CanTpRxFcNPdu): CanTpRxFcNPduId=11, CanTpRxFcNPduRef=PCAN_DIAG_REQ_PHYS_PLANT_Tp_oPCAN_RADAR_68155c61_Rx
            CanTpTxNPdu_070c7dc6 (CanTpTxNPdu): CanTpTxNPduConfirmationPduId=11, CanTpTxNPduRef=PCAN_DIAG_RESP_PHYS_PLANT_Tp_oPCAN_RADAR_bd11d57f_Tx
          CanTpRxNSdu_ca28ec73 (CanTpRxNSdu):
            CanTpRxAddressingFormat = CANTP_STANDARD
            CanTpRxDl = 64
            CanTpRxTaType = CANTP_CANFD_PHYSICAL
            CanTpNbr = 0.01
            CanTpRxNSduId = 10
            CanTpRxPaddingActivation = CANTP_ON
            CanTpBs = 8
            CanTpNar = 1
            CanTpNcr = 1
            CanTpRxWftMax = 15
            CanTpSTmin = 0.02
            CanTpRxNSduRef = PCAN_DIAG_REQ_PHYS_PLANT_oPCAN_RADAR_214e1a1c_Rx
            CanTpTxFcNPdu_25f6a934 (CanTpTxFcNPdu): CanTpTxFcNPduConfirmationPduId=11, CanTpTxFcNPduRef=PCAN_DIAG_RESP_PHYS_PLANT_Tp_oPCAN_RADAR_bd11d57f_Tx
            CanTpRxNPdu_25f6a934 (CanTpRxNPdu): CanTpRxNPduId=11, CanTpRxNPduRef=PCAN_DIAG_REQ_PHYS_PLANT_Tp_oPCAN_RADAR_68155c61_Rx
        TPCH_4ce6e994: variation-point=post-build-variant-condition{matching-criterion=RDR_POS, value=2}
          CanTpTxNSdu_471bd8a5 (CanTpTxNSdu):
            CanTpTxAddressingFormat = CANTP_STANDARD
            CanTpTxDl = 8
            CanTpTxTaType = CANTP_PHYSICAL
            CanTpNas = 1
            CanTpNcs = 0.01
            CanTpTc = false
            CanTpTxNSduId = 0
            CanTpTxPaddingActivation = CANTP_ON
            CanTpNbs = 1
            CanTpTxNSduRef = PCAN_DIAG_RESP_PHYS_OBD2_oPCAN_RADAR_20_f1bd890a_Tx
            CanTpRxFcNPdu_35063251 (CanTpRxFcNPdu): CanTpRxFcNPduId=7, CanTpRxFcNPduRef=PCAN_DIAG_REQ_PHYS_OBD2_Tp_oPCAN_RADAR_20_65ff9201_Rx
            CanTpTxNPdu_35063251 (CanTpTxNPdu): CanTpTxNPduConfirmationPduId=7, CanTpTxNPduRef=PCAN_DIAG_RESP_PHYS_OBD2_Tp_oPCAN_RADAR_20_25da435e_Tx
          CanTpRxNSdu_471bd8a5 (CanTpRxNSdu):
            CanTpRxAddressingFormat = CANTP_STANDARD
            CanTpRxDl = 8
            CanTpRxTaType = CANTP_PHYSICAL
            CanTpNbr = 0.01
            CanTpRxNSduId = 2
            CanTpRxPaddingActivation = CANTP_ON
            CanTpBs = 8
            CanTpNar = 1
            CanTpNcr = 1
            CanTpRxWftMax = 15
            CanTpSTmin = 0.02
            CanTpRxNSduRef = PCAN_DIAG_REQ_PHYS_OBD2_oPCAN_RADAR_20_95757328_Rx
            CanTpRxNPdu_17fce6a3 (CanTpRxNPdu): CanTpRxNPduId=7, CanTpRxNPduRef=PCAN_DIAG_REQ_PHYS_OBD2_Tp_oPCAN_RADAR_20_65ff9201_Rx
            CanTpTxFcNPdu_17fce6a3 (CanTpTxFcNPdu): CanTpTxFcNPduConfirmationPduId=7, CanTpTxFcNPduRef=PCAN_DIAG_RESP_PHYS_OBD2_Tp_oPCAN_RADAR_20_25da435e_Tx
        TPCH_4a9c4dee: variation-point=post-build-variant-condition{matching-criterion=RDR_POS, value=2}
          CanTpRxNSdu_468ce7a5 (CanTpRxNSdu):
            CanTpRxAddressingFormat = CANTP_STANDARD
            CanTpRxDl = 8
            CanTpRxTaType = CANTP_FUNCTIONAL
            CanTpNbr = 0.1
            CanTpRxNSduId = 1
            CanTpRxPaddingActivation = CANTP_ON
            CanTpRxNSduRef = PCAN_DIAG_REQ_FUNC_OTA_oPCAN_RADAR_20_e1100275_Rx
            CanTpRxNPdu_b29ee0c8 (CanTpRxNPdu): CanTpRxNPduId=21, CanTpRxNPduRef=PCAN_DIAG_REQ_FUNC_OTA_Tp_oPCAN_RADAR_20_0a67f2f6_Rx
        TPCH_8b16005e: variation-point=post-build-variant-condition{matching-criterion=RDR_POS, value=2}
          CanTpTxNSdu_620766ce (CanTpTxNSdu):
            CanTpTxAddressingFormat = CANTP_STANDARD
            CanTpTxDl = 8
            CanTpTxTaType = CANTP_PHYSICAL
            CanTpNas = 1
            CanTpNcs = 0.01
            CanTpTc = false
            CanTpTxNSduId = 2
            CanTpTxPaddingActivation = CANTP_ON
            CanTpNbs = 1
            CanTpTxNSduRef = PCAN_DIAG_RESP_PHYS_OBD1_oPCAN_RADAR_20_955df2f4_Tx
            CanTpRxFcNPdu_d3b2b1a3 (CanTpRxFcNPdu): CanTpRxFcNPduId=5, CanTpRxFcNPduRef=PCAN_DIAG_REQ_PHYS_OBD1_Tp_oPCAN_RADAR_20_b6648efa_Rx
            CanTpTxNPdu_d3b2b1a3 (CanTpTxNPdu): CanTpTxNPduConfirmationPduId=5, CanTpTxNPduRef=PCAN_DIAG_RESP_PHYS_OBD1_Tp_oPCAN_RADAR_20_f6415fa5_Tx
          CanTpRxNSdu_620766ce (CanTpRxNSdu):
            CanTpRxAddressingFormat = CANTP_STANDARD
            CanTpRxDl = 8
            CanTpRxTaType = CANTP_PHYSICAL
            CanTpNbr = 0.01
            CanTpRxNSduId = 4
            CanTpRxPaddingActivation = CANTP_ON
            CanTpBs = 8
            CanTpNar = 1
            CanTpNcr = 1
            CanTpRxWftMax = 15
            CanTpSTmin = 0.02
            CanTpRxNSduRef = PCAN_DIAG_REQ_PHYS_OBD1_oPCAN_RADAR_20_f19508d6_Rx
            CanTpTxFcNPdu_f1486551 (CanTpTxFcNPdu): CanTpTxFcNPduConfirmationPduId=5, CanTpTxFcNPduRef=PCAN_DIAG_RESP_PHYS_OBD1_Tp_oPCAN_RADAR_20_f6415fa5_Tx
            CanTpRxNPdu_f1486551 (CanTpRxNPdu): CanTpRxNPduId=5, CanTpRxNPduRef=PCAN_DIAG_REQ_PHYS_OBD1_Tp_oPCAN_RADAR_20_b6648efa_Rx
        TPCH_6496da17: variation-point=post-build-variant-condition{matching-criterion=RDR_POS, value=2}
          CanTpRxNSdu_13c303b2 (CanTpRxNSdu):
            CanTpRxAddressingFormat = CANTP_STANDARD
            CanTpRxDl = 64
            CanTpRxTaType = CANTP_CANFD_FUNCTIONAL
            CanTpNbr = 0.1
            CanTpRxNSduId = 15
            CanTpRxPaddingActivation = CANTP_ON
            CanTpRxNSduRef = PCAN_DIAG_REQ_FUNC_OBD2_oPCAN_RADAR_e2bd2c08_Rx
            CanTpRxNPdu_eed79f7d (CanTpRxNPdu): CanTpRxNPduId=19, CanTpRxNPduRef=PCAN_DIAG_REQ_FUNC_OBD2_Tp_oPCAN_RADAR_de9265dd_Rx
        TPCH_8c21d5d3: variation-point=post-build-variant-condition{matching-criterion=RDR_POS, value=2}
          CanTpTxNSdu_93c8010e (CanTpTxNSdu):
            CanTpTxAddressingFormat = CANTP_STANDARD
            CanTpTxDl = 8
            CanTpTxTaType = CANTP_PHYSICAL
            CanTpNas = 1
            CanTpNcs = 0.01
            CanTpTc = false
            CanTpTxNSduId = 3
            CanTpTxPaddingActivation = CANTP_ON
            CanTpNbs = 1
            CanTpTxNSduRef = FR_DIAG_RES_PHY_OBD1_oVCAN_RADAR_cd47a295_Tx
            CanTpTxNPdu_01d8e2bf (CanTpTxNPdu): CanTpTxNPduConfirmationPduId=0, CanTpTxNPduRef=FR_DIAG_RES_PHY_OBD1_Tp_oVCAN_RADAR_41a76716_Tx
            CanTpRxFcNPdu_01d8e2bf (CanTpRxFcNPdu): CanTpRxFcNPduId=0, CanTpRxFcNPduRef=FR_DIAG_REQ_PHY_OBD1_Tp_oVCAN_RADAR_ddfa31cf_Rx
          CanTpRxNSdu_93c8010e (CanTpRxNSdu):
            CanTpRxAddressingFormat = CANTP_STANDARD
            CanTpRxDl = 8
            CanTpRxTaType = CANTP_PHYSICAL
            CanTpNbr = 0.01
            CanTpRxNSduId = 5
            CanTpRxPaddingActivation = CANTP_ON
            CanTpBs = 8
            CanTpNar = 1
            CanTpNcr = 1
            CanTpRxWftMax = 15
            CanTpSTmin = 0.02
            CanTpRxNSduRef = FR_DIAG_REQ_PHY_OBD1_oVCAN_RADAR_5445ad08_Rx
            CanTpTxFcNPdu_2322364d (CanTpTxFcNPdu): CanTpTxFcNPduConfirmationPduId=0, CanTpTxFcNPduRef=FR_DIAG_RES_PHY_OBD1_Tp_oVCAN_RADAR_41a76716_Tx
            CanTpRxNPdu_2322364d (CanTpRxNPdu): CanTpRxNPduId=0, CanTpRxNPduRef=FR_DIAG_REQ_PHY_OBD1_Tp_oVCAN_RADAR_ddfa31cf_Rx
        TPCH_fc0cdca1: variation-point=post-build-variant-condition{matching-criterion=RDR_POS, value=2}
          CanTpRxNSdu_27371a31 (CanTpRxNSdu):
            CanTpRxAddressingFormat = CANTP_STANDARD
            CanTpRxDl = 64
            CanTpRxTaType = CANTP_CANFD_FUNCTIONAL
            CanTpNbr = 0.1
            CanTpRxNSduId = 23
            CanTpRxPaddingActivation = CANTP_ON
            CanTpRxNSduRef = PCAN_DIAG_REQ_FUNC_OTA_oPCAN_RADAR_a013523e_Rx
            CanTpRxNPdu_a219ac95 (CanTpRxNPdu): CanTpRxNPduId=20, CanTpRxNPduRef=PCAN_DIAG_REQ_FUNC_OTA_Tp_oPCAN_RADAR_7ea6262a_Rx
        TPCH_2433c4a7: variation-point=post-build-variant-condition{matching-criterion=RDR_POS, value=2}
          CanTpRxNSdu_b3e928e8 (CanTpRxNSdu):
            CanTpRxAddressingFormat = CANTP_STANDARD
            CanTpRxDl = 8
            CanTpRxTaType = CANTP_FUNCTIONAL
            CanTpNbr = 0.1
            CanTpRxNSduId = 13
            CanTpRxPaddingActivation = CANTP_ON
            CanTpRxNSduRef = DIAG_REQ_FNC_OBD1_oVCAN_RADAR_7e5c8685_Rx
            CanTpRxNPdu_5e5e67e3 (CanTpRxNPdu): CanTpRxNPduId=12, CanTpRxNPduRef=DIAG_REQ_FNC_OBD1_Tp_oVCAN_RADAR_260cec9f_Rx
        TPCH_82f88316: variation-point=post-build-variant-condition{matching-criterion=RDR_POS, value=3}
          CanTpRxNSdu_be955aab (CanTpRxNSdu):
            CanTpRxAddressingFormat = CANTP_STANDARD
            CanTpRxDl = 64
            CanTpRxTaType = CANTP_CANFD_PHYSICAL
            CanTpNbr = 0.01
            CanTpRxNSduId = 8
            CanTpRxPaddingActivation = CANTP_ON
            CanTpBs = 8
            CanTpNar = 1
            CanTpNcr = 1
            CanTpRxWftMax = 15
            CanTpSTmin = 0.02
            CanTpRxNSduRef = PCAN_DIAG_REQ_PHYS_OTA_oPCAN_RADAR_45eab9fd_Rx
            CanTpTxFcNPdu_50d05297 (CanTpTxFcNPdu): CanTpTxFcNPduConfirmationPduId=9, CanTpTxFcNPduRef=PCAN_DIAG_RESP_PHYS_OTA_Tp_oPCAN_RADAR_37f68c50_Tx
            CanTpRxNPdu_50d05297 (CanTpRxNPdu): CanTpRxNPduId=9, CanTpRxNPduRef=PCAN_DIAG_REQ_PHYS_OTA_Tp_oPCAN_RADAR_94a46e49_Rx
          CanTpTxNSdu_be955aab (CanTpTxNSdu):
            CanTpTxAddressingFormat = CANTP_STANDARD
            CanTpTxDl = 64
            CanTpTxTaType = CANTP_CANFD_PHYSICAL
            CanTpNas = 1
            CanTpNcs = 0.01
            CanTpTc = false
            CanTpTxNSduId = 3
            CanTpTxPaddingActivation = CANTP_ON
            CanTpNbs = 1
            CanTpTxNSduRef = PCAN_DIAG_RESP_PHYS_OTA_oPCAN_RADAR_2a569d3c_Tx
            CanTpTxNPdu_722a8665 (CanTpTxNPdu): CanTpTxNPduConfirmationPduId=9, CanTpTxNPduRef=PCAN_DIAG_RESP_PHYS_OTA_Tp_oPCAN_RADAR_37f68c50_Tx
            CanTpRxFcNPdu_722a8665 (CanTpRxFcNPdu): CanTpRxFcNPduId=9, CanTpRxFcNPduRef=PCAN_DIAG_REQ_PHYS_OTA_Tp_oPCAN_RADAR_94a46e49_Rx
        TPCH_e22bff3b: variation-point=post-build-variant-condition{matching-criterion=RDR_POS, value=3}
          CanTpTxNSdu_8a9f4292 (CanTpTxNSdu):
            CanTpTxAddressingFormat = CANTP_STANDARD
            CanTpTxDl = 64
            CanTpTxTaType = CANTP_CANFD_PHYSICAL
            CanTpNas = 1
            CanTpNcs = 0.01
            CanTpTc = false
            CanTpTxNSduId = 11
            CanTpTxPaddingActivation = CANTP_ON
            CanTpNbs = 1
            CanTpTxNSduRef = PCAN_DIAG_RESP_PHYS_OBD2_oPCAN_RADAR_0c3908eb_Tx
            CanTpTxNPdu_ec3e6156 (CanTpTxNPdu): CanTpTxNPduConfirmationPduId=6, CanTpTxNPduRef=PCAN_DIAG_RESP_PHYS_OBD2_Tp_oPCAN_RADAR_6e0bad55_Tx
            CanTpRxFcNPdu_ec3e6156 (CanTpRxFcNPdu): CanTpRxFcNPduId=6, CanTpRxFcNPduRef=PCAN_DIAG_REQ_PHYS_OBD2_Tp_oPCAN_RADAR_0ac35777_Rx
          CanTpRxNSdu_8a9f4292 (CanTpRxNSdu):
            CanTpRxAddressingFormat = CANTP_STANDARD
            CanTpRxDl = 64
            CanTpRxTaType = CANTP_CANFD_PHYSICAL
            CanTpNbr = 0.01
            CanTpRxNSduId = 21
            CanTpRxPaddingActivation = CANTP_ON
            CanTpBs = 8
            CanTpNar = 1
            CanTpNcr = 1
            CanTpRxWftMax = 15
            CanTpSTmin = 0.02
            CanTpRxNSduRef = PCAN_DIAG_REQ_PHYS_OBD2_oPCAN_RADAR_e03546e9_Rx
            CanTpRxNPdu_cec4b5a4 (CanTpRxNPdu): CanTpRxNPduId=6, CanTpRxNPduRef=PCAN_DIAG_REQ_PHYS_OBD2_Tp_oPCAN_RADAR_0ac35777_Rx
            CanTpTxFcNPdu_cec4b5a4 (CanTpTxFcNPdu): CanTpTxFcNPduConfirmationPduId=6, CanTpTxFcNPduRef=PCAN_DIAG_RESP_PHYS_OBD2_Tp_oPCAN_RADAR_6e0bad55_Tx
        TPCH_69ca1b27: variation-point=post-build-variant-condition{matching-criterion=RDR_POS, value=3}
          CanTpTxNSdu_808a4832 (CanTpTxNSdu):
            CanTpTxAddressingFormat = CANTP_STANDARD
            CanTpTxDl = 8
            CanTpTxTaType = CANTP_PHYSICAL
            CanTpNas = 1
            CanTpNcs = 0.01
            CanTpTc = false
            CanTpTxNSduId = 2
            CanTpTxPaddingActivation = CANTP_ON
            CanTpNbs = 1
            CanTpTxNSduRef = PCAN_DIAG_RESP_PHYS_OBD1_oPCAN_RADAR_20_955df2f4_Tx
            CanTpTxNPdu_2abb8ac6 (CanTpTxNPdu): CanTpTxNPduConfirmationPduId=5, CanTpTxNPduRef=PCAN_DIAG_RESP_PHYS_OBD1_Tp_oPCAN_RADAR_20_f6415fa5_Tx
            CanTpRxFcNPdu_2abb8ac6 (CanTpRxFcNPdu): CanTpRxFcNPduId=5, CanTpRxFcNPduRef=PCAN_DIAG_REQ_PHYS_OBD1_Tp_oPCAN_RADAR_20_b6648efa_Rx
          CanTpRxNSdu_808a4832 (CanTpRxNSdu):
            CanTpRxAddressingFormat = CANTP_STANDARD
            CanTpRxDl = 8
            CanTpRxTaType = CANTP_PHYSICAL
            CanTpNbr = 0.01
            CanTpRxNSduId = 7
            CanTpRxPaddingActivation = CANTP_ON
            CanTpBs = 8
            CanTpNar = 1
            CanTpNcr = 1
            CanTpRxWftMax = 15
            CanTpSTmin = 0.02
            CanTpRxNSduRef = PCAN_DIAG_REQ_PHYS_OBD1_oPCAN_RADAR_20_f19508d6_Rx
            CanTpRxNPdu_08415e34 (CanTpRxNPdu): CanTpRxNPduId=5, CanTpRxNPduRef=PCAN_DIAG_REQ_PHYS_OBD1_Tp_oPCAN_RADAR_20_b6648efa_Rx
            CanTpTxFcNPdu_08415e34 (CanTpTxFcNPdu): CanTpTxFcNPduConfirmationPduId=5, CanTpTxFcNPduRef=PCAN_DIAG_RESP_PHYS_OBD1_Tp_oPCAN_RADAR_20_f6415fa5_Tx
        TPCH_014fe457: variation-point=post-build-variant-condition{matching-criterion=RDR_POS, value=3}
          CanTpRxNSdu_b5beb7bd (CanTpRxNSdu):
            CanTpRxAddressingFormat = CANTP_STANDARD
            CanTpRxDl = 64
            CanTpRxTaType = CANTP_CANFD_FUNCTIONAL
            CanTpNbr = 0.1
            CanTpRxNSduId = 10
            CanTpRxPaddingActivation = CANTP_ON
            CanTpRxNSduRef = PCAN_DIAG_REQ_FUNC_OBD2_oPCAN_RADAR_e2bd2c08_Rx
            CanTpRxNPdu_ef2320d0 (CanTpRxNPdu): CanTpRxNPduId=19, CanTpRxNPduRef=PCAN_DIAG_REQ_FUNC_OBD2_Tp_oPCAN_RADAR_de9265dd_Rx
        TPCH_9a3b0030: variation-point=post-build-variant-condition{matching-criterion=RDR_POS, value=3}
          CanTpRxNSdu_5245b630 (CanTpRxNSdu):
            CanTpRxAddressingFormat = CANTP_STANDARD
            CanTpRxDl = 8
            CanTpRxTaType = CANTP_FUNCTIONAL
            CanTpNbr = 0.1
            CanTpRxNSduId = 5
            CanTpRxPaddingActivation = CANTP_ON
            CanTpRxNSduRef = PCAN_DIAG_REQ_FUNC_OBD2_oPCAN_RADAR_20_41244182_Rx
            CanTpRxNPdu_4664bd26 (CanTpRxNPdu): CanTpRxNPduId=18, CanTpRxNPduRef=PCAN_DIAG_REQ_FUNC_OBD2_Tp_oPCAN_RADAR_20_400c7f70_Rx
        TPCH_6b9e55c7: variation-point=post-build-variant-condition{matching-criterion=RDR_POS, value=3}
          CanTpRxNSdu_bcfcbb59 (CanTpRxNSdu):
            CanTpRxAddressingFormat = CANTP_STANDARD
            CanTpRxDl = 8
            CanTpRxTaType = CANTP_FUNCTIONAL
            CanTpNbr = 0.1
            CanTpRxNSduId = 3
            CanTpRxPaddingActivation = CANTP_ON
            CanTpRxNSduRef = DIAG_REQ_FNC_OBD2_oVCAN_RADAR_254b3790_Rx
            CanTpRxNPdu_604a7f84 (CanTpRxNPdu): CanTpRxNPduId=13, CanTpRxNPduRef=DIAG_REQ_FNC_OBD2_Tp_oVCAN_RADAR_42ec9761_Rx
        TPCH_6efdceaa: variation-point=post-build-variant-condition{matching-criterion=RDR_POS, value=3}
          CanTpRxNSdu_8b07fec8 (CanTpRxNSdu):
            CanTpRxAddressingFormat = CANTP_STANDARD
            CanTpRxDl = 8
            CanTpRxTaType = CANTP_PHYSICAL
            CanTpNbr = 0.01
            CanTpRxNSduId = 4
            CanTpRxPaddingActivation = CANTP_ON
            CanTpBs = 8
            CanTpNar = 1
            CanTpNcr = 1
            CanTpRxWftMax = 15
            CanTpSTmin = 0.02
            CanTpRxNSduRef = FR_DIAG_REQ_PHY_OBD1_oVCAN_RADAR_5445ad08_Rx
            CanTpTxFcNPdu_26482297 (CanTpTxFcNPdu): CanTpTxFcNPduConfirmationPduId=0, CanTpTxFcNPduRef=FR_DIAG_RES_PHY_OBD1_Tp_oVCAN_RADAR_41a76716_Tx
            CanTpRxNPdu_26482297 (CanTpRxNPdu): CanTpRxNPduId=0, CanTpRxNPduRef=FR_DIAG_REQ_PHY_OBD1_Tp_oVCAN_RADAR_ddfa31cf_Rx
          CanTpTxNSdu_8b07fec8 (CanTpTxNSdu):
            CanTpTxAddressingFormat = CANTP_STANDARD
            CanTpTxDl = 8
            CanTpTxTaType = CANTP_PHYSICAL
            CanTpNas = 1
            CanTpNcs = 0.01
            CanTpTc = false
            CanTpTxNSduId = 1
            CanTpTxPaddingActivation = CANTP_ON
            CanTpNbs = 1
            CanTpTxNSduRef = FR_DIAG_RES_PHY_OBD1_oVCAN_RADAR_cd47a295_Tx
            CanTpTxNPdu_04b2f665 (CanTpTxNPdu): CanTpTxNPduConfirmationPduId=0, CanTpTxNPduRef=FR_DIAG_RES_PHY_OBD1_Tp_oVCAN_RADAR_41a76716_Tx
            CanTpRxFcNPdu_04b2f665 (CanTpRxFcNPdu): CanTpRxFcNPduId=0, CanTpRxFcNPduRef=FR_DIAG_REQ_PHY_OBD1_Tp_oVCAN_RADAR_ddfa31cf_Rx
        TPCH_043f6eba: variation-point=post-build-variant-condition{matching-criterion=RDR_POS, value=3}
          CanTpRxNSdu_39b7733b (CanTpRxNSdu):
            CanTpRxAddressingFormat = CANTP_STANDARD
            CanTpRxDl = 8
            CanTpRxTaType = CANTP_PHYSICAL
            CanTpNbr = 0.01
            CanTpRxNSduId = 11
            CanTpRxPaddingActivation = CANTP_ON
            CanTpBs = 8
            CanTpNar = 1
            CanTpNcr = 1
            CanTpRxWftMax = 15
            CanTpSTmin = 0.02
            CanTpRxNSduRef = FR_DIAG_REQ_PHY_PLANT_oVCAN_RADAR_d1c8c991_Rx
            CanTpTxFcNPdu_fa7e2a6b (CanTpTxFcNPdu): CanTpTxFcNPduConfirmationPduId=3, CanTpTxFcNPduRef=FR_DIAG_RES_PHY_PLANT_Tp_oVCAN_RADAR_4233d42d_Tx
            CanTpRxNPdu_fa7e2a6b (CanTpRxNPdu): CanTpRxNPduId=3, CanTpRxNPduRef=FR_DIAG_REQ_PHY_PLANT_Tp_oVCAN_RADAR_bda0e30b_Rx
          CanTpTxNSdu_39b7733b (CanTpTxNSdu):
            CanTpTxAddressingFormat = CANTP_STANDARD
            CanTpTxDl = 8
            CanTpTxTaType = CANTP_PHYSICAL
            CanTpNas = 1
            CanTpNcs = 0.01
            CanTpTc = false
            CanTpTxNSduId = 4
            CanTpTxPaddingActivation = CANTP_ON
            CanTpNbs = 1
            CanTpTxNSduRef = FR_DIAG_RES_PHY_PLANT_oVCAN_RADAR_5fef2467_Tx
            CanTpRxFcNPdu_d884fe99 (CanTpRxFcNPdu): CanTpRxFcNPduId=3, CanTpRxFcNPduRef=FR_DIAG_REQ_PHY_PLANT_Tp_oVCAN_RADAR_bda0e30b_Rx
            CanTpTxNPdu_d884fe99 (CanTpTxNPdu): CanTpTxNPduConfirmationPduId=3, CanTpTxNPduRef=FR_DIAG_RES_PHY_PLANT_Tp_oVCAN_RADAR_4233d42d_Tx
        TPCH_d1ca84e0: variation-point=post-build-variant-condition{matching-criterion=RDR_POS, value=3}
          CanTpRxNSdu_dac1b156 (CanTpRxNSdu):
            CanTpRxAddressingFormat = CANTP_STANDARD
            CanTpRxDl = 64
            CanTpRxTaType = CANTP_CANFD_PHYSICAL
            CanTpNbr = 0.01
            CanTpRxNSduId = 20
            CanTpRxPaddingActivation = CANTP_ON
            CanTpBs = 8
            CanTpNar = 1
            CanTpNcr = 1
            CanTpRxWftMax = 15
            CanTpSTmin = 0.02
            CanTpRxNSduRef = PCAN_DIAG_REQ_PHYS_PLANT_oPCAN_RADAR_214e1a1c_Rx
            CanTpRxNPdu_2dbb61ae (CanTpRxNPdu): CanTpRxNPduId=11, CanTpRxNPduRef=PCAN_DIAG_REQ_PHYS_PLANT_Tp_oPCAN_RADAR_68155c61_Rx
            CanTpTxFcNPdu_2dbb61ae (CanTpTxFcNPdu): CanTpTxFcNPduConfirmationPduId=11, CanTpTxFcNPduRef=PCAN_DIAG_RESP_PHYS_PLANT_Tp_oPCAN_RADAR_bd11d57f_Tx
          CanTpTxNSdu_dac1b156 (CanTpTxNSdu):
            CanTpTxAddressingFormat = CANTP_STANDARD
            CanTpTxDl = 64
            CanTpTxTaType = CANTP_CANFD_PHYSICAL
            CanTpNas = 1
            CanTpNcs = 0.01
            CanTpTc = false
            CanTpTxNSduId = 10
            CanTpTxPaddingActivation = CANTP_ON
            CanTpNbs = 1
            CanTpTxNSduRef = PCAN_DIAG_RESP_PHYS_PLANT_oPCAN_RADAR_cfac777e_Tx
            CanTpRxFcNPdu_0f41b55c (CanTpRxFcNPdu): CanTpRxFcNPduId=11, CanTpRxFcNPduRef=PCAN_DIAG_REQ_PHYS_PLANT_Tp_oPCAN_RADAR_68155c61_Rx
            CanTpTxNPdu_0f41b55c (CanTpTxNPdu): CanTpTxNPduConfirmationPduId=11, CanTpTxNPduRef=PCAN_DIAG_RESP_PHYS_PLANT_Tp_oPCAN_RADAR_bd11d57f_Tx
        TPCH_889aab04: variation-point=post-build-variant-condition{matching-criterion=RDR_POS, value=3}
          CanTpRxNSdu_fe5046bf (CanTpRxNSdu):
            CanTpRxAddressingFormat = CANTP_STANDARD
            CanTpRxDl = 64
            CanTpRxTaType = CANTP_CANFD_FUNCTIONAL
            CanTpNbr = 0.1
            CanTpRxNSduId = 13
            CanTpRxPaddingActivation = CANTP_ON
            CanTpRxNSduRef = PCAN_DIAG_REQ_FUNC_OBD1_oPCAN_RADAR_b9aa9d1d_Rx
            CanTpRxNPdu_af4492d7 (CanTpRxNPdu): CanTpRxNPduId=17, CanTpRxNPduRef=PCAN_DIAG_REQ_FUNC_OBD1_Tp_oPCAN_RADAR_ba721e23_Rx
        TPCH_99d5e2e1: variation-point=post-build-variant-condition{matching-criterion=RDR_POS, value=3}
          CanTpRxNSdu_bd76dbce (CanTpRxNSdu):
            CanTpRxAddressingFormat = CANTP_STANDARD
            CanTpRxDl = 64
            CanTpRxTaType = CANTP_CANFD_FUNCTIONAL
            CanTpNbr = 0.1
            CanTpRxNSduId = 9
            CanTpRxPaddingActivation = CANTP_ON
            CanTpRxNSduRef = PCAN_DIAG_REQ_FUNC_OTA_oPCAN_RADAR_a013523e_Rx
            CanTpRxNPdu_0e79eefd (CanTpRxNPdu): CanTpRxNPduId=20, CanTpRxNPduRef=PCAN_DIAG_REQ_FUNC_OTA_Tp_oPCAN_RADAR_7ea6262a_Rx
        TPCH_fcce3320: variation-point=post-build-variant-condition{matching-criterion=RDR_POS, value=3}
          CanTpRxNSdu_fe9ab262 (CanTpRxNSdu):
            CanTpRxAddressingFormat = CANTP_STANDARD
            CanTpRxDl = 64
            CanTpRxTaType = CANTP_CANFD_FUNCTIONAL
            CanTpNbr = 0.1
            CanTpRxNSduId = 23
            CanTpRxPaddingActivation = CANTP_ON
            CanTpRxNSduRef = PCAN_DIAG_REQ_FUNC_PLANT_oPCAN_RADAR_f6414098_Rx
            CanTpRxNPdu_e3fed264 (CanTpRxNPdu): CanTpRxNPduId=22, CanTpRxNPduRef=PCAN_DIAG_REQ_FUNC_PLANT_Tp_oPCAN_RADAR_5ec247a5_Rx
        TPCH_50ab2d28: variation-point=post-build-variant-condition{matching-criterion=RDR_POS, value=3}
          CanTpRxNSdu_17721f14 (CanTpRxNSdu):
            CanTpRxAddressingFormat = CANTP_STANDARD
            CanTpRxDl = 8
            CanTpRxTaType = CANTP_FUNCTIONAL
            CanTpNbr = 0.1
            CanTpRxNSduId = 6
            CanTpRxPaddingActivation = CANTP_ON
            CanTpRxNSduRef = DIAG_REQ_FNC_OBD1_oVCAN_RADAR_7e5c8685_Rx
            CanTpRxNPdu_09f211c0 (CanTpRxNPdu): CanTpRxNPduId=12, CanTpRxNPduRef=DIAG_REQ_FNC_OBD1_Tp_oVCAN_RADAR_260cec9f_Rx
        TPCH_0d31f32e: variation-point=post-build-variant-condition{matching-criterion=RDR_POS, value=3}
          CanTpRxNSdu_8ebb4dba (CanTpRxNSdu):
            CanTpRxAddressingFormat = CANTP_STANDARD
            CanTpRxDl = 8
            CanTpRxTaType = CANTP_FUNCTIONAL
            CanTpNbr = 0.1
            CanTpRxNSduId = 0
            CanTpRxPaddingActivation = CANTP_ON
            CanTpRxNSduRef = DIAG_REQ_FNC_OTA_oVCAN_RADAR_e787ed21_Rx
            CanTpRxNPdu_60bfe9ef (CanTpRxNPdu): CanTpRxNPduId=14, CanTpRxNPduRef=DIAG_REQ_FNC_OTA_Tp_oVCAN_RADAR_6f75a08a_Rx
        TPCH_a82d3b47: variation-point=post-build-variant-condition{matching-criterion=RDR_POS, value=3}
          CanTpRxNSdu_8a7f8276 (CanTpRxNSdu):
            CanTpRxAddressingFormat = CANTP_STANDARD
            CanTpRxDl = 8
            CanTpRxTaType = CANTP_FUNCTIONAL
            CanTpNbr = 0.1
            CanTpRxNSduId = 15
            CanTpRxPaddingActivation = CANTP_ON
            CanTpRxNSduRef = DIAG_REQ_FNC_PLANT_oVCAN_RADAR_42eb2f27_Rx
            CanTpRxNPdu_cb01d19c (CanTpRxNPdu): CanTpRxNPduId=15, CanTpRxNPduRef=DIAG_REQ_FNC_PLANT_Tp_oVCAN_RADAR_d6304422_Rx
        TPCH_abe7acb0: variation-point=post-build-variant-condition{matching-criterion=RDR_POS, value=3}
          CanTpTxNSdu_71a17bb4 (CanTpTxNSdu):
            CanTpTxAddressingFormat = CANTP_STANDARD
            CanTpTxDl = 8
            CanTpTxTaType = CANTP_PHYSICAL
            CanTpNas = 1
            CanTpNcs = 0.01
            CanTpTc = false
            CanTpTxNSduId = 6
            CanTpTxPaddingActivation = CANTP_ON
            CanTpNbs = 1
            CanTpTxNSduRef = FR_DIAG_RES_PHY_OBD2_oVCAN_RADAR_96501380_Tx
            CanTpRxFcNPdu_ea1ccf13 (CanTpRxFcNPdu): CanTpRxFcNPduId=1, CanTpRxFcNPduRef=FR_DIAG_REQ_PHY_OBD2_Tp_oVCAN_RADAR_b91a4a31_Rx
            CanTpTxNPdu_ea1ccf13 (CanTpTxNPdu): CanTpTxNPduConfirmationPduId=1, CanTpTxNPduRef=FR_DIAG_RES_PHY_OBD2_Tp_oVCAN_RADAR_25471ce8_Tx
          CanTpRxNSdu_71a17bb4 (CanTpRxNSdu):
            CanTpRxAddressingFormat = CANTP_STANDARD
            CanTpRxDl = 8
            CanTpRxTaType = CANTP_PHYSICAL
            CanTpNbr = 0.01
            CanTpRxNSduId = 16
            CanTpRxPaddingActivation = CANTP_ON
            CanTpBs = 8
            CanTpNar = 1
            CanTpNcr = 1
            CanTpRxWftMax = 15
            CanTpSTmin = 0.02
            CanTpRxNSduRef = FR_DIAG_REQ_PHY_OBD2_oVCAN_RADAR_0f521c1d_Rx
            CanTpTxFcNPdu_c8e61be1 (CanTpTxFcNPdu): CanTpTxFcNPduConfirmationPduId=1, CanTpTxFcNPduRef=FR_DIAG_RES_PHY_OBD2_Tp_oVCAN_RADAR_25471ce8_Tx
            CanTpRxNPdu_c8e61be1 (CanTpRxNPdu): CanTpRxNPduId=1, CanTpRxNPduRef=FR_DIAG_REQ_PHY_OBD2_Tp_oVCAN_RADAR_b91a4a31_Rx
        TPCH_ae3af2ed: variation-point=post-build-variant-condition{matching-criterion=RDR_POS, value=3}
          CanTpTxNSdu_0a6cebaf (CanTpTxNSdu):
            CanTpTxAddressingFormat = CANTP_STANDARD
            CanTpTxDl = 8
            CanTpTxTaType = CANTP_PHYSICAL
            CanTpNas = 1
            CanTpNcs = 0.01
            CanTpTc = false
            CanTpTxNSduId = 7
            CanTpTxPaddingActivation = CANTP_ON
            CanTpNbs = 1
            CanTpTxNSduRef = PCAN_DIAG_RESP_PHYS_OBD2_oPCAN_RADAR_20_f1bd890a_Tx
            CanTpTxNPdu_15aa1e7a (CanTpTxNPdu): CanTpTxNPduConfirmationPduId=7, CanTpTxNPduRef=PCAN_DIAG_RESP_PHYS_OBD2_Tp_oPCAN_RADAR_20_25da435e_Tx
            CanTpRxFcNPdu_15aa1e7a (CanTpRxFcNPdu): CanTpRxFcNPduId=7, CanTpRxFcNPduRef=PCAN_DIAG_REQ_PHYS_OBD2_Tp_oPCAN_RADAR_20_65ff9201_Rx
          CanTpRxNSdu_0a6cebaf (CanTpRxNSdu):
            CanTpRxAddressingFormat = CANTP_STANDARD
            CanTpRxDl = 8
            CanTpRxTaType = CANTP_PHYSICAL
            CanTpNbr = 0.01
            CanTpRxNSduId = 17
            CanTpRxPaddingActivation = CANTP_ON
            CanTpBs = 8
            CanTpNar = 1
            CanTpNcr = 1
            CanTpRxWftMax = 15
            CanTpSTmin = 0.02
            CanTpRxNSduRef = PCAN_DIAG_REQ_PHYS_OBD2_oPCAN_RADAR_20_95757328_Rx
            CanTpRxNPdu_3750ca88 (CanTpRxNPdu): CanTpRxNPduId=7, CanTpRxNPduRef=PCAN_DIAG_REQ_PHYS_OBD2_Tp_oPCAN_RADAR_20_65ff9201_Rx
            CanTpTxFcNPdu_3750ca88 (CanTpTxFcNPdu): CanTpTxFcNPduConfirmationPduId=7, CanTpTxFcNPduRef=PCAN_DIAG_RESP_PHYS_OBD2_Tp_oPCAN_RADAR_20_25da435e_Tx
        TPCH_3e04a461: variation-point=post-build-variant-condition{matching-criterion=RDR_POS, value=3}
          CanTpRxNSdu_78c5c2e6 (CanTpRxNSdu):
            CanTpRxAddressingFormat = CANTP_STANDARD
            CanTpRxDl = 8
            CanTpRxTaType = CANTP_FUNCTIONAL
            CanTpNbr = 0.1
            CanTpRxNSduId = 1
            CanTpRxPaddingActivation = CANTP_ON
            CanTpRxNSduRef = PCAN_DIAG_REQ_FUNC_OTA_oPCAN_RADAR_20_e1100275_Rx
            CanTpRxNPdu_24fb9ff2 (CanTpRxNPdu): CanTpRxNPduId=21, CanTpRxNPduRef=PCAN_DIAG_REQ_FUNC_OTA_Tp_oPCAN_RADAR_20_0a67f2f6_Rx
        TPCH_b29eaa00: variation-point=post-build-variant-condition{matching-criterion=RDR_POS, value=3}
          CanTpTxNSdu_6e6d2a7f (CanTpTxNSdu):
            CanTpTxAddressingFormat = CANTP_STANDARD
            CanTpTxDl = 8
            CanTpTxTaType = CANTP_PHYSICAL
            CanTpNas = 1
            CanTpNcs = 0.01
            CanTpTc = false
            CanTpTxNSduId = 9
            CanTpTxPaddingActivation = CANTP_ON
            CanTpNbs = 1
            CanTpTxNSduRef = FR_DIAG_RES_PHY_OTA_oVCAN_RADAR_9ad9d3d9_Tx
            CanTpTxNPdu_a08e1aa2 (CanTpTxNPdu): CanTpTxNPduConfirmationPduId=2, CanTpTxNPduRef=FR_DIAG_RES_PHY_OTA_Tp_oVCAN_RADAR_19b4e511_Tx
            CanTpRxFcNPdu_a08e1aa2 (CanTpRxFcNPdu): CanTpRxFcNPduId=2, CanTpRxFcNPduRef=FR_DIAG_REQ_PHY_OTA_Tp_oVCAN_RADAR_4de495d5_Rx
          CanTpRxNSdu_6e6d2a7f (CanTpRxNSdu):
            CanTpRxAddressingFormat = CANTP_STANDARD
            CanTpRxDl = 8
            CanTpRxTaType = CANTP_PHYSICAL
            CanTpNbr = 0.01
            CanTpRxNSduId = 19
            CanTpRxPaddingActivation = CANTP_ON
            CanTpBs = 8
            CanTpNar = 1
            CanTpNcr = 1
            CanTpRxWftMax = 15
            CanTpSTmin = 0.02
            CanTpRxNSduRef = FR_DIAG_REQ_PHY_OTA_oVCAN_RADAR_9187f4da_Rx
            CanTpRxNPdu_8274ce50 (CanTpRxNPdu): CanTpRxNPduId=2, CanTpRxNPduRef=FR_DIAG_REQ_PHY_OTA_Tp_oVCAN_RADAR_4de495d5_Rx
            CanTpTxFcNPdu_8274ce50 (CanTpTxFcNPdu): CanTpTxFcNPduConfirmationPduId=2, CanTpTxFcNPduRef=FR_DIAG_RES_PHY_OTA_Tp_oVCAN_RADAR_19b4e511_Tx
        TPCH_3fecd692: variation-point=post-build-variant-condition{matching-criterion=RDR_POS, value=3}
          CanTpRxNSdu_b5963bcd (CanTpRxNSdu):
            CanTpRxAddressingFormat = CANTP_STANDARD
            CanTpRxDl = 64
            CanTpRxTaType = CANTP_CANFD_PHYSICAL
            CanTpNbr = 0.01
            CanTpRxNSduId = 2
            CanTpRxPaddingActivation = CANTP_ON
            CanTpBs = 8
            CanTpNar = 1
            CanTpNcr = 1
            CanTpRxWftMax = 15
            CanTpSTmin = 0.02
            CanTpRxNSduRef = PCAN_DIAG_REQ_PHYS_OBD1_oPCAN_RADAR_bb22f7fc_Rx
            CanTpTxFcNPdu_492bb4b1 (CanTpTxFcNPdu): CanTpTxFcNPduConfirmationPduId=4, CanTpTxFcNPduRef=PCAN_DIAG_RESP_PHYS_OBD1_Tp_oPCAN_RADAR_0aebd6ab_Tx
            CanTpRxNPdu_492bb4b1 (CanTpRxNPdu): CanTpRxNPduId=4, CanTpRxNPduRef=PCAN_DIAG_REQ_PHYS_OBD1_Tp_oPCAN_RADAR_6e232c89_Rx
          CanTpTxNSdu_b5963bcd (CanTpTxNSdu):
            CanTpTxAddressingFormat = CANTP_STANDARD
            CanTpTxDl = 64
            CanTpTxTaType = CANTP_CANFD_PHYSICAL
            CanTpNas = 1
            CanTpNcs = 0.01
            CanTpTc = false
            CanTpTxNSduId = 0
            CanTpTxPaddingActivation = CANTP_ON
            CanTpNbs = 1
            CanTpTxNSduRef = PCAN_DIAG_RESP_PHYS_OBD1_oPCAN_RADAR_572eb9fe_Tx
            CanTpRxFcNPdu_6bd16043 (CanTpRxFcNPdu): CanTpRxFcNPduId=4, CanTpRxFcNPduRef=PCAN_DIAG_REQ_PHYS_OBD1_Tp_oPCAN_RADAR_6e232c89_Rx
            CanTpTxNPdu_6bd16043 (CanTpTxNPdu): CanTpTxNPduConfirmationPduId=4, CanTpTxNPduRef=PCAN_DIAG_RESP_PHYS_OBD1_Tp_oPCAN_RADAR_0aebd6ab_Tx
        TPCH_12962da8: variation-point=post-build-variant-condition{matching-criterion=RDR_POS, value=3}
          CanTpRxNSdu_b87fedc1 (CanTpRxNSdu):
            CanTpRxAddressingFormat = CANTP_STANDARD
            CanTpRxDl = 8
            CanTpRxTaType = CANTP_FUNCTIONAL
            CanTpNbr = 0.1
            CanTpRxNSduId = 14
            CanTpRxPaddingActivation = CANTP_ON
            CanTpRxNSduRef = PCAN_DIAG_REQ_FUNC_PLANT_oPCAN_RADAR_20_c17463fa_Rx
            CanTpRxNPdu_0a9d3920 (CanTpRxNPdu): CanTpRxNPduId=23, CanTpRxNPduRef=PCAN_DIAG_REQ_FUNC_PLANT_Tp_oPCAN_RADAR_20_d63751cc_Rx
        TPCH_085d580b: variation-point=post-build-variant-condition{matching-criterion=RDR_POS, value=3}
          CanTpTxNSdu_35dbd553 (CanTpTxNSdu):
            CanTpTxAddressingFormat = CANTP_STANDARD
            CanTpTxDl = 8
            CanTpTxTaType = CANTP_PHYSICAL
            CanTpNas = 1
            CanTpNcs = 0.01
            CanTpTc = false
            CanTpTxNSduId = 5
            CanTpTxPaddingActivation = CANTP_ON
            CanTpNbs = 1
            CanTpTxNSduRef = PCAN_DIAG_RESP_PHYS_PLANT_oPCAN_RADAR_20_22a7f120_Tx
            CanTpTxNPdu_8ac432ad (CanTpTxNPdu): CanTpTxNPduConfirmationPduId=10, CanTpTxNPduRef=PCAN_DIAG_RESP_PHYS_PLANT_Tp_oPCAN_RADAR_20_0a848a3f_Tx
            CanTpRxFcNPdu_8ac432ad (CanTpRxFcNPdu): CanTpRxFcNPduId=10, CanTpRxFcNPduRef=PCAN_DIAG_REQ_PHYS_PLANT_Tp_oPCAN_RADAR_20_f110e38b_Rx
          CanTpRxNSdu_35dbd553 (CanTpRxNSdu):
            CanTpRxAddressingFormat = CANTP_STANDARD
            CanTpRxDl = 8
            CanTpRxTaType = CANTP_PHYSICAL
            CanTpNbr = 0.01
            CanTpRxNSduId = 12
            CanTpRxPaddingActivation = CANTP_ON
            CanTpBs = 8
            CanTpNar = 1
            CanTpNcr = 1
            CanTpRxWftMax = 15
            CanTpSTmin = 0.02
            CanTpRxNSduRef = PCAN_DIAG_REQ_PHYS_PLANT_oPCAN_RADAR_20_f7a3783e_Rx
            CanTpRxNPdu_a83ee65f (CanTpRxNPdu): CanTpRxNPduId=10, CanTpRxNPduRef=PCAN_DIAG_REQ_PHYS_PLANT_Tp_oPCAN_RADAR_20_f110e38b_Rx
            CanTpTxFcNPdu_a83ee65f (CanTpTxFcNPdu): CanTpTxFcNPduConfirmationPduId=10, CanTpTxFcNPduRef=PCAN_DIAG_RESP_PHYS_PLANT_Tp_oPCAN_RADAR_20_0a848a3f_Tx
        TPCH_fbc8df6a: variation-point=post-build-variant-condition{matching-criterion=RDR_POS, value=3}
          CanTpRxNSdu_dcc3cd8a (CanTpRxNSdu):
            CanTpRxAddressingFormat = CANTP_STANDARD
            CanTpRxDl = 8
            CanTpRxTaType = CANTP_FUNCTIONAL
            CanTpNbr = 0.1
            CanTpRxNSduId = 22
            CanTpRxPaddingActivation = CANTP_ON
            CanTpRxNSduRef = PCAN_DIAG_REQ_FUNC_OBD1_oPCAN_RADAR_20_25c43a7c_Rx
            CanTpRxNPdu_8e0f0117 (CanTpRxNPdu): CanTpRxNPduId=16, CanTpRxNPduRef=PCAN_DIAG_REQ_FUNC_OBD1_Tp_oPCAN_RADAR_20_9397638b_Rx
        TPCH_b8a7316c: variation-point=post-build-variant-condition{matching-criterion=RDR_POS, value=3}
          CanTpTxNSdu_c1932d51 (CanTpTxNSdu):
            CanTpTxAddressingFormat = CANTP_STANDARD
            CanTpTxDl = 8
            CanTpTxTaType = CANTP_PHYSICAL
            CanTpNas = 1
            CanTpNcs = 0.01
            CanTpTc = false
            CanTpTxNSduId = 8
            CanTpTxPaddingActivation = CANTP_ON
            CanTpNbs = 1
            CanTpTxNSduRef = PCAN_DIAG_RESP_PHYS_OTA_oPCAN_RADAR_20_a840a80f_Tx
            CanTpRxFcNPdu_06f6f546 (CanTpRxFcNPdu): CanTpRxFcNPduId=8, CanTpRxFcNPduRef=PCAN_DIAG_REQ_PHYS_OTA_Tp_oPCAN_RADAR_20_96582344_Rx
            CanTpTxNPdu_06f6f546 (CanTpTxNPdu): CanTpTxNPduConfirmationPduId=8, CanTpTxNPduRef=PCAN_DIAG_RESP_PHYS_OTA_Tp_oPCAN_RADAR_20_6c821aae_Tx
          CanTpRxNSdu_c1932d51 (CanTpRxNSdu):
            CanTpRxAddressingFormat = CANTP_STANDARD
            CanTpRxDl = 8
            CanTpRxTaType = CANTP_PHYSICAL
            CanTpNbr = 0.01
            CanTpRxNSduId = 18
            CanTpRxPaddingActivation = CANTP_ON
            CanTpBs = 8
            CanTpNar = 1
            CanTpNcr = 1
            CanTpRxWftMax = 15
            CanTpSTmin = 0.02
            CanTpRxNSduRef = PCAN_DIAG_REQ_PHYS_OTA_oPCAN_RADAR_20_0b124a16_Rx
            CanTpRxNPdu_240c21b4 (CanTpRxNPdu): CanTpRxNPduId=8, CanTpRxNPduRef=PCAN_DIAG_REQ_PHYS_OTA_Tp_oPCAN_RADAR_20_96582344_Rx
            CanTpTxFcNPdu_240c21b4 (CanTpTxFcNPdu): CanTpTxFcNPduConfirmationPduId=8, CanTpTxFcNPduRef=PCAN_DIAG_RESP_PHYS_OTA_Tp_oPCAN_RADAR_20_6c821aae_Tx
