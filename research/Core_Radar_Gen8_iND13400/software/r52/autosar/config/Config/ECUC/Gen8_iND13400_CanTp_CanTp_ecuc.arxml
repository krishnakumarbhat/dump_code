[part 2 of 2: package /ActiveEcuC]
AUTOSAR XML (schema 00053)
package /ActiveEcuC  (continued)
  module config CanTp: implementation-config-variant=VARIANT-POST-BUILD-SELECTABLE, module-description=CanTp_Impl  (continued)
    CanTpConfig: CanTpMainFunctionPeriod=0.005  (continued)
      192 x CanTpChannel, all with CanTpChannelMode=CANTP_MODE_FULL_DUPLEX:  (continued)
        TPCH_874cc47d: variation-point=post-build-variant-condition{matching-criterion=RDR_POS, value=4}
          CanTpTxNSdu_28542b52 (CanTpTxNSdu):
            CanTpTxAddressingFormat = CANTP_STANDARD
            CanTpTxDl = 64
            CanTpTxTaType = CANTP_CANFD_PHYSICAL
            CanTpNas = 1
            CanTpNcs = 0.01
            CanTpTc = false
            CanTpTxNSduId = 4
            CanTpTxPaddingActivation = CANTP_ON
            CanTpNbs = 1
            CanTpTxNSduRef = PCAN_DIAG_RESP_PHYS_OBD2_oPCAN_RADAR_0c3908eb_Tx
            CanTpTxNPdu_813de497 (CanTpTxNPdu): CanTpTxNPduConfirmationPduId=6, CanTpTxNPduRef=PCAN_DIAG_RESP_PHYS_OBD2_Tp_oPCAN_RADAR_6e0bad55_Tx
            CanTpRxFcNPdu_813de497 (CanTpRxFcNPdu): CanTpRxFcNPduId=6, CanTpRxFcNPduRef=PCAN_DIAG_REQ_PHYS_OBD2_Tp_oPCAN_RADAR_0ac35777_Rx
          CanTpRxNSdu_28542b52 (CanTpRxNSdu):
            CanTpRxAddressingFormat = CANTP_STANDARD
            CanTpRxDl = 64
            CanTpRxTaType = CANTP_CANFD_PHYSICAL
            CanTpNbr = 0.01
            CanTpRxNSduId = 8
            CanTpRxPaddingActivation = CANTP_ON
            CanTpRxWftMax = 15
            CanTpSTmin = 0.02
            CanTpNcr = 1
            CanTpNar = 1
            CanTpBs = 8
            CanTpRxNSduRef = PCAN_DIAG_REQ_PHYS_OBD2_oPCAN_RADAR_e03546e9_Rx
            CanTpRxNPdu_a3c73065 (CanTpRxNPdu): CanTpRxNPduId=6, CanTpRxNPduRef=PCAN_DIAG_REQ_PHYS_OBD2_Tp_oPCAN_RADAR_0ac35777_Rx
            CanTpTxFcNPdu_a3c73065 (CanTpTxFcNPdu): CanTpTxFcNPduConfirmationPduId=6, CanTpTxFcNPduRef=PCAN_DIAG_RESP_PHYS_OBD2_Tp_oPCAN_RADAR_6e0bad55_Tx
        TPCH_4425c78e: variation-point=post-build-variant-condition{matching-criterion=RDR_POS, value=4}
          CanTpRxNSdu_ddc06ff6 (CanTpRxNSdu):
            CanTpRxAddressingFormat = CANTP_STANDARD
            CanTpRxDl = 8
            CanTpRxTaType = CANTP_PHYSICAL
            CanTpNbr = 0.01
            CanTpRxNSduId = 9
            CanTpRxPaddingActivation = CANTP_ON
            CanTpRxWftMax = 15
            CanTpSTmin = 0.02
            CanTpNcr = 1
            CanTpNar = 1
            CanTpBs = 8
            CanTpRxNSduRef = FR_DIAG_REQ_PHY_OBD2_oVCAN_RADAR_0f521c1d_Rx
            CanTpRxNPdu_ca69fbd1 (CanTpRxNPdu): CanTpRxNPduId=1, CanTpRxNPduRef=FR_DIAG_REQ_PHY_OBD2_Tp_oVCAN_RADAR_b91a4a31_Rx
            CanTpTxFcNPdu_ca69fbd1 (CanTpTxFcNPdu): CanTpTxFcNPduConfirmationPduId=1, CanTpTxFcNPduRef=FR_DIAG_RES_PHY_OBD2_Tp_oVCAN_RADAR_25471ce8_Tx
          CanTpTxNSdu_ddc06ff6 (CanTpTxNSdu):
            CanTpTxAddressingFormat = CANTP_STANDARD
            CanTpTxDl = 8
            CanTpTxTaType = CANTP_PHYSICAL
            CanTpNas = 1
            CanTpNcs = 0.01
            CanTpTc = false
            CanTpTxNSduId = 5
            CanTpTxPaddingActivation = CANTP_ON
            CanTpNbs = 1
            CanTpTxNSduRef = FR_DIAG_RES_PHY_OBD2_oVCAN_RADAR_96501380_Tx
            CanTpRxFcNPdu_e8932f23 (CanTpRxFcNPdu): CanTpRxFcNPduId=1, CanTpRxFcNPduRef=FR_DIAG_REQ_PHY_OBD2_Tp_oVCAN_RADAR_b91a4a31_Rx
            CanTpTxNPdu_e8932f23 (CanTpTxNPdu): CanTpTxNPduConfirmationPduId=1, CanTpTxNPduRef=FR_DIAG_RES_PHY_OBD2_Tp_oVCAN_RADAR_25471ce8_Tx
        TPCH_813fa594: variation-point=post-build-variant-condition{matching-criterion=RDR_POS, value=4}
          CanTpTxNSdu_c0427f66 (CanTpTxNSdu):
            CanTpTxAddressingFormat = CANTP_STANDARD
            CanTpTxDl = 8
            CanTpTxTaType = CANTP_PHYSICAL
            CanTpNas = 1
            CanTpNcs = 0.01
            CanTpTc = false
            CanTpTxNSduId = 3
            CanTpTxPaddingActivation = CANTP_ON
            CanTpNbs = 1
            CanTpTxNSduRef = FR_DIAG_RES_PHY_OBD1_oVCAN_RADAR_cd47a295_Tx
            CanTpRxFcNPdu_f6bcd3b8 (CanTpRxFcNPdu): CanTpRxFcNPduId=0, CanTpRxFcNPduRef=FR_DIAG_REQ_PHY_OBD1_Tp_oVCAN_RADAR_ddfa31cf_Rx
            CanTpTxNPdu_f6bcd3b8 (CanTpTxNPdu): CanTpTxNPduConfirmationPduId=0, CanTpTxNPduRef=FR_DIAG_RES_PHY_OBD1_Tp_oVCAN_RADAR_41a76716_Tx
          CanTpRxNSdu_c0427f66 (CanTpRxNSdu):
            CanTpRxAddressingFormat = CANTP_STANDARD
            CanTpRxDl = 8
            CanTpRxTaType = CANTP_PHYSICAL
            CanTpNbr = 0.01
            CanTpRxNSduId = 7
            CanTpRxPaddingActivation = CANTP_ON
            CanTpRxWftMax = 15
            CanTpSTmin = 0.02
            CanTpNcr = 1
            CanTpNar = 1
            CanTpBs = 8
            CanTpRxNSduRef = FR_DIAG_REQ_PHY_OBD1_oVCAN_RADAR_5445ad08_Rx
            CanTpRxNPdu_d446074a (CanTpRxNPdu): CanTpRxNPduId=0, CanTpRxNPduRef=FR_DIAG_REQ_PHY_OBD1_Tp_oVCAN_RADAR_ddfa31cf_Rx
            CanTpTxFcNPdu_d446074a (CanTpTxFcNPdu): CanTpTxFcNPduConfirmationPduId=0, CanTpTxFcNPduRef=FR_DIAG_RES_PHY_OBD1_Tp_oVCAN_RADAR_41a76716_Tx
        TPCH_ebe657e0: variation-point=post-build-variant-condition{matching-criterion=RDR_POS, value=4}
          CanTpRxNSdu_a810d4a0 (CanTpRxNSdu):
            CanTpRxAddressingFormat = CANTP_STANDARD
            CanTpRxDl = 64
            CanTpRxTaType = CANTP_CANFD_FUNCTIONAL
            CanTpNbr = 0.1
            CanTpRxNSduId = 21
            CanTpRxPaddingActivation = CANTP_ON
            CanTpRxNSduRef = PCAN_DIAG_REQ_FUNC_PLANT_oPCAN_RADAR_f6414098_Rx
            CanTpRxNPdu_8cec51f3 (CanTpRxNPdu): CanTpRxNPduId=22, CanTpRxNPduRef=PCAN_DIAG_REQ_FUNC_PLANT_Tp_oPCAN_RADAR_5ec247a5_Rx
        TPCH_606d9305: variation-point=post-build-variant-condition{matching-criterion=RDR_POS, value=4}
          CanTpRxNSdu_f5437413 (CanTpRxNSdu):
            CanTpRxAddressingFormat = CANTP_STANDARD
            CanTpRxDl = 8
            CanTpRxTaType = CANTP_FUNCTIONAL
            CanTpNbr = 0.1
            CanTpRxNSduId = 6
            CanTpRxPaddingActivation = CANTP_ON
            CanTpRxNSduRef = PCAN_DIAG_REQ_FUNC_OBD1_oPCAN_RADAR_20_25c43a7c_Rx
            CanTpRxNPdu_748cf4a0 (CanTpRxNPdu): CanTpRxNPduId=16, CanTpRxNPduRef=PCAN_DIAG_REQ_FUNC_OBD1_Tp_oPCAN_RADAR_20_9397638b_Rx
        TPCH_019e4c5f: variation-point=post-build-variant-condition{matching-criterion=RDR_POS, value=4}
          CanTpRxNSdu_48aeef23 (CanTpRxNSdu):
            CanTpRxAddressingFormat = CANTP_STANDARD
            CanTpRxDl = 8
            CanTpRxTaType = CANTP_FUNCTIONAL
            CanTpNbr = 0.1
            CanTpRxNSduId = 5
            CanTpRxPaddingActivation = CANTP_ON
            CanTpRxNSduRef = PCAN_DIAG_REQ_FUNC_OBD2_oPCAN_RADAR_20_41244182_Rx
            CanTpRxNPdu_41a3f494 (CanTpRxNPdu): CanTpRxNPduId=18, CanTpRxNPduRef=PCAN_DIAG_REQ_FUNC_OBD2_Tp_oPCAN_RADAR_20_400c7f70_Rx
        TPCH_893361c7: variation-point=post-build-variant-condition{matching-criterion=RDR_POS, value=4}
          CanTpRxNSdu_8bd00a19 (CanTpRxNSdu):
            CanTpRxAddressingFormat = CANTP_STANDARD
            CanTpRxDl = 8
            CanTpRxTaType = CANTP_FUNCTIONAL
            CanTpNbr = 0.1
            CanTpRxNSduId = 12
            CanTpRxPaddingActivation = CANTP_ON
            CanTpRxNSduRef = PCAN_DIAG_REQ_FUNC_PLANT_oPCAN_RADAR_20_c17463fa_Rx
            CanTpRxNPdu_634576d0 (CanTpRxNPdu): CanTpRxNPduId=23, CanTpRxNPduRef=PCAN_DIAG_REQ_FUNC_PLANT_Tp_oPCAN_RADAR_20_d63751cc_Rx
        TPCH_33887728: variation-point=post-build-variant-condition{matching-criterion=RDR_POS, value=4}
          CanTpRxNSdu_e0f3e280 (CanTpRxNSdu):
            CanTpRxAddressingFormat = CANTP_STANDARD
            CanTpRxDl = 8
            CanTpRxTaType = CANTP_FUNCTIONAL
            CanTpNbr = 0.1
            CanTpRxNSduId = 14
            CanTpRxPaddingActivation = CANTP_ON
            CanTpRxNSduRef = DIAG_REQ_FNC_PLANT_oVCAN_RADAR_42eb2f27_Rx
            CanTpRxNPdu_acecf7b1 (CanTpRxNPdu): CanTpRxNPduId=15, CanTpRxNPduRef=DIAG_REQ_FNC_PLANT_Tp_oVCAN_RADAR_d6304422_Rx
        TPCH_b4adbfa6: variation-point=post-build-variant-condition{matching-criterion=RDR_POS, value=4}
          CanTpRxNSdu_8d39cc24 (CanTpRxNSdu):
            CanTpRxAddressingFormat = CANTP_STANDARD
            CanTpRxDl = 64
            CanTpRxTaType = CANTP_CANFD_PHYSICAL
            CanTpNbr = 0.01
            CanTpRxNSduId = 17
            CanTpRxPaddingActivation = CANTP_ON
            CanTpRxWftMax = 15
            CanTpSTmin = 0.02
            CanTpNcr = 1
            CanTpNar = 1
            CanTpBs = 8
            CanTpRxNSduRef = PCAN_DIAG_REQ_PHYS_PLANT_oPCAN_RADAR_214e1a1c_Rx
            CanTpRxNPdu_1cdbe534 (CanTpRxNPdu): CanTpRxNPduId=11, CanTpRxNPduRef=PCAN_DIAG_REQ_PHYS_PLANT_Tp_oPCAN_RADAR_68155c61_Rx
            CanTpTxFcNPdu_1cdbe534 (CanTpTxFcNPdu): CanTpTxFcNPduConfirmationPduId=11, CanTpTxFcNPduRef=PCAN_DIAG_RESP_PHYS_PLANT_Tp_oPCAN_RADAR_bd11d57f_Tx
          CanTpTxNSdu_8d39cc24 (CanTpTxNSdu):
            CanTpTxAddressingFormat = CANTP_STANDARD
            CanTpTxDl = 64
            CanTpTxTaType = CANTP_CANFD_PHYSICAL
            CanTpNas = 1
            CanTpNcs = 0.01
            CanTpTc = false
            CanTpTxNSduId = 8
            CanTpTxPaddingActivation = CANTP_ON
            CanTpNbs = 1
            CanTpTxNSduRef = PCAN_DIAG_RESP_PHYS_PLANT_oPCAN_RADAR_cfac777e_Tx
            CanTpRxFcNPdu_3e2131c6 (CanTpRxFcNPdu): CanTpRxFcNPduId=11, CanTpRxFcNPduRef=PCAN_DIAG_REQ_PHYS_PLANT_Tp_oPCAN_RADAR_68155c61_Rx
            CanTpTxNPdu_3e2131c6 (CanTpTxNPdu): CanTpTxNPduConfirmationPduId=11, CanTpTxNPduRef=PCAN_DIAG_RESP_PHYS_PLANT_Tp_oPCAN_RADAR_bd11d57f_Tx
        TPCH_9fb2cfc4: variation-point=post-build-variant-condition{matching-criterion=RDR_POS, value=4}
          CanTpRxNSdu_647cf724 (CanTpRxNSdu):
            CanTpRxAddressingFormat = CANTP_STANDARD
            CanTpRxDl = 64
            CanTpRxTaType = CANTP_CANFD_FUNCTIONAL
            CanTpNbr = 0.1
            CanTpRxNSduId = 3
            CanTpRxPaddingActivation = CANTP_ON
            CanTpRxNSduRef = PCAN_DIAG_REQ_FUNC_OBD1_oPCAN_RADAR_b9aa9d1d_Rx
            CanTpRxNPdu_95b4ca6b (CanTpRxNPdu): CanTpRxNPduId=17, CanTpRxNPduRef=PCAN_DIAG_REQ_FUNC_OBD1_Tp_oPCAN_RADAR_ba721e23_Rx
        TPCH_cb0e6147: variation-point=post-build-variant-condition{matching-criterion=RDR_POS, value=4}
          CanTpRxNSdu_6673db92 (CanTpRxNSdu):
            CanTpRxAddressingFormat = CANTP_STANDARD
            CanTpRxDl = 8
            CanTpRxTaType = CANTP_FUNCTIONAL
            CanTpNbr = 0.1
            CanTpRxNSduId = 18
            CanTpRxPaddingActivation = CANTP_ON
            CanTpRxNSduRef = DIAG_REQ_FNC_OBD1_oVCAN_RADAR_7e5c8685_Rx
            CanTpRxNPdu_67f2735b (CanTpRxNPdu): CanTpRxNPduId=12, CanTpRxNPduRef=DIAG_REQ_FNC_OBD1_Tp_oVCAN_RADAR_260cec9f_Rx
        TPCH_f03b19a8: variation-point=post-build-variant-condition{matching-criterion=RDR_POS, value=4}
          CanTpRxNSdu_6ada5e57 (CanTpRxNSdu):
            CanTpRxAddressingFormat = CANTP_STANDARD
            CanTpRxDl = 8
            CanTpRxTaType = CANTP_FUNCTIONAL
            CanTpNbr = 0.1
            CanTpRxNSduId = 23
            CanTpRxPaddingActivation = CANTP_ON
            CanTpRxNSduRef = DIAG_REQ_FNC_OBD2_oVCAN_RADAR_254b3790_Rx
            CanTpRxNPdu_964d0a86 (CanTpRxNPdu): CanTpRxNPduId=13, CanTpRxNPduRef=DIAG_REQ_FNC_OBD2_Tp_oVCAN_RADAR_42ec9761_Rx
        TPCH_5d5cc13e: variation-point=post-build-variant-condition{matching-criterion=RDR_POS, value=4}
          CanTpRxNSdu_7f902975 (CanTpRxNSdu):
            CanTpRxAddressingFormat = CANTP_STANDARD
            CanTpRxDl = 8
            CanTpRxTaType = CANTP_PHYSICAL
            CanTpNbr = 0.01
            CanTpRxNSduId = 1
            CanTpRxPaddingActivation = CANTP_ON
            CanTpNar = 1
            CanTpNcr = 1
            CanTpRxWftMax = 15
            CanTpSTmin = 0.02
            CanTpBs = 8
            CanTpRxNSduRef = FR_DIAG_REQ_PHY_OTA_oVCAN_RADAR_9187f4da_Rx
            CanTpTxFcNPdu_a9a436aa (CanTpTxFcNPdu): CanTpTxFcNPduConfirmationPduId=2, CanTpTxFcNPduRef=FR_DIAG_RES_PHY_OTA_Tp_oVCAN_RADAR_19b4e511_Tx
            CanTpRxNPdu_a9a436aa (CanTpRxNPdu): CanTpRxNPduId=2, CanTpRxNPduRef=FR_DIAG_REQ_PHY_OTA_Tp_oVCAN_RADAR_4de495d5_Rx
          CanTpTxNSdu_7f902975 (CanTpTxNSdu):
            CanTpTxAddressingFormat = CANTP_STANDARD
            CanTpTxDl = 8
            CanTpTxTaType = CANTP_PHYSICAL
            CanTpNas = 1
            CanTpNcs = 0.01
            CanTpTc = false
            CanTpTxNSduId = 1
            CanTpTxPaddingActivation = CANTP_ON
            CanTpNbs = 1
            CanTpTxNSduRef = FR_DIAG_RES_PHY_OTA_oVCAN_RADAR_9ad9d3d9_Tx
            CanTpTxNPdu_8b5ee258 (CanTpTxNPdu): CanTpTxNPduConfirmationPduId=2, CanTpTxNPduRef=FR_DIAG_RES_PHY_OTA_Tp_oVCAN_RADAR_19b4e511_Tx
            CanTpRxFcNPdu_8b5ee258 (CanTpRxFcNPdu): CanTpRxFcNPduId=2, CanTpRxFcNPduRef=FR_DIAG_REQ_PHY_OTA_Tp_oVCAN_RADAR_4de495d5_Rx
        TPCH_9694bf41: variation-point=post-build-variant-condition{matching-criterion=RDR_POS, value=4}
          CanTpRxNSdu_938c4b7e (CanTpRxNSdu):
            CanTpRxAddressingFormat = CANTP_STANDARD
            CanTpRxDl = 8
            CanTpRxTaType = CANTP_FUNCTIONAL
            CanTpNbr = 0.1
            CanTpRxNSduId = 10
            CanTpRxPaddingActivation = CANTP_ON
            CanTpRxNSduRef = DIAG_REQ_FNC_OTA_oVCAN_RADAR_e787ed21_Rx
            CanTpRxNPdu_4a313afd (CanTpRxNPdu): CanTpRxNPduId=14, CanTpRxNPduRef=DIAG_REQ_FNC_OTA_Tp_oVCAN_RADAR_6f75a08a_Rx
        TPCH_ebfd0584: variation-point=post-build-variant-condition{matching-criterion=RDR_POS, value=4}
          CanTpTxNSdu_5075f9f9 (CanTpTxNSdu):
            CanTpTxAddressingFormat = CANTP_STANDARD
            CanTpTxDl = 8
            CanTpTxTaType = CANTP_PHYSICAL
            CanTpNas = 1
            CanTpNcs = 0.01
            CanTpTc = false
            CanTpTxNSduId = 11
            CanTpTxPaddingActivation = CANTP_ON
            CanTpNbs = 1
            CanTpTxNSduRef = FR_DIAG_RES_PHY_PLANT_oVCAN_RADAR_5fef2467_Tx
            CanTpRxFcNPdu_4ab4679c (CanTpRxFcNPdu): CanTpRxFcNPduId=3, CanTpRxFcNPduRef=FR_DIAG_REQ_PHY_PLANT_Tp_oVCAN_RADAR_bda0e30b_Rx
            CanTpTxNPdu_4ab4679c (CanTpTxNPdu): CanTpTxNPduConfirmationPduId=3, CanTpTxNPduRef=FR_DIAG_RES_PHY_PLANT_Tp_oVCAN_RADAR_4233d42d_Tx
          CanTpRxNSdu_5075f9f9 (CanTpRxNSdu):
            CanTpRxAddressingFormat = CANTP_STANDARD
            CanTpRxDl = 8
            CanTpRxTaType = CANTP_PHYSICAL
            CanTpNbr = 0.01
            CanTpRxNSduId = 22
            CanTpRxPaddingActivation = CANTP_ON
            CanTpRxWftMax = 15
            CanTpSTmin = 0.02
            CanTpNcr = 1
            CanTpNar = 1
            CanTpBs = 8
            CanTpRxNSduRef = FR_DIAG_REQ_PHY_PLANT_oVCAN_RADAR_d1c8c991_Rx
            CanTpRxNPdu_684eb36e (CanTpRxNPdu): CanTpRxNPduId=3, CanTpRxNPduRef=FR_DIAG_REQ_PHY_PLANT_Tp_oVCAN_RADAR_bda0e30b_Rx
            CanTpTxFcNPdu_684eb36e (CanTpTxFcNPdu): CanTpTxFcNPduConfirmationPduId=3, CanTpTxFcNPduRef=FR_DIAG_RES_PHY_PLANT_Tp_oVCAN_RADAR_4233d42d_Tx
        TPCH_8efd8621: variation-point=post-build-variant-condition{matching-criterion=RDR_POS, value=4}
          CanTpRxNSdu_1686abd3 (CanTpRxNSdu):
            CanTpRxAddressingFormat = CANTP_STANDARD
            CanTpRxDl = 64
            CanTpRxTaType = CANTP_CANFD_FUNCTIONAL
            CanTpNbr = 0.1
            CanTpRxNSduId = 2
            CanTpRxPaddingActivation = CANTP_ON
            CanTpRxNSduRef = PCAN_DIAG_REQ_FUNC_OTA_oPCAN_RADAR_a013523e_Rx
            CanTpRxNPdu_aa895199 (CanTpRxNPdu): CanTpRxNPduId=20, CanTpRxNPduRef=PCAN_DIAG_REQ_FUNC_OTA_Tp_oPCAN_RADAR_7ea6262a_Rx
        TPCH_a5a1e80e: variation-point=post-build-variant-condition{matching-criterion=RDR_POS, value=4}
          CanTpRxNSdu_ff05d790 (CanTpRxNSdu):
            CanTpRxAddressingFormat = CANTP_STANDARD
            CanTpRxDl = 8
            CanTpRxTaType = CANTP_FUNCTIONAL
            CanTpNbr = 0.1
            CanTpRxNSduId = 16
            CanTpRxPaddingActivation = CANTP_ON
            CanTpRxNSduRef = PCAN_DIAG_REQ_FUNC_OTA_oPCAN_RADAR_20_e1100275_Rx
            CanTpRxNPdu_ad161582 (CanTpRxNPdu): CanTpRxNPduId=21, CanTpRxNPduRef=PCAN_DIAG_REQ_FUNC_OTA_Tp_oPCAN_RADAR_20_0a67f2f6_Rx
        TPCH_5a8bedd4: variation-point=post-build-variant-condition{matching-criterion=RDR_POS, value=4}
          CanTpRxNSdu_0adc25ca (CanTpRxNSdu):
            CanTpRxAddressingFormat = CANTP_STANDARD
            CanTpRxDl = 64
            CanTpRxTaType = CANTP_CANFD_PHYSICAL
            CanTpNbr = 0.01
            CanTpRxNSduId = 0
            CanTpRxPaddingActivation = CANTP_ON
            CanTpNar = 1
            CanTpNcr = 1
            CanTpRxWftMax = 15
            CanTpSTmin = 0.02
            CanTpBs = 8
            CanTpRxNSduRef = PCAN_DIAG_REQ_PHYS_OBD1_oPCAN_RADAR_bb22f7fc_Rx
            CanTpTxFcNPdu_e3414a64 (CanTpTxFcNPdu): CanTpTxFcNPduConfirmationPduId=4, CanTpTxFcNPduRef=PCAN_DIAG_RESP_PHYS_OBD1_Tp_oPCAN_RADAR_0aebd6ab_Tx
            CanTpRxNPdu_e3414a64 (CanTpRxNPdu): CanTpRxNPduId=4, CanTpRxNPduRef=PCAN_DIAG_REQ_PHYS_OBD1_Tp_oPCAN_RADAR_6e232c89_Rx
          CanTpTxNSdu_0adc25ca (CanTpTxNSdu):
            CanTpTxAddressingFormat = CANTP_STANDARD
            CanTpTxDl = 64
            CanTpTxTaType = CANTP_CANFD_PHYSICAL
            CanTpNas = 1
            CanTpNcs = 0.01
            CanTpTc = false
            CanTpTxNSduId = 0
            CanTpTxPaddingActivation = CANTP_ON
            CanTpNbs = 1
            CanTpTxNSduRef = PCAN_DIAG_RESP_PHYS_OBD1_oPCAN_RADAR_572eb9fe_Tx
            CanTpRxFcNPdu_c1bb9e96 (CanTpRxFcNPdu): CanTpRxFcNPduId=4, CanTpRxFcNPduRef=PCAN_DIAG_REQ_PHYS_OBD1_Tp_oPCAN_RADAR_6e232c89_Rx
            CanTpTxNPdu_c1bb9e96 (CanTpTxNPdu): CanTpTxNPduConfirmationPduId=4, CanTpTxNPduRef=PCAN_DIAG_RESP_PHYS_OBD1_Tp_oPCAN_RADAR_0aebd6ab_Tx
        TPCH_86087019: variation-point=post-build-variant-condition{matching-criterion=RDR_POS, value=4}
          CanTpRxNSdu_5a9726cc (CanTpRxNSdu):
            CanTpRxAddressingFormat = CANTP_STANDARD
            CanTpRxDl = 8
            CanTpRxTaType = CANTP_PHYSICAL
            CanTpNbr = 0.01
            CanTpRxNSduId = 15
            CanTpRxPaddingActivation = CANTP_ON
            CanTpRxWftMax = 15
            CanTpSTmin = 0.02
            CanTpNcr = 1
            CanTpNar = 1
            CanTpBs = 8
            CanTpRxNSduRef = PCAN_DIAG_REQ_PHYS_OBD1_oPCAN_RADAR_20_f19508d6_Rx
            CanTpRxNPdu_102ffa27 (CanTpRxNPdu): CanTpRxNPduId=5, CanTpRxNPduRef=PCAN_DIAG_REQ_PHYS_OBD1_Tp_oPCAN_RADAR_20_b6648efa_Rx
            CanTpTxFcNPdu_102ffa27 (CanTpTxFcNPdu): CanTpTxFcNPduConfirmationPduId=5, CanTpTxFcNPduRef=PCAN_DIAG_RESP_PHYS_OBD1_Tp_oPCAN_RADAR_20_f6415fa5_Tx
          CanTpTxNSdu_5a9726cc (CanTpTxNSdu):
            CanTpTxAddressingFormat = CANTP_STANDARD
            CanTpTxDl = 8
            CanTpTxTaType = CANTP_PHYSICAL
            CanTpNas = 1
            CanTpNcs = 0.01
            CanTpTc = false
            CanTpTxNSduId = 7
            CanTpTxPaddingActivation = CANTP_ON
            CanTpNbs = 1
            CanTpTxNSduRef = PCAN_DIAG_RESP_PHYS_OBD1_oPCAN_RADAR_20_955df2f4_Tx
            CanTpTxNPdu_32d52ed5 (CanTpTxNPdu): CanTpTxNPduConfirmationPduId=5, CanTpTxNPduRef=PCAN_DIAG_RESP_PHYS_OBD1_Tp_oPCAN_RADAR_20_f6415fa5_Tx
            CanTpRxFcNPdu_32d52ed5 (CanTpRxFcNPdu): CanTpRxFcNPduId=5, CanTpRxFcNPduRef=PCAN_DIAG_REQ_PHYS_OBD1_Tp_oPCAN_RADAR_20_b6648efa_Rx
        TPCH_57655a52: variation-point=post-build-variant-condition{matching-criterion=RDR_POS, value=4}
          CanTpTxNSdu_7de58f85 (CanTpTxNSdu):
            CanTpTxAddressingFormat = CANTP_STANDARD
            CanTpTxDl = 8
            CanTpTxTaType = CANTP_PHYSICAL
            CanTpNas = 1
            CanTpNcs = 0.01
            CanTpTc = false
            CanTpTxNSduId = 6
            CanTpTxPaddingActivation = CANTP_ON
            CanTpNbs = 1
            CanTpTxNSduRef = PCAN_DIAG_RESP_PHYS_OTA_oPCAN_RADAR_20_a840a80f_Tx
            CanTpTxNPdu_8c680c30 (CanTpTxNPdu): CanTpTxNPduConfirmationPduId=8, CanTpTxNPduRef=PCAN_DIAG_RESP_PHYS_OTA_Tp_oPCAN_RADAR_20_6c821aae_Tx
            CanTpRxFcNPdu_8c680c30 (CanTpRxFcNPdu): CanTpRxFcNPduId=8, CanTpRxFcNPduRef=PCAN_DIAG_REQ_PHYS_OTA_Tp_oPCAN_RADAR_20_96582344_Rx
          CanTpRxNSdu_7de58f85 (CanTpRxNSdu):
            CanTpRxAddressingFormat = CANTP_STANDARD
            CanTpRxDl = 8
            CanTpRxTaType = CANTP_PHYSICAL
            CanTpNbr = 0.01
            CanTpRxNSduId = 11
            CanTpRxPaddingActivation = CANTP_ON
            CanTpRxWftMax = 15
            CanTpSTmin = 0.02
            CanTpNcr = 1
            CanTpNar = 1
            CanTpBs = 8
            CanTpRxNSduRef = PCAN_DIAG_REQ_PHYS_OTA_oPCAN_RADAR_20_0b124a16_Rx
            CanTpRxNPdu_ae92d8c2 (CanTpRxNPdu): CanTpRxNPduId=8, CanTpRxNPduRef=PCAN_DIAG_REQ_PHYS_OTA_Tp_oPCAN_RADAR_20_96582344_Rx
            CanTpTxFcNPdu_ae92d8c2 (CanTpTxFcNPdu): CanTpTxFcNPduConfirmationPduId=8, CanTpTxFcNPduRef=PCAN_DIAG_RESP_PHYS_OTA_Tp_oPCAN_RADAR_20_6c821aae_Tx
        TPCH_e79f3335: variation-point=post-build-variant-condition{matching-criterion=RDR_POS, value=4}
          CanTpRxNSdu_244becaa (CanTpRxNSdu):
            CanTpRxAddressingFormat = CANTP_STANDARD
            CanTpRxDl = 8
            CanTpRxTaType = CANTP_PHYSICAL
            CanTpNbr = 0.01
            CanTpRxNSduId = 19
            CanTpRxPaddingActivation = CANTP_ON
            CanTpRxWftMax = 15
            CanTpSTmin = 0.02
            CanTpNcr = 1
            CanTpNar = 1
            CanTpBs = 8
            CanTpRxNSduRef = PCAN_DIAG_REQ_PHYS_PLANT_oPCAN_RADAR_20_f7a3783e_Rx
            CanTpTxFcNPdu_af200a9a (CanTpTxFcNPdu): CanTpTxFcNPduConfirmationPduId=10, CanTpTxFcNPduRef=PCAN_DIAG_RESP_PHYS_PLANT_Tp_oPCAN_RADAR_20_0a848a3f_Tx
            CanTpRxNPdu_af200a9a (CanTpRxNPdu): CanTpRxNPduId=10, CanTpRxNPduRef=PCAN_DIAG_REQ_PHYS_PLANT_Tp_oPCAN_RADAR_20_f110e38b_Rx
          CanTpTxNSdu_244becaa (CanTpTxNSdu):
            CanTpTxAddressingFormat = CANTP_STANDARD
            CanTpTxDl = 8
            CanTpTxTaType = CANTP_PHYSICAL
            CanTpNas = 1
            CanTpNcs = 0.01
            CanTpTc = false
            CanTpTxNSduId = 9
            CanTpTxPaddingActivation = CANTP_ON
            CanTpNbs = 1
            CanTpTxNSduRef = PCAN_DIAG_RESP_PHYS_PLANT_oPCAN_RADAR_20_22a7f120_Tx
            CanTpTxNPdu_8ddade68 (CanTpTxNPdu): CanTpTxNPduConfirmationPduId=10, CanTpTxNPduRef=PCAN_DIAG_RESP_PHYS_PLANT_Tp_oPCAN_RADAR_20_0a848a3f_Tx
            CanTpRxFcNPdu_8ddade68 (CanTpRxFcNPdu): CanTpRxFcNPduId=10, CanTpRxFcNPduRef=PCAN_DIAG_REQ_PHYS_PLANT_Tp_oPCAN_RADAR_20_f110e38b_Rx
        TPCH_41f899d3: variation-point=post-build-variant-condition{matching-criterion=RDR_POS, value=4}
          CanTpRxNSdu_da5fea54 (CanTpRxNSdu):
            CanTpRxAddressingFormat = CANTP_STANDARD
            CanTpRxDl = 8
            CanTpRxTaType = CANTP_PHYSICAL
            CanTpNbr = 0.01
            CanTpRxNSduId = 4
            CanTpRxPaddingActivation = CANTP_ON
            CanTpRxWftMax = 15
            CanTpSTmin = 0.02
            CanTpNcr = 1
            CanTpNar = 1
            CanTpBs = 8
            CanTpRxNSduRef = PCAN_DIAG_REQ_PHYS_OBD2_oPCAN_RADAR_20_95757328_Rx
            CanTpTxFcNPdu_7c9c8a40 (CanTpTxFcNPdu): CanTpTxFcNPduConfirmationPduId=7, CanTpTxFcNPduRef=PCAN_DIAG_RESP_PHYS_OBD2_Tp_oPCAN_RADAR_20_25da435e_Tx
            CanTpRxNPdu_7c9c8a40 (CanTpRxNPdu): CanTpRxNPduId=7, CanTpRxNPduRef=PCAN_DIAG_REQ_PHYS_OBD2_Tp_oPCAN_RADAR_20_65ff9201_Rx
          CanTpTxNSdu_da5fea54 (CanTpTxNSdu):
            CanTpTxAddressingFormat = CANTP_STANDARD
            CanTpTxDl = 8
            CanTpTxTaType = CANTP_PHYSICAL
            CanTpNas = 1
            CanTpNcs = 0.01
            CanTpTc = false
            CanTpTxNSduId = 2
            CanTpTxPaddingActivation = CANTP_ON
            CanTpNbs = 1
            CanTpTxNSduRef = PCAN_DIAG_RESP_PHYS_OBD2_oPCAN_RADAR_20_f1bd890a_Tx
            CanTpRxFcNPdu_5e665eb2 (CanTpRxFcNPdu): CanTpRxFcNPduId=7, CanTpRxFcNPduRef=PCAN_DIAG_REQ_PHYS_OBD2_Tp_oPCAN_RADAR_20_65ff9201_Rx
            CanTpTxNPdu_5e665eb2 (CanTpTxNPdu): CanTpTxNPduConfirmationPduId=7, CanTpTxNPduRef=PCAN_DIAG_RESP_PHYS_OBD2_Tp_oPCAN_RADAR_20_25da435e_Tx
        TPCH_16678097: variation-point=post-build-variant-condition{matching-criterion=RDR_POS, value=4}
          CanTpRxNSdu_66d3fe72 (CanTpRxNSdu):
            CanTpRxAddressingFormat = CANTP_STANDARD
            CanTpRxDl = 64
            CanTpRxTaType = CANTP_CANFD_FUNCTIONAL
            CanTpNbr = 0.1
            CanTpRxNSduId = 13
            CanTpRxPaddingActivation = CANTP_ON
            CanTpRxNSduRef = PCAN_DIAG_REQ_FUNC_OBD2_oPCAN_RADAR_e2bd2c08_Rx
            CanTpRxNPdu_00542158 (CanTpRxNPdu): CanTpRxNPduId=19, CanTpRxNPduRef=PCAN_DIAG_REQ_FUNC_OBD2_Tp_oPCAN_RADAR_de9265dd_Rx
        TPCH_e79fb850: variation-point=post-build-variant-condition{matching-criterion=RDR_POS, value=4}
          CanTpTxNSdu_7d9f3885 (CanTpTxNSdu):
            CanTpTxAddressingFormat = CANTP_STANDARD
            CanTpTxDl = 64
            CanTpTxTaType = CANTP_CANFD_PHYSICAL
            CanTpNas = 1
            CanTpNcs = 0.01
            CanTpTc = false
            CanTpTxNSduId = 10
            CanTpTxPaddingActivation = CANTP_ON
            CanTpNbs = 1
            CanTpTxNSduRef = PCAN_DIAG_RESP_PHYS_OTA_oPCAN_RADAR_2a569d3c_Tx
            CanTpRxFcNPdu_4ce052cf (CanTpRxFcNPdu): CanTpRxFcNPduId=9, CanTpRxFcNPduRef=PCAN_DIAG_REQ_PHYS_OTA_Tp_oPCAN_RADAR_94a46e49_Rx
            CanTpTxNPdu_4ce052cf (CanTpTxNPdu): CanTpTxNPduConfirmationPduId=9, CanTpTxNPduRef=PCAN_DIAG_RESP_PHYS_OTA_Tp_oPCAN_RADAR_37f68c50_Tx
          CanTpRxNSdu_7d9f3885 (CanTpRxNSdu):
            CanTpRxAddressingFormat = CANTP_STANDARD
            CanTpRxDl = 64
            CanTpRxTaType = CANTP_CANFD_PHYSICAL
            CanTpNbr = 0.01
            CanTpRxNSduId = 20
            CanTpRxPaddingActivation = CANTP_ON
            CanTpRxWftMax = 15
            CanTpSTmin = 0.02
            CanTpNcr = 1
            CanTpNar = 1
            CanTpBs = 8
            CanTpRxNSduRef = PCAN_DIAG_REQ_PHYS_OTA_oPCAN_RADAR_45eab9fd_Rx
            CanTpTxFcNPdu_6e1a863d (CanTpTxFcNPdu): CanTpTxFcNPduConfirmationPduId=9, CanTpTxFcNPduRef=PCAN_DIAG_RESP_PHYS_OTA_Tp_oPCAN_RADAR_37f68c50_Tx
            CanTpRxNPdu_6e1a863d (CanTpRxNPdu): CanTpRxNPduId=9, CanTpRxNPduRef=PCAN_DIAG_REQ_PHYS_OTA_Tp_oPCAN_RADAR_94a46e49_Rx
        TPCH_28e589b7: variation-point=post-build-variant-condition{matching-criterion=RDR_POS, value=5}
          CanTpRxNSdu_1e2714e5 (CanTpRxNSdu):
            CanTpRxAddressingFormat = CANTP_STANDARD
            CanTpRxDl = 64
            CanTpRxTaType = CANTP_CANFD_PHYSICAL
            CanTpNbr = 0.01
            CanTpRxNSduId = 7
            CanTpRxPaddingActivation = CANTP_ON
            CanTpBs = 8
            CanTpNar = 1
            CanTpNcr = 1
            CanTpRxWftMax = 15
            CanTpSTmin = 0.02
            CanTpRxNSduRef = PCAN_DIAG_REQ_PHYS_OBD2_oPCAN_RADAR_e03546e9_Rx
            CanTpTxFcNPdu_cc681870 (CanTpTxFcNPdu): CanTpTxFcNPduConfirmationPduId=6, CanTpTxFcNPduRef=PCAN_DIAG_RESP_PHYS_OBD2_Tp_oPCAN_RADAR_6e0bad55_Tx
            CanTpRxNPdu_cc681870 (CanTpRxNPdu): CanTpRxNPduId=6, CanTpRxNPduRef=PCAN_DIAG_REQ_PHYS_OBD2_Tp_oPCAN_RADAR_0ac35777_Rx
          CanTpTxNSdu_1e2714e5 (CanTpTxNSdu):
            CanTpTxAddressingFormat = CANTP_STANDARD
            CanTpTxDl = 64
            CanTpTxTaType = CANTP_CANFD_PHYSICAL
            CanTpNas = 1
            CanTpNcs = 0.01
            CanTpTc = false
            CanTpTxNSduId = 5
            CanTpTxPaddingActivation = CANTP_ON
            CanTpNbs = 1
            CanTpTxNSduRef = PCAN_DIAG_RESP_PHYS_OBD2_oPCAN_RADAR_0c3908eb_Tx
            CanTpRxFcNPdu_ee92cc82 (CanTpRxFcNPdu): CanTpRxFcNPduId=6, CanTpRxFcNPduRef=PCAN_DIAG_REQ_PHYS_OBD2_Tp_oPCAN_RADAR_0ac35777_Rx
            CanTpTxNPdu_ee92cc82 (CanTpTxNPdu): CanTpTxNPduConfirmationPduId=6, CanTpTxNPduRef=PCAN_DIAG_RESP_PHYS_OBD2_Tp_oPCAN_RADAR_6e0bad55_Tx
        TPCH_feadb337: variation-point=post-build-variant-condition{matching-criterion=RDR_POS, value=5}
          CanTpRxNSdu_192cc3c6 (CanTpRxNSdu):
            CanTpRxAddressingFormat = CANTP_STANDARD
            CanTpRxDl = 8
            CanTpRxTaType = CANTP_FUNCTIONAL
            CanTpNbr = 0.1
            CanTpRxNSduId = 23
            CanTpRxPaddingActivation = CANTP_ON
            CanTpRxNSduRef = PCAN_DIAG_REQ_FUNC_PLANT_oPCAN_RADAR_20_c17463fa_Rx
            CanTpRxNPdu_b6120ed7 (CanTpRxNPdu): CanTpRxNPduId=23, CanTpRxNPduRef=PCAN_DIAG_REQ_FUNC_PLANT_Tp_oPCAN_RADAR_20_d63751cc_Rx
        TPCH_76009eaf: variation-point=post-build-variant-condition{matching-criterion=RDR_POS, value=5}
          CanTpRxNSdu_7800f5f8 (CanTpRxNSdu):
            CanTpRxAddressingFormat = CANTP_STANDARD
            CanTpRxDl = 8
            CanTpRxTaType = CANTP_FUNCTIONAL
            CanTpNbr = 0.1
            CanTpRxNSduId = 11
            CanTpRxPaddingActivation = CANTP_ON
            CanTpRxNSduRef = PCAN_DIAG_REQ_FUNC_OBD2_oPCAN_RADAR_20_41244182_Rx
            CanTpRxNPdu_f2c3088b (CanTpRxNPdu): CanTpRxNPduId=18, CanTpRxNPduRef=PCAN_DIAG_REQ_FUNC_OBD2_Tp_oPCAN_RADAR_20_400c7f70_Rx
        TPCH_6a081e97: variation-point=post-build-variant-condition{matching-criterion=RDR_POS, value=5}
          CanTpTxNSdu_c912f74f (CanTpTxNSdu):
            CanTpTxAddressingFormat = CANTP_STANDARD
            CanTpTxDl = 8
            CanTpTxTaType = CANTP_PHYSICAL
            CanTpNas = 1
            CanTpNcs = 0.01
            CanTpTc = false
            CanTpTxNSduId = 2
            CanTpTxPaddingActivation = CANTP_ON
            CanTpNbs = 1
            CanTpTxNSduRef = FR_DIAG_RES_PHY_OBD1_oVCAN_RADAR_cd47a295_Tx
            CanTpTxNPdu_09f8ee8f (CanTpTxNPdu): CanTpTxNPduConfirmationPduId=0, CanTpTxNPduRef=FR_DIAG_RES_PHY_OBD1_Tp_oVCAN_RADAR_41a76716_Tx
            CanTpRxFcNPdu_09f8ee8f (CanTpRxFcNPdu): CanTpRxFcNPduId=0, CanTpRxFcNPduRef=FR_DIAG_REQ_PHY_OBD1_Tp_oVCAN_RADAR_ddfa31cf_Rx
          CanTpRxNSdu_c912f74f (CanTpRxNSdu):
            CanTpRxAddressingFormat = CANTP_STANDARD
            CanTpRxDl = 8
            CanTpRxTaType = CANTP_PHYSICAL
            CanTpNbr = 0.01
            CanTpRxNSduId = 3
            CanTpRxPaddingActivation = CANTP_ON
            CanTpBs = 8
            CanTpNar = 1
            CanTpNcr = 1
            CanTpRxWftMax = 15
            CanTpSTmin = 0.02
            CanTpRxNSduRef = FR_DIAG_REQ_PHY_OBD1_oVCAN_RADAR_5445ad08_Rx
            CanTpTxFcNPdu_2b023a7d (CanTpTxFcNPdu): CanTpTxFcNPduConfirmationPduId=0, CanTpTxFcNPduRef=FR_DIAG_RES_PHY_OBD1_Tp_oVCAN_RADAR_41a76716_Tx
            CanTpRxNPdu_2b023a7d (CanTpRxNPdu): CanTpRxNPduId=0, CanTpRxNPduRef=FR_DIAG_REQ_PHY_OBD1_Tp_oVCAN_RADAR_ddfa31cf_Rx
        TPCH_4836f59a: variation-point=post-build-variant-condition{matching-criterion=RDR_POS, value=5}
          CanTpTxNSdu_bcb07df3 (CanTpTxNSdu):
            CanTpTxAddressingFormat = CANTP_STANDARD
            CanTpTxDl = 64
            CanTpTxTaType = CANTP_CANFD_PHYSICAL
            CanTpNas = 1
            CanTpNcs = 0.01
            CanTpTc = false
            CanTpTxNSduId = 6
            CanTpTxPaddingActivation = CANTP_ON
            CanTpNbs = 1
            CanTpTxNSduRef = PCAN_DIAG_RESP_PHYS_OTA_oPCAN_RADAR_2a569d3c_Tx
            CanTpRxFcNPdu_3c290900 (CanTpRxFcNPdu): CanTpRxFcNPduId=9, CanTpRxFcNPduRef=PCAN_DIAG_REQ_PHYS_OTA_Tp_oPCAN_RADAR_94a46e49_Rx
            CanTpTxNPdu_3c290900 (CanTpTxNPdu): CanTpTxNPduConfirmationPduId=9, CanTpTxNPduRef=PCAN_DIAG_RESP_PHYS_OTA_Tp_oPCAN_RADAR_37f68c50_Tx
          CanTpRxNSdu_bcb07df3 (CanTpRxNSdu):
            CanTpRxAddressingFormat = CANTP_STANDARD
            CanTpRxDl = 64
            CanTpRxTaType = CANTP_CANFD_PHYSICAL
            CanTpNbr = 0.01
            CanTpRxNSduId = 10
            CanTpRxPaddingActivation = CANTP_ON
            CanTpBs = 8
            CanTpNar = 1
            CanTpNcr = 1
            CanTpRxWftMax = 15
            CanTpSTmin = 0.02
            CanTpRxNSduRef = PCAN_DIAG_REQ_PHYS_OTA_oPCAN_RADAR_45eab9fd_Rx
            CanTpRxNPdu_1ed3ddf2 (CanTpRxNPdu): CanTpRxNPduId=9, CanTpRxNPduRef=PCAN_DIAG_REQ_PHYS_OTA_Tp_oPCAN_RADAR_94a46e49_Rx
            CanTpTxFcNPdu_1ed3ddf2 (CanTpTxFcNPdu): CanTpTxFcNPduConfirmationPduId=9, CanTpTxFcNPduRef=PCAN_DIAG_RESP_PHYS_OTA_Tp_oPCAN_RADAR_37f68c50_Tx
        TPCH_17f341f5: variation-point=post-build-variant-condition{matching-criterion=RDR_POS, value=5}
          CanTpRxNSdu_a193aec9 (CanTpRxNSdu):
            CanTpRxAddressingFormat = CANTP_STANDARD
            CanTpRxDl = 8
            CanTpRxTaType = CANTP_FUNCTIONAL
            CanTpNbr = 0.1
            CanTpRxNSduId = 6
            CanTpRxPaddingActivation = CANTP_ON
            CanTpRxNSduRef = PCAN_DIAG_REQ_FUNC_OBD1_oPCAN_RADAR_20_25c43a7c_Rx
            CanTpRxNPdu_235fdddd (CanTpRxNPdu): CanTpRxNPduId=16, CanTpRxNPduRef=PCAN_DIAG_REQ_FUNC_OBD1_Tp_oPCAN_RADAR_20_9397638b_Rx
        TPCH_d29efaa0: variation-point=post-build-variant-condition{matching-criterion=RDR_POS, value=5}
          CanTpRxNSdu_96757754 (CanTpRxNSdu):
            CanTpRxAddressingFormat = CANTP_STANDARD
            CanTpRxDl = 64
            CanTpRxTaType = CANTP_CANFD_FUNCTIONAL
            CanTpNbr = 0.1
            CanTpRxNSduId = 20
            CanTpRxPaddingActivation = CANTP_ON
            CanTpRxNSduRef = PCAN_DIAG_REQ_FUNC_PLANT_oPCAN_RADAR_f6414098_Rx
            CanTpRxNPdu_af00b3fb (CanTpRxNPdu): CanTpRxNPduId=22, CanTpRxNPduRef=PCAN_DIAG_REQ_FUNC_PLANT_Tp_oPCAN_RADAR_5ec247a5_Rx
        TPCH_0ca88836: variation-point=post-build-variant-condition{matching-criterion=RDR_POS, value=5}
          CanTpTxNSdu_cbb41ec6 (CanTpTxNSdu):
            CanTpTxAddressingFormat = CANTP_STANDARD
            CanTpTxDl = 8
            CanTpTxTaType = CANTP_PHYSICAL
            CanTpNas = 1
            CanTpNcs = 0.01
            CanTpTc = false
            CanTpTxNSduId = 0
            CanTpTxPaddingActivation = CANTP_ON
            CanTpNbs = 1
            CanTpTxNSduRef = PCAN_DIAG_RESP_PHYS_PLANT_oPCAN_RADAR_20_22a7f120_Tx
            CanTpRxFcNPdu_9a4c0fc3 (CanTpRxFcNPdu): CanTpRxFcNPduId=10, CanTpRxFcNPduRef=PCAN_DIAG_REQ_PHYS_PLANT_Tp_oPCAN_RADAR_20_f110e38b_Rx
            CanTpTxNPdu_9a4c0fc3 (CanTpTxNPdu): CanTpTxNPduConfirmationPduId=10, CanTpTxNPduRef=PCAN_DIAG_RESP_PHYS_PLANT_Tp_oPCAN_RADAR_20_0a848a3f_Tx
          CanTpRxNSdu_cbb41ec6 (CanTpRxNSdu):
            CanTpRxAddressingFormat = CANTP_STANDARD
            CanTpRxDl = 8
            CanTpRxTaType = CANTP_PHYSICAL
            CanTpNbr = 0.01
            CanTpRxNSduId = 0
            CanTpRxPaddingActivation = CANTP_ON
            CanTpBs = 8
            CanTpNar = 1
            CanTpNcr = 1
            CanTpRxWftMax = 15
            CanTpSTmin = 0.02
            CanTpRxNSduRef = PCAN_DIAG_REQ_PHYS_PLANT_oPCAN_RADAR_20_f7a3783e_Rx
            CanTpRxNPdu_b8b6db31 (CanTpRxNPdu): CanTpRxNPduId=10, CanTpRxNPduRef=PCAN_DIAG_REQ_PHYS_PLANT_Tp_oPCAN_RADAR_20_f110e38b_Rx
            CanTpTxFcNPdu_b8b6db31 (CanTpTxFcNPdu): CanTpTxFcNPduConfirmationPduId=10, CanTpTxFcNPduRef=PCAN_DIAG_RESP_PHYS_PLANT_Tp_oPCAN_RADAR_20_0a848a3f_Tx
        TPCH_af127c8d: variation-point=post-build-variant-condition{matching-criterion=RDR_POS, value=5}
          CanTpRxNSdu_1825ea7b (CanTpRxNSdu):
            CanTpRxAddressingFormat = CANTP_STANDARD
            CanTpRxDl = 8
            CanTpRxTaType = CANTP_PHYSICAL
            CanTpNbr = 0.01
            CanTpRxNSduId = 14
            CanTpRxPaddingActivation = CANTP_ON
            CanTpBs = 8
            CanTpNar = 1
            CanTpNcr = 1
            CanTpRxWftMax = 15
            CanTpSTmin = 0.02
            CanTpRxNSduRef = FR_DIAG_REQ_PHY_OBD2_oVCAN_RADAR_0f521c1d_Rx
            CanTpRxNPdu_caab25b0 (CanTpRxNPdu): CanTpRxNPduId=1, CanTpRxNPduRef=FR_DIAG_REQ_PHY_OBD2_Tp_oVCAN_RADAR_b91a4a31_Rx
            CanTpTxFcNPdu_caab25b0 (CanTpTxFcNPdu): CanTpTxFcNPduConfirmationPduId=1, CanTpTxFcNPduRef=FR_DIAG_RES_PHY_OBD2_Tp_oVCAN_RADAR_25471ce8_Tx
          CanTpTxNSdu_1825ea7b (CanTpTxNSdu):
            CanTpTxAddressingFormat = CANTP_STANDARD
            CanTpTxDl = 8
            CanTpTxTaType = CANTP_PHYSICAL
            CanTpNas = 1
            CanTpNcs = 0.01
            CanTpTc = false
            CanTpTxNSduId = 8
            CanTpTxPaddingActivation = CANTP_ON
            CanTpNbs = 1
            CanTpTxNSduRef = FR_DIAG_RES_PHY_OBD2_oVCAN_RADAR_96501380_Tx
            CanTpRxFcNPdu_e851f142 (CanTpRxFcNPdu): CanTpRxFcNPduId=1, CanTpRxFcNPduRef=FR_DIAG_REQ_PHY_OBD2_Tp_oVCAN_RADAR_b91a4a31_Rx
            CanTpTxNPdu_e851f142 (CanTpTxNPdu): CanTpTxNPduConfirmationPduId=1, CanTpTxNPduRef=FR_DIAG_RES_PHY_OBD2_Tp_oVCAN_RADAR_25471ce8_Tx
        TPCH_b66b7a3d: variation-point=post-build-variant-condition{matching-criterion=RDR_POS, value=5}
          CanTpTxNSdu_7019f6f9 (CanTpTxNSdu):
            CanTpTxAddressingFormat = CANTP_STANDARD
            CanTpTxDl = 8
            CanTpTxTaType = CANTP_PHYSICAL
            CanTpNas = 1
            CanTpNcs = 0.01
            CanTpTc = false
            CanTpTxNSduId = 9
            CanTpTxPaddingActivation = CANTP_ON
            CanTpNbs = 1
            CanTpTxNSduRef = FR_DIAG_RES_PHY_OTA_oVCAN_RADAR_9ad9d3d9_Tx
            CanTpTxNPdu_baf86b8a (CanTpTxNPdu): CanTpTxNPduConfirmationPduId=2, CanTpTxNPduRef=FR_DIAG_RES_PHY_OTA_Tp_oVCAN_RADAR_19b4e511_Tx
            CanTpRxFcNPdu_baf86b8a (CanTpRxFcNPdu): CanTpRxFcNPduId=2, CanTpRxFcNPduRef=FR_DIAG_REQ_PHY_OTA_Tp_oVCAN_RADAR_4de495d5_Rx
          CanTpRxNSdu_7019f6f9 (CanTpRxNSdu):
            CanTpRxAddressingFormat = CANTP_STANDARD
            CanTpRxDl = 8
            CanTpRxTaType = CANTP_PHYSICAL
            CanTpNbr = 0.01
            CanTpRxNSduId = 15
            CanTpRxPaddingActivation = CANTP_ON
            CanTpBs = 8
            CanTpNar = 1
            CanTpNcr = 1
            CanTpRxWftMax = 15
            CanTpSTmin = 0.02
            CanTpRxNSduRef = FR_DIAG_REQ_PHY_OTA_oVCAN_RADAR_9187f4da_Rx
            CanTpTxFcNPdu_9802bf78 (CanTpTxFcNPdu): CanTpTxFcNPduConfirmationPduId=2, CanTpTxFcNPduRef=FR_DIAG_RES_PHY_OTA_Tp_oVCAN_RADAR_19b4e511_Tx
            CanTpRxNPdu_9802bf78 (CanTpRxNPdu): CanTpRxNPduId=2, CanTpRxNPduRef=FR_DIAG_REQ_PHY_OTA_Tp_oVCAN_RADAR_4de495d5_Rx
        TPCH_f522a01e: variation-point=post-build-variant-condition{matching-criterion=RDR_POS, value=5}
          CanTpTxNSdu_a01029ae (CanTpTxNSdu):
            CanTpTxAddressingFormat = CANTP_STANDARD
            CanTpTxDl = 64
            CanTpTxTaType = CANTP_CANFD_PHYSICAL
            CanTpNas = 1
            CanTpNcs = 0.01
            CanTpTc = false
            CanTpTxNSduId = 11
            CanTpTxPaddingActivation = CANTP_ON
            CanTpNbs = 1
            CanTpTxNSduRef = PCAN_DIAG_RESP_PHYS_OBD1_oPCAN_RADAR_572eb9fe_Tx
            CanTpTxNPdu_b6ba1235 (CanTpTxNPdu): CanTpTxNPduConfirmationPduId=4, CanTpTxNPduRef=PCAN_DIAG_RESP_PHYS_OBD1_Tp_oPCAN_RADAR_0aebd6ab_Tx
            CanTpRxFcNPdu_b6ba1235 (CanTpRxFcNPdu): CanTpRxFcNPduId=4, CanTpRxFcNPduRef=PCAN_DIAG_REQ_PHYS_OBD1_Tp_oPCAN_RADAR_6e232c89_Rx
          CanTpRxNSdu_a01029ae (CanTpRxNSdu):
            CanTpRxAddressingFormat = CANTP_STANDARD
            CanTpRxDl = 64
            CanTpRxTaType = CANTP_CANFD_PHYSICAL
            CanTpNbr = 0.01
            CanTpRxNSduId = 22
            CanTpRxPaddingActivation = CANTP_ON
            CanTpBs = 8
            CanTpNar = 1
            CanTpNcr = 1
            CanTpRxWftMax = 15
            CanTpSTmin = 0.02
            CanTpRxNSduRef = PCAN_DIAG_REQ_PHYS_OBD1_oPCAN_RADAR_bb22f7fc_Rx
            CanTpRxNPdu_9440c6c7 (CanTpRxNPdu): CanTpRxNPduId=4, CanTpRxNPduRef=PCAN_DIAG_REQ_PHYS_OBD1_Tp_oPCAN_RADAR_6e232c89_Rx
            CanTpTxFcNPdu_9440c6c7 (CanTpTxFcNPdu): CanTpTxFcNPduConfirmationPduId=4, CanTpTxFcNPduRef=PCAN_DIAG_RESP_PHYS_OBD1_Tp_oPCAN_RADAR_0aebd6ab_Tx
        TPCH_1b04f26c: variation-point=post-build-variant-condition{matching-criterion=RDR_POS, value=5}
          CanTpTxNSdu_e3788fc6 (CanTpTxNSdu):
            CanTpTxAddressingFormat = CANTP_STANDARD
            CanTpTxDl = 64
            CanTpTxTaType = CANTP_CANFD_PHYSICAL
            CanTpNas = 1
            CanTpNcs = 0.01
            CanTpTc = false
            CanTpTxNSduId = 1
            CanTpTxPaddingActivation = CANTP_ON
            CanTpNbs = 1
            CanTpTxNSduRef = PCAN_DIAG_RESP_PHYS_PLANT_oPCAN_RADAR_cfac777e_Tx
            CanTpTxNPdu_aceb83bd (CanTpTxNPdu): CanTpTxNPduConfirmationPduId=11, CanTpTxNPduRef=PCAN_DIAG_RESP_PHYS_PLANT_Tp_oPCAN_RADAR_bd11d57f_Tx
            CanTpRxFcNPdu_aceb83bd (CanTpRxFcNPdu): CanTpRxFcNPduId=11, CanTpRxFcNPduRef=PCAN_DIAG_REQ_PHYS_PLANT_Tp_oPCAN_RADAR_68155c61_Rx
          CanTpRxNSdu_e3788fc6 (CanTpRxNSdu):
            CanTpRxAddressingFormat = CANTP_STANDARD
            CanTpRxDl = 64
            CanTpRxTaType = CANTP_CANFD_PHYSICAL
            CanTpNbr = 0.01
            CanTpRxNSduId = 1
            CanTpRxPaddingActivation = CANTP_ON
            CanTpBs = 8
            CanTpNar = 1
            CanTpNcr = 1
            CanTpRxWftMax = 15
            CanTpSTmin = 0.02
            CanTpRxNSduRef = PCAN_DIAG_REQ_PHYS_PLANT_oPCAN_RADAR_214e1a1c_Rx
            CanTpTxFcNPdu_8e11574f (CanTpTxFcNPdu): CanTpTxFcNPduConfirmationPduId=11, CanTpTxFcNPduRef=PCAN_DIAG_RESP_PHYS_PLANT_Tp_oPCAN_RADAR_bd11d57f_Tx
            CanTpRxNPdu_8e11574f (CanTpRxNPdu): CanTpRxNPduId=11, CanTpRxNPduRef=PCAN_DIAG_REQ_PHYS_PLANT_Tp_oPCAN_RADAR_68155c61_Rx
        TPCH_aacf22d0: variation-point=post-build-variant-condition{matching-criterion=RDR_POS, value=5}
          CanTpTxNSdu_71ff2702 (CanTpTxNSdu):
            CanTpTxAddressingFormat = CANTP_STANDARD
            CanTpTxDl = 8
            CanTpTxTaType = CANTP_PHYSICAL
            CanTpNas = 1
            CanTpNcs = 0.01
            CanTpTc = false
            CanTpTxNSduId = 7
            CanTpTxPaddingActivation = CANTP_ON
            CanTpNbs = 1
            CanTpTxNSduRef = PCAN_DIAG_RESP_PHYS_OBD2_oPCAN_RADAR_20_f1bd890a_Tx
            CanTpRxFcNPdu_95f032c7 (CanTpRxFcNPdu): CanTpRxFcNPduId=7, CanTpRxFcNPduRef=PCAN_DIAG_REQ_PHYS_OBD2_Tp_oPCAN_RADAR_20_65ff9201_Rx
            CanTpTxNPdu_95f032c7 (CanTpTxNPdu): CanTpTxNPduConfirmationPduId=7, CanTpTxNPduRef=PCAN_DIAG_RESP_PHYS_OBD2_Tp_oPCAN_RADAR_20_25da435e_Tx
          CanTpRxNSdu_71ff2702 (CanTpRxNSdu):
            CanTpRxAddressingFormat = CANTP_STANDARD
            CanTpRxDl = 8
            CanTpRxTaType = CANTP_PHYSICAL
            CanTpNbr = 0.01
            CanTpRxNSduId = 13
            CanTpRxPaddingActivation = CANTP_ON
            CanTpBs = 8
            CanTpNar = 1
            CanTpNcr = 1
            CanTpRxWftMax = 15
            CanTpSTmin = 0.02
            CanTpRxNSduRef = PCAN_DIAG_REQ_PHYS_OBD2_oPCAN_RADAR_20_95757328_Rx
            CanTpTxFcNPdu_b70ae635 (CanTpTxFcNPdu): CanTpTxFcNPduConfirmationPduId=7, CanTpTxFcNPduRef=PCAN_DIAG_RESP_PHYS_OBD2_Tp_oPCAN_RADAR_20_25da435e_Tx
            CanTpRxNPdu_b70ae635 (CanTpRxNPdu): CanTpRxNPduId=7, CanTpRxNPduRef=PCAN_DIAG_REQ_PHYS_OBD2_Tp_oPCAN_RADAR_20_65ff9201_Rx
        TPCH_b7852b61: variation-point=post-build-variant-condition{matching-criterion=RDR_POS, value=5}
          CanTpRxNSdu_35b990b3 (CanTpRxNSdu):
            CanTpRxAddressingFormat = CANTP_STANDARD
            CanTpRxDl = 64
            CanTpRxTaType = CANTP_CANFD_FUNCTIONAL
            CanTpNbr = 0.1
            CanTpRxNSduId = 16
            CanTpRxPaddingActivation = CANTP_ON
            CanTpRxNSduRef = PCAN_DIAG_REQ_FUNC_OTA_oPCAN_RADAR_a013523e_Rx
            CanTpRxNPdu_ab223cd1 (CanTpRxNPdu): CanTpRxNPduId=20, CanTpRxNPduRef=PCAN_DIAG_REQ_FUNC_OTA_Tp_oPCAN_RADAR_7ea6262a_Rx
        TPCH_e10a6db1: variation-point=post-build-variant-condition{matching-criterion=RDR_POS, value=5}
          CanTpRxNSdu_28543443 (CanTpRxNSdu):
            CanTpRxAddressingFormat = CANTP_STANDARD
            CanTpRxDl = 8
            CanTpRxTaType = CANTP_FUNCTIONAL
            CanTpNbr = 0.1
            CanTpRxNSduId = 21
            CanTpRxPaddingActivation = CANTP_ON
            CanTpRxNSduRef = DIAG_REQ_FNC_OTA_oVCAN_RADAR_e787ed21_Rx
            CanTpRxNPdu_55314ea3 (CanTpRxNPdu): CanTpRxNPduId=14, CanTpRxNPduRef=DIAG_REQ_FNC_OTA_Tp_oVCAN_RADAR_6f75a08a_Rx
        TPCH_00cabe87: variation-point=post-build-variant-condition{matching-criterion=RDR_POS, value=5}
          CanTpRxNSdu_f5655a25 (CanTpRxNSdu):
            CanTpRxAddressingFormat = CANTP_STANDARD
            CanTpRxDl = 8
            CanTpRxTaType = CANTP_PHYSICAL
            CanTpNbr = 0.01
            CanTpRxNSduId = 5
            CanTpRxPaddingActivation = CANTP_ON
            CanTpBs = 8
            CanTpNar = 1
            CanTpNcr = 1
            CanTpRxWftMax = 15
            CanTpSTmin = 0.02
            CanTpRxNSduRef = FR_DIAG_REQ_PHY_PLANT_oVCAN_RADAR_d1c8c991_Rx
            CanTpRxNPdu_267926b4 (CanTpRxNPdu): CanTpRxNPduId=3, CanTpRxNPduRef=FR_DIAG_REQ_PHY_PLANT_Tp_oVCAN_RADAR_bda0e30b_Rx
            CanTpTxFcNPdu_267926b4 (CanTpTxFcNPdu): CanTpTxFcNPduConfirmationPduId=3, CanTpTxFcNPduRef=FR_DIAG_RES_PHY_PLANT_Tp_oVCAN_RADAR_4233d42d_Tx
          CanTpTxNSdu_f5655a25 (CanTpTxNSdu):
            CanTpTxAddressingFormat = CANTP_STANDARD
            CanTpTxDl = 8
            CanTpTxTaType = CANTP_PHYSICAL
            CanTpNas = 1
            CanTpNcs = 0.01
            CanTpTc = false
            CanTpTxNSduId = 4
            CanTpTxPaddingActivation = CANTP_ON
            CanTpNbs = 1
            CanTpTxNSduRef = FR_DIAG_RES_PHY_PLANT_oVCAN_RADAR_5fef2467_Tx
            CanTpRxFcNPdu_0483f246 (CanTpRxFcNPdu): CanTpRxFcNPduId=3, CanTpRxFcNPduRef=FR_DIAG_REQ_PHY_PLANT_Tp_oVCAN_RADAR_bda0e30b_Rx
            CanTpTxNPdu_0483f246 (CanTpTxNPdu): CanTpTxNPduConfirmationPduId=3, CanTpTxNPduRef=FR_DIAG_RES_PHY_PLANT_Tp_oVCAN_RADAR_4233d42d_Tx
        TPCH_2f1f2dd7: variation-point=post-build-variant-condition{matching-criterion=RDR_POS, value=5}
          CanTpRxNSdu_d8e283f4 (CanTpRxNSdu):
            CanTpRxAddressingFormat = CANTP_STANDARD
            CanTpRxDl = 64
            CanTpRxTaType = CANTP_CANFD_FUNCTIONAL
            CanTpNbr = 0.1
            CanTpRxNSduId = 2
            CanTpRxPaddingActivation = CANTP_ON
            CanTpRxNSduRef = PCAN_DIAG_REQ_FUNC_OBD2_oPCAN_RADAR_e2bd2c08_Rx
            CanTpRxNPdu_23eeaf8e (CanTpRxNPdu): CanTpRxNPduId=19, CanTpRxNPduRef=PCAN_DIAG_REQ_FUNC_OBD2_Tp_oPCAN_RADAR_de9265dd_Rx
        TPCH_d23f3afe: variation-point=post-build-variant-condition{matching-criterion=RDR_POS, value=5}
          CanTpRxNSdu_d8dde2ce (CanTpRxNSdu):
            CanTpRxAddressingFormat = CANTP_STANDARD
            CanTpRxDl = 8
            CanTpRxTaType = CANTP_FUNCTIONAL
            CanTpNbr = 0.1
            CanTpRxNSduId = 19
            CanTpRxPaddingActivation = CANTP_ON
            CanTpRxNSduRef = PCAN_DIAG_REQ_FUNC_OTA_oPCAN_RADAR_20_e1100275_Rx
            CanTpRxNPdu_277f419b (CanTpRxNPdu): CanTpRxNPduId=21, CanTpRxNPduRef=PCAN_DIAG_REQ_FUNC_OTA_Tp_oPCAN_RADAR_20_0a67f2f6_Rx
        TPCH_4416a5d8: variation-point=post-build-variant-condition{matching-criterion=RDR_POS, value=5}
          CanTpRxNSdu_b6ad447c (CanTpRxNSdu):
            CanTpRxAddressingFormat = CANTP_STANDARD
            CanTpRxDl = 8
            CanTpRxTaType = CANTP_FUNCTIONAL
            CanTpNbr = 0.1
            CanTpRxNSduId = 9
            CanTpRxPaddingActivation = CANTP_ON
            CanTpRxNSduRef = DIAG_REQ_FNC_PLANT_oVCAN_RADAR_42eb2f27_Rx
            CanTpRxNPdu_d837d615 (CanTpRxNPdu): CanTpRxNPduId=15, CanTpRxNPduRef=DIAG_REQ_FNC_PLANT_Tp_oVCAN_RADAR_d6304422_Rx
        TPCH_bc52e151: variation-point=post-build-variant-condition{matching-criterion=RDR_POS, value=5}
          CanTpTxNSdu_ff9066e8 (CanTpTxNSdu):
            CanTpTxAddressingFormat = CANTP_STANDARD
            CanTpTxDl = 8
            CanTpTxTaType = CANTP_PHYSICAL
            CanTpNas = 1
            CanTpNcs = 0.01
            CanTpTc = false
            CanTpTxNSduId = 10
            CanTpTxPaddingActivation = CANTP_ON
            CanTpNbs = 1
            CanTpTxNSduRef = PCAN_DIAG_RESP_PHYS_OTA_oPCAN_RADAR_20_a840a80f_Tx
            CanTpRxFcNPdu_565ab5ab (CanTpRxFcNPdu): CanTpRxFcNPduId=8, CanTpRxFcNPduRef=PCAN_DIAG_REQ_PHYS_OTA_Tp_oPCAN_RADAR_20_96582344_Rx
            CanTpTxNPdu_565ab5ab (CanTpTxNPdu): CanTpTxNPduConfirmationPduId=8, CanTpTxNPduRef=PCAN_DIAG_RESP_PHYS_OTA_Tp_oPCAN_RADAR_20_6c821aae_Tx
          CanTpRxNSdu_ff9066e8 (CanTpRxNSdu):
            CanTpRxAddressingFormat = CANTP_STANDARD
            CanTpRxDl = 8
            CanTpRxTaType = CANTP_PHYSICAL
            CanTpNbr = 0.01
            CanTpRxNSduId = 17
            CanTpRxPaddingActivation = CANTP_ON
            CanTpBs = 8
            CanTpNar = 1
            CanTpNcr = 1
            CanTpRxWftMax = 15
            CanTpSTmin = 0.02
            CanTpRxNSduRef = PCAN_DIAG_REQ_PHYS_OTA_oPCAN_RADAR_20_0b124a16_Rx
            CanTpTxFcNPdu_74a06159 (CanTpTxFcNPdu): CanTpTxFcNPduConfirmationPduId=8, CanTpTxFcNPduRef=PCAN_DIAG_RESP_PHYS_OTA_Tp_oPCAN_RADAR_20_6c821aae_Tx
            CanTpRxNPdu_74a06159 (CanTpRxNPdu): CanTpRxNPduId=8, CanTpRxNPduRef=PCAN_DIAG_REQ_PHYS_OTA_Tp_oPCAN_RADAR_20_96582344_Rx
        TPCH_87a5cb58: variation-point=post-build-variant-condition{matching-criterion=RDR_POS, value=5}
          CanTpRxNSdu_fb9ea522 (CanTpRxNSdu):
            CanTpRxAddressingFormat = CANTP_STANDARD
            CanTpRxDl = 8
            CanTpRxTaType = CANTP_FUNCTIONAL
            CanTpNbr = 0.1
            CanTpRxNSduId = 8
            CanTpRxPaddingActivation = CANTP_ON
            CanTpRxNSduRef = DIAG_REQ_FNC_OBD2_oVCAN_RADAR_254b3790_Rx
            CanTpRxNPdu_58be1a07 (CanTpRxNPdu): CanTpRxNPduId=13, CanTpRxNPduRef=DIAG_REQ_FNC_OBD2_Tp_oVCAN_RADAR_42ec9761_Rx
        TPCH_6d3fcb1a: variation-point=post-build-variant-condition{matching-criterion=RDR_POS, value=5}
          CanTpRxNSdu_b4077489 (CanTpRxNSdu):
            CanTpRxAddressingFormat = CANTP_STANDARD
            CanTpRxDl = 8
            CanTpRxTaType = CANTP_PHYSICAL
            CanTpNbr = 0.01
            CanTpRxNSduId = 4
            CanTpRxPaddingActivation = CANTP_ON
            CanTpBs = 8
            CanTpNar = 1
            CanTpNcr = 1
            CanTpRxWftMax = 15
            CanTpSTmin = 0.02
            CanTpRxNSduRef = PCAN_DIAG_REQ_PHYS_OBD1_oPCAN_RADAR_20_f19508d6_Rx
            CanTpTxFcNPdu_4069e760 (CanTpTxFcNPdu): CanTpTxFcNPduConfirmationPduId=5, CanTpTxFcNPduRef=PCAN_DIAG_RESP_PHYS_OBD1_Tp_oPCAN_RADAR_20_f6415fa5_Tx
            CanTpRxNPdu_4069e760 (CanTpRxNPdu): CanTpRxNPduId=5, CanTpRxNPduRef=PCAN_DIAG_REQ_PHYS_OBD1_Tp_oPCAN_RADAR_20_b6648efa_Rx
          CanTpTxNSdu_b4077489 (CanTpTxNSdu):
            CanTpTxAddressingFormat = CANTP_STANDARD
            CanTpTxDl = 8
            CanTpTxTaType = CANTP_PHYSICAL
            CanTpNas = 1
            CanTpNcs = 0.01
            CanTpTc = false
            CanTpTxNSduId = 3
            CanTpTxPaddingActivation = CANTP_ON
            CanTpNbs = 1
            CanTpTxNSduRef = PCAN_DIAG_RESP_PHYS_OBD1_oPCAN_RADAR_20_955df2f4_Tx
            CanTpTxNPdu_62933392 (CanTpTxNPdu): CanTpTxNPduConfirmationPduId=5, CanTpTxNPduRef=PCAN_DIAG_RESP_PHYS_OBD1_Tp_oPCAN_RADAR_20_f6415fa5_Tx
            CanTpRxFcNPdu_62933392 (CanTpRxFcNPdu): CanTpRxFcNPduId=5, CanTpRxFcNPduRef=PCAN_DIAG_REQ_PHYS_OBD1_Tp_oPCAN_RADAR_20_b6648efa_Rx
        TPCH_bc90b3b7: variation-point=post-build-variant-condition{matching-criterion=RDR_POS, value=5}
          CanTpRxNSdu_70587782 (CanTpRxNSdu):
            CanTpRxAddressingFormat = CANTP_STANDARD
            CanTpRxDl = 8
            CanTpRxTaType = CANTP_FUNCTIONAL
            CanTpNbr = 0.1
            CanTpRxNSduId = 18
            CanTpRxPaddingActivation = CANTP_ON
            CanTpRxNSduRef = DIAG_REQ_FNC_OBD1_oVCAN_RADAR_7e5c8685_Rx
            CanTpRxNPdu_1d379936 (CanTpRxNPdu): CanTpRxNPduId=12, CanTpRxNPduRef=DIAG_REQ_FNC_OBD1_Tp_oVCAN_RADAR_260cec9f_Rx
        TPCH_a6ca6284: variation-point=post-build-variant-condition{matching-criterion=RDR_POS, value=5}
          CanTpRxNSdu_bbac6d3d (CanTpRxNSdu):
            CanTpRxAddressingFormat = CANTP_STANDARD
            CanTpRxDl = 64
            CanTpRxTaType = CANTP_CANFD_FUNCTIONAL
            CanTpNbr = 0.1
            CanTpRxNSduId = 12
            CanTpRxPaddingActivation = CANTP_ON
            CanTpRxNSduRef = PCAN_DIAG_REQ_FUNC_OBD1_oPCAN_RADAR_b9aa9d1d_Rx
            CanTpRxNPdu_2c024d1e (CanTpRxNPdu): CanTpRxNPduId=17, CanTpRxNPduRef=PCAN_DIAG_REQ_FUNC_OBD1_Tp_oPCAN_RADAR_ba721e23_Rx
        TPCH_a0ad4fa1: variation-point=post-build-variant-condition{matching-criterion=RDR_POS, value=6}
          CanTpRxNSdu_87fb2a09 (CanTpRxNSdu):
            CanTpRxAddressingFormat = CANTP_STANDARD
            CanTpRxDl = 64
            CanTpRxTaType = CANTP_CANFD_FUNCTIONAL
            CanTpNbr = 0.1
            CanTpRxNSduId = 17
            CanTpRxPaddingActivation = CANTP_ON
            CanTpRxNSduRef = PCAN_DIAG_REQ_FUNC_OTA_oPCAN_RADAR_a013523e_Rx
            CanTpRxNPdu_6f33a27f (CanTpRxNPdu): CanTpRxNPduId=20, CanTpRxNPduRef=PCAN_DIAG_REQ_FUNC_OTA_Tp_oPCAN_RADAR_7ea6262a_Rx
        TPCH_7aaf21de: variation-point=post-build-variant-condition{matching-criterion=RDR_POS, value=6}
          CanTpRxNSdu_b639676a (CanTpRxNSdu):
            CanTpRxAddressingFormat = CANTP_STANDARD
            CanTpRxDl = 8
            CanTpRxTaType = CANTP_FUNCTIONAL
            CanTpNbr = 0.1
            CanTpRxNSduId = 3
            CanTpRxPaddingActivation = CANTP_ON
            CanTpRxNSduRef = DIAG_REQ_FNC_OTA_oVCAN_RADAR_e787ed21_Rx
            CanTpRxNPdu_6e1fb67f (CanTpRxNPdu): CanTpRxNPduId=14, CanTpRxNPduRef=DIAG_REQ_FNC_OTA_Tp_oVCAN_RADAR_6f75a08a_Rx
        TPCH_82fda024: variation-point=post-build-variant-condition{matching-criterion=RDR_POS, value=6}
          CanTpRxNSdu_3216b4ff (CanTpRxNSdu):
            CanTpRxAddressingFormat = CANTP_STANDARD
            CanTpRxDl = 8
            CanTpRxTaType = CANTP_PHYSICAL
            CanTpNbr = 0.01
            CanTpRxNSduId = 8
            CanTpRxPaddingActivation = CANTP_ON
            CanTpBs = 8
            CanTpNar = 1
            CanTpNcr = 1
            CanTpRxWftMax = 15
            CanTpSTmin = 0.02
            CanTpRxNSduRef = PCAN_DIAG_REQ_PHYS_OBD1_oPCAN_RADAR_20_f19508d6_Rx
            CanTpTxFcNPdu_8b786657 (CanTpTxFcNPdu): CanTpTxFcNPduConfirmationPduId=5, CanTpTxFcNPduRef=PCAN_DIAG_RESP_PHYS_OBD1_Tp_oPCAN_RADAR_20_f6415fa5_Tx
            CanTpRxNPdu_8b786657 (CanTpRxNPdu): CanTpRxNPduId=5, CanTpRxNPduRef=PCAN_DIAG_REQ_PHYS_OBD1_Tp_oPCAN_RADAR_20_b6648efa_Rx
          CanTpTxNSdu_3216b4ff (CanTpTxNSdu):
            CanTpTxAddressingFormat = CANTP_STANDARD
            CanTpTxDl = 8
            CanTpTxTaType = CANTP_PHYSICAL
            CanTpNas = 1
            CanTpNcs = 0.01
            CanTpTc = false
            CanTpTxNSduId = 5
            CanTpTxPaddingActivation = CANTP_ON
            CanTpNbs = 1
            CanTpTxNSduRef = PCAN_DIAG_RESP_PHYS_OBD1_oPCAN_RADAR_20_955df2f4_Tx
            CanTpTxNPdu_a982b2a5 (CanTpTxNPdu): CanTpTxNPduConfirmationPduId=5, CanTpTxNPduRef=PCAN_DIAG_RESP_PHYS_OBD1_Tp_oPCAN_RADAR_20_f6415fa5_Tx
            CanTpRxFcNPdu_a982b2a5 (CanTpRxFcNPdu): CanTpRxFcNPduId=5, CanTpRxFcNPduRef=PCAN_DIAG_REQ_PHYS_OBD1_Tp_oPCAN_RADAR_20_b6648efa_Rx
        TPCH_40d017b3: variation-point=post-build-variant-condition{matching-criterion=RDR_POS, value=6}
          CanTpRxNSdu_98e0a949 (CanTpRxNSdu):
            CanTpRxAddressingFormat = CANTP_STANDARD
            CanTpRxDl = 8
            CanTpRxTaType = CANTP_PHYSICAL
            CanTpNbr = 0.01
            CanTpRxNSduId = 6
            CanTpRxPaddingActivation = CANTP_ON
            CanTpBs = 8
            CanTpNar = 1
            CanTpNcr = 1
            CanTpRxWftMax = 15
            CanTpSTmin = 0.02
            CanTpRxNSduRef = FR_DIAG_REQ_PHY_OBD2_oVCAN_RADAR_0f521c1d_Rx
            CanTpTxFcNPdu_1f3d3e0c (CanTpTxFcNPdu): CanTpTxFcNPduConfirmationPduId=1, CanTpTxFcNPduRef=FR_DIAG_RES_PHY_OBD2_Tp_oVCAN_RADAR_25471ce8_Tx
            CanTpRxNPdu_1f3d3e0c (CanTpRxNPdu): CanTpRxNPduId=1, CanTpRxNPduRef=FR_DIAG_REQ_PHY_OBD2_Tp_oVCAN_RADAR_b91a4a31_Rx
          CanTpTxNSdu_98e0a949 (CanTpTxNSdu):
            CanTpTxAddressingFormat = CANTP_STANDARD
            CanTpTxDl = 8
            CanTpTxTaType = CANTP_PHYSICAL
            CanTpNas = 1
            CanTpNcs = 0.01
            CanTpTc = false
            CanTpTxNSduId = 3
            CanTpTxPaddingActivation = CANTP_ON
            CanTpNbs = 1
            CanTpTxNSduRef = FR_DIAG_RES_PHY_OBD2_oVCAN_RADAR_96501380_Tx
            CanTpRxFcNPdu_3dc7eafe (CanTpRxFcNPdu): CanTpRxFcNPduId=1, CanTpRxFcNPduRef=FR_DIAG_REQ_PHY_OBD2_Tp_oVCAN_RADAR_b91a4a31_Rx
            CanTpTxNPdu_3dc7eafe (CanTpTxNPdu): CanTpTxNPduConfirmationPduId=1, CanTpTxNPduRef=FR_DIAG_RES_PHY_OBD2_Tp_oVCAN_RADAR_25471ce8_Tx
        TPCH_7e63c92a: variation-point=post-build-variant-condition{matching-criterion=RDR_POS, value=6}
          CanTpRxNSdu_35203c39 (CanTpRxNSdu):
            CanTpRxAddressingFormat = CANTP_STANDARD
            CanTpRxDl = 64
            CanTpRxTaType = CANTP_CANFD_PHYSICAL
            CanTpNbr = 0.01
            CanTpRxNSduId = 4
            CanTpRxPaddingActivation = CANTP_ON
            CanTpBs = 8
            CanTpNar = 1
            CanTpNcr = 1
            CanTpRxWftMax = 15
            CanTpSTmin = 0.02
            CanTpRxNSduRef = PCAN_DIAG_REQ_PHYS_PLANT_oPCAN_RADAR_214e1a1c_Rx
            CanTpTxFcNPdu_ee206532 (CanTpTxFcNPdu): CanTpTxFcNPduConfirmationPduId=11, CanTpTxFcNPduRef=PCAN_DIAG_RESP_PHYS_PLANT_Tp_oPCAN_RADAR_bd11d57f_Tx
            CanTpRxNPdu_ee206532 (CanTpRxNPdu): CanTpRxNPduId=11, CanTpRxNPduRef=PCAN_DIAG_REQ_PHYS_PLANT_Tp_oPCAN_RADAR_68155c61_Rx
          CanTpTxNSdu_35203c39 (CanTpTxNSdu):
            CanTpTxAddressingFormat = CANTP_STANDARD
            CanTpTxDl = 64
            CanTpTxTaType = CANTP_CANFD_PHYSICAL
            CanTpNas = 1
            CanTpNcs = 0.01
            CanTpTc = false
            CanTpTxNSduId = 2
            CanTpTxPaddingActivation = CANTP_ON
            CanTpNbs = 1
            CanTpTxNSduRef = PCAN_DIAG_RESP_PHYS_PLANT_oPCAN_RADAR_cfac777e_Tx
            CanTpRxFcNPdu_ccdab1c0 (CanTpRxFcNPdu): CanTpRxFcNPduId=11, CanTpRxFcNPduRef=PCAN_DIAG_REQ_PHYS_PLANT_Tp_oPCAN_RADAR_68155c61_Rx
            CanTpTxNPdu_ccdab1c0 (CanTpTxNPdu): CanTpTxNPduConfirmationPduId=11, CanTpTxNPduRef=PCAN_DIAG_RESP_PHYS_PLANT_Tp_oPCAN_RADAR_bd11d57f_Tx
        TPCH_ef08d5b9: variation-point=post-build-variant-condition{matching-criterion=RDR_POS, value=6}
          CanTpRxNSdu_f984455c (CanTpRxNSdu):
            CanTpRxAddressingFormat = CANTP_STANDARD
            CanTpRxDl = 8
            CanTpRxTaType = CANTP_PHYSICAL
            CanTpNbr = 0.01
            CanTpRxNSduId = 23
            CanTpRxPaddingActivation = CANTP_ON
            CanTpBs = 8
            CanTpNar = 1
            CanTpNcr = 1
            CanTpRxWftMax = 15
            CanTpSTmin = 0.02
            CanTpRxNSduRef = FR_DIAG_REQ_PHY_PLANT_oVCAN_RADAR_d1c8c991_Rx
            CanTpTxFcNPdu_ccc91718 (CanTpTxFcNPdu): CanTpTxFcNPduConfirmationPduId=3, CanTpTxFcNPduRef=FR_DIAG_RES_PHY_PLANT_Tp_oVCAN_RADAR_4233d42d_Tx
            CanTpRxNPdu_ccc91718 (CanTpRxNPdu): CanTpRxNPduId=3, CanTpRxNPduRef=FR_DIAG_REQ_PHY_PLANT_Tp_oVCAN_RADAR_bda0e30b_Rx
          CanTpTxNSdu_f984455c (CanTpTxNSdu):
            CanTpTxAddressingFormat = CANTP_STANDARD
            CanTpTxDl = 8
            CanTpTxTaType = CANTP_PHYSICAL
            CanTpNas = 1
            CanTpNcs = 0.01
            CanTpTc = false
            CanTpTxNSduId = 11
            CanTpTxPaddingActivation = CANTP_ON
            CanTpNbs = 1
            CanTpTxNSduRef = FR_DIAG_RES_PHY_PLANT_oVCAN_RADAR_5fef2467_Tx
            CanTpTxNPdu_ee33c3ea (CanTpTxNPdu): CanTpTxNPduConfirmationPduId=3, CanTpTxNPduRef=FR_DIAG_RES_PHY_PLANT_Tp_oVCAN_RADAR_4233d42d_Tx
            CanTpRxFcNPdu_ee33c3ea (CanTpRxFcNPdu): CanTpRxFcNPduId=3, CanTpRxFcNPduRef=FR_DIAG_REQ_PHY_PLANT_Tp_oVCAN_RADAR_bda0e30b_Rx
        TPCH_6508ff58: variation-point=post-build-variant-condition{matching-criterion=RDR_POS, value=6}
          CanTpRxNSdu_761ee134 (CanTpRxNSdu):
            CanTpRxAddressingFormat = CANTP_STANDARD
            CanTpRxDl = 8
            CanTpRxTaType = CANTP_FUNCTIONAL
            CanTpNbr = 0.1
            CanTpRxNSduId = 13
            CanTpRxPaddingActivation = CANTP_ON
            CanTpRxNSduRef = PCAN_DIAG_REQ_FUNC_PLANT_oPCAN_RADAR_20_c17463fa_Rx
            CanTpRxNPdu_83f5a036 (CanTpRxNPdu): CanTpRxNPduId=23, CanTpRxNPduRef=PCAN_DIAG_REQ_FUNC_PLANT_Tp_oPCAN_RADAR_20_d63751cc_Rx
        TPCH_dfb3e9b7: variation-point=post-build-variant-condition{matching-criterion=RDR_POS, value=6}
          CanTpRxNSdu_55a66e29 (CanTpRxNSdu):
            CanTpRxAddressingFormat = CANTP_STANDARD
            CanTpRxDl = 8
            CanTpRxTaType = CANTP_FUNCTIONAL
            CanTpNbr = 0.1
            CanTpRxNSduId = 20
            CanTpRxPaddingActivation = CANTP_ON
            CanTpRxNSduRef = DIAG_REQ_FNC_PLANT_oVCAN_RADAR_42eb2f27_Rx
            CanTpRxNPdu_b34f2acd (CanTpRxNPdu): CanTpRxNPduId=15, CanTpRxNPduRef=DIAG_REQ_FNC_PLANT_Tp_oVCAN_RADAR_d6304422_Rx
        TPCH_90459b58: variation-point=post-build-variant-condition{matching-criterion=RDR_POS, value=6}
          CanTpTxNSdu_0a60edb0 (CanTpTxNSdu):
            CanTpTxAddressingFormat = CANTP_STANDARD
            CanTpTxDl = 64
            CanTpTxTaType = CANTP_CANFD_PHYSICAL
            CanTpNas = 1
            CanTpNcs = 0.01
            CanTpTc = false
            CanTpTxNSduId = 9
            CanTpTxPaddingActivation = CANTP_ON
            CanTpNbs = 1
            CanTpTxNSduRef = PCAN_DIAG_RESP_PHYS_OBD1_oPCAN_RADAR_572eb9fe_Tx
            CanTpTxNPdu_a4aa60a1 (CanTpTxNPdu): CanTpTxNPduConfirmationPduId=4, CanTpTxNPduRef=PCAN_DIAG_RESP_PHYS_OBD1_Tp_oPCAN_RADAR_0aebd6ab_Tx
            CanTpRxFcNPdu_a4aa60a1 (CanTpRxFcNPdu): CanTpRxFcNPduId=4, CanTpRxFcNPduRef=PCAN_DIAG_REQ_PHYS_OBD1_Tp_oPCAN_RADAR_6e232c89_Rx
          CanTpRxNSdu_0a60edb0 (CanTpRxNSdu):
            CanTpRxAddressingFormat = CANTP_STANDARD
            CanTpRxDl = 64
            CanTpRxTaType = CANTP_CANFD_PHYSICAL
            CanTpNbr = 0.01
            CanTpRxNSduId = 15
            CanTpRxPaddingActivation = CANTP_ON
            CanTpBs = 8
            CanTpNar = 1
            CanTpNcr = 1
            CanTpRxWftMax = 15
            CanTpSTmin = 0.02
            CanTpRxNSduRef = PCAN_DIAG_REQ_PHYS_OBD1_oPCAN_RADAR_bb22f7fc_Rx
            CanTpTxFcNPdu_8650b453 (CanTpTxFcNPdu): CanTpTxFcNPduConfirmationPduId=4, CanTpTxFcNPduRef=PCAN_DIAG_RESP_PHYS_OBD1_Tp_oPCAN_RADAR_0aebd6ab_Tx
            CanTpRxNPdu_8650b453 (CanTpRxNPdu): CanTpRxNPduId=4, CanTpRxNPduRef=PCAN_DIAG_REQ_PHYS_OBD1_Tp_oPCAN_RADAR_6e232c89_Rx
        TPCH_38374917: variation-point=post-build-variant-condition{matching-criterion=RDR_POS, value=6}
          CanTpRxNSdu_a9da1dde (CanTpRxNSdu):
            CanTpRxAddressingFormat = CANTP_STANDARD
            CanTpRxDl = 64
            CanTpRxTaType = CANTP_CANFD_FUNCTIONAL
            CanTpNbr = 0.1
            CanTpRxNSduId = 16
            CanTpRxPaddingActivation = CANTP_ON
            CanTpRxNSduRef = PCAN_DIAG_REQ_FUNC_OBD2_oPCAN_RADAR_e2bd2c08_Rx
            CanTpRxNPdu_9d5b4730 (CanTpRxNPdu): CanTpRxNPduId=19, CanTpRxNPduRef=PCAN_DIAG_REQ_FUNC_OBD2_Tp_oPCAN_RADAR_de9265dd_Rx
        TPCH_450d49ee: variation-point=post-build-variant-condition{matching-criterion=RDR_POS, value=6}
          CanTpTxNSdu_605d1a3a (CanTpTxNSdu):
            CanTpTxAddressingFormat = CANTP_STANDARD
            CanTpTxDl = 8
            CanTpTxTaType = CANTP_PHYSICAL
            CanTpNas = 1
            CanTpNcs = 0.01
            CanTpTc = false
            CanTpTxNSduId = 7
            CanTpTxPaddingActivation = CANTP_ON
            CanTpNbs = 1
            CanTpTxNSduRef = PCAN_DIAG_RESP_PHYS_OBD2_oPCAN_RADAR_20_f1bd890a_Tx
            CanTpTxNPdu_10593f38 (CanTpTxNPdu): CanTpTxNPduConfirmationPduId=7, CanTpTxNPduRef=PCAN_DIAG_RESP_PHYS_OBD2_Tp_oPCAN_RADAR_20_25da435e_Tx
            CanTpRxFcNPdu_10593f38 (CanTpRxFcNPdu): CanTpRxFcNPduId=7, CanTpRxFcNPduRef=PCAN_DIAG_REQ_PHYS_OBD2_Tp_oPCAN_RADAR_20_65ff9201_Rx
          CanTpRxNSdu_605d1a3a (CanTpRxNSdu):
            CanTpRxAddressingFormat = CANTP_STANDARD
            CanTpRxDl = 8
            CanTpRxTaType = CANTP_PHYSICAL
            CanTpNbr = 0.01
            CanTpRxNSduId = 10
            CanTpRxPaddingActivation = CANTP_ON
            CanTpBs = 8
            CanTpNar = 1
            CanTpNcr = 1
            CanTpRxWftMax = 15
            CanTpSTmin = 0.02
            CanTpRxNSduRef = PCAN_DIAG_REQ_PHYS_OBD2_oPCAN_RADAR_20_95757328_Rx
            CanTpRxNPdu_32a3ebca (CanTpRxNPdu): CanTpRxNPduId=7, CanTpRxNPduRef=PCAN_DIAG_REQ_PHYS_OBD2_Tp_oPCAN_RADAR_20_65ff9201_Rx
            CanTpTxFcNPdu_32a3ebca (CanTpTxFcNPdu): CanTpTxFcNPduConfirmationPduId=7, CanTpTxFcNPduRef=PCAN_DIAG_RESP_PHYS_OBD2_Tp_oPCAN_RADAR_20_25da435e_Tx
        TPCH_8c560d9a: variation-point=post-build-variant-condition{matching-criterion=RDR_POS, value=6}
          CanTpRxNSdu_9f8c2215 (CanTpRxNSdu):
            CanTpRxAddressingFormat = CANTP_STANDARD
            CanTpRxDl = 8
            CanTpRxTaType = CANTP_FUNCTIONAL
            CanTpNbr = 0.1
            CanTpRxNSduId = 5
            CanTpRxPaddingActivation = CANTP_ON
            CanTpRxNSduRef = PCAN_DIAG_REQ_FUNC_OBD1_oPCAN_RADAR_20_25c43a7c_Rx
            CanTpRxNPdu_b9befcac (CanTpRxNPdu): CanTpRxNPduId=16, CanTpRxNPduRef=PCAN_DIAG_REQ_FUNC_OBD1_Tp_oPCAN_RADAR_20_9397638b_Rx
        TPCH_59a91103: variation-point=post-build-variant-condition{matching-criterion=RDR_POS, value=6}
          CanTpRxNSdu_100f5ca2 (CanTpRxNSdu):
            CanTpRxAddressingFormat = CANTP_STANDARD
            CanTpRxDl = 8
            CanTpRxTaType = CANTP_PHYSICAL
            CanTpNbr = 0.01
            CanTpRxNSduId = 7
            CanTpRxPaddingActivation = CANTP_ON
            CanTpBs = 8
            CanTpNar = 1
            CanTpNcr = 1
            CanTpRxWftMax = 15
            CanTpSTmin = 0.02
            CanTpRxNSduRef = FR_DIAG_REQ_PHY_OTA_oVCAN_RADAR_9187f4da_Rx
            CanTpTxFcNPdu_ea8aa2c0 (CanTpTxFcNPdu): CanTpTxFcNPduConfirmationPduId=2, CanTpTxFcNPduRef=FR_DIAG_RES_PHY_OTA_Tp_oVCAN_RADAR_19b4e511_Tx
            CanTpRxNPdu_ea8aa2c0 (CanTpRxNPdu): CanTpRxNPduId=2, CanTpRxNPduRef=FR_DIAG_REQ_PHY_OTA_Tp_oVCAN_RADAR_4de495d5_Rx
          CanTpTxNSdu_100f5ca2 (CanTpTxNSdu):
            CanTpTxAddressingFormat = CANTP_STANDARD
            CanTpTxDl = 8
            CanTpTxTaType = CANTP_PHYSICAL
            CanTpNas = 1
            CanTpNcs = 0.01
            CanTpTc = false
            CanTpTxNSduId = 4
            CanTpTxPaddingActivation = CANTP_ON
            CanTpNbs = 1
            CanTpTxNSduRef = FR_DIAG_RES_PHY_OTA_oVCAN_RADAR_9ad9d3d9_Tx
            CanTpRxFcNPdu_c8707632 (CanTpRxFcNPdu): CanTpRxFcNPduId=2, CanTpRxFcNPduRef=FR_DIAG_REQ_PHY_OTA_Tp_oVCAN_RADAR_4de495d5_Rx
            CanTpTxNPdu_c8707632 (CanTpTxNPdu): CanTpTxNPduConfirmationPduId=2, CanTpTxNPduRef=FR_DIAG_RES_PHY_OTA_Tp_oVCAN_RADAR_19b4e511_Tx
        TPCH_b1e20644: variation-point=post-build-variant-condition{matching-criterion=RDR_POS, value=6}
          CanTpRxNSdu_d7b9ba5a (CanTpRxNSdu):
            CanTpRxAddressingFormat = CANTP_STANDARD
            CanTpRxDl = 64
            CanTpRxTaType = CANTP_CANFD_FUNCTIONAL
            CanTpNbr = 0.1
            CanTpRxNSduId = 18
            CanTpRxPaddingActivation = CANTP_ON
            CanTpRxNSduRef = PCAN_DIAG_REQ_FUNC_OBD1_oPCAN_RADAR_b9aa9d1d_Rx
            CanTpRxNPdu_889c2a4d (CanTpRxNPdu): CanTpRxNPduId=17, CanTpRxNPduRef=PCAN_DIAG_REQ_FUNC_OBD1_Tp_oPCAN_RADAR_ba721e23_Rx
        TPCH_c5b69e60: variation-point=post-build-variant-condition{matching-criterion=RDR_POS, value=6}
          CanTpRxNSdu_21707157 (CanTpRxNSdu):
            CanTpRxAddressingFormat = CANTP_STANDARD
            CanTpRxDl = 64
            CanTpRxTaType = CANTP_CANFD_FUNCTIONAL
            CanTpNbr = 0.1
            CanTpRxNSduId = 19
            CanTpRxPaddingActivation = CANTP_ON
            CanTpRxNSduRef = PCAN_DIAG_REQ_FUNC_PLANT_oPCAN_RADAR_f6414098_Rx
            CanTpRxNPdu_9fbea91a (CanTpRxNPdu): CanTpRxNPduId=22, CanTpRxNPduRef=PCAN_DIAG_REQ_FUNC_PLANT_Tp_oPCAN_RADAR_5ec247a5_Rx
        TPCH_1c008737: variation-point=post-build-variant-condition{matching-criterion=RDR_POS, value=6}
          CanTpRxNSdu_8ce7f960 (CanTpRxNSdu):
            CanTpRxAddressingFormat = CANTP_STANDARD
            CanTpRxDl = 8
            CanTpRxTaType = CANTP_FUNCTIONAL
            CanTpNbr = 0.1
            CanTpRxNSduId = 0
            CanTpRxPaddingActivation = CANTP_ON
            CanTpRxNSduRef = DIAG_REQ_FNC_OBD2_oVCAN_RADAR_254b3790_Rx
            CanTpRxNPdu_01b31906 (CanTpRxNPdu): CanTpRxNPduId=13, CanTpRxNPduRef=DIAG_REQ_FNC_OBD2_Tp_oVCAN_RADAR_42ec9761_Rx
        TPCH_499a7691: variation-point=post-build-variant-condition{matching-criterion=RDR_POS, value=6}
          CanTpRxNSdu_2bf3c190 (CanTpRxNSdu):
            CanTpRxAddressingFormat = CANTP_STANDARD
            CanTpRxDl = 8
            CanTpRxTaType = CANTP_FUNCTIONAL
            CanTpNbr = 0.1
            CanTpRxNSduId = 11
            CanTpRxPaddingActivation = CANTP_ON
            CanTpRxNSduRef = PCAN_DIAG_REQ_FUNC_OTA_oPCAN_RADAR_20_e1100275_Rx
            CanTpRxNPdu_6ef3cf96 (CanTpRxNPdu): CanTpRxNPduId=21, CanTpRxNPduRef=PCAN_DIAG_REQ_FUNC_OTA_Tp_oPCAN_RADAR_20_0a67f2f6_Rx
        TPCH_85ca75a9: variation-point=post-build-variant-condition{matching-criterion=RDR_POS, value=6}
          CanTpTxNSdu_6816740d (CanTpTxNSdu):
            CanTpTxAddressingFormat = CANTP_STANDARD
            CanTpTxDl = 8
            CanTpTxTaType = CANTP_PHYSICAL
            CanTpNas = 1
            CanTpNcs = 0.01
            CanTpTc = false
            CanTpTxNSduId = 6
            CanTpTxPaddingActivation = CANTP_ON
            CanTpNbs = 1
            CanTpTxNSduRef = FR_DIAG_RES_PHY_OBD1_oVCAN_RADAR_cd47a295_Tx
            CanTpTxNPdu_9d366837 (CanTpTxNPdu): CanTpTxNPduConfirmationPduId=0, CanTpTxNPduRef=FR_DIAG_RES_PHY_OBD1_Tp_oVCAN_RADAR_41a76716_Tx
            CanTpRxFcNPdu_9d366837 (CanTpRxFcNPdu): CanTpRxFcNPduId=0, CanTpRxFcNPduRef=FR_DIAG_REQ_PHY_OBD1_Tp_oVCAN_RADAR_ddfa31cf_Rx
          CanTpRxNSdu_6816740d (CanTpRxNSdu):
            CanTpRxAddressingFormat = CANTP_STANDARD
            CanTpRxDl = 8
            CanTpRxTaType = CANTP_PHYSICAL
            CanTpNbr = 0.01
            CanTpRxNSduId = 9
            CanTpRxPaddingActivation = CANTP_ON
            CanTpBs = 8
            CanTpNar = 1
            CanTpNcr = 1
            CanTpRxWftMax = 15
            CanTpSTmin = 0.02
            CanTpRxNSduRef = FR_DIAG_REQ_PHY_OBD1_oVCAN_RADAR_5445ad08_Rx
            CanTpTxFcNPdu_bfccbcc5 (CanTpTxFcNPdu): CanTpTxFcNPduConfirmationPduId=0, CanTpTxFcNPduRef=FR_DIAG_RES_PHY_OBD1_Tp_oVCAN_RADAR_41a76716_Tx
            CanTpRxNPdu_bfccbcc5 (CanTpRxNPdu): CanTpRxNPduId=0, CanTpRxNPduRef=FR_DIAG_REQ_PHY_OBD1_Tp_oVCAN_RADAR_ddfa31cf_Rx
        TPCH_2735ffd8: variation-point=post-build-variant-condition{matching-criterion=RDR_POS, value=6}
          CanTpRxNSdu_b86f24ed (CanTpRxNSdu):
            CanTpRxAddressingFormat = CANTP_STANDARD
            CanTpRxDl = 8
            CanTpRxTaType = CANTP_FUNCTIONAL
            CanTpNbr = 0.1
            CanTpRxNSduId = 12
            CanTpRxPaddingActivation = CANTP_ON
            CanTpRxNSduRef = DIAG_REQ_FNC_OBD1_oVCAN_RADAR_7e5c8685_Rx
            CanTpRxNPdu_a3c8ef02 (CanTpRxNPdu): CanTpRxNPduId=12, CanTpRxNPduRef=DIAG_REQ_FNC_OBD1_Tp_oVCAN_RADAR_260cec9f_Rx
        TPCH_eda5d2c0: variation-point=post-build-variant-condition{matching-criterion=RDR_POS, value=6}
          CanTpRxNSdu_34d1d4f6 (CanTpRxNSdu):
            CanTpRxAddressingFormat = CANTP_STANDARD
            CanTpRxDl = 8
            CanTpRxTaType = CANTP_FUNCTIONAL
            CanTpNbr = 0.1
            CanTpRxNSduId = 22
            CanTpRxPaddingActivation = CANTP_ON
            CanTpRxNSduRef = PCAN_DIAG_REQ_FUNC_OBD2_oPCAN_RADAR_20_41244182_Rx
            CanTpRxNPdu_4ebc6152 (CanTpRxNPdu): CanTpRxNPduId=18, CanTpRxNPduRef=PCAN_DIAG_REQ_FUNC_OBD2_Tp_oPCAN_RADAR_20_400c7f70_Rx
        TPCH_53908a6f: variation-point=post-build-variant-condition{matching-criterion=RDR_POS, value=6}
          CanTpTxNSdu_055d88c0 (CanTpTxNSdu):
            CanTpTxAddressingFormat = CANTP_STANDARD
            CanTpTxDl = 8
            CanTpTxTaType = CANTP_PHYSICAL
            CanTpNas = 1
            CanTpNcs = 0.01
            CanTpTc = false
            CanTpTxNSduId = 8
            CanTpTxPaddingActivation = CANTP_ON
            CanTpNbs = 1
            CanTpTxNSduRef = PCAN_DIAG_RESP_PHYS_OTA_oPCAN_RADAR_20_a840a80f_Tx
            CanTpTxNPdu_a53ca4c4 (CanTpTxNPdu): CanTpTxNPduConfirmationPduId=8, CanTpTxNPduRef=PCAN_DIAG_RESP_PHYS_OTA_Tp_oPCAN_RADAR_20_6c821aae_Tx
            CanTpRxFcNPdu_a53ca4c4 (CanTpRxFcNPdu): CanTpRxFcNPduId=8, CanTpRxFcNPduRef=PCAN_DIAG_REQ_PHYS_OTA_Tp_oPCAN_RADAR_20_96582344_Rx
          CanTpRxNSdu_055d88c0 (CanTpRxNSdu):
            CanTpRxAddressingFormat = CANTP_STANDARD
            CanTpRxDl = 8
            CanTpRxTaType = CANTP_PHYSICAL
            CanTpNbr = 0.01
            CanTpRxNSduId = 14
            CanTpRxPaddingActivation = CANTP_ON
            CanTpBs = 8
            CanTpNar = 1
            CanTpNcr = 1
            CanTpRxWftMax = 15
            CanTpSTmin = 0.02
            CanTpRxNSduRef = PCAN_DIAG_REQ_PHYS_OTA_oPCAN_RADAR_20_0b124a16_Rx
            CanTpTxFcNPdu_87c67036 (CanTpTxFcNPdu): CanTpTxFcNPduConfirmationPduId=8, CanTpTxFcNPduRef=PCAN_DIAG_RESP_PHYS_OTA_Tp_oPCAN_RADAR_20_6c821aae_Tx
            CanTpRxNPdu_87c67036 (CanTpRxNPdu): CanTpRxNPduId=8, CanTpRxNPduRef=PCAN_DIAG_REQ_PHYS_OTA_Tp_oPCAN_RADAR_20_96582344_Rx
        TPCH_4d82b2f1: variation-point=post-build-variant-condition{matching-criterion=RDR_POS, value=6}
          CanTpRxNSdu_1be7398e (CanTpRxNSdu):
            CanTpRxAddressingFormat = CANTP_STANDARD
            CanTpRxDl = 64
            CanTpRxTaType = CANTP_CANFD_PHYSICAL
            CanTpNbr = 0.01
            CanTpRxNSduId = 2
            CanTpRxPaddingActivation = CANTP_ON
            CanTpBs = 8
            CanTpNar = 1
            CanTpNcr = 1
            CanTpRxWftMax = 15
            CanTpSTmin = 0.02
            CanTpRxNSduRef = PCAN_DIAG_REQ_PHYS_OBD2_oPCAN_RADAR_e03546e9_Rx
            CanTpRxNPdu_7c60d701 (CanTpRxNPdu): CanTpRxNPduId=6, CanTpRxNPduRef=PCAN_DIAG_REQ_PHYS_OBD2_Tp_oPCAN_RADAR_0ac35777_Rx
            CanTpTxFcNPdu_7c60d701 (CanTpTxFcNPdu): CanTpTxFcNPduConfirmationPduId=6, CanTpTxFcNPduRef=PCAN_DIAG_RESP_PHYS_OBD2_Tp_oPCAN_RADAR_6e0bad55_Tx
          CanTpTxNSdu_1be7398e (CanTpTxNSdu):
            CanTpTxAddressingFormat = CANTP_STANDARD
            CanTpTxDl = 64
            CanTpTxTaType = CANTP_CANFD_PHYSICAL
            CanTpNas = 1
            CanTpNcs = 0.01
            CanTpTc = false
            CanTpTxNSduId = 1
            CanTpTxPaddingActivation = CANTP_ON
            CanTpNbs = 1
            CanTpTxNSduRef = PCAN_DIAG_RESP_PHYS_OBD2_oPCAN_RADAR_0c3908eb_Tx
            CanTpRxFcNPdu_5e9a03f3 (CanTpRxFcNPdu): CanTpRxFcNPduId=6, CanTpRxFcNPduRef=PCAN_DIAG_REQ_PHYS_OBD2_Tp_oPCAN_RADAR_0ac35777_Rx
            CanTpTxNPdu_5e9a03f3 (CanTpTxNPdu): CanTpTxNPduConfirmationPduId=6, CanTpTxNPduRef=PCAN_DIAG_RESP_PHYS_OBD2_Tp_oPCAN_RADAR_6e0bad55_Tx
        TPCH_e36ae308: variation-point=post-build-variant-condition{matching-criterion=RDR_POS, value=6}
          CanTpRxNSdu_2888d97c (CanTpRxNSdu):
            CanTpRxAddressingFormat = CANTP_STANDARD
            CanTpRxDl = 8
            CanTpRxTaType = CANTP_PHYSICAL
            CanTpNbr = 0.01
            CanTpRxNSduId = 21
            CanTpRxPaddingActivation = CANTP_ON
            CanTpBs = 8
            CanTpNar = 1
            CanTpNcr = 1
            CanTpRxWftMax = 15
            CanTpSTmin = 0.02
            CanTpRxNSduRef = PCAN_DIAG_REQ_PHYS_PLANT_oPCAN_RADAR_20_f7a3783e_Rx
            CanTpRxNPdu_74140790 (CanTpRxNPdu): CanTpRxNPduId=10, CanTpRxNPduRef=PCAN_DIAG_REQ_PHYS_PLANT_Tp_oPCAN_RADAR_20_f110e38b_Rx
            CanTpTxFcNPdu_74140790 (CanTpTxFcNPdu): CanTpTxFcNPduConfirmationPduId=10, CanTpTxFcNPduRef=PCAN_DIAG_RESP_PHYS_PLANT_Tp_oPCAN_RADAR_20_0a848a3f_Tx
          CanTpTxNSdu_2888d97c (CanTpTxNSdu):
            CanTpTxAddressingFormat = CANTP_STANDARD
            CanTpTxDl = 8
            CanTpTxTaType = CANTP_PHYSICAL
            CanTpNas = 1
            CanTpNcs = 0.01
            CanTpTc = false
            CanTpTxNSduId = 10
            CanTpTxPaddingActivation = CANTP_ON
            CanTpNbs = 1
            CanTpTxNSduRef = PCAN_DIAG_RESP_PHYS_PLANT_oPCAN_RADAR_20_22a7f120_Tx
            CanTpRxFcNPdu_56eed362 (CanTpRxFcNPdu): CanTpRxFcNPduId=10, CanTpRxFcNPduRef=PCAN_DIAG_REQ_PHYS_PLANT_Tp_oPCAN_RADAR_20_f110e38b_Rx
            CanTpTxNPdu_56eed362 (CanTpTxNPdu): CanTpTxNPduConfirmationPduId=10, CanTpTxNPduRef=PCAN_DIAG_RESP_PHYS_PLANT_Tp_oPCAN_RADAR_20_0a848a3f_Tx
        TPCH_2d51cedc: variation-point=post-build-variant-condition{matching-criterion=RDR_POS, value=6}
          CanTpTxNSdu_40aa540d (CanTpTxNSdu):
            CanTpTxAddressingFormat = CANTP_STANDARD
            CanTpTxDl = 64
            CanTpTxTaType = CANTP_CANFD_PHYSICAL
            CanTpNas = 1
            CanTpNcs = 0.01
            CanTpTc = false
            CanTpTxNSduId = 0
            CanTpTxPaddingActivation = CANTP_ON
            CanTpNbs = 1
            CanTpTxNSduRef = PCAN_DIAG_RESP_PHYS_OTA_oPCAN_RADAR_2a569d3c_Tx
            CanTpTxNPdu_dfbd3194 (CanTpTxNPdu): CanTpTxNPduConfirmationPduId=9, CanTpTxNPduRef=PCAN_DIAG_RESP_PHYS_OTA_Tp_oPCAN_RADAR_37f68c50_Tx
            CanTpRxFcNPdu_dfbd3194 (CanTpRxFcNPdu): CanTpRxFcNPduId=9, CanTpRxFcNPduRef=PCAN_DIAG_REQ_PHYS_OTA_Tp_oPCAN_RADAR_94a46e49_Rx
          CanTpRxNSdu_40aa540d (CanTpRxNSdu):
            CanTpRxAddressingFormat = CANTP_STANDARD
            CanTpRxDl = 64
            CanTpRxTaType = CANTP_CANFD_PHYSICAL
            CanTpNbr = 0.01
            CanTpRxNSduId = 1
            CanTpRxPaddingActivation = CANTP_ON
            CanTpBs = 8
            CanTpNar = 1
            CanTpNcr = 1
            CanTpRxWftMax = 15
            CanTpSTmin = 0.02
            CanTpRxNSduRef = PCAN_DIAG_REQ_PHYS_OTA_oPCAN_RADAR_45eab9fd_Rx
            CanTpRxNPdu_fd47e566 (CanTpRxNPdu): CanTpRxNPduId=9, CanTpRxNPduRef=PCAN_DIAG_REQ_PHYS_OTA_Tp_oPCAN_RADAR_94a46e49_Rx
            CanTpTxFcNPdu_fd47e566 (CanTpTxFcNPdu): CanTpTxFcNPduConfirmationPduId=9, CanTpTxFcNPduRef=PCAN_DIAG_RESP_PHYS_OTA_Tp_oPCAN_RADAR_37f68c50_Tx
        TPCH_e4ad5157: variation-point=post-build-variant-condition{matching-criterion=RDR_POS, value=7}
          CanTpRxNSdu_110562d5 (CanTpRxNSdu):
            CanTpRxAddressingFormat = CANTP_STANDARD
            CanTpRxDl = 64
            CanTpRxTaType = CANTP_CANFD_FUNCTIONAL
            CanTpNbr = 0.1
            CanTpRxNSduId = 21
            CanTpRxPaddingActivation = CANTP_ON
            CanTpRxNSduRef = PCAN_DIAG_REQ_FUNC_OBD2_oPCAN_RADAR_e2bd2c08_Rx
            CanTpRxNPdu_9f3977a1 (CanTpRxNPdu): CanTpRxNPduId=19, CanTpRxNPduRef=PCAN_DIAG_REQ_FUNC_OBD2_Tp_oPCAN_RADAR_de9265dd_Rx
        TPCH_a8a24a8e: variation-point=post-build-variant-condition{matching-criterion=RDR_POS, value=7}
          CanTpTxNSdu_01773b70 (CanTpTxNSdu):
            CanTpTxAddressingFormat = CANTP_STANDARD
            CanTpTxDl = 8
            CanTpTxTaType = CANTP_PHYSICAL
            CanTpNas = 1
            CanTpNcs = 0.01
            CanTpTc = false
            CanTpTxNSduId = 7
            CanTpTxPaddingActivation = CANTP_ON
            CanTpNbs = 1
            CanTpTxNSduRef = FR_DIAG_RES_PHY_OTA_oVCAN_RADAR_9ad9d3d9_Tx
            CanTpRxFcNPdu_8b31c6c9 (CanTpRxFcNPdu): CanTpRxFcNPduId=2, CanTpRxFcNPduRef=FR_DIAG_REQ_PHY_OTA_Tp_oVCAN_RADAR_4de495d5_Rx
            CanTpTxNPdu_8b31c6c9 (CanTpTxNPdu): CanTpTxNPduConfirmationPduId=2, CanTpTxNPduRef=FR_DIAG_RES_PHY_OTA_Tp_oVCAN_RADAR_19b4e511_Tx
          CanTpRxNSdu_01773b70 (CanTpRxNSdu):
            CanTpRxAddressingFormat = CANTP_STANDARD
            CanTpRxDl = 8
            CanTpRxTaType = CANTP_PHYSICAL
            CanTpNbr = 0.01
            CanTpRxNSduId = 16
            CanTpRxPaddingActivation = CANTP_ON
            CanTpBs = 8
            CanTpNar = 1
            CanTpNcr = 1
            CanTpRxWftMax = 15
            CanTpSTmin = 0.02
            CanTpRxNSduRef = FR_DIAG_REQ_PHY_OTA_oVCAN_RADAR_9187f4da_Rx
            CanTpRxNPdu_a9cb123b (CanTpRxNPdu): CanTpRxNPduId=2, CanTpRxNPduRef=FR_DIAG_REQ_PHY_OTA_Tp_oVCAN_RADAR_4de495d5_Rx
            CanTpTxFcNPdu_a9cb123b (CanTpTxFcNPdu): CanTpTxFcNPduConfirmationPduId=2, CanTpTxFcNPduRef=FR_DIAG_RES_PHY_OTA_Tp_oVCAN_RADAR_19b4e511_Tx
        TPCH_1261b885: variation-point=post-build-variant-condition{matching-criterion=RDR_POS, value=7}
          CanTpTxNSdu_406ac1d2 (CanTpTxNSdu):
            CanTpTxAddressingFormat = CANTP_STANDARD
            CanTpTxDl = 8
            CanTpTxTaType = CANTP_PHYSICAL
            CanTpNas = 1
            CanTpNcs = 0.01
            CanTpTc = false
            CanTpTxNSduId = 6
            CanTpTxPaddingActivation = CANTP_ON
            CanTpNbs = 1
            CanTpTxNSduRef = PCAN_DIAG_RESP_PHYS_PLANT_oPCAN_RADAR_20_22a7f120_Tx
            CanTpTxNPdu_cc43b521 (CanTpTxNPdu): CanTpTxNPduConfirmationPduId=10, CanTpTxNPduRef=PCAN_DIAG_RESP_PHYS_PLANT_Tp_oPCAN_RADAR_20_0a848a3f_Tx
            CanTpRxFcNPdu_cc43b521 (CanTpRxFcNPdu): CanTpRxFcNPduId=10, CanTpRxFcNPduRef=PCAN_DIAG_REQ_PHYS_PLANT_Tp_oPCAN_RADAR_20_f110e38b_Rx
          CanTpRxNSdu_406ac1d2 (CanTpRxNSdu):
            CanTpRxAddressingFormat = CANTP_STANDARD
            CanTpRxDl = 8
            CanTpRxTaType = CANTP_PHYSICAL
            CanTpNbr = 0.01
            CanTpRxNSduId = 15
            CanTpRxPaddingActivation = CANTP_ON
            CanTpBs = 8
            CanTpNar = 1
            CanTpNcr = 1
            CanTpRxWftMax = 15
            CanTpSTmin = 0.02
            CanTpRxNSduRef = PCAN_DIAG_REQ_PHYS_PLANT_oPCAN_RADAR_20_f7a3783e_Rx
            CanTpRxNPdu_eeb961d3 (CanTpRxNPdu): CanTpRxNPduId=10, CanTpRxNPduRef=PCAN_DIAG_REQ_PHYS_PLANT_Tp_oPCAN_RADAR_20_f110e38b_Rx
            CanTpTxFcNPdu_eeb961d3 (CanTpTxFcNPdu): CanTpTxFcNPduConfirmationPduId=10, CanTpTxFcNPduRef=PCAN_DIAG_RESP_PHYS_PLANT_Tp_oPCAN_RADAR_20_0a848a3f_Tx
        TPCH_179c6029: variation-point=post-build-variant-condition{matching-criterion=RDR_POS, value=7}
          CanTpRxNSdu_18f2ade7 (CanTpRxNSdu):
            CanTpRxAddressingFormat = CANTP_STANDARD
            CanTpRxDl = 8
            CanTpRxTaType = CANTP_FUNCTIONAL
            CanTpNbr = 0.1
            CanTpRxNSduId = 12
            CanTpRxPaddingActivation = CANTP_ON
            CanTpRxNSduRef = PCAN_DIAG_REQ_FUNC_PLANT_oPCAN_RADAR_20_c17463fa_Rx
            CanTpRxNPdu_e1347c6e (CanTpRxNPdu): CanTpRxNPduId=23, CanTpRxNPduRef=PCAN_DIAG_REQ_FUNC_PLANT_Tp_oPCAN_RADAR_20_d63751cc_Rx
        TPCH_192c8620: variation-point=post-build-variant-condition{matching-criterion=RDR_POS, value=7}
          CanTpRxNSdu_bf84955c (CanTpRxNSdu):
            CanTpRxAddressingFormat = CANTP_STANDARD
            CanTpRxDl = 64
            CanTpRxTaType = CANTP_CANFD_FUNCTIONAL
            CanTpNbr = 0.1
            CanTpRxNSduId = 13
            CanTpRxPaddingActivation = CANTP_ON
            CanTpRxNSduRef = PCAN_DIAG_REQ_FUNC_PLANT_oPCAN_RADAR_f6414098_Rx
            CanTpRxNPdu_654adf9b (CanTpRxNPdu): CanTpRxNPduId=22, CanTpRxNPduRef=PCAN_DIAG_REQ_FUNC_PLANT_Tp_oPCAN_RADAR_5ec247a5_Rx
        TPCH_311dc2d0: variation-point=post-build-variant-condition{matching-criterion=RDR_POS, value=7}
          CanTpRxNSdu_0d1ea855 (CanTpRxNSdu):
            CanTpRxAddressingFormat = CANTP_STANDARD
            CanTpRxDl = 64
            CanTpRxTaType = CANTP_CANFD_PHYSICAL
            CanTpNbr = 0.01
            CanTpRxNSduId = 14
            CanTpRxPaddingActivation = CANTP_ON
            CanTpBs = 8
            CanTpNar = 1
            CanTpNcr = 1
            CanTpRxWftMax = 15
            CanTpSTmin = 0.02
            CanTpRxNSduRef = PCAN_DIAG_REQ_PHYS_OBD2_oPCAN_RADAR_e03546e9_Rx
            CanTpRxNPdu_999c2b0a (CanTpRxNPdu): CanTpRxNPduId=6, CanTpRxNPduRef=PCAN_DIAG_REQ_PHYS_OBD2_Tp_oPCAN_RADAR_0ac35777_Rx
            CanTpTxFcNPdu_999c2b0a (CanTpTxFcNPdu): CanTpTxFcNPduConfirmationPduId=6, CanTpTxFcNPduRef=PCAN_DIAG_RESP_PHYS_OBD2_Tp_oPCAN_RADAR_6e0bad55_Tx
          CanTpTxNSdu_0d1ea855 (CanTpTxNSdu):
            CanTpTxAddressingFormat = CANTP_STANDARD
            CanTpTxDl = 64
            CanTpTxTaType = CANTP_CANFD_PHYSICAL
            CanTpNas = 1
            CanTpNcs = 0.01
            CanTpTc = false
            CanTpTxNSduId = 5
            CanTpTxPaddingActivation = CANTP_ON
            CanTpNbs = 1
            CanTpTxNSduRef = PCAN_DIAG_RESP_PHYS_OBD2_oPCAN_RADAR_0c3908eb_Tx
            CanTpRxFcNPdu_bb66fff8 (CanTpRxFcNPdu): CanTpRxFcNPduId=6, CanTpRxFcNPduRef=PCAN_DIAG_REQ_PHYS_OBD2_Tp_oPCAN_RADAR_0ac35777_Rx
            CanTpTxNPdu_bb66fff8 (CanTpTxNPdu): CanTpTxNPduConfirmationPduId=6, CanTpTxNPduRef=PCAN_DIAG_RESP_PHYS_OBD2_Tp_oPCAN_RADAR_6e0bad55_Tx
        TPCH_a29bd1e2: variation-point=post-build-variant-condition{matching-criterion=RDR_POS, value=7}
          CanTpTxNSdu_2062e733 (CanTpTxNSdu):
            CanTpTxAddressingFormat = CANTP_STANDARD
            CanTpTxDl = 8
            CanTpTxTaType = CANTP_PHYSICAL
            CanTpNas = 1
            CanTpNcs = 0.01
            CanTpTc = false
            CanTpTxNSduId = 8
            CanTpTxPaddingActivation = CANTP_ON
            CanTpNbs = 1
            CanTpTxNSduRef = PCAN_DIAG_RESP_PHYS_OTA_oPCAN_RADAR_20_a840a80f_Tx
            CanTpRxFcNPdu_6871bfc9 (CanTpRxFcNPdu): CanTpRxFcNPduId=8, CanTpRxFcNPduRef=PCAN_DIAG_REQ_PHYS_OTA_Tp_oPCAN_RADAR_20_96582344_Rx
            CanTpTxNPdu_6871bfc9 (CanTpTxNPdu): CanTpTxNPduConfirmationPduId=8, CanTpTxNPduRef=PCAN_DIAG_RESP_PHYS_OTA_Tp_oPCAN_RADAR_20_6c821aae_Tx
          CanTpRxNSdu_2062e733 (CanTpRxNSdu):
            CanTpRxAddressingFormat = CANTP_STANDARD
            CanTpRxDl = 8
            CanTpRxTaType = CANTP_PHYSICAL
            CanTpNbr = 0.01
            CanTpRxNSduId = 17
            CanTpRxPaddingActivation = CANTP_ON
            CanTpBs = 8
            CanTpNar = 1
            CanTpNcr = 1
            CanTpRxWftMax = 15
            CanTpSTmin = 0.02
            CanTpRxNSduRef = PCAN_DIAG_REQ_PHYS_OTA_oPCAN_RADAR_20_0b124a16_Rx
            CanTpTxFcNPdu_4a8b6b3b (CanTpTxFcNPdu): CanTpTxFcNPduConfirmationPduId=8, CanTpTxFcNPduRef=PCAN_DIAG_RESP_PHYS_OTA_Tp_oPCAN_RADAR_20_6c821aae_Tx
            CanTpRxNPdu_4a8b6b3b (CanTpRxNPdu): CanTpRxNPduId=8, CanTpRxNPduRef=PCAN_DIAG_REQ_PHYS_OTA_Tp_oPCAN_RADAR_20_96582344_Rx
        TPCH_ecdaeb79: variation-point=post-build-variant-condition{matching-criterion=RDR_POS, value=7}
          CanTpRxNSdu_1f237be1 (CanTpRxNSdu):
            CanTpRxAddressingFormat = CANTP_STANDARD
            CanTpRxDl = 64
            CanTpRxTaType = CANTP_CANFD_PHYSICAL
            CanTpNbr = 0.01
            CanTpRxNSduId = 22
            CanTpRxPaddingActivation = CANTP_ON
            CanTpBs = 8
            CanTpNar = 1
            CanTpNcr = 1
            CanTpRxWftMax = 15
            CanTpSTmin = 0.02
            CanTpRxNSduRef = PCAN_DIAG_REQ_PHYS_OBD1_oPCAN_RADAR_bb22f7fc_Rx
            CanTpTxFcNPdu_056f526e (CanTpTxFcNPdu): CanTpTxFcNPduConfirmationPduId=4, CanTpTxFcNPduRef=PCAN_DIAG_RESP_PHYS_OBD1_Tp_oPCAN_RADAR_0aebd6ab_Tx
            CanTpRxNPdu_056f526e (CanTpRxNPdu): CanTpRxNPduId=4, CanTpRxNPduRef=PCAN_DIAG_REQ_PHYS_OBD1_Tp_oPCAN_RADAR_6e232c89_Rx
          CanTpTxNSdu_1f237be1 (CanTpTxNSdu):
            CanTpTxAddressingFormat = CANTP_STANDARD
            CanTpTxDl = 64
            CanTpTxTaType = CANTP_CANFD_PHYSICAL
            CanTpNas = 1
            CanTpNcs = 0.01
            CanTpTc = false
            CanTpTxNSduId = 11
            CanTpTxPaddingActivation = CANTP_ON
            CanTpNbs = 1
            CanTpTxNSduRef = PCAN_DIAG_RESP_PHYS_OBD1_oPCAN_RADAR_572eb9fe_Tx
            CanTpRxFcNPdu_2795869c (CanTpRxFcNPdu): CanTpRxFcNPduId=4, CanTpRxFcNPduRef=PCAN_DIAG_REQ_PHYS_OBD1_Tp_oPCAN_RADAR_6e232c89_Rx
            CanTpTxNPdu_2795869c (CanTpTxNPdu): CanTpTxNPduConfirmationPduId=4, CanTpTxNPduRef=PCAN_DIAG_RESP_PHYS_OBD1_Tp_oPCAN_RADAR_0aebd6ab_Tx
        TPCH_6d781e04: variation-point=post-build-variant-condition{matching-criterion=RDR_POS, value=7}
          CanTpRxNSdu_cee402a3 (CanTpRxNSdu):
            CanTpRxAddressingFormat = CANTP_STANDARD
            CanTpRxDl = 64
            CanTpRxTaType = CANTP_CANFD_FUNCTIONAL
            CanTpNbr = 0.1
            CanTpRxNSduId = 2
            CanTpRxPaddingActivation = CANTP_ON
            CanTpRxNSduRef = PCAN_DIAG_REQ_FUNC_OBD1_oPCAN_RADAR_b9aa9d1d_Rx
            CanTpRxNPdu_944dd35d (CanTpRxNPdu): CanTpRxNPduId=17, CanTpRxNPduRef=PCAN_DIAG_REQ_FUNC_OBD1_Tp_oPCAN_RADAR_ba721e23_Rx
        TPCH_74c12e24: variation-point=post-build-variant-condition{matching-criterion=RDR_POS, value=7}
          CanTpTxNSdu_9b170e76 (CanTpTxNSdu):
            CanTpTxAddressingFormat = CANTP_STANDARD
            CanTpTxDl = 8
            CanTpTxTaType = CANTP_PHYSICAL
            CanTpNas = 1
            CanTpNcs = 0.01
            CanTpTc = false
            CanTpTxNSduId = 4
            CanTpTxPaddingActivation = CANTP_ON
            CanTpNbs = 1
            CanTpTxNSduRef = FR_DIAG_RES_PHY_OBD1_oVCAN_RADAR_cd47a295_Tx
            CanTpTxNPdu_70cf1a56 (CanTpTxNPdu): CanTpTxNPduConfirmationPduId=0, CanTpTxNPduRef=FR_DIAG_RES_PHY_OBD1_Tp_oVCAN_RADAR_41a76716_Tx
            CanTpRxFcNPdu_70cf1a56 (CanTpRxFcNPdu): CanTpRxFcNPduId=0, CanTpRxFcNPduRef=FR_DIAG_REQ_PHY_OBD1_Tp_oVCAN_RADAR_ddfa31cf_Rx
          CanTpRxNSdu_9b170e76 (CanTpRxNSdu):
            CanTpRxAddressingFormat = CANTP_STANDARD
            CanTpRxDl = 8
            CanTpRxTaType = CANTP_PHYSICAL
            CanTpNbr = 0.01
            CanTpRxNSduId = 10
            CanTpRxPaddingActivation = CANTP_ON
            CanTpBs = 8
            CanTpNar = 1
            CanTpNcr = 1
            CanTpRxWftMax = 15
            CanTpSTmin = 0.02
            CanTpRxNSduRef = FR_DIAG_REQ_PHY_OBD1_oVCAN_RADAR_5445ad08_Rx
            CanTpTxFcNPdu_5235cea4 (CanTpTxFcNPdu): CanTpTxFcNPduConfirmationPduId=0, CanTpTxFcNPduRef=FR_DIAG_RES_PHY_OBD1_Tp_oVCAN_RADAR_41a76716_Tx
            CanTpRxNPdu_5235cea4 (CanTpRxNPdu): CanTpRxNPduId=0, CanTpRxNPduRef=FR_DIAG_REQ_PHY_OBD1_Tp_oVCAN_RADAR_ddfa31cf_Rx
        TPCH_55a160a9: variation-point=post-build-variant-condition{matching-criterion=RDR_POS, value=7}
          CanTpRxNSdu_38bfaa92 (CanTpRxNSdu):
            CanTpRxAddressingFormat = CANTP_STANDARD
            CanTpRxDl = 8
            CanTpRxTaType = CANTP_FUNCTIONAL
            CanTpNbr = 0.1
            CanTpRxNSduId = 8
            CanTpRxPaddingActivation = CANTP_ON
            CanTpRxNSduRef = DIAG_REQ_FNC_OBD1_oVCAN_RADAR_7e5c8685_Rx
            CanTpRxNPdu_f673eb66 (CanTpRxNPdu): CanTpRxNPduId=12, CanTpRxNPduRef=DIAG_REQ_FNC_OBD1_Tp_oVCAN_RADAR_260cec9f_Rx
        TPCH_fec292eb: variation-point=post-build-variant-condition{matching-criterion=RDR_POS, value=7}
          CanTpRxNSdu_0999e59b (CanTpRxNSdu):
            CanTpRxAddressingFormat = CANTP_STANDARD
            CanTpRxDl = 8
            CanTpRxTaType = CANTP_FUNCTIONAL
            CanTpNbr = 0.1
            CanTpRxNSduId = 23
            CanTpRxPaddingActivation = CANTP_ON
            CanTpRxNSduRef = PCAN_DIAG_REQ_FUNC_OBD1_oPCAN_RADAR_20_25c43a7c_Rx
            CanTpRxNPdu_599d72c1 (CanTpRxNPdu): CanTpRxNPduId=16, CanTpRxNPduRef=PCAN_DIAG_REQ_FUNC_OBD1_Tp_oPCAN_RADAR_20_9397638b_Rx
        TPCH_51cebefd: variation-point=post-build-variant-condition{matching-criterion=RDR_POS, value=7}
          CanTpTxNSdu_382889a1 (CanTpTxNSdu):
            CanTpTxAddressingFormat = CANTP_STANDARD
            CanTpTxDl = 64
            CanTpTxTaType = CANTP_CANFD_PHYSICAL
            CanTpNas = 1
            CanTpNcs = 0.01
            CanTpTc = false
            CanTpTxNSduId = 2
            CanTpTxPaddingActivation = CANTP_ON
            CanTpNbs = 1
            CanTpTxNSduRef = PCAN_DIAG_RESP_PHYS_OTA_oPCAN_RADAR_2a569d3c_Tx
            CanTpRxFcNPdu_b1ef3f08 (CanTpRxFcNPdu): CanTpRxFcNPduId=9, CanTpRxFcNPduRef=PCAN_DIAG_REQ_PHYS_OTA_Tp_oPCAN_RADAR_94a46e49_Rx
            CanTpTxNPdu_b1ef3f08 (CanTpTxNPdu): CanTpTxNPduConfirmationPduId=9, CanTpTxNPduRef=PCAN_DIAG_RESP_PHYS_OTA_Tp_oPCAN_RADAR_37f68c50_Tx
          CanTpRxNSdu_382889a1 (CanTpRxNSdu):
            CanTpRxAddressingFormat = CANTP_STANDARD
            CanTpRxDl = 64
            CanTpRxTaType = CANTP_CANFD_PHYSICAL
            CanTpNbr = 0.01
            CanTpRxNSduId = 7
            CanTpRxPaddingActivation = CANTP_ON
            CanTpBs = 8
            CanTpNar = 1
            CanTpNcr = 1
            CanTpRxWftMax = 15
            CanTpSTmin = 0.02
            CanTpRxNSduRef = PCAN_DIAG_REQ_PHYS_OTA_oPCAN_RADAR_45eab9fd_Rx
            CanTpTxFcNPdu_9315ebfa (CanTpTxFcNPdu): CanTpTxFcNPduConfirmationPduId=9, CanTpTxFcNPduRef=PCAN_DIAG_RESP_PHYS_OTA_Tp_oPCAN_RADAR_37f68c50_Tx
            CanTpRxNPdu_9315ebfa (CanTpRxNPdu): CanTpRxNPduId=9, CanTpRxNPduRef=PCAN_DIAG_REQ_PHYS_OTA_Tp_oPCAN_RADAR_94a46e49_Rx
        TPCH_9f314db1: variation-point=post-build-variant-condition{matching-criterion=RDR_POS, value=7}
          CanTpRxNSdu_d821701d (CanTpRxNSdu):
            CanTpRxAddressingFormat = CANTP_STANDARD
            CanTpRxDl = 8
            CanTpRxTaType = CANTP_FUNCTIONAL
            CanTpNbr = 0.1
            CanTpRxNSduId = 5
            CanTpRxPaddingActivation = CANTP_ON
            CanTpRxNSduRef = PCAN_DIAG_REQ_FUNC_OBD2_oPCAN_RADAR_20_41244182_Rx
            CanTpRxNPdu_25164214 (CanTpRxNPdu): CanTpRxNPduId=18, CanTpRxNPduRef=PCAN_DIAG_REQ_FUNC_OBD2_Tp_oPCAN_RADAR_20_400c7f70_Rx
        TPCH_ad2776c6: variation-point=post-build-variant-condition{matching-criterion=RDR_POS, value=7}
          CanTpRxNSdu_77935e90 (CanTpRxNSdu):
            CanTpRxAddressingFormat = CANTP_STANDARD
            CanTpRxDl = 8
            CanTpRxTaType = CANTP_FUNCTIONAL
            CanTpNbr = 0.1
            CanTpRxNSduId = 18
            CanTpRxPaddingActivation = CANTP_ON
            CanTpRxNSduRef = DIAG_REQ_FNC_PLANT_oVCAN_RADAR_42eb2f27_Rx
            CanTpRxNPdu_3b063fb4 (CanTpRxNPdu): CanTpRxNPduId=15, CanTpRxNPduRef=DIAG_REQ_FNC_PLANT_Tp_oVCAN_RADAR_d6304422_Rx
        TPCH_1e038e34: variation-point=post-build-variant-condition{matching-criterion=RDR_POS, value=7}
          CanTpRxNSdu_5ea61dee (CanTpRxNSdu):
            CanTpRxAddressingFormat = CANTP_STANDARD
            CanTpRxDl = 8
            CanTpRxTaType = CANTP_PHYSICAL
            CanTpNbr = 0.01
            CanTpRxNSduId = 0
            CanTpRxPaddingActivation = CANTP_ON
            CanTpBs = 8
            CanTpNar = 1
            CanTpNcr = 1
            CanTpRxWftMax = 15
            CanTpSTmin = 0.02
            CanTpRxNSduRef = FR_DIAG_REQ_PHY_PLANT_oVCAN_RADAR_d1c8c991_Rx
            CanTpTxFcNPdu_a9a1742e (CanTpTxFcNPdu): CanTpTxFcNPduConfirmationPduId=3, CanTpTxFcNPduRef=FR_DIAG_RES_PHY_PLANT_Tp_oVCAN_RADAR_4233d42d_Tx
            CanTpRxNPdu_a9a1742e (CanTpRxNPdu): CanTpRxNPduId=3, CanTpRxNPduRef=FR_DIAG_REQ_PHY_PLANT_Tp_oVCAN_RADAR_bda0e30b_Rx
          CanTpTxNSdu_5ea61dee (CanTpTxNSdu):
            CanTpTxAddressingFormat = CANTP_STANDARD
            CanTpTxDl = 8
            CanTpTxTaType = CANTP_PHYSICAL
            CanTpNas = 1
            CanTpNcs = 0.01
            CanTpTc = false
            CanTpTxNSduId = 0
            CanTpTxPaddingActivation = CANTP_ON
            CanTpNbs = 1
            CanTpTxNSduRef = FR_DIAG_RES_PHY_PLANT_oVCAN_RADAR_5fef2467_Tx
            CanTpTxNPdu_8b5ba0dc (CanTpTxNPdu): CanTpTxNPduConfirmationPduId=3, CanTpTxNPduRef=FR_DIAG_RES_PHY_PLANT_Tp_oVCAN_RADAR_4233d42d_Tx
            CanTpRxFcNPdu_8b5ba0dc (CanTpRxFcNPdu): CanTpRxFcNPduId=3, CanTpRxFcNPduRef=FR_DIAG_REQ_PHY_PLANT_Tp_oVCAN_RADAR_bda0e30b_Rx
        TPCH_b4061263: variation-point=post-build-variant-condition{matching-criterion=RDR_POS, value=7}
          CanTpRxNSdu_3fa592e1 (CanTpRxNSdu):
            CanTpRxAddressingFormat = CANTP_STANDARD
            CanTpRxDl = 8
            CanTpRxTaType = CANTP_PHYSICAL
            CanTpNbr = 0.01
            CanTpRxNSduId = 20
            CanTpRxPaddingActivation = CANTP_ON
            CanTpBs = 8
            CanTpNar = 1
            CanTpNcr = 1
            CanTpRxWftMax = 15
            CanTpSTmin = 0.02
            CanTpRxNSduRef = PCAN_DIAG_REQ_PHYS_OBD2_oPCAN_RADAR_20_95757328_Rx
            CanTpRxNPdu_28b1b5df (CanTpRxNPdu): CanTpRxNPduId=7, CanTpRxNPduRef=PCAN_DIAG_REQ_PHYS_OBD2_Tp_oPCAN_RADAR_20_65ff9201_Rx
            CanTpTxFcNPdu_28b1b5df (CanTpTxFcNPdu): CanTpTxFcNPduConfirmationPduId=7, CanTpTxFcNPduRef=PCAN_DIAG_RESP_PHYS_OBD2_Tp_oPCAN_RADAR_20_25da435e_Tx
          CanTpTxNSdu_3fa592e1 (CanTpTxNSdu):
            CanTpTxAddressingFormat = CANTP_STANDARD
            CanTpTxDl = 8
            CanTpTxTaType = CANTP_PHYSICAL
            CanTpNas = 1
            CanTpNcs = 0.01
            CanTpTc = false
            CanTpTxNSduId = 10
            CanTpTxPaddingActivation = CANTP_ON
            CanTpNbs = 1
            CanTpTxNSduRef = PCAN_DIAG_RESP_PHYS_OBD2_oPCAN_RADAR_20_f1bd890a_Tx
            CanTpTxNPdu_0a4b612d (CanTpTxNPdu): CanTpTxNPduConfirmationPduId=7, CanTpTxNPduRef=PCAN_DIAG_RESP_PHYS_OBD2_Tp_oPCAN_RADAR_20_25da435e_Tx
            CanTpRxFcNPdu_0a4b612d (CanTpRxFcNPdu): CanTpRxFcNPduId=7, CanTpRxFcNPduRef=PCAN_DIAG_REQ_PHYS_OBD2_Tp_oPCAN_RADAR_20_65ff9201_Rx
        TPCH_6e941846: variation-point=post-build-variant-condition{matching-criterion=RDR_POS, value=7}
          CanTpRxNSdu_796f9cad (CanTpRxNSdu):
            CanTpRxAddressingFormat = CANTP_STANDARD
            CanTpRxDl = 8
            CanTpRxTaType = CANTP_FUNCTIONAL
            CanTpNbr = 0.1
            CanTpRxNSduId = 3
            CanTpRxPaddingActivation = CANTP_ON
            CanTpRxNSduRef = DIAG_REQ_FNC_OBD2_oVCAN_RADAR_254b3790_Rx
            CanTpRxNPdu_c1a26365 (CanTpRxNPdu): CanTpRxNPduId=13, CanTpRxNPduRef=DIAG_REQ_FNC_OBD2_Tp_oVCAN_RADAR_42ec9761_Rx
        TPCH_02fcb90b: variation-point=post-build-variant-condition{matching-criterion=RDR_POS, value=7}
          CanTpTxNSdu_fe897178 (CanTpTxNSdu):
            CanTpTxAddressingFormat = CANTP_STANDARD
            CanTpTxDl = 64
            CanTpTxTaType = CANTP_CANFD_PHYSICAL
            CanTpNas = 1
            CanTpNcs = 0.01
            CanTpTc = false
            CanTpTxNSduId = 1
            CanTpTxPaddingActivation = CANTP_ON
            CanTpNbs = 1
            CanTpTxNSduRef = PCAN_DIAG_RESP_PHYS_PLANT_oPCAN_RADAR_cfac777e_Tx
            CanTpRxFcNPdu_ce06c21b (CanTpRxFcNPdu): CanTpRxFcNPduId=11, CanTpRxFcNPduRef=PCAN_DIAG_REQ_PHYS_PLANT_Tp_oPCAN_RADAR_68155c61_Rx
            CanTpTxNPdu_ce06c21b (CanTpTxNPdu): CanTpTxNPduConfirmationPduId=11, CanTpTxNPduRef=PCAN_DIAG_RESP_PHYS_PLANT_Tp_oPCAN_RADAR_bd11d57f_Tx
          CanTpRxNSdu_fe897178 (CanTpRxNSdu):
            CanTpRxAddressingFormat = CANTP_STANDARD
            CanTpRxDl = 64
            CanTpRxTaType = CANTP_CANFD_PHYSICAL
            CanTpNbr = 0.01
            CanTpRxNSduId = 6
            CanTpRxPaddingActivation = CANTP_ON
            CanTpBs = 8
            CanTpNar = 1
            CanTpNcr = 1
            CanTpRxWftMax = 15
            CanTpSTmin = 0.02
            CanTpRxNSduRef = PCAN_DIAG_REQ_PHYS_PLANT_oPCAN_RADAR_214e1a1c_Rx
            CanTpRxNPdu_ecfc16e9 (CanTpRxNPdu): CanTpRxNPduId=11, CanTpRxNPduRef=PCAN_DIAG_REQ_PHYS_PLANT_Tp_oPCAN_RADAR_68155c61_Rx
            CanTpTxFcNPdu_ecfc16e9 (CanTpTxFcNPdu): CanTpTxFcNPduConfirmationPduId=11, CanTpTxFcNPduRef=PCAN_DIAG_RESP_PHYS_PLANT_Tp_oPCAN_RADAR_bd11d57f_Tx
        TPCH_73f6fba9: variation-point=post-build-variant-condition{matching-criterion=RDR_POS, value=7}
          CanTpRxNSdu_125a8101 (CanTpRxNSdu):
            CanTpRxAddressingFormat = CANTP_STANDARD
            CanTpRxDl = 8
            CanTpRxTaType = CANTP_PHYSICAL
            CanTpNbr = 0.01
            CanTpRxNSduId = 9
            CanTpRxPaddingActivation = CANTP_ON
            CanTpBs = 8
            CanTpNar = 1
            CanTpNcr = 1
            CanTpRxWftMax = 15
            CanTpSTmin = 0.02
            CanTpRxNSduRef = PCAN_DIAG_REQ_PHYS_OBD1_oPCAN_RADAR_20_f19508d6_Rx
            CanTpTxFcNPdu_8beca7d7 (CanTpTxFcNPdu): CanTpTxFcNPduConfirmationPduId=5, CanTpTxFcNPduRef=PCAN_DIAG_RESP_PHYS_OBD1_Tp_oPCAN_RADAR_20_f6415fa5_Tx
            CanTpRxNPdu_8beca7d7 (CanTpRxNPdu): CanTpRxNPduId=5, CanTpRxNPduRef=PCAN_DIAG_REQ_PHYS_OBD1_Tp_oPCAN_RADAR_20_b6648efa_Rx
          CanTpTxNSdu_125a8101 (CanTpTxNSdu):
            CanTpTxAddressingFormat = CANTP_STANDARD
            CanTpTxDl = 8
            CanTpTxTaType = CANTP_PHYSICAL
            CanTpNas = 1
            CanTpNcs = 0.01
            CanTpTc = false
            CanTpTxNSduId = 3
            CanTpTxPaddingActivation = CANTP_ON
            CanTpNbs = 1
            CanTpTxNSduRef = PCAN_DIAG_RESP_PHYS_OBD1_oPCAN_RADAR_20_955df2f4_Tx
            CanTpRxFcNPdu_a9167325 (CanTpRxFcNPdu): CanTpRxFcNPduId=5, CanTpRxFcNPduRef=PCAN_DIAG_REQ_PHYS_OBD1_Tp_oPCAN_RADAR_20_b6648efa_Rx
            CanTpTxNPdu_a9167325 (CanTpTxNPdu): CanTpTxNPduConfirmationPduId=5, CanTpTxNPduRef=PCAN_DIAG_RESP_PHYS_OBD1_Tp_oPCAN_RADAR_20_f6415fa5_Tx
        TPCH_b1db4c3e: variation-point=post-build-variant-condition{matching-criterion=RDR_POS, value=7}
          CanTpTxNSdu_92ce2a9d (CanTpTxNSdu):
            CanTpTxAddressingFormat = CANTP_STANDARD
            CanTpTxDl = 8
            CanTpTxTaType = CANTP_PHYSICAL
            CanTpNas = 1
            CanTpNcs = 0.01
            CanTpTc = false
            CanTpTxNSduId = 9
            CanTpTxPaddingActivation = CANTP_ON
            CanTpNbs = 1
            CanTpTxNSduRef = FR_DIAG_RES_PHY_OBD2_oVCAN_RADAR_96501380_Tx
            CanTpTxNPdu_5f15f4b8 (CanTpTxNPdu): CanTpTxNPduConfirmationPduId=1, CanTpTxNPduRef=FR_DIAG_RES_PHY_OBD2_Tp_oVCAN_RADAR_25471ce8_Tx
            CanTpRxFcNPdu_5f15f4b8 (CanTpRxFcNPdu): CanTpRxFcNPduId=1, CanTpRxFcNPduRef=FR_DIAG_REQ_PHY_OBD2_Tp_oVCAN_RADAR_b91a4a31_Rx
          CanTpRxNSdu_92ce2a9d (CanTpRxNSdu):
            CanTpRxAddressingFormat = CANTP_STANDARD
            CanTpRxDl = 8
            CanTpRxTaType = CANTP_PHYSICAL
            CanTpNbr = 0.01
            CanTpRxNSduId = 19
            CanTpRxPaddingActivation = CANTP_ON
            CanTpBs = 8
            CanTpNar = 1
            CanTpNcr = 1
            CanTpRxWftMax = 15
            CanTpSTmin = 0.02
            CanTpRxNSduRef = FR_DIAG_REQ_PHY_OBD2_oVCAN_RADAR_0f521c1d_Rx
            CanTpTxFcNPdu_7def204a (CanTpTxFcNPdu): CanTpTxFcNPduConfirmationPduId=1, CanTpTxFcNPduRef=FR_DIAG_RES_PHY_OBD2_Tp_oVCAN_RADAR_25471ce8_Tx
            CanTpRxNPdu_7def204a (CanTpRxNPdu): CanTpRxNPduId=1, CanTpRxNPduRef=FR_DIAG_REQ_PHY_OBD2_Tp_oVCAN_RADAR_b91a4a31_Rx
        TPCH_3b0ee9e0: variation-point=post-build-variant-condition{matching-criterion=RDR_POS, value=7}
          CanTpRxNSdu_d93a2016 (CanTpRxNSdu):
            CanTpRxAddressingFormat = CANTP_STANDARD
            CanTpRxDl = 8
            CanTpRxTaType = CANTP_FUNCTIONAL
            CanTpNbr = 0.1
            CanTpRxNSduId = 1
            CanTpRxPaddingActivation = CANTP_ON
            CanTpRxNSduRef = PCAN_DIAG_REQ_FUNC_OTA_oPCAN_RADAR_20_e1100275_Rx
            CanTpRxNPdu_1fa00345 (CanTpRxNPdu): CanTpRxNPduId=21, CanTpRxNPduRef=PCAN_DIAG_REQ_FUNC_OTA_Tp_oPCAN_RADAR_20_0a67f2f6_Rx
        TPCH_7c3757e1: variation-point=post-build-variant-condition{matching-criterion=RDR_POS, value=7}
          CanTpRxNSdu_89d4d963 (CanTpRxNSdu):
            CanTpRxAddressingFormat = CANTP_STANDARD
            CanTpRxDl = 64
            CanTpRxTaType = CANTP_CANFD_FUNCTIONAL
            CanTpNbr = 0.1
            CanTpRxNSduId = 4
            CanTpRxPaddingActivation = CANTP_ON
            CanTpRxNSduRef = PCAN_DIAG_REQ_FUNC_OTA_oPCAN_RADAR_a013523e_Rx
            CanTpRxNPdu_2a62e703 (CanTpRxNPdu): CanTpRxNPduId=20, CanTpRxNPduRef=PCAN_DIAG_REQ_FUNC_OTA_Tp_oPCAN_RADAR_7ea6262a_Rx
        TPCH_083bbeaf: variation-point=post-build-variant-condition{matching-criterion=RDR_POS, value=7}
          CanTpRxNSdu_fab1e11a (CanTpRxNSdu):
            CanTpRxAddressingFormat = CANTP_STANDARD
            CanTpRxDl = 8
            CanTpRxTaType = CANTP_FUNCTIONAL
            CanTpNbr = 0.1
            CanTpRxNSduId = 11
            CanTpRxPaddingActivation = CANTP_ON
            CanTpRxNSduRef = DIAG_REQ_FNC_OTA_oVCAN_RADAR_e787ed21_Rx
            CanTpRxNPdu_9b2ade95 (CanTpRxNPdu): CanTpRxNPduId=14, CanTpRxNPduRef=DIAG_REQ_FNC_OTA_Tp_oVCAN_RADAR_6f75a08a_Rx
