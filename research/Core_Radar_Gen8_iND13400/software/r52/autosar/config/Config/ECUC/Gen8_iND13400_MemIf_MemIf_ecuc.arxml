AUTOSAR XML (schema 00053)
package /ActiveEcuC
  module config MemIf: implementation-config-variant=VARIANT-PRE-COMPILE, module-description=MemIf_Impl
    MemIfGeneral: MemIfSafeBswChecks=true, MemIfDevErrorDetect=true, MemIfVersionInfoApi=false
    MemIfMemHwA: MemIfMemHwAId=0, MemIfSetModeAvailable=false, MemIfMemHwARef=FeeGeneral
