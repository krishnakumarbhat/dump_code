AUTOSAR XML (schema 00053)
package /ActiveEcuC
  module config NvM: implementation-config-variant=VARIANT-PRE-COMPILE, module-description=NvM_Impl
    NvMConfigBlock (NvMBlockDescriptor):
      NvMBlockCrcType = NVM_CRC16
      NvMSelectBlockForWriteAll = true
      NvMBlockUseCrc = true
      NvMNvramBlockIdentifier = 1
      NvMBlockManagementType = NVM_BLOCK_REDUNDANT
      NvMNvBlockNum = 2
      NvMNvBlockLength = 2
      NvMSelectBlockForReadAll = true
      NvMResistantToChangedSw = true
      NvMUseInitCallback = false
      NvMCalcRamBlockCrc = false
      NvMRomBlockDataAddress = NULL_PTR
      NvMBlockPostReadTransformCallback = NULL_PTR
      NvMBlockPreWriteTransformCallback = NULL_PTR
      NvMBlockUseSetRamBlockStatus = true
      NvMBlockJobPriority = 127
      NvMBlockUseSyncMechanism = false
      NvMBlockWriteProt = false
      NvMBswMBlockStatusInformation = false
      NvMWriteBlockOnce = false
      NvMUseServicePorts = true
      NvMUseJobendCallback = false
      NvMBlockUseCRCCompMechanism = false
      NvMInvokeCallbacksForReadAll = true
      NvMInvokeCallbacksForWriteAll = true
      NvMCheckLossOfRedundancy = false
      NvMRamBlockDataAddress = NVM_Config_Ram_Block
      NvMAutomaticBlockLength = true
      NvMTargetBlockReference
        NvMFeeRef: NvMNameOfFeeBlock=FeeBlockConfiguration
    NvMCommon:
      NvMApiConfigClass = NVM_API_CONFIG_CLASS_3
      NvMBswMMultiBlockJobStatusInformation = true
      NvMCompiledConfigId = 1
      NvMCrcNumOfBytes = 64
      NvMDatasetSelectionBits = 4
      NvMDevErrorDetect = true
      NvMDrvModeSwitch = true
      NvMDynamicConfiguration = true
      NvMJobPrioritization = false
      NvMPollingMode = true
      NvMSetRamBlockStatusApi = true
      NvMSizeStandardJobQueue = 7
      NvMVersionInfoApi = false
      NvMMaxNoOfWriteRetries = 1
      NvMMainFunctionPeriod = 0.005
      NvMUseBlockIdCheck = false
      NvMRepairRedundantBlocksApi = false
      NvMSafeBswChecks = true
      NvMDetectedLossOfRedundancyCallback = NULL_PTR
      NvMUseAsr440CallbackInterface = false
    NvMCommonVendorParams:
      NvMDataIntegrityIntBuffer = true
      NvMKillWriteAllApi = true
      NvMPreReadAllApi = false
      NvMJobForwardingToMemoryCore = false
      NvMCfgCbkIncludeList = SWC_Appl_FaultMgr_Cfg.h
      NvMCfgCbkIncludeList = Dem_Cbk.h
      NvMCfgCbkIncludeList = SWC_PLT_Appl_NvMHandler.h
    24 x NvMBlockDescriptor, all with NvMSelectBlockForWriteAll=true, NvMBlockUseSyncMechanism=false, NvMBlockWriteProt=false, NvMBswMBlockStatusInformation=false, NvMResistantToChangedSw=true, NvMWriteBlockOnce=false, NvMBlockUseCRCCompMechanism=false, NvMBlockUseSetRamBlockStatus=true, NvMInvokeCallbacksForReadAll=true, NvMInvokeCallbacksForWriteAll=true, NvMCheckLossOfRedundancy=false, NvMSelectBlockForReadAll=true:
      SWC_PLT_Appl_NvMHandlerAlignment_NvMBlock: NvMBlockCrcType=NVM_CRC16, NvMBlockUseCrc=true, NvMBlockJobPriority=255, NvMBlockManagementType=NVM_BLOCK_NATIVE, NvMNvBlockLength=64, NvMNvBlockNum=1, NvMNvramBlockIdentifier=2, NvMUseServicePorts=true, NvMUseJobendCallback=false, NvMUseInitCallback=false, NvMRomBlockDataAddress=Rte_SWC_PLT_Appl_NvMHandler_Alignment_NvMBlock_DefaultValue, NvMRamBlockDataAddress=Rte_SWC_PLT_Appl_NvMHandler_Appl_Alignment_PIM, NvMAutomaticBlockLength=true  # UC:Derived from NvBlockNeeds
        NvMTargetBlockReference
          NvMFeeRef: NvMNameOfFeeBlock=FeeSWC_PLT_Appl_NvMHandlerAlignment_NvMBlock
      SWC_PLT_Appl_NvMHandlerRFE_R1R2_Fault_NvM: NvMBlockCrcType=NVM_CRC16, NvMBlockUseCrc=false, NvMBlockJobPriority=255, NvMBlockManagementType=NVM_BLOCK_NATIVE, NvMNvBlockLength=72, NvMNvBlockNum=1, NvMNvramBlockIdentifier=4, NvMUseServicePorts=true, NvMUseJobendCallback=false, NvMUseInitCallback=false, NvMRamBlockDataAddress=Rte_SWC_PLT_Appl_NvMHandler_RFE_R1R2_PIM, NvMRomBlockDataAddress=Rte_SWC_PLT_Appl_NvMHandler_RFE_R1R2_Fault_NvM_DefaultValue  # UC:Derived from NvBlockNeeds
        NvMTargetBlockReference
          NvMFeeRef: NvMNameOfFeeBlock=FeeSWC_PLT_Appl_NvMHandlerRFE_R1R2_Fault_NvM
      SWC_PLT_Appl_NvMHandlerSWC_PLT_CDD_FailSafe: NvMBlockCrcType=NVM_CRC16, NvMBlockUseCrc=true, NvMBlockJobPriority=255, NvMBlockManagementType=NVM_BLOCK_NATIVE, NvMNvBlockLength=124, NvMNvBlockNum=1, NvMNvramBlockIdentifier=5, NvMUseServicePorts=true, NvMUseJobendCallback=false, NvMUseInitCallback=false, NvMRamBlockDataAddress=Rte_SWC_PLT_Appl_NvMHandler_FailSafe_ResetReason_PIM, NvMRomBlockDataAddress=Rte_SWC_PLT_Appl_NvMHandler_SWC_PLT_CDD_FailSafe_DefaultValue  # UC:Derived from NvBlockNeeds
        NvMTargetBlockReference
          NvMFeeRef: NvMNameOfFeeBlock=FeeSWC_PLT_Appl_NvMHandlerSWC_PLT_CDD_FailSafe
      SWC_PLT_Appl_NvMHandlerBringup_NvMBlock: NvMBlockCrcType=NVM_CRC16, NvMBlockUseCrc=true, NvMBlockManagementType=NVM_BLOCK_NATIVE, NvMNvBlockLength=64, NvMNvBlockNum=1, NvMNvramBlockIdentifier=3, NvMUseServicePorts=true, NvMUseJobendCallback=false, NvMUseInitCallback=false, NvMRamBlockDataAddress=Rte_SWC_PLT_Appl_NvMHandler_NvMBringUp_PIM, NvMRomBlockDataAddress=Rte_SWC_PLT_Appl_NvMHandler_NvMBringUp_DefaultValue, NvMAutomaticBlockLength=true, NvMBlockJobPriority=128  # UC:Derived from NvBlockNeeds
        NvMTargetBlockReference
          NvMFeeRef: NvMNameOfFeeBlock=FeeSWC_PLT_Appl_NvMHandlerBringup_NvMBlock
      SWC_Appl_Faultmgr: NvMBlockCrcType=NVM_CRC32, NvMBlockUseCrc=true, NvMBlockJobPriority=127, NvMBlockManagementType=NVM_BLOCK_NATIVE, NvMNvBlockLength=16, NvMNvBlockNum=1, NvMNvramBlockIdentifier=6, NvMUseServicePorts=false, NvMUseJobendCallback=false, NvMUseInitCallback=false, NvMBlockLengthCheck=true, NvMBlockLengthCheckType=true, NvMCalcRamBlockCrc=false, NvMInitBlockCallback=NULL_PTR, NvMRamBlockDataAddress=SWC_Appl_FaultMgr_NVblock, NvMSelectBlockForPreReadAll=false, NvMWriteVerification=true, NvMSingleBlockCallback=NULL_PTR, NvMAutomaticBlockLength=true, NvMRomBlockNum=1, NvMRomBlockDataAddress=SWC_Appl_FaultMgr_DefaultValue
        NvMTargetBlockReference
          NvMFeeRef: NvMNameOfFeeBlock=FeeSWC_PLT_Appl_NvMHandlerSWC_Appl_Faultmgr
      SWC_PLT_Appl_NvMHandlerCorrectable_Fault_NvM: NvMBlockCrcType=NVM_CRC16, NvMBlockUseCrc=true, NvMBlockJobPriority=255, NvMNvBlockLength=24, NvMNvBlockNum=2, NvMNvramBlockIdentifier=7, NvMUseServicePorts=true, NvMUseJobendCallback=false, NvMUseInitCallback=false, NvMRamBlockDataAddress=Rte_SWC_PLT_Appl_NvMHandler_Correctable_Fault_PIM, NvMRomBlockDataAddress=Rte_SWC_PLT_Appl_NvMHandler_Correctable_Fault_NvM_DefaultValue, NvMBlockManagementType=NVM_BLOCK_REDUNDANT, NvMRomBlockNum=1  # UC:Derived from NvBlockNeeds
        NvMTargetBlockReference
          NvMFeeRef: NvMNameOfFeeBlock=FeeSWC_PLT_Appl_NvMHandlerCorrectable_Fault_NvM
      DemAdminDataBlock: NvMBlockCrcType=NVM_CRC16, NvMBlockUseCrc=false, NvMBlockJobPriority=127, NvMBlockManagementType=NVM_BLOCK_NATIVE, NvMNvBlockLength=12, NvMNvBlockNum=1, NvMNvramBlockIdentifier=8, NvMUseServicePorts=false, NvMUseJobendCallback=true, NvMUseInitCallback=true, NvMRamBlockDataAddress=Dem_Cfg_AdminData, NvMRomBlockDataAddress=NULL_PTR, NvMInitBlockCallback=Dem_NvM_InitAdminData, NvMSingleBlockCallback=Dem_NvM_JobFinished, NvMAutomaticBlockLength=true
        NvMTargetBlockReference
          NvMFeeRef: NvMNameOfFeeBlock=FeeDemAdminDataBlock
      DemStatusDataBlock: NvMBlockCrcType=NVM_CRC16, NvMBlockUseCrc=false, NvMBlockJobPriority=127, NvMBlockManagementType=NVM_BLOCK_NATIVE, NvMNvBlockLength=72, NvMNvBlockNum=1, NvMNvramBlockIdentifier=9, NvMUseServicePorts=false, NvMUseJobendCallback=true, NvMUseInitCallback=true, NvMRamBlockDataAddress=Dem_Cfg_StatusData, NvMRomBlockDataAddress=NULL_PTR, NvMInitBlockCallback=Dem_NvM_InitStatusData, NvMSingleBlockCallback=Dem_NvM_JobFinished, NvMAutomaticBlockLength=true
        NvMTargetBlockReference
          NvMFeeRef: NvMNameOfFeeBlock=FeeDemStatusDataBlock
      DemPrimaryDataBlock0: NvMBlockCrcType=NVM_CRC16, NvMBlockUseCrc=false, NvMBlockJobPriority=127, NvMBlockManagementType=NVM_BLOCK_NATIVE, NvMNvBlockLength=28, NvMNvBlockNum=1, NvMNvramBlockIdentifier=10, NvMUseServicePorts=false, NvMUseJobendCallback=true, NvMUseInitCallback=false, NvMRamBlockDataAddress=Dem_Cfg_PrimaryEntry_0, NvMRomBlockDataAddress=Dem_Cfg_PrimaryEventEntryInit, NvMInitBlockCallback=NULL_PTR, NvMSingleBlockCallback=Dem_NvM_JobFinished, NvMAutomaticBlockLength=true
        NvMTargetBlockReference
          NvMFeeRef: NvMNameOfFeeBlock=FeeDemPrimaryDataBlock0
      SWC_CMP_PRJ_UDSHandlerSWC_UDSHandler_VIN: NvMBlockCrcType=NVM_CRC16, NvMBlockUseCrc=true, NvMBlockJobPriority=255, NvMBlockManagementType=NVM_BLOCK_NATIVE, NvMNvBlockLength=17, NvMNvBlockNum=1, NvMNvramBlockIdentifier=20, NvMUseJobendCallback=false, NvMUseInitCallback=false, NvMRamBlockDataAddress=Rte_SWC_CMP_PRJ_UDSHandler_SWC_UDS_VIN, NvMRomBlockDataAddress=Rte_SWC_CMP_PRJ_UDSHandler_SWC_UDSHandler_VIN_DefaultValue, NvMUseServicePorts=true, NvMRomBlockNum=1  # UC:Derived from NvBlockNeeds
        NvMTargetBlockReference
          NvMFeeRef: NvMNameOfFeeBlock=FeeSWC_CMP_PRJ_UDSHandlerSWC_UDSHandler_VIN
      SWC_PLT_Appl_NvMHandlerSensorPos_NvM: NvMBlockCrcType=NVM_CRC16, NvMBlockJobPriority=255, NvMBlockManagementType=NVM_BLOCK_REDUNDANT, NvMNvBlockLength=8, NvMNvBlockNum=2, NvMNvramBlockIdentifier=21, NvMUseServicePorts=true, NvMUseJobendCallback=false, NvMUseInitCallback=false, NvMRomBlockNum=1, NvMRamBlockDataAddress=Rte_SWC_PLT_Appl_NvMHandler_Sensorpos_PIM_UDS, NvMRomBlockDataAddress=Rte_SWC_PLT_Appl_NvMHandler_SensorPos_NvM_DefaultValue, NvMCalcRamBlockCrc=false, NvMBlockUseCrc=true  # UC:Derived from NvBlockNeeds
        NvMTargetBlockReference
          NvMFeeRef: NvMNameOfFeeBlock=FeeSWC_PLT_Appl_NvMHandlerSensorPos_NvM
      DemPrimaryDataBlock1: NvMBlockCrcType=NVM_CRC16, NvMBlockUseCrc=false, NvMBlockJobPriority=127, NvMBlockManagementType=NVM_BLOCK_NATIVE, NvMNvBlockLength=28, NvMNvBlockNum=1, NvMNvramBlockIdentifier=11, NvMUseServicePorts=false, NvMUseJobendCallback=true, NvMUseInitCallback=false, NvMRamBlockDataAddress=Dem_Cfg_PrimaryEntry_1, NvMRomBlockDataAddress=Dem_Cfg_PrimaryEventEntryInit, NvMInitBlockCallback=NULL_PTR, NvMSingleBlockCallback=Dem_NvM_JobFinished, NvMAutomaticBlockLength=true
        NvMTargetBlockReference
          NvMFeeRef: NvMNameOfFeeBlock=FeeDemPrimaryDataBlock1
      DemPrimaryDataBlock2: NvMBlockCrcType=NVM_CRC16, NvMBlockUseCrc=false, NvMBlockJobPriority=127, NvMBlockManagementType=NVM_BLOCK_NATIVE, NvMNvBlockLength=28, NvMNvBlockNum=1, NvMNvramBlockIdentifier=12, NvMUseServicePorts=false, NvMUseJobendCallback=true, NvMUseInitCallback=false, NvMRamBlockDataAddress=Dem_Cfg_PrimaryEntry_2, NvMRomBlockDataAddress=Dem_Cfg_PrimaryEventEntryInit, NvMInitBlockCallback=NULL_PTR, NvMSingleBlockCallback=Dem_NvM_JobFinished, NvMAutomaticBlockLength=true
        NvMTargetBlockReference
          NvMFeeRef: NvMNameOfFeeBlock=FeeDemPrimaryDataBlock2
      DemPrimaryDataBlock3: NvMBlockCrcType=NVM_CRC16, NvMBlockUseCrc=false, NvMBlockJobPriority=127, NvMBlockManagementType=NVM_BLOCK_NATIVE, NvMNvBlockLength=28, NvMNvBlockNum=1, NvMNvramBlockIdentifier=13, NvMUseServicePorts=false, NvMUseJobendCallback=true, NvMUseInitCallback=false, NvMRamBlockDataAddress=Dem_Cfg_PrimaryEntry_3, NvMRomBlockDataAddress=Dem_Cfg_PrimaryEventEntryInit, NvMInitBlockCallback=NULL_PTR, NvMSingleBlockCallback=Dem_NvM_JobFinished, NvMAutomaticBlockLength=true
        NvMTargetBlockReference
          NvMFeeRef: NvMNameOfFeeBlock=FeeDemPrimaryDataBlock3
      DemPrimaryDataBlock4: NvMBlockCrcType=NVM_CRC16, NvMBlockUseCrc=false, NvMBlockJobPriority=127, NvMBlockManagementType=NVM_BLOCK_NATIVE, NvMNvBlockLength=28, NvMNvBlockNum=1, NvMNvramBlockIdentifier=14, NvMUseServicePorts=false, NvMUseJobendCallback=true, NvMUseInitCallback=false, NvMRamBlockDataAddress=Dem_Cfg_PrimaryEntry_4, NvMRomBlockDataAddress=Dem_Cfg_PrimaryEventEntryInit, NvMInitBlockCallback=NULL_PTR, NvMSingleBlockCallback=Dem_NvM_JobFinished, NvMAutomaticBlockLength=true
        NvMTargetBlockReference
          NvMFeeRef: NvMNameOfFeeBlock=FeeDemPrimaryDataBlock4
      DemPrimaryDataBlock5: NvMBlockCrcType=NVM_CRC16, NvMBlockUseCrc=false, NvMBlockJobPriority=127, NvMBlockManagementType=NVM_BLOCK_NATIVE, NvMNvBlockLength=28, NvMNvBlockNum=1, NvMNvramBlockIdentifier=15, NvMUseServicePorts=false, NvMUseJobendCallback=true, NvMUseInitCallback=false, NvMRamBlockDataAddress=Dem_Cfg_PrimaryEntry_5, NvMRomBlockDataAddress=Dem_Cfg_PrimaryEventEntryInit, NvMInitBlockCallback=NULL_PTR, NvMSingleBlockCallback=Dem_NvM_JobFinished, NvMAutomaticBlockLength=true
        NvMTargetBlockReference
          NvMFeeRef: NvMNameOfFeeBlock=FeeDemPrimaryDataBlock5
      DemPrimaryDataBlock6: NvMBlockCrcType=NVM_CRC16, NvMBlockUseCrc=false, NvMBlockJobPriority=127, NvMBlockManagementType=NVM_BLOCK_NATIVE, NvMNvBlockLength=28, NvMNvBlockNum=1, NvMNvramBlockIdentifier=16, NvMUseServicePorts=false, NvMUseJobendCallback=true, NvMUseInitCallback=false, NvMRamBlockDataAddress=Dem_Cfg_PrimaryEntry_6, NvMRomBlockDataAddress=Dem_Cfg_PrimaryEventEntryInit, NvMInitBlockCallback=NULL_PTR, NvMSingleBlockCallback=Dem_NvM_JobFinished, NvMAutomaticBlockLength=true
        NvMTargetBlockReference
          NvMFeeRef: NvMNameOfFeeBlock=FeeDemPrimaryDataBlock6
      DemPrimaryDataBlock7: NvMBlockCrcType=NVM_CRC16, NvMBlockUseCrc=false, NvMBlockJobPriority=127, NvMBlockManagementType=NVM_BLOCK_NATIVE, NvMNvBlockLength=28, NvMNvBlockNum=1, NvMNvramBlockIdentifier=17, NvMUseServicePorts=false, NvMUseJobendCallback=true, NvMUseInitCallback=false, NvMRamBlockDataAddress=Dem_Cfg_PrimaryEntry_7, NvMRomBlockDataAddress=Dem_Cfg_PrimaryEventEntryInit, NvMInitBlockCallback=NULL_PTR, NvMSingleBlockCallback=Dem_NvM_JobFinished, NvMAutomaticBlockLength=true
        NvMTargetBlockReference
          NvMFeeRef: NvMNameOfFeeBlock=FeeDemPrimaryDataBlock7
      DemPrimaryDataBlock8: NvMBlockCrcType=NVM_CRC16, NvMBlockUseCrc=false, NvMBlockJobPriority=127, NvMBlockManagementType=NVM_BLOCK_NATIVE, NvMNvBlockLength=28, NvMNvBlockNum=1, NvMNvramBlockIdentifier=18, NvMUseServicePorts=false, NvMUseJobendCallback=true, NvMUseInitCallback=false, NvMRamBlockDataAddress=Dem_Cfg_PrimaryEntry_8, NvMRomBlockDataAddress=Dem_Cfg_PrimaryEventEntryInit, NvMInitBlockCallback=NULL_PTR, NvMSingleBlockCallback=Dem_NvM_JobFinished, NvMAutomaticBlockLength=true
        NvMTargetBlockReference
          NvMFeeRef: NvMNameOfFeeBlock=FeeDemPrimaryDataBlock8
      DemPrimaryDataBlock9: NvMBlockCrcType=NVM_CRC16, NvMBlockUseCrc=false, NvMBlockJobPriority=127, NvMBlockManagementType=NVM_BLOCK_NATIVE, NvMNvBlockLength=28, NvMNvBlockNum=1, NvMNvramBlockIdentifier=19, NvMUseServicePorts=false, NvMUseJobendCallback=true, NvMUseInitCallback=false, NvMRamBlockDataAddress=Dem_Cfg_PrimaryEntry_9, NvMRomBlockDataAddress=Dem_Cfg_PrimaryEventEntryInit, NvMInitBlockCallback=NULL_PTR, NvMSingleBlockCallback=Dem_NvM_JobFinished, NvMAutomaticBlockLength=true
        NvMTargetBlockReference
          NvMFeeRef: NvMNameOfFeeBlock=FeeDemPrimaryDataBlock9
      SWC_CMP_PRJ_UDSHandlerSWC_UDSHandler_Attemptcounter: NvMBlockCrcType=NVM_CRC16, NvMBlockUseCrc=true, NvMBlockJobPriority=255, NvMBlockManagementType=NVM_BLOCK_NATIVE, NvMNvBlockLength=2, NvMNvBlockNum=1, NvMNvramBlockIdentifier=22, NvMUseServicePorts=true, NvMUseJobendCallback=false, NvMUseInitCallback=false, NvMRamBlockDataAddress=Rte_SWC_CMP_PRJ_UDSHandler_SWC_UDS_AttemptCounter, NvMRomBlockDataAddress=Rte_SWC_CMP_PRJ_UDSHandler_SWC_UDSHandler_Attemptcounter_DefaultValue, NvMRomBlockNum=1  # UC:Derived from NvBlockNeeds
        NvMTargetBlockReference
          NvMFeeRef: NvMNameOfFeeBlock=FeeSWC_CMP_PRJ_UDSHandlerSWC_UDSHandler_Attemptcounter
      SWC_PLT_Appl_NvMHandlerSWC_Manual_alignment_Execution: NvMBlockCrcType=NVM_CRC16, NvMBlockUseCrc=true, NvMBlockJobPriority=255, NvMBlockManagementType=NVM_BLOCK_REDUNDANT, NvMNvBlockLength=16, NvMNvBlockNum=2, NvMNvramBlockIdentifier=23, NvMUseServicePorts=true, NvMUseJobendCallback=false, NvMUseInitCallback=false, NvMRamBlockDataAddress=Rte_SWC_PLT_Appl_NvMHandler_Manual_Alignment_Execution_Data_PIM, NvMRomBlockDataAddress=Rte_SWC_PLT_Appl_NvMHandler_SWC_Manual_alignment_Execution_DefaultValue, NvMRomBlockNum=1  # UC:Derived from NvBlockNeeds
        NvMTargetBlockReference
          NvMFeeRef: NvMNameOfFeeBlock=FeeSWC_PLT_Appl_NvMHandlerSWC_Manual_alignment_Execution
      SWC_PLT_Appl_NvMHandlerSWC_Static_Alignment_Write_Parameters: NvMBlockCrcType=NVM_CRC16, NvMBlockUseCrc=true, NvMBlockManagementType=NVM_BLOCK_REDUNDANT, NvMNvBlockLength=12, NvMNvBlockNum=2, NvMNvramBlockIdentifier=24, NvMUseServicePorts=true, NvMUseJobendCallback=false, NvMUseInitCallback=false, NvMRamBlockDataAddress=Rte_SWC_PLT_Appl_NvMHandler_Static_Alignment_Engineering_Write_Configuration_Parameters_PIM, NvMRomBlockDataAddress=Rte_SWC_PLT_Appl_NvMHandler_SWC_Static_Alignment_Write_Parameters_DefaultValue, NvMRomBlockNum=1, NvMBlockJobPriority=127  # UC:Derived from NvBlockNeeds
        NvMTargetBlockReference
          NvMFeeRef: NvMNameOfFeeBlock=FeeSWC_PLT_Appl_NvMHandlerSWC_Static_Alignment_Write_Parameters
      SWC_PLT_Appl_NvMHandlerSWC_VSE_NVM_Params: NvMBlockCrcType=NVM_CRC16, NvMBlockUseCrc=true, NvMBlockJobPriority=255, NvMBlockManagementType=NVM_BLOCK_NATIVE, NvMNvBlockLength=20, NvMNvBlockNum=1, NvMNvramBlockIdentifier=25, NvMUseServicePorts=true, NvMUseJobendCallback=false, NvMUseInitCallback=false, NvMRamBlockDataAddress=Rte_SWC_PLT_Appl_NvMHandler_VSE_NVM_Params_PIM, NvMRomBlockDataAddress=Rte_SWC_PLT_Appl_NvMHandler_SWC_VSE_NVM_Params_DefaultValue  # UC:Derived from NvBlockNeeds
        NvMTargetBlockReference
          NvMFeeRef: NvMNameOfFeeBlock=FeeSWC_PLT_Appl_NvMHandlerSWC_VSE_NVM_Params
