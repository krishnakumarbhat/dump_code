[part 3 of 3: package /ActiveEcuC]
AUTOSAR XML (schema 00053)
package /ActiveEcuC  (continued)
  module config Rte: implementation-config-variant=VARIANT-PRE-COMPILE, module-description=Rte_Impl  (continued)
    DemSatellite_Invalid_OsApplication_EcuSwComposition (RteSwComponentInstance): RteSoftwareComponentInstanceRef=DemSatellite_Invalid_OsApplication  (continued)
      1376 x RteEventToTaskMapping, all with RteImmediateRestart=false:  (continued)
        OpEventGetEventFreezeFrameDataEx_GetEventFreezeFrameDataEx_EvtInfo_Radar_AutoAlignment_Algorithm_Signal_Calculation_Failure: RteEventRef=OpEventGetEventFreezeFrameDataEx_GetEventFreezeFrameDataEx_EvtInfo_Radar_AutoAlignment_Algorithm_Signal_Calculation_Failure
        OpEventGetEventFreezeFrameDataEx_GetEventFreezeFrameDataEx_Event_Radar_AutoAlignment_Algorithm_Signal_Calculation_Failure: RteEventRef=OpEventGetEventFreezeFrameDataEx_GetEventFreezeFrameDataEx_Event_Radar_AutoAlignment_Algorithm_Signal_Calculation_Failure
        OpEventGetEventFreezeFrameDataEx_GetEventFreezeFrameDataEx_EvtInfo_Vehicle_DataSet_Not_Configured: RteEventRef=OpEventGetEventFreezeFrameDataEx_GetEventFreezeFrameDataEx_EvtInfo_Vehicle_DataSet_Not_Configured
        OpEventGetEventFreezeFrameDataEx_GetEventFreezeFrameDataEx_Event_Vehicle_DataSet_Not_Configured: RteEventRef=OpEventGetEventFreezeFrameDataEx_GetEventFreezeFrameDataEx_Event_Vehicle_DataSet_Not_Configured
        OpEventGetEventFreezeFrameDataEx_GetEventFreezeFrameDataEx_EvtInfo_Radar_Module_System_Internal_Failure: RteEventRef=OpEventGetEventFreezeFrameDataEx_GetEventFreezeFrameDataEx_EvtInfo_Radar_Module_System_Internal_Failure
        OpEventGetEventFreezeFrameDataEx_GetEventFreezeFrameDataEx_Event_Radar_Module_System_Internal_Failure: RteEventRef=OpEventGetEventFreezeFrameDataEx_GetEventFreezeFrameDataEx_Event_Radar_Module_System_Internal_Failure
        OpEventGetEventFreezeFrameDataEx_GetEventFreezeFrameDataEx_EvtInfo_Radar_MMIC_Component_Failure: RteEventRef=OpEventGetEventFreezeFrameDataEx_GetEventFreezeFrameDataEx_EvtInfo_Radar_MMIC_Component_Failure
        OpEventGetEventFreezeFrameDataEx_GetEventFreezeFrameDataEx_Event_Radar_MMIC_Component_Failure: RteEventRef=OpEventGetEventFreezeFrameDataEx_GetEventFreezeFrameDataEx_Event_Radar_MMIC_Component_Failure
        OpEventGetEventFreezeFrameDataEx_GetEventFreezeFrameDataEx_EvtInfo_Radar_Module_General_Memory_Failure: RteEventRef=OpEventGetEventFreezeFrameDataEx_GetEventFreezeFrameDataEx_EvtInfo_Radar_Module_General_Memory_Failure
        OpEventGetEventFreezeFrameDataEx_GetEventFreezeFrameDataEx_Event_Radar_Module_General_Memory_Failure: RteEventRef=OpEventGetEventFreezeFrameDataEx_GetEventFreezeFrameDataEx_Event_Radar_Module_General_Memory_Failure
        OpEventGetEventFreezeFrameDataEx_GetEventFreezeFrameDataEx_EvtInfo_Radar_System_Battery_High_Voltage_System_Voltage_High: RteEventRef=OpEventGetEventFreezeFrameDataEx_GetEventFreezeFrameDataEx_EvtInfo_Radar_System_Battery_High_Voltage_System_Voltage_High
        OpEventGetEventFreezeFrameDataEx_GetEventFreezeFrameDataEx_Event_Radar_System_Battery_High_Voltage_System_Voltage_High: RteEventRef=OpEventGetEventFreezeFrameDataEx_GetEventFreezeFrameDataEx_Event_Radar_System_Battery_High_Voltage_System_Voltage_High
        OpEventGetEventFreezeFrameDataEx_GetEventFreezeFrameDataEx_EvtInfo_CCVS1_message_Vehicle_Speed_Invalid_Serial_Data_Received: RteEventRef=OpEventGetEventFreezeFrameDataEx_GetEventFreezeFrameDataEx_EvtInfo_CCVS1_message_Vehicle_Speed_Invalid_Serial_Data_Received
        OpEventGetEventFreezeFrameDataEx_GetEventFreezeFrameDataEx_Event_CCVS1_message_Vehicle_Speed_Invalid_Serial_Data_Received: RteEventRef=OpEventGetEventFreezeFrameDataEx_GetEventFreezeFrameDataEx_Event_CCVS1_message_Vehicle_Speed_Invalid_Serial_Data_Received
        OpEventGetEventFreezeFrameDataEx_GetEventFreezeFrameDataEx_EvtInfo_EMS_ECU_VD_erratic_communication_Erratic: RteEventRef=OpEventGetEventFreezeFrameDataEx_GetEventFreezeFrameDataEx_EvtInfo_EMS_ECU_VD_erratic_communication_Erratic
        OpEventGetEventFreezeFrameDataEx_GetEventFreezeFrameDataEx_Event_EMS_ECU_VD_erratic_communication_Erratic: RteEventRef=OpEventGetEventFreezeFrameDataEx_GetEventFreezeFrameDataEx_Event_EMS_ECU_VD_erratic_communication_Erratic
        OpEventGetEventFreezeFrameDataEx_GetEventFreezeFrameDataEx_EvtInfo_EMS_ECU_ETC2_00_message_Missing_Message: RteEventRef=OpEventGetEventFreezeFrameDataEx_GetEventFreezeFrameDataEx_EvtInfo_EMS_ECU_ETC2_00_message_Missing_Message
        OpEventGetEventFreezeFrameDataEx_GetEventFreezeFrameDataEx_Event_EMS_ECU_ETC2_00_message_Missing_Message: RteEventRef=OpEventGetEventFreezeFrameDataEx_GetEventFreezeFrameDataEx_Event_EMS_ECU_ETC2_00_message_Missing_Message
        OpEventGetEventFreezeFrameDataEx_GetEventFreezeFrameDataEx_EvtInfo_Cluster_ECU_CLS_Tx_16_message_Missing_Message: RteEventRef=OpEventGetEventFreezeFrameDataEx_GetEventFreezeFrameDataEx_EvtInfo_Cluster_ECU_CLS_Tx_16_message_Missing_Message
        OpEventGetEventFreezeFrameDataEx_GetEventFreezeFrameDataEx_Event_Cluster_ECU_CLS_Tx_16_message_Missing_Message: RteEventRef=OpEventGetEventFreezeFrameDataEx_GetEventFreezeFrameDataEx_Event_Cluster_ECU_CLS_Tx_16_message_Missing_Message
        OpEventGetEventFreezeFrameDataEx_GetEventFreezeFrameDataEx_EvtInfo_Exceeded_Security_Access_0x27_Attempt_Threshold_Auth_872b5c35: RteEventRef=OpEventGetEventFreezeFrameDataEx_GetEventFreezeFrameDataEx_EvtInfo_Exceeded_Security_Access_0x27_Attempt_Threshold_Auth_872b5c35
        OpEventGetEventFreezeFrameDataEx_GetEventFreezeFrameDataEx_Event_Exceeded_Security_Access_0x27_Attempt_Threshold_Authen_c1efc3a8: RteEventRef=OpEventGetEventFreezeFrameDataEx_GetEventFreezeFrameDataEx_Event_Exceeded_Security_Access_0x27_Attempt_Threshold_Authen_c1efc3a8
        OpEventGetEventFreezeFrameDataEx_GetEventFreezeFrameDataEx_EvtInfo_Front_Left_Side_Radar_value_of_signal_protection_cal_cdb2887d: RteEventRef=OpEventGetEventFreezeFrameDataEx_GetEventFreezeFrameDataEx_EvtInfo_Front_Left_Side_Radar_value_of_signal_protection_cal_cdb2887d
        OpEventGetEventFreezeFrameDataEx_GetEventFreezeFrameDataEx_Event_Front_Left_Side_Radar_value_of_signal_protection_calcu_8b7617e0: RteEventRef=OpEventGetEventFreezeFrameDataEx_GetEventFreezeFrameDataEx_Event_Front_Left_Side_Radar_value_of_signal_protection_calcu_8b7617e0
        OpEventGetEventFreezeFrameDataEx_GetEventFreezeFrameDataEx_EvtInfo_AT_AMT_ETC2_erratic_communication_Erratic: RteEventRef=OpEventGetEventFreezeFrameDataEx_GetEventFreezeFrameDataEx_EvtInfo_AT_AMT_ETC2_erratic_communication_Erratic
        OpEventGetEventFreezeFrameDataEx_GetEventFreezeFrameDataEx_Event_AT_AMT_ETC2_erratic_communication_Erratic: RteEventRef=OpEventGetEventFreezeFrameDataEx_GetEventFreezeFrameDataEx_Event_AT_AMT_ETC2_erratic_communication_Erratic
        OpEventGetEventFreezeFrameDataEx_GetEventFreezeFrameDataEx_EvtInfo_VCAN_Communication_Bus_Off: RteEventRef=OpEventGetEventFreezeFrameDataEx_GetEventFreezeFrameDataEx_EvtInfo_VCAN_Communication_Bus_Off
        OpEventGetEventFreezeFrameDataEx_GetEventFreezeFrameDataEx_Event_VCAN_Communication_Bus_Off: RteEventRef=OpEventGetEventFreezeFrameDataEx_GetEventFreezeFrameDataEx_Event_VCAN_Communication_Bus_Off
        OpEventGetEventFreezeFrameDataEx_GetEventFreezeFrameDataEx_EvtInfo_VDC2_message_LongitudinalAcceleration_Invalid_Serial_73dc9629: RteEventRef=OpEventGetEventFreezeFrameDataEx_GetEventFreezeFrameDataEx_EvtInfo_VDC2_message_LongitudinalAcceleration_Invalid_Serial_73dc9629
        OpEventGetEventFreezeFrameDataEx_GetEventFreezeFrameDataEx_Event_VDC2_message_LongitudinalAcceleration_Invalid_Serial_D_24982aee: RteEventRef=OpEventGetEventFreezeFrameDataEx_GetEventFreezeFrameDataEx_Event_VDC2_message_LongitudinalAcceleration_Invalid_Serial_D_24982aee
        OpEventGetEventFreezeFrameDataEx_GetEventFreezeFrameDataEx_EvtInfo_Radar_MMIC_RFBIST_Component_Internal_Failure: RteEventRef=OpEventGetEventFreezeFrameDataEx_GetEventFreezeFrameDataEx_EvtInfo_Radar_MMIC_RFBIST_Component_Internal_Failure
        OpEventGetEventFreezeFrameDataEx_GetEventFreezeFrameDataEx_Event_Radar_MMIC_RFBIST_Component_Internal_Failure: RteEventRef=OpEventGetEventFreezeFrameDataEx_GetEventFreezeFrameDataEx_Event_Radar_MMIC_RFBIST_Component_Internal_Failure
        OpEventGetEventFreezeFrameDataEx_GetEventFreezeFrameDataEx_EvtInfo_Radar_Initial_Alignment_Missing_Calibration: RteEventRef=OpEventGetEventFreezeFrameDataEx_GetEventFreezeFrameDataEx_EvtInfo_Radar_Initial_Alignment_Missing_Calibration
        OpEventGetEventFreezeFrameDataEx_GetEventFreezeFrameDataEx_Event_Radar_Initial_Alignment_Missing_Calibration: RteEventRef=OpEventGetEventFreezeFrameDataEx_GetEventFreezeFrameDataEx_Event_Radar_Initial_Alignment_Missing_Calibration
        OpEventGetEventFreezeFrameDataEx_GetEventFreezeFrameDataEx_EvtInfo_Cluster_ECU_OEL_message_Missing_Message: RteEventRef=OpEventGetEventFreezeFrameDataEx_GetEventFreezeFrameDataEx_EvtInfo_Cluster_ECU_OEL_message_Missing_Message
        OpEventGetEventFreezeFrameDataEx_GetEventFreezeFrameDataEx_Event_Cluster_ECU_OEL_message_Missing_Message: RteEventRef=OpEventGetEventFreezeFrameDataEx_GetEventFreezeFrameDataEx_Event_Cluster_ECU_OEL_message_Missing_Message
        OpEventGetEventFreezeFrameDataEx_GetEventFreezeFrameDataEx_EvtInfo_AT_AMT_ECU_ETC2_03_message_Missing_Message: RteEventRef=OpEventGetEventFreezeFrameDataEx_GetEventFreezeFrameDataEx_EvtInfo_AT_AMT_ECU_ETC2_03_message_Missing_Message
        OpEventGetEventFreezeFrameDataEx_GetEventFreezeFrameDataEx_Event_AT_AMT_ECU_ETC2_03_message_Missing_Message: RteEventRef=OpEventGetEventFreezeFrameDataEx_GetEventFreezeFrameDataEx_Event_AT_AMT_ECU_ETC2_03_message_Missing_Message
        OpEventGetEventFreezeFrameDataEx_GetEventFreezeFrameDataEx_EvtInfo_ADAS_FN_STS_message_MOIS_FN_Switch_STS_Invalid_Seria_37587b36: RteEventRef=OpEventGetEventFreezeFrameDataEx_GetEventFreezeFrameDataEx_EvtInfo_ADAS_FN_STS_message_MOIS_FN_Switch_STS_Invalid_Seria_37587b36
        OpEventGetEventFreezeFrameDataEx_GetEventFreezeFrameDataEx_Event_ADAS_FN_STS_message_MOIS_FN_Switch_STS_Invalid_Serial_320f6899: RteEventRef=OpEventGetEventFreezeFrameDataEx_GetEventFreezeFrameDataEx_Event_ADAS_FN_STS_message_MOIS_FN_Switch_STS_Invalid_Serial_320f6899
        OpEventGetEventFreezeFrameDataEx_GetEventFreezeFrameDataEx_EvtInfo_Radar_Module_Over_Temperature: RteEventRef=OpEventGetEventFreezeFrameDataEx_GetEventFreezeFrameDataEx_EvtInfo_Radar_Module_Over_Temperature
        OpEventGetEventFreezeFrameDataEx_GetEventFreezeFrameDataEx_Event_Radar_Module_Over_Temperature: RteEventRef=OpEventGetEventFreezeFrameDataEx_GetEventFreezeFrameDataEx_Event_Radar_Module_Over_Temperature
        OpEventGetEventFreezeFrameDataEx_GetEventFreezeFrameDataEx_EvtInfo_PCAN_TimeSync_Missing_Message: RteEventRef=OpEventGetEventFreezeFrameDataEx_GetEventFreezeFrameDataEx_EvtInfo_PCAN_TimeSync_Missing_Message
        OpEventGetEventFreezeFrameDataEx_GetEventFreezeFrameDataEx_Event_PCAN_TimeSync_Missing_Message: RteEventRef=OpEventGetEventFreezeFrameDataEx_GetEventFreezeFrameDataEx_Event_PCAN_TimeSync_Missing_Message
        OpEventGetEventFreezeFrameDataEx_GetEventFreezeFrameDataEx_EvtInfo_Radar_Module_Watchdog_Failure: RteEventRef=OpEventGetEventFreezeFrameDataEx_GetEventFreezeFrameDataEx_EvtInfo_Radar_Module_Watchdog_Failure
        OpEventGetEventFreezeFrameDataEx_GetEventFreezeFrameDataEx_Event_Radar_Module_Watchdog_Failure: RteEventRef=OpEventGetEventFreezeFrameDataEx_GetEventFreezeFrameDataEx_Event_Radar_Module_Watchdog_Failure
        OpEventGetEventFreezeFrameDataEx_GetEventFreezeFrameDataEx_EvtInfo_SAS_ECU_SAS_message_Missing_Message: RteEventRef=OpEventGetEventFreezeFrameDataEx_GetEventFreezeFrameDataEx_EvtInfo_SAS_ECU_SAS_message_Missing_Message
        OpEventGetEventFreezeFrameDataEx_GetEventFreezeFrameDataEx_Event_SAS_ECU_SAS_message_Missing_Message: RteEventRef=OpEventGetEventFreezeFrameDataEx_GetEventFreezeFrameDataEx_Event_SAS_ECU_SAS_message_Missing_Message
        OpEventGetEventFreezeFrameDataEx_GetEventFreezeFrameDataEx_EvtInfo_ECU_NVM_Corruption_Program_memory_Failure: RteEventRef=OpEventGetEventFreezeFrameDataEx_GetEventFreezeFrameDataEx_EvtInfo_ECU_NVM_Corruption_Program_memory_Failure
        OpEventGetEventFreezeFrameDataEx_GetEventFreezeFrameDataEx_Event_ECU_NVM_Corruption_Program_memory_Failure: RteEventRef=OpEventGetEventFreezeFrameDataEx_GetEventFreezeFrameDataEx_Event_ECU_NVM_Corruption_Program_memory_Failure
        OpEventGetEventFreezeFrameDataEx_GetEventFreezeFrameDataEx_EvtInfo_Cluster_ECU_TD_message_Missing_Message: RteEventRef=OpEventGetEventFreezeFrameDataEx_GetEventFreezeFrameDataEx_EvtInfo_Cluster_ECU_TD_message_Missing_Message
        OpEventGetEventFreezeFrameDataEx_GetEventFreezeFrameDataEx_Event_Cluster_ECU_TD_message_Missing_Message: RteEventRef=OpEventGetEventFreezeFrameDataEx_GetEventFreezeFrameDataEx_Event_Cluster_ECU_TD_message_Missing_Message
        OpEventGetEventFreezeFrameDataEx_GetEventFreezeFrameDataEx_EvtInfo_PCAN_Communication_Bus_Off: RteEventRef=OpEventGetEventFreezeFrameDataEx_GetEventFreezeFrameDataEx_EvtInfo_PCAN_Communication_Bus_Off
        OpEventGetEventFreezeFrameDataEx_GetEventFreezeFrameDataEx_Event_PCAN_Communication_Bus_Off: RteEventRef=OpEventGetEventFreezeFrameDataEx_GetEventFreezeFrameDataEx_Event_PCAN_Communication_Bus_Off
        OpEventGetEventFreezeFrameDataEx_GetEventFreezeFrameDataEx_EvtInfo_Front_Left_Side_Radar_Missing_Message: RteEventRef=OpEventGetEventFreezeFrameDataEx_GetEventFreezeFrameDataEx_EvtInfo_Front_Left_Side_Radar_Missing_Message
        OpEventGetEventFreezeFrameDataEx_GetEventFreezeFrameDataEx_Event_Front_Left_Side_Radar_Missing_Message: RteEventRef=OpEventGetEventFreezeFrameDataEx_GetEventFreezeFrameDataEx_Event_Front_Left_Side_Radar_Missing_Message
        OpEventGetEventFreezeFrameDataEx_GetEventFreezeFrameDataEx_EvtInfo_Manual_ETC2_message_Transcurrent_gear_Invalid_Serial_efa4be3d: RteEventRef=OpEventGetEventFreezeFrameDataEx_GetEventFreezeFrameDataEx_EvtInfo_Manual_ETC2_message_Transcurrent_gear_Invalid_Serial_efa4be3d
        OpEventGetEventFreezeFrameDataEx_GetEventFreezeFrameDataEx_Event_Manual_ETC2_message_Transcurrent_gear_Invalid_Serial_D_b8e002fa: RteEventRef=OpEventGetEventFreezeFrameDataEx_GetEventFreezeFrameDataEx_Event_Manual_ETC2_message_Transcurrent_gear_Invalid_Serial_D_b8e002fa
        OpEventGetEventFreezeFrameDataEx_GetEventFreezeFrameDataEx_EvtInfo_SAS_ECU_erratic_communication_Erratic: RteEventRef=OpEventGetEventFreezeFrameDataEx_GetEventFreezeFrameDataEx_EvtInfo_SAS_ECU_erratic_communication_Erratic
        OpEventGetEventFreezeFrameDataEx_GetEventFreezeFrameDataEx_Event_SAS_ECU_erratic_communication_Erratic: RteEventRef=OpEventGetEventFreezeFrameDataEx_GetEventFreezeFrameDataEx_Event_SAS_ECU_erratic_communication_Erratic
        OpEventGetEventFreezeFrameDataEx_GetEventFreezeFrameDataEx_EvtInfo_VDC2_message_Yaw_rate_Invalid_Serial_Data_Received: RteEventRef=OpEventGetEventFreezeFrameDataEx_GetEventFreezeFrameDataEx_EvtInfo_VDC2_message_Yaw_rate_Invalid_Serial_Data_Received
        OpEventGetEventFreezeFrameDataEx_GetEventFreezeFrameDataEx_Event_VDC2_message_Yaw_rate_Invalid_Serial_Data_Received: RteEventRef=OpEventGetEventFreezeFrameDataEx_GetEventFreezeFrameDataEx_Event_VDC2_message_Yaw_rate_Invalid_Serial_Data_Received
        OpEventGetEventFreezeFrameDataEx_GetEventFreezeFrameDataEx_EvtInfo_Cluster_ECU_TD_erratic_communication_Erratic: RteEventRef=OpEventGetEventFreezeFrameDataEx_GetEventFreezeFrameDataEx_EvtInfo_Cluster_ECU_TD_erratic_communication_Erratic
        OpEventGetEventFreezeFrameDataEx_GetEventFreezeFrameDataEx_Event_Cluster_ECU_TD_erratic_communication_Erratic: RteEventRef=OpEventGetEventFreezeFrameDataEx_GetEventFreezeFrameDataEx_Event_Cluster_ECU_TD_erratic_communication_Erratic
        OpEventGetEventFreezeFrameDataEx_GetEventFreezeFrameDataEx_EvtInfo_EMS_ECU_CCVS1_message_Missing_Message: RteEventRef=OpEventGetEventFreezeFrameDataEx_GetEventFreezeFrameDataEx_EvtInfo_EMS_ECU_CCVS1_message_Missing_Message
        OpEventGetEventFreezeFrameDataEx_GetEventFreezeFrameDataEx_Event_EMS_ECU_CCVS1_message_Missing_Message: RteEventRef=OpEventGetEventFreezeFrameDataEx_GetEventFreezeFrameDataEx_Event_EMS_ECU_CCVS1_message_Missing_Message
        OpEventGetEventFreezeFrameDataEx_GetEventFreezeFrameDataEx_EvtInfo_Radar_Mounting_Orientation_Incorrect_Assembly: RteEventRef=OpEventGetEventFreezeFrameDataEx_GetEventFreezeFrameDataEx_EvtInfo_Radar_Mounting_Orientation_Incorrect_Assembly
        OpEventGetEventFreezeFrameDataEx_GetEventFreezeFrameDataEx_Event_Radar_Mounting_Orientation_Incorrect_Assembly: RteEventRef=OpEventGetEventFreezeFrameDataEx_GetEventFreezeFrameDataEx_Event_Radar_Mounting_Orientation_Incorrect_Assembly
        OpEventGetEventFreezeFrameDataEx_GetEventFreezeFrameDataEx_EvtInfo_EMS_ECU_ETC2_erratic_communication_Erractic: RteEventRef=OpEventGetEventFreezeFrameDataEx_GetEventFreezeFrameDataEx_EvtInfo_EMS_ECU_ETC2_erratic_communication_Erractic
        OpEventGetEventFreezeFrameDataEx_GetEventFreezeFrameDataEx_Event_EMS_ECU_ETC2_erratic_communication_Erractic: RteEventRef=OpEventGetEventFreezeFrameDataEx_GetEventFreezeFrameDataEx_Event_EMS_ECU_ETC2_erratic_communication_Erractic
        OpEventGetEventFreezeFrameDataEx_GetEventFreezeFrameDataEx_EvtInfo_Cluster_ECU_ADAS_FN_STS_erratic_communication_Erratic: RteEventRef=OpEventGetEventFreezeFrameDataEx_GetEventFreezeFrameDataEx_EvtInfo_Cluster_ECU_ADAS_FN_STS_erratic_communication_Erratic
        OpEventGetEventFreezeFrameDataEx_GetEventFreezeFrameDataEx_Event_Cluster_ECU_ADAS_FN_STS_erratic_communication_Erratic: RteEventRef=OpEventGetEventFreezeFrameDataEx_GetEventFreezeFrameDataEx_Event_Cluster_ECU_ADAS_FN_STS_erratic_communication_Erratic
        OpEventGetEventFreezeFrameDataEx_GetEventFreezeFrameDataEx_EvtInfo_ESC_ECU_VDC2_message_Missing_Message: RteEventRef=OpEventGetEventFreezeFrameDataEx_GetEventFreezeFrameDataEx_EvtInfo_ESC_ECU_VDC2_message_Missing_Message
        OpEventGetEventFreezeFrameDataEx_GetEventFreezeFrameDataEx_Event_ESC_ECU_VDC2_message_Missing_Message: RteEventRef=OpEventGetEventFreezeFrameDataEx_GetEventFreezeFrameDataEx_Event_ESC_ECU_VDC2_message_Missing_Message
        OpEventGetEventFreezeFrameDataEx_GetEventFreezeFrameDataEx_EvtInfo_CLS_TX_16_message_Transmission_Type_info_Invalid_Ser_553cfe21: RteEventRef=OpEventGetEventFreezeFrameDataEx_GetEventFreezeFrameDataEx_EvtInfo_CLS_TX_16_message_Transmission_Type_info_Invalid_Ser_553cfe21
        OpEventGetEventFreezeFrameDataEx_GetEventFreezeFrameDataEx_Event_CLS_TX_16_message_Transmission_Type_info_Invalid_Seria_f81d1a8e: RteEventRef=OpEventGetEventFreezeFrameDataEx_GetEventFreezeFrameDataEx_Event_CLS_TX_16_message_Transmission_Type_info_Invalid_Seria_f81d1a8e
        OpEventGetEventFreezeFrameDataEx_GetEventFreezeFrameDataEx_EvtInfo_Cluster_ECU_CLS_Tx_4_erratic_communication_Erratic: RteEventRef=OpEventGetEventFreezeFrameDataEx_GetEventFreezeFrameDataEx_EvtInfo_Cluster_ECU_CLS_Tx_4_erratic_communication_Erratic
        OpEventGetEventFreezeFrameDataEx_GetEventFreezeFrameDataEx_Event_Cluster_ECU_CLS_Tx_4_erratic_communication_Erratic: RteEventRef=OpEventGetEventFreezeFrameDataEx_GetEventFreezeFrameDataEx_Event_Cluster_ECU_CLS_Tx_4_erratic_communication_Erratic
        OpEventGetEventFreezeFrameDataEx_GetEventFreezeFrameDataEx_EvtInfo_Cluster_ECU_ADAS_FN_STS_message_Missing_Message: RteEventRef=OpEventGetEventFreezeFrameDataEx_GetEventFreezeFrameDataEx_EvtInfo_Cluster_ECU_ADAS_FN_STS_message_Missing_Message
        OpEventGetEventFreezeFrameDataEx_GetEventFreezeFrameDataEx_Event_Cluster_ECU_ADAS_FN_STS_message_Missing_Message: RteEventRef=OpEventGetEventFreezeFrameDataEx_GetEventFreezeFrameDataEx_Event_Cluster_ECU_ADAS_FN_STS_message_Missing_Message
        OpEventGetEventFreezeFrameDataEx_GetEventFreezeFrameDataEx_EvtInfo_Vehicle_Dataset_value_of_signal_protection_calculati_d72c87b5: RteEventRef=OpEventGetEventFreezeFrameDataEx_GetEventFreezeFrameDataEx_EvtInfo_Vehicle_Dataset_value_of_signal_protection_calculati_d72c87b5
        OpEventGetEventFreezeFrameDataEx_GetEventFreezeFrameDataEx_Event_Vehicle_Dataset_value_of_signal_protection_calculation_0750780b: RteEventRef=OpEventGetEventFreezeFrameDataEx_GetEventFreezeFrameDataEx_Event_Vehicle_Dataset_value_of_signal_protection_calculation_0750780b
        OpEventGetEventFreezeFrameDataEx_GetEventFreezeFrameDataEx_EvtInfo_Cluster_ECU_CLS_Tx_16_erratic_communication_Erratic: RteEventRef=OpEventGetEventFreezeFrameDataEx_GetEventFreezeFrameDataEx_EvtInfo_Cluster_ECU_CLS_Tx_16_erratic_communication_Erratic
        OpEventGetEventFreezeFrameDataEx_GetEventFreezeFrameDataEx_Event_Cluster_ECU_CLS_Tx_16_erratic_communication_Erratic: RteEventRef=OpEventGetEventFreezeFrameDataEx_GetEventFreezeFrameDataEx_Event_Cluster_ECU_CLS_Tx_16_erratic_communication_Erratic
        OpEventGetEventFreezeFrameDataEx_GetEventFreezeFrameDataEx_EvtInfo_Cluster_ECU_OEL_erratic_communication_Erratic: RteEventRef=OpEventGetEventFreezeFrameDataEx_GetEventFreezeFrameDataEx_EvtInfo_Cluster_ECU_OEL_erratic_communication_Erratic
        OpEventGetEventFreezeFrameDataEx_GetEventFreezeFrameDataEx_Event_Cluster_ECU_OEL_erratic_communication_Erratic: RteEventRef=OpEventGetEventFreezeFrameDataEx_GetEventFreezeFrameDataEx_Event_Cluster_ECU_OEL_erratic_communication_Erratic
        OpEventGetEventFreezeFrameDataEx_GetEventFreezeFrameDataEx_EvtInfo_Cluster_ECU_CLS_Tx_4_message_Missing_Message: RteEventRef=OpEventGetEventFreezeFrameDataEx_GetEventFreezeFrameDataEx_EvtInfo_Cluster_ECU_CLS_Tx_4_message_Missing_Message
        OpEventGetEventFreezeFrameDataEx_GetEventFreezeFrameDataEx_Event_Cluster_ECU_CLS_Tx_4_message_Missing_Message: RteEventRef=OpEventGetEventFreezeFrameDataEx_GetEventFreezeFrameDataEx_Event_Cluster_ECU_CLS_Tx_4_message_Missing_Message
        OpEventGetEventFreezeFrameDataEx_GetEventFreezeFrameDataEx_EvtInfo_Radar_Performance_Capability_Algorithm_Based_Failure: RteEventRef=OpEventGetEventFreezeFrameDataEx_GetEventFreezeFrameDataEx_EvtInfo_Radar_Performance_Capability_Algorithm_Based_Failure
        OpEventGetEventFreezeFrameDataEx_GetEventFreezeFrameDataEx_Event_Radar_Performance_Capability_Algorithm_Based_Failure: RteEventRef=OpEventGetEventFreezeFrameDataEx_GetEventFreezeFrameDataEx_Event_Radar_Performance_Capability_Algorithm_Based_Failure
        OpEventGetEventFreezeFrameDataEx_GetEventFreezeFrameDataEx_EvtInfo_Radar_AutoAlignment_Range_Alignment_or_Adjustement_Incorrect: RteEventRef=OpEventGetEventFreezeFrameDataEx_GetEventFreezeFrameDataEx_EvtInfo_Radar_AutoAlignment_Range_Alignment_or_Adjustement_Incorrect
        OpEventGetEventFreezeFrameDataEx_GetEventFreezeFrameDataEx_Event_Radar_AutoAlignment_Range_Alignment_or_Adjustement_Incorrect: RteEventRef=OpEventGetEventFreezeFrameDataEx_GetEventFreezeFrameDataEx_Event_Radar_AutoAlignment_Range_Alignment_or_Adjustement_Incorrect
        OpEventGetEventFreezeFrameDataEx_GetEventFreezeFrameDataEx_EvtInfo_EMS_ECU_CCVS1_erratic_communication_Erractic: RteEventRef=OpEventGetEventFreezeFrameDataEx_GetEventFreezeFrameDataEx_EvtInfo_EMS_ECU_CCVS1_erratic_communication_Erractic
        OpEventGetEventFreezeFrameDataEx_GetEventFreezeFrameDataEx_Event_EMS_ECU_CCVS1_erratic_communication_Erractic: RteEventRef=OpEventGetEventFreezeFrameDataEx_GetEventFreezeFrameDataEx_Event_EMS_ECU_CCVS1_erratic_communication_Erractic
        OpEventGetEventFreezeFrameDataEx_GetEventFreezeFrameDataEx_EvtInfo_Radar_System_Battery_Low_Voltage_System_Voltage_Low: RteEventRef=OpEventGetEventFreezeFrameDataEx_GetEventFreezeFrameDataEx_EvtInfo_Radar_System_Battery_Low_Voltage_System_Voltage_Low
        OpEventGetEventFreezeFrameDataEx_GetEventFreezeFrameDataEx_Event_Radar_System_Battery_Low_Voltage_System_Voltage_Low: RteEventRef=OpEventGetEventFreezeFrameDataEx_GetEventFreezeFrameDataEx_Event_Radar_System_Battery_Low_Voltage_System_Voltage_Low
        OpEventGetEventFreezeFrameDataEx_GetEventFreezeFrameDataEx_EvtInfo_Radar_SMC_General_Checksum_Failure: RteEventRef=OpEventGetEventFreezeFrameDataEx_GetEventFreezeFrameDataEx_EvtInfo_Radar_SMC_General_Checksum_Failure
        OpEventGetEventFreezeFrameDataEx_GetEventFreezeFrameDataEx_Event_Radar_SMC_General_Checksum_Failure: RteEventRef=OpEventGetEventFreezeFrameDataEx_GetEventFreezeFrameDataEx_Event_Radar_SMC_General_Checksum_Failure
        OpEventGetEventFreezeFrameDataEx_GetEventFreezeFrameDataEx_EvtInfo_Radar_Pin_Position_Wrong_Mounting_Position: RteEventRef=OpEventGetEventFreezeFrameDataEx_GetEventFreezeFrameDataEx_EvtInfo_Radar_Pin_Position_Wrong_Mounting_Position
        OpEventGetEventFreezeFrameDataEx_GetEventFreezeFrameDataEx_Event_Radar_Pin_Position_Wrong_Mounting_Position: RteEventRef=OpEventGetEventFreezeFrameDataEx_GetEventFreezeFrameDataEx_Event_Radar_Pin_Position_Wrong_Mounting_Position
        OpEventGetEventFreezeFrameDataEx_GetEventFreezeFrameDataEx_EvtInfo_VDC2_message_Lateral_Accleration_Invalid_Serial_Data_Received: RteEventRef=OpEventGetEventFreezeFrameDataEx_GetEventFreezeFrameDataEx_EvtInfo_VDC2_message_Lateral_Accleration_Invalid_Serial_Data_Received
        OpEventGetEventFreezeFrameDataEx_GetEventFreezeFrameDataEx_Event_VDC2_message_Lateral_Accleration_Invalid_Serial_Data_Received: RteEventRef=OpEventGetEventFreezeFrameDataEx_GetEventFreezeFrameDataEx_Event_VDC2_message_Lateral_Accleration_Invalid_Serial_Data_Received
        OpEventGetEventFreezeFrameDataEx_GetEventFreezeFrameDataEx_EvtInfo_ADAS_FN_STS_message_BSIS_FN_Switch_STS_Invalid_Seria_f2c802c5: RteEventRef=OpEventGetEventFreezeFrameDataEx_GetEventFreezeFrameDataEx_EvtInfo_ADAS_FN_STS_message_BSIS_FN_Switch_STS_Invalid_Seria_f2c802c5
        OpEventGetEventFreezeFrameDataEx_GetEventFreezeFrameDataEx_Event_ADAS_FN_STS_message_BSIS_FN_Switch_STS_Invalid_Serial_f79f116a: RteEventRef=OpEventGetEventFreezeFrameDataEx_GetEventFreezeFrameDataEx_Event_ADAS_FN_STS_message_BSIS_FN_Switch_STS_Invalid_Serial_f79f116a
        OpEventGetEventFreezeFrameDataEx_GetEventFreezeFrameDataEx_EvtInfo_Radar_AutoAlignment_Misalignment_Performance_or_Inco_a491aa6c: RteEventRef=OpEventGetEventFreezeFrameDataEx_GetEventFreezeFrameDataEx_EvtInfo_Radar_AutoAlignment_Misalignment_Performance_or_Inco_a491aa6c
        OpEventGetEventFreezeFrameDataEx_GetEventFreezeFrameDataEx_Event_Radar_AutoAlignment_Misalignment_Performance_or_Incorr_a1c6b9c3: RteEventRef=OpEventGetEventFreezeFrameDataEx_GetEventFreezeFrameDataEx_Event_Radar_AutoAlignment_Misalignment_Performance_or_Incorr_a1c6b9c3
        OpEventGetEventFreezeFrameDataEx_GetEventFreezeFrameDataEx_EvtInfo_ESC_ECU_VDC2_erratic_communication_Erratic: RteEventRef=OpEventGetEventFreezeFrameDataEx_GetEventFreezeFrameDataEx_EvtInfo_ESC_ECU_VDC2_erratic_communication_Erratic
        OpEventGetEventFreezeFrameDataEx_GetEventFreezeFrameDataEx_Event_ESC_ECU_VDC2_erratic_communication_Erratic: RteEventRef=OpEventGetEventFreezeFrameDataEx_GetEventFreezeFrameDataEx_Event_ESC_ECU_VDC2_erratic_communication_Erratic
        OpEventGetEventFreezeFrameDataEx_GetEventFreezeFrameDataEx_EvtInfo_Application_Interface_Lookup_Performance_or_Incorrec_c1c0384c: RteEventRef=OpEventGetEventFreezeFrameDataEx_GetEventFreezeFrameDataEx_EvtInfo_Application_Interface_Lookup_Performance_or_Incorrec_c1c0384c
        OpEventGetEventFreezeFrameDataEx_GetEventFreezeFrameDataEx_Event_Application_Interface_Lookup_Performance_or_Incorrect_Operation: RteEventRef=OpEventGetEventFreezeFrameDataEx_GetEventFreezeFrameDataEx_Event_Application_Interface_Lookup_Performance_or_Incorrect_Operation
        OpEventGetEventFreezeFrameDataEx_GetEventFreezeFrameDataEx_EvtInfo_EMS_ECU_VD_message_Missing_Message: RteEventRef=OpEventGetEventFreezeFrameDataEx_GetEventFreezeFrameDataEx_EvtInfo_EMS_ECU_VD_message_Missing_Message
        OpEventGetEventFreezeFrameDataEx_GetEventFreezeFrameDataEx_Event_EMS_ECU_VD_message_Missing_Message: RteEventRef=OpEventGetEventFreezeFrameDataEx_GetEventFreezeFrameDataEx_Event_EMS_ECU_VD_message_Missing_Message
        OpEventGetEventFreezeFrameDataEx_GetEventFreezeFrameDataEx_EvtInfo_Radar_Platform_Time_System_Programming_Failure: RteEventRef=OpEventGetEventFreezeFrameDataEx_GetEventFreezeFrameDataEx_EvtInfo_Radar_Platform_Time_System_Programming_Failure
        OpEventGetEventFreezeFrameDataEx_GetEventFreezeFrameDataEx_Event_Radar_Platform_Time_System_Programming_Failure: RteEventRef=OpEventGetEventFreezeFrameDataEx_GetEventFreezeFrameDataEx_Event_Radar_Platform_Time_System_Programming_Failure
        OpEventGetEventFreezeFrameDataEx_GetEventFreezeFrameDataEx_EvtInfo_OEL_message_Turn_Signal_Switch_Invalid_Serial_Data_Received: RteEventRef=OpEventGetEventFreezeFrameDataEx_GetEventFreezeFrameDataEx_EvtInfo_OEL_message_Turn_Signal_Switch_Invalid_Serial_Data_Received
        OpEventGetEventFreezeFrameDataEx_GetEventFreezeFrameDataEx_Event_OEL_message_Turn_Signal_Switch_Invalid_Serial_Data_Received: RteEventRef=OpEventGetEventFreezeFrameDataEx_GetEventFreezeFrameDataEx_Event_OEL_message_Turn_Signal_Switch_Invalid_Serial_Data_Received
        OpEventGetEventFreezeFrameDataEx_GetEventFreezeFrameDataEx_EvtInfo_Radar_calibration_Calibration_or_Paramater_Memory_Failure: RteEventRef=OpEventGetEventFreezeFrameDataEx_GetEventFreezeFrameDataEx_EvtInfo_Radar_calibration_Calibration_or_Paramater_Memory_Failure
        OpEventGetEventFreezeFrameDataEx_GetEventFreezeFrameDataEx_Event_Radar_calibration_Calibration_or_Paramater_Memory_Failure: RteEventRef=OpEventGetEventFreezeFrameDataEx_GetEventFreezeFrameDataEx_Event_Radar_calibration_Calibration_or_Paramater_Memory_Failure
        OpEventGetEventFreezeFrameDataEx_GetEventFreezeFrameDataEx_GeneralEvtInfo: RteEventRef=OpEventGetEventFreezeFrameDataEx_GetEventFreezeFrameDataEx_GeneralEvtInfo
        OpEventGetEventExtendedDataRecordEx_GetEventExtendedDataRecordEx_EvtInfo_SAS_message_Steering_Wheel_Angle_Invalid_Seria_f6ef6b8e: RteEventRef=OpEventGetEventExtendedDataRecordEx_GetEventExtendedDataRecordEx_EvtInfo_SAS_message_Steering_Wheel_Angle_Invalid_Seria_f6ef6b8e
        OpEventGetEventExtendedDataRecordEx_GetEventExtendedDataRecordEx_Event_SAS_message_Steering_Wheel_Angle_Invalid_Serial_3dd17937: RteEventRef=OpEventGetEventExtendedDataRecordEx_GetEventExtendedDataRecordEx_Event_SAS_message_Steering_Wheel_Angle_Invalid_Serial_3dd17937
        OpEventGetEventExtendedDataRecordEx_GetEventExtendedDataRecordEx_EvtInfo_AT_AMT_ETC2_message_Transcurrent_gear_Invalid_040ddf16: RteEventRef=OpEventGetEventExtendedDataRecordEx_GetEventExtendedDataRecordEx_EvtInfo_AT_AMT_ETC2_message_Transcurrent_gear_Invalid_040ddf16
        OpEventGetEventExtendedDataRecordEx_GetEventExtendedDataRecordEx_Event_AT_AMT_ETC2_message_Transcurrent_gear_Invalid_Se_e531ec78: RteEventRef=OpEventGetEventExtendedDataRecordEx_GetEventExtendedDataRecordEx_Event_AT_AMT_ETC2_message_Transcurrent_gear_Invalid_Se_e531ec78
        OpEventGetEventExtendedDataRecordEx_GetEventExtendedDataRecordEx_EvtInfo_Radar_AutoAlignment_Algorithm_Signal_Calculati_cadbd56c: RteEventRef=OpEventGetEventExtendedDataRecordEx_GetEventExtendedDataRecordEx_EvtInfo_Radar_AutoAlignment_Algorithm_Signal_Calculati_cadbd56c
        OpEventGetEventExtendedDataRecordEx_GetEventExtendedDataRecordEx_Event_Radar_AutoAlignment_Algorithm_Signal_Calculation_Failure: RteEventRef=OpEventGetEventExtendedDataRecordEx_GetEventExtendedDataRecordEx_Event_Radar_AutoAlignment_Algorithm_Signal_Calculation_Failure
        OpEventGetEventExtendedDataRecordEx_GetEventExtendedDataRecordEx_EvtInfo_Vehicle_DataSet_Not_Configured: RteEventRef=OpEventGetEventExtendedDataRecordEx_GetEventExtendedDataRecordEx_EvtInfo_Vehicle_DataSet_Not_Configured
        OpEventGetEventExtendedDataRecordEx_GetEventExtendedDataRecordEx_Event_Vehicle_DataSet_Not_Configured: RteEventRef=OpEventGetEventExtendedDataRecordEx_GetEventExtendedDataRecordEx_Event_Vehicle_DataSet_Not_Configured
        OpEventGetEventExtendedDataRecordEx_GetEventExtendedDataRecordEx_EvtInfo_Radar_Module_System_Internal_Failure: RteEventRef=OpEventGetEventExtendedDataRecordEx_GetEventExtendedDataRecordEx_EvtInfo_Radar_Module_System_Internal_Failure
        OpEventGetEventExtendedDataRecordEx_GetEventExtendedDataRecordEx_Event_Radar_Module_System_Internal_Failure: RteEventRef=OpEventGetEventExtendedDataRecordEx_GetEventExtendedDataRecordEx_Event_Radar_Module_System_Internal_Failure
        OpEventGetEventExtendedDataRecordEx_GetEventExtendedDataRecordEx_EvtInfo_Radar_MMIC_Component_Failure: RteEventRef=OpEventGetEventExtendedDataRecordEx_GetEventExtendedDataRecordEx_EvtInfo_Radar_MMIC_Component_Failure
        OpEventGetEventExtendedDataRecordEx_GetEventExtendedDataRecordEx_Event_Radar_MMIC_Component_Failure: RteEventRef=OpEventGetEventExtendedDataRecordEx_GetEventExtendedDataRecordEx_Event_Radar_MMIC_Component_Failure
        OpEventGetEventExtendedDataRecordEx_GetEventExtendedDataRecordEx_EvtInfo_Radar_Module_General_Memory_Failure: RteEventRef=OpEventGetEventExtendedDataRecordEx_GetEventExtendedDataRecordEx_EvtInfo_Radar_Module_General_Memory_Failure
        OpEventGetEventExtendedDataRecordEx_GetEventExtendedDataRecordEx_Event_Radar_Module_General_Memory_Failure: RteEventRef=OpEventGetEventExtendedDataRecordEx_GetEventExtendedDataRecordEx_Event_Radar_Module_General_Memory_Failure
        OpEventGetEventExtendedDataRecordEx_GetEventExtendedDataRecordEx_EvtInfo_Radar_System_Battery_High_Voltage_System_Voltage_High: RteEventRef=OpEventGetEventExtendedDataRecordEx_GetEventExtendedDataRecordEx_EvtInfo_Radar_System_Battery_High_Voltage_System_Voltage_High
        OpEventGetEventExtendedDataRecordEx_GetEventExtendedDataRecordEx_Event_Radar_System_Battery_High_Voltage_System_Voltage_High: RteEventRef=OpEventGetEventExtendedDataRecordEx_GetEventExtendedDataRecordEx_Event_Radar_System_Battery_High_Voltage_System_Voltage_High
        OpEventGetEventExtendedDataRecordEx_GetEventExtendedDataRecordEx_EvtInfo_CCVS1_message_Vehicle_Speed_Invalid_Serial_Dat_90bf66b5: RteEventRef=OpEventGetEventExtendedDataRecordEx_GetEventExtendedDataRecordEx_EvtInfo_CCVS1_message_Vehicle_Speed_Invalid_Serial_Dat_90bf66b5
        OpEventGetEventExtendedDataRecordEx_GetEventExtendedDataRecordEx_Event_CCVS1_message_Vehicle_Speed_Invalid_Serial_Data_Received: RteEventRef=OpEventGetEventExtendedDataRecordEx_GetEventExtendedDataRecordEx_Event_CCVS1_message_Vehicle_Speed_Invalid_Serial_Data_Received
        OpEventGetEventExtendedDataRecordEx_GetEventExtendedDataRecordEx_EvtInfo_EMS_ECU_VD_erratic_communication_Erratic: RteEventRef=OpEventGetEventExtendedDataRecordEx_GetEventExtendedDataRecordEx_EvtInfo_EMS_ECU_VD_erratic_communication_Erratic
        OpEventGetEventExtendedDataRecordEx_GetEventExtendedDataRecordEx_Event_EMS_ECU_VD_erratic_communication_Erratic: RteEventRef=OpEventGetEventExtendedDataRecordEx_GetEventExtendedDataRecordEx_Event_EMS_ECU_VD_erratic_communication_Erratic
        OpEventGetEventExtendedDataRecordEx_GetEventExtendedDataRecordEx_EvtInfo_EMS_ECU_ETC2_00_message_Missing_Message: RteEventRef=OpEventGetEventExtendedDataRecordEx_GetEventExtendedDataRecordEx_EvtInfo_EMS_ECU_ETC2_00_message_Missing_Message
        OpEventGetEventExtendedDataRecordEx_GetEventExtendedDataRecordEx_Event_EMS_ECU_ETC2_00_message_Missing_Message: RteEventRef=OpEventGetEventExtendedDataRecordEx_GetEventExtendedDataRecordEx_Event_EMS_ECU_ETC2_00_message_Missing_Message
        OpEventGetEventExtendedDataRecordEx_GetEventExtendedDataRecordEx_EvtInfo_Cluster_ECU_CLS_Tx_16_message_Missing_Message: RteEventRef=OpEventGetEventExtendedDataRecordEx_GetEventExtendedDataRecordEx_EvtInfo_Cluster_ECU_CLS_Tx_16_message_Missing_Message
        OpEventGetEventExtendedDataRecordEx_GetEventExtendedDataRecordEx_Event_Cluster_ECU_CLS_Tx_16_message_Missing_Message: RteEventRef=OpEventGetEventExtendedDataRecordEx_GetEventExtendedDataRecordEx_Event_Cluster_ECU_CLS_Tx_16_message_Missing_Message
        OpEventGetEventExtendedDataRecordEx_GetEventExtendedDataRecordEx_EvtInfo_Exceeded_Security_Access_0x27_Attempt_Threshol_6d3a8fb9: RteEventRef=OpEventGetEventExtendedDataRecordEx_GetEventExtendedDataRecordEx_EvtInfo_Exceeded_Security_Access_0x27_Attempt_Threshol_6d3a8fb9
        OpEventGetEventExtendedDataRecordEx_GetEventExtendedDataRecordEx_Event_Exceeded_Security_Access_0x27_Attempt_Threshold_3410ff51: RteEventRef=OpEventGetEventExtendedDataRecordEx_GetEventExtendedDataRecordEx_Event_Exceeded_Security_Access_0x27_Attempt_Threshold_3410ff51
        OpEventGetEventExtendedDataRecordEx_GetEventExtendedDataRecordEx_EvtInfo_Front_Left_Side_Radar_value_of_signal_protecti_27a35bf1: RteEventRef=OpEventGetEventExtendedDataRecordEx_GetEventExtendedDataRecordEx_EvtInfo_Front_Left_Side_Radar_value_of_signal_protecti_27a35bf1
        OpEventGetEventExtendedDataRecordEx_GetEventExtendedDataRecordEx_Event_Front_Left_Side_Radar_value_of_signal_protection_7e892b19: RteEventRef=OpEventGetEventExtendedDataRecordEx_GetEventExtendedDataRecordEx_Event_Front_Left_Side_Radar_value_of_signal_protection_7e892b19
        OpEventGetEventExtendedDataRecordEx_GetEventExtendedDataRecordEx_EvtInfo_AT_AMT_ETC2_erratic_communication_Erratic: RteEventRef=OpEventGetEventExtendedDataRecordEx_GetEventExtendedDataRecordEx_EvtInfo_AT_AMT_ETC2_erratic_communication_Erratic
        OpEventGetEventExtendedDataRecordEx_GetEventExtendedDataRecordEx_Event_AT_AMT_ETC2_erratic_communication_Erratic: RteEventRef=OpEventGetEventExtendedDataRecordEx_GetEventExtendedDataRecordEx_Event_AT_AMT_ETC2_erratic_communication_Erratic
        OpEventGetEventExtendedDataRecordEx_GetEventExtendedDataRecordEx_EvtInfo_VCAN_Communication_Bus_Off: RteEventRef=OpEventGetEventExtendedDataRecordEx_GetEventExtendedDataRecordEx_EvtInfo_VCAN_Communication_Bus_Off
        OpEventGetEventExtendedDataRecordEx_GetEventExtendedDataRecordEx_Event_VCAN_Communication_Bus_Off: RteEventRef=OpEventGetEventExtendedDataRecordEx_GetEventExtendedDataRecordEx_Event_VCAN_Communication_Bus_Off
        OpEventGetEventExtendedDataRecordEx_GetEventExtendedDataRecordEx_EvtInfo_VDC2_message_LongitudinalAcceleration_Invalid_84e185b9: RteEventRef=OpEventGetEventExtendedDataRecordEx_GetEventExtendedDataRecordEx_EvtInfo_VDC2_message_LongitudinalAcceleration_Invalid_84e185b9
        OpEventGetEventExtendedDataRecordEx_GetEventExtendedDataRecordEx_Event_VDC2_message_LongitudinalAcceleration_Invalid_Se_65ddb6d7: RteEventRef=OpEventGetEventExtendedDataRecordEx_GetEventExtendedDataRecordEx_Event_VDC2_message_LongitudinalAcceleration_Invalid_Se_65ddb6d7
        OpEventGetEventExtendedDataRecordEx_GetEventExtendedDataRecordEx_EvtInfo_Radar_MMIC_RFBIST_Component_Internal_Failure: RteEventRef=OpEventGetEventExtendedDataRecordEx_GetEventExtendedDataRecordEx_EvtInfo_Radar_MMIC_RFBIST_Component_Internal_Failure
        OpEventGetEventExtendedDataRecordEx_GetEventExtendedDataRecordEx_Event_Radar_MMIC_RFBIST_Component_Internal_Failure: RteEventRef=OpEventGetEventExtendedDataRecordEx_GetEventExtendedDataRecordEx_Event_Radar_MMIC_RFBIST_Component_Internal_Failure
        OpEventGetEventExtendedDataRecordEx_GetEventExtendedDataRecordEx_EvtInfo_Radar_Initial_Alignment_Missing_Calibration: RteEventRef=OpEventGetEventExtendedDataRecordEx_GetEventExtendedDataRecordEx_EvtInfo_Radar_Initial_Alignment_Missing_Calibration
        OpEventGetEventExtendedDataRecordEx_GetEventExtendedDataRecordEx_Event_Radar_Initial_Alignment_Missing_Calibration: RteEventRef=OpEventGetEventExtendedDataRecordEx_GetEventExtendedDataRecordEx_Event_Radar_Initial_Alignment_Missing_Calibration
        OpEventGetEventExtendedDataRecordEx_GetEventExtendedDataRecordEx_EvtInfo_Cluster_ECU_OEL_message_Missing_Message: RteEventRef=OpEventGetEventExtendedDataRecordEx_GetEventExtendedDataRecordEx_EvtInfo_Cluster_ECU_OEL_message_Missing_Message
        OpEventGetEventExtendedDataRecordEx_GetEventExtendedDataRecordEx_Event_Cluster_ECU_OEL_message_Missing_Message: RteEventRef=OpEventGetEventExtendedDataRecordEx_GetEventExtendedDataRecordEx_Event_Cluster_ECU_OEL_message_Missing_Message
        OpEventGetEventExtendedDataRecordEx_GetEventExtendedDataRecordEx_EvtInfo_AT_AMT_ECU_ETC2_03_message_Missing_Message: RteEventRef=OpEventGetEventExtendedDataRecordEx_GetEventExtendedDataRecordEx_EvtInfo_AT_AMT_ECU_ETC2_03_message_Missing_Message
        OpEventGetEventExtendedDataRecordEx_GetEventExtendedDataRecordEx_Event_AT_AMT_ECU_ETC2_03_message_Missing_Message: RteEventRef=OpEventGetEventExtendedDataRecordEx_GetEventExtendedDataRecordEx_Event_AT_AMT_ECU_ETC2_03_message_Missing_Message
        OpEventGetEventExtendedDataRecordEx_GetEventExtendedDataRecordEx_EvtInfo_ADAS_FN_STS_message_MOIS_FN_Switch_STS_Invalid_c7a0d561: RteEventRef=OpEventGetEventExtendedDataRecordEx_GetEventExtendedDataRecordEx_EvtInfo_ADAS_FN_STS_message_MOIS_FN_Switch_STS_Invalid_c7a0d561
        OpEventGetEventExtendedDataRecordEx_GetEventExtendedDataRecordEx_Event_ADAS_FN_STS_message_MOIS_FN_Switch_STS_Invalid_S_6d4ba50d: RteEventRef=OpEventGetEventExtendedDataRecordEx_GetEventExtendedDataRecordEx_Event_ADAS_FN_STS_message_MOIS_FN_Switch_STS_Invalid_S_6d4ba50d
        OpEventGetEventExtendedDataRecordEx_GetEventExtendedDataRecordEx_EvtInfo_Radar_Module_Over_Temperature: RteEventRef=OpEventGetEventExtendedDataRecordEx_GetEventExtendedDataRecordEx_EvtInfo_Radar_Module_Over_Temperature
        OpEventGetEventExtendedDataRecordEx_GetEventExtendedDataRecordEx_Event_Radar_Module_Over_Temperature: RteEventRef=OpEventGetEventExtendedDataRecordEx_GetEventExtendedDataRecordEx_Event_Radar_Module_Over_Temperature
        OpEventGetEventExtendedDataRecordEx_GetEventExtendedDataRecordEx_EvtInfo_PCAN_TimeSync_Missing_Message: RteEventRef=OpEventGetEventExtendedDataRecordEx_GetEventExtendedDataRecordEx_EvtInfo_PCAN_TimeSync_Missing_Message
        OpEventGetEventExtendedDataRecordEx_GetEventExtendedDataRecordEx_Event_PCAN_TimeSync_Missing_Message: RteEventRef=OpEventGetEventExtendedDataRecordEx_GetEventExtendedDataRecordEx_Event_PCAN_TimeSync_Missing_Message
        OpEventGetEventExtendedDataRecordEx_GetEventExtendedDataRecordEx_EvtInfo_Radar_Module_Watchdog_Failure: RteEventRef=OpEventGetEventExtendedDataRecordEx_GetEventExtendedDataRecordEx_EvtInfo_Radar_Module_Watchdog_Failure
        OpEventGetEventExtendedDataRecordEx_GetEventExtendedDataRecordEx_Event_Radar_Module_Watchdog_Failure: RteEventRef=OpEventGetEventExtendedDataRecordEx_GetEventExtendedDataRecordEx_Event_Radar_Module_Watchdog_Failure
        OpEventGetEventExtendedDataRecordEx_GetEventExtendedDataRecordEx_EvtInfo_SAS_ECU_SAS_message_Missing_Message: RteEventRef=OpEventGetEventExtendedDataRecordEx_GetEventExtendedDataRecordEx_EvtInfo_SAS_ECU_SAS_message_Missing_Message
        OpEventGetEventExtendedDataRecordEx_GetEventExtendedDataRecordEx_Event_SAS_ECU_SAS_message_Missing_Message: RteEventRef=OpEventGetEventExtendedDataRecordEx_GetEventExtendedDataRecordEx_Event_SAS_ECU_SAS_message_Missing_Message
        OpEventGetEventExtendedDataRecordEx_GetEventExtendedDataRecordEx_EvtInfo_ECU_NVM_Corruption_Program_memory_Failure: RteEventRef=OpEventGetEventExtendedDataRecordEx_GetEventExtendedDataRecordEx_EvtInfo_ECU_NVM_Corruption_Program_memory_Failure
        OpEventGetEventExtendedDataRecordEx_GetEventExtendedDataRecordEx_Event_ECU_NVM_Corruption_Program_memory_Failure: RteEventRef=OpEventGetEventExtendedDataRecordEx_GetEventExtendedDataRecordEx_Event_ECU_NVM_Corruption_Program_memory_Failure
        OpEventGetEventExtendedDataRecordEx_GetEventExtendedDataRecordEx_EvtInfo_Cluster_ECU_TD_message_Missing_Message: RteEventRef=OpEventGetEventExtendedDataRecordEx_GetEventExtendedDataRecordEx_EvtInfo_Cluster_ECU_TD_message_Missing_Message
        OpEventGetEventExtendedDataRecordEx_GetEventExtendedDataRecordEx_Event_Cluster_ECU_TD_message_Missing_Message: RteEventRef=OpEventGetEventExtendedDataRecordEx_GetEventExtendedDataRecordEx_Event_Cluster_ECU_TD_message_Missing_Message
        OpEventGetEventExtendedDataRecordEx_GetEventExtendedDataRecordEx_EvtInfo_PCAN_Communication_Bus_Off: RteEventRef=OpEventGetEventExtendedDataRecordEx_GetEventExtendedDataRecordEx_EvtInfo_PCAN_Communication_Bus_Off
        OpEventGetEventExtendedDataRecordEx_GetEventExtendedDataRecordEx_Event_PCAN_Communication_Bus_Off: RteEventRef=OpEventGetEventExtendedDataRecordEx_GetEventExtendedDataRecordEx_Event_PCAN_Communication_Bus_Off
        OpEventGetEventExtendedDataRecordEx_GetEventExtendedDataRecordEx_EvtInfo_Front_Left_Side_Radar_Missing_Message: RteEventRef=OpEventGetEventExtendedDataRecordEx_GetEventExtendedDataRecordEx_EvtInfo_Front_Left_Side_Radar_Missing_Message
        OpEventGetEventExtendedDataRecordEx_GetEventExtendedDataRecordEx_Event_Front_Left_Side_Radar_Missing_Message: RteEventRef=OpEventGetEventExtendedDataRecordEx_GetEventExtendedDataRecordEx_Event_Front_Left_Side_Radar_Missing_Message
        OpEventGetEventExtendedDataRecordEx_GetEventExtendedDataRecordEx_EvtInfo_Manual_ETC2_message_Transcurrent_gear_Invalid_1899adad: RteEventRef=OpEventGetEventExtendedDataRecordEx_GetEventExtendedDataRecordEx_EvtInfo_Manual_ETC2_message_Transcurrent_gear_Invalid_1899adad
        OpEventGetEventExtendedDataRecordEx_GetEventExtendedDataRecordEx_Event_Manual_ETC2_message_Transcurrent_gear_Invalid_Se_f9a59ec3: RteEventRef=OpEventGetEventExtendedDataRecordEx_GetEventExtendedDataRecordEx_Event_Manual_ETC2_message_Transcurrent_gear_Invalid_Se_f9a59ec3
        OpEventGetEventExtendedDataRecordEx_GetEventExtendedDataRecordEx_EvtInfo_SAS_ECU_erratic_communication_Erratic: RteEventRef=OpEventGetEventExtendedDataRecordEx_GetEventExtendedDataRecordEx_EvtInfo_SAS_ECU_erratic_communication_Erratic
        OpEventGetEventExtendedDataRecordEx_GetEventExtendedDataRecordEx_Event_SAS_ECU_erratic_communication_Erratic: RteEventRef=OpEventGetEventExtendedDataRecordEx_GetEventExtendedDataRecordEx_Event_SAS_ECU_erratic_communication_Erratic
        OpEventGetEventExtendedDataRecordEx_GetEventExtendedDataRecordEx_EvtInfo_VDC2_message_Yaw_rate_Invalid_Serial_Data_Received: RteEventRef=OpEventGetEventExtendedDataRecordEx_GetEventExtendedDataRecordEx_EvtInfo_VDC2_message_Yaw_rate_Invalid_Serial_Data_Received
        OpEventGetEventExtendedDataRecordEx_GetEventExtendedDataRecordEx_Event_VDC2_message_Yaw_rate_Invalid_Serial_Data_Received: RteEventRef=OpEventGetEventExtendedDataRecordEx_GetEventExtendedDataRecordEx_Event_VDC2_message_Yaw_rate_Invalid_Serial_Data_Received
        OpEventGetEventExtendedDataRecordEx_GetEventExtendedDataRecordEx_EvtInfo_Cluster_ECU_TD_erratic_communication_Erratic: RteEventRef=OpEventGetEventExtendedDataRecordEx_GetEventExtendedDataRecordEx_EvtInfo_Cluster_ECU_TD_erratic_communication_Erratic
        OpEventGetEventExtendedDataRecordEx_GetEventExtendedDataRecordEx_Event_Cluster_ECU_TD_erratic_communication_Erratic: RteEventRef=OpEventGetEventExtendedDataRecordEx_GetEventExtendedDataRecordEx_Event_Cluster_ECU_TD_erratic_communication_Erratic
        OpEventGetEventExtendedDataRecordEx_GetEventExtendedDataRecordEx_EvtInfo_EMS_ECU_CCVS1_message_Missing_Message: RteEventRef=OpEventGetEventExtendedDataRecordEx_GetEventExtendedDataRecordEx_EvtInfo_EMS_ECU_CCVS1_message_Missing_Message
        OpEventGetEventExtendedDataRecordEx_GetEventExtendedDataRecordEx_Event_EMS_ECU_CCVS1_message_Missing_Message: RteEventRef=OpEventGetEventExtendedDataRecordEx_GetEventExtendedDataRecordEx_Event_EMS_ECU_CCVS1_message_Missing_Message
        OpEventGetEventExtendedDataRecordEx_GetEventExtendedDataRecordEx_EvtInfo_Radar_Mounting_Orientation_Incorrect_Assembly: RteEventRef=OpEventGetEventExtendedDataRecordEx_GetEventExtendedDataRecordEx_EvtInfo_Radar_Mounting_Orientation_Incorrect_Assembly
        OpEventGetEventExtendedDataRecordEx_GetEventExtendedDataRecordEx_Event_Radar_Mounting_Orientation_Incorrect_Assembly: RteEventRef=OpEventGetEventExtendedDataRecordEx_GetEventExtendedDataRecordEx_Event_Radar_Mounting_Orientation_Incorrect_Assembly
        OpEventGetEventExtendedDataRecordEx_GetEventExtendedDataRecordEx_EvtInfo_EMS_ECU_ETC2_erratic_communication_Erractic: RteEventRef=OpEventGetEventExtendedDataRecordEx_GetEventExtendedDataRecordEx_EvtInfo_EMS_ECU_ETC2_erratic_communication_Erractic
        OpEventGetEventExtendedDataRecordEx_GetEventExtendedDataRecordEx_Event_EMS_ECU_ETC2_erratic_communication_Erractic: RteEventRef=OpEventGetEventExtendedDataRecordEx_GetEventExtendedDataRecordEx_Event_EMS_ECU_ETC2_erratic_communication_Erractic
        OpEventGetEventExtendedDataRecordEx_GetEventExtendedDataRecordEx_EvtInfo_Cluster_ECU_ADAS_FN_STS_erratic_communication_Erratic: RteEventRef=OpEventGetEventExtendedDataRecordEx_GetEventExtendedDataRecordEx_EvtInfo_Cluster_ECU_ADAS_FN_STS_erratic_communication_Erratic
        OpEventGetEventExtendedDataRecordEx_GetEventExtendedDataRecordEx_Event_Cluster_ECU_ADAS_FN_STS_erratic_communication_Erratic: RteEventRef=OpEventGetEventExtendedDataRecordEx_GetEventExtendedDataRecordEx_Event_Cluster_ECU_ADAS_FN_STS_erratic_communication_Erratic
        OpEventGetEventExtendedDataRecordEx_GetEventExtendedDataRecordEx_EvtInfo_ESC_ECU_VDC2_message_Missing_Message: RteEventRef=OpEventGetEventExtendedDataRecordEx_GetEventExtendedDataRecordEx_EvtInfo_ESC_ECU_VDC2_message_Missing_Message
        OpEventGetEventExtendedDataRecordEx_GetEventExtendedDataRecordEx_Event_ESC_ECU_VDC2_message_Missing_Message: RteEventRef=OpEventGetEventExtendedDataRecordEx_GetEventExtendedDataRecordEx_Event_ESC_ECU_VDC2_message_Missing_Message
        OpEventGetEventExtendedDataRecordEx_GetEventExtendedDataRecordEx_EvtInfo_CLS_TX_16_message_Transmission_Type_info_Inval_91a84ba5: RteEventRef=OpEventGetEventExtendedDataRecordEx_GetEventExtendedDataRecordEx_EvtInfo_CLS_TX_16_message_Transmission_Type_info_Inval_91a84ba5
        OpEventGetEventExtendedDataRecordEx_GetEventExtendedDataRecordEx_Event_CLS_TX_16_message_Transmission_Type_info_Invalid_08e5b4d9: RteEventRef=OpEventGetEventExtendedDataRecordEx_GetEventExtendedDataRecordEx_Event_CLS_TX_16_message_Transmission_Type_info_Invalid_08e5b4d9
        OpEventGetEventExtendedDataRecordEx_GetEventExtendedDataRecordEx_EvtInfo_Cluster_ECU_CLS_Tx_4_erratic_communication_Erratic: RteEventRef=OpEventGetEventExtendedDataRecordEx_GetEventExtendedDataRecordEx_EvtInfo_Cluster_ECU_CLS_Tx_4_erratic_communication_Erratic
        OpEventGetEventExtendedDataRecordEx_GetEventExtendedDataRecordEx_Event_Cluster_ECU_CLS_Tx_4_erratic_communication_Erratic: RteEventRef=OpEventGetEventExtendedDataRecordEx_GetEventExtendedDataRecordEx_Event_Cluster_ECU_CLS_Tx_4_erratic_communication_Erratic
        OpEventGetEventExtendedDataRecordEx_GetEventExtendedDataRecordEx_EvtInfo_Cluster_ECU_ADAS_FN_STS_message_Missing_Message: RteEventRef=OpEventGetEventExtendedDataRecordEx_GetEventExtendedDataRecordEx_EvtInfo_Cluster_ECU_ADAS_FN_STS_message_Missing_Message
        OpEventGetEventExtendedDataRecordEx_GetEventExtendedDataRecordEx_Event_Cluster_ECU_ADAS_FN_STS_message_Missing_Message: RteEventRef=OpEventGetEventExtendedDataRecordEx_GetEventExtendedDataRecordEx_Event_Cluster_ECU_ADAS_FN_STS_message_Missing_Message
        OpEventGetEventExtendedDataRecordEx_GetEventExtendedDataRecordEx_EvtInfo_Vehicle_Dataset_value_of_signal_protection_cal_96691b8c: RteEventRef=OpEventGetEventExtendedDataRecordEx_GetEventExtendedDataRecordEx_EvtInfo_Vehicle_Dataset_value_of_signal_protection_cal_96691b8c
        OpEventGetEventExtendedDataRecordEx_GetEventExtendedDataRecordEx_Event_Vehicle_Dataset_value_of_signal_protection_calcu_e573b3a0: RteEventRef=OpEventGetEventExtendedDataRecordEx_GetEventExtendedDataRecordEx_Event_Vehicle_Dataset_value_of_signal_protection_calcu_e573b3a0
        OpEventGetEventExtendedDataRecordEx_GetEventExtendedDataRecordEx_EvtInfo_Cluster_ECU_CLS_Tx_16_erratic_communication_Erratic: RteEventRef=OpEventGetEventExtendedDataRecordEx_GetEventExtendedDataRecordEx_EvtInfo_Cluster_ECU_CLS_Tx_16_erratic_communication_Erratic
        OpEventGetEventExtendedDataRecordEx_GetEventExtendedDataRecordEx_Event_Cluster_ECU_CLS_Tx_16_erratic_communication_Erratic: RteEventRef=OpEventGetEventExtendedDataRecordEx_GetEventExtendedDataRecordEx_Event_Cluster_ECU_CLS_Tx_16_erratic_communication_Erratic
        OpEventGetEventExtendedDataRecordEx_GetEventExtendedDataRecordEx_EvtInfo_Cluster_ECU_OEL_erratic_communication_Erratic: RteEventRef=OpEventGetEventExtendedDataRecordEx_GetEventExtendedDataRecordEx_EvtInfo_Cluster_ECU_OEL_erratic_communication_Erratic
        OpEventGetEventExtendedDataRecordEx_GetEventExtendedDataRecordEx_Event_Cluster_ECU_OEL_erratic_communication_Erratic: RteEventRef=OpEventGetEventExtendedDataRecordEx_GetEventExtendedDataRecordEx_Event_Cluster_ECU_OEL_erratic_communication_Erratic
        OpEventGetEventExtendedDataRecordEx_GetEventExtendedDataRecordEx_EvtInfo_Cluster_ECU_CLS_Tx_4_message_Missing_Message: RteEventRef=OpEventGetEventExtendedDataRecordEx_GetEventExtendedDataRecordEx_EvtInfo_Cluster_ECU_CLS_Tx_4_message_Missing_Message
        OpEventGetEventExtendedDataRecordEx_GetEventExtendedDataRecordEx_Event_Cluster_ECU_CLS_Tx_4_message_Missing_Message: RteEventRef=OpEventGetEventExtendedDataRecordEx_GetEventExtendedDataRecordEx_Event_Cluster_ECU_CLS_Tx_4_message_Missing_Message
        OpEventGetEventExtendedDataRecordEx_GetEventExtendedDataRecordEx_EvtInfo_Radar_Performance_Capability_Algorithm_Based_Failure: RteEventRef=OpEventGetEventExtendedDataRecordEx_GetEventExtendedDataRecordEx_EvtInfo_Radar_Performance_Capability_Algorithm_Based_Failure
        OpEventGetEventExtendedDataRecordEx_GetEventExtendedDataRecordEx_Event_Radar_Performance_Capability_Algorithm_Based_Failure: RteEventRef=OpEventGetEventExtendedDataRecordEx_GetEventExtendedDataRecordEx_Event_Radar_Performance_Capability_Algorithm_Based_Failure
        OpEventGetEventExtendedDataRecordEx_GetEventExtendedDataRecordEx_EvtInfo_Radar_AutoAlignment_Range_Alignment_or_Adjuste_162bbf47: RteEventRef=OpEventGetEventExtendedDataRecordEx_GetEventExtendedDataRecordEx_EvtInfo_Radar_AutoAlignment_Range_Alignment_or_Adjuste_162bbf47
        OpEventGetEventExtendedDataRecordEx_GetEventExtendedDataRecordEx_Event_Radar_AutoAlignment_Range_Alignment_or_Adjusteme_498a8af7: RteEventRef=OpEventGetEventExtendedDataRecordEx_GetEventExtendedDataRecordEx_Event_Radar_AutoAlignment_Range_Alignment_or_Adjusteme_498a8af7
        OpEventGetEventExtendedDataRecordEx_GetEventExtendedDataRecordEx_EvtInfo_EMS_ECU_CCVS1_erratic_communication_Erractic: RteEventRef=OpEventGetEventExtendedDataRecordEx_GetEventExtendedDataRecordEx_EvtInfo_EMS_ECU_CCVS1_erratic_communication_Erractic
        OpEventGetEventExtendedDataRecordEx_GetEventExtendedDataRecordEx_Event_EMS_ECU_CCVS1_erratic_communication_Erractic: RteEventRef=OpEventGetEventExtendedDataRecordEx_GetEventExtendedDataRecordEx_Event_EMS_ECU_CCVS1_erratic_communication_Erractic
        OpEventGetEventExtendedDataRecordEx_GetEventExtendedDataRecordEx_EvtInfo_Radar_System_Battery_Low_Voltage_System_Voltage_Low: RteEventRef=OpEventGetEventExtendedDataRecordEx_GetEventExtendedDataRecordEx_EvtInfo_Radar_System_Battery_Low_Voltage_System_Voltage_Low
        OpEventGetEventExtendedDataRecordEx_GetEventExtendedDataRecordEx_Event_Radar_System_Battery_Low_Voltage_System_Voltage_Low: RteEventRef=OpEventGetEventExtendedDataRecordEx_GetEventExtendedDataRecordEx_Event_Radar_System_Battery_Low_Voltage_System_Voltage_Low
        OpEventGetEventExtendedDataRecordEx_GetEventExtendedDataRecordEx_EvtInfo_Radar_SMC_General_Checksum_Failure: RteEventRef=OpEventGetEventExtendedDataRecordEx_GetEventExtendedDataRecordEx_EvtInfo_Radar_SMC_General_Checksum_Failure
        OpEventGetEventExtendedDataRecordEx_GetEventExtendedDataRecordEx_Event_Radar_SMC_General_Checksum_Failure: RteEventRef=OpEventGetEventExtendedDataRecordEx_GetEventExtendedDataRecordEx_Event_Radar_SMC_General_Checksum_Failure
        OpEventGetEventExtendedDataRecordEx_GetEventExtendedDataRecordEx_EvtInfo_Radar_Pin_Position_Wrong_Mounting_Position: RteEventRef=OpEventGetEventExtendedDataRecordEx_GetEventExtendedDataRecordEx_EvtInfo_Radar_Pin_Position_Wrong_Mounting_Position
        OpEventGetEventExtendedDataRecordEx_GetEventExtendedDataRecordEx_Event_Radar_Pin_Position_Wrong_Mounting_Position: RteEventRef=OpEventGetEventExtendedDataRecordEx_GetEventExtendedDataRecordEx_Event_Radar_Pin_Position_Wrong_Mounting_Position
        OpEventGetEventExtendedDataRecordEx_GetEventExtendedDataRecordEx_EvtInfo_VDC2_message_Lateral_Accleration_Invalid_Seria_8bd1d122: RteEventRef=OpEventGetEventExtendedDataRecordEx_GetEventExtendedDataRecordEx_EvtInfo_VDC2_message_Lateral_Accleration_Invalid_Seria_8bd1d122
        OpEventGetEventExtendedDataRecordEx_GetEventExtendedDataRecordEx_Event_VDC2_message_Lateral_Accleration_Invalid_Serial_40efc39b: RteEventRef=OpEventGetEventExtendedDataRecordEx_GetEventExtendedDataRecordEx_Event_VDC2_message_Lateral_Accleration_Invalid_Serial_40efc39b
        OpEventGetEventExtendedDataRecordEx_GetEventExtendedDataRecordEx_EvtInfo_ADAS_FN_STS_message_BSIS_FN_Switch_STS_Invalid_0230ac92: RteEventRef=OpEventGetEventExtendedDataRecordEx_GetEventExtendedDataRecordEx_EvtInfo_ADAS_FN_STS_message_BSIS_FN_Switch_STS_Invalid_0230ac92
        OpEventGetEventExtendedDataRecordEx_GetEventExtendedDataRecordEx_Event_ADAS_FN_STS_message_BSIS_FN_Switch_STS_Invalid_S_a8dbdcfe: RteEventRef=OpEventGetEventExtendedDataRecordEx_GetEventExtendedDataRecordEx_Event_ADAS_FN_STS_message_BSIS_FN_Switch_STS_Invalid_S_a8dbdcfe
        OpEventGetEventExtendedDataRecordEx_GetEventExtendedDataRecordEx_EvtInfo_Radar_AutoAlignment_Misalignment_Performance_o_5469043b: RteEventRef=OpEventGetEventExtendedDataRecordEx_GetEventExtendedDataRecordEx_EvtInfo_Radar_AutoAlignment_Misalignment_Performance_o_5469043b
        OpEventGetEventExtendedDataRecordEx_GetEventExtendedDataRecordEx_Event_Radar_AutoAlignment_Misalignment_Performance_or_fe827457: RteEventRef=OpEventGetEventExtendedDataRecordEx_GetEventExtendedDataRecordEx_Event_Radar_AutoAlignment_Misalignment_Performance_or_fe827457
        OpEventGetEventExtendedDataRecordEx_GetEventExtendedDataRecordEx_EvtInfo_ESC_ECU_VDC2_erratic_communication_Erratic: RteEventRef=OpEventGetEventExtendedDataRecordEx_GetEventExtendedDataRecordEx_EvtInfo_ESC_ECU_VDC2_erratic_communication_Erratic
        OpEventGetEventExtendedDataRecordEx_GetEventExtendedDataRecordEx_Event_ESC_ECU_VDC2_erratic_communication_Erratic: RteEventRef=OpEventGetEventExtendedDataRecordEx_GetEventExtendedDataRecordEx_Event_ESC_ECU_VDC2_erratic_communication_Erratic
        OpEventGetEventExtendedDataRecordEx_GetEventExtendedDataRecordEx_EvtInfo_Application_Interface_Lookup_Performance_or_In_802661e7: RteEventRef=OpEventGetEventExtendedDataRecordEx_GetEventExtendedDataRecordEx_EvtInfo_Application_Interface_Lookup_Performance_or_In_802661e7
        OpEventGetEventExtendedDataRecordEx_GetEventExtendedDataRecordEx_Event_Application_Interface_Lookup_Performance_or_Inco_4698ce60: RteEventRef=OpEventGetEventExtendedDataRecordEx_GetEventExtendedDataRecordEx_Event_Application_Interface_Lookup_Performance_or_Inco_4698ce60
        OpEventGetEventExtendedDataRecordEx_GetEventExtendedDataRecordEx_EvtInfo_EMS_ECU_VD_message_Missing_Message: RteEventRef=OpEventGetEventExtendedDataRecordEx_GetEventExtendedDataRecordEx_EvtInfo_EMS_ECU_VD_message_Missing_Message
        OpEventGetEventExtendedDataRecordEx_GetEventExtendedDataRecordEx_Event_EMS_ECU_VD_message_Missing_Message: RteEventRef=OpEventGetEventExtendedDataRecordEx_GetEventExtendedDataRecordEx_Event_EMS_ECU_VD_message_Missing_Message
        OpEventGetEventExtendedDataRecordEx_GetEventExtendedDataRecordEx_EvtInfo_Radar_Platform_Time_System_Programming_Failure: RteEventRef=OpEventGetEventExtendedDataRecordEx_GetEventExtendedDataRecordEx_EvtInfo_Radar_Platform_Time_System_Programming_Failure
        OpEventGetEventExtendedDataRecordEx_GetEventExtendedDataRecordEx_Event_Radar_Platform_Time_System_Programming_Failure: RteEventRef=OpEventGetEventExtendedDataRecordEx_GetEventExtendedDataRecordEx_Event_Radar_Platform_Time_System_Programming_Failure
        OpEventGetEventExtendedDataRecordEx_GetEventExtendedDataRecordEx_EvtInfo_OEL_message_Turn_Signal_Switch_Invalid_Serial_39dbabbc: RteEventRef=OpEventGetEventExtendedDataRecordEx_GetEventExtendedDataRecordEx_EvtInfo_OEL_message_Turn_Signal_Switch_Invalid_Serial_39dbabbc
        OpEventGetEventExtendedDataRecordEx_GetEventExtendedDataRecordEx_Event_OEL_message_Turn_Signal_Switch_Invalid_Serial_Da_9d661385: RteEventRef=OpEventGetEventExtendedDataRecordEx_GetEventExtendedDataRecordEx_Event_OEL_message_Turn_Signal_Switch_Invalid_Serial_Da_9d661385
        OpEventGetEventExtendedDataRecordEx_GetEventExtendedDataRecordEx_EvtInfo_Radar_calibration_Calibration_or_Paramater_Mem_ab89598b: RteEventRef=OpEventGetEventExtendedDataRecordEx_GetEventExtendedDataRecordEx_EvtInfo_Radar_calibration_Calibration_or_Paramater_Mem_ab89598b
        OpEventGetEventExtendedDataRecordEx_GetEventExtendedDataRecordEx_Event_Radar_calibration_Calibration_or_Paramater_Memory_Failure: RteEventRef=OpEventGetEventExtendedDataRecordEx_GetEventExtendedDataRecordEx_Event_Radar_calibration_Calibration_or_Paramater_Memory_Failure
        OpEventGetEventExtendedDataRecordEx_GetEventExtendedDataRecordEx_GeneralEvtInfo: RteEventRef=OpEventGetEventExtendedDataRecordEx_GetEventExtendedDataRecordEx_GeneralEvtInfo
        OpEventGetEventEnableCondition_GetEventEnableCondition_EvtInfo_SAS_message_Steering_Wheel_Angle_Invalid_Serial_Data_Received: RteEventRef=OpEventGetEventEnableCondition_GetEventEnableCondition_EvtInfo_SAS_message_Steering_Wheel_Angle_Invalid_Serial_Data_Received
        OpEventGetEventEnableCondition_GetEventEnableCondition_EvtInfo_AT_AMT_ETC2_message_Transcurrent_gear_Invalid_Serial_Dat_98622d12: RteEventRef=OpEventGetEventEnableCondition_GetEventEnableCondition_EvtInfo_AT_AMT_ETC2_message_Transcurrent_gear_Invalid_Serial_Dat_98622d12
        OpEventGetEventEnableCondition_GetEventEnableCondition_EvtInfo_Radar_AutoAlignment_Algorithm_Signal_Calculation_Failure: RteEventRef=OpEventGetEventEnableCondition_GetEventEnableCondition_EvtInfo_Radar_AutoAlignment_Algorithm_Signal_Calculation_Failure
        OpEventGetEventEnableCondition_GetEventEnableCondition_EvtInfo_Vehicle_DataSet_Not_Configured: RteEventRef=OpEventGetEventEnableCondition_GetEventEnableCondition_EvtInfo_Vehicle_DataSet_Not_Configured
        OpEventGetEventEnableCondition_GetEventEnableCondition_EvtInfo_Radar_Module_System_Internal_Failure: RteEventRef=OpEventGetEventEnableCondition_GetEventEnableCondition_EvtInfo_Radar_Module_System_Internal_Failure
        OpEventGetEventEnableCondition_GetEventEnableCondition_EvtInfo_Radar_MMIC_Component_Failure: RteEventRef=OpEventGetEventEnableCondition_GetEventEnableCondition_EvtInfo_Radar_MMIC_Component_Failure
        OpEventGetEventEnableCondition_GetEventEnableCondition_EvtInfo_Radar_Module_General_Memory_Failure: RteEventRef=OpEventGetEventEnableCondition_GetEventEnableCondition_EvtInfo_Radar_Module_General_Memory_Failure
        OpEventGetEventEnableCondition_GetEventEnableCondition_EvtInfo_Radar_System_Battery_High_Voltage_System_Voltage_High: RteEventRef=OpEventGetEventEnableCondition_GetEventEnableCondition_EvtInfo_Radar_System_Battery_High_Voltage_System_Voltage_High
        OpEventGetEventEnableCondition_GetEventEnableCondition_EvtInfo_CCVS1_message_Vehicle_Speed_Invalid_Serial_Data_Received: RteEventRef=OpEventGetEventEnableCondition_GetEventEnableCondition_EvtInfo_CCVS1_message_Vehicle_Speed_Invalid_Serial_Data_Received
        OpEventGetEventEnableCondition_GetEventEnableCondition_EvtInfo_EMS_ECU_VD_erratic_communication_Erratic: RteEventRef=OpEventGetEventEnableCondition_GetEventEnableCondition_EvtInfo_EMS_ECU_VD_erratic_communication_Erratic
        OpEventGetEventEnableCondition_GetEventEnableCondition_EvtInfo_EMS_ECU_ETC2_00_message_Missing_Message: RteEventRef=OpEventGetEventEnableCondition_GetEventEnableCondition_EvtInfo_EMS_ECU_ETC2_00_message_Missing_Message
        OpEventGetEventEnableCondition_GetEventEnableCondition_EvtInfo_Cluster_ECU_CLS_Tx_16_message_Missing_Message: RteEventRef=OpEventGetEventEnableCondition_GetEventEnableCondition_EvtInfo_Cluster_ECU_CLS_Tx_16_message_Missing_Message
        OpEventGetEventEnableCondition_GetEventEnableCondition_EvtInfo_Exceeded_Security_Access_0x27_Attempt_Threshold_Authenti_4fc41757: RteEventRef=OpEventGetEventEnableCondition_GetEventEnableCondition_EvtInfo_Exceeded_Security_Access_0x27_Attempt_Threshold_Authenti_4fc41757
        OpEventGetEventEnableCondition_GetEventEnableCondition_EvtInfo_Front_Left_Side_Radar_value_of_signal_protection_calcula_055dc31f: RteEventRef=OpEventGetEventEnableCondition_GetEventEnableCondition_EvtInfo_Front_Left_Side_Radar_value_of_signal_protection_calcula_055dc31f
        OpEventGetEventEnableCondition_GetEventEnableCondition_EvtInfo_AT_AMT_ETC2_erratic_communication_Erratic: RteEventRef=OpEventGetEventEnableCondition_GetEventEnableCondition_EvtInfo_AT_AMT_ETC2_erratic_communication_Erratic
        OpEventGetEventEnableCondition_GetEventEnableCondition_EvtInfo_VCAN_Communication_Bus_Off: RteEventRef=OpEventGetEventEnableCondition_GetEventEnableCondition_EvtInfo_VCAN_Communication_Bus_Off
        OpEventGetEventEnableCondition_GetEventEnableCondition_EvtInfo_VDC2_message_LongitudinalAcceleration_Invalid_Serial_Dat_188e77bd: RteEventRef=OpEventGetEventEnableCondition_GetEventEnableCondition_EvtInfo_VDC2_message_LongitudinalAcceleration_Invalid_Serial_Dat_188e77bd
        OpEventGetEventEnableCondition_GetEventEnableCondition_EvtInfo_Radar_MMIC_RFBIST_Component_Internal_Failure: RteEventRef=OpEventGetEventEnableCondition_GetEventEnableCondition_EvtInfo_Radar_MMIC_RFBIST_Component_Internal_Failure
        OpEventGetEventEnableCondition_GetEventEnableCondition_EvtInfo_Radar_Initial_Alignment_Missing_Calibration: RteEventRef=OpEventGetEventEnableCondition_GetEventEnableCondition_EvtInfo_Radar_Initial_Alignment_Missing_Calibration
        OpEventGetEventEnableCondition_GetEventEnableCondition_EvtInfo_Cluster_ECU_OEL_message_Missing_Message: RteEventRef=OpEventGetEventEnableCondition_GetEventEnableCondition_EvtInfo_Cluster_ECU_OEL_message_Missing_Message
        OpEventGetEventEnableCondition_GetEventEnableCondition_EvtInfo_AT_AMT_ECU_ETC2_03_message_Missing_Message: RteEventRef=OpEventGetEventEnableCondition_GetEventEnableCondition_EvtInfo_AT_AMT_ECU_ETC2_03_message_Missing_Message
        OpEventGetEventEnableCondition_GetEventEnableCondition_EvtInfo_ADAS_FN_STS_message_MOIS_FN_Switch_STS_Invalid_Serial_Da_c0517e8a: RteEventRef=OpEventGetEventEnableCondition_GetEventEnableCondition_EvtInfo_ADAS_FN_STS_message_MOIS_FN_Switch_STS_Invalid_Serial_Da_c0517e8a
        OpEventGetEventEnableCondition_GetEventEnableCondition_EvtInfo_Radar_Module_Over_Temperature: RteEventRef=OpEventGetEventEnableCondition_GetEventEnableCondition_EvtInfo_Radar_Module_Over_Temperature
        OpEventGetEventEnableCondition_GetEventEnableCondition_EvtInfo_PCAN_TimeSync_Missing_Message: RteEventRef=OpEventGetEventEnableCondition_GetEventEnableCondition_EvtInfo_PCAN_TimeSync_Missing_Message
        OpEventGetEventEnableCondition_GetEventEnableCondition_EvtInfo_Radar_Module_Watchdog_Failure: RteEventRef=OpEventGetEventEnableCondition_GetEventEnableCondition_EvtInfo_Radar_Module_Watchdog_Failure
        OpEventGetEventEnableCondition_GetEventEnableCondition_EvtInfo_SAS_ECU_SAS_message_Missing_Message: RteEventRef=OpEventGetEventEnableCondition_GetEventEnableCondition_EvtInfo_SAS_ECU_SAS_message_Missing_Message
        OpEventGetEventEnableCondition_GetEventEnableCondition_EvtInfo_ECU_NVM_Corruption_Program_memory_Failure: RteEventRef=OpEventGetEventEnableCondition_GetEventEnableCondition_EvtInfo_ECU_NVM_Corruption_Program_memory_Failure
        OpEventGetEventEnableCondition_GetEventEnableCondition_EvtInfo_Cluster_ECU_TD_message_Missing_Message: RteEventRef=OpEventGetEventEnableCondition_GetEventEnableCondition_EvtInfo_Cluster_ECU_TD_message_Missing_Message
        OpEventGetEventEnableCondition_GetEventEnableCondition_EvtInfo_PCAN_Communication_Bus_Off: RteEventRef=OpEventGetEventEnableCondition_GetEventEnableCondition_EvtInfo_PCAN_Communication_Bus_Off
        OpEventGetEventEnableCondition_GetEventEnableCondition_EvtInfo_Front_Left_Side_Radar_Missing_Message: RteEventRef=OpEventGetEventEnableCondition_GetEventEnableCondition_EvtInfo_Front_Left_Side_Radar_Missing_Message
        OpEventGetEventEnableCondition_GetEventEnableCondition_EvtInfo_Manual_ETC2_message_Transcurrent_gear_Invalid_Serial_Dat_84f65fa9: RteEventRef=OpEventGetEventEnableCondition_GetEventEnableCondition_EvtInfo_Manual_ETC2_message_Transcurrent_gear_Invalid_Serial_Dat_84f65fa9
        OpEventGetEventEnableCondition_GetEventEnableCondition_EvtInfo_SAS_ECU_erratic_communication_Erratic: RteEventRef=OpEventGetEventEnableCondition_GetEventEnableCondition_EvtInfo_SAS_ECU_erratic_communication_Erratic
        OpEventGetEventEnableCondition_GetEventEnableCondition_EvtInfo_VDC2_message_Yaw_rate_Invalid_Serial_Data_Received: RteEventRef=OpEventGetEventEnableCondition_GetEventEnableCondition_EvtInfo_VDC2_message_Yaw_rate_Invalid_Serial_Data_Received
        OpEventGetEventEnableCondition_GetEventEnableCondition_EvtInfo_Cluster_ECU_TD_erratic_communication_Erratic: RteEventRef=OpEventGetEventEnableCondition_GetEventEnableCondition_EvtInfo_Cluster_ECU_TD_erratic_communication_Erratic
        OpEventGetEventEnableCondition_GetEventEnableCondition_EvtInfo_EMS_ECU_CCVS1_message_Missing_Message: RteEventRef=OpEventGetEventEnableCondition_GetEventEnableCondition_EvtInfo_EMS_ECU_CCVS1_message_Missing_Message
        OpEventGetEventEnableCondition_GetEventEnableCondition_EvtInfo_Radar_Mounting_Orientation_Incorrect_Assembly: RteEventRef=OpEventGetEventEnableCondition_GetEventEnableCondition_EvtInfo_Radar_Mounting_Orientation_Incorrect_Assembly
        OpEventGetEventEnableCondition_GetEventEnableCondition_EvtInfo_EMS_ECU_ETC2_erratic_communication_Erractic: RteEventRef=OpEventGetEventEnableCondition_GetEventEnableCondition_EvtInfo_EMS_ECU_ETC2_erratic_communication_Erractic
        OpEventGetEventEnableCondition_GetEventEnableCondition_EvtInfo_Cluster_ECU_ADAS_FN_STS_erratic_communication_Erratic: RteEventRef=OpEventGetEventEnableCondition_GetEventEnableCondition_EvtInfo_Cluster_ECU_ADAS_FN_STS_erratic_communication_Erratic
        OpEventGetEventEnableCondition_GetEventEnableCondition_EvtInfo_ESC_ECU_VDC2_message_Missing_Message: RteEventRef=OpEventGetEventEnableCondition_GetEventEnableCondition_EvtInfo_ESC_ECU_VDC2_message_Missing_Message
        OpEventGetEventEnableCondition_GetEventEnableCondition_EvtInfo_CLS_TX_16_message_Transmission_Type_info_Invalid_Serial_6d261c13: RteEventRef=OpEventGetEventEnableCondition_GetEventEnableCondition_EvtInfo_CLS_TX_16_message_Transmission_Type_info_Invalid_Serial_6d261c13
        OpEventGetEventEnableCondition_GetEventEnableCondition_EvtInfo_Cluster_ECU_CLS_Tx_4_erratic_communication_Erratic: RteEventRef=OpEventGetEventEnableCondition_GetEventEnableCondition_EvtInfo_Cluster_ECU_CLS_Tx_4_erratic_communication_Erratic
        OpEventGetEventEnableCondition_GetEventEnableCondition_EvtInfo_Cluster_ECU_ADAS_FN_STS_message_Missing_Message: RteEventRef=OpEventGetEventEnableCondition_GetEventEnableCondition_EvtInfo_Cluster_ECU_ADAS_FN_STS_message_Missing_Message
        OpEventGetEventEnableCondition_GetEventEnableCondition_EvtInfo_Vehicle_Dataset_value_of_signal_protection_calculation_Incorrect: RteEventRef=OpEventGetEventEnableCondition_GetEventEnableCondition_EvtInfo_Vehicle_Dataset_value_of_signal_protection_calculation_Incorrect
        OpEventGetEventEnableCondition_GetEventEnableCondition_EvtInfo_Cluster_ECU_CLS_Tx_16_erratic_communication_Erratic: RteEventRef=OpEventGetEventEnableCondition_GetEventEnableCondition_EvtInfo_Cluster_ECU_CLS_Tx_16_erratic_communication_Erratic
        OpEventGetEventEnableCondition_GetEventEnableCondition_EvtInfo_Cluster_ECU_OEL_erratic_communication_Erratic: RteEventRef=OpEventGetEventEnableCondition_GetEventEnableCondition_EvtInfo_Cluster_ECU_OEL_erratic_communication_Erratic
        OpEventGetEventEnableCondition_GetEventEnableCondition_EvtInfo_Cluster_ECU_CLS_Tx_4_message_Missing_Message: RteEventRef=OpEventGetEventEnableCondition_GetEventEnableCondition_EvtInfo_Cluster_ECU_CLS_Tx_4_message_Missing_Message
        OpEventGetEventEnableCondition_GetEventEnableCondition_EvtInfo_Radar_Performance_Capability_Algorithm_Based_Failure: RteEventRef=OpEventGetEventEnableCondition_GetEventEnableCondition_EvtInfo_Radar_Performance_Capability_Algorithm_Based_Failure
        OpEventGetEventEnableCondition_GetEventEnableCondition_EvtInfo_Radar_AutoAlignment_Range_Alignment_or_Adjustement_Incorrect: RteEventRef=OpEventGetEventEnableCondition_GetEventEnableCondition_EvtInfo_Radar_AutoAlignment_Range_Alignment_or_Adjustement_Incorrect
        OpEventGetEventEnableCondition_GetEventEnableCondition_EvtInfo_EMS_ECU_CCVS1_erratic_communication_Erractic: RteEventRef=OpEventGetEventEnableCondition_GetEventEnableCondition_EvtInfo_EMS_ECU_CCVS1_erratic_communication_Erractic
        OpEventGetEventEnableCondition_GetEventEnableCondition_EvtInfo_Radar_System_Battery_Low_Voltage_System_Voltage_Low: RteEventRef=OpEventGetEventEnableCondition_GetEventEnableCondition_EvtInfo_Radar_System_Battery_Low_Voltage_System_Voltage_Low
        OpEventGetEventEnableCondition_GetEventEnableCondition_EvtInfo_Radar_SMC_General_Checksum_Failure: RteEventRef=OpEventGetEventEnableCondition_GetEventEnableCondition_EvtInfo_Radar_SMC_General_Checksum_Failure
        OpEventGetEventEnableCondition_GetEventEnableCondition_EvtInfo_Radar_Pin_Position_Wrong_Mounting_Position: RteEventRef=OpEventGetEventEnableCondition_GetEventEnableCondition_EvtInfo_Radar_Pin_Position_Wrong_Mounting_Position
        OpEventGetEventEnableCondition_GetEventEnableCondition_EvtInfo_VDC2_message_Lateral_Accleration_Invalid_Serial_Data_Received: RteEventRef=OpEventGetEventEnableCondition_GetEventEnableCondition_EvtInfo_VDC2_message_Lateral_Accleration_Invalid_Serial_Data_Received
        OpEventGetEventEnableCondition_GetEventEnableCondition_EvtInfo_ADAS_FN_STS_message_BSIS_FN_Switch_STS_Invalid_Serial_Da_05c10779: RteEventRef=OpEventGetEventEnableCondition_GetEventEnableCondition_EvtInfo_ADAS_FN_STS_message_BSIS_FN_Switch_STS_Invalid_Serial_Da_05c10779
        OpEventGetEventEnableCondition_GetEventEnableCondition_EvtInfo_Radar_AutoAlignment_Misalignment_Performance_or_Incorrec_5398afd0: RteEventRef=OpEventGetEventEnableCondition_GetEventEnableCondition_EvtInfo_Radar_AutoAlignment_Misalignment_Performance_or_Incorrec_5398afd0
        OpEventGetEventEnableCondition_GetEventEnableCondition_EvtInfo_ESC_ECU_VDC2_erratic_communication_Erratic: RteEventRef=OpEventGetEventEnableCondition_GetEventEnableCondition_EvtInfo_ESC_ECU_VDC2_erratic_communication_Erratic
        OpEventGetEventEnableCondition_GetEventEnableCondition_EvtInfo_Application_Interface_Lookup_Performance_or_Incorrect_Operation: RteEventRef=OpEventGetEventEnableCondition_GetEventEnableCondition_EvtInfo_Application_Interface_Lookup_Performance_or_Incorrect_Operation
        OpEventGetEventEnableCondition_GetEventEnableCondition_EvtInfo_EMS_ECU_VD_message_Missing_Message: RteEventRef=OpEventGetEventEnableCondition_GetEventEnableCondition_EvtInfo_EMS_ECU_VD_message_Missing_Message
        OpEventGetEventEnableCondition_GetEventEnableCondition_EvtInfo_Radar_Platform_Time_System_Programming_Failure: RteEventRef=OpEventGetEventEnableCondition_GetEventEnableCondition_EvtInfo_Radar_Platform_Time_System_Programming_Failure
        OpEventGetEventEnableCondition_GetEventEnableCondition_EvtInfo_OEL_message_Turn_Signal_Switch_Invalid_Serial_Data_Received: RteEventRef=OpEventGetEventEnableCondition_GetEventEnableCondition_EvtInfo_OEL_message_Turn_Signal_Switch_Invalid_Serial_Data_Received
        OpEventGetEventEnableCondition_GetEventEnableCondition_EvtInfo_Radar_calibration_Calibration_or_Paramater_Memory_Failure: RteEventRef=OpEventGetEventEnableCondition_GetEventEnableCondition_EvtInfo_Radar_calibration_Calibration_or_Paramater_Memory_Failure
        OpEventGetEventEnableCondition_GetEventEnableCondition_GeneralEvtInfo: RteEventRef=OpEventGetEventEnableCondition_GetEventEnableCondition_GeneralEvtInfo
        OpEventGetDebouncingOfEvent_GetDebouncingOfEvent_EvtInfo_SAS_message_Steering_Wheel_Angle_Invalid_Serial_Data_Received: RteEventRef=OpEventGetDebouncingOfEvent_GetDebouncingOfEvent_EvtInfo_SAS_message_Steering_Wheel_Angle_Invalid_Serial_Data_Received
        OpEventGetDebouncingOfEvent_GetDebouncingOfEvent_EvtInfo_AT_AMT_ETC2_message_Transcurrent_gear_Invalid_Serial_Data_Received: RteEventRef=OpEventGetDebouncingOfEvent_GetDebouncingOfEvent_EvtInfo_AT_AMT_ETC2_message_Transcurrent_gear_Invalid_Serial_Data_Received
        OpEventGetDebouncingOfEvent_GetDebouncingOfEvent_EvtInfo_Radar_AutoAlignment_Algorithm_Signal_Calculation_Failure: RteEventRef=OpEventGetDebouncingOfEvent_GetDebouncingOfEvent_EvtInfo_Radar_AutoAlignment_Algorithm_Signal_Calculation_Failure
        OpEventGetDebouncingOfEvent_GetDebouncingOfEvent_EvtInfo_Vehicle_DataSet_Not_Configured: RteEventRef=OpEventGetDebouncingOfEvent_GetDebouncingOfEvent_EvtInfo_Vehicle_DataSet_Not_Configured
        OpEventGetDebouncingOfEvent_GetDebouncingOfEvent_EvtInfo_Radar_Module_System_Internal_Failure: RteEventRef=OpEventGetDebouncingOfEvent_GetDebouncingOfEvent_EvtInfo_Radar_Module_System_Internal_Failure
        OpEventGetDebouncingOfEvent_GetDebouncingOfEvent_EvtInfo_Radar_MMIC_Component_Failure: RteEventRef=OpEventGetDebouncingOfEvent_GetDebouncingOfEvent_EvtInfo_Radar_MMIC_Component_Failure
        OpEventGetDebouncingOfEvent_GetDebouncingOfEvent_EvtInfo_Radar_Module_General_Memory_Failure: RteEventRef=OpEventGetDebouncingOfEvent_GetDebouncingOfEvent_EvtInfo_Radar_Module_General_Memory_Failure
        OpEventGetDebouncingOfEvent_GetDebouncingOfEvent_EvtInfo_Radar_System_Battery_High_Voltage_System_Voltage_High: RteEventRef=OpEventGetDebouncingOfEvent_GetDebouncingOfEvent_EvtInfo_Radar_System_Battery_High_Voltage_System_Voltage_High
        OpEventGetDebouncingOfEvent_GetDebouncingOfEvent_EvtInfo_CCVS1_message_Vehicle_Speed_Invalid_Serial_Data_Received: RteEventRef=OpEventGetDebouncingOfEvent_GetDebouncingOfEvent_EvtInfo_CCVS1_message_Vehicle_Speed_Invalid_Serial_Data_Received
        OpEventGetDebouncingOfEvent_GetDebouncingOfEvent_EvtInfo_EMS_ECU_VD_erratic_communication_Erratic: RteEventRef=OpEventGetDebouncingOfEvent_GetDebouncingOfEvent_EvtInfo_EMS_ECU_VD_erratic_communication_Erratic
        OpEventGetDebouncingOfEvent_GetDebouncingOfEvent_EvtInfo_EMS_ECU_ETC2_00_message_Missing_Message: RteEventRef=OpEventGetDebouncingOfEvent_GetDebouncingOfEvent_EvtInfo_EMS_ECU_ETC2_00_message_Missing_Message
        OpEventGetDebouncingOfEvent_GetDebouncingOfEvent_EvtInfo_Cluster_ECU_CLS_Tx_16_message_Missing_Message: RteEventRef=OpEventGetDebouncingOfEvent_GetDebouncingOfEvent_EvtInfo_Cluster_ECU_CLS_Tx_16_message_Missing_Message
        OpEventGetDebouncingOfEvent_GetDebouncingOfEvent_EvtInfo_Exceeded_Security_Access_0x27_Attempt_Threshold_Authentication_Failure: RteEventRef=OpEventGetDebouncingOfEvent_GetDebouncingOfEvent_EvtInfo_Exceeded_Security_Access_0x27_Attempt_Threshold_Authentication_Failure
        OpEventGetDebouncingOfEvent_GetDebouncingOfEvent_EvtInfo_Front_Left_Side_Radar_value_of_signal_protection_calculation_Incorrect: RteEventRef=OpEventGetDebouncingOfEvent_GetDebouncingOfEvent_EvtInfo_Front_Left_Side_Radar_value_of_signal_protection_calculation_Incorrect
        OpEventGetDebouncingOfEvent_GetDebouncingOfEvent_EvtInfo_AT_AMT_ETC2_erratic_communication_Erratic: RteEventRef=OpEventGetDebouncingOfEvent_GetDebouncingOfEvent_EvtInfo_AT_AMT_ETC2_erratic_communication_Erratic
        OpEventGetDebouncingOfEvent_GetDebouncingOfEvent_EvtInfo_VCAN_Communication_Bus_Off: RteEventRef=OpEventGetDebouncingOfEvent_GetDebouncingOfEvent_EvtInfo_VCAN_Communication_Bus_Off
        OpEventGetDebouncingOfEvent_GetDebouncingOfEvent_EvtInfo_VDC2_message_LongitudinalAcceleration_Invalid_Serial_Data_Received: RteEventRef=OpEventGetDebouncingOfEvent_GetDebouncingOfEvent_EvtInfo_VDC2_message_LongitudinalAcceleration_Invalid_Serial_Data_Received
        OpEventGetDebouncingOfEvent_GetDebouncingOfEvent_EvtInfo_Radar_MMIC_RFBIST_Component_Internal_Failure: RteEventRef=OpEventGetDebouncingOfEvent_GetDebouncingOfEvent_EvtInfo_Radar_MMIC_RFBIST_Component_Internal_Failure
        OpEventGetDebouncingOfEvent_GetDebouncingOfEvent_EvtInfo_Radar_Initial_Alignment_Missing_Calibration: RteEventRef=OpEventGetDebouncingOfEvent_GetDebouncingOfEvent_EvtInfo_Radar_Initial_Alignment_Missing_Calibration
        OpEventGetDebouncingOfEvent_GetDebouncingOfEvent_EvtInfo_Cluster_ECU_OEL_message_Missing_Message: RteEventRef=OpEventGetDebouncingOfEvent_GetDebouncingOfEvent_EvtInfo_Cluster_ECU_OEL_message_Missing_Message
        OpEventGetDebouncingOfEvent_GetDebouncingOfEvent_EvtInfo_AT_AMT_ECU_ETC2_03_message_Missing_Message: RteEventRef=OpEventGetDebouncingOfEvent_GetDebouncingOfEvent_EvtInfo_AT_AMT_ECU_ETC2_03_message_Missing_Message
        OpEventGetDebouncingOfEvent_GetDebouncingOfEvent_EvtInfo_ADAS_FN_STS_message_MOIS_FN_Switch_STS_Invalid_Serial_Data_Received: RteEventRef=OpEventGetDebouncingOfEvent_GetDebouncingOfEvent_EvtInfo_ADAS_FN_STS_message_MOIS_FN_Switch_STS_Invalid_Serial_Data_Received
        OpEventGetDebouncingOfEvent_GetDebouncingOfEvent_EvtInfo_Radar_Module_Over_Temperature: RteEventRef=OpEventGetDebouncingOfEvent_GetDebouncingOfEvent_EvtInfo_Radar_Module_Over_Temperature
        OpEventGetDebouncingOfEvent_GetDebouncingOfEvent_EvtInfo_PCAN_TimeSync_Missing_Message: RteEventRef=OpEventGetDebouncingOfEvent_GetDebouncingOfEvent_EvtInfo_PCAN_TimeSync_Missing_Message
        OpEventGetDebouncingOfEvent_GetDebouncingOfEvent_EvtInfo_Radar_Module_Watchdog_Failure: RteEventRef=OpEventGetDebouncingOfEvent_GetDebouncingOfEvent_EvtInfo_Radar_Module_Watchdog_Failure
        OpEventGetDebouncingOfEvent_GetDebouncingOfEvent_EvtInfo_SAS_ECU_SAS_message_Missing_Message: RteEventRef=OpEventGetDebouncingOfEvent_GetDebouncingOfEvent_EvtInfo_SAS_ECU_SAS_message_Missing_Message
        OpEventGetDebouncingOfEvent_GetDebouncingOfEvent_EvtInfo_ECU_NVM_Corruption_Program_memory_Failure: RteEventRef=OpEventGetDebouncingOfEvent_GetDebouncingOfEvent_EvtInfo_ECU_NVM_Corruption_Program_memory_Failure
        OpEventGetDebouncingOfEvent_GetDebouncingOfEvent_EvtInfo_Cluster_ECU_TD_message_Missing_Message: RteEventRef=OpEventGetDebouncingOfEvent_GetDebouncingOfEvent_EvtInfo_Cluster_ECU_TD_message_Missing_Message
        OpEventGetDebouncingOfEvent_GetDebouncingOfEvent_EvtInfo_PCAN_Communication_Bus_Off: RteEventRef=OpEventGetDebouncingOfEvent_GetDebouncingOfEvent_EvtInfo_PCAN_Communication_Bus_Off
        OpEventGetDebouncingOfEvent_GetDebouncingOfEvent_EvtInfo_Front_Left_Side_Radar_Missing_Message: RteEventRef=OpEventGetDebouncingOfEvent_GetDebouncingOfEvent_EvtInfo_Front_Left_Side_Radar_Missing_Message
        OpEventGetDebouncingOfEvent_GetDebouncingOfEvent_EvtInfo_Manual_ETC2_message_Transcurrent_gear_Invalid_Serial_Data_Received: RteEventRef=OpEventGetDebouncingOfEvent_GetDebouncingOfEvent_EvtInfo_Manual_ETC2_message_Transcurrent_gear_Invalid_Serial_Data_Received
        OpEventGetDebouncingOfEvent_GetDebouncingOfEvent_EvtInfo_SAS_ECU_erratic_communication_Erratic: RteEventRef=OpEventGetDebouncingOfEvent_GetDebouncingOfEvent_EvtInfo_SAS_ECU_erratic_communication_Erratic
        OpEventGetDebouncingOfEvent_GetDebouncingOfEvent_EvtInfo_VDC2_message_Yaw_rate_Invalid_Serial_Data_Received: RteEventRef=OpEventGetDebouncingOfEvent_GetDebouncingOfEvent_EvtInfo_VDC2_message_Yaw_rate_Invalid_Serial_Data_Received
        OpEventGetDebouncingOfEvent_GetDebouncingOfEvent_EvtInfo_Cluster_ECU_TD_erratic_communication_Erratic: RteEventRef=OpEventGetDebouncingOfEvent_GetDebouncingOfEvent_EvtInfo_Cluster_ECU_TD_erratic_communication_Erratic
        OpEventGetDebouncingOfEvent_GetDebouncingOfEvent_EvtInfo_EMS_ECU_CCVS1_message_Missing_Message: RteEventRef=OpEventGetDebouncingOfEvent_GetDebouncingOfEvent_EvtInfo_EMS_ECU_CCVS1_message_Missing_Message
        OpEventGetDebouncingOfEvent_GetDebouncingOfEvent_EvtInfo_Radar_Mounting_Orientation_Incorrect_Assembly: RteEventRef=OpEventGetDebouncingOfEvent_GetDebouncingOfEvent_EvtInfo_Radar_Mounting_Orientation_Incorrect_Assembly
        OpEventGetDebouncingOfEvent_GetDebouncingOfEvent_EvtInfo_EMS_ECU_ETC2_erratic_communication_Erractic: RteEventRef=OpEventGetDebouncingOfEvent_GetDebouncingOfEvent_EvtInfo_EMS_ECU_ETC2_erratic_communication_Erractic
        OpEventGetDebouncingOfEvent_GetDebouncingOfEvent_EvtInfo_Cluster_ECU_ADAS_FN_STS_erratic_communication_Erratic: RteEventRef=OpEventGetDebouncingOfEvent_GetDebouncingOfEvent_EvtInfo_Cluster_ECU_ADAS_FN_STS_erratic_communication_Erratic
        OpEventGetDebouncingOfEvent_GetDebouncingOfEvent_EvtInfo_ESC_ECU_VDC2_message_Missing_Message: RteEventRef=OpEventGetDebouncingOfEvent_GetDebouncingOfEvent_EvtInfo_ESC_ECU_VDC2_message_Missing_Message
        OpEventGetDebouncingOfEvent_GetDebouncingOfEvent_EvtInfo_CLS_TX_16_message_Transmission_Type_info_Invalid_Serial_Data_Received: RteEventRef=OpEventGetDebouncingOfEvent_GetDebouncingOfEvent_EvtInfo_CLS_TX_16_message_Transmission_Type_info_Invalid_Serial_Data_Received
        OpEventGetDebouncingOfEvent_GetDebouncingOfEvent_EvtInfo_Cluster_ECU_CLS_Tx_4_erratic_communication_Erratic: RteEventRef=OpEventGetDebouncingOfEvent_GetDebouncingOfEvent_EvtInfo_Cluster_ECU_CLS_Tx_4_erratic_communication_Erratic
        OpEventGetDebouncingOfEvent_GetDebouncingOfEvent_EvtInfo_Cluster_ECU_ADAS_FN_STS_message_Missing_Message: RteEventRef=OpEventGetDebouncingOfEvent_GetDebouncingOfEvent_EvtInfo_Cluster_ECU_ADAS_FN_STS_message_Missing_Message
        OpEventGetDebouncingOfEvent_GetDebouncingOfEvent_EvtInfo_Vehicle_Dataset_value_of_signal_protection_calculation_Incorrect: RteEventRef=OpEventGetDebouncingOfEvent_GetDebouncingOfEvent_EvtInfo_Vehicle_Dataset_value_of_signal_protection_calculation_Incorrect
        OpEventGetDebouncingOfEvent_GetDebouncingOfEvent_EvtInfo_Cluster_ECU_CLS_Tx_16_erratic_communication_Erratic: RteEventRef=OpEventGetDebouncingOfEvent_GetDebouncingOfEvent_EvtInfo_Cluster_ECU_CLS_Tx_16_erratic_communication_Erratic
        OpEventGetDebouncingOfEvent_GetDebouncingOfEvent_EvtInfo_Cluster_ECU_OEL_erratic_communication_Erratic: RteEventRef=OpEventGetDebouncingOfEvent_GetDebouncingOfEvent_EvtInfo_Cluster_ECU_OEL_erratic_communication_Erratic
        OpEventGetDebouncingOfEvent_GetDebouncingOfEvent_EvtInfo_Cluster_ECU_CLS_Tx_4_message_Missing_Message: RteEventRef=OpEventGetDebouncingOfEvent_GetDebouncingOfEvent_EvtInfo_Cluster_ECU_CLS_Tx_4_message_Missing_Message
        OpEventGetDebouncingOfEvent_GetDebouncingOfEvent_EvtInfo_Radar_Performance_Capability_Algorithm_Based_Failure: RteEventRef=OpEventGetDebouncingOfEvent_GetDebouncingOfEvent_EvtInfo_Radar_Performance_Capability_Algorithm_Based_Failure
        OpEventGetDebouncingOfEvent_GetDebouncingOfEvent_EvtInfo_Radar_AutoAlignment_Range_Alignment_or_Adjustement_Incorrect: RteEventRef=OpEventGetDebouncingOfEvent_GetDebouncingOfEvent_EvtInfo_Radar_AutoAlignment_Range_Alignment_or_Adjustement_Incorrect
        OpEventGetDebouncingOfEvent_GetDebouncingOfEvent_EvtInfo_EMS_ECU_CCVS1_erratic_communication_Erractic: RteEventRef=OpEventGetDebouncingOfEvent_GetDebouncingOfEvent_EvtInfo_EMS_ECU_CCVS1_erratic_communication_Erractic
        OpEventGetDebouncingOfEvent_GetDebouncingOfEvent_EvtInfo_Radar_System_Battery_Low_Voltage_System_Voltage_Low: RteEventRef=OpEventGetDebouncingOfEvent_GetDebouncingOfEvent_EvtInfo_Radar_System_Battery_Low_Voltage_System_Voltage_Low
        OpEventGetDebouncingOfEvent_GetDebouncingOfEvent_EvtInfo_Radar_SMC_General_Checksum_Failure: RteEventRef=OpEventGetDebouncingOfEvent_GetDebouncingOfEvent_EvtInfo_Radar_SMC_General_Checksum_Failure
        OpEventGetDebouncingOfEvent_GetDebouncingOfEvent_EvtInfo_Radar_Pin_Position_Wrong_Mounting_Position: RteEventRef=OpEventGetDebouncingOfEvent_GetDebouncingOfEvent_EvtInfo_Radar_Pin_Position_Wrong_Mounting_Position
        OpEventGetDebouncingOfEvent_GetDebouncingOfEvent_EvtInfo_VDC2_message_Lateral_Accleration_Invalid_Serial_Data_Received: RteEventRef=OpEventGetDebouncingOfEvent_GetDebouncingOfEvent_EvtInfo_VDC2_message_Lateral_Accleration_Invalid_Serial_Data_Received
        OpEventGetDebouncingOfEvent_GetDebouncingOfEvent_EvtInfo_ADAS_FN_STS_message_BSIS_FN_Switch_STS_Invalid_Serial_Data_Received: RteEventRef=OpEventGetDebouncingOfEvent_GetDebouncingOfEvent_EvtInfo_ADAS_FN_STS_message_BSIS_FN_Switch_STS_Invalid_Serial_Data_Received
        OpEventGetDebouncingOfEvent_GetDebouncingOfEvent_EvtInfo_Radar_AutoAlignment_Misalignment_Performance_or_Incorrect_Operation: RteEventRef=OpEventGetDebouncingOfEvent_GetDebouncingOfEvent_EvtInfo_Radar_AutoAlignment_Misalignment_Performance_or_Incorrect_Operation
        OpEventGetDebouncingOfEvent_GetDebouncingOfEvent_EvtInfo_ESC_ECU_VDC2_erratic_communication_Erratic: RteEventRef=OpEventGetDebouncingOfEvent_GetDebouncingOfEvent_EvtInfo_ESC_ECU_VDC2_erratic_communication_Erratic
        OpEventGetDebouncingOfEvent_GetDebouncingOfEvent_EvtInfo_Application_Interface_Lookup_Performance_or_Incorrect_Operation: RteEventRef=OpEventGetDebouncingOfEvent_GetDebouncingOfEvent_EvtInfo_Application_Interface_Lookup_Performance_or_Incorrect_Operation
        OpEventGetDebouncingOfEvent_GetDebouncingOfEvent_EvtInfo_EMS_ECU_VD_message_Missing_Message: RteEventRef=OpEventGetDebouncingOfEvent_GetDebouncingOfEvent_EvtInfo_EMS_ECU_VD_message_Missing_Message
        OpEventGetDebouncingOfEvent_GetDebouncingOfEvent_EvtInfo_Radar_Platform_Time_System_Programming_Failure: RteEventRef=OpEventGetDebouncingOfEvent_GetDebouncingOfEvent_EvtInfo_Radar_Platform_Time_System_Programming_Failure
        OpEventGetDebouncingOfEvent_GetDebouncingOfEvent_EvtInfo_OEL_message_Turn_Signal_Switch_Invalid_Serial_Data_Received: RteEventRef=OpEventGetDebouncingOfEvent_GetDebouncingOfEvent_EvtInfo_OEL_message_Turn_Signal_Switch_Invalid_Serial_Data_Received
        OpEventGetDebouncingOfEvent_GetDebouncingOfEvent_EvtInfo_Radar_calibration_Calibration_or_Paramater_Memory_Failure: RteEventRef=OpEventGetDebouncingOfEvent_GetDebouncingOfEvent_EvtInfo_Radar_calibration_Calibration_or_Paramater_Memory_Failure
        OpEventGetDebouncingOfEvent_GetDebouncingOfEvent_GeneralEvtInfo: RteEventRef=OpEventGetDebouncingOfEvent_GetDebouncingOfEvent_GeneralEvtInfo
        OpEventGetMonitorStatus_GetMonitorStatus_EvtInfo_SAS_message_Steering_Wheel_Angle_Invalid_Serial_Data_Received: RteEventRef=OpEventGetMonitorStatus_GetMonitorStatus_EvtInfo_SAS_message_Steering_Wheel_Angle_Invalid_Serial_Data_Received
        OpEventGetMonitorStatus_GetMonitorStatus_EvtInfo_AT_AMT_ETC2_message_Transcurrent_gear_Invalid_Serial_Data_Received: RteEventRef=OpEventGetMonitorStatus_GetMonitorStatus_EvtInfo_AT_AMT_ETC2_message_Transcurrent_gear_Invalid_Serial_Data_Received
        OpEventGetMonitorStatus_GetMonitorStatus_EvtInfo_Radar_AutoAlignment_Algorithm_Signal_Calculation_Failure: RteEventRef=OpEventGetMonitorStatus_GetMonitorStatus_EvtInfo_Radar_AutoAlignment_Algorithm_Signal_Calculation_Failure
        OpEventGetMonitorStatus_GetMonitorStatus_EvtInfo_Vehicle_DataSet_Not_Configured: RteEventRef=OpEventGetMonitorStatus_GetMonitorStatus_EvtInfo_Vehicle_DataSet_Not_Configured
        OpEventGetMonitorStatus_GetMonitorStatus_EvtInfo_Radar_Module_System_Internal_Failure: RteEventRef=OpEventGetMonitorStatus_GetMonitorStatus_EvtInfo_Radar_Module_System_Internal_Failure
        OpEventGetMonitorStatus_GetMonitorStatus_EvtInfo_Radar_MMIC_Component_Failure: RteEventRef=OpEventGetMonitorStatus_GetMonitorStatus_EvtInfo_Radar_MMIC_Component_Failure
        OpEventGetMonitorStatus_GetMonitorStatus_EvtInfo_Radar_Module_General_Memory_Failure: RteEventRef=OpEventGetMonitorStatus_GetMonitorStatus_EvtInfo_Radar_Module_General_Memory_Failure
        OpEventGetMonitorStatus_GetMonitorStatus_EvtInfo_Radar_System_Battery_High_Voltage_System_Voltage_High: RteEventRef=OpEventGetMonitorStatus_GetMonitorStatus_EvtInfo_Radar_System_Battery_High_Voltage_System_Voltage_High
        OpEventGetMonitorStatus_GetMonitorStatus_EvtInfo_CCVS1_message_Vehicle_Speed_Invalid_Serial_Data_Received: RteEventRef=OpEventGetMonitorStatus_GetMonitorStatus_EvtInfo_CCVS1_message_Vehicle_Speed_Invalid_Serial_Data_Received
        OpEventGetMonitorStatus_GetMonitorStatus_EvtInfo_EMS_ECU_VD_erratic_communication_Erratic: RteEventRef=OpEventGetMonitorStatus_GetMonitorStatus_EvtInfo_EMS_ECU_VD_erratic_communication_Erratic
        OpEventGetMonitorStatus_GetMonitorStatus_EvtInfo_EMS_ECU_ETC2_00_message_Missing_Message: RteEventRef=OpEventGetMonitorStatus_GetMonitorStatus_EvtInfo_EMS_ECU_ETC2_00_message_Missing_Message
        OpEventGetMonitorStatus_GetMonitorStatus_EvtInfo_Cluster_ECU_CLS_Tx_16_message_Missing_Message: RteEventRef=OpEventGetMonitorStatus_GetMonitorStatus_EvtInfo_Cluster_ECU_CLS_Tx_16_message_Missing_Message
        OpEventGetMonitorStatus_GetMonitorStatus_EvtInfo_Exceeded_Security_Access_0x27_Attempt_Threshold_Authentication_Failure: RteEventRef=OpEventGetMonitorStatus_GetMonitorStatus_EvtInfo_Exceeded_Security_Access_0x27_Attempt_Threshold_Authentication_Failure
        OpEventGetMonitorStatus_GetMonitorStatus_EvtInfo_Front_Left_Side_Radar_value_of_signal_protection_calculation_Incorrect: RteEventRef=OpEventGetMonitorStatus_GetMonitorStatus_EvtInfo_Front_Left_Side_Radar_value_of_signal_protection_calculation_Incorrect
        OpEventGetMonitorStatus_GetMonitorStatus_EvtInfo_AT_AMT_ETC2_erratic_communication_Erratic: RteEventRef=OpEventGetMonitorStatus_GetMonitorStatus_EvtInfo_AT_AMT_ETC2_erratic_communication_Erratic
        OpEventGetMonitorStatus_GetMonitorStatus_EvtInfo_VCAN_Communication_Bus_Off: RteEventRef=OpEventGetMonitorStatus_GetMonitorStatus_EvtInfo_VCAN_Communication_Bus_Off
        OpEventGetMonitorStatus_GetMonitorStatus_EvtInfo_VDC2_message_LongitudinalAcceleration_Invalid_Serial_Data_Received: RteEventRef=OpEventGetMonitorStatus_GetMonitorStatus_EvtInfo_VDC2_message_LongitudinalAcceleration_Invalid_Serial_Data_Received
        OpEventGetMonitorStatus_GetMonitorStatus_EvtInfo_Radar_MMIC_RFBIST_Component_Internal_Failure: RteEventRef=OpEventGetMonitorStatus_GetMonitorStatus_EvtInfo_Radar_MMIC_RFBIST_Component_Internal_Failure
        OpEventGetMonitorStatus_GetMonitorStatus_EvtInfo_Radar_Initial_Alignment_Missing_Calibration: RteEventRef=OpEventGetMonitorStatus_GetMonitorStatus_EvtInfo_Radar_Initial_Alignment_Missing_Calibration
        OpEventGetMonitorStatus_GetMonitorStatus_EvtInfo_Cluster_ECU_OEL_message_Missing_Message: RteEventRef=OpEventGetMonitorStatus_GetMonitorStatus_EvtInfo_Cluster_ECU_OEL_message_Missing_Message
        OpEventGetMonitorStatus_GetMonitorStatus_EvtInfo_AT_AMT_ECU_ETC2_03_message_Missing_Message: RteEventRef=OpEventGetMonitorStatus_GetMonitorStatus_EvtInfo_AT_AMT_ECU_ETC2_03_message_Missing_Message
        OpEventGetMonitorStatus_GetMonitorStatus_EvtInfo_ADAS_FN_STS_message_MOIS_FN_Switch_STS_Invalid_Serial_Data_Received: RteEventRef=OpEventGetMonitorStatus_GetMonitorStatus_EvtInfo_ADAS_FN_STS_message_MOIS_FN_Switch_STS_Invalid_Serial_Data_Received
        OpEventGetMonitorStatus_GetMonitorStatus_EvtInfo_Radar_Module_Over_Temperature: RteEventRef=OpEventGetMonitorStatus_GetMonitorStatus_EvtInfo_Radar_Module_Over_Temperature
        OpEventGetMonitorStatus_GetMonitorStatus_EvtInfo_PCAN_TimeSync_Missing_Message: RteEventRef=OpEventGetMonitorStatus_GetMonitorStatus_EvtInfo_PCAN_TimeSync_Missing_Message
        OpEventGetMonitorStatus_GetMonitorStatus_EvtInfo_Radar_Module_Watchdog_Failure: RteEventRef=OpEventGetMonitorStatus_GetMonitorStatus_EvtInfo_Radar_Module_Watchdog_Failure
        OpEventGetMonitorStatus_GetMonitorStatus_EvtInfo_SAS_ECU_SAS_message_Missing_Message: RteEventRef=OpEventGetMonitorStatus_GetMonitorStatus_EvtInfo_SAS_ECU_SAS_message_Missing_Message
        OpEventGetMonitorStatus_GetMonitorStatus_EvtInfo_ECU_NVM_Corruption_Program_memory_Failure: RteEventRef=OpEventGetMonitorStatus_GetMonitorStatus_EvtInfo_ECU_NVM_Corruption_Program_memory_Failure
        OpEventGetMonitorStatus_GetMonitorStatus_EvtInfo_Cluster_ECU_TD_message_Missing_Message: RteEventRef=OpEventGetMonitorStatus_GetMonitorStatus_EvtInfo_Cluster_ECU_TD_message_Missing_Message
        OpEventGetMonitorStatus_GetMonitorStatus_EvtInfo_PCAN_Communication_Bus_Off: RteEventRef=OpEventGetMonitorStatus_GetMonitorStatus_EvtInfo_PCAN_Communication_Bus_Off
        OpEventGetMonitorStatus_GetMonitorStatus_EvtInfo_Front_Left_Side_Radar_Missing_Message: RteEventRef=OpEventGetMonitorStatus_GetMonitorStatus_EvtInfo_Front_Left_Side_Radar_Missing_Message
        OpEventGetMonitorStatus_GetMonitorStatus_EvtInfo_Manual_ETC2_message_Transcurrent_gear_Invalid_Serial_Data_Received: RteEventRef=OpEventGetMonitorStatus_GetMonitorStatus_EvtInfo_Manual_ETC2_message_Transcurrent_gear_Invalid_Serial_Data_Received
        OpEventGetMonitorStatus_GetMonitorStatus_EvtInfo_SAS_ECU_erratic_communication_Erratic: RteEventRef=OpEventGetMonitorStatus_GetMonitorStatus_EvtInfo_SAS_ECU_erratic_communication_Erratic
        OpEventGetMonitorStatus_GetMonitorStatus_EvtInfo_VDC2_message_Yaw_rate_Invalid_Serial_Data_Received: RteEventRef=OpEventGetMonitorStatus_GetMonitorStatus_EvtInfo_VDC2_message_Yaw_rate_Invalid_Serial_Data_Received
        OpEventGetMonitorStatus_GetMonitorStatus_EvtInfo_Cluster_ECU_TD_erratic_communication_Erratic: RteEventRef=OpEventGetMonitorStatus_GetMonitorStatus_EvtInfo_Cluster_ECU_TD_erratic_communication_Erratic
        OpEventGetMonitorStatus_GetMonitorStatus_EvtInfo_EMS_ECU_CCVS1_message_Missing_Message: RteEventRef=OpEventGetMonitorStatus_GetMonitorStatus_EvtInfo_EMS_ECU_CCVS1_message_Missing_Message
        OpEventGetMonitorStatus_GetMonitorStatus_EvtInfo_Radar_Mounting_Orientation_Incorrect_Assembly: RteEventRef=OpEventGetMonitorStatus_GetMonitorStatus_EvtInfo_Radar_Mounting_Orientation_Incorrect_Assembly
        OpEventGetMonitorStatus_GetMonitorStatus_EvtInfo_EMS_ECU_ETC2_erratic_communication_Erractic: RteEventRef=OpEventGetMonitorStatus_GetMonitorStatus_EvtInfo_EMS_ECU_ETC2_erratic_communication_Erractic
        OpEventGetMonitorStatus_GetMonitorStatus_EvtInfo_Cluster_ECU_ADAS_FN_STS_erratic_communication_Erratic: RteEventRef=OpEventGetMonitorStatus_GetMonitorStatus_EvtInfo_Cluster_ECU_ADAS_FN_STS_erratic_communication_Erratic
        OpEventGetMonitorStatus_GetMonitorStatus_EvtInfo_ESC_ECU_VDC2_message_Missing_Message: RteEventRef=OpEventGetMonitorStatus_GetMonitorStatus_EvtInfo_ESC_ECU_VDC2_message_Missing_Message
        OpEventGetMonitorStatus_GetMonitorStatus_EvtInfo_CLS_TX_16_message_Transmission_Type_info_Invalid_Serial_Data_Received: RteEventRef=OpEventGetMonitorStatus_GetMonitorStatus_EvtInfo_CLS_TX_16_message_Transmission_Type_info_Invalid_Serial_Data_Received
        OpEventGetMonitorStatus_GetMonitorStatus_EvtInfo_Cluster_ECU_CLS_Tx_4_erratic_communication_Erratic: RteEventRef=OpEventGetMonitorStatus_GetMonitorStatus_EvtInfo_Cluster_ECU_CLS_Tx_4_erratic_communication_Erratic
        OpEventGetMonitorStatus_GetMonitorStatus_EvtInfo_Cluster_ECU_ADAS_FN_STS_message_Missing_Message: RteEventRef=OpEventGetMonitorStatus_GetMonitorStatus_EvtInfo_Cluster_ECU_ADAS_FN_STS_message_Missing_Message
        OpEventGetMonitorStatus_GetMonitorStatus_EvtInfo_Vehicle_Dataset_value_of_signal_protection_calculation_Incorrect: RteEventRef=OpEventGetMonitorStatus_GetMonitorStatus_EvtInfo_Vehicle_Dataset_value_of_signal_protection_calculation_Incorrect
        OpEventGetMonitorStatus_GetMonitorStatus_EvtInfo_Cluster_ECU_CLS_Tx_16_erratic_communication_Erratic: RteEventRef=OpEventGetMonitorStatus_GetMonitorStatus_EvtInfo_Cluster_ECU_CLS_Tx_16_erratic_communication_Erratic
        OpEventGetMonitorStatus_GetMonitorStatus_EvtInfo_Cluster_ECU_OEL_erratic_communication_Erratic: RteEventRef=OpEventGetMonitorStatus_GetMonitorStatus_EvtInfo_Cluster_ECU_OEL_erratic_communication_Erratic
        OpEventGetMonitorStatus_GetMonitorStatus_EvtInfo_Cluster_ECU_CLS_Tx_4_message_Missing_Message: RteEventRef=OpEventGetMonitorStatus_GetMonitorStatus_EvtInfo_Cluster_ECU_CLS_Tx_4_message_Missing_Message
        OpEventGetMonitorStatus_GetMonitorStatus_EvtInfo_Radar_Performance_Capability_Algorithm_Based_Failure: RteEventRef=OpEventGetMonitorStatus_GetMonitorStatus_EvtInfo_Radar_Performance_Capability_Algorithm_Based_Failure
        OpEventGetMonitorStatus_GetMonitorStatus_EvtInfo_Radar_AutoAlignment_Range_Alignment_or_Adjustement_Incorrect: RteEventRef=OpEventGetMonitorStatus_GetMonitorStatus_EvtInfo_Radar_AutoAlignment_Range_Alignment_or_Adjustement_Incorrect
        OpEventGetMonitorStatus_GetMonitorStatus_EvtInfo_EMS_ECU_CCVS1_erratic_communication_Erractic: RteEventRef=OpEventGetMonitorStatus_GetMonitorStatus_EvtInfo_EMS_ECU_CCVS1_erratic_communication_Erractic
        OpEventGetMonitorStatus_GetMonitorStatus_EvtInfo_Radar_System_Battery_Low_Voltage_System_Voltage_Low: RteEventRef=OpEventGetMonitorStatus_GetMonitorStatus_EvtInfo_Radar_System_Battery_Low_Voltage_System_Voltage_Low
        OpEventGetMonitorStatus_GetMonitorStatus_EvtInfo_Radar_SMC_General_Checksum_Failure: RteEventRef=OpEventGetMonitorStatus_GetMonitorStatus_EvtInfo_Radar_SMC_General_Checksum_Failure
        OpEventGetMonitorStatus_GetMonitorStatus_EvtInfo_Radar_Pin_Position_Wrong_Mounting_Position: RteEventRef=OpEventGetMonitorStatus_GetMonitorStatus_EvtInfo_Radar_Pin_Position_Wrong_Mounting_Position
        OpEventGetMonitorStatus_GetMonitorStatus_EvtInfo_VDC2_message_Lateral_Accleration_Invalid_Serial_Data_Received: RteEventRef=OpEventGetMonitorStatus_GetMonitorStatus_EvtInfo_VDC2_message_Lateral_Accleration_Invalid_Serial_Data_Received
        OpEventGetMonitorStatus_GetMonitorStatus_EvtInfo_ADAS_FN_STS_message_BSIS_FN_Switch_STS_Invalid_Serial_Data_Received: RteEventRef=OpEventGetMonitorStatus_GetMonitorStatus_EvtInfo_ADAS_FN_STS_message_BSIS_FN_Switch_STS_Invalid_Serial_Data_Received
        OpEventGetMonitorStatus_GetMonitorStatus_EvtInfo_Radar_AutoAlignment_Misalignment_Performance_or_Incorrect_Operation: RteEventRef=OpEventGetMonitorStatus_GetMonitorStatus_EvtInfo_Radar_AutoAlignment_Misalignment_Performance_or_Incorrect_Operation
        OpEventGetMonitorStatus_GetMonitorStatus_EvtInfo_ESC_ECU_VDC2_erratic_communication_Erratic: RteEventRef=OpEventGetMonitorStatus_GetMonitorStatus_EvtInfo_ESC_ECU_VDC2_erratic_communication_Erratic
        OpEventGetMonitorStatus_GetMonitorStatus_EvtInfo_Application_Interface_Lookup_Performance_or_Incorrect_Operation: RteEventRef=OpEventGetMonitorStatus_GetMonitorStatus_EvtInfo_Application_Interface_Lookup_Performance_or_Incorrect_Operation
        OpEventGetMonitorStatus_GetMonitorStatus_EvtInfo_EMS_ECU_VD_message_Missing_Message: RteEventRef=OpEventGetMonitorStatus_GetMonitorStatus_EvtInfo_EMS_ECU_VD_message_Missing_Message
        OpEventGetMonitorStatus_GetMonitorStatus_EvtInfo_Radar_Platform_Time_System_Programming_Failure: RteEventRef=OpEventGetMonitorStatus_GetMonitorStatus_EvtInfo_Radar_Platform_Time_System_Programming_Failure
        OpEventGetMonitorStatus_GetMonitorStatus_EvtInfo_OEL_message_Turn_Signal_Switch_Invalid_Serial_Data_Received: RteEventRef=OpEventGetMonitorStatus_GetMonitorStatus_EvtInfo_OEL_message_Turn_Signal_Switch_Invalid_Serial_Data_Received
        OpEventGetMonitorStatus_GetMonitorStatus_EvtInfo_Radar_calibration_Calibration_or_Paramater_Memory_Failure: RteEventRef=OpEventGetMonitorStatus_GetMonitorStatus_EvtInfo_Radar_calibration_Calibration_or_Paramater_Memory_Failure
        OpEventGetMonitorStatus_GetMonitorStatus_GeneralEvtInfo: RteEventRef=OpEventGetMonitorStatus_GetMonitorStatus_GeneralEvtInfo
        OpEventSetEventStatus_SetEventStatus_Event_SAS_message_Steering_Wheel_Angle_Invalid_Serial_Data_Received: RteEventRef=OpEventSetEventStatus_SetEventStatus_Event_SAS_message_Steering_Wheel_Angle_Invalid_Serial_Data_Received
        OpEventSetEventStatus_SetEventStatus_Event_AT_AMT_ETC2_message_Transcurrent_gear_Invalid_Serial_Data_Received: RteEventRef=OpEventSetEventStatus_SetEventStatus_Event_AT_AMT_ETC2_message_Transcurrent_gear_Invalid_Serial_Data_Received
        OpEventSetEventStatus_SetEventStatus_Event_Radar_AutoAlignment_Algorithm_Signal_Calculation_Failure: RteEventRef=OpEventSetEventStatus_SetEventStatus_Event_Radar_AutoAlignment_Algorithm_Signal_Calculation_Failure
        OpEventSetEventStatus_SetEventStatus_Event_Vehicle_DataSet_Not_Configured: RteEventRef=OpEventSetEventStatus_SetEventStatus_Event_Vehicle_DataSet_Not_Configured
        OpEventSetEventStatus_SetEventStatus_Event_Radar_Module_System_Internal_Failure: RteEventRef=OpEventSetEventStatus_SetEventStatus_Event_Radar_Module_System_Internal_Failure
        OpEventSetEventStatus_SetEventStatus_Event_Radar_MMIC_Component_Failure: RteEventRef=OpEventSetEventStatus_SetEventStatus_Event_Radar_MMIC_Component_Failure
        OpEventSetEventStatus_SetEventStatus_Event_Radar_Module_General_Memory_Failure: RteEventRef=OpEventSetEventStatus_SetEventStatus_Event_Radar_Module_General_Memory_Failure
        OpEventSetEventStatus_SetEventStatus_Event_Radar_System_Battery_High_Voltage_System_Voltage_High: RteEventRef=OpEventSetEventStatus_SetEventStatus_Event_Radar_System_Battery_High_Voltage_System_Voltage_High
        OpEventSetEventStatus_SetEventStatus_Event_CCVS1_message_Vehicle_Speed_Invalid_Serial_Data_Received: RteEventRef=OpEventSetEventStatus_SetEventStatus_Event_CCVS1_message_Vehicle_Speed_Invalid_Serial_Data_Received
        OpEventSetEventStatus_SetEventStatus_Event_EMS_ECU_VD_erratic_communication_Erratic: RteEventRef=OpEventSetEventStatus_SetEventStatus_Event_EMS_ECU_VD_erratic_communication_Erratic
        OpEventSetEventStatus_SetEventStatus_Event_EMS_ECU_ETC2_00_message_Missing_Message: RteEventRef=OpEventSetEventStatus_SetEventStatus_Event_EMS_ECU_ETC2_00_message_Missing_Message
        OpEventSetEventStatus_SetEventStatus_Event_Cluster_ECU_CLS_Tx_16_message_Missing_Message: RteEventRef=OpEventSetEventStatus_SetEventStatus_Event_Cluster_ECU_CLS_Tx_16_message_Missing_Message
        OpEventSetEventStatus_SetEventStatus_Event_Exceeded_Security_Access_0x27_Attempt_Threshold_Authentication_Failure: RteEventRef=OpEventSetEventStatus_SetEventStatus_Event_Exceeded_Security_Access_0x27_Attempt_Threshold_Authentication_Failure
        OpEventSetEventStatus_SetEventStatus_Event_Front_Left_Side_Radar_value_of_signal_protection_calculation_Incorrect: RteEventRef=OpEventSetEventStatus_SetEventStatus_Event_Front_Left_Side_Radar_value_of_signal_protection_calculation_Incorrect
        OpEventSetEventStatus_SetEventStatus_Event_AT_AMT_ETC2_erratic_communication_Erratic: RteEventRef=OpEventSetEventStatus_SetEventStatus_Event_AT_AMT_ETC2_erratic_communication_Erratic
        OpEventSetEventStatus_SetEventStatus_Event_VCAN_Communication_Bus_Off: RteEventRef=OpEventSetEventStatus_SetEventStatus_Event_VCAN_Communication_Bus_Off
        OpEventSetEventStatus_SetEventStatus_Event_VDC2_message_LongitudinalAcceleration_Invalid_Serial_Data_Received: RteEventRef=OpEventSetEventStatus_SetEventStatus_Event_VDC2_message_LongitudinalAcceleration_Invalid_Serial_Data_Received
        OpEventSetEventStatus_SetEventStatus_Event_Radar_MMIC_RFBIST_Component_Internal_Failure: RteEventRef=OpEventSetEventStatus_SetEventStatus_Event_Radar_MMIC_RFBIST_Component_Internal_Failure
        OpEventSetEventStatus_SetEventStatus_Event_Radar_Initial_Alignment_Missing_Calibration: RteEventRef=OpEventSetEventStatus_SetEventStatus_Event_Radar_Initial_Alignment_Missing_Calibration
        OpEventSetEventStatus_SetEventStatus_Event_Cluster_ECU_OEL_message_Missing_Message: RteEventRef=OpEventSetEventStatus_SetEventStatus_Event_Cluster_ECU_OEL_message_Missing_Message
        OpEventSetEventStatus_SetEventStatus_Event_AT_AMT_ECU_ETC2_03_message_Missing_Message: RteEventRef=OpEventSetEventStatus_SetEventStatus_Event_AT_AMT_ECU_ETC2_03_message_Missing_Message
        OpEventSetEventStatus_SetEventStatus_Event_ADAS_FN_STS_message_MOIS_FN_Switch_STS_Invalid_Serial_Data_Received: RteEventRef=OpEventSetEventStatus_SetEventStatus_Event_ADAS_FN_STS_message_MOIS_FN_Switch_STS_Invalid_Serial_Data_Received
        OpEventSetEventStatus_SetEventStatus_Event_Radar_Module_Over_Temperature: RteEventRef=OpEventSetEventStatus_SetEventStatus_Event_Radar_Module_Over_Temperature
        OpEventSetEventStatus_SetEventStatus_Event_PCAN_TimeSync_Missing_Message: RteEventRef=OpEventSetEventStatus_SetEventStatus_Event_PCAN_TimeSync_Missing_Message
        OpEventSetEventStatus_SetEventStatus_Event_Radar_Module_Watchdog_Failure: RteEventRef=OpEventSetEventStatus_SetEventStatus_Event_Radar_Module_Watchdog_Failure
        OpEventSetEventStatus_SetEventStatus_Event_SAS_ECU_SAS_message_Missing_Message: RteEventRef=OpEventSetEventStatus_SetEventStatus_Event_SAS_ECU_SAS_message_Missing_Message
        OpEventSetEventStatus_SetEventStatus_Event_ECU_NVM_Corruption_Program_memory_Failure: RteEventRef=OpEventSetEventStatus_SetEventStatus_Event_ECU_NVM_Corruption_Program_memory_Failure
        OpEventSetEventStatus_SetEventStatus_Event_Cluster_ECU_TD_message_Missing_Message: RteEventRef=OpEventSetEventStatus_SetEventStatus_Event_Cluster_ECU_TD_message_Missing_Message
        OpEventSetEventStatus_SetEventStatus_Event_PCAN_Communication_Bus_Off: RteEventRef=OpEventSetEventStatus_SetEventStatus_Event_PCAN_Communication_Bus_Off
        OpEventSetEventStatus_SetEventStatus_Event_Front_Left_Side_Radar_Missing_Message: RteEventRef=OpEventSetEventStatus_SetEventStatus_Event_Front_Left_Side_Radar_Missing_Message
        OpEventSetEventStatus_SetEventStatus_Event_Manual_ETC2_message_Transcurrent_gear_Invalid_Serial_Data_Received: RteEventRef=OpEventSetEventStatus_SetEventStatus_Event_Manual_ETC2_message_Transcurrent_gear_Invalid_Serial_Data_Received
        OpEventSetEventStatus_SetEventStatus_Event_SAS_ECU_erratic_communication_Erratic: RteEventRef=OpEventSetEventStatus_SetEventStatus_Event_SAS_ECU_erratic_communication_Erratic
        OpEventSetEventStatus_SetEventStatus_Event_VDC2_message_Yaw_rate_Invalid_Serial_Data_Received: RteEventRef=OpEventSetEventStatus_SetEventStatus_Event_VDC2_message_Yaw_rate_Invalid_Serial_Data_Received
        OpEventSetEventStatus_SetEventStatus_Event_Cluster_ECU_TD_erratic_communication_Erratic: RteEventRef=OpEventSetEventStatus_SetEventStatus_Event_Cluster_ECU_TD_erratic_communication_Erratic
        OpEventSetEventStatus_SetEventStatus_Event_EMS_ECU_CCVS1_message_Missing_Message: RteEventRef=OpEventSetEventStatus_SetEventStatus_Event_EMS_ECU_CCVS1_message_Missing_Message
        OpEventSetEventStatus_SetEventStatus_Event_Radar_Mounting_Orientation_Incorrect_Assembly: RteEventRef=OpEventSetEventStatus_SetEventStatus_Event_Radar_Mounting_Orientation_Incorrect_Assembly
        OpEventSetEventStatus_SetEventStatus_Event_EMS_ECU_ETC2_erratic_communication_Erractic: RteEventRef=OpEventSetEventStatus_SetEventStatus_Event_EMS_ECU_ETC2_erratic_communication_Erractic
        OpEventSetEventStatus_SetEventStatus_Event_Cluster_ECU_ADAS_FN_STS_erratic_communication_Erratic: RteEventRef=OpEventSetEventStatus_SetEventStatus_Event_Cluster_ECU_ADAS_FN_STS_erratic_communication_Erratic
        OpEventSetEventStatus_SetEventStatus_Event_ESC_ECU_VDC2_message_Missing_Message: RteEventRef=OpEventSetEventStatus_SetEventStatus_Event_ESC_ECU_VDC2_message_Missing_Message
        OpEventSetEventStatus_SetEventStatus_Event_CLS_TX_16_message_Transmission_Type_info_Invalid_Serial_Data_Received: RteEventRef=OpEventSetEventStatus_SetEventStatus_Event_CLS_TX_16_message_Transmission_Type_info_Invalid_Serial_Data_Received
        OpEventSetEventStatus_SetEventStatus_Event_Cluster_ECU_CLS_Tx_4_erratic_communication_Erratic: RteEventRef=OpEventSetEventStatus_SetEventStatus_Event_Cluster_ECU_CLS_Tx_4_erratic_communication_Erratic
        OpEventSetEventStatus_SetEventStatus_Event_Cluster_ECU_ADAS_FN_STS_message_Missing_Message: RteEventRef=OpEventSetEventStatus_SetEventStatus_Event_Cluster_ECU_ADAS_FN_STS_message_Missing_Message
        OpEventSetEventStatus_SetEventStatus_Event_Vehicle_Dataset_value_of_signal_protection_calculation_Incorrect: RteEventRef=OpEventSetEventStatus_SetEventStatus_Event_Vehicle_Dataset_value_of_signal_protection_calculation_Incorrect
        OpEventSetEventStatus_SetEventStatus_Event_Cluster_ECU_CLS_Tx_16_erratic_communication_Erratic: RteEventRef=OpEventSetEventStatus_SetEventStatus_Event_Cluster_ECU_CLS_Tx_16_erratic_communication_Erratic
        OpEventSetEventStatus_SetEventStatus_Event_Cluster_ECU_OEL_erratic_communication_Erratic: RteEventRef=OpEventSetEventStatus_SetEventStatus_Event_Cluster_ECU_OEL_erratic_communication_Erratic
        OpEventSetEventStatus_SetEventStatus_Event_Cluster_ECU_CLS_Tx_4_message_Missing_Message: RteEventRef=OpEventSetEventStatus_SetEventStatus_Event_Cluster_ECU_CLS_Tx_4_message_Missing_Message
        OpEventSetEventStatus_SetEventStatus_Event_Radar_Performance_Capability_Algorithm_Based_Failure: RteEventRef=OpEventSetEventStatus_SetEventStatus_Event_Radar_Performance_Capability_Algorithm_Based_Failure
        OpEventSetEventStatus_SetEventStatus_Event_Radar_AutoAlignment_Range_Alignment_or_Adjustement_Incorrect: RteEventRef=OpEventSetEventStatus_SetEventStatus_Event_Radar_AutoAlignment_Range_Alignment_or_Adjustement_Incorrect
        OpEventSetEventStatus_SetEventStatus_Event_EMS_ECU_CCVS1_erratic_communication_Erractic: RteEventRef=OpEventSetEventStatus_SetEventStatus_Event_EMS_ECU_CCVS1_erratic_communication_Erractic
        OpEventSetEventStatus_SetEventStatus_Event_Radar_System_Battery_Low_Voltage_System_Voltage_Low: RteEventRef=OpEventSetEventStatus_SetEventStatus_Event_Radar_System_Battery_Low_Voltage_System_Voltage_Low
        OpEventSetEventStatus_SetEventStatus_Event_Radar_SMC_General_Checksum_Failure: RteEventRef=OpEventSetEventStatus_SetEventStatus_Event_Radar_SMC_General_Checksum_Failure
        OpEventSetEventStatus_SetEventStatus_Event_Radar_Pin_Position_Wrong_Mounting_Position: RteEventRef=OpEventSetEventStatus_SetEventStatus_Event_Radar_Pin_Position_Wrong_Mounting_Position
        OpEventSetEventStatus_SetEventStatus_Event_VDC2_message_Lateral_Accleration_Invalid_Serial_Data_Received: RteEventRef=OpEventSetEventStatus_SetEventStatus_Event_VDC2_message_Lateral_Accleration_Invalid_Serial_Data_Received
        OpEventSetEventStatus_SetEventStatus_Event_ADAS_FN_STS_message_BSIS_FN_Switch_STS_Invalid_Serial_Data_Received: RteEventRef=OpEventSetEventStatus_SetEventStatus_Event_ADAS_FN_STS_message_BSIS_FN_Switch_STS_Invalid_Serial_Data_Received
        OpEventSetEventStatus_SetEventStatus_Event_Radar_AutoAlignment_Misalignment_Performance_or_Incorrect_Operation: RteEventRef=OpEventSetEventStatus_SetEventStatus_Event_Radar_AutoAlignment_Misalignment_Performance_or_Incorrect_Operation
        OpEventSetEventStatus_SetEventStatus_Event_ESC_ECU_VDC2_erratic_communication_Erratic: RteEventRef=OpEventSetEventStatus_SetEventStatus_Event_ESC_ECU_VDC2_erratic_communication_Erratic
        OpEventSetEventStatus_SetEventStatus_Event_Application_Interface_Lookup_Performance_or_Incorrect_Operation: RteEventRef=OpEventSetEventStatus_SetEventStatus_Event_Application_Interface_Lookup_Performance_or_Incorrect_Operation
        OpEventSetEventStatus_SetEventStatus_Event_EMS_ECU_VD_message_Missing_Message: RteEventRef=OpEventSetEventStatus_SetEventStatus_Event_EMS_ECU_VD_message_Missing_Message
        OpEventSetEventStatus_SetEventStatus_Event_Radar_Platform_Time_System_Programming_Failure: RteEventRef=OpEventSetEventStatus_SetEventStatus_Event_Radar_Platform_Time_System_Programming_Failure
        OpEventSetEventStatus_SetEventStatus_Event_OEL_message_Turn_Signal_Switch_Invalid_Serial_Data_Received: RteEventRef=OpEventSetEventStatus_SetEventStatus_Event_OEL_message_Turn_Signal_Switch_Invalid_Serial_Data_Received
        OpEventSetEventStatus_SetEventStatus_Event_Radar_calibration_Calibration_or_Paramater_Memory_Failure: RteEventRef=OpEventSetEventStatus_SetEventStatus_Event_Radar_calibration_Calibration_or_Paramater_Memory_Failure
        OpEventResetEventStatus_ResetEventStatus_Event_SAS_message_Steering_Wheel_Angle_Invalid_Serial_Data_Received: RteEventRef=OpEventResetEventStatus_ResetEventStatus_Event_SAS_message_Steering_Wheel_Angle_Invalid_Serial_Data_Received
        OpEventResetEventStatus_ResetEventStatus_Event_AT_AMT_ETC2_message_Transcurrent_gear_Invalid_Serial_Data_Received: RteEventRef=OpEventResetEventStatus_ResetEventStatus_Event_AT_AMT_ETC2_message_Transcurrent_gear_Invalid_Serial_Data_Received
        OpEventResetEventStatus_ResetEventStatus_Event_Radar_AutoAlignment_Algorithm_Signal_Calculation_Failure: RteEventRef=OpEventResetEventStatus_ResetEventStatus_Event_Radar_AutoAlignment_Algorithm_Signal_Calculation_Failure
        OpEventResetEventStatus_ResetEventStatus_Event_Vehicle_DataSet_Not_Configured: RteEventRef=OpEventResetEventStatus_ResetEventStatus_Event_Vehicle_DataSet_Not_Configured
        OpEventResetEventStatus_ResetEventStatus_Event_Radar_Module_System_Internal_Failure: RteEventRef=OpEventResetEventStatus_ResetEventStatus_Event_Radar_Module_System_Internal_Failure
        OpEventResetEventStatus_ResetEventStatus_Event_Radar_MMIC_Component_Failure: RteEventRef=OpEventResetEventStatus_ResetEventStatus_Event_Radar_MMIC_Component_Failure
        OpEventResetEventStatus_ResetEventStatus_Event_Radar_Module_General_Memory_Failure: RteEventRef=OpEventResetEventStatus_ResetEventStatus_Event_Radar_Module_General_Memory_Failure
        OpEventResetEventStatus_ResetEventStatus_Event_Radar_System_Battery_High_Voltage_System_Voltage_High: RteEventRef=OpEventResetEventStatus_ResetEventStatus_Event_Radar_System_Battery_High_Voltage_System_Voltage_High
        OpEventResetEventStatus_ResetEventStatus_Event_CCVS1_message_Vehicle_Speed_Invalid_Serial_Data_Received: RteEventRef=OpEventResetEventStatus_ResetEventStatus_Event_CCVS1_message_Vehicle_Speed_Invalid_Serial_Data_Received
        OpEventResetEventStatus_ResetEventStatus_Event_EMS_ECU_VD_erratic_communication_Erratic: RteEventRef=OpEventResetEventStatus_ResetEventStatus_Event_EMS_ECU_VD_erratic_communication_Erratic
        OpEventResetEventStatus_ResetEventStatus_Event_EMS_ECU_ETC2_00_message_Missing_Message: RteEventRef=OpEventResetEventStatus_ResetEventStatus_Event_EMS_ECU_ETC2_00_message_Missing_Message
        OpEventResetEventStatus_ResetEventStatus_Event_Cluster_ECU_CLS_Tx_16_message_Missing_Message: RteEventRef=OpEventResetEventStatus_ResetEventStatus_Event_Cluster_ECU_CLS_Tx_16_message_Missing_Message
        OpEventResetEventStatus_ResetEventStatus_Event_Exceeded_Security_Access_0x27_Attempt_Threshold_Authentication_Failure: RteEventRef=OpEventResetEventStatus_ResetEventStatus_Event_Exceeded_Security_Access_0x27_Attempt_Threshold_Authentication_Failure
        OpEventResetEventStatus_ResetEventStatus_Event_Front_Left_Side_Radar_value_of_signal_protection_calculation_Incorrect: RteEventRef=OpEventResetEventStatus_ResetEventStatus_Event_Front_Left_Side_Radar_value_of_signal_protection_calculation_Incorrect
        OpEventResetEventStatus_ResetEventStatus_Event_AT_AMT_ETC2_erratic_communication_Erratic: RteEventRef=OpEventResetEventStatus_ResetEventStatus_Event_AT_AMT_ETC2_erratic_communication_Erratic
        OpEventResetEventStatus_ResetEventStatus_Event_VCAN_Communication_Bus_Off: RteEventRef=OpEventResetEventStatus_ResetEventStatus_Event_VCAN_Communication_Bus_Off
        OpEventResetEventStatus_ResetEventStatus_Event_VDC2_message_LongitudinalAcceleration_Invalid_Serial_Data_Received: RteEventRef=OpEventResetEventStatus_ResetEventStatus_Event_VDC2_message_LongitudinalAcceleration_Invalid_Serial_Data_Received
        OpEventResetEventStatus_ResetEventStatus_Event_Radar_MMIC_RFBIST_Component_Internal_Failure: RteEventRef=OpEventResetEventStatus_ResetEventStatus_Event_Radar_MMIC_RFBIST_Component_Internal_Failure
        OpEventResetEventStatus_ResetEventStatus_Event_Radar_Initial_Alignment_Missing_Calibration: RteEventRef=OpEventResetEventStatus_ResetEventStatus_Event_Radar_Initial_Alignment_Missing_Calibration
        OpEventResetEventStatus_ResetEventStatus_Event_Cluster_ECU_OEL_message_Missing_Message: RteEventRef=OpEventResetEventStatus_ResetEventStatus_Event_Cluster_ECU_OEL_message_Missing_Message
        OpEventResetEventStatus_ResetEventStatus_Event_AT_AMT_ECU_ETC2_03_message_Missing_Message: RteEventRef=OpEventResetEventStatus_ResetEventStatus_Event_AT_AMT_ECU_ETC2_03_message_Missing_Message
        OpEventResetEventStatus_ResetEventStatus_Event_ADAS_FN_STS_message_MOIS_FN_Switch_STS_Invalid_Serial_Data_Received: RteEventRef=OpEventResetEventStatus_ResetEventStatus_Event_ADAS_FN_STS_message_MOIS_FN_Switch_STS_Invalid_Serial_Data_Received
        OpEventResetEventStatus_ResetEventStatus_Event_Radar_Module_Over_Temperature: RteEventRef=OpEventResetEventStatus_ResetEventStatus_Event_Radar_Module_Over_Temperature
        OpEventResetEventStatus_ResetEventStatus_Event_PCAN_TimeSync_Missing_Message: RteEventRef=OpEventResetEventStatus_ResetEventStatus_Event_PCAN_TimeSync_Missing_Message
        OpEventResetEventStatus_ResetEventStatus_Event_Radar_Module_Watchdog_Failure: RteEventRef=OpEventResetEventStatus_ResetEventStatus_Event_Radar_Module_Watchdog_Failure
        OpEventResetEventStatus_ResetEventStatus_Event_SAS_ECU_SAS_message_Missing_Message: RteEventRef=OpEventResetEventStatus_ResetEventStatus_Event_SAS_ECU_SAS_message_Missing_Message
        OpEventResetEventStatus_ResetEventStatus_Event_ECU_NVM_Corruption_Program_memory_Failure: RteEventRef=OpEventResetEventStatus_ResetEventStatus_Event_ECU_NVM_Corruption_Program_memory_Failure
        OpEventResetEventStatus_ResetEventStatus_Event_Cluster_ECU_TD_message_Missing_Message: RteEventRef=OpEventResetEventStatus_ResetEventStatus_Event_Cluster_ECU_TD_message_Missing_Message
        OpEventResetEventStatus_ResetEventStatus_Event_PCAN_Communication_Bus_Off: RteEventRef=OpEventResetEventStatus_ResetEventStatus_Event_PCAN_Communication_Bus_Off
        OpEventResetEventStatus_ResetEventStatus_Event_Front_Left_Side_Radar_Missing_Message: RteEventRef=OpEventResetEventStatus_ResetEventStatus_Event_Front_Left_Side_Radar_Missing_Message
        OpEventResetEventStatus_ResetEventStatus_Event_Manual_ETC2_message_Transcurrent_gear_Invalid_Serial_Data_Received: RteEventRef=OpEventResetEventStatus_ResetEventStatus_Event_Manual_ETC2_message_Transcurrent_gear_Invalid_Serial_Data_Received
        OpEventResetEventStatus_ResetEventStatus_Event_SAS_ECU_erratic_communication_Erratic: RteEventRef=OpEventResetEventStatus_ResetEventStatus_Event_SAS_ECU_erratic_communication_Erratic
        OpEventResetEventStatus_ResetEventStatus_Event_VDC2_message_Yaw_rate_Invalid_Serial_Data_Received: RteEventRef=OpEventResetEventStatus_ResetEventStatus_Event_VDC2_message_Yaw_rate_Invalid_Serial_Data_Received
        OpEventResetEventStatus_ResetEventStatus_Event_Cluster_ECU_TD_erratic_communication_Erratic: RteEventRef=OpEventResetEventStatus_ResetEventStatus_Event_Cluster_ECU_TD_erratic_communication_Erratic
        OpEventResetEventStatus_ResetEventStatus_Event_EMS_ECU_CCVS1_message_Missing_Message: RteEventRef=OpEventResetEventStatus_ResetEventStatus_Event_EMS_ECU_CCVS1_message_Missing_Message
        OpEventResetEventStatus_ResetEventStatus_Event_Radar_Mounting_Orientation_Incorrect_Assembly: RteEventRef=OpEventResetEventStatus_ResetEventStatus_Event_Radar_Mounting_Orientation_Incorrect_Assembly
        OpEventResetEventStatus_ResetEventStatus_Event_EMS_ECU_ETC2_erratic_communication_Erractic: RteEventRef=OpEventResetEventStatus_ResetEventStatus_Event_EMS_ECU_ETC2_erratic_communication_Erractic
        OpEventResetEventStatus_ResetEventStatus_Event_Cluster_ECU_ADAS_FN_STS_erratic_communication_Erratic: RteEventRef=OpEventResetEventStatus_ResetEventStatus_Event_Cluster_ECU_ADAS_FN_STS_erratic_communication_Erratic
        OpEventResetEventStatus_ResetEventStatus_Event_ESC_ECU_VDC2_message_Missing_Message: RteEventRef=OpEventResetEventStatus_ResetEventStatus_Event_ESC_ECU_VDC2_message_Missing_Message
        OpEventResetEventStatus_ResetEventStatus_Event_CLS_TX_16_message_Transmission_Type_info_Invalid_Serial_Data_Received: RteEventRef=OpEventResetEventStatus_ResetEventStatus_Event_CLS_TX_16_message_Transmission_Type_info_Invalid_Serial_Data_Received
        OpEventResetEventStatus_ResetEventStatus_Event_Cluster_ECU_CLS_Tx_4_erratic_communication_Erratic: RteEventRef=OpEventResetEventStatus_ResetEventStatus_Event_Cluster_ECU_CLS_Tx_4_erratic_communication_Erratic
        OpEventResetEventStatus_ResetEventStatus_Event_Cluster_ECU_ADAS_FN_STS_message_Missing_Message: RteEventRef=OpEventResetEventStatus_ResetEventStatus_Event_Cluster_ECU_ADAS_FN_STS_message_Missing_Message
        OpEventResetEventStatus_ResetEventStatus_Event_Vehicle_Dataset_value_of_signal_protection_calculation_Incorrect: RteEventRef=OpEventResetEventStatus_ResetEventStatus_Event_Vehicle_Dataset_value_of_signal_protection_calculation_Incorrect
        OpEventResetEventStatus_ResetEventStatus_Event_Cluster_ECU_CLS_Tx_16_erratic_communication_Erratic: RteEventRef=OpEventResetEventStatus_ResetEventStatus_Event_Cluster_ECU_CLS_Tx_16_erratic_communication_Erratic
        OpEventResetEventStatus_ResetEventStatus_Event_Cluster_ECU_OEL_erratic_communication_Erratic: RteEventRef=OpEventResetEventStatus_ResetEventStatus_Event_Cluster_ECU_OEL_erratic_communication_Erratic
        OpEventResetEventStatus_ResetEventStatus_Event_Cluster_ECU_CLS_Tx_4_message_Missing_Message: RteEventRef=OpEventResetEventStatus_ResetEventStatus_Event_Cluster_ECU_CLS_Tx_4_message_Missing_Message
        OpEventResetEventStatus_ResetEventStatus_Event_Radar_Performance_Capability_Algorithm_Based_Failure: RteEventRef=OpEventResetEventStatus_ResetEventStatus_Event_Radar_Performance_Capability_Algorithm_Based_Failure
        OpEventResetEventStatus_ResetEventStatus_Event_Radar_AutoAlignment_Range_Alignment_or_Adjustement_Incorrect: RteEventRef=OpEventResetEventStatus_ResetEventStatus_Event_Radar_AutoAlignment_Range_Alignment_or_Adjustement_Incorrect
        OpEventResetEventStatus_ResetEventStatus_Event_EMS_ECU_CCVS1_erratic_communication_Erractic: RteEventRef=OpEventResetEventStatus_ResetEventStatus_Event_EMS_ECU_CCVS1_erratic_communication_Erractic
        OpEventResetEventStatus_ResetEventStatus_Event_Radar_System_Battery_Low_Voltage_System_Voltage_Low: RteEventRef=OpEventResetEventStatus_ResetEventStatus_Event_Radar_System_Battery_Low_Voltage_System_Voltage_Low
        OpEventResetEventStatus_ResetEventStatus_Event_Radar_SMC_General_Checksum_Failure: RteEventRef=OpEventResetEventStatus_ResetEventStatus_Event_Radar_SMC_General_Checksum_Failure
        OpEventResetEventStatus_ResetEventStatus_Event_Radar_Pin_Position_Wrong_Mounting_Position: RteEventRef=OpEventResetEventStatus_ResetEventStatus_Event_Radar_Pin_Position_Wrong_Mounting_Position
        OpEventResetEventStatus_ResetEventStatus_Event_VDC2_message_Lateral_Accleration_Invalid_Serial_Data_Received: RteEventRef=OpEventResetEventStatus_ResetEventStatus_Event_VDC2_message_Lateral_Accleration_Invalid_Serial_Data_Received
        OpEventResetEventStatus_ResetEventStatus_Event_ADAS_FN_STS_message_BSIS_FN_Switch_STS_Invalid_Serial_Data_Received: RteEventRef=OpEventResetEventStatus_ResetEventStatus_Event_ADAS_FN_STS_message_BSIS_FN_Switch_STS_Invalid_Serial_Data_Received
        OpEventResetEventStatus_ResetEventStatus_Event_Radar_AutoAlignment_Misalignment_Performance_or_Incorrect_Operation: RteEventRef=OpEventResetEventStatus_ResetEventStatus_Event_Radar_AutoAlignment_Misalignment_Performance_or_Incorrect_Operation
        OpEventResetEventStatus_ResetEventStatus_Event_ESC_ECU_VDC2_erratic_communication_Erratic: RteEventRef=OpEventResetEventStatus_ResetEventStatus_Event_ESC_ECU_VDC2_erratic_communication_Erratic
        OpEventResetEventStatus_ResetEventStatus_Event_Application_Interface_Lookup_Performance_or_Incorrect_Operation: RteEventRef=OpEventResetEventStatus_ResetEventStatus_Event_Application_Interface_Lookup_Performance_or_Incorrect_Operation
        OpEventResetEventStatus_ResetEventStatus_Event_EMS_ECU_VD_message_Missing_Message: RteEventRef=OpEventResetEventStatus_ResetEventStatus_Event_EMS_ECU_VD_message_Missing_Message
        OpEventResetEventStatus_ResetEventStatus_Event_Radar_Platform_Time_System_Programming_Failure: RteEventRef=OpEventResetEventStatus_ResetEventStatus_Event_Radar_Platform_Time_System_Programming_Failure
        OpEventResetEventStatus_ResetEventStatus_Event_OEL_message_Turn_Signal_Switch_Invalid_Serial_Data_Received: RteEventRef=OpEventResetEventStatus_ResetEventStatus_Event_OEL_message_Turn_Signal_Switch_Invalid_Serial_Data_Received
        OpEventResetEventStatus_ResetEventStatus_Event_Radar_calibration_Calibration_or_Paramater_Memory_Failure: RteEventRef=OpEventResetEventStatus_ResetEventStatus_Event_Radar_calibration_Calibration_or_Paramater_Memory_Failure
        OpEventResetEventDebounceStatus_ResetEventDebounceStatus_Event_SAS_message_Steering_Wheel_Angle_Invalid_Serial_Data_Received: RteEventRef=OpEventResetEventDebounceStatus_ResetEventDebounceStatus_Event_SAS_message_Steering_Wheel_Angle_Invalid_Serial_Data_Received
        OpEventResetEventDebounceStatus_ResetEventDebounceStatus_Event_AT_AMT_ETC2_message_Transcurrent_gear_Invalid_Serial_Dat_3b6a62f4: RteEventRef=OpEventResetEventDebounceStatus_ResetEventDebounceStatus_Event_AT_AMT_ETC2_message_Transcurrent_gear_Invalid_Serial_Dat_3b6a62f4
        OpEventResetEventDebounceStatus_ResetEventDebounceStatus_Event_Radar_AutoAlignment_Algorithm_Signal_Calculation_Failure: RteEventRef=OpEventResetEventDebounceStatus_ResetEventDebounceStatus_Event_Radar_AutoAlignment_Algorithm_Signal_Calculation_Failure
        OpEventResetEventDebounceStatus_ResetEventDebounceStatus_Event_Vehicle_DataSet_Not_Configured: RteEventRef=OpEventResetEventDebounceStatus_ResetEventDebounceStatus_Event_Vehicle_DataSet_Not_Configured
        OpEventResetEventDebounceStatus_ResetEventDebounceStatus_Event_Radar_Module_System_Internal_Failure: RteEventRef=OpEventResetEventDebounceStatus_ResetEventDebounceStatus_Event_Radar_Module_System_Internal_Failure
        OpEventResetEventDebounceStatus_ResetEventDebounceStatus_Event_Radar_MMIC_Component_Failure: RteEventRef=OpEventResetEventDebounceStatus_ResetEventDebounceStatus_Event_Radar_MMIC_Component_Failure
        OpEventResetEventDebounceStatus_ResetEventDebounceStatus_Event_Radar_Module_General_Memory_Failure: RteEventRef=OpEventResetEventDebounceStatus_ResetEventDebounceStatus_Event_Radar_Module_General_Memory_Failure
        OpEventResetEventDebounceStatus_ResetEventDebounceStatus_Event_Radar_System_Battery_High_Voltage_System_Voltage_High: RteEventRef=OpEventResetEventDebounceStatus_ResetEventDebounceStatus_Event_Radar_System_Battery_High_Voltage_System_Voltage_High
        OpEventResetEventDebounceStatus_ResetEventDebounceStatus_Event_CCVS1_message_Vehicle_Speed_Invalid_Serial_Data_Received: RteEventRef=OpEventResetEventDebounceStatus_ResetEventDebounceStatus_Event_CCVS1_message_Vehicle_Speed_Invalid_Serial_Data_Received
        OpEventResetEventDebounceStatus_ResetEventDebounceStatus_Event_EMS_ECU_VD_erratic_communication_Erratic: RteEventRef=OpEventResetEventDebounceStatus_ResetEventDebounceStatus_Event_EMS_ECU_VD_erratic_communication_Erratic
        OpEventResetEventDebounceStatus_ResetEventDebounceStatus_Event_EMS_ECU_ETC2_00_message_Missing_Message: RteEventRef=OpEventResetEventDebounceStatus_ResetEventDebounceStatus_Event_EMS_ECU_ETC2_00_message_Missing_Message
        OpEventResetEventDebounceStatus_ResetEventDebounceStatus_Event_Cluster_ECU_CLS_Tx_16_message_Missing_Message: RteEventRef=OpEventResetEventDebounceStatus_ResetEventDebounceStatus_Event_Cluster_ECU_CLS_Tx_16_message_Missing_Message
        OpEventResetEventDebounceStatus_ResetEventDebounceStatus_Event_Exceeded_Security_Access_0x27_Attempt_Threshold_Authenti_4010bb14: RteEventRef=OpEventResetEventDebounceStatus_ResetEventDebounceStatus_Event_Exceeded_Security_Access_0x27_Attempt_Threshold_Authenti_4010bb14
        OpEventResetEventDebounceStatus_ResetEventDebounceStatus_Event_Front_Left_Side_Radar_value_of_signal_protection_calcula_0a896f5c: RteEventRef=OpEventResetEventDebounceStatus_ResetEventDebounceStatus_Event_Front_Left_Side_Radar_value_of_signal_protection_calcula_0a896f5c
        OpEventResetEventDebounceStatus_ResetEventDebounceStatus_Event_AT_AMT_ETC2_erratic_communication_Erratic: RteEventRef=OpEventResetEventDebounceStatus_ResetEventDebounceStatus_Event_AT_AMT_ETC2_erratic_communication_Erratic
        OpEventResetEventDebounceStatus_ResetEventDebounceStatus_Event_VCAN_Communication_Bus_Off: RteEventRef=OpEventResetEventDebounceStatus_ResetEventDebounceStatus_Event_VCAN_Communication_Bus_Off
        OpEventResetEventDebounceStatus_ResetEventDebounceStatus_Event_VDC2_message_LongitudinalAcceleration_Invalid_Serial_Dat_bb86385b: RteEventRef=OpEventResetEventDebounceStatus_ResetEventDebounceStatus_Event_VDC2_message_LongitudinalAcceleration_Invalid_Serial_Dat_bb86385b
        OpEventResetEventDebounceStatus_ResetEventDebounceStatus_Event_Radar_MMIC_RFBIST_Component_Internal_Failure: RteEventRef=OpEventResetEventDebounceStatus_ResetEventDebounceStatus_Event_Radar_MMIC_RFBIST_Component_Internal_Failure
        OpEventResetEventDebounceStatus_ResetEventDebounceStatus_Event_Radar_Initial_Alignment_Missing_Calibration: RteEventRef=OpEventResetEventDebounceStatus_ResetEventDebounceStatus_Event_Radar_Initial_Alignment_Missing_Calibration
        OpEventResetEventDebounceStatus_ResetEventDebounceStatus_Event_Cluster_ECU_OEL_message_Missing_Message: RteEventRef=OpEventResetEventDebounceStatus_ResetEventDebounceStatus_Event_Cluster_ECU_OEL_message_Missing_Message
        OpEventResetEventDebounceStatus_ResetEventDebounceStatus_Event_AT_AMT_ECU_ETC2_03_message_Missing_Message: RteEventRef=OpEventResetEventDebounceStatus_ResetEventDebounceStatus_Event_AT_AMT_ECU_ETC2_03_message_Missing_Message
        OpEventResetEventDebounceStatus_ResetEventDebounceStatus_Event_ADAS_FN_STS_message_MOIS_FN_Switch_STS_Invalid_Serial_Da_899b3188: RteEventRef=OpEventResetEventDebounceStatus_ResetEventDebounceStatus_Event_ADAS_FN_STS_message_MOIS_FN_Switch_STS_Invalid_Serial_Da_899b3188
        OpEventResetEventDebounceStatus_ResetEventDebounceStatus_Event_Radar_Module_Over_Temperature: RteEventRef=OpEventResetEventDebounceStatus_ResetEventDebounceStatus_Event_Radar_Module_Over_Temperature
        OpEventResetEventDebounceStatus_ResetEventDebounceStatus_Event_PCAN_TimeSync_Missing_Message: RteEventRef=OpEventResetEventDebounceStatus_ResetEventDebounceStatus_Event_PCAN_TimeSync_Missing_Message
        OpEventResetEventDebounceStatus_ResetEventDebounceStatus_Event_Radar_Module_Watchdog_Failure: RteEventRef=OpEventResetEventDebounceStatus_ResetEventDebounceStatus_Event_Radar_Module_Watchdog_Failure
        OpEventResetEventDebounceStatus_ResetEventDebounceStatus_Event_SAS_ECU_SAS_message_Missing_Message: RteEventRef=OpEventResetEventDebounceStatus_ResetEventDebounceStatus_Event_SAS_ECU_SAS_message_Missing_Message
        OpEventResetEventDebounceStatus_ResetEventDebounceStatus_Event_ECU_NVM_Corruption_Program_memory_Failure: RteEventRef=OpEventResetEventDebounceStatus_ResetEventDebounceStatus_Event_ECU_NVM_Corruption_Program_memory_Failure
        OpEventResetEventDebounceStatus_ResetEventDebounceStatus_Event_Cluster_ECU_TD_message_Missing_Message: RteEventRef=OpEventResetEventDebounceStatus_ResetEventDebounceStatus_Event_Cluster_ECU_TD_message_Missing_Message
        OpEventResetEventDebounceStatus_ResetEventDebounceStatus_Event_PCAN_Communication_Bus_Off: RteEventRef=OpEventResetEventDebounceStatus_ResetEventDebounceStatus_Event_PCAN_Communication_Bus_Off
        OpEventResetEventDebounceStatus_ResetEventDebounceStatus_Event_Front_Left_Side_Radar_Missing_Message: RteEventRef=OpEventResetEventDebounceStatus_ResetEventDebounceStatus_Event_Front_Left_Side_Radar_Missing_Message
        OpEventResetEventDebounceStatus_ResetEventDebounceStatus_Event_Manual_ETC2_message_Transcurrent_gear_Invalid_Serial_Dat_27fe104f: RteEventRef=OpEventResetEventDebounceStatus_ResetEventDebounceStatus_Event_Manual_ETC2_message_Transcurrent_gear_Invalid_Serial_Dat_27fe104f
        OpEventResetEventDebounceStatus_ResetEventDebounceStatus_Event_SAS_ECU_erratic_communication_Erratic: RteEventRef=OpEventResetEventDebounceStatus_ResetEventDebounceStatus_Event_SAS_ECU_erratic_communication_Erratic
        OpEventResetEventDebounceStatus_ResetEventDebounceStatus_Event_VDC2_message_Yaw_rate_Invalid_Serial_Data_Received: RteEventRef=OpEventResetEventDebounceStatus_ResetEventDebounceStatus_Event_VDC2_message_Yaw_rate_Invalid_Serial_Data_Received
        OpEventResetEventDebounceStatus_ResetEventDebounceStatus_Event_Cluster_ECU_TD_erratic_communication_Erratic: RteEventRef=OpEventResetEventDebounceStatus_ResetEventDebounceStatus_Event_Cluster_ECU_TD_erratic_communication_Erratic
        OpEventResetEventDebounceStatus_ResetEventDebounceStatus_Event_EMS_ECU_CCVS1_message_Missing_Message: RteEventRef=OpEventResetEventDebounceStatus_ResetEventDebounceStatus_Event_EMS_ECU_CCVS1_message_Missing_Message
        OpEventResetEventDebounceStatus_ResetEventDebounceStatus_Event_Radar_Mounting_Orientation_Incorrect_Assembly: RteEventRef=OpEventResetEventDebounceStatus_ResetEventDebounceStatus_Event_Radar_Mounting_Orientation_Incorrect_Assembly
        OpEventResetEventDebounceStatus_ResetEventDebounceStatus_Event_EMS_ECU_ETC2_erratic_communication_Erractic: RteEventRef=OpEventResetEventDebounceStatus_ResetEventDebounceStatus_Event_EMS_ECU_ETC2_erratic_communication_Erractic
        OpEventResetEventDebounceStatus_ResetEventDebounceStatus_Event_Cluster_ECU_ADAS_FN_STS_erratic_communication_Erratic: RteEventRef=OpEventResetEventDebounceStatus_ResetEventDebounceStatus_Event_Cluster_ECU_ADAS_FN_STS_erratic_communication_Erratic
        OpEventResetEventDebounceStatus_ResetEventDebounceStatus_Event_ESC_ECU_VDC2_message_Missing_Message: RteEventRef=OpEventResetEventDebounceStatus_ResetEventDebounceStatus_Event_ESC_ECU_VDC2_message_Missing_Message
        OpEventResetEventDebounceStatus_ResetEventDebounceStatus_Event_CLS_TX_16_message_Transmission_Type_info_Invalid_Serial_b9736b5a: RteEventRef=OpEventResetEventDebounceStatus_ResetEventDebounceStatus_Event_CLS_TX_16_message_Transmission_Type_info_Invalid_Serial_b9736b5a
        OpEventResetEventDebounceStatus_ResetEventDebounceStatus_Event_Cluster_ECU_CLS_Tx_4_erratic_communication_Erratic: RteEventRef=OpEventResetEventDebounceStatus_ResetEventDebounceStatus_Event_Cluster_ECU_CLS_Tx_4_erratic_communication_Erratic
        OpEventResetEventDebounceStatus_ResetEventDebounceStatus_Event_Cluster_ECU_ADAS_FN_STS_message_Missing_Message: RteEventRef=OpEventResetEventDebounceStatus_ResetEventDebounceStatus_Event_Cluster_ECU_ADAS_FN_STS_message_Missing_Message
        OpEventResetEventDebounceStatus_ResetEventDebounceStatus_Event_Vehicle_Dataset_value_of_signal_protection_calculation_Incorrect: RteEventRef=OpEventResetEventDebounceStatus_ResetEventDebounceStatus_Event_Vehicle_Dataset_value_of_signal_protection_calculation_Incorrect
        OpEventResetEventDebounceStatus_ResetEventDebounceStatus_Event_Cluster_ECU_CLS_Tx_16_erratic_communication_Erratic: RteEventRef=OpEventResetEventDebounceStatus_ResetEventDebounceStatus_Event_Cluster_ECU_CLS_Tx_16_erratic_communication_Erratic
        OpEventResetEventDebounceStatus_ResetEventDebounceStatus_Event_Cluster_ECU_OEL_erratic_communication_Erratic: RteEventRef=OpEventResetEventDebounceStatus_ResetEventDebounceStatus_Event_Cluster_ECU_OEL_erratic_communication_Erratic
        OpEventResetEventDebounceStatus_ResetEventDebounceStatus_Event_Cluster_ECU_CLS_Tx_4_message_Missing_Message: RteEventRef=OpEventResetEventDebounceStatus_ResetEventDebounceStatus_Event_Cluster_ECU_CLS_Tx_4_message_Missing_Message
        OpEventResetEventDebounceStatus_ResetEventDebounceStatus_Event_Radar_Performance_Capability_Algorithm_Based_Failure: RteEventRef=OpEventResetEventDebounceStatus_ResetEventDebounceStatus_Event_Radar_Performance_Capability_Algorithm_Based_Failure
        OpEventResetEventDebounceStatus_ResetEventDebounceStatus_Event_Radar_AutoAlignment_Range_Alignment_or_Adjustement_Incorrect: RteEventRef=OpEventResetEventDebounceStatus_ResetEventDebounceStatus_Event_Radar_AutoAlignment_Range_Alignment_or_Adjustement_Incorrect
        OpEventResetEventDebounceStatus_ResetEventDebounceStatus_Event_EMS_ECU_CCVS1_erratic_communication_Erractic: RteEventRef=OpEventResetEventDebounceStatus_ResetEventDebounceStatus_Event_EMS_ECU_CCVS1_erratic_communication_Erractic
        OpEventResetEventDebounceStatus_ResetEventDebounceStatus_Event_Radar_System_Battery_Low_Voltage_System_Voltage_Low: RteEventRef=OpEventResetEventDebounceStatus_ResetEventDebounceStatus_Event_Radar_System_Battery_Low_Voltage_System_Voltage_Low
        OpEventResetEventDebounceStatus_ResetEventDebounceStatus_Event_Radar_SMC_General_Checksum_Failure: RteEventRef=OpEventResetEventDebounceStatus_ResetEventDebounceStatus_Event_Radar_SMC_General_Checksum_Failure
        OpEventResetEventDebounceStatus_ResetEventDebounceStatus_Event_Radar_Pin_Position_Wrong_Mounting_Position: RteEventRef=OpEventResetEventDebounceStatus_ResetEventDebounceStatus_Event_Radar_Pin_Position_Wrong_Mounting_Position
        OpEventResetEventDebounceStatus_ResetEventDebounceStatus_Event_VDC2_message_Lateral_Accleration_Invalid_Serial_Data_Received: RteEventRef=OpEventResetEventDebounceStatus_ResetEventDebounceStatus_Event_VDC2_message_Lateral_Accleration_Invalid_Serial_Data_Received
        OpEventResetEventDebounceStatus_ResetEventDebounceStatus_Event_ADAS_FN_STS_message_BSIS_FN_Switch_STS_Invalid_Serial_Da_4c0b487b: RteEventRef=OpEventResetEventDebounceStatus_ResetEventDebounceStatus_Event_ADAS_FN_STS_message_BSIS_FN_Switch_STS_Invalid_Serial_Da_4c0b487b
        OpEventResetEventDebounceStatus_ResetEventDebounceStatus_Event_Radar_AutoAlignment_Misalignment_Performance_or_Incorrec_1a52e0d2: RteEventRef=OpEventResetEventDebounceStatus_ResetEventDebounceStatus_Event_Radar_AutoAlignment_Misalignment_Performance_or_Incorrec_1a52e0d2
        OpEventResetEventDebounceStatus_ResetEventDebounceStatus_Event_ESC_ECU_VDC2_erratic_communication_Erratic: RteEventRef=OpEventResetEventDebounceStatus_ResetEventDebounceStatus_Event_ESC_ECU_VDC2_erratic_communication_Erratic
        OpEventResetEventDebounceStatus_ResetEventDebounceStatus_Event_Application_Interface_Lookup_Performance_or_Incorrect_Operation: RteEventRef=OpEventResetEventDebounceStatus_ResetEventDebounceStatus_Event_Application_Interface_Lookup_Performance_or_Incorrect_Operation
        OpEventResetEventDebounceStatus_ResetEventDebounceStatus_Event_EMS_ECU_VD_message_Missing_Message: RteEventRef=OpEventResetEventDebounceStatus_ResetEventDebounceStatus_Event_EMS_ECU_VD_message_Missing_Message
        OpEventResetEventDebounceStatus_ResetEventDebounceStatus_Event_Radar_Platform_Time_System_Programming_Failure: RteEventRef=OpEventResetEventDebounceStatus_ResetEventDebounceStatus_Event_Radar_Platform_Time_System_Programming_Failure
        OpEventResetEventDebounceStatus_ResetEventDebounceStatus_Event_OEL_message_Turn_Signal_Switch_Invalid_Serial_Data_Received: RteEventRef=OpEventResetEventDebounceStatus_ResetEventDebounceStatus_Event_OEL_message_Turn_Signal_Switch_Invalid_Serial_Data_Received
        OpEventResetEventDebounceStatus_ResetEventDebounceStatus_Event_Radar_calibration_Calibration_or_Paramater_Memory_Failure: RteEventRef=OpEventResetEventDebounceStatus_ResetEventDebounceStatus_Event_Radar_calibration_Calibration_or_Paramater_Memory_Failure
        OpEventGetEventFailed_GetEventFailed_EvtInfo_DemEventParameter: RteEventRef=OpEventGetEventFailed_GetEventFailed_EvtInfo_DemEventParameter
        OpEventGetEventExtendedDataRecordEx_GetEventExtendedDataRecordEx_Event_DemEventParameter: RteEventRef=OpEventGetEventExtendedDataRecordEx_GetEventExtendedDataRecordEx_Event_DemEventParameter
        OpEventGetDTCOfEvent_GetDTCOfEvent_Event_DemEventParameter: RteEventRef=OpEventGetDTCOfEvent_GetDTCOfEvent_Event_DemEventParameter
        OpEventGetEventEnableCondition_GetEventEnableCondition_EvtInfo_DemEventParameter: RteEventRef=OpEventGetEventEnableCondition_GetEventEnableCondition_EvtInfo_DemEventParameter
        OpEventResetEventStatus_ResetEventStatus_Event_DemEventParameter: RteEventRef=OpEventResetEventStatus_ResetEventStatus_Event_DemEventParameter
        OpEventGetFaultDetectionCounter_GetFaultDetectionCounter_EvtInfo_DemEventParameter: RteEventRef=OpEventGetFaultDetectionCounter_GetFaultDetectionCounter_EvtInfo_DemEventParameter
        OpEventGetMonitorStatus_GetMonitorStatus_EvtInfo_DemEventParameter: RteEventRef=OpEventGetMonitorStatus_GetMonitorStatus_EvtInfo_DemEventParameter
        OpEventGetEventTested_GetEventTested_Event_DemEventParameter: RteEventRef=OpEventGetEventTested_GetEventTested_Event_DemEventParameter
        OpEventGetEventStatus_GetEventStatus_EvtInfo_DemEventParameter: RteEventRef=OpEventGetEventStatus_GetEventStatus_EvtInfo_DemEventParameter
        OpEventGetEventStatus_GetEventStatus_Event_DemEventParameter: RteEventRef=OpEventGetEventStatus_GetEventStatus_Event_DemEventParameter
        OpEventGetEventExtendedDataRecordEx_GetEventExtendedDataRecordEx_EvtInfo_DemEventParameter: RteEventRef=OpEventGetEventExtendedDataRecordEx_GetEventExtendedDataRecordEx_EvtInfo_DemEventParameter
        OpEventResetEventDebounceStatus_ResetEventDebounceStatus_Event_DemEventParameter: RteEventRef=OpEventResetEventDebounceStatus_ResetEventDebounceStatus_Event_DemEventParameter
        OpEventGetDTCOfEvent_GetDTCOfEvent_EvtInfo_DemEventParameter: RteEventRef=OpEventGetDTCOfEvent_GetDTCOfEvent_EvtInfo_DemEventParameter
        OpEventGetEventUdsStatus_GetEventUdsStatus_EvtInfo_DemEventParameter: RteEventRef=OpEventGetEventUdsStatus_GetEventUdsStatus_EvtInfo_DemEventParameter
        OpEventGetEventFreezeFrameDataEx_GetEventFreezeFrameDataEx_Event_DemEventParameter: RteEventRef=OpEventGetEventFreezeFrameDataEx_GetEventFreezeFrameDataEx_Event_DemEventParameter
        OpEventGetEventUdsStatus_GetEventUdsStatus_Event_DemEventParameter: RteEventRef=OpEventGetEventUdsStatus_GetEventUdsStatus_Event_DemEventParameter
        OpEventSetEventStatus_SetEventStatus_Event_DemEventParameter: RteEventRef=OpEventSetEventStatus_SetEventStatus_Event_DemEventParameter
        OpEventGetEventFailed_GetEventFailed_Event_DemEventParameter: RteEventRef=OpEventGetEventFailed_GetEventFailed_Event_DemEventParameter
        OpEventGetDebouncingOfEvent_GetDebouncingOfEvent_EvtInfo_DemEventParameter: RteEventRef=OpEventGetDebouncingOfEvent_GetDebouncingOfEvent_EvtInfo_DemEventParameter
        OpEventGetEventTested_GetEventTested_EvtInfo_DemEventParameter: RteEventRef=OpEventGetEventTested_GetEventTested_EvtInfo_DemEventParameter
        OpEventGetFaultDetectionCounter_GetFaultDetectionCounter_Event_DemEventParameter: RteEventRef=OpEventGetFaultDetectionCounter_GetFaultDetectionCounter_Event_DemEventParameter
        OpEventGetEventFreezeFrameDataEx_GetEventFreezeFrameDataEx_EvtInfo_DemEventParameter: RteEventRef=OpEventGetEventFreezeFrameDataEx_GetEventFreezeFrameDataEx_EvtInfo_DemEventParameter
    J1939Dcm (RteBswModuleInstance): RteBswImplementationRef=J1939Dcm_Impl, RteBswModuleConfigurationRef=J1939Dcm
      J1939Dcm_MainFunctionTimingEvent0 (RteBswEventToTaskMapping): RteBswImmediateRestart=false, RteBswEventRef=J1939Dcm_MainFunctionTimingEvent0
      J1939DCM_EXCLUSIVE_AREA_0 (RteBswExclusiveAreaImpl): RteExclusiveAreaImplMechanism=ALL_INTERRUPT_BLOCKING, RteBswExclusiveAreaRef=J1939DCM_EXCLUSIVE_AREA_0
    SWC_PRJ_Appl_SensorPosition_EcuSwComposition (RteSwComponentInstance): RteSoftwareComponentInstanceRef=SWC_PRJ_Appl_SensorPosition
      TMT_RE_SensorPosition_50ms (RteEventToTaskMapping):
        RteImmediateRestart = false
        RtePositionInTask = 6
        RteEventRef = TMT_RE_SensorPosition_50ms
        RteMappedToTaskRef = Appl_Task
        RteUsedOsEventRef = Rte_Ev_Cyclic_Appl_Task_0_50ms
        RteUsedOsAlarmRef = Rte_Al_TE_Appl_Task_0_50ms
      OIT_CS_Get_Pinposition_Status_Operation_CS_Get_Pinposition_Status_Operation (RteEventToTaskMapping): RteImmediateRestart=false, RteEventRef=OIT_CS_Get_Pinposition_Status_Operation_CS_Get_Pinposition_Status_Operation
    SWC_PRJ_Appl_SensorPosition (RteSwComponentType): RteComponentTypeRef=SWC_PRJ_Appl_SensorPosition, RteImplementationRef=SWC_PRJ_Appl_SensorPosition_Implementation
      ComponentTypeCalibration (RteComponentTypeCalibration): RteCalibrationSupportEnabled=false
    E2EXf (RteBswModuleInstance): RteBswImplementationRef=E2EXf_Impl, RteBswModuleConfigurationRef=E2EXf
    SWC_PRJ_Appl_Security_Manager_EcuSwComposition (RteSwComponentInstance): RteSoftwareComponentInstanceRef=SWC_PRJ_Appl_Security_Manager
      4 x RteEventToTaskMapping, all with RteImmediateRestart=false:
        OIT_CS_HSE_Security_Compare_key_Operation_CS_HSE_Security_Compare_key_Operation: RteEventRef=OIT_CS_HSE_Security_Compare_key_Operation_CS_HSE_Security_Compare_key_Operation
        OIT_CS_HSE_Security_generate_seed_Operation_CS_HSE_Security_generate_seed_Operation: RteEventRef=OIT_CS_HSE_Security_generate_seed_Operation_CS_HSE_Security_generate_seed_Operation
        TMT_RE_Security_Manager_50ms: RtePositionInTask=52, RteEventRef=TMT_RE_Security_Manager_50ms, RteMappedToTaskRef=Appl_Task, RteUsedOsEventRef=Rte_Ev_Cyclic_Appl_Task_0_50ms, RteUsedOsAlarmRef=Rte_Al_TE_Appl_Task_0_50ms
        RE_Security_Manager_InitEvent: RtePositionInTask=24, RteEventRef=RE_Security_Manager_InitEvent, RteMappedToTaskRef=Appl_Init
    SWC_PRJ_Appl_Security_Manager (RteSwComponentType): RteComponentTypeRef=SWC_PRJ_Appl_Security_Manager, RteImplementationRef=SWC_PRJ_Appl_Security_Manager_Implementation
      ComponentTypeCalibration (RteComponentTypeCalibration): RteCalibrationSupportEnabled=false
    3 x RteBswModuleInstance:
      I2c: RteBswImplementationRef=I2c_Impl, RteBswModuleConfigurationRef=I2c
        I2C_EXCLUSIVE_AREA_0 (RteBswExclusiveAreaImpl): RteExclusiveAreaImplMechanism=ALL_INTERRUPT_BLOCKING, RteBswExclusiveAreaRef=I2C_EXCLUSIVE_AREA_0
      EthTrcv_001: RteBswImplementationRef=EthTrcv_Impl, RteBswModuleConfigurationRef=EthTrcv_NXP
        EthTrcv_30_Tja1103_MainFunctionTimingEvent0 (RteBswEventToTaskMapping): RteBswImmediateRestart=false, RteBswEventRef=EthTrcv_30_Tja1103_MainFunctionTimingEvent0
        10 x RteBswExclusiveAreaImpl, all with RteExclusiveAreaImplMechanism=ALL_INTERRUPT_BLOCKING:
          ETHTRCV_30_TJA1103_EXCLUSIVE_AREA_MODE: RteBswExclusiveAreaRef=ETHTRCV_30_TJA1103_EXCLUSIVE_AREA_MODE
          ETHTRCV_30_TJA1103_EXCLUSIVE_AREA_DIAGNOSTICS: RteBswExclusiveAreaRef=ETHTRCV_30_TJA1103_EXCLUSIVE_AREA_DIAGNOSTICS
          ETHTRCV_30_TJA1103_EXCLUSIVE_AREA_AUTONEG: RteBswExclusiveAreaRef=ETHTRCV_30_TJA1103_EXCLUSIVE_AREA_AUTONEG
          ETHTRCV_30_TJA1103_EXCLUSIVE_AREA_MACSEC64: RteBswExclusiveAreaRef=ETHTRCV_30_TJA1103_EXCLUSIVE_AREA_MACSEC64
          ETHTRCV_30_TJA1103_EXCLUSIVE_AREA_CL45: RteBswExclusiveAreaRef=ETHTRCV_30_TJA1103_EXCLUSIVE_AREA_CL45
          ETHTRCV_30_TJA1103_EXCLUSIVE_AREA_MACSEC32: RteBswExclusiveAreaRef=ETHTRCV_30_TJA1103_EXCLUSIVE_AREA_MACSEC32
          ETHTRCV_30_TJA1103_EXCLUSIVE_AREA_HWINIT: RteBswExclusiveAreaRef=ETHTRCV_30_TJA1103_EXCLUSIVE_AREA_HWINIT
          ETHTRCV_30_TJA1103_EXCLUSIVE_AREA_LINK: RteBswExclusiveAreaRef=ETHTRCV_30_TJA1103_EXCLUSIVE_AREA_LINK
          ETHTRCV_30_TJA1103_EXCLUSIVE_AREA_WAKEUP: RteBswExclusiveAreaRef=ETHTRCV_30_TJA1103_EXCLUSIVE_AREA_WAKEUP
          ETHTRCV_30_TJA1103_EXCLUSIVE_AREA_MACSEC: RteBswExclusiveAreaRef=ETHTRCV_30_TJA1103_EXCLUSIVE_AREA_MACSEC
      Dio: RteBswImplementationRef=Dio_Impl, RteBswModuleConfigurationRef=Dio
        DIO_EXCLUSIVE_AREA_0 (RteBswExclusiveAreaImpl): RteExclusiveAreaImplMechanism=ALL_INTERRUPT_BLOCKING, RteBswExclusiveAreaRef=DIO_EXCLUSIVE_AREA_0
