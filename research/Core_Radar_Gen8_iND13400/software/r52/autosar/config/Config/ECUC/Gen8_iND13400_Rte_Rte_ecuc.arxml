[part 1 of 3: package /ActiveEcuC]
AUTOSAR XML (schema 00053)
package /ActiveEcuC
  module config Rte: implementation-config-variant=VARIANT-PRE-COMPILE, module-description=Rte_Impl
    RteInitializationBehavior: RteInitializationStrategy=RTE_INITIALIZATION_STRATEGY_AT_DATA_DECLARATION, RteSectionInitializationPolicy=INIT
    RteGeneration:
      RteGenerationMode = COMPATIBILITY_MODE
      RteIocInteractionReturnValue = RTE_IOC
      RteValueRangeCheckEnabled = false
      RteCalibrationSupport = NONE
      RteCodeVendorId = 30
      RteDevErrorDetect = false
      RteDevErrorDetectUninit = false
      RteMeasurementSupport = false
      RteOptimizationMode = RUNTIME
      RteVfbTraceEnabled = false
      RteEnableMemoryProtection = true
      RteEnableMultiCore = false
      RteDisableInterEcuIntToIntDataConversion = true
    RteBswGeneral: RteSchMVersionInfoApi=false, RteUseComShadowSignalApi=false
    11 x RteBswModuleInstance:
      BswM: RteBswImplementationRef=BswM_Impl, RteBswModuleConfigurationRef=BswM
        BSWM_EXCLUSIVE_AREA_0 (RteBswExclusiveAreaImpl): RteExclusiveAreaImplMechanism=ALL_INTERRUPT_BLOCKING, RteBswExclusiveAreaRef=BSWM_EXCLUSIVE_AREA_0
        BswM_MainFunctionTimingEvent0 (RteBswEventToTaskMapping):
          RteBswImmediateRestart = false
          RteBswPositionInTask = 1
          RteBswEventRef = BswM_MainFunctionTimingEvent0
          RteBswMappedToTaskRef = BSW_Task
          RteBswUsedOsEventRef = Rte_Ev_Cyclic2_BSW_Task_0_10ms
          RteBswUsedOsAlarmRef = Rte_Al_TE2_BSW_Task_0_10ms
      Com: RteBswImplementationRef=Com_Impl, RteBswModuleConfigurationRef=Com
        3 x RteBswExclusiveAreaImpl, all with RteExclusiveAreaImplMechanism=ALL_INTERRUPT_BLOCKING:
          COM_EXCLUSIVE_AREA_TX: RteBswExclusiveAreaRef=COM_EXCLUSIVE_AREA_TX
          COM_EXCLUSIVE_AREA_RX: RteBswExclusiveAreaRef=COM_EXCLUSIVE_AREA_RX
          COM_EXCLUSIVE_AREA_BOTH: RteBswExclusiveAreaRef=COM_EXCLUSIVE_AREA_BOTH
        3 x RteBswEventToTaskMapping, all with RteBswImmediateRestart=false, RteBswMappedToTaskRef=Appl_Task_Communication:
          Com_MainFunctionRx_ComMainFunctionRxTimingEvent0: RteBswPositionInTask=2, RteBswEventRef=Com_MainFunctionRx_ComMainFunctionRxTimingEvent0, RteBswUsedOsEventRef=Rte_Ev_Cyclic2_Appl_Task_Communication_0_10ms, RteBswUsedOsAlarmRef=Rte_Al_TE2_Appl_Task_Communication_0_10ms
          Com_MainFunctionTx_ComMainFunctionTx_EventTimingEvent0: RteBswPositionInTask=0, RteBswEventRef=Com_MainFunctionTx_ComMainFunctionTx_EventTimingEvent0, RteBswUsedOsAlarmRef=Rte_Al_TE2_Appl_Task_Communication_0_10ms, RteBswUsedOsEventRef=Rte_Ev_Cyclic2_Appl_Task_Communication_0_10ms
          Com_MainFunctionTx_ComMainFunctionTx_PeriodicTimingEvent0: RteBswPositionInTask=1, RteBswEventRef=Com_MainFunctionTx_ComMainFunctionTx_PeriodicTimingEvent0, RteBswUsedOsEventRef=Rte_Ev_Run_Com_Com_MainFunctionTx_ComMainFunctionTx_Periodic, RteBswUsedOsAlarmRef=Rte_Al_TE_Com_Com_MainFunctionTx_ComMainFunctionTx_Periodic
      ComM: RteBswImplementationRef=ComM_Impl, RteBswModuleConfigurationRef=ComM
        ComM_MainFunction_0TimingEvent0 (RteBswEventToTaskMapping):
          RteBswImmediateRestart = false
          RteBswPositionInTask = 5
          RteBswEventRef = ComM_MainFunction_0TimingEvent0
          RteBswMappedToTaskRef = BSW_Task
          RteBswUsedOsEventRef = Rte_Ev_Cyclic2_BSW_Task_0_20ms
          RteBswUsedOsAlarmRef = Rte_Al_TE2_BSW_Task_0_20ms
        6 x RteBswExclusiveAreaImpl:
          COMM_EXCLUSIVE_AREA_0: RteExclusiveAreaImplMechanism=ALL_INTERRUPT_BLOCKING, RteBswExclusiveAreaRef=COMM_EXCLUSIVE_AREA_0
          COMM_EXCLUSIVE_AREA_1: RteExclusiveAreaImplMechanism=ALL_INTERRUPT_BLOCKING, RteBswExclusiveAreaRef=COMM_EXCLUSIVE_AREA_1
          COMM_EXCLUSIVE_AREA_{2..5}: RteExclusiveAreaImplMechanism=NONE, RteBswExclusiveAreaRef=COMM_EXCLUSIVE_AREA_{2..5}
        ComM_MainFunction_1TimingEvent0 (RteBswEventToTaskMapping):
          RteBswImmediateRestart = false
          RteBswPositionInTask = 6
          RteBswEventRef = ComM_MainFunction_1TimingEvent0
          RteBswMappedToTaskRef = BSW_Task
          RteBswUsedOsEventRef = Rte_Ev_Cyclic2_BSW_Task_0_20ms
          RteBswUsedOsAlarmRef = Rte_Al_TE2_BSW_Task_0_20ms
        ComM_MainFunction_2TimingEvent0 (RteBswEventToTaskMapping):
          RteBswImmediateRestart = false
          RteBswPositionInTask = 4
          RteBswEventRef = ComM_MainFunction_2TimingEvent0
          RteBswMappedToTaskRef = BSW_Task
          RteBswUsedOsEventRef = Rte_Ev_Cyclic2_BSW_Task_0_20ms
          RteBswUsedOsAlarmRef = Rte_Al_TE2_BSW_Task_0_20ms
      Det: RteBswImplementationRef=Det_Impl, RteBswModuleConfigurationRef=Det
        DET_EXCLUSIVE_AREA_0 (RteBswExclusiveAreaImpl): RteExclusiveAreaImplMechanism=ALL_INTERRUPT_BLOCKING, RteBswExclusiveAreaRef=DET_EXCLUSIVE_AREA_0
      EcuM: RteBswImplementationRef=EcuM_Impl, RteBswModuleConfigurationRef=EcuM
        EcuM_MainFunctionTimingEvent0 (RteBswEventToTaskMapping):
          RteBswImmediateRestart = false
          RteBswPositionInTask = 0
          RteBswEventRef = EcuM_MainFunctionTimingEvent0
          RteBswMappedToTaskRef = BSW_Task
          RteBswUsedOsEventRef = Rte_Ev_Cyclic2_BSW_Task_0_10ms
          RteBswUsedOsAlarmRef = Rte_Al_TE2_BSW_Task_0_10ms
        5 x RteBswExclusiveAreaImpl, all with RteExclusiveAreaImplMechanism=ALL_INTERRUPT_BLOCKING:
          ECUM_EXCLUSIVE_AREA_{0..3}: RteBswExclusiveAreaRef=ECUM_EXCLUSIVE_AREA_{0..3}
          ECUM_EXCLUSIVE_AREA_RUNREQUESTFLAGS: RteBswExclusiveAreaRef=ECUM_EXCLUSIVE_AREA_RUNREQUESTFLAGS
      EthIf: RteBswImplementationRef=EthIf_Impl, RteBswModuleConfigurationRef=EthIf
        EthIf_MainFunctionRxTimingEvent0 (RteBswEventToTaskMapping):
          RteBswImmediateRestart = false
          RteBswPositionInTask = 15
          RteBswEventRef = EthIf_MainFunctionRxTimingEvent0
          RteBswMappedToTaskRef = BSW_Task
          RteBswUsedOsEventRef = Rte_Ev_Cyclic2_BSW_Task_0_5ms
          RteBswUsedOsAlarmRef = Rte_Al_TE2_BSW_Task_0_5ms
        EthIf_MainFunctionTxTimingEvent0 (RteBswEventToTaskMapping):
          RteBswImmediateRestart = false
          RteBswPositionInTask = 14
          RteBswEventRef = EthIf_MainFunctionTxTimingEvent0
          RteBswMappedToTaskRef = BSW_Task
          RteBswUsedOsEventRef = Rte_Ev_Cyclic2_BSW_Task_0_5ms
          RteBswUsedOsAlarmRef = Rte_Al_TE2_BSW_Task_0_5ms
        7 x RteBswExclusiveAreaImpl, all with RteExclusiveAreaImplMechanism=ALL_INTERRUPT_BLOCKING:
          ETHIF_EXCLUSIVE_AREA_CTRL_INIT: RteBswExclusiveAreaRef=ETHIF_EXCLUSIVE_AREA_CTRL_INIT
          ETHIF_EXCLUSIVE_AREA_SET_CTRL_MODE: RteBswExclusiveAreaRef=ETHIF_EXCLUSIVE_AREA_SET_CTRL_MODE
          ETHIF_EXCLUSIVE_AREA_TX_MIRROR_ELEMENT: RteBswExclusiveAreaRef=ETHIF_EXCLUSIVE_AREA_TX_MIRROR_ELEMENT
          ETHIF_EXCLUSIVE_AREA_RXTX_STATS: RteBswExclusiveAreaRef=ETHIF_EXCLUSIVE_AREA_RXTX_STATS
          ETHIF_EXCLUSIVE_AREA_SIGNAL_QUALITY: RteBswExclusiveAreaRef=ETHIF_EXCLUSIVE_AREA_SIGNAL_QUALITY
          ETHIF_EXCLUSIVE_AREA_RX_PDU_ALLOCATION: RteBswExclusiveAreaRef=ETHIF_EXCLUSIVE_AREA_RX_PDU_ALLOCATION
          ETHIF_EXCLUSIVE_AREA_MULTI_CORE: RteBswExclusiveAreaRef=ETHIF_EXCLUSIVE_AREA_MULTI_CORE
      EthSM: RteBswImplementationRef=EthSM_Impl, RteBswModuleConfigurationRef=EthSM
        EthSM_MainFunctionTimingEvent0 (RteBswEventToTaskMapping):
          RteBswImmediateRestart = false
          RteBswPositionInTask = 7
          RteBswEventRef = EthSM_MainFunctionTimingEvent0
          RteBswMappedToTaskRef = BSW_Task
          RteBswUsedOsEventRef = Rte_Ev_Cyclic2_BSW_Task_0_20ms
          RteBswUsedOsAlarmRef = Rte_Al_TE2_BSW_Task_0_20ms
      PduR: RteBswImplementationRef=PduR_Impl, RteBswModuleConfigurationRef=PduR
        PDUR_EXCLUSIVE_AREA_0 (RteBswExclusiveAreaImpl): RteExclusiveAreaImplMechanism=ALL_INTERRUPT_BLOCKING, RteBswExclusiveAreaRef=PDUR_EXCLUSIVE_AREA_0
      Rte: RteBswImplementationRef=Rte_Impl, RteBswModuleConfigurationRef=Rte
        Rte_ComMainFunctionTxProxyPeriodic_ComMainFunctionTx_Event_OsCore0_ASILTimingEvent0 (RteBswEventToTaskMapping): RteBswImmediateRestart=false, RteBswEventRef=Rte_ComMainFunctionTxProxyPeriodic_ComMainFunctionTx_Event_OsCore0_ASILTimingEvent0
        Rte_ComMainFunctionTxProxyPeriodic_ComMainFunctionTx_Periodic_OsCore0_ASILTimingEvent0 (RteBswEventToTaskMapping): RteBswImmediateRestart=false, RteBswEventRef=Rte_ComMainFunctionTxProxyPeriodic_ComMainFunctionTx_Periodic_OsCore0_ASILTimingEvent0
      SoAd: RteBswImplementationRef=SoAd_Impl, RteBswModuleConfigurationRef=SoAd
        SoAd_MainFunctionTimingEvent0 (RteBswEventToTaskMapping):
          RteBswImmediateRestart = false
          RteBswPositionInTask = 8
          RteBswEventRef = SoAd_MainFunctionTimingEvent0
          RteBswMappedToTaskRef = BSW_Task
          RteBswUsedOsEventRef = Rte_Ev_Cyclic2_BSW_Task_0_5ms
          RteBswUsedOsAlarmRef = Rte_Al_TE2_BSW_Task_0_5ms
        3 x RteBswExclusiveAreaImpl, all with RteExclusiveAreaImplMechanism=ALL_INTERRUPT_BLOCKING:
          SOAD_EXCLUSIVE_AREA_0: RteBswExclusiveAreaRef=SOAD_EXCLUSIVE_AREA_0
          SOAD_EXCLUSIVE_AREA_1: RteBswExclusiveAreaRef=SOAD_EXCLUSIVE_AREA_1
          SOAD_EXCLUSIVE_AREA_MULTI_PARTITION: RteBswExclusiveAreaRef=SOAD_EXCLUSIVE_AREA_MULTI_PARTITION
      TcpIp: RteBswImplementationRef=TcpIp_Impl, RteBswModuleConfigurationRef=TcpIp
        TcpIp_MainFunctionTimingEvent0 (RteBswEventToTaskMapping):
          RteBswImmediateRestart = false
          RteBswPositionInTask = 9
          RteBswEventRef = TcpIp_MainFunctionTimingEvent0
          RteBswMappedToTaskRef = BSW_Task
          RteBswUsedOsEventRef = Rte_Ev_Cyclic2_BSW_Task_0_5ms
          RteBswUsedOsAlarmRef = Rte_Al_TE2_BSW_Task_0_5ms
        TCPIP_EXCLUSIVE_AREA_0 (RteBswExclusiveAreaImpl): RteExclusiveAreaImplMechanism=ALL_INTERRUPT_BLOCKING, RteBswExclusiveAreaRef=TCPIP_EXCLUSIVE_AREA_0
        TCPIP_EXCLUSIVE_AREA_1 (RteBswExclusiveAreaImpl): RteExclusiveAreaImplMechanism=ALL_INTERRUPT_BLOCKING, RteBswExclusiveAreaRef=TCPIP_EXCLUSIVE_AREA_1
    5 x RteSwComponentInstance:
      Det_EcuSwComposition: RteSoftwareComponentInstanceRef=Det
      ComM_EcuSwComposition: RteSoftwareComponentInstanceRef=ComM
        31 x RteEventToTaskMapping, all with RteImmediateRestart=false:
          Timer_ComM_MainFunction_0: RtePositionInTask=5, RteEventRef=Timer_ComM_MainFunction_0, RteMappedToTaskRef=BSW_Task, RteUsedOsEventRef=Rte_Ev_Cyclic2_BSW_Task_0_20ms, RteUsedOsAlarmRef=Rte_Al_TE2_BSW_Task_0_20ms
          OpEventLimitECUToNoComMode_LimitECUToNoComMode_modeLimitation: RteEventRef=OpEventLimitECUToNoComMode_LimitECUToNoComMode_modeLimitation
          OpEventReadInhibitCounter_ReadInhibitCounter_modeLimitation: RteEventRef=OpEventReadInhibitCounter_ReadInhibitCounter_modeLimitation
          OpEventResetInhibitCounter_ResetInhibitCounter_modeLimitation: RteEventRef=OpEventResetInhibitCounter_ResetInhibitCounter_modeLimitation
          OpEventSetECUGroupClassification_SetECUGroupClassification_modeLimitation: RteEventRef=OpEventSetECUGroupClassification_SetECUGroupClassification_modeLimitation
          OpEventGetInhibitionStatus_GetInhibitionStatus_CL_CN_PCAN_RADAR_458ff0f1: RteEventRef=OpEventGetInhibitionStatus_GetInhibitionStatus_CL_CN_PCAN_RADAR_458ff0f1
          OpEventLimitChannelToNoComMode_LimitChannelToNoComMode_CL_CN_PCAN_RADAR_458ff0f1: RteEventRef=OpEventLimitChannelToNoComMode_LimitChannelToNoComMode_CL_CN_PCAN_RADAR_458ff0f1
          OpEventGetInhibitionStatus_GetInhibitionStatus_CW_CN_PCAN_RADAR_458ff0f1: RteEventRef=OpEventGetInhibitionStatus_GetInhibitionStatus_CW_CN_PCAN_RADAR_458ff0f1
          Timer_ComM_MainFunction_1: RtePositionInTask=6, RteEventRef=Timer_ComM_MainFunction_1, RteMappedToTaskRef=BSW_Task, RteUsedOsEventRef=Rte_Ev_Cyclic2_BSW_Task_0_20ms, RteUsedOsAlarmRef=Rte_Al_TE2_BSW_Task_0_20ms
          OpEventPreventWakeUp_PreventWakeUp_CW_CN_PCAN_RADAR_458ff0f1: RteEventRef=OpEventPreventWakeUp_PreventWakeUp_CW_CN_PCAN_RADAR_458ff0f1
          OpEventGetInhibitionStatus_GetInhibitionStatus_CW_cnctr_RDR_RdrNet_5172a59b: RteEventRef=OpEventGetInhibitionStatus_GetInhibitionStatus_CW_cnctr_RDR_RdrNet_5172a59b
          OpEventGetMaxComMode_GetMaxComMode_UR_cnctr_RDR_RdrNet_9faa6a47: RteEventRef=OpEventGetMaxComMode_GetMaxComMode_UR_cnctr_RDR_RdrNet_9faa6a47
          OpEventPreventWakeUp_PreventWakeUp_CW_cnctr_RDR_RdrNet_5172a59b: RteEventRef=OpEventPreventWakeUp_PreventWakeUp_CW_cnctr_RDR_RdrNet_5172a59b
          OpEventGetInhibitionStatus_GetInhibitionStatus_CL_cnctr_RDR_RdrNet_5172a59b: RteEventRef=OpEventGetInhibitionStatus_GetInhibitionStatus_CL_cnctr_RDR_RdrNet_5172a59b
          OpEventRequestComMode_RequestComMode_UR_cnctr_RDR_RdrNet_9faa6a47: RteEventRef=OpEventRequestComMode_RequestComMode_UR_cnctr_RDR_RdrNet_9faa6a47
          OpEventGetCurrentComMode_GetCurrentComMode_UR_cnctr_RDR_RdrNet_9faa6a47: RteEventRef=OpEventGetCurrentComMode_GetCurrentComMode_UR_cnctr_RDR_RdrNet_9faa6a47
          OpEventGetRequestedComMode_GetRequestedComMode_UR_cnctr_RDR_RdrNet_9faa6a47: RteEventRef=OpEventGetRequestedComMode_GetRequestedComMode_UR_cnctr_RDR_RdrNet_9faa6a47
          OpEventLimitChannelToNoComMode_LimitChannelToNoComMode_CL_cnctr_RDR_RdrNet_5172a59b: RteEventRef=OpEventLimitChannelToNoComMode_LimitChannelToNoComMode_CL_cnctr_RDR_RdrNet_5172a59b
          OpEventRequestComMode_RequestComMode_UR_CN_PCAN_RADAR_d6cf874b: RteEventRef=OpEventRequestComMode_RequestComMode_UR_CN_PCAN_RADAR_d6cf874b
          OpEventGetRequestedComMode_GetRequestedComMode_UR_CN_PCAN_RADAR_d6cf874b: RteEventRef=OpEventGetRequestedComMode_GetRequestedComMode_UR_CN_PCAN_RADAR_d6cf874b
          OpEventGetMaxComMode_GetMaxComMode_UR_CN_PCAN_RADAR_d6cf874b: RteEventRef=OpEventGetMaxComMode_GetMaxComMode_UR_CN_PCAN_RADAR_d6cf874b
          OpEventGetCurrentComMode_GetCurrentComMode_UR_CN_PCAN_RADAR_d6cf874b: RteEventRef=OpEventGetCurrentComMode_GetCurrentComMode_UR_CN_PCAN_RADAR_d6cf874b
          Timer_ComM_MainFunction_2: RtePositionInTask=4, RteEventRef=Timer_ComM_MainFunction_2, RteUsedOsEventRef=Rte_Ev_Cyclic2_BSW_Task_0_20ms, RteUsedOsAlarmRef=Rte_Al_TE2_BSW_Task_0_20ms, RteMappedToTaskRef=BSW_Task
          OpEventGetCurrentComMode_GetCurrentComMode_UR_CN_VCAN_RADAR_4b138c58: RteEventRef=OpEventGetCurrentComMode_GetCurrentComMode_UR_CN_VCAN_RADAR_4b138c58
          OpEventGetMaxComMode_GetMaxComMode_UR_CN_VCAN_RADAR_4b138c58: RteEventRef=OpEventGetMaxComMode_GetMaxComMode_UR_CN_VCAN_RADAR_4b138c58
          OpEventLimitChannelToNoComMode_LimitChannelToNoComMode_CL_CN_VCAN_RADAR_489180b6: RteEventRef=OpEventLimitChannelToNoComMode_LimitChannelToNoComMode_CL_CN_VCAN_RADAR_489180b6
          OpEventGetRequestedComMode_GetRequestedComMode_UR_CN_VCAN_RADAR_4b138c58: RteEventRef=OpEventGetRequestedComMode_GetRequestedComMode_UR_CN_VCAN_RADAR_4b138c58
          OpEventPreventWakeUp_PreventWakeUp_CW_CN_VCAN_RADAR_489180b6: RteEventRef=OpEventPreventWakeUp_PreventWakeUp_CW_CN_VCAN_RADAR_489180b6
          OpEventRequestComMode_RequestComMode_UR_CN_VCAN_RADAR_4b138c58: RteEventRef=OpEventRequestComMode_RequestComMode_UR_CN_VCAN_RADAR_4b138c58
          OpEventGetInhibitionStatus_GetInhibitionStatus_CL_CN_VCAN_RADAR_489180b6: RteEventRef=OpEventGetInhibitionStatus_GetInhibitionStatus_CL_CN_VCAN_RADAR_489180b6
          OpEventGetInhibitionStatus_GetInhibitionStatus_CW_CN_VCAN_RADAR_489180b6: RteEventRef=OpEventGetInhibitionStatus_GetInhibitionStatus_CW_CN_VCAN_RADAR_489180b6
      EcuM_EcuSwComposition: RteSoftwareComponentInstanceRef=EcuM
        8 x RteEventToTaskMapping, all with RteImmediateRestart=false:
          Timer_EcuM_MainFunction: RtePositionInTask=0, RteEventRef=Timer_EcuM_MainFunction, RteMappedToTaskRef=BSW_Task, RteUsedOsEventRef=Rte_Ev_Cyclic2_BSW_Task_0_10ms, RteUsedOsAlarmRef=Rte_Al_TE2_BSW_Task_0_10ms
          OpEventSelectShutdownTarget_SelectShutdownTarget_EcuM_ShutdownTarget: RteEventRef=OpEventSelectShutdownTarget_SelectShutdownTarget_EcuM_ShutdownTarget
          OpEventGetShutdownTarget_GetShutdownTarget_EcuM_ShutdownTarget: RteEventRef=OpEventGetShutdownTarget_GetShutdownTarget_EcuM_ShutdownTarget
          OpEventGetLastShutdownTarget_GetLastShutdownTarget_EcuM_ShutdownTarget: RteEventRef=OpEventGetLastShutdownTarget_GetLastShutdownTarget_EcuM_ShutdownTarget
          OpEventSelectShutdownCause_SelectShutdownCause_EcuM_ShutdownTarget: RteEventRef=OpEventSelectShutdownCause_SelectShutdownCause_EcuM_ShutdownTarget
          OpEventGetShutdownCause_GetShutdownCause_EcuM_ShutdownTarget: RteEventRef=OpEventGetShutdownCause_GetShutdownCause_EcuM_ShutdownTarget
          OpEventSelectBootTarget_SelectBootTarget_EcuM_BootTarget: RteEventRef=OpEventSelectBootTarget_SelectBootTarget_EcuM_BootTarget
          OpEventGetBootTarget_GetBootTarget_EcuM_BootTarget: RteEventRef=OpEventGetBootTarget_GetBootTarget_EcuM_BootTarget
      BswM_EcuSwComposition: RteSoftwareComponentInstanceRef=BswM
        Timer_BswM_MainFunction (RteEventToTaskMapping):
          RteImmediateRestart = false
          RtePositionInTask = 1
          RteEventRef = Timer_BswM_MainFunction
          RteMappedToTaskRef = BSW_Task
          RteUsedOsEventRef = Rte_Ev_Cyclic2_BSW_Task_0_10ms
          RteUsedOsAlarmRef = Rte_Al_TE2_BSW_Task_0_10ms
      Os_OsCore0_swc_EcuSwComposition: RteSoftwareComponentInstanceRef=Os_OsCore0_swc
        OpEventGetCounterValue_GetCounterValue_OsService_OsCounter (RteEventToTaskMapping): RteImmediateRestart=false, RteEventRef=OpEventGetCounterValue_GetCounterValue_OsService_OsCounter
        OpEventGetElapsedValue_GetElapsedValue_OsService_OsCounter (RteEventToTaskMapping): RteImmediateRestart=false, RteEventRef=OpEventGetElapsedValue_GetElapsedValue_OsService_OsCounter
    RteOsInteraction
      29 x RteUsedOsActivation, all with RteExpectedActivationOffset=0, RteExpectedTickDuration=0:
        Rte_Al_TE2_BSW_Task_0_10ms: RteActivationOsAlarmRef=Rte_Al_TE2_BSW_Task_0_10ms, RteActivationOsTaskRef=BSW_Task
        Rte_Al_TE2_BSW_Task_0_20ms: RteActivationOsAlarmRef=Rte_Al_TE2_BSW_Task_0_20ms, RteActivationOsTaskRef=BSW_Task
        Rte_Al_TE2_BSW_Task_0_5ms: RteActivationOsAlarmRef=Rte_Al_TE2_BSW_Task_0_5ms, RteActivationOsTaskRef=BSW_Task
        Rte_Al_TE_Appl_Task_0_50ms: RteActivationOsAlarmRef=Rte_Al_TE_Appl_Task_0_50ms, RteActivationOsTaskRef=Appl_Task
        Rte_Al_TE_SWC_PLT_CDD_Radar_Control_RE_Radar_Control_10ms: RteActivationOsAlarmRef=Rte_Al_TE_SWC_PLT_CDD_Radar_Control_RE_Radar_Control_10ms, RteActivationOsTaskRef=Radar_Ctrl_Task
        Rte_Al_TE_Appl_Task_0_10ms: RteActivationOsAlarmRef=Rte_Al_TE_Appl_Task_0_10ms, RteActivationOsTaskRef=Appl_Task
        Rte_Al_TE_Appl_Task_0_5ms: RteActivationOsAlarmRef=Rte_Al_TE_Appl_Task_0_5ms, RteActivationOsTaskRef=Appl_Task
        Rte_Al_TE_Radar_Ctrl_Task_0_50ms: RteActivationOsAlarmRef=Rte_Al_TE_Radar_Ctrl_Task_0_50ms, RteActivationOsTaskRef=Radar_Ctrl_Task
        Rte_Al_TE_Rtm_Rtm_MainFunction: RteActivationOsAlarmRef=Rte_Al_TE_Rtm_Rtm_MainFunction, RteActivationOsTaskRef=Radar_Ctrl_Task
        Rte_Al_TE_SWC_PLT_CDD_Logging_RE_Logging_2ms: RteActivationOsAlarmRef=Rte_Al_TE_SWC_PLT_CDD_Logging_RE_Logging_2ms, RteActivationOsTaskRef=Appl_Task_Fast
        Rte_Al_TE_SWC_PLT_Appl_Communication_RE_Communication_Tx_50ms: RteActivationOsAlarmRef=Rte_Al_TE_SWC_PLT_Appl_Communication_RE_Communication_Tx_50ms, RteActivationOsTaskRef=Appl_Task_Communication
        Rte_Al_TE2_Appl_Task_Communication_0_10ms: RteActivationOsAlarmRef=Rte_Al_TE2_Appl_Task_Communication_0_10ms, RteActivationOsTaskRef=Appl_Task_Communication
        Rte_Al_TE_Com_Com_MainFunctionTx_ComMainFunctionTx_Periodic: RteActivationOsAlarmRef=Rte_Al_TE_Com_Com_MainFunctionTx_ComMainFunctionTx_Periodic, RteActivationOsTaskRef=Appl_Task_Communication
        Rte_Al_TE2_Appl_Task_High_Prio_0_5ms: RteActivationOsAlarmRef=Rte_Al_TE2_Appl_Task_High_Prio_0_5ms, RteActivationOsTaskRef=Appl_Task_High_Prio
        Rte_Al_TE_SWC_PLT_Appl_IntWDG_RE_PLT_WDG_Main_5ms: RteActivationOsAlarmRef=Rte_Al_TE_SWC_PLT_Appl_IntWDG_RE_PLT_WDG_Main_5ms, RteActivationOsTaskRef=Appl_Task_High_Prio
        Rte_Al_TE_SWC_PLT_Appl_Diag_RE_PLT_Diag_PlatformTime_50ms: RteActivationOsAlarmRef=Rte_Al_TE_SWC_PLT_Appl_Diag_RE_PLT_Diag_PlatformTime_50ms, RteActivationOsTaskRef=Appl_Task_High_Prio
        Rte_Al_TE_Appl_IPC_Task_0_50ms: RteActivationOsAlarmRef=Rte_Al_TE_Appl_IPC_Task_0_50ms, RteActivationOsTaskRef=Appl_IPC_Task
        Rte_Al_TE_SWC_PLT_CDD_Logging_RE_Logging_10ms: RteActivationOsAlarmRef=Rte_Al_TE_SWC_PLT_CDD_Logging_RE_Logging_10ms, RteActivationOsTaskRef=Appl_Task_Fast
        Rte_Al_TE_SWC_PLT_CDD_Logging_RE_Logging_50ms: RteActivationOsAlarmRef=Rte_Al_TE_SWC_PLT_CDD_Logging_RE_Logging_50ms, RteActivationOsTaskRef=Appl_Task_Fast
        Rte_Al_TE_SWC_PLT_CDD_Logging_RE_Logging_5ms: RteActivationOsAlarmRef=Rte_Al_TE_SWC_PLT_CDD_Logging_RE_Logging_5ms, RteActivationOsTaskRef=Appl_Task_Fast
        Rte_Al_TE_SWC_CMP_PRJ_UDSHandler_RE_SWC_CMP_PRJ_UDSHandler_Main_50ms: RteActivationOsAlarmRef=Rte_Al_TE_SWC_CMP_PRJ_UDSHandler_RE_SWC_CMP_PRJ_UDSHandler_Main_50ms, RteActivationOsTaskRef=Appl_Task_Logging
        Rte_Al_TE_SWC_PLT_CDD_Radar_Control_RE_Radar_Ctl_Look_Complete_Post_RFBIST: RteActivationOsAlarmRef=Rte_Al_TE_SWC_PLT_CDD_Radar_Control_RE_Radar_Ctl_Look_Complete_Post_RFBIST, RteActivationOsTaskRef=Radar_Ctrl_Task
        Rte_Al_TE_SWC_CDD_IPC_RE_IPC_VSE_Handler_10ms: RteActivationOsAlarmRef=Rte_Al_TE_SWC_CDD_IPC_RE_IPC_VSE_Handler_10ms, RteActivationOsTaskRef=Appl_IPC_Task
        Rte_Al_TE_SWC_PLT_Appl_IntWDG_RE_PLT_WDG_INTERNAL_WDG_PLT_Appl_Task: RteActivationOsAlarmRef=Rte_Al_TE_SWC_PLT_Appl_IntWDG_RE_PLT_WDG_INTERNAL_WDG_PLT_Appl_Task, RteActivationOsTaskRef=Appl_Task
        Rte_Al_TE_Appl_Task_Communication_0_25ms: RteActivationOsAlarmRef=Rte_Al_TE_Appl_Task_Communication_0_25ms, RteActivationOsTaskRef=Appl_Task_Communication
        Rte_Al_TE_SWC_PLT_Appl_IntWDG_RE_PLT_WDG_INTERNAL_WDG_BSW_Task: RteActivationOsAlarmRef=Rte_Al_TE_SWC_PLT_Appl_IntWDG_RE_PLT_WDG_INTERNAL_WDG_BSW_Task, RteActivationOsTaskRef=BSW_Task
        Rte_Al_TE2_Appl_BackgroundTask_0_5ms: RteActivationOsAlarmRef=Rte_Al_TE2_Appl_BackgroundTask_0_5ms, RteActivationOsTaskRef=Appl_BackgroundTask
        Rte_Al_TE_SWC_PLT_Appl_NvMHandler_RE_PLT_Appl_NvMHandler_5ms: RteActivationOsAlarmRef=Rte_Al_TE_SWC_PLT_Appl_NvMHandler_RE_PLT_Appl_NvMHandler_5ms, RteActivationOsTaskRef=BSW_Task
        Rte_Al_TE2_Appl_Task_High_Prio_0_10ms: RteActivationOsAlarmRef=Rte_Al_TE2_Appl_Task_High_Prio_0_10ms, RteActivationOsTaskRef=Appl_Task_High_Prio
    CanIf (RteBswModuleInstance): RteBswImplementationRef=CanIf_Impl, RteBswModuleConfigurationRef=CanIf
      10 x RteBswExclusiveAreaImpl, all with RteExclusiveAreaImplMechanism=ALL_INTERRUPT_BLOCKING:
        CANIF_EXCLUSIVE_AREA_{0..9}: RteBswExclusiveAreaRef=CANIF_EXCLUSIVE_AREA_{0..9}
    CanSM (RteBswModuleInstance): RteBswImplementationRef=CanSM_Impl, RteBswModuleConfigurationRef=CanSM
      CanSM_MainFunctionTimingEvent0 (RteBswEventToTaskMapping):
        RteBswImmediateRestart = false
        RteBswPositionInTask = 2
        RteBswEventRef = CanSM_MainFunctionTimingEvent0
        RteBswMappedToTaskRef = BSW_Task
        RteBswUsedOsAlarmRef = Rte_Al_TE2_BSW_Task_0_10ms
        RteBswUsedOsEventRef = Rte_Ev_Cyclic2_BSW_Task_0_10ms
      6 x RteBswExclusiveAreaImpl, all with RteExclusiveAreaImplMechanism=ALL_INTERRUPT_BLOCKING:
        CANSM_EXCLUSIVE_AREA_{1..6}: RteBswExclusiveAreaRef=CANSM_EXCLUSIVE_AREA_{1..6}
    SWC_PLT_CDD_Logging_EcuSwComposition (RteSwComponentInstance): RteSoftwareComponentInstanceRef=SWC_PLT_CDD_Logging
      14 x RteEventToTaskMapping, all with RteImmediateRestart=false:
        TMT_RE_Logging_50ms: RtePositionInTask=3, RteEventRef=TMT_RE_Logging_50ms, RteMappedToTaskRef=Appl_Task_Fast, RteUsedOsEventRef=Rte_Ev_Run_SWC_PLT_CDD_Logging_RE_Logging_50ms, RteUsedOsAlarmRef=Rte_Al_TE_SWC_PLT_CDD_Logging_RE_Logging_50ms
        TMT_RE_Logging_10ms: RtePositionInTask=1, RteEventRef=TMT_RE_Logging_10ms, RteMappedToTaskRef=Appl_Task_Fast, RteUsedOsEventRef=Rte_Ev_Run_SWC_PLT_CDD_Logging_RE_Logging_10ms, RteUsedOsAlarmRef=Rte_Al_TE_SWC_PLT_CDD_Logging_RE_Logging_10ms
        TMT_RE_Logging_5ms: RtePositionInTask=4, RteEventRef=TMT_RE_Logging_5ms, RteMappedToTaskRef=Appl_Task_Fast, RteUsedOsEventRef=Rte_Ev_Run_SWC_PLT_CDD_Logging_RE_Logging_5ms, RteUsedOsAlarmRef=Rte_Al_TE_SWC_PLT_CDD_Logging_RE_Logging_5ms
        RE_Logging_InitEvent: RtePositionInTask=1, RteEventRef=RE_Logging_InitEvent, RteMappedToTaskRef=Init_Task_Qm
        OIT_PostRadarProcessing_MMIC_Populate_MMIC_Stream_PostRadarProcessing_MMIC_Populate_MMIC_Stream: RtePositionInTask=4, RteEventRef=OIT_PostRadarProcessing_MMIC_Populate_MMIC_Stream_PostRadarProcessing_MMIC_Populate_MMIC_Stream, RteMappedToTaskRef=Appl_Task_Logging, RteUsedOsEventRef=Rte_Ev_Run_SWC_PLT_CDD_Logging_PostRadarProcessing_MMIC_Populate_MMIC_Stream
        OIT_PostRadarProcessing_Radar_Capability_Populate_Radar_Capability_Stream_PostRadarProcessing_Radar_Capability_Populate_4F329E1C: RtePositionInTask=5, RteEventRef=OIT_PostRadarProcessing_Radar_Capability_Populate_Radar_Capability_Stream_PostRadarProcessing_Radar_Capability_Populate_4F329E1C, RteMappedToTaskRef=Appl_Task_Logging, RteUsedOsEventRef=Rte_Ev_Run_SWC_PLT_CDD_Logging_PostRadarProcessing_Radar_Capability_Populate_Radar_Capability_Stream
        OIT_PostRadarProcessing_Status_Populate_Status_Stream_PostRadarProcessing_Status_Populate_Status_Stream: RtePositionInTask=7, RteEventRef=OIT_PostRadarProcessing_Status_Populate_Status_Stream_PostRadarProcessing_Status_Populate_Status_Stream, RteMappedToTaskRef=Appl_Task_Logging, RteUsedOsEventRef=Rte_Ev_Run_SWC_PLT_CDD_Logging_PostRadarProcessing_Status_Populate_Status_Stream
        OIT_PostRadarProcessing_Debug_Populate_Debug_Stream_PostRadarProcessing_Debug_Populate_Debug_Stream: RtePositionInTask=1, RteEventRef=OIT_PostRadarProcessing_Debug_Populate_Debug_Stream_PostRadarProcessing_Debug_Populate_Debug_Stream, RteMappedToTaskRef=Appl_Task_Logging, RteUsedOsEventRef=Rte_Ev_Run_SWC_PLT_CDD_Logging_PostRadarProcessing_Debug_Populate_Debug_Stream
        OIT_PostRadarProcessing_RDD_Populate_RDD_Stream_PostRadarProcessing_RDD_Populate_RDD_Stream: RtePositionInTask=0, RteEventRef=OIT_PostRadarProcessing_RDD_Populate_RDD_Stream_PostRadarProcessing_RDD_Populate_RDD_Stream, RteMappedToTaskRef=Appl_Task_Fast, RteUsedOsEventRef=Rte_Ev_Run_SWC_PLT_CDD_Logging_PostRadarProcessing_RDD_Populate_RDD_Stream
        OIT_PostRadarProcessing_Detection_Populate_Detection_Stream_PostRadarProcessing_Detection_Populate_Detection_Stream: RtePositionInTask=2, RteEventRef=OIT_PostRadarProcessing_Detection_Populate_Detection_Stream_PostRadarProcessing_Detection_Populate_Detection_Stream, RteMappedToTaskRef=Appl_Task_Logging, RteUsedOsEventRef=Rte_Ev_Run_SWC_PLT_CDD_Logging_PostRadarProcessing_Detection_Populate_Detection_Stream
        OIT_PostRadarProcessing_Header_Populate_Header_Stream_PostRadarProcessing_Header_Populate_Header_Stream: RtePositionInTask=3, RteEventRef=OIT_PostRadarProcessing_Header_Populate_Header_Stream_PostRadarProcessing_Header_Populate_Header_Stream, RteMappedToTaskRef=Appl_Task_Logging, RteUsedOsEventRef=Rte_Ev_Run_SWC_PLT_CDD_Logging_PostRadarProcessing_Header_Populate_Header_Stream
        OIT_PostRadarProcessing_ADC_Populate_ADC_Stream_PostRadarProcessing_ADC_Populate_ADC_Stream: RtePositionInTask=0, RteEventRef=OIT_PostRadarProcessing_ADC_Populate_ADC_Stream_PostRadarProcessing_ADC_Populate_ADC_Stream, RteMappedToTaskRef=Appl_Task_Logging, RteUsedOsEventRef=Rte_Ev_Run_SWC_PLT_CDD_Logging_PostRadarProcessing_ADC_Populate_ADC_Stream
        OIT_StbM_MeasurementNotification_StbMSynchronizedTimeBase_TimeRecordBlock_Callback_StbM_MeasurementNotification_StbMSync71EECD83: RtePositionInTask=6, RteEventRef=OIT_StbM_MeasurementNotification_StbMSynchronizedTimeBase_TimeRecordBlock_Callback_StbM_MeasurementNotification_StbMSync71EECD83, RteMappedToTaskRef=Appl_Task_Logging, RteUsedOsEventRef=Rte_Ev_Run_SWC_PLT_CDD_Logging_StbM_MeasurementNotification_StbMSynchronizedTimeBase_TimeRecordBlock_Callback
        TMT_RE_Logging_2ms: RtePositionInTask=2, RteEventRef=TMT_RE_Logging_2ms, RteUsedOsEventRef=Rte_Ev_Run_SWC_PLT_CDD_Logging_RE_Logging_2ms, RteUsedOsAlarmRef=Rte_Al_TE_SWC_PLT_CDD_Logging_RE_Logging_2ms, RteMappedToTaskRef=Appl_Task_Fast
    SWC_PLT_CDD_Logging (RteSwComponentType): RteComponentTypeRef=SWC_PLT_CDD_Logging, RteImplementationRef=SWC_PLT_CDD_Logging_Implementation
      ComponentTypeCalibration (RteComponentTypeCalibration): RteCalibrationSupportEnabled=false
    SWC_PLT_CDD_Radar_Control_EcuSwComposition (RteSwComponentInstance): RteSoftwareComponentInstanceRef=SWC_PLT_CDD_Radar_Control
      8 x RteEventToTaskMapping, all with RteImmediateRestart=false:
        RE_Radar_Control_InitEvent: RtePositionInTask=2, RteEventRef=RE_Radar_Control_InitEvent, RteMappedToTaskRef=Appl_Init
        TMT_RE_Radar_Control_50ms: RtePositionInTask=0, RteEventRef=TMT_RE_Radar_Control_50ms, RteMappedToTaskRef=Radar_Ctrl_Task, RteUsedOsEventRef=Rte_Ev_Cyclic_Radar_Ctrl_Task_0_50ms, RteUsedOsAlarmRef=Rte_Al_TE_Radar_Ctrl_Task_0_50ms
        TMT_RE_Radar_Control_10ms: RtePositionInTask=4, RteEventRef=TMT_RE_Radar_Control_10ms, RteMappedToTaskRef=Radar_Ctrl_Task, RteUsedOsEventRef=Rte_Ev_Run_SWC_PLT_CDD_Radar_Control_RE_Radar_Control_10ms, RteUsedOsAlarmRef=Rte_Al_TE_SWC_PLT_CDD_Radar_Control_RE_Radar_Control_10ms
        TMT_RE_Test: RtePositionInTask=6, RteEventRef=TMT_RE_Test, RteMappedToTaskRef=Radar_Ctrl_Task, RteUsedOsEventRef=Rte_Ev_Cyclic_Radar_Ctrl_Task_0_50ms, RteUsedOsAlarmRef=Rte_Al_TE_Radar_Ctrl_Task_0_50ms
        OIT_RE_Radar_Ctl_Look_Trigger_Pp_Radar_Ctl_Look_Trigger_Operation: RtePositionInTask=1, RteEventRef=OIT_RE_Radar_Ctl_Look_Trigger_Pp_Radar_Ctl_Look_Trigger_Operation, RteMappedToTaskRef=Radar_Ctrl_Task, RteUsedOsEventRef=Rte_Ev_Run_SWC_PLT_CDD_Radar_Control_RE_Radar_Ctl_Look_Trigger
        EXTO_RE_Radar_Ctl_Look_Complete_Rp_Radar_Ctl_Look_Complete_Trigger: RtePositionInTask=2, RteEventRef=EXTO_RE_Radar_Ctl_Look_Complete_Rp_Radar_Ctl_Look_Complete_Trigger, RteMappedToTaskRef=Radar_Ctrl_Task, RteUsedOsEventRef=Rte_Ev_Run_SWC_PLT_CDD_Radar_Control_RE_Radar_Ctl_Look_Complete_Rp_Radar_Ctl_Look_Complete_Trigger
        OIT_CS_Radar_control_Fault_Injection_Read_CS_Radar_control_Fault_Injection_Read: RteEventRef=OIT_CS_Radar_control_Fault_Injection_Read_CS_Radar_control_Fault_Injection_Read
        TMT_RE_Radar_Ctl_Look_Complete_Post_RFBIST: RteActivationOffset=0.005, RtePositionInTask=3, RteEventRef=TMT_RE_Radar_Ctl_Look_Complete_Post_RFBIST, RteMappedToTaskRef=Radar_Ctrl_Task, RteUsedOsEventRef=Rte_Ev_Run_SWC_PLT_CDD_Radar_Control_RE_Radar_Ctl_Look_Complete_Post_RFBIST, RteUsedOsAlarmRef=Rte_Al_TE_SWC_PLT_CDD_Radar_Control_RE_Radar_Ctl_Look_Complete_Post_RFBIST
    SWC_PLT_CDD_Radar_Control (RteSwComponentType): RteComponentTypeRef=SWC_PLT_CDD_Radar_Control, RteImplementationRef=SWC_PLT_CDD_Radar_Control_Implementation
      ComponentTypeCalibration (RteComponentTypeCalibration): RteCalibrationSupportEnabled=false
    SWC_PLT_Appl_IoHwAb (RteSwComponentType): RteComponentTypeRef=SWC_PLT_Appl_IoHwAb, RteImplementationRef=SWC_PLT_Appl_IoHwAb_Implementation
      ComponentTypeCalibration (RteComponentTypeCalibration): RteCalibrationSupportEnabled=false
    Xcp (RteBswModuleInstance): RteBswImplementationRef=Xcp_Impl, RteBswModuleConfigurationRef=Xcp
      Xcp_MainFunctionTimingEvent0 (RteBswEventToTaskMapping):
        RteBswImmediateRestart = false
        RteBswPositionInTask = 11
        RteBswEventRef = Xcp_MainFunctionTimingEvent0
        RteBswMappedToTaskRef = BSW_Task
        RteBswUsedOsAlarmRef = Rte_Al_TE2_BSW_Task_0_5ms
        RteBswUsedOsEventRef = Rte_Ev_Cyclic2_BSW_Task_0_5ms
      8 x RteBswExclusiveAreaImpl, all with RteExclusiveAreaImplMechanism=ALL_INTERRUPT_BLOCKING:
        XCP_EXCLUSIVE_AREA_{0..2}: RteBswExclusiveAreaRef=XCP_EXCLUSIVE_AREA_{0..2}
        CANXCP_EXCLUSIVE_AREA_0: RteBswExclusiveAreaRef=CANXCP_EXCLUSIVE_AREA_0
        FRXCP_EXCLUSIVE_AREA_{0..2}: RteBswExclusiveAreaRef=FRXCP_EXCLUSIVE_AREA_{0..2}
        TCPIPXCP_EXCLUSIVE_AREA_0: RteBswExclusiveAreaRef=TCPIPXCP_EXCLUSIVE_AREA_0
      TcpIpXcp_MainFunctionTimingEvent0 (RteBswEventToTaskMapping):
        RteBswImmediateRestart = false
        RteBswPositionInTask = 12
        RteBswEventRef = TcpIpXcp_MainFunctionTimingEvent0
        RteBswMappedToTaskRef = BSW_Task
        RteBswUsedOsAlarmRef = Rte_Al_TE2_BSW_Task_0_5ms
        RteBswUsedOsEventRef = Rte_Ev_Cyclic2_BSW_Task_0_5ms
      CanXcp_MainFunctionTimingEvent0 (RteBswEventToTaskMapping):
        RteBswImmediateRestart = false
        RteBswPositionInTask = 13
        RteBswEventRef = CanXcp_MainFunctionTimingEvent0
        RteBswUsedOsAlarmRef = Rte_Al_TE2_BSW_Task_0_5ms
        RteBswUsedOsEventRef = Rte_Ev_Cyclic2_BSW_Task_0_5ms
        RteBswMappedToTaskRef = BSW_Task
    SWC_PLT_CDD_XCP_EcuSwComposition (RteSwComponentInstance): RteSoftwareComponentInstanceRef=SWC_PLT_CDD_XCP
      5 x RteEventToTaskMapping, all with RteImmediateRestart=false:
        TMT_RE_XCP_10ms: RtePositionInTask=1, RteEventRef=TMT_RE_XCP_10ms, RteMappedToTaskRef=Appl_Task, RteUsedOsEventRef=Rte_Ev_Cyclic_Appl_Task_0_10ms, RteUsedOsAlarmRef=Rte_Al_TE_Appl_Task_0_10ms
        SWC_PLT_CDD_XCP_50ms: RtePositionInTask=2, RteEventRef=SWC_PLT_CDD_XCP_50ms, RteMappedToTaskRef=Appl_Task, RteUsedOsEventRef=Rte_Ev_Cyclic_Appl_Task_0_50ms, RteUsedOsAlarmRef=Rte_Al_TE_Appl_Task_0_50ms
        SWC_PLT_CDD_XCP_InitEvent: RtePositionInTask=0, RteEventRef=SWC_PLT_CDD_XCP_InitEvent, RteMappedToTaskRef=Appl_Init
        OIT_Pp_XCP_Enable_Disable_Status_Pp_XCP_Enable_Disable_Status: RteEventRef=OIT_Pp_XCP_Enable_Disable_Status_Pp_XCP_Enable_Disable_Status
        OIT_CS_PostRadarProcessing_XCP_Event_Trigger_Trigger_Look_Based_XCP_Event_CS_PostRadarProcessing_XCP_Event_Trigger_Trigg5AF17252: RteEventRef=OIT_CS_PostRadarProcessing_XCP_Event_Trigger_Trigger_Look_Based_XCP_Event_CS_PostRadarProcessing_XCP_Event_Trigger_Trigg5AF17252
    SWC_PLT_CDD_XCP (RteSwComponentType): RteComponentTypeRef=SWC_PLT_CDD_XCP, RteImplementationRef=SWC_PLT_CDD_XCP_Implementation
      ComponentTypeCalibration (RteComponentTypeCalibration): RteCalibrationSupportEnabled=false
    StbM (RteBswModuleInstance): RteBswImplementationRef=StbM_Impl, RteBswModuleConfigurationRef=StbM
      StbM_MainFunctionTimingEvent0 (RteBswEventToTaskMapping):
        RteBswImmediateRestart = false
        RteBswPositionInTask = 5
        RteBswEventRef = StbM_MainFunctionTimingEvent0
        RteBswMappedToTaskRef = Appl_Task_High_Prio
        RteBswUsedOsEventRef = Rte_Ev_Cyclic2_Appl_Task_High_Prio_0_10ms
        RteBswUsedOsAlarmRef = Rte_Al_TE2_Appl_Task_High_Prio_0_10ms
      STBM_EXCLUSIVE_AREA_0 (RteBswExclusiveAreaImpl): RteExclusiveAreaImplMechanism=ALL_INTERRUPT_BLOCKING, RteBswExclusiveAreaRef=STBM_EXCLUSIVE_AREA_0
      STBM_EXCLUSIVE_AREA_1 (RteBswExclusiveAreaImpl): RteExclusiveAreaImplMechanism=ALL_INTERRUPT_BLOCKING, RteBswExclusiveAreaRef=STBM_EXCLUSIVE_AREA_1
    StbM_EcuSwComposition (RteSwComponentInstance): RteSoftwareComponentInstanceRef=StbM
      11 x RteEventToTaskMapping, all with RteImmediateRestart=false:
        Timer_StbM_MainFunction: RtePositionInTask=5, RteEventRef=Timer_StbM_MainFunction, RteMappedToTaskRef=Appl_Task_High_Prio, RteUsedOsEventRef=Rte_Ev_Cyclic2_Appl_Task_High_Prio_0_10ms, RteUsedOsAlarmRef=Rte_Al_TE2_Appl_Task_High_Prio_0_10ms
        OpEventGetCurrentTime_GetCurrentTime_GlobalTime_Slave_StbMSynchronizedTimeBase: RteEventRef=OpEventGetCurrentTime_GetCurrentTime_GlobalTime_Slave_StbMSynchronizedTimeBase
        OpEventGetRateDeviation_GetRateDeviation_GlobalTime_Slave_StbMSynchronizedTimeBase: RteEventRef=OpEventGetRateDeviation_GetRateDeviation_GlobalTime_Slave_StbMSynchronizedTimeBase
        OpEventGetTimeLeap_GetTimeLeap_GlobalTime_Slave_StbMSynchronizedTimeBase: RteEventRef=OpEventGetTimeLeap_GetTimeLeap_GlobalTime_Slave_StbMSynchronizedTimeBase
        OpEventGetTimeBaseStatus_GetTimeBaseStatus_GlobalTime_Slave_StbMSynchronizedTimeBase: RteEventRef=OpEventGetTimeBaseStatus_GetTimeBaseStatus_GlobalTime_Slave_StbMSynchronizedTimeBase
        OpEventGetSyncTimeRecordHead_GetSyncTimeRecordHead_GlobalTime_Slave_StbMSynchronizedTimeBase: RteEventRef=OpEventGetSyncTimeRecordHead_GetSyncTimeRecordHead_GlobalTime_Slave_StbMSynchronizedTimeBase
        OpEventGetRateDeviation_GetRateDeviation_GlobalTime_Slave_StbMSynchronizedTimeBase_CanTsync: RteEventRef=OpEventGetRateDeviation_GetRateDeviation_GlobalTime_Slave_StbMSynchronizedTimeBase_CanTsync
        OpEventGetTimeBaseStatus_GetTimeBaseStatus_GlobalTime_Slave_StbMSynchronizedTimeBase_CanTsync: RteEventRef=OpEventGetTimeBaseStatus_GetTimeBaseStatus_GlobalTime_Slave_StbMSynchronizedTimeBase_CanTsync
        OpEventGetTimeLeap_GetTimeLeap_GlobalTime_Slave_StbMSynchronizedTimeBase_CanTsync: RteEventRef=OpEventGetTimeLeap_GetTimeLeap_GlobalTime_Slave_StbMSynchronizedTimeBase_CanTsync
        OpEventGetSyncTimeRecordHead_GetSyncTimeRecordHead_GlobalTime_Slave_StbMSynchronizedTimeBase_CanTsync: RteEventRef=OpEventGetSyncTimeRecordHead_GetSyncTimeRecordHead_GlobalTime_Slave_StbMSynchronizedTimeBase_CanTsync
        OpEventGetCurrentTime_GetCurrentTime_GlobalTime_Slave_StbMSynchronizedTimeBase_CanTsync: RteEventRef=OpEventGetCurrentTime_GetCurrentTime_GlobalTime_Slave_StbMSynchronizedTimeBase_CanTsync
    EthTSyn (RteBswModuleInstance): RteBswImplementationRef=EthTSyn_Impl, RteBswModuleConfigurationRef=EthTSyn
      EthTSyn_MainFunctionTimingEvent0 (RteBswEventToTaskMapping):
        RteBswImmediateRestart = false
        RteBswPositionInTask = 4
        RteBswEventRef = EthTSyn_MainFunctionTimingEvent0
        RteBswMappedToTaskRef = Appl_Task_High_Prio
        RteBswUsedOsEventRef = Rte_Ev_Cyclic2_Appl_Task_High_Prio_0_10ms
        RteBswUsedOsAlarmRef = Rte_Al_TE2_Appl_Task_High_Prio_0_10ms
      5 x RteBswExclusiveAreaImpl, all with RteExclusiveAreaImplMechanism=ALL_INTERRUPT_BLOCKING:
        ETHTSYN_EXCLUSIVE_AREA_RX: RteBswExclusiveAreaRef=ETHTSYN_EXCLUSIVE_AREA_RX
        ETHTSYN_EXCLUSIVE_AREA_TX: RteBswExclusiveAreaRef=ETHTSYN_EXCLUSIVE_AREA_TX
        ETHTSYN_EXCLUSIVE_AREA_LINK_STATE: RteBswExclusiveAreaRef=ETHTSYN_EXCLUSIVE_AREA_LINK_STATE
        ETHTSYN_EXCLUSIVE_AREA_0: RteBswExclusiveAreaRef=ETHTSYN_EXCLUSIVE_AREA_0
        ETHTSYN_EXCLUSIVE_AREA_GET_TS: RteBswExclusiveAreaRef=ETHTSYN_EXCLUSIVE_AREA_GET_TS
    SWC_PLT_CDD_ECUSync_EcuSwComposition (RteSwComponentInstance): RteSoftwareComponentInstanceRef=SWC_PLT_CDD_ECUSync
      SWC_PLT_CDD_ECUSync_InitEvent (RteEventToTaskMapping): RteImmediateRestart=false, RtePositionInTask=16, RteEventRef=SWC_PLT_CDD_ECUSync_InitEvent, RteMappedToTaskRef=Appl_Init
    SWC_PLT_CDD_ECUSync (RteSwComponentType): RteComponentTypeRef=SWC_PLT_CDD_ECUSync, RteImplementationRef=SWC_PLT_CDD_ECUSync_Implementation
      ComponentTypeCalibration (RteComponentTypeCalibration): RteCalibrationSupportEnabled=false
    SWC_PLT_Appl_Communication_EcuSwComposition (RteSwComponentInstance): RteSoftwareComponentInstanceRef=SWC_PLT_Appl_Communication
      9 x RteEventToTaskMapping, all with RteImmediateRestart=false:
        RE_Communication_InitEvent: RtePositionInTask=3, RteEventRef=RE_Communication_InitEvent, RteMappedToTaskRef=Appl_Init
        TMT_RE_Communication_Tx: RtePositionInTask=4, RteEventRef=TMT_RE_Communication_Tx, RteMappedToTaskRef=Appl_Task_Communication, RteUsedOsEventRef=Rte_Ev_Run_SWC_PLT_Appl_Communication_RE_Communication_Tx_50ms, RteUsedOsAlarmRef=Rte_Al_TE_SWC_PLT_Appl_Communication_RE_Communication_Tx_50ms
        TMT_RE_Communication_Rx: RtePositionInTask=5, RteEventRef=TMT_RE_Communication_Rx, RteMappedToTaskRef=Appl_Task_Communication, RteUsedOsEventRef=Rte_Ev_Cyclic_Appl_Task_Communication_0_25ms, RteUsedOsAlarmRef=Rte_Al_TE_Appl_Task_Communication_0_25ms
        OIT_Rp_PCAN_Srv_EnableAppTx_Operation_Rp_PCAN_Srv_EnableAppTx_Operation: RteEventRef=OIT_Rp_PCAN_Srv_EnableAppTx_Operation_Rp_PCAN_Srv_EnableAppTx_Operation
        OIT_Pp_PCAN_Srv_DisableAppTx_Operation_Pp_PCAN_Srv_DisableAppTx_Operation: RteEventRef=OIT_Pp_PCAN_Srv_DisableAppTx_Operation_Pp_PCAN_Srv_DisableAppTx_Operation
        OIT_PostRadarProcessing_CAN_Tx_RE_Communication_Tx_PostRadarProcessing_CAN_Tx_RE_Communication_Tx: RtePositionInTask=3, RteEventRef=OIT_PostRadarProcessing_CAN_Tx_RE_Communication_Tx_PostRadarProcessing_CAN_Tx_RE_Communication_Tx, RteMappedToTaskRef=Appl_Task_Communication, RteUsedOsEventRef=Rte_Ev_Run_SWC_PLT_Appl_Communication_PostRadarProcessing_CAN_Tx_RE_Communication_Tx
        OIT_Pp_VCAN_Srv_DisableAppTx_Operation_Pp_VCAN_Srv_DisableAppTx_Operation: RteEventRef=OIT_Pp_VCAN_Srv_DisableAppTx_Operation_Pp_VCAN_Srv_DisableAppTx_Operation
        OIT_Pp_VCAN_Srv_EnableAppTx_Operation_Pp_VCAN_Srv_EnableAppTx_Operation: RteEventRef=OIT_Pp_VCAN_Srv_EnableAppTx_Operation_Pp_VCAN_Srv_EnableAppTx_Operation
        TMT_RE_Communication_10ms: RtePositionInTask=53, RteEventRef=TMT_RE_Communication_10ms, RteMappedToTaskRef=Appl_Task, RteUsedOsEventRef=Rte_Ev_Cyclic_Appl_Task_0_10ms, RteUsedOsAlarmRef=Rte_Al_TE_Appl_Task_0_10ms
    SWC_PLT_Appl_Communication (RteSwComponentType): RteComponentTypeRef=SWC_PLT_Appl_Communication, RteImplementationRef=SWC_PLT_Appl_Communication_Implementation
      ComponentTypeCalibration (RteComponentTypeCalibration): RteCalibrationSupportEnabled=false
    4 x RteBswModuleInstance:
      Adc: RteBswImplementationRef=Adc_Impl, RteBswModuleConfigurationRef=Adc
        ADC_EXCLUSIVE_AREA_0 (RteBswExclusiveAreaImpl): RteExclusiveAreaImplMechanism=ALL_INTERRUPT_BLOCKING, RteBswExclusiveAreaRef=ADC_EXCLUSIVE_AREA_0
      Eth: RteBswImplementationRef=Eth_Impl, RteBswModuleConfigurationRef=Eth
        ETH_30_WRAPPER_EXCLUSIVE_AREA_MUTEX_ACCESS (RteBswExclusiveAreaImpl): RteExclusiveAreaImplMechanism=ALL_INTERRUPT_BLOCKING, RteBswExclusiveAreaRef=ETH_30_WRAPPER_EXCLUSIVE_AREA_MUTEX_ACCESS
      Gpt: RteBswImplementationRef=Gpt_Impl, RteBswModuleConfigurationRef=Gpt
        GPT_EXCLUSIVE_AREA_0 (RteBswExclusiveAreaImpl): RteExclusiveAreaImplMechanism=ALL_INTERRUPT_BLOCKING, RteBswExclusiveAreaRef=GPT_EXCLUSIVE_AREA_0
      Eth_Indie: RteBswImplementationRef=Eth_Impl, RteBswModuleConfigurationRef=Eth_Indie
        ETH_EXCLUSIVE_AREA_0 (RteBswExclusiveAreaImpl): RteExclusiveAreaImplMechanism=ALL_INTERRUPT_BLOCKING, RteBswExclusiveAreaRef=ETH_EXCLUSIVE_AREA_0
        Eth_MainFunctionTimingEvent0 (RteBswEventToTaskMapping): RteBswImmediateRestart=false, RteBswEventRef=Eth_MainFunctionTimingEvent0
    SWC_PLT_Radar_Alignment_Handler (RteSwComponentType): RteComponentTypeRef=SWC_PLT_Radar_Alignment_Handler, RteImplementationRef=SWC_PLT_Radar_Alignment_Handler_Implementation
      ComponentTypeCalibration (RteComponentTypeCalibration): RteCalibrationSupportEnabled=false
    SWC_PLT_Radar_Alignment_Handler_EcuSwComposition (RteSwComponentInstance): RteSoftwareComponentInstanceRef=SWC_PLT_Radar_Alignment_Handler
      3 x RteEventToTaskMapping, all with RteImmediateRestart=false:
        OIT_CS_Alignment_Fault_Injection_read_CS_Alignment_Fault_Injection_read: RteEventRef=OIT_CS_Alignment_Fault_Injection_read_CS_Alignment_Fault_Injection_read
        SWC_Appl_Alignment_InitEvent: RtePositionInTask=21, RteEventRef=SWC_Appl_Alignment_InitEvent, RteMappedToTaskRef=Appl_Init
        TMT_Runnable: RtePositionInTask=5, RteEventRef=TMT_Runnable, RteMappedToTaskRef=Appl_Task, RteUsedOsEventRef=Rte_Ev_Cyclic_Appl_Task_0_50ms, RteUsedOsAlarmRef=Rte_Al_TE_Appl_Task_0_50ms
    SWC_PLT_Appl_PlatformTime_EcuSwComposition (RteSwComponentInstance): RteSoftwareComponentInstanceRef=SWC_PLT_Appl_PlatformTime
      PlatformTime_ExclusiveArea (RteExclusiveAreaImplementation): RteExclusiveAreaImplMechanism=ALL_INTERRUPT_BLOCKING, RteExclusiveAreaOptimization=false, RteExclusiveAreaRef=PlatformTime_ExclusiveArea
      7 x RteEventToTaskMapping, all with RteImmediateRestart=false:
        OIT_CS_Get_Platform_Elapsed_ustime_read_CS_Get_Platform_Elapsed_ustime_read: RteEventRef=OIT_CS_Get_Platform_Elapsed_ustime_read_CS_Get_Platform_Elapsed_ustime_read
        OIT_CS_PlatformTime_Fault_Injection_Read_CS_PlatformTime_Fault_Injection_Read: RteEventRef=OIT_CS_PlatformTime_Fault_Injection_Read_CS_PlatformTime_Fault_Injection_Read
        OIT_Get_PlatformTime_ms_read_Get_PlatformTime_ms_read: RteEventRef=OIT_Get_PlatformTime_ms_read_Get_PlatformTime_ms_read
        OIT_Get_PlatfromTime_us_read_Get_PlatfromTime_us_read: RteEventRef=OIT_Get_PlatfromTime_us_read_Get_PlatfromTime_us_read
        SWC_PLT_Appl_PlatformTime_InitEvent: RtePositionInTask=5, RteEventRef=SWC_PLT_Appl_PlatformTime_InitEvent, RteMappedToTaskRef=Appl_Init
        TMT_RE_PLT_PlatformTime_50ms: RtePositionInTask=8, RteEventRef=TMT_RE_PLT_PlatformTime_50ms, RteMappedToTaskRef=Appl_Task, RteUsedOsEventRef=Rte_Ev_Cyclic_Appl_Task_0_50ms, RteUsedOsAlarmRef=Rte_Al_TE_Appl_Task_0_50ms
        RE_PLT_PlatformTime_InitEvent: RtePositionInTask=4, RteEventRef=RE_PLT_PlatformTime_InitEvent, RteMappedToTaskRef=Appl_Init
    SWC_PLT_Appl_PlatformTime (RteSwComponentType): RteComponentTypeRef=SWC_PLT_Appl_PlatformTime, RteImplementationRef=SWC_PLT_Appl_PlatformTime_Implementation
      ComponentTypeCalibration (RteComponentTypeCalibration): RteCalibrationSupportEnabled=false
    Rtm (RteBswModuleInstance): RteBswImplementationRef=Rtm_Impl, RteBswModuleConfigurationRef=Rtm
      Rtm_MainFunctionTimingEvent0 (RteBswEventToTaskMapping):
        RteBswImmediateRestart = false
        RteBswPositionInTask = 5
        RteBswEventRef = Rtm_MainFunctionTimingEvent0
        RteBswMappedToTaskRef = Radar_Ctrl_Task
        RteBswUsedOsEventRef = Rte_Ev_Run_Rtm_Rtm_MainFunction
        RteBswUsedOsAlarmRef = Rte_Al_TE_Rtm_Rtm_MainFunction
      3 x RteBswExclusiveAreaImpl, all with RteExclusiveAreaImplMechanism=ALL_INTERRUPT_BLOCKING:
        RTM_EXCLUSIVE_AREA_{0..2}: RteBswExclusiveAreaRef=RTM_EXCLUSIVE_AREA_{0..2}
    SWC_PLT_Appl_RTM_EcuSwComposition (RteSwComponentInstance): RteSoftwareComponentInstanceRef=SWC_PLT_Appl_RTM
      3 x RteEventToTaskMapping, all with RteImmediateRestart=false:
        SWC_PLT_Appl_RTM_InitEvent: RtePositionInTask=18, RteEventRef=SWC_PLT_Appl_RTM_InitEvent, RteMappedToTaskRef=Appl_Init
        TMT_RE_RTM_Main_50ms: RtePositionInTask=9, RteEventRef=TMT_RE_RTM_Main_50ms, RteMappedToTaskRef=Appl_Task, RteUsedOsEventRef=Rte_Ev_Cyclic_Appl_Task_0_50ms, RteUsedOsAlarmRef=Rte_Al_TE_Appl_Task_0_50ms
        OIT_CS_Rtm_task_measurement_Operation_CS_Rtm_task_measurement_Operation: RteEventRef=OIT_CS_Rtm_task_measurement_Operation_CS_Rtm_task_measurement_Operation
    7 x RteSwComponentType:
      SWC_PLT_Appl_RTM: RteComponentTypeRef=SWC_PLT_Appl_RTM, RteImplementationRef=SWC_PLT_Appl_RTM_Implementation
        ComponentTypeCalibration (RteComponentTypeCalibration): RteCalibrationSupportEnabled=false
      SWC_CDD_IPC: RteComponentTypeRef=SWC_CDD_IPC, RteImplementationRef=SWC_CDD_IPC_Implementation
        ComponentTypeCalibration (RteComponentTypeCalibration): RteCalibrationSupportEnabled=false
      SWC_PLT_Appl_Diag: RteComponentTypeRef=SWC_PLT_Appl_Diag, RteImplementationRef=SWC_PLT_Appl_Diag_Implementation
        ComponentTypeCalibration (RteComponentTypeCalibration): RteCalibrationSupportEnabled=false
      SWC_PLT_Appl_FaultMgr: RteComponentTypeRef=SWC_PLT_Appl_FaultMgr, RteImplementationRef=SWC_PLT_Appl_FaultMgr_Implementation
        ComponentTypeCalibration (RteComponentTypeCalibration): RteCalibrationSupportEnabled=false
      SWC_PLT_Appl_ModeManager: RteComponentTypeRef=SWC_PLT_Appl_ModeManager, RteImplementationRef=SWC_PLT_Appl_ModeManager_Implementation
        ComponentTypeCalibration (RteComponentTypeCalibration): RteCalibrationSupportEnabled=false
      SWC_PLT_CDD_FailSafe: RteComponentTypeRef=SWC_PLT_CDD_FailSafe, RteImplementationRef=SWC_PLT_CDD_FailSafe_Implementation
        ComponentTypeCalibration (RteComponentTypeCalibration): RteCalibrationSupportEnabled=false
      SWC_PLT_CDD_MCU_Safety: RteComponentTypeRef=SWC_PLT_CDD_MCU_Safety, RteImplementationRef=SWC_PLT_CDD_MCU_Safety_Implementation
        ComponentTypeCalibration (RteComponentTypeCalibration): RteCalibrationSupportEnabled=false
    8 x RteSwComponentInstance:
      SWC_CDD_IPC_EcuSwComposition: RteSoftwareComponentInstanceRef=SWC_CDD_IPC
        4 x RteEventToTaskMapping, all with RteImmediateRestart=false:
          OIT_CS_IPC_Fault_Injection_Read_CS_IPC_Fault_Injection_Read: RteEventRef=OIT_CS_IPC_Fault_Injection_Read_CS_IPC_Fault_Injection_Read
          TMT_RE_IPC_Rx_50ms: RtePositionInTask=0, RteEventRef=TMT_RE_IPC_Rx_50ms, RteMappedToTaskRef=Appl_IPC_Task, RteUsedOsEventRef=Rte_Ev_Cyclic_Appl_IPC_Task_0_50ms, RteUsedOsAlarmRef=Rte_Al_TE_Appl_IPC_Task_0_50ms
          TMT_RE_IPC_Trigger_50ms: RtePositionInTask=1, RteEventRef=TMT_RE_IPC_Trigger_50ms, RteMappedToTaskRef=Appl_IPC_Task, RteUsedOsEventRef=Rte_Ev_Cyclic_Appl_IPC_Task_0_50ms, RteUsedOsAlarmRef=Rte_Al_TE_Appl_IPC_Task_0_50ms
          TMT_RE_IPC_Tx_50ms: RtePositionInTask=2, RteEventRef=TMT_RE_IPC_Tx_50ms, RteMappedToTaskRef=Appl_IPC_Task, RteUsedOsEventRef=Rte_Ev_Cyclic_Appl_IPC_Task_0_50ms, RteUsedOsAlarmRef=Rte_Al_TE_Appl_IPC_Task_0_50ms
        ITP_RE_IPC_Trigger_50ms (RteInternalTriggerConfig): RteTriggerSourceQueueLength=0, RteSwcTriggerSourceRef=ITP_RE_IPC_Trigger_50ms
        ITP_RE_IPC_Trigger_50ms_Dsp_sp_post_processing_complete (RteInternalTriggerConfig): RteTriggerSourceQueueLength=0, RteSwcTriggerSourceRef=ITP_RE_IPC_Trigger_50ms_Dsp_sp_post_processing_complete
        3 x RteEventToTaskMapping, all with RteImmediateRestart=false:
          ITOE_Dsp_sp_post_processing_complete_ITP_RE_IPC_Trigger_50ms_Dsp_sp_post_processing_complete: RtePositionInTask=3, RteEventRef=ITOE_Dsp_sp_post_processing_complete_ITP_RE_IPC_Trigger_50ms_Dsp_sp_post_processing_complete, RteUsedOsEventRef=Rte_Ev_Run_SWC_CDD_IPC_Dsp_sp_post_processing_complete, RteMappedToTaskRef=Appl_IPC_Task
          RE_CDD_IPC_InitEvent: RtePositionInTask=22, RteEventRef=RE_CDD_IPC_InitEvent, RteMappedToTaskRef=Appl_Init
          TMT_RE_IPC_VSE_Handler_10ms: RtePositionInTask=4, RteEventRef=TMT_RE_IPC_VSE_Handler_10ms, RteUsedOsEventRef=Rte_Ev_Run_SWC_CDD_IPC_RE_IPC_VSE_Handler_10ms, RteUsedOsAlarmRef=Rte_Al_TE_SWC_CDD_IPC_RE_IPC_VSE_Handler_10ms, RteMappedToTaskRef=Appl_IPC_Task
      SWC_PLT_Appl_Diag_EcuSwComposition: RteSoftwareComponentInstanceRef=SWC_PLT_Appl_Diag
        ExclusiveArea (RteExclusiveAreaImplementation): RteExclusiveAreaImplMechanism=ALL_INTERRUPT_BLOCKING, RteExclusiveAreaRef=ExclusiveArea
        13 x RteEventToTaskMapping, all with RteImmediateRestart=false:
          TMT_RE_PLT_Diag_Alignment_Diagnostics_50ms: RtePositionInTask=30, RteEventRef=TMT_RE_PLT_Diag_Alignment_Diagnostics_50ms, RteMappedToTaskRef=Appl_Task, RteUsedOsEventRef=Rte_Ev_Cyclic_Appl_Task_0_50ms, RteUsedOsAlarmRef=Rte_Al_TE_Appl_Task_0_50ms
          TMT_RE_Validation_Battery_Fault_Tests: RtePositionInTask=21, RteEventRef=TMT_RE_Validation_Battery_Fault_Tests, RteMappedToTaskRef=Appl_Task, RteUsedOsEventRef=Rte_Ev_Cyclic_Appl_Task_0_50ms, RteUsedOsAlarmRef=Rte_Al_TE_Appl_Task_0_50ms
          TMT_RE_Platform_Can_Bus_Off_Fault_Test: RtePositionInTask=22, RteEventRef=TMT_RE_Platform_Can_Bus_Off_Fault_Test, RteMappedToTaskRef=Appl_Task, RteUsedOsEventRef=Rte_Ev_Cyclic_Appl_Task_0_50ms, RteUsedOsAlarmRef=Rte_Al_TE_Appl_Task_0_50ms
          TMT_RE_Validation_Host_Microcontroller_Tests: RtePositionInTask=23, RteEventRef=TMT_RE_Validation_Host_Microcontroller_Tests, RteMappedToTaskRef=Appl_Task, RteUsedOsEventRef=Rte_Ev_Cyclic_Appl_Task_0_50ms, RteUsedOsAlarmRef=Rte_Al_TE_Appl_Task_0_50ms
          SWC_PLT_Appl_Diag_InitEvent: RtePositionInTask=12, RteEventRef=SWC_PLT_Appl_Diag_InitEvent, RteMappedToTaskRef=Appl_Init
          TMT_RE_Validation_Inter_Processor_Communication_Diagnostics: RtePositionInTask=24, RteEventRef=TMT_RE_Validation_Inter_Processor_Communication_Diagnostics, RteMappedToTaskRef=Appl_Task, RteUsedOsEventRef=Rte_Ev_Cyclic_Appl_Task_0_50ms, RteUsedOsAlarmRef=Rte_Al_TE_Appl_Task_0_50ms
          TMT_RE_Validation_Memory_Diagnostics: RtePositionInTask=25, RteEventRef=TMT_RE_Validation_Memory_Diagnostics, RteMappedToTaskRef=Appl_Task, RteUsedOsEventRef=Rte_Ev_Cyclic_Appl_Task_0_50ms, RteUsedOsAlarmRef=Rte_Al_TE_Appl_Task_0_50ms
          TMT_RE_Validation_Microprocessor_Temp_Tests: RtePositionInTask=26, RteEventRef=TMT_RE_Validation_Microprocessor_Temp_Tests, RteMappedToTaskRef=Appl_Task, RteUsedOsEventRef=Rte_Ev_Cyclic_Appl_Task_0_50ms, RteUsedOsAlarmRef=Rte_Al_TE_Appl_Task_0_50ms
          TMT_RE_PLT_Diag_PlatformTime_Diagnostics_50ms: RtePositionInTask=0, RteEventRef=TMT_RE_PLT_Diag_PlatformTime_Diagnostics_50ms, RteMappedToTaskRef=Appl_Task_High_Prio, RteUsedOsEventRef=Rte_Ev_Run_SWC_PLT_Appl_Diag_RE_PLT_Diag_PlatformTime_50ms, RteUsedOsAlarmRef=Rte_Al_TE_SWC_PLT_Appl_Diag_RE_PLT_Diag_PlatformTime_50ms
          TMT_RE_Validation_Radar_Blockage_Detection_Test: RtePositionInTask=27, RteEventRef=TMT_RE_Validation_Radar_Blockage_Detection_Test, RteMappedToTaskRef=Appl_Task, RteUsedOsEventRef=Rte_Ev_Cyclic_Appl_Task_0_50ms, RteUsedOsAlarmRef=Rte_Al_TE_Appl_Task_0_50ms
          TMT_RE_Validation_Radar_Hardware_Tests: RtePositionInTask=28, RteEventRef=TMT_RE_Validation_Radar_Hardware_Tests, RteMappedToTaskRef=Appl_Task, RteUsedOsEventRef=Rte_Ev_Cyclic_Appl_Task_0_50ms, RteUsedOsAlarmRef=Rte_Al_TE_Appl_Task_0_50ms
          TMT_RE_Validation_Dolphin_Chip_Diagnostics: RtePositionInTask=29, RteEventRef=TMT_RE_Validation_Dolphin_Chip_Diagnostics, RteMappedToTaskRef=Appl_Task, RteUsedOsEventRef=Rte_Ev_Cyclic_Appl_Task_0_50ms, RteUsedOsAlarmRef=Rte_Al_TE_Appl_Task_0_50ms
          OIT_CS_Diag_Fault_Injection_Read_CS_Diag_Fault_Injection_Read: RteEventRef=OIT_CS_Diag_Fault_Injection_Read_CS_Diag_Fault_Injection_Read
      SWC_PLT_Appl_FaultMgr_EcuSwComposition: RteSoftwareComponentInstanceRef=SWC_PLT_Appl_FaultMgr
        15 x RteEventToTaskMapping, all with RteImmediateRestart=false:
          TMT_RE_Alignment_Diagnostics_50ms: RtePositionInTask=31, RteEventRef=TMT_RE_Alignment_Diagnostics_50ms, RteMappedToTaskRef=Appl_Task, RteUsedOsEventRef=Rte_Ev_Cyclic_Appl_Task_0_50ms, RteUsedOsAlarmRef=Rte_Al_TE_Appl_Task_0_50ms
          TMT_RE_Fault_Mgr_Battery_Fault_Tests: RtePositionInTask=32, RteEventRef=TMT_RE_Fault_Mgr_Battery_Fault_Tests, RteMappedToTaskRef=Appl_Task, RteUsedOsEventRef=Rte_Ev_Cyclic_Appl_Task_0_50ms, RteUsedOsAlarmRef=Rte_Al_TE_Appl_Task_0_50ms
          TMT_RE_Fault_Mgr_Can_Bus_Off_Fault_Test: RtePositionInTask=33, RteEventRef=TMT_RE_Fault_Mgr_Can_Bus_Off_Fault_Test, RteMappedToTaskRef=Appl_Task, RteUsedOsEventRef=Rte_Ev_Cyclic_Appl_Task_0_50ms, RteUsedOsAlarmRef=Rte_Al_TE_Appl_Task_0_50ms
          TMT_RE_General_Diagnostics_50ms: RtePositionInTask=44, RteEventRef=TMT_RE_General_Diagnostics_50ms, RteMappedToTaskRef=Appl_Task, RteUsedOsEventRef=Rte_Ev_Cyclic_Appl_Task_0_50ms, RteUsedOsAlarmRef=Rte_Al_TE_Appl_Task_0_50ms
          TMT_RE_Fault_Mgr_Host_Microcontroller_Tests: RtePositionInTask=34, RteEventRef=TMT_RE_Fault_Mgr_Host_Microcontroller_Tests, RteMappedToTaskRef=Appl_Task, RteUsedOsEventRef=Rte_Ev_Cyclic_Appl_Task_0_50ms, RteUsedOsAlarmRef=Rte_Al_TE_Appl_Task_0_50ms
          SWC_Appl_Diag_InitEvent: RtePositionInTask=13, RteEventRef=SWC_Appl_Diag_InitEvent, RteMappedToTaskRef=Appl_Init
          TMT_RE_Fault_Mgr_Interprocessor_Comm: RtePositionInTask=35, RteEventRef=TMT_RE_Fault_Mgr_Interprocessor_Comm, RteMappedToTaskRef=Appl_Task, RteUsedOsEventRef=Rte_Ev_Cyclic_Appl_Task_0_50ms, RteUsedOsAlarmRef=Rte_Al_TE_Appl_Task_0_50ms
          TMT_RE_FaultMgr_Main_10ms: RtePositionInTask=17, RteEventRef=TMT_RE_FaultMgr_Main_10ms, RteMappedToTaskRef=Appl_Task, RteUsedOsEventRef=Rte_Ev_Cyclic_Appl_Task_0_10ms, RteUsedOsAlarmRef=Rte_Al_TE_Appl_Task_0_10ms
          TMT_RE_Diag_Main_50ms: RtePositionInTask=19, RteEventRef=TMT_RE_Diag_Main_50ms, RteMappedToTaskRef=Appl_Task, RteUsedOsEventRef=Rte_Ev_Cyclic_Appl_Task_0_50ms, RteUsedOsAlarmRef=Rte_Al_TE_Appl_Task_0_50ms
          TMT_RE_Fault_Mgr_Memory_Diagnostics: RtePositionInTask=36, RteEventRef=TMT_RE_Fault_Mgr_Memory_Diagnostics, RteMappedToTaskRef=Appl_Task, RteUsedOsEventRef=Rte_Ev_Cyclic_Appl_Task_0_50ms, RteUsedOsAlarmRef=Rte_Al_TE_Appl_Task_0_50ms
          TMT_RE_Fault_Mgr_Microprocessor_Temp_Tests: RtePositionInTask=37, RteEventRef=TMT_RE_Fault_Mgr_Microprocessor_Temp_Tests, RteMappedToTaskRef=Appl_Task, RteUsedOsEventRef=Rte_Ev_Cyclic_Appl_Task_0_50ms, RteUsedOsAlarmRef=Rte_Al_TE_Appl_Task_0_50ms
          TMT_RE_Fault_Mgr_Radar_Blockage_Detection_Test: RtePositionInTask=38, RteEventRef=TMT_RE_Fault_Mgr_Radar_Blockage_Detection_Test, RteMappedToTaskRef=Appl_Task, RteUsedOsEventRef=Rte_Ev_Cyclic_Appl_Task_0_50ms, RteUsedOsAlarmRef=Rte_Al_TE_Appl_Task_0_50ms
          TMT_RE_Fault_Mgr_Radar_Hardware_Tests: RtePositionInTask=41, RteEventRef=TMT_RE_Fault_Mgr_Radar_Hardware_Tests, RteMappedToTaskRef=Appl_Task, RteUsedOsEventRef=Rte_Ev_Cyclic_Appl_Task_0_50ms, RteUsedOsAlarmRef=Rte_Al_TE_Appl_Task_0_50ms
          TMT_RE_Fault_Mgr_Dolphin_Chip_Diagnostics: RtePositionInTask=42, RteEventRef=TMT_RE_Fault_Mgr_Dolphin_Chip_Diagnostics, RteMappedToTaskRef=Appl_Task, RteUsedOsEventRef=Rte_Ev_Cyclic_Appl_Task_0_50ms, RteUsedOsAlarmRef=Rte_Al_TE_Appl_Task_0_50ms
          TMT_RE_Watchdog_Diagnostics_50ms: RtePositionInTask=43, RteEventRef=TMT_RE_Watchdog_Diagnostics_50ms, RteMappedToTaskRef=Appl_Task, RteUsedOsEventRef=Rte_Ev_Cyclic_Appl_Task_0_50ms, RteUsedOsAlarmRef=Rte_Al_TE_Appl_Task_0_50ms
      SWC_PLT_Appl_ModeManager_EcuSwComposition: RteSoftwareComponentInstanceRef=SWC_PLT_Appl_ModeManager
        4 x RteEventToTaskMapping, all with RteImmediateRestart=false:
          SWC_PLT_Appl_ModeManager_InitEvent: RtePositionInTask=15, RteEventRef=SWC_PLT_Appl_ModeManager_InitEvent, RteMappedToTaskRef=Appl_Init
          TMT_RE_Platform_ModeManager_Main_50ms: RtePositionInTask=45, RteEventRef=TMT_RE_Platform_ModeManager_Main_50ms, RteMappedToTaskRef=Appl_Task, RteUsedOsEventRef=Rte_Ev_Cyclic_Appl_Task_0_50ms, RteUsedOsAlarmRef=Rte_Al_TE_Appl_Task_0_50ms
          TMT_RE_Platform_ModeManagerStateMachine_5ms: RtePositionInTask=14, RteEventRef=TMT_RE_Platform_ModeManagerStateMachine_5ms, RteMappedToTaskRef=Appl_Task, RteUsedOsEventRef=Rte_Ev_Cyclic_Appl_Task_0_5ms, RteUsedOsAlarmRef=Rte_Al_TE_Appl_Task_0_5ms
          OIT_CS_Modemanager_Fault_Injection_Read_CS_Modemanager_Fault_Injection_Read: RteEventRef=OIT_CS_Modemanager_Fault_Injection_Read_CS_Modemanager_Fault_Injection_Read
      SWC_PLT_CDD_FailSafe_EcuSwComposition: RteSoftwareComponentInstanceRef=SWC_PLT_CDD_FailSafe
        6 x RteEventToTaskMapping, all with RteImmediateRestart=false:
          OIT_CS_FailSafe_Fault_Injection_Read_CS_FailSafe_Fault_Injection_Read: RteEventRef=OIT_CS_FailSafe_Fault_Injection_Read_CS_FailSafe_Fault_Injection_Read
          OIT_FailSafe_Log_ResetReason_FailSafe_Log_ResetReason_FailSafe_Log_ResetReason_FailSafe_Log_ResetReason: RteEventRef=OIT_FailSafe_Log_ResetReason_FailSafe_Log_ResetReason_FailSafe_Log_ResetReason_FailSafe_Log_ResetReason
          SWC_PLT_CDD_FailSafe_InitEvent: RtePositionInTask=7, RteEventRef=SWC_PLT_CDD_FailSafe_InitEvent, RteMappedToTaskRef=Appl_Init
          TMT_RE_FailSafe_Main_50ms: RtePositionInTask=39, RteEventRef=TMT_RE_FailSafe_Main_50ms, RteMappedToTaskRef=Appl_Task, RteUsedOsEventRef=Rte_Ev_Cyclic_Appl_Task_0_50ms, RteUsedOsAlarmRef=Rte_Al_TE_Appl_Task_0_50ms
          OIT_CS_Failsafe_Log_ResetReason_at_Startup_CS_Failsafe_Log_ResetReason_at_Startup_fcru_reset_reason: RteEventRef=OIT_CS_Failsafe_Log_ResetReason_at_Startup_CS_Failsafe_Log_ResetReason_at_Startup_fcru_reset_reason
          OIT_CS_Get_RepetativeReset_Faultnum_Operation_CS_Get_RepetativeReset_Faultnum_Operation: RteEventRef=OIT_CS_Get_RepetativeReset_Faultnum_Operation_CS_Get_RepetativeReset_Faultnum_Operation
      SWC_PLT_CDD_MCU_Safety_EcuSwComposition: RteSoftwareComponentInstanceRef=SWC_PLT_CDD_MCU_Safety
        10 x RteEventToTaskMapping, all with RteImmediateRestart=false:
          OIT_CS_MCU_Safety_Fault_Injection_Read_CS_MCU_Safety_Fault_Injection_Read: RteEventRef=OIT_CS_MCU_Safety_Fault_Injection_Read_CS_MCU_Safety_Fault_Injection_Read
          OIT_Pi_PltRRUFS_SafetyReq_Status_ECC_CacheMemory_SafetyCore_Disable_Pi_PltRRUFS_SafetyReq_Status_ECC_CacheMemory_SafetyCA86BA9B6: RteEventRef=OIT_Pi_PltRRUFS_SafetyReq_Status_ECC_CacheMemory_SafetyCore_Disable_Pi_PltRRUFS_SafetyReq_Status_ECC_CacheMemory_SafetyCA86BA9B6
          OIT_Pi_PltRRUFS_SafetyReq_Status_ECC_CacheMemory_SafetyCore_Enable_Pi_PltRRUFS_SafetyReq_Status_ECC_CacheMemory_SafetyCo27762F73: RteEventRef=OIT_Pi_PltRRUFS_SafetyReq_Status_ECC_CacheMemory_SafetyCore_Enable_Pi_PltRRUFS_SafetyReq_Status_ECC_CacheMemory_SafetyCo27762F73
          OIT_Pi_PltRRUFS_SafetyReq_Status_ECC_CacheMemory_SafetyCore_Status_Pi_PltRRUFS_SafetyReq_Status_ECC_CacheMemory_SafetyCoAEF3F286: RteEventRef=OIT_Pi_PltRRUFS_SafetyReq_Status_ECC_CacheMemory_SafetyCore_Status_Pi_PltRRUFS_SafetyReq_Status_ECC_CacheMemory_SafetyCoAEF3F286
          OIT_Pi_PltRRUFS_SafetyReq_Status_ECC_FlashMemory_Fault_Report_Check_Pi_PltRRUFS_SafetyReq_Status_ECC_FlashMemory_Fault_R4B6A5298: RteEventRef=OIT_Pi_PltRRUFS_SafetyReq_Status_ECC_FlashMemory_Fault_Report_Check_Pi_PltRRUFS_SafetyReq_Status_ECC_FlashMemory_Fault_R4B6A5298
          OIT_Pp_ECU_Reset_ECU_Soft_Reset_Pp_ECU_Reset_ECU_Soft_Reset: RteEventRef=OIT_Pp_ECU_Reset_ECU_Soft_Reset_Pp_ECU_Reset_ECU_Soft_Reset
          OIT_Pi_PltRRUFS_SafetyReq_Status_RCCU_CheckerCore_Status_Pi_PltRRUFS_SafetyReq_Status_RCCU_CheckerCore_Status: RteEventRef=OIT_Pi_PltRRUFS_SafetyReq_Status_RCCU_CheckerCore_Status_Pi_PltRRUFS_SafetyReq_Status_RCCU_CheckerCore_Status
          TMT_RE_PLT_MCU_Safety_50ms: RtePositionInTask=47, RteEventRef=TMT_RE_PLT_MCU_Safety_50ms, RteMappedToTaskRef=Appl_Task, RteUsedOsEventRef=Rte_Ev_Cyclic_Appl_Task_0_50ms, RteUsedOsAlarmRef=Rte_Al_TE_Appl_Task_0_50ms
          SWC_PLT_CDD_RRU_FuncSafety_InitEvent: RtePositionInTask=11, RteEventRef=SWC_PLT_CDD_RRU_FuncSafety_InitEvent, RteMappedToTaskRef=Appl_Init
          OIT_Pi_PltRRUFS_SafetyReq_Status_RRU_FS_InitTest_Pi_PltRRUFS_SafetyReq_Status_RRU_FS_InitTest: RteEventRef=OIT_Pi_PltRRUFS_SafetyReq_Status_RRU_FS_InitTest_Pi_PltRRUFS_SafetyReq_Status_RRU_FS_InitTest
      SWC_PLT_Appl_IoHwAb_001_EcuSwComposition: RteSoftwareComponentInstanceRef=SWC_PLT_Appl_IoHwAb
        6 x RteEventToTaskMapping, all with RteImmediateRestart=false:
          OIT_CS_Platform_register_set_Operation_CS_Platform_register_set_Operation: RteEventRef=OIT_CS_Platform_register_set_Operation_CS_Platform_register_set_Operation
          OIT_CS_ThermMonTemp_Read_CS_ThermMonTemp_Read: RteEventRef=OIT_CS_ThermMonTemp_Read_CS_ThermMonTemp_Read
          SWC_PLT_Appl_IoHwAb_InitEvent: RtePositionInTask=8, RteEventRef=SWC_PLT_Appl_IoHwAb_InitEvent, RteMappedToTaskRef=Appl_Init
          TMT_RE_IoHwAb_Main_50ms: RtePositionInTask=18, RteEventRef=TMT_RE_IoHwAb_Main_50ms, RteMappedToTaskRef=Appl_Task, RteUsedOsEventRef=Rte_Ev_Cyclic_Appl_Task_0_50ms, RteUsedOsAlarmRef=Rte_Al_TE_Appl_Task_0_50ms
          TMT_RE_IoHwAb_Main_5ms: RtePositionInTask=12, RteEventRef=TMT_RE_IoHwAb_Main_5ms, RteMappedToTaskRef=Appl_Task, RteUsedOsEventRef=Rte_Ev_Cyclic_Appl_Task_0_5ms, RteUsedOsAlarmRef=Rte_Al_TE_Appl_Task_0_5ms
          TMT_RE_PLT_IoHwAb_Main_10ms: RtePositionInTask=13, RteEventRef=TMT_RE_PLT_IoHwAb_Main_10ms, RteMappedToTaskRef=Appl_Task, RteUsedOsEventRef=Rte_Ev_Cyclic_Appl_Task_0_10ms, RteUsedOsAlarmRef=Rte_Al_TE_Appl_Task_0_10ms
      SWC_PLT_Service_IoHwAb_EcuSwComposition: RteSoftwareComponentInstanceRef=SWC_PLT_Service_IoHwAb
        9 x RteEventToTaskMapping, all with RteImmediateRestart=false:
          OIT_CS_RawAdcCount_ADC_Count_Read_CS_RawAdcCount_ADC_Count_Read: RteEventRef=OIT_CS_RawAdcCount_ADC_Count_Read_CS_RawAdcCount_ADC_Count_Read
          OIT_CS_Thermal_Mon_Temps_Read_CS_Thermal_Mon_Temps_Read: RteEventRef=OIT_CS_Thermal_Mon_Temps_Read_CS_Thermal_Mon_Temps_Read
          OIT_Pi_Get_FloatingPinPosition_FaultStatus_Pi_Get_FloatingPinPosition_FaultStatus: RteEventRef=OIT_Pi_Get_FloatingPinPosition_FaultStatus_Pi_Get_FloatingPinPosition_FaultStatus
          OIT_Pp_Get_STM_TimeStamp_Get_STM_TimeStamp_Pp_Get_STM_TimeStamp_Get_STM_TimeStamp: RteEventRef=OIT_Pp_Get_STM_TimeStamp_Get_STM_TimeStamp_Pp_Get_STM_TimeStamp_Get_STM_TimeStamp
          OIT_Pp_PWMDutyCycle_PWMDutyCycle_Pp_PWMDutyCycle_PWMDutyCycle: RteEventRef=OIT_Pp_PWMDutyCycle_PWMDutyCycle_Pp_PWMDutyCycle_PWMDutyCycle
          TMT_RE_Service_IoHwAb_ADCFilter_5ms: RtePositionInTask=11, RteEventRef=TMT_RE_Service_IoHwAb_ADCFilter_5ms, RteMappedToTaskRef=Appl_Task, RteUsedOsEventRef=Rte_Ev_Cyclic_Appl_Task_0_5ms, RteUsedOsAlarmRef=Rte_Al_TE_Appl_Task_0_5ms
          SWC_PLT_Service_IoHwAb_InitEvent: RtePositionInTask=6, RteEventRef=SWC_PLT_Service_IoHwAb_InitEvent, RteMappedToTaskRef=Appl_Init
          TMT_RE_Service_IoHwAb_Main_5ms: RtePositionInTask=10, RteEventRef=TMT_RE_Service_IoHwAb_Main_5ms, RteMappedToTaskRef=Appl_Task, RteUsedOsEventRef=Rte_Ev_Cyclic_Appl_Task_0_5ms, RteUsedOsAlarmRef=Rte_Al_TE_Appl_Task_0_5ms
          OIT_Pp_Set_DIO_LED_SRC_PULL_Write_Pp_Set_DIO_LED_SRC_PULL_Write: RteEventRef=OIT_Pp_Set_DIO_LED_SRC_PULL_Write_Pp_Set_DIO_LED_SRC_PULL_Write
    Fee (RteBswModuleInstance): RteBswImplementationRef=Fee_Impl, RteBswModuleConfigurationRef=Fee
      Fee_30_FlexNor_MainFunctionTimingEvent0 (RteBswEventToTaskMapping):
        RteBswImmediateRestart = false
        RteBswPositionInTask = 2
        RteBswEventRef = Fee_30_FlexNor_MainFunctionTimingEvent0
        RteBswMappedToTaskRef = Appl_BackgroundTask
        RteBswUsedOsAlarmRef = Rte_Al_TE2_Appl_BackgroundTask_0_5ms
        RteBswUsedOsEventRef = Rte_Ev_Cyclic2_Appl_BackgroundTask_0_5ms
    NvM (RteBswModuleInstance): RteBswImplementationRef=NvM_Impl, RteBswModuleConfigurationRef=NvM
      NvM_MainFunctionTimingEvent0 (RteBswEventToTaskMapping):
        RteBswImmediateRestart = false
        RteBswPositionInTask = 1
        RteBswEventRef = NvM_MainFunctionTimingEvent0
        RteBswMappedToTaskRef = Appl_BackgroundTask
        RteBswUsedOsAlarmRef = Rte_Al_TE2_Appl_BackgroundTask_0_5ms
        RteBswUsedOsEventRef = Rte_Ev_Cyclic2_Appl_BackgroundTask_0_5ms
      NVM_EXCLUSIVE_AREA_0 (RteBswExclusiveAreaImpl): RteExclusiveAreaImplMechanism=ALL_INTERRUPT_BLOCKING, RteBswExclusiveAreaRef=NVM_EXCLUSIVE_AREA_0
    NvM_EcuSwComposition (RteSwComponentInstance): RteSoftwareComponentInstanceRef=NvM
      97 x RteEventToTaskMapping, all with RteImmediateRestart=false:
        Timer_NvM_MainFunction: RtePositionInTask=1, RteEventRef=Timer_NvM_MainFunction, RteMappedToTaskRef=Appl_BackgroundTask, RteUsedOsAlarmRef=Rte_Al_TE2_Appl_BackgroundTask_0_5ms, RteUsedOsEventRef=Rte_Ev_Cyclic2_Appl_BackgroundTask_0_5ms
        OpEventGetErrorStatus_GetErrorStatus_PS_NvMConfigBlock: RteEventRef=OpEventGetErrorStatus_GetErrorStatus_PS_NvMConfigBlock
        OpEventSetRamBlockStatus_SetRamBlockStatus_PS_NvMConfigBlock: RteEventRef=OpEventSetRamBlockStatus_SetRamBlockStatus_PS_NvMConfigBlock
        OpEventReadBlock_ReadBlock_PS_NvMConfigBlock: RteEventRef=OpEventReadBlock_ReadBlock_PS_NvMConfigBlock
        OpEventWriteBlock_WriteBlock_PS_NvMConfigBlock: RteEventRef=OpEventWriteBlock_WriteBlock_PS_NvMConfigBlock
        OpEventRestoreBlockDefaults_RestoreBlockDefaults_PS_NvMConfigBlock: RteEventRef=OpEventRestoreBlockDefaults_RestoreBlockDefaults_PS_NvMConfigBlock
        OpEventInvalidateNvBlock_InvalidateNvBlock_PS_NvMConfigBlock: RteEventRef=OpEventInvalidateNvBlock_InvalidateNvBlock_PS_NvMConfigBlock
        OpEventEraseBlock_EraseBlock_PS_NvMConfigBlock: RteEventRef=OpEventEraseBlock_EraseBlock_PS_NvMConfigBlock
        OpEventSetBlockProtection_SetBlockProtection_PAdmin_NvMConfigBlock: RteEventRef=OpEventSetBlockProtection_SetBlockProtection_PAdmin_NvMConfigBlock
        OpEventRestoreBlockDefaults_RestoreBlockDefaults_PS_SWC_PLT_Appl_NvMHandlerSWC_PLT_CDD_FailSafe: RteEventRef=OpEventRestoreBlockDefaults_RestoreBlockDefaults_PS_SWC_PLT_Appl_NvMHandlerSWC_PLT_CDD_FailSafe
        OpEventSetRamBlockStatus_SetRamBlockStatus_PS_SWC_PLT_Appl_NvMHandlerAlignment_NvMBlock: RteEventRef=OpEventSetRamBlockStatus_SetRamBlockStatus_PS_SWC_PLT_Appl_NvMHandlerAlignment_NvMBlock
        OpEventInvalidateNvBlock_InvalidateNvBlock_PS_SWC_PLT_Appl_NvMHandlerRFE_R1R2_Fault_NvM: RteEventRef=OpEventInvalidateNvBlock_InvalidateNvBlock_PS_SWC_PLT_Appl_NvMHandlerRFE_R1R2_Fault_NvM
        OpEventGetErrorStatus_GetErrorStatus_PS_SWC_PLT_Appl_NvMHandlerAlignment_NvMBlock: RteEventRef=OpEventGetErrorStatus_GetErrorStatus_PS_SWC_PLT_Appl_NvMHandlerAlignment_NvMBlock
        OpEventSetBlockProtection_SetBlockProtection_PAdmin_SWC_PLT_Appl_NvMHandlerSWC_PLT_CDD_FailSafe: RteEventRef=OpEventSetBlockProtection_SetBlockProtection_PAdmin_SWC_PLT_Appl_NvMHandlerSWC_PLT_CDD_FailSafe
        OpEventWriteBlock_WriteBlock_PS_SWC_PLT_Appl_NvMHandlerSWC_PLT_CDD_FailSafe: RteEventRef=OpEventWriteBlock_WriteBlock_PS_SWC_PLT_Appl_NvMHandlerSWC_PLT_CDD_FailSafe
        OpEventReadBlock_ReadBlock_PS_SWC_PLT_Appl_NvMHandlerRFE_R1R2_Fault_NvM: RteEventRef=OpEventReadBlock_ReadBlock_PS_SWC_PLT_Appl_NvMHandlerRFE_R1R2_Fault_NvM
        OpEventEraseBlock_EraseBlock_PS_SWC_PLT_Appl_NvMHandlerRFE_R1R2_Fault_NvM: RteEventRef=OpEventEraseBlock_EraseBlock_PS_SWC_PLT_Appl_NvMHandlerRFE_R1R2_Fault_NvM
        OpEventGetErrorStatus_GetErrorStatus_PS_SWC_PLT_Appl_NvMHandlerSWC_PLT_CDD_FailSafe: RteEventRef=OpEventGetErrorStatus_GetErrorStatus_PS_SWC_PLT_Appl_NvMHandlerSWC_PLT_CDD_FailSafe
        OpEventWriteBlock_WriteBlock_PS_SWC_PLT_Appl_NvMHandlerAlignment_NvMBlock: RteEventRef=OpEventWriteBlock_WriteBlock_PS_SWC_PLT_Appl_NvMHandlerAlignment_NvMBlock
        OpEventInvalidateNvBlock_InvalidateNvBlock_PS_SWC_PLT_Appl_NvMHandlerAlignment_NvMBlock: RteEventRef=OpEventInvalidateNvBlock_InvalidateNvBlock_PS_SWC_PLT_Appl_NvMHandlerAlignment_NvMBlock
        OpEventRestoreBlockDefaults_RestoreBlockDefaults_PS_SWC_PLT_Appl_NvMHandlerRFE_R1R2_Fault_NvM: RteEventRef=OpEventRestoreBlockDefaults_RestoreBlockDefaults_PS_SWC_PLT_Appl_NvMHandlerRFE_R1R2_Fault_NvM
        OpEventReadBlock_ReadBlock_PS_SWC_PLT_Appl_NvMHandlerSWC_PLT_CDD_FailSafe: RteEventRef=OpEventReadBlock_ReadBlock_PS_SWC_PLT_Appl_NvMHandlerSWC_PLT_CDD_FailSafe
        OpEventSetRamBlockStatus_SetRamBlockStatus_PS_SWC_PLT_Appl_NvMHandlerSWC_PLT_CDD_FailSafe: RteEventRef=OpEventSetRamBlockStatus_SetRamBlockStatus_PS_SWC_PLT_Appl_NvMHandlerSWC_PLT_CDD_FailSafe
        OpEventReadBlock_ReadBlock_PS_SWC_PLT_Appl_NvMHandlerAlignment_NvMBlock: RteEventRef=OpEventReadBlock_ReadBlock_PS_SWC_PLT_Appl_NvMHandlerAlignment_NvMBlock
        OpEventEraseBlock_EraseBlock_PS_SWC_PLT_Appl_NvMHandlerSWC_PLT_CDD_FailSafe: RteEventRef=OpEventEraseBlock_EraseBlock_PS_SWC_PLT_Appl_NvMHandlerSWC_PLT_CDD_FailSafe
        OpEventSetBlockProtection_SetBlockProtection_PAdmin_SWC_PLT_Appl_NvMHandlerRFE_R1R2_Fault_NvM: RteEventRef=OpEventSetBlockProtection_SetBlockProtection_PAdmin_SWC_PLT_Appl_NvMHandlerRFE_R1R2_Fault_NvM
        OpEventWriteBlock_WriteBlock_PS_SWC_PLT_Appl_NvMHandlerRFE_R1R2_Fault_NvM: RteEventRef=OpEventWriteBlock_WriteBlock_PS_SWC_PLT_Appl_NvMHandlerRFE_R1R2_Fault_NvM
        OpEventRestoreBlockDefaults_RestoreBlockDefaults_PS_SWC_PLT_Appl_NvMHandlerAlignment_NvMBlock: RteEventRef=OpEventRestoreBlockDefaults_RestoreBlockDefaults_PS_SWC_PLT_Appl_NvMHandlerAlignment_NvMBlock
        OpEventInvalidateNvBlock_InvalidateNvBlock_PS_SWC_PLT_Appl_NvMHandlerSWC_PLT_CDD_FailSafe: RteEventRef=OpEventInvalidateNvBlock_InvalidateNvBlock_PS_SWC_PLT_Appl_NvMHandlerSWC_PLT_CDD_FailSafe
        OpEventEraseBlock_EraseBlock_PS_SWC_PLT_Appl_NvMHandlerAlignment_NvMBlock: RteEventRef=OpEventEraseBlock_EraseBlock_PS_SWC_PLT_Appl_NvMHandlerAlignment_NvMBlock
        OpEventSetBlockProtection_SetBlockProtection_PAdmin_SWC_PLT_Appl_NvMHandlerAlignment_NvMBlock: RteEventRef=OpEventSetBlockProtection_SetBlockProtection_PAdmin_SWC_PLT_Appl_NvMHandlerAlignment_NvMBlock
        OpEventSetRamBlockStatus_SetRamBlockStatus_PS_SWC_PLT_Appl_NvMHandlerRFE_R1R2_Fault_NvM: RteEventRef=OpEventSetRamBlockStatus_SetRamBlockStatus_PS_SWC_PLT_Appl_NvMHandlerRFE_R1R2_Fault_NvM
        OpEventGetErrorStatus_GetErrorStatus_PS_SWC_PLT_Appl_NvMHandlerRFE_R1R2_Fault_NvM: RteEventRef=OpEventGetErrorStatus_GetErrorStatus_PS_SWC_PLT_Appl_NvMHandlerRFE_R1R2_Fault_NvM
        OpEventReadBlock_ReadBlock_PS_SWC_PLT_Appl_NvMHandlerBringup_NvMBlock: RteEventRef=OpEventReadBlock_ReadBlock_PS_SWC_PLT_Appl_NvMHandlerBringup_NvMBlock
        OpEventInvalidateNvBlock_InvalidateNvBlock_PS_SWC_PLT_Appl_NvMHandlerBringup_NvMBlock: RteEventRef=OpEventInvalidateNvBlock_InvalidateNvBlock_PS_SWC_PLT_Appl_NvMHandlerBringup_NvMBlock
        OpEventEraseBlock_EraseBlock_PS_SWC_PLT_Appl_NvMHandlerBringup_NvMBlock: RteEventRef=OpEventEraseBlock_EraseBlock_PS_SWC_PLT_Appl_NvMHandlerBringup_NvMBlock
        OpEventSetBlockProtection_SetBlockProtection_PAdmin_SWC_PLT_Appl_NvMHandlerBringup_NvMBlock: RteEventRef=OpEventSetBlockProtection_SetBlockProtection_PAdmin_SWC_PLT_Appl_NvMHandlerBringup_NvMBlock
        OpEventGetErrorStatus_GetErrorStatus_PS_SWC_PLT_Appl_NvMHandlerBringup_NvMBlock: RteEventRef=OpEventGetErrorStatus_GetErrorStatus_PS_SWC_PLT_Appl_NvMHandlerBringup_NvMBlock
        OpEventWriteBlock_WriteBlock_PS_SWC_PLT_Appl_NvMHandlerBringup_NvMBlock: RteEventRef=OpEventWriteBlock_WriteBlock_PS_SWC_PLT_Appl_NvMHandlerBringup_NvMBlock
        OpEventRestoreBlockDefaults_RestoreBlockDefaults_PS_SWC_PLT_Appl_NvMHandlerBringup_NvMBlock: RteEventRef=OpEventRestoreBlockDefaults_RestoreBlockDefaults_PS_SWC_PLT_Appl_NvMHandlerBringup_NvMBlock
        OpEventSetRamBlockStatus_SetRamBlockStatus_PS_SWC_PLT_Appl_NvMHandlerBringup_NvMBlock: RteEventRef=OpEventSetRamBlockStatus_SetRamBlockStatus_PS_SWC_PLT_Appl_NvMHandlerBringup_NvMBlock
        OpEventEraseBlock_EraseBlock_PS_SWC_PLT_Appl_NvMHandlerCorrectable_Fault_NvM: RteEventRef=OpEventEraseBlock_EraseBlock_PS_SWC_PLT_Appl_NvMHandlerCorrectable_Fault_NvM
        OpEventRestoreBlockDefaults_RestoreBlockDefaults_PS_SWC_PLT_Appl_NvMHandlerCorrectable_Fault_NvM: RteEventRef=OpEventRestoreBlockDefaults_RestoreBlockDefaults_PS_SWC_PLT_Appl_NvMHandlerCorrectable_Fault_NvM
        OpEventSetRamBlockStatus_SetRamBlockStatus_PS_SWC_PLT_Appl_NvMHandlerCorrectable_Fault_NvM: RteEventRef=OpEventSetRamBlockStatus_SetRamBlockStatus_PS_SWC_PLT_Appl_NvMHandlerCorrectable_Fault_NvM
        OpEventReadBlock_ReadBlock_PS_SWC_PLT_Appl_NvMHandlerCorrectable_Fault_NvM: RteEventRef=OpEventReadBlock_ReadBlock_PS_SWC_PLT_Appl_NvMHandlerCorrectable_Fault_NvM
        OpEventWriteBlock_WriteBlock_PS_SWC_PLT_Appl_NvMHandlerCorrectable_Fault_NvM: RteEventRef=OpEventWriteBlock_WriteBlock_PS_SWC_PLT_Appl_NvMHandlerCorrectable_Fault_NvM
        OpEventSetBlockProtection_SetBlockProtection_PAdmin_SWC_PLT_Appl_NvMHandlerCorrectable_Fault_NvM: RteEventRef=OpEventSetBlockProtection_SetBlockProtection_PAdmin_SWC_PLT_Appl_NvMHandlerCorrectable_Fault_NvM
        OpEventGetErrorStatus_GetErrorStatus_PS_SWC_PLT_Appl_NvMHandlerCorrectable_Fault_NvM: RteEventRef=OpEventGetErrorStatus_GetErrorStatus_PS_SWC_PLT_Appl_NvMHandlerCorrectable_Fault_NvM
        OpEventInvalidateNvBlock_InvalidateNvBlock_PS_SWC_PLT_Appl_NvMHandlerCorrectable_Fault_NvM: RteEventRef=OpEventInvalidateNvBlock_InvalidateNvBlock_PS_SWC_PLT_Appl_NvMHandlerCorrectable_Fault_NvM
        OpEventGetErrorStatus_GetErrorStatus_PS_SWC_CMP_PRJ_UDSHandlerSWC_UDSHandler_VIN: RteEventRef=OpEventGetErrorStatus_GetErrorStatus_PS_SWC_CMP_PRJ_UDSHandlerSWC_UDSHandler_VIN
        OpEventRestoreBlockDefaults_RestoreBlockDefaults_PS_SWC_CMP_PRJ_UDSHandlerSWC_UDSHandler_VIN: RteEventRef=OpEventRestoreBlockDefaults_RestoreBlockDefaults_PS_SWC_CMP_PRJ_UDSHandlerSWC_UDSHandler_VIN
        OpEventReadBlock_ReadBlock_PS_SWC_CMP_PRJ_UDSHandlerSWC_UDSHandler_VIN: RteEventRef=OpEventReadBlock_ReadBlock_PS_SWC_CMP_PRJ_UDSHandlerSWC_UDSHandler_VIN
        OpEventEraseBlock_EraseBlock_PS_SWC_CMP_PRJ_UDSHandlerSWC_UDSHandler_VIN: RteEventRef=OpEventEraseBlock_EraseBlock_PS_SWC_CMP_PRJ_UDSHandlerSWC_UDSHandler_VIN
        OpEventSetRamBlockStatus_SetRamBlockStatus_PS_SWC_CMP_PRJ_UDSHandlerSWC_UDSHandler_VIN: RteEventRef=OpEventSetRamBlockStatus_SetRamBlockStatus_PS_SWC_CMP_PRJ_UDSHandlerSWC_UDSHandler_VIN
        OpEventInvalidateNvBlock_InvalidateNvBlock_PS_SWC_CMP_PRJ_UDSHandlerSWC_UDSHandler_VIN: RteEventRef=OpEventInvalidateNvBlock_InvalidateNvBlock_PS_SWC_CMP_PRJ_UDSHandlerSWC_UDSHandler_VIN
        OpEventSetBlockProtection_SetBlockProtection_PAdmin_SWC_CMP_PRJ_UDSHandlerSWC_UDSHandler_VIN: RteEventRef=OpEventSetBlockProtection_SetBlockProtection_PAdmin_SWC_CMP_PRJ_UDSHandlerSWC_UDSHandler_VIN
        OpEventWriteBlock_WriteBlock_PS_SWC_CMP_PRJ_UDSHandlerSWC_UDSHandler_VIN: RteEventRef=OpEventWriteBlock_WriteBlock_PS_SWC_CMP_PRJ_UDSHandlerSWC_UDSHandler_VIN
        OpEventEraseBlock_EraseBlock_PS_SWC_PLT_Appl_NvMHandlerSensorPos_NvM: RteEventRef=OpEventEraseBlock_EraseBlock_PS_SWC_PLT_Appl_NvMHandlerSensorPos_NvM
        OpEventRestoreBlockDefaults_RestoreBlockDefaults_PS_SWC_PLT_Appl_NvMHandlerSensorPos_NvM: RteEventRef=OpEventRestoreBlockDefaults_RestoreBlockDefaults_PS_SWC_PLT_Appl_NvMHandlerSensorPos_NvM
        OpEventReadBlock_ReadBlock_PS_SWC_PLT_Appl_NvMHandlerSensorPos_NvM: RteEventRef=OpEventReadBlock_ReadBlock_PS_SWC_PLT_Appl_NvMHandlerSensorPos_NvM
        OpEventSetBlockProtection_SetBlockProtection_PAdmin_SWC_PLT_Appl_NvMHandlerSensorPos_NvM: RteEventRef=OpEventSetBlockProtection_SetBlockProtection_PAdmin_SWC_PLT_Appl_NvMHandlerSensorPos_NvM
        OpEventInvalidateNvBlock_InvalidateNvBlock_PS_SWC_PLT_Appl_NvMHandlerSensorPos_NvM: RteEventRef=OpEventInvalidateNvBlock_InvalidateNvBlock_PS_SWC_PLT_Appl_NvMHandlerSensorPos_NvM
        OpEventWriteBlock_WriteBlock_PS_SWC_PLT_Appl_NvMHandlerSensorPos_NvM: RteEventRef=OpEventWriteBlock_WriteBlock_PS_SWC_PLT_Appl_NvMHandlerSensorPos_NvM
        OpEventSetRamBlockStatus_SetRamBlockStatus_PS_SWC_PLT_Appl_NvMHandlerSensorPos_NvM: RteEventRef=OpEventSetRamBlockStatus_SetRamBlockStatus_PS_SWC_PLT_Appl_NvMHandlerSensorPos_NvM
        OpEventGetErrorStatus_GetErrorStatus_PS_SWC_PLT_Appl_NvMHandlerSensorPos_NvM: RteEventRef=OpEventGetErrorStatus_GetErrorStatus_PS_SWC_PLT_Appl_NvMHandlerSensorPos_NvM
        OpEventReadBlock_ReadBlock_PS_SWC_CMP_PRJ_UDSHandlerSWC_UDSHandler_Attemptcounter: RteEventRef=OpEventReadBlock_ReadBlock_PS_SWC_CMP_PRJ_UDSHandlerSWC_UDSHandler_Attemptcounter
        OpEventSetBlockProtection_SetBlockProtection_PAdmin_SWC_CMP_PRJ_UDSHandlerSWC_UDSHandler_Attemptcounter: RteEventRef=OpEventSetBlockProtection_SetBlockProtection_PAdmin_SWC_CMP_PRJ_UDSHandlerSWC_UDSHandler_Attemptcounter
        OpEventEraseBlock_EraseBlock_PS_SWC_CMP_PRJ_UDSHandlerSWC_UDSHandler_Attemptcounter: RteEventRef=OpEventEraseBlock_EraseBlock_PS_SWC_CMP_PRJ_UDSHandlerSWC_UDSHandler_Attemptcounter
        OpEventSetRamBlockStatus_SetRamBlockStatus_PS_SWC_CMP_PRJ_UDSHandlerSWC_UDSHandler_Attemptcounter: RteEventRef=OpEventSetRamBlockStatus_SetRamBlockStatus_PS_SWC_CMP_PRJ_UDSHandlerSWC_UDSHandler_Attemptcounter
        OpEventInvalidateNvBlock_InvalidateNvBlock_PS_SWC_CMP_PRJ_UDSHandlerSWC_UDSHandler_Attemptcounter: RteEventRef=OpEventInvalidateNvBlock_InvalidateNvBlock_PS_SWC_CMP_PRJ_UDSHandlerSWC_UDSHandler_Attemptcounter
        OpEventWriteBlock_WriteBlock_PS_SWC_CMP_PRJ_UDSHandlerSWC_UDSHandler_Attemptcounter: RteEventRef=OpEventWriteBlock_WriteBlock_PS_SWC_CMP_PRJ_UDSHandlerSWC_UDSHandler_Attemptcounter
        OpEventRestoreBlockDefaults_RestoreBlockDefaults_PS_SWC_CMP_PRJ_UDSHandlerSWC_UDSHandler_Attemptcounter: RteEventRef=OpEventRestoreBlockDefaults_RestoreBlockDefaults_PS_SWC_CMP_PRJ_UDSHandlerSWC_UDSHandler_Attemptcounter
        OpEventGetErrorStatus_GetErrorStatus_PS_SWC_CMP_PRJ_UDSHandlerSWC_UDSHandler_Attemptcounter: RteEventRef=OpEventGetErrorStatus_GetErrorStatus_PS_SWC_CMP_PRJ_UDSHandlerSWC_UDSHandler_Attemptcounter
        OpEventEraseBlock_EraseBlock_PS_SWC_PLT_Appl_NvMHandlerSWC_Manual_alignment_Execution: RteEventRef=OpEventEraseBlock_EraseBlock_PS_SWC_PLT_Appl_NvMHandlerSWC_Manual_alignment_Execution
        OpEventWriteBlock_WriteBlock_PS_SWC_PLT_Appl_NvMHandlerSWC_Manual_alignment_Execution: RteEventRef=OpEventWriteBlock_WriteBlock_PS_SWC_PLT_Appl_NvMHandlerSWC_Manual_alignment_Execution
        OpEventGetErrorStatus_GetErrorStatus_PS_SWC_PLT_Appl_NvMHandlerSWC_Manual_alignment_Execution: RteEventRef=OpEventGetErrorStatus_GetErrorStatus_PS_SWC_PLT_Appl_NvMHandlerSWC_Manual_alignment_Execution
        OpEventSetBlockProtection_SetBlockProtection_PAdmin_SWC_PLT_Appl_NvMHandlerSWC_Manual_alignment_Execution: RteEventRef=OpEventSetBlockProtection_SetBlockProtection_PAdmin_SWC_PLT_Appl_NvMHandlerSWC_Manual_alignment_Execution
        OpEventSetRamBlockStatus_SetRamBlockStatus_PS_SWC_PLT_Appl_NvMHandlerSWC_Manual_alignment_Execution: RteEventRef=OpEventSetRamBlockStatus_SetRamBlockStatus_PS_SWC_PLT_Appl_NvMHandlerSWC_Manual_alignment_Execution
        OpEventReadBlock_ReadBlock_PS_SWC_PLT_Appl_NvMHandlerSWC_Manual_alignment_Execution: RteEventRef=OpEventReadBlock_ReadBlock_PS_SWC_PLT_Appl_NvMHandlerSWC_Manual_alignment_Execution
        OpEventInvalidateNvBlock_InvalidateNvBlock_PS_SWC_PLT_Appl_NvMHandlerSWC_Manual_alignment_Execution: RteEventRef=OpEventInvalidateNvBlock_InvalidateNvBlock_PS_SWC_PLT_Appl_NvMHandlerSWC_Manual_alignment_Execution
        OpEventRestoreBlockDefaults_RestoreBlockDefaults_PS_SWC_PLT_Appl_NvMHandlerSWC_Manual_alignment_Execution: RteEventRef=OpEventRestoreBlockDefaults_RestoreBlockDefaults_PS_SWC_PLT_Appl_NvMHandlerSWC_Manual_alignment_Execution
        OpEventWriteBlock_WriteBlock_PS_SWC_PLT_Appl_NvMHandlerSWC_VSE_NVM_Params: RteEventRef=OpEventWriteBlock_WriteBlock_PS_SWC_PLT_Appl_NvMHandlerSWC_VSE_NVM_Params
        OpEventGetErrorStatus_GetErrorStatus_PS_SWC_PLT_Appl_NvMHandlerSWC_VSE_NVM_Params: RteEventRef=OpEventGetErrorStatus_GetErrorStatus_PS_SWC_PLT_Appl_NvMHandlerSWC_VSE_NVM_Params
        OpEventEraseBlock_EraseBlock_PS_SWC_PLT_Appl_NvMHandlerSWC_Static_Alignment_Write_Parameters: RteEventRef=OpEventEraseBlock_EraseBlock_PS_SWC_PLT_Appl_NvMHandlerSWC_Static_Alignment_Write_Parameters
        OpEventSetBlockProtection_SetBlockProtection_PAdmin_SWC_PLT_Appl_NvMHandlerSWC_Static_Alignment_Write_Parameters: RteEventRef=OpEventSetBlockProtection_SetBlockProtection_PAdmin_SWC_PLT_Appl_NvMHandlerSWC_Static_Alignment_Write_Parameters
        OpEventSetRamBlockStatus_SetRamBlockStatus_PS_SWC_PLT_Appl_NvMHandlerSWC_VSE_NVM_Params: RteEventRef=OpEventSetRamBlockStatus_SetRamBlockStatus_PS_SWC_PLT_Appl_NvMHandlerSWC_VSE_NVM_Params
        OpEventSetBlockProtection_SetBlockProtection_PAdmin_SWC_PLT_Appl_NvMHandlerSWC_VSE_NVM_Params: RteEventRef=OpEventSetBlockProtection_SetBlockProtection_PAdmin_SWC_PLT_Appl_NvMHandlerSWC_VSE_NVM_Params
        OpEventInvalidateNvBlock_InvalidateNvBlock_PS_SWC_PLT_Appl_NvMHandlerSWC_VSE_NVM_Params: RteEventRef=OpEventInvalidateNvBlock_InvalidateNvBlock_PS_SWC_PLT_Appl_NvMHandlerSWC_VSE_NVM_Params
        OpEventEraseBlock_EraseBlock_PS_SWC_PLT_Appl_NvMHandlerSWC_VSE_NVM_Params: RteEventRef=OpEventEraseBlock_EraseBlock_PS_SWC_PLT_Appl_NvMHandlerSWC_VSE_NVM_Params
        OpEventReadBlock_ReadBlock_PS_SWC_PLT_Appl_NvMHandlerSWC_Static_Alignment_Write_Parameters: RteEventRef=OpEventReadBlock_ReadBlock_PS_SWC_PLT_Appl_NvMHandlerSWC_Static_Alignment_Write_Parameters
        OpEventSetRamBlockStatus_SetRamBlockStatus_PS_SWC_PLT_Appl_NvMHandlerSWC_Static_Alignment_Write_Parameters: RteEventRef=OpEventSetRamBlockStatus_SetRamBlockStatus_PS_SWC_PLT_Appl_NvMHandlerSWC_Static_Alignment_Write_Parameters
        OpEventReadBlock_ReadBlock_PS_SWC_PLT_Appl_NvMHandlerSWC_VSE_NVM_Params: RteEventRef=OpEventReadBlock_ReadBlock_PS_SWC_PLT_Appl_NvMHandlerSWC_VSE_NVM_Params
        OpEventRestoreBlockDefaults_RestoreBlockDefaults_PS_SWC_PLT_Appl_NvMHandlerSWC_Static_Alignment_Write_Parameters: RteEventRef=OpEventRestoreBlockDefaults_RestoreBlockDefaults_PS_SWC_PLT_Appl_NvMHandlerSWC_Static_Alignment_Write_Parameters
        OpEventWriteBlock_WriteBlock_PS_SWC_PLT_Appl_NvMHandlerSWC_Static_Alignment_Write_Parameters: RteEventRef=OpEventWriteBlock_WriteBlock_PS_SWC_PLT_Appl_NvMHandlerSWC_Static_Alignment_Write_Parameters
        OpEventRestoreBlockDefaults_RestoreBlockDefaults_PS_SWC_PLT_Appl_NvMHandlerSWC_VSE_NVM_Params: RteEventRef=OpEventRestoreBlockDefaults_RestoreBlockDefaults_PS_SWC_PLT_Appl_NvMHandlerSWC_VSE_NVM_Params
        OpEventGetErrorStatus_GetErrorStatus_PS_SWC_PLT_Appl_NvMHandlerSWC_Static_Alignment_Write_Parameters: RteEventRef=OpEventGetErrorStatus_GetErrorStatus_PS_SWC_PLT_Appl_NvMHandlerSWC_Static_Alignment_Write_Parameters
        OpEventInvalidateNvBlock_InvalidateNvBlock_PS_SWC_PLT_Appl_NvMHandlerSWC_Static_Alignment_Write_Parameters: RteEventRef=OpEventInvalidateNvBlock_InvalidateNvBlock_PS_SWC_PLT_Appl_NvMHandlerSWC_Static_Alignment_Write_Parameters
    SWC_PLT_Appl_NvMHandler_EcuSwComposition (RteSwComponentInstance): RteSoftwareComponentInstanceRef=SWC_PLT_Appl_NvMHandler
      3 x RteNvRamAllocation:
        NvmBlock_SWC_PLT_Appl_NvMHandler_Alignment_NvMBlock: RteNvmRamBlockLocationSymbol=, RteNvmBlockRef=SWC_PLT_Appl_NvMHandlerAlignment_NvMBlock, RteSwNvRamMappingRef=Alignment_NvMBlock
        NvmBlock_SWC_PLT_Appl_NvMHandler_SWC_PLT_CDD_FailSafe: RteNvmRamBlockLocationSymbol=Rte_SWC_PLT_Appl_NvMHandler_FailSafe_ResetReason_PIM, RteNvmRomBlockLocationSymbol=Rte_SWC_PLT_Appl_NvMHandler_SWC_PLT_CDD_FailSafe_DefaultValue, RteNvmBlockRef=SWC_PLT_Appl_NvMHandlerSWC_PLT_CDD_FailSafe, RteSwNvRamMappingRef=SWC_PLT_CDD_FailSafe
        NvmBlock_SWC_PLT_Appl_NvMHandler_RFE_R1R2_Fault_NvM: RteNvmRamBlockLocationSymbol=Rte_SWC_PLT_Appl_NvMHandler_RFE_R1R2_PIM, RteNvmRomBlockLocationSymbol=Rte_SWC_PLT_Appl_NvMHandler_RFE_R1R2_Fault_NvM_DefaultValue, RteNvmBlockRef=SWC_PLT_Appl_NvMHandlerRFE_R1R2_Fault_NvM, RteSwNvRamMappingRef=RFE_R1R2_Fault_NvM
      4 x RteEventToTaskMapping, all with RteImmediateRestart=false:
        TMT_SWC_PLT_Appl_NvMHandler_50ms: RtePositionInTask=49, RteEventRef=TMT_SWC_PLT_Appl_NvMHandler_50ms, RteMappedToTaskRef=Appl_Task, RteUsedOsEventRef=Rte_Ev_Cyclic_Appl_Task_0_50ms, RteUsedOsAlarmRef=Rte_Al_TE_Appl_Task_0_50ms
        SWC_PLT_Appl_NvMHandler_InitEvent: RtePositionInTask=1, RteEventRef=SWC_PLT_Appl_NvMHandler_InitEvent, RteMappedToTaskRef=Appl_Init
        OIT_CS_Pp_Trigger_Write_to_NvM_NvHandler_Trigger_Write_To_NVM_CS_Pp_Trigger_Write_to_NvM_NvHandler_Trigger_Write_To_NVM: RteEventRef=OIT_CS_Pp_Trigger_Write_to_NvM_NvHandler_Trigger_Write_To_NVM_CS_Pp_Trigger_Write_to_NvM_NvHandler_Trigger_Write_To_NVM
        OIT_CS_Pp_Trigger_Write_to_NvM_NvHandler_Trigger_Write_To_NVM_CS_Trigger_Write_to_NVM_NvHandler_Trigger_Write_To_NVM: RteEventRef=OIT_CS_Pp_Trigger_Write_to_NvM_NvHandler_Trigger_Write_To_NVM_CS_Trigger_Write_to_NVM_NvHandler_Trigger_Write_To_NVM
      3 x RteNvRamAllocation:
        NvmBlock_SWC_PLT_Appl_NvMHandler_Bringup_NvMBlock: RteNvmRamBlockLocationSymbol=Rte_SWC_PLT_Appl_NvMHandler_NvMBringUp_PIM, RteNvmRomBlockLocationSymbol=Rte_SWC_PLT_Appl_NvMHandler_NvMBringUp_DefaultValue, RteNvmBlockRef=SWC_PLT_Appl_NvMHandlerBringup_NvMBlock, RteSwNvRamMappingRef=Bringup_NvMBlock
        NvmBlock_SWC_PLT_Appl_NvMHandler_Correctable_Fault_NvM: RteNvmRamBlockLocationSymbol=Rte_SWC_PLT_Appl_NvMHandler_Correctable_Fault_PIM, RteNvmRomBlockLocationSymbol=Rte_SWC_PLT_Appl_NvMHandler_Correctable_Fault_NvM_DefaultValue, RteNvmBlockRef=SWC_PLT_Appl_NvMHandlerCorrectable_Fault_NvM, RteSwNvRamMappingRef=Correctable_Fault_NvM
        NvmBlock_SWC_PLT_Appl_NvMHandler_SensorPos_NvM: RteNvmRamBlockLocationSymbol=Rte_SWC_PLT_Appl_NvMHandler_Sensorpos_PIM_UDS, RteNvmRomBlockLocationSymbol=Rte_SWC_PLT_Appl_NvMHandler_SensorPos_NvM_DefaultValue, RteNvmBlockRef=SWC_PLT_Appl_NvMHandlerSensorPos_NvM, RteSwNvRamMappingRef=SensorPos_NvM
      OIT_CS_GetError_Status_Operation_CS_GetError_Status_Operation (RteEventToTaskMapping): RteImmediateRestart=false, RteEventRef=OIT_CS_GetError_Status_Operation_CS_GetError_Status_Operation
      OIT_CS_ReadNvM_Value_Operation_CS_ReadNvM_Value_Operation (RteEventToTaskMapping): RteImmediateRestart=false, RteEventRef=OIT_CS_ReadNvM_Value_Operation_CS_ReadNvM_Value_Operation
      3 x RteNvRamAllocation:
        NvmBlock_SWC_PLT_Appl_NvMHandler_SWC_Manual_alignment_Execution: RteNvmRamBlockLocationSymbol=Rte_SWC_PLT_Appl_NvMHandler_Manual_Alignment_Execution_Data_PIM, RteNvmRomBlockLocationSymbol=Rte_SWC_PLT_Appl_NvMHandler_SWC_Manual_alignment_Execution_DefaultValue, RteNvmBlockRef=SWC_PLT_Appl_NvMHandlerSWC_Manual_alignment_Execution, RteSwNvRamMappingRef=SWC_Manual_alignment_Execution
        NvmBlock_SWC_PLT_Appl_NvMHandler_SWC_VSE_NVM_Params: RteNvmRamBlockLocationSymbol=Rte_SWC_PLT_Appl_NvMHandler_VSE_NVM_Params_PIM, RteNvmRomBlockLocationSymbol=Rte_SWC_PLT_Appl_NvMHandler_SWC_VSE_NVM_Params_DefaultValue, RteNvmBlockRef=SWC_PLT_Appl_NvMHandlerSWC_VSE_NVM_Params, RteSwNvRamMappingRef=SWC_VSE_NVM_Params
        NvmBlock_SWC_PLT_Appl_NvMHandler_SWC_Static_Alignment_Write_Parameters: RteNvmRamBlockLocationSymbol=Rte_SWC_PLT_Appl_NvMHandler_Static_Alignment_Engineering_Write_Configuration_Parameters_PIM, RteNvmRomBlockLocationSymbol=Rte_SWC_PLT_Appl_NvMHandler_SWC_Static_Alignment_Write_Parameters_DefaultValue, RteNvmBlockRef=SWC_PLT_Appl_NvMHandlerSWC_Static_Alignment_Write_Parameters, RteSwNvRamMappingRef=SWC_Static_Alignment_Write_Parameters
      TMT_RE_PLT_Appl_NvMHandler_5ms (RteEventToTaskMapping):
        RteImmediateRestart = false
        RtePositionInTask = 26
        RteEventRef = TMT_RE_PLT_Appl_NvMHandler_5ms
        RteMappedToTaskRef = BSW_Task
        RteUsedOsEventRef = Rte_Ev_Run_SWC_PLT_Appl_NvMHandler_RE_PLT_Appl_NvMHandler_5ms
        RteUsedOsAlarmRef = Rte_Al_TE_SWC_PLT_Appl_NvMHandler_RE_PLT_Appl_NvMHandler_5ms
    SWC_PLT_Appl_NvMHandler (RteSwComponentType): RteComponentTypeRef=SWC_PLT_Appl_NvMHandler, RteImplementationRef=SWC_PLT_Appl_NvMHandler_Implementation
      ComponentTypeCalibration (RteComponentTypeCalibration): RteCalibrationSupportEnabled=false
    3 x RteBswModuleInstance:
      Fls: RteBswImplementationRef=Fls_Impl, RteBswModuleConfigurationRef=Fls
        Fls_MainFunctionTimingEvent0 (RteBswEventToTaskMapping):
          RteBswImmediateRestart = false
          RteBswPositionInTask = 3
          RteBswEventRef = Fls_MainFunctionTimingEvent0
          RteBswMappedToTaskRef = Appl_BackgroundTask
          RteBswUsedOsAlarmRef = Rte_Al_TE2_Appl_BackgroundTask_0_5ms
          RteBswUsedOsEventRef = Rte_Ev_Cyclic2_Appl_BackgroundTask_0_5ms
      Can: RteBswImplementationRef=Can_Impl, RteBswModuleConfigurationRef=Can
        Can_MainFunction_ModeTimingEvent0 (RteBswEventToTaskMapping): RteBswImmediateRestart=false, RteBswEventRef=Can_MainFunction_ModeTimingEvent0
        CAN_EXCLUSIVE_AREA_0 (RteBswExclusiveAreaImpl): RteExclusiveAreaImplMechanism=ALL_INTERRUPT_BLOCKING, RteBswExclusiveAreaRef=CAN_EXCLUSIVE_AREA_0
        CAN_EXCLUSIVE_AREA_1 (RteBswExclusiveAreaImpl): RteExclusiveAreaImplMechanism=ALL_INTERRUPT_BLOCKING, RteBswExclusiveAreaRef=CAN_EXCLUSIVE_AREA_1
      Spi: RteBswImplementationRef=Spi_Impl, RteBswModuleConfigurationRef=Spi
        Spi_MainFunction_HandlingTimingEvent0 (RteBswEventToTaskMapping): RteBswImmediateRestart=false, RteBswEventRef=Spi_MainFunction_HandlingTimingEvent0
        SPI_EXCLUSIVE_AREA_0 (RteBswExclusiveAreaImpl): RteExclusiveAreaImplMechanism=ALL_INTERRUPT_BLOCKING, RteBswExclusiveAreaRef=SPI_EXCLUSIVE_AREA_0
    SWC_PLT_CDD_ExternalWdg (RteSwComponentType): RteComponentTypeRef=SWC_PLT_CDD_ExternalWdg, RteImplementationRef=SWC_PLT_CDD_ExternalWdg_Implementation
      ComponentTypeCalibration (RteComponentTypeCalibration): RteCalibrationSupportEnabled=false
    SWC_PLT_CDD_ExternalWdg_EcuSwComposition (RteSwComponentInstance): RteSoftwareComponentInstanceRef=SWC_PLT_CDD_ExternalWdg
      6 x RteEventToTaskMapping, all with RteImmediateRestart=false:
        OIT_Pp_ExtWdg_Disable_Operation_Pp_ExtWdg_Disable_Operation: RteEventRef=OIT_Pp_ExtWdg_Disable_Operation_Pp_ExtWdg_Disable_Operation
        OIT_Pp_ExtWdg_Enable_Operation_Pp_ExtWdg_Enable_Operation: RteEventRef=OIT_Pp_ExtWdg_Enable_Operation_Pp_ExtWdg_Enable_Operation
        TMT_RE_CDD_Ext_Wdg_5ms: RtePositionInTask=16, RteEventRef=TMT_RE_CDD_Ext_Wdg_5ms, RteMappedToTaskRef=Appl_Task, RteUsedOsEventRef=Rte_Ev_Cyclic_Appl_Task_0_5ms, RteUsedOsAlarmRef=Rte_Al_TE_Appl_Task_0_5ms
        SWC_PLT_CDD_ExternalWdg_InitEvent: RtePositionInTask=9, RteEventRef=SWC_PLT_CDD_ExternalWdg_InitEvent, RteMappedToTaskRef=Appl_Init
        TMT_RE_CDD_Ext_Wdg_50ms: RtePositionInTask=46, RteEventRef=TMT_RE_CDD_Ext_Wdg_50ms, RteMappedToTaskRef=Appl_Task, RteUsedOsEventRef=Rte_Ev_Cyclic_Appl_Task_0_50ms, RteUsedOsAlarmRef=Rte_Al_TE_Appl_Task_0_50ms
        OIT_CS_External_Watchdog_Fault_Injection_Read_CS_External_Watchdog_Fault_Injection_Read: RteEventRef=OIT_CS_External_Watchdog_Fault_Injection_Read_CS_External_Watchdog_Fault_Injection_Read
    4 x RteBswModuleInstance:
      LdCom: RteBswImplementationRef=LdCom_Impl, RteBswModuleConfigurationRef=LdCom
      SomeIpXf: RteBswImplementationRef=SomeIpXf_Impl, RteBswModuleConfigurationRef=SomeIpXf
      SomeIpTp: RteBswImplementationRef=SomeIpTp_Impl, RteBswModuleConfigurationRef=SomeIpTp
        SomeIpTp_MainFunctionTxTimingEvent0 (RteBswEventToTaskMapping):
          RteBswImmediateRestart = false
          RteBswPositionInTask = 19
          RteBswEventRef = SomeIpTp_MainFunctionTxTimingEvent0
          RteBswMappedToTaskRef = BSW_Task
          RteBswUsedOsAlarmRef = Rte_Al_TE2_BSW_Task_0_5ms
          RteBswUsedOsEventRef = Rte_Ev_Cyclic2_BSW_Task_0_5ms
        SomeIpTp_MainFunctionRxTimingEvent0 (RteBswEventToTaskMapping):
          RteBswImmediateRestart = false
          RteBswPositionInTask = 18
          RteBswEventRef = SomeIpTp_MainFunctionRxTimingEvent0
          RteBswMappedToTaskRef = BSW_Task
          RteBswUsedOsAlarmRef = Rte_Al_TE2_BSW_Task_0_5ms
          RteBswUsedOsEventRef = Rte_Ev_Cyclic2_BSW_Task_0_5ms
        SOMEIPTP_EXCLUSIVE_AREA_0 (RteBswExclusiveAreaImpl): RteExclusiveAreaImplMechanism=ALL_INTERRUPT_BLOCKING, RteBswExclusiveAreaRef=SOMEIPTP_EXCLUSIVE_AREA_0
      Sd: RteBswImplementationRef=Sd_Impl, RteBswModuleConfigurationRef=Sd
        Sd_MainFunctionTimingEvent0 (RteBswEventToTaskMapping):
          RteBswImmediateRestart = false
          RteBswPositionInTask = 17
          RteBswEventRef = Sd_MainFunctionTimingEvent0
          RteBswMappedToTaskRef = BSW_Task
          RteBswUsedOsAlarmRef = Rte_Al_TE2_BSW_Task_0_5ms
          RteBswUsedOsEventRef = Rte_Ev_Cyclic2_BSW_Task_0_5ms
        SD_EXCLUSIVE_AREA_0 (RteBswExclusiveAreaImpl): RteExclusiveAreaImplMechanism=ALL_INTERRUPT_BLOCKING, RteBswExclusiveAreaRef=SD_EXCLUSIVE_AREA_0
        SD_EXCLUSIVE_AREA_MULTI_PARTITION (RteBswExclusiveAreaImpl): RteExclusiveAreaImplMechanism=ALL_INTERRUPT_BLOCKING, RteBswExclusiveAreaRef=SD_EXCLUSIVE_AREA_MULTI_PARTITION
    3 x RteSwComponentInstance:
      SWC_PLT_Appl_IntWDG_EcuSwComposition: RteSoftwareComponentInstanceRef=SWC_PLT_Appl_IntWDG
        9 x RteEventToTaskMapping, all with RteImmediateRestart=false:
          SWC_PLT_Appl_Wdg_InitEvent: RtePositionInTask=19, RteEventRef=SWC_PLT_Appl_Wdg_InitEvent, RteMappedToTaskRef=Appl_Init
          TMT_RE_PLT_WDG_Main_50ms: RtePositionInTask=48, RteEventRef=TMT_RE_PLT_WDG_Main_50ms, RteMappedToTaskRef=Appl_Task, RteUsedOsEventRef=Rte_Ev_Cyclic_Appl_Task_0_50ms, RteUsedOsAlarmRef=Rte_Al_TE_Appl_Task_0_50ms
          TMT_RE_PLT_WDG_Main_5ms: RtePositionInTask=2, RteEventRef=TMT_RE_PLT_WDG_Main_5ms, RteMappedToTaskRef=Appl_Task_High_Prio, RteUsedOsEventRef=Rte_Ev_Run_SWC_PLT_Appl_IntWDG_RE_PLT_WDG_Main_5ms, RteUsedOsAlarmRef=Rte_Al_TE_SWC_PLT_Appl_IntWDG_RE_PLT_WDG_Main_5ms
          OIT_CS_Disable_Wdg_Supervised_Entites_Operation_CS_Disable_Wdg_Supervised_Entites_Operation: RteEventRef=OIT_CS_Disable_Wdg_Supervised_Entites_Operation_CS_Disable_Wdg_Supervised_Entites_Operation
          TMT_RE_PLT_WDG_INTERNAL_WDG_BSW_Task: RtePositionInTask=27, RteEventRef=TMT_RE_PLT_WDG_INTERNAL_WDG_BSW_Task, RteMappedToTaskRef=BSW_Task, RteUsedOsEventRef=Rte_Ev_Run_SWC_PLT_Appl_IntWDG_RE_PLT_WDG_INTERNAL_WDG_BSW_Task, RteUsedOsAlarmRef=Rte_Al_TE_SWC_PLT_Appl_IntWDG_RE_PLT_WDG_INTERNAL_WDG_BSW_Task
          TMT_RE_PLT_WDG_INTERNAL_WDG_Appl_Task_Radar_Control: RtePositionInTask=7, RteEventRef=TMT_RE_PLT_WDG_INTERNAL_WDG_Appl_Task_Radar_Control, RteMappedToTaskRef=Radar_Ctrl_Task, RteUsedOsEventRef=Rte_Ev_Cyclic_Radar_Ctrl_Task_0_50ms, RteUsedOsAlarmRef=Rte_Al_TE_Radar_Ctrl_Task_0_50ms
          TMT_RE_PLT_WDG_INTERNAL_WDG_PLT_Appl_Task: RtePositionInTask=54, RteEventRef=TMT_RE_PLT_WDG_INTERNAL_WDG_PLT_Appl_Task, RteMappedToTaskRef=Appl_Task, RteUsedOsEventRef=Rte_Ev_Run_SWC_PLT_Appl_IntWDG_RE_PLT_WDG_INTERNAL_WDG_PLT_Appl_Task, RteUsedOsAlarmRef=Rte_Al_TE_SWC_PLT_Appl_IntWDG_RE_PLT_WDG_INTERNAL_WDG_PLT_Appl_Task
          TMT_RE_PLT_WDG_INTERNAL_WDG_Appl_Task_Communication: RtePositionInTask=9, RteEventRef=TMT_RE_PLT_WDG_INTERNAL_WDG_Appl_Task_Communication, RteMappedToTaskRef=Appl_Task_Communication, RteUsedOsEventRef=Rte_Ev_Cyclic_Appl_Task_Communication_0_25ms, RteUsedOsAlarmRef=Rte_Al_TE_Appl_Task_Communication_0_25ms
          TMT_RE_PLT_WDG_INTERNAL_WDG_Appl_IPC_Task: RtePositionInTask=5, RteEventRef=TMT_RE_PLT_WDG_INTERNAL_WDG_Appl_IPC_Task, RteMappedToTaskRef=Appl_IPC_Task, RteUsedOsEventRef=Rte_Ev_Cyclic_Appl_IPC_Task_0_50ms, RteUsedOsAlarmRef=Rte_Al_TE_Appl_IPC_Task_0_50ms
      SWC_PLT_CDD_WdgHandler_EcuSwComposition: RteSoftwareComponentInstanceRef=SWC_PLT_CDD_WdgHandler
        3 x RteEventToTaskMapping, all with RteImmediateRestart=false:
          OIT_CS_WdgHandler_Fault_Injection_Read_CS_WdgHandler_Fault_Injection_Read: RteEventRef=OIT_CS_WdgHandler_Fault_Injection_Read_CS_WdgHandler_Fault_Injection_Read
          SWC_PLT_CDD_WdgHandler_InitEvent: RtePositionInTask=20, RteEventRef=SWC_PLT_CDD_WdgHandler_InitEvent, RteMappedToTaskRef=Appl_Init
          OIT_CS_Wdg_Disable_Read_CS_Wdg_Disable_Read: RteEventRef=OIT_CS_Wdg_Disable_Read_CS_Wdg_Disable_Read
      SWC_Appl_Project_EcuSwComposition: RteSoftwareComponentInstanceRef=SWC_Appl_Project
        TMT_RE_Appl_Project_Main_50ms (RteEventToTaskMapping):
          RteImmediateRestart = false
          RtePositionInTask = 7
          RteEventRef = TMT_RE_Appl_Project_Main_50ms
          RteMappedToTaskRef = Appl_Task
          RteUsedOsEventRef = Rte_Ev_Cyclic_Appl_Task_0_50ms
          RteUsedOsAlarmRef = Rte_Al_TE_Appl_Task_0_50ms
        OIT_CS_Signal_Integrity_Fault_Injection_Read_CS_Signal_Integrity_Fault_Injection_Read (RteEventToTaskMapping): RteImmediateRestart=false, RteEventRef=OIT_CS_Signal_Integrity_Fault_Injection_Read_CS_Signal_Integrity_Fault_Injection_Read
    3 x RteSwComponentType:
      SWC_PLT_Appl_IntWDG: RteComponentTypeRef=SWC_PLT_Appl_IntWDG, RteImplementationRef=SWC_PLT_Appl_IntWDG_Implementation
        ComponentTypeCalibration (RteComponentTypeCalibration): RteCalibrationSupportEnabled=false
      SWC_PLT_CDD_WdgHandler: RteComponentTypeRef=SWC_PLT_CDD_WdgHandler, RteImplementationRef=SWC_PLT_CDD_WdgHandler_Implementation
        ComponentTypeCalibration (RteComponentTypeCalibration): RteCalibrationSupportEnabled=false
      SWC_Appl_Project: RteComponentTypeRef=SWC_Appl_Project, RteImplementationRef=SWC_Appl_Project_Implementation
        ComponentTypeCalibration (RteComponentTypeCalibration): RteCalibrationSupportEnabled=false
    ComXf (RteBswModuleInstance): RteBswImplementationRef=ComXf_Impl, RteBswModuleConfigurationRef=ComXf
    WdgM (RteBswModuleInstance): RteBswImplementationRef=WdgM_Impl, RteBswModuleConfigurationRef=WdgM
      WdgM_MainFunctionTimingEvent0 (RteBswEventToTaskMapping):
        RteBswImmediateRestart = false
        RteBswPositionInTask = 1
        RteBswEventRef = WdgM_MainFunctionTimingEvent0
        RteBswMappedToTaskRef = Appl_Task_High_Prio
        RteBswUsedOsEventRef = Rte_Ev_Cyclic2_Appl_Task_High_Prio_0_5ms
        RteBswUsedOsAlarmRef = Rte_Al_TE2_Appl_Task_High_Prio_0_5ms
      WDGM_EXCLUSIVE_AREA_0 (RteBswExclusiveAreaImpl): RteExclusiveAreaImplMechanism=ALL_INTERRUPT_BLOCKING, RteBswExclusiveAreaRef=WDGM_EXCLUSIVE_AREA_0
    SWC_PLT_CDD_FCRU_EcuSwComposition (RteSwComponentInstance): RteSoftwareComponentInstanceRef=SWC_PLT_CDD_FCRU
      3 x RteEventToTaskMapping, all with RteImmediateRestart=false:
        TMT_RE_PLT_FCRU_Main_50ms: RtePositionInTask=40, RteEventRef=TMT_RE_PLT_FCRU_Main_50ms, RteMappedToTaskRef=Appl_Task, RteUsedOsEventRef=Rte_Ev_Cyclic_Appl_Task_0_50ms, RteUsedOsAlarmRef=Rte_Al_TE_Appl_Task_0_50ms
        SWC_PLT_CDD_FCRU_InitEvent: RtePositionInTask=10, RteEventRef=SWC_PLT_CDD_FCRU_InitEvent, RteMappedToTaskRef=Appl_Init
        OIT_CS_FCRU_Fault_Injection_Read_CS_FCRU_Fault_Injection_Read: RteEventRef=OIT_CS_FCRU_Fault_Injection_Read_CS_FCRU_Fault_Injection_Read
    SWC_PLT_CDD_HIL_EcuSwComposition (RteSwComponentInstance): RteSoftwareComponentInstanceRef=SWC_PLT_CDD_HIL
      SWC_PLT_CDD_HIL_InitEvent (RteEventToTaskMapping): RteImmediateRestart=false, RtePositionInTask=0, RteEventRef=SWC_PLT_CDD_HIL_InitEvent, RteMappedToTaskRef=Init_Task_Qm
      EXTO_RE_HIL_Periodic_Handler_Rp_HIL_Periodic_Handler_Trigger (RteEventToTaskMapping):
        RteImmediateRestart = false
        RtePositionInTask = 8
        RteEventRef = EXTO_RE_HIL_Periodic_Handler_Rp_HIL_Periodic_Handler_Trigger
        RteMappedToTaskRef = Appl_Task_Logging
        RteUsedOsEventRef = Rte_Ev_Run_SWC_PLT_CDD_HIL_RE_HIL_Periodic_Handler_Rp_HIL_Periodic_Handler_Trigger
    SWC_PLT_CDD_FCRU (RteSwComponentType): RteComponentTypeRef=SWC_PLT_CDD_FCRU, RteImplementationRef=SWC_PLT_CDD_FCRU_Implementation
      ComponentTypeCalibration (RteComponentTypeCalibration): RteCalibrationSupportEnabled=false
    SWC_PLT_CDD_HIL (RteSwComponentType): RteComponentTypeRef=SWC_PLT_CDD_HIL, RteImplementationRef=SWC_PLT_CDD_HIL_Implementation
      ComponentTypeCalibration (RteComponentTypeCalibration): RteCalibrationSupportEnabled=false
    CanTSyn (RteBswModuleInstance): RteBswImplementationRef=CanTSyn_Impl, RteBswModuleConfigurationRef=CanTSyn
      CanTSyn_MainFunctionTimingEvent0 (RteBswEventToTaskMapping):
        RteBswImmediateRestart = false
        RteBswPositionInTask = 3
        RteBswEventRef = CanTSyn_MainFunctionTimingEvent0
        RteBswMappedToTaskRef = Appl_Task_High_Prio
        RteBswUsedOsEventRef = Rte_Ev_Cyclic2_Appl_Task_High_Prio_0_10ms
        RteBswUsedOsAlarmRef = Rte_Al_TE2_Appl_Task_High_Prio_0_10ms
      CANTSYN_EXCLUSIVE_AREA_0 (RteBswExclusiveAreaImpl): RteExclusiveAreaImplMechanism=ALL_INTERRUPT_BLOCKING, RteBswExclusiveAreaRef=CANTSYN_EXCLUSIVE_AREA_0
    SWC_PRJ_Appl_FaultMgr_EcuSwComposition (RteSwComponentInstance): RteSoftwareComponentInstanceRef=SWC_PRJ_Appl_FaultMgr
      20 x RteEventToTaskMapping, all with RteImmediateRestart=false:
        TMT_RE_PRJ_FaultMgr_50ms: RtePositionInTask=20, RteEventRef=TMT_RE_PRJ_FaultMgr_50ms, RteMappedToTaskRef=Appl_Task, RteUsedOsEventRef=Rte_Ev_Cyclic_Appl_Task_0_50ms, RteUsedOsAlarmRef=Rte_Al_TE_Appl_Task_0_50ms
        RE_PRJ_FaultMgr_InitEvent: RtePositionInTask=17, RteEventRef=RE_PRJ_FaultMgr_InitEvent, RteMappedToTaskRef=Appl_Init
        TMT_RE_PRJ_FaultMgr_DEM_50ms: RtePositionInTask=51, RteEventRef=TMT_RE_PRJ_FaultMgr_DEM_50ms, RteMappedToTaskRef=Appl_Task, RteUsedOsEventRef=Rte_Ev_Cyclic_Appl_Task_0_50ms, RteUsedOsAlarmRef=Rte_Al_TE_Appl_Task_0_50ms
        OIT_CS_Control_DTC_Service_Operation_CS_Control_DTC_Service_Operation: RteEventRef=OIT_CS_Control_DTC_Service_Operation_CS_Control_DTC_Service_Operation
        DRT_RE_VCAN_Timeout_Faults_100ms_1000ms_Event_Rp_VD_message_Non_Safety_Timeout_Status_De_Com_Rx_Vcan_Non_Safety_Timeout_Status: RtePositionInTask=7, RteEventRef=DRT_RE_VCAN_Timeout_Faults_100ms_1000ms_Event_Rp_VD_message_Non_Safety_Timeout_Status_De_Com_Rx_Vcan_Non_Safety_Timeout_Status, RteMappedToTaskRef=Appl_Task_Communication, RteUsedOsEventRef=Rte_Ev_Run_SWC_PRJ_Appl_FaultMgr_RE_VCAN_Timeout_Faults_100ms_1000ms_Event
        DRT_RE_VCAN_Timeout_Faults_100ms_1000ms_Event_Rp_TD_message_Non_Safety_Timeout_Status_De_Com_Rx_Vcan_Non_Safety_Timeout_Status: RtePositionInTask=7, RteEventRef=DRT_RE_VCAN_Timeout_Faults_100ms_1000ms_Event_Rp_TD_message_Non_Safety_Timeout_Status_De_Com_Rx_Vcan_Non_Safety_Timeout_Status, RteMappedToTaskRef=Appl_Task_Communication, RteUsedOsEventRef=Rte_Ev_Run_SWC_PRJ_Appl_FaultMgr_RE_VCAN_Timeout_Faults_100ms_1000ms_Event
        DRT_RE_PCAN_Timeout_Faults_Event_Rp_Radar_Status_1_Com_Rx_Timeout_Status_De_Com_Rx_Timeout_Status: RtePositionInTask=6, RteEventRef=DRT_RE_PCAN_Timeout_Faults_Event_Rp_Radar_Status_1_Com_Rx_Timeout_Status_De_Com_Rx_Timeout_Status, RteMappedToTaskRef=Appl_Task_Communication, RteUsedOsEventRef=Rte_Ev_Run_SWC_PRJ_Appl_FaultMgr_RE_PCAN_Timeout_Faults_Event
        DRT_RE_PCAN_Timeout_Faults_Event_Rp_Alignment_Status_1_Com_Rx_Timeout_Status_De_Com_Rx_Timeout_Status: RtePositionInTask=6, RteEventRef=DRT_RE_PCAN_Timeout_Faults_Event_Rp_Alignment_Status_1_Com_Rx_Timeout_Status_De_Com_Rx_Timeout_Status, RteMappedToTaskRef=Appl_Task_Communication, RteUsedOsEventRef=Rte_Ev_Run_SWC_PRJ_Appl_FaultMgr_RE_PCAN_Timeout_Faults_Event
        DRT_RE_VCAN_Timeout_Faults_10ms_20ms_50ms_Event_Rp_SAS_message_Non_Safety_Timeout_Status_De_Com_Rx_Vcan_Non_Safety_TimeoFAAB906B: RtePositionInTask=8, RteEventRef=DRT_RE_VCAN_Timeout_Faults_10ms_20ms_50ms_Event_Rp_SAS_message_Non_Safety_Timeout_Status_De_Com_Rx_Vcan_Non_Safety_TimeoFAAB906B, RteMappedToTaskRef=Appl_Task_Communication, RteUsedOsEventRef=Rte_Ev_Run_SWC_PRJ_Appl_FaultMgr_RE_VCAN_Timeout_Faults_10ms_20ms_50ms_Event
        DRT_RE_PCAN_Timeout_Faults_Event_Rp_Radar_Capability_Com_Rx_Timeout_Status_De_Com_Rx_Timeout_Status: RtePositionInTask=6, RteEventRef=DRT_RE_PCAN_Timeout_Faults_Event_Rp_Radar_Capability_Com_Rx_Timeout_Status_De_Com_Rx_Timeout_Status, RteMappedToTaskRef=Appl_Task_Communication, RteUsedOsEventRef=Rte_Ev_Run_SWC_PRJ_Appl_FaultMgr_RE_PCAN_Timeout_Faults_Event
        DRT_RE_PCAN_Timeout_Faults_Event_Rp_Radar_Status_2_Com_Rx_Timeout_Status_De_Com_Rx_Timeout_Status: RtePositionInTask=6, RteEventRef=DRT_RE_PCAN_Timeout_Faults_Event_Rp_Radar_Status_2_Com_Rx_Timeout_Status_De_Com_Rx_Timeout_Status, RteMappedToTaskRef=Appl_Task_Communication, RteUsedOsEventRef=Rte_Ev_Run_SWC_PRJ_Appl_FaultMgr_RE_PCAN_Timeout_Faults_Event
        DRT_RE_VCAN_Timeout_Faults_100ms_1000ms_Event_Rp_CLS_TX_16_message_Non_Safety_Timeout_Status_De_Com_Rx_Vcan_Non_Safety_T1AF7BF27: RtePositionInTask=7, RteEventRef=DRT_RE_VCAN_Timeout_Faults_100ms_1000ms_Event_Rp_CLS_TX_16_message_Non_Safety_Timeout_Status_De_Com_Rx_Vcan_Non_Safety_T1AF7BF27, RteMappedToTaskRef=Appl_Task_Communication, RteUsedOsEventRef=Rte_Ev_Run_SWC_PRJ_Appl_FaultMgr_RE_VCAN_Timeout_Faults_100ms_1000ms_Event
        DRT_RE_VCAN_Timeout_Faults_10ms_20ms_50ms_Event_Rp_ADAS_Function_Switch_message_Non_Safety_Timeout_Status_De_Com_Rx_Vcan730D83E3: RtePositionInTask=8, RteEventRef=DRT_RE_VCAN_Timeout_Faults_10ms_20ms_50ms_Event_Rp_ADAS_Function_Switch_message_Non_Safety_Timeout_Status_De_Com_Rx_Vcan730D83E3, RteMappedToTaskRef=Appl_Task_Communication, RteUsedOsEventRef=Rte_Ev_Run_SWC_PRJ_Appl_FaultMgr_RE_VCAN_Timeout_Faults_10ms_20ms_50ms_Event
        DRT_RE_VCAN_Timeout_Faults_10ms_20ms_50ms_Event_Rp_VDC2_message_Vcan_Safety_Timeout_Status_De_Com_Rx_Vcan_Timeout_Status: RtePositionInTask=8, RteEventRef=DRT_RE_VCAN_Timeout_Faults_10ms_20ms_50ms_Event_Rp_VDC2_message_Vcan_Safety_Timeout_Status_De_Com_Rx_Vcan_Timeout_Status, RteMappedToTaskRef=Appl_Task_Communication, RteUsedOsEventRef=Rte_Ev_Run_SWC_PRJ_Appl_FaultMgr_RE_VCAN_Timeout_Faults_10ms_20ms_50ms_Event
        DRT_RE_VCAN_Timeout_Faults_10ms_20ms_50ms_Event_Rp_CCVS1_message_Vcan_Safety_Timeout_Status_De_Com_Rx_Vcan_Timeout_Status: RtePositionInTask=8, RteEventRef=DRT_RE_VCAN_Timeout_Faults_10ms_20ms_50ms_Event_Rp_CCVS1_message_Vcan_Safety_Timeout_Status_De_Com_Rx_Vcan_Timeout_Status, RteMappedToTaskRef=Appl_Task_Communication, RteUsedOsEventRef=Rte_Ev_Run_SWC_PRJ_Appl_FaultMgr_RE_VCAN_Timeout_Faults_10ms_20ms_50ms_Event
        DRT_RE_PCAN_Timeout_Faults_Event_Rp_Header_msg_Com_Rx_Timeout_Status_De_Com_Rx_Timeout_Status: RtePositionInTask=6, RteEventRef=DRT_RE_PCAN_Timeout_Faults_Event_Rp_Header_msg_Com_Rx_Timeout_Status_De_Com_Rx_Timeout_Status, RteMappedToTaskRef=Appl_Task_Communication, RteUsedOsEventRef=Rte_Ev_Run_SWC_PRJ_Appl_FaultMgr_RE_PCAN_Timeout_Faults_Event
        DRT_RE_VCAN_Timeout_Faults_100ms_1000ms_Event_Rp_ETC2_MT_Variant_message_Vcan_Safety_Timeout_Status_De_Com_Rx_Vcan_TimeoB50257A3: RtePositionInTask=7, RteEventRef=DRT_RE_VCAN_Timeout_Faults_100ms_1000ms_Event_Rp_ETC2_MT_Variant_message_Vcan_Safety_Timeout_Status_De_Com_Rx_Vcan_TimeoB50257A3, RteMappedToTaskRef=Appl_Task_Communication, RteUsedOsEventRef=Rte_Ev_Run_SWC_PRJ_Appl_FaultMgr_RE_VCAN_Timeout_Faults_100ms_1000ms_Event
        DRT_RE_VCAN_Timeout_Faults_100ms_1000ms_Event_Rp_ETC2_AT_AMT_message_Vcan_Safety_Timeout_Status_De_Com_Rx_Vcan_Timeout_Status: RtePositionInTask=7, RteEventRef=DRT_RE_VCAN_Timeout_Faults_100ms_1000ms_Event_Rp_ETC2_AT_AMT_message_Vcan_Safety_Timeout_Status_De_Com_Rx_Vcan_Timeout_Status, RteMappedToTaskRef=Appl_Task_Communication, RteUsedOsEventRef=Rte_Ev_Run_SWC_PRJ_Appl_FaultMgr_RE_VCAN_Timeout_Faults_100ms_1000ms_Event
        DRT_RE_VCAN_Timeout_Faults_100ms_1000ms_Event_Rp_CLS_TX_4_message_Non_Safety_Timeout_Status_De_Com_Rx_Vcan_Non_Safety_TiECCFE111: RtePositionInTask=7, RteEventRef=DRT_RE_VCAN_Timeout_Faults_100ms_1000ms_Event_Rp_CLS_TX_4_message_Non_Safety_Timeout_Status_De_Com_Rx_Vcan_Non_Safety_TiECCFE111, RteMappedToTaskRef=Appl_Task_Communication, RteUsedOsEventRef=Rte_Ev_Run_SWC_PRJ_Appl_FaultMgr_RE_VCAN_Timeout_Faults_100ms_1000ms_Event
        DRT_RE_VCAN_Timeout_Faults_100ms_1000ms_Event_Rp_OEL_message_Non_Safety_Timeout_Status_De_Com_Rx_Vcan_Non_Safety_Timeout_Status: RtePositionInTask=7, RteEventRef=DRT_RE_VCAN_Timeout_Faults_100ms_1000ms_Event_Rp_OEL_message_Non_Safety_Timeout_Status_De_Com_Rx_Vcan_Non_Safety_Timeout_Status, RteMappedToTaskRef=Appl_Task_Communication, RteUsedOsEventRef=Rte_Ev_Run_SWC_PRJ_Appl_FaultMgr_RE_VCAN_Timeout_Faults_100ms_1000ms_Event
    SWC_PRJ_Appl_FaultMgr (RteSwComponentType): RteComponentTypeRef=SWC_PRJ_Appl_FaultMgr, RteImplementationRef=SWC_PRJ_Appl_FaultMgr_Implementation
      ComponentTypeCalibration (RteComponentTypeCalibration): RteCalibrationSupportEnabled=false
    SWC_PLT_CDD_TimeSync_EcuSwComposition (RteSwComponentInstance): RteSoftwareComponentInstanceRef=SWC_PLT_CDD_TimeSync
      TMT_RE_PLT_TimeSync_Main_50ms (RteEventToTaskMapping):
        RteImmediateRestart = false
        RtePositionInTask = 50
        RteEventRef = TMT_RE_PLT_TimeSync_Main_50ms
        RteMappedToTaskRef = Appl_Task
        RteUsedOsEventRef = Rte_Ev_Cyclic_Appl_Task_0_50ms
        RteUsedOsAlarmRef = Rte_Al_TE_Appl_Task_0_50ms
      TimeSync_ExclusiveArea (RteExclusiveAreaImplementation): RteExclusiveAreaImplMechanism=ALL_INTERRUPT_BLOCKING, RteExclusiveAreaOptimization=false, RteExclusiveAreaRef=TimeSync_ExclusiveArea
      DRT_DRE_StatusNotification_Callback_Rp_StbMStatusNotificationCallback_StbMSynchronizedTimeBase_eventNotification (RteEventToTaskMapping):
        RteImmediateRestart = false
        RtePositionInTask = 25
        RteEventRef = DRT_DRE_StatusNotification_Callback_Rp_StbMStatusNotificationCallback_StbMSynchronizedTimeBase_eventNotification
        RteMappedToTaskRef = BSW_Task
        RteUsedOsEventRef = Rte_Ev_Run_SWC_PLT_CDD_TimeSync_DRE_StatusNotification_Callback
      SWC_PLT_CDD_TimeSync_InitEvent (RteEventToTaskMapping): RteImmediateRestart=false, RtePositionInTask=23, RteEventRef=SWC_PLT_CDD_TimeSync_InitEvent, RteMappedToTaskRef=Appl_Init
    SWC_PLT_CDD_TimeSync (RteSwComponentType): RteComponentTypeRef=SWC_PLT_CDD_TimeSync, RteImplementationRef=SWC_PLT_CDD_TimeSync_Implementation
      ComponentTypeCalibration (RteComponentTypeCalibration): RteCalibrationSupportEnabled=false
    3 x RteBswModuleInstance:
      Wdg: RteBswImplementationRef=Wdg_Impl, RteBswModuleConfigurationRef=Wdg
        WDG_EXCLUSIVE_AREA_0 (RteBswExclusiveAreaImpl): RteExclusiveAreaImplMechanism=ALL_INTERRUPT_BLOCKING, RteBswExclusiveAreaRef=WDG_EXCLUSIVE_AREA_0
      Crypto: RteBswImplementationRef=Crypto_Impl, RteBswModuleConfigurationRef=Crypto
        CRYPTO_EXCLUSIVE_AREA_0 (RteBswExclusiveAreaImpl): RteExclusiveAreaImplMechanism=ALL_INTERRUPT_BLOCKING, RteBswExclusiveAreaRef=CRYPTO_EXCLUSIVE_AREA_0
        CRYPTO_EXCLUSIVE_AREA_1 (RteBswExclusiveAreaImpl): RteExclusiveAreaImplMechanism=ALL_INTERRUPT_BLOCKING, RteBswExclusiveAreaRef=CRYPTO_EXCLUSIVE_AREA_1
        Crypto_182_iND13400_MainFunctionTimingEvent0 (RteBswEventToTaskMapping):
          RteBswImmediateRestart = false
          RteBswPositionInTask = 20
          RteBswEventRef = Crypto_182_iND13400_MainFunctionTimingEvent0
          RteBswMappedToTaskRef = BSW_Task
          RteBswUsedOsEventRef = Rte_Ev_Cyclic2_BSW_Task_0_10ms
          RteBswUsedOsAlarmRef = Rte_Al_TE2_BSW_Task_0_10ms
      Csm: RteBswImplementationRef=Csm_Impl, RteBswModuleConfigurationRef=Csm
        CSM_EXCLUSIVE_AREA_0 (RteBswExclusiveAreaImpl): RteExclusiveAreaImplMechanism=ALL_INTERRUPT_BLOCKING, RteBswExclusiveAreaRef=CSM_EXCLUSIVE_AREA_0
        Csm_MainFunctionTimingEvent0 (RteBswEventToTaskMapping):
          RteBswImmediateRestart = false
          RteBswPositionInTask = 21
          RteBswEventRef = Csm_MainFunctionTimingEvent0
          RteBswMappedToTaskRef = BSW_Task
          RteBswUsedOsEventRef = Rte_Ev_Cyclic2_BSW_Task_0_10ms
          RteBswUsedOsAlarmRef = Rte_Al_TE2_BSW_Task_0_10ms
    Csm_EcuSwComposition (RteSwComponentInstance): RteSoftwareComponentInstanceRef=Csm
      Timer_Csm_MainFunction (RteEventToTaskMapping):
        RteImmediateRestart = false
        RtePositionInTask = 21
        RteEventRef = Timer_Csm_MainFunction
        RteMappedToTaskRef = BSW_Task
        RteUsedOsEventRef = Rte_Ev_Cyclic2_BSW_Task_0_10ms
        RteUsedOsAlarmRef = Rte_Al_TE2_BSW_Task_0_10ms
    4 x RteBswModuleInstance:
      EthTrcv: RteBswImplementationRef=EthTrcv_Impl, RteBswModuleConfigurationRef=EthTrcv_RTL
        EthTrcv_30_Rtl9010_MainFunctionTimingEvent0 (RteBswEventToTaskMapping): RteBswImmediateRestart=false, RteBswPositionInTask=10, RteBswEventRef=EthTrcv_30_Rtl9010_MainFunctionTimingEvent0
        10 x RteBswExclusiveAreaImpl, all with RteExclusiveAreaImplMechanism=ALL_INTERRUPT_BLOCKING:
          ETHTRCV_30_RTL9010_EXCLUSIVE_AREA_MACSEC: RteBswExclusiveAreaRef=ETHTRCV_30_RTL9010_EXCLUSIVE_AREA_MACSEC
          ETHTRCV_30_RTL9010_EXCLUSIVE_AREA_MODE: RteBswExclusiveAreaRef=ETHTRCV_30_RTL9010_EXCLUSIVE_AREA_MODE
          ETHTRCV_30_RTL9010_EXCLUSIVE_AREA_CL45: RteBswExclusiveAreaRef=ETHTRCV_30_RTL9010_EXCLUSIVE_AREA_CL45
          ETHTRCV_30_RTL9010_EXCLUSIVE_AREA_MACSEC64: RteBswExclusiveAreaRef=ETHTRCV_30_RTL9010_EXCLUSIVE_AREA_MACSEC64
          ETHTRCV_30_RTL9010_EXCLUSIVE_AREA_MACSEC32: RteBswExclusiveAreaRef=ETHTRCV_30_RTL9010_EXCLUSIVE_AREA_MACSEC32
          ETHTRCV_30_RTL9010_EXCLUSIVE_AREA_LINK: RteBswExclusiveAreaRef=ETHTRCV_30_RTL9010_EXCLUSIVE_AREA_LINK
          ETHTRCV_30_RTL9010_EXCLUSIVE_AREA_WAKEUP: RteBswExclusiveAreaRef=ETHTRCV_30_RTL9010_EXCLUSIVE_AREA_WAKEUP
          ETHTRCV_30_RTL9010_EXCLUSIVE_AREA_DIAGNOSTICS: RteBswExclusiveAreaRef=ETHTRCV_30_RTL9010_EXCLUSIVE_AREA_DIAGNOSTICS
          ETHTRCV_30_RTL9010_EXCLUSIVE_AREA_AUTONEG: RteBswExclusiveAreaRef=ETHTRCV_30_RTL9010_EXCLUSIVE_AREA_AUTONEG
          ETHTRCV_30_RTL9010_EXCLUSIVE_AREA_HWINIT: RteBswExclusiveAreaRef=ETHTRCV_30_RTL9010_EXCLUSIVE_AREA_HWINIT
      Uart: RteBswImplementationRef=Uart_Impl, RteBswModuleConfigurationRef=Uart
        Uart_MainFunctionTimingEvent0 (RteBswEventToTaskMapping): RteBswImmediateRestart=false, RteBswEventRef=Uart_MainFunctionTimingEvent0
      Dem: RteBswImplementationRef=Dem_Impl, RteBswModuleConfigurationRef=Dem
        Dem_MasterMainFunctionTimingEvent0 (RteBswEventToTaskMapping):
          RteBswImmediateRestart = false
          RteBswPositionInTask = 3
          RteBswEventRef = Dem_MasterMainFunctionTimingEvent0
          RteBswMappedToTaskRef = BSW_Task
          RteBswUsedOsEventRef = Rte_Ev_Cyclic2_BSW_Task_0_10ms
          RteBswUsedOsAlarmRef = Rte_Al_TE2_BSW_Task_0_10ms
        Dem_SatelliteMainFunctionTimingEvent0 (RteBswEventToTaskMapping):
          RteBswImmediateRestart = false
          RteBswPositionInTask = 22
          RteBswEventRef = Dem_SatelliteMainFunctionTimingEvent0
          RteBswMappedToTaskRef = BSW_Task
          RteBswUsedOsEventRef = Rte_Ev_Cyclic2_BSW_Task_0_10ms
          RteBswUsedOsAlarmRef = Rte_Al_TE2_BSW_Task_0_10ms
        5 x RteBswExclusiveAreaImpl, all with RteExclusiveAreaImplMechanism=ALL_INTERRUPT_BLOCKING:
          DEM_EXCLUSIVE_AREA_3: RteBswExclusiveAreaRef=DEM_EXCLUSIVE_AREA_3
          DEM_EXCLUSIVE_AREA_0: RteBswExclusiveAreaRef=DEM_EXCLUSIVE_AREA_0
          DEM_EXCLUSIVE_AREA_4: RteBswExclusiveAreaRef=DEM_EXCLUSIVE_AREA_4
          DEM_EXCLUSIVE_AREA_1: RteBswExclusiveAreaRef=DEM_EXCLUSIVE_AREA_1
          DEM_EXCLUSIVE_AREA_2: RteBswExclusiveAreaRef=DEM_EXCLUSIVE_AREA_2
      J1939Tp: RteBswImplementationRef=J1939Tp_Impl, RteBswModuleConfigurationRef=J1939Tp
        J1939Tp_MainFunctionTimingEvent0 (RteBswEventToTaskMapping): RteBswImmediateRestart=false, RteBswEventRef=J1939Tp_MainFunctionTimingEvent0
        3 x RteBswExclusiveAreaImpl, all with RteExclusiveAreaImplMechanism=ALL_INTERRUPT_BLOCKING:
          J1939TP_EXCLUSIVE_AREA_TXNPDULOCK: RteBswExclusiveAreaRef=J1939TP_EXCLUSIVE_AREA_TXNPDULOCK
          J1939TP_EXCLUSIVE_AREA_RXNSDULOCK: RteBswExclusiveAreaRef=J1939TP_EXCLUSIVE_AREA_RXNSDULOCK
          J1939TP_EXCLUSIVE_AREA_TXNSDULOCK: RteBswExclusiveAreaRef=J1939TP_EXCLUSIVE_AREA_TXNSDULOCK
    SWC_PRJ_Appl_Power_Manager_EcuSwComposition (RteSwComponentInstance): RteSoftwareComponentInstanceRef=SWC_PRJ_Appl_Power_Manager
      SWC_PRJ_Appl_Power_Manager_InitEvent (RteEventToTaskMapping): RteImmediateRestart=false, RtePositionInTask=14, RteEventRef=SWC_PRJ_Appl_Power_Manager_InitEvent, RteMappedToTaskRef=Appl_Init
      TMT_RE_Power_Manager_5ms (RteEventToTaskMapping):
        RteImmediateRestart = false
        RtePositionInTask = 15
        RteEventRef = TMT_RE_Power_Manager_5ms
        RteMappedToTaskRef = Appl_Task
        RteUsedOsEventRef = Rte_Ev_Cyclic_Appl_Task_0_5ms
        RteUsedOsAlarmRef = Rte_Al_TE_Appl_Task_0_5ms
    SWC_PRJ_Appl_Power_Manager (RteSwComponentType): RteComponentTypeRef=SWC_PRJ_Appl_Power_Manager, RteImplementationRef=SWC_PRJ_Appl_Power_Manager_Implementation
      ComponentTypeCalibration (RteComponentTypeCalibration): RteCalibrationSupportEnabled=false
    CanTp (RteBswModuleInstance): RteBswImplementationRef=CanTp_Impl, RteBswModuleConfigurationRef=CanTp
      CanTp_MainFunctionTimingEvent0 (RteBswEventToTaskMapping):
        RteBswImmediateRestart = false
        RteBswPositionInTask = 23
        RteBswEventRef = CanTp_MainFunctionTimingEvent0
        RteBswMappedToTaskRef = BSW_Task
        RteBswUsedOsEventRef = Rte_Ev_Cyclic2_BSW_Task_0_5ms
        RteBswUsedOsAlarmRef = Rte_Al_TE2_BSW_Task_0_5ms
      CANTP_EXCLUSIVE_AREA_0 (RteBswExclusiveAreaImpl): RteExclusiveAreaImplMechanism=ALL_INTERRUPT_BLOCKING, RteBswExclusiveAreaRef=CANTP_EXCLUSIVE_AREA_0
    Dcm (RteBswModuleInstance): RteBswImplementationRef=Dcm_Impl, RteBswModuleConfigurationRef=Dcm
      Dcm_MainFunctionTimingEvent0 (RteBswEventToTaskMapping):
        RteBswImmediateRestart = false
        RteBswPositionInTask = 24
        RteBswEventRef = Dcm_MainFunctionTimingEvent0
        RteBswMappedToTaskRef = BSW_Task
        RteBswUsedOsEventRef = Rte_Ev_Cyclic2_BSW_Task_0_10ms
        RteBswUsedOsAlarmRef = Rte_Al_TE2_BSW_Task_0_10ms
      DCM_EXCLUSIVE_AREA_0 (RteBswExclusiveAreaImpl): RteExclusiveAreaImplMechanism=ALL_INTERRUPT_BLOCKING, RteBswExclusiveAreaRef=DCM_EXCLUSIVE_AREA_0
    Dcm_EcuSwComposition (RteSwComponentInstance): RteSoftwareComponentInstanceRef=Dcm
      7 x RteEventToTaskMapping, all with RteImmediateRestart=false:
        Timer_Dcm_MainFunction: RtePositionInTask=24, RteEventRef=Timer_Dcm_MainFunction, RteMappedToTaskRef=BSW_Task, RteUsedOsEventRef=Rte_Ev_Cyclic2_BSW_Task_0_10ms, RteUsedOsAlarmRef=Rte_Al_TE2_BSW_Task_0_10ms
        OpEventGetActiveProtocol_GetActiveProtocol_DCMServices: RteEventRef=OpEventGetActiveProtocol_GetActiveProtocol_DCMServices
        OpEventGetSesCtrlType_GetSesCtrlType_DCMServices: RteEventRef=OpEventGetSesCtrlType_GetSesCtrlType_DCMServices
        OpEventResetToDefaultSession_ResetToDefaultSession_DCMServices: RteEventRef=OpEventResetToDefaultSession_ResetToDefaultSession_DCMServices
        OpEventGetSecurityLevel_GetSecurityLevel_DCMServices: RteEventRef=OpEventGetSecurityLevel_GetSecurityLevel_DCMServices
        OpEventSetActiveDiagnostic_SetActiveDiagnostic_DCMServices: RteEventRef=OpEventSetActiveDiagnostic_SetActiveDiagnostic_DCMServices
        OpEventGetRequestKind_GetRequestKind_DCMServices: RteEventRef=OpEventGetRequestKind_GetRequestKind_DCMServices
    SWC_CMP_PRJ_UDSHandler_EcuSwComposition (RteSwComponentInstance): RteSoftwareComponentInstanceRef=SWC_CMP_PRJ_UDSHandler
      4 x RteEventToTaskMapping, all with RteImmediateRestart=false:
        OIT_DataServices_Data_0xF190_VIN_WriteData_DataServices_Data_0xF190_VIN_WriteData: RteEventRef=OIT_DataServices_Data_0xF190_VIN_WriteData_DataServices_Data_0xF190_VIN_WriteData
        OIT_DataServices_Data_0xF190_VIN_ConditionCheckRead_DataServices_Data_0xF190_VIN_ConditionCheckRead: RteEventRef=OIT_DataServices_Data_0xF190_VIN_ConditionCheckRead_DataServices_Data_0xF190_VIN_ConditionCheckRead
        OIT_DataServices_Data_0xF190_VIN_ReadData_DataServices_Data_0xF190_VIN_ReadData: RteEventRef=OIT_DataServices_Data_0xF190_VIN_ReadData_DataServices_Data_0xF190_VIN_ReadData
        TMT_RE_SWC_CMP_PRJ_UDSHandler_Main_50ms: RtePositionInTask=9, RteEventRef=TMT_RE_SWC_CMP_PRJ_UDSHandler_Main_50ms, RteMappedToTaskRef=Appl_Task_Logging, RteUsedOsEventRef=Rte_Ev_Run_SWC_CMP_PRJ_UDSHandler_RE_SWC_CMP_PRJ_UDSHandler_Main_50ms, RteUsedOsAlarmRef=Rte_Al_TE_SWC_CMP_PRJ_UDSHandler_RE_SWC_CMP_PRJ_UDSHandler_Main_50ms
      NvmBlock_SWC_CMP_PRJ_UDSHandler_SWC_UDSHandler_VIN (RteNvRamAllocation):
        RteNvmRamBlockLocationSymbol = Rte_SWC_CMP_PRJ_UDSHandler_SWC_UDS_VIN
        RteNvmRomBlockLocationSymbol = Rte_SWC_CMP_PRJ_UDSHandler_SWC_UDSHandler_VIN_DefaultValue
        RteNvmBlockRef = SWC_CMP_PRJ_UDSHandlerSWC_UDSHandler_VIN
        RteSwNvRamMappingRef = SWC_UDSHandler_VIN
      62 x RteEventToTaskMapping, all with RteImmediateRestart=false:
        OIT_DataServices_Data_0xF180_BootloaderNumber_ReadData_DataServices_Data_0xF180_BootloaderNumber_ReadData: RteEventRef=OIT_DataServices_Data_0xF180_BootloaderNumber_ReadData_DataServices_Data_0xF180_BootloaderNumber_ReadData
        OIT_DataServices_Data_0xF189_Base_Software_Version_number_ConditionCheckRead_DataServices_Data_0xF189_Base_Software_Vers7E0CB6E2: RteEventRef=OIT_DataServices_Data_0xF189_Base_Software_Version_number_ConditionCheckRead_DataServices_Data_0xF189_Base_Software_Vers7E0CB6E2
        OIT_DataServices_Data_0xF16A_Boot_App_Identification_ReadData_DataServices_Data_0xF16A_Boot_App_Identification_ReadData: RteEventRef=OIT_DataServices_Data_0xF16A_Boot_App_Identification_ReadData_DataServices_Data_0xF16A_Boot_App_Identification_ReadData
        OIT_DataServices_Data_0xF19E_PCAN_DBC_Version_ReadData_DataServices_Data_0xF19E_PCAN_DBC_Version_ReadData: RteEventRef=OIT_DataServices_Data_0xF19E_PCAN_DBC_Version_ReadData_DataServices_Data_0xF19E_PCAN_DBC_Version_ReadData
        OIT_DataServices_Data_0xF150_Hardware_Version_number_ReadData_DataServices_Data_0xF150_Hardware_Version_number_ReadData: RteEventRef=OIT_DataServices_Data_0xF150_Hardware_Version_number_ReadData_DataServices_Data_0xF150_Hardware_Version_number_ReadData
        OIT_DataServices_Data_0x1117_Sensor_Availability_Flag_ReadData_DataServices_Data_0x1117_Sensor_Availability_Flag_ReadData: RteEventRef=OIT_DataServices_Data_0x1117_Sensor_Availability_Flag_ReadData_DataServices_Data_0x1117_Sensor_Availability_Flag_ReadData
        OIT_DataServices_Data_0xF180_BootloaderNumber_ConditionCheckRead_DataServices_Data_0xF180_BootloaderNumber_ConditionCheckRead: RteEventRef=OIT_DataServices_Data_0xF180_BootloaderNumber_ConditionCheckRead_DataServices_Data_0xF180_BootloaderNumber_ConditionCheckRead
        OIT_DataServices_Data_0xF150_Hardware_Version_number_ConditionCheckRead_DataServices_Data_0xF150_Hardware_Version_number5319F0E0: RteEventRef=OIT_DataServices_Data_0xF150_Hardware_Version_number_ConditionCheckRead_DataServices_Data_0xF150_Hardware_Version_number5319F0E0
        OIT_DataServices_Data_0x1111_ECUVoltage_ReadData_DataServices_Data_0x1111_ECUVoltage_ReadData: RteEventRef=OIT_DataServices_Data_0x1111_ECUVoltage_ReadData_DataServices_Data_0x1111_ECUVoltage_ReadData
        OIT_DataServices_Data_0xA002_Dataset_Part_No_and_Revision_ConditionCheckRead_DataServices_Data_0xA002_Dataset_Part_No_an2C00C244: RteEventRef=OIT_DataServices_Data_0xA002_Dataset_Part_No_and_Revision_ConditionCheckRead_DataServices_Data_0xA002_Dataset_Part_No_an2C00C244
        OIT_DataServices_Data_0x1116_DateandTime_ConditionCheckRead_DataServices_Data_0x1116_DateandTime_ConditionCheckRead: RteEventRef=OIT_DataServices_Data_0x1116_DateandTime_ConditionCheckRead_DataServices_Data_0x1116_DateandTime_ConditionCheckRead
        OIT_DataServices_Data_0xF191_HardwareNumber_ReadData_DataServices_Data_0xF191_HardwareNumber_ReadData: RteEventRef=OIT_DataServices_Data_0xF191_HardwareNumber_ReadData_DataServices_Data_0xF191_HardwareNumber_ReadData
        OIT_DataServices_Data_0xF017_Pin_Position_Status_ConditionCheckRead_DataServices_Data_0xF017_Pin_Position_Status_Conditi46601389: RteEventRef=OIT_DataServices_Data_0xF017_Pin_Position_Status_ConditionCheckRead_DataServices_Data_0xF017_Pin_Position_Status_Conditi46601389
        OIT_DataServices_Data_0xF186_ActiveDiagnosticSessionDataIdentifier_ConditionCheckRead_DataServices_Data_0xF186_ActiveDia76F3A2B5: RteEventRef=OIT_DataServices_Data_0xF186_ActiveDiagnosticSessionDataIdentifier_ConditionCheckRead_DataServices_Data_0xF186_ActiveDia76F3A2B5
        OIT_DataServices_Data_0xA004_Ego_Acceleration_ConditionCheckRead_DataServices_Data_0xA004_Ego_Acceleration_ConditionCheckRead: RteEventRef=OIT_DataServices_Data_0xA004_Ego_Acceleration_ConditionCheckRead_DataServices_Data_0xA004_Ego_Acceleration_ConditionCheckRead
        OIT_DataServices_Data_0xA001_SoftwareNumber_ConditionCheckRead_DataServices_Data_0xA001_SoftwareNumber_ConditionCheckRead: RteEventRef=OIT_DataServices_Data_0xA001_SoftwareNumber_ConditionCheckRead_DataServices_Data_0xA001_SoftwareNumber_ConditionCheckRead
        OIT_DataServices_Data_0x1117_Sensor_Availability_Flag_ConditionCheckRead_DataServices_Data_0x1117_Sensor_Availability_FlC3AC68A5: RteEventRef=OIT_DataServices_Data_0x1117_Sensor_Availability_Flag_ConditionCheckRead_DataServices_Data_0x1117_Sensor_Availability_FlC3AC68A5
        OIT_DataServices_Data_0xA000_SerialNumber_ConditionCheckRead_DataServices_Data_0xA000_SerialNumber_ConditionCheckRead: RteEventRef=OIT_DataServices_Data_0xA000_SerialNumber_ConditionCheckRead_DataServices_Data_0xA000_SerialNumber_ConditionCheckRead
        OIT_DataServices_Data_0xA003_SMC_Part_No_and_Revision_ReadData_DataServices_Data_0xA003_SMC_Part_No_and_Revision_ReadData: RteEventRef=OIT_DataServices_Data_0xA003_SMC_Part_No_and_Revision_ReadData_DataServices_Data_0xA003_SMC_Part_No_and_Revision_ReadData
        OIT_DataServices_Data_0x1111_ECUVoltage_ConditionCheckRead_DataServices_Data_0x1111_ECUVoltage_ConditionCheckRead: RteEventRef=OIT_DataServices_Data_0x1111_ECUVoltage_ConditionCheckRead_DataServices_Data_0x1111_ECUVoltage_ConditionCheckRead
        OIT_DataServices_Data_0x1112_VehicleSpeed_ConditionCheckRead_DataServices_Data_0x1112_VehicleSpeed_ConditionCheckRead: RteEventRef=OIT_DataServices_Data_0x1112_VehicleSpeed_ConditionCheckRead_DataServices_Data_0x1112_VehicleSpeed_ConditionCheckRead
        OIT_DataServices_Data_0xA002_Dataset_Part_No_and_Revision_ReadData_DataServices_Data_0xA002_Dataset_Part_No_and_Revision58D1EF9A: RteEventRef=OIT_DataServices_Data_0xA002_Dataset_Part_No_and_Revision_ReadData_DataServices_Data_0xA002_Dataset_Part_No_and_Revision58D1EF9A
        OIT_DataServices_Data_0xA001_SoftwareNumber_ReadData_DataServices_Data_0xA001_SoftwareNumber_ReadData: RteEventRef=OIT_DataServices_Data_0xA001_SoftwareNumber_ReadData_DataServices_Data_0xA001_SoftwareNumber_ReadData
        OIT_DataServices_Data_0xF19D_CANDBMatrixVer_ConditionCheckRead_DataServices_Data_0xF19D_CANDBMatrixVer_ConditionCheckRead: RteEventRef=OIT_DataServices_Data_0xF19D_CANDBMatrixVer_ConditionCheckRead_DataServices_Data_0xF19D_CANDBMatrixVer_ConditionCheckRead
        OIT_DataServices_Data_0xF191_HardwareNumber_ConditionCheckRead_DataServices_Data_0xF191_HardwareNumber_ConditionCheckRead: RteEventRef=OIT_DataServices_Data_0xF191_HardwareNumber_ConditionCheckRead_DataServices_Data_0xF191_HardwareNumber_ConditionCheckRead
        OIT_DataServices_Data_0xF189_Base_Software_Version_number_ReadData_DataServices_Data_0xF189_Base_Software_Version_number3E358C8D: RteEventRef=OIT_DataServices_Data_0xF189_Base_Software_Version_number_ReadData_DataServices_Data_0xF189_Base_Software_Version_number3E358C8D
        OIT_DataServices_Data_0xF010_Vehicle_Variant_ReadData_DataServices_Data_0xF010_Vehicle_Variant_ReadData: RteEventRef=OIT_DataServices_Data_0xF010_Vehicle_Variant_ReadData_DataServices_Data_0xF010_Vehicle_Variant_ReadData
        OIT_DataServices_Data_0x1116_DateandTime_ReadData_DataServices_Data_0x1116_DateandTime_ReadData: RteEventRef=OIT_DataServices_Data_0x1116_DateandTime_ReadData_DataServices_Data_0x1116_DateandTime_ReadData
        OIT_DataServices_Data_0xF16A_Boot_App_Identification_ConditionCheckRead_DataServices_Data_0xF16A_Boot_App_Identification9C41B615: RteEventRef=OIT_DataServices_Data_0xF16A_Boot_App_Identification_ConditionCheckRead_DataServices_Data_0xF16A_Boot_App_Identification9C41B615
        OIT_DataServices_Data_0xF15A_Software_Fingerprint_ReadData_DataServices_Data_0xF15A_Software_Fingerprint_ReadData: RteEventRef=OIT_DataServices_Data_0xF15A_Software_Fingerprint_ReadData_DataServices_Data_0xF15A_Software_Fingerprint_ReadData
        OIT_DataServices_Data_0xA003_SMC_Part_No_and_Revision_ConditionCheckRead_DataServices_Data_0xA003_SMC_Part_No_and_Revisi4479C802: RteEventRef=OIT_DataServices_Data_0xA003_SMC_Part_No_and_Revision_ConditionCheckRead_DataServices_Data_0xA003_SMC_Part_No_and_Revisi4479C802
        OIT_DataServices_Data_0xF186_ActiveDiagnosticSessionDataIdentifier_ReadData_DataServices_Data_0xF186_ActiveDiagnosticSes4023728F: RteEventRef=OIT_DataServices_Data_0xF186_ActiveDiagnosticSessionDataIdentifier_ReadData_DataServices_Data_0xF186_ActiveDiagnosticSes4023728F
        OIT_DataServices_Data_0xF15A_Software_Fingerprint_WriteData_DataServices_Data_0xF15A_Software_Fingerprint_WriteData: RteEventRef=OIT_DataServices_Data_0xF15A_Software_Fingerprint_WriteData_DataServices_Data_0xF15A_Software_Fingerprint_WriteData
        OIT_DataServices_Data_0x1112_VehicleSpeed_ReadData_DataServices_Data_0x1112_VehicleSpeed_ReadData: RteEventRef=OIT_DataServices_Data_0x1112_VehicleSpeed_ReadData_DataServices_Data_0x1112_VehicleSpeed_ReadData
        OIT_DataServices_Data_0xF18B_ECUBuildDate_ConditionCheckRead_DataServices_Data_0xF18B_ECUBuildDate_ConditionCheckRead: RteEventRef=OIT_DataServices_Data_0xF18B_ECUBuildDate_ConditionCheckRead_DataServices_Data_0xF18B_ECUBuildDate_ConditionCheckRead
        OIT_DataServices_Data_0xA000_SerialNumber_ReadData_DataServices_Data_0xA000_SerialNumber_ReadData: RteEventRef=OIT_DataServices_Data_0xA000_SerialNumber_ReadData_DataServices_Data_0xA000_SerialNumber_ReadData
        OIT_DataServices_Data_0xF19E_PCAN_DBC_Version_ConditionCheckRead_DataServices_Data_0xF19E_PCAN_DBC_Version_ConditionCheckRead: RteEventRef=OIT_DataServices_Data_0xF19E_PCAN_DBC_Version_ConditionCheckRead_DataServices_Data_0xF19E_PCAN_DBC_Version_ConditionCheckRead
        OIT_DataServices_Data_0xA004_Ego_Acceleration_ReadData_DataServices_Data_0xA004_Ego_Acceleration_ReadData: RteEventRef=OIT_DataServices_Data_0xA004_Ego_Acceleration_ReadData_DataServices_Data_0xA004_Ego_Acceleration_ReadData
        OIT_DataServices_Data_0xF19D_CANDBMatrixVer_ReadData_DataServices_Data_0xF19D_CANDBMatrixVer_ReadData: RteEventRef=OIT_DataServices_Data_0xF19D_CANDBMatrixVer_ReadData_DataServices_Data_0xF19D_CANDBMatrixVer_ReadData
        OIT_DataServices_Data_0xF18B_ECUBuildDate_ReadData_DataServices_Data_0xF18B_ECUBuildDate_ReadData: RteEventRef=OIT_DataServices_Data_0xF18B_ECUBuildDate_ReadData_DataServices_Data_0xF18B_ECUBuildDate_ReadData
        OIT_DataServices_Data_0xF15A_Software_Fingerprint_ConditionCheckRead_DataServices_Data_0xF15A_Software_Fingerprint_Condi6D559378: RteEventRef=OIT_DataServices_Data_0xF15A_Software_Fingerprint_ConditionCheckRead_DataServices_Data_0xF15A_Software_Fingerprint_Condi6D559378
        OIT_DataServices_Data_0xF010_Vehicle_Variant_ConditionCheckRead_DataServices_Data_0xF010_Vehicle_Variant_ConditionCheckRead: RteEventRef=OIT_DataServices_Data_0xF010_Vehicle_Variant_ConditionCheckRead_DataServices_Data_0xF010_Vehicle_Variant_ConditionCheckRead
        OIT_DataServices_Data_0xF017_Pin_Position_Status_ReadData_DataServices_Data_0xF017_Pin_Position_Status_ReadData: RteEventRef=OIT_DataServices_Data_0xF017_Pin_Position_Status_ReadData_DataServices_Data_0xF017_Pin_Position_Status_ReadData
        OIT_CSDataServices_Data_Snapshot_DID_0xa004_Ego_Acceleration_ReadData_CSDataServices_Data_Snapshot_DID_0xa004_Ego_AcceleA5E32AA8: RteEventRef=OIT_CSDataServices_Data_Snapshot_DID_0xa004_Ego_Acceleration_ReadData_CSDataServices_Data_Snapshot_DID_0xa004_Ego_AcceleA5E32AA8
        OIT_CSDataServices_Data_Snapshot_DID_0x1111_ECUVoltage_ReadData_CSDataServices_Data_Snapshot_DID_0x1111_ECUVoltage_ReadData: RteEventRef=OIT_CSDataServices_Data_Snapshot_DID_0x1111_ECUVoltage_ReadData_CSDataServices_Data_Snapshot_DID_0x1111_ECUVoltage_ReadData
        OIT_CSDataServices_Data_Snapshot_DID_0x1116_CombinedSignal_ReadData_CSDataServices_Data_Snapshot_DID_0x1116_CombinedSignA3433445: RteEventRef=OIT_CSDataServices_Data_Snapshot_DID_0x1116_CombinedSignal_ReadData_CSDataServices_Data_Snapshot_DID_0x1116_CombinedSignA3433445
        OIT_CSDataServices_Data_Snapshot_DID_0x1112_VehicleSpeed_ReadData_CSDataServices_Data_Snapshot_DID_0x1112_VehicleSpeed_ReadData: RteEventRef=OIT_CSDataServices_Data_Snapshot_DID_0x1112_VehicleSpeed_ReadData_CSDataServices_Data_Snapshot_DID_0x1112_VehicleSpeed_ReadData
        OIT_CSDataServices_Data_Snapshot_DID_0x1117_Sensor_Availability_Flag_Information_ReadData_CSDataServices_Data_Snapshot_DDAA3099C: RteEventRef=OIT_CSDataServices_Data_Snapshot_DID_0x1117_Sensor_Availability_Flag_Information_ReadData_CSDataServices_Data_Snapshot_DDAA3099C
        OIT_SecurityAccess_Unlocked_L1_CompareKey_SecurityAccess_Unlocked_L1_CompareKey: RteEventRef=OIT_SecurityAccess_Unlocked_L1_CompareKey_SecurityAccess_Unlocked_L1_CompareKey
        OIT_SecurityAccess_Unlocked_L1_GetSeed_SecurityAccess_Unlocked_L1_GetSeed: RteEventRef=OIT_SecurityAccess_Unlocked_L1_GetSeed_SecurityAccess_Unlocked_L1_GetSeed
        OIT_ServiceRequestNotification_Indication_ServiceRequestNotification_Indication: RteEventRef=OIT_ServiceRequestNotification_Indication_ServiceRequestNotification_Indication
        OIT_ServiceRequestNotification_Confirmation_ServiceRequestNotification_Confirmation: RteEventRef=OIT_ServiceRequestNotification_Confirmation_ServiceRequestNotification_Confirmation
        OIT_RoutineServices_Routine_0x7004_Pin_Position_Lock_Start_Start_RoutineServices_Routine_0x7004_Pin_Position_Lock_Start_Start: RteEventRef=OIT_RoutineServices_Routine_0x7004_Pin_Position_Lock_Start_Start_RoutineServices_Routine_0x7004_Pin_Position_Lock_Start_Start
        OIT_RoutineServices_Routine_0x7005_Pin_Position_Unlock_Start_RequestResults_RoutineServices_Routine_0x7005_Pin_Position_DA16A899: RteEventRef=OIT_RoutineServices_Routine_0x7005_Pin_Position_Unlock_Start_RequestResults_RoutineServices_Routine_0x7005_Pin_Position_DA16A899
        OIT_RoutineServices_Routine_0x0200_CheckProgPreCond_Start_Start_RoutineServices_Routine_0x0200_CheckProgPreCond_Start_Start: RteEventRef=OIT_RoutineServices_Routine_0x0200_CheckProgPreCond_Start_Start_RoutineServices_Routine_0x0200_CheckProgPreCond_Start_Start
        OIT_RoutineServices_Routine_0x7005_Pin_Position_Unlock_Start_Start_RoutineServices_Routine_0x7005_Pin_Position_Unlock_St48C89B13: RteEventRef=OIT_RoutineServices_Routine_0x7005_Pin_Position_Unlock_Start_Start_RoutineServices_Routine_0x7005_Pin_Position_Unlock_St48C89B13
        OIT_RoutineServices_Routine_0x7004_Pin_Position_Lock_Start_RequestResults_RoutineServices_Routine_0x7004_Pin_Position_Lo83125386: RteEventRef=OIT_RoutineServices_Routine_0x7004_Pin_Position_Lock_Start_RequestResults_RoutineServices_Routine_0x7004_Pin_Position_Lo83125386
        OIT_DataServices_Data_0xFDA3_Read_Active_Fault_Table_ConditionCheckRead_DataServices_Data_0xFDA3_Read_Active_Fault_Table8976C99A: RteEventRef=OIT_DataServices_Data_0xFDA3_Read_Active_Fault_Table_ConditionCheckRead_DataServices_Data_0xFDA3_Read_Active_Fault_Table8976C99A
        OIT_DataServices_Data_0xFDA3_Read_Active_Fault_Table_ReadData_DataServices_Data_0xFDA3_Read_Active_Fault_Table_ReadData: RteEventRef=OIT_DataServices_Data_0xFDA3_Read_Active_Fault_Table_ReadData_DataServices_Data_0xFDA3_Read_Active_Fault_Table_ReadData
        OIT_CSCallbackDTCStatusChange_DTCStatusChanged_CSCallbackDTCStatusChange_DTCStatusChanged: RteEventRef=OIT_CSCallbackDTCStatusChange_DTCStatusChanged_CSCallbackDTCStatusChange_DTCStatusChanged
        OIT_SecurityAccess_Unlocked_L1_GetSecurityAttemptCounter_SecurityAccess_Unlocked_L1_GetSecurityAttemptCounter: RteEventRef=OIT_SecurityAccess_Unlocked_L1_GetSecurityAttemptCounter_SecurityAccess_Unlocked_L1_GetSecurityAttemptCounter
        OIT_SecurityAccess_Unlocked_L1_SetSecurityAttemptCounter_SecurityAccess_Unlocked_L1_SetSecurityAttemptCounter: RteEventRef=OIT_SecurityAccess_Unlocked_L1_SetSecurityAttemptCounter_SecurityAccess_Unlocked_L1_SetSecurityAttemptCounter
      NvmBlock_SWC_CMP_PRJ_UDSHandler_SWC_UDSHandler_Attemptcounter (RteNvRamAllocation):
        RteNvmRamBlockLocationSymbol = Rte_SWC_CMP_PRJ_UDSHandler_SWC_UDS_AttemptCounter
        RteNvmRomBlockLocationSymbol = Rte_SWC_CMP_PRJ_UDSHandler_SWC_UDSHandler_Attemptcounter_DefaultValue
        RteNvmBlockRef = SWC_CMP_PRJ_UDSHandlerSWC_UDSHandler_Attemptcounter
        RteSwNvRamMappingRef = SWC_UDSHandler_Attemptcounter
      22 x RteEventToTaskMapping, all with RteImmediateRestart=false:
        OIT_DataServices_Data_0xF01B_Manual_Alignment_Execution_ReadData_DataServices_Data_0xF01B_Manual_Alignment_Execution_ReadData: RteEventRef=OIT_DataServices_Data_0xF01B_Manual_Alignment_Execution_ReadData_DataServices_Data_0xF01B_Manual_Alignment_Execution_ReadData
        OIT_DataServices_Data_0xF016_Auto_Alignment_Status_Information_ReadData_DataServices_Data_0xF016_Auto_Alignment_Status_IE39C6DE0: RteEventRef=OIT_DataServices_Data_0xF016_Auto_Alignment_Status_Information_ReadData_DataServices_Data_0xF016_Auto_Alignment_Status_IE39C6DE0
        OIT_DataServices_Data_0xF01C_Static_Alignment_Result_Parameters_ConditionCheckRead_DataServices_Data_0xF01C_Static_AlignD8019410: RteEventRef=OIT_DataServices_Data_0xF01C_Static_Alignment_Result_Parameters_ConditionCheckRead_DataServices_Data_0xF01C_Static_AlignD8019410
        OIT_DataServices_Data_0xF013_Static_Alignment_Engineering_Write_Configuration_Parameter_WriteData_DataServices_Data_0xF0635C6EC6: RteEventRef=OIT_DataServices_Data_0xF013_Static_Alignment_Engineering_Write_Configuration_Parameter_WriteData_DataServices_Data_0xF0635C6EC6
        OIT_RoutineServices_Routine_0x7000_Static_Alignment_Execution_Start_Start_RoutineServices_Routine_0x7000_Static_Alignmen1031943F: RteEventRef=OIT_RoutineServices_Routine_0x7000_Static_Alignment_Execution_Start_Start_RoutineServices_Routine_0x7000_Static_Alignmen1031943F
        OIT_DataServices_Data_0xF015_Service_Alignment_Result_Parameters_ConditionCheckRead_DataServices_Data_0xF015_Service_Ali520B7E9E: RteEventRef=OIT_DataServices_Data_0xF015_Service_Alignment_Result_Parameters_ConditionCheckRead_DataServices_Data_0xF015_Service_Ali520B7E9E
        OIT_DataServices_Data_0xF01B_Manual_Alignment_Execution_ConditionCheckRead_DataServices_Data_0xF01B_Manual_Alignment_Exe4C1CC3E0: RteEventRef=OIT_DataServices_Data_0xF01B_Manual_Alignment_Execution_ConditionCheckRead_DataServices_Data_0xF01B_Manual_Alignment_Exe4C1CC3E0
        OIT_RoutineServices_Routine_0x7000_Static_Alignment_Execution_Start_Stop_RoutineServices_Routine_0x7000_Static_Alignment6EF74555: RteEventRef=OIT_RoutineServices_Routine_0x7000_Static_Alignment_Execution_Start_Stop_RoutineServices_Routine_0x7000_Static_Alignment6EF74555
        OIT_DataServices_Data_0xF014_Service_Alignment_Engineering_Non_Configuration_Parameters_ReadData_DataServices_Data_0xF01E7B35011: RteEventRef=OIT_DataServices_Data_0xF014_Service_Alignment_Engineering_Non_Configuration_Parameters_ReadData_DataServices_Data_0xF01E7B35011
        OIT_DataServices_Data_0xF014_Service_Alignment_Engineering_Non_Configuration_Parameters_ConditionCheckRead_DataServices_4EC705AA: RteEventRef=OIT_DataServices_Data_0xF014_Service_Alignment_Engineering_Non_Configuration_Parameters_ConditionCheckRead_DataServices_4EC705AA
        OIT_DataServices_Data_0xF011_Static_Alignment_Engineering_Non_Configuration_Parameters_ReadData_DataServices_Data_0xF0114E070977: RteEventRef=OIT_DataServices_Data_0xF011_Static_Alignment_Engineering_Non_Configuration_Parameters_ReadData_DataServices_Data_0xF0114E070977
        OIT_DataServices_Data_0xF011_Static_Alignment_Engineering_Non_Configuration_Parameters_ConditionCheckRead_DataServices_DCF75DAD5: RteEventRef=OIT_DataServices_Data_0xF011_Static_Alignment_Engineering_Non_Configuration_Parameters_ConditionCheckRead_DataServices_DCF75DAD5
        OIT_DataServices_Data_0xF01C_Static_Alignment_Result_Parameters_ReadData_DataServices_Data_0xF01C_Static_Alignment_Resul9B0D7DB7: RteEventRef=OIT_DataServices_Data_0xF01C_Static_Alignment_Result_Parameters_ReadData_DataServices_Data_0xF01C_Static_Alignment_Resul9B0D7DB7
        OIT_RoutineServices_Routine_0x7003_Service_Alignment_Execution_Start_RequestResults_RoutineServices_Routine_0x7003_ServiA1346617: RteEventRef=OIT_RoutineServices_Routine_0x7003_Service_Alignment_Execution_Start_RequestResults_RoutineServices_Routine_0x7003_ServiA1346617
        OIT_DataServices_Data_0xF012_Static_Alignment_Engineering_Read_Parameters_ReadData_DataServices_Data_0xF012_Static_Align735FEBE5: RteEventRef=OIT_DataServices_Data_0xF012_Static_Alignment_Engineering_Read_Parameters_ReadData_DataServices_Data_0xF012_Static_Align735FEBE5
        OIT_DataServices_Data_0xF01B_Manual_Alignment_Execution_WriteData_DataServices_Data_0xF01B_Manual_Alignment_Execution_WriteData: RteEventRef=OIT_DataServices_Data_0xF01B_Manual_Alignment_Execution_WriteData_DataServices_Data_0xF01B_Manual_Alignment_Execution_WriteData
        OIT_RoutineServices_Routine_0x7003_Service_Alignment_Execution_Start_Stop_RoutineServices_Routine_0x7003_Service_Alignme44A434DD: RteEventRef=OIT_RoutineServices_Routine_0x7003_Service_Alignment_Execution_Start_Stop_RoutineServices_Routine_0x7003_Service_Alignme44A434DD
        OIT_DataServices_Data_0xF012_Static_Alignment_Engineering_Read_Parameters_ConditionCheckRead_DataServices_Data_0xF012_St600605D7: RteEventRef=OIT_DataServices_Data_0xF012_Static_Alignment_Engineering_Read_Parameters_ConditionCheckRead_DataServices_Data_0xF012_St600605D7
        OIT_DataServices_Data_0xF015_Service_Alignment_Result_Parameters_ReadData_DataServices_Data_0xF015_Service_Alignment_ResBCFFEA9C: RteEventRef=OIT_DataServices_Data_0xF015_Service_Alignment_Result_Parameters_ReadData_DataServices_Data_0xF015_Service_Alignment_ResBCFFEA9C
        OIT_DataServices_Data_0xF016_Auto_Alignment_Status_Information_ConditionCheckRead_DataServices_Data_0xF016_Auto_AlignmenC54767F7: RteEventRef=OIT_DataServices_Data_0xF016_Auto_Alignment_Status_Information_ConditionCheckRead_DataServices_Data_0xF016_Auto_AlignmenC54767F7
        OIT_RoutineServices_Routine_0x7003_Service_Alignment_Execution_Start_Start_RoutineServices_Routine_0x7003_Service_Alignm60FF78D2: RteEventRef=OIT_RoutineServices_Routine_0x7003_Service_Alignment_Execution_Start_Start_RoutineServices_Routine_0x7003_Service_Alignm60FF78D2
        OIT_RoutineServices_Routine_0x7000_Static_Alignment_Execution_Start_RequestResults_RoutineServices_Routine_0x7000_StaticC951749F: RteEventRef=OIT_RoutineServices_Routine_0x7000_Static_Alignment_Execution_Start_RequestResults_RoutineServices_Routine_0x7000_StaticC951749F
    SWC_CMP_PRJ_UDSHandler (RteSwComponentType): RteComponentTypeRef=SWC_CMP_PRJ_UDSHandler, RteImplementationRef=SWC_CMP_PRJ_UDSHandler_Implementation
      ComponentTypeCalibration (RteComponentTypeCalibration): RteCalibrationSupportEnabled=false
    WdgM_OsCore0_ASIL_EcuSwComposition (RteSwComponentInstance): RteSoftwareComponentInstanceRef=WdgM_OsCore0_ASIL
      25 x RteEventToTaskMapping, all with RteImmediateRestart=false:
        Timer_WdgM_MainFunction: RtePositionInTask=1, RteEventRef=Timer_WdgM_MainFunction, RteMappedToTaskRef=Appl_Task_High_Prio, RteUsedOsEventRef=Rte_Ev_Cyclic2_Appl_Task_High_Prio_0_5ms, RteUsedOsAlarmRef=Rte_Al_TE2_Appl_Task_High_Prio_0_5ms
        OpEventCheckpointReached_CheckpointReached_alive_SE_Internal_Wdg: RteEventRef=OpEventCheckpointReached_CheckpointReached_alive_SE_Internal_Wdg
        OpEventCheckpointReached_CheckpointReached_alive_SE_Internal_Wdg_Dummy: RteEventRef=OpEventCheckpointReached_CheckpointReached_alive_SE_Internal_Wdg_Dummy
        OpEventCheckpointReached_CheckpointReached_alive_SE_Alive_Program_Flow_Monitoring: RteEventRef=OpEventCheckpointReached_CheckpointReached_alive_SE_Alive_Program_Flow_Monitoring
        OpEventGetLocalStatus_GetLocalStatus_localStatus_SE_Internal_Wdg: RteEventRef=OpEventGetLocalStatus_GetLocalStatus_localStatus_SE_Internal_Wdg
        OpEventGetLocalStatus_GetLocalStatus_localStatus_SE_Internal_Wdg_Dummy: RteEventRef=OpEventGetLocalStatus_GetLocalStatus_localStatus_SE_Internal_Wdg_Dummy
        OpEventGetLocalStatus_GetLocalStatus_localStatus_SE_Alive_Program_Flow_Monitoring: RteEventRef=OpEventGetLocalStatus_GetLocalStatus_localStatus_SE_Alive_Program_Flow_Monitoring
        OpEventGetLocalStatus_GetLocalStatus_general_Core0: RteEventRef=OpEventGetLocalStatus_GetLocalStatus_general_Core0
        OpEventGetMode_GetMode_general_Core0: RteEventRef=OpEventGetMode_GetMode_general_Core0
        OpEventGetGlobalStatus_GetGlobalStatus_general_Core0: RteEventRef=OpEventGetGlobalStatus_GetGlobalStatus_general_Core0
        OpEventPerformReset_PerformReset_general_Core0: RteEventRef=OpEventPerformReset_PerformReset_general_Core0
        OpEventSetMode_SetMode_general_Core0: RteEventRef=OpEventSetMode_SetMode_general_Core0
        OpEventGetFirstExpiredSEID_GetFirstExpiredSEID_general_Core0: RteEventRef=OpEventGetFirstExpiredSEID_GetFirstExpiredSEID_general_Core0
        OpEventActivateSupervisionEntity_ActivateSupervisionEntity_general_Core0: RteEventRef=OpEventActivateSupervisionEntity_ActivateSupervisionEntity_general_Core0
        OpEventDeactivateSupervisionEntity_DeactivateSupervisionEntity_general_Core0: RteEventRef=OpEventDeactivateSupervisionEntity_DeactivateSupervisionEntity_general_Core0
        OpEventCheckpointReached_CheckpointReached_alive_SE_Internal_Wdg_Appl_IPC_Task: RteEventRef=OpEventCheckpointReached_CheckpointReached_alive_SE_Internal_Wdg_Appl_IPC_Task
        OpEventCheckpointReached_CheckpointReached_alive_SE_Internal_Wdg_PLT_Appl_Task: RteEventRef=OpEventCheckpointReached_CheckpointReached_alive_SE_Internal_Wdg_PLT_Appl_Task
        OpEventGetLocalStatus_GetLocalStatus_localStatus_SE_Internal_Wdg_Appl_Task_Communication: RteEventRef=OpEventGetLocalStatus_GetLocalStatus_localStatus_SE_Internal_Wdg_Appl_Task_Communication
        OpEventCheckpointReached_CheckpointReached_alive_SE_Internal_Wdg_Appl_Task_Communication: RteEventRef=OpEventCheckpointReached_CheckpointReached_alive_SE_Internal_Wdg_Appl_Task_Communication
        OpEventGetLocalStatus_GetLocalStatus_localStatus_SE_Internal_Wdg_PLT_Appl_Task: RteEventRef=OpEventGetLocalStatus_GetLocalStatus_localStatus_SE_Internal_Wdg_PLT_Appl_Task
        OpEventGetLocalStatus_GetLocalStatus_localStatus_SE_Internal_Wdg_Appl_IPC_Task: RteEventRef=OpEventGetLocalStatus_GetLocalStatus_localStatus_SE_Internal_Wdg_Appl_IPC_Task
        OpEventGetLocalStatus_GetLocalStatus_localStatus_SE_Internal_Wdg_BSW_Task: RteEventRef=OpEventGetLocalStatus_GetLocalStatus_localStatus_SE_Internal_Wdg_BSW_Task
        OpEventCheckpointReached_CheckpointReached_alive_SE_Internal_Wdg_BSW_Task: RteEventRef=OpEventCheckpointReached_CheckpointReached_alive_SE_Internal_Wdg_BSW_Task
        OpEventGetLocalStatus_GetLocalStatus_localStatus_SE_Internal_Wdg_Appl_Task_Radar_Control: RteEventRef=OpEventGetLocalStatus_GetLocalStatus_localStatus_SE_Internal_Wdg_Appl_Task_Radar_Control
        OpEventCheckpointReached_CheckpointReached_alive_SE_Internal_Wdg_Appl_Task_Radar_Control: RteEventRef=OpEventCheckpointReached_CheckpointReached_alive_SE_Internal_Wdg_Appl_Task_Radar_Control
    SWC_RDR_1_Veh_Com (RteSwComponentType): RteComponentTypeRef=SWC_RDR_1_Veh_Com
      ComponentTypeCalibration (RteComponentTypeCalibration): RteCalibrationSupportEnabled=false
    DemMaster_Invalid_OsApplication_EcuSwComposition (RteSwComponentInstance): RteSoftwareComponentInstanceRef=DemMaster_Invalid_OsApplication
      21 x RteEventToTaskMapping, all with RteImmediateRestart=false:
        Timer_Dem_MasterMainFunction: RtePositionInTask=3, RteEventRef=Timer_Dem_MasterMainFunction, RteMappedToTaskRef=BSW_Task, RteUsedOsEventRef=Rte_Ev_Cyclic2_BSW_Task_0_10ms, RteUsedOsAlarmRef=Rte_Al_TE2_BSW_Task_0_10ms
        OpEventPostRunRequested_GetPostRunRequested_DemServices: RteEventRef=OpEventPostRunRequested_GetPostRunRequested_DemServices
        OpEventGetDTCStatusAvailabilityMask_GetDTCStatusAvailabilityMask_DemServices: RteEventRef=OpEventGetDTCStatusAvailabilityMask_GetDTCStatusAvailabilityMask_DemServices
        OpEventClearDTC_ClearDTC_ClearDTC_DemClient: RteEventRef=OpEventClearDTC_ClearDTC_ClearDTC_DemClient
        OpEventSelectDTC_SelectDTC_ClearDTC_DemClient: RteEventRef=OpEventSelectDTC_SelectDTC_ClearDTC_DemClient
        OpEventGetEventMemoryOverflow_GetEventMemoryOverflow_OverflowIndPrimaryMemory_DemClient: RteEventRef=OpEventGetEventMemoryOverflow_GetEventMemoryOverflow_OverflowIndPrimaryMemory_DemClient
        OpEventGetNumberOfEventMemoryEntries_GetNumberOfEventMemoryEntries_OverflowIndPrimaryMemory_DemClient: RteEventRef=OpEventGetNumberOfEventMemoryEntries_GetNumberOfEventMemoryEntries_OverflowIndPrimaryMemory_DemClient
        OpEventGetEventUdsStatus_GetEventUdsStatus_GeneralEvtInfo: RteEventRef=OpEventGetEventUdsStatus_GetEventUdsStatus_GeneralEvtInfo
        OpEventGetEventStatus_GetEventStatus_GeneralEvtInfo: RteEventRef=OpEventGetEventStatus_GetEventStatus_GeneralEvtInfo
        OpEventGetEventFailed_GetEventFailed_GeneralEvtInfo: RteEventRef=OpEventGetEventFailed_GetEventFailed_GeneralEvtInfo
        OpEventGetEventTested_GetEventTested_GeneralEvtInfo: RteEventRef=OpEventGetEventTested_GetEventTested_GeneralEvtInfo
        OpEventGetDTCOfEvent_GetDTCOfEvent_GeneralEvtInfo: RteEventRef=OpEventGetDTCOfEvent_GetDTCOfEvent_GeneralEvtInfo
        OpEventGetFaultDetectionCounter_GetFaultDetectionCounter_GeneralEvtInfo: RteEventRef=OpEventGetFaultDetectionCounter_GetFaultDetectionCounter_GeneralEvtInfo
        OpEventGetEventFreezeFrameDataEx_GetEventFreezeFrameDataEx_GeneralEvtInfo: RteEventRef=OpEventGetEventFreezeFrameDataEx_GetEventFreezeFrameDataEx_GeneralEvtInfo
        OpEventGetEventExtendedDataRecordEx_GetEventExtendedDataRecordEx_GeneralEvtInfo: RteEventRef=OpEventGetEventExtendedDataRecordEx_GetEventExtendedDataRecordEx_GeneralEvtInfo
        OpEventGetEventEnableCondition_GetEventEnableCondition_GeneralEvtInfo: RteEventRef=OpEventGetEventEnableCondition_GetEventEnableCondition_GeneralEvtInfo
        OpEventGetDebouncingOfEvent_GetDebouncingOfEvent_GeneralEvtInfo: RteEventRef=OpEventGetDebouncingOfEvent_GetDebouncingOfEvent_GeneralEvtInfo
        OpEventGetMonitorStatus_GetMonitorStatus_GeneralEvtInfo: RteEventRef=OpEventGetMonitorStatus_GetMonitorStatus_GeneralEvtInfo
        OpEventGetOperationCycleState_GetOperationCycleState_OpCycle_Power_On_Off: RteEventRef=OpEventGetOperationCycleState_GetOperationCycleState_OpCycle_Power_On_Off
        OpEventSetOperationCycleState_SetOperationCycleState_OpCycle_Power_On_Off: RteEventRef=OpEventSetOperationCycleState_SetOperationCycleState_OpCycle_Power_On_Off
        OpEventSynchronizeNvData_SynchronizeNvData_DemServices: RteEventRef=OpEventSynchronizeNvData_SynchronizeNvData_DemServices
    DemSatellite_Invalid_OsApplication_EcuSwComposition (RteSwComponentInstance): RteSoftwareComponentInstanceRef=DemSatellite_Invalid_OsApplication
      1376 x RteEventToTaskMapping, all with RteImmediateRestart=false:
        Timer_Dem_SatelliteMainFunction: RtePositionInTask=22, RteEventRef=Timer_Dem_SatelliteMainFunction, RteMappedToTaskRef=BSW_Task, RteUsedOsEventRef=Rte_Ev_Cyclic2_BSW_Task_0_10ms, RteUsedOsAlarmRef=Rte_Al_TE2_BSW_Task_0_10ms
        OpEventGetEventUdsStatus_GetEventUdsStatus_EvtInfo_SAS_message_Steering_Wheel_Angle_Invalid_Serial_Data_Received: RteEventRef=OpEventGetEventUdsStatus_GetEventUdsStatus_EvtInfo_SAS_message_Steering_Wheel_Angle_Invalid_Serial_Data_Received
        OpEventGetEventUdsStatus_GetEventUdsStatus_Event_SAS_message_Steering_Wheel_Angle_Invalid_Serial_Data_Received: RteEventRef=OpEventGetEventUdsStatus_GetEventUdsStatus_Event_SAS_message_Steering_Wheel_Angle_Invalid_Serial_Data_Received
        OpEventGetEventUdsStatus_GetEventUdsStatus_EvtInfo_AT_AMT_ETC2_message_Transcurrent_gear_Invalid_Serial_Data_Received: RteEventRef=OpEventGetEventUdsStatus_GetEventUdsStatus_EvtInfo_AT_AMT_ETC2_message_Transcurrent_gear_Invalid_Serial_Data_Received
        OpEventGetEventUdsStatus_GetEventUdsStatus_Event_AT_AMT_ETC2_message_Transcurrent_gear_Invalid_Serial_Data_Received: RteEventRef=OpEventGetEventUdsStatus_GetEventUdsStatus_Event_AT_AMT_ETC2_message_Transcurrent_gear_Invalid_Serial_Data_Received
        OpEventGetEventUdsStatus_GetEventUdsStatus_EvtInfo_Radar_AutoAlignment_Algorithm_Signal_Calculation_Failure: RteEventRef=OpEventGetEventUdsStatus_GetEventUdsStatus_EvtInfo_Radar_AutoAlignment_Algorithm_Signal_Calculation_Failure
        OpEventGetEventUdsStatus_GetEventUdsStatus_Event_Radar_AutoAlignment_Algorithm_Signal_Calculation_Failure: RteEventRef=OpEventGetEventUdsStatus_GetEventUdsStatus_Event_Radar_AutoAlignment_Algorithm_Signal_Calculation_Failure
        OpEventGetEventUdsStatus_GetEventUdsStatus_EvtInfo_Vehicle_DataSet_Not_Configured: RteEventRef=OpEventGetEventUdsStatus_GetEventUdsStatus_EvtInfo_Vehicle_DataSet_Not_Configured
        OpEventGetEventUdsStatus_GetEventUdsStatus_Event_Vehicle_DataSet_Not_Configured: RteEventRef=OpEventGetEventUdsStatus_GetEventUdsStatus_Event_Vehicle_DataSet_Not_Configured
        OpEventGetEventUdsStatus_GetEventUdsStatus_EvtInfo_Radar_Module_System_Internal_Failure: RteEventRef=OpEventGetEventUdsStatus_GetEventUdsStatus_EvtInfo_Radar_Module_System_Internal_Failure
        OpEventGetEventUdsStatus_GetEventUdsStatus_Event_Radar_Module_System_Internal_Failure: RteEventRef=OpEventGetEventUdsStatus_GetEventUdsStatus_Event_Radar_Module_System_Internal_Failure
