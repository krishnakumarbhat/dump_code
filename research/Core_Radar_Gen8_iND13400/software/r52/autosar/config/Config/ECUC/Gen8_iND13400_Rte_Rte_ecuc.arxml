[part 2 of 3: package /ActiveEcuC]
AUTOSAR XML (schema 00053)
package /ActiveEcuC  (continued)
  module config Rte: implementation-config-variant=VARIANT-PRE-COMPILE, module-description=Rte_Impl  (continued)
    DemSatellite_Invalid_OsApplication_EcuSwComposition (RteSwComponentInstance): RteSoftwareComponentInstanceRef=DemSatellite_Invalid_OsApplication  (continued)
      1376 x RteEventToTaskMapping, all with RteImmediateRestart=false:  (continued)
        OpEventGetEventUdsStatus_GetEventUdsStatus_EvtInfo_Radar_MMIC_Component_Failure: RteEventRef=OpEventGetEventUdsStatus_GetEventUdsStatus_EvtInfo_Radar_MMIC_Component_Failure
        OpEventGetEventUdsStatus_GetEventUdsStatus_Event_Radar_MMIC_Component_Failure: RteEventRef=OpEventGetEventUdsStatus_GetEventUdsStatus_Event_Radar_MMIC_Component_Failure
        OpEventGetEventUdsStatus_GetEventUdsStatus_EvtInfo_Radar_Module_General_Memory_Failure: RteEventRef=OpEventGetEventUdsStatus_GetEventUdsStatus_EvtInfo_Radar_Module_General_Memory_Failure
        OpEventGetEventUdsStatus_GetEventUdsStatus_Event_Radar_Module_General_Memory_Failure: RteEventRef=OpEventGetEventUdsStatus_GetEventUdsStatus_Event_Radar_Module_General_Memory_Failure
        OpEventGetEventUdsStatus_GetEventUdsStatus_EvtInfo_Radar_System_Battery_High_Voltage_System_Voltage_High: RteEventRef=OpEventGetEventUdsStatus_GetEventUdsStatus_EvtInfo_Radar_System_Battery_High_Voltage_System_Voltage_High
        OpEventGetEventUdsStatus_GetEventUdsStatus_Event_Radar_System_Battery_High_Voltage_System_Voltage_High: RteEventRef=OpEventGetEventUdsStatus_GetEventUdsStatus_Event_Radar_System_Battery_High_Voltage_System_Voltage_High
        OpEventGetEventUdsStatus_GetEventUdsStatus_EvtInfo_CCVS1_message_Vehicle_Speed_Invalid_Serial_Data_Received: RteEventRef=OpEventGetEventUdsStatus_GetEventUdsStatus_EvtInfo_CCVS1_message_Vehicle_Speed_Invalid_Serial_Data_Received
        OpEventGetEventUdsStatus_GetEventUdsStatus_Event_CCVS1_message_Vehicle_Speed_Invalid_Serial_Data_Received: RteEventRef=OpEventGetEventUdsStatus_GetEventUdsStatus_Event_CCVS1_message_Vehicle_Speed_Invalid_Serial_Data_Received
        OpEventGetEventUdsStatus_GetEventUdsStatus_EvtInfo_EMS_ECU_VD_erratic_communication_Erratic: RteEventRef=OpEventGetEventUdsStatus_GetEventUdsStatus_EvtInfo_EMS_ECU_VD_erratic_communication_Erratic
        OpEventGetEventUdsStatus_GetEventUdsStatus_Event_EMS_ECU_VD_erratic_communication_Erratic: RteEventRef=OpEventGetEventUdsStatus_GetEventUdsStatus_Event_EMS_ECU_VD_erratic_communication_Erratic
        OpEventGetEventUdsStatus_GetEventUdsStatus_EvtInfo_EMS_ECU_ETC2_00_message_Missing_Message: RteEventRef=OpEventGetEventUdsStatus_GetEventUdsStatus_EvtInfo_EMS_ECU_ETC2_00_message_Missing_Message
        OpEventGetEventUdsStatus_GetEventUdsStatus_Event_EMS_ECU_ETC2_00_message_Missing_Message: RteEventRef=OpEventGetEventUdsStatus_GetEventUdsStatus_Event_EMS_ECU_ETC2_00_message_Missing_Message
        OpEventGetEventUdsStatus_GetEventUdsStatus_EvtInfo_Cluster_ECU_CLS_Tx_16_message_Missing_Message: RteEventRef=OpEventGetEventUdsStatus_GetEventUdsStatus_EvtInfo_Cluster_ECU_CLS_Tx_16_message_Missing_Message
        OpEventGetEventUdsStatus_GetEventUdsStatus_Event_Cluster_ECU_CLS_Tx_16_message_Missing_Message: RteEventRef=OpEventGetEventUdsStatus_GetEventUdsStatus_Event_Cluster_ECU_CLS_Tx_16_message_Missing_Message
        OpEventGetEventUdsStatus_GetEventUdsStatus_EvtInfo_Exceeded_Security_Access_0x27_Attempt_Threshold_Authentication_Failure: RteEventRef=OpEventGetEventUdsStatus_GetEventUdsStatus_EvtInfo_Exceeded_Security_Access_0x27_Attempt_Threshold_Authentication_Failure
        OpEventGetEventUdsStatus_GetEventUdsStatus_Event_Exceeded_Security_Access_0x27_Attempt_Threshold_Authentication_Failure: RteEventRef=OpEventGetEventUdsStatus_GetEventUdsStatus_Event_Exceeded_Security_Access_0x27_Attempt_Threshold_Authentication_Failure
        OpEventGetEventUdsStatus_GetEventUdsStatus_EvtInfo_Front_Left_Side_Radar_value_of_signal_protection_calculation_Incorrect: RteEventRef=OpEventGetEventUdsStatus_GetEventUdsStatus_EvtInfo_Front_Left_Side_Radar_value_of_signal_protection_calculation_Incorrect
        OpEventGetEventUdsStatus_GetEventUdsStatus_Event_Front_Left_Side_Radar_value_of_signal_protection_calculation_Incorrect: RteEventRef=OpEventGetEventUdsStatus_GetEventUdsStatus_Event_Front_Left_Side_Radar_value_of_signal_protection_calculation_Incorrect
        OpEventGetEventUdsStatus_GetEventUdsStatus_EvtInfo_AT_AMT_ETC2_erratic_communication_Erratic: RteEventRef=OpEventGetEventUdsStatus_GetEventUdsStatus_EvtInfo_AT_AMT_ETC2_erratic_communication_Erratic
        OpEventGetEventUdsStatus_GetEventUdsStatus_Event_AT_AMT_ETC2_erratic_communication_Erratic: RteEventRef=OpEventGetEventUdsStatus_GetEventUdsStatus_Event_AT_AMT_ETC2_erratic_communication_Erratic
        OpEventGetEventUdsStatus_GetEventUdsStatus_EvtInfo_VCAN_Communication_Bus_Off: RteEventRef=OpEventGetEventUdsStatus_GetEventUdsStatus_EvtInfo_VCAN_Communication_Bus_Off
        OpEventGetEventUdsStatus_GetEventUdsStatus_Event_VCAN_Communication_Bus_Off: RteEventRef=OpEventGetEventUdsStatus_GetEventUdsStatus_Event_VCAN_Communication_Bus_Off
        OpEventGetEventUdsStatus_GetEventUdsStatus_EvtInfo_VDC2_message_LongitudinalAcceleration_Invalid_Serial_Data_Received: RteEventRef=OpEventGetEventUdsStatus_GetEventUdsStatus_EvtInfo_VDC2_message_LongitudinalAcceleration_Invalid_Serial_Data_Received
        OpEventGetEventUdsStatus_GetEventUdsStatus_Event_VDC2_message_LongitudinalAcceleration_Invalid_Serial_Data_Received: RteEventRef=OpEventGetEventUdsStatus_GetEventUdsStatus_Event_VDC2_message_LongitudinalAcceleration_Invalid_Serial_Data_Received
        OpEventGetEventUdsStatus_GetEventUdsStatus_EvtInfo_Radar_MMIC_RFBIST_Component_Internal_Failure: RteEventRef=OpEventGetEventUdsStatus_GetEventUdsStatus_EvtInfo_Radar_MMIC_RFBIST_Component_Internal_Failure
        OpEventGetEventUdsStatus_GetEventUdsStatus_Event_Radar_MMIC_RFBIST_Component_Internal_Failure: RteEventRef=OpEventGetEventUdsStatus_GetEventUdsStatus_Event_Radar_MMIC_RFBIST_Component_Internal_Failure
        OpEventGetEventUdsStatus_GetEventUdsStatus_EvtInfo_Radar_Initial_Alignment_Missing_Calibration: RteEventRef=OpEventGetEventUdsStatus_GetEventUdsStatus_EvtInfo_Radar_Initial_Alignment_Missing_Calibration
        OpEventGetEventUdsStatus_GetEventUdsStatus_Event_Radar_Initial_Alignment_Missing_Calibration: RteEventRef=OpEventGetEventUdsStatus_GetEventUdsStatus_Event_Radar_Initial_Alignment_Missing_Calibration
        OpEventGetEventUdsStatus_GetEventUdsStatus_EvtInfo_Cluster_ECU_OEL_message_Missing_Message: RteEventRef=OpEventGetEventUdsStatus_GetEventUdsStatus_EvtInfo_Cluster_ECU_OEL_message_Missing_Message
        OpEventGetEventUdsStatus_GetEventUdsStatus_Event_Cluster_ECU_OEL_message_Missing_Message: RteEventRef=OpEventGetEventUdsStatus_GetEventUdsStatus_Event_Cluster_ECU_OEL_message_Missing_Message
        OpEventGetEventUdsStatus_GetEventUdsStatus_EvtInfo_AT_AMT_ECU_ETC2_03_message_Missing_Message: RteEventRef=OpEventGetEventUdsStatus_GetEventUdsStatus_EvtInfo_AT_AMT_ECU_ETC2_03_message_Missing_Message
        OpEventGetEventUdsStatus_GetEventUdsStatus_Event_AT_AMT_ECU_ETC2_03_message_Missing_Message: RteEventRef=OpEventGetEventUdsStatus_GetEventUdsStatus_Event_AT_AMT_ECU_ETC2_03_message_Missing_Message
        OpEventGetEventUdsStatus_GetEventUdsStatus_EvtInfo_ADAS_FN_STS_message_MOIS_FN_Switch_STS_Invalid_Serial_Data_Received: RteEventRef=OpEventGetEventUdsStatus_GetEventUdsStatus_EvtInfo_ADAS_FN_STS_message_MOIS_FN_Switch_STS_Invalid_Serial_Data_Received
        OpEventGetEventUdsStatus_GetEventUdsStatus_Event_ADAS_FN_STS_message_MOIS_FN_Switch_STS_Invalid_Serial_Data_Received: RteEventRef=OpEventGetEventUdsStatus_GetEventUdsStatus_Event_ADAS_FN_STS_message_MOIS_FN_Switch_STS_Invalid_Serial_Data_Received
        OpEventGetEventUdsStatus_GetEventUdsStatus_EvtInfo_Radar_Module_Over_Temperature: RteEventRef=OpEventGetEventUdsStatus_GetEventUdsStatus_EvtInfo_Radar_Module_Over_Temperature
        OpEventGetEventUdsStatus_GetEventUdsStatus_Event_Radar_Module_Over_Temperature: RteEventRef=OpEventGetEventUdsStatus_GetEventUdsStatus_Event_Radar_Module_Over_Temperature
        OpEventGetEventUdsStatus_GetEventUdsStatus_EvtInfo_PCAN_TimeSync_Missing_Message: RteEventRef=OpEventGetEventUdsStatus_GetEventUdsStatus_EvtInfo_PCAN_TimeSync_Missing_Message
        OpEventGetEventUdsStatus_GetEventUdsStatus_Event_PCAN_TimeSync_Missing_Message: RteEventRef=OpEventGetEventUdsStatus_GetEventUdsStatus_Event_PCAN_TimeSync_Missing_Message
        OpEventGetEventUdsStatus_GetEventUdsStatus_EvtInfo_Radar_Module_Watchdog_Failure: RteEventRef=OpEventGetEventUdsStatus_GetEventUdsStatus_EvtInfo_Radar_Module_Watchdog_Failure
        OpEventGetEventUdsStatus_GetEventUdsStatus_Event_Radar_Module_Watchdog_Failure: RteEventRef=OpEventGetEventUdsStatus_GetEventUdsStatus_Event_Radar_Module_Watchdog_Failure
        OpEventGetEventUdsStatus_GetEventUdsStatus_EvtInfo_SAS_ECU_SAS_message_Missing_Message: RteEventRef=OpEventGetEventUdsStatus_GetEventUdsStatus_EvtInfo_SAS_ECU_SAS_message_Missing_Message
        OpEventGetEventUdsStatus_GetEventUdsStatus_Event_SAS_ECU_SAS_message_Missing_Message: RteEventRef=OpEventGetEventUdsStatus_GetEventUdsStatus_Event_SAS_ECU_SAS_message_Missing_Message
        OpEventGetEventUdsStatus_GetEventUdsStatus_EvtInfo_ECU_NVM_Corruption_Program_memory_Failure: RteEventRef=OpEventGetEventUdsStatus_GetEventUdsStatus_EvtInfo_ECU_NVM_Corruption_Program_memory_Failure
        OpEventGetEventUdsStatus_GetEventUdsStatus_Event_ECU_NVM_Corruption_Program_memory_Failure: RteEventRef=OpEventGetEventUdsStatus_GetEventUdsStatus_Event_ECU_NVM_Corruption_Program_memory_Failure
        OpEventGetEventUdsStatus_GetEventUdsStatus_EvtInfo_Cluster_ECU_TD_message_Missing_Message: RteEventRef=OpEventGetEventUdsStatus_GetEventUdsStatus_EvtInfo_Cluster_ECU_TD_message_Missing_Message
        OpEventGetEventUdsStatus_GetEventUdsStatus_Event_Cluster_ECU_TD_message_Missing_Message: RteEventRef=OpEventGetEventUdsStatus_GetEventUdsStatus_Event_Cluster_ECU_TD_message_Missing_Message
        OpEventGetEventUdsStatus_GetEventUdsStatus_EvtInfo_PCAN_Communication_Bus_Off: RteEventRef=OpEventGetEventUdsStatus_GetEventUdsStatus_EvtInfo_PCAN_Communication_Bus_Off
        OpEventGetEventUdsStatus_GetEventUdsStatus_Event_PCAN_Communication_Bus_Off: RteEventRef=OpEventGetEventUdsStatus_GetEventUdsStatus_Event_PCAN_Communication_Bus_Off
        OpEventGetEventUdsStatus_GetEventUdsStatus_EvtInfo_Front_Left_Side_Radar_Missing_Message: RteEventRef=OpEventGetEventUdsStatus_GetEventUdsStatus_EvtInfo_Front_Left_Side_Radar_Missing_Message
        OpEventGetEventUdsStatus_GetEventUdsStatus_Event_Front_Left_Side_Radar_Missing_Message: RteEventRef=OpEventGetEventUdsStatus_GetEventUdsStatus_Event_Front_Left_Side_Radar_Missing_Message
        OpEventGetEventUdsStatus_GetEventUdsStatus_EvtInfo_Manual_ETC2_message_Transcurrent_gear_Invalid_Serial_Data_Received: RteEventRef=OpEventGetEventUdsStatus_GetEventUdsStatus_EvtInfo_Manual_ETC2_message_Transcurrent_gear_Invalid_Serial_Data_Received
        OpEventGetEventUdsStatus_GetEventUdsStatus_Event_Manual_ETC2_message_Transcurrent_gear_Invalid_Serial_Data_Received: RteEventRef=OpEventGetEventUdsStatus_GetEventUdsStatus_Event_Manual_ETC2_message_Transcurrent_gear_Invalid_Serial_Data_Received
        OpEventGetEventUdsStatus_GetEventUdsStatus_EvtInfo_SAS_ECU_erratic_communication_Erratic: RteEventRef=OpEventGetEventUdsStatus_GetEventUdsStatus_EvtInfo_SAS_ECU_erratic_communication_Erratic
        OpEventGetEventUdsStatus_GetEventUdsStatus_Event_SAS_ECU_erratic_communication_Erratic: RteEventRef=OpEventGetEventUdsStatus_GetEventUdsStatus_Event_SAS_ECU_erratic_communication_Erratic
        OpEventGetEventUdsStatus_GetEventUdsStatus_EvtInfo_VDC2_message_Yaw_rate_Invalid_Serial_Data_Received: RteEventRef=OpEventGetEventUdsStatus_GetEventUdsStatus_EvtInfo_VDC2_message_Yaw_rate_Invalid_Serial_Data_Received
        OpEventGetEventUdsStatus_GetEventUdsStatus_Event_VDC2_message_Yaw_rate_Invalid_Serial_Data_Received: RteEventRef=OpEventGetEventUdsStatus_GetEventUdsStatus_Event_VDC2_message_Yaw_rate_Invalid_Serial_Data_Received
        OpEventGetEventUdsStatus_GetEventUdsStatus_EvtInfo_Cluster_ECU_TD_erratic_communication_Erratic: RteEventRef=OpEventGetEventUdsStatus_GetEventUdsStatus_EvtInfo_Cluster_ECU_TD_erratic_communication_Erratic
        OpEventGetEventUdsStatus_GetEventUdsStatus_Event_Cluster_ECU_TD_erratic_communication_Erratic: RteEventRef=OpEventGetEventUdsStatus_GetEventUdsStatus_Event_Cluster_ECU_TD_erratic_communication_Erratic
        OpEventGetEventUdsStatus_GetEventUdsStatus_EvtInfo_EMS_ECU_CCVS1_message_Missing_Message: RteEventRef=OpEventGetEventUdsStatus_GetEventUdsStatus_EvtInfo_EMS_ECU_CCVS1_message_Missing_Message
        OpEventGetEventUdsStatus_GetEventUdsStatus_Event_EMS_ECU_CCVS1_message_Missing_Message: RteEventRef=OpEventGetEventUdsStatus_GetEventUdsStatus_Event_EMS_ECU_CCVS1_message_Missing_Message
        OpEventGetEventUdsStatus_GetEventUdsStatus_EvtInfo_Radar_Mounting_Orientation_Incorrect_Assembly: RteEventRef=OpEventGetEventUdsStatus_GetEventUdsStatus_EvtInfo_Radar_Mounting_Orientation_Incorrect_Assembly
        OpEventGetEventUdsStatus_GetEventUdsStatus_Event_Radar_Mounting_Orientation_Incorrect_Assembly: RteEventRef=OpEventGetEventUdsStatus_GetEventUdsStatus_Event_Radar_Mounting_Orientation_Incorrect_Assembly
        OpEventGetEventUdsStatus_GetEventUdsStatus_EvtInfo_EMS_ECU_ETC2_erratic_communication_Erractic: RteEventRef=OpEventGetEventUdsStatus_GetEventUdsStatus_EvtInfo_EMS_ECU_ETC2_erratic_communication_Erractic
        OpEventGetEventUdsStatus_GetEventUdsStatus_Event_EMS_ECU_ETC2_erratic_communication_Erractic: RteEventRef=OpEventGetEventUdsStatus_GetEventUdsStatus_Event_EMS_ECU_ETC2_erratic_communication_Erractic
        OpEventGetEventUdsStatus_GetEventUdsStatus_EvtInfo_Cluster_ECU_ADAS_FN_STS_erratic_communication_Erratic: RteEventRef=OpEventGetEventUdsStatus_GetEventUdsStatus_EvtInfo_Cluster_ECU_ADAS_FN_STS_erratic_communication_Erratic
        OpEventGetEventUdsStatus_GetEventUdsStatus_Event_Cluster_ECU_ADAS_FN_STS_erratic_communication_Erratic: RteEventRef=OpEventGetEventUdsStatus_GetEventUdsStatus_Event_Cluster_ECU_ADAS_FN_STS_erratic_communication_Erratic
        OpEventGetEventUdsStatus_GetEventUdsStatus_EvtInfo_ESC_ECU_VDC2_message_Missing_Message: RteEventRef=OpEventGetEventUdsStatus_GetEventUdsStatus_EvtInfo_ESC_ECU_VDC2_message_Missing_Message
        OpEventGetEventUdsStatus_GetEventUdsStatus_Event_ESC_ECU_VDC2_message_Missing_Message: RteEventRef=OpEventGetEventUdsStatus_GetEventUdsStatus_Event_ESC_ECU_VDC2_message_Missing_Message
        OpEventGetEventUdsStatus_GetEventUdsStatus_EvtInfo_CLS_TX_16_message_Transmission_Type_info_Invalid_Serial_Data_Received: RteEventRef=OpEventGetEventUdsStatus_GetEventUdsStatus_EvtInfo_CLS_TX_16_message_Transmission_Type_info_Invalid_Serial_Data_Received
        OpEventGetEventUdsStatus_GetEventUdsStatus_Event_CLS_TX_16_message_Transmission_Type_info_Invalid_Serial_Data_Received: RteEventRef=OpEventGetEventUdsStatus_GetEventUdsStatus_Event_CLS_TX_16_message_Transmission_Type_info_Invalid_Serial_Data_Received
        OpEventGetEventUdsStatus_GetEventUdsStatus_EvtInfo_Cluster_ECU_CLS_Tx_4_erratic_communication_Erratic: RteEventRef=OpEventGetEventUdsStatus_GetEventUdsStatus_EvtInfo_Cluster_ECU_CLS_Tx_4_erratic_communication_Erratic
        OpEventGetEventUdsStatus_GetEventUdsStatus_Event_Cluster_ECU_CLS_Tx_4_erratic_communication_Erratic: RteEventRef=OpEventGetEventUdsStatus_GetEventUdsStatus_Event_Cluster_ECU_CLS_Tx_4_erratic_communication_Erratic
        OpEventGetEventUdsStatus_GetEventUdsStatus_EvtInfo_Cluster_ECU_ADAS_FN_STS_message_Missing_Message: RteEventRef=OpEventGetEventUdsStatus_GetEventUdsStatus_EvtInfo_Cluster_ECU_ADAS_FN_STS_message_Missing_Message
        OpEventGetEventUdsStatus_GetEventUdsStatus_Event_Cluster_ECU_ADAS_FN_STS_message_Missing_Message: RteEventRef=OpEventGetEventUdsStatus_GetEventUdsStatus_Event_Cluster_ECU_ADAS_FN_STS_message_Missing_Message
        OpEventGetEventUdsStatus_GetEventUdsStatus_EvtInfo_Vehicle_Dataset_value_of_signal_protection_calculation_Incorrect: RteEventRef=OpEventGetEventUdsStatus_GetEventUdsStatus_EvtInfo_Vehicle_Dataset_value_of_signal_protection_calculation_Incorrect
        OpEventGetEventUdsStatus_GetEventUdsStatus_Event_Vehicle_Dataset_value_of_signal_protection_calculation_Incorrect: RteEventRef=OpEventGetEventUdsStatus_GetEventUdsStatus_Event_Vehicle_Dataset_value_of_signal_protection_calculation_Incorrect
        OpEventGetEventUdsStatus_GetEventUdsStatus_EvtInfo_Cluster_ECU_CLS_Tx_16_erratic_communication_Erratic: RteEventRef=OpEventGetEventUdsStatus_GetEventUdsStatus_EvtInfo_Cluster_ECU_CLS_Tx_16_erratic_communication_Erratic
        OpEventGetEventUdsStatus_GetEventUdsStatus_Event_Cluster_ECU_CLS_Tx_16_erratic_communication_Erratic: RteEventRef=OpEventGetEventUdsStatus_GetEventUdsStatus_Event_Cluster_ECU_CLS_Tx_16_erratic_communication_Erratic
        OpEventGetEventUdsStatus_GetEventUdsStatus_EvtInfo_Cluster_ECU_OEL_erratic_communication_Erratic: RteEventRef=OpEventGetEventUdsStatus_GetEventUdsStatus_EvtInfo_Cluster_ECU_OEL_erratic_communication_Erratic
        OpEventGetEventUdsStatus_GetEventUdsStatus_Event_Cluster_ECU_OEL_erratic_communication_Erratic: RteEventRef=OpEventGetEventUdsStatus_GetEventUdsStatus_Event_Cluster_ECU_OEL_erratic_communication_Erratic
        OpEventGetEventUdsStatus_GetEventUdsStatus_EvtInfo_Cluster_ECU_CLS_Tx_4_message_Missing_Message: RteEventRef=OpEventGetEventUdsStatus_GetEventUdsStatus_EvtInfo_Cluster_ECU_CLS_Tx_4_message_Missing_Message
        OpEventGetEventUdsStatus_GetEventUdsStatus_Event_Cluster_ECU_CLS_Tx_4_message_Missing_Message: RteEventRef=OpEventGetEventUdsStatus_GetEventUdsStatus_Event_Cluster_ECU_CLS_Tx_4_message_Missing_Message
        OpEventGetEventUdsStatus_GetEventUdsStatus_EvtInfo_Radar_Performance_Capability_Algorithm_Based_Failure: RteEventRef=OpEventGetEventUdsStatus_GetEventUdsStatus_EvtInfo_Radar_Performance_Capability_Algorithm_Based_Failure
        OpEventGetEventUdsStatus_GetEventUdsStatus_Event_Radar_Performance_Capability_Algorithm_Based_Failure: RteEventRef=OpEventGetEventUdsStatus_GetEventUdsStatus_Event_Radar_Performance_Capability_Algorithm_Based_Failure
        OpEventGetEventUdsStatus_GetEventUdsStatus_EvtInfo_Radar_AutoAlignment_Range_Alignment_or_Adjustement_Incorrect: RteEventRef=OpEventGetEventUdsStatus_GetEventUdsStatus_EvtInfo_Radar_AutoAlignment_Range_Alignment_or_Adjustement_Incorrect
        OpEventGetEventUdsStatus_GetEventUdsStatus_Event_Radar_AutoAlignment_Range_Alignment_or_Adjustement_Incorrect: RteEventRef=OpEventGetEventUdsStatus_GetEventUdsStatus_Event_Radar_AutoAlignment_Range_Alignment_or_Adjustement_Incorrect
        OpEventGetEventUdsStatus_GetEventUdsStatus_EvtInfo_EMS_ECU_CCVS1_erratic_communication_Erractic: RteEventRef=OpEventGetEventUdsStatus_GetEventUdsStatus_EvtInfo_EMS_ECU_CCVS1_erratic_communication_Erractic
        OpEventGetEventUdsStatus_GetEventUdsStatus_Event_EMS_ECU_CCVS1_erratic_communication_Erractic: RteEventRef=OpEventGetEventUdsStatus_GetEventUdsStatus_Event_EMS_ECU_CCVS1_erratic_communication_Erractic
        OpEventGetEventUdsStatus_GetEventUdsStatus_EvtInfo_Radar_System_Battery_Low_Voltage_System_Voltage_Low: RteEventRef=OpEventGetEventUdsStatus_GetEventUdsStatus_EvtInfo_Radar_System_Battery_Low_Voltage_System_Voltage_Low
        OpEventGetEventUdsStatus_GetEventUdsStatus_Event_Radar_System_Battery_Low_Voltage_System_Voltage_Low: RteEventRef=OpEventGetEventUdsStatus_GetEventUdsStatus_Event_Radar_System_Battery_Low_Voltage_System_Voltage_Low
        OpEventGetEventUdsStatus_GetEventUdsStatus_EvtInfo_Radar_SMC_General_Checksum_Failure: RteEventRef=OpEventGetEventUdsStatus_GetEventUdsStatus_EvtInfo_Radar_SMC_General_Checksum_Failure
        OpEventGetEventUdsStatus_GetEventUdsStatus_Event_Radar_SMC_General_Checksum_Failure: RteEventRef=OpEventGetEventUdsStatus_GetEventUdsStatus_Event_Radar_SMC_General_Checksum_Failure
        OpEventGetEventUdsStatus_GetEventUdsStatus_EvtInfo_Radar_Pin_Position_Wrong_Mounting_Position: RteEventRef=OpEventGetEventUdsStatus_GetEventUdsStatus_EvtInfo_Radar_Pin_Position_Wrong_Mounting_Position
        OpEventGetEventUdsStatus_GetEventUdsStatus_Event_Radar_Pin_Position_Wrong_Mounting_Position: RteEventRef=OpEventGetEventUdsStatus_GetEventUdsStatus_Event_Radar_Pin_Position_Wrong_Mounting_Position
        OpEventGetEventUdsStatus_GetEventUdsStatus_EvtInfo_VDC2_message_Lateral_Accleration_Invalid_Serial_Data_Received: RteEventRef=OpEventGetEventUdsStatus_GetEventUdsStatus_EvtInfo_VDC2_message_Lateral_Accleration_Invalid_Serial_Data_Received
        OpEventGetEventUdsStatus_GetEventUdsStatus_Event_VDC2_message_Lateral_Accleration_Invalid_Serial_Data_Received: RteEventRef=OpEventGetEventUdsStatus_GetEventUdsStatus_Event_VDC2_message_Lateral_Accleration_Invalid_Serial_Data_Received
        OpEventGetEventUdsStatus_GetEventUdsStatus_EvtInfo_ADAS_FN_STS_message_BSIS_FN_Switch_STS_Invalid_Serial_Data_Received: RteEventRef=OpEventGetEventUdsStatus_GetEventUdsStatus_EvtInfo_ADAS_FN_STS_message_BSIS_FN_Switch_STS_Invalid_Serial_Data_Received
        OpEventGetEventUdsStatus_GetEventUdsStatus_Event_ADAS_FN_STS_message_BSIS_FN_Switch_STS_Invalid_Serial_Data_Received: RteEventRef=OpEventGetEventUdsStatus_GetEventUdsStatus_Event_ADAS_FN_STS_message_BSIS_FN_Switch_STS_Invalid_Serial_Data_Received
        OpEventGetEventUdsStatus_GetEventUdsStatus_EvtInfo_Radar_AutoAlignment_Misalignment_Performance_or_Incorrect_Operation: RteEventRef=OpEventGetEventUdsStatus_GetEventUdsStatus_EvtInfo_Radar_AutoAlignment_Misalignment_Performance_or_Incorrect_Operation
        OpEventGetEventUdsStatus_GetEventUdsStatus_Event_Radar_AutoAlignment_Misalignment_Performance_or_Incorrect_Operation: RteEventRef=OpEventGetEventUdsStatus_GetEventUdsStatus_Event_Radar_AutoAlignment_Misalignment_Performance_or_Incorrect_Operation
        OpEventGetEventUdsStatus_GetEventUdsStatus_EvtInfo_ESC_ECU_VDC2_erratic_communication_Erratic: RteEventRef=OpEventGetEventUdsStatus_GetEventUdsStatus_EvtInfo_ESC_ECU_VDC2_erratic_communication_Erratic
        OpEventGetEventUdsStatus_GetEventUdsStatus_Event_ESC_ECU_VDC2_erratic_communication_Erratic: RteEventRef=OpEventGetEventUdsStatus_GetEventUdsStatus_Event_ESC_ECU_VDC2_erratic_communication_Erratic
        OpEventGetEventUdsStatus_GetEventUdsStatus_EvtInfo_Application_Interface_Lookup_Performance_or_Incorrect_Operation: RteEventRef=OpEventGetEventUdsStatus_GetEventUdsStatus_EvtInfo_Application_Interface_Lookup_Performance_or_Incorrect_Operation
        OpEventGetEventUdsStatus_GetEventUdsStatus_Event_Application_Interface_Lookup_Performance_or_Incorrect_Operation: RteEventRef=OpEventGetEventUdsStatus_GetEventUdsStatus_Event_Application_Interface_Lookup_Performance_or_Incorrect_Operation
        OpEventGetEventUdsStatus_GetEventUdsStatus_EvtInfo_EMS_ECU_VD_message_Missing_Message: RteEventRef=OpEventGetEventUdsStatus_GetEventUdsStatus_EvtInfo_EMS_ECU_VD_message_Missing_Message
        OpEventGetEventUdsStatus_GetEventUdsStatus_Event_EMS_ECU_VD_message_Missing_Message: RteEventRef=OpEventGetEventUdsStatus_GetEventUdsStatus_Event_EMS_ECU_VD_message_Missing_Message
        OpEventGetEventUdsStatus_GetEventUdsStatus_EvtInfo_Radar_Platform_Time_System_Programming_Failure: RteEventRef=OpEventGetEventUdsStatus_GetEventUdsStatus_EvtInfo_Radar_Platform_Time_System_Programming_Failure
        OpEventGetEventUdsStatus_GetEventUdsStatus_Event_Radar_Platform_Time_System_Programming_Failure: RteEventRef=OpEventGetEventUdsStatus_GetEventUdsStatus_Event_Radar_Platform_Time_System_Programming_Failure
        OpEventGetEventUdsStatus_GetEventUdsStatus_EvtInfo_OEL_message_Turn_Signal_Switch_Invalid_Serial_Data_Received: RteEventRef=OpEventGetEventUdsStatus_GetEventUdsStatus_EvtInfo_OEL_message_Turn_Signal_Switch_Invalid_Serial_Data_Received
        OpEventGetEventUdsStatus_GetEventUdsStatus_Event_OEL_message_Turn_Signal_Switch_Invalid_Serial_Data_Received: RteEventRef=OpEventGetEventUdsStatus_GetEventUdsStatus_Event_OEL_message_Turn_Signal_Switch_Invalid_Serial_Data_Received
        OpEventGetEventUdsStatus_GetEventUdsStatus_EvtInfo_Radar_calibration_Calibration_or_Paramater_Memory_Failure: RteEventRef=OpEventGetEventUdsStatus_GetEventUdsStatus_EvtInfo_Radar_calibration_Calibration_or_Paramater_Memory_Failure
        OpEventGetEventUdsStatus_GetEventUdsStatus_Event_Radar_calibration_Calibration_or_Paramater_Memory_Failure: RteEventRef=OpEventGetEventUdsStatus_GetEventUdsStatus_Event_Radar_calibration_Calibration_or_Paramater_Memory_Failure
        OpEventGetEventUdsStatus_GetEventUdsStatus_GeneralEvtInfo: RteEventRef=OpEventGetEventUdsStatus_GetEventUdsStatus_GeneralEvtInfo
        OpEventGetEventStatus_GetEventStatus_EvtInfo_SAS_message_Steering_Wheel_Angle_Invalid_Serial_Data_Received: RteEventRef=OpEventGetEventStatus_GetEventStatus_EvtInfo_SAS_message_Steering_Wheel_Angle_Invalid_Serial_Data_Received
        OpEventGetEventStatus_GetEventStatus_Event_SAS_message_Steering_Wheel_Angle_Invalid_Serial_Data_Received: RteEventRef=OpEventGetEventStatus_GetEventStatus_Event_SAS_message_Steering_Wheel_Angle_Invalid_Serial_Data_Received
        OpEventGetEventStatus_GetEventStatus_EvtInfo_AT_AMT_ETC2_message_Transcurrent_gear_Invalid_Serial_Data_Received: RteEventRef=OpEventGetEventStatus_GetEventStatus_EvtInfo_AT_AMT_ETC2_message_Transcurrent_gear_Invalid_Serial_Data_Received
        OpEventGetEventStatus_GetEventStatus_Event_AT_AMT_ETC2_message_Transcurrent_gear_Invalid_Serial_Data_Received: RteEventRef=OpEventGetEventStatus_GetEventStatus_Event_AT_AMT_ETC2_message_Transcurrent_gear_Invalid_Serial_Data_Received
        OpEventGetEventStatus_GetEventStatus_EvtInfo_Radar_AutoAlignment_Algorithm_Signal_Calculation_Failure: RteEventRef=OpEventGetEventStatus_GetEventStatus_EvtInfo_Radar_AutoAlignment_Algorithm_Signal_Calculation_Failure
        OpEventGetEventStatus_GetEventStatus_Event_Radar_AutoAlignment_Algorithm_Signal_Calculation_Failure: RteEventRef=OpEventGetEventStatus_GetEventStatus_Event_Radar_AutoAlignment_Algorithm_Signal_Calculation_Failure
        OpEventGetEventStatus_GetEventStatus_EvtInfo_Vehicle_DataSet_Not_Configured: RteEventRef=OpEventGetEventStatus_GetEventStatus_EvtInfo_Vehicle_DataSet_Not_Configured
        OpEventGetEventStatus_GetEventStatus_Event_Vehicle_DataSet_Not_Configured: RteEventRef=OpEventGetEventStatus_GetEventStatus_Event_Vehicle_DataSet_Not_Configured
        OpEventGetEventStatus_GetEventStatus_EvtInfo_Radar_Module_System_Internal_Failure: RteEventRef=OpEventGetEventStatus_GetEventStatus_EvtInfo_Radar_Module_System_Internal_Failure
        OpEventGetEventStatus_GetEventStatus_Event_Radar_Module_System_Internal_Failure: RteEventRef=OpEventGetEventStatus_GetEventStatus_Event_Radar_Module_System_Internal_Failure
        OpEventGetEventStatus_GetEventStatus_EvtInfo_Radar_MMIC_Component_Failure: RteEventRef=OpEventGetEventStatus_GetEventStatus_EvtInfo_Radar_MMIC_Component_Failure
        OpEventGetEventStatus_GetEventStatus_Event_Radar_MMIC_Component_Failure: RteEventRef=OpEventGetEventStatus_GetEventStatus_Event_Radar_MMIC_Component_Failure
        OpEventGetEventStatus_GetEventStatus_EvtInfo_Radar_Module_General_Memory_Failure: RteEventRef=OpEventGetEventStatus_GetEventStatus_EvtInfo_Radar_Module_General_Memory_Failure
        OpEventGetEventStatus_GetEventStatus_Event_Radar_Module_General_Memory_Failure: RteEventRef=OpEventGetEventStatus_GetEventStatus_Event_Radar_Module_General_Memory_Failure
        OpEventGetEventStatus_GetEventStatus_EvtInfo_Radar_System_Battery_High_Voltage_System_Voltage_High: RteEventRef=OpEventGetEventStatus_GetEventStatus_EvtInfo_Radar_System_Battery_High_Voltage_System_Voltage_High
        OpEventGetEventStatus_GetEventStatus_Event_Radar_System_Battery_High_Voltage_System_Voltage_High: RteEventRef=OpEventGetEventStatus_GetEventStatus_Event_Radar_System_Battery_High_Voltage_System_Voltage_High
        OpEventGetEventStatus_GetEventStatus_EvtInfo_CCVS1_message_Vehicle_Speed_Invalid_Serial_Data_Received: RteEventRef=OpEventGetEventStatus_GetEventStatus_EvtInfo_CCVS1_message_Vehicle_Speed_Invalid_Serial_Data_Received
        OpEventGetEventStatus_GetEventStatus_Event_CCVS1_message_Vehicle_Speed_Invalid_Serial_Data_Received: RteEventRef=OpEventGetEventStatus_GetEventStatus_Event_CCVS1_message_Vehicle_Speed_Invalid_Serial_Data_Received
        OpEventGetEventStatus_GetEventStatus_EvtInfo_EMS_ECU_VD_erratic_communication_Erratic: RteEventRef=OpEventGetEventStatus_GetEventStatus_EvtInfo_EMS_ECU_VD_erratic_communication_Erratic
        OpEventGetEventStatus_GetEventStatus_Event_EMS_ECU_VD_erratic_communication_Erratic: RteEventRef=OpEventGetEventStatus_GetEventStatus_Event_EMS_ECU_VD_erratic_communication_Erratic
        OpEventGetEventStatus_GetEventStatus_EvtInfo_EMS_ECU_ETC2_00_message_Missing_Message: RteEventRef=OpEventGetEventStatus_GetEventStatus_EvtInfo_EMS_ECU_ETC2_00_message_Missing_Message
        OpEventGetEventStatus_GetEventStatus_Event_EMS_ECU_ETC2_00_message_Missing_Message: RteEventRef=OpEventGetEventStatus_GetEventStatus_Event_EMS_ECU_ETC2_00_message_Missing_Message
        OpEventGetEventStatus_GetEventStatus_EvtInfo_Cluster_ECU_CLS_Tx_16_message_Missing_Message: RteEventRef=OpEventGetEventStatus_GetEventStatus_EvtInfo_Cluster_ECU_CLS_Tx_16_message_Missing_Message
        OpEventGetEventStatus_GetEventStatus_Event_Cluster_ECU_CLS_Tx_16_message_Missing_Message: RteEventRef=OpEventGetEventStatus_GetEventStatus_Event_Cluster_ECU_CLS_Tx_16_message_Missing_Message
        OpEventGetEventStatus_GetEventStatus_EvtInfo_Exceeded_Security_Access_0x27_Attempt_Threshold_Authentication_Failure: RteEventRef=OpEventGetEventStatus_GetEventStatus_EvtInfo_Exceeded_Security_Access_0x27_Attempt_Threshold_Authentication_Failure
        OpEventGetEventStatus_GetEventStatus_Event_Exceeded_Security_Access_0x27_Attempt_Threshold_Authentication_Failure: RteEventRef=OpEventGetEventStatus_GetEventStatus_Event_Exceeded_Security_Access_0x27_Attempt_Threshold_Authentication_Failure
        OpEventGetEventStatus_GetEventStatus_EvtInfo_Front_Left_Side_Radar_value_of_signal_protection_calculation_Incorrect: RteEventRef=OpEventGetEventStatus_GetEventStatus_EvtInfo_Front_Left_Side_Radar_value_of_signal_protection_calculation_Incorrect
        OpEventGetEventStatus_GetEventStatus_Event_Front_Left_Side_Radar_value_of_signal_protection_calculation_Incorrect: RteEventRef=OpEventGetEventStatus_GetEventStatus_Event_Front_Left_Side_Radar_value_of_signal_protection_calculation_Incorrect
        OpEventGetEventStatus_GetEventStatus_EvtInfo_AT_AMT_ETC2_erratic_communication_Erratic: RteEventRef=OpEventGetEventStatus_GetEventStatus_EvtInfo_AT_AMT_ETC2_erratic_communication_Erratic
        OpEventGetEventStatus_GetEventStatus_Event_AT_AMT_ETC2_erratic_communication_Erratic: RteEventRef=OpEventGetEventStatus_GetEventStatus_Event_AT_AMT_ETC2_erratic_communication_Erratic
        OpEventGetEventStatus_GetEventStatus_EvtInfo_VCAN_Communication_Bus_Off: RteEventRef=OpEventGetEventStatus_GetEventStatus_EvtInfo_VCAN_Communication_Bus_Off
        OpEventGetEventStatus_GetEventStatus_Event_VCAN_Communication_Bus_Off: RteEventRef=OpEventGetEventStatus_GetEventStatus_Event_VCAN_Communication_Bus_Off
        OpEventGetEventStatus_GetEventStatus_EvtInfo_VDC2_message_LongitudinalAcceleration_Invalid_Serial_Data_Received: RteEventRef=OpEventGetEventStatus_GetEventStatus_EvtInfo_VDC2_message_LongitudinalAcceleration_Invalid_Serial_Data_Received
        OpEventGetEventStatus_GetEventStatus_Event_VDC2_message_LongitudinalAcceleration_Invalid_Serial_Data_Received: RteEventRef=OpEventGetEventStatus_GetEventStatus_Event_VDC2_message_LongitudinalAcceleration_Invalid_Serial_Data_Received
        OpEventGetEventStatus_GetEventStatus_EvtInfo_Radar_MMIC_RFBIST_Component_Internal_Failure: RteEventRef=OpEventGetEventStatus_GetEventStatus_EvtInfo_Radar_MMIC_RFBIST_Component_Internal_Failure
        OpEventGetEventStatus_GetEventStatus_Event_Radar_MMIC_RFBIST_Component_Internal_Failure: RteEventRef=OpEventGetEventStatus_GetEventStatus_Event_Radar_MMIC_RFBIST_Component_Internal_Failure
        OpEventGetEventStatus_GetEventStatus_EvtInfo_Radar_Initial_Alignment_Missing_Calibration: RteEventRef=OpEventGetEventStatus_GetEventStatus_EvtInfo_Radar_Initial_Alignment_Missing_Calibration
        OpEventGetEventStatus_GetEventStatus_Event_Radar_Initial_Alignment_Missing_Calibration: RteEventRef=OpEventGetEventStatus_GetEventStatus_Event_Radar_Initial_Alignment_Missing_Calibration
        OpEventGetEventStatus_GetEventStatus_EvtInfo_Cluster_ECU_OEL_message_Missing_Message: RteEventRef=OpEventGetEventStatus_GetEventStatus_EvtInfo_Cluster_ECU_OEL_message_Missing_Message
        OpEventGetEventStatus_GetEventStatus_Event_Cluster_ECU_OEL_message_Missing_Message: RteEventRef=OpEventGetEventStatus_GetEventStatus_Event_Cluster_ECU_OEL_message_Missing_Message
        OpEventGetEventStatus_GetEventStatus_EvtInfo_AT_AMT_ECU_ETC2_03_message_Missing_Message: RteEventRef=OpEventGetEventStatus_GetEventStatus_EvtInfo_AT_AMT_ECU_ETC2_03_message_Missing_Message
        OpEventGetEventStatus_GetEventStatus_Event_AT_AMT_ECU_ETC2_03_message_Missing_Message: RteEventRef=OpEventGetEventStatus_GetEventStatus_Event_AT_AMT_ECU_ETC2_03_message_Missing_Message
        OpEventGetEventStatus_GetEventStatus_EvtInfo_ADAS_FN_STS_message_MOIS_FN_Switch_STS_Invalid_Serial_Data_Received: RteEventRef=OpEventGetEventStatus_GetEventStatus_EvtInfo_ADAS_FN_STS_message_MOIS_FN_Switch_STS_Invalid_Serial_Data_Received
        OpEventGetEventStatus_GetEventStatus_Event_ADAS_FN_STS_message_MOIS_FN_Switch_STS_Invalid_Serial_Data_Received: RteEventRef=OpEventGetEventStatus_GetEventStatus_Event_ADAS_FN_STS_message_MOIS_FN_Switch_STS_Invalid_Serial_Data_Received
        OpEventGetEventStatus_GetEventStatus_EvtInfo_Radar_Module_Over_Temperature: RteEventRef=OpEventGetEventStatus_GetEventStatus_EvtInfo_Radar_Module_Over_Temperature
        OpEventGetEventStatus_GetEventStatus_Event_Radar_Module_Over_Temperature: RteEventRef=OpEventGetEventStatus_GetEventStatus_Event_Radar_Module_Over_Temperature
        OpEventGetEventStatus_GetEventStatus_EvtInfo_PCAN_TimeSync_Missing_Message: RteEventRef=OpEventGetEventStatus_GetEventStatus_EvtInfo_PCAN_TimeSync_Missing_Message
        OpEventGetEventStatus_GetEventStatus_Event_PCAN_TimeSync_Missing_Message: RteEventRef=OpEventGetEventStatus_GetEventStatus_Event_PCAN_TimeSync_Missing_Message
        OpEventGetEventStatus_GetEventStatus_EvtInfo_Radar_Module_Watchdog_Failure: RteEventRef=OpEventGetEventStatus_GetEventStatus_EvtInfo_Radar_Module_Watchdog_Failure
        OpEventGetEventStatus_GetEventStatus_Event_Radar_Module_Watchdog_Failure: RteEventRef=OpEventGetEventStatus_GetEventStatus_Event_Radar_Module_Watchdog_Failure
        OpEventGetEventStatus_GetEventStatus_EvtInfo_SAS_ECU_SAS_message_Missing_Message: RteEventRef=OpEventGetEventStatus_GetEventStatus_EvtInfo_SAS_ECU_SAS_message_Missing_Message
        OpEventGetEventStatus_GetEventStatus_Event_SAS_ECU_SAS_message_Missing_Message: RteEventRef=OpEventGetEventStatus_GetEventStatus_Event_SAS_ECU_SAS_message_Missing_Message
        OpEventGetEventStatus_GetEventStatus_EvtInfo_ECU_NVM_Corruption_Program_memory_Failure: RteEventRef=OpEventGetEventStatus_GetEventStatus_EvtInfo_ECU_NVM_Corruption_Program_memory_Failure
        OpEventGetEventStatus_GetEventStatus_Event_ECU_NVM_Corruption_Program_memory_Failure: RteEventRef=OpEventGetEventStatus_GetEventStatus_Event_ECU_NVM_Corruption_Program_memory_Failure
        OpEventGetEventStatus_GetEventStatus_EvtInfo_Cluster_ECU_TD_message_Missing_Message: RteEventRef=OpEventGetEventStatus_GetEventStatus_EvtInfo_Cluster_ECU_TD_message_Missing_Message
        OpEventGetEventStatus_GetEventStatus_Event_Cluster_ECU_TD_message_Missing_Message: RteEventRef=OpEventGetEventStatus_GetEventStatus_Event_Cluster_ECU_TD_message_Missing_Message
        OpEventGetEventStatus_GetEventStatus_EvtInfo_PCAN_Communication_Bus_Off: RteEventRef=OpEventGetEventStatus_GetEventStatus_EvtInfo_PCAN_Communication_Bus_Off
        OpEventGetEventStatus_GetEventStatus_Event_PCAN_Communication_Bus_Off: RteEventRef=OpEventGetEventStatus_GetEventStatus_Event_PCAN_Communication_Bus_Off
        OpEventGetEventStatus_GetEventStatus_EvtInfo_Front_Left_Side_Radar_Missing_Message: RteEventRef=OpEventGetEventStatus_GetEventStatus_EvtInfo_Front_Left_Side_Radar_Missing_Message
        OpEventGetEventStatus_GetEventStatus_Event_Front_Left_Side_Radar_Missing_Message: RteEventRef=OpEventGetEventStatus_GetEventStatus_Event_Front_Left_Side_Radar_Missing_Message
        OpEventGetEventStatus_GetEventStatus_EvtInfo_Manual_ETC2_message_Transcurrent_gear_Invalid_Serial_Data_Received: RteEventRef=OpEventGetEventStatus_GetEventStatus_EvtInfo_Manual_ETC2_message_Transcurrent_gear_Invalid_Serial_Data_Received
        OpEventGetEventStatus_GetEventStatus_Event_Manual_ETC2_message_Transcurrent_gear_Invalid_Serial_Data_Received: RteEventRef=OpEventGetEventStatus_GetEventStatus_Event_Manual_ETC2_message_Transcurrent_gear_Invalid_Serial_Data_Received
        OpEventGetEventStatus_GetEventStatus_EvtInfo_SAS_ECU_erratic_communication_Erratic: RteEventRef=OpEventGetEventStatus_GetEventStatus_EvtInfo_SAS_ECU_erratic_communication_Erratic
        OpEventGetEventStatus_GetEventStatus_Event_SAS_ECU_erratic_communication_Erratic: RteEventRef=OpEventGetEventStatus_GetEventStatus_Event_SAS_ECU_erratic_communication_Erratic
        OpEventGetEventStatus_GetEventStatus_EvtInfo_VDC2_message_Yaw_rate_Invalid_Serial_Data_Received: RteEventRef=OpEventGetEventStatus_GetEventStatus_EvtInfo_VDC2_message_Yaw_rate_Invalid_Serial_Data_Received
        OpEventGetEventStatus_GetEventStatus_Event_VDC2_message_Yaw_rate_Invalid_Serial_Data_Received: RteEventRef=OpEventGetEventStatus_GetEventStatus_Event_VDC2_message_Yaw_rate_Invalid_Serial_Data_Received
        OpEventGetEventStatus_GetEventStatus_EvtInfo_Cluster_ECU_TD_erratic_communication_Erratic: RteEventRef=OpEventGetEventStatus_GetEventStatus_EvtInfo_Cluster_ECU_TD_erratic_communication_Erratic
        OpEventGetEventStatus_GetEventStatus_Event_Cluster_ECU_TD_erratic_communication_Erratic: RteEventRef=OpEventGetEventStatus_GetEventStatus_Event_Cluster_ECU_TD_erratic_communication_Erratic
        OpEventGetEventStatus_GetEventStatus_EvtInfo_EMS_ECU_CCVS1_message_Missing_Message: RteEventRef=OpEventGetEventStatus_GetEventStatus_EvtInfo_EMS_ECU_CCVS1_message_Missing_Message
        OpEventGetEventStatus_GetEventStatus_Event_EMS_ECU_CCVS1_message_Missing_Message: RteEventRef=OpEventGetEventStatus_GetEventStatus_Event_EMS_ECU_CCVS1_message_Missing_Message
        OpEventGetEventStatus_GetEventStatus_EvtInfo_Radar_Mounting_Orientation_Incorrect_Assembly: RteEventRef=OpEventGetEventStatus_GetEventStatus_EvtInfo_Radar_Mounting_Orientation_Incorrect_Assembly
        OpEventGetEventStatus_GetEventStatus_Event_Radar_Mounting_Orientation_Incorrect_Assembly: RteEventRef=OpEventGetEventStatus_GetEventStatus_Event_Radar_Mounting_Orientation_Incorrect_Assembly
        OpEventGetEventStatus_GetEventStatus_EvtInfo_EMS_ECU_ETC2_erratic_communication_Erractic: RteEventRef=OpEventGetEventStatus_GetEventStatus_EvtInfo_EMS_ECU_ETC2_erratic_communication_Erractic
        OpEventGetEventStatus_GetEventStatus_Event_EMS_ECU_ETC2_erratic_communication_Erractic: RteEventRef=OpEventGetEventStatus_GetEventStatus_Event_EMS_ECU_ETC2_erratic_communication_Erractic
        OpEventGetEventStatus_GetEventStatus_EvtInfo_Cluster_ECU_ADAS_FN_STS_erratic_communication_Erratic: RteEventRef=OpEventGetEventStatus_GetEventStatus_EvtInfo_Cluster_ECU_ADAS_FN_STS_erratic_communication_Erratic
        OpEventGetEventStatus_GetEventStatus_Event_Cluster_ECU_ADAS_FN_STS_erratic_communication_Erratic: RteEventRef=OpEventGetEventStatus_GetEventStatus_Event_Cluster_ECU_ADAS_FN_STS_erratic_communication_Erratic
        OpEventGetEventStatus_GetEventStatus_EvtInfo_ESC_ECU_VDC2_message_Missing_Message: RteEventRef=OpEventGetEventStatus_GetEventStatus_EvtInfo_ESC_ECU_VDC2_message_Missing_Message
        OpEventGetEventStatus_GetEventStatus_Event_ESC_ECU_VDC2_message_Missing_Message: RteEventRef=OpEventGetEventStatus_GetEventStatus_Event_ESC_ECU_VDC2_message_Missing_Message
        OpEventGetEventStatus_GetEventStatus_EvtInfo_CLS_TX_16_message_Transmission_Type_info_Invalid_Serial_Data_Received: RteEventRef=OpEventGetEventStatus_GetEventStatus_EvtInfo_CLS_TX_16_message_Transmission_Type_info_Invalid_Serial_Data_Received
        OpEventGetEventStatus_GetEventStatus_Event_CLS_TX_16_message_Transmission_Type_info_Invalid_Serial_Data_Received: RteEventRef=OpEventGetEventStatus_GetEventStatus_Event_CLS_TX_16_message_Transmission_Type_info_Invalid_Serial_Data_Received
        OpEventGetEventStatus_GetEventStatus_EvtInfo_Cluster_ECU_CLS_Tx_4_erratic_communication_Erratic: RteEventRef=OpEventGetEventStatus_GetEventStatus_EvtInfo_Cluster_ECU_CLS_Tx_4_erratic_communication_Erratic
        OpEventGetEventStatus_GetEventStatus_Event_Cluster_ECU_CLS_Tx_4_erratic_communication_Erratic: RteEventRef=OpEventGetEventStatus_GetEventStatus_Event_Cluster_ECU_CLS_Tx_4_erratic_communication_Erratic
        OpEventGetEventStatus_GetEventStatus_EvtInfo_Cluster_ECU_ADAS_FN_STS_message_Missing_Message: RteEventRef=OpEventGetEventStatus_GetEventStatus_EvtInfo_Cluster_ECU_ADAS_FN_STS_message_Missing_Message
        OpEventGetEventStatus_GetEventStatus_Event_Cluster_ECU_ADAS_FN_STS_message_Missing_Message: RteEventRef=OpEventGetEventStatus_GetEventStatus_Event_Cluster_ECU_ADAS_FN_STS_message_Missing_Message
        OpEventGetEventStatus_GetEventStatus_EvtInfo_Vehicle_Dataset_value_of_signal_protection_calculation_Incorrect: RteEventRef=OpEventGetEventStatus_GetEventStatus_EvtInfo_Vehicle_Dataset_value_of_signal_protection_calculation_Incorrect
        OpEventGetEventStatus_GetEventStatus_Event_Vehicle_Dataset_value_of_signal_protection_calculation_Incorrect: RteEventRef=OpEventGetEventStatus_GetEventStatus_Event_Vehicle_Dataset_value_of_signal_protection_calculation_Incorrect
        OpEventGetEventStatus_GetEventStatus_EvtInfo_Cluster_ECU_CLS_Tx_16_erratic_communication_Erratic: RteEventRef=OpEventGetEventStatus_GetEventStatus_EvtInfo_Cluster_ECU_CLS_Tx_16_erratic_communication_Erratic
        OpEventGetEventStatus_GetEventStatus_Event_Cluster_ECU_CLS_Tx_16_erratic_communication_Erratic: RteEventRef=OpEventGetEventStatus_GetEventStatus_Event_Cluster_ECU_CLS_Tx_16_erratic_communication_Erratic
        OpEventGetEventStatus_GetEventStatus_EvtInfo_Cluster_ECU_OEL_erratic_communication_Erratic: RteEventRef=OpEventGetEventStatus_GetEventStatus_EvtInfo_Cluster_ECU_OEL_erratic_communication_Erratic
        OpEventGetEventStatus_GetEventStatus_Event_Cluster_ECU_OEL_erratic_communication_Erratic: RteEventRef=OpEventGetEventStatus_GetEventStatus_Event_Cluster_ECU_OEL_erratic_communication_Erratic
        OpEventGetEventStatus_GetEventStatus_EvtInfo_Cluster_ECU_CLS_Tx_4_message_Missing_Message: RteEventRef=OpEventGetEventStatus_GetEventStatus_EvtInfo_Cluster_ECU_CLS_Tx_4_message_Missing_Message
        OpEventGetEventStatus_GetEventStatus_Event_Cluster_ECU_CLS_Tx_4_message_Missing_Message: RteEventRef=OpEventGetEventStatus_GetEventStatus_Event_Cluster_ECU_CLS_Tx_4_message_Missing_Message
        OpEventGetEventStatus_GetEventStatus_EvtInfo_Radar_Performance_Capability_Algorithm_Based_Failure: RteEventRef=OpEventGetEventStatus_GetEventStatus_EvtInfo_Radar_Performance_Capability_Algorithm_Based_Failure
        OpEventGetEventStatus_GetEventStatus_Event_Radar_Performance_Capability_Algorithm_Based_Failure: RteEventRef=OpEventGetEventStatus_GetEventStatus_Event_Radar_Performance_Capability_Algorithm_Based_Failure
        OpEventGetEventStatus_GetEventStatus_EvtInfo_Radar_AutoAlignment_Range_Alignment_or_Adjustement_Incorrect: RteEventRef=OpEventGetEventStatus_GetEventStatus_EvtInfo_Radar_AutoAlignment_Range_Alignment_or_Adjustement_Incorrect
        OpEventGetEventStatus_GetEventStatus_Event_Radar_AutoAlignment_Range_Alignment_or_Adjustement_Incorrect: RteEventRef=OpEventGetEventStatus_GetEventStatus_Event_Radar_AutoAlignment_Range_Alignment_or_Adjustement_Incorrect
        OpEventGetEventStatus_GetEventStatus_EvtInfo_EMS_ECU_CCVS1_erratic_communication_Erractic: RteEventRef=OpEventGetEventStatus_GetEventStatus_EvtInfo_EMS_ECU_CCVS1_erratic_communication_Erractic
        OpEventGetEventStatus_GetEventStatus_Event_EMS_ECU_CCVS1_erratic_communication_Erractic: RteEventRef=OpEventGetEventStatus_GetEventStatus_Event_EMS_ECU_CCVS1_erratic_communication_Erractic
        OpEventGetEventStatus_GetEventStatus_EvtInfo_Radar_System_Battery_Low_Voltage_System_Voltage_Low: RteEventRef=OpEventGetEventStatus_GetEventStatus_EvtInfo_Radar_System_Battery_Low_Voltage_System_Voltage_Low
        OpEventGetEventStatus_GetEventStatus_Event_Radar_System_Battery_Low_Voltage_System_Voltage_Low: RteEventRef=OpEventGetEventStatus_GetEventStatus_Event_Radar_System_Battery_Low_Voltage_System_Voltage_Low
        OpEventGetEventStatus_GetEventStatus_EvtInfo_Radar_SMC_General_Checksum_Failure: RteEventRef=OpEventGetEventStatus_GetEventStatus_EvtInfo_Radar_SMC_General_Checksum_Failure
        OpEventGetEventStatus_GetEventStatus_Event_Radar_SMC_General_Checksum_Failure: RteEventRef=OpEventGetEventStatus_GetEventStatus_Event_Radar_SMC_General_Checksum_Failure
        OpEventGetEventStatus_GetEventStatus_EvtInfo_Radar_Pin_Position_Wrong_Mounting_Position: RteEventRef=OpEventGetEventStatus_GetEventStatus_EvtInfo_Radar_Pin_Position_Wrong_Mounting_Position
        OpEventGetEventStatus_GetEventStatus_Event_Radar_Pin_Position_Wrong_Mounting_Position: RteEventRef=OpEventGetEventStatus_GetEventStatus_Event_Radar_Pin_Position_Wrong_Mounting_Position
        OpEventGetEventStatus_GetEventStatus_EvtInfo_VDC2_message_Lateral_Accleration_Invalid_Serial_Data_Received: RteEventRef=OpEventGetEventStatus_GetEventStatus_EvtInfo_VDC2_message_Lateral_Accleration_Invalid_Serial_Data_Received
        OpEventGetEventStatus_GetEventStatus_Event_VDC2_message_Lateral_Accleration_Invalid_Serial_Data_Received: RteEventRef=OpEventGetEventStatus_GetEventStatus_Event_VDC2_message_Lateral_Accleration_Invalid_Serial_Data_Received
        OpEventGetEventStatus_GetEventStatus_EvtInfo_ADAS_FN_STS_message_BSIS_FN_Switch_STS_Invalid_Serial_Data_Received: RteEventRef=OpEventGetEventStatus_GetEventStatus_EvtInfo_ADAS_FN_STS_message_BSIS_FN_Switch_STS_Invalid_Serial_Data_Received
        OpEventGetEventStatus_GetEventStatus_Event_ADAS_FN_STS_message_BSIS_FN_Switch_STS_Invalid_Serial_Data_Received: RteEventRef=OpEventGetEventStatus_GetEventStatus_Event_ADAS_FN_STS_message_BSIS_FN_Switch_STS_Invalid_Serial_Data_Received
        OpEventGetEventStatus_GetEventStatus_EvtInfo_Radar_AutoAlignment_Misalignment_Performance_or_Incorrect_Operation: RteEventRef=OpEventGetEventStatus_GetEventStatus_EvtInfo_Radar_AutoAlignment_Misalignment_Performance_or_Incorrect_Operation
        OpEventGetEventStatus_GetEventStatus_Event_Radar_AutoAlignment_Misalignment_Performance_or_Incorrect_Operation: RteEventRef=OpEventGetEventStatus_GetEventStatus_Event_Radar_AutoAlignment_Misalignment_Performance_or_Incorrect_Operation
        OpEventGetEventStatus_GetEventStatus_EvtInfo_ESC_ECU_VDC2_erratic_communication_Erratic: RteEventRef=OpEventGetEventStatus_GetEventStatus_EvtInfo_ESC_ECU_VDC2_erratic_communication_Erratic
        OpEventGetEventStatus_GetEventStatus_Event_ESC_ECU_VDC2_erratic_communication_Erratic: RteEventRef=OpEventGetEventStatus_GetEventStatus_Event_ESC_ECU_VDC2_erratic_communication_Erratic
        OpEventGetEventStatus_GetEventStatus_EvtInfo_Application_Interface_Lookup_Performance_or_Incorrect_Operation: RteEventRef=OpEventGetEventStatus_GetEventStatus_EvtInfo_Application_Interface_Lookup_Performance_or_Incorrect_Operation
        OpEventGetEventStatus_GetEventStatus_Event_Application_Interface_Lookup_Performance_or_Incorrect_Operation: RteEventRef=OpEventGetEventStatus_GetEventStatus_Event_Application_Interface_Lookup_Performance_or_Incorrect_Operation
        OpEventGetEventStatus_GetEventStatus_EvtInfo_EMS_ECU_VD_message_Missing_Message: RteEventRef=OpEventGetEventStatus_GetEventStatus_EvtInfo_EMS_ECU_VD_message_Missing_Message
        OpEventGetEventStatus_GetEventStatus_Event_EMS_ECU_VD_message_Missing_Message: RteEventRef=OpEventGetEventStatus_GetEventStatus_Event_EMS_ECU_VD_message_Missing_Message
        OpEventGetEventStatus_GetEventStatus_EvtInfo_Radar_Platform_Time_System_Programming_Failure: RteEventRef=OpEventGetEventStatus_GetEventStatus_EvtInfo_Radar_Platform_Time_System_Programming_Failure
        OpEventGetEventStatus_GetEventStatus_Event_Radar_Platform_Time_System_Programming_Failure: RteEventRef=OpEventGetEventStatus_GetEventStatus_Event_Radar_Platform_Time_System_Programming_Failure
        OpEventGetEventStatus_GetEventStatus_EvtInfo_OEL_message_Turn_Signal_Switch_Invalid_Serial_Data_Received: RteEventRef=OpEventGetEventStatus_GetEventStatus_EvtInfo_OEL_message_Turn_Signal_Switch_Invalid_Serial_Data_Received
        OpEventGetEventStatus_GetEventStatus_Event_OEL_message_Turn_Signal_Switch_Invalid_Serial_Data_Received: RteEventRef=OpEventGetEventStatus_GetEventStatus_Event_OEL_message_Turn_Signal_Switch_Invalid_Serial_Data_Received
        OpEventGetEventStatus_GetEventStatus_EvtInfo_Radar_calibration_Calibration_or_Paramater_Memory_Failure: RteEventRef=OpEventGetEventStatus_GetEventStatus_EvtInfo_Radar_calibration_Calibration_or_Paramater_Memory_Failure
        OpEventGetEventStatus_GetEventStatus_Event_Radar_calibration_Calibration_or_Paramater_Memory_Failure: RteEventRef=OpEventGetEventStatus_GetEventStatus_Event_Radar_calibration_Calibration_or_Paramater_Memory_Failure
        OpEventGetEventStatus_GetEventStatus_GeneralEvtInfo: RteEventRef=OpEventGetEventStatus_GetEventStatus_GeneralEvtInfo
        OpEventGetEventFailed_GetEventFailed_EvtInfo_SAS_message_Steering_Wheel_Angle_Invalid_Serial_Data_Received: RteEventRef=OpEventGetEventFailed_GetEventFailed_EvtInfo_SAS_message_Steering_Wheel_Angle_Invalid_Serial_Data_Received
        OpEventGetEventFailed_GetEventFailed_Event_SAS_message_Steering_Wheel_Angle_Invalid_Serial_Data_Received: RteEventRef=OpEventGetEventFailed_GetEventFailed_Event_SAS_message_Steering_Wheel_Angle_Invalid_Serial_Data_Received
        OpEventGetEventFailed_GetEventFailed_EvtInfo_AT_AMT_ETC2_message_Transcurrent_gear_Invalid_Serial_Data_Received: RteEventRef=OpEventGetEventFailed_GetEventFailed_EvtInfo_AT_AMT_ETC2_message_Transcurrent_gear_Invalid_Serial_Data_Received
        OpEventGetEventFailed_GetEventFailed_Event_AT_AMT_ETC2_message_Transcurrent_gear_Invalid_Serial_Data_Received: RteEventRef=OpEventGetEventFailed_GetEventFailed_Event_AT_AMT_ETC2_message_Transcurrent_gear_Invalid_Serial_Data_Received
        OpEventGetEventFailed_GetEventFailed_EvtInfo_Radar_AutoAlignment_Algorithm_Signal_Calculation_Failure: RteEventRef=OpEventGetEventFailed_GetEventFailed_EvtInfo_Radar_AutoAlignment_Algorithm_Signal_Calculation_Failure
        OpEventGetEventFailed_GetEventFailed_Event_Radar_AutoAlignment_Algorithm_Signal_Calculation_Failure: RteEventRef=OpEventGetEventFailed_GetEventFailed_Event_Radar_AutoAlignment_Algorithm_Signal_Calculation_Failure
        OpEventGetEventFailed_GetEventFailed_EvtInfo_Vehicle_DataSet_Not_Configured: RteEventRef=OpEventGetEventFailed_GetEventFailed_EvtInfo_Vehicle_DataSet_Not_Configured
        OpEventGetEventFailed_GetEventFailed_Event_Vehicle_DataSet_Not_Configured: RteEventRef=OpEventGetEventFailed_GetEventFailed_Event_Vehicle_DataSet_Not_Configured
        OpEventGetEventFailed_GetEventFailed_EvtInfo_Radar_Module_System_Internal_Failure: RteEventRef=OpEventGetEventFailed_GetEventFailed_EvtInfo_Radar_Module_System_Internal_Failure
        OpEventGetEventFailed_GetEventFailed_Event_Radar_Module_System_Internal_Failure: RteEventRef=OpEventGetEventFailed_GetEventFailed_Event_Radar_Module_System_Internal_Failure
        OpEventGetEventFailed_GetEventFailed_EvtInfo_Radar_MMIC_Component_Failure: RteEventRef=OpEventGetEventFailed_GetEventFailed_EvtInfo_Radar_MMIC_Component_Failure
        OpEventGetEventFailed_GetEventFailed_Event_Radar_MMIC_Component_Failure: RteEventRef=OpEventGetEventFailed_GetEventFailed_Event_Radar_MMIC_Component_Failure
        OpEventGetEventFailed_GetEventFailed_EvtInfo_Radar_Module_General_Memory_Failure: RteEventRef=OpEventGetEventFailed_GetEventFailed_EvtInfo_Radar_Module_General_Memory_Failure
        OpEventGetEventFailed_GetEventFailed_Event_Radar_Module_General_Memory_Failure: RteEventRef=OpEventGetEventFailed_GetEventFailed_Event_Radar_Module_General_Memory_Failure
        OpEventGetEventFailed_GetEventFailed_EvtInfo_Radar_System_Battery_High_Voltage_System_Voltage_High: RteEventRef=OpEventGetEventFailed_GetEventFailed_EvtInfo_Radar_System_Battery_High_Voltage_System_Voltage_High
        OpEventGetEventFailed_GetEventFailed_Event_Radar_System_Battery_High_Voltage_System_Voltage_High: RteEventRef=OpEventGetEventFailed_GetEventFailed_Event_Radar_System_Battery_High_Voltage_System_Voltage_High
        OpEventGetEventFailed_GetEventFailed_EvtInfo_CCVS1_message_Vehicle_Speed_Invalid_Serial_Data_Received: RteEventRef=OpEventGetEventFailed_GetEventFailed_EvtInfo_CCVS1_message_Vehicle_Speed_Invalid_Serial_Data_Received
        OpEventGetEventFailed_GetEventFailed_Event_CCVS1_message_Vehicle_Speed_Invalid_Serial_Data_Received: RteEventRef=OpEventGetEventFailed_GetEventFailed_Event_CCVS1_message_Vehicle_Speed_Invalid_Serial_Data_Received
        OpEventGetEventFailed_GetEventFailed_EvtInfo_EMS_ECU_VD_erratic_communication_Erratic: RteEventRef=OpEventGetEventFailed_GetEventFailed_EvtInfo_EMS_ECU_VD_erratic_communication_Erratic
        OpEventGetEventFailed_GetEventFailed_Event_EMS_ECU_VD_erratic_communication_Erratic: RteEventRef=OpEventGetEventFailed_GetEventFailed_Event_EMS_ECU_VD_erratic_communication_Erratic
        OpEventGetEventFailed_GetEventFailed_EvtInfo_EMS_ECU_ETC2_00_message_Missing_Message: RteEventRef=OpEventGetEventFailed_GetEventFailed_EvtInfo_EMS_ECU_ETC2_00_message_Missing_Message
        OpEventGetEventFailed_GetEventFailed_Event_EMS_ECU_ETC2_00_message_Missing_Message: RteEventRef=OpEventGetEventFailed_GetEventFailed_Event_EMS_ECU_ETC2_00_message_Missing_Message
        OpEventGetEventFailed_GetEventFailed_EvtInfo_Cluster_ECU_CLS_Tx_16_message_Missing_Message: RteEventRef=OpEventGetEventFailed_GetEventFailed_EvtInfo_Cluster_ECU_CLS_Tx_16_message_Missing_Message
        OpEventGetEventFailed_GetEventFailed_Event_Cluster_ECU_CLS_Tx_16_message_Missing_Message: RteEventRef=OpEventGetEventFailed_GetEventFailed_Event_Cluster_ECU_CLS_Tx_16_message_Missing_Message
        OpEventGetEventFailed_GetEventFailed_EvtInfo_Exceeded_Security_Access_0x27_Attempt_Threshold_Authentication_Failure: RteEventRef=OpEventGetEventFailed_GetEventFailed_EvtInfo_Exceeded_Security_Access_0x27_Attempt_Threshold_Authentication_Failure
        OpEventGetEventFailed_GetEventFailed_Event_Exceeded_Security_Access_0x27_Attempt_Threshold_Authentication_Failure: RteEventRef=OpEventGetEventFailed_GetEventFailed_Event_Exceeded_Security_Access_0x27_Attempt_Threshold_Authentication_Failure
        OpEventGetEventFailed_GetEventFailed_EvtInfo_Front_Left_Side_Radar_value_of_signal_protection_calculation_Incorrect: RteEventRef=OpEventGetEventFailed_GetEventFailed_EvtInfo_Front_Left_Side_Radar_value_of_signal_protection_calculation_Incorrect
        OpEventGetEventFailed_GetEventFailed_Event_Front_Left_Side_Radar_value_of_signal_protection_calculation_Incorrect: RteEventRef=OpEventGetEventFailed_GetEventFailed_Event_Front_Left_Side_Radar_value_of_signal_protection_calculation_Incorrect
        OpEventGetEventFailed_GetEventFailed_EvtInfo_AT_AMT_ETC2_erratic_communication_Erratic: RteEventRef=OpEventGetEventFailed_GetEventFailed_EvtInfo_AT_AMT_ETC2_erratic_communication_Erratic
        OpEventGetEventFailed_GetEventFailed_Event_AT_AMT_ETC2_erratic_communication_Erratic: RteEventRef=OpEventGetEventFailed_GetEventFailed_Event_AT_AMT_ETC2_erratic_communication_Erratic
        OpEventGetEventFailed_GetEventFailed_EvtInfo_VCAN_Communication_Bus_Off: RteEventRef=OpEventGetEventFailed_GetEventFailed_EvtInfo_VCAN_Communication_Bus_Off
        OpEventGetEventFailed_GetEventFailed_Event_VCAN_Communication_Bus_Off: RteEventRef=OpEventGetEventFailed_GetEventFailed_Event_VCAN_Communication_Bus_Off
        OpEventGetEventFailed_GetEventFailed_EvtInfo_VDC2_message_LongitudinalAcceleration_Invalid_Serial_Data_Received: RteEventRef=OpEventGetEventFailed_GetEventFailed_EvtInfo_VDC2_message_LongitudinalAcceleration_Invalid_Serial_Data_Received
        OpEventGetEventFailed_GetEventFailed_Event_VDC2_message_LongitudinalAcceleration_Invalid_Serial_Data_Received: RteEventRef=OpEventGetEventFailed_GetEventFailed_Event_VDC2_message_LongitudinalAcceleration_Invalid_Serial_Data_Received
        OpEventGetEventFailed_GetEventFailed_EvtInfo_Radar_MMIC_RFBIST_Component_Internal_Failure: RteEventRef=OpEventGetEventFailed_GetEventFailed_EvtInfo_Radar_MMIC_RFBIST_Component_Internal_Failure
        OpEventGetEventFailed_GetEventFailed_Event_Radar_MMIC_RFBIST_Component_Internal_Failure: RteEventRef=OpEventGetEventFailed_GetEventFailed_Event_Radar_MMIC_RFBIST_Component_Internal_Failure
        OpEventGetEventFailed_GetEventFailed_EvtInfo_Radar_Initial_Alignment_Missing_Calibration: RteEventRef=OpEventGetEventFailed_GetEventFailed_EvtInfo_Radar_Initial_Alignment_Missing_Calibration
        OpEventGetEventFailed_GetEventFailed_Event_Radar_Initial_Alignment_Missing_Calibration: RteEventRef=OpEventGetEventFailed_GetEventFailed_Event_Radar_Initial_Alignment_Missing_Calibration
        OpEventGetEventFailed_GetEventFailed_EvtInfo_Cluster_ECU_OEL_message_Missing_Message: RteEventRef=OpEventGetEventFailed_GetEventFailed_EvtInfo_Cluster_ECU_OEL_message_Missing_Message
        OpEventGetEventFailed_GetEventFailed_Event_Cluster_ECU_OEL_message_Missing_Message: RteEventRef=OpEventGetEventFailed_GetEventFailed_Event_Cluster_ECU_OEL_message_Missing_Message
        OpEventGetEventFailed_GetEventFailed_EvtInfo_AT_AMT_ECU_ETC2_03_message_Missing_Message: RteEventRef=OpEventGetEventFailed_GetEventFailed_EvtInfo_AT_AMT_ECU_ETC2_03_message_Missing_Message
        OpEventGetEventFailed_GetEventFailed_Event_AT_AMT_ECU_ETC2_03_message_Missing_Message: RteEventRef=OpEventGetEventFailed_GetEventFailed_Event_AT_AMT_ECU_ETC2_03_message_Missing_Message
        OpEventGetEventFailed_GetEventFailed_EvtInfo_ADAS_FN_STS_message_MOIS_FN_Switch_STS_Invalid_Serial_Data_Received: RteEventRef=OpEventGetEventFailed_GetEventFailed_EvtInfo_ADAS_FN_STS_message_MOIS_FN_Switch_STS_Invalid_Serial_Data_Received
        OpEventGetEventFailed_GetEventFailed_Event_ADAS_FN_STS_message_MOIS_FN_Switch_STS_Invalid_Serial_Data_Received: RteEventRef=OpEventGetEventFailed_GetEventFailed_Event_ADAS_FN_STS_message_MOIS_FN_Switch_STS_Invalid_Serial_Data_Received
        OpEventGetEventFailed_GetEventFailed_EvtInfo_Radar_Module_Over_Temperature: RteEventRef=OpEventGetEventFailed_GetEventFailed_EvtInfo_Radar_Module_Over_Temperature
        OpEventGetEventFailed_GetEventFailed_Event_Radar_Module_Over_Temperature: RteEventRef=OpEventGetEventFailed_GetEventFailed_Event_Radar_Module_Over_Temperature
        OpEventGetEventFailed_GetEventFailed_EvtInfo_PCAN_TimeSync_Missing_Message: RteEventRef=OpEventGetEventFailed_GetEventFailed_EvtInfo_PCAN_TimeSync_Missing_Message
        OpEventGetEventFailed_GetEventFailed_Event_PCAN_TimeSync_Missing_Message: RteEventRef=OpEventGetEventFailed_GetEventFailed_Event_PCAN_TimeSync_Missing_Message
        OpEventGetEventFailed_GetEventFailed_EvtInfo_Radar_Module_Watchdog_Failure: RteEventRef=OpEventGetEventFailed_GetEventFailed_EvtInfo_Radar_Module_Watchdog_Failure
        OpEventGetEventFailed_GetEventFailed_Event_Radar_Module_Watchdog_Failure: RteEventRef=OpEventGetEventFailed_GetEventFailed_Event_Radar_Module_Watchdog_Failure
        OpEventGetEventFailed_GetEventFailed_EvtInfo_SAS_ECU_SAS_message_Missing_Message: RteEventRef=OpEventGetEventFailed_GetEventFailed_EvtInfo_SAS_ECU_SAS_message_Missing_Message
        OpEventGetEventFailed_GetEventFailed_Event_SAS_ECU_SAS_message_Missing_Message: RteEventRef=OpEventGetEventFailed_GetEventFailed_Event_SAS_ECU_SAS_message_Missing_Message
        OpEventGetEventFailed_GetEventFailed_EvtInfo_ECU_NVM_Corruption_Program_memory_Failure: RteEventRef=OpEventGetEventFailed_GetEventFailed_EvtInfo_ECU_NVM_Corruption_Program_memory_Failure
        OpEventGetEventFailed_GetEventFailed_Event_ECU_NVM_Corruption_Program_memory_Failure: RteEventRef=OpEventGetEventFailed_GetEventFailed_Event_ECU_NVM_Corruption_Program_memory_Failure
        OpEventGetEventFailed_GetEventFailed_EvtInfo_Cluster_ECU_TD_message_Missing_Message: RteEventRef=OpEventGetEventFailed_GetEventFailed_EvtInfo_Cluster_ECU_TD_message_Missing_Message
        OpEventGetEventFailed_GetEventFailed_Event_Cluster_ECU_TD_message_Missing_Message: RteEventRef=OpEventGetEventFailed_GetEventFailed_Event_Cluster_ECU_TD_message_Missing_Message
        OpEventGetEventFailed_GetEventFailed_EvtInfo_PCAN_Communication_Bus_Off: RteEventRef=OpEventGetEventFailed_GetEventFailed_EvtInfo_PCAN_Communication_Bus_Off
        OpEventGetEventFailed_GetEventFailed_Event_PCAN_Communication_Bus_Off: RteEventRef=OpEventGetEventFailed_GetEventFailed_Event_PCAN_Communication_Bus_Off
        OpEventGetEventFailed_GetEventFailed_EvtInfo_Front_Left_Side_Radar_Missing_Message: RteEventRef=OpEventGetEventFailed_GetEventFailed_EvtInfo_Front_Left_Side_Radar_Missing_Message
        OpEventGetEventFailed_GetEventFailed_Event_Front_Left_Side_Radar_Missing_Message: RteEventRef=OpEventGetEventFailed_GetEventFailed_Event_Front_Left_Side_Radar_Missing_Message
        OpEventGetEventFailed_GetEventFailed_EvtInfo_Manual_ETC2_message_Transcurrent_gear_Invalid_Serial_Data_Received: RteEventRef=OpEventGetEventFailed_GetEventFailed_EvtInfo_Manual_ETC2_message_Transcurrent_gear_Invalid_Serial_Data_Received
        OpEventGetEventFailed_GetEventFailed_Event_Manual_ETC2_message_Transcurrent_gear_Invalid_Serial_Data_Received: RteEventRef=OpEventGetEventFailed_GetEventFailed_Event_Manual_ETC2_message_Transcurrent_gear_Invalid_Serial_Data_Received
        OpEventGetEventFailed_GetEventFailed_EvtInfo_SAS_ECU_erratic_communication_Erratic: RteEventRef=OpEventGetEventFailed_GetEventFailed_EvtInfo_SAS_ECU_erratic_communication_Erratic
        OpEventGetEventFailed_GetEventFailed_Event_SAS_ECU_erratic_communication_Erratic: RteEventRef=OpEventGetEventFailed_GetEventFailed_Event_SAS_ECU_erratic_communication_Erratic
        OpEventGetEventFailed_GetEventFailed_EvtInfo_VDC2_message_Yaw_rate_Invalid_Serial_Data_Received: RteEventRef=OpEventGetEventFailed_GetEventFailed_EvtInfo_VDC2_message_Yaw_rate_Invalid_Serial_Data_Received
        OpEventGetEventFailed_GetEventFailed_Event_VDC2_message_Yaw_rate_Invalid_Serial_Data_Received: RteEventRef=OpEventGetEventFailed_GetEventFailed_Event_VDC2_message_Yaw_rate_Invalid_Serial_Data_Received
        OpEventGetEventFailed_GetEventFailed_EvtInfo_Cluster_ECU_TD_erratic_communication_Erratic: RteEventRef=OpEventGetEventFailed_GetEventFailed_EvtInfo_Cluster_ECU_TD_erratic_communication_Erratic
        OpEventGetEventFailed_GetEventFailed_Event_Cluster_ECU_TD_erratic_communication_Erratic: RteEventRef=OpEventGetEventFailed_GetEventFailed_Event_Cluster_ECU_TD_erratic_communication_Erratic
        OpEventGetEventFailed_GetEventFailed_EvtInfo_EMS_ECU_CCVS1_message_Missing_Message: RteEventRef=OpEventGetEventFailed_GetEventFailed_EvtInfo_EMS_ECU_CCVS1_message_Missing_Message
        OpEventGetEventFailed_GetEventFailed_Event_EMS_ECU_CCVS1_message_Missing_Message: RteEventRef=OpEventGetEventFailed_GetEventFailed_Event_EMS_ECU_CCVS1_message_Missing_Message
        OpEventGetEventFailed_GetEventFailed_EvtInfo_Radar_Mounting_Orientation_Incorrect_Assembly: RteEventRef=OpEventGetEventFailed_GetEventFailed_EvtInfo_Radar_Mounting_Orientation_Incorrect_Assembly
        OpEventGetEventFailed_GetEventFailed_Event_Radar_Mounting_Orientation_Incorrect_Assembly: RteEventRef=OpEventGetEventFailed_GetEventFailed_Event_Radar_Mounting_Orientation_Incorrect_Assembly
        OpEventGetEventFailed_GetEventFailed_EvtInfo_EMS_ECU_ETC2_erratic_communication_Erractic: RteEventRef=OpEventGetEventFailed_GetEventFailed_EvtInfo_EMS_ECU_ETC2_erratic_communication_Erractic
        OpEventGetEventFailed_GetEventFailed_Event_EMS_ECU_ETC2_erratic_communication_Erractic: RteEventRef=OpEventGetEventFailed_GetEventFailed_Event_EMS_ECU_ETC2_erratic_communication_Erractic
        OpEventGetEventFailed_GetEventFailed_EvtInfo_Cluster_ECU_ADAS_FN_STS_erratic_communication_Erratic: RteEventRef=OpEventGetEventFailed_GetEventFailed_EvtInfo_Cluster_ECU_ADAS_FN_STS_erratic_communication_Erratic
        OpEventGetEventFailed_GetEventFailed_Event_Cluster_ECU_ADAS_FN_STS_erratic_communication_Erratic: RteEventRef=OpEventGetEventFailed_GetEventFailed_Event_Cluster_ECU_ADAS_FN_STS_erratic_communication_Erratic
        OpEventGetEventFailed_GetEventFailed_EvtInfo_ESC_ECU_VDC2_message_Missing_Message: RteEventRef=OpEventGetEventFailed_GetEventFailed_EvtInfo_ESC_ECU_VDC2_message_Missing_Message
        OpEventGetEventFailed_GetEventFailed_Event_ESC_ECU_VDC2_message_Missing_Message: RteEventRef=OpEventGetEventFailed_GetEventFailed_Event_ESC_ECU_VDC2_message_Missing_Message
        OpEventGetEventFailed_GetEventFailed_EvtInfo_CLS_TX_16_message_Transmission_Type_info_Invalid_Serial_Data_Received: RteEventRef=OpEventGetEventFailed_GetEventFailed_EvtInfo_CLS_TX_16_message_Transmission_Type_info_Invalid_Serial_Data_Received
        OpEventGetEventFailed_GetEventFailed_Event_CLS_TX_16_message_Transmission_Type_info_Invalid_Serial_Data_Received: RteEventRef=OpEventGetEventFailed_GetEventFailed_Event_CLS_TX_16_message_Transmission_Type_info_Invalid_Serial_Data_Received
        OpEventGetEventFailed_GetEventFailed_EvtInfo_Cluster_ECU_CLS_Tx_4_erratic_communication_Erratic: RteEventRef=OpEventGetEventFailed_GetEventFailed_EvtInfo_Cluster_ECU_CLS_Tx_4_erratic_communication_Erratic
        OpEventGetEventFailed_GetEventFailed_Event_Cluster_ECU_CLS_Tx_4_erratic_communication_Erratic: RteEventRef=OpEventGetEventFailed_GetEventFailed_Event_Cluster_ECU_CLS_Tx_4_erratic_communication_Erratic
        OpEventGetEventFailed_GetEventFailed_EvtInfo_Cluster_ECU_ADAS_FN_STS_message_Missing_Message: RteEventRef=OpEventGetEventFailed_GetEventFailed_EvtInfo_Cluster_ECU_ADAS_FN_STS_message_Missing_Message
        OpEventGetEventFailed_GetEventFailed_Event_Cluster_ECU_ADAS_FN_STS_message_Missing_Message: RteEventRef=OpEventGetEventFailed_GetEventFailed_Event_Cluster_ECU_ADAS_FN_STS_message_Missing_Message
        OpEventGetEventFailed_GetEventFailed_EvtInfo_Vehicle_Dataset_value_of_signal_protection_calculation_Incorrect: RteEventRef=OpEventGetEventFailed_GetEventFailed_EvtInfo_Vehicle_Dataset_value_of_signal_protection_calculation_Incorrect
        OpEventGetEventFailed_GetEventFailed_Event_Vehicle_Dataset_value_of_signal_protection_calculation_Incorrect: RteEventRef=OpEventGetEventFailed_GetEventFailed_Event_Vehicle_Dataset_value_of_signal_protection_calculation_Incorrect
        OpEventGetEventFailed_GetEventFailed_EvtInfo_Cluster_ECU_CLS_Tx_16_erratic_communication_Erratic: RteEventRef=OpEventGetEventFailed_GetEventFailed_EvtInfo_Cluster_ECU_CLS_Tx_16_erratic_communication_Erratic
        OpEventGetEventFailed_GetEventFailed_Event_Cluster_ECU_CLS_Tx_16_erratic_communication_Erratic: RteEventRef=OpEventGetEventFailed_GetEventFailed_Event_Cluster_ECU_CLS_Tx_16_erratic_communication_Erratic
        OpEventGetEventFailed_GetEventFailed_EvtInfo_Cluster_ECU_OEL_erratic_communication_Erratic: RteEventRef=OpEventGetEventFailed_GetEventFailed_EvtInfo_Cluster_ECU_OEL_erratic_communication_Erratic
        OpEventGetEventFailed_GetEventFailed_Event_Cluster_ECU_OEL_erratic_communication_Erratic: RteEventRef=OpEventGetEventFailed_GetEventFailed_Event_Cluster_ECU_OEL_erratic_communication_Erratic
        OpEventGetEventFailed_GetEventFailed_EvtInfo_Cluster_ECU_CLS_Tx_4_message_Missing_Message: RteEventRef=OpEventGetEventFailed_GetEventFailed_EvtInfo_Cluster_ECU_CLS_Tx_4_message_Missing_Message
        OpEventGetEventFailed_GetEventFailed_Event_Cluster_ECU_CLS_Tx_4_message_Missing_Message: RteEventRef=OpEventGetEventFailed_GetEventFailed_Event_Cluster_ECU_CLS_Tx_4_message_Missing_Message
        OpEventGetEventFailed_GetEventFailed_EvtInfo_Radar_Performance_Capability_Algorithm_Based_Failure: RteEventRef=OpEventGetEventFailed_GetEventFailed_EvtInfo_Radar_Performance_Capability_Algorithm_Based_Failure
        OpEventGetEventFailed_GetEventFailed_Event_Radar_Performance_Capability_Algorithm_Based_Failure: RteEventRef=OpEventGetEventFailed_GetEventFailed_Event_Radar_Performance_Capability_Algorithm_Based_Failure
        OpEventGetEventFailed_GetEventFailed_EvtInfo_Radar_AutoAlignment_Range_Alignment_or_Adjustement_Incorrect: RteEventRef=OpEventGetEventFailed_GetEventFailed_EvtInfo_Radar_AutoAlignment_Range_Alignment_or_Adjustement_Incorrect
        OpEventGetEventFailed_GetEventFailed_Event_Radar_AutoAlignment_Range_Alignment_or_Adjustement_Incorrect: RteEventRef=OpEventGetEventFailed_GetEventFailed_Event_Radar_AutoAlignment_Range_Alignment_or_Adjustement_Incorrect
        OpEventGetEventFailed_GetEventFailed_EvtInfo_EMS_ECU_CCVS1_erratic_communication_Erractic: RteEventRef=OpEventGetEventFailed_GetEventFailed_EvtInfo_EMS_ECU_CCVS1_erratic_communication_Erractic
        OpEventGetEventFailed_GetEventFailed_Event_EMS_ECU_CCVS1_erratic_communication_Erractic: RteEventRef=OpEventGetEventFailed_GetEventFailed_Event_EMS_ECU_CCVS1_erratic_communication_Erractic
        OpEventGetEventFailed_GetEventFailed_EvtInfo_Radar_System_Battery_Low_Voltage_System_Voltage_Low: RteEventRef=OpEventGetEventFailed_GetEventFailed_EvtInfo_Radar_System_Battery_Low_Voltage_System_Voltage_Low
        OpEventGetEventFailed_GetEventFailed_Event_Radar_System_Battery_Low_Voltage_System_Voltage_Low: RteEventRef=OpEventGetEventFailed_GetEventFailed_Event_Radar_System_Battery_Low_Voltage_System_Voltage_Low
        OpEventGetEventFailed_GetEventFailed_EvtInfo_Radar_SMC_General_Checksum_Failure: RteEventRef=OpEventGetEventFailed_GetEventFailed_EvtInfo_Radar_SMC_General_Checksum_Failure
        OpEventGetEventFailed_GetEventFailed_Event_Radar_SMC_General_Checksum_Failure: RteEventRef=OpEventGetEventFailed_GetEventFailed_Event_Radar_SMC_General_Checksum_Failure
        OpEventGetEventFailed_GetEventFailed_EvtInfo_Radar_Pin_Position_Wrong_Mounting_Position: RteEventRef=OpEventGetEventFailed_GetEventFailed_EvtInfo_Radar_Pin_Position_Wrong_Mounting_Position
        OpEventGetEventFailed_GetEventFailed_Event_Radar_Pin_Position_Wrong_Mounting_Position: RteEventRef=OpEventGetEventFailed_GetEventFailed_Event_Radar_Pin_Position_Wrong_Mounting_Position
        OpEventGetEventFailed_GetEventFailed_EvtInfo_VDC2_message_Lateral_Accleration_Invalid_Serial_Data_Received: RteEventRef=OpEventGetEventFailed_GetEventFailed_EvtInfo_VDC2_message_Lateral_Accleration_Invalid_Serial_Data_Received
        OpEventGetEventFailed_GetEventFailed_Event_VDC2_message_Lateral_Accleration_Invalid_Serial_Data_Received: RteEventRef=OpEventGetEventFailed_GetEventFailed_Event_VDC2_message_Lateral_Accleration_Invalid_Serial_Data_Received
        OpEventGetEventFailed_GetEventFailed_EvtInfo_ADAS_FN_STS_message_BSIS_FN_Switch_STS_Invalid_Serial_Data_Received: RteEventRef=OpEventGetEventFailed_GetEventFailed_EvtInfo_ADAS_FN_STS_message_BSIS_FN_Switch_STS_Invalid_Serial_Data_Received
        OpEventGetEventFailed_GetEventFailed_Event_ADAS_FN_STS_message_BSIS_FN_Switch_STS_Invalid_Serial_Data_Received: RteEventRef=OpEventGetEventFailed_GetEventFailed_Event_ADAS_FN_STS_message_BSIS_FN_Switch_STS_Invalid_Serial_Data_Received
        OpEventGetEventFailed_GetEventFailed_EvtInfo_Radar_AutoAlignment_Misalignment_Performance_or_Incorrect_Operation: RteEventRef=OpEventGetEventFailed_GetEventFailed_EvtInfo_Radar_AutoAlignment_Misalignment_Performance_or_Incorrect_Operation
        OpEventGetEventFailed_GetEventFailed_Event_Radar_AutoAlignment_Misalignment_Performance_or_Incorrect_Operation: RteEventRef=OpEventGetEventFailed_GetEventFailed_Event_Radar_AutoAlignment_Misalignment_Performance_or_Incorrect_Operation
        OpEventGetEventFailed_GetEventFailed_EvtInfo_ESC_ECU_VDC2_erratic_communication_Erratic: RteEventRef=OpEventGetEventFailed_GetEventFailed_EvtInfo_ESC_ECU_VDC2_erratic_communication_Erratic
        OpEventGetEventFailed_GetEventFailed_Event_ESC_ECU_VDC2_erratic_communication_Erratic: RteEventRef=OpEventGetEventFailed_GetEventFailed_Event_ESC_ECU_VDC2_erratic_communication_Erratic
        OpEventGetEventFailed_GetEventFailed_EvtInfo_Application_Interface_Lookup_Performance_or_Incorrect_Operation: RteEventRef=OpEventGetEventFailed_GetEventFailed_EvtInfo_Application_Interface_Lookup_Performance_or_Incorrect_Operation
        OpEventGetEventFailed_GetEventFailed_Event_Application_Interface_Lookup_Performance_or_Incorrect_Operation: RteEventRef=OpEventGetEventFailed_GetEventFailed_Event_Application_Interface_Lookup_Performance_or_Incorrect_Operation
        OpEventGetEventFailed_GetEventFailed_EvtInfo_EMS_ECU_VD_message_Missing_Message: RteEventRef=OpEventGetEventFailed_GetEventFailed_EvtInfo_EMS_ECU_VD_message_Missing_Message
        OpEventGetEventFailed_GetEventFailed_Event_EMS_ECU_VD_message_Missing_Message: RteEventRef=OpEventGetEventFailed_GetEventFailed_Event_EMS_ECU_VD_message_Missing_Message
        OpEventGetEventFailed_GetEventFailed_EvtInfo_Radar_Platform_Time_System_Programming_Failure: RteEventRef=OpEventGetEventFailed_GetEventFailed_EvtInfo_Radar_Platform_Time_System_Programming_Failure
        OpEventGetEventFailed_GetEventFailed_Event_Radar_Platform_Time_System_Programming_Failure: RteEventRef=OpEventGetEventFailed_GetEventFailed_Event_Radar_Platform_Time_System_Programming_Failure
        OpEventGetEventFailed_GetEventFailed_EvtInfo_OEL_message_Turn_Signal_Switch_Invalid_Serial_Data_Received: RteEventRef=OpEventGetEventFailed_GetEventFailed_EvtInfo_OEL_message_Turn_Signal_Switch_Invalid_Serial_Data_Received
        OpEventGetEventFailed_GetEventFailed_Event_OEL_message_Turn_Signal_Switch_Invalid_Serial_Data_Received: RteEventRef=OpEventGetEventFailed_GetEventFailed_Event_OEL_message_Turn_Signal_Switch_Invalid_Serial_Data_Received
        OpEventGetEventFailed_GetEventFailed_EvtInfo_Radar_calibration_Calibration_or_Paramater_Memory_Failure: RteEventRef=OpEventGetEventFailed_GetEventFailed_EvtInfo_Radar_calibration_Calibration_or_Paramater_Memory_Failure
        OpEventGetEventFailed_GetEventFailed_Event_Radar_calibration_Calibration_or_Paramater_Memory_Failure: RteEventRef=OpEventGetEventFailed_GetEventFailed_Event_Radar_calibration_Calibration_or_Paramater_Memory_Failure
        OpEventGetEventFailed_GetEventFailed_GeneralEvtInfo: RteEventRef=OpEventGetEventFailed_GetEventFailed_GeneralEvtInfo
        OpEventGetEventTested_GetEventTested_EvtInfo_SAS_message_Steering_Wheel_Angle_Invalid_Serial_Data_Received: RteEventRef=OpEventGetEventTested_GetEventTested_EvtInfo_SAS_message_Steering_Wheel_Angle_Invalid_Serial_Data_Received
        OpEventGetEventTested_GetEventTested_Event_SAS_message_Steering_Wheel_Angle_Invalid_Serial_Data_Received: RteEventRef=OpEventGetEventTested_GetEventTested_Event_SAS_message_Steering_Wheel_Angle_Invalid_Serial_Data_Received
        OpEventGetEventTested_GetEventTested_EvtInfo_AT_AMT_ETC2_message_Transcurrent_gear_Invalid_Serial_Data_Received: RteEventRef=OpEventGetEventTested_GetEventTested_EvtInfo_AT_AMT_ETC2_message_Transcurrent_gear_Invalid_Serial_Data_Received
        OpEventGetEventTested_GetEventTested_Event_AT_AMT_ETC2_message_Transcurrent_gear_Invalid_Serial_Data_Received: RteEventRef=OpEventGetEventTested_GetEventTested_Event_AT_AMT_ETC2_message_Transcurrent_gear_Invalid_Serial_Data_Received
        OpEventGetEventTested_GetEventTested_EvtInfo_Radar_AutoAlignment_Algorithm_Signal_Calculation_Failure: RteEventRef=OpEventGetEventTested_GetEventTested_EvtInfo_Radar_AutoAlignment_Algorithm_Signal_Calculation_Failure
        OpEventGetEventTested_GetEventTested_Event_Radar_AutoAlignment_Algorithm_Signal_Calculation_Failure: RteEventRef=OpEventGetEventTested_GetEventTested_Event_Radar_AutoAlignment_Algorithm_Signal_Calculation_Failure
        OpEventGetEventTested_GetEventTested_EvtInfo_Vehicle_DataSet_Not_Configured: RteEventRef=OpEventGetEventTested_GetEventTested_EvtInfo_Vehicle_DataSet_Not_Configured
        OpEventGetEventTested_GetEventTested_Event_Vehicle_DataSet_Not_Configured: RteEventRef=OpEventGetEventTested_GetEventTested_Event_Vehicle_DataSet_Not_Configured
        OpEventGetEventTested_GetEventTested_EvtInfo_Radar_Module_System_Internal_Failure: RteEventRef=OpEventGetEventTested_GetEventTested_EvtInfo_Radar_Module_System_Internal_Failure
        OpEventGetEventTested_GetEventTested_Event_Radar_Module_System_Internal_Failure: RteEventRef=OpEventGetEventTested_GetEventTested_Event_Radar_Module_System_Internal_Failure
        OpEventGetEventTested_GetEventTested_EvtInfo_Radar_MMIC_Component_Failure: RteEventRef=OpEventGetEventTested_GetEventTested_EvtInfo_Radar_MMIC_Component_Failure
        OpEventGetEventTested_GetEventTested_Event_Radar_MMIC_Component_Failure: RteEventRef=OpEventGetEventTested_GetEventTested_Event_Radar_MMIC_Component_Failure
        OpEventGetEventTested_GetEventTested_EvtInfo_Radar_Module_General_Memory_Failure: RteEventRef=OpEventGetEventTested_GetEventTested_EvtInfo_Radar_Module_General_Memory_Failure
        OpEventGetEventTested_GetEventTested_Event_Radar_Module_General_Memory_Failure: RteEventRef=OpEventGetEventTested_GetEventTested_Event_Radar_Module_General_Memory_Failure
        OpEventGetEventTested_GetEventTested_EvtInfo_Radar_System_Battery_High_Voltage_System_Voltage_High: RteEventRef=OpEventGetEventTested_GetEventTested_EvtInfo_Radar_System_Battery_High_Voltage_System_Voltage_High
        OpEventGetEventTested_GetEventTested_Event_Radar_System_Battery_High_Voltage_System_Voltage_High: RteEventRef=OpEventGetEventTested_GetEventTested_Event_Radar_System_Battery_High_Voltage_System_Voltage_High
        OpEventGetEventTested_GetEventTested_EvtInfo_CCVS1_message_Vehicle_Speed_Invalid_Serial_Data_Received: RteEventRef=OpEventGetEventTested_GetEventTested_EvtInfo_CCVS1_message_Vehicle_Speed_Invalid_Serial_Data_Received
        OpEventGetEventTested_GetEventTested_Event_CCVS1_message_Vehicle_Speed_Invalid_Serial_Data_Received: RteEventRef=OpEventGetEventTested_GetEventTested_Event_CCVS1_message_Vehicle_Speed_Invalid_Serial_Data_Received
        OpEventGetEventTested_GetEventTested_EvtInfo_EMS_ECU_VD_erratic_communication_Erratic: RteEventRef=OpEventGetEventTested_GetEventTested_EvtInfo_EMS_ECU_VD_erratic_communication_Erratic
        OpEventGetEventTested_GetEventTested_Event_EMS_ECU_VD_erratic_communication_Erratic: RteEventRef=OpEventGetEventTested_GetEventTested_Event_EMS_ECU_VD_erratic_communication_Erratic
        OpEventGetEventTested_GetEventTested_EvtInfo_EMS_ECU_ETC2_00_message_Missing_Message: RteEventRef=OpEventGetEventTested_GetEventTested_EvtInfo_EMS_ECU_ETC2_00_message_Missing_Message
        OpEventGetEventTested_GetEventTested_Event_EMS_ECU_ETC2_00_message_Missing_Message: RteEventRef=OpEventGetEventTested_GetEventTested_Event_EMS_ECU_ETC2_00_message_Missing_Message
        OpEventGetEventTested_GetEventTested_EvtInfo_Cluster_ECU_CLS_Tx_16_message_Missing_Message: RteEventRef=OpEventGetEventTested_GetEventTested_EvtInfo_Cluster_ECU_CLS_Tx_16_message_Missing_Message
        OpEventGetEventTested_GetEventTested_Event_Cluster_ECU_CLS_Tx_16_message_Missing_Message: RteEventRef=OpEventGetEventTested_GetEventTested_Event_Cluster_ECU_CLS_Tx_16_message_Missing_Message
        OpEventGetEventTested_GetEventTested_EvtInfo_Exceeded_Security_Access_0x27_Attempt_Threshold_Authentication_Failure: RteEventRef=OpEventGetEventTested_GetEventTested_EvtInfo_Exceeded_Security_Access_0x27_Attempt_Threshold_Authentication_Failure
        OpEventGetEventTested_GetEventTested_Event_Exceeded_Security_Access_0x27_Attempt_Threshold_Authentication_Failure: RteEventRef=OpEventGetEventTested_GetEventTested_Event_Exceeded_Security_Access_0x27_Attempt_Threshold_Authentication_Failure
        OpEventGetEventTested_GetEventTested_EvtInfo_Front_Left_Side_Radar_value_of_signal_protection_calculation_Incorrect: RteEventRef=OpEventGetEventTested_GetEventTested_EvtInfo_Front_Left_Side_Radar_value_of_signal_protection_calculation_Incorrect
        OpEventGetEventTested_GetEventTested_Event_Front_Left_Side_Radar_value_of_signal_protection_calculation_Incorrect: RteEventRef=OpEventGetEventTested_GetEventTested_Event_Front_Left_Side_Radar_value_of_signal_protection_calculation_Incorrect
        OpEventGetEventTested_GetEventTested_EvtInfo_AT_AMT_ETC2_erratic_communication_Erratic: RteEventRef=OpEventGetEventTested_GetEventTested_EvtInfo_AT_AMT_ETC2_erratic_communication_Erratic
        OpEventGetEventTested_GetEventTested_Event_AT_AMT_ETC2_erratic_communication_Erratic: RteEventRef=OpEventGetEventTested_GetEventTested_Event_AT_AMT_ETC2_erratic_communication_Erratic
        OpEventGetEventTested_GetEventTested_EvtInfo_VCAN_Communication_Bus_Off: RteEventRef=OpEventGetEventTested_GetEventTested_EvtInfo_VCAN_Communication_Bus_Off
        OpEventGetEventTested_GetEventTested_Event_VCAN_Communication_Bus_Off: RteEventRef=OpEventGetEventTested_GetEventTested_Event_VCAN_Communication_Bus_Off
        OpEventGetEventTested_GetEventTested_EvtInfo_VDC2_message_LongitudinalAcceleration_Invalid_Serial_Data_Received: RteEventRef=OpEventGetEventTested_GetEventTested_EvtInfo_VDC2_message_LongitudinalAcceleration_Invalid_Serial_Data_Received
        OpEventGetEventTested_GetEventTested_Event_VDC2_message_LongitudinalAcceleration_Invalid_Serial_Data_Received: RteEventRef=OpEventGetEventTested_GetEventTested_Event_VDC2_message_LongitudinalAcceleration_Invalid_Serial_Data_Received
        OpEventGetEventTested_GetEventTested_EvtInfo_Radar_MMIC_RFBIST_Component_Internal_Failure: RteEventRef=OpEventGetEventTested_GetEventTested_EvtInfo_Radar_MMIC_RFBIST_Component_Internal_Failure
        OpEventGetEventTested_GetEventTested_Event_Radar_MMIC_RFBIST_Component_Internal_Failure: RteEventRef=OpEventGetEventTested_GetEventTested_Event_Radar_MMIC_RFBIST_Component_Internal_Failure
        OpEventGetEventTested_GetEventTested_EvtInfo_Radar_Initial_Alignment_Missing_Calibration: RteEventRef=OpEventGetEventTested_GetEventTested_EvtInfo_Radar_Initial_Alignment_Missing_Calibration
        OpEventGetEventTested_GetEventTested_Event_Radar_Initial_Alignment_Missing_Calibration: RteEventRef=OpEventGetEventTested_GetEventTested_Event_Radar_Initial_Alignment_Missing_Calibration
        OpEventGetEventTested_GetEventTested_EvtInfo_Cluster_ECU_OEL_message_Missing_Message: RteEventRef=OpEventGetEventTested_GetEventTested_EvtInfo_Cluster_ECU_OEL_message_Missing_Message
        OpEventGetEventTested_GetEventTested_Event_Cluster_ECU_OEL_message_Missing_Message: RteEventRef=OpEventGetEventTested_GetEventTested_Event_Cluster_ECU_OEL_message_Missing_Message
        OpEventGetEventTested_GetEventTested_EvtInfo_AT_AMT_ECU_ETC2_03_message_Missing_Message: RteEventRef=OpEventGetEventTested_GetEventTested_EvtInfo_AT_AMT_ECU_ETC2_03_message_Missing_Message
        OpEventGetEventTested_GetEventTested_Event_AT_AMT_ECU_ETC2_03_message_Missing_Message: RteEventRef=OpEventGetEventTested_GetEventTested_Event_AT_AMT_ECU_ETC2_03_message_Missing_Message
        OpEventGetEventTested_GetEventTested_EvtInfo_ADAS_FN_STS_message_MOIS_FN_Switch_STS_Invalid_Serial_Data_Received: RteEventRef=OpEventGetEventTested_GetEventTested_EvtInfo_ADAS_FN_STS_message_MOIS_FN_Switch_STS_Invalid_Serial_Data_Received
        OpEventGetEventTested_GetEventTested_Event_ADAS_FN_STS_message_MOIS_FN_Switch_STS_Invalid_Serial_Data_Received: RteEventRef=OpEventGetEventTested_GetEventTested_Event_ADAS_FN_STS_message_MOIS_FN_Switch_STS_Invalid_Serial_Data_Received
        OpEventGetEventTested_GetEventTested_EvtInfo_Radar_Module_Over_Temperature: RteEventRef=OpEventGetEventTested_GetEventTested_EvtInfo_Radar_Module_Over_Temperature
        OpEventGetEventTested_GetEventTested_Event_Radar_Module_Over_Temperature: RteEventRef=OpEventGetEventTested_GetEventTested_Event_Radar_Module_Over_Temperature
        OpEventGetEventTested_GetEventTested_EvtInfo_PCAN_TimeSync_Missing_Message: RteEventRef=OpEventGetEventTested_GetEventTested_EvtInfo_PCAN_TimeSync_Missing_Message
        OpEventGetEventTested_GetEventTested_Event_PCAN_TimeSync_Missing_Message: RteEventRef=OpEventGetEventTested_GetEventTested_Event_PCAN_TimeSync_Missing_Message
        OpEventGetEventTested_GetEventTested_EvtInfo_Radar_Module_Watchdog_Failure: RteEventRef=OpEventGetEventTested_GetEventTested_EvtInfo_Radar_Module_Watchdog_Failure
        OpEventGetEventTested_GetEventTested_Event_Radar_Module_Watchdog_Failure: RteEventRef=OpEventGetEventTested_GetEventTested_Event_Radar_Module_Watchdog_Failure
        OpEventGetEventTested_GetEventTested_EvtInfo_SAS_ECU_SAS_message_Missing_Message: RteEventRef=OpEventGetEventTested_GetEventTested_EvtInfo_SAS_ECU_SAS_message_Missing_Message
        OpEventGetEventTested_GetEventTested_Event_SAS_ECU_SAS_message_Missing_Message: RteEventRef=OpEventGetEventTested_GetEventTested_Event_SAS_ECU_SAS_message_Missing_Message
        OpEventGetEventTested_GetEventTested_EvtInfo_ECU_NVM_Corruption_Program_memory_Failure: RteEventRef=OpEventGetEventTested_GetEventTested_EvtInfo_ECU_NVM_Corruption_Program_memory_Failure
        OpEventGetEventTested_GetEventTested_Event_ECU_NVM_Corruption_Program_memory_Failure: RteEventRef=OpEventGetEventTested_GetEventTested_Event_ECU_NVM_Corruption_Program_memory_Failure
        OpEventGetEventTested_GetEventTested_EvtInfo_Cluster_ECU_TD_message_Missing_Message: RteEventRef=OpEventGetEventTested_GetEventTested_EvtInfo_Cluster_ECU_TD_message_Missing_Message
        OpEventGetEventTested_GetEventTested_Event_Cluster_ECU_TD_message_Missing_Message: RteEventRef=OpEventGetEventTested_GetEventTested_Event_Cluster_ECU_TD_message_Missing_Message
        OpEventGetEventTested_GetEventTested_EvtInfo_PCAN_Communication_Bus_Off: RteEventRef=OpEventGetEventTested_GetEventTested_EvtInfo_PCAN_Communication_Bus_Off
        OpEventGetEventTested_GetEventTested_Event_PCAN_Communication_Bus_Off: RteEventRef=OpEventGetEventTested_GetEventTested_Event_PCAN_Communication_Bus_Off
        OpEventGetEventTested_GetEventTested_EvtInfo_Front_Left_Side_Radar_Missing_Message: RteEventRef=OpEventGetEventTested_GetEventTested_EvtInfo_Front_Left_Side_Radar_Missing_Message
        OpEventGetEventTested_GetEventTested_Event_Front_Left_Side_Radar_Missing_Message: RteEventRef=OpEventGetEventTested_GetEventTested_Event_Front_Left_Side_Radar_Missing_Message
        OpEventGetEventTested_GetEventTested_EvtInfo_Manual_ETC2_message_Transcurrent_gear_Invalid_Serial_Data_Received: RteEventRef=OpEventGetEventTested_GetEventTested_EvtInfo_Manual_ETC2_message_Transcurrent_gear_Invalid_Serial_Data_Received
        OpEventGetEventTested_GetEventTested_Event_Manual_ETC2_message_Transcurrent_gear_Invalid_Serial_Data_Received: RteEventRef=OpEventGetEventTested_GetEventTested_Event_Manual_ETC2_message_Transcurrent_gear_Invalid_Serial_Data_Received
        OpEventGetEventTested_GetEventTested_EvtInfo_SAS_ECU_erratic_communication_Erratic: RteEventRef=OpEventGetEventTested_GetEventTested_EvtInfo_SAS_ECU_erratic_communication_Erratic
        OpEventGetEventTested_GetEventTested_Event_SAS_ECU_erratic_communication_Erratic: RteEventRef=OpEventGetEventTested_GetEventTested_Event_SAS_ECU_erratic_communication_Erratic
        OpEventGetEventTested_GetEventTested_EvtInfo_VDC2_message_Yaw_rate_Invalid_Serial_Data_Received: RteEventRef=OpEventGetEventTested_GetEventTested_EvtInfo_VDC2_message_Yaw_rate_Invalid_Serial_Data_Received
        OpEventGetEventTested_GetEventTested_Event_VDC2_message_Yaw_rate_Invalid_Serial_Data_Received: RteEventRef=OpEventGetEventTested_GetEventTested_Event_VDC2_message_Yaw_rate_Invalid_Serial_Data_Received
        OpEventGetEventTested_GetEventTested_EvtInfo_Cluster_ECU_TD_erratic_communication_Erratic: RteEventRef=OpEventGetEventTested_GetEventTested_EvtInfo_Cluster_ECU_TD_erratic_communication_Erratic
        OpEventGetEventTested_GetEventTested_Event_Cluster_ECU_TD_erratic_communication_Erratic: RteEventRef=OpEventGetEventTested_GetEventTested_Event_Cluster_ECU_TD_erratic_communication_Erratic
        OpEventGetEventTested_GetEventTested_EvtInfo_EMS_ECU_CCVS1_message_Missing_Message: RteEventRef=OpEventGetEventTested_GetEventTested_EvtInfo_EMS_ECU_CCVS1_message_Missing_Message
        OpEventGetEventTested_GetEventTested_Event_EMS_ECU_CCVS1_message_Missing_Message: RteEventRef=OpEventGetEventTested_GetEventTested_Event_EMS_ECU_CCVS1_message_Missing_Message
        OpEventGetEventTested_GetEventTested_EvtInfo_Radar_Mounting_Orientation_Incorrect_Assembly: RteEventRef=OpEventGetEventTested_GetEventTested_EvtInfo_Radar_Mounting_Orientation_Incorrect_Assembly
        OpEventGetEventTested_GetEventTested_Event_Radar_Mounting_Orientation_Incorrect_Assembly: RteEventRef=OpEventGetEventTested_GetEventTested_Event_Radar_Mounting_Orientation_Incorrect_Assembly
        OpEventGetEventTested_GetEventTested_EvtInfo_EMS_ECU_ETC2_erratic_communication_Erractic: RteEventRef=OpEventGetEventTested_GetEventTested_EvtInfo_EMS_ECU_ETC2_erratic_communication_Erractic
        OpEventGetEventTested_GetEventTested_Event_EMS_ECU_ETC2_erratic_communication_Erractic: RteEventRef=OpEventGetEventTested_GetEventTested_Event_EMS_ECU_ETC2_erratic_communication_Erractic
        OpEventGetEventTested_GetEventTested_EvtInfo_Cluster_ECU_ADAS_FN_STS_erratic_communication_Erratic: RteEventRef=OpEventGetEventTested_GetEventTested_EvtInfo_Cluster_ECU_ADAS_FN_STS_erratic_communication_Erratic
        OpEventGetEventTested_GetEventTested_Event_Cluster_ECU_ADAS_FN_STS_erratic_communication_Erratic: RteEventRef=OpEventGetEventTested_GetEventTested_Event_Cluster_ECU_ADAS_FN_STS_erratic_communication_Erratic
        OpEventGetEventTested_GetEventTested_EvtInfo_ESC_ECU_VDC2_message_Missing_Message: RteEventRef=OpEventGetEventTested_GetEventTested_EvtInfo_ESC_ECU_VDC2_message_Missing_Message
        OpEventGetEventTested_GetEventTested_Event_ESC_ECU_VDC2_message_Missing_Message: RteEventRef=OpEventGetEventTested_GetEventTested_Event_ESC_ECU_VDC2_message_Missing_Message
        OpEventGetEventTested_GetEventTested_EvtInfo_CLS_TX_16_message_Transmission_Type_info_Invalid_Serial_Data_Received: RteEventRef=OpEventGetEventTested_GetEventTested_EvtInfo_CLS_TX_16_message_Transmission_Type_info_Invalid_Serial_Data_Received
        OpEventGetEventTested_GetEventTested_Event_CLS_TX_16_message_Transmission_Type_info_Invalid_Serial_Data_Received: RteEventRef=OpEventGetEventTested_GetEventTested_Event_CLS_TX_16_message_Transmission_Type_info_Invalid_Serial_Data_Received
        OpEventGetEventTested_GetEventTested_EvtInfo_Cluster_ECU_CLS_Tx_4_erratic_communication_Erratic: RteEventRef=OpEventGetEventTested_GetEventTested_EvtInfo_Cluster_ECU_CLS_Tx_4_erratic_communication_Erratic
        OpEventGetEventTested_GetEventTested_Event_Cluster_ECU_CLS_Tx_4_erratic_communication_Erratic: RteEventRef=OpEventGetEventTested_GetEventTested_Event_Cluster_ECU_CLS_Tx_4_erratic_communication_Erratic
        OpEventGetEventTested_GetEventTested_EvtInfo_Cluster_ECU_ADAS_FN_STS_message_Missing_Message: RteEventRef=OpEventGetEventTested_GetEventTested_EvtInfo_Cluster_ECU_ADAS_FN_STS_message_Missing_Message
        OpEventGetEventTested_GetEventTested_Event_Cluster_ECU_ADAS_FN_STS_message_Missing_Message: RteEventRef=OpEventGetEventTested_GetEventTested_Event_Cluster_ECU_ADAS_FN_STS_message_Missing_Message
        OpEventGetEventTested_GetEventTested_EvtInfo_Vehicle_Dataset_value_of_signal_protection_calculation_Incorrect: RteEventRef=OpEventGetEventTested_GetEventTested_EvtInfo_Vehicle_Dataset_value_of_signal_protection_calculation_Incorrect
        OpEventGetEventTested_GetEventTested_Event_Vehicle_Dataset_value_of_signal_protection_calculation_Incorrect: RteEventRef=OpEventGetEventTested_GetEventTested_Event_Vehicle_Dataset_value_of_signal_protection_calculation_Incorrect
        OpEventGetEventTested_GetEventTested_EvtInfo_Cluster_ECU_CLS_Tx_16_erratic_communication_Erratic: RteEventRef=OpEventGetEventTested_GetEventTested_EvtInfo_Cluster_ECU_CLS_Tx_16_erratic_communication_Erratic
        OpEventGetEventTested_GetEventTested_Event_Cluster_ECU_CLS_Tx_16_erratic_communication_Erratic: RteEventRef=OpEventGetEventTested_GetEventTested_Event_Cluster_ECU_CLS_Tx_16_erratic_communication_Erratic
        OpEventGetEventTested_GetEventTested_EvtInfo_Cluster_ECU_OEL_erratic_communication_Erratic: RteEventRef=OpEventGetEventTested_GetEventTested_EvtInfo_Cluster_ECU_OEL_erratic_communication_Erratic
        OpEventGetEventTested_GetEventTested_Event_Cluster_ECU_OEL_erratic_communication_Erratic: RteEventRef=OpEventGetEventTested_GetEventTested_Event_Cluster_ECU_OEL_erratic_communication_Erratic
        OpEventGetEventTested_GetEventTested_EvtInfo_Cluster_ECU_CLS_Tx_4_message_Missing_Message: RteEventRef=OpEventGetEventTested_GetEventTested_EvtInfo_Cluster_ECU_CLS_Tx_4_message_Missing_Message
        OpEventGetEventTested_GetEventTested_Event_Cluster_ECU_CLS_Tx_4_message_Missing_Message: RteEventRef=OpEventGetEventTested_GetEventTested_Event_Cluster_ECU_CLS_Tx_4_message_Missing_Message
        OpEventGetEventTested_GetEventTested_EvtInfo_Radar_Performance_Capability_Algorithm_Based_Failure: RteEventRef=OpEventGetEventTested_GetEventTested_EvtInfo_Radar_Performance_Capability_Algorithm_Based_Failure
        OpEventGetEventTested_GetEventTested_Event_Radar_Performance_Capability_Algorithm_Based_Failure: RteEventRef=OpEventGetEventTested_GetEventTested_Event_Radar_Performance_Capability_Algorithm_Based_Failure
        OpEventGetEventTested_GetEventTested_EvtInfo_Radar_AutoAlignment_Range_Alignment_or_Adjustement_Incorrect: RteEventRef=OpEventGetEventTested_GetEventTested_EvtInfo_Radar_AutoAlignment_Range_Alignment_or_Adjustement_Incorrect
        OpEventGetEventTested_GetEventTested_Event_Radar_AutoAlignment_Range_Alignment_or_Adjustement_Incorrect: RteEventRef=OpEventGetEventTested_GetEventTested_Event_Radar_AutoAlignment_Range_Alignment_or_Adjustement_Incorrect
        OpEventGetEventTested_GetEventTested_EvtInfo_EMS_ECU_CCVS1_erratic_communication_Erractic: RteEventRef=OpEventGetEventTested_GetEventTested_EvtInfo_EMS_ECU_CCVS1_erratic_communication_Erractic
        OpEventGetEventTested_GetEventTested_Event_EMS_ECU_CCVS1_erratic_communication_Erractic: RteEventRef=OpEventGetEventTested_GetEventTested_Event_EMS_ECU_CCVS1_erratic_communication_Erractic
        OpEventGetEventTested_GetEventTested_EvtInfo_Radar_System_Battery_Low_Voltage_System_Voltage_Low: RteEventRef=OpEventGetEventTested_GetEventTested_EvtInfo_Radar_System_Battery_Low_Voltage_System_Voltage_Low
        OpEventGetEventTested_GetEventTested_Event_Radar_System_Battery_Low_Voltage_System_Voltage_Low: RteEventRef=OpEventGetEventTested_GetEventTested_Event_Radar_System_Battery_Low_Voltage_System_Voltage_Low
        OpEventGetEventTested_GetEventTested_EvtInfo_Radar_SMC_General_Checksum_Failure: RteEventRef=OpEventGetEventTested_GetEventTested_EvtInfo_Radar_SMC_General_Checksum_Failure
        OpEventGetEventTested_GetEventTested_Event_Radar_SMC_General_Checksum_Failure: RteEventRef=OpEventGetEventTested_GetEventTested_Event_Radar_SMC_General_Checksum_Failure
        OpEventGetEventTested_GetEventTested_EvtInfo_Radar_Pin_Position_Wrong_Mounting_Position: RteEventRef=OpEventGetEventTested_GetEventTested_EvtInfo_Radar_Pin_Position_Wrong_Mounting_Position
        OpEventGetEventTested_GetEventTested_Event_Radar_Pin_Position_Wrong_Mounting_Position: RteEventRef=OpEventGetEventTested_GetEventTested_Event_Radar_Pin_Position_Wrong_Mounting_Position
        OpEventGetEventTested_GetEventTested_EvtInfo_VDC2_message_Lateral_Accleration_Invalid_Serial_Data_Received: RteEventRef=OpEventGetEventTested_GetEventTested_EvtInfo_VDC2_message_Lateral_Accleration_Invalid_Serial_Data_Received
        OpEventGetEventTested_GetEventTested_Event_VDC2_message_Lateral_Accleration_Invalid_Serial_Data_Received: RteEventRef=OpEventGetEventTested_GetEventTested_Event_VDC2_message_Lateral_Accleration_Invalid_Serial_Data_Received
        OpEventGetEventTested_GetEventTested_EvtInfo_ADAS_FN_STS_message_BSIS_FN_Switch_STS_Invalid_Serial_Data_Received: RteEventRef=OpEventGetEventTested_GetEventTested_EvtInfo_ADAS_FN_STS_message_BSIS_FN_Switch_STS_Invalid_Serial_Data_Received
        OpEventGetEventTested_GetEventTested_Event_ADAS_FN_STS_message_BSIS_FN_Switch_STS_Invalid_Serial_Data_Received: RteEventRef=OpEventGetEventTested_GetEventTested_Event_ADAS_FN_STS_message_BSIS_FN_Switch_STS_Invalid_Serial_Data_Received
        OpEventGetEventTested_GetEventTested_EvtInfo_Radar_AutoAlignment_Misalignment_Performance_or_Incorrect_Operation: RteEventRef=OpEventGetEventTested_GetEventTested_EvtInfo_Radar_AutoAlignment_Misalignment_Performance_or_Incorrect_Operation
        OpEventGetEventTested_GetEventTested_Event_Radar_AutoAlignment_Misalignment_Performance_or_Incorrect_Operation: RteEventRef=OpEventGetEventTested_GetEventTested_Event_Radar_AutoAlignment_Misalignment_Performance_or_Incorrect_Operation
        OpEventGetEventTested_GetEventTested_EvtInfo_ESC_ECU_VDC2_erratic_communication_Erratic: RteEventRef=OpEventGetEventTested_GetEventTested_EvtInfo_ESC_ECU_VDC2_erratic_communication_Erratic
        OpEventGetEventTested_GetEventTested_Event_ESC_ECU_VDC2_erratic_communication_Erratic: RteEventRef=OpEventGetEventTested_GetEventTested_Event_ESC_ECU_VDC2_erratic_communication_Erratic
        OpEventGetEventTested_GetEventTested_EvtInfo_Application_Interface_Lookup_Performance_or_Incorrect_Operation: RteEventRef=OpEventGetEventTested_GetEventTested_EvtInfo_Application_Interface_Lookup_Performance_or_Incorrect_Operation
        OpEventGetEventTested_GetEventTested_Event_Application_Interface_Lookup_Performance_or_Incorrect_Operation: RteEventRef=OpEventGetEventTested_GetEventTested_Event_Application_Interface_Lookup_Performance_or_Incorrect_Operation
        OpEventGetEventTested_GetEventTested_EvtInfo_EMS_ECU_VD_message_Missing_Message: RteEventRef=OpEventGetEventTested_GetEventTested_EvtInfo_EMS_ECU_VD_message_Missing_Message
        OpEventGetEventTested_GetEventTested_Event_EMS_ECU_VD_message_Missing_Message: RteEventRef=OpEventGetEventTested_GetEventTested_Event_EMS_ECU_VD_message_Missing_Message
        OpEventGetEventTested_GetEventTested_EvtInfo_Radar_Platform_Time_System_Programming_Failure: RteEventRef=OpEventGetEventTested_GetEventTested_EvtInfo_Radar_Platform_Time_System_Programming_Failure
        OpEventGetEventTested_GetEventTested_Event_Radar_Platform_Time_System_Programming_Failure: RteEventRef=OpEventGetEventTested_GetEventTested_Event_Radar_Platform_Time_System_Programming_Failure
        OpEventGetEventTested_GetEventTested_EvtInfo_OEL_message_Turn_Signal_Switch_Invalid_Serial_Data_Received: RteEventRef=OpEventGetEventTested_GetEventTested_EvtInfo_OEL_message_Turn_Signal_Switch_Invalid_Serial_Data_Received
        OpEventGetEventTested_GetEventTested_Event_OEL_message_Turn_Signal_Switch_Invalid_Serial_Data_Received: RteEventRef=OpEventGetEventTested_GetEventTested_Event_OEL_message_Turn_Signal_Switch_Invalid_Serial_Data_Received
        OpEventGetEventTested_GetEventTested_EvtInfo_Radar_calibration_Calibration_or_Paramater_Memory_Failure: RteEventRef=OpEventGetEventTested_GetEventTested_EvtInfo_Radar_calibration_Calibration_or_Paramater_Memory_Failure
        OpEventGetEventTested_GetEventTested_Event_Radar_calibration_Calibration_or_Paramater_Memory_Failure: RteEventRef=OpEventGetEventTested_GetEventTested_Event_Radar_calibration_Calibration_or_Paramater_Memory_Failure
        OpEventGetEventTested_GetEventTested_GeneralEvtInfo: RteEventRef=OpEventGetEventTested_GetEventTested_GeneralEvtInfo
        OpEventGetDTCOfEvent_GetDTCOfEvent_EvtInfo_SAS_message_Steering_Wheel_Angle_Invalid_Serial_Data_Received: RteEventRef=OpEventGetDTCOfEvent_GetDTCOfEvent_EvtInfo_SAS_message_Steering_Wheel_Angle_Invalid_Serial_Data_Received
        OpEventGetDTCOfEvent_GetDTCOfEvent_Event_SAS_message_Steering_Wheel_Angle_Invalid_Serial_Data_Received: RteEventRef=OpEventGetDTCOfEvent_GetDTCOfEvent_Event_SAS_message_Steering_Wheel_Angle_Invalid_Serial_Data_Received
        OpEventGetDTCOfEvent_GetDTCOfEvent_EvtInfo_AT_AMT_ETC2_message_Transcurrent_gear_Invalid_Serial_Data_Received: RteEventRef=OpEventGetDTCOfEvent_GetDTCOfEvent_EvtInfo_AT_AMT_ETC2_message_Transcurrent_gear_Invalid_Serial_Data_Received
        OpEventGetDTCOfEvent_GetDTCOfEvent_Event_AT_AMT_ETC2_message_Transcurrent_gear_Invalid_Serial_Data_Received: RteEventRef=OpEventGetDTCOfEvent_GetDTCOfEvent_Event_AT_AMT_ETC2_message_Transcurrent_gear_Invalid_Serial_Data_Received
        OpEventGetDTCOfEvent_GetDTCOfEvent_EvtInfo_Radar_AutoAlignment_Algorithm_Signal_Calculation_Failure: RteEventRef=OpEventGetDTCOfEvent_GetDTCOfEvent_EvtInfo_Radar_AutoAlignment_Algorithm_Signal_Calculation_Failure
        OpEventGetDTCOfEvent_GetDTCOfEvent_Event_Radar_AutoAlignment_Algorithm_Signal_Calculation_Failure: RteEventRef=OpEventGetDTCOfEvent_GetDTCOfEvent_Event_Radar_AutoAlignment_Algorithm_Signal_Calculation_Failure
        OpEventGetDTCOfEvent_GetDTCOfEvent_EvtInfo_Vehicle_DataSet_Not_Configured: RteEventRef=OpEventGetDTCOfEvent_GetDTCOfEvent_EvtInfo_Vehicle_DataSet_Not_Configured
        OpEventGetDTCOfEvent_GetDTCOfEvent_Event_Vehicle_DataSet_Not_Configured: RteEventRef=OpEventGetDTCOfEvent_GetDTCOfEvent_Event_Vehicle_DataSet_Not_Configured
        OpEventGetDTCOfEvent_GetDTCOfEvent_EvtInfo_Radar_Module_System_Internal_Failure: RteEventRef=OpEventGetDTCOfEvent_GetDTCOfEvent_EvtInfo_Radar_Module_System_Internal_Failure
        OpEventGetDTCOfEvent_GetDTCOfEvent_Event_Radar_Module_System_Internal_Failure: RteEventRef=OpEventGetDTCOfEvent_GetDTCOfEvent_Event_Radar_Module_System_Internal_Failure
        OpEventGetDTCOfEvent_GetDTCOfEvent_EvtInfo_Radar_MMIC_Component_Failure: RteEventRef=OpEventGetDTCOfEvent_GetDTCOfEvent_EvtInfo_Radar_MMIC_Component_Failure
        OpEventGetDTCOfEvent_GetDTCOfEvent_Event_Radar_MMIC_Component_Failure: RteEventRef=OpEventGetDTCOfEvent_GetDTCOfEvent_Event_Radar_MMIC_Component_Failure
        OpEventGetDTCOfEvent_GetDTCOfEvent_EvtInfo_Radar_Module_General_Memory_Failure: RteEventRef=OpEventGetDTCOfEvent_GetDTCOfEvent_EvtInfo_Radar_Module_General_Memory_Failure
        OpEventGetDTCOfEvent_GetDTCOfEvent_Event_Radar_Module_General_Memory_Failure: RteEventRef=OpEventGetDTCOfEvent_GetDTCOfEvent_Event_Radar_Module_General_Memory_Failure
        OpEventGetDTCOfEvent_GetDTCOfEvent_EvtInfo_Radar_System_Battery_High_Voltage_System_Voltage_High: RteEventRef=OpEventGetDTCOfEvent_GetDTCOfEvent_EvtInfo_Radar_System_Battery_High_Voltage_System_Voltage_High
        OpEventGetDTCOfEvent_GetDTCOfEvent_Event_Radar_System_Battery_High_Voltage_System_Voltage_High: RteEventRef=OpEventGetDTCOfEvent_GetDTCOfEvent_Event_Radar_System_Battery_High_Voltage_System_Voltage_High
        OpEventGetDTCOfEvent_GetDTCOfEvent_EvtInfo_CCVS1_message_Vehicle_Speed_Invalid_Serial_Data_Received: RteEventRef=OpEventGetDTCOfEvent_GetDTCOfEvent_EvtInfo_CCVS1_message_Vehicle_Speed_Invalid_Serial_Data_Received
        OpEventGetDTCOfEvent_GetDTCOfEvent_Event_CCVS1_message_Vehicle_Speed_Invalid_Serial_Data_Received: RteEventRef=OpEventGetDTCOfEvent_GetDTCOfEvent_Event_CCVS1_message_Vehicle_Speed_Invalid_Serial_Data_Received
        OpEventGetDTCOfEvent_GetDTCOfEvent_EvtInfo_EMS_ECU_VD_erratic_communication_Erratic: RteEventRef=OpEventGetDTCOfEvent_GetDTCOfEvent_EvtInfo_EMS_ECU_VD_erratic_communication_Erratic
        OpEventGetDTCOfEvent_GetDTCOfEvent_Event_EMS_ECU_VD_erratic_communication_Erratic: RteEventRef=OpEventGetDTCOfEvent_GetDTCOfEvent_Event_EMS_ECU_VD_erratic_communication_Erratic
        OpEventGetDTCOfEvent_GetDTCOfEvent_EvtInfo_EMS_ECU_ETC2_00_message_Missing_Message: RteEventRef=OpEventGetDTCOfEvent_GetDTCOfEvent_EvtInfo_EMS_ECU_ETC2_00_message_Missing_Message
        OpEventGetDTCOfEvent_GetDTCOfEvent_Event_EMS_ECU_ETC2_00_message_Missing_Message: RteEventRef=OpEventGetDTCOfEvent_GetDTCOfEvent_Event_EMS_ECU_ETC2_00_message_Missing_Message
        OpEventGetDTCOfEvent_GetDTCOfEvent_EvtInfo_Cluster_ECU_CLS_Tx_16_message_Missing_Message: RteEventRef=OpEventGetDTCOfEvent_GetDTCOfEvent_EvtInfo_Cluster_ECU_CLS_Tx_16_message_Missing_Message
        OpEventGetDTCOfEvent_GetDTCOfEvent_Event_Cluster_ECU_CLS_Tx_16_message_Missing_Message: RteEventRef=OpEventGetDTCOfEvent_GetDTCOfEvent_Event_Cluster_ECU_CLS_Tx_16_message_Missing_Message
        OpEventGetDTCOfEvent_GetDTCOfEvent_EvtInfo_Exceeded_Security_Access_0x27_Attempt_Threshold_Authentication_Failure: RteEventRef=OpEventGetDTCOfEvent_GetDTCOfEvent_EvtInfo_Exceeded_Security_Access_0x27_Attempt_Threshold_Authentication_Failure
        OpEventGetDTCOfEvent_GetDTCOfEvent_Event_Exceeded_Security_Access_0x27_Attempt_Threshold_Authentication_Failure: RteEventRef=OpEventGetDTCOfEvent_GetDTCOfEvent_Event_Exceeded_Security_Access_0x27_Attempt_Threshold_Authentication_Failure
        OpEventGetDTCOfEvent_GetDTCOfEvent_EvtInfo_Front_Left_Side_Radar_value_of_signal_protection_calculation_Incorrect: RteEventRef=OpEventGetDTCOfEvent_GetDTCOfEvent_EvtInfo_Front_Left_Side_Radar_value_of_signal_protection_calculation_Incorrect
        OpEventGetDTCOfEvent_GetDTCOfEvent_Event_Front_Left_Side_Radar_value_of_signal_protection_calculation_Incorrect: RteEventRef=OpEventGetDTCOfEvent_GetDTCOfEvent_Event_Front_Left_Side_Radar_value_of_signal_protection_calculation_Incorrect
        OpEventGetDTCOfEvent_GetDTCOfEvent_EvtInfo_AT_AMT_ETC2_erratic_communication_Erratic: RteEventRef=OpEventGetDTCOfEvent_GetDTCOfEvent_EvtInfo_AT_AMT_ETC2_erratic_communication_Erratic
        OpEventGetDTCOfEvent_GetDTCOfEvent_Event_AT_AMT_ETC2_erratic_communication_Erratic: RteEventRef=OpEventGetDTCOfEvent_GetDTCOfEvent_Event_AT_AMT_ETC2_erratic_communication_Erratic
        OpEventGetDTCOfEvent_GetDTCOfEvent_EvtInfo_VCAN_Communication_Bus_Off: RteEventRef=OpEventGetDTCOfEvent_GetDTCOfEvent_EvtInfo_VCAN_Communication_Bus_Off
        OpEventGetDTCOfEvent_GetDTCOfEvent_Event_VCAN_Communication_Bus_Off: RteEventRef=OpEventGetDTCOfEvent_GetDTCOfEvent_Event_VCAN_Communication_Bus_Off
        OpEventGetDTCOfEvent_GetDTCOfEvent_EvtInfo_VDC2_message_LongitudinalAcceleration_Invalid_Serial_Data_Received: RteEventRef=OpEventGetDTCOfEvent_GetDTCOfEvent_EvtInfo_VDC2_message_LongitudinalAcceleration_Invalid_Serial_Data_Received
        OpEventGetDTCOfEvent_GetDTCOfEvent_Event_VDC2_message_LongitudinalAcceleration_Invalid_Serial_Data_Received: RteEventRef=OpEventGetDTCOfEvent_GetDTCOfEvent_Event_VDC2_message_LongitudinalAcceleration_Invalid_Serial_Data_Received
        OpEventGetDTCOfEvent_GetDTCOfEvent_EvtInfo_Radar_MMIC_RFBIST_Component_Internal_Failure: RteEventRef=OpEventGetDTCOfEvent_GetDTCOfEvent_EvtInfo_Radar_MMIC_RFBIST_Component_Internal_Failure
        OpEventGetDTCOfEvent_GetDTCOfEvent_Event_Radar_MMIC_RFBIST_Component_Internal_Failure: RteEventRef=OpEventGetDTCOfEvent_GetDTCOfEvent_Event_Radar_MMIC_RFBIST_Component_Internal_Failure
        OpEventGetDTCOfEvent_GetDTCOfEvent_EvtInfo_Radar_Initial_Alignment_Missing_Calibration: RteEventRef=OpEventGetDTCOfEvent_GetDTCOfEvent_EvtInfo_Radar_Initial_Alignment_Missing_Calibration
        OpEventGetDTCOfEvent_GetDTCOfEvent_Event_Radar_Initial_Alignment_Missing_Calibration: RteEventRef=OpEventGetDTCOfEvent_GetDTCOfEvent_Event_Radar_Initial_Alignment_Missing_Calibration
        OpEventGetDTCOfEvent_GetDTCOfEvent_EvtInfo_Cluster_ECU_OEL_message_Missing_Message: RteEventRef=OpEventGetDTCOfEvent_GetDTCOfEvent_EvtInfo_Cluster_ECU_OEL_message_Missing_Message
        OpEventGetDTCOfEvent_GetDTCOfEvent_Event_Cluster_ECU_OEL_message_Missing_Message: RteEventRef=OpEventGetDTCOfEvent_GetDTCOfEvent_Event_Cluster_ECU_OEL_message_Missing_Message
        OpEventGetDTCOfEvent_GetDTCOfEvent_EvtInfo_AT_AMT_ECU_ETC2_03_message_Missing_Message: RteEventRef=OpEventGetDTCOfEvent_GetDTCOfEvent_EvtInfo_AT_AMT_ECU_ETC2_03_message_Missing_Message
        OpEventGetDTCOfEvent_GetDTCOfEvent_Event_AT_AMT_ECU_ETC2_03_message_Missing_Message: RteEventRef=OpEventGetDTCOfEvent_GetDTCOfEvent_Event_AT_AMT_ECU_ETC2_03_message_Missing_Message
        OpEventGetDTCOfEvent_GetDTCOfEvent_EvtInfo_ADAS_FN_STS_message_MOIS_FN_Switch_STS_Invalid_Serial_Data_Received: RteEventRef=OpEventGetDTCOfEvent_GetDTCOfEvent_EvtInfo_ADAS_FN_STS_message_MOIS_FN_Switch_STS_Invalid_Serial_Data_Received
        OpEventGetDTCOfEvent_GetDTCOfEvent_Event_ADAS_FN_STS_message_MOIS_FN_Switch_STS_Invalid_Serial_Data_Received: RteEventRef=OpEventGetDTCOfEvent_GetDTCOfEvent_Event_ADAS_FN_STS_message_MOIS_FN_Switch_STS_Invalid_Serial_Data_Received
        OpEventGetDTCOfEvent_GetDTCOfEvent_EvtInfo_Radar_Module_Over_Temperature: RteEventRef=OpEventGetDTCOfEvent_GetDTCOfEvent_EvtInfo_Radar_Module_Over_Temperature
        OpEventGetDTCOfEvent_GetDTCOfEvent_Event_Radar_Module_Over_Temperature: RteEventRef=OpEventGetDTCOfEvent_GetDTCOfEvent_Event_Radar_Module_Over_Temperature
        OpEventGetDTCOfEvent_GetDTCOfEvent_EvtInfo_PCAN_TimeSync_Missing_Message: RteEventRef=OpEventGetDTCOfEvent_GetDTCOfEvent_EvtInfo_PCAN_TimeSync_Missing_Message
        OpEventGetDTCOfEvent_GetDTCOfEvent_Event_PCAN_TimeSync_Missing_Message: RteEventRef=OpEventGetDTCOfEvent_GetDTCOfEvent_Event_PCAN_TimeSync_Missing_Message
        OpEventGetDTCOfEvent_GetDTCOfEvent_EvtInfo_Radar_Module_Watchdog_Failure: RteEventRef=OpEventGetDTCOfEvent_GetDTCOfEvent_EvtInfo_Radar_Module_Watchdog_Failure
        OpEventGetDTCOfEvent_GetDTCOfEvent_Event_Radar_Module_Watchdog_Failure: RteEventRef=OpEventGetDTCOfEvent_GetDTCOfEvent_Event_Radar_Module_Watchdog_Failure
        OpEventGetDTCOfEvent_GetDTCOfEvent_EvtInfo_SAS_ECU_SAS_message_Missing_Message: RteEventRef=OpEventGetDTCOfEvent_GetDTCOfEvent_EvtInfo_SAS_ECU_SAS_message_Missing_Message
        OpEventGetDTCOfEvent_GetDTCOfEvent_Event_SAS_ECU_SAS_message_Missing_Message: RteEventRef=OpEventGetDTCOfEvent_GetDTCOfEvent_Event_SAS_ECU_SAS_message_Missing_Message
        OpEventGetDTCOfEvent_GetDTCOfEvent_EvtInfo_ECU_NVM_Corruption_Program_memory_Failure: RteEventRef=OpEventGetDTCOfEvent_GetDTCOfEvent_EvtInfo_ECU_NVM_Corruption_Program_memory_Failure
        OpEventGetDTCOfEvent_GetDTCOfEvent_Event_ECU_NVM_Corruption_Program_memory_Failure: RteEventRef=OpEventGetDTCOfEvent_GetDTCOfEvent_Event_ECU_NVM_Corruption_Program_memory_Failure
        OpEventGetDTCOfEvent_GetDTCOfEvent_EvtInfo_Cluster_ECU_TD_message_Missing_Message: RteEventRef=OpEventGetDTCOfEvent_GetDTCOfEvent_EvtInfo_Cluster_ECU_TD_message_Missing_Message
        OpEventGetDTCOfEvent_GetDTCOfEvent_Event_Cluster_ECU_TD_message_Missing_Message: RteEventRef=OpEventGetDTCOfEvent_GetDTCOfEvent_Event_Cluster_ECU_TD_message_Missing_Message
        OpEventGetDTCOfEvent_GetDTCOfEvent_EvtInfo_PCAN_Communication_Bus_Off: RteEventRef=OpEventGetDTCOfEvent_GetDTCOfEvent_EvtInfo_PCAN_Communication_Bus_Off
        OpEventGetDTCOfEvent_GetDTCOfEvent_Event_PCAN_Communication_Bus_Off: RteEventRef=OpEventGetDTCOfEvent_GetDTCOfEvent_Event_PCAN_Communication_Bus_Off
        OpEventGetDTCOfEvent_GetDTCOfEvent_EvtInfo_Front_Left_Side_Radar_Missing_Message: RteEventRef=OpEventGetDTCOfEvent_GetDTCOfEvent_EvtInfo_Front_Left_Side_Radar_Missing_Message
        OpEventGetDTCOfEvent_GetDTCOfEvent_Event_Front_Left_Side_Radar_Missing_Message: RteEventRef=OpEventGetDTCOfEvent_GetDTCOfEvent_Event_Front_Left_Side_Radar_Missing_Message
        OpEventGetDTCOfEvent_GetDTCOfEvent_EvtInfo_Manual_ETC2_message_Transcurrent_gear_Invalid_Serial_Data_Received: RteEventRef=OpEventGetDTCOfEvent_GetDTCOfEvent_EvtInfo_Manual_ETC2_message_Transcurrent_gear_Invalid_Serial_Data_Received
        OpEventGetDTCOfEvent_GetDTCOfEvent_Event_Manual_ETC2_message_Transcurrent_gear_Invalid_Serial_Data_Received: RteEventRef=OpEventGetDTCOfEvent_GetDTCOfEvent_Event_Manual_ETC2_message_Transcurrent_gear_Invalid_Serial_Data_Received
        OpEventGetDTCOfEvent_GetDTCOfEvent_EvtInfo_SAS_ECU_erratic_communication_Erratic: RteEventRef=OpEventGetDTCOfEvent_GetDTCOfEvent_EvtInfo_SAS_ECU_erratic_communication_Erratic
        OpEventGetDTCOfEvent_GetDTCOfEvent_Event_SAS_ECU_erratic_communication_Erratic: RteEventRef=OpEventGetDTCOfEvent_GetDTCOfEvent_Event_SAS_ECU_erratic_communication_Erratic
        OpEventGetDTCOfEvent_GetDTCOfEvent_EvtInfo_VDC2_message_Yaw_rate_Invalid_Serial_Data_Received: RteEventRef=OpEventGetDTCOfEvent_GetDTCOfEvent_EvtInfo_VDC2_message_Yaw_rate_Invalid_Serial_Data_Received
        OpEventGetDTCOfEvent_GetDTCOfEvent_Event_VDC2_message_Yaw_rate_Invalid_Serial_Data_Received: RteEventRef=OpEventGetDTCOfEvent_GetDTCOfEvent_Event_VDC2_message_Yaw_rate_Invalid_Serial_Data_Received
        OpEventGetDTCOfEvent_GetDTCOfEvent_EvtInfo_Cluster_ECU_TD_erratic_communication_Erratic: RteEventRef=OpEventGetDTCOfEvent_GetDTCOfEvent_EvtInfo_Cluster_ECU_TD_erratic_communication_Erratic
        OpEventGetDTCOfEvent_GetDTCOfEvent_Event_Cluster_ECU_TD_erratic_communication_Erratic: RteEventRef=OpEventGetDTCOfEvent_GetDTCOfEvent_Event_Cluster_ECU_TD_erratic_communication_Erratic
        OpEventGetDTCOfEvent_GetDTCOfEvent_EvtInfo_EMS_ECU_CCVS1_message_Missing_Message: RteEventRef=OpEventGetDTCOfEvent_GetDTCOfEvent_EvtInfo_EMS_ECU_CCVS1_message_Missing_Message
        OpEventGetDTCOfEvent_GetDTCOfEvent_Event_EMS_ECU_CCVS1_message_Missing_Message: RteEventRef=OpEventGetDTCOfEvent_GetDTCOfEvent_Event_EMS_ECU_CCVS1_message_Missing_Message
        OpEventGetDTCOfEvent_GetDTCOfEvent_EvtInfo_Radar_Mounting_Orientation_Incorrect_Assembly: RteEventRef=OpEventGetDTCOfEvent_GetDTCOfEvent_EvtInfo_Radar_Mounting_Orientation_Incorrect_Assembly
        OpEventGetDTCOfEvent_GetDTCOfEvent_Event_Radar_Mounting_Orientation_Incorrect_Assembly: RteEventRef=OpEventGetDTCOfEvent_GetDTCOfEvent_Event_Radar_Mounting_Orientation_Incorrect_Assembly
        OpEventGetDTCOfEvent_GetDTCOfEvent_EvtInfo_EMS_ECU_ETC2_erratic_communication_Erractic: RteEventRef=OpEventGetDTCOfEvent_GetDTCOfEvent_EvtInfo_EMS_ECU_ETC2_erratic_communication_Erractic
        OpEventGetDTCOfEvent_GetDTCOfEvent_Event_EMS_ECU_ETC2_erratic_communication_Erractic: RteEventRef=OpEventGetDTCOfEvent_GetDTCOfEvent_Event_EMS_ECU_ETC2_erratic_communication_Erractic
        OpEventGetDTCOfEvent_GetDTCOfEvent_EvtInfo_Cluster_ECU_ADAS_FN_STS_erratic_communication_Erratic: RteEventRef=OpEventGetDTCOfEvent_GetDTCOfEvent_EvtInfo_Cluster_ECU_ADAS_FN_STS_erratic_communication_Erratic
        OpEventGetDTCOfEvent_GetDTCOfEvent_Event_Cluster_ECU_ADAS_FN_STS_erratic_communication_Erratic: RteEventRef=OpEventGetDTCOfEvent_GetDTCOfEvent_Event_Cluster_ECU_ADAS_FN_STS_erratic_communication_Erratic
        OpEventGetDTCOfEvent_GetDTCOfEvent_EvtInfo_ESC_ECU_VDC2_message_Missing_Message: RteEventRef=OpEventGetDTCOfEvent_GetDTCOfEvent_EvtInfo_ESC_ECU_VDC2_message_Missing_Message
        OpEventGetDTCOfEvent_GetDTCOfEvent_Event_ESC_ECU_VDC2_message_Missing_Message: RteEventRef=OpEventGetDTCOfEvent_GetDTCOfEvent_Event_ESC_ECU_VDC2_message_Missing_Message
        OpEventGetDTCOfEvent_GetDTCOfEvent_EvtInfo_CLS_TX_16_message_Transmission_Type_info_Invalid_Serial_Data_Received: RteEventRef=OpEventGetDTCOfEvent_GetDTCOfEvent_EvtInfo_CLS_TX_16_message_Transmission_Type_info_Invalid_Serial_Data_Received
        OpEventGetDTCOfEvent_GetDTCOfEvent_Event_CLS_TX_16_message_Transmission_Type_info_Invalid_Serial_Data_Received: RteEventRef=OpEventGetDTCOfEvent_GetDTCOfEvent_Event_CLS_TX_16_message_Transmission_Type_info_Invalid_Serial_Data_Received
        OpEventGetDTCOfEvent_GetDTCOfEvent_EvtInfo_Cluster_ECU_CLS_Tx_4_erratic_communication_Erratic: RteEventRef=OpEventGetDTCOfEvent_GetDTCOfEvent_EvtInfo_Cluster_ECU_CLS_Tx_4_erratic_communication_Erratic
        OpEventGetDTCOfEvent_GetDTCOfEvent_Event_Cluster_ECU_CLS_Tx_4_erratic_communication_Erratic: RteEventRef=OpEventGetDTCOfEvent_GetDTCOfEvent_Event_Cluster_ECU_CLS_Tx_4_erratic_communication_Erratic
        OpEventGetDTCOfEvent_GetDTCOfEvent_EvtInfo_Cluster_ECU_ADAS_FN_STS_message_Missing_Message: RteEventRef=OpEventGetDTCOfEvent_GetDTCOfEvent_EvtInfo_Cluster_ECU_ADAS_FN_STS_message_Missing_Message
        OpEventGetDTCOfEvent_GetDTCOfEvent_Event_Cluster_ECU_ADAS_FN_STS_message_Missing_Message: RteEventRef=OpEventGetDTCOfEvent_GetDTCOfEvent_Event_Cluster_ECU_ADAS_FN_STS_message_Missing_Message
        OpEventGetDTCOfEvent_GetDTCOfEvent_EvtInfo_Vehicle_Dataset_value_of_signal_protection_calculation_Incorrect: RteEventRef=OpEventGetDTCOfEvent_GetDTCOfEvent_EvtInfo_Vehicle_Dataset_value_of_signal_protection_calculation_Incorrect
        OpEventGetDTCOfEvent_GetDTCOfEvent_Event_Vehicle_Dataset_value_of_signal_protection_calculation_Incorrect: RteEventRef=OpEventGetDTCOfEvent_GetDTCOfEvent_Event_Vehicle_Dataset_value_of_signal_protection_calculation_Incorrect
        OpEventGetDTCOfEvent_GetDTCOfEvent_EvtInfo_Cluster_ECU_CLS_Tx_16_erratic_communication_Erratic: RteEventRef=OpEventGetDTCOfEvent_GetDTCOfEvent_EvtInfo_Cluster_ECU_CLS_Tx_16_erratic_communication_Erratic
        OpEventGetDTCOfEvent_GetDTCOfEvent_Event_Cluster_ECU_CLS_Tx_16_erratic_communication_Erratic: RteEventRef=OpEventGetDTCOfEvent_GetDTCOfEvent_Event_Cluster_ECU_CLS_Tx_16_erratic_communication_Erratic
        OpEventGetDTCOfEvent_GetDTCOfEvent_EvtInfo_Cluster_ECU_OEL_erratic_communication_Erratic: RteEventRef=OpEventGetDTCOfEvent_GetDTCOfEvent_EvtInfo_Cluster_ECU_OEL_erratic_communication_Erratic
        OpEventGetDTCOfEvent_GetDTCOfEvent_Event_Cluster_ECU_OEL_erratic_communication_Erratic: RteEventRef=OpEventGetDTCOfEvent_GetDTCOfEvent_Event_Cluster_ECU_OEL_erratic_communication_Erratic
        OpEventGetDTCOfEvent_GetDTCOfEvent_EvtInfo_Cluster_ECU_CLS_Tx_4_message_Missing_Message: RteEventRef=OpEventGetDTCOfEvent_GetDTCOfEvent_EvtInfo_Cluster_ECU_CLS_Tx_4_message_Missing_Message
        OpEventGetDTCOfEvent_GetDTCOfEvent_Event_Cluster_ECU_CLS_Tx_4_message_Missing_Message: RteEventRef=OpEventGetDTCOfEvent_GetDTCOfEvent_Event_Cluster_ECU_CLS_Tx_4_message_Missing_Message
        OpEventGetDTCOfEvent_GetDTCOfEvent_EvtInfo_Radar_Performance_Capability_Algorithm_Based_Failure: RteEventRef=OpEventGetDTCOfEvent_GetDTCOfEvent_EvtInfo_Radar_Performance_Capability_Algorithm_Based_Failure
        OpEventGetDTCOfEvent_GetDTCOfEvent_Event_Radar_Performance_Capability_Algorithm_Based_Failure: RteEventRef=OpEventGetDTCOfEvent_GetDTCOfEvent_Event_Radar_Performance_Capability_Algorithm_Based_Failure
        OpEventGetDTCOfEvent_GetDTCOfEvent_EvtInfo_Radar_AutoAlignment_Range_Alignment_or_Adjustement_Incorrect: RteEventRef=OpEventGetDTCOfEvent_GetDTCOfEvent_EvtInfo_Radar_AutoAlignment_Range_Alignment_or_Adjustement_Incorrect
        OpEventGetDTCOfEvent_GetDTCOfEvent_Event_Radar_AutoAlignment_Range_Alignment_or_Adjustement_Incorrect: RteEventRef=OpEventGetDTCOfEvent_GetDTCOfEvent_Event_Radar_AutoAlignment_Range_Alignment_or_Adjustement_Incorrect
        OpEventGetDTCOfEvent_GetDTCOfEvent_EvtInfo_EMS_ECU_CCVS1_erratic_communication_Erractic: RteEventRef=OpEventGetDTCOfEvent_GetDTCOfEvent_EvtInfo_EMS_ECU_CCVS1_erratic_communication_Erractic
        OpEventGetDTCOfEvent_GetDTCOfEvent_Event_EMS_ECU_CCVS1_erratic_communication_Erractic: RteEventRef=OpEventGetDTCOfEvent_GetDTCOfEvent_Event_EMS_ECU_CCVS1_erratic_communication_Erractic
        OpEventGetDTCOfEvent_GetDTCOfEvent_EvtInfo_Radar_System_Battery_Low_Voltage_System_Voltage_Low: RteEventRef=OpEventGetDTCOfEvent_GetDTCOfEvent_EvtInfo_Radar_System_Battery_Low_Voltage_System_Voltage_Low
        OpEventGetDTCOfEvent_GetDTCOfEvent_Event_Radar_System_Battery_Low_Voltage_System_Voltage_Low: RteEventRef=OpEventGetDTCOfEvent_GetDTCOfEvent_Event_Radar_System_Battery_Low_Voltage_System_Voltage_Low
        OpEventGetDTCOfEvent_GetDTCOfEvent_EvtInfo_Radar_SMC_General_Checksum_Failure: RteEventRef=OpEventGetDTCOfEvent_GetDTCOfEvent_EvtInfo_Radar_SMC_General_Checksum_Failure
        OpEventGetDTCOfEvent_GetDTCOfEvent_Event_Radar_SMC_General_Checksum_Failure: RteEventRef=OpEventGetDTCOfEvent_GetDTCOfEvent_Event_Radar_SMC_General_Checksum_Failure
        OpEventGetDTCOfEvent_GetDTCOfEvent_EvtInfo_Radar_Pin_Position_Wrong_Mounting_Position: RteEventRef=OpEventGetDTCOfEvent_GetDTCOfEvent_EvtInfo_Radar_Pin_Position_Wrong_Mounting_Position
        OpEventGetDTCOfEvent_GetDTCOfEvent_Event_Radar_Pin_Position_Wrong_Mounting_Position: RteEventRef=OpEventGetDTCOfEvent_GetDTCOfEvent_Event_Radar_Pin_Position_Wrong_Mounting_Position
        OpEventGetDTCOfEvent_GetDTCOfEvent_EvtInfo_VDC2_message_Lateral_Accleration_Invalid_Serial_Data_Received: RteEventRef=OpEventGetDTCOfEvent_GetDTCOfEvent_EvtInfo_VDC2_message_Lateral_Accleration_Invalid_Serial_Data_Received
        OpEventGetDTCOfEvent_GetDTCOfEvent_Event_VDC2_message_Lateral_Accleration_Invalid_Serial_Data_Received: RteEventRef=OpEventGetDTCOfEvent_GetDTCOfEvent_Event_VDC2_message_Lateral_Accleration_Invalid_Serial_Data_Received
        OpEventGetDTCOfEvent_GetDTCOfEvent_EvtInfo_ADAS_FN_STS_message_BSIS_FN_Switch_STS_Invalid_Serial_Data_Received: RteEventRef=OpEventGetDTCOfEvent_GetDTCOfEvent_EvtInfo_ADAS_FN_STS_message_BSIS_FN_Switch_STS_Invalid_Serial_Data_Received
        OpEventGetDTCOfEvent_GetDTCOfEvent_Event_ADAS_FN_STS_message_BSIS_FN_Switch_STS_Invalid_Serial_Data_Received: RteEventRef=OpEventGetDTCOfEvent_GetDTCOfEvent_Event_ADAS_FN_STS_message_BSIS_FN_Switch_STS_Invalid_Serial_Data_Received
        OpEventGetDTCOfEvent_GetDTCOfEvent_EvtInfo_Radar_AutoAlignment_Misalignment_Performance_or_Incorrect_Operation: RteEventRef=OpEventGetDTCOfEvent_GetDTCOfEvent_EvtInfo_Radar_AutoAlignment_Misalignment_Performance_or_Incorrect_Operation
        OpEventGetDTCOfEvent_GetDTCOfEvent_Event_Radar_AutoAlignment_Misalignment_Performance_or_Incorrect_Operation: RteEventRef=OpEventGetDTCOfEvent_GetDTCOfEvent_Event_Radar_AutoAlignment_Misalignment_Performance_or_Incorrect_Operation
        OpEventGetDTCOfEvent_GetDTCOfEvent_EvtInfo_ESC_ECU_VDC2_erratic_communication_Erratic: RteEventRef=OpEventGetDTCOfEvent_GetDTCOfEvent_EvtInfo_ESC_ECU_VDC2_erratic_communication_Erratic
        OpEventGetDTCOfEvent_GetDTCOfEvent_Event_ESC_ECU_VDC2_erratic_communication_Erratic: RteEventRef=OpEventGetDTCOfEvent_GetDTCOfEvent_Event_ESC_ECU_VDC2_erratic_communication_Erratic
        OpEventGetDTCOfEvent_GetDTCOfEvent_EvtInfo_Application_Interface_Lookup_Performance_or_Incorrect_Operation: RteEventRef=OpEventGetDTCOfEvent_GetDTCOfEvent_EvtInfo_Application_Interface_Lookup_Performance_or_Incorrect_Operation
        OpEventGetDTCOfEvent_GetDTCOfEvent_Event_Application_Interface_Lookup_Performance_or_Incorrect_Operation: RteEventRef=OpEventGetDTCOfEvent_GetDTCOfEvent_Event_Application_Interface_Lookup_Performance_or_Incorrect_Operation
        OpEventGetDTCOfEvent_GetDTCOfEvent_EvtInfo_EMS_ECU_VD_message_Missing_Message: RteEventRef=OpEventGetDTCOfEvent_GetDTCOfEvent_EvtInfo_EMS_ECU_VD_message_Missing_Message
        OpEventGetDTCOfEvent_GetDTCOfEvent_Event_EMS_ECU_VD_message_Missing_Message: RteEventRef=OpEventGetDTCOfEvent_GetDTCOfEvent_Event_EMS_ECU_VD_message_Missing_Message
        OpEventGetDTCOfEvent_GetDTCOfEvent_EvtInfo_Radar_Platform_Time_System_Programming_Failure: RteEventRef=OpEventGetDTCOfEvent_GetDTCOfEvent_EvtInfo_Radar_Platform_Time_System_Programming_Failure
        OpEventGetDTCOfEvent_GetDTCOfEvent_Event_Radar_Platform_Time_System_Programming_Failure: RteEventRef=OpEventGetDTCOfEvent_GetDTCOfEvent_Event_Radar_Platform_Time_System_Programming_Failure
        OpEventGetDTCOfEvent_GetDTCOfEvent_EvtInfo_OEL_message_Turn_Signal_Switch_Invalid_Serial_Data_Received: RteEventRef=OpEventGetDTCOfEvent_GetDTCOfEvent_EvtInfo_OEL_message_Turn_Signal_Switch_Invalid_Serial_Data_Received
        OpEventGetDTCOfEvent_GetDTCOfEvent_Event_OEL_message_Turn_Signal_Switch_Invalid_Serial_Data_Received: RteEventRef=OpEventGetDTCOfEvent_GetDTCOfEvent_Event_OEL_message_Turn_Signal_Switch_Invalid_Serial_Data_Received
        OpEventGetDTCOfEvent_GetDTCOfEvent_EvtInfo_Radar_calibration_Calibration_or_Paramater_Memory_Failure: RteEventRef=OpEventGetDTCOfEvent_GetDTCOfEvent_EvtInfo_Radar_calibration_Calibration_or_Paramater_Memory_Failure
        OpEventGetDTCOfEvent_GetDTCOfEvent_Event_Radar_calibration_Calibration_or_Paramater_Memory_Failure: RteEventRef=OpEventGetDTCOfEvent_GetDTCOfEvent_Event_Radar_calibration_Calibration_or_Paramater_Memory_Failure
        OpEventGetDTCOfEvent_GetDTCOfEvent_GeneralEvtInfo: RteEventRef=OpEventGetDTCOfEvent_GetDTCOfEvent_GeneralEvtInfo
        OpEventGetFaultDetectionCounter_GetFaultDetectionCounter_EvtInfo_SAS_message_Steering_Wheel_Angle_Invalid_Serial_Data_Received: RteEventRef=OpEventGetFaultDetectionCounter_GetFaultDetectionCounter_EvtInfo_SAS_message_Steering_Wheel_Angle_Invalid_Serial_Data_Received
        OpEventGetFaultDetectionCounter_GetFaultDetectionCounter_Event_SAS_message_Steering_Wheel_Angle_Invalid_Serial_Data_Received: RteEventRef=OpEventGetFaultDetectionCounter_GetFaultDetectionCounter_Event_SAS_message_Steering_Wheel_Angle_Invalid_Serial_Data_Received
        OpEventGetFaultDetectionCounter_GetFaultDetectionCounter_EvtInfo_AT_AMT_ETC2_message_Transcurrent_gear_Invalid_Serial_D_17ddc8c4: RteEventRef=OpEventGetFaultDetectionCounter_GetFaultDetectionCounter_EvtInfo_AT_AMT_ETC2_message_Transcurrent_gear_Invalid_Serial_D_17ddc8c4
        OpEventGetFaultDetectionCounter_GetFaultDetectionCounter_Event_AT_AMT_ETC2_message_Transcurrent_gear_Invalid_Serial_Dat_0c36eec9: RteEventRef=OpEventGetFaultDetectionCounter_GetFaultDetectionCounter_Event_AT_AMT_ETC2_message_Transcurrent_gear_Invalid_Serial_Dat_0c36eec9
        OpEventGetFaultDetectionCounter_GetFaultDetectionCounter_EvtInfo_Radar_AutoAlignment_Algorithm_Signal_Calculation_Failure: RteEventRef=OpEventGetFaultDetectionCounter_GetFaultDetectionCounter_EvtInfo_Radar_AutoAlignment_Algorithm_Signal_Calculation_Failure
        OpEventGetFaultDetectionCounter_GetFaultDetectionCounter_Event_Radar_AutoAlignment_Algorithm_Signal_Calculation_Failure: RteEventRef=OpEventGetFaultDetectionCounter_GetFaultDetectionCounter_Event_Radar_AutoAlignment_Algorithm_Signal_Calculation_Failure
        OpEventGetFaultDetectionCounter_GetFaultDetectionCounter_EvtInfo_Vehicle_DataSet_Not_Configured: RteEventRef=OpEventGetFaultDetectionCounter_GetFaultDetectionCounter_EvtInfo_Vehicle_DataSet_Not_Configured
        OpEventGetFaultDetectionCounter_GetFaultDetectionCounter_Event_Vehicle_DataSet_Not_Configured: RteEventRef=OpEventGetFaultDetectionCounter_GetFaultDetectionCounter_Event_Vehicle_DataSet_Not_Configured
        OpEventGetFaultDetectionCounter_GetFaultDetectionCounter_EvtInfo_Radar_Module_System_Internal_Failure: RteEventRef=OpEventGetFaultDetectionCounter_GetFaultDetectionCounter_EvtInfo_Radar_Module_System_Internal_Failure
        OpEventGetFaultDetectionCounter_GetFaultDetectionCounter_Event_Radar_Module_System_Internal_Failure: RteEventRef=OpEventGetFaultDetectionCounter_GetFaultDetectionCounter_Event_Radar_Module_System_Internal_Failure
        OpEventGetFaultDetectionCounter_GetFaultDetectionCounter_EvtInfo_Radar_MMIC_Component_Failure: RteEventRef=OpEventGetFaultDetectionCounter_GetFaultDetectionCounter_EvtInfo_Radar_MMIC_Component_Failure
        OpEventGetFaultDetectionCounter_GetFaultDetectionCounter_Event_Radar_MMIC_Component_Failure: RteEventRef=OpEventGetFaultDetectionCounter_GetFaultDetectionCounter_Event_Radar_MMIC_Component_Failure
        OpEventGetFaultDetectionCounter_GetFaultDetectionCounter_EvtInfo_Radar_Module_General_Memory_Failure: RteEventRef=OpEventGetFaultDetectionCounter_GetFaultDetectionCounter_EvtInfo_Radar_Module_General_Memory_Failure
        OpEventGetFaultDetectionCounter_GetFaultDetectionCounter_Event_Radar_Module_General_Memory_Failure: RteEventRef=OpEventGetFaultDetectionCounter_GetFaultDetectionCounter_Event_Radar_Module_General_Memory_Failure
        OpEventGetFaultDetectionCounter_GetFaultDetectionCounter_EvtInfo_Radar_System_Battery_High_Voltage_System_Voltage_High: RteEventRef=OpEventGetFaultDetectionCounter_GetFaultDetectionCounter_EvtInfo_Radar_System_Battery_High_Voltage_System_Voltage_High
        OpEventGetFaultDetectionCounter_GetFaultDetectionCounter_Event_Radar_System_Battery_High_Voltage_System_Voltage_High: RteEventRef=OpEventGetFaultDetectionCounter_GetFaultDetectionCounter_Event_Radar_System_Battery_High_Voltage_System_Voltage_High
        OpEventGetFaultDetectionCounter_GetFaultDetectionCounter_EvtInfo_CCVS1_message_Vehicle_Speed_Invalid_Serial_Data_Received: RteEventRef=OpEventGetFaultDetectionCounter_GetFaultDetectionCounter_EvtInfo_CCVS1_message_Vehicle_Speed_Invalid_Serial_Data_Received
        OpEventGetFaultDetectionCounter_GetFaultDetectionCounter_Event_CCVS1_message_Vehicle_Speed_Invalid_Serial_Data_Received: RteEventRef=OpEventGetFaultDetectionCounter_GetFaultDetectionCounter_Event_CCVS1_message_Vehicle_Speed_Invalid_Serial_Data_Received
        OpEventGetFaultDetectionCounter_GetFaultDetectionCounter_EvtInfo_EMS_ECU_VD_erratic_communication_Erratic: RteEventRef=OpEventGetFaultDetectionCounter_GetFaultDetectionCounter_EvtInfo_EMS_ECU_VD_erratic_communication_Erratic
        OpEventGetFaultDetectionCounter_GetFaultDetectionCounter_Event_EMS_ECU_VD_erratic_communication_Erratic: RteEventRef=OpEventGetFaultDetectionCounter_GetFaultDetectionCounter_Event_EMS_ECU_VD_erratic_communication_Erratic
        OpEventGetFaultDetectionCounter_GetFaultDetectionCounter_EvtInfo_EMS_ECU_ETC2_00_message_Missing_Message: RteEventRef=OpEventGetFaultDetectionCounter_GetFaultDetectionCounter_EvtInfo_EMS_ECU_ETC2_00_message_Missing_Message
        OpEventGetFaultDetectionCounter_GetFaultDetectionCounter_Event_EMS_ECU_ETC2_00_message_Missing_Message: RteEventRef=OpEventGetFaultDetectionCounter_GetFaultDetectionCounter_Event_EMS_ECU_ETC2_00_message_Missing_Message
        OpEventGetFaultDetectionCounter_GetFaultDetectionCounter_EvtInfo_Cluster_ECU_CLS_Tx_16_message_Missing_Message: RteEventRef=OpEventGetFaultDetectionCounter_GetFaultDetectionCounter_EvtInfo_Cluster_ECU_CLS_Tx_16_message_Missing_Message
        OpEventGetFaultDetectionCounter_GetFaultDetectionCounter_Event_Cluster_ECU_CLS_Tx_16_message_Missing_Message: RteEventRef=OpEventGetFaultDetectionCounter_GetFaultDetectionCounter_Event_Cluster_ECU_CLS_Tx_16_message_Missing_Message
        OpEventGetFaultDetectionCounter_GetFaultDetectionCounter_EvtInfo_Exceeded_Security_Access_0x27_Attempt_Threshold_Authen_fd88cf9f: RteEventRef=OpEventGetFaultDetectionCounter_GetFaultDetectionCounter_EvtInfo_Exceeded_Security_Access_0x27_Attempt_Threshold_Authen_fd88cf9f
        OpEventGetFaultDetectionCounter_GetFaultDetectionCounter_Event_Exceeded_Security_Access_0x27_Attempt_Threshold_Authenti_04cdcedb: RteEventRef=OpEventGetFaultDetectionCounter_GetFaultDetectionCounter_Event_Exceeded_Security_Access_0x27_Attempt_Threshold_Authenti_04cdcedb
        OpEventGetFaultDetectionCounter_GetFaultDetectionCounter_EvtInfo_Front_Left_Side_Radar_value_of_signal_protection_calcu_b7111bd7: RteEventRef=OpEventGetFaultDetectionCounter_GetFaultDetectionCounter_EvtInfo_Front_Left_Side_Radar_value_of_signal_protection_calcu_b7111bd7
        OpEventGetFaultDetectionCounter_GetFaultDetectionCounter_Event_Front_Left_Side_Radar_value_of_signal_protection_calcula_4e541a93: RteEventRef=OpEventGetFaultDetectionCounter_GetFaultDetectionCounter_Event_Front_Left_Side_Radar_value_of_signal_protection_calcula_4e541a93
        OpEventGetFaultDetectionCounter_GetFaultDetectionCounter_EvtInfo_AT_AMT_ETC2_erratic_communication_Erratic: RteEventRef=OpEventGetFaultDetectionCounter_GetFaultDetectionCounter_EvtInfo_AT_AMT_ETC2_erratic_communication_Erratic
        OpEventGetFaultDetectionCounter_GetFaultDetectionCounter_Event_AT_AMT_ETC2_erratic_communication_Erratic: RteEventRef=OpEventGetFaultDetectionCounter_GetFaultDetectionCounter_Event_AT_AMT_ETC2_erratic_communication_Erratic
        OpEventGetFaultDetectionCounter_GetFaultDetectionCounter_EvtInfo_VCAN_Communication_Bus_Off: RteEventRef=OpEventGetFaultDetectionCounter_GetFaultDetectionCounter_EvtInfo_VCAN_Communication_Bus_Off
        OpEventGetFaultDetectionCounter_GetFaultDetectionCounter_Event_VCAN_Communication_Bus_Off: RteEventRef=OpEventGetFaultDetectionCounter_GetFaultDetectionCounter_Event_VCAN_Communication_Bus_Off
        OpEventGetFaultDetectionCounter_GetFaultDetectionCounter_EvtInfo_VDC2_message_LongitudinalAcceleration_Invalid_Serial_D_9731926b: RteEventRef=OpEventGetFaultDetectionCounter_GetFaultDetectionCounter_EvtInfo_VDC2_message_LongitudinalAcceleration_Invalid_Serial_D_9731926b
        OpEventGetFaultDetectionCounter_GetFaultDetectionCounter_Event_VDC2_message_LongitudinalAcceleration_Invalid_Serial_Dat_8cdab466: RteEventRef=OpEventGetFaultDetectionCounter_GetFaultDetectionCounter_Event_VDC2_message_LongitudinalAcceleration_Invalid_Serial_Dat_8cdab466
        OpEventGetFaultDetectionCounter_GetFaultDetectionCounter_EvtInfo_Radar_MMIC_RFBIST_Component_Internal_Failure: RteEventRef=OpEventGetFaultDetectionCounter_GetFaultDetectionCounter_EvtInfo_Radar_MMIC_RFBIST_Component_Internal_Failure
        OpEventGetFaultDetectionCounter_GetFaultDetectionCounter_Event_Radar_MMIC_RFBIST_Component_Internal_Failure: RteEventRef=OpEventGetFaultDetectionCounter_GetFaultDetectionCounter_Event_Radar_MMIC_RFBIST_Component_Internal_Failure
        OpEventGetFaultDetectionCounter_GetFaultDetectionCounter_EvtInfo_Radar_Initial_Alignment_Missing_Calibration: RteEventRef=OpEventGetFaultDetectionCounter_GetFaultDetectionCounter_EvtInfo_Radar_Initial_Alignment_Missing_Calibration
        OpEventGetFaultDetectionCounter_GetFaultDetectionCounter_Event_Radar_Initial_Alignment_Missing_Calibration: RteEventRef=OpEventGetFaultDetectionCounter_GetFaultDetectionCounter_Event_Radar_Initial_Alignment_Missing_Calibration
        OpEventGetFaultDetectionCounter_GetFaultDetectionCounter_EvtInfo_Cluster_ECU_OEL_message_Missing_Message: RteEventRef=OpEventGetFaultDetectionCounter_GetFaultDetectionCounter_EvtInfo_Cluster_ECU_OEL_message_Missing_Message
        OpEventGetFaultDetectionCounter_GetFaultDetectionCounter_Event_Cluster_ECU_OEL_message_Missing_Message: RteEventRef=OpEventGetFaultDetectionCounter_GetFaultDetectionCounter_Event_Cluster_ECU_OEL_message_Missing_Message
        OpEventGetFaultDetectionCounter_GetFaultDetectionCounter_EvtInfo_AT_AMT_ECU_ETC2_03_message_Missing_Message: RteEventRef=OpEventGetFaultDetectionCounter_GetFaultDetectionCounter_EvtInfo_AT_AMT_ECU_ETC2_03_message_Missing_Message
        OpEventGetFaultDetectionCounter_GetFaultDetectionCounter_Event_AT_AMT_ECU_ETC2_03_message_Missing_Message: RteEventRef=OpEventGetFaultDetectionCounter_GetFaultDetectionCounter_Event_AT_AMT_ECU_ETC2_03_message_Missing_Message
        OpEventGetFaultDetectionCounter_GetFaultDetectionCounter_EvtInfo_ADAS_FN_STS_message_MOIS_FN_Switch_STS_Invalid_Serial_af6eb68e: RteEventRef=OpEventGetFaultDetectionCounter_GetFaultDetectionCounter_EvtInfo_ADAS_FN_STS_message_MOIS_FN_Switch_STS_Invalid_Serial_af6eb68e
        OpEventGetFaultDetectionCounter_GetFaultDetectionCounter_Event_ADAS_FN_STS_message_MOIS_FN_Switch_STS_Invalid_Serial_Da_d1c42115: RteEventRef=OpEventGetFaultDetectionCounter_GetFaultDetectionCounter_Event_ADAS_FN_STS_message_MOIS_FN_Switch_STS_Invalid_Serial_Da_d1c42115
        OpEventGetFaultDetectionCounter_GetFaultDetectionCounter_EvtInfo_Radar_Module_Over_Temperature: RteEventRef=OpEventGetFaultDetectionCounter_GetFaultDetectionCounter_EvtInfo_Radar_Module_Over_Temperature
        OpEventGetFaultDetectionCounter_GetFaultDetectionCounter_Event_Radar_Module_Over_Temperature: RteEventRef=OpEventGetFaultDetectionCounter_GetFaultDetectionCounter_Event_Radar_Module_Over_Temperature
        OpEventGetFaultDetectionCounter_GetFaultDetectionCounter_EvtInfo_PCAN_TimeSync_Missing_Message: RteEventRef=OpEventGetFaultDetectionCounter_GetFaultDetectionCounter_EvtInfo_PCAN_TimeSync_Missing_Message
        OpEventGetFaultDetectionCounter_GetFaultDetectionCounter_Event_PCAN_TimeSync_Missing_Message: RteEventRef=OpEventGetFaultDetectionCounter_GetFaultDetectionCounter_Event_PCAN_TimeSync_Missing_Message
        OpEventGetFaultDetectionCounter_GetFaultDetectionCounter_EvtInfo_Radar_Module_Watchdog_Failure: RteEventRef=OpEventGetFaultDetectionCounter_GetFaultDetectionCounter_EvtInfo_Radar_Module_Watchdog_Failure
        OpEventGetFaultDetectionCounter_GetFaultDetectionCounter_Event_Radar_Module_Watchdog_Failure: RteEventRef=OpEventGetFaultDetectionCounter_GetFaultDetectionCounter_Event_Radar_Module_Watchdog_Failure
        OpEventGetFaultDetectionCounter_GetFaultDetectionCounter_EvtInfo_SAS_ECU_SAS_message_Missing_Message: RteEventRef=OpEventGetFaultDetectionCounter_GetFaultDetectionCounter_EvtInfo_SAS_ECU_SAS_message_Missing_Message
        OpEventGetFaultDetectionCounter_GetFaultDetectionCounter_Event_SAS_ECU_SAS_message_Missing_Message: RteEventRef=OpEventGetFaultDetectionCounter_GetFaultDetectionCounter_Event_SAS_ECU_SAS_message_Missing_Message
        OpEventGetFaultDetectionCounter_GetFaultDetectionCounter_EvtInfo_ECU_NVM_Corruption_Program_memory_Failure: RteEventRef=OpEventGetFaultDetectionCounter_GetFaultDetectionCounter_EvtInfo_ECU_NVM_Corruption_Program_memory_Failure
        OpEventGetFaultDetectionCounter_GetFaultDetectionCounter_Event_ECU_NVM_Corruption_Program_memory_Failure: RteEventRef=OpEventGetFaultDetectionCounter_GetFaultDetectionCounter_Event_ECU_NVM_Corruption_Program_memory_Failure
        OpEventGetFaultDetectionCounter_GetFaultDetectionCounter_EvtInfo_Cluster_ECU_TD_message_Missing_Message: RteEventRef=OpEventGetFaultDetectionCounter_GetFaultDetectionCounter_EvtInfo_Cluster_ECU_TD_message_Missing_Message
        OpEventGetFaultDetectionCounter_GetFaultDetectionCounter_Event_Cluster_ECU_TD_message_Missing_Message: RteEventRef=OpEventGetFaultDetectionCounter_GetFaultDetectionCounter_Event_Cluster_ECU_TD_message_Missing_Message
        OpEventGetFaultDetectionCounter_GetFaultDetectionCounter_EvtInfo_PCAN_Communication_Bus_Off: RteEventRef=OpEventGetFaultDetectionCounter_GetFaultDetectionCounter_EvtInfo_PCAN_Communication_Bus_Off
        OpEventGetFaultDetectionCounter_GetFaultDetectionCounter_Event_PCAN_Communication_Bus_Off: RteEventRef=OpEventGetFaultDetectionCounter_GetFaultDetectionCounter_Event_PCAN_Communication_Bus_Off
        OpEventGetFaultDetectionCounter_GetFaultDetectionCounter_EvtInfo_Front_Left_Side_Radar_Missing_Message: RteEventRef=OpEventGetFaultDetectionCounter_GetFaultDetectionCounter_EvtInfo_Front_Left_Side_Radar_Missing_Message
        OpEventGetFaultDetectionCounter_GetFaultDetectionCounter_Event_Front_Left_Side_Radar_Missing_Message: RteEventRef=OpEventGetFaultDetectionCounter_GetFaultDetectionCounter_Event_Front_Left_Side_Radar_Missing_Message
        OpEventGetFaultDetectionCounter_GetFaultDetectionCounter_EvtInfo_Manual_ETC2_message_Transcurrent_gear_Invalid_Serial_D_0b49ba7f: RteEventRef=OpEventGetFaultDetectionCounter_GetFaultDetectionCounter_EvtInfo_Manual_ETC2_message_Transcurrent_gear_Invalid_Serial_D_0b49ba7f
        OpEventGetFaultDetectionCounter_GetFaultDetectionCounter_Event_Manual_ETC2_message_Transcurrent_gear_Invalid_Serial_Dat_10a29c72: RteEventRef=OpEventGetFaultDetectionCounter_GetFaultDetectionCounter_Event_Manual_ETC2_message_Transcurrent_gear_Invalid_Serial_Dat_10a29c72
        OpEventGetFaultDetectionCounter_GetFaultDetectionCounter_EvtInfo_SAS_ECU_erratic_communication_Erratic: RteEventRef=OpEventGetFaultDetectionCounter_GetFaultDetectionCounter_EvtInfo_SAS_ECU_erratic_communication_Erratic
        OpEventGetFaultDetectionCounter_GetFaultDetectionCounter_Event_SAS_ECU_erratic_communication_Erratic: RteEventRef=OpEventGetFaultDetectionCounter_GetFaultDetectionCounter_Event_SAS_ECU_erratic_communication_Erratic
        OpEventGetFaultDetectionCounter_GetFaultDetectionCounter_EvtInfo_VDC2_message_Yaw_rate_Invalid_Serial_Data_Received: RteEventRef=OpEventGetFaultDetectionCounter_GetFaultDetectionCounter_EvtInfo_VDC2_message_Yaw_rate_Invalid_Serial_Data_Received
        OpEventGetFaultDetectionCounter_GetFaultDetectionCounter_Event_VDC2_message_Yaw_rate_Invalid_Serial_Data_Received: RteEventRef=OpEventGetFaultDetectionCounter_GetFaultDetectionCounter_Event_VDC2_message_Yaw_rate_Invalid_Serial_Data_Received
        OpEventGetFaultDetectionCounter_GetFaultDetectionCounter_EvtInfo_Cluster_ECU_TD_erratic_communication_Erratic: RteEventRef=OpEventGetFaultDetectionCounter_GetFaultDetectionCounter_EvtInfo_Cluster_ECU_TD_erratic_communication_Erratic
        OpEventGetFaultDetectionCounter_GetFaultDetectionCounter_Event_Cluster_ECU_TD_erratic_communication_Erratic: RteEventRef=OpEventGetFaultDetectionCounter_GetFaultDetectionCounter_Event_Cluster_ECU_TD_erratic_communication_Erratic
        OpEventGetFaultDetectionCounter_GetFaultDetectionCounter_EvtInfo_EMS_ECU_CCVS1_message_Missing_Message: RteEventRef=OpEventGetFaultDetectionCounter_GetFaultDetectionCounter_EvtInfo_EMS_ECU_CCVS1_message_Missing_Message
        OpEventGetFaultDetectionCounter_GetFaultDetectionCounter_Event_EMS_ECU_CCVS1_message_Missing_Message: RteEventRef=OpEventGetFaultDetectionCounter_GetFaultDetectionCounter_Event_EMS_ECU_CCVS1_message_Missing_Message
        OpEventGetFaultDetectionCounter_GetFaultDetectionCounter_EvtInfo_Radar_Mounting_Orientation_Incorrect_Assembly: RteEventRef=OpEventGetFaultDetectionCounter_GetFaultDetectionCounter_EvtInfo_Radar_Mounting_Orientation_Incorrect_Assembly
        OpEventGetFaultDetectionCounter_GetFaultDetectionCounter_Event_Radar_Mounting_Orientation_Incorrect_Assembly: RteEventRef=OpEventGetFaultDetectionCounter_GetFaultDetectionCounter_Event_Radar_Mounting_Orientation_Incorrect_Assembly
        OpEventGetFaultDetectionCounter_GetFaultDetectionCounter_EvtInfo_EMS_ECU_ETC2_erratic_communication_Erractic: RteEventRef=OpEventGetFaultDetectionCounter_GetFaultDetectionCounter_EvtInfo_EMS_ECU_ETC2_erratic_communication_Erractic
        OpEventGetFaultDetectionCounter_GetFaultDetectionCounter_Event_EMS_ECU_ETC2_erratic_communication_Erractic: RteEventRef=OpEventGetFaultDetectionCounter_GetFaultDetectionCounter_Event_EMS_ECU_ETC2_erratic_communication_Erractic
        OpEventGetFaultDetectionCounter_GetFaultDetectionCounter_EvtInfo_Cluster_ECU_ADAS_FN_STS_erratic_communication_Erratic: RteEventRef=OpEventGetFaultDetectionCounter_GetFaultDetectionCounter_EvtInfo_Cluster_ECU_ADAS_FN_STS_erratic_communication_Erratic
        OpEventGetFaultDetectionCounter_GetFaultDetectionCounter_Event_Cluster_ECU_ADAS_FN_STS_erratic_communication_Erratic: RteEventRef=OpEventGetFaultDetectionCounter_GetFaultDetectionCounter_Event_Cluster_ECU_ADAS_FN_STS_erratic_communication_Erratic
        OpEventGetFaultDetectionCounter_GetFaultDetectionCounter_EvtInfo_ESC_ECU_VDC2_message_Missing_Message: RteEventRef=OpEventGetFaultDetectionCounter_GetFaultDetectionCounter_EvtInfo_ESC_ECU_VDC2_message_Missing_Message
        OpEventGetFaultDetectionCounter_GetFaultDetectionCounter_Event_ESC_ECU_VDC2_message_Missing_Message: RteEventRef=OpEventGetFaultDetectionCounter_GetFaultDetectionCounter_Event_ESC_ECU_VDC2_message_Missing_Message
        OpEventGetFaultDetectionCounter_GetFaultDetectionCounter_EvtInfo_CLS_TX_16_message_Transmission_Type_info_Invalid_Seria_9cf5fcaa: RteEventRef=OpEventGetFaultDetectionCounter_GetFaultDetectionCounter_EvtInfo_CLS_TX_16_message_Transmission_Type_info_Invalid_Seria_9cf5fcaa
        OpEventGetFaultDetectionCounter_GetFaultDetectionCounter_Event_CLS_TX_16_message_Transmission_Type_info_Invalid_Serial_602bd736: RteEventRef=OpEventGetFaultDetectionCounter_GetFaultDetectionCounter_Event_CLS_TX_16_message_Transmission_Type_info_Invalid_Serial_602bd736
        OpEventGetFaultDetectionCounter_GetFaultDetectionCounter_EvtInfo_Cluster_ECU_CLS_Tx_4_erratic_communication_Erratic: RteEventRef=OpEventGetFaultDetectionCounter_GetFaultDetectionCounter_EvtInfo_Cluster_ECU_CLS_Tx_4_erratic_communication_Erratic
        OpEventGetFaultDetectionCounter_GetFaultDetectionCounter_Event_Cluster_ECU_CLS_Tx_4_erratic_communication_Erratic: RteEventRef=OpEventGetFaultDetectionCounter_GetFaultDetectionCounter_Event_Cluster_ECU_CLS_Tx_4_erratic_communication_Erratic
        OpEventGetFaultDetectionCounter_GetFaultDetectionCounter_EvtInfo_Cluster_ECU_ADAS_FN_STS_message_Missing_Message: RteEventRef=OpEventGetFaultDetectionCounter_GetFaultDetectionCounter_EvtInfo_Cluster_ECU_ADAS_FN_STS_message_Missing_Message
        OpEventGetFaultDetectionCounter_GetFaultDetectionCounter_Event_Cluster_ECU_ADAS_FN_STS_message_Missing_Message: RteEventRef=OpEventGetFaultDetectionCounter_GetFaultDetectionCounter_Event_Cluster_ECU_ADAS_FN_STS_message_Missing_Message
        OpEventGetFaultDetectionCounter_GetFaultDetectionCounter_EvtInfo_Vehicle_Dataset_value_of_signal_protection_calculation_7f6e193d: RteEventRef=OpEventGetFaultDetectionCounter_GetFaultDetectionCounter_EvtInfo_Vehicle_Dataset_value_of_signal_protection_calculation_7f6e193d
        OpEventGetFaultDetectionCounter_GetFaultDetectionCounter_Event_Vehicle_Dataset_value_of_signal_protection_calculation_Incorrect: RteEventRef=OpEventGetFaultDetectionCounter_GetFaultDetectionCounter_Event_Vehicle_Dataset_value_of_signal_protection_calculation_Incorrect
        OpEventGetFaultDetectionCounter_GetFaultDetectionCounter_EvtInfo_Cluster_ECU_CLS_Tx_16_erratic_communication_Erratic: RteEventRef=OpEventGetFaultDetectionCounter_GetFaultDetectionCounter_EvtInfo_Cluster_ECU_CLS_Tx_16_erratic_communication_Erratic
        OpEventGetFaultDetectionCounter_GetFaultDetectionCounter_Event_Cluster_ECU_CLS_Tx_16_erratic_communication_Erratic: RteEventRef=OpEventGetFaultDetectionCounter_GetFaultDetectionCounter_Event_Cluster_ECU_CLS_Tx_16_erratic_communication_Erratic
        OpEventGetFaultDetectionCounter_GetFaultDetectionCounter_EvtInfo_Cluster_ECU_OEL_erratic_communication_Erratic: RteEventRef=OpEventGetFaultDetectionCounter_GetFaultDetectionCounter_EvtInfo_Cluster_ECU_OEL_erratic_communication_Erratic
        OpEventGetFaultDetectionCounter_GetFaultDetectionCounter_Event_Cluster_ECU_OEL_erratic_communication_Erratic: RteEventRef=OpEventGetFaultDetectionCounter_GetFaultDetectionCounter_Event_Cluster_ECU_OEL_erratic_communication_Erratic
        OpEventGetFaultDetectionCounter_GetFaultDetectionCounter_EvtInfo_Cluster_ECU_CLS_Tx_4_message_Missing_Message: RteEventRef=OpEventGetFaultDetectionCounter_GetFaultDetectionCounter_EvtInfo_Cluster_ECU_CLS_Tx_4_message_Missing_Message
        OpEventGetFaultDetectionCounter_GetFaultDetectionCounter_Event_Cluster_ECU_CLS_Tx_4_message_Missing_Message: RteEventRef=OpEventGetFaultDetectionCounter_GetFaultDetectionCounter_Event_Cluster_ECU_CLS_Tx_4_message_Missing_Message
        OpEventGetFaultDetectionCounter_GetFaultDetectionCounter_EvtInfo_Radar_Performance_Capability_Algorithm_Based_Failure: RteEventRef=OpEventGetFaultDetectionCounter_GetFaultDetectionCounter_EvtInfo_Radar_Performance_Capability_Algorithm_Based_Failure
        OpEventGetFaultDetectionCounter_GetFaultDetectionCounter_Event_Radar_Performance_Capability_Algorithm_Based_Failure: RteEventRef=OpEventGetFaultDetectionCounter_GetFaultDetectionCounter_Event_Radar_Performance_Capability_Algorithm_Based_Failure
        OpEventGetFaultDetectionCounter_GetFaultDetectionCounter_EvtInfo_Radar_AutoAlignment_Range_Alignment_or_Adjustement_Incorrect: RteEventRef=OpEventGetFaultDetectionCounter_GetFaultDetectionCounter_EvtInfo_Radar_AutoAlignment_Range_Alignment_or_Adjustement_Incorrect
        OpEventGetFaultDetectionCounter_GetFaultDetectionCounter_Event_Radar_AutoAlignment_Range_Alignment_or_Adjustement_Incorrect: RteEventRef=OpEventGetFaultDetectionCounter_GetFaultDetectionCounter_Event_Radar_AutoAlignment_Range_Alignment_or_Adjustement_Incorrect
        OpEventGetFaultDetectionCounter_GetFaultDetectionCounter_EvtInfo_EMS_ECU_CCVS1_erratic_communication_Erractic: RteEventRef=OpEventGetFaultDetectionCounter_GetFaultDetectionCounter_EvtInfo_EMS_ECU_CCVS1_erratic_communication_Erractic
        OpEventGetFaultDetectionCounter_GetFaultDetectionCounter_Event_EMS_ECU_CCVS1_erratic_communication_Erractic: RteEventRef=OpEventGetFaultDetectionCounter_GetFaultDetectionCounter_Event_EMS_ECU_CCVS1_erratic_communication_Erractic
        OpEventGetFaultDetectionCounter_GetFaultDetectionCounter_EvtInfo_Radar_System_Battery_Low_Voltage_System_Voltage_Low: RteEventRef=OpEventGetFaultDetectionCounter_GetFaultDetectionCounter_EvtInfo_Radar_System_Battery_Low_Voltage_System_Voltage_Low
        OpEventGetFaultDetectionCounter_GetFaultDetectionCounter_Event_Radar_System_Battery_Low_Voltage_System_Voltage_Low: RteEventRef=OpEventGetFaultDetectionCounter_GetFaultDetectionCounter_Event_Radar_System_Battery_Low_Voltage_System_Voltage_Low
        OpEventGetFaultDetectionCounter_GetFaultDetectionCounter_EvtInfo_Radar_SMC_General_Checksum_Failure: RteEventRef=OpEventGetFaultDetectionCounter_GetFaultDetectionCounter_EvtInfo_Radar_SMC_General_Checksum_Failure
        OpEventGetFaultDetectionCounter_GetFaultDetectionCounter_Event_Radar_SMC_General_Checksum_Failure: RteEventRef=OpEventGetFaultDetectionCounter_GetFaultDetectionCounter_Event_Radar_SMC_General_Checksum_Failure
        OpEventGetFaultDetectionCounter_GetFaultDetectionCounter_EvtInfo_Radar_Pin_Position_Wrong_Mounting_Position: RteEventRef=OpEventGetFaultDetectionCounter_GetFaultDetectionCounter_EvtInfo_Radar_Pin_Position_Wrong_Mounting_Position
        OpEventGetFaultDetectionCounter_GetFaultDetectionCounter_Event_Radar_Pin_Position_Wrong_Mounting_Position: RteEventRef=OpEventGetFaultDetectionCounter_GetFaultDetectionCounter_Event_Radar_Pin_Position_Wrong_Mounting_Position
        OpEventGetFaultDetectionCounter_GetFaultDetectionCounter_EvtInfo_VDC2_message_Lateral_Accleration_Invalid_Serial_Data_Received: RteEventRef=OpEventGetFaultDetectionCounter_GetFaultDetectionCounter_EvtInfo_VDC2_message_Lateral_Accleration_Invalid_Serial_Data_Received
        OpEventGetFaultDetectionCounter_GetFaultDetectionCounter_Event_VDC2_message_Lateral_Accleration_Invalid_Serial_Data_Received: RteEventRef=OpEventGetFaultDetectionCounter_GetFaultDetectionCounter_Event_VDC2_message_Lateral_Accleration_Invalid_Serial_Data_Received
        OpEventGetFaultDetectionCounter_GetFaultDetectionCounter_EvtInfo_ADAS_FN_STS_message_BSIS_FN_Switch_STS_Invalid_Serial_6afecf7d: RteEventRef=OpEventGetFaultDetectionCounter_GetFaultDetectionCounter_EvtInfo_ADAS_FN_STS_message_BSIS_FN_Switch_STS_Invalid_Serial_6afecf7d
        OpEventGetFaultDetectionCounter_GetFaultDetectionCounter_Event_ADAS_FN_STS_message_BSIS_FN_Switch_STS_Invalid_Serial_Da_145458e6: RteEventRef=OpEventGetFaultDetectionCounter_GetFaultDetectionCounter_Event_ADAS_FN_STS_message_BSIS_FN_Switch_STS_Invalid_Serial_Da_145458e6
        OpEventGetFaultDetectionCounter_GetFaultDetectionCounter_EvtInfo_Radar_AutoAlignment_Misalignment_Performance_or_Incorr_3ca767d4: RteEventRef=OpEventGetFaultDetectionCounter_GetFaultDetectionCounter_EvtInfo_Radar_AutoAlignment_Misalignment_Performance_or_Incorr_3ca767d4
        OpEventGetFaultDetectionCounter_GetFaultDetectionCounter_Event_Radar_AutoAlignment_Misalignment_Performance_or_Incorrec_420df04f: RteEventRef=OpEventGetFaultDetectionCounter_GetFaultDetectionCounter_Event_Radar_AutoAlignment_Misalignment_Performance_or_Incorrec_420df04f
        OpEventGetFaultDetectionCounter_GetFaultDetectionCounter_EvtInfo_ESC_ECU_VDC2_erratic_communication_Erratic: RteEventRef=OpEventGetFaultDetectionCounter_GetFaultDetectionCounter_EvtInfo_ESC_ECU_VDC2_erratic_communication_Erratic
        OpEventGetFaultDetectionCounter_GetFaultDetectionCounter_Event_ESC_ECU_VDC2_erratic_communication_Erratic: RteEventRef=OpEventGetFaultDetectionCounter_GetFaultDetectionCounter_Event_ESC_ECU_VDC2_erratic_communication_Erratic
        OpEventGetFaultDetectionCounter_GetFaultDetectionCounter_EvtInfo_Application_Interface_Lookup_Performance_or_Incorrect_Operation: RteEventRef=OpEventGetFaultDetectionCounter_GetFaultDetectionCounter_EvtInfo_Application_Interface_Lookup_Performance_or_Incorrect_Operation
        OpEventGetFaultDetectionCounter_GetFaultDetectionCounter_Event_Application_Interface_Lookup_Performance_or_Incorrect_Operation: RteEventRef=OpEventGetFaultDetectionCounter_GetFaultDetectionCounter_Event_Application_Interface_Lookup_Performance_or_Incorrect_Operation
        OpEventGetFaultDetectionCounter_GetFaultDetectionCounter_EvtInfo_EMS_ECU_VD_message_Missing_Message: RteEventRef=OpEventGetFaultDetectionCounter_GetFaultDetectionCounter_EvtInfo_EMS_ECU_VD_message_Missing_Message
        OpEventGetFaultDetectionCounter_GetFaultDetectionCounter_Event_EMS_ECU_VD_message_Missing_Message: RteEventRef=OpEventGetFaultDetectionCounter_GetFaultDetectionCounter_Event_EMS_ECU_VD_message_Missing_Message
        OpEventGetFaultDetectionCounter_GetFaultDetectionCounter_EvtInfo_Radar_Platform_Time_System_Programming_Failure: RteEventRef=OpEventGetFaultDetectionCounter_GetFaultDetectionCounter_EvtInfo_Radar_Platform_Time_System_Programming_Failure
        OpEventGetFaultDetectionCounter_GetFaultDetectionCounter_Event_Radar_Platform_Time_System_Programming_Failure: RteEventRef=OpEventGetFaultDetectionCounter_GetFaultDetectionCounter_Event_Radar_Platform_Time_System_Programming_Failure
        OpEventGetFaultDetectionCounter_GetFaultDetectionCounter_EvtInfo_OEL_message_Turn_Signal_Switch_Invalid_Serial_Data_Received: RteEventRef=OpEventGetFaultDetectionCounter_GetFaultDetectionCounter_EvtInfo_OEL_message_Turn_Signal_Switch_Invalid_Serial_Data_Received
        OpEventGetFaultDetectionCounter_GetFaultDetectionCounter_Event_OEL_message_Turn_Signal_Switch_Invalid_Serial_Data_Received: RteEventRef=OpEventGetFaultDetectionCounter_GetFaultDetectionCounter_Event_OEL_message_Turn_Signal_Switch_Invalid_Serial_Data_Received
        OpEventGetFaultDetectionCounter_GetFaultDetectionCounter_EvtInfo_Radar_calibration_Calibration_or_Paramater_Memory_Failure: RteEventRef=OpEventGetFaultDetectionCounter_GetFaultDetectionCounter_EvtInfo_Radar_calibration_Calibration_or_Paramater_Memory_Failure
        OpEventGetFaultDetectionCounter_GetFaultDetectionCounter_Event_Radar_calibration_Calibration_or_Paramater_Memory_Failure: RteEventRef=OpEventGetFaultDetectionCounter_GetFaultDetectionCounter_Event_Radar_calibration_Calibration_or_Paramater_Memory_Failure
        OpEventGetFaultDetectionCounter_GetFaultDetectionCounter_GeneralEvtInfo: RteEventRef=OpEventGetFaultDetectionCounter_GetFaultDetectionCounter_GeneralEvtInfo
        OpEventGetEventFreezeFrameDataEx_GetEventFreezeFrameDataEx_EvtInfo_SAS_message_Steering_Wheel_Angle_Invalid_Serial_Data_Received: RteEventRef=OpEventGetEventFreezeFrameDataEx_GetEventFreezeFrameDataEx_EvtInfo_SAS_message_Steering_Wheel_Angle_Invalid_Serial_Data_Received
        OpEventGetEventFreezeFrameDataEx_GetEventFreezeFrameDataEx_Event_SAS_message_Steering_Wheel_Angle_Invalid_Serial_Data_Received: RteEventRef=OpEventGetEventFreezeFrameDataEx_GetEventFreezeFrameDataEx_Event_SAS_message_Steering_Wheel_Angle_Invalid_Serial_Data_Received
        OpEventGetEventFreezeFrameDataEx_GetEventFreezeFrameDataEx_EvtInfo_AT_AMT_ETC2_message_Transcurrent_gear_Invalid_Serial_f330cc86: RteEventRef=OpEventGetEventFreezeFrameDataEx_GetEventFreezeFrameDataEx_EvtInfo_AT_AMT_ETC2_message_Transcurrent_gear_Invalid_Serial_f330cc86
        OpEventGetEventFreezeFrameDataEx_GetEventFreezeFrameDataEx_Event_AT_AMT_ETC2_message_Transcurrent_gear_Invalid_Serial_D_a4747041: RteEventRef=OpEventGetEventFreezeFrameDataEx_GetEventFreezeFrameDataEx_Event_AT_AMT_ETC2_message_Transcurrent_gear_Invalid_Serial_D_a4747041
