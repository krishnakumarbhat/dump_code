AUTOSAR XML (schema 00053)
package /ActiveEcuC
  module config Gpt: implementation-config-variant=VARIANT-PRE-COMPILE, module-description=Gpt_Impl
    GptChannelConfigSet
      5 x GptChannelConfiguration, all with GptChannelMode=GPT_CH_MODE_CONTINUOUS, GptChannelTickValueMax=4294967295, GptEnableWakeup=false, GptChannelClkSrcRef=GptClockReferencePoint:
        StbM_Local_Timer_Ch: GptChannelId=0, GptChannelTickFrequency=100000000, GptNotification=NULL_PTR, GptTimerPhysicalChannel=GPT_PHY_TMR_0
        Radar_Trigger_Timer_Ch: GptChannelId=1, GptChannelTickFrequency=100000000, GptNotification=Radar_Trigger_Timer_ISR, GptTimerPhysicalChannel=GPT_PHY_TMR_1
        Free_Running_Timer_Ch: GptChannelId=2, GptChannelTickFrequency=100000000, GptNotification=Free_Running_Timer_Notification, GptTimerPhysicalChannel=GPT_PHY_TMR_2
        PlatformTimer: GptChannelId=3, GptChannelTickFrequency=250000000, GptNotification=NULL_PTR, GptTimerPhysicalChannel=GPT_PHY_TMR_3
        RTM_Timer_Ch: GptChannelId=4, GptChannelTickFrequency=250000000, GptNotification=NULL_PTR, GptTimerPhysicalChannel=GPT_PHY_TMR_4
    GptConfigurationOfOptApiServices:
      GptDeinitApi = true
      GptEnableDisableNotificationApi = true
      GptTimeElapsedApi = true
      GptTimeRemainingApi = true
      GptVersionInfoApi = false
      GptWakeupFunctionalityApi = false
      GptEnableInitCheck = true
    GptDriverConfiguration:
      GptDevErrorDetect = false
      GptReportWakeupSource = false
      GptSafeBswChecks = false
      GptHardwareVariant = GPT_B0_HARDWARE_VARIANT
      GptPredefTimer100us32bitEnable = false
      GptPredefTimer1usEnablingGrade = GPT_PREDEF_TIMER_1US_DISABLED
      GptClockReferencePoint: GptClockReference=McuClockReferencePoint
