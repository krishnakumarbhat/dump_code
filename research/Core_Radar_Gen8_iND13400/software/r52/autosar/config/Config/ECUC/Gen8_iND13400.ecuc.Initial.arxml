[part 9 of 24: package /InitialEcuC]
AUTOSAR XML (schema 00053)
package /InitialEcuC  (continued)
  module config Com  (continued)
    ComConfig  (continued)
      242 x ComSignalGroup, all with ComTransferProperty=PENDING:  (continued)
        SG_Detections_153_156_oRDR_DETECTION_153_156_oPCAN_RADAR_2db98fbc_Tx: ComSystemTemplateSignalGroupRef=SG_Detections_153_156
          83 x ComGroupSignal, all with ComSignalEndianness=LITTLE_ENDIAN, ComTransferProperty=PENDING:
            DET_AZIMUTH_153_oRDR_DETECTION_153_156_oPCAN_RADAR_ec06a7d8_Tx: ComBitPosition=88, ComBitSize=13, ComSignalInitValue=0, ComSignalType=UINT16, ComSystemTemplateSystemSignalRef=DET_AZIMUTH_153
            DET_AZIMUTH_154_oRDR_DETECTION_153_156_oPCAN_RADAR_b0b684b1_Tx: ComBitPosition=200, ComBitSize=13, ComSignalInitValue=0, ComSignalType=UINT16, ComSystemTemplateSystemSignalRef=DET_AZIMUTH_154
            DET_AZIMUTH_155_oRDR_DETECTION_153_156_oPCAN_RADAR_25c65024_Tx: ComBitPosition=312, ComBitSize=13, ComSignalInitValue=0, ComSignalType=UINT16, ComSystemTemplateSystemSignalRef=DET_AZIMUTH_155
            DET_AZIMUTH_156_oRDR_DETECTION_153_156_oPCAN_RADAR_41262bda_Tx: ComBitPosition=424, ComBitSize=13, ComSignalInitValue=0, ComSignalType=UINT16, ComSystemTemplateSystemSignalRef=DET_AZIMUTH_156
            DET_AZIMUTH_ERR_153_oRDR_DETECTION_153_156_oPCAN_RADAR_48b3322d_Tx: ComBitPosition=105, ComBitSize=7, ComSignalInitValue=0, ComSignalType=UINT8, ComSystemTemplateSystemSignalRef=DET_AZIMUTH_ERR_153
            DET_AZIMUTH_ERR_154_oRDR_DETECTION_153_156_oPCAN_RADAR_14031144_Tx: ComBitPosition=217, ComBitSize=7, ComSignalInitValue=0, ComSignalType=UINT8, ComSystemTemplateSystemSignalRef=DET_AZIMUTH_ERR_154
            DET_AZIMUTH_ERR_155_oRDR_DETECTION_153_156_oPCAN_RADAR_8173c5d1_Tx: ComBitPosition=329, ComBitSize=7, ComSignalInitValue=0, ComSignalType=UINT8, ComSystemTemplateSystemSignalRef=DET_AZIMUTH_ERR_155
            DET_AZIMUTH_ERR_156_oRDR_DETECTION_153_156_oPCAN_RADAR_e593be2f_Tx: ComBitPosition=441, ComBitSize=7, ComSignalInitValue=0, ComSignalType=UINT8, ComSystemTemplateSystemSignalRef=DET_AZIMUTH_ERR_156
            DET_BELOW_RAIN_THOLD_153_oRDR_DETECTION_153_156_oPCAN_RADAR_39073418_Tx: ComBitPosition=39, ComBitSize=1, ComSignalInitValue=0, ComSignalType=BOOLEAN, ComSystemTemplateSystemSignalRef=DET_BELOW_RAIN_THOLD_153
            DET_BELOW_RAIN_THOLD_154_oRDR_DETECTION_153_156_oPCAN_RADAR_65b71771_Tx: ComBitPosition=151, ComBitSize=1, ComSignalInitValue=0, ComSignalType=BOOLEAN, ComSystemTemplateSystemSignalRef=DET_BELOW_RAIN_THOLD_154
            DET_BELOW_RAIN_THOLD_155_oRDR_DETECTION_153_156_oPCAN_RADAR_f0c7c3e4_Tx: ComBitPosition=263, ComBitSize=1, ComSignalInitValue=0, ComSignalType=BOOLEAN, ComSystemTemplateSystemSignalRef=DET_BELOW_RAIN_THOLD_155
            DET_BELOW_RAIN_THOLD_156_oRDR_DETECTION_153_156_oPCAN_RADAR_9427b81a_Tx: ComBitPosition=375, ComBitSize=1, ComSignalInitValue=0, ComSignalType=BOOLEAN, ComSystemTemplateSystemSignalRef=DET_BELOW_RAIN_THOLD_156
            DET_BI_STATIC_FLAG_153_oRDR_DETECTION_153_156_oPCAN_RADAR_ba2ae75d_Tx: ComBitPosition=104, ComBitSize=1, ComSignalInitValue=0, ComSignalType=BOOLEAN, ComSystemTemplateSystemSignalRef=DET_BI_STATIC_FLAG_153
            DET_BI_STATIC_FLAG_154_oRDR_DETECTION_153_156_oPCAN_RADAR_e69ac434_Tx: ComBitPosition=216, ComBitSize=1, ComSignalInitValue=0, ComSignalType=BOOLEAN, ComSystemTemplateSystemSignalRef=DET_BI_STATIC_FLAG_154
            DET_BI_STATIC_FLAG_155_oRDR_DETECTION_153_156_oPCAN_RADAR_73ea10a1_Tx: ComBitPosition=328, ComBitSize=1, ComSignalInitValue=0, ComSignalType=BOOLEAN, ComSystemTemplateSystemSignalRef=DET_BI_STATIC_FLAG_155
            DET_BI_STATIC_FLAG_156_oRDR_DETECTION_153_156_oPCAN_RADAR_170a6b5f_Tx: ComBitPosition=440, ComBitSize=1, ComSignalInitValue=0, ComSignalType=BOOLEAN, ComSystemTemplateSystemSignalRef=DET_BI_STATIC_FLAG_156
            DET_CONFD_AZIMUTH_153_oRDR_DETECTION_153_156_oPCAN_RADAR_eee0ad12_Tx: ComBitPosition=118, ComBitSize=2, ComSignalInitValue=0, ComSignalType=UINT8, ComSystemTemplateSystemSignalRef=DET_CONFD_AZIMUTH_153
            DET_CONFD_AZIMUTH_154_oRDR_DETECTION_153_156_oPCAN_RADAR_b2508e7b_Tx: ComBitPosition=230, ComBitSize=2, ComSignalInitValue=0, ComSignalType=UINT8, ComSystemTemplateSystemSignalRef=DET_CONFD_AZIMUTH_154
            DET_CONFD_AZIMUTH_155_oRDR_DETECTION_153_156_oPCAN_RADAR_27205aee_Tx: ComBitPosition=342, ComBitSize=2, ComSignalInitValue=0, ComSignalType=UINT8, ComSystemTemplateSystemSignalRef=DET_CONFD_AZIMUTH_155
            DET_CONFD_AZIMUTH_156_oRDR_DETECTION_153_156_oPCAN_RADAR_43c02110_Tx: ComBitPosition=454, ComBitSize=2, ComSignalInitValue=0, ComSignalType=UINT8, ComSystemTemplateSystemSignalRef=DET_CONFD_AZIMUTH_156
            DET_CONFD_ELEVATION_153_oRDR_DETECTION_153_156_oPCAN_RADAR_ec75ace8_Tx: ComBitPosition=101, ComBitSize=2, ComSignalInitValue=0, ComSignalType=UINT8, ComSystemTemplateSystemSignalRef=DET_CONFD_ELEVATION_153
            DET_CONFD_ELEVATION_154_oRDR_DETECTION_153_156_oPCAN_RADAR_b0c58f81_Tx: ComBitPosition=213, ComBitSize=2, ComSignalInitValue=0, ComSignalType=UINT8, ComSystemTemplateSystemSignalRef=DET_CONFD_ELEVATION_154
            DET_CONFD_ELEVATION_155_oRDR_DETECTION_153_156_oPCAN_RADAR_25b55b14_Tx: ComBitPosition=325, ComBitSize=2, ComSignalInitValue=0, ComSignalType=UINT8, ComSystemTemplateSystemSignalRef=DET_CONFD_ELEVATION_155
            DET_CONFD_ELEVATION_156_oRDR_DETECTION_153_156_oPCAN_RADAR_415520ea_Tx: ComBitPosition=437, ComBitSize=2, ComSignalInitValue=0, ComSignalType=UINT8, ComSystemTemplateSystemSignalRef=DET_CONFD_ELEVATION_156
            DET_ELEVATION_153_oRDR_DETECTION_153_156_oPCAN_RADAR_3db578d4_Tx: ComBitPosition=72, ComBitSize=8, ComSignalInitValue=0, ComSignalType=UINT8, ComSystemTemplateSystemSignalRef=DET_ELEVATION_153
            DET_ELEVATION_154_oRDR_DETECTION_153_156_oPCAN_RADAR_61055bbd_Tx: ComBitPosition=184, ComBitSize=8, ComSignalInitValue=0, ComSignalType=UINT8, ComSystemTemplateSystemSignalRef=DET_ELEVATION_154
            DET_ELEVATION_155_oRDR_DETECTION_153_156_oPCAN_RADAR_f4758f28_Tx: ComBitPosition=296, ComBitSize=8, ComSignalInitValue=0, ComSignalType=UINT8, ComSystemTemplateSystemSignalRef=DET_ELEVATION_155
            DET_ELEVATION_156_oRDR_DETECTION_153_156_oPCAN_RADAR_9095f4d6_Tx: ComBitPosition=408, ComBitSize=8, ComSignalInitValue=0, ComSignalType=UINT8, ComSystemTemplateSystemSignalRef=DET_ELEVATION_156
            DET_ELEVATION_ERR_153_oRDR_DETECTION_153_156_oPCAN_RADAR_ba8ce0a1_Tx: ComBitPosition=80, ComBitSize=6, ComSignalInitValue=0, ComSignalType=UINT8, ComSystemTemplateSystemSignalRef=DET_ELEVATION_ERR_153
            DET_ELEVATION_ERR_154_oRDR_DETECTION_153_156_oPCAN_RADAR_e63cc3c8_Tx: ComBitPosition=192, ComBitSize=6, ComSignalInitValue=0, ComSignalType=UINT8, ComSystemTemplateSystemSignalRef=DET_ELEVATION_ERR_154
            DET_ELEVATION_ERR_155_oRDR_DETECTION_153_156_oPCAN_RADAR_734c175d_Tx: ComBitPosition=304, ComBitSize=6, ComSignalInitValue=0, ComSignalType=UINT8, ComSystemTemplateSystemSignalRef=DET_ELEVATION_ERR_155
            DET_ELEVATION_ERR_156_oRDR_DETECTION_153_156_oPCAN_RADAR_17ac6ca3_Tx: ComBitPosition=416, ComBitSize=6, ComSignalInitValue=0, ComSignalType=UINT8, ComSystemTemplateSystemSignalRef=DET_ELEVATION_ERR_156
            DET_EXISTENCE_PROB_153_oRDR_DETECTION_153_156_oPCAN_RADAR_681395c1_Tx: ComBitPosition=112, ComBitSize=6, ComSignalInitValue=0, ComSignalType=UINT8, ComSystemTemplateSystemSignalRef=DET_EXISTENCE_PROB_153
            DET_EXISTENCE_PROB_154_oRDR_DETECTION_153_156_oPCAN_RADAR_34a3b6a8_Tx: ComBitPosition=224, ComBitSize=6, ComSignalInitValue=0, ComSignalType=UINT8, ComSystemTemplateSystemSignalRef=DET_EXISTENCE_PROB_154
            DET_EXISTENCE_PROB_155_oRDR_DETECTION_153_156_oPCAN_RADAR_a1d3623d_Tx: ComBitPosition=336, ComBitSize=6, ComSignalInitValue=0, ComSignalType=UINT8, ComSystemTemplateSystemSignalRef=DET_EXISTENCE_PROB_155
            DET_EXISTENCE_PROB_156_oRDR_DETECTION_153_156_oPCAN_RADAR_c53319c3_Tx: ComBitPosition=448, ComBitSize=6, ComSignalInitValue=0, ComSignalType=UINT8, ComSystemTemplateSystemSignalRef=DET_EXISTENCE_PROB_156
            DET_HVC_FLAG_153_oRDR_DETECTION_153_156_oPCAN_RADAR_8967d6be_Tx: ComBitPosition=86, ComBitSize=1, ComSignalInitValue=0, ComSignalType=BOOLEAN, ComSystemTemplateSystemSignalRef=DET_HVC_FLAG_153
            DET_HVC_FLAG_154_oRDR_DETECTION_153_156_oPCAN_RADAR_d5d7f5d7_Tx: ComBitPosition=198, ComBitSize=1, ComSignalInitValue=0, ComSignalType=BOOLEAN, ComSystemTemplateSystemSignalRef=DET_HVC_FLAG_154
            DET_HVC_FLAG_155_oRDR_DETECTION_153_156_oPCAN_RADAR_40a72142_Tx: ComBitPosition=310, ComBitSize=1, ComSignalInitValue=0, ComSignalType=BOOLEAN, ComSystemTemplateSystemSignalRef=DET_HVC_FLAG_155
            DET_HVC_FLAG_156_oRDR_DETECTION_153_156_oPCAN_RADAR_24475abc_Tx: ComBitPosition=422, ComBitSize=1, ComSignalInitValue=0, ComSignalType=BOOLEAN, ComSystemTemplateSystemSignalRef=DET_HVC_FLAG_156
            DET_IDM_153_oRDR_DETECTION_153_156_oPCAN_RADAR_0235ed03_Tx: ComBitPosition=63, ComBitSize=1, ComSignalInitValue=0, ComSignalType=BOOLEAN, ComSystemTemplateSystemSignalRef=DET_IDM_153
            DET_IDM_154_oRDR_DETECTION_153_156_oPCAN_RADAR_5e85ce6a_Tx: ComBitPosition=175, ComBitSize=1, ComSignalInitValue=0, ComSignalType=BOOLEAN, ComSystemTemplateSystemSignalRef=DET_IDM_154
            DET_IDM_155_oRDR_DETECTION_153_156_oPCAN_RADAR_cbf51aff_Tx: ComBitPosition=287, ComBitSize=1, ComSignalInitValue=0, ComSignalType=BOOLEAN, ComSystemTemplateSystemSignalRef=DET_IDM_155
            DET_IDM_156_oRDR_DETECTION_153_156_oPCAN_RADAR_af156101_Tx: ComBitPosition=399, ComBitSize=1, ComSignalInitValue=0, ComSignalType=BOOLEAN, ComSystemTemplateSystemSignalRef=DET_IDM_156
            DET_MH_CRC16_153_156_oRDR_DETECTION_153_156_oPCAN_RADAR_a9315db7_Tx: ComBitPosition=0, ComBitSize=16, ComSignalInitValue=0, ComSignalType=UINT16, ComSystemTemplateSystemSignalRef=DET_MH_CRC16_153_156
            DET_MH_CYCLE_COUNTER_153_156_oRDR_DETECTION_153_156_oPCAN_RADAR_2d44fc80_Tx: ComBitPosition=16, ComBitSize=8, ComSignalInitValue=0, ComSignalType=UINT8, ComSystemTemplateSystemSignalRef=DET_MH_CYCLE_COUNTER_153_156
            DET_MH_SCAN_INDEX_4LSB_153_156_oRDR_DETECTION_153_156_oPCAN_RADAR_e16ed90c_Tx: ComBitPosition=476, ComBitSize=4, ComSignalInitValue=0, ComSignalType=UINT8, ComSystemTemplateSystemSignalRef=DET_MH_SCAN_INDEX_4LSB_153_156
            DET_MTD_153_oRDR_DETECTION_153_156_oPCAN_RADAR_6486dfd8_Tx: ComBitPosition=47, ComBitSize=1, ComSignalInitValue=0, ComSignalType=BOOLEAN, ComSystemTemplateSystemSignalRef=DET_MTD_153
            DET_MTD_154_oRDR_DETECTION_153_156_oPCAN_RADAR_3836fcb1_Tx: ComBitPosition=159, ComBitSize=1, ComSignalInitValue=0, ComSignalType=BOOLEAN, ComSystemTemplateSystemSignalRef=DET_MTD_154
            DET_MTD_155_oRDR_DETECTION_153_156_oPCAN_RADAR_ad462824_Tx: ComBitPosition=271, ComBitSize=1, ComSignalInitValue=0, ComSignalType=BOOLEAN, ComSystemTemplateSystemSignalRef=DET_MTD_155
            DET_MTD_156_oRDR_DETECTION_153_156_oPCAN_RADAR_c9a653da_Tx: ComBitPosition=383, ComBitSize=1, ComSignalInitValue=0, ComSignalType=BOOLEAN, ComSystemTemplateSystemSignalRef=DET_MTD_156
            DET_PROB_1STAZHYPO_153_oRDR_DETECTION_153_156_oPCAN_RADAR_f7323715_Tx: ComBitPosition=103, ComBitSize=1, ComSignalInitValue=0, ComSignalType=BOOLEAN, ComSystemTemplateSystemSignalRef=DET_PROB_1STAZHYPO_153
            DET_PROB_1STAZHYPO_154_oRDR_DETECTION_153_156_oPCAN_RADAR_ab82147c_Tx: ComBitPosition=215, ComBitSize=1, ComSignalInitValue=0, ComSignalType=BOOLEAN, ComSystemTemplateSystemSignalRef=DET_PROB_1STAZHYPO_154
            DET_PROB_1STAZHYPO_155_oRDR_DETECTION_153_156_oPCAN_RADAR_3ef2c0e9_Tx: ComBitPosition=327, ComBitSize=1, ComSignalInitValue=0, ComSignalType=BOOLEAN, ComSystemTemplateSystemSignalRef=DET_PROB_1STAZHYPO_155
            DET_PROB_1STAZHYPO_156_oRDR_DETECTION_153_156_oPCAN_RADAR_5a12bb17_Tx: ComBitPosition=439, ComBitSize=1, ComSignalInitValue=0, ComSignalType=BOOLEAN, ComSystemTemplateSystemSignalRef=DET_PROB_1STAZHYPO_156
            DET_RANGE_153_oRDR_DETECTION_153_156_oPCAN_RADAR_fc9dd463_Tx: ComBitPosition=24, ComBitSize=15, ComSignalInitValue=0, ComSignalType=UINT16, ComSystemTemplateSystemSignalRef=DET_RANGE_153
            DET_RANGE_154_oRDR_DETECTION_153_156_oPCAN_RADAR_a02df70a_Tx: ComBitPosition=136, ComBitSize=15, ComSignalInitValue=0, ComSignalType=UINT16, ComSystemTemplateSystemSignalRef=DET_RANGE_154
            DET_RANGE_155_oRDR_DETECTION_153_156_oPCAN_RADAR_355d239f_Tx: ComBitPosition=248, ComBitSize=15, ComSignalInitValue=0, ComSignalType=UINT16, ComSystemTemplateSystemSignalRef=DET_RANGE_155
            DET_RANGE_156_oRDR_DETECTION_153_156_oPCAN_RADAR_51bd5861_Tx: ComBitPosition=360, ComBitSize=15, ComSignalInitValue=0, ComSignalType=UINT16, ComSystemTemplateSystemSignalRef=DET_RANGE_156
            DET_RANGE_ERR_153_oRDR_DETECTION_153_156_oPCAN_RADAR_5b756e0a_Tx: ComBitPosition=40, ComBitSize=7, ComSignalInitValue=0, ComSignalType=UINT8, ComSystemTemplateSystemSignalRef=DET_RANGE_ERR_153
            DET_RANGE_ERR_154_oRDR_DETECTION_153_156_oPCAN_RADAR_07c54d63_Tx: ComBitPosition=152, ComBitSize=7, ComSignalInitValue=0, ComSignalType=UINT8, ComSystemTemplateSystemSignalRef=DET_RANGE_ERR_154
            DET_RANGE_ERR_155_oRDR_DETECTION_153_156_oPCAN_RADAR_92b599f6_Tx: ComBitPosition=264, ComBitSize=7, ComSignalInitValue=0, ComSignalType=UINT8, ComSystemTemplateSystemSignalRef=DET_RANGE_ERR_155
            DET_RANGE_ERR_156_oRDR_DETECTION_153_156_oPCAN_RADAR_f655e208_Tx: ComBitPosition=376, ComBitSize=7, ComSignalInitValue=0, ComSignalType=UINT8, ComSystemTemplateSystemSignalRef=DET_RANGE_ERR_156
            DET_RANGE_VELOCITY_153_oRDR_DETECTION_153_156_oPCAN_RADAR_893b1646_Tx: ComBitPosition=48, ComBitSize=15, ComSignalInitValue=16384, ComSignalType=UINT16, ComSystemTemplateSystemSignalRef=DET_RANGE_VELOCITY_153
            DET_RANGE_VELOCITY_154_oRDR_DETECTION_153_156_oPCAN_RADAR_d58b352f_Tx: ComBitPosition=160, ComBitSize=15, ComSignalInitValue=16384, ComSignalType=UINT16, ComSystemTemplateSystemSignalRef=DET_RANGE_VELOCITY_154
            DET_RANGE_VELOCITY_155_oRDR_DETECTION_153_156_oPCAN_RADAR_40fbe1ba_Tx: ComBitPosition=272, ComBitSize=15, ComSignalInitValue=16384, ComSignalType=UINT16, ComSystemTemplateSystemSignalRef=DET_RANGE_VELOCITY_155
            DET_RANGE_VELOCITY_156_oRDR_DETECTION_153_156_oPCAN_RADAR_241b9a44_Tx: ComBitPosition=384, ComBitSize=15, ComSignalInitValue=16384, ComSignalType=UINT16, ComSystemTemplateSystemSignalRef=DET_RANGE_VELOCITY_156
            DET_RANGE_VELOCITY_ERR_153_oRDR_DETECTION_153_156_oPCAN_RADAR_8680edf4_Tx: ComBitPosition=64, ComBitSize=8, ComSignalInitValue=0, ComSignalType=UINT8, ComSystemTemplateSystemSignalRef=DET_RANGE_VELOCITY_ERR_153
            DET_RANGE_VELOCITY_ERR_154_oRDR_DETECTION_153_156_oPCAN_RADAR_da30ce9d_Tx: ComBitPosition=176, ComBitSize=8, ComSignalInitValue=0, ComSignalType=UINT8, ComSystemTemplateSystemSignalRef=DET_RANGE_VELOCITY_ERR_154
            DET_RANGE_VELOCITY_ERR_155_oRDR_DETECTION_153_156_oPCAN_RADAR_4f401a08_Tx: ComBitPosition=288, ComBitSize=8, ComSignalInitValue=0, ComSignalType=UINT8, ComSystemTemplateSystemSignalRef=DET_RANGE_VELOCITY_ERR_155
            DET_RANGE_VELOCITY_ERR_156_oRDR_DETECTION_153_156_oPCAN_RADAR_2ba061f6_Tx: ComBitPosition=400, ComBitSize=8, ComSignalInitValue=0, ComSignalType=UINT8, ComSystemTemplateSystemSignalRef=DET_RANGE_VELOCITY_ERR_156
            DET_RCS_153_oRDR_DETECTION_153_156_oPCAN_RADAR_0ebb211c_Tx: ComBitPosition=128, ComBitSize=8, ComSignalInitValue=128, ComSignalType=UINT8, ComSystemTemplateSystemSignalRef=DET_RCS_153
            DET_RCS_154_oRDR_DETECTION_153_156_oPCAN_RADAR_520b0275_Tx: ComBitPosition=240, ComBitSize=8, ComSignalInitValue=128, ComSignalType=UINT8, ComSystemTemplateSystemSignalRef=DET_RCS_154
            DET_RCS_155_oRDR_DETECTION_153_156_oPCAN_RADAR_c77bd6e0_Tx: ComBitPosition=352, ComBitSize=8, ComSignalInitValue=128, ComSignalType=UINT8, ComSystemTemplateSystemSignalRef=DET_RCS_155
            DET_RCS_156_oRDR_DETECTION_153_156_oPCAN_RADAR_a39bad1e_Tx: ComBitPosition=464, ComBitSize=8, ComSignalInitValue=128, ComSignalType=UINT8, ComSystemTemplateSystemSignalRef=DET_RCS_156
            DET_SNR_153_oRDR_DETECTION_153_156_oPCAN_RADAR_d315751e_Tx: ComBitPosition=120, ComBitSize=8, ComSignalInitValue=0, ComSignalType=UINT8, ComSystemTemplateSystemSignalRef=DET_SNR_153
            DET_SNR_154_oRDR_DETECTION_153_156_oPCAN_RADAR_8fa55677_Tx: ComBitPosition=232, ComBitSize=8, ComSignalInitValue=0, ComSignalType=UINT8, ComSystemTemplateSystemSignalRef=DET_SNR_154
            DET_SNR_155_oRDR_DETECTION_153_156_oPCAN_RADAR_1ad582e2_Tx: ComBitPosition=344, ComBitSize=8, ComSignalInitValue=0, ComSignalType=UINT8, ComSystemTemplateSystemSignalRef=DET_SNR_155
            DET_SNR_156_oRDR_DETECTION_153_156_oPCAN_RADAR_7e35f91c_Tx: ComBitPosition=456, ComBitSize=8, ComSignalInitValue=0, ComSignalType=UINT8, ComSystemTemplateSystemSignalRef=DET_SNR_156
            DET_SUPER_RES_TARGET_153_oRDR_DETECTION_153_156_oPCAN_RADAR_e28c5d7b_Tx: ComBitPosition=87, ComBitSize=1, ComSignalInitValue=0, ComSignalType=BOOLEAN, ComSystemTemplateSystemSignalRef=DET_SUPER_RES_TARGET_153
            DET_SUPER_RES_TARGET_154_oRDR_DETECTION_153_156_oPCAN_RADAR_be3c7e12_Tx: ComBitPosition=199, ComBitSize=1, ComSignalInitValue=0, ComSignalType=BOOLEAN, ComSystemTemplateSystemSignalRef=DET_SUPER_RES_TARGET_154
            DET_SUPER_RES_TARGET_155_oRDR_DETECTION_153_156_oPCAN_RADAR_2b4caa87_Tx: ComBitPosition=311, ComBitSize=1, ComSignalInitValue=0, ComSignalType=BOOLEAN, ComSystemTemplateSystemSignalRef=DET_SUPER_RES_TARGET_155
            DET_SUPER_RES_TARGET_156_oRDR_DETECTION_153_156_oPCAN_RADAR_4facd179_Tx: ComBitPosition=423, ComBitSize=1, ComSignalInitValue=0, ComSignalType=BOOLEAN, ComSystemTemplateSystemSignalRef=DET_SUPER_RES_TARGET_156
        SG_Detections_157_160_oRDR_DETECTION_157_160_oPCAN_RADAR_c115d936_Tx: ComSystemTemplateSignalGroupRef=SG_Detections_157_160
          83 x ComGroupSignal, all with ComSignalEndianness=LITTLE_ENDIAN, ComTransferProperty=PENDING:
            DET_AZIMUTH_157_oRDR_DETECTION_157_160_oPCAN_RADAR_7bda2286_Tx: ComBitPosition=88, ComBitSize=13, ComSignalInitValue=0, ComSignalType=UINT16, ComSystemTemplateSystemSignalRef=DET_AZIMUTH_157
            DET_AZIMUTH_158_oRDR_DETECTION_157_160_oPCAN_RADAR_57cab0c1_Tx: ComBitPosition=200, ComBitSize=13, ComSignalInitValue=0, ComSignalType=UINT16, ComSystemTemplateSystemSignalRef=DET_AZIMUTH_158
            DET_AZIMUTH_159_oRDR_DETECTION_157_160_oPCAN_RADAR_c2ba6454_Tx: ComBitPosition=312, ComBitSize=13, ComSignalInitValue=0, ComSignalType=UINT16, ComSystemTemplateSystemSignalRef=DET_AZIMUTH_159
            DET_AZIMUTH_160_oRDR_DETECTION_157_160_oPCAN_RADAR_7d0b3e8f_Tx: ComBitPosition=424, ComBitSize=13, ComSignalInitValue=0, ComSignalType=UINT16, ComSystemTemplateSystemSignalRef=DET_AZIMUTH_160
            DET_AZIMUTH_ERR_157_oRDR_DETECTION_157_160_oPCAN_RADAR_df6fb773_Tx: ComBitPosition=105, ComBitSize=7, ComSignalInitValue=0, ComSignalType=UINT8, ComSystemTemplateSystemSignalRef=DET_AZIMUTH_ERR_157
            DET_AZIMUTH_ERR_158_oRDR_DETECTION_157_160_oPCAN_RADAR_f37f2534_Tx: ComBitPosition=217, ComBitSize=7, ComSignalInitValue=0, ComSignalType=UINT8, ComSystemTemplateSystemSignalRef=DET_AZIMUTH_ERR_158
            DET_AZIMUTH_ERR_159_oRDR_DETECTION_157_160_oPCAN_RADAR_660ff1a1_Tx: ComBitPosition=329, ComBitSize=7, ComSignalInitValue=0, ComSignalType=UINT8, ComSystemTemplateSystemSignalRef=DET_AZIMUTH_ERR_159
            DET_AZIMUTH_ERR_160_oRDR_DETECTION_157_160_oPCAN_RADAR_d9beab7a_Tx: ComBitPosition=441, ComBitSize=7, ComSignalInitValue=0, ComSignalType=UINT8, ComSystemTemplateSystemSignalRef=DET_AZIMUTH_ERR_160
            DET_BELOW_RAIN_THOLD_157_oRDR_DETECTION_157_160_oPCAN_RADAR_aedbb146_Tx: ComBitPosition=39, ComBitSize=1, ComSignalInitValue=0, ComSignalType=BOOLEAN, ComSystemTemplateSystemSignalRef=DET_BELOW_RAIN_THOLD_157
            DET_BELOW_RAIN_THOLD_158_oRDR_DETECTION_157_160_oPCAN_RADAR_82cb2301_Tx: ComBitPosition=151, ComBitSize=1, ComSignalInitValue=0, ComSignalType=BOOLEAN, ComSystemTemplateSystemSignalRef=DET_BELOW_RAIN_THOLD_158
            DET_BELOW_RAIN_THOLD_159_oRDR_DETECTION_157_160_oPCAN_RADAR_17bbf794_Tx: ComBitPosition=263, ComBitSize=1, ComSignalInitValue=0, ComSignalType=BOOLEAN, ComSystemTemplateSystemSignalRef=DET_BELOW_RAIN_THOLD_159
            DET_BELOW_RAIN_THOLD_160_oRDR_DETECTION_157_160_oPCAN_RADAR_a80aad4f_Tx: ComBitPosition=375, ComBitSize=1, ComSignalInitValue=0, ComSignalType=BOOLEAN, ComSystemTemplateSystemSignalRef=DET_BELOW_RAIN_THOLD_160
            DET_BI_STATIC_FLAG_157_oRDR_DETECTION_157_160_oPCAN_RADAR_2df66203_Tx: ComBitPosition=104, ComBitSize=1, ComSignalInitValue=0, ComSignalType=BOOLEAN, ComSystemTemplateSystemSignalRef=DET_BI_STATIC_FLAG_157
            DET_BI_STATIC_FLAG_158_oRDR_DETECTION_157_160_oPCAN_RADAR_01e6f044_Tx: ComBitPosition=216, ComBitSize=1, ComSignalInitValue=0, ComSignalType=BOOLEAN, ComSystemTemplateSystemSignalRef=DET_BI_STATIC_FLAG_158
            DET_BI_STATIC_FLAG_159_oRDR_DETECTION_157_160_oPCAN_RADAR_949624d1_Tx: ComBitPosition=328, ComBitSize=1, ComSignalInitValue=0, ComSignalType=BOOLEAN, ComSystemTemplateSystemSignalRef=DET_BI_STATIC_FLAG_159
            DET_BI_STATIC_FLAG_160_oRDR_DETECTION_157_160_oPCAN_RADAR_2b277e0a_Tx: ComBitPosition=440, ComBitSize=1, ComSignalInitValue=0, ComSignalType=BOOLEAN, ComSystemTemplateSystemSignalRef=DET_BI_STATIC_FLAG_160
            DET_CONFD_AZIMUTH_157_oRDR_DETECTION_157_160_oPCAN_RADAR_793c284c_Tx: ComBitPosition=118, ComBitSize=2, ComSignalInitValue=0, ComSignalType=UINT8, ComSystemTemplateSystemSignalRef=DET_CONFD_AZIMUTH_157
            DET_CONFD_AZIMUTH_158_oRDR_DETECTION_157_160_oPCAN_RADAR_552cba0b_Tx: ComBitPosition=230, ComBitSize=2, ComSignalInitValue=0, ComSignalType=UINT8, ComSystemTemplateSystemSignalRef=DET_CONFD_AZIMUTH_158
            DET_CONFD_AZIMUTH_159_oRDR_DETECTION_157_160_oPCAN_RADAR_c05c6e9e_Tx: ComBitPosition=342, ComBitSize=2, ComSignalInitValue=0, ComSignalType=UINT8, ComSystemTemplateSystemSignalRef=DET_CONFD_AZIMUTH_159
            DET_CONFD_AZIMUTH_160_oRDR_DETECTION_157_160_oPCAN_RADAR_7fed3445_Tx: ComBitPosition=454, ComBitSize=2, ComSignalInitValue=0, ComSignalType=UINT8, ComSystemTemplateSystemSignalRef=DET_CONFD_AZIMUTH_160
            DET_CONFD_ELEVATION_157_oRDR_DETECTION_157_160_oPCAN_RADAR_7ba929b6_Tx: ComBitPosition=101, ComBitSize=2, ComSignalInitValue=0, ComSignalType=UINT8, ComSystemTemplateSystemSignalRef=DET_CONFD_ELEVATION_157
            DET_CONFD_ELEVATION_158_oRDR_DETECTION_157_160_oPCAN_RADAR_57b9bbf1_Tx: ComBitPosition=213, ComBitSize=2, ComSignalInitValue=0, ComSignalType=UINT8, ComSystemTemplateSystemSignalRef=DET_CONFD_ELEVATION_158
            DET_CONFD_ELEVATION_159_oRDR_DETECTION_157_160_oPCAN_RADAR_c2c96f64_Tx: ComBitPosition=325, ComBitSize=2, ComSignalInitValue=0, ComSignalType=UINT8, ComSystemTemplateSystemSignalRef=DET_CONFD_ELEVATION_159
            DET_CONFD_ELEVATION_160_oRDR_DETECTION_157_160_oPCAN_RADAR_7d7835bf_Tx: ComBitPosition=437, ComBitSize=2, ComSignalInitValue=0, ComSignalType=UINT8, ComSystemTemplateSystemSignalRef=DET_CONFD_ELEVATION_160
            DET_ELEVATION_157_oRDR_DETECTION_157_160_oPCAN_RADAR_aa69fd8a_Tx: ComBitPosition=72, ComBitSize=8, ComSignalInitValue=0, ComSignalType=UINT8, ComSystemTemplateSystemSignalRef=DET_ELEVATION_157
            DET_ELEVATION_158_oRDR_DETECTION_157_160_oPCAN_RADAR_86796fcd_Tx: ComBitPosition=184, ComBitSize=8, ComSignalInitValue=0, ComSignalType=UINT8, ComSystemTemplateSystemSignalRef=DET_ELEVATION_158
            DET_ELEVATION_159_oRDR_DETECTION_157_160_oPCAN_RADAR_1309bb58_Tx: ComBitPosition=296, ComBitSize=8, ComSignalInitValue=0, ComSignalType=UINT8, ComSystemTemplateSystemSignalRef=DET_ELEVATION_159
            DET_ELEVATION_160_oRDR_DETECTION_157_160_oPCAN_RADAR_acb8e183_Tx: ComBitPosition=408, ComBitSize=8, ComSignalInitValue=0, ComSignalType=UINT8, ComSystemTemplateSystemSignalRef=DET_ELEVATION_160
            DET_ELEVATION_ERR_157_oRDR_DETECTION_157_160_oPCAN_RADAR_2d5065ff_Tx: ComBitPosition=80, ComBitSize=6, ComSignalInitValue=0, ComSignalType=UINT8, ComSystemTemplateSystemSignalRef=DET_ELEVATION_ERR_157
            DET_ELEVATION_ERR_158_oRDR_DETECTION_157_160_oPCAN_RADAR_0140f7b8_Tx: ComBitPosition=192, ComBitSize=6, ComSignalInitValue=0, ComSignalType=UINT8, ComSystemTemplateSystemSignalRef=DET_ELEVATION_ERR_158
            DET_ELEVATION_ERR_159_oRDR_DETECTION_157_160_oPCAN_RADAR_9430232d_Tx: ComBitPosition=304, ComBitSize=6, ComSignalInitValue=0, ComSignalType=UINT8, ComSystemTemplateSystemSignalRef=DET_ELEVATION_ERR_159
            DET_ELEVATION_ERR_160_oRDR_DETECTION_157_160_oPCAN_RADAR_2b8179f6_Tx: ComBitPosition=416, ComBitSize=6, ComSignalInitValue=0, ComSignalType=UINT8, ComSystemTemplateSystemSignalRef=DET_ELEVATION_ERR_160
            DET_EXISTENCE_PROB_157_oRDR_DETECTION_157_160_oPCAN_RADAR_ffcf109f_Tx: ComBitPosition=112, ComBitSize=6, ComSignalInitValue=0, ComSignalType=UINT8, ComSystemTemplateSystemSignalRef=DET_EXISTENCE_PROB_157
            DET_EXISTENCE_PROB_158_oRDR_DETECTION_157_160_oPCAN_RADAR_d3df82d8_Tx: ComBitPosition=224, ComBitSize=6, ComSignalInitValue=0, ComSignalType=UINT8, ComSystemTemplateSystemSignalRef=DET_EXISTENCE_PROB_158
            DET_EXISTENCE_PROB_159_oRDR_DETECTION_157_160_oPCAN_RADAR_46af564d_Tx: ComBitPosition=336, ComBitSize=6, ComSignalInitValue=0, ComSignalType=UINT8, ComSystemTemplateSystemSignalRef=DET_EXISTENCE_PROB_159
            DET_EXISTENCE_PROB_160_oRDR_DETECTION_157_160_oPCAN_RADAR_f91e0c96_Tx: ComBitPosition=448, ComBitSize=6, ComSignalInitValue=0, ComSignalType=UINT8, ComSystemTemplateSystemSignalRef=DET_EXISTENCE_PROB_160
            DET_HVC_FLAG_157_oRDR_DETECTION_157_160_oPCAN_RADAR_1ebb53e0_Tx: ComBitPosition=86, ComBitSize=1, ComSignalInitValue=0, ComSignalType=BOOLEAN, ComSystemTemplateSystemSignalRef=DET_HVC_FLAG_157
            DET_HVC_FLAG_158_oRDR_DETECTION_157_160_oPCAN_RADAR_32abc1a7_Tx: ComBitPosition=198, ComBitSize=1, ComSignalInitValue=0, ComSignalType=BOOLEAN, ComSystemTemplateSystemSignalRef=DET_HVC_FLAG_158
            DET_HVC_FLAG_159_oRDR_DETECTION_157_160_oPCAN_RADAR_a7db1532_Tx: ComBitPosition=310, ComBitSize=1, ComSignalInitValue=0, ComSignalType=BOOLEAN, ComSystemTemplateSystemSignalRef=DET_HVC_FLAG_159
            DET_HVC_FLAG_160_oRDR_DETECTION_157_160_oPCAN_RADAR_186a4fe9_Tx: ComBitPosition=422, ComBitSize=1, ComSignalInitValue=0, ComSignalType=BOOLEAN, ComSystemTemplateSystemSignalRef=DET_HVC_FLAG_160
            DET_IDM_157_oRDR_DETECTION_157_160_oPCAN_RADAR_95e9685d_Tx: ComBitPosition=63, ComBitSize=1, ComSignalInitValue=0, ComSignalType=BOOLEAN, ComSystemTemplateSystemSignalRef=DET_IDM_157
            DET_IDM_158_oRDR_DETECTION_157_160_oPCAN_RADAR_b9f9fa1a_Tx: ComBitPosition=175, ComBitSize=1, ComSignalInitValue=0, ComSignalType=BOOLEAN, ComSystemTemplateSystemSignalRef=DET_IDM_158
            DET_IDM_159_oRDR_DETECTION_157_160_oPCAN_RADAR_2c892e8f_Tx: ComBitPosition=287, ComBitSize=1, ComSignalInitValue=0, ComSignalType=BOOLEAN, ComSystemTemplateSystemSignalRef=DET_IDM_159
            DET_IDM_160_oRDR_DETECTION_157_160_oPCAN_RADAR_93387454_Tx: ComBitPosition=399, ComBitSize=1, ComSignalInitValue=0, ComSignalType=BOOLEAN, ComSystemTemplateSystemSignalRef=DET_IDM_160
            DET_MH_CRC16_157_160_oRDR_DETECTION_157_160_oPCAN_RADAR_459d0b3d_Tx: ComBitPosition=0, ComBitSize=16, ComSignalInitValue=0, ComSignalType=UINT16, ComSystemTemplateSystemSignalRef=DET_MH_CRC16_157_160
            DET_MH_CYCLE_COUNTER_157_160_oRDR_DETECTION_157_160_oPCAN_RADAR_c1e8aa0a_Tx: ComBitPosition=16, ComBitSize=8, ComSignalInitValue=0, ComSignalType=UINT8, ComSystemTemplateSystemSignalRef=DET_MH_CYCLE_COUNTER_157_160
            DET_MH_SCAN_INDEX_4LSB_157_160_oRDR_DETECTION_157_160_oPCAN_RADAR_0dc28f86_Tx: ComBitPosition=476, ComBitSize=4, ComSignalInitValue=0, ComSignalType=UINT8, ComSystemTemplateSystemSignalRef=DET_MH_SCAN_INDEX_4LSB_157_160
            DET_MTD_157_oRDR_DETECTION_157_160_oPCAN_RADAR_f35a5a86_Tx: ComBitPosition=47, ComBitSize=1, ComSignalInitValue=0, ComSignalType=BOOLEAN, ComSystemTemplateSystemSignalRef=DET_MTD_157
            DET_MTD_158_oRDR_DETECTION_157_160_oPCAN_RADAR_df4ac8c1_Tx: ComBitPosition=159, ComBitSize=1, ComSignalInitValue=0, ComSignalType=BOOLEAN, ComSystemTemplateSystemSignalRef=DET_MTD_158
            DET_MTD_159_oRDR_DETECTION_157_160_oPCAN_RADAR_4a3a1c54_Tx: ComBitPosition=271, ComBitSize=1, ComSignalInitValue=0, ComSignalType=BOOLEAN, ComSystemTemplateSystemSignalRef=DET_MTD_159
            DET_MTD_160_oRDR_DETECTION_157_160_oPCAN_RADAR_f58b468f_Tx: ComBitPosition=383, ComBitSize=1, ComSignalInitValue=0, ComSignalType=BOOLEAN, ComSystemTemplateSystemSignalRef=DET_MTD_160
            DET_PROB_1STAZHYPO_157_oRDR_DETECTION_157_160_oPCAN_RADAR_60eeb24b_Tx: ComBitPosition=103, ComBitSize=1, ComSignalInitValue=0, ComSignalType=BOOLEAN, ComSystemTemplateSystemSignalRef=DET_PROB_1STAZHYPO_157
            DET_PROB_1STAZHYPO_158_oRDR_DETECTION_157_160_oPCAN_RADAR_4cfe200c_Tx: ComBitPosition=215, ComBitSize=1, ComSignalInitValue=0, ComSignalType=BOOLEAN, ComSystemTemplateSystemSignalRef=DET_PROB_1STAZHYPO_158
            DET_PROB_1STAZHYPO_159_oRDR_DETECTION_157_160_oPCAN_RADAR_d98ef499_Tx: ComBitPosition=327, ComBitSize=1, ComSignalInitValue=0, ComSignalType=BOOLEAN, ComSystemTemplateSystemSignalRef=DET_PROB_1STAZHYPO_159
            DET_PROB_1STAZHYPO_160_oRDR_DETECTION_157_160_oPCAN_RADAR_663fae42_Tx: ComBitPosition=439, ComBitSize=1, ComSignalInitValue=0, ComSignalType=BOOLEAN, ComSystemTemplateSystemSignalRef=DET_PROB_1STAZHYPO_160
            DET_RANGE_157_oRDR_DETECTION_157_160_oPCAN_RADAR_6b41513d_Tx: ComBitPosition=24, ComBitSize=15, ComSignalInitValue=0, ComSignalType=UINT16, ComSystemTemplateSystemSignalRef=DET_RANGE_157
            DET_RANGE_158_oRDR_DETECTION_157_160_oPCAN_RADAR_4751c37a_Tx: ComBitPosition=136, ComBitSize=15, ComSignalInitValue=0, ComSignalType=UINT16, ComSystemTemplateSystemSignalRef=DET_RANGE_158
            DET_RANGE_159_oRDR_DETECTION_157_160_oPCAN_RADAR_d22117ef_Tx: ComBitPosition=248, ComBitSize=15, ComSignalInitValue=0, ComSignalType=UINT16, ComSystemTemplateSystemSignalRef=DET_RANGE_159
            DET_RANGE_160_oRDR_DETECTION_157_160_oPCAN_RADAR_6d904d34_Tx: ComBitPosition=360, ComBitSize=15, ComSignalInitValue=0, ComSignalType=UINT16, ComSystemTemplateSystemSignalRef=DET_RANGE_160
            DET_RANGE_ERR_157_oRDR_DETECTION_157_160_oPCAN_RADAR_cca9eb54_Tx: ComBitPosition=40, ComBitSize=7, ComSignalInitValue=0, ComSignalType=UINT8, ComSystemTemplateSystemSignalRef=DET_RANGE_ERR_157
            DET_RANGE_ERR_158_oRDR_DETECTION_157_160_oPCAN_RADAR_e0b97913_Tx: ComBitPosition=152, ComBitSize=7, ComSignalInitValue=0, ComSignalType=UINT8, ComSystemTemplateSystemSignalRef=DET_RANGE_ERR_158
            DET_RANGE_ERR_159_oRDR_DETECTION_157_160_oPCAN_RADAR_75c9ad86_Tx: ComBitPosition=264, ComBitSize=7, ComSignalInitValue=0, ComSignalType=UINT8, ComSystemTemplateSystemSignalRef=DET_RANGE_ERR_159
            DET_RANGE_ERR_160_oRDR_DETECTION_157_160_oPCAN_RADAR_ca78f75d_Tx: ComBitPosition=376, ComBitSize=7, ComSignalInitValue=0, ComSignalType=UINT8, ComSystemTemplateSystemSignalRef=DET_RANGE_ERR_160
            DET_RANGE_VELOCITY_157_oRDR_DETECTION_157_160_oPCAN_RADAR_1ee79318_Tx: ComBitPosition=48, ComBitSize=15, ComSignalInitValue=16384, ComSignalType=UINT16, ComSystemTemplateSystemSignalRef=DET_RANGE_VELOCITY_157
            DET_RANGE_VELOCITY_158_oRDR_DETECTION_157_160_oPCAN_RADAR_32f7015f_Tx: ComBitPosition=160, ComBitSize=15, ComSignalInitValue=16384, ComSignalType=UINT16, ComSystemTemplateSystemSignalRef=DET_RANGE_VELOCITY_158
            DET_RANGE_VELOCITY_159_oRDR_DETECTION_157_160_oPCAN_RADAR_a787d5ca_Tx: ComBitPosition=272, ComBitSize=15, ComSignalInitValue=16384, ComSignalType=UINT16, ComSystemTemplateSystemSignalRef=DET_RANGE_VELOCITY_159
            DET_RANGE_VELOCITY_160_oRDR_DETECTION_157_160_oPCAN_RADAR_18368f11_Tx: ComBitPosition=384, ComBitSize=15, ComSignalInitValue=16384, ComSignalType=UINT16, ComSystemTemplateSystemSignalRef=DET_RANGE_VELOCITY_160
            DET_RANGE_VELOCITY_ERR_157_oRDR_DETECTION_157_160_oPCAN_RADAR_115c68aa_Tx: ComBitPosition=64, ComBitSize=8, ComSignalInitValue=0, ComSignalType=UINT8, ComSystemTemplateSystemSignalRef=DET_RANGE_VELOCITY_ERR_157
            DET_RANGE_VELOCITY_ERR_158_oRDR_DETECTION_157_160_oPCAN_RADAR_3d4cfaed_Tx: ComBitPosition=176, ComBitSize=8, ComSignalInitValue=0, ComSignalType=UINT8, ComSystemTemplateSystemSignalRef=DET_RANGE_VELOCITY_ERR_158
            DET_RANGE_VELOCITY_ERR_159_oRDR_DETECTION_157_160_oPCAN_RADAR_a83c2e78_Tx: ComBitPosition=288, ComBitSize=8, ComSignalInitValue=0, ComSignalType=UINT8, ComSystemTemplateSystemSignalRef=DET_RANGE_VELOCITY_ERR_159
            DET_RANGE_VELOCITY_ERR_160_oRDR_DETECTION_157_160_oPCAN_RADAR_178d74a3_Tx: ComBitPosition=400, ComBitSize=8, ComSignalInitValue=0, ComSignalType=UINT8, ComSystemTemplateSystemSignalRef=DET_RANGE_VELOCITY_ERR_160
            DET_RCS_157_oRDR_DETECTION_157_160_oPCAN_RADAR_9967a442_Tx: ComBitPosition=128, ComBitSize=8, ComSignalInitValue=128, ComSignalType=UINT8, ComSystemTemplateSystemSignalRef=DET_RCS_157
            DET_RCS_158_oRDR_DETECTION_157_160_oPCAN_RADAR_b5773605_Tx: ComBitPosition=240, ComBitSize=8, ComSignalInitValue=128, ComSignalType=UINT8, ComSystemTemplateSystemSignalRef=DET_RCS_158
            DET_RCS_159_oRDR_DETECTION_157_160_oPCAN_RADAR_2007e290_Tx: ComBitPosition=352, ComBitSize=8, ComSignalInitValue=128, ComSignalType=UINT8, ComSystemTemplateSystemSignalRef=DET_RCS_159
            DET_RCS_160_oRDR_DETECTION_157_160_oPCAN_RADAR_9fb6b84b_Tx: ComBitPosition=464, ComBitSize=8, ComSignalInitValue=128, ComSignalType=UINT8, ComSystemTemplateSystemSignalRef=DET_RCS_160
            DET_SNR_157_oRDR_DETECTION_157_160_oPCAN_RADAR_44c9f040_Tx: ComBitPosition=120, ComBitSize=8, ComSignalInitValue=0, ComSignalType=UINT8, ComSystemTemplateSystemSignalRef=DET_SNR_157
            DET_SNR_158_oRDR_DETECTION_157_160_oPCAN_RADAR_68d96207_Tx: ComBitPosition=232, ComBitSize=8, ComSignalInitValue=0, ComSignalType=UINT8, ComSystemTemplateSystemSignalRef=DET_SNR_158
            DET_SNR_159_oRDR_DETECTION_157_160_oPCAN_RADAR_fda9b692_Tx: ComBitPosition=344, ComBitSize=8, ComSignalInitValue=0, ComSignalType=UINT8, ComSystemTemplateSystemSignalRef=DET_SNR_159
            DET_SNR_160_oRDR_DETECTION_157_160_oPCAN_RADAR_4218ec49_Tx: ComBitPosition=456, ComBitSize=8, ComSignalInitValue=0, ComSignalType=UINT8, ComSystemTemplateSystemSignalRef=DET_SNR_160
            DET_SUPER_RES_TARGET_157_oRDR_DETECTION_157_160_oPCAN_RADAR_7550d825_Tx: ComBitPosition=87, ComBitSize=1, ComSignalInitValue=0, ComSignalType=BOOLEAN, ComSystemTemplateSystemSignalRef=DET_SUPER_RES_TARGET_157
            DET_SUPER_RES_TARGET_158_oRDR_DETECTION_157_160_oPCAN_RADAR_59404a62_Tx: ComBitPosition=199, ComBitSize=1, ComSignalInitValue=0, ComSignalType=BOOLEAN, ComSystemTemplateSystemSignalRef=DET_SUPER_RES_TARGET_158
            DET_SUPER_RES_TARGET_159_oRDR_DETECTION_157_160_oPCAN_RADAR_cc309ef7_Tx: ComBitPosition=311, ComBitSize=1, ComSignalInitValue=0, ComSignalType=BOOLEAN, ComSystemTemplateSystemSignalRef=DET_SUPER_RES_TARGET_159
            DET_SUPER_RES_TARGET_160_oRDR_DETECTION_157_160_oPCAN_RADAR_7381c42c_Tx: ComBitPosition=423, ComBitSize=1, ComSignalInitValue=0, ComSignalType=BOOLEAN, ComSystemTemplateSystemSignalRef=DET_SUPER_RES_TARGET_160
        SG_Detections_161_164_oRDR_DETECTION_161_164_oPCAN_RADAR_c27e57ef_Tx: ComSystemTemplateSignalGroupRef=SG_Detections_161_164
          83 x ComGroupSignal, all with ComSignalEndianness=LITTLE_ENDIAN, ComTransferProperty=PENDING:
            DET_AZIMUTH_161_oRDR_DETECTION_161_164_oPCAN_RADAR_6570eae6_Tx: ComBitPosition=88, ComBitSize=13, ComSignalInitValue=0, ComSignalType=UINT16, ComSystemTemplateSystemSignalRef=DET_AZIMUTH_161
            DET_AZIMUTH_162_oRDR_DETECTION_161_164_oPCAN_RADAR_01909118_Tx: ComBitPosition=200, ComBitSize=13, ComSignalInitValue=0, ComSignalType=UINT16, ComSystemTemplateSystemSignalRef=DET_AZIMUTH_162
            DET_AZIMUTH_163_oRDR_DETECTION_161_164_oPCAN_RADAR_94e0458d_Tx: ComBitPosition=312, ComBitSize=13, ComSignalInitValue=0, ComSignalType=UINT16, ComSystemTemplateSystemSignalRef=DET_AZIMUTH_163
            DET_AZIMUTH_164_oRDR_DETECTION_161_164_oPCAN_RADAR_c85066e4_Tx: ComBitPosition=424, ComBitSize=13, ComSignalInitValue=0, ComSignalType=UINT16, ComSystemTemplateSystemSignalRef=DET_AZIMUTH_164
            DET_AZIMUTH_ERR_161_oRDR_DETECTION_161_164_oPCAN_RADAR_c1c57f13_Tx: ComBitPosition=105, ComBitSize=7, ComSignalInitValue=0, ComSignalType=UINT8, ComSystemTemplateSystemSignalRef=DET_AZIMUTH_ERR_161
            DET_AZIMUTH_ERR_162_oRDR_DETECTION_161_164_oPCAN_RADAR_a52504ed_Tx: ComBitPosition=217, ComBitSize=7, ComSignalInitValue=0, ComSignalType=UINT8, ComSystemTemplateSystemSignalRef=DET_AZIMUTH_ERR_162
            DET_AZIMUTH_ERR_163_oRDR_DETECTION_161_164_oPCAN_RADAR_3055d078_Tx: ComBitPosition=329, ComBitSize=7, ComSignalInitValue=0, ComSignalType=UINT8, ComSystemTemplateSystemSignalRef=DET_AZIMUTH_ERR_163
            DET_AZIMUTH_ERR_164_oRDR_DETECTION_161_164_oPCAN_RADAR_6ce5f311_Tx: ComBitPosition=441, ComBitSize=7, ComSignalInitValue=0, ComSignalType=UINT8, ComSystemTemplateSystemSignalRef=DET_AZIMUTH_ERR_164
            DET_BELOW_RAIN_THOLD_161_oRDR_DETECTION_161_164_oPCAN_RADAR_b0717926_Tx: ComBitPosition=39, ComBitSize=1, ComSignalInitValue=0, ComSignalType=BOOLEAN, ComSystemTemplateSystemSignalRef=DET_BELOW_RAIN_THOLD_161
            DET_BELOW_RAIN_THOLD_162_oRDR_DETECTION_161_164_oPCAN_RADAR_d49102d8_Tx: ComBitPosition=151, ComBitSize=1, ComSignalInitValue=0, ComSignalType=BOOLEAN, ComSystemTemplateSystemSignalRef=DET_BELOW_RAIN_THOLD_162
            DET_BELOW_RAIN_THOLD_163_oRDR_DETECTION_161_164_oPCAN_RADAR_41e1d64d_Tx: ComBitPosition=263, ComBitSize=1, ComSignalInitValue=0, ComSignalType=BOOLEAN, ComSystemTemplateSystemSignalRef=DET_BELOW_RAIN_THOLD_163
            DET_BELOW_RAIN_THOLD_164_oRDR_DETECTION_161_164_oPCAN_RADAR_1d51f524_Tx: ComBitPosition=375, ComBitSize=1, ComSignalInitValue=0, ComSignalType=BOOLEAN, ComSystemTemplateSystemSignalRef=DET_BELOW_RAIN_THOLD_164
            DET_BI_STATIC_FLAG_161_oRDR_DETECTION_161_164_oPCAN_RADAR_335caa63_Tx: ComBitPosition=104, ComBitSize=1, ComSignalInitValue=0, ComSignalType=BOOLEAN, ComSystemTemplateSystemSignalRef=DET_BI_STATIC_FLAG_161
            DET_BI_STATIC_FLAG_162_oRDR_DETECTION_161_164_oPCAN_RADAR_57bcd19d_Tx: ComBitPosition=216, ComBitSize=1, ComSignalInitValue=0, ComSignalType=BOOLEAN, ComSystemTemplateSystemSignalRef=DET_BI_STATIC_FLAG_162
            DET_BI_STATIC_FLAG_163_oRDR_DETECTION_161_164_oPCAN_RADAR_c2cc0508_Tx: ComBitPosition=328, ComBitSize=1, ComSignalInitValue=0, ComSignalType=BOOLEAN, ComSystemTemplateSystemSignalRef=DET_BI_STATIC_FLAG_163
            DET_BI_STATIC_FLAG_164_oRDR_DETECTION_161_164_oPCAN_RADAR_9e7c2661_Tx: ComBitPosition=440, ComBitSize=1, ComSignalInitValue=0, ComSignalType=BOOLEAN, ComSystemTemplateSystemSignalRef=DET_BI_STATIC_FLAG_164
            DET_CONFD_AZIMUTH_161_oRDR_DETECTION_161_164_oPCAN_RADAR_6796e02c_Tx: ComBitPosition=118, ComBitSize=2, ComSignalInitValue=0, ComSignalType=UINT8, ComSystemTemplateSystemSignalRef=DET_CONFD_AZIMUTH_161
            DET_CONFD_AZIMUTH_162_oRDR_DETECTION_161_164_oPCAN_RADAR_03769bd2_Tx: ComBitPosition=230, ComBitSize=2, ComSignalInitValue=0, ComSignalType=UINT8, ComSystemTemplateSystemSignalRef=DET_CONFD_AZIMUTH_162
            DET_CONFD_AZIMUTH_163_oRDR_DETECTION_161_164_oPCAN_RADAR_96064f47_Tx: ComBitPosition=342, ComBitSize=2, ComSignalInitValue=0, ComSignalType=UINT8, ComSystemTemplateSystemSignalRef=DET_CONFD_AZIMUTH_163
            DET_CONFD_AZIMUTH_164_oRDR_DETECTION_161_164_oPCAN_RADAR_cab66c2e_Tx: ComBitPosition=454, ComBitSize=2, ComSignalInitValue=0, ComSignalType=UINT8, ComSystemTemplateSystemSignalRef=DET_CONFD_AZIMUTH_164
            DET_CONFD_ELEVATION_161_oRDR_DETECTION_161_164_oPCAN_RADAR_6503e1d6_Tx: ComBitPosition=101, ComBitSize=2, ComSignalInitValue=0, ComSignalType=UINT8, ComSystemTemplateSystemSignalRef=DET_CONFD_ELEVATION_161
            DET_CONFD_ELEVATION_162_oRDR_DETECTION_161_164_oPCAN_RADAR_01e39a28_Tx: ComBitPosition=213, ComBitSize=2, ComSignalInitValue=0, ComSignalType=UINT8, ComSystemTemplateSystemSignalRef=DET_CONFD_ELEVATION_162
            DET_CONFD_ELEVATION_163_oRDR_DETECTION_161_164_oPCAN_RADAR_94934ebd_Tx: ComBitPosition=325, ComBitSize=2, ComSignalInitValue=0, ComSignalType=UINT8, ComSystemTemplateSystemSignalRef=DET_CONFD_ELEVATION_163
            DET_CONFD_ELEVATION_164_oRDR_DETECTION_161_164_oPCAN_RADAR_c8236dd4_Tx: ComBitPosition=437, ComBitSize=2, ComSignalInitValue=0, ComSignalType=UINT8, ComSystemTemplateSystemSignalRef=DET_CONFD_ELEVATION_164
            DET_ELEVATION_161_oRDR_DETECTION_161_164_oPCAN_RADAR_b4c335ea_Tx: ComBitPosition=72, ComBitSize=8, ComSignalInitValue=0, ComSignalType=UINT8, ComSystemTemplateSystemSignalRef=DET_ELEVATION_161
            DET_ELEVATION_162_oRDR_DETECTION_161_164_oPCAN_RADAR_d0234e14_Tx: ComBitPosition=184, ComBitSize=8, ComSignalInitValue=0, ComSignalType=UINT8, ComSystemTemplateSystemSignalRef=DET_ELEVATION_162
            DET_ELEVATION_163_oRDR_DETECTION_161_164_oPCAN_RADAR_45539a81_Tx: ComBitPosition=296, ComBitSize=8, ComSignalInitValue=0, ComSignalType=UINT8, ComSystemTemplateSystemSignalRef=DET_ELEVATION_163
            DET_ELEVATION_164_oRDR_DETECTION_161_164_oPCAN_RADAR_19e3b9e8_Tx: ComBitPosition=408, ComBitSize=8, ComSignalInitValue=0, ComSignalType=UINT8, ComSystemTemplateSystemSignalRef=DET_ELEVATION_164
            DET_ELEVATION_ERR_161_oRDR_DETECTION_161_164_oPCAN_RADAR_33faad9f_Tx: ComBitPosition=80, ComBitSize=6, ComSignalInitValue=0, ComSignalType=UINT8, ComSystemTemplateSystemSignalRef=DET_ELEVATION_ERR_161
            DET_ELEVATION_ERR_162_oRDR_DETECTION_161_164_oPCAN_RADAR_571ad661_Tx: ComBitPosition=192, ComBitSize=6, ComSignalInitValue=0, ComSignalType=UINT8, ComSystemTemplateSystemSignalRef=DET_ELEVATION_ERR_162
            DET_ELEVATION_ERR_163_oRDR_DETECTION_161_164_oPCAN_RADAR_c26a02f4_Tx: ComBitPosition=304, ComBitSize=6, ComSignalInitValue=0, ComSignalType=UINT8, ComSystemTemplateSystemSignalRef=DET_ELEVATION_ERR_163
            DET_ELEVATION_ERR_164_oRDR_DETECTION_161_164_oPCAN_RADAR_9eda219d_Tx: ComBitPosition=416, ComBitSize=6, ComSignalInitValue=0, ComSignalType=UINT8, ComSystemTemplateSystemSignalRef=DET_ELEVATION_ERR_164
            DET_EXISTENCE_PROB_161_oRDR_DETECTION_161_164_oPCAN_RADAR_e165d8ff_Tx: ComBitPosition=112, ComBitSize=6, ComSignalInitValue=0, ComSignalType=UINT8, ComSystemTemplateSystemSignalRef=DET_EXISTENCE_PROB_161
            DET_EXISTENCE_PROB_162_oRDR_DETECTION_161_164_oPCAN_RADAR_8585a301_Tx: ComBitPosition=224, ComBitSize=6, ComSignalInitValue=0, ComSignalType=UINT8, ComSystemTemplateSystemSignalRef=DET_EXISTENCE_PROB_162
            DET_EXISTENCE_PROB_163_oRDR_DETECTION_161_164_oPCAN_RADAR_10f57794_Tx: ComBitPosition=336, ComBitSize=6, ComSignalInitValue=0, ComSignalType=UINT8, ComSystemTemplateSystemSignalRef=DET_EXISTENCE_PROB_163
            DET_EXISTENCE_PROB_164_oRDR_DETECTION_161_164_oPCAN_RADAR_4c4554fd_Tx: ComBitPosition=448, ComBitSize=6, ComSignalInitValue=0, ComSignalType=UINT8, ComSystemTemplateSystemSignalRef=DET_EXISTENCE_PROB_164
            DET_HVC_FLAG_161_oRDR_DETECTION_161_164_oPCAN_RADAR_00119b80_Tx: ComBitPosition=86, ComBitSize=1, ComSignalInitValue=0, ComSignalType=BOOLEAN, ComSystemTemplateSystemSignalRef=DET_HVC_FLAG_161
            DET_HVC_FLAG_162_oRDR_DETECTION_161_164_oPCAN_RADAR_64f1e07e_Tx: ComBitPosition=198, ComBitSize=1, ComSignalInitValue=0, ComSignalType=BOOLEAN, ComSystemTemplateSystemSignalRef=DET_HVC_FLAG_162
            DET_HVC_FLAG_163_oRDR_DETECTION_161_164_oPCAN_RADAR_f18134eb_Tx: ComBitPosition=310, ComBitSize=1, ComSignalInitValue=0, ComSignalType=BOOLEAN, ComSystemTemplateSystemSignalRef=DET_HVC_FLAG_163
            DET_HVC_FLAG_164_oRDR_DETECTION_161_164_oPCAN_RADAR_ad311782_Tx: ComBitPosition=422, ComBitSize=1, ComSignalInitValue=0, ComSignalType=BOOLEAN, ComSystemTemplateSystemSignalRef=DET_HVC_FLAG_164
            DET_IDM_161_oRDR_DETECTION_161_164_oPCAN_RADAR_8b43a03d_Tx: ComBitPosition=63, ComBitSize=1, ComSignalInitValue=0, ComSignalType=BOOLEAN, ComSystemTemplateSystemSignalRef=DET_IDM_161
            DET_IDM_162_oRDR_DETECTION_161_164_oPCAN_RADAR_efa3dbc3_Tx: ComBitPosition=175, ComBitSize=1, ComSignalInitValue=0, ComSignalType=BOOLEAN, ComSystemTemplateSystemSignalRef=DET_IDM_162
            DET_IDM_163_oRDR_DETECTION_161_164_oPCAN_RADAR_7ad30f56_Tx: ComBitPosition=287, ComBitSize=1, ComSignalInitValue=0, ComSignalType=BOOLEAN, ComSystemTemplateSystemSignalRef=DET_IDM_163
            DET_IDM_164_oRDR_DETECTION_161_164_oPCAN_RADAR_26632c3f_Tx: ComBitPosition=399, ComBitSize=1, ComSignalInitValue=0, ComSignalType=BOOLEAN, ComSystemTemplateSystemSignalRef=DET_IDM_164
            DET_MH_CRC16_161_164_oRDR_DETECTION_161_164_oPCAN_RADAR_46f685e4_Tx: ComBitPosition=0, ComBitSize=16, ComSignalInitValue=0, ComSignalType=UINT16, ComSystemTemplateSystemSignalRef=DET_MH_CRC16_161_164
            DET_MH_CYCLE_COUNTER_161_164_oRDR_DETECTION_161_164_oPCAN_RADAR_c28324d3_Tx: ComBitPosition=16, ComBitSize=8, ComSignalInitValue=0, ComSignalType=UINT8, ComSystemTemplateSystemSignalRef=DET_MH_CYCLE_COUNTER_161_164
            DET_MH_SCAN_INDEX_4LSB_161_164_oRDR_DETECTION_161_164_oPCAN_RADAR_0ea9015f_Tx: ComBitPosition=476, ComBitSize=4, ComSignalInitValue=0, ComSignalType=UINT8, ComSystemTemplateSystemSignalRef=DET_MH_SCAN_INDEX_4LSB_161_164
            DET_MTD_161_oRDR_DETECTION_161_164_oPCAN_RADAR_edf092e6_Tx: ComBitPosition=47, ComBitSize=1, ComSignalInitValue=0, ComSignalType=BOOLEAN, ComSystemTemplateSystemSignalRef=DET_MTD_161
            DET_MTD_162_oRDR_DETECTION_161_164_oPCAN_RADAR_8910e918_Tx: ComBitPosition=159, ComBitSize=1, ComSignalInitValue=0, ComSignalType=BOOLEAN, ComSystemTemplateSystemSignalRef=DET_MTD_162
            DET_MTD_163_oRDR_DETECTION_161_164_oPCAN_RADAR_1c603d8d_Tx: ComBitPosition=271, ComBitSize=1, ComSignalInitValue=0, ComSignalType=BOOLEAN, ComSystemTemplateSystemSignalRef=DET_MTD_163
            DET_MTD_164_oRDR_DETECTION_161_164_oPCAN_RADAR_40d01ee4_Tx: ComBitPosition=383, ComBitSize=1, ComSignalInitValue=0, ComSignalType=BOOLEAN, ComSystemTemplateSystemSignalRef=DET_MTD_164
            DET_PROB_1STAZHYPO_161_oRDR_DETECTION_161_164_oPCAN_RADAR_7e447a2b_Tx: ComBitPosition=103, ComBitSize=1, ComSignalInitValue=0, ComSignalType=BOOLEAN, ComSystemTemplateSystemSignalRef=DET_PROB_1STAZHYPO_161
            DET_PROB_1STAZHYPO_162_oRDR_DETECTION_161_164_oPCAN_RADAR_1aa401d5_Tx: ComBitPosition=215, ComBitSize=1, ComSignalInitValue=0, ComSignalType=BOOLEAN, ComSystemTemplateSystemSignalRef=DET_PROB_1STAZHYPO_162
            DET_PROB_1STAZHYPO_163_oRDR_DETECTION_161_164_oPCAN_RADAR_8fd4d540_Tx: ComBitPosition=327, ComBitSize=1, ComSignalInitValue=0, ComSignalType=BOOLEAN, ComSystemTemplateSystemSignalRef=DET_PROB_1STAZHYPO_163
            DET_PROB_1STAZHYPO_164_oRDR_DETECTION_161_164_oPCAN_RADAR_d364f629_Tx: ComBitPosition=439, ComBitSize=1, ComSignalInitValue=0, ComSignalType=BOOLEAN, ComSystemTemplateSystemSignalRef=DET_PROB_1STAZHYPO_164
            DET_RANGE_161_oRDR_DETECTION_161_164_oPCAN_RADAR_75eb995d_Tx: ComBitPosition=24, ComBitSize=15, ComSignalInitValue=0, ComSignalType=UINT16, ComSystemTemplateSystemSignalRef=DET_RANGE_161
            DET_RANGE_162_oRDR_DETECTION_161_164_oPCAN_RADAR_110be2a3_Tx: ComBitPosition=136, ComBitSize=15, ComSignalInitValue=0, ComSignalType=UINT16, ComSystemTemplateSystemSignalRef=DET_RANGE_162
            DET_RANGE_163_oRDR_DETECTION_161_164_oPCAN_RADAR_847b3636_Tx: ComBitPosition=248, ComBitSize=15, ComSignalInitValue=0, ComSignalType=UINT16, ComSystemTemplateSystemSignalRef=DET_RANGE_163
            DET_RANGE_164_oRDR_DETECTION_161_164_oPCAN_RADAR_d8cb155f_Tx: ComBitPosition=360, ComBitSize=15, ComSignalInitValue=0, ComSignalType=UINT16, ComSystemTemplateSystemSignalRef=DET_RANGE_164
            DET_RANGE_ERR_161_oRDR_DETECTION_161_164_oPCAN_RADAR_d2032334_Tx: ComBitPosition=40, ComBitSize=7, ComSignalInitValue=0, ComSignalType=UINT8, ComSystemTemplateSystemSignalRef=DET_RANGE_ERR_161
            DET_RANGE_ERR_162_oRDR_DETECTION_161_164_oPCAN_RADAR_b6e358ca_Tx: ComBitPosition=152, ComBitSize=7, ComSignalInitValue=0, ComSignalType=UINT8, ComSystemTemplateSystemSignalRef=DET_RANGE_ERR_162
            DET_RANGE_ERR_163_oRDR_DETECTION_161_164_oPCAN_RADAR_23938c5f_Tx: ComBitPosition=264, ComBitSize=7, ComSignalInitValue=0, ComSignalType=UINT8, ComSystemTemplateSystemSignalRef=DET_RANGE_ERR_163
            DET_RANGE_ERR_164_oRDR_DETECTION_161_164_oPCAN_RADAR_7f23af36_Tx: ComBitPosition=376, ComBitSize=7, ComSignalInitValue=0, ComSignalType=UINT8, ComSystemTemplateSystemSignalRef=DET_RANGE_ERR_164
            DET_RANGE_VELOCITY_161_oRDR_DETECTION_161_164_oPCAN_RADAR_004d5b78_Tx: ComBitPosition=48, ComBitSize=15, ComSignalInitValue=16384, ComSignalType=UINT16, ComSystemTemplateSystemSignalRef=DET_RANGE_VELOCITY_161
            DET_RANGE_VELOCITY_162_oRDR_DETECTION_161_164_oPCAN_RADAR_64ad2086_Tx: ComBitPosition=160, ComBitSize=15, ComSignalInitValue=16384, ComSignalType=UINT16, ComSystemTemplateSystemSignalRef=DET_RANGE_VELOCITY_162
            DET_RANGE_VELOCITY_163_oRDR_DETECTION_161_164_oPCAN_RADAR_f1ddf413_Tx: ComBitPosition=272, ComBitSize=15, ComSignalInitValue=16384, ComSignalType=UINT16, ComSystemTemplateSystemSignalRef=DET_RANGE_VELOCITY_163
            DET_RANGE_VELOCITY_164_oRDR_DETECTION_161_164_oPCAN_RADAR_ad6dd77a_Tx: ComBitPosition=384, ComBitSize=15, ComSignalInitValue=16384, ComSignalType=UINT16, ComSystemTemplateSystemSignalRef=DET_RANGE_VELOCITY_164
            DET_RANGE_VELOCITY_ERR_161_oRDR_DETECTION_161_164_oPCAN_RADAR_0ff6a0ca_Tx: ComBitPosition=64, ComBitSize=8, ComSignalInitValue=0, ComSignalType=UINT8, ComSystemTemplateSystemSignalRef=DET_RANGE_VELOCITY_ERR_161
            DET_RANGE_VELOCITY_ERR_162_oRDR_DETECTION_161_164_oPCAN_RADAR_6b16db34_Tx: ComBitPosition=176, ComBitSize=8, ComSignalInitValue=0, ComSignalType=UINT8, ComSystemTemplateSystemSignalRef=DET_RANGE_VELOCITY_ERR_162
            DET_RANGE_VELOCITY_ERR_163_oRDR_DETECTION_161_164_oPCAN_RADAR_fe660fa1_Tx: ComBitPosition=288, ComBitSize=8, ComSignalInitValue=0, ComSignalType=UINT8, ComSystemTemplateSystemSignalRef=DET_RANGE_VELOCITY_ERR_163
            DET_RANGE_VELOCITY_ERR_164_oRDR_DETECTION_161_164_oPCAN_RADAR_a2d62cc8_Tx: ComBitPosition=400, ComBitSize=8, ComSignalInitValue=0, ComSignalType=UINT8, ComSystemTemplateSystemSignalRef=DET_RANGE_VELOCITY_ERR_164
            DET_RCS_161_oRDR_DETECTION_161_164_oPCAN_RADAR_87cd6c22_Tx: ComBitPosition=128, ComBitSize=8, ComSignalInitValue=128, ComSignalType=UINT8, ComSystemTemplateSystemSignalRef=DET_RCS_161
            DET_RCS_162_oRDR_DETECTION_161_164_oPCAN_RADAR_e32d17dc_Tx: ComBitPosition=240, ComBitSize=8, ComSignalInitValue=128, ComSignalType=UINT8, ComSystemTemplateSystemSignalRef=DET_RCS_162
            DET_RCS_163_oRDR_DETECTION_161_164_oPCAN_RADAR_765dc349_Tx: ComBitPosition=352, ComBitSize=8, ComSignalInitValue=128, ComSignalType=UINT8, ComSystemTemplateSystemSignalRef=DET_RCS_163
            DET_RCS_164_oRDR_DETECTION_161_164_oPCAN_RADAR_2aede020_Tx: ComBitPosition=464, ComBitSize=8, ComSignalInitValue=128, ComSignalType=UINT8, ComSystemTemplateSystemSignalRef=DET_RCS_164
            DET_SNR_161_oRDR_DETECTION_161_164_oPCAN_RADAR_5a633820_Tx: ComBitPosition=120, ComBitSize=8, ComSignalInitValue=0, ComSignalType=UINT8, ComSystemTemplateSystemSignalRef=DET_SNR_161
            DET_SNR_162_oRDR_DETECTION_161_164_oPCAN_RADAR_3e8343de_Tx: ComBitPosition=232, ComBitSize=8, ComSignalInitValue=0, ComSignalType=UINT8, ComSystemTemplateSystemSignalRef=DET_SNR_162
            DET_SNR_163_oRDR_DETECTION_161_164_oPCAN_RADAR_abf3974b_Tx: ComBitPosition=344, ComBitSize=8, ComSignalInitValue=0, ComSignalType=UINT8, ComSystemTemplateSystemSignalRef=DET_SNR_163
            DET_SNR_164_oRDR_DETECTION_161_164_oPCAN_RADAR_f743b422_Tx: ComBitPosition=456, ComBitSize=8, ComSignalInitValue=0, ComSignalType=UINT8, ComSystemTemplateSystemSignalRef=DET_SNR_164
            DET_SUPER_RES_TARGET_161_oRDR_DETECTION_161_164_oPCAN_RADAR_6bfa1045_Tx: ComBitPosition=87, ComBitSize=1, ComSignalInitValue=0, ComSignalType=BOOLEAN, ComSystemTemplateSystemSignalRef=DET_SUPER_RES_TARGET_161
            DET_SUPER_RES_TARGET_162_oRDR_DETECTION_161_164_oPCAN_RADAR_0f1a6bbb_Tx: ComBitPosition=199, ComBitSize=1, ComSignalInitValue=0, ComSignalType=BOOLEAN, ComSystemTemplateSystemSignalRef=DET_SUPER_RES_TARGET_162
            DET_SUPER_RES_TARGET_163_oRDR_DETECTION_161_164_oPCAN_RADAR_9a6abf2e_Tx: ComBitPosition=311, ComBitSize=1, ComSignalInitValue=0, ComSignalType=BOOLEAN, ComSystemTemplateSystemSignalRef=DET_SUPER_RES_TARGET_163
            DET_SUPER_RES_TARGET_164_oRDR_DETECTION_161_164_oPCAN_RADAR_c6da9c47_Tx: ComBitPosition=423, ComBitSize=1, ComSignalInitValue=0, ComSignalType=BOOLEAN, ComSystemTemplateSystemSignalRef=DET_SUPER_RES_TARGET_164
        SG_Detections_165_168_oRDR_DETECTION_165_168_oPCAN_RADAR_b3bd63bd_Tx: ComSystemTemplateSignalGroupRef=SG_Detections_165_168
          83 x ComGroupSignal, all with ComSignalEndianness=LITTLE_ENDIAN, ComTransferProperty=PENDING:
            DET_AZIMUTH_165_oRDR_DETECTION_165_168_oPCAN_RADAR_b4922c45_Tx: ComBitPosition=88, ComBitSize=13, ComSignalInitValue=0, ComSignalType=UINT16, ComSystemTemplateSystemSignalRef=DET_AZIMUTH_165
            DET_AZIMUTH_166_oRDR_DETECTION_165_168_oPCAN_RADAR_d07257bb_Tx: ComBitPosition=200, ComBitSize=13, ComSignalInitValue=0, ComSignalType=UINT16, ComSystemTemplateSystemSignalRef=DET_AZIMUTH_166
            DET_AZIMUTH_167_oRDR_DETECTION_165_168_oPCAN_RADAR_4502832e_Tx: ComBitPosition=312, ComBitSize=13, ComSignalInitValue=0, ComSignalType=UINT16, ComSystemTemplateSystemSignalRef=DET_AZIMUTH_167
            DET_AZIMUTH_168_oRDR_DETECTION_165_168_oPCAN_RADAR_69121169_Tx: ComBitPosition=424, ComBitSize=13, ComSignalInitValue=0, ComSignalType=UINT16, ComSystemTemplateSystemSignalRef=DET_AZIMUTH_168
            DET_AZIMUTH_ERR_165_oRDR_DETECTION_165_168_oPCAN_RADAR_1027b9b0_Tx: ComBitPosition=105, ComBitSize=7, ComSignalInitValue=0, ComSignalType=UINT8, ComSystemTemplateSystemSignalRef=DET_AZIMUTH_ERR_165
            DET_AZIMUTH_ERR_166_oRDR_DETECTION_165_168_oPCAN_RADAR_74c7c24e_Tx: ComBitPosition=217, ComBitSize=7, ComSignalInitValue=0, ComSignalType=UINT8, ComSystemTemplateSystemSignalRef=DET_AZIMUTH_ERR_166
            DET_AZIMUTH_ERR_167_oRDR_DETECTION_165_168_oPCAN_RADAR_e1b716db_Tx: ComBitPosition=329, ComBitSize=7, ComSignalInitValue=0, ComSignalType=UINT8, ComSystemTemplateSystemSignalRef=DET_AZIMUTH_ERR_167
            DET_AZIMUTH_ERR_168_oRDR_DETECTION_165_168_oPCAN_RADAR_cda7849c_Tx: ComBitPosition=441, ComBitSize=7, ComSignalInitValue=0, ComSignalType=UINT8, ComSystemTemplateSystemSignalRef=DET_AZIMUTH_ERR_168
            DET_BELOW_RAIN_THOLD_165_oRDR_DETECTION_165_168_oPCAN_RADAR_6193bf85_Tx: ComBitPosition=39, ComBitSize=1, ComSignalInitValue=0, ComSignalType=BOOLEAN, ComSystemTemplateSystemSignalRef=DET_BELOW_RAIN_THOLD_165
            DET_BELOW_RAIN_THOLD_166_oRDR_DETECTION_165_168_oPCAN_RADAR_0573c47b_Tx: ComBitPosition=151, ComBitSize=1, ComSignalInitValue=0, ComSignalType=BOOLEAN, ComSystemTemplateSystemSignalRef=DET_BELOW_RAIN_THOLD_166
            DET_BELOW_RAIN_THOLD_167_oRDR_DETECTION_165_168_oPCAN_RADAR_900310ee_Tx: ComBitPosition=263, ComBitSize=1, ComSignalInitValue=0, ComSignalType=BOOLEAN, ComSystemTemplateSystemSignalRef=DET_BELOW_RAIN_THOLD_167
            DET_BELOW_RAIN_THOLD_168_oRDR_DETECTION_165_168_oPCAN_RADAR_bc1382a9_Tx: ComBitPosition=375, ComBitSize=1, ComSignalInitValue=0, ComSignalType=BOOLEAN, ComSystemTemplateSystemSignalRef=DET_BELOW_RAIN_THOLD_168
            DET_BI_STATIC_FLAG_165_oRDR_DETECTION_165_168_oPCAN_RADAR_e2be6cc0_Tx: ComBitPosition=104, ComBitSize=1, ComSignalInitValue=0, ComSignalType=BOOLEAN, ComSystemTemplateSystemSignalRef=DET_BI_STATIC_FLAG_165
            DET_BI_STATIC_FLAG_166_oRDR_DETECTION_165_168_oPCAN_RADAR_865e173e_Tx: ComBitPosition=216, ComBitSize=1, ComSignalInitValue=0, ComSignalType=BOOLEAN, ComSystemTemplateSystemSignalRef=DET_BI_STATIC_FLAG_166
            DET_BI_STATIC_FLAG_167_oRDR_DETECTION_165_168_oPCAN_RADAR_132ec3ab_Tx: ComBitPosition=328, ComBitSize=1, ComSignalInitValue=0, ComSignalType=BOOLEAN, ComSystemTemplateSystemSignalRef=DET_BI_STATIC_FLAG_167
            DET_BI_STATIC_FLAG_168_oRDR_DETECTION_165_168_oPCAN_RADAR_3f3e51ec_Tx: ComBitPosition=440, ComBitSize=1, ComSignalInitValue=0, ComSignalType=BOOLEAN, ComSystemTemplateSystemSignalRef=DET_BI_STATIC_FLAG_168
            DET_CONFD_AZIMUTH_165_oRDR_DETECTION_165_168_oPCAN_RADAR_b674268f_Tx: ComBitPosition=118, ComBitSize=2, ComSignalInitValue=0, ComSignalType=UINT8, ComSystemTemplateSystemSignalRef=DET_CONFD_AZIMUTH_165
            DET_CONFD_AZIMUTH_166_oRDR_DETECTION_165_168_oPCAN_RADAR_d2945d71_Tx: ComBitPosition=230, ComBitSize=2, ComSignalInitValue=0, ComSignalType=UINT8, ComSystemTemplateSystemSignalRef=DET_CONFD_AZIMUTH_166
            DET_CONFD_AZIMUTH_167_oRDR_DETECTION_165_168_oPCAN_RADAR_47e489e4_Tx: ComBitPosition=342, ComBitSize=2, ComSignalInitValue=0, ComSignalType=UINT8, ComSystemTemplateSystemSignalRef=DET_CONFD_AZIMUTH_167
            DET_CONFD_AZIMUTH_168_oRDR_DETECTION_165_168_oPCAN_RADAR_6bf41ba3_Tx: ComBitPosition=454, ComBitSize=2, ComSignalInitValue=0, ComSignalType=UINT8, ComSystemTemplateSystemSignalRef=DET_CONFD_AZIMUTH_168
            DET_CONFD_ELEVATION_165_oRDR_DETECTION_165_168_oPCAN_RADAR_b4e12775_Tx: ComBitPosition=101, ComBitSize=2, ComSignalInitValue=0, ComSignalType=UINT8, ComSystemTemplateSystemSignalRef=DET_CONFD_ELEVATION_165
            DET_CONFD_ELEVATION_166_oRDR_DETECTION_165_168_oPCAN_RADAR_d0015c8b_Tx: ComBitPosition=213, ComBitSize=2, ComSignalInitValue=0, ComSignalType=UINT8, ComSystemTemplateSystemSignalRef=DET_CONFD_ELEVATION_166
            DET_CONFD_ELEVATION_167_oRDR_DETECTION_165_168_oPCAN_RADAR_4571881e_Tx: ComBitPosition=325, ComBitSize=2, ComSignalInitValue=0, ComSignalType=UINT8, ComSystemTemplateSystemSignalRef=DET_CONFD_ELEVATION_167
            DET_CONFD_ELEVATION_168_oRDR_DETECTION_165_168_oPCAN_RADAR_69611a59_Tx: ComBitPosition=437, ComBitSize=2, ComSignalInitValue=0, ComSignalType=UINT8, ComSystemTemplateSystemSignalRef=DET_CONFD_ELEVATION_168
            DET_ELEVATION_165_oRDR_DETECTION_165_168_oPCAN_RADAR_6521f349_Tx: ComBitPosition=72, ComBitSize=8, ComSignalInitValue=0, ComSignalType=UINT8, ComSystemTemplateSystemSignalRef=DET_ELEVATION_165
            DET_ELEVATION_166_oRDR_DETECTION_165_168_oPCAN_RADAR_01c188b7_Tx: ComBitPosition=184, ComBitSize=8, ComSignalInitValue=0, ComSignalType=UINT8, ComSystemTemplateSystemSignalRef=DET_ELEVATION_166
            DET_ELEVATION_167_oRDR_DETECTION_165_168_oPCAN_RADAR_94b15c22_Tx: ComBitPosition=296, ComBitSize=8, ComSignalInitValue=0, ComSignalType=UINT8, ComSystemTemplateSystemSignalRef=DET_ELEVATION_167
            DET_ELEVATION_168_oRDR_DETECTION_165_168_oPCAN_RADAR_b8a1ce65_Tx: ComBitPosition=408, ComBitSize=8, ComSignalInitValue=0, ComSignalType=UINT8, ComSystemTemplateSystemSignalRef=DET_ELEVATION_168
            DET_ELEVATION_ERR_165_oRDR_DETECTION_165_168_oPCAN_RADAR_e2186b3c_Tx: ComBitPosition=80, ComBitSize=6, ComSignalInitValue=0, ComSignalType=UINT8, ComSystemTemplateSystemSignalRef=DET_ELEVATION_ERR_165
            DET_ELEVATION_ERR_166_oRDR_DETECTION_165_168_oPCAN_RADAR_86f810c2_Tx: ComBitPosition=192, ComBitSize=6, ComSignalInitValue=0, ComSignalType=UINT8, ComSystemTemplateSystemSignalRef=DET_ELEVATION_ERR_166
            DET_ELEVATION_ERR_167_oRDR_DETECTION_165_168_oPCAN_RADAR_1388c457_Tx: ComBitPosition=304, ComBitSize=6, ComSignalInitValue=0, ComSignalType=UINT8, ComSystemTemplateSystemSignalRef=DET_ELEVATION_ERR_167
            DET_ELEVATION_ERR_168_oRDR_DETECTION_165_168_oPCAN_RADAR_3f985610_Tx: ComBitPosition=416, ComBitSize=6, ComSignalInitValue=0, ComSignalType=UINT8, ComSystemTemplateSystemSignalRef=DET_ELEVATION_ERR_168
            DET_EXISTENCE_PROB_165_oRDR_DETECTION_165_168_oPCAN_RADAR_30871e5c_Tx: ComBitPosition=112, ComBitSize=6, ComSignalInitValue=0, ComSignalType=UINT8, ComSystemTemplateSystemSignalRef=DET_EXISTENCE_PROB_165
            DET_EXISTENCE_PROB_166_oRDR_DETECTION_165_168_oPCAN_RADAR_546765a2_Tx: ComBitPosition=224, ComBitSize=6, ComSignalInitValue=0, ComSignalType=UINT8, ComSystemTemplateSystemSignalRef=DET_EXISTENCE_PROB_166
            DET_EXISTENCE_PROB_167_oRDR_DETECTION_165_168_oPCAN_RADAR_c117b137_Tx: ComBitPosition=336, ComBitSize=6, ComSignalInitValue=0, ComSignalType=UINT8, ComSystemTemplateSystemSignalRef=DET_EXISTENCE_PROB_167
            DET_EXISTENCE_PROB_168_oRDR_DETECTION_165_168_oPCAN_RADAR_ed072370_Tx: ComBitPosition=448, ComBitSize=6, ComSignalInitValue=0, ComSignalType=UINT8, ComSystemTemplateSystemSignalRef=DET_EXISTENCE_PROB_168
            DET_HVC_FLAG_165_oRDR_DETECTION_165_168_oPCAN_RADAR_d1f35d23_Tx: ComBitPosition=86, ComBitSize=1, ComSignalInitValue=0, ComSignalType=BOOLEAN, ComSystemTemplateSystemSignalRef=DET_HVC_FLAG_165
            DET_HVC_FLAG_166_oRDR_DETECTION_165_168_oPCAN_RADAR_b51326dd_Tx: ComBitPosition=198, ComBitSize=1, ComSignalInitValue=0, ComSignalType=BOOLEAN, ComSystemTemplateSystemSignalRef=DET_HVC_FLAG_166
            DET_HVC_FLAG_167_oRDR_DETECTION_165_168_oPCAN_RADAR_2063f248_Tx: ComBitPosition=310, ComBitSize=1, ComSignalInitValue=0, ComSignalType=BOOLEAN, ComSystemTemplateSystemSignalRef=DET_HVC_FLAG_167
            DET_HVC_FLAG_168_oRDR_DETECTION_165_168_oPCAN_RADAR_0c73600f_Tx: ComBitPosition=422, ComBitSize=1, ComSignalInitValue=0, ComSignalType=BOOLEAN, ComSystemTemplateSystemSignalRef=DET_HVC_FLAG_168
            DET_IDM_165_oRDR_DETECTION_165_168_oPCAN_RADAR_5aa1669e_Tx: ComBitPosition=63, ComBitSize=1, ComSignalInitValue=0, ComSignalType=BOOLEAN, ComSystemTemplateSystemSignalRef=DET_IDM_165
            DET_IDM_166_oRDR_DETECTION_165_168_oPCAN_RADAR_3e411d60_Tx: ComBitPosition=175, ComBitSize=1, ComSignalInitValue=0, ComSignalType=BOOLEAN, ComSystemTemplateSystemSignalRef=DET_IDM_166
            DET_IDM_167_oRDR_DETECTION_165_168_oPCAN_RADAR_ab31c9f5_Tx: ComBitPosition=287, ComBitSize=1, ComSignalInitValue=0, ComSignalType=BOOLEAN, ComSystemTemplateSystemSignalRef=DET_IDM_167
            DET_IDM_168_oRDR_DETECTION_165_168_oPCAN_RADAR_87215bb2_Tx: ComBitPosition=399, ComBitSize=1, ComSignalInitValue=0, ComSignalType=BOOLEAN, ComSystemTemplateSystemSignalRef=DET_IDM_168
            DET_MH_CRC16_165_168_oRDR_DETECTION_165_168_oPCAN_RADAR_3735b1b6_Tx: ComBitPosition=0, ComBitSize=16, ComSignalInitValue=0, ComSignalType=UINT16, ComSystemTemplateSystemSignalRef=DET_MH_CRC16_165_168
            DET_MH_CYCLE_COUNTER_165_168_oRDR_DETECTION_165_168_oPCAN_RADAR_b3401081_Tx: ComBitPosition=16, ComBitSize=8, ComSignalInitValue=0, ComSignalType=UINT8, ComSystemTemplateSystemSignalRef=DET_MH_CYCLE_COUNTER_165_168
            DET_MH_SCAN_INDEX_4LSB_165_168_oRDR_DETECTION_165_168_oPCAN_RADAR_7f6a350d_Tx: ComBitPosition=476, ComBitSize=4, ComSignalInitValue=0, ComSignalType=UINT8, ComSystemTemplateSystemSignalRef=DET_MH_SCAN_INDEX_4LSB_165_168
            DET_MTD_165_oRDR_DETECTION_165_168_oPCAN_RADAR_3c125445_Tx: ComBitPosition=47, ComBitSize=1, ComSignalInitValue=0, ComSignalType=BOOLEAN, ComSystemTemplateSystemSignalRef=DET_MTD_165
            DET_MTD_166_oRDR_DETECTION_165_168_oPCAN_RADAR_58f22fbb_Tx: ComBitPosition=159, ComBitSize=1, ComSignalInitValue=0, ComSignalType=BOOLEAN, ComSystemTemplateSystemSignalRef=DET_MTD_166
            DET_MTD_167_oRDR_DETECTION_165_168_oPCAN_RADAR_cd82fb2e_Tx: ComBitPosition=271, ComBitSize=1, ComSignalInitValue=0, ComSignalType=BOOLEAN, ComSystemTemplateSystemSignalRef=DET_MTD_167
            DET_MTD_168_oRDR_DETECTION_165_168_oPCAN_RADAR_e1926969_Tx: ComBitPosition=383, ComBitSize=1, ComSignalInitValue=0, ComSignalType=BOOLEAN, ComSystemTemplateSystemSignalRef=DET_MTD_168
            DET_PROB_1STAZHYPO_165_oRDR_DETECTION_165_168_oPCAN_RADAR_afa6bc88_Tx: ComBitPosition=103, ComBitSize=1, ComSignalInitValue=0, ComSignalType=BOOLEAN, ComSystemTemplateSystemSignalRef=DET_PROB_1STAZHYPO_165
            DET_PROB_1STAZHYPO_166_oRDR_DETECTION_165_168_oPCAN_RADAR_cb46c776_Tx: ComBitPosition=215, ComBitSize=1, ComSignalInitValue=0, ComSignalType=BOOLEAN, ComSystemTemplateSystemSignalRef=DET_PROB_1STAZHYPO_166
            DET_PROB_1STAZHYPO_167_oRDR_DETECTION_165_168_oPCAN_RADAR_5e3613e3_Tx: ComBitPosition=327, ComBitSize=1, ComSignalInitValue=0, ComSignalType=BOOLEAN, ComSystemTemplateSystemSignalRef=DET_PROB_1STAZHYPO_167
            DET_PROB_1STAZHYPO_168_oRDR_DETECTION_165_168_oPCAN_RADAR_722681a4_Tx: ComBitPosition=439, ComBitSize=1, ComSignalInitValue=0, ComSignalType=BOOLEAN, ComSystemTemplateSystemSignalRef=DET_PROB_1STAZHYPO_168
            DET_RANGE_165_oRDR_DETECTION_165_168_oPCAN_RADAR_a4095ffe_Tx: ComBitPosition=24, ComBitSize=15, ComSignalInitValue=0, ComSignalType=UINT16, ComSystemTemplateSystemSignalRef=DET_RANGE_165
            DET_RANGE_166_oRDR_DETECTION_165_168_oPCAN_RADAR_c0e92400_Tx: ComBitPosition=136, ComBitSize=15, ComSignalInitValue=0, ComSignalType=UINT16, ComSystemTemplateSystemSignalRef=DET_RANGE_166
            DET_RANGE_167_oRDR_DETECTION_165_168_oPCAN_RADAR_5599f095_Tx: ComBitPosition=248, ComBitSize=15, ComSignalInitValue=0, ComSignalType=UINT16, ComSystemTemplateSystemSignalRef=DET_RANGE_167
            DET_RANGE_168_oRDR_DETECTION_165_168_oPCAN_RADAR_798962d2_Tx: ComBitPosition=360, ComBitSize=15, ComSignalInitValue=0, ComSignalType=UINT16, ComSystemTemplateSystemSignalRef=DET_RANGE_168
            DET_RANGE_ERR_165_oRDR_DETECTION_165_168_oPCAN_RADAR_03e1e597_Tx: ComBitPosition=40, ComBitSize=7, ComSignalInitValue=0, ComSignalType=UINT8, ComSystemTemplateSystemSignalRef=DET_RANGE_ERR_165
            DET_RANGE_ERR_166_oRDR_DETECTION_165_168_oPCAN_RADAR_67019e69_Tx: ComBitPosition=152, ComBitSize=7, ComSignalInitValue=0, ComSignalType=UINT8, ComSystemTemplateSystemSignalRef=DET_RANGE_ERR_166
            DET_RANGE_ERR_167_oRDR_DETECTION_165_168_oPCAN_RADAR_f2714afc_Tx: ComBitPosition=264, ComBitSize=7, ComSignalInitValue=0, ComSignalType=UINT8, ComSystemTemplateSystemSignalRef=DET_RANGE_ERR_167
            DET_RANGE_ERR_168_oRDR_DETECTION_165_168_oPCAN_RADAR_de61d8bb_Tx: ComBitPosition=376, ComBitSize=7, ComSignalInitValue=0, ComSignalType=UINT8, ComSystemTemplateSystemSignalRef=DET_RANGE_ERR_168
            DET_RANGE_VELOCITY_165_oRDR_DETECTION_165_168_oPCAN_RADAR_d1af9ddb_Tx: ComBitPosition=48, ComBitSize=15, ComSignalInitValue=16384, ComSignalType=UINT16, ComSystemTemplateSystemSignalRef=DET_RANGE_VELOCITY_165
            DET_RANGE_VELOCITY_166_oRDR_DETECTION_165_168_oPCAN_RADAR_b54fe625_Tx: ComBitPosition=160, ComBitSize=15, ComSignalInitValue=16384, ComSignalType=UINT16, ComSystemTemplateSystemSignalRef=DET_RANGE_VELOCITY_166
            DET_RANGE_VELOCITY_167_oRDR_DETECTION_165_168_oPCAN_RADAR_203f32b0_Tx: ComBitPosition=272, ComBitSize=15, ComSignalInitValue=16384, ComSignalType=UINT16, ComSystemTemplateSystemSignalRef=DET_RANGE_VELOCITY_167
            DET_RANGE_VELOCITY_168_oRDR_DETECTION_165_168_oPCAN_RADAR_0c2fa0f7_Tx: ComBitPosition=384, ComBitSize=15, ComSignalInitValue=16384, ComSignalType=UINT16, ComSystemTemplateSystemSignalRef=DET_RANGE_VELOCITY_168
            DET_RANGE_VELOCITY_ERR_165_oRDR_DETECTION_165_168_oPCAN_RADAR_de146669_Tx: ComBitPosition=64, ComBitSize=8, ComSignalInitValue=0, ComSignalType=UINT8, ComSystemTemplateSystemSignalRef=DET_RANGE_VELOCITY_ERR_165
            DET_RANGE_VELOCITY_ERR_166_oRDR_DETECTION_165_168_oPCAN_RADAR_baf41d97_Tx: ComBitPosition=176, ComBitSize=8, ComSignalInitValue=0, ComSignalType=UINT8, ComSystemTemplateSystemSignalRef=DET_RANGE_VELOCITY_ERR_166
            DET_RANGE_VELOCITY_ERR_167_oRDR_DETECTION_165_168_oPCAN_RADAR_2f84c902_Tx: ComBitPosition=288, ComBitSize=8, ComSignalInitValue=0, ComSignalType=UINT8, ComSystemTemplateSystemSignalRef=DET_RANGE_VELOCITY_ERR_167
            DET_RANGE_VELOCITY_ERR_168_oRDR_DETECTION_165_168_oPCAN_RADAR_03945b45_Tx: ComBitPosition=400, ComBitSize=8, ComSignalInitValue=0, ComSignalType=UINT8, ComSystemTemplateSystemSignalRef=DET_RANGE_VELOCITY_ERR_168
            DET_RCS_165_oRDR_DETECTION_165_168_oPCAN_RADAR_562faa81_Tx: ComBitPosition=128, ComBitSize=8, ComSignalInitValue=128, ComSignalType=UINT8, ComSystemTemplateSystemSignalRef=DET_RCS_165
            DET_RCS_166_oRDR_DETECTION_165_168_oPCAN_RADAR_32cfd17f_Tx: ComBitPosition=240, ComBitSize=8, ComSignalInitValue=128, ComSignalType=UINT8, ComSystemTemplateSystemSignalRef=DET_RCS_166
            DET_RCS_167_oRDR_DETECTION_165_168_oPCAN_RADAR_a7bf05ea_Tx: ComBitPosition=352, ComBitSize=8, ComSignalInitValue=128, ComSignalType=UINT8, ComSystemTemplateSystemSignalRef=DET_RCS_167
            DET_RCS_168_oRDR_DETECTION_165_168_oPCAN_RADAR_8baf97ad_Tx: ComBitPosition=464, ComBitSize=8, ComSignalInitValue=128, ComSignalType=UINT8, ComSystemTemplateSystemSignalRef=DET_RCS_168
            DET_SNR_165_oRDR_DETECTION_165_168_oPCAN_RADAR_8b81fe83_Tx: ComBitPosition=120, ComBitSize=8, ComSignalInitValue=0, ComSignalType=UINT8, ComSystemTemplateSystemSignalRef=DET_SNR_165
            DET_SNR_166_oRDR_DETECTION_165_168_oPCAN_RADAR_ef61857d_Tx: ComBitPosition=232, ComBitSize=8, ComSignalInitValue=0, ComSignalType=UINT8, ComSystemTemplateSystemSignalRef=DET_SNR_166
            DET_SNR_167_oRDR_DETECTION_165_168_oPCAN_RADAR_7a1151e8_Tx: ComBitPosition=344, ComBitSize=8, ComSignalInitValue=0, ComSignalType=UINT8, ComSystemTemplateSystemSignalRef=DET_SNR_167
            DET_SNR_168_oRDR_DETECTION_165_168_oPCAN_RADAR_5601c3af_Tx: ComBitPosition=456, ComBitSize=8, ComSignalInitValue=0, ComSignalType=UINT8, ComSystemTemplateSystemSignalRef=DET_SNR_168
            DET_SUPER_RES_TARGET_165_oRDR_DETECTION_165_168_oPCAN_RADAR_ba18d6e6_Tx: ComBitPosition=87, ComBitSize=1, ComSignalInitValue=0, ComSignalType=BOOLEAN, ComSystemTemplateSystemSignalRef=DET_SUPER_RES_TARGET_165
            DET_SUPER_RES_TARGET_166_oRDR_DETECTION_165_168_oPCAN_RADAR_def8ad18_Tx: ComBitPosition=199, ComBitSize=1, ComSignalInitValue=0, ComSignalType=BOOLEAN, ComSystemTemplateSystemSignalRef=DET_SUPER_RES_TARGET_166
            DET_SUPER_RES_TARGET_167_oRDR_DETECTION_165_168_oPCAN_RADAR_4b88798d_Tx: ComBitPosition=311, ComBitSize=1, ComSignalInitValue=0, ComSignalType=BOOLEAN, ComSystemTemplateSystemSignalRef=DET_SUPER_RES_TARGET_167
            DET_SUPER_RES_TARGET_168_oRDR_DETECTION_165_168_oPCAN_RADAR_6798ebca_Tx: ComBitPosition=423, ComBitSize=1, ComSignalInitValue=0, ComSignalType=BOOLEAN, ComSystemTemplateSystemSignalRef=DET_SUPER_RES_TARGET_168
        SG_Detections_169_172_oRDR_DETECTION_169_172_oPCAN_RADAR_2ac747c6_Tx: ComSystemTemplateSignalGroupRef=SG_Detections_169_172
          83 x ComGroupSignal, all with ComSignalEndianness=LITTLE_ENDIAN, ComTransferProperty=PENDING:
            DET_AZIMUTH_169_oRDR_DETECTION_169_172_oPCAN_RADAR_ce2a2afd_Tx: ComBitPosition=88, ComBitSize=13, ComSignalInitValue=0, ComSignalType=UINT16, ComSystemTemplateSystemSignalRef=DET_AZIMUTH_169
            DET_AZIMUTH_170_oRDR_DETECTION_169_172_oPCAN_RADAR_ab0a5859_Tx: ComBitPosition=200, ComBitSize=13, ComSignalInitValue=0, ComSignalType=UINT16, ComSystemTemplateSystemSignalRef=DET_AZIMUTH_170
            DET_AZIMUTH_171_oRDR_DETECTION_169_172_oPCAN_RADAR_3e7a8ccc_Tx: ComBitPosition=312, ComBitSize=13, ComSignalInitValue=0, ComSignalType=UINT16, ComSystemTemplateSystemSignalRef=DET_AZIMUTH_171
            DET_AZIMUTH_172_oRDR_DETECTION_169_172_oPCAN_RADAR_5a9af732_Tx: ComBitPosition=424, ComBitSize=13, ComSignalInitValue=0, ComSignalType=UINT16, ComSystemTemplateSystemSignalRef=DET_AZIMUTH_172
            DET_AZIMUTH_ERR_169_oRDR_DETECTION_169_172_oPCAN_RADAR_6a9fbf08_Tx: ComBitPosition=105, ComBitSize=7, ComSignalInitValue=0, ComSignalType=UINT8, ComSystemTemplateSystemSignalRef=DET_AZIMUTH_ERR_169
            DET_AZIMUTH_ERR_170_oRDR_DETECTION_169_172_oPCAN_RADAR_0fbfcdac_Tx: ComBitPosition=217, ComBitSize=7, ComSignalInitValue=0, ComSignalType=UINT8, ComSystemTemplateSystemSignalRef=DET_AZIMUTH_ERR_170
            DET_AZIMUTH_ERR_171_oRDR_DETECTION_169_172_oPCAN_RADAR_9acf1939_Tx: ComBitPosition=329, ComBitSize=7, ComSignalInitValue=0, ComSignalType=UINT8, ComSystemTemplateSystemSignalRef=DET_AZIMUTH_ERR_171
            DET_AZIMUTH_ERR_172_oRDR_DETECTION_169_172_oPCAN_RADAR_fe2f62c7_Tx: ComBitPosition=441, ComBitSize=7, ComSignalInitValue=0, ComSignalType=UINT8, ComSystemTemplateSystemSignalRef=DET_AZIMUTH_ERR_172
            DET_BELOW_RAIN_THOLD_169_oRDR_DETECTION_169_172_oPCAN_RADAR_1b2bb93d_Tx: ComBitPosition=39, ComBitSize=1, ComSignalInitValue=0, ComSignalType=BOOLEAN, ComSystemTemplateSystemSignalRef=DET_BELOW_RAIN_THOLD_169
            DET_BELOW_RAIN_THOLD_170_oRDR_DETECTION_169_172_oPCAN_RADAR_7e0bcb99_Tx: ComBitPosition=151, ComBitSize=1, ComSignalInitValue=0, ComSignalType=BOOLEAN, ComSystemTemplateSystemSignalRef=DET_BELOW_RAIN_THOLD_170
            DET_BELOW_RAIN_THOLD_171_oRDR_DETECTION_169_172_oPCAN_RADAR_eb7b1f0c_Tx: ComBitPosition=263, ComBitSize=1, ComSignalInitValue=0, ComSignalType=BOOLEAN, ComSystemTemplateSystemSignalRef=DET_BELOW_RAIN_THOLD_171
            DET_BELOW_RAIN_THOLD_172_oRDR_DETECTION_169_172_oPCAN_RADAR_8f9b64f2_Tx: ComBitPosition=375, ComBitSize=1, ComSignalInitValue=0, ComSignalType=BOOLEAN, ComSystemTemplateSystemSignalRef=DET_BELOW_RAIN_THOLD_172
            DET_BI_STATIC_FLAG_169_oRDR_DETECTION_169_172_oPCAN_RADAR_98066a78_Tx: ComBitPosition=104, ComBitSize=1, ComSignalInitValue=0, ComSignalType=BOOLEAN, ComSystemTemplateSystemSignalRef=DET_BI_STATIC_FLAG_169
            DET_BI_STATIC_FLAG_170_oRDR_DETECTION_169_172_oPCAN_RADAR_fd2618dc_Tx: ComBitPosition=216, ComBitSize=1, ComSignalInitValue=0, ComSignalType=BOOLEAN, ComSystemTemplateSystemSignalRef=DET_BI_STATIC_FLAG_170
            DET_BI_STATIC_FLAG_171_oRDR_DETECTION_169_172_oPCAN_RADAR_6856cc49_Tx: ComBitPosition=328, ComBitSize=1, ComSignalInitValue=0, ComSignalType=BOOLEAN, ComSystemTemplateSystemSignalRef=DET_BI_STATIC_FLAG_171
            DET_BI_STATIC_FLAG_172_oRDR_DETECTION_169_172_oPCAN_RADAR_0cb6b7b7_Tx: ComBitPosition=440, ComBitSize=1, ComSignalInitValue=0, ComSignalType=BOOLEAN, ComSystemTemplateSystemSignalRef=DET_BI_STATIC_FLAG_172
            DET_CONFD_AZIMUTH_169_oRDR_DETECTION_169_172_oPCAN_RADAR_cccc2037_Tx: ComBitPosition=118, ComBitSize=2, ComSignalInitValue=0, ComSignalType=UINT8, ComSystemTemplateSystemSignalRef=DET_CONFD_AZIMUTH_169
            DET_CONFD_AZIMUTH_170_oRDR_DETECTION_169_172_oPCAN_RADAR_a9ec5293_Tx: ComBitPosition=230, ComBitSize=2, ComSignalInitValue=0, ComSignalType=UINT8, ComSystemTemplateSystemSignalRef=DET_CONFD_AZIMUTH_170
            DET_CONFD_AZIMUTH_171_oRDR_DETECTION_169_172_oPCAN_RADAR_3c9c8606_Tx: ComBitPosition=342, ComBitSize=2, ComSignalInitValue=0, ComSignalType=UINT8, ComSystemTemplateSystemSignalRef=DET_CONFD_AZIMUTH_171
            DET_CONFD_AZIMUTH_172_oRDR_DETECTION_169_172_oPCAN_RADAR_587cfdf8_Tx: ComBitPosition=454, ComBitSize=2, ComSignalInitValue=0, ComSignalType=UINT8, ComSystemTemplateSystemSignalRef=DET_CONFD_AZIMUTH_172
            DET_CONFD_ELEVATION_169_oRDR_DETECTION_169_172_oPCAN_RADAR_ce5921cd_Tx: ComBitPosition=101, ComBitSize=2, ComSignalInitValue=0, ComSignalType=UINT8, ComSystemTemplateSystemSignalRef=DET_CONFD_ELEVATION_169
            DET_CONFD_ELEVATION_170_oRDR_DETECTION_169_172_oPCAN_RADAR_ab795369_Tx: ComBitPosition=213, ComBitSize=2, ComSignalInitValue=0, ComSignalType=UINT8, ComSystemTemplateSystemSignalRef=DET_CONFD_ELEVATION_170
            DET_CONFD_ELEVATION_171_oRDR_DETECTION_169_172_oPCAN_RADAR_3e0987fc_Tx: ComBitPosition=325, ComBitSize=2, ComSignalInitValue=0, ComSignalType=UINT8, ComSystemTemplateSystemSignalRef=DET_CONFD_ELEVATION_171
            DET_CONFD_ELEVATION_172_oRDR_DETECTION_169_172_oPCAN_RADAR_5ae9fc02_Tx: ComBitPosition=437, ComBitSize=2, ComSignalInitValue=0, ComSignalType=UINT8, ComSystemTemplateSystemSignalRef=DET_CONFD_ELEVATION_172
            DET_ELEVATION_169_oRDR_DETECTION_169_172_oPCAN_RADAR_1f99f5f1_Tx: ComBitPosition=72, ComBitSize=8, ComSignalInitValue=0, ComSignalType=UINT8, ComSystemTemplateSystemSignalRef=DET_ELEVATION_169
            DET_ELEVATION_170_oRDR_DETECTION_169_172_oPCAN_RADAR_7ab98755_Tx: ComBitPosition=184, ComBitSize=8, ComSignalInitValue=0, ComSignalType=UINT8, ComSystemTemplateSystemSignalRef=DET_ELEVATION_170
            DET_ELEVATION_171_oRDR_DETECTION_169_172_oPCAN_RADAR_efc953c0_Tx: ComBitPosition=296, ComBitSize=8, ComSignalInitValue=0, ComSignalType=UINT8, ComSystemTemplateSystemSignalRef=DET_ELEVATION_171
            DET_ELEVATION_172_oRDR_DETECTION_169_172_oPCAN_RADAR_8b29283e_Tx: ComBitPosition=408, ComBitSize=8, ComSignalInitValue=0, ComSignalType=UINT8, ComSystemTemplateSystemSignalRef=DET_ELEVATION_172
            DET_ELEVATION_ERR_169_oRDR_DETECTION_169_172_oPCAN_RADAR_98a06d84_Tx: ComBitPosition=80, ComBitSize=6, ComSignalInitValue=0, ComSignalType=UINT8, ComSystemTemplateSystemSignalRef=DET_ELEVATION_ERR_169
            DET_ELEVATION_ERR_170_oRDR_DETECTION_169_172_oPCAN_RADAR_fd801f20_Tx: ComBitPosition=192, ComBitSize=6, ComSignalInitValue=0, ComSignalType=UINT8, ComSystemTemplateSystemSignalRef=DET_ELEVATION_ERR_170
            DET_ELEVATION_ERR_171_oRDR_DETECTION_169_172_oPCAN_RADAR_68f0cbb5_Tx: ComBitPosition=304, ComBitSize=6, ComSignalInitValue=0, ComSignalType=UINT8, ComSystemTemplateSystemSignalRef=DET_ELEVATION_ERR_171
            DET_ELEVATION_ERR_172_oRDR_DETECTION_169_172_oPCAN_RADAR_0c10b04b_Tx: ComBitPosition=416, ComBitSize=6, ComSignalInitValue=0, ComSignalType=UINT8, ComSystemTemplateSystemSignalRef=DET_ELEVATION_ERR_172
            DET_EXISTENCE_PROB_169_oRDR_DETECTION_169_172_oPCAN_RADAR_4a3f18e4_Tx: ComBitPosition=112, ComBitSize=6, ComSignalInitValue=0, ComSignalType=UINT8, ComSystemTemplateSystemSignalRef=DET_EXISTENCE_PROB_169
            DET_EXISTENCE_PROB_170_oRDR_DETECTION_169_172_oPCAN_RADAR_2f1f6a40_Tx: ComBitPosition=224, ComBitSize=6, ComSignalInitValue=0, ComSignalType=UINT8, ComSystemTemplateSystemSignalRef=DET_EXISTENCE_PROB_170
            DET_EXISTENCE_PROB_171_oRDR_DETECTION_169_172_oPCAN_RADAR_ba6fbed5_Tx: ComBitPosition=336, ComBitSize=6, ComSignalInitValue=0, ComSignalType=UINT8, ComSystemTemplateSystemSignalRef=DET_EXISTENCE_PROB_171
            DET_EXISTENCE_PROB_172_oRDR_DETECTION_169_172_oPCAN_RADAR_de8fc52b_Tx: ComBitPosition=448, ComBitSize=6, ComSignalInitValue=0, ComSignalType=UINT8, ComSystemTemplateSystemSignalRef=DET_EXISTENCE_PROB_172
            DET_HVC_FLAG_169_oRDR_DETECTION_169_172_oPCAN_RADAR_ab4b5b9b_Tx: ComBitPosition=86, ComBitSize=1, ComSignalInitValue=0, ComSignalType=BOOLEAN, ComSystemTemplateSystemSignalRef=DET_HVC_FLAG_169
            DET_HVC_FLAG_170_oRDR_DETECTION_169_172_oPCAN_RADAR_ce6b293f_Tx: ComBitPosition=198, ComBitSize=1, ComSignalInitValue=0, ComSignalType=BOOLEAN, ComSystemTemplateSystemSignalRef=DET_HVC_FLAG_170
            DET_HVC_FLAG_171_oRDR_DETECTION_169_172_oPCAN_RADAR_5b1bfdaa_Tx: ComBitPosition=310, ComBitSize=1, ComSignalInitValue=0, ComSignalType=BOOLEAN, ComSystemTemplateSystemSignalRef=DET_HVC_FLAG_171
            DET_HVC_FLAG_172_oRDR_DETECTION_169_172_oPCAN_RADAR_3ffb8654_Tx: ComBitPosition=422, ComBitSize=1, ComSignalInitValue=0, ComSignalType=BOOLEAN, ComSystemTemplateSystemSignalRef=DET_HVC_FLAG_172
            DET_IDM_169_oRDR_DETECTION_169_172_oPCAN_RADAR_20196026_Tx: ComBitPosition=63, ComBitSize=1, ComSignalInitValue=0, ComSignalType=BOOLEAN, ComSystemTemplateSystemSignalRef=DET_IDM_169
            DET_IDM_170_oRDR_DETECTION_169_172_oPCAN_RADAR_45391282_Tx: ComBitPosition=175, ComBitSize=1, ComSignalInitValue=0, ComSignalType=BOOLEAN, ComSystemTemplateSystemSignalRef=DET_IDM_170
            DET_IDM_171_oRDR_DETECTION_169_172_oPCAN_RADAR_d049c617_Tx: ComBitPosition=287, ComBitSize=1, ComSignalInitValue=0, ComSignalType=BOOLEAN, ComSystemTemplateSystemSignalRef=DET_IDM_171
            DET_IDM_172_oRDR_DETECTION_169_172_oPCAN_RADAR_b4a9bde9_Tx: ComBitPosition=399, ComBitSize=1, ComSignalInitValue=0, ComSignalType=BOOLEAN, ComSystemTemplateSystemSignalRef=DET_IDM_172
            DET_MH_CRC16_169_172_oRDR_DETECTION_169_172_oPCAN_RADAR_ae4f95cd_Tx: ComBitPosition=0, ComBitSize=16, ComSignalInitValue=0, ComSignalType=UINT16, ComSystemTemplateSystemSignalRef=DET_MH_CRC16_169_172
            DET_MH_CYCLE_COUNTER_169_172_oRDR_DETECTION_169_172_oPCAN_RADAR_2a3a34fa_Tx: ComBitPosition=16, ComBitSize=8, ComSignalInitValue=0, ComSignalType=UINT8, ComSystemTemplateSystemSignalRef=DET_MH_CYCLE_COUNTER_169_172
            DET_MH_SCAN_INDEX_4LSB_169_172_oRDR_DETECTION_169_172_oPCAN_RADAR_e6101176_Tx: ComBitPosition=476, ComBitSize=4, ComSignalInitValue=0, ComSignalType=UINT8, ComSystemTemplateSystemSignalRef=DET_MH_SCAN_INDEX_4LSB_169_172
            DET_MTD_169_oRDR_DETECTION_169_172_oPCAN_RADAR_46aa52fd_Tx: ComBitPosition=47, ComBitSize=1, ComSignalInitValue=0, ComSignalType=BOOLEAN, ComSystemTemplateSystemSignalRef=DET_MTD_169
            DET_MTD_170_oRDR_DETECTION_169_172_oPCAN_RADAR_238a2059_Tx: ComBitPosition=159, ComBitSize=1, ComSignalInitValue=0, ComSignalType=BOOLEAN, ComSystemTemplateSystemSignalRef=DET_MTD_170
            DET_MTD_171_oRDR_DETECTION_169_172_oPCAN_RADAR_b6faf4cc_Tx: ComBitPosition=271, ComBitSize=1, ComSignalInitValue=0, ComSignalType=BOOLEAN, ComSystemTemplateSystemSignalRef=DET_MTD_171
            DET_MTD_172_oRDR_DETECTION_169_172_oPCAN_RADAR_d21a8f32_Tx: ComBitPosition=383, ComBitSize=1, ComSignalInitValue=0, ComSignalType=BOOLEAN, ComSystemTemplateSystemSignalRef=DET_MTD_172
            DET_PROB_1STAZHYPO_169_oRDR_DETECTION_169_172_oPCAN_RADAR_d51eba30_Tx: ComBitPosition=103, ComBitSize=1, ComSignalInitValue=0, ComSignalType=BOOLEAN, ComSystemTemplateSystemSignalRef=DET_PROB_1STAZHYPO_169
            DET_PROB_1STAZHYPO_170_oRDR_DETECTION_169_172_oPCAN_RADAR_b03ec894_Tx: ComBitPosition=215, ComBitSize=1, ComSignalInitValue=0, ComSignalType=BOOLEAN, ComSystemTemplateSystemSignalRef=DET_PROB_1STAZHYPO_170
            DET_PROB_1STAZHYPO_171_oRDR_DETECTION_169_172_oPCAN_RADAR_254e1c01_Tx: ComBitPosition=327, ComBitSize=1, ComSignalInitValue=0, ComSignalType=BOOLEAN, ComSystemTemplateSystemSignalRef=DET_PROB_1STAZHYPO_171
            DET_PROB_1STAZHYPO_172_oRDR_DETECTION_169_172_oPCAN_RADAR_41ae67ff_Tx: ComBitPosition=439, ComBitSize=1, ComSignalInitValue=0, ComSignalType=BOOLEAN, ComSystemTemplateSystemSignalRef=DET_PROB_1STAZHYPO_172
            DET_RANGE_169_oRDR_DETECTION_169_172_oPCAN_RADAR_deb15946_Tx: ComBitPosition=24, ComBitSize=15, ComSignalInitValue=0, ComSignalType=UINT16, ComSystemTemplateSystemSignalRef=DET_RANGE_169
            DET_RANGE_170_oRDR_DETECTION_169_172_oPCAN_RADAR_bb912be2_Tx: ComBitPosition=136, ComBitSize=15, ComSignalInitValue=0, ComSignalType=UINT16, ComSystemTemplateSystemSignalRef=DET_RANGE_170
            DET_RANGE_171_oRDR_DETECTION_169_172_oPCAN_RADAR_2ee1ff77_Tx: ComBitPosition=248, ComBitSize=15, ComSignalInitValue=0, ComSignalType=UINT16, ComSystemTemplateSystemSignalRef=DET_RANGE_171
            DET_RANGE_172_oRDR_DETECTION_169_172_oPCAN_RADAR_4a018489_Tx: ComBitPosition=360, ComBitSize=15, ComSignalInitValue=0, ComSignalType=UINT16, ComSystemTemplateSystemSignalRef=DET_RANGE_172
            DET_RANGE_ERR_169_oRDR_DETECTION_169_172_oPCAN_RADAR_7959e32f_Tx: ComBitPosition=40, ComBitSize=7, ComSignalInitValue=0, ComSignalType=UINT8, ComSystemTemplateSystemSignalRef=DET_RANGE_ERR_169
            DET_RANGE_ERR_170_oRDR_DETECTION_169_172_oPCAN_RADAR_1c79918b_Tx: ComBitPosition=152, ComBitSize=7, ComSignalInitValue=0, ComSignalType=UINT8, ComSystemTemplateSystemSignalRef=DET_RANGE_ERR_170
            DET_RANGE_ERR_171_oRDR_DETECTION_169_172_oPCAN_RADAR_8909451e_Tx: ComBitPosition=264, ComBitSize=7, ComSignalInitValue=0, ComSignalType=UINT8, ComSystemTemplateSystemSignalRef=DET_RANGE_ERR_171
            DET_RANGE_ERR_172_oRDR_DETECTION_169_172_oPCAN_RADAR_ede93ee0_Tx: ComBitPosition=376, ComBitSize=7, ComSignalInitValue=0, ComSignalType=UINT8, ComSystemTemplateSystemSignalRef=DET_RANGE_ERR_172
            DET_RANGE_VELOCITY_169_oRDR_DETECTION_169_172_oPCAN_RADAR_ab179b63_Tx: ComBitPosition=48, ComBitSize=15, ComSignalInitValue=16384, ComSignalType=UINT16, ComSystemTemplateSystemSignalRef=DET_RANGE_VELOCITY_169
            DET_RANGE_VELOCITY_170_oRDR_DETECTION_169_172_oPCAN_RADAR_ce37e9c7_Tx: ComBitPosition=160, ComBitSize=15, ComSignalInitValue=16384, ComSignalType=UINT16, ComSystemTemplateSystemSignalRef=DET_RANGE_VELOCITY_170
            DET_RANGE_VELOCITY_171_oRDR_DETECTION_169_172_oPCAN_RADAR_5b473d52_Tx: ComBitPosition=272, ComBitSize=15, ComSignalInitValue=16384, ComSignalType=UINT16, ComSystemTemplateSystemSignalRef=DET_RANGE_VELOCITY_171
            DET_RANGE_VELOCITY_172_oRDR_DETECTION_169_172_oPCAN_RADAR_3fa746ac_Tx: ComBitPosition=384, ComBitSize=15, ComSignalInitValue=16384, ComSignalType=UINT16, ComSystemTemplateSystemSignalRef=DET_RANGE_VELOCITY_172
            DET_RANGE_VELOCITY_ERR_169_oRDR_DETECTION_169_172_oPCAN_RADAR_a4ac60d1_Tx: ComBitPosition=64, ComBitSize=8, ComSignalInitValue=0, ComSignalType=UINT8, ComSystemTemplateSystemSignalRef=DET_RANGE_VELOCITY_ERR_169
            DET_RANGE_VELOCITY_ERR_170_oRDR_DETECTION_169_172_oPCAN_RADAR_c18c1275_Tx: ComBitPosition=176, ComBitSize=8, ComSignalInitValue=0, ComSignalType=UINT8, ComSystemTemplateSystemSignalRef=DET_RANGE_VELOCITY_ERR_170
            DET_RANGE_VELOCITY_ERR_171_oRDR_DETECTION_169_172_oPCAN_RADAR_54fcc6e0_Tx: ComBitPosition=288, ComBitSize=8, ComSignalInitValue=0, ComSignalType=UINT8, ComSystemTemplateSystemSignalRef=DET_RANGE_VELOCITY_ERR_171
            DET_RANGE_VELOCITY_ERR_172_oRDR_DETECTION_169_172_oPCAN_RADAR_301cbd1e_Tx: ComBitPosition=400, ComBitSize=8, ComSignalInitValue=0, ComSignalType=UINT8, ComSystemTemplateSystemSignalRef=DET_RANGE_VELOCITY_ERR_172
            DET_RCS_169_oRDR_DETECTION_169_172_oPCAN_RADAR_2c97ac39_Tx: ComBitPosition=128, ComBitSize=8, ComSignalInitValue=128, ComSignalType=UINT8, ComSystemTemplateSystemSignalRef=DET_RCS_169
            DET_RCS_170_oRDR_DETECTION_169_172_oPCAN_RADAR_49b7de9d_Tx: ComBitPosition=240, ComBitSize=8, ComSignalInitValue=128, ComSignalType=UINT8, ComSystemTemplateSystemSignalRef=DET_RCS_170
            DET_RCS_171_oRDR_DETECTION_169_172_oPCAN_RADAR_dcc70a08_Tx: ComBitPosition=352, ComBitSize=8, ComSignalInitValue=128, ComSignalType=UINT8, ComSystemTemplateSystemSignalRef=DET_RCS_171
            DET_RCS_172_oRDR_DETECTION_169_172_oPCAN_RADAR_b82771f6_Tx: ComBitPosition=464, ComBitSize=8, ComSignalInitValue=128, ComSignalType=UINT8, ComSystemTemplateSystemSignalRef=DET_RCS_172
            DET_SNR_169_oRDR_DETECTION_169_172_oPCAN_RADAR_f139f83b_Tx: ComBitPosition=120, ComBitSize=8, ComSignalInitValue=0, ComSignalType=UINT8, ComSystemTemplateSystemSignalRef=DET_SNR_169
            DET_SNR_170_oRDR_DETECTION_169_172_oPCAN_RADAR_94198a9f_Tx: ComBitPosition=232, ComBitSize=8, ComSignalInitValue=0, ComSignalType=UINT8, ComSystemTemplateSystemSignalRef=DET_SNR_170
            DET_SNR_171_oRDR_DETECTION_169_172_oPCAN_RADAR_01695e0a_Tx: ComBitPosition=344, ComBitSize=8, ComSignalInitValue=0, ComSignalType=UINT8, ComSystemTemplateSystemSignalRef=DET_SNR_171
            DET_SNR_172_oRDR_DETECTION_169_172_oPCAN_RADAR_658925f4_Tx: ComBitPosition=456, ComBitSize=8, ComSignalInitValue=0, ComSignalType=UINT8, ComSystemTemplateSystemSignalRef=DET_SNR_172
            DET_SUPER_RES_TARGET_169_oRDR_DETECTION_169_172_oPCAN_RADAR_c0a0d05e_Tx: ComBitPosition=87, ComBitSize=1, ComSignalInitValue=0, ComSignalType=BOOLEAN, ComSystemTemplateSystemSignalRef=DET_SUPER_RES_TARGET_169
            DET_SUPER_RES_TARGET_170_oRDR_DETECTION_169_172_oPCAN_RADAR_a580a2fa_Tx: ComBitPosition=199, ComBitSize=1, ComSignalInitValue=0, ComSignalType=BOOLEAN, ComSystemTemplateSystemSignalRef=DET_SUPER_RES_TARGET_170
            DET_SUPER_RES_TARGET_171_oRDR_DETECTION_169_172_oPCAN_RADAR_30f0766f_Tx: ComBitPosition=311, ComBitSize=1, ComSignalInitValue=0, ComSignalType=BOOLEAN, ComSystemTemplateSystemSignalRef=DET_SUPER_RES_TARGET_171
            DET_SUPER_RES_TARGET_172_oRDR_DETECTION_169_172_oPCAN_RADAR_54100d91_Tx: ComBitPosition=423, ComBitSize=1, ComSignalInitValue=0, ComSignalType=BOOLEAN, ComSystemTemplateSystemSignalRef=DET_SUPER_RES_TARGET_172
        SG_Detections_173_176_oRDR_DETECTION_173_176_oPCAN_RADAR_18cc2fee_Tx: ComSystemTemplateSignalGroupRef=SG_Detections_173_176
          83 x ComGroupSignal, all with ComSignalEndianness=LITTLE_ENDIAN, ComTransferProperty=PENDING:
            DET_AZIMUTH_173_oRDR_DETECTION_173_176_oPCAN_RADAR_d22d2089_Tx: ComBitPosition=88, ComBitSize=13, ComSignalInitValue=0, ComSignalType=UINT16, ComSystemTemplateSystemSignalRef=DET_AZIMUTH_173
            DET_AZIMUTH_174_oRDR_DETECTION_173_176_oPCAN_RADAR_8e9d03e0_Tx: ComBitPosition=200, ComBitSize=13, ComSignalInitValue=0, ComSignalType=UINT16, ComSystemTemplateSystemSignalRef=DET_AZIMUTH_174
            DET_AZIMUTH_175_oRDR_DETECTION_173_176_oPCAN_RADAR_1bedd775_Tx: ComBitPosition=312, ComBitSize=13, ComSignalInitValue=0, ComSignalType=UINT16, ComSystemTemplateSystemSignalRef=DET_AZIMUTH_175
            DET_AZIMUTH_176_oRDR_DETECTION_173_176_oPCAN_RADAR_7f0dac8b_Tx: ComBitPosition=424, ComBitSize=13, ComSignalInitValue=0, ComSignalType=UINT16, ComSystemTemplateSystemSignalRef=DET_AZIMUTH_176
            DET_AZIMUTH_ERR_173_oRDR_DETECTION_173_176_oPCAN_RADAR_7698b57c_Tx: ComBitPosition=105, ComBitSize=7, ComSignalInitValue=0, ComSignalType=UINT8, ComSystemTemplateSystemSignalRef=DET_AZIMUTH_ERR_173
            DET_AZIMUTH_ERR_174_oRDR_DETECTION_173_176_oPCAN_RADAR_2a289615_Tx: ComBitPosition=217, ComBitSize=7, ComSignalInitValue=0, ComSignalType=UINT8, ComSystemTemplateSystemSignalRef=DET_AZIMUTH_ERR_174
            DET_AZIMUTH_ERR_175_oRDR_DETECTION_173_176_oPCAN_RADAR_bf584280_Tx: ComBitPosition=329, ComBitSize=7, ComSignalInitValue=0, ComSignalType=UINT8, ComSystemTemplateSystemSignalRef=DET_AZIMUTH_ERR_175
            DET_AZIMUTH_ERR_176_oRDR_DETECTION_173_176_oPCAN_RADAR_dbb8397e_Tx: ComBitPosition=441, ComBitSize=7, ComSignalInitValue=0, ComSignalType=UINT8, ComSystemTemplateSystemSignalRef=DET_AZIMUTH_ERR_176
            DET_BELOW_RAIN_THOLD_173_oRDR_DETECTION_173_176_oPCAN_RADAR_072cb349_Tx: ComBitPosition=39, ComBitSize=1, ComSignalInitValue=0, ComSignalType=BOOLEAN, ComSystemTemplateSystemSignalRef=DET_BELOW_RAIN_THOLD_173
            DET_BELOW_RAIN_THOLD_174_oRDR_DETECTION_173_176_oPCAN_RADAR_5b9c9020_Tx: ComBitPosition=151, ComBitSize=1, ComSignalInitValue=0, ComSignalType=BOOLEAN, ComSystemTemplateSystemSignalRef=DET_BELOW_RAIN_THOLD_174
            DET_BELOW_RAIN_THOLD_175_oRDR_DETECTION_173_176_oPCAN_RADAR_ceec44b5_Tx: ComBitPosition=263, ComBitSize=1, ComSignalInitValue=0, ComSignalType=BOOLEAN, ComSystemTemplateSystemSignalRef=DET_BELOW_RAIN_THOLD_175
            DET_BELOW_RAIN_THOLD_176_oRDR_DETECTION_173_176_oPCAN_RADAR_aa0c3f4b_Tx: ComBitPosition=375, ComBitSize=1, ComSignalInitValue=0, ComSignalType=BOOLEAN, ComSystemTemplateSystemSignalRef=DET_BELOW_RAIN_THOLD_176
            DET_BI_STATIC_FLAG_173_oRDR_DETECTION_173_176_oPCAN_RADAR_8401600c_Tx: ComBitPosition=104, ComBitSize=1, ComSignalInitValue=0, ComSignalType=BOOLEAN, ComSystemTemplateSystemSignalRef=DET_BI_STATIC_FLAG_173
            DET_BI_STATIC_FLAG_174_oRDR_DETECTION_173_176_oPCAN_RADAR_d8b14365_Tx: ComBitPosition=216, ComBitSize=1, ComSignalInitValue=0, ComSignalType=BOOLEAN, ComSystemTemplateSystemSignalRef=DET_BI_STATIC_FLAG_174
            DET_BI_STATIC_FLAG_175_oRDR_DETECTION_173_176_oPCAN_RADAR_4dc197f0_Tx: ComBitPosition=328, ComBitSize=1, ComSignalInitValue=0, ComSignalType=BOOLEAN, ComSystemTemplateSystemSignalRef=DET_BI_STATIC_FLAG_175
            DET_BI_STATIC_FLAG_176_oRDR_DETECTION_173_176_oPCAN_RADAR_2921ec0e_Tx: ComBitPosition=440, ComBitSize=1, ComSignalInitValue=0, ComSignalType=BOOLEAN, ComSystemTemplateSystemSignalRef=DET_BI_STATIC_FLAG_176
            DET_CONFD_AZIMUTH_173_oRDR_DETECTION_173_176_oPCAN_RADAR_d0cb2a43_Tx: ComBitPosition=118, ComBitSize=2, ComSignalInitValue=0, ComSignalType=UINT8, ComSystemTemplateSystemSignalRef=DET_CONFD_AZIMUTH_173
            DET_CONFD_AZIMUTH_174_oRDR_DETECTION_173_176_oPCAN_RADAR_8c7b092a_Tx: ComBitPosition=230, ComBitSize=2, ComSignalInitValue=0, ComSignalType=UINT8, ComSystemTemplateSystemSignalRef=DET_CONFD_AZIMUTH_174
            DET_CONFD_AZIMUTH_175_oRDR_DETECTION_173_176_oPCAN_RADAR_190bddbf_Tx: ComBitPosition=342, ComBitSize=2, ComSignalInitValue=0, ComSignalType=UINT8, ComSystemTemplateSystemSignalRef=DET_CONFD_AZIMUTH_175
            DET_CONFD_AZIMUTH_176_oRDR_DETECTION_173_176_oPCAN_RADAR_7deba641_Tx: ComBitPosition=454, ComBitSize=2, ComSignalInitValue=0, ComSignalType=UINT8, ComSystemTemplateSystemSignalRef=DET_CONFD_AZIMUTH_176
            DET_CONFD_ELEVATION_173_oRDR_DETECTION_173_176_oPCAN_RADAR_d25e2bb9_Tx: ComBitPosition=101, ComBitSize=2, ComSignalInitValue=0, ComSignalType=UINT8, ComSystemTemplateSystemSignalRef=DET_CONFD_ELEVATION_173
            DET_CONFD_ELEVATION_174_oRDR_DETECTION_173_176_oPCAN_RADAR_8eee08d0_Tx: ComBitPosition=213, ComBitSize=2, ComSignalInitValue=0, ComSignalType=UINT8, ComSystemTemplateSystemSignalRef=DET_CONFD_ELEVATION_174
            DET_CONFD_ELEVATION_175_oRDR_DETECTION_173_176_oPCAN_RADAR_1b9edc45_Tx: ComBitPosition=325, ComBitSize=2, ComSignalInitValue=0, ComSignalType=UINT8, ComSystemTemplateSystemSignalRef=DET_CONFD_ELEVATION_175
            DET_CONFD_ELEVATION_176_oRDR_DETECTION_173_176_oPCAN_RADAR_7f7ea7bb_Tx: ComBitPosition=437, ComBitSize=2, ComSignalInitValue=0, ComSignalType=UINT8, ComSystemTemplateSystemSignalRef=DET_CONFD_ELEVATION_176
            DET_ELEVATION_173_oRDR_DETECTION_173_176_oPCAN_RADAR_039eff85_Tx: ComBitPosition=72, ComBitSize=8, ComSignalInitValue=0, ComSignalType=UINT8, ComSystemTemplateSystemSignalRef=DET_ELEVATION_173
            DET_ELEVATION_174_oRDR_DETECTION_173_176_oPCAN_RADAR_5f2edcec_Tx: ComBitPosition=184, ComBitSize=8, ComSignalInitValue=0, ComSignalType=UINT8, ComSystemTemplateSystemSignalRef=DET_ELEVATION_174
            DET_ELEVATION_175_oRDR_DETECTION_173_176_oPCAN_RADAR_ca5e0879_Tx: ComBitPosition=296, ComBitSize=8, ComSignalInitValue=0, ComSignalType=UINT8, ComSystemTemplateSystemSignalRef=DET_ELEVATION_175
            DET_ELEVATION_176_oRDR_DETECTION_173_176_oPCAN_RADAR_aebe7387_Tx: ComBitPosition=408, ComBitSize=8, ComSignalInitValue=0, ComSignalType=UINT8, ComSystemTemplateSystemSignalRef=DET_ELEVATION_176
            DET_ELEVATION_ERR_173_oRDR_DETECTION_173_176_oPCAN_RADAR_84a767f0_Tx: ComBitPosition=80, ComBitSize=6, ComSignalInitValue=0, ComSignalType=UINT8, ComSystemTemplateSystemSignalRef=DET_ELEVATION_ERR_173
            DET_ELEVATION_ERR_174_oRDR_DETECTION_173_176_oPCAN_RADAR_d8174499_Tx: ComBitPosition=192, ComBitSize=6, ComSignalInitValue=0, ComSignalType=UINT8, ComSystemTemplateSystemSignalRef=DET_ELEVATION_ERR_174
            DET_ELEVATION_ERR_175_oRDR_DETECTION_173_176_oPCAN_RADAR_4d67900c_Tx: ComBitPosition=304, ComBitSize=6, ComSignalInitValue=0, ComSignalType=UINT8, ComSystemTemplateSystemSignalRef=DET_ELEVATION_ERR_175
            DET_ELEVATION_ERR_176_oRDR_DETECTION_173_176_oPCAN_RADAR_2987ebf2_Tx: ComBitPosition=416, ComBitSize=6, ComSignalInitValue=0, ComSignalType=UINT8, ComSystemTemplateSystemSignalRef=DET_ELEVATION_ERR_176
            DET_EXISTENCE_PROB_173_oRDR_DETECTION_173_176_oPCAN_RADAR_56381290_Tx: ComBitPosition=112, ComBitSize=6, ComSignalInitValue=0, ComSignalType=UINT8, ComSystemTemplateSystemSignalRef=DET_EXISTENCE_PROB_173
            DET_EXISTENCE_PROB_174_oRDR_DETECTION_173_176_oPCAN_RADAR_0a8831f9_Tx: ComBitPosition=224, ComBitSize=6, ComSignalInitValue=0, ComSignalType=UINT8, ComSystemTemplateSystemSignalRef=DET_EXISTENCE_PROB_174
            DET_EXISTENCE_PROB_175_oRDR_DETECTION_173_176_oPCAN_RADAR_9ff8e56c_Tx: ComBitPosition=336, ComBitSize=6, ComSignalInitValue=0, ComSignalType=UINT8, ComSystemTemplateSystemSignalRef=DET_EXISTENCE_PROB_175
            DET_EXISTENCE_PROB_176_oRDR_DETECTION_173_176_oPCAN_RADAR_fb189e92_Tx: ComBitPosition=448, ComBitSize=6, ComSignalInitValue=0, ComSignalType=UINT8, ComSystemTemplateSystemSignalRef=DET_EXISTENCE_PROB_176
            DET_HVC_FLAG_173_oRDR_DETECTION_173_176_oPCAN_RADAR_b74c51ef_Tx: ComBitPosition=86, ComBitSize=1, ComSignalInitValue=0, ComSignalType=BOOLEAN, ComSystemTemplateSystemSignalRef=DET_HVC_FLAG_173
            DET_HVC_FLAG_174_oRDR_DETECTION_173_176_oPCAN_RADAR_ebfc7286_Tx: ComBitPosition=198, ComBitSize=1, ComSignalInitValue=0, ComSignalType=BOOLEAN, ComSystemTemplateSystemSignalRef=DET_HVC_FLAG_174
            DET_HVC_FLAG_175_oRDR_DETECTION_173_176_oPCAN_RADAR_7e8ca613_Tx: ComBitPosition=310, ComBitSize=1, ComSignalInitValue=0, ComSignalType=BOOLEAN, ComSystemTemplateSystemSignalRef=DET_HVC_FLAG_175
            DET_HVC_FLAG_176_oRDR_DETECTION_173_176_oPCAN_RADAR_1a6cdded_Tx: ComBitPosition=422, ComBitSize=1, ComSignalInitValue=0, ComSignalType=BOOLEAN, ComSystemTemplateSystemSignalRef=DET_HVC_FLAG_176
            DET_IDM_173_oRDR_DETECTION_173_176_oPCAN_RADAR_3c1e6a52_Tx: ComBitPosition=63, ComBitSize=1, ComSignalInitValue=0, ComSignalType=BOOLEAN, ComSystemTemplateSystemSignalRef=DET_IDM_173
            DET_IDM_174_oRDR_DETECTION_173_176_oPCAN_RADAR_60ae493b_Tx: ComBitPosition=175, ComBitSize=1, ComSignalInitValue=0, ComSignalType=BOOLEAN, ComSystemTemplateSystemSignalRef=DET_IDM_174
            DET_IDM_175_oRDR_DETECTION_173_176_oPCAN_RADAR_f5de9dae_Tx: ComBitPosition=287, ComBitSize=1, ComSignalInitValue=0, ComSignalType=BOOLEAN, ComSystemTemplateSystemSignalRef=DET_IDM_175
            DET_IDM_176_oRDR_DETECTION_173_176_oPCAN_RADAR_913ee650_Tx: ComBitPosition=399, ComBitSize=1, ComSignalInitValue=0, ComSignalType=BOOLEAN, ComSystemTemplateSystemSignalRef=DET_IDM_176
            DET_MH_CRC16_173_176_oRDR_DETECTION_173_176_oPCAN_RADAR_9c44fde5_Tx: ComBitPosition=0, ComBitSize=16, ComSignalInitValue=0, ComSignalType=UINT16, ComSystemTemplateSystemSignalRef=DET_MH_CRC16_173_176
            DET_MH_CYCLE_COUNTER_173_176_oRDR_DETECTION_173_176_oPCAN_RADAR_18315cd2_Tx: ComBitPosition=16, ComBitSize=8, ComSignalInitValue=0, ComSignalType=UINT8, ComSystemTemplateSystemSignalRef=DET_MH_CYCLE_COUNTER_173_176
            DET_MH_SCAN_INDEX_4LSB_173_176_oRDR_DETECTION_173_176_oPCAN_RADAR_d41b795e_Tx: ComBitPosition=476, ComBitSize=4, ComSignalInitValue=0, ComSignalType=UINT8, ComSystemTemplateSystemSignalRef=DET_MH_SCAN_INDEX_4LSB_173_176
            DET_MTD_173_oRDR_DETECTION_173_176_oPCAN_RADAR_5aad5889_Tx: ComBitPosition=47, ComBitSize=1, ComSignalInitValue=0, ComSignalType=BOOLEAN, ComSystemTemplateSystemSignalRef=DET_MTD_173
            DET_MTD_174_oRDR_DETECTION_173_176_oPCAN_RADAR_061d7be0_Tx: ComBitPosition=159, ComBitSize=1, ComSignalInitValue=0, ComSignalType=BOOLEAN, ComSystemTemplateSystemSignalRef=DET_MTD_174
            DET_MTD_175_oRDR_DETECTION_173_176_oPCAN_RADAR_936daf75_Tx: ComBitPosition=271, ComBitSize=1, ComSignalInitValue=0, ComSignalType=BOOLEAN, ComSystemTemplateSystemSignalRef=DET_MTD_175
            DET_MTD_176_oRDR_DETECTION_173_176_oPCAN_RADAR_f78dd48b_Tx: ComBitPosition=383, ComBitSize=1, ComSignalInitValue=0, ComSignalType=BOOLEAN, ComSystemTemplateSystemSignalRef=DET_MTD_176
            DET_PROB_1STAZHYPO_173_oRDR_DETECTION_173_176_oPCAN_RADAR_c919b044_Tx: ComBitPosition=103, ComBitSize=1, ComSignalInitValue=0, ComSignalType=BOOLEAN, ComSystemTemplateSystemSignalRef=DET_PROB_1STAZHYPO_173
            DET_PROB_1STAZHYPO_174_oRDR_DETECTION_173_176_oPCAN_RADAR_95a9932d_Tx: ComBitPosition=215, ComBitSize=1, ComSignalInitValue=0, ComSignalType=BOOLEAN, ComSystemTemplateSystemSignalRef=DET_PROB_1STAZHYPO_174
            DET_PROB_1STAZHYPO_175_oRDR_DETECTION_173_176_oPCAN_RADAR_00d947b8_Tx: ComBitPosition=327, ComBitSize=1, ComSignalInitValue=0, ComSignalType=BOOLEAN, ComSystemTemplateSystemSignalRef=DET_PROB_1STAZHYPO_175
            DET_PROB_1STAZHYPO_176_oRDR_DETECTION_173_176_oPCAN_RADAR_64393c46_Tx: ComBitPosition=439, ComBitSize=1, ComSignalInitValue=0, ComSignalType=BOOLEAN, ComSystemTemplateSystemSignalRef=DET_PROB_1STAZHYPO_176
            DET_RANGE_173_oRDR_DETECTION_173_176_oPCAN_RADAR_c2b65332_Tx: ComBitPosition=24, ComBitSize=15, ComSignalInitValue=0, ComSignalType=UINT16, ComSystemTemplateSystemSignalRef=DET_RANGE_173
            DET_RANGE_174_oRDR_DETECTION_173_176_oPCAN_RADAR_9e06705b_Tx: ComBitPosition=136, ComBitSize=15, ComSignalInitValue=0, ComSignalType=UINT16, ComSystemTemplateSystemSignalRef=DET_RANGE_174
            DET_RANGE_175_oRDR_DETECTION_173_176_oPCAN_RADAR_0b76a4ce_Tx: ComBitPosition=248, ComBitSize=15, ComSignalInitValue=0, ComSignalType=UINT16, ComSystemTemplateSystemSignalRef=DET_RANGE_175
            DET_RANGE_176_oRDR_DETECTION_173_176_oPCAN_RADAR_6f96df30_Tx: ComBitPosition=360, ComBitSize=15, ComSignalInitValue=0, ComSignalType=UINT16, ComSystemTemplateSystemSignalRef=DET_RANGE_176
            DET_RANGE_ERR_173_oRDR_DETECTION_173_176_oPCAN_RADAR_655ee95b_Tx: ComBitPosition=40, ComBitSize=7, ComSignalInitValue=0, ComSignalType=UINT8, ComSystemTemplateSystemSignalRef=DET_RANGE_ERR_173
            DET_RANGE_ERR_174_oRDR_DETECTION_173_176_oPCAN_RADAR_39eeca32_Tx: ComBitPosition=152, ComBitSize=7, ComSignalInitValue=0, ComSignalType=UINT8, ComSystemTemplateSystemSignalRef=DET_RANGE_ERR_174
            DET_RANGE_ERR_175_oRDR_DETECTION_173_176_oPCAN_RADAR_ac9e1ea7_Tx: ComBitPosition=264, ComBitSize=7, ComSignalInitValue=0, ComSignalType=UINT8, ComSystemTemplateSystemSignalRef=DET_RANGE_ERR_175
            DET_RANGE_ERR_176_oRDR_DETECTION_173_176_oPCAN_RADAR_c87e6559_Tx: ComBitPosition=376, ComBitSize=7, ComSignalInitValue=0, ComSignalType=UINT8, ComSystemTemplateSystemSignalRef=DET_RANGE_ERR_176
            DET_RANGE_VELOCITY_173_oRDR_DETECTION_173_176_oPCAN_RADAR_b7109117_Tx: ComBitPosition=48, ComBitSize=15, ComSignalInitValue=16384, ComSignalType=UINT16, ComSystemTemplateSystemSignalRef=DET_RANGE_VELOCITY_173
            DET_RANGE_VELOCITY_174_oRDR_DETECTION_173_176_oPCAN_RADAR_eba0b27e_Tx: ComBitPosition=160, ComBitSize=15, ComSignalInitValue=16384, ComSignalType=UINT16, ComSystemTemplateSystemSignalRef=DET_RANGE_VELOCITY_174
            DET_RANGE_VELOCITY_175_oRDR_DETECTION_173_176_oPCAN_RADAR_7ed066eb_Tx: ComBitPosition=272, ComBitSize=15, ComSignalInitValue=16384, ComSignalType=UINT16, ComSystemTemplateSystemSignalRef=DET_RANGE_VELOCITY_175
            DET_RANGE_VELOCITY_176_oRDR_DETECTION_173_176_oPCAN_RADAR_1a301d15_Tx: ComBitPosition=384, ComBitSize=15, ComSignalInitValue=16384, ComSignalType=UINT16, ComSystemTemplateSystemSignalRef=DET_RANGE_VELOCITY_176
            DET_RANGE_VELOCITY_ERR_173_oRDR_DETECTION_173_176_oPCAN_RADAR_b8ab6aa5_Tx: ComBitPosition=64, ComBitSize=8, ComSignalInitValue=0, ComSignalType=UINT8, ComSystemTemplateSystemSignalRef=DET_RANGE_VELOCITY_ERR_173
            DET_RANGE_VELOCITY_ERR_174_oRDR_DETECTION_173_176_oPCAN_RADAR_e41b49cc_Tx: ComBitPosition=176, ComBitSize=8, ComSignalInitValue=0, ComSignalType=UINT8, ComSystemTemplateSystemSignalRef=DET_RANGE_VELOCITY_ERR_174
            DET_RANGE_VELOCITY_ERR_175_oRDR_DETECTION_173_176_oPCAN_RADAR_716b9d59_Tx: ComBitPosition=288, ComBitSize=8, ComSignalInitValue=0, ComSignalType=UINT8, ComSystemTemplateSystemSignalRef=DET_RANGE_VELOCITY_ERR_175
            DET_RANGE_VELOCITY_ERR_176_oRDR_DETECTION_173_176_oPCAN_RADAR_158be6a7_Tx: ComBitPosition=400, ComBitSize=8, ComSignalInitValue=0, ComSignalType=UINT8, ComSystemTemplateSystemSignalRef=DET_RANGE_VELOCITY_ERR_176
            DET_RCS_173_oRDR_DETECTION_173_176_oPCAN_RADAR_3090a64d_Tx: ComBitPosition=128, ComBitSize=8, ComSignalInitValue=128, ComSignalType=UINT8, ComSystemTemplateSystemSignalRef=DET_RCS_173
            DET_RCS_174_oRDR_DETECTION_173_176_oPCAN_RADAR_6c208524_Tx: ComBitPosition=240, ComBitSize=8, ComSignalInitValue=128, ComSignalType=UINT8, ComSystemTemplateSystemSignalRef=DET_RCS_174
            DET_RCS_175_oRDR_DETECTION_173_176_oPCAN_RADAR_f95051b1_Tx: ComBitPosition=352, ComBitSize=8, ComSignalInitValue=128, ComSignalType=UINT8, ComSystemTemplateSystemSignalRef=DET_RCS_175
            DET_RCS_176_oRDR_DETECTION_173_176_oPCAN_RADAR_9db02a4f_Tx: ComBitPosition=464, ComBitSize=8, ComSignalInitValue=128, ComSignalType=UINT8, ComSystemTemplateSystemSignalRef=DET_RCS_176
            DET_SNR_173_oRDR_DETECTION_173_176_oPCAN_RADAR_ed3ef24f_Tx: ComBitPosition=120, ComBitSize=8, ComSignalInitValue=0, ComSignalType=UINT8, ComSystemTemplateSystemSignalRef=DET_SNR_173
            DET_SNR_174_oRDR_DETECTION_173_176_oPCAN_RADAR_b18ed126_Tx: ComBitPosition=232, ComBitSize=8, ComSignalInitValue=0, ComSignalType=UINT8, ComSystemTemplateSystemSignalRef=DET_SNR_174
            DET_SNR_175_oRDR_DETECTION_173_176_oPCAN_RADAR_24fe05b3_Tx: ComBitPosition=344, ComBitSize=8, ComSignalInitValue=0, ComSignalType=UINT8, ComSystemTemplateSystemSignalRef=DET_SNR_175
            DET_SNR_176_oRDR_DETECTION_173_176_oPCAN_RADAR_401e7e4d_Tx: ComBitPosition=456, ComBitSize=8, ComSignalInitValue=0, ComSignalType=UINT8, ComSystemTemplateSystemSignalRef=DET_SNR_176
            DET_SUPER_RES_TARGET_173_oRDR_DETECTION_173_176_oPCAN_RADAR_dca7da2a_Tx: ComBitPosition=87, ComBitSize=1, ComSignalInitValue=0, ComSignalType=BOOLEAN, ComSystemTemplateSystemSignalRef=DET_SUPER_RES_TARGET_173
            DET_SUPER_RES_TARGET_174_oRDR_DETECTION_173_176_oPCAN_RADAR_8017f943_Tx: ComBitPosition=199, ComBitSize=1, ComSignalInitValue=0, ComSignalType=BOOLEAN, ComSystemTemplateSystemSignalRef=DET_SUPER_RES_TARGET_174
            DET_SUPER_RES_TARGET_175_oRDR_DETECTION_173_176_oPCAN_RADAR_15672dd6_Tx: ComBitPosition=311, ComBitSize=1, ComSignalInitValue=0, ComSignalType=BOOLEAN, ComSystemTemplateSystemSignalRef=DET_SUPER_RES_TARGET_175
            DET_SUPER_RES_TARGET_176_oRDR_DETECTION_173_176_oPCAN_RADAR_71875628_Tx: ComBitPosition=423, ComBitSize=1, ComSignalInitValue=0, ComSignalType=BOOLEAN, ComSystemTemplateSystemSignalRef=DET_SUPER_RES_TARGET_176
        SG_Detections_177_180_oRDR_DETECTION_177_180_oPCAN_RADAR_6c601388_Tx: ComSystemTemplateSignalGroupRef=SG_Detections_177_180
          83 x ComGroupSignal, all with ComSignalEndianness=LITTLE_ENDIAN, ComTransferProperty=PENDING:
            DET_AZIMUTH_177_oRDR_DETECTION_177_180_oPCAN_RADAR_6f0434fa_Tx: ComBitPosition=88, ComBitSize=13, ComSignalInitValue=0, ComSignalType=UINT16, ComSystemTemplateSystemSignalRef=DET_AZIMUTH_177
            DET_AZIMUTH_178_oRDR_DETECTION_177_180_oPCAN_RADAR_4314a6bd_Tx: ComBitPosition=200, ComBitSize=13, ComSignalInitValue=0, ComSignalType=UINT16, ComSystemTemplateSystemSignalRef=DET_AZIMUTH_178
            DET_AZIMUTH_179_oRDR_DETECTION_177_180_oPCAN_RADAR_d6647228_Tx: ComBitPosition=312, ComBitSize=13, ComSignalInitValue=0, ComSignalType=UINT16, ComSystemTemplateSystemSignalRef=DET_AZIMUTH_179
            DET_AZIMUTH_180_oRDR_DETECTION_177_180_oPCAN_RADAR_db20d332_Tx: ComBitPosition=424, ComBitSize=13, ComSignalInitValue=0, ComSignalType=UINT16, ComSystemTemplateSystemSignalRef=DET_AZIMUTH_180
            DET_AZIMUTH_ERR_177_oRDR_DETECTION_177_180_oPCAN_RADAR_cbb1a10f_Tx: ComBitPosition=105, ComBitSize=7, ComSignalInitValue=0, ComSignalType=UINT8, ComSystemTemplateSystemSignalRef=DET_AZIMUTH_ERR_177
            DET_AZIMUTH_ERR_178_oRDR_DETECTION_177_180_oPCAN_RADAR_e7a13348_Tx: ComBitPosition=217, ComBitSize=7, ComSignalInitValue=0, ComSignalType=UINT8, ComSystemTemplateSystemSignalRef=DET_AZIMUTH_ERR_178
            DET_AZIMUTH_ERR_179_oRDR_DETECTION_177_180_oPCAN_RADAR_72d1e7dd_Tx: ComBitPosition=329, ComBitSize=7, ComSignalInitValue=0, ComSignalType=UINT8, ComSystemTemplateSystemSignalRef=DET_AZIMUTH_ERR_179
            DET_AZIMUTH_ERR_180_oRDR_DETECTION_177_180_oPCAN_RADAR_7f9546c7_Tx: ComBitPosition=441, ComBitSize=7, ComSignalInitValue=0, ComSignalType=UINT8, ComSystemTemplateSystemSignalRef=DET_AZIMUTH_ERR_180
            DET_BELOW_RAIN_THOLD_177_oRDR_DETECTION_177_180_oPCAN_RADAR_ba05a73a_Tx: ComBitPosition=39, ComBitSize=1, ComSignalInitValue=0, ComSignalType=BOOLEAN, ComSystemTemplateSystemSignalRef=DET_BELOW_RAIN_THOLD_177
            DET_BELOW_RAIN_THOLD_178_oRDR_DETECTION_177_180_oPCAN_RADAR_9615357d_Tx: ComBitPosition=151, ComBitSize=1, ComSignalInitValue=0, ComSignalType=BOOLEAN, ComSystemTemplateSystemSignalRef=DET_BELOW_RAIN_THOLD_178
            DET_BELOW_RAIN_THOLD_179_oRDR_DETECTION_177_180_oPCAN_RADAR_0365e1e8_Tx: ComBitPosition=263, ComBitSize=1, ComSignalInitValue=0, ComSignalType=BOOLEAN, ComSystemTemplateSystemSignalRef=DET_BELOW_RAIN_THOLD_179
            DET_BELOW_RAIN_THOLD_180_oRDR_DETECTION_177_180_oPCAN_RADAR_0e2140f2_Tx: ComBitPosition=375, ComBitSize=1, ComSignalInitValue=0, ComSignalType=BOOLEAN, ComSystemTemplateSystemSignalRef=DET_BELOW_RAIN_THOLD_180
            DET_BI_STATIC_FLAG_177_oRDR_DETECTION_177_180_oPCAN_RADAR_3928747f_Tx: ComBitPosition=104, ComBitSize=1, ComSignalInitValue=0, ComSignalType=BOOLEAN, ComSystemTemplateSystemSignalRef=DET_BI_STATIC_FLAG_177
            DET_BI_STATIC_FLAG_178_oRDR_DETECTION_177_180_oPCAN_RADAR_1538e638_Tx: ComBitPosition=216, ComBitSize=1, ComSignalInitValue=0, ComSignalType=BOOLEAN, ComSystemTemplateSystemSignalRef=DET_BI_STATIC_FLAG_178
            DET_BI_STATIC_FLAG_179_oRDR_DETECTION_177_180_oPCAN_RADAR_804832ad_Tx: ComBitPosition=328, ComBitSize=1, ComSignalInitValue=0, ComSignalType=BOOLEAN, ComSystemTemplateSystemSignalRef=DET_BI_STATIC_FLAG_179
            DET_BI_STATIC_FLAG_180_oRDR_DETECTION_177_180_oPCAN_RADAR_8d0c93b7_Tx: ComBitPosition=440, ComBitSize=1, ComSignalInitValue=0, ComSignalType=BOOLEAN, ComSystemTemplateSystemSignalRef=DET_BI_STATIC_FLAG_180
            DET_CONFD_AZIMUTH_177_oRDR_DETECTION_177_180_oPCAN_RADAR_6de23e30_Tx: ComBitPosition=118, ComBitSize=2, ComSignalInitValue=0, ComSignalType=UINT8, ComSystemTemplateSystemSignalRef=DET_CONFD_AZIMUTH_177
            DET_CONFD_AZIMUTH_178_oRDR_DETECTION_177_180_oPCAN_RADAR_41f2ac77_Tx: ComBitPosition=230, ComBitSize=2, ComSignalInitValue=0, ComSignalType=UINT8, ComSystemTemplateSystemSignalRef=DET_CONFD_AZIMUTH_178
            DET_CONFD_AZIMUTH_179_oRDR_DETECTION_177_180_oPCAN_RADAR_d48278e2_Tx: ComBitPosition=342, ComBitSize=2, ComSignalInitValue=0, ComSignalType=UINT8, ComSystemTemplateSystemSignalRef=DET_CONFD_AZIMUTH_179
            DET_CONFD_AZIMUTH_180_oRDR_DETECTION_177_180_oPCAN_RADAR_d9c6d9f8_Tx: ComBitPosition=454, ComBitSize=2, ComSignalInitValue=0, ComSignalType=UINT8, ComSystemTemplateSystemSignalRef=DET_CONFD_AZIMUTH_180
            DET_CONFD_ELEVATION_177_oRDR_DETECTION_177_180_oPCAN_RADAR_6f773fca_Tx: ComBitPosition=101, ComBitSize=2, ComSignalInitValue=0, ComSignalType=UINT8, ComSystemTemplateSystemSignalRef=DET_CONFD_ELEVATION_177
            DET_CONFD_ELEVATION_178_oRDR_DETECTION_177_180_oPCAN_RADAR_4367ad8d_Tx: ComBitPosition=213, ComBitSize=2, ComSignalInitValue=0, ComSignalType=UINT8, ComSystemTemplateSystemSignalRef=DET_CONFD_ELEVATION_178
            DET_CONFD_ELEVATION_179_oRDR_DETECTION_177_180_oPCAN_RADAR_d6177918_Tx: ComBitPosition=325, ComBitSize=2, ComSignalInitValue=0, ComSignalType=UINT8, ComSystemTemplateSystemSignalRef=DET_CONFD_ELEVATION_179
            DET_CONFD_ELEVATION_180_oRDR_DETECTION_177_180_oPCAN_RADAR_db53d802_Tx: ComBitPosition=437, ComBitSize=2, ComSignalInitValue=0, ComSignalType=UINT8, ComSystemTemplateSystemSignalRef=DET_CONFD_ELEVATION_180
            DET_ELEVATION_177_oRDR_DETECTION_177_180_oPCAN_RADAR_beb7ebf6_Tx: ComBitPosition=72, ComBitSize=8, ComSignalInitValue=0, ComSignalType=UINT8, ComSystemTemplateSystemSignalRef=DET_ELEVATION_177
            DET_ELEVATION_178_oRDR_DETECTION_177_180_oPCAN_RADAR_92a779b1_Tx: ComBitPosition=184, ComBitSize=8, ComSignalInitValue=0, ComSignalType=UINT8, ComSystemTemplateSystemSignalRef=DET_ELEVATION_178
            DET_ELEVATION_179_oRDR_DETECTION_177_180_oPCAN_RADAR_07d7ad24_Tx: ComBitPosition=296, ComBitSize=8, ComSignalInitValue=0, ComSignalType=UINT8, ComSystemTemplateSystemSignalRef=DET_ELEVATION_179
            DET_ELEVATION_180_oRDR_DETECTION_177_180_oPCAN_RADAR_0a930c3e_Tx: ComBitPosition=408, ComBitSize=8, ComSignalInitValue=0, ComSignalType=UINT8, ComSystemTemplateSystemSignalRef=DET_ELEVATION_180
            DET_ELEVATION_ERR_177_oRDR_DETECTION_177_180_oPCAN_RADAR_398e7383_Tx: ComBitPosition=80, ComBitSize=6, ComSignalInitValue=0, ComSignalType=UINT8, ComSystemTemplateSystemSignalRef=DET_ELEVATION_ERR_177
            DET_ELEVATION_ERR_178_oRDR_DETECTION_177_180_oPCAN_RADAR_159ee1c4_Tx: ComBitPosition=192, ComBitSize=6, ComSignalInitValue=0, ComSignalType=UINT8, ComSystemTemplateSystemSignalRef=DET_ELEVATION_ERR_178
            DET_ELEVATION_ERR_179_oRDR_DETECTION_177_180_oPCAN_RADAR_80ee3551_Tx: ComBitPosition=304, ComBitSize=6, ComSignalInitValue=0, ComSignalType=UINT8, ComSystemTemplateSystemSignalRef=DET_ELEVATION_ERR_179
            DET_ELEVATION_ERR_180_oRDR_DETECTION_177_180_oPCAN_RADAR_8daa944b_Tx: ComBitPosition=416, ComBitSize=6, ComSignalInitValue=0, ComSignalType=UINT8, ComSystemTemplateSystemSignalRef=DET_ELEVATION_ERR_180
            DET_EXISTENCE_PROB_177_oRDR_DETECTION_177_180_oPCAN_RADAR_eb1106e3_Tx: ComBitPosition=112, ComBitSize=6, ComSignalInitValue=0, ComSignalType=UINT8, ComSystemTemplateSystemSignalRef=DET_EXISTENCE_PROB_177
            DET_EXISTENCE_PROB_178_oRDR_DETECTION_177_180_oPCAN_RADAR_c70194a4_Tx: ComBitPosition=224, ComBitSize=6, ComSignalInitValue=0, ComSignalType=UINT8, ComSystemTemplateSystemSignalRef=DET_EXISTENCE_PROB_178
            DET_EXISTENCE_PROB_179_oRDR_DETECTION_177_180_oPCAN_RADAR_52714031_Tx: ComBitPosition=336, ComBitSize=6, ComSignalInitValue=0, ComSignalType=UINT8, ComSystemTemplateSystemSignalRef=DET_EXISTENCE_PROB_179
            DET_EXISTENCE_PROB_180_oRDR_DETECTION_177_180_oPCAN_RADAR_5f35e12b_Tx: ComBitPosition=448, ComBitSize=6, ComSignalInitValue=0, ComSignalType=UINT8, ComSystemTemplateSystemSignalRef=DET_EXISTENCE_PROB_180
            DET_HVC_FLAG_177_oRDR_DETECTION_177_180_oPCAN_RADAR_0a65459c_Tx: ComBitPosition=86, ComBitSize=1, ComSignalInitValue=0, ComSignalType=BOOLEAN, ComSystemTemplateSystemSignalRef=DET_HVC_FLAG_177
            DET_HVC_FLAG_178_oRDR_DETECTION_177_180_oPCAN_RADAR_2675d7db_Tx: ComBitPosition=198, ComBitSize=1, ComSignalInitValue=0, ComSignalType=BOOLEAN, ComSystemTemplateSystemSignalRef=DET_HVC_FLAG_178
            DET_HVC_FLAG_179_oRDR_DETECTION_177_180_oPCAN_RADAR_b305034e_Tx: ComBitPosition=310, ComBitSize=1, ComSignalInitValue=0, ComSignalType=BOOLEAN, ComSystemTemplateSystemSignalRef=DET_HVC_FLAG_179
            DET_HVC_FLAG_180_oRDR_DETECTION_177_180_oPCAN_RADAR_be41a254_Tx: ComBitPosition=422, ComBitSize=1, ComSignalInitValue=0, ComSignalType=BOOLEAN, ComSystemTemplateSystemSignalRef=DET_HVC_FLAG_180
            DET_IDM_177_oRDR_DETECTION_177_180_oPCAN_RADAR_81377e21_Tx: ComBitPosition=63, ComBitSize=1, ComSignalInitValue=0, ComSignalType=BOOLEAN, ComSystemTemplateSystemSignalRef=DET_IDM_177
            DET_IDM_178_oRDR_DETECTION_177_180_oPCAN_RADAR_ad27ec66_Tx: ComBitPosition=175, ComBitSize=1, ComSignalInitValue=0, ComSignalType=BOOLEAN, ComSystemTemplateSystemSignalRef=DET_IDM_178
            DET_IDM_179_oRDR_DETECTION_177_180_oPCAN_RADAR_385738f3_Tx: ComBitPosition=287, ComBitSize=1, ComSignalInitValue=0, ComSignalType=BOOLEAN, ComSystemTemplateSystemSignalRef=DET_IDM_179
            DET_IDM_180_oRDR_DETECTION_177_180_oPCAN_RADAR_351399e9_Tx: ComBitPosition=399, ComBitSize=1, ComSignalInitValue=0, ComSignalType=BOOLEAN, ComSystemTemplateSystemSignalRef=DET_IDM_180
            DET_MH_CRC16_177_180_oRDR_DETECTION_177_180_oPCAN_RADAR_e8e8c183_Tx: ComBitPosition=0, ComBitSize=16, ComSignalInitValue=0, ComSignalType=UINT16, ComSystemTemplateSystemSignalRef=DET_MH_CRC16_177_180
            DET_MH_CYCLE_COUNTER_177_180_oRDR_DETECTION_177_180_oPCAN_RADAR_6c9d60b4_Tx: ComBitPosition=16, ComBitSize=8, ComSignalInitValue=0, ComSignalType=UINT8, ComSystemTemplateSystemSignalRef=DET_MH_CYCLE_COUNTER_177_180
            DET_MH_SCAN_INDEX_4LSB_177_180_oRDR_DETECTION_177_180_oPCAN_RADAR_a0b74538_Tx: ComBitPosition=476, ComBitSize=4, ComSignalInitValue=0, ComSignalType=UINT8, ComSystemTemplateSystemSignalRef=DET_MH_SCAN_INDEX_4LSB_177_180
            DET_MTD_177_oRDR_DETECTION_177_180_oPCAN_RADAR_e7844cfa_Tx: ComBitPosition=47, ComBitSize=1, ComSignalInitValue=0, ComSignalType=BOOLEAN, ComSystemTemplateSystemSignalRef=DET_MTD_177
            DET_MTD_178_oRDR_DETECTION_177_180_oPCAN_RADAR_cb94debd_Tx: ComBitPosition=159, ComBitSize=1, ComSignalInitValue=0, ComSignalType=BOOLEAN, ComSystemTemplateSystemSignalRef=DET_MTD_178
            DET_MTD_179_oRDR_DETECTION_177_180_oPCAN_RADAR_5ee40a28_Tx: ComBitPosition=271, ComBitSize=1, ComSignalInitValue=0, ComSignalType=BOOLEAN, ComSystemTemplateSystemSignalRef=DET_MTD_179
            DET_MTD_180_oRDR_DETECTION_177_180_oPCAN_RADAR_53a0ab32_Tx: ComBitPosition=383, ComBitSize=1, ComSignalInitValue=0, ComSignalType=BOOLEAN, ComSystemTemplateSystemSignalRef=DET_MTD_180
            DET_PROB_1STAZHYPO_177_oRDR_DETECTION_177_180_oPCAN_RADAR_7430a437_Tx: ComBitPosition=103, ComBitSize=1, ComSignalInitValue=0, ComSignalType=BOOLEAN, ComSystemTemplateSystemSignalRef=DET_PROB_1STAZHYPO_177
            DET_PROB_1STAZHYPO_178_oRDR_DETECTION_177_180_oPCAN_RADAR_58203670_Tx: ComBitPosition=215, ComBitSize=1, ComSignalInitValue=0, ComSignalType=BOOLEAN, ComSystemTemplateSystemSignalRef=DET_PROB_1STAZHYPO_178
            DET_PROB_1STAZHYPO_179_oRDR_DETECTION_177_180_oPCAN_RADAR_cd50e2e5_Tx: ComBitPosition=327, ComBitSize=1, ComSignalInitValue=0, ComSignalType=BOOLEAN, ComSystemTemplateSystemSignalRef=DET_PROB_1STAZHYPO_179
            DET_PROB_1STAZHYPO_180_oRDR_DETECTION_177_180_oPCAN_RADAR_c01443ff_Tx: ComBitPosition=439, ComBitSize=1, ComSignalInitValue=0, ComSignalType=BOOLEAN, ComSystemTemplateSystemSignalRef=DET_PROB_1STAZHYPO_180
            DET_RANGE_177_oRDR_DETECTION_177_180_oPCAN_RADAR_7f9f4741_Tx: ComBitPosition=24, ComBitSize=15, ComSignalInitValue=0, ComSignalType=UINT16, ComSystemTemplateSystemSignalRef=DET_RANGE_177
            DET_RANGE_178_oRDR_DETECTION_177_180_oPCAN_RADAR_538fd506_Tx: ComBitPosition=136, ComBitSize=15, ComSignalInitValue=0, ComSignalType=UINT16, ComSystemTemplateSystemSignalRef=DET_RANGE_178
            DET_RANGE_179_oRDR_DETECTION_177_180_oPCAN_RADAR_c6ff0193_Tx: ComBitPosition=248, ComBitSize=15, ComSignalInitValue=0, ComSignalType=UINT16, ComSystemTemplateSystemSignalRef=DET_RANGE_179
            DET_RANGE_180_oRDR_DETECTION_177_180_oPCAN_RADAR_cbbba089_Tx: ComBitPosition=360, ComBitSize=15, ComSignalInitValue=0, ComSignalType=UINT16, ComSystemTemplateSystemSignalRef=DET_RANGE_180
            DET_RANGE_ERR_177_oRDR_DETECTION_177_180_oPCAN_RADAR_d877fd28_Tx: ComBitPosition=40, ComBitSize=7, ComSignalInitValue=0, ComSignalType=UINT8, ComSystemTemplateSystemSignalRef=DET_RANGE_ERR_177
            DET_RANGE_ERR_178_oRDR_DETECTION_177_180_oPCAN_RADAR_f4676f6f_Tx: ComBitPosition=152, ComBitSize=7, ComSignalInitValue=0, ComSignalType=UINT8, ComSystemTemplateSystemSignalRef=DET_RANGE_ERR_178
            DET_RANGE_ERR_179_oRDR_DETECTION_177_180_oPCAN_RADAR_6117bbfa_Tx: ComBitPosition=264, ComBitSize=7, ComSignalInitValue=0, ComSignalType=UINT8, ComSystemTemplateSystemSignalRef=DET_RANGE_ERR_179
            DET_RANGE_ERR_180_oRDR_DETECTION_177_180_oPCAN_RADAR_6c531ae0_Tx: ComBitPosition=376, ComBitSize=7, ComSignalInitValue=0, ComSignalType=UINT8, ComSystemTemplateSystemSignalRef=DET_RANGE_ERR_180
            DET_RANGE_VELOCITY_177_oRDR_DETECTION_177_180_oPCAN_RADAR_0a398564_Tx: ComBitPosition=48, ComBitSize=15, ComSignalInitValue=16384, ComSignalType=UINT16, ComSystemTemplateSystemSignalRef=DET_RANGE_VELOCITY_177
            DET_RANGE_VELOCITY_178_oRDR_DETECTION_177_180_oPCAN_RADAR_26291723_Tx: ComBitPosition=160, ComBitSize=15, ComSignalInitValue=16384, ComSignalType=UINT16, ComSystemTemplateSystemSignalRef=DET_RANGE_VELOCITY_178
            DET_RANGE_VELOCITY_179_oRDR_DETECTION_177_180_oPCAN_RADAR_b359c3b6_Tx: ComBitPosition=272, ComBitSize=15, ComSignalInitValue=16384, ComSignalType=UINT16, ComSystemTemplateSystemSignalRef=DET_RANGE_VELOCITY_179
            DET_RANGE_VELOCITY_180_oRDR_DETECTION_177_180_oPCAN_RADAR_be1d62ac_Tx: ComBitPosition=384, ComBitSize=15, ComSignalInitValue=16384, ComSignalType=UINT16, ComSystemTemplateSystemSignalRef=DET_RANGE_VELOCITY_180
            DET_RANGE_VELOCITY_ERR_177_oRDR_DETECTION_177_180_oPCAN_RADAR_05827ed6_Tx: ComBitPosition=64, ComBitSize=8, ComSignalInitValue=0, ComSignalType=UINT8, ComSystemTemplateSystemSignalRef=DET_RANGE_VELOCITY_ERR_177
            DET_RANGE_VELOCITY_ERR_178_oRDR_DETECTION_177_180_oPCAN_RADAR_2992ec91_Tx: ComBitPosition=176, ComBitSize=8, ComSignalInitValue=0, ComSignalType=UINT8, ComSystemTemplateSystemSignalRef=DET_RANGE_VELOCITY_ERR_178
            DET_RANGE_VELOCITY_ERR_179_oRDR_DETECTION_177_180_oPCAN_RADAR_bce23804_Tx: ComBitPosition=288, ComBitSize=8, ComSignalInitValue=0, ComSignalType=UINT8, ComSystemTemplateSystemSignalRef=DET_RANGE_VELOCITY_ERR_179
            DET_RANGE_VELOCITY_ERR_180_oRDR_DETECTION_177_180_oPCAN_RADAR_b1a6991e_Tx: ComBitPosition=400, ComBitSize=8, ComSignalInitValue=0, ComSignalType=UINT8, ComSystemTemplateSystemSignalRef=DET_RANGE_VELOCITY_ERR_180
            DET_RCS_177_oRDR_DETECTION_177_180_oPCAN_RADAR_8db9b23e_Tx: ComBitPosition=128, ComBitSize=8, ComSignalInitValue=128, ComSignalType=UINT8, ComSystemTemplateSystemSignalRef=DET_RCS_177
            DET_RCS_178_oRDR_DETECTION_177_180_oPCAN_RADAR_a1a92079_Tx: ComBitPosition=240, ComBitSize=8, ComSignalInitValue=128, ComSignalType=UINT8, ComSystemTemplateSystemSignalRef=DET_RCS_178
            DET_RCS_179_oRDR_DETECTION_177_180_oPCAN_RADAR_34d9f4ec_Tx: ComBitPosition=352, ComBitSize=8, ComSignalInitValue=128, ComSignalType=UINT8, ComSystemTemplateSystemSignalRef=DET_RCS_179
            DET_RCS_180_oRDR_DETECTION_177_180_oPCAN_RADAR_399d55f6_Tx: ComBitPosition=464, ComBitSize=8, ComSignalInitValue=128, ComSignalType=UINT8, ComSystemTemplateSystemSignalRef=DET_RCS_180
            DET_SNR_177_oRDR_DETECTION_177_180_oPCAN_RADAR_5017e63c_Tx: ComBitPosition=120, ComBitSize=8, ComSignalInitValue=0, ComSignalType=UINT8, ComSystemTemplateSystemSignalRef=DET_SNR_177
            DET_SNR_178_oRDR_DETECTION_177_180_oPCAN_RADAR_7c07747b_Tx: ComBitPosition=232, ComBitSize=8, ComSignalInitValue=0, ComSignalType=UINT8, ComSystemTemplateSystemSignalRef=DET_SNR_178
            DET_SNR_179_oRDR_DETECTION_177_180_oPCAN_RADAR_e977a0ee_Tx: ComBitPosition=344, ComBitSize=8, ComSignalInitValue=0, ComSignalType=UINT8, ComSystemTemplateSystemSignalRef=DET_SNR_179
            DET_SNR_180_oRDR_DETECTION_177_180_oPCAN_RADAR_e43301f4_Tx: ComBitPosition=456, ComBitSize=8, ComSignalInitValue=0, ComSignalType=UINT8, ComSystemTemplateSystemSignalRef=DET_SNR_180
            DET_SUPER_RES_TARGET_177_oRDR_DETECTION_177_180_oPCAN_RADAR_618ece59_Tx: ComBitPosition=87, ComBitSize=1, ComSignalInitValue=0, ComSignalType=BOOLEAN, ComSystemTemplateSystemSignalRef=DET_SUPER_RES_TARGET_177
            DET_SUPER_RES_TARGET_178_oRDR_DETECTION_177_180_oPCAN_RADAR_4d9e5c1e_Tx: ComBitPosition=199, ComBitSize=1, ComSignalInitValue=0, ComSignalType=BOOLEAN, ComSystemTemplateSystemSignalRef=DET_SUPER_RES_TARGET_178
            DET_SUPER_RES_TARGET_179_oRDR_DETECTION_177_180_oPCAN_RADAR_d8ee888b_Tx: ComBitPosition=311, ComBitSize=1, ComSignalInitValue=0, ComSignalType=BOOLEAN, ComSystemTemplateSystemSignalRef=DET_SUPER_RES_TARGET_179
            DET_SUPER_RES_TARGET_180_oRDR_DETECTION_177_180_oPCAN_RADAR_d5aa2991_Tx: ComBitPosition=423, ComBitSize=1, ComSignalInitValue=0, ComSignalType=BOOLEAN, ComSystemTemplateSystemSignalRef=DET_SUPER_RES_TARGET_180
        SG_Detections_181_184_oRDR_DETECTION_181_184_oPCAN_RADAR_48363651_Tx: ComSystemTemplateSignalGroupRef=SG_Detections_181_184
          83 x ComGroupSignal, all with ComSignalEndianness=LITTLE_ENDIAN, ComTransferProperty=PENDING:
            DET_AZIMUTH_181_oRDR_DETECTION_181_184_oPCAN_RADAR_dfa27e51_Tx: ComBitPosition=88, ComBitSize=13, ComSignalInitValue=0, ComSignalType=UINT16, ComSystemTemplateSystemSignalRef=DET_AZIMUTH_181
            DET_AZIMUTH_182_oRDR_DETECTION_181_184_oPCAN_RADAR_bb4205af_Tx: ComBitPosition=200, ComBitSize=13, ComSignalInitValue=0, ComSignalType=UINT16, ComSystemTemplateSystemSignalRef=DET_AZIMUTH_182
            DET_AZIMUTH_183_oRDR_DETECTION_181_184_oPCAN_RADAR_2e32d13a_Tx: ComBitPosition=312, ComBitSize=13, ComSignalInitValue=0, ComSignalType=UINT16, ComSystemTemplateSystemSignalRef=DET_AZIMUTH_183
            DET_AZIMUTH_184_oRDR_DETECTION_181_184_oPCAN_RADAR_7282f253_Tx: ComBitPosition=424, ComBitSize=13, ComSignalInitValue=0, ComSignalType=UINT16, ComSystemTemplateSystemSignalRef=DET_AZIMUTH_184
            DET_AZIMUTH_ERR_181_oRDR_DETECTION_181_184_oPCAN_RADAR_7b17eba4_Tx: ComBitPosition=105, ComBitSize=7, ComSignalInitValue=0, ComSignalType=UINT8, ComSystemTemplateSystemSignalRef=DET_AZIMUTH_ERR_181
            DET_AZIMUTH_ERR_182_oRDR_DETECTION_181_184_oPCAN_RADAR_1ff7905a_Tx: ComBitPosition=217, ComBitSize=7, ComSignalInitValue=0, ComSignalType=UINT8, ComSystemTemplateSystemSignalRef=DET_AZIMUTH_ERR_182
            DET_AZIMUTH_ERR_183_oRDR_DETECTION_181_184_oPCAN_RADAR_8a8744cf_Tx: ComBitPosition=329, ComBitSize=7, ComSignalInitValue=0, ComSignalType=UINT8, ComSystemTemplateSystemSignalRef=DET_AZIMUTH_ERR_183
            DET_AZIMUTH_ERR_184_oRDR_DETECTION_181_184_oPCAN_RADAR_d63767a6_Tx: ComBitPosition=441, ComBitSize=7, ComSignalInitValue=0, ComSignalType=UINT8, ComSystemTemplateSystemSignalRef=DET_AZIMUTH_ERR_184
            DET_BELOW_RAIN_THOLD_181_oRDR_DETECTION_181_184_oPCAN_RADAR_0aa3ed91_Tx: ComBitPosition=39, ComBitSize=1, ComSignalInitValue=0, ComSignalType=BOOLEAN, ComSystemTemplateSystemSignalRef=DET_BELOW_RAIN_THOLD_181
            DET_BELOW_RAIN_THOLD_182_oRDR_DETECTION_181_184_oPCAN_RADAR_6e43966f_Tx: ComBitPosition=151, ComBitSize=1, ComSignalInitValue=0, ComSignalType=BOOLEAN, ComSystemTemplateSystemSignalRef=DET_BELOW_RAIN_THOLD_182
            DET_BELOW_RAIN_THOLD_183_oRDR_DETECTION_181_184_oPCAN_RADAR_fb3342fa_Tx: ComBitPosition=263, ComBitSize=1, ComSignalInitValue=0, ComSignalType=BOOLEAN, ComSystemTemplateSystemSignalRef=DET_BELOW_RAIN_THOLD_183
            DET_BELOW_RAIN_THOLD_184_oRDR_DETECTION_181_184_oPCAN_RADAR_a7836193_Tx: ComBitPosition=375, ComBitSize=1, ComSignalInitValue=0, ComSignalType=BOOLEAN, ComSystemTemplateSystemSignalRef=DET_BELOW_RAIN_THOLD_184
            DET_BI_STATIC_FLAG_181_oRDR_DETECTION_181_184_oPCAN_RADAR_898e3ed4_Tx: ComBitPosition=104, ComBitSize=1, ComSignalInitValue=0, ComSignalType=BOOLEAN, ComSystemTemplateSystemSignalRef=DET_BI_STATIC_FLAG_181
            DET_BI_STATIC_FLAG_182_oRDR_DETECTION_181_184_oPCAN_RADAR_ed6e452a_Tx: ComBitPosition=216, ComBitSize=1, ComSignalInitValue=0, ComSignalType=BOOLEAN, ComSystemTemplateSystemSignalRef=DET_BI_STATIC_FLAG_182
            DET_BI_STATIC_FLAG_183_oRDR_DETECTION_181_184_oPCAN_RADAR_781e91bf_Tx: ComBitPosition=328, ComBitSize=1, ComSignalInitValue=0, ComSignalType=BOOLEAN, ComSystemTemplateSystemSignalRef=DET_BI_STATIC_FLAG_183
            DET_BI_STATIC_FLAG_184_oRDR_DETECTION_181_184_oPCAN_RADAR_24aeb2d6_Tx: ComBitPosition=440, ComBitSize=1, ComSignalInitValue=0, ComSignalType=BOOLEAN, ComSystemTemplateSystemSignalRef=DET_BI_STATIC_FLAG_184
            DET_CONFD_AZIMUTH_181_oRDR_DETECTION_181_184_oPCAN_RADAR_dd44749b_Tx: ComBitPosition=118, ComBitSize=2, ComSignalInitValue=0, ComSignalType=UINT8, ComSystemTemplateSystemSignalRef=DET_CONFD_AZIMUTH_181
            DET_CONFD_AZIMUTH_182_oRDR_DETECTION_181_184_oPCAN_RADAR_b9a40f65_Tx: ComBitPosition=230, ComBitSize=2, ComSignalInitValue=0, ComSignalType=UINT8, ComSystemTemplateSystemSignalRef=DET_CONFD_AZIMUTH_182
            DET_CONFD_AZIMUTH_183_oRDR_DETECTION_181_184_oPCAN_RADAR_2cd4dbf0_Tx: ComBitPosition=342, ComBitSize=2, ComSignalInitValue=0, ComSignalType=UINT8, ComSystemTemplateSystemSignalRef=DET_CONFD_AZIMUTH_183
            DET_CONFD_AZIMUTH_184_oRDR_DETECTION_181_184_oPCAN_RADAR_7064f899_Tx: ComBitPosition=454, ComBitSize=2, ComSignalInitValue=0, ComSignalType=UINT8, ComSystemTemplateSystemSignalRef=DET_CONFD_AZIMUTH_184
            DET_CONFD_ELEVATION_181_oRDR_DETECTION_181_184_oPCAN_RADAR_dfd17561_Tx: ComBitPosition=101, ComBitSize=2, ComSignalInitValue=0, ComSignalType=UINT8, ComSystemTemplateSystemSignalRef=DET_CONFD_ELEVATION_181
            DET_CONFD_ELEVATION_182_oRDR_DETECTION_181_184_oPCAN_RADAR_bb310e9f_Tx: ComBitPosition=213, ComBitSize=2, ComSignalInitValue=0, ComSignalType=UINT8, ComSystemTemplateSystemSignalRef=DET_CONFD_ELEVATION_182
            DET_CONFD_ELEVATION_183_oRDR_DETECTION_181_184_oPCAN_RADAR_2e41da0a_Tx: ComBitPosition=325, ComBitSize=2, ComSignalInitValue=0, ComSignalType=UINT8, ComSystemTemplateSystemSignalRef=DET_CONFD_ELEVATION_183
            DET_CONFD_ELEVATION_184_oRDR_DETECTION_181_184_oPCAN_RADAR_72f1f963_Tx: ComBitPosition=437, ComBitSize=2, ComSignalInitValue=0, ComSignalType=UINT8, ComSystemTemplateSystemSignalRef=DET_CONFD_ELEVATION_184
            DET_ELEVATION_181_oRDR_DETECTION_181_184_oPCAN_RADAR_0e11a15d_Tx: ComBitPosition=72, ComBitSize=8, ComSignalInitValue=0, ComSignalType=UINT8, ComSystemTemplateSystemSignalRef=DET_ELEVATION_181
            DET_ELEVATION_182_oRDR_DETECTION_181_184_oPCAN_RADAR_6af1daa3_Tx: ComBitPosition=184, ComBitSize=8, ComSignalInitValue=0, ComSignalType=UINT8, ComSystemTemplateSystemSignalRef=DET_ELEVATION_182
            DET_ELEVATION_183_oRDR_DETECTION_181_184_oPCAN_RADAR_ff810e36_Tx: ComBitPosition=296, ComBitSize=8, ComSignalInitValue=0, ComSignalType=UINT8, ComSystemTemplateSystemSignalRef=DET_ELEVATION_183
            DET_ELEVATION_184_oRDR_DETECTION_181_184_oPCAN_RADAR_a3312d5f_Tx: ComBitPosition=408, ComBitSize=8, ComSignalInitValue=0, ComSignalType=UINT8, ComSystemTemplateSystemSignalRef=DET_ELEVATION_184
            DET_ELEVATION_ERR_181_oRDR_DETECTION_181_184_oPCAN_RADAR_89283928_Tx: ComBitPosition=80, ComBitSize=6, ComSignalInitValue=0, ComSignalType=UINT8, ComSystemTemplateSystemSignalRef=DET_ELEVATION_ERR_181
            DET_ELEVATION_ERR_182_oRDR_DETECTION_181_184_oPCAN_RADAR_edc842d6_Tx: ComBitPosition=192, ComBitSize=6, ComSignalInitValue=0, ComSignalType=UINT8, ComSystemTemplateSystemSignalRef=DET_ELEVATION_ERR_182
            DET_ELEVATION_ERR_183_oRDR_DETECTION_181_184_oPCAN_RADAR_78b89643_Tx: ComBitPosition=304, ComBitSize=6, ComSignalInitValue=0, ComSignalType=UINT8, ComSystemTemplateSystemSignalRef=DET_ELEVATION_ERR_183
            DET_ELEVATION_ERR_184_oRDR_DETECTION_181_184_oPCAN_RADAR_2408b52a_Tx: ComBitPosition=416, ComBitSize=6, ComSignalInitValue=0, ComSignalType=UINT8, ComSystemTemplateSystemSignalRef=DET_ELEVATION_ERR_184
            DET_EXISTENCE_PROB_181_oRDR_DETECTION_181_184_oPCAN_RADAR_5bb74c48_Tx: ComBitPosition=112, ComBitSize=6, ComSignalInitValue=0, ComSignalType=UINT8, ComSystemTemplateSystemSignalRef=DET_EXISTENCE_PROB_181
            DET_EXISTENCE_PROB_182_oRDR_DETECTION_181_184_oPCAN_RADAR_3f5737b6_Tx: ComBitPosition=224, ComBitSize=6, ComSignalInitValue=0, ComSignalType=UINT8, ComSystemTemplateSystemSignalRef=DET_EXISTENCE_PROB_182
            DET_EXISTENCE_PROB_183_oRDR_DETECTION_181_184_oPCAN_RADAR_aa27e323_Tx: ComBitPosition=336, ComBitSize=6, ComSignalInitValue=0, ComSignalType=UINT8, ComSystemTemplateSystemSignalRef=DET_EXISTENCE_PROB_183
            DET_EXISTENCE_PROB_184_oRDR_DETECTION_181_184_oPCAN_RADAR_f697c04a_Tx: ComBitPosition=448, ComBitSize=6, ComSignalInitValue=0, ComSignalType=UINT8, ComSystemTemplateSystemSignalRef=DET_EXISTENCE_PROB_184
            DET_HVC_FLAG_181_oRDR_DETECTION_181_184_oPCAN_RADAR_bac30f37_Tx: ComBitPosition=86, ComBitSize=1, ComSignalInitValue=0, ComSignalType=BOOLEAN, ComSystemTemplateSystemSignalRef=DET_HVC_FLAG_181
            DET_HVC_FLAG_182_oRDR_DETECTION_181_184_oPCAN_RADAR_de2374c9_Tx: ComBitPosition=198, ComBitSize=1, ComSignalInitValue=0, ComSignalType=BOOLEAN, ComSystemTemplateSystemSignalRef=DET_HVC_FLAG_182
            DET_HVC_FLAG_183_oRDR_DETECTION_181_184_oPCAN_RADAR_4b53a05c_Tx: ComBitPosition=310, ComBitSize=1, ComSignalInitValue=0, ComSignalType=BOOLEAN, ComSystemTemplateSystemSignalRef=DET_HVC_FLAG_183
            DET_HVC_FLAG_184_oRDR_DETECTION_181_184_oPCAN_RADAR_17e38335_Tx: ComBitPosition=422, ComBitSize=1, ComSignalInitValue=0, ComSignalType=BOOLEAN, ComSystemTemplateSystemSignalRef=DET_HVC_FLAG_184
            DET_IDM_181_oRDR_DETECTION_181_184_oPCAN_RADAR_3191348a_Tx: ComBitPosition=63, ComBitSize=1, ComSignalInitValue=0, ComSignalType=BOOLEAN, ComSystemTemplateSystemSignalRef=DET_IDM_181
            DET_IDM_182_oRDR_DETECTION_181_184_oPCAN_RADAR_55714f74_Tx: ComBitPosition=175, ComBitSize=1, ComSignalInitValue=0, ComSignalType=BOOLEAN, ComSystemTemplateSystemSignalRef=DET_IDM_182
            DET_IDM_183_oRDR_DETECTION_181_184_oPCAN_RADAR_c0019be1_Tx: ComBitPosition=287, ComBitSize=1, ComSignalInitValue=0, ComSignalType=BOOLEAN, ComSystemTemplateSystemSignalRef=DET_IDM_183
            DET_IDM_184_oRDR_DETECTION_181_184_oPCAN_RADAR_9cb1b888_Tx: ComBitPosition=399, ComBitSize=1, ComSignalInitValue=0, ComSignalType=BOOLEAN, ComSystemTemplateSystemSignalRef=DET_IDM_184
            DET_MH_CRC16_181_184_oRDR_DETECTION_181_184_oPCAN_RADAR_ccbee45a_Tx: ComBitPosition=0, ComBitSize=16, ComSignalInitValue=0, ComSignalType=UINT16, ComSystemTemplateSystemSignalRef=DET_MH_CRC16_181_184
            DET_MH_CYCLE_COUNTER_181_184_oRDR_DETECTION_181_184_oPCAN_RADAR_48cb456d_Tx: ComBitPosition=16, ComBitSize=8, ComSignalInitValue=0, ComSignalType=UINT8, ComSystemTemplateSystemSignalRef=DET_MH_CYCLE_COUNTER_181_184
            DET_MH_SCAN_INDEX_4LSB_181_184_oRDR_DETECTION_181_184_oPCAN_RADAR_84e160e1_Tx: ComBitPosition=476, ComBitSize=4, ComSignalInitValue=0, ComSignalType=UINT8, ComSystemTemplateSystemSignalRef=DET_MH_SCAN_INDEX_4LSB_181_184
            DET_MTD_181_oRDR_DETECTION_181_184_oPCAN_RADAR_57220651_Tx: ComBitPosition=47, ComBitSize=1, ComSignalInitValue=0, ComSignalType=BOOLEAN, ComSystemTemplateSystemSignalRef=DET_MTD_181
            DET_MTD_182_oRDR_DETECTION_181_184_oPCAN_RADAR_33c27daf_Tx: ComBitPosition=159, ComBitSize=1, ComSignalInitValue=0, ComSignalType=BOOLEAN, ComSystemTemplateSystemSignalRef=DET_MTD_182
            DET_MTD_183_oRDR_DETECTION_181_184_oPCAN_RADAR_a6b2a93a_Tx: ComBitPosition=271, ComBitSize=1, ComSignalInitValue=0, ComSignalType=BOOLEAN, ComSystemTemplateSystemSignalRef=DET_MTD_183
            DET_MTD_184_oRDR_DETECTION_181_184_oPCAN_RADAR_fa028a53_Tx: ComBitPosition=383, ComBitSize=1, ComSignalInitValue=0, ComSignalType=BOOLEAN, ComSystemTemplateSystemSignalRef=DET_MTD_184
            DET_PROB_1STAZHYPO_181_oRDR_DETECTION_181_184_oPCAN_RADAR_c496ee9c_Tx: ComBitPosition=103, ComBitSize=1, ComSignalInitValue=0, ComSignalType=BOOLEAN, ComSystemTemplateSystemSignalRef=DET_PROB_1STAZHYPO_181
            DET_PROB_1STAZHYPO_182_oRDR_DETECTION_181_184_oPCAN_RADAR_a0769562_Tx: ComBitPosition=215, ComBitSize=1, ComSignalInitValue=0, ComSignalType=BOOLEAN, ComSystemTemplateSystemSignalRef=DET_PROB_1STAZHYPO_182
            DET_PROB_1STAZHYPO_183_oRDR_DETECTION_181_184_oPCAN_RADAR_350641f7_Tx: ComBitPosition=327, ComBitSize=1, ComSignalInitValue=0, ComSignalType=BOOLEAN, ComSystemTemplateSystemSignalRef=DET_PROB_1STAZHYPO_183
            DET_PROB_1STAZHYPO_184_oRDR_DETECTION_181_184_oPCAN_RADAR_69b6629e_Tx: ComBitPosition=439, ComBitSize=1, ComSignalInitValue=0, ComSignalType=BOOLEAN, ComSystemTemplateSystemSignalRef=DET_PROB_1STAZHYPO_184
            DET_RANGE_181_oRDR_DETECTION_181_184_oPCAN_RADAR_cf390dea_Tx: ComBitPosition=24, ComBitSize=15, ComSignalInitValue=0, ComSignalType=UINT16, ComSystemTemplateSystemSignalRef=DET_RANGE_181
            DET_RANGE_182_oRDR_DETECTION_181_184_oPCAN_RADAR_abd97614_Tx: ComBitPosition=136, ComBitSize=15, ComSignalInitValue=0, ComSignalType=UINT16, ComSystemTemplateSystemSignalRef=DET_RANGE_182
            DET_RANGE_183_oRDR_DETECTION_181_184_oPCAN_RADAR_3ea9a281_Tx: ComBitPosition=248, ComBitSize=15, ComSignalInitValue=0, ComSignalType=UINT16, ComSystemTemplateSystemSignalRef=DET_RANGE_183
            DET_RANGE_184_oRDR_DETECTION_181_184_oPCAN_RADAR_621981e8_Tx: ComBitPosition=360, ComBitSize=15, ComSignalInitValue=0, ComSignalType=UINT16, ComSystemTemplateSystemSignalRef=DET_RANGE_184
            DET_RANGE_ERR_181_oRDR_DETECTION_181_184_oPCAN_RADAR_68d1b783_Tx: ComBitPosition=40, ComBitSize=7, ComSignalInitValue=0, ComSignalType=UINT8, ComSystemTemplateSystemSignalRef=DET_RANGE_ERR_181
            DET_RANGE_ERR_182_oRDR_DETECTION_181_184_oPCAN_RADAR_0c31cc7d_Tx: ComBitPosition=152, ComBitSize=7, ComSignalInitValue=0, ComSignalType=UINT8, ComSystemTemplateSystemSignalRef=DET_RANGE_ERR_182
            DET_RANGE_ERR_183_oRDR_DETECTION_181_184_oPCAN_RADAR_994118e8_Tx: ComBitPosition=264, ComBitSize=7, ComSignalInitValue=0, ComSignalType=UINT8, ComSystemTemplateSystemSignalRef=DET_RANGE_ERR_183
            DET_RANGE_ERR_184_oRDR_DETECTION_181_184_oPCAN_RADAR_c5f13b81_Tx: ComBitPosition=376, ComBitSize=7, ComSignalInitValue=0, ComSignalType=UINT8, ComSystemTemplateSystemSignalRef=DET_RANGE_ERR_184
            DET_RANGE_VELOCITY_181_oRDR_DETECTION_181_184_oPCAN_RADAR_ba9fcfcf_Tx: ComBitPosition=48, ComBitSize=15, ComSignalInitValue=16384, ComSignalType=UINT16, ComSystemTemplateSystemSignalRef=DET_RANGE_VELOCITY_181
            DET_RANGE_VELOCITY_182_oRDR_DETECTION_181_184_oPCAN_RADAR_de7fb431_Tx: ComBitPosition=160, ComBitSize=15, ComSignalInitValue=16384, ComSignalType=UINT16, ComSystemTemplateSystemSignalRef=DET_RANGE_VELOCITY_182
            DET_RANGE_VELOCITY_183_oRDR_DETECTION_181_184_oPCAN_RADAR_4b0f60a4_Tx: ComBitPosition=272, ComBitSize=15, ComSignalInitValue=16384, ComSignalType=UINT16, ComSystemTemplateSystemSignalRef=DET_RANGE_VELOCITY_183
            DET_RANGE_VELOCITY_184_oRDR_DETECTION_181_184_oPCAN_RADAR_17bf43cd_Tx: ComBitPosition=384, ComBitSize=15, ComSignalInitValue=16384, ComSignalType=UINT16, ComSystemTemplateSystemSignalRef=DET_RANGE_VELOCITY_184
            DET_RANGE_VELOCITY_ERR_181_oRDR_DETECTION_181_184_oPCAN_RADAR_b524347d_Tx: ComBitPosition=64, ComBitSize=8, ComSignalInitValue=0, ComSignalType=UINT8, ComSystemTemplateSystemSignalRef=DET_RANGE_VELOCITY_ERR_181
            DET_RANGE_VELOCITY_ERR_182_oRDR_DETECTION_181_184_oPCAN_RADAR_d1c44f83_Tx: ComBitPosition=176, ComBitSize=8, ComSignalInitValue=0, ComSignalType=UINT8, ComSystemTemplateSystemSignalRef=DET_RANGE_VELOCITY_ERR_182
            DET_RANGE_VELOCITY_ERR_183_oRDR_DETECTION_181_184_oPCAN_RADAR_44b49b16_Tx: ComBitPosition=288, ComBitSize=8, ComSignalInitValue=0, ComSignalType=UINT8, ComSystemTemplateSystemSignalRef=DET_RANGE_VELOCITY_ERR_183
            DET_RANGE_VELOCITY_ERR_184_oRDR_DETECTION_181_184_oPCAN_RADAR_1804b87f_Tx: ComBitPosition=400, ComBitSize=8, ComSignalInitValue=0, ComSignalType=UINT8, ComSystemTemplateSystemSignalRef=DET_RANGE_VELOCITY_ERR_184
            DET_RCS_181_oRDR_DETECTION_181_184_oPCAN_RADAR_3d1ff895_Tx: ComBitPosition=128, ComBitSize=8, ComSignalInitValue=128, ComSignalType=UINT8, ComSystemTemplateSystemSignalRef=DET_RCS_181
            DET_RCS_182_oRDR_DETECTION_181_184_oPCAN_RADAR_59ff836b_Tx: ComBitPosition=240, ComBitSize=8, ComSignalInitValue=128, ComSignalType=UINT8, ComSystemTemplateSystemSignalRef=DET_RCS_182
            DET_RCS_183_oRDR_DETECTION_181_184_oPCAN_RADAR_cc8f57fe_Tx: ComBitPosition=352, ComBitSize=8, ComSignalInitValue=128, ComSignalType=UINT8, ComSystemTemplateSystemSignalRef=DET_RCS_183
            DET_RCS_184_oRDR_DETECTION_181_184_oPCAN_RADAR_903f7497_Tx: ComBitPosition=464, ComBitSize=8, ComSignalInitValue=128, ComSignalType=UINT8, ComSystemTemplateSystemSignalRef=DET_RCS_184
            DET_SNR_181_oRDR_DETECTION_181_184_oPCAN_RADAR_e0b1ac97_Tx: ComBitPosition=120, ComBitSize=8, ComSignalInitValue=0, ComSignalType=UINT8, ComSystemTemplateSystemSignalRef=DET_SNR_181
            DET_SNR_182_oRDR_DETECTION_181_184_oPCAN_RADAR_8451d769_Tx: ComBitPosition=232, ComBitSize=8, ComSignalInitValue=0, ComSignalType=UINT8, ComSystemTemplateSystemSignalRef=DET_SNR_182
            DET_SNR_183_oRDR_DETECTION_181_184_oPCAN_RADAR_112103fc_Tx: ComBitPosition=344, ComBitSize=8, ComSignalInitValue=0, ComSignalType=UINT8, ComSystemTemplateSystemSignalRef=DET_SNR_183
            DET_SNR_184_oRDR_DETECTION_181_184_oPCAN_RADAR_4d912095_Tx: ComBitPosition=456, ComBitSize=8, ComSignalInitValue=0, ComSignalType=UINT8, ComSystemTemplateSystemSignalRef=DET_SNR_184
            DET_SUPER_RES_TARGET_181_oRDR_DETECTION_181_184_oPCAN_RADAR_d12884f2_Tx: ComBitPosition=87, ComBitSize=1, ComSignalInitValue=0, ComSignalType=BOOLEAN, ComSystemTemplateSystemSignalRef=DET_SUPER_RES_TARGET_181
            DET_SUPER_RES_TARGET_182_oRDR_DETECTION_181_184_oPCAN_RADAR_b5c8ff0c_Tx: ComBitPosition=199, ComBitSize=1, ComSignalInitValue=0, ComSignalType=BOOLEAN, ComSystemTemplateSystemSignalRef=DET_SUPER_RES_TARGET_182
            DET_SUPER_RES_TARGET_183_oRDR_DETECTION_181_184_oPCAN_RADAR_20b82b99_Tx: ComBitPosition=311, ComBitSize=1, ComSignalInitValue=0, ComSignalType=BOOLEAN, ComSystemTemplateSystemSignalRef=DET_SUPER_RES_TARGET_183
            DET_SUPER_RES_TARGET_184_oRDR_DETECTION_181_184_oPCAN_RADAR_7c0808f0_Tx: ComBitPosition=423, ComBitSize=1, ComSignalInitValue=0, ComSignalType=BOOLEAN, ComSystemTemplateSystemSignalRef=DET_SUPER_RES_TARGET_184
        SG_Detections_185_188_oRDR_DETECTION_185_188_oPCAN_RADAR_39f50203_Tx: ComSystemTemplateSignalGroupRef=SG_Detections_185_188
          83 x ComGroupSignal, all with ComSignalEndianness=LITTLE_ENDIAN, ComTransferProperty=PENDING:
            DET_AZIMUTH_185_oRDR_DETECTION_185_188_oPCAN_RADAR_0e40b8f2_Tx: ComBitPosition=88, ComBitSize=13, ComSignalInitValue=0, ComSignalType=UINT16, ComSystemTemplateSystemSignalRef=DET_AZIMUTH_185
            DET_AZIMUTH_186_oRDR_DETECTION_185_188_oPCAN_RADAR_6aa0c30c_Tx: ComBitPosition=200, ComBitSize=13, ComSignalInitValue=0, ComSignalType=UINT16, ComSystemTemplateSystemSignalRef=DET_AZIMUTH_186
            DET_AZIMUTH_187_oRDR_DETECTION_185_188_oPCAN_RADAR_ffd01799_Tx: ComBitPosition=312, ComBitSize=13, ComSignalInitValue=0, ComSignalType=UINT16, ComSystemTemplateSystemSignalRef=DET_AZIMUTH_187
            DET_AZIMUTH_188_oRDR_DETECTION_185_188_oPCAN_RADAR_d3c085de_Tx: ComBitPosition=424, ComBitSize=13, ComSignalInitValue=0, ComSignalType=UINT16, ComSystemTemplateSystemSignalRef=DET_AZIMUTH_188
            DET_AZIMUTH_ERR_185_oRDR_DETECTION_185_188_oPCAN_RADAR_aaf52d07_Tx: ComBitPosition=105, ComBitSize=7, ComSignalInitValue=0, ComSignalType=UINT8, ComSystemTemplateSystemSignalRef=DET_AZIMUTH_ERR_185
            DET_AZIMUTH_ERR_186_oRDR_DETECTION_185_188_oPCAN_RADAR_ce1556f9_Tx: ComBitPosition=217, ComBitSize=7, ComSignalInitValue=0, ComSignalType=UINT8, ComSystemTemplateSystemSignalRef=DET_AZIMUTH_ERR_186
            DET_AZIMUTH_ERR_187_oRDR_DETECTION_185_188_oPCAN_RADAR_5b65826c_Tx: ComBitPosition=329, ComBitSize=7, ComSignalInitValue=0, ComSignalType=UINT8, ComSystemTemplateSystemSignalRef=DET_AZIMUTH_ERR_187
            DET_AZIMUTH_ERR_188_oRDR_DETECTION_185_188_oPCAN_RADAR_7775102b_Tx: ComBitPosition=441, ComBitSize=7, ComSignalInitValue=0, ComSignalType=UINT8, ComSystemTemplateSystemSignalRef=DET_AZIMUTH_ERR_188
            DET_BELOW_RAIN_THOLD_185_oRDR_DETECTION_185_188_oPCAN_RADAR_db412b32_Tx: ComBitPosition=39, ComBitSize=1, ComSignalInitValue=0, ComSignalType=BOOLEAN, ComSystemTemplateSystemSignalRef=DET_BELOW_RAIN_THOLD_185
            DET_BELOW_RAIN_THOLD_186_oRDR_DETECTION_185_188_oPCAN_RADAR_bfa150cc_Tx: ComBitPosition=151, ComBitSize=1, ComSignalInitValue=0, ComSignalType=BOOLEAN, ComSystemTemplateSystemSignalRef=DET_BELOW_RAIN_THOLD_186
            DET_BELOW_RAIN_THOLD_187_oRDR_DETECTION_185_188_oPCAN_RADAR_2ad18459_Tx: ComBitPosition=263, ComBitSize=1, ComSignalInitValue=0, ComSignalType=BOOLEAN, ComSystemTemplateSystemSignalRef=DET_BELOW_RAIN_THOLD_187
            DET_BELOW_RAIN_THOLD_188_oRDR_DETECTION_185_188_oPCAN_RADAR_06c1161e_Tx: ComBitPosition=375, ComBitSize=1, ComSignalInitValue=0, ComSignalType=BOOLEAN, ComSystemTemplateSystemSignalRef=DET_BELOW_RAIN_THOLD_188
            DET_BI_STATIC_FLAG_185_oRDR_DETECTION_185_188_oPCAN_RADAR_586cf877_Tx: ComBitPosition=104, ComBitSize=1, ComSignalInitValue=0, ComSignalType=BOOLEAN, ComSystemTemplateSystemSignalRef=DET_BI_STATIC_FLAG_185
            DET_BI_STATIC_FLAG_186_oRDR_DETECTION_185_188_oPCAN_RADAR_3c8c8389_Tx: ComBitPosition=216, ComBitSize=1, ComSignalInitValue=0, ComSignalType=BOOLEAN, ComSystemTemplateSystemSignalRef=DET_BI_STATIC_FLAG_186
            DET_BI_STATIC_FLAG_187_oRDR_DETECTION_185_188_oPCAN_RADAR_a9fc571c_Tx: ComBitPosition=328, ComBitSize=1, ComSignalInitValue=0, ComSignalType=BOOLEAN, ComSystemTemplateSystemSignalRef=DET_BI_STATIC_FLAG_187
            DET_BI_STATIC_FLAG_188_oRDR_DETECTION_185_188_oPCAN_RADAR_85ecc55b_Tx: ComBitPosition=440, ComBitSize=1, ComSignalInitValue=0, ComSignalType=BOOLEAN, ComSystemTemplateSystemSignalRef=DET_BI_STATIC_FLAG_188
            DET_CONFD_AZIMUTH_185_oRDR_DETECTION_185_188_oPCAN_RADAR_0ca6b238_Tx: ComBitPosition=118, ComBitSize=2, ComSignalInitValue=0, ComSignalType=UINT8, ComSystemTemplateSystemSignalRef=DET_CONFD_AZIMUTH_185
            DET_CONFD_AZIMUTH_186_oRDR_DETECTION_185_188_oPCAN_RADAR_6846c9c6_Tx: ComBitPosition=230, ComBitSize=2, ComSignalInitValue=0, ComSignalType=UINT8, ComSystemTemplateSystemSignalRef=DET_CONFD_AZIMUTH_186
            DET_CONFD_AZIMUTH_187_oRDR_DETECTION_185_188_oPCAN_RADAR_fd361d53_Tx: ComBitPosition=342, ComBitSize=2, ComSignalInitValue=0, ComSignalType=UINT8, ComSystemTemplateSystemSignalRef=DET_CONFD_AZIMUTH_187
            DET_CONFD_AZIMUTH_188_oRDR_DETECTION_185_188_oPCAN_RADAR_d1268f14_Tx: ComBitPosition=454, ComBitSize=2, ComSignalInitValue=0, ComSignalType=UINT8, ComSystemTemplateSystemSignalRef=DET_CONFD_AZIMUTH_188
            DET_CONFD_ELEVATION_185_oRDR_DETECTION_185_188_oPCAN_RADAR_0e33b3c2_Tx: ComBitPosition=101, ComBitSize=2, ComSignalInitValue=0, ComSignalType=UINT8, ComSystemTemplateSystemSignalRef=DET_CONFD_ELEVATION_185
            DET_CONFD_ELEVATION_186_oRDR_DETECTION_185_188_oPCAN_RADAR_6ad3c83c_Tx: ComBitPosition=213, ComBitSize=2, ComSignalInitValue=0, ComSignalType=UINT8, ComSystemTemplateSystemSignalRef=DET_CONFD_ELEVATION_186
            DET_CONFD_ELEVATION_187_oRDR_DETECTION_185_188_oPCAN_RADAR_ffa31ca9_Tx: ComBitPosition=325, ComBitSize=2, ComSignalInitValue=0, ComSignalType=UINT8, ComSystemTemplateSystemSignalRef=DET_CONFD_ELEVATION_187
            DET_CONFD_ELEVATION_188_oRDR_DETECTION_185_188_oPCAN_RADAR_d3b38eee_Tx: ComBitPosition=437, ComBitSize=2, ComSignalInitValue=0, ComSignalType=UINT8, ComSystemTemplateSystemSignalRef=DET_CONFD_ELEVATION_188
            DET_ELEVATION_185_oRDR_DETECTION_185_188_oPCAN_RADAR_dff367fe_Tx: ComBitPosition=72, ComBitSize=8, ComSignalInitValue=0, ComSignalType=UINT8, ComSystemTemplateSystemSignalRef=DET_ELEVATION_185
            DET_ELEVATION_186_oRDR_DETECTION_185_188_oPCAN_RADAR_bb131c00_Tx: ComBitPosition=184, ComBitSize=8, ComSignalInitValue=0, ComSignalType=UINT8, ComSystemTemplateSystemSignalRef=DET_ELEVATION_186
            DET_ELEVATION_187_oRDR_DETECTION_185_188_oPCAN_RADAR_2e63c895_Tx: ComBitPosition=296, ComBitSize=8, ComSignalInitValue=0, ComSignalType=UINT8, ComSystemTemplateSystemSignalRef=DET_ELEVATION_187
            DET_ELEVATION_188_oRDR_DETECTION_185_188_oPCAN_RADAR_02735ad2_Tx: ComBitPosition=408, ComBitSize=8, ComSignalInitValue=0, ComSignalType=UINT8, ComSystemTemplateSystemSignalRef=DET_ELEVATION_188
            DET_ELEVATION_ERR_185_oRDR_DETECTION_185_188_oPCAN_RADAR_58caff8b_Tx: ComBitPosition=80, ComBitSize=6, ComSignalInitValue=0, ComSignalType=UINT8, ComSystemTemplateSystemSignalRef=DET_ELEVATION_ERR_185
            DET_ELEVATION_ERR_186_oRDR_DETECTION_185_188_oPCAN_RADAR_3c2a8475_Tx: ComBitPosition=192, ComBitSize=6, ComSignalInitValue=0, ComSignalType=UINT8, ComSystemTemplateSystemSignalRef=DET_ELEVATION_ERR_186
            DET_ELEVATION_ERR_187_oRDR_DETECTION_185_188_oPCAN_RADAR_a95a50e0_Tx: ComBitPosition=304, ComBitSize=6, ComSignalInitValue=0, ComSignalType=UINT8, ComSystemTemplateSystemSignalRef=DET_ELEVATION_ERR_187
            DET_ELEVATION_ERR_188_oRDR_DETECTION_185_188_oPCAN_RADAR_854ac2a7_Tx: ComBitPosition=416, ComBitSize=6, ComSignalInitValue=0, ComSignalType=UINT8, ComSystemTemplateSystemSignalRef=DET_ELEVATION_ERR_188
            DET_EXISTENCE_PROB_185_oRDR_DETECTION_185_188_oPCAN_RADAR_8a558aeb_Tx: ComBitPosition=112, ComBitSize=6, ComSignalInitValue=0, ComSignalType=UINT8, ComSystemTemplateSystemSignalRef=DET_EXISTENCE_PROB_185
            DET_EXISTENCE_PROB_186_oRDR_DETECTION_185_188_oPCAN_RADAR_eeb5f115_Tx: ComBitPosition=224, ComBitSize=6, ComSignalInitValue=0, ComSignalType=UINT8, ComSystemTemplateSystemSignalRef=DET_EXISTENCE_PROB_186
            DET_EXISTENCE_PROB_187_oRDR_DETECTION_185_188_oPCAN_RADAR_7bc52580_Tx: ComBitPosition=336, ComBitSize=6, ComSignalInitValue=0, ComSignalType=UINT8, ComSystemTemplateSystemSignalRef=DET_EXISTENCE_PROB_187
            DET_EXISTENCE_PROB_188_oRDR_DETECTION_185_188_oPCAN_RADAR_57d5b7c7_Tx: ComBitPosition=448, ComBitSize=6, ComSignalInitValue=0, ComSignalType=UINT8, ComSystemTemplateSystemSignalRef=DET_EXISTENCE_PROB_188
            DET_HVC_FLAG_185_oRDR_DETECTION_185_188_oPCAN_RADAR_6b21c994_Tx: ComBitPosition=86, ComBitSize=1, ComSignalInitValue=0, ComSignalType=BOOLEAN, ComSystemTemplateSystemSignalRef=DET_HVC_FLAG_185
            DET_HVC_FLAG_186_oRDR_DETECTION_185_188_oPCAN_RADAR_0fc1b26a_Tx: ComBitPosition=198, ComBitSize=1, ComSignalInitValue=0, ComSignalType=BOOLEAN, ComSystemTemplateSystemSignalRef=DET_HVC_FLAG_186
            DET_HVC_FLAG_187_oRDR_DETECTION_185_188_oPCAN_RADAR_9ab166ff_Tx: ComBitPosition=310, ComBitSize=1, ComSignalInitValue=0, ComSignalType=BOOLEAN, ComSystemTemplateSystemSignalRef=DET_HVC_FLAG_187
            DET_HVC_FLAG_188_oRDR_DETECTION_185_188_oPCAN_RADAR_b6a1f4b8_Tx: ComBitPosition=422, ComBitSize=1, ComSignalInitValue=0, ComSignalType=BOOLEAN, ComSystemTemplateSystemSignalRef=DET_HVC_FLAG_188
            DET_IDM_185_oRDR_DETECTION_185_188_oPCAN_RADAR_e073f229_Tx: ComBitPosition=63, ComBitSize=1, ComSignalInitValue=0, ComSignalType=BOOLEAN, ComSystemTemplateSystemSignalRef=DET_IDM_185
            DET_IDM_186_oRDR_DETECTION_185_188_oPCAN_RADAR_849389d7_Tx: ComBitPosition=175, ComBitSize=1, ComSignalInitValue=0, ComSignalType=BOOLEAN, ComSystemTemplateSystemSignalRef=DET_IDM_186
            DET_IDM_187_oRDR_DETECTION_185_188_oPCAN_RADAR_11e35d42_Tx: ComBitPosition=287, ComBitSize=1, ComSignalInitValue=0, ComSignalType=BOOLEAN, ComSystemTemplateSystemSignalRef=DET_IDM_187
            DET_IDM_188_oRDR_DETECTION_185_188_oPCAN_RADAR_3df3cf05_Tx: ComBitPosition=399, ComBitSize=1, ComSignalInitValue=0, ComSignalType=BOOLEAN, ComSystemTemplateSystemSignalRef=DET_IDM_188
            DET_MH_CRC16_185_188_oRDR_DETECTION_185_188_oPCAN_RADAR_bd7dd008_Tx: ComBitPosition=0, ComBitSize=16, ComSignalInitValue=0, ComSignalType=UINT16, ComSystemTemplateSystemSignalRef=DET_MH_CRC16_185_188
            DET_MH_CYCLE_COUNTER_185_188_oRDR_DETECTION_185_188_oPCAN_RADAR_3908713f_Tx: ComBitPosition=16, ComBitSize=8, ComSignalInitValue=0, ComSignalType=UINT8, ComSystemTemplateSystemSignalRef=DET_MH_CYCLE_COUNTER_185_188
            DET_MH_SCAN_INDEX_4LSB_185_188_oRDR_DETECTION_185_188_oPCAN_RADAR_f52254b3_Tx: ComBitPosition=476, ComBitSize=4, ComSignalInitValue=0, ComSignalType=UINT8, ComSystemTemplateSystemSignalRef=DET_MH_SCAN_INDEX_4LSB_185_188
            DET_MTD_185_oRDR_DETECTION_185_188_oPCAN_RADAR_86c0c0f2_Tx: ComBitPosition=47, ComBitSize=1, ComSignalInitValue=0, ComSignalType=BOOLEAN, ComSystemTemplateSystemSignalRef=DET_MTD_185
            DET_MTD_186_oRDR_DETECTION_185_188_oPCAN_RADAR_e220bb0c_Tx: ComBitPosition=159, ComBitSize=1, ComSignalInitValue=0, ComSignalType=BOOLEAN, ComSystemTemplateSystemSignalRef=DET_MTD_186
            DET_MTD_187_oRDR_DETECTION_185_188_oPCAN_RADAR_77506f99_Tx: ComBitPosition=271, ComBitSize=1, ComSignalInitValue=0, ComSignalType=BOOLEAN, ComSystemTemplateSystemSignalRef=DET_MTD_187
            DET_MTD_188_oRDR_DETECTION_185_188_oPCAN_RADAR_5b40fdde_Tx: ComBitPosition=383, ComBitSize=1, ComSignalInitValue=0, ComSignalType=BOOLEAN, ComSystemTemplateSystemSignalRef=DET_MTD_188
            DET_PROB_1STAZHYPO_185_oRDR_DETECTION_185_188_oPCAN_RADAR_1574283f_Tx: ComBitPosition=103, ComBitSize=1, ComSignalInitValue=0, ComSignalType=BOOLEAN, ComSystemTemplateSystemSignalRef=DET_PROB_1STAZHYPO_185
            DET_PROB_1STAZHYPO_186_oRDR_DETECTION_185_188_oPCAN_RADAR_719453c1_Tx: ComBitPosition=215, ComBitSize=1, ComSignalInitValue=0, ComSignalType=BOOLEAN, ComSystemTemplateSystemSignalRef=DET_PROB_1STAZHYPO_186
            DET_PROB_1STAZHYPO_187_oRDR_DETECTION_185_188_oPCAN_RADAR_e4e48754_Tx: ComBitPosition=327, ComBitSize=1, ComSignalInitValue=0, ComSignalType=BOOLEAN, ComSystemTemplateSystemSignalRef=DET_PROB_1STAZHYPO_187
            DET_PROB_1STAZHYPO_188_oRDR_DETECTION_185_188_oPCAN_RADAR_c8f41513_Tx: ComBitPosition=439, ComBitSize=1, ComSignalInitValue=0, ComSignalType=BOOLEAN, ComSystemTemplateSystemSignalRef=DET_PROB_1STAZHYPO_188
            DET_RANGE_185_oRDR_DETECTION_185_188_oPCAN_RADAR_1edbcb49_Tx: ComBitPosition=24, ComBitSize=15, ComSignalInitValue=0, ComSignalType=UINT16, ComSystemTemplateSystemSignalRef=DET_RANGE_185
            DET_RANGE_186_oRDR_DETECTION_185_188_oPCAN_RADAR_7a3bb0b7_Tx: ComBitPosition=136, ComBitSize=15, ComSignalInitValue=0, ComSignalType=UINT16, ComSystemTemplateSystemSignalRef=DET_RANGE_186
            DET_RANGE_187_oRDR_DETECTION_185_188_oPCAN_RADAR_ef4b6422_Tx: ComBitPosition=248, ComBitSize=15, ComSignalInitValue=0, ComSignalType=UINT16, ComSystemTemplateSystemSignalRef=DET_RANGE_187
            DET_RANGE_188_oRDR_DETECTION_185_188_oPCAN_RADAR_c35bf665_Tx: ComBitPosition=360, ComBitSize=15, ComSignalInitValue=0, ComSignalType=UINT16, ComSystemTemplateSystemSignalRef=DET_RANGE_188
            DET_RANGE_ERR_185_oRDR_DETECTION_185_188_oPCAN_RADAR_b9337120_Tx: ComBitPosition=40, ComBitSize=7, ComSignalInitValue=0, ComSignalType=UINT8, ComSystemTemplateSystemSignalRef=DET_RANGE_ERR_185
            DET_RANGE_ERR_186_oRDR_DETECTION_185_188_oPCAN_RADAR_ddd30ade_Tx: ComBitPosition=152, ComBitSize=7, ComSignalInitValue=0, ComSignalType=UINT8, ComSystemTemplateSystemSignalRef=DET_RANGE_ERR_186
            DET_RANGE_ERR_187_oRDR_DETECTION_185_188_oPCAN_RADAR_48a3de4b_Tx: ComBitPosition=264, ComBitSize=7, ComSignalInitValue=0, ComSignalType=UINT8, ComSystemTemplateSystemSignalRef=DET_RANGE_ERR_187
            DET_RANGE_ERR_188_oRDR_DETECTION_185_188_oPCAN_RADAR_64b34c0c_Tx: ComBitPosition=376, ComBitSize=7, ComSignalInitValue=0, ComSignalType=UINT8, ComSystemTemplateSystemSignalRef=DET_RANGE_ERR_188
            DET_RANGE_VELOCITY_185_oRDR_DETECTION_185_188_oPCAN_RADAR_6b7d096c_Tx: ComBitPosition=48, ComBitSize=15, ComSignalInitValue=16384, ComSignalType=UINT16, ComSystemTemplateSystemSignalRef=DET_RANGE_VELOCITY_185
            DET_RANGE_VELOCITY_186_oRDR_DETECTION_185_188_oPCAN_RADAR_0f9d7292_Tx: ComBitPosition=160, ComBitSize=15, ComSignalInitValue=16384, ComSignalType=UINT16, ComSystemTemplateSystemSignalRef=DET_RANGE_VELOCITY_186
            DET_RANGE_VELOCITY_187_oRDR_DETECTION_185_188_oPCAN_RADAR_9aeda607_Tx: ComBitPosition=272, ComBitSize=15, ComSignalInitValue=16384, ComSignalType=UINT16, ComSystemTemplateSystemSignalRef=DET_RANGE_VELOCITY_187
            DET_RANGE_VELOCITY_188_oRDR_DETECTION_185_188_oPCAN_RADAR_b6fd3440_Tx: ComBitPosition=384, ComBitSize=15, ComSignalInitValue=16384, ComSignalType=UINT16, ComSystemTemplateSystemSignalRef=DET_RANGE_VELOCITY_188
            DET_RANGE_VELOCITY_ERR_185_oRDR_DETECTION_185_188_oPCAN_RADAR_64c6f2de_Tx: ComBitPosition=64, ComBitSize=8, ComSignalInitValue=0, ComSignalType=UINT8, ComSystemTemplateSystemSignalRef=DET_RANGE_VELOCITY_ERR_185
            DET_RANGE_VELOCITY_ERR_186_oRDR_DETECTION_185_188_oPCAN_RADAR_00268920_Tx: ComBitPosition=176, ComBitSize=8, ComSignalInitValue=0, ComSignalType=UINT8, ComSystemTemplateSystemSignalRef=DET_RANGE_VELOCITY_ERR_186
            DET_RANGE_VELOCITY_ERR_187_oRDR_DETECTION_185_188_oPCAN_RADAR_95565db5_Tx: ComBitPosition=288, ComBitSize=8, ComSignalInitValue=0, ComSignalType=UINT8, ComSystemTemplateSystemSignalRef=DET_RANGE_VELOCITY_ERR_187
            DET_RANGE_VELOCITY_ERR_188_oRDR_DETECTION_185_188_oPCAN_RADAR_b946cff2_Tx: ComBitPosition=400, ComBitSize=8, ComSignalInitValue=0, ComSignalType=UINT8, ComSystemTemplateSystemSignalRef=DET_RANGE_VELOCITY_ERR_188
            DET_RCS_185_oRDR_DETECTION_185_188_oPCAN_RADAR_ecfd3e36_Tx: ComBitPosition=128, ComBitSize=8, ComSignalInitValue=128, ComSignalType=UINT8, ComSystemTemplateSystemSignalRef=DET_RCS_185
            DET_RCS_186_oRDR_DETECTION_185_188_oPCAN_RADAR_881d45c8_Tx: ComBitPosition=240, ComBitSize=8, ComSignalInitValue=128, ComSignalType=UINT8, ComSystemTemplateSystemSignalRef=DET_RCS_186
            DET_RCS_187_oRDR_DETECTION_185_188_oPCAN_RADAR_1d6d915d_Tx: ComBitPosition=352, ComBitSize=8, ComSignalInitValue=128, ComSignalType=UINT8, ComSystemTemplateSystemSignalRef=DET_RCS_187
            DET_RCS_188_oRDR_DETECTION_185_188_oPCAN_RADAR_317d031a_Tx: ComBitPosition=464, ComBitSize=8, ComSignalInitValue=128, ComSignalType=UINT8, ComSystemTemplateSystemSignalRef=DET_RCS_188
            DET_SNR_185_oRDR_DETECTION_185_188_oPCAN_RADAR_31536a34_Tx: ComBitPosition=120, ComBitSize=8, ComSignalInitValue=0, ComSignalType=UINT8, ComSystemTemplateSystemSignalRef=DET_SNR_185
            DET_SNR_186_oRDR_DETECTION_185_188_oPCAN_RADAR_55b311ca_Tx: ComBitPosition=232, ComBitSize=8, ComSignalInitValue=0, ComSignalType=UINT8, ComSystemTemplateSystemSignalRef=DET_SNR_186
            DET_SNR_187_oRDR_DETECTION_185_188_oPCAN_RADAR_c0c3c55f_Tx: ComBitPosition=344, ComBitSize=8, ComSignalInitValue=0, ComSignalType=UINT8, ComSystemTemplateSystemSignalRef=DET_SNR_187
            DET_SNR_188_oRDR_DETECTION_185_188_oPCAN_RADAR_ecd35718_Tx: ComBitPosition=456, ComBitSize=8, ComSignalInitValue=0, ComSignalType=UINT8, ComSystemTemplateSystemSignalRef=DET_SNR_188
            DET_SUPER_RES_TARGET_185_oRDR_DETECTION_185_188_oPCAN_RADAR_00ca4251_Tx: ComBitPosition=87, ComBitSize=1, ComSignalInitValue=0, ComSignalType=BOOLEAN, ComSystemTemplateSystemSignalRef=DET_SUPER_RES_TARGET_185
            DET_SUPER_RES_TARGET_186_oRDR_DETECTION_185_188_oPCAN_RADAR_642a39af_Tx: ComBitPosition=199, ComBitSize=1, ComSignalInitValue=0, ComSignalType=BOOLEAN, ComSystemTemplateSystemSignalRef=DET_SUPER_RES_TARGET_186
            DET_SUPER_RES_TARGET_187_oRDR_DETECTION_185_188_oPCAN_RADAR_f15aed3a_Tx: ComBitPosition=311, ComBitSize=1, ComSignalInitValue=0, ComSignalType=BOOLEAN, ComSystemTemplateSystemSignalRef=DET_SUPER_RES_TARGET_187
            DET_SUPER_RES_TARGET_188_oRDR_DETECTION_185_188_oPCAN_RADAR_dd4a7f7d_Tx: ComBitPosition=423, ComBitSize=1, ComSignalInitValue=0, ComSignalType=BOOLEAN, ComSystemTemplateSystemSignalRef=DET_SUPER_RES_TARGET_188
        SG_Detections_189_192_oRDR_DETECTION_189_192_oPCAN_RADAR_a08f2678_Tx: ComSystemTemplateSignalGroupRef=SG_Detections_189_192
          83 x ComGroupSignal, all with ComSignalEndianness=LITTLE_ENDIAN, ComTransferProperty=PENDING:
            DET_AZIMUTH_189_oRDR_DETECTION_189_192_oPCAN_RADAR_74f8be4a_Tx: ComBitPosition=88, ComBitSize=13, ComSignalInitValue=0, ComSignalType=UINT16, ComSystemTemplateSystemSignalRef=DET_AZIMUTH_189
            DET_AZIMUTH_190_oRDR_DETECTION_189_192_oPCAN_RADAR_11d8ccee_Tx: ComBitPosition=200, ComBitSize=13, ComSignalInitValue=0, ComSignalType=UINT16, ComSystemTemplateSystemSignalRef=DET_AZIMUTH_190
            DET_AZIMUTH_191_oRDR_DETECTION_189_192_oPCAN_RADAR_84a8187b_Tx: ComBitPosition=312, ComBitSize=13, ComSignalInitValue=0, ComSignalType=UINT16, ComSystemTemplateSystemSignalRef=DET_AZIMUTH_191
            DET_AZIMUTH_192_oRDR_DETECTION_189_192_oPCAN_RADAR_e0486385_Tx: ComBitPosition=424, ComBitSize=13, ComSignalInitValue=0, ComSignalType=UINT16, ComSystemTemplateSystemSignalRef=DET_AZIMUTH_192
            DET_AZIMUTH_ERR_189_oRDR_DETECTION_189_192_oPCAN_RADAR_d04d2bbf_Tx: ComBitPosition=105, ComBitSize=7, ComSignalInitValue=0, ComSignalType=UINT8, ComSystemTemplateSystemSignalRef=DET_AZIMUTH_ERR_189
            DET_AZIMUTH_ERR_190_oRDR_DETECTION_189_192_oPCAN_RADAR_b56d591b_Tx: ComBitPosition=217, ComBitSize=7, ComSignalInitValue=0, ComSignalType=UINT8, ComSystemTemplateSystemSignalRef=DET_AZIMUTH_ERR_190
            DET_AZIMUTH_ERR_191_oRDR_DETECTION_189_192_oPCAN_RADAR_201d8d8e_Tx: ComBitPosition=329, ComBitSize=7, ComSignalInitValue=0, ComSignalType=UINT8, ComSystemTemplateSystemSignalRef=DET_AZIMUTH_ERR_191
            DET_AZIMUTH_ERR_192_oRDR_DETECTION_189_192_oPCAN_RADAR_44fdf670_Tx: ComBitPosition=441, ComBitSize=7, ComSignalInitValue=0, ComSignalType=UINT8, ComSystemTemplateSystemSignalRef=DET_AZIMUTH_ERR_192
            DET_BELOW_RAIN_THOLD_189_oRDR_DETECTION_189_192_oPCAN_RADAR_a1f92d8a_Tx: ComBitPosition=39, ComBitSize=1, ComSignalInitValue=0, ComSignalType=BOOLEAN, ComSystemTemplateSystemSignalRef=DET_BELOW_RAIN_THOLD_189
            DET_BELOW_RAIN_THOLD_190_oRDR_DETECTION_189_192_oPCAN_RADAR_c4d95f2e_Tx: ComBitPosition=151, ComBitSize=1, ComSignalInitValue=0, ComSignalType=BOOLEAN, ComSystemTemplateSystemSignalRef=DET_BELOW_RAIN_THOLD_190
            DET_BELOW_RAIN_THOLD_191_oRDR_DETECTION_189_192_oPCAN_RADAR_51a98bbb_Tx: ComBitPosition=263, ComBitSize=1, ComSignalInitValue=0, ComSignalType=BOOLEAN, ComSystemTemplateSystemSignalRef=DET_BELOW_RAIN_THOLD_191
            DET_BELOW_RAIN_THOLD_192_oRDR_DETECTION_189_192_oPCAN_RADAR_3549f045_Tx: ComBitPosition=375, ComBitSize=1, ComSignalInitValue=0, ComSignalType=BOOLEAN, ComSystemTemplateSystemSignalRef=DET_BELOW_RAIN_THOLD_192
            DET_BI_STATIC_FLAG_189_oRDR_DETECTION_189_192_oPCAN_RADAR_22d4fecf_Tx: ComBitPosition=104, ComBitSize=1, ComSignalInitValue=0, ComSignalType=BOOLEAN, ComSystemTemplateSystemSignalRef=DET_BI_STATIC_FLAG_189
            DET_BI_STATIC_FLAG_190_oRDR_DETECTION_189_192_oPCAN_RADAR_47f48c6b_Tx: ComBitPosition=216, ComBitSize=1, ComSignalInitValue=0, ComSignalType=BOOLEAN, ComSystemTemplateSystemSignalRef=DET_BI_STATIC_FLAG_190
            DET_BI_STATIC_FLAG_191_oRDR_DETECTION_189_192_oPCAN_RADAR_d28458fe_Tx: ComBitPosition=328, ComBitSize=1, ComSignalInitValue=0, ComSignalType=BOOLEAN, ComSystemTemplateSystemSignalRef=DET_BI_STATIC_FLAG_191
            DET_BI_STATIC_FLAG_192_oRDR_DETECTION_189_192_oPCAN_RADAR_b6642300_Tx: ComBitPosition=440, ComBitSize=1, ComSignalInitValue=0, ComSignalType=BOOLEAN, ComSystemTemplateSystemSignalRef=DET_BI_STATIC_FLAG_192
            DET_CONFD_AZIMUTH_189_oRDR_DETECTION_189_192_oPCAN_RADAR_761eb480_Tx: ComBitPosition=118, ComBitSize=2, ComSignalInitValue=0, ComSignalType=UINT8, ComSystemTemplateSystemSignalRef=DET_CONFD_AZIMUTH_189
            DET_CONFD_AZIMUTH_190_oRDR_DETECTION_189_192_oPCAN_RADAR_133ec624_Tx: ComBitPosition=230, ComBitSize=2, ComSignalInitValue=0, ComSignalType=UINT8, ComSystemTemplateSystemSignalRef=DET_CONFD_AZIMUTH_190
            DET_CONFD_AZIMUTH_191_oRDR_DETECTION_189_192_oPCAN_RADAR_864e12b1_Tx: ComBitPosition=342, ComBitSize=2, ComSignalInitValue=0, ComSignalType=UINT8, ComSystemTemplateSystemSignalRef=DET_CONFD_AZIMUTH_191
            DET_CONFD_AZIMUTH_192_oRDR_DETECTION_189_192_oPCAN_RADAR_e2ae694f_Tx: ComBitPosition=454, ComBitSize=2, ComSignalInitValue=0, ComSignalType=UINT8, ComSystemTemplateSystemSignalRef=DET_CONFD_AZIMUTH_192
            DET_CONFD_ELEVATION_189_oRDR_DETECTION_189_192_oPCAN_RADAR_748bb57a_Tx: ComBitPosition=101, ComBitSize=2, ComSignalInitValue=0, ComSignalType=UINT8, ComSystemTemplateSystemSignalRef=DET_CONFD_ELEVATION_189
            DET_CONFD_ELEVATION_190_oRDR_DETECTION_189_192_oPCAN_RADAR_11abc7de_Tx: ComBitPosition=213, ComBitSize=2, ComSignalInitValue=0, ComSignalType=UINT8, ComSystemTemplateSystemSignalRef=DET_CONFD_ELEVATION_190
            DET_CONFD_ELEVATION_191_oRDR_DETECTION_189_192_oPCAN_RADAR_84db134b_Tx: ComBitPosition=325, ComBitSize=2, ComSignalInitValue=0, ComSignalType=UINT8, ComSystemTemplateSystemSignalRef=DET_CONFD_ELEVATION_191
            DET_CONFD_ELEVATION_192_oRDR_DETECTION_189_192_oPCAN_RADAR_e03b68b5_Tx: ComBitPosition=437, ComBitSize=2, ComSignalInitValue=0, ComSignalType=UINT8, ComSystemTemplateSystemSignalRef=DET_CONFD_ELEVATION_192
            DET_ELEVATION_189_oRDR_DETECTION_189_192_oPCAN_RADAR_a54b6146_Tx: ComBitPosition=72, ComBitSize=8, ComSignalInitValue=0, ComSignalType=UINT8, ComSystemTemplateSystemSignalRef=DET_ELEVATION_189
            DET_ELEVATION_190_oRDR_DETECTION_189_192_oPCAN_RADAR_c06b13e2_Tx: ComBitPosition=184, ComBitSize=8, ComSignalInitValue=0, ComSignalType=UINT8, ComSystemTemplateSystemSignalRef=DET_ELEVATION_190
            DET_ELEVATION_191_oRDR_DETECTION_189_192_oPCAN_RADAR_551bc777_Tx: ComBitPosition=296, ComBitSize=8, ComSignalInitValue=0, ComSignalType=UINT8, ComSystemTemplateSystemSignalRef=DET_ELEVATION_191
            DET_ELEVATION_192_oRDR_DETECTION_189_192_oPCAN_RADAR_31fbbc89_Tx: ComBitPosition=408, ComBitSize=8, ComSignalInitValue=0, ComSignalType=UINT8, ComSystemTemplateSystemSignalRef=DET_ELEVATION_192
            DET_ELEVATION_ERR_189_oRDR_DETECTION_189_192_oPCAN_RADAR_2272f933_Tx: ComBitPosition=80, ComBitSize=6, ComSignalInitValue=0, ComSignalType=UINT8, ComSystemTemplateSystemSignalRef=DET_ELEVATION_ERR_189
            DET_ELEVATION_ERR_190_oRDR_DETECTION_189_192_oPCAN_RADAR_47528b97_Tx: ComBitPosition=192, ComBitSize=6, ComSignalInitValue=0, ComSignalType=UINT8, ComSystemTemplateSystemSignalRef=DET_ELEVATION_ERR_190
            DET_ELEVATION_ERR_191_oRDR_DETECTION_189_192_oPCAN_RADAR_d2225f02_Tx: ComBitPosition=304, ComBitSize=6, ComSignalInitValue=0, ComSignalType=UINT8, ComSystemTemplateSystemSignalRef=DET_ELEVATION_ERR_191
            DET_ELEVATION_ERR_192_oRDR_DETECTION_189_192_oPCAN_RADAR_b6c224fc_Tx: ComBitPosition=416, ComBitSize=6, ComSignalInitValue=0, ComSignalType=UINT8, ComSystemTemplateSystemSignalRef=DET_ELEVATION_ERR_192
            DET_EXISTENCE_PROB_189_oRDR_DETECTION_189_192_oPCAN_RADAR_f0ed8c53_Tx: ComBitPosition=112, ComBitSize=6, ComSignalInitValue=0, ComSignalType=UINT8, ComSystemTemplateSystemSignalRef=DET_EXISTENCE_PROB_189
            DET_EXISTENCE_PROB_190_oRDR_DETECTION_189_192_oPCAN_RADAR_95cdfef7_Tx: ComBitPosition=224, ComBitSize=6, ComSignalInitValue=0, ComSignalType=UINT8, ComSystemTemplateSystemSignalRef=DET_EXISTENCE_PROB_190
            DET_EXISTENCE_PROB_191_oRDR_DETECTION_189_192_oPCAN_RADAR_00bd2a62_Tx: ComBitPosition=336, ComBitSize=6, ComSignalInitValue=0, ComSignalType=UINT8, ComSystemTemplateSystemSignalRef=DET_EXISTENCE_PROB_191
            DET_EXISTENCE_PROB_192_oRDR_DETECTION_189_192_oPCAN_RADAR_645d519c_Tx: ComBitPosition=448, ComBitSize=6, ComSignalInitValue=0, ComSignalType=UINT8, ComSystemTemplateSystemSignalRef=DET_EXISTENCE_PROB_192
            DET_HVC_FLAG_189_oRDR_DETECTION_189_192_oPCAN_RADAR_1199cf2c_Tx: ComBitPosition=86, ComBitSize=1, ComSignalInitValue=0, ComSignalType=BOOLEAN, ComSystemTemplateSystemSignalRef=DET_HVC_FLAG_189
            DET_HVC_FLAG_190_oRDR_DETECTION_189_192_oPCAN_RADAR_74b9bd88_Tx: ComBitPosition=198, ComBitSize=1, ComSignalInitValue=0, ComSignalType=BOOLEAN, ComSystemTemplateSystemSignalRef=DET_HVC_FLAG_190
            DET_HVC_FLAG_191_oRDR_DETECTION_189_192_oPCAN_RADAR_e1c9691d_Tx: ComBitPosition=310, ComBitSize=1, ComSignalInitValue=0, ComSignalType=BOOLEAN, ComSystemTemplateSystemSignalRef=DET_HVC_FLAG_191
            DET_HVC_FLAG_192_oRDR_DETECTION_189_192_oPCAN_RADAR_852912e3_Tx: ComBitPosition=422, ComBitSize=1, ComSignalInitValue=0, ComSignalType=BOOLEAN, ComSystemTemplateSystemSignalRef=DET_HVC_FLAG_192
            DET_IDM_189_oRDR_DETECTION_189_192_oPCAN_RADAR_9acbf491_Tx: ComBitPosition=63, ComBitSize=1, ComSignalInitValue=0, ComSignalType=BOOLEAN, ComSystemTemplateSystemSignalRef=DET_IDM_189
            DET_IDM_190_oRDR_DETECTION_189_192_oPCAN_RADAR_ffeb8635_Tx: ComBitPosition=175, ComBitSize=1, ComSignalInitValue=0, ComSignalType=BOOLEAN, ComSystemTemplateSystemSignalRef=DET_IDM_190
            DET_IDM_191_oRDR_DETECTION_189_192_oPCAN_RADAR_6a9b52a0_Tx: ComBitPosition=287, ComBitSize=1, ComSignalInitValue=0, ComSignalType=BOOLEAN, ComSystemTemplateSystemSignalRef=DET_IDM_191
            DET_IDM_192_oRDR_DETECTION_189_192_oPCAN_RADAR_0e7b295e_Tx: ComBitPosition=399, ComBitSize=1, ComSignalInitValue=0, ComSignalType=BOOLEAN, ComSystemTemplateSystemSignalRef=DET_IDM_192
            DET_MH_CRC16_189_192_oRDR_DETECTION_189_192_oPCAN_RADAR_2407f473_Tx: ComBitPosition=0, ComBitSize=16, ComSignalInitValue=0, ComSignalType=UINT16, ComSystemTemplateSystemSignalRef=DET_MH_CRC16_189_192
            DET_MH_CYCLE_COUNTER_189_192_oRDR_DETECTION_189_192_oPCAN_RADAR_a0725544_Tx: ComBitPosition=16, ComBitSize=8, ComSignalInitValue=0, ComSignalType=UINT8, ComSystemTemplateSystemSignalRef=DET_MH_CYCLE_COUNTER_189_192
            DET_MH_SCAN_INDEX_4LSB_189_192_oRDR_DETECTION_189_192_oPCAN_RADAR_6c5870c8_Tx: ComBitPosition=476, ComBitSize=4, ComSignalInitValue=0, ComSignalType=UINT8, ComSystemTemplateSystemSignalRef=DET_MH_SCAN_INDEX_4LSB_189_192
            DET_MTD_189_oRDR_DETECTION_189_192_oPCAN_RADAR_fc78c64a_Tx: ComBitPosition=47, ComBitSize=1, ComSignalInitValue=0, ComSignalType=BOOLEAN, ComSystemTemplateSystemSignalRef=DET_MTD_189
            DET_MTD_190_oRDR_DETECTION_189_192_oPCAN_RADAR_9958b4ee_Tx: ComBitPosition=159, ComBitSize=1, ComSignalInitValue=0, ComSignalType=BOOLEAN, ComSystemTemplateSystemSignalRef=DET_MTD_190
            DET_MTD_191_oRDR_DETECTION_189_192_oPCAN_RADAR_0c28607b_Tx: ComBitPosition=271, ComBitSize=1, ComSignalInitValue=0, ComSignalType=BOOLEAN, ComSystemTemplateSystemSignalRef=DET_MTD_191
            DET_MTD_192_oRDR_DETECTION_189_192_oPCAN_RADAR_68c81b85_Tx: ComBitPosition=383, ComBitSize=1, ComSignalInitValue=0, ComSignalType=BOOLEAN, ComSystemTemplateSystemSignalRef=DET_MTD_192
            DET_PROB_1STAZHYPO_189_oRDR_DETECTION_189_192_oPCAN_RADAR_6fcc2e87_Tx: ComBitPosition=103, ComBitSize=1, ComSignalInitValue=0, ComSignalType=BOOLEAN, ComSystemTemplateSystemSignalRef=DET_PROB_1STAZHYPO_189
            DET_PROB_1STAZHYPO_190_oRDR_DETECTION_189_192_oPCAN_RADAR_0aec5c23_Tx: ComBitPosition=215, ComBitSize=1, ComSignalInitValue=0, ComSignalType=BOOLEAN, ComSystemTemplateSystemSignalRef=DET_PROB_1STAZHYPO_190
            DET_PROB_1STAZHYPO_191_oRDR_DETECTION_189_192_oPCAN_RADAR_9f9c88b6_Tx: ComBitPosition=327, ComBitSize=1, ComSignalInitValue=0, ComSignalType=BOOLEAN, ComSystemTemplateSystemSignalRef=DET_PROB_1STAZHYPO_191
            DET_PROB_1STAZHYPO_192_oRDR_DETECTION_189_192_oPCAN_RADAR_fb7cf348_Tx: ComBitPosition=439, ComBitSize=1, ComSignalInitValue=0, ComSignalType=BOOLEAN, ComSystemTemplateSystemSignalRef=DET_PROB_1STAZHYPO_192
            DET_RANGE_189_oRDR_DETECTION_189_192_oPCAN_RADAR_6463cdf1_Tx: ComBitPosition=24, ComBitSize=15, ComSignalInitValue=0, ComSignalType=UINT16, ComSystemTemplateSystemSignalRef=DET_RANGE_189
            DET_RANGE_190_oRDR_DETECTION_189_192_oPCAN_RADAR_0143bf55_Tx: ComBitPosition=136, ComBitSize=15, ComSignalInitValue=0, ComSignalType=UINT16, ComSystemTemplateSystemSignalRef=DET_RANGE_190
            DET_RANGE_191_oRDR_DETECTION_189_192_oPCAN_RADAR_94336bc0_Tx: ComBitPosition=248, ComBitSize=15, ComSignalInitValue=0, ComSignalType=UINT16, ComSystemTemplateSystemSignalRef=DET_RANGE_191
            DET_RANGE_192_oRDR_DETECTION_189_192_oPCAN_RADAR_f0d3103e_Tx: ComBitPosition=360, ComBitSize=15, ComSignalInitValue=0, ComSignalType=UINT16, ComSystemTemplateSystemSignalRef=DET_RANGE_192
            DET_RANGE_ERR_189_oRDR_DETECTION_189_192_oPCAN_RADAR_c38b7798_Tx: ComBitPosition=40, ComBitSize=7, ComSignalInitValue=0, ComSignalType=UINT8, ComSystemTemplateSystemSignalRef=DET_RANGE_ERR_189
            DET_RANGE_ERR_190_oRDR_DETECTION_189_192_oPCAN_RADAR_a6ab053c_Tx: ComBitPosition=152, ComBitSize=7, ComSignalInitValue=0, ComSignalType=UINT8, ComSystemTemplateSystemSignalRef=DET_RANGE_ERR_190
            DET_RANGE_ERR_191_oRDR_DETECTION_189_192_oPCAN_RADAR_33dbd1a9_Tx: ComBitPosition=264, ComBitSize=7, ComSignalInitValue=0, ComSignalType=UINT8, ComSystemTemplateSystemSignalRef=DET_RANGE_ERR_191
            DET_RANGE_ERR_192_oRDR_DETECTION_189_192_oPCAN_RADAR_573baa57_Tx: ComBitPosition=376, ComBitSize=7, ComSignalInitValue=0, ComSignalType=UINT8, ComSystemTemplateSystemSignalRef=DET_RANGE_ERR_192
            DET_RANGE_VELOCITY_189_oRDR_DETECTION_189_192_oPCAN_RADAR_11c50fd4_Tx: ComBitPosition=48, ComBitSize=15, ComSignalInitValue=16384, ComSignalType=UINT16, ComSystemTemplateSystemSignalRef=DET_RANGE_VELOCITY_189
            DET_RANGE_VELOCITY_190_oRDR_DETECTION_189_192_oPCAN_RADAR_74e57d70_Tx: ComBitPosition=160, ComBitSize=15, ComSignalInitValue=16384, ComSignalType=UINT16, ComSystemTemplateSystemSignalRef=DET_RANGE_VELOCITY_190
            DET_RANGE_VELOCITY_191_oRDR_DETECTION_189_192_oPCAN_RADAR_e195a9e5_Tx: ComBitPosition=272, ComBitSize=15, ComSignalInitValue=16384, ComSignalType=UINT16, ComSystemTemplateSystemSignalRef=DET_RANGE_VELOCITY_191
            DET_RANGE_VELOCITY_192_oRDR_DETECTION_189_192_oPCAN_RADAR_8575d21b_Tx: ComBitPosition=384, ComBitSize=15, ComSignalInitValue=16384, ComSignalType=UINT16, ComSystemTemplateSystemSignalRef=DET_RANGE_VELOCITY_192
            DET_RANGE_VELOCITY_ERR_189_oRDR_DETECTION_189_192_oPCAN_RADAR_1e7ef466_Tx: ComBitPosition=64, ComBitSize=8, ComSignalInitValue=0, ComSignalType=UINT8, ComSystemTemplateSystemSignalRef=DET_RANGE_VELOCITY_ERR_189
            DET_RANGE_VELOCITY_ERR_190_oRDR_DETECTION_189_192_oPCAN_RADAR_7b5e86c2_Tx: ComBitPosition=176, ComBitSize=8, ComSignalInitValue=0, ComSignalType=UINT8, ComSystemTemplateSystemSignalRef=DET_RANGE_VELOCITY_ERR_190
            DET_RANGE_VELOCITY_ERR_191_oRDR_DETECTION_189_192_oPCAN_RADAR_ee2e5257_Tx: ComBitPosition=288, ComBitSize=8, ComSignalInitValue=0, ComSignalType=UINT8, ComSystemTemplateSystemSignalRef=DET_RANGE_VELOCITY_ERR_191
            DET_RANGE_VELOCITY_ERR_192_oRDR_DETECTION_189_192_oPCAN_RADAR_8ace29a9_Tx: ComBitPosition=400, ComBitSize=8, ComSignalInitValue=0, ComSignalType=UINT8, ComSystemTemplateSystemSignalRef=DET_RANGE_VELOCITY_ERR_192
            DET_RCS_189_oRDR_DETECTION_189_192_oPCAN_RADAR_9645388e_Tx: ComBitPosition=128, ComBitSize=8, ComSignalInitValue=128, ComSignalType=UINT8, ComSystemTemplateSystemSignalRef=DET_RCS_189
            DET_RCS_190_oRDR_DETECTION_189_192_oPCAN_RADAR_f3654a2a_Tx: ComBitPosition=240, ComBitSize=8, ComSignalInitValue=128, ComSignalType=UINT8, ComSystemTemplateSystemSignalRef=DET_RCS_190
            DET_RCS_191_oRDR_DETECTION_189_192_oPCAN_RADAR_66159ebf_Tx: ComBitPosition=352, ComBitSize=8, ComSignalInitValue=128, ComSignalType=UINT8, ComSystemTemplateSystemSignalRef=DET_RCS_191
            DET_RCS_192_oRDR_DETECTION_189_192_oPCAN_RADAR_02f5e541_Tx: ComBitPosition=464, ComBitSize=8, ComSignalInitValue=128, ComSignalType=UINT8, ComSystemTemplateSystemSignalRef=DET_RCS_192
            DET_SNR_189_oRDR_DETECTION_189_192_oPCAN_RADAR_4beb6c8c_Tx: ComBitPosition=120, ComBitSize=8, ComSignalInitValue=0, ComSignalType=UINT8, ComSystemTemplateSystemSignalRef=DET_SNR_189
            DET_SNR_190_oRDR_DETECTION_189_192_oPCAN_RADAR_2ecb1e28_Tx: ComBitPosition=232, ComBitSize=8, ComSignalInitValue=0, ComSignalType=UINT8, ComSystemTemplateSystemSignalRef=DET_SNR_190
            DET_SNR_191_oRDR_DETECTION_189_192_oPCAN_RADAR_bbbbcabd_Tx: ComBitPosition=344, ComBitSize=8, ComSignalInitValue=0, ComSignalType=UINT8, ComSystemTemplateSystemSignalRef=DET_SNR_191
            DET_SNR_192_oRDR_DETECTION_189_192_oPCAN_RADAR_df5bb143_Tx: ComBitPosition=456, ComBitSize=8, ComSignalInitValue=0, ComSignalType=UINT8, ComSystemTemplateSystemSignalRef=DET_SNR_192
            DET_SUPER_RES_TARGET_189_oRDR_DETECTION_189_192_oPCAN_RADAR_7a7244e9_Tx: ComBitPosition=87, ComBitSize=1, ComSignalInitValue=0, ComSignalType=BOOLEAN, ComSystemTemplateSystemSignalRef=DET_SUPER_RES_TARGET_189
            DET_SUPER_RES_TARGET_190_oRDR_DETECTION_189_192_oPCAN_RADAR_1f52364d_Tx: ComBitPosition=199, ComBitSize=1, ComSignalInitValue=0, ComSignalType=BOOLEAN, ComSystemTemplateSystemSignalRef=DET_SUPER_RES_TARGET_190
            DET_SUPER_RES_TARGET_191_oRDR_DETECTION_189_192_oPCAN_RADAR_8a22e2d8_Tx: ComBitPosition=311, ComBitSize=1, ComSignalInitValue=0, ComSignalType=BOOLEAN, ComSystemTemplateSystemSignalRef=DET_SUPER_RES_TARGET_191
            DET_SUPER_RES_TARGET_192_oRDR_DETECTION_189_192_oPCAN_RADAR_eec29926_Tx: ComBitPosition=423, ComBitSize=1, ComSignalInitValue=0, ComSignalType=BOOLEAN, ComSystemTemplateSystemSignalRef=DET_SUPER_RES_TARGET_192
        SG_Detections_193_196_oRDR_DETECTION_193_196_oPCAN_RADAR_92844e50_Tx: ComSystemTemplateSignalGroupRef=SG_Detections_193_196
          83 x ComGroupSignal, all with ComSignalEndianness=LITTLE_ENDIAN, ComTransferProperty=PENDING:
            DET_AZIMUTH_193_oRDR_DETECTION_193_196_oPCAN_RADAR_68ffb43e_Tx: ComBitPosition=88, ComBitSize=13, ComSignalInitValue=0, ComSignalType=UINT16, ComSystemTemplateSystemSignalRef=DET_AZIMUTH_193
            DET_AZIMUTH_194_oRDR_DETECTION_193_196_oPCAN_RADAR_344f9757_Tx: ComBitPosition=200, ComBitSize=13, ComSignalInitValue=0, ComSignalType=UINT16, ComSystemTemplateSystemSignalRef=DET_AZIMUTH_194
            DET_AZIMUTH_195_oRDR_DETECTION_193_196_oPCAN_RADAR_a13f43c2_Tx: ComBitPosition=312, ComBitSize=13, ComSignalInitValue=0, ComSignalType=UINT16, ComSystemTemplateSystemSignalRef=DET_AZIMUTH_195
            DET_AZIMUTH_196_oRDR_DETECTION_193_196_oPCAN_RADAR_c5df383c_Tx: ComBitPosition=424, ComBitSize=13, ComSignalInitValue=0, ComSignalType=UINT16, ComSystemTemplateSystemSignalRef=DET_AZIMUTH_196
            DET_AZIMUTH_ERR_193_oRDR_DETECTION_193_196_oPCAN_RADAR_cc4a21cb_Tx: ComBitPosition=105, ComBitSize=7, ComSignalInitValue=0, ComSignalType=UINT8, ComSystemTemplateSystemSignalRef=DET_AZIMUTH_ERR_193
            DET_AZIMUTH_ERR_194_oRDR_DETECTION_193_196_oPCAN_RADAR_90fa02a2_Tx: ComBitPosition=217, ComBitSize=7, ComSignalInitValue=0, ComSignalType=UINT8, ComSystemTemplateSystemSignalRef=DET_AZIMUTH_ERR_194
            DET_AZIMUTH_ERR_195_oRDR_DETECTION_193_196_oPCAN_RADAR_058ad637_Tx: ComBitPosition=329, ComBitSize=7, ComSignalInitValue=0, ComSignalType=UINT8, ComSystemTemplateSystemSignalRef=DET_AZIMUTH_ERR_195
            DET_AZIMUTH_ERR_196_oRDR_DETECTION_193_196_oPCAN_RADAR_616aadc9_Tx: ComBitPosition=441, ComBitSize=7, ComSignalInitValue=0, ComSignalType=UINT8, ComSystemTemplateSystemSignalRef=DET_AZIMUTH_ERR_196
            DET_BELOW_RAIN_THOLD_193_oRDR_DETECTION_193_196_oPCAN_RADAR_bdfe27fe_Tx: ComBitPosition=39, ComBitSize=1, ComSignalInitValue=0, ComSignalType=BOOLEAN, ComSystemTemplateSystemSignalRef=DET_BELOW_RAIN_THOLD_193
            DET_BELOW_RAIN_THOLD_194_oRDR_DETECTION_193_196_oPCAN_RADAR_e14e0497_Tx: ComBitPosition=151, ComBitSize=1, ComSignalInitValue=0, ComSignalType=BOOLEAN, ComSystemTemplateSystemSignalRef=DET_BELOW_RAIN_THOLD_194
            DET_BELOW_RAIN_THOLD_195_oRDR_DETECTION_193_196_oPCAN_RADAR_743ed002_Tx: ComBitPosition=263, ComBitSize=1, ComSignalInitValue=0, ComSignalType=BOOLEAN, ComSystemTemplateSystemSignalRef=DET_BELOW_RAIN_THOLD_195
            DET_BELOW_RAIN_THOLD_196_oRDR_DETECTION_193_196_oPCAN_RADAR_10deabfc_Tx: ComBitPosition=375, ComBitSize=1, ComSignalInitValue=0, ComSignalType=BOOLEAN, ComSystemTemplateSystemSignalRef=DET_BELOW_RAIN_THOLD_196
            DET_BI_STATIC_FLAG_193_oRDR_DETECTION_193_196_oPCAN_RADAR_3ed3f4bb_Tx: ComBitPosition=104, ComBitSize=1, ComSignalInitValue=0, ComSignalType=BOOLEAN, ComSystemTemplateSystemSignalRef=DET_BI_STATIC_FLAG_193
            DET_BI_STATIC_FLAG_194_oRDR_DETECTION_193_196_oPCAN_RADAR_6263d7d2_Tx: ComBitPosition=216, ComBitSize=1, ComSignalInitValue=0, ComSignalType=BOOLEAN, ComSystemTemplateSystemSignalRef=DET_BI_STATIC_FLAG_194
            DET_BI_STATIC_FLAG_195_oRDR_DETECTION_193_196_oPCAN_RADAR_f7130347_Tx: ComBitPosition=328, ComBitSize=1, ComSignalInitValue=0, ComSignalType=BOOLEAN, ComSystemTemplateSystemSignalRef=DET_BI_STATIC_FLAG_195
            DET_BI_STATIC_FLAG_196_oRDR_DETECTION_193_196_oPCAN_RADAR_93f378b9_Tx: ComBitPosition=440, ComBitSize=1, ComSignalInitValue=0, ComSignalType=BOOLEAN, ComSystemTemplateSystemSignalRef=DET_BI_STATIC_FLAG_196
            DET_CONFD_AZIMUTH_193_oRDR_DETECTION_193_196_oPCAN_RADAR_6a19bef4_Tx: ComBitPosition=118, ComBitSize=2, ComSignalInitValue=0, ComSignalType=UINT8, ComSystemTemplateSystemSignalRef=DET_CONFD_AZIMUTH_193
            DET_CONFD_AZIMUTH_194_oRDR_DETECTION_193_196_oPCAN_RADAR_36a99d9d_Tx: ComBitPosition=230, ComBitSize=2, ComSignalInitValue=0, ComSignalType=UINT8, ComSystemTemplateSystemSignalRef=DET_CONFD_AZIMUTH_194
            DET_CONFD_AZIMUTH_195_oRDR_DETECTION_193_196_oPCAN_RADAR_a3d94908_Tx: ComBitPosition=342, ComBitSize=2, ComSignalInitValue=0, ComSignalType=UINT8, ComSystemTemplateSystemSignalRef=DET_CONFD_AZIMUTH_195
            DET_CONFD_AZIMUTH_196_oRDR_DETECTION_193_196_oPCAN_RADAR_c73932f6_Tx: ComBitPosition=454, ComBitSize=2, ComSignalInitValue=0, ComSignalType=UINT8, ComSystemTemplateSystemSignalRef=DET_CONFD_AZIMUTH_196
            DET_CONFD_ELEVATION_193_oRDR_DETECTION_193_196_oPCAN_RADAR_688cbf0e_Tx: ComBitPosition=101, ComBitSize=2, ComSignalInitValue=0, ComSignalType=UINT8, ComSystemTemplateSystemSignalRef=DET_CONFD_ELEVATION_193
            DET_CONFD_ELEVATION_194_oRDR_DETECTION_193_196_oPCAN_RADAR_343c9c67_Tx: ComBitPosition=213, ComBitSize=2, ComSignalInitValue=0, ComSignalType=UINT8, ComSystemTemplateSystemSignalRef=DET_CONFD_ELEVATION_194
            DET_CONFD_ELEVATION_195_oRDR_DETECTION_193_196_oPCAN_RADAR_a14c48f2_Tx: ComBitPosition=325, ComBitSize=2, ComSignalInitValue=0, ComSignalType=UINT8, ComSystemTemplateSystemSignalRef=DET_CONFD_ELEVATION_195
            DET_CONFD_ELEVATION_196_oRDR_DETECTION_193_196_oPCAN_RADAR_c5ac330c_Tx: ComBitPosition=437, ComBitSize=2, ComSignalInitValue=0, ComSignalType=UINT8, ComSystemTemplateSystemSignalRef=DET_CONFD_ELEVATION_196
            DET_ELEVATION_193_oRDR_DETECTION_193_196_oPCAN_RADAR_b94c6b32_Tx: ComBitPosition=72, ComBitSize=8, ComSignalInitValue=0, ComSignalType=UINT8, ComSystemTemplateSystemSignalRef=DET_ELEVATION_193
            DET_ELEVATION_194_oRDR_DETECTION_193_196_oPCAN_RADAR_e5fc485b_Tx: ComBitPosition=184, ComBitSize=8, ComSignalInitValue=0, ComSignalType=UINT8, ComSystemTemplateSystemSignalRef=DET_ELEVATION_194
            DET_ELEVATION_195_oRDR_DETECTION_193_196_oPCAN_RADAR_708c9cce_Tx: ComBitPosition=296, ComBitSize=8, ComSignalInitValue=0, ComSignalType=UINT8, ComSystemTemplateSystemSignalRef=DET_ELEVATION_195
            DET_ELEVATION_196_oRDR_DETECTION_193_196_oPCAN_RADAR_146ce730_Tx: ComBitPosition=408, ComBitSize=8, ComSignalInitValue=0, ComSignalType=UINT8, ComSystemTemplateSystemSignalRef=DET_ELEVATION_196
            DET_ELEVATION_ERR_193_oRDR_DETECTION_193_196_oPCAN_RADAR_3e75f347_Tx: ComBitPosition=80, ComBitSize=6, ComSignalInitValue=0, ComSignalType=UINT8, ComSystemTemplateSystemSignalRef=DET_ELEVATION_ERR_193
            DET_ELEVATION_ERR_194_oRDR_DETECTION_193_196_oPCAN_RADAR_62c5d02e_Tx: ComBitPosition=192, ComBitSize=6, ComSignalInitValue=0, ComSignalType=UINT8, ComSystemTemplateSystemSignalRef=DET_ELEVATION_ERR_194
            DET_ELEVATION_ERR_195_oRDR_DETECTION_193_196_oPCAN_RADAR_f7b504bb_Tx: ComBitPosition=304, ComBitSize=6, ComSignalInitValue=0, ComSignalType=UINT8, ComSystemTemplateSystemSignalRef=DET_ELEVATION_ERR_195
            DET_ELEVATION_ERR_196_oRDR_DETECTION_193_196_oPCAN_RADAR_93557f45_Tx: ComBitPosition=416, ComBitSize=6, ComSignalInitValue=0, ComSignalType=UINT8, ComSystemTemplateSystemSignalRef=DET_ELEVATION_ERR_196
            DET_EXISTENCE_PROB_193_oRDR_DETECTION_193_196_oPCAN_RADAR_ecea8627_Tx: ComBitPosition=112, ComBitSize=6, ComSignalInitValue=0, ComSignalType=UINT8, ComSystemTemplateSystemSignalRef=DET_EXISTENCE_PROB_193
            DET_EXISTENCE_PROB_194_oRDR_DETECTION_193_196_oPCAN_RADAR_b05aa54e_Tx: ComBitPosition=224, ComBitSize=6, ComSignalInitValue=0, ComSignalType=UINT8, ComSystemTemplateSystemSignalRef=DET_EXISTENCE_PROB_194
            DET_EXISTENCE_PROB_195_oRDR_DETECTION_193_196_oPCAN_RADAR_252a71db_Tx: ComBitPosition=336, ComBitSize=6, ComSignalInitValue=0, ComSignalType=UINT8, ComSystemTemplateSystemSignalRef=DET_EXISTENCE_PROB_195
            DET_EXISTENCE_PROB_196_oRDR_DETECTION_193_196_oPCAN_RADAR_41ca0a25_Tx: ComBitPosition=448, ComBitSize=6, ComSignalInitValue=0, ComSignalType=UINT8, ComSystemTemplateSystemSignalRef=DET_EXISTENCE_PROB_196
            DET_HVC_FLAG_193_oRDR_DETECTION_193_196_oPCAN_RADAR_0d9ec558_Tx: ComBitPosition=86, ComBitSize=1, ComSignalInitValue=0, ComSignalType=BOOLEAN, ComSystemTemplateSystemSignalRef=DET_HVC_FLAG_193
            DET_HVC_FLAG_194_oRDR_DETECTION_193_196_oPCAN_RADAR_512ee631_Tx: ComBitPosition=198, ComBitSize=1, ComSignalInitValue=0, ComSignalType=BOOLEAN, ComSystemTemplateSystemSignalRef=DET_HVC_FLAG_194
            DET_HVC_FLAG_195_oRDR_DETECTION_193_196_oPCAN_RADAR_c45e32a4_Tx: ComBitPosition=310, ComBitSize=1, ComSignalInitValue=0, ComSignalType=BOOLEAN, ComSystemTemplateSystemSignalRef=DET_HVC_FLAG_195
            DET_HVC_FLAG_196_oRDR_DETECTION_193_196_oPCAN_RADAR_a0be495a_Tx: ComBitPosition=422, ComBitSize=1, ComSignalInitValue=0, ComSignalType=BOOLEAN, ComSystemTemplateSystemSignalRef=DET_HVC_FLAG_196
            DET_IDM_193_oRDR_DETECTION_193_196_oPCAN_RADAR_86ccfee5_Tx: ComBitPosition=63, ComBitSize=1, ComSignalInitValue=0, ComSignalType=BOOLEAN, ComSystemTemplateSystemSignalRef=DET_IDM_193
            DET_IDM_194_oRDR_DETECTION_193_196_oPCAN_RADAR_da7cdd8c_Tx: ComBitPosition=175, ComBitSize=1, ComSignalInitValue=0, ComSignalType=BOOLEAN, ComSystemTemplateSystemSignalRef=DET_IDM_194
            DET_IDM_195_oRDR_DETECTION_193_196_oPCAN_RADAR_4f0c0919_Tx: ComBitPosition=287, ComBitSize=1, ComSignalInitValue=0, ComSignalType=BOOLEAN, ComSystemTemplateSystemSignalRef=DET_IDM_195
            DET_IDM_196_oRDR_DETECTION_193_196_oPCAN_RADAR_2bec72e7_Tx: ComBitPosition=399, ComBitSize=1, ComSignalInitValue=0, ComSignalType=BOOLEAN, ComSystemTemplateSystemSignalRef=DET_IDM_196
            DET_MH_CRC16_193_196_oRDR_DETECTION_193_196_oPCAN_RADAR_160c9c5b_Tx: ComBitPosition=0, ComBitSize=16, ComSignalInitValue=0, ComSignalType=UINT16, ComSystemTemplateSystemSignalRef=DET_MH_CRC16_193_196
            DET_MH_CYCLE_COUNTER_193_196_oRDR_DETECTION_193_196_oPCAN_RADAR_92793d6c_Tx: ComBitPosition=16, ComBitSize=8, ComSignalInitValue=0, ComSignalType=UINT8, ComSystemTemplateSystemSignalRef=DET_MH_CYCLE_COUNTER_193_196
            DET_MH_SCAN_INDEX_4LSB_193_196_oRDR_DETECTION_193_196_oPCAN_RADAR_5e5318e0_Tx: ComBitPosition=476, ComBitSize=4, ComSignalInitValue=0, ComSignalType=UINT8, ComSystemTemplateSystemSignalRef=DET_MH_SCAN_INDEX_4LSB_193_196
            DET_MTD_193_oRDR_DETECTION_193_196_oPCAN_RADAR_e07fcc3e_Tx: ComBitPosition=47, ComBitSize=1, ComSignalInitValue=0, ComSignalType=BOOLEAN, ComSystemTemplateSystemSignalRef=DET_MTD_193
            DET_MTD_194_oRDR_DETECTION_193_196_oPCAN_RADAR_bccfef57_Tx: ComBitPosition=159, ComBitSize=1, ComSignalInitValue=0, ComSignalType=BOOLEAN, ComSystemTemplateSystemSignalRef=DET_MTD_194
            DET_MTD_195_oRDR_DETECTION_193_196_oPCAN_RADAR_29bf3bc2_Tx: ComBitPosition=271, ComBitSize=1, ComSignalInitValue=0, ComSignalType=BOOLEAN, ComSystemTemplateSystemSignalRef=DET_MTD_195
            DET_MTD_196_oRDR_DETECTION_193_196_oPCAN_RADAR_4d5f403c_Tx: ComBitPosition=383, ComBitSize=1, ComSignalInitValue=0, ComSignalType=BOOLEAN, ComSystemTemplateSystemSignalRef=DET_MTD_196
            DET_PROB_1STAZHYPO_193_oRDR_DETECTION_193_196_oPCAN_RADAR_73cb24f3_Tx: ComBitPosition=103, ComBitSize=1, ComSignalInitValue=0, ComSignalType=BOOLEAN, ComSystemTemplateSystemSignalRef=DET_PROB_1STAZHYPO_193
            DET_PROB_1STAZHYPO_194_oRDR_DETECTION_193_196_oPCAN_RADAR_2f7b079a_Tx: ComBitPosition=215, ComBitSize=1, ComSignalInitValue=0, ComSignalType=BOOLEAN, ComSystemTemplateSystemSignalRef=DET_PROB_1STAZHYPO_194
            DET_PROB_1STAZHYPO_195_oRDR_DETECTION_193_196_oPCAN_RADAR_ba0bd30f_Tx: ComBitPosition=327, ComBitSize=1, ComSignalInitValue=0, ComSignalType=BOOLEAN, ComSystemTemplateSystemSignalRef=DET_PROB_1STAZHYPO_195
            DET_PROB_1STAZHYPO_196_oRDR_DETECTION_193_196_oPCAN_RADAR_deeba8f1_Tx: ComBitPosition=439, ComBitSize=1, ComSignalInitValue=0, ComSignalType=BOOLEAN, ComSystemTemplateSystemSignalRef=DET_PROB_1STAZHYPO_196
            DET_RANGE_193_oRDR_DETECTION_193_196_oPCAN_RADAR_7864c785_Tx: ComBitPosition=24, ComBitSize=15, ComSignalInitValue=0, ComSignalType=UINT16, ComSystemTemplateSystemSignalRef=DET_RANGE_193
            DET_RANGE_194_oRDR_DETECTION_193_196_oPCAN_RADAR_24d4e4ec_Tx: ComBitPosition=136, ComBitSize=15, ComSignalInitValue=0, ComSignalType=UINT16, ComSystemTemplateSystemSignalRef=DET_RANGE_194
            DET_RANGE_195_oRDR_DETECTION_193_196_oPCAN_RADAR_b1a43079_Tx: ComBitPosition=248, ComBitSize=15, ComSignalInitValue=0, ComSignalType=UINT16, ComSystemTemplateSystemSignalRef=DET_RANGE_195
            DET_RANGE_196_oRDR_DETECTION_193_196_oPCAN_RADAR_d5444b87_Tx: ComBitPosition=360, ComBitSize=15, ComSignalInitValue=0, ComSignalType=UINT16, ComSystemTemplateSystemSignalRef=DET_RANGE_196
            DET_RANGE_ERR_193_oRDR_DETECTION_193_196_oPCAN_RADAR_df8c7dec_Tx: ComBitPosition=40, ComBitSize=7, ComSignalInitValue=0, ComSignalType=UINT8, ComSystemTemplateSystemSignalRef=DET_RANGE_ERR_193
            DET_RANGE_ERR_194_oRDR_DETECTION_193_196_oPCAN_RADAR_833c5e85_Tx: ComBitPosition=152, ComBitSize=7, ComSignalInitValue=0, ComSignalType=UINT8, ComSystemTemplateSystemSignalRef=DET_RANGE_ERR_194
            DET_RANGE_ERR_195_oRDR_DETECTION_193_196_oPCAN_RADAR_164c8a10_Tx: ComBitPosition=264, ComBitSize=7, ComSignalInitValue=0, ComSignalType=UINT8, ComSystemTemplateSystemSignalRef=DET_RANGE_ERR_195
            DET_RANGE_ERR_196_oRDR_DETECTION_193_196_oPCAN_RADAR_72acf1ee_Tx: ComBitPosition=376, ComBitSize=7, ComSignalInitValue=0, ComSignalType=UINT8, ComSystemTemplateSystemSignalRef=DET_RANGE_ERR_196
            DET_RANGE_VELOCITY_193_oRDR_DETECTION_193_196_oPCAN_RADAR_0dc205a0_Tx: ComBitPosition=48, ComBitSize=15, ComSignalInitValue=16384, ComSignalType=UINT16, ComSystemTemplateSystemSignalRef=DET_RANGE_VELOCITY_193
            DET_RANGE_VELOCITY_194_oRDR_DETECTION_193_196_oPCAN_RADAR_517226c9_Tx: ComBitPosition=160, ComBitSize=15, ComSignalInitValue=16384, ComSignalType=UINT16, ComSystemTemplateSystemSignalRef=DET_RANGE_VELOCITY_194
            DET_RANGE_VELOCITY_195_oRDR_DETECTION_193_196_oPCAN_RADAR_c402f25c_Tx: ComBitPosition=272, ComBitSize=15, ComSignalInitValue=16384, ComSignalType=UINT16, ComSystemTemplateSystemSignalRef=DET_RANGE_VELOCITY_195
            DET_RANGE_VELOCITY_196_oRDR_DETECTION_193_196_oPCAN_RADAR_a0e289a2_Tx: ComBitPosition=384, ComBitSize=15, ComSignalInitValue=16384, ComSignalType=UINT16, ComSystemTemplateSystemSignalRef=DET_RANGE_VELOCITY_196
            DET_RANGE_VELOCITY_ERR_193_oRDR_DETECTION_193_196_oPCAN_RADAR_0279fe12_Tx: ComBitPosition=64, ComBitSize=8, ComSignalInitValue=0, ComSignalType=UINT8, ComSystemTemplateSystemSignalRef=DET_RANGE_VELOCITY_ERR_193
            DET_RANGE_VELOCITY_ERR_194_oRDR_DETECTION_193_196_oPCAN_RADAR_5ec9dd7b_Tx: ComBitPosition=176, ComBitSize=8, ComSignalInitValue=0, ComSignalType=UINT8, ComSystemTemplateSystemSignalRef=DET_RANGE_VELOCITY_ERR_194
            DET_RANGE_VELOCITY_ERR_195_oRDR_DETECTION_193_196_oPCAN_RADAR_cbb909ee_Tx: ComBitPosition=288, ComBitSize=8, ComSignalInitValue=0, ComSignalType=UINT8, ComSystemTemplateSystemSignalRef=DET_RANGE_VELOCITY_ERR_195
            DET_RANGE_VELOCITY_ERR_196_oRDR_DETECTION_193_196_oPCAN_RADAR_af597210_Tx: ComBitPosition=400, ComBitSize=8, ComSignalInitValue=0, ComSignalType=UINT8, ComSystemTemplateSystemSignalRef=DET_RANGE_VELOCITY_ERR_196
            DET_RCS_193_oRDR_DETECTION_193_196_oPCAN_RADAR_8a4232fa_Tx: ComBitPosition=128, ComBitSize=8, ComSignalInitValue=128, ComSignalType=UINT8, ComSystemTemplateSystemSignalRef=DET_RCS_193
            DET_RCS_194_oRDR_DETECTION_193_196_oPCAN_RADAR_d6f21193_Tx: ComBitPosition=240, ComBitSize=8, ComSignalInitValue=128, ComSignalType=UINT8, ComSystemTemplateSystemSignalRef=DET_RCS_194
            DET_RCS_195_oRDR_DETECTION_193_196_oPCAN_RADAR_4382c506_Tx: ComBitPosition=352, ComBitSize=8, ComSignalInitValue=128, ComSignalType=UINT8, ComSystemTemplateSystemSignalRef=DET_RCS_195
            DET_RCS_196_oRDR_DETECTION_193_196_oPCAN_RADAR_2762bef8_Tx: ComBitPosition=464, ComBitSize=8, ComSignalInitValue=128, ComSignalType=UINT8, ComSystemTemplateSystemSignalRef=DET_RCS_196
            DET_SNR_193_oRDR_DETECTION_193_196_oPCAN_RADAR_57ec66f8_Tx: ComBitPosition=120, ComBitSize=8, ComSignalInitValue=0, ComSignalType=UINT8, ComSystemTemplateSystemSignalRef=DET_SNR_193
            DET_SNR_194_oRDR_DETECTION_193_196_oPCAN_RADAR_0b5c4591_Tx: ComBitPosition=232, ComBitSize=8, ComSignalInitValue=0, ComSignalType=UINT8, ComSystemTemplateSystemSignalRef=DET_SNR_194
            DET_SNR_195_oRDR_DETECTION_193_196_oPCAN_RADAR_9e2c9104_Tx: ComBitPosition=344, ComBitSize=8, ComSignalInitValue=0, ComSignalType=UINT8, ComSystemTemplateSystemSignalRef=DET_SNR_195
            DET_SNR_196_oRDR_DETECTION_193_196_oPCAN_RADAR_facceafa_Tx: ComBitPosition=456, ComBitSize=8, ComSignalInitValue=0, ComSignalType=UINT8, ComSystemTemplateSystemSignalRef=DET_SNR_196
            DET_SUPER_RES_TARGET_193_oRDR_DETECTION_193_196_oPCAN_RADAR_66754e9d_Tx: ComBitPosition=87, ComBitSize=1, ComSignalInitValue=0, ComSignalType=BOOLEAN, ComSystemTemplateSystemSignalRef=DET_SUPER_RES_TARGET_193
            DET_SUPER_RES_TARGET_194_oRDR_DETECTION_193_196_oPCAN_RADAR_3ac56df4_Tx: ComBitPosition=199, ComBitSize=1, ComSignalInitValue=0, ComSignalType=BOOLEAN, ComSystemTemplateSystemSignalRef=DET_SUPER_RES_TARGET_194
            DET_SUPER_RES_TARGET_195_oRDR_DETECTION_193_196_oPCAN_RADAR_afb5b961_Tx: ComBitPosition=311, ComBitSize=1, ComSignalInitValue=0, ComSignalType=BOOLEAN, ComSystemTemplateSystemSignalRef=DET_SUPER_RES_TARGET_195
            DET_SUPER_RES_TARGET_196_oRDR_DETECTION_193_196_oPCAN_RADAR_cb55c29f_Tx: ComBitPosition=423, ComBitSize=1, ComSignalInitValue=0, ComSignalType=BOOLEAN, ComSystemTemplateSystemSignalRef=DET_SUPER_RES_TARGET_196
