[part 19 of 24: package /InitialEcuC]
AUTOSAR XML (schema 00053)
package /InitialEcuC  (continued)
  module config Com  (continued)
    ComConfig  (continued)
      242 x ComSignalGroup, all with ComTransferProperty=PENDING:  (continued)
        SG_TrackerObject020_oRDR_TRACKER_OBJ_020_oPCAN_RADAR_f9891b52_Tx: ComSystemTemplateSignalGroupRef=SG_TrackerObject020
          49 x ComGroupSignal, all with ComSignalEndianness=BIG_ENDIAN, ComSignalInitValue=0, ComTransferProperty=PENDING:
            OBJ_ACCELERATION_LAT_020_oRDR_TRACKER_OBJ_020_oPCAN_RADAR_f7ad4025_Tx: ComBitPosition=177, ComBitSize=10, ComSignalType=UINT16, ComSystemTemplateSystemSignalRef=OBJ_ACCELERATION_LAT_020
            OBJ_ACCELERATION_LAT_ERR_020_oRDR_TRACKER_OBJ_020_oPCAN_RADAR_22597a9b_Tx: ComBitPosition=223, ComBitSize=8, ComSignalType=UINT8, ComSystemTemplateSystemSignalRef=OBJ_ACCELERATION_LAT_ERR_020
            OBJ_ACCELERATION_LONG_020_oRDR_TRACKER_OBJ_020_oPCAN_RADAR_855d19c5_Tx: ComBitPosition=193, ComBitSize=10, ComSignalType=UINT16, ComSystemTemplateSystemSignalRef=OBJ_ACCELERATION_LONG_020
            OBJ_ACCELERATION_LONG_ERR_020_oRDR_TRACKER_OBJ_020_oPCAN_RADAR_3dfcdf31_Tx: ComBitPosition=215, ComBitSize=8, ComSignalType=UINT8, ComSystemTemplateSystemSignalRef=OBJ_ACCELERATION_LONG_ERR_020
            OBJ_ACCEL_ERR_CRR_COEF_020_oRDR_TRACKER_OBJ_020_oPCAN_RADAR_9d5ffe57_Tx: ComBitPosition=431, ComBitSize=8, ComSignalType=UINT8, ComSystemTemplateSystemSignalRef=OBJ_ACCEL_ERR_CRR_COEF_020
            OBJ_ALIVE_TIME_020_oRDR_TRACKER_OBJ_020_oPCAN_RADAR_e53c5279_Tx: ComBitPosition=255, ComBitSize=16, ComSignalType=UINT16, ComSystemTemplateSystemSignalRef=OBJ_ALIVE_TIME_020
            OBJ_CLS_TYPE1_020_oRDR_TRACKER_OBJ_020_oPCAN_RADAR_72e7b35f_Tx: ComBitPosition=271, ComBitSize=4, ComSignalType=UINT8, ComSystemTemplateSystemSignalRef=OBJ_CLS_TYPE1_020
            OBJ_CLS_TYPE1_PROB_020_oRDR_TRACKER_OBJ_020_oPCAN_RADAR_dabf64ac_Tx: ComBitPosition=303, ComBitSize=8, ComSignalType=UINT8, ComSystemTemplateSystemSignalRef=OBJ_CLS_TYPE1_PROB_020
            OBJ_CLS_TYPE2_020_oRDR_TRACKER_OBJ_020_oPCAN_RADAR_3f0fb338_Tx: ComBitPosition=267, ComBitSize=4, ComSignalType=UINT8, ComSystemTemplateSystemSignalRef=OBJ_CLS_TYPE2_020
            OBJ_CLS_TYPE2_PROB_020_oRDR_TRACKER_OBJ_020_oPCAN_RADAR_138b7fa1_Tx: ComBitPosition=311, ComBitSize=8, ComSignalType=UINT8, ComSystemTemplateSystemSignalRef=OBJ_CLS_TYPE2_PROB_020
            OBJ_CLS_TYPE3_020_oRDR_TRACKER_OBJ_020_oPCAN_RADAR_b2874eda_Tx: ComBitPosition=279, ComBitSize=4, ComSignalType=UINT8, ComSystemTemplateSystemSignalRef=OBJ_CLS_TYPE3_020
            OBJ_CLS_TYPE3_PROB_020_oRDR_TRACKER_OBJ_020_oPCAN_RADAR_5498895a_Tx: ComBitPosition=319, ComBitSize=8, ComSignalType=UINT8, ComSystemTemplateSystemSignalRef=OBJ_CLS_TYPE3_PROB_020
            OBJ_CLS_TYPE4_020_oRDR_TRACKER_OBJ_020_oPCAN_RADAR_a4dfb3f6_Tx: ComBitPosition=275, ComBitSize=4, ComSignalType=UINT8, ComSystemTemplateSystemSignalRef=OBJ_CLS_TYPE4_020
            OBJ_CLS_TYPE4_PROB_020_oRDR_TRACKER_OBJ_020_oPCAN_RADAR_5a924ffa_Tx: ComBitPosition=327, ComBitSize=8, ComSignalType=UINT8, ComSystemTemplateSystemSignalRef=OBJ_CLS_TYPE4_PROB_020
            OBJ_CLS_TYPE5_020_oRDR_TRACKER_OBJ_020_oPCAN_RADAR_29574e14_Tx: ComBitPosition=287, ComBitSize=4, ComSignalType=UINT8, ComSystemTemplateSystemSignalRef=OBJ_CLS_TYPE5_020
            OBJ_CLS_TYPE5_PROB_020_oRDR_TRACKER_OBJ_020_oPCAN_RADAR_1d81b901_Tx: ComBitPosition=335, ComBitSize=8, ComSignalType=UINT8, ComSystemTemplateSystemSignalRef=OBJ_CLS_TYPE5_PROB_020
            OBJ_CLS_TYPE6_020_oRDR_TRACKER_OBJ_020_oPCAN_RADAR_64bf4e73_Tx: ComBitPosition=282, ComBitSize=4, ComSignalType=UINT8, ComSystemTemplateSystemSignalRef=OBJ_CLS_TYPE6_020
            OBJ_CLS_TYPE6_PROB_020_oRDR_TRACKER_OBJ_020_oPCAN_RADAR_d4b5a20c_Tx: ComBitPosition=343, ComBitSize=8, ComSignalType=UINT8, ComSystemTemplateSystemSignalRef=OBJ_CLS_TYPE6_PROB_020
            OBJ_DIMENSION_LENGTH_020_oRDR_TRACKER_OBJ_020_oPCAN_RADAR_3079e01b_Tx: ComBitPosition=37, ComBitSize=12, ComSignalType=UINT16, ComSystemTemplateSystemSignalRef=OBJ_DIMENSION_LENGTH_020
            OBJ_DIMENSION_LENGTH_ERR_020_oRDR_TRACKER_OBJ_020_oPCAN_RADAR_0b81ff61_Tx: ComBitPosition=41, ComBitSize=10, ComSignalType=UINT16, ComSystemTemplateSystemSignalRef=OBJ_DIMENSION_LENGTH_ERR_020
            OBJ_DIMENSION_WIDTH_020_oRDR_TRACKER_OBJ_020_oPCAN_RADAR_13b717b6_Tx: ComBitPosition=17, ComBitSize=10, ComSignalType=UINT16, ComSystemTemplateSystemSignalRef=OBJ_DIMENSION_WIDTH_020
            OBJ_DIMENSION_WIDTH_ERR_020_oRDR_TRACKER_OBJ_020_oPCAN_RADAR_f315d05e_Tx: ComBitPosition=23, ComBitSize=6, ComSignalType=UINT8, ComSystemTemplateSystemSignalRef=OBJ_DIMENSION_WIDTH_ERR_020
            OBJ_EXISTENCE_PROB_020_oRDR_TRACKER_OBJ_020_oPCAN_RADAR_180b938b_Tx: ComBitPosition=229, ComBitSize=14, ComSignalType=UINT16, ComSystemTemplateSystemSignalRef=OBJ_EXISTENCE_PROB_020
            OBJ_GROUP_ID_020_oRDR_TRACKER_OBJ_020_oPCAN_RADAR_91798726_Tx: ComBitPosition=405, ComBitSize=6, ComSignalType=UINT8, ComSystemTemplateSystemSignalRef=OBJ_GROUP_ID_020
            OBJ_ID_020_oRDR_TRACKER_OBJ_020_oPCAN_RADAR_6257ac21_Tx: ComBitPosition=7, ComBitSize=8, ComSignalType=UINT8, ComSystemTemplateSystemSignalRef=OBJ_ID_020
            OBJ_MEASUREMENT_STATUS_020_oRDR_TRACKER_OBJ_020_oPCAN_RADAR_1d85de9c_Tx: ComBitPosition=14, ComBitSize=3, ComSignalType=UINT8, ComSystemTemplateSystemSignalRef=OBJ_MEASUREMENT_STATUS_020
            OBJ_MH_CRC16_020_oRDR_TRACKER_OBJ_020_oPCAN_RADAR_61e569a0_Tx: ComBitPosition=495, ComBitSize=16, ComSignalType=UINT16, ComSystemTemplateSystemSignalRef=OBJ_MH_CRC16_020
            OBJ_MH_CYCLE_COUNTER_020_oRDR_TRACKER_OBJ_020_oPCAN_RADAR_10013341_Tx: ComBitPosition=487, ComBitSize=8, ComSignalType=UINT8, ComSystemTemplateSystemSignalRef=OBJ_MH_CYCLE_COUNTER_020
            OBJ_MOVEMENT_STATUS_020_oRDR_TRACKER_OBJ_020_oPCAN_RADAR_322b4bd0_Tx: ComBitPosition=196, ComBitSize=3, ComSignalType=UINT8, ComSystemTemplateSystemSignalRef=OBJ_MOVEMENT_STATUS_020
            OBJ_POS_ERR_CRR_COEF_020_oRDR_TRACKER_OBJ_020_oPCAN_RADAR_a2548bea_Tx: ComBitPosition=415, ComBitSize=8, ComSignalType=UINT8, ComSystemTemplateSystemSignalRef=OBJ_POS_ERR_CRR_COEF_020
            OBJ_POS_LAT_020_oRDR_TRACKER_OBJ_020_oPCAN_RADAR_40fb76a6_Tx: ComBitPosition=79, ComBitSize=16, ComSignalType=UINT16, ComSystemTemplateSystemSignalRef=OBJ_POS_LAT_020
            OBJ_POS_LAT_ERR_020_oRDR_TRACKER_OBJ_020_oPCAN_RADAR_44b72691_Tx: ComBitPosition=103, ComBitSize=8, ComSignalType=UINT8, ComSystemTemplateSystemSignalRef=OBJ_POS_LAT_ERR_020
            OBJ_POS_LONG_020_oRDR_TRACKER_OBJ_020_oPCAN_RADAR_f15b9d69_Tx: ComBitPosition=63, ComBitSize=16, ComSignalType=UINT16, ComSystemTemplateSystemSignalRef=OBJ_POS_LONG_020
            OBJ_POS_LONG_ERR_020_oRDR_TRACKER_OBJ_020_oPCAN_RADAR_dd4fd873_Tx: ComBitPosition=95, ComBitSize=8, ComSignalType=UINT8, ComSystemTemplateSystemSignalRef=OBJ_POS_LONG_ERR_020
            OBJ_RCS_020_oRDR_TRACKER_OBJ_020_oPCAN_RADAR_623420a1_Tx: ComBitPosition=351, ComBitSize=7, ComSignalType=UINT8, ComSystemTemplateSystemSignalRef=OBJ_RCS_020
            OBJ_REF_PT_LAT_OFFSET_020_oRDR_TRACKER_OBJ_020_oPCAN_RADAR_97094bd4_Tx: ComBitPosition=370, ComBitSize=14, ComSignalType=UINT16, ComSystemTemplateSystemSignalRef=OBJ_REF_PT_LAT_OFFSET_020
            OBJ_REF_PT_LONG_OFFSET_020_oRDR_TRACKER_OBJ_020_oPCAN_RADAR_d85bbbd7_Tx: ComBitPosition=357, ComBitSize=14, ComSignalType=UINT16, ComSystemTemplateSystemSignalRef=OBJ_REF_PT_LONG_OFFSET_020
            OBJ_TIMESTAMP_OFFSET_020_oRDR_TRACKER_OBJ_020_oPCAN_RADAR_629820f7_Tx: ComBitPosition=247, ComBitSize=8, ComSignalType=UINT8, ComSystemTemplateSystemSignalRef=OBJ_TIMESTAMP_OFFSET_020
            OBJ_TRACK_MOTION_MODEL_020_oRDR_TRACKER_OBJ_020_oPCAN_RADAR_ae9b212a_Tx: ComBitPosition=9, ComBitSize=2, ComSignalType=UINT8, ComSystemTemplateSystemSignalRef=OBJ_TRACK_MOTION_MODEL_020
            OBJ_VEH_TRACK_FLAG_020_oRDR_TRACKER_OBJ_020_oPCAN_RADAR_2cb1d777_Tx: ComBitPosition=10, ComBitSize=1, ComSignalType=BOOLEAN, ComSystemTemplateSystemSignalRef=OBJ_VEH_TRACK_FLAG_020
            OBJ_VELOCITY_ERR_CRR_COEF_020_oRDR_TRACKER_OBJ_020_oPCAN_RADAR_0b2eb60b_Tx: ComBitPosition=423, ComBitSize=8, ComSignalType=UINT8, ComSystemTemplateSystemSignalRef=OBJ_VELOCITY_ERR_CRR_COEF_020
            OBJ_VELOCITY_LAT_020_oRDR_TRACKER_OBJ_020_oPCAN_RADAR_04983381_Tx: ComBitPosition=126, ComBitSize=15, ComSignalType=UINT16, ComSystemTemplateSystemSignalRef=OBJ_VELOCITY_LAT_020
            OBJ_VELOCITY_LAT_ERR_020_oRDR_TRACKER_OBJ_020_oPCAN_RADAR_306243d0_Tx: ComBitPosition=151, ComBitSize=8, ComSignalType=UINT8, ComSystemTemplateSystemSignalRef=OBJ_VELOCITY_LAT_ERR_020
            OBJ_VELOCITY_LONG_020_oRDR_TRACKER_OBJ_020_oPCAN_RADAR_54154b47_Tx: ComBitPosition=110, ComBitSize=15, ComSignalType=UINT16, ComSystemTemplateSystemSignalRef=OBJ_VELOCITY_LONG_020
            OBJ_VELOCITY_LONG_ERR_020_oRDR_TRACKER_OBJ_020_oPCAN_RADAR_dce07c10_Tx: ComBitPosition=143, ComBitSize=8, ComSignalType=UINT8, ComSystemTemplateSystemSignalRef=OBJ_VELOCITY_LONG_ERR_020
            OBJ_YAW_ANGLE_020_oRDR_TRACKER_OBJ_020_oPCAN_RADAR_e82477c1_Tx: ComBitPosition=155, ComBitSize=12, ComSignalType=UINT16, ComSystemTemplateSystemSignalRef=OBJ_YAW_ANGLE_020
            OBJ_YAW_ANGLE_ERR_020_oRDR_TRACKER_OBJ_020_oPCAN_RADAR_3d297116_Tx: ComBitPosition=175, ComBitSize=7, ComSignalType=UINT8, ComSystemTemplateSystemSignalRef=OBJ_YAW_ANGLE_ERR_020
            OBJ_YAW_RATE_020_oRDR_TRACKER_OBJ_020_oPCAN_RADAR_cdab5286_Tx: ComBitPosition=399, ComBitSize=10, ComSignalType=UINT16, ComSystemTemplateSystemSignalRef=OBJ_YAW_RATE_020
            OBJ_YAW_RATE_ERR_020_oRDR_TRACKER_OBJ_020_oPCAN_RADAR_f273c55a_Tx: ComBitPosition=388, ComBitSize=5, ComSignalType=UINT8, ComSystemTemplateSystemSignalRef=OBJ_YAW_RATE_ERR_020
        SG_TrackerObject021_oRDR_TRACKER_OBJ_021_oPCAN_RADAR_009d93e1_Tx: ComSystemTemplateSignalGroupRef=SG_TrackerObject021
          49 x ComGroupSignal, all with ComSignalEndianness=BIG_ENDIAN, ComSignalInitValue=0, ComTransferProperty=PENDING:
            OBJ_ACCELERATION_LAT_021_oRDR_TRACKER_OBJ_021_oPCAN_RADAR_0eb9c896_Tx: ComBitPosition=177, ComBitSize=10, ComSignalType=UINT16, ComSystemTemplateSystemSignalRef=OBJ_ACCELERATION_LAT_021
            OBJ_ACCELERATION_LAT_ERR_021_oRDR_TRACKER_OBJ_021_oPCAN_RADAR_db4df228_Tx: ComBitPosition=223, ComBitSize=8, ComSignalType=UINT8, ComSystemTemplateSystemSignalRef=OBJ_ACCELERATION_LAT_ERR_021
            OBJ_ACCELERATION_LONG_021_oRDR_TRACKER_OBJ_021_oPCAN_RADAR_7c499176_Tx: ComBitPosition=193, ComBitSize=10, ComSignalType=UINT16, ComSystemTemplateSystemSignalRef=OBJ_ACCELERATION_LONG_021
            OBJ_ACCELERATION_LONG_ERR_021_oRDR_TRACKER_OBJ_021_oPCAN_RADAR_c4e85782_Tx: ComBitPosition=215, ComBitSize=8, ComSignalType=UINT8, ComSystemTemplateSystemSignalRef=OBJ_ACCELERATION_LONG_ERR_021
            OBJ_ACCEL_ERR_CRR_COEF_021_oRDR_TRACKER_OBJ_021_oPCAN_RADAR_644b76e4_Tx: ComBitPosition=431, ComBitSize=8, ComSignalType=UINT8, ComSystemTemplateSystemSignalRef=OBJ_ACCEL_ERR_CRR_COEF_021
            OBJ_ALIVE_TIME_021_oRDR_TRACKER_OBJ_021_oPCAN_RADAR_1c28daca_Tx: ComBitPosition=255, ComBitSize=16, ComSignalType=UINT16, ComSystemTemplateSystemSignalRef=OBJ_ALIVE_TIME_021
            OBJ_CLS_TYPE1_021_oRDR_TRACKER_OBJ_021_oPCAN_RADAR_8bf33bec_Tx: ComBitPosition=271, ComBitSize=4, ComSignalType=UINT8, ComSystemTemplateSystemSignalRef=OBJ_CLS_TYPE1_021
            OBJ_CLS_TYPE1_PROB_021_oRDR_TRACKER_OBJ_021_oPCAN_RADAR_23abec1f_Tx: ComBitPosition=303, ComBitSize=8, ComSignalType=UINT8, ComSystemTemplateSystemSignalRef=OBJ_CLS_TYPE1_PROB_021
            OBJ_CLS_TYPE2_021_oRDR_TRACKER_OBJ_021_oPCAN_RADAR_c61b3b8b_Tx: ComBitPosition=267, ComBitSize=4, ComSignalType=UINT8, ComSystemTemplateSystemSignalRef=OBJ_CLS_TYPE2_021
            OBJ_CLS_TYPE2_PROB_021_oRDR_TRACKER_OBJ_021_oPCAN_RADAR_ea9ff712_Tx: ComBitPosition=311, ComBitSize=8, ComSignalType=UINT8, ComSystemTemplateSystemSignalRef=OBJ_CLS_TYPE2_PROB_021
            OBJ_CLS_TYPE3_021_oRDR_TRACKER_OBJ_021_oPCAN_RADAR_4b93c669_Tx: ComBitPosition=279, ComBitSize=4, ComSignalType=UINT8, ComSystemTemplateSystemSignalRef=OBJ_CLS_TYPE3_021
            OBJ_CLS_TYPE3_PROB_021_oRDR_TRACKER_OBJ_021_oPCAN_RADAR_ad8c01e9_Tx: ComBitPosition=319, ComBitSize=8, ComSignalType=UINT8, ComSystemTemplateSystemSignalRef=OBJ_CLS_TYPE3_PROB_021
            OBJ_CLS_TYPE4_021_oRDR_TRACKER_OBJ_021_oPCAN_RADAR_5dcb3b45_Tx: ComBitPosition=275, ComBitSize=4, ComSignalType=UINT8, ComSystemTemplateSystemSignalRef=OBJ_CLS_TYPE4_021
            OBJ_CLS_TYPE4_PROB_021_oRDR_TRACKER_OBJ_021_oPCAN_RADAR_a386c749_Tx: ComBitPosition=327, ComBitSize=8, ComSignalType=UINT8, ComSystemTemplateSystemSignalRef=OBJ_CLS_TYPE4_PROB_021
            OBJ_CLS_TYPE5_021_oRDR_TRACKER_OBJ_021_oPCAN_RADAR_d043c6a7_Tx: ComBitPosition=287, ComBitSize=4, ComSignalType=UINT8, ComSystemTemplateSystemSignalRef=OBJ_CLS_TYPE5_021
            OBJ_CLS_TYPE5_PROB_021_oRDR_TRACKER_OBJ_021_oPCAN_RADAR_e49531b2_Tx: ComBitPosition=335, ComBitSize=8, ComSignalType=UINT8, ComSystemTemplateSystemSignalRef=OBJ_CLS_TYPE5_PROB_021
            OBJ_CLS_TYPE6_021_oRDR_TRACKER_OBJ_021_oPCAN_RADAR_9dabc6c0_Tx: ComBitPosition=282, ComBitSize=4, ComSignalType=UINT8, ComSystemTemplateSystemSignalRef=OBJ_CLS_TYPE6_021
            OBJ_CLS_TYPE6_PROB_021_oRDR_TRACKER_OBJ_021_oPCAN_RADAR_2da12abf_Tx: ComBitPosition=343, ComBitSize=8, ComSignalType=UINT8, ComSystemTemplateSystemSignalRef=OBJ_CLS_TYPE6_PROB_021
            OBJ_DIMENSION_LENGTH_021_oRDR_TRACKER_OBJ_021_oPCAN_RADAR_c96d68a8_Tx: ComBitPosition=37, ComBitSize=12, ComSignalType=UINT16, ComSystemTemplateSystemSignalRef=OBJ_DIMENSION_LENGTH_021
            OBJ_DIMENSION_LENGTH_ERR_021_oRDR_TRACKER_OBJ_021_oPCAN_RADAR_f29577d2_Tx: ComBitPosition=41, ComBitSize=10, ComSignalType=UINT16, ComSystemTemplateSystemSignalRef=OBJ_DIMENSION_LENGTH_ERR_021
            OBJ_DIMENSION_WIDTH_021_oRDR_TRACKER_OBJ_021_oPCAN_RADAR_eaa39f05_Tx: ComBitPosition=17, ComBitSize=10, ComSignalType=UINT16, ComSystemTemplateSystemSignalRef=OBJ_DIMENSION_WIDTH_021
            OBJ_DIMENSION_WIDTH_ERR_021_oRDR_TRACKER_OBJ_021_oPCAN_RADAR_0a0158ed_Tx: ComBitPosition=23, ComBitSize=6, ComSignalType=UINT8, ComSystemTemplateSystemSignalRef=OBJ_DIMENSION_WIDTH_ERR_021
            OBJ_EXISTENCE_PROB_021_oRDR_TRACKER_OBJ_021_oPCAN_RADAR_e11f1b38_Tx: ComBitPosition=229, ComBitSize=14, ComSignalType=UINT16, ComSystemTemplateSystemSignalRef=OBJ_EXISTENCE_PROB_021
            OBJ_GROUP_ID_021_oRDR_TRACKER_OBJ_021_oPCAN_RADAR_686d0f95_Tx: ComBitPosition=405, ComBitSize=6, ComSignalType=UINT8, ComSystemTemplateSystemSignalRef=OBJ_GROUP_ID_021
            OBJ_ID_021_oRDR_TRACKER_OBJ_021_oPCAN_RADAR_9b432492_Tx: ComBitPosition=7, ComBitSize=8, ComSignalType=UINT8, ComSystemTemplateSystemSignalRef=OBJ_ID_021
            OBJ_MEASUREMENT_STATUS_021_oRDR_TRACKER_OBJ_021_oPCAN_RADAR_e491562f_Tx: ComBitPosition=14, ComBitSize=3, ComSignalType=UINT8, ComSystemTemplateSystemSignalRef=OBJ_MEASUREMENT_STATUS_021
            OBJ_MH_CRC16_021_oRDR_TRACKER_OBJ_021_oPCAN_RADAR_98f1e113_Tx: ComBitPosition=495, ComBitSize=16, ComSignalType=UINT16, ComSystemTemplateSystemSignalRef=OBJ_MH_CRC16_021
            OBJ_MH_CYCLE_COUNTER_021_oRDR_TRACKER_OBJ_021_oPCAN_RADAR_e915bbf2_Tx: ComBitPosition=487, ComBitSize=8, ComSignalType=UINT8, ComSystemTemplateSystemSignalRef=OBJ_MH_CYCLE_COUNTER_021
            OBJ_MOVEMENT_STATUS_021_oRDR_TRACKER_OBJ_021_oPCAN_RADAR_cb3fc363_Tx: ComBitPosition=196, ComBitSize=3, ComSignalType=UINT8, ComSystemTemplateSystemSignalRef=OBJ_MOVEMENT_STATUS_021
            OBJ_POS_ERR_CRR_COEF_021_oRDR_TRACKER_OBJ_021_oPCAN_RADAR_5b400359_Tx: ComBitPosition=415, ComBitSize=8, ComSignalType=UINT8, ComSystemTemplateSystemSignalRef=OBJ_POS_ERR_CRR_COEF_021
            OBJ_POS_LAT_021_oRDR_TRACKER_OBJ_021_oPCAN_RADAR_b9effe15_Tx: ComBitPosition=79, ComBitSize=16, ComSignalType=UINT16, ComSystemTemplateSystemSignalRef=OBJ_POS_LAT_021
            OBJ_POS_LAT_ERR_021_oRDR_TRACKER_OBJ_021_oPCAN_RADAR_bda3ae22_Tx: ComBitPosition=103, ComBitSize=8, ComSignalType=UINT8, ComSystemTemplateSystemSignalRef=OBJ_POS_LAT_ERR_021
            OBJ_POS_LONG_021_oRDR_TRACKER_OBJ_021_oPCAN_RADAR_084f15da_Tx: ComBitPosition=63, ComBitSize=16, ComSignalType=UINT16, ComSystemTemplateSystemSignalRef=OBJ_POS_LONG_021
            OBJ_POS_LONG_ERR_021_oRDR_TRACKER_OBJ_021_oPCAN_RADAR_245b50c0_Tx: ComBitPosition=95, ComBitSize=8, ComSignalType=UINT8, ComSystemTemplateSystemSignalRef=OBJ_POS_LONG_ERR_021
            OBJ_RCS_021_oRDR_TRACKER_OBJ_021_oPCAN_RADAR_9b20a812_Tx: ComBitPosition=351, ComBitSize=7, ComSignalType=UINT8, ComSystemTemplateSystemSignalRef=OBJ_RCS_021
            OBJ_REF_PT_LAT_OFFSET_021_oRDR_TRACKER_OBJ_021_oPCAN_RADAR_6e1dc367_Tx: ComBitPosition=370, ComBitSize=14, ComSignalType=UINT16, ComSystemTemplateSystemSignalRef=OBJ_REF_PT_LAT_OFFSET_021
            OBJ_REF_PT_LONG_OFFSET_021_oRDR_TRACKER_OBJ_021_oPCAN_RADAR_214f3364_Tx: ComBitPosition=357, ComBitSize=14, ComSignalType=UINT16, ComSystemTemplateSystemSignalRef=OBJ_REF_PT_LONG_OFFSET_021
            OBJ_TIMESTAMP_OFFSET_021_oRDR_TRACKER_OBJ_021_oPCAN_RADAR_9b8ca844_Tx: ComBitPosition=247, ComBitSize=8, ComSignalType=UINT8, ComSystemTemplateSystemSignalRef=OBJ_TIMESTAMP_OFFSET_021
            OBJ_TRACK_MOTION_MODEL_021_oRDR_TRACKER_OBJ_021_oPCAN_RADAR_578fa999_Tx: ComBitPosition=9, ComBitSize=2, ComSignalType=UINT8, ComSystemTemplateSystemSignalRef=OBJ_TRACK_MOTION_MODEL_021
            OBJ_VEH_TRACK_FLAG_021_oRDR_TRACKER_OBJ_021_oPCAN_RADAR_d5a55fc4_Tx: ComBitPosition=10, ComBitSize=1, ComSignalType=BOOLEAN, ComSystemTemplateSystemSignalRef=OBJ_VEH_TRACK_FLAG_021
            OBJ_VELOCITY_ERR_CRR_COEF_021_oRDR_TRACKER_OBJ_021_oPCAN_RADAR_f23a3eb8_Tx: ComBitPosition=423, ComBitSize=8, ComSignalType=UINT8, ComSystemTemplateSystemSignalRef=OBJ_VELOCITY_ERR_CRR_COEF_021
            OBJ_VELOCITY_LAT_021_oRDR_TRACKER_OBJ_021_oPCAN_RADAR_fd8cbb32_Tx: ComBitPosition=126, ComBitSize=15, ComSignalType=UINT16, ComSystemTemplateSystemSignalRef=OBJ_VELOCITY_LAT_021
            OBJ_VELOCITY_LAT_ERR_021_oRDR_TRACKER_OBJ_021_oPCAN_RADAR_c976cb63_Tx: ComBitPosition=151, ComBitSize=8, ComSignalType=UINT8, ComSystemTemplateSystemSignalRef=OBJ_VELOCITY_LAT_ERR_021
            OBJ_VELOCITY_LONG_021_oRDR_TRACKER_OBJ_021_oPCAN_RADAR_ad01c3f4_Tx: ComBitPosition=110, ComBitSize=15, ComSignalType=UINT16, ComSystemTemplateSystemSignalRef=OBJ_VELOCITY_LONG_021
            OBJ_VELOCITY_LONG_ERR_021_oRDR_TRACKER_OBJ_021_oPCAN_RADAR_25f4f4a3_Tx: ComBitPosition=143, ComBitSize=8, ComSignalType=UINT8, ComSystemTemplateSystemSignalRef=OBJ_VELOCITY_LONG_ERR_021
            OBJ_YAW_ANGLE_021_oRDR_TRACKER_OBJ_021_oPCAN_RADAR_1130ff72_Tx: ComBitPosition=155, ComBitSize=12, ComSignalType=UINT16, ComSystemTemplateSystemSignalRef=OBJ_YAW_ANGLE_021
            OBJ_YAW_ANGLE_ERR_021_oRDR_TRACKER_OBJ_021_oPCAN_RADAR_c43df9a5_Tx: ComBitPosition=175, ComBitSize=7, ComSignalType=UINT8, ComSystemTemplateSystemSignalRef=OBJ_YAW_ANGLE_ERR_021
            OBJ_YAW_RATE_021_oRDR_TRACKER_OBJ_021_oPCAN_RADAR_34bfda35_Tx: ComBitPosition=399, ComBitSize=10, ComSignalType=UINT16, ComSystemTemplateSystemSignalRef=OBJ_YAW_RATE_021
            OBJ_YAW_RATE_ERR_021_oRDR_TRACKER_OBJ_021_oPCAN_RADAR_0b674de9_Tx: ComBitPosition=388, ComBitSize=5, ComSignalType=UINT8, ComSystemTemplateSystemSignalRef=OBJ_YAW_RATE_ERR_021
        SG_TrackerObject022_oRDR_TRACKER_OBJ_022_oPCAN_RADAR_d0d10c75_Tx: ComSystemTemplateSignalGroupRef=SG_TrackerObject022
          49 x ComGroupSignal, all with ComSignalEndianness=BIG_ENDIAN, ComSignalInitValue=0, ComTransferProperty=PENDING:
            OBJ_ACCELERATION_LAT_022_oRDR_TRACKER_OBJ_022_oPCAN_RADAR_def55702_Tx: ComBitPosition=177, ComBitSize=10, ComSignalType=UINT16, ComSystemTemplateSystemSignalRef=OBJ_ACCELERATION_LAT_022
            OBJ_ACCELERATION_LAT_ERR_022_oRDR_TRACKER_OBJ_022_oPCAN_RADAR_0b016dbc_Tx: ComBitPosition=223, ComBitSize=8, ComSignalType=UINT8, ComSystemTemplateSystemSignalRef=OBJ_ACCELERATION_LAT_ERR_022
            OBJ_ACCELERATION_LONG_022_oRDR_TRACKER_OBJ_022_oPCAN_RADAR_ac050ee2_Tx: ComBitPosition=193, ComBitSize=10, ComSignalType=UINT16, ComSystemTemplateSystemSignalRef=OBJ_ACCELERATION_LONG_022
            OBJ_ACCELERATION_LONG_ERR_022_oRDR_TRACKER_OBJ_022_oPCAN_RADAR_14a4c816_Tx: ComBitPosition=215, ComBitSize=8, ComSignalType=UINT8, ComSystemTemplateSystemSignalRef=OBJ_ACCELERATION_LONG_ERR_022
            OBJ_ACCEL_ERR_CRR_COEF_022_oRDR_TRACKER_OBJ_022_oPCAN_RADAR_b407e970_Tx: ComBitPosition=431, ComBitSize=8, ComSignalType=UINT8, ComSystemTemplateSystemSignalRef=OBJ_ACCEL_ERR_CRR_COEF_022
            OBJ_ALIVE_TIME_022_oRDR_TRACKER_OBJ_022_oPCAN_RADAR_cc64455e_Tx: ComBitPosition=255, ComBitSize=16, ComSignalType=UINT16, ComSystemTemplateSystemSignalRef=OBJ_ALIVE_TIME_022
            OBJ_CLS_TYPE1_022_oRDR_TRACKER_OBJ_022_oPCAN_RADAR_5bbfa478_Tx: ComBitPosition=271, ComBitSize=4, ComSignalType=UINT8, ComSystemTemplateSystemSignalRef=OBJ_CLS_TYPE1_022
            OBJ_CLS_TYPE1_PROB_022_oRDR_TRACKER_OBJ_022_oPCAN_RADAR_f3e7738b_Tx: ComBitPosition=303, ComBitSize=8, ComSignalType=UINT8, ComSystemTemplateSystemSignalRef=OBJ_CLS_TYPE1_PROB_022
            OBJ_CLS_TYPE2_022_oRDR_TRACKER_OBJ_022_oPCAN_RADAR_1657a41f_Tx: ComBitPosition=267, ComBitSize=4, ComSignalType=UINT8, ComSystemTemplateSystemSignalRef=OBJ_CLS_TYPE2_022
            OBJ_CLS_TYPE2_PROB_022_oRDR_TRACKER_OBJ_022_oPCAN_RADAR_3ad36886_Tx: ComBitPosition=311, ComBitSize=8, ComSignalType=UINT8, ComSystemTemplateSystemSignalRef=OBJ_CLS_TYPE2_PROB_022
            OBJ_CLS_TYPE3_022_oRDR_TRACKER_OBJ_022_oPCAN_RADAR_9bdf59fd_Tx: ComBitPosition=279, ComBitSize=4, ComSignalType=UINT8, ComSystemTemplateSystemSignalRef=OBJ_CLS_TYPE3_022
            OBJ_CLS_TYPE3_PROB_022_oRDR_TRACKER_OBJ_022_oPCAN_RADAR_7dc09e7d_Tx: ComBitPosition=319, ComBitSize=8, ComSignalType=UINT8, ComSystemTemplateSystemSignalRef=OBJ_CLS_TYPE3_PROB_022
            OBJ_CLS_TYPE4_022_oRDR_TRACKER_OBJ_022_oPCAN_RADAR_8d87a4d1_Tx: ComBitPosition=275, ComBitSize=4, ComSignalType=UINT8, ComSystemTemplateSystemSignalRef=OBJ_CLS_TYPE4_022
            OBJ_CLS_TYPE4_PROB_022_oRDR_TRACKER_OBJ_022_oPCAN_RADAR_73ca58dd_Tx: ComBitPosition=327, ComBitSize=8, ComSignalType=UINT8, ComSystemTemplateSystemSignalRef=OBJ_CLS_TYPE4_PROB_022
            OBJ_CLS_TYPE5_022_oRDR_TRACKER_OBJ_022_oPCAN_RADAR_000f5933_Tx: ComBitPosition=287, ComBitSize=4, ComSignalType=UINT8, ComSystemTemplateSystemSignalRef=OBJ_CLS_TYPE5_022
            OBJ_CLS_TYPE5_PROB_022_oRDR_TRACKER_OBJ_022_oPCAN_RADAR_34d9ae26_Tx: ComBitPosition=335, ComBitSize=8, ComSignalType=UINT8, ComSystemTemplateSystemSignalRef=OBJ_CLS_TYPE5_PROB_022
            OBJ_CLS_TYPE6_022_oRDR_TRACKER_OBJ_022_oPCAN_RADAR_4de75954_Tx: ComBitPosition=282, ComBitSize=4, ComSignalType=UINT8, ComSystemTemplateSystemSignalRef=OBJ_CLS_TYPE6_022
            OBJ_CLS_TYPE6_PROB_022_oRDR_TRACKER_OBJ_022_oPCAN_RADAR_fdedb52b_Tx: ComBitPosition=343, ComBitSize=8, ComSignalType=UINT8, ComSystemTemplateSystemSignalRef=OBJ_CLS_TYPE6_PROB_022
            OBJ_DIMENSION_LENGTH_022_oRDR_TRACKER_OBJ_022_oPCAN_RADAR_1921f73c_Tx: ComBitPosition=37, ComBitSize=12, ComSignalType=UINT16, ComSystemTemplateSystemSignalRef=OBJ_DIMENSION_LENGTH_022
            OBJ_DIMENSION_LENGTH_ERR_022_oRDR_TRACKER_OBJ_022_oPCAN_RADAR_22d9e846_Tx: ComBitPosition=41, ComBitSize=10, ComSignalType=UINT16, ComSystemTemplateSystemSignalRef=OBJ_DIMENSION_LENGTH_ERR_022
            OBJ_DIMENSION_WIDTH_022_oRDR_TRACKER_OBJ_022_oPCAN_RADAR_3aef0091_Tx: ComBitPosition=17, ComBitSize=10, ComSignalType=UINT16, ComSystemTemplateSystemSignalRef=OBJ_DIMENSION_WIDTH_022
            OBJ_DIMENSION_WIDTH_ERR_022_oRDR_TRACKER_OBJ_022_oPCAN_RADAR_da4dc779_Tx: ComBitPosition=23, ComBitSize=6, ComSignalType=UINT8, ComSystemTemplateSystemSignalRef=OBJ_DIMENSION_WIDTH_ERR_022
            OBJ_EXISTENCE_PROB_022_oRDR_TRACKER_OBJ_022_oPCAN_RADAR_315384ac_Tx: ComBitPosition=229, ComBitSize=14, ComSignalType=UINT16, ComSystemTemplateSystemSignalRef=OBJ_EXISTENCE_PROB_022
            OBJ_GROUP_ID_022_oRDR_TRACKER_OBJ_022_oPCAN_RADAR_b8219001_Tx: ComBitPosition=405, ComBitSize=6, ComSignalType=UINT8, ComSystemTemplateSystemSignalRef=OBJ_GROUP_ID_022
            OBJ_ID_022_oRDR_TRACKER_OBJ_022_oPCAN_RADAR_4b0fbb06_Tx: ComBitPosition=7, ComBitSize=8, ComSignalType=UINT8, ComSystemTemplateSystemSignalRef=OBJ_ID_022
            OBJ_MEASUREMENT_STATUS_022_oRDR_TRACKER_OBJ_022_oPCAN_RADAR_34ddc9bb_Tx: ComBitPosition=14, ComBitSize=3, ComSignalType=UINT8, ComSystemTemplateSystemSignalRef=OBJ_MEASUREMENT_STATUS_022
            OBJ_MH_CRC16_022_oRDR_TRACKER_OBJ_022_oPCAN_RADAR_48bd7e87_Tx: ComBitPosition=495, ComBitSize=16, ComSignalType=UINT16, ComSystemTemplateSystemSignalRef=OBJ_MH_CRC16_022
            OBJ_MH_CYCLE_COUNTER_022_oRDR_TRACKER_OBJ_022_oPCAN_RADAR_39592466_Tx: ComBitPosition=487, ComBitSize=8, ComSignalType=UINT8, ComSystemTemplateSystemSignalRef=OBJ_MH_CYCLE_COUNTER_022
            OBJ_MOVEMENT_STATUS_022_oRDR_TRACKER_OBJ_022_oPCAN_RADAR_1b735cf7_Tx: ComBitPosition=196, ComBitSize=3, ComSignalType=UINT8, ComSystemTemplateSystemSignalRef=OBJ_MOVEMENT_STATUS_022
            OBJ_POS_ERR_CRR_COEF_022_oRDR_TRACKER_OBJ_022_oPCAN_RADAR_8b0c9ccd_Tx: ComBitPosition=415, ComBitSize=8, ComSignalType=UINT8, ComSystemTemplateSystemSignalRef=OBJ_POS_ERR_CRR_COEF_022
            OBJ_POS_LAT_022_oRDR_TRACKER_OBJ_022_oPCAN_RADAR_69a36181_Tx: ComBitPosition=79, ComBitSize=16, ComSignalType=UINT16, ComSystemTemplateSystemSignalRef=OBJ_POS_LAT_022
            OBJ_POS_LAT_ERR_022_oRDR_TRACKER_OBJ_022_oPCAN_RADAR_6def31b6_Tx: ComBitPosition=103, ComBitSize=8, ComSignalType=UINT8, ComSystemTemplateSystemSignalRef=OBJ_POS_LAT_ERR_022
            OBJ_POS_LONG_022_oRDR_TRACKER_OBJ_022_oPCAN_RADAR_d8038a4e_Tx: ComBitPosition=63, ComBitSize=16, ComSignalType=UINT16, ComSystemTemplateSystemSignalRef=OBJ_POS_LONG_022
            OBJ_POS_LONG_ERR_022_oRDR_TRACKER_OBJ_022_oPCAN_RADAR_f417cf54_Tx: ComBitPosition=95, ComBitSize=8, ComSignalType=UINT8, ComSystemTemplateSystemSignalRef=OBJ_POS_LONG_ERR_022
            OBJ_RCS_022_oRDR_TRACKER_OBJ_022_oPCAN_RADAR_4b6c3786_Tx: ComBitPosition=351, ComBitSize=7, ComSignalType=UINT8, ComSystemTemplateSystemSignalRef=OBJ_RCS_022
            OBJ_REF_PT_LAT_OFFSET_022_oRDR_TRACKER_OBJ_022_oPCAN_RADAR_be515cf3_Tx: ComBitPosition=370, ComBitSize=14, ComSignalType=UINT16, ComSystemTemplateSystemSignalRef=OBJ_REF_PT_LAT_OFFSET_022
            OBJ_REF_PT_LONG_OFFSET_022_oRDR_TRACKER_OBJ_022_oPCAN_RADAR_f103acf0_Tx: ComBitPosition=357, ComBitSize=14, ComSignalType=UINT16, ComSystemTemplateSystemSignalRef=OBJ_REF_PT_LONG_OFFSET_022
            OBJ_TIMESTAMP_OFFSET_022_oRDR_TRACKER_OBJ_022_oPCAN_RADAR_4bc037d0_Tx: ComBitPosition=247, ComBitSize=8, ComSignalType=UINT8, ComSystemTemplateSystemSignalRef=OBJ_TIMESTAMP_OFFSET_022
            OBJ_TRACK_MOTION_MODEL_022_oRDR_TRACKER_OBJ_022_oPCAN_RADAR_87c3360d_Tx: ComBitPosition=9, ComBitSize=2, ComSignalType=UINT8, ComSystemTemplateSystemSignalRef=OBJ_TRACK_MOTION_MODEL_022
            OBJ_VEH_TRACK_FLAG_022_oRDR_TRACKER_OBJ_022_oPCAN_RADAR_05e9c050_Tx: ComBitPosition=10, ComBitSize=1, ComSignalType=BOOLEAN, ComSystemTemplateSystemSignalRef=OBJ_VEH_TRACK_FLAG_022
            OBJ_VELOCITY_ERR_CRR_COEF_022_oRDR_TRACKER_OBJ_022_oPCAN_RADAR_2276a12c_Tx: ComBitPosition=423, ComBitSize=8, ComSignalType=UINT8, ComSystemTemplateSystemSignalRef=OBJ_VELOCITY_ERR_CRR_COEF_022
            OBJ_VELOCITY_LAT_022_oRDR_TRACKER_OBJ_022_oPCAN_RADAR_2dc024a6_Tx: ComBitPosition=126, ComBitSize=15, ComSignalType=UINT16, ComSystemTemplateSystemSignalRef=OBJ_VELOCITY_LAT_022
            OBJ_VELOCITY_LAT_ERR_022_oRDR_TRACKER_OBJ_022_oPCAN_RADAR_193a54f7_Tx: ComBitPosition=151, ComBitSize=8, ComSignalType=UINT8, ComSystemTemplateSystemSignalRef=OBJ_VELOCITY_LAT_ERR_022
            OBJ_VELOCITY_LONG_022_oRDR_TRACKER_OBJ_022_oPCAN_RADAR_7d4d5c60_Tx: ComBitPosition=110, ComBitSize=15, ComSignalType=UINT16, ComSystemTemplateSystemSignalRef=OBJ_VELOCITY_LONG_022
            OBJ_VELOCITY_LONG_ERR_022_oRDR_TRACKER_OBJ_022_oPCAN_RADAR_f5b86b37_Tx: ComBitPosition=143, ComBitSize=8, ComSignalType=UINT8, ComSystemTemplateSystemSignalRef=OBJ_VELOCITY_LONG_ERR_022
            OBJ_YAW_ANGLE_022_oRDR_TRACKER_OBJ_022_oPCAN_RADAR_c17c60e6_Tx: ComBitPosition=155, ComBitSize=12, ComSignalType=UINT16, ComSystemTemplateSystemSignalRef=OBJ_YAW_ANGLE_022
            OBJ_YAW_ANGLE_ERR_022_oRDR_TRACKER_OBJ_022_oPCAN_RADAR_14716631_Tx: ComBitPosition=175, ComBitSize=7, ComSignalType=UINT8, ComSystemTemplateSystemSignalRef=OBJ_YAW_ANGLE_ERR_022
            OBJ_YAW_RATE_022_oRDR_TRACKER_OBJ_022_oPCAN_RADAR_e4f345a1_Tx: ComBitPosition=399, ComBitSize=10, ComSignalType=UINT16, ComSystemTemplateSystemSignalRef=OBJ_YAW_RATE_022
            OBJ_YAW_RATE_ERR_022_oRDR_TRACKER_OBJ_022_oPCAN_RADAR_db2bd27d_Tx: ComBitPosition=388, ComBitSize=5, ComSignalType=UINT8, ComSystemTemplateSystemSignalRef=OBJ_YAW_RATE_ERR_022
        SG_TrackerObject023_oRDR_TRACKER_OBJ_023_oPCAN_RADAR_29c584c6_Tx: ComSystemTemplateSignalGroupRef=SG_TrackerObject023
          49 x ComGroupSignal, all with ComSignalEndianness=BIG_ENDIAN, ComSignalInitValue=0, ComTransferProperty=PENDING:
            OBJ_ACCELERATION_LAT_023_oRDR_TRACKER_OBJ_023_oPCAN_RADAR_27e1dfb1_Tx: ComBitPosition=177, ComBitSize=10, ComSignalType=UINT16, ComSystemTemplateSystemSignalRef=OBJ_ACCELERATION_LAT_023
            OBJ_ACCELERATION_LAT_ERR_023_oRDR_TRACKER_OBJ_023_oPCAN_RADAR_f215e50f_Tx: ComBitPosition=223, ComBitSize=8, ComSignalType=UINT8, ComSystemTemplateSystemSignalRef=OBJ_ACCELERATION_LAT_ERR_023
            OBJ_ACCELERATION_LONG_023_oRDR_TRACKER_OBJ_023_oPCAN_RADAR_55118651_Tx: ComBitPosition=193, ComBitSize=10, ComSignalType=UINT16, ComSystemTemplateSystemSignalRef=OBJ_ACCELERATION_LONG_023
            OBJ_ACCELERATION_LONG_ERR_023_oRDR_TRACKER_OBJ_023_oPCAN_RADAR_edb040a5_Tx: ComBitPosition=215, ComBitSize=8, ComSignalType=UINT8, ComSystemTemplateSystemSignalRef=OBJ_ACCELERATION_LONG_ERR_023
            OBJ_ACCEL_ERR_CRR_COEF_023_oRDR_TRACKER_OBJ_023_oPCAN_RADAR_4d1361c3_Tx: ComBitPosition=431, ComBitSize=8, ComSignalType=UINT8, ComSystemTemplateSystemSignalRef=OBJ_ACCEL_ERR_CRR_COEF_023
            OBJ_ALIVE_TIME_023_oRDR_TRACKER_OBJ_023_oPCAN_RADAR_3570cded_Tx: ComBitPosition=255, ComBitSize=16, ComSignalType=UINT16, ComSystemTemplateSystemSignalRef=OBJ_ALIVE_TIME_023
            OBJ_CLS_TYPE1_023_oRDR_TRACKER_OBJ_023_oPCAN_RADAR_a2ab2ccb_Tx: ComBitPosition=271, ComBitSize=4, ComSignalType=UINT8, ComSystemTemplateSystemSignalRef=OBJ_CLS_TYPE1_023
            OBJ_CLS_TYPE1_PROB_023_oRDR_TRACKER_OBJ_023_oPCAN_RADAR_0af3fb38_Tx: ComBitPosition=303, ComBitSize=8, ComSignalType=UINT8, ComSystemTemplateSystemSignalRef=OBJ_CLS_TYPE1_PROB_023
            OBJ_CLS_TYPE2_023_oRDR_TRACKER_OBJ_023_oPCAN_RADAR_ef432cac_Tx: ComBitPosition=267, ComBitSize=4, ComSignalType=UINT8, ComSystemTemplateSystemSignalRef=OBJ_CLS_TYPE2_023
            OBJ_CLS_TYPE2_PROB_023_oRDR_TRACKER_OBJ_023_oPCAN_RADAR_c3c7e035_Tx: ComBitPosition=311, ComBitSize=8, ComSignalType=UINT8, ComSystemTemplateSystemSignalRef=OBJ_CLS_TYPE2_PROB_023
            OBJ_CLS_TYPE3_023_oRDR_TRACKER_OBJ_023_oPCAN_RADAR_62cbd14e_Tx: ComBitPosition=279, ComBitSize=4, ComSignalType=UINT8, ComSystemTemplateSystemSignalRef=OBJ_CLS_TYPE3_023
            OBJ_CLS_TYPE3_PROB_023_oRDR_TRACKER_OBJ_023_oPCAN_RADAR_84d416ce_Tx: ComBitPosition=319, ComBitSize=8, ComSignalType=UINT8, ComSystemTemplateSystemSignalRef=OBJ_CLS_TYPE3_PROB_023
            OBJ_CLS_TYPE4_023_oRDR_TRACKER_OBJ_023_oPCAN_RADAR_74932c62_Tx: ComBitPosition=275, ComBitSize=4, ComSignalType=UINT8, ComSystemTemplateSystemSignalRef=OBJ_CLS_TYPE4_023
            OBJ_CLS_TYPE4_PROB_023_oRDR_TRACKER_OBJ_023_oPCAN_RADAR_8aded06e_Tx: ComBitPosition=327, ComBitSize=8, ComSignalType=UINT8, ComSystemTemplateSystemSignalRef=OBJ_CLS_TYPE4_PROB_023
            OBJ_CLS_TYPE5_023_oRDR_TRACKER_OBJ_023_oPCAN_RADAR_f91bd180_Tx: ComBitPosition=287, ComBitSize=4, ComSignalType=UINT8, ComSystemTemplateSystemSignalRef=OBJ_CLS_TYPE5_023
            OBJ_CLS_TYPE5_PROB_023_oRDR_TRACKER_OBJ_023_oPCAN_RADAR_cdcd2695_Tx: ComBitPosition=335, ComBitSize=8, ComSignalType=UINT8, ComSystemTemplateSystemSignalRef=OBJ_CLS_TYPE5_PROB_023
            OBJ_CLS_TYPE6_023_oRDR_TRACKER_OBJ_023_oPCAN_RADAR_b4f3d1e7_Tx: ComBitPosition=282, ComBitSize=4, ComSignalType=UINT8, ComSystemTemplateSystemSignalRef=OBJ_CLS_TYPE6_023
            OBJ_CLS_TYPE6_PROB_023_oRDR_TRACKER_OBJ_023_oPCAN_RADAR_04f93d98_Tx: ComBitPosition=343, ComBitSize=8, ComSignalType=UINT8, ComSystemTemplateSystemSignalRef=OBJ_CLS_TYPE6_PROB_023
            OBJ_DIMENSION_LENGTH_023_oRDR_TRACKER_OBJ_023_oPCAN_RADAR_e0357f8f_Tx: ComBitPosition=37, ComBitSize=12, ComSignalType=UINT16, ComSystemTemplateSystemSignalRef=OBJ_DIMENSION_LENGTH_023
            OBJ_DIMENSION_LENGTH_ERR_023_oRDR_TRACKER_OBJ_023_oPCAN_RADAR_dbcd60f5_Tx: ComBitPosition=41, ComBitSize=10, ComSignalType=UINT16, ComSystemTemplateSystemSignalRef=OBJ_DIMENSION_LENGTH_ERR_023
            OBJ_DIMENSION_WIDTH_023_oRDR_TRACKER_OBJ_023_oPCAN_RADAR_c3fb8822_Tx: ComBitPosition=17, ComBitSize=10, ComSignalType=UINT16, ComSystemTemplateSystemSignalRef=OBJ_DIMENSION_WIDTH_023
            OBJ_DIMENSION_WIDTH_ERR_023_oRDR_TRACKER_OBJ_023_oPCAN_RADAR_23594fca_Tx: ComBitPosition=23, ComBitSize=6, ComSignalType=UINT8, ComSystemTemplateSystemSignalRef=OBJ_DIMENSION_WIDTH_ERR_023
            OBJ_EXISTENCE_PROB_023_oRDR_TRACKER_OBJ_023_oPCAN_RADAR_c8470c1f_Tx: ComBitPosition=229, ComBitSize=14, ComSignalType=UINT16, ComSystemTemplateSystemSignalRef=OBJ_EXISTENCE_PROB_023
            OBJ_GROUP_ID_023_oRDR_TRACKER_OBJ_023_oPCAN_RADAR_413518b2_Tx: ComBitPosition=405, ComBitSize=6, ComSignalType=UINT8, ComSystemTemplateSystemSignalRef=OBJ_GROUP_ID_023
            OBJ_ID_023_oRDR_TRACKER_OBJ_023_oPCAN_RADAR_b21b33b5_Tx: ComBitPosition=7, ComBitSize=8, ComSignalType=UINT8, ComSystemTemplateSystemSignalRef=OBJ_ID_023
            OBJ_MEASUREMENT_STATUS_023_oRDR_TRACKER_OBJ_023_oPCAN_RADAR_cdc94108_Tx: ComBitPosition=14, ComBitSize=3, ComSignalType=UINT8, ComSystemTemplateSystemSignalRef=OBJ_MEASUREMENT_STATUS_023
            OBJ_MH_CRC16_023_oRDR_TRACKER_OBJ_023_oPCAN_RADAR_b1a9f634_Tx: ComBitPosition=495, ComBitSize=16, ComSignalType=UINT16, ComSystemTemplateSystemSignalRef=OBJ_MH_CRC16_023
            OBJ_MH_CYCLE_COUNTER_023_oRDR_TRACKER_OBJ_023_oPCAN_RADAR_c04dacd5_Tx: ComBitPosition=487, ComBitSize=8, ComSignalType=UINT8, ComSystemTemplateSystemSignalRef=OBJ_MH_CYCLE_COUNTER_023
            OBJ_MOVEMENT_STATUS_023_oRDR_TRACKER_OBJ_023_oPCAN_RADAR_e267d444_Tx: ComBitPosition=196, ComBitSize=3, ComSignalType=UINT8, ComSystemTemplateSystemSignalRef=OBJ_MOVEMENT_STATUS_023
            OBJ_POS_ERR_CRR_COEF_023_oRDR_TRACKER_OBJ_023_oPCAN_RADAR_7218147e_Tx: ComBitPosition=415, ComBitSize=8, ComSignalType=UINT8, ComSystemTemplateSystemSignalRef=OBJ_POS_ERR_CRR_COEF_023
            OBJ_POS_LAT_023_oRDR_TRACKER_OBJ_023_oPCAN_RADAR_90b7e932_Tx: ComBitPosition=79, ComBitSize=16, ComSignalType=UINT16, ComSystemTemplateSystemSignalRef=OBJ_POS_LAT_023
            OBJ_POS_LAT_ERR_023_oRDR_TRACKER_OBJ_023_oPCAN_RADAR_94fbb905_Tx: ComBitPosition=103, ComBitSize=8, ComSignalType=UINT8, ComSystemTemplateSystemSignalRef=OBJ_POS_LAT_ERR_023
            OBJ_POS_LONG_023_oRDR_TRACKER_OBJ_023_oPCAN_RADAR_211702fd_Tx: ComBitPosition=63, ComBitSize=16, ComSignalType=UINT16, ComSystemTemplateSystemSignalRef=OBJ_POS_LONG_023
            OBJ_POS_LONG_ERR_023_oRDR_TRACKER_OBJ_023_oPCAN_RADAR_0d0347e7_Tx: ComBitPosition=95, ComBitSize=8, ComSignalType=UINT8, ComSystemTemplateSystemSignalRef=OBJ_POS_LONG_ERR_023
            OBJ_RCS_023_oRDR_TRACKER_OBJ_023_oPCAN_RADAR_b278bf35_Tx: ComBitPosition=351, ComBitSize=7, ComSignalType=UINT8, ComSystemTemplateSystemSignalRef=OBJ_RCS_023
            OBJ_REF_PT_LAT_OFFSET_023_oRDR_TRACKER_OBJ_023_oPCAN_RADAR_4745d440_Tx: ComBitPosition=370, ComBitSize=14, ComSignalType=UINT16, ComSystemTemplateSystemSignalRef=OBJ_REF_PT_LAT_OFFSET_023
            OBJ_REF_PT_LONG_OFFSET_023_oRDR_TRACKER_OBJ_023_oPCAN_RADAR_08172443_Tx: ComBitPosition=357, ComBitSize=14, ComSignalType=UINT16, ComSystemTemplateSystemSignalRef=OBJ_REF_PT_LONG_OFFSET_023
            OBJ_TIMESTAMP_OFFSET_023_oRDR_TRACKER_OBJ_023_oPCAN_RADAR_b2d4bf63_Tx: ComBitPosition=247, ComBitSize=8, ComSignalType=UINT8, ComSystemTemplateSystemSignalRef=OBJ_TIMESTAMP_OFFSET_023
            OBJ_TRACK_MOTION_MODEL_023_oRDR_TRACKER_OBJ_023_oPCAN_RADAR_7ed7bebe_Tx: ComBitPosition=9, ComBitSize=2, ComSignalType=UINT8, ComSystemTemplateSystemSignalRef=OBJ_TRACK_MOTION_MODEL_023
            OBJ_VEH_TRACK_FLAG_023_oRDR_TRACKER_OBJ_023_oPCAN_RADAR_fcfd48e3_Tx: ComBitPosition=10, ComBitSize=1, ComSignalType=BOOLEAN, ComSystemTemplateSystemSignalRef=OBJ_VEH_TRACK_FLAG_023
            OBJ_VELOCITY_ERR_CRR_COEF_023_oRDR_TRACKER_OBJ_023_oPCAN_RADAR_db62299f_Tx: ComBitPosition=423, ComBitSize=8, ComSignalType=UINT8, ComSystemTemplateSystemSignalRef=OBJ_VELOCITY_ERR_CRR_COEF_023
            OBJ_VELOCITY_LAT_023_oRDR_TRACKER_OBJ_023_oPCAN_RADAR_d4d4ac15_Tx: ComBitPosition=126, ComBitSize=15, ComSignalType=UINT16, ComSystemTemplateSystemSignalRef=OBJ_VELOCITY_LAT_023
            OBJ_VELOCITY_LAT_ERR_023_oRDR_TRACKER_OBJ_023_oPCAN_RADAR_e02edc44_Tx: ComBitPosition=151, ComBitSize=8, ComSignalType=UINT8, ComSystemTemplateSystemSignalRef=OBJ_VELOCITY_LAT_ERR_023
            OBJ_VELOCITY_LONG_023_oRDR_TRACKER_OBJ_023_oPCAN_RADAR_8459d4d3_Tx: ComBitPosition=110, ComBitSize=15, ComSignalType=UINT16, ComSystemTemplateSystemSignalRef=OBJ_VELOCITY_LONG_023
            OBJ_VELOCITY_LONG_ERR_023_oRDR_TRACKER_OBJ_023_oPCAN_RADAR_0cace384_Tx: ComBitPosition=143, ComBitSize=8, ComSignalType=UINT8, ComSystemTemplateSystemSignalRef=OBJ_VELOCITY_LONG_ERR_023
            OBJ_YAW_ANGLE_023_oRDR_TRACKER_OBJ_023_oPCAN_RADAR_3868e855_Tx: ComBitPosition=155, ComBitSize=12, ComSignalType=UINT16, ComSystemTemplateSystemSignalRef=OBJ_YAW_ANGLE_023
            OBJ_YAW_ANGLE_ERR_023_oRDR_TRACKER_OBJ_023_oPCAN_RADAR_ed65ee82_Tx: ComBitPosition=175, ComBitSize=7, ComSignalType=UINT8, ComSystemTemplateSystemSignalRef=OBJ_YAW_ANGLE_ERR_023
            OBJ_YAW_RATE_023_oRDR_TRACKER_OBJ_023_oPCAN_RADAR_1de7cd12_Tx: ComBitPosition=399, ComBitSize=10, ComSignalType=UINT16, ComSystemTemplateSystemSignalRef=OBJ_YAW_RATE_023
            OBJ_YAW_RATE_ERR_023_oRDR_TRACKER_OBJ_023_oPCAN_RADAR_223f5ace_Tx: ComBitPosition=388, ComBitSize=5, ComSignalType=UINT8, ComSystemTemplateSystemSignalRef=OBJ_YAW_RATE_ERR_023
        SG_TrackerObject024_oRDR_TRACKER_OBJ_024_oPCAN_RADAR_ab39351c_Tx: ComSystemTemplateSignalGroupRef=SG_TrackerObject024
          49 x ComGroupSignal, all with ComSignalEndianness=BIG_ENDIAN, ComSignalInitValue=0, ComTransferProperty=PENDING:
            OBJ_ACCELERATION_LAT_024_oRDR_TRACKER_OBJ_024_oPCAN_RADAR_a51d6e6b_Tx: ComBitPosition=177, ComBitSize=10, ComSignalType=UINT16, ComSystemTemplateSystemSignalRef=OBJ_ACCELERATION_LAT_024
            OBJ_ACCELERATION_LAT_ERR_024_oRDR_TRACKER_OBJ_024_oPCAN_RADAR_70e954d5_Tx: ComBitPosition=223, ComBitSize=8, ComSignalType=UINT8, ComSystemTemplateSystemSignalRef=OBJ_ACCELERATION_LAT_ERR_024
            OBJ_ACCELERATION_LONG_024_oRDR_TRACKER_OBJ_024_oPCAN_RADAR_d7ed378b_Tx: ComBitPosition=193, ComBitSize=10, ComSignalType=UINT16, ComSystemTemplateSystemSignalRef=OBJ_ACCELERATION_LONG_024
            OBJ_ACCELERATION_LONG_ERR_024_oRDR_TRACKER_OBJ_024_oPCAN_RADAR_6f4cf17f_Tx: ComBitPosition=215, ComBitSize=8, ComSignalType=UINT8, ComSystemTemplateSystemSignalRef=OBJ_ACCELERATION_LONG_ERR_024
            OBJ_ACCEL_ERR_CRR_COEF_024_oRDR_TRACKER_OBJ_024_oPCAN_RADAR_cfefd019_Tx: ComBitPosition=431, ComBitSize=8, ComSignalType=UINT8, ComSystemTemplateSystemSignalRef=OBJ_ACCEL_ERR_CRR_COEF_024
            OBJ_ALIVE_TIME_024_oRDR_TRACKER_OBJ_024_oPCAN_RADAR_b78c7c37_Tx: ComBitPosition=255, ComBitSize=16, ComSignalType=UINT16, ComSystemTemplateSystemSignalRef=OBJ_ALIVE_TIME_024
            OBJ_CLS_TYPE1_024_oRDR_TRACKER_OBJ_024_oPCAN_RADAR_20579d11_Tx: ComBitPosition=271, ComBitSize=4, ComSignalType=UINT8, ComSystemTemplateSystemSignalRef=OBJ_CLS_TYPE1_024
            OBJ_CLS_TYPE1_PROB_024_oRDR_TRACKER_OBJ_024_oPCAN_RADAR_880f4ae2_Tx: ComBitPosition=303, ComBitSize=8, ComSignalType=UINT8, ComSystemTemplateSystemSignalRef=OBJ_CLS_TYPE1_PROB_024
            OBJ_CLS_TYPE2_024_oRDR_TRACKER_OBJ_024_oPCAN_RADAR_6dbf9d76_Tx: ComBitPosition=267, ComBitSize=4, ComSignalType=UINT8, ComSystemTemplateSystemSignalRef=OBJ_CLS_TYPE2_024
            OBJ_CLS_TYPE2_PROB_024_oRDR_TRACKER_OBJ_024_oPCAN_RADAR_413b51ef_Tx: ComBitPosition=311, ComBitSize=8, ComSignalType=UINT8, ComSystemTemplateSystemSignalRef=OBJ_CLS_TYPE2_PROB_024
            OBJ_CLS_TYPE3_024_oRDR_TRACKER_OBJ_024_oPCAN_RADAR_e0376094_Tx: ComBitPosition=279, ComBitSize=4, ComSignalType=UINT8, ComSystemTemplateSystemSignalRef=OBJ_CLS_TYPE3_024
            OBJ_CLS_TYPE3_PROB_024_oRDR_TRACKER_OBJ_024_oPCAN_RADAR_0628a714_Tx: ComBitPosition=319, ComBitSize=8, ComSignalType=UINT8, ComSystemTemplateSystemSignalRef=OBJ_CLS_TYPE3_PROB_024
            OBJ_CLS_TYPE4_024_oRDR_TRACKER_OBJ_024_oPCAN_RADAR_f66f9db8_Tx: ComBitPosition=275, ComBitSize=4, ComSignalType=UINT8, ComSystemTemplateSystemSignalRef=OBJ_CLS_TYPE4_024
            OBJ_CLS_TYPE4_PROB_024_oRDR_TRACKER_OBJ_024_oPCAN_RADAR_082261b4_Tx: ComBitPosition=327, ComBitSize=8, ComSignalType=UINT8, ComSystemTemplateSystemSignalRef=OBJ_CLS_TYPE4_PROB_024
            OBJ_CLS_TYPE5_024_oRDR_TRACKER_OBJ_024_oPCAN_RADAR_7be7605a_Tx: ComBitPosition=287, ComBitSize=4, ComSignalType=UINT8, ComSystemTemplateSystemSignalRef=OBJ_CLS_TYPE5_024
            OBJ_CLS_TYPE5_PROB_024_oRDR_TRACKER_OBJ_024_oPCAN_RADAR_4f31974f_Tx: ComBitPosition=335, ComBitSize=8, ComSignalType=UINT8, ComSystemTemplateSystemSignalRef=OBJ_CLS_TYPE5_PROB_024
            OBJ_CLS_TYPE6_024_oRDR_TRACKER_OBJ_024_oPCAN_RADAR_360f603d_Tx: ComBitPosition=282, ComBitSize=4, ComSignalType=UINT8, ComSystemTemplateSystemSignalRef=OBJ_CLS_TYPE6_024
            OBJ_CLS_TYPE6_PROB_024_oRDR_TRACKER_OBJ_024_oPCAN_RADAR_86058c42_Tx: ComBitPosition=343, ComBitSize=8, ComSignalType=UINT8, ComSystemTemplateSystemSignalRef=OBJ_CLS_TYPE6_PROB_024
            OBJ_DIMENSION_LENGTH_024_oRDR_TRACKER_OBJ_024_oPCAN_RADAR_62c9ce55_Tx: ComBitPosition=37, ComBitSize=12, ComSignalType=UINT16, ComSystemTemplateSystemSignalRef=OBJ_DIMENSION_LENGTH_024
            OBJ_DIMENSION_LENGTH_ERR_024_oRDR_TRACKER_OBJ_024_oPCAN_RADAR_5931d12f_Tx: ComBitPosition=41, ComBitSize=10, ComSignalType=UINT16, ComSystemTemplateSystemSignalRef=OBJ_DIMENSION_LENGTH_ERR_024
            OBJ_DIMENSION_WIDTH_024_oRDR_TRACKER_OBJ_024_oPCAN_RADAR_410739f8_Tx: ComBitPosition=17, ComBitSize=10, ComSignalType=UINT16, ComSystemTemplateSystemSignalRef=OBJ_DIMENSION_WIDTH_024
            OBJ_DIMENSION_WIDTH_ERR_024_oRDR_TRACKER_OBJ_024_oPCAN_RADAR_a1a5fe10_Tx: ComBitPosition=23, ComBitSize=6, ComSignalType=UINT8, ComSystemTemplateSystemSignalRef=OBJ_DIMENSION_WIDTH_ERR_024
            OBJ_EXISTENCE_PROB_024_oRDR_TRACKER_OBJ_024_oPCAN_RADAR_4abbbdc5_Tx: ComBitPosition=229, ComBitSize=14, ComSignalType=UINT16, ComSystemTemplateSystemSignalRef=OBJ_EXISTENCE_PROB_024
            OBJ_GROUP_ID_024_oRDR_TRACKER_OBJ_024_oPCAN_RADAR_c3c9a968_Tx: ComBitPosition=405, ComBitSize=6, ComSignalType=UINT8, ComSystemTemplateSystemSignalRef=OBJ_GROUP_ID_024
            OBJ_ID_024_oRDR_TRACKER_OBJ_024_oPCAN_RADAR_30e7826f_Tx: ComBitPosition=7, ComBitSize=8, ComSignalType=UINT8, ComSystemTemplateSystemSignalRef=OBJ_ID_024
            OBJ_MEASUREMENT_STATUS_024_oRDR_TRACKER_OBJ_024_oPCAN_RADAR_4f35f0d2_Tx: ComBitPosition=14, ComBitSize=3, ComSignalType=UINT8, ComSystemTemplateSystemSignalRef=OBJ_MEASUREMENT_STATUS_024
            OBJ_MH_CRC16_024_oRDR_TRACKER_OBJ_024_oPCAN_RADAR_335547ee_Tx: ComBitPosition=495, ComBitSize=16, ComSignalType=UINT16, ComSystemTemplateSystemSignalRef=OBJ_MH_CRC16_024
            OBJ_MH_CYCLE_COUNTER_024_oRDR_TRACKER_OBJ_024_oPCAN_RADAR_42b11d0f_Tx: ComBitPosition=487, ComBitSize=8, ComSignalType=UINT8, ComSystemTemplateSystemSignalRef=OBJ_MH_CYCLE_COUNTER_024
            OBJ_MOVEMENT_STATUS_024_oRDR_TRACKER_OBJ_024_oPCAN_RADAR_609b659e_Tx: ComBitPosition=196, ComBitSize=3, ComSignalType=UINT8, ComSystemTemplateSystemSignalRef=OBJ_MOVEMENT_STATUS_024
            OBJ_POS_ERR_CRR_COEF_024_oRDR_TRACKER_OBJ_024_oPCAN_RADAR_f0e4a5a4_Tx: ComBitPosition=415, ComBitSize=8, ComSignalType=UINT8, ComSystemTemplateSystemSignalRef=OBJ_POS_ERR_CRR_COEF_024
            OBJ_POS_LAT_024_oRDR_TRACKER_OBJ_024_oPCAN_RADAR_124b58e8_Tx: ComBitPosition=79, ComBitSize=16, ComSignalType=UINT16, ComSystemTemplateSystemSignalRef=OBJ_POS_LAT_024
            OBJ_POS_LAT_ERR_024_oRDR_TRACKER_OBJ_024_oPCAN_RADAR_160708df_Tx: ComBitPosition=103, ComBitSize=8, ComSignalType=UINT8, ComSystemTemplateSystemSignalRef=OBJ_POS_LAT_ERR_024
            OBJ_POS_LONG_024_oRDR_TRACKER_OBJ_024_oPCAN_RADAR_a3ebb327_Tx: ComBitPosition=63, ComBitSize=16, ComSignalType=UINT16, ComSystemTemplateSystemSignalRef=OBJ_POS_LONG_024
            OBJ_POS_LONG_ERR_024_oRDR_TRACKER_OBJ_024_oPCAN_RADAR_8ffff63d_Tx: ComBitPosition=95, ComBitSize=8, ComSignalType=UINT8, ComSystemTemplateSystemSignalRef=OBJ_POS_LONG_ERR_024
            OBJ_RCS_024_oRDR_TRACKER_OBJ_024_oPCAN_RADAR_30840eef_Tx: ComBitPosition=351, ComBitSize=7, ComSignalType=UINT8, ComSystemTemplateSystemSignalRef=OBJ_RCS_024
            OBJ_REF_PT_LAT_OFFSET_024_oRDR_TRACKER_OBJ_024_oPCAN_RADAR_c5b9659a_Tx: ComBitPosition=370, ComBitSize=14, ComSignalType=UINT16, ComSystemTemplateSystemSignalRef=OBJ_REF_PT_LAT_OFFSET_024
            OBJ_REF_PT_LONG_OFFSET_024_oRDR_TRACKER_OBJ_024_oPCAN_RADAR_8aeb9599_Tx: ComBitPosition=357, ComBitSize=14, ComSignalType=UINT16, ComSystemTemplateSystemSignalRef=OBJ_REF_PT_LONG_OFFSET_024
            OBJ_TIMESTAMP_OFFSET_024_oRDR_TRACKER_OBJ_024_oPCAN_RADAR_30280eb9_Tx: ComBitPosition=247, ComBitSize=8, ComSignalType=UINT8, ComSystemTemplateSystemSignalRef=OBJ_TIMESTAMP_OFFSET_024
            OBJ_TRACK_MOTION_MODEL_024_oRDR_TRACKER_OBJ_024_oPCAN_RADAR_fc2b0f64_Tx: ComBitPosition=9, ComBitSize=2, ComSignalType=UINT8, ComSystemTemplateSystemSignalRef=OBJ_TRACK_MOTION_MODEL_024
            OBJ_VEH_TRACK_FLAG_024_oRDR_TRACKER_OBJ_024_oPCAN_RADAR_7e01f939_Tx: ComBitPosition=10, ComBitSize=1, ComSignalType=BOOLEAN, ComSystemTemplateSystemSignalRef=OBJ_VEH_TRACK_FLAG_024
            OBJ_VELOCITY_ERR_CRR_COEF_024_oRDR_TRACKER_OBJ_024_oPCAN_RADAR_599e9845_Tx: ComBitPosition=423, ComBitSize=8, ComSignalType=UINT8, ComSystemTemplateSystemSignalRef=OBJ_VELOCITY_ERR_CRR_COEF_024
            OBJ_VELOCITY_LAT_024_oRDR_TRACKER_OBJ_024_oPCAN_RADAR_56281dcf_Tx: ComBitPosition=126, ComBitSize=15, ComSignalType=UINT16, ComSystemTemplateSystemSignalRef=OBJ_VELOCITY_LAT_024
            OBJ_VELOCITY_LAT_ERR_024_oRDR_TRACKER_OBJ_024_oPCAN_RADAR_62d26d9e_Tx: ComBitPosition=151, ComBitSize=8, ComSignalType=UINT8, ComSystemTemplateSystemSignalRef=OBJ_VELOCITY_LAT_ERR_024
            OBJ_VELOCITY_LONG_024_oRDR_TRACKER_OBJ_024_oPCAN_RADAR_06a56509_Tx: ComBitPosition=110, ComBitSize=15, ComSignalType=UINT16, ComSystemTemplateSystemSignalRef=OBJ_VELOCITY_LONG_024
            OBJ_VELOCITY_LONG_ERR_024_oRDR_TRACKER_OBJ_024_oPCAN_RADAR_8e50525e_Tx: ComBitPosition=143, ComBitSize=8, ComSignalType=UINT8, ComSystemTemplateSystemSignalRef=OBJ_VELOCITY_LONG_ERR_024
            OBJ_YAW_ANGLE_024_oRDR_TRACKER_OBJ_024_oPCAN_RADAR_ba94598f_Tx: ComBitPosition=155, ComBitSize=12, ComSignalType=UINT16, ComSystemTemplateSystemSignalRef=OBJ_YAW_ANGLE_024
            OBJ_YAW_ANGLE_ERR_024_oRDR_TRACKER_OBJ_024_oPCAN_RADAR_6f995f58_Tx: ComBitPosition=175, ComBitSize=7, ComSignalType=UINT8, ComSystemTemplateSystemSignalRef=OBJ_YAW_ANGLE_ERR_024
            OBJ_YAW_RATE_024_oRDR_TRACKER_OBJ_024_oPCAN_RADAR_9f1b7cc8_Tx: ComBitPosition=399, ComBitSize=10, ComSignalType=UINT16, ComSystemTemplateSystemSignalRef=OBJ_YAW_RATE_024
            OBJ_YAW_RATE_ERR_024_oRDR_TRACKER_OBJ_024_oPCAN_RADAR_a0c3eb14_Tx: ComBitPosition=388, ComBitSize=5, ComSignalType=UINT8, ComSystemTemplateSystemSignalRef=OBJ_YAW_RATE_ERR_024
        SG_TrackerObject025_oRDR_TRACKER_OBJ_025_oPCAN_RADAR_522dbdaf_Tx: ComSystemTemplateSignalGroupRef=SG_TrackerObject025
          49 x ComGroupSignal, all with ComSignalEndianness=BIG_ENDIAN, ComSignalInitValue=0, ComTransferProperty=PENDING:
            OBJ_ACCELERATION_LAT_025_oRDR_TRACKER_OBJ_025_oPCAN_RADAR_5c09e6d8_Tx: ComBitPosition=177, ComBitSize=10, ComSignalType=UINT16, ComSystemTemplateSystemSignalRef=OBJ_ACCELERATION_LAT_025
            OBJ_ACCELERATION_LAT_ERR_025_oRDR_TRACKER_OBJ_025_oPCAN_RADAR_89fddc66_Tx: ComBitPosition=223, ComBitSize=8, ComSignalType=UINT8, ComSystemTemplateSystemSignalRef=OBJ_ACCELERATION_LAT_ERR_025
            OBJ_ACCELERATION_LONG_025_oRDR_TRACKER_OBJ_025_oPCAN_RADAR_2ef9bf38_Tx: ComBitPosition=193, ComBitSize=10, ComSignalType=UINT16, ComSystemTemplateSystemSignalRef=OBJ_ACCELERATION_LONG_025
            OBJ_ACCELERATION_LONG_ERR_025_oRDR_TRACKER_OBJ_025_oPCAN_RADAR_965879cc_Tx: ComBitPosition=215, ComBitSize=8, ComSignalType=UINT8, ComSystemTemplateSystemSignalRef=OBJ_ACCELERATION_LONG_ERR_025
            OBJ_ACCEL_ERR_CRR_COEF_025_oRDR_TRACKER_OBJ_025_oPCAN_RADAR_36fb58aa_Tx: ComBitPosition=431, ComBitSize=8, ComSignalType=UINT8, ComSystemTemplateSystemSignalRef=OBJ_ACCEL_ERR_CRR_COEF_025
            OBJ_ALIVE_TIME_025_oRDR_TRACKER_OBJ_025_oPCAN_RADAR_4e98f484_Tx: ComBitPosition=255, ComBitSize=16, ComSignalType=UINT16, ComSystemTemplateSystemSignalRef=OBJ_ALIVE_TIME_025
            OBJ_CLS_TYPE1_025_oRDR_TRACKER_OBJ_025_oPCAN_RADAR_d94315a2_Tx: ComBitPosition=271, ComBitSize=4, ComSignalType=UINT8, ComSystemTemplateSystemSignalRef=OBJ_CLS_TYPE1_025
            OBJ_CLS_TYPE1_PROB_025_oRDR_TRACKER_OBJ_025_oPCAN_RADAR_711bc251_Tx: ComBitPosition=303, ComBitSize=8, ComSignalType=UINT8, ComSystemTemplateSystemSignalRef=OBJ_CLS_TYPE1_PROB_025
            OBJ_CLS_TYPE2_025_oRDR_TRACKER_OBJ_025_oPCAN_RADAR_94ab15c5_Tx: ComBitPosition=267, ComBitSize=4, ComSignalType=UINT8, ComSystemTemplateSystemSignalRef=OBJ_CLS_TYPE2_025
            OBJ_CLS_TYPE2_PROB_025_oRDR_TRACKER_OBJ_025_oPCAN_RADAR_b82fd95c_Tx: ComBitPosition=311, ComBitSize=8, ComSignalType=UINT8, ComSystemTemplateSystemSignalRef=OBJ_CLS_TYPE2_PROB_025
            OBJ_CLS_TYPE3_025_oRDR_TRACKER_OBJ_025_oPCAN_RADAR_1923e827_Tx: ComBitPosition=279, ComBitSize=4, ComSignalType=UINT8, ComSystemTemplateSystemSignalRef=OBJ_CLS_TYPE3_025
            OBJ_CLS_TYPE3_PROB_025_oRDR_TRACKER_OBJ_025_oPCAN_RADAR_ff3c2fa7_Tx: ComBitPosition=319, ComBitSize=8, ComSignalType=UINT8, ComSystemTemplateSystemSignalRef=OBJ_CLS_TYPE3_PROB_025
            OBJ_CLS_TYPE4_025_oRDR_TRACKER_OBJ_025_oPCAN_RADAR_0f7b150b_Tx: ComBitPosition=275, ComBitSize=4, ComSignalType=UINT8, ComSystemTemplateSystemSignalRef=OBJ_CLS_TYPE4_025
            OBJ_CLS_TYPE4_PROB_025_oRDR_TRACKER_OBJ_025_oPCAN_RADAR_f136e907_Tx: ComBitPosition=327, ComBitSize=8, ComSignalType=UINT8, ComSystemTemplateSystemSignalRef=OBJ_CLS_TYPE4_PROB_025
            OBJ_CLS_TYPE5_025_oRDR_TRACKER_OBJ_025_oPCAN_RADAR_82f3e8e9_Tx: ComBitPosition=287, ComBitSize=4, ComSignalType=UINT8, ComSystemTemplateSystemSignalRef=OBJ_CLS_TYPE5_025
            OBJ_CLS_TYPE5_PROB_025_oRDR_TRACKER_OBJ_025_oPCAN_RADAR_b6251ffc_Tx: ComBitPosition=335, ComBitSize=8, ComSignalType=UINT8, ComSystemTemplateSystemSignalRef=OBJ_CLS_TYPE5_PROB_025
            OBJ_CLS_TYPE6_025_oRDR_TRACKER_OBJ_025_oPCAN_RADAR_cf1be88e_Tx: ComBitPosition=282, ComBitSize=4, ComSignalType=UINT8, ComSystemTemplateSystemSignalRef=OBJ_CLS_TYPE6_025
            OBJ_CLS_TYPE6_PROB_025_oRDR_TRACKER_OBJ_025_oPCAN_RADAR_7f1104f1_Tx: ComBitPosition=343, ComBitSize=8, ComSignalType=UINT8, ComSystemTemplateSystemSignalRef=OBJ_CLS_TYPE6_PROB_025
            OBJ_DIMENSION_LENGTH_025_oRDR_TRACKER_OBJ_025_oPCAN_RADAR_9bdd46e6_Tx: ComBitPosition=37, ComBitSize=12, ComSignalType=UINT16, ComSystemTemplateSystemSignalRef=OBJ_DIMENSION_LENGTH_025
            OBJ_DIMENSION_LENGTH_ERR_025_oRDR_TRACKER_OBJ_025_oPCAN_RADAR_a025599c_Tx: ComBitPosition=41, ComBitSize=10, ComSignalType=UINT16, ComSystemTemplateSystemSignalRef=OBJ_DIMENSION_LENGTH_ERR_025
            OBJ_DIMENSION_WIDTH_025_oRDR_TRACKER_OBJ_025_oPCAN_RADAR_b813b14b_Tx: ComBitPosition=17, ComBitSize=10, ComSignalType=UINT16, ComSystemTemplateSystemSignalRef=OBJ_DIMENSION_WIDTH_025
            OBJ_DIMENSION_WIDTH_ERR_025_oRDR_TRACKER_OBJ_025_oPCAN_RADAR_58b176a3_Tx: ComBitPosition=23, ComBitSize=6, ComSignalType=UINT8, ComSystemTemplateSystemSignalRef=OBJ_DIMENSION_WIDTH_ERR_025
            OBJ_EXISTENCE_PROB_025_oRDR_TRACKER_OBJ_025_oPCAN_RADAR_b3af3576_Tx: ComBitPosition=229, ComBitSize=14, ComSignalType=UINT16, ComSystemTemplateSystemSignalRef=OBJ_EXISTENCE_PROB_025
            OBJ_GROUP_ID_025_oRDR_TRACKER_OBJ_025_oPCAN_RADAR_3add21db_Tx: ComBitPosition=405, ComBitSize=6, ComSignalType=UINT8, ComSystemTemplateSystemSignalRef=OBJ_GROUP_ID_025
            OBJ_ID_025_oRDR_TRACKER_OBJ_025_oPCAN_RADAR_c9f30adc_Tx: ComBitPosition=7, ComBitSize=8, ComSignalType=UINT8, ComSystemTemplateSystemSignalRef=OBJ_ID_025
            OBJ_MEASUREMENT_STATUS_025_oRDR_TRACKER_OBJ_025_oPCAN_RADAR_b6217861_Tx: ComBitPosition=14, ComBitSize=3, ComSignalType=UINT8, ComSystemTemplateSystemSignalRef=OBJ_MEASUREMENT_STATUS_025
            OBJ_MH_CRC16_025_oRDR_TRACKER_OBJ_025_oPCAN_RADAR_ca41cf5d_Tx: ComBitPosition=495, ComBitSize=16, ComSignalType=UINT16, ComSystemTemplateSystemSignalRef=OBJ_MH_CRC16_025
            OBJ_MH_CYCLE_COUNTER_025_oRDR_TRACKER_OBJ_025_oPCAN_RADAR_bba595bc_Tx: ComBitPosition=487, ComBitSize=8, ComSignalType=UINT8, ComSystemTemplateSystemSignalRef=OBJ_MH_CYCLE_COUNTER_025
            OBJ_MOVEMENT_STATUS_025_oRDR_TRACKER_OBJ_025_oPCAN_RADAR_998fed2d_Tx: ComBitPosition=196, ComBitSize=3, ComSignalType=UINT8, ComSystemTemplateSystemSignalRef=OBJ_MOVEMENT_STATUS_025
            OBJ_POS_ERR_CRR_COEF_025_oRDR_TRACKER_OBJ_025_oPCAN_RADAR_09f02d17_Tx: ComBitPosition=415, ComBitSize=8, ComSignalType=UINT8, ComSystemTemplateSystemSignalRef=OBJ_POS_ERR_CRR_COEF_025
            OBJ_POS_LAT_025_oRDR_TRACKER_OBJ_025_oPCAN_RADAR_eb5fd05b_Tx: ComBitPosition=79, ComBitSize=16, ComSignalType=UINT16, ComSystemTemplateSystemSignalRef=OBJ_POS_LAT_025
            OBJ_POS_LAT_ERR_025_oRDR_TRACKER_OBJ_025_oPCAN_RADAR_ef13806c_Tx: ComBitPosition=103, ComBitSize=8, ComSignalType=UINT8, ComSystemTemplateSystemSignalRef=OBJ_POS_LAT_ERR_025
            OBJ_POS_LONG_025_oRDR_TRACKER_OBJ_025_oPCAN_RADAR_5aff3b94_Tx: ComBitPosition=63, ComBitSize=16, ComSignalType=UINT16, ComSystemTemplateSystemSignalRef=OBJ_POS_LONG_025
            OBJ_POS_LONG_ERR_025_oRDR_TRACKER_OBJ_025_oPCAN_RADAR_76eb7e8e_Tx: ComBitPosition=95, ComBitSize=8, ComSignalType=UINT8, ComSystemTemplateSystemSignalRef=OBJ_POS_LONG_ERR_025
            OBJ_RCS_025_oRDR_TRACKER_OBJ_025_oPCAN_RADAR_c990865c_Tx: ComBitPosition=351, ComBitSize=7, ComSignalType=UINT8, ComSystemTemplateSystemSignalRef=OBJ_RCS_025
            OBJ_REF_PT_LAT_OFFSET_025_oRDR_TRACKER_OBJ_025_oPCAN_RADAR_3caded29_Tx: ComBitPosition=370, ComBitSize=14, ComSignalType=UINT16, ComSystemTemplateSystemSignalRef=OBJ_REF_PT_LAT_OFFSET_025
            OBJ_REF_PT_LONG_OFFSET_025_oRDR_TRACKER_OBJ_025_oPCAN_RADAR_73ff1d2a_Tx: ComBitPosition=357, ComBitSize=14, ComSignalType=UINT16, ComSystemTemplateSystemSignalRef=OBJ_REF_PT_LONG_OFFSET_025
            OBJ_TIMESTAMP_OFFSET_025_oRDR_TRACKER_OBJ_025_oPCAN_RADAR_c93c860a_Tx: ComBitPosition=247, ComBitSize=8, ComSignalType=UINT8, ComSystemTemplateSystemSignalRef=OBJ_TIMESTAMP_OFFSET_025
            OBJ_TRACK_MOTION_MODEL_025_oRDR_TRACKER_OBJ_025_oPCAN_RADAR_053f87d7_Tx: ComBitPosition=9, ComBitSize=2, ComSignalType=UINT8, ComSystemTemplateSystemSignalRef=OBJ_TRACK_MOTION_MODEL_025
            OBJ_VEH_TRACK_FLAG_025_oRDR_TRACKER_OBJ_025_oPCAN_RADAR_8715718a_Tx: ComBitPosition=10, ComBitSize=1, ComSignalType=BOOLEAN, ComSystemTemplateSystemSignalRef=OBJ_VEH_TRACK_FLAG_025
            OBJ_VELOCITY_ERR_CRR_COEF_025_oRDR_TRACKER_OBJ_025_oPCAN_RADAR_a08a10f6_Tx: ComBitPosition=423, ComBitSize=8, ComSignalType=UINT8, ComSystemTemplateSystemSignalRef=OBJ_VELOCITY_ERR_CRR_COEF_025
            OBJ_VELOCITY_LAT_025_oRDR_TRACKER_OBJ_025_oPCAN_RADAR_af3c957c_Tx: ComBitPosition=126, ComBitSize=15, ComSignalType=UINT16, ComSystemTemplateSystemSignalRef=OBJ_VELOCITY_LAT_025
            OBJ_VELOCITY_LAT_ERR_025_oRDR_TRACKER_OBJ_025_oPCAN_RADAR_9bc6e52d_Tx: ComBitPosition=151, ComBitSize=8, ComSignalType=UINT8, ComSystemTemplateSystemSignalRef=OBJ_VELOCITY_LAT_ERR_025
            OBJ_VELOCITY_LONG_025_oRDR_TRACKER_OBJ_025_oPCAN_RADAR_ffb1edba_Tx: ComBitPosition=110, ComBitSize=15, ComSignalType=UINT16, ComSystemTemplateSystemSignalRef=OBJ_VELOCITY_LONG_025
            OBJ_VELOCITY_LONG_ERR_025_oRDR_TRACKER_OBJ_025_oPCAN_RADAR_7744daed_Tx: ComBitPosition=143, ComBitSize=8, ComSignalType=UINT8, ComSystemTemplateSystemSignalRef=OBJ_VELOCITY_LONG_ERR_025
            OBJ_YAW_ANGLE_025_oRDR_TRACKER_OBJ_025_oPCAN_RADAR_4380d13c_Tx: ComBitPosition=155, ComBitSize=12, ComSignalType=UINT16, ComSystemTemplateSystemSignalRef=OBJ_YAW_ANGLE_025
            OBJ_YAW_ANGLE_ERR_025_oRDR_TRACKER_OBJ_025_oPCAN_RADAR_968dd7eb_Tx: ComBitPosition=175, ComBitSize=7, ComSignalType=UINT8, ComSystemTemplateSystemSignalRef=OBJ_YAW_ANGLE_ERR_025
            OBJ_YAW_RATE_025_oRDR_TRACKER_OBJ_025_oPCAN_RADAR_660ff47b_Tx: ComBitPosition=399, ComBitSize=10, ComSignalType=UINT16, ComSystemTemplateSystemSignalRef=OBJ_YAW_RATE_025
            OBJ_YAW_RATE_ERR_025_oRDR_TRACKER_OBJ_025_oPCAN_RADAR_59d763a7_Tx: ComBitPosition=388, ComBitSize=5, ComSignalType=UINT8, ComSystemTemplateSystemSignalRef=OBJ_YAW_RATE_ERR_025
        SG_TrackerObject026_oRDR_TRACKER_OBJ_026_oPCAN_RADAR_8261223b_Tx: ComSystemTemplateSignalGroupRef=SG_TrackerObject026
          49 x ComGroupSignal, all with ComSignalEndianness=BIG_ENDIAN, ComSignalInitValue=0, ComTransferProperty=PENDING:
            OBJ_ACCELERATION_LAT_026_oRDR_TRACKER_OBJ_026_oPCAN_RADAR_8c45794c_Tx: ComBitPosition=177, ComBitSize=10, ComSignalType=UINT16, ComSystemTemplateSystemSignalRef=OBJ_ACCELERATION_LAT_026
            OBJ_ACCELERATION_LAT_ERR_026_oRDR_TRACKER_OBJ_026_oPCAN_RADAR_59b143f2_Tx: ComBitPosition=223, ComBitSize=8, ComSignalType=UINT8, ComSystemTemplateSystemSignalRef=OBJ_ACCELERATION_LAT_ERR_026
            OBJ_ACCELERATION_LONG_026_oRDR_TRACKER_OBJ_026_oPCAN_RADAR_feb520ac_Tx: ComBitPosition=193, ComBitSize=10, ComSignalType=UINT16, ComSystemTemplateSystemSignalRef=OBJ_ACCELERATION_LONG_026
            OBJ_ACCELERATION_LONG_ERR_026_oRDR_TRACKER_OBJ_026_oPCAN_RADAR_4614e658_Tx: ComBitPosition=215, ComBitSize=8, ComSignalType=UINT8, ComSystemTemplateSystemSignalRef=OBJ_ACCELERATION_LONG_ERR_026
            OBJ_ACCEL_ERR_CRR_COEF_026_oRDR_TRACKER_OBJ_026_oPCAN_RADAR_e6b7c73e_Tx: ComBitPosition=431, ComBitSize=8, ComSignalType=UINT8, ComSystemTemplateSystemSignalRef=OBJ_ACCEL_ERR_CRR_COEF_026
            OBJ_ALIVE_TIME_026_oRDR_TRACKER_OBJ_026_oPCAN_RADAR_9ed46b10_Tx: ComBitPosition=255, ComBitSize=16, ComSignalType=UINT16, ComSystemTemplateSystemSignalRef=OBJ_ALIVE_TIME_026
            OBJ_CLS_TYPE1_026_oRDR_TRACKER_OBJ_026_oPCAN_RADAR_090f8a36_Tx: ComBitPosition=271, ComBitSize=4, ComSignalType=UINT8, ComSystemTemplateSystemSignalRef=OBJ_CLS_TYPE1_026
            OBJ_CLS_TYPE1_PROB_026_oRDR_TRACKER_OBJ_026_oPCAN_RADAR_a1575dc5_Tx: ComBitPosition=303, ComBitSize=8, ComSignalType=UINT8, ComSystemTemplateSystemSignalRef=OBJ_CLS_TYPE1_PROB_026
            OBJ_CLS_TYPE2_026_oRDR_TRACKER_OBJ_026_oPCAN_RADAR_44e78a51_Tx: ComBitPosition=267, ComBitSize=4, ComSignalType=UINT8, ComSystemTemplateSystemSignalRef=OBJ_CLS_TYPE2_026
            OBJ_CLS_TYPE2_PROB_026_oRDR_TRACKER_OBJ_026_oPCAN_RADAR_686346c8_Tx: ComBitPosition=311, ComBitSize=8, ComSignalType=UINT8, ComSystemTemplateSystemSignalRef=OBJ_CLS_TYPE2_PROB_026
            OBJ_CLS_TYPE3_026_oRDR_TRACKER_OBJ_026_oPCAN_RADAR_c96f77b3_Tx: ComBitPosition=279, ComBitSize=4, ComSignalType=UINT8, ComSystemTemplateSystemSignalRef=OBJ_CLS_TYPE3_026
            OBJ_CLS_TYPE3_PROB_026_oRDR_TRACKER_OBJ_026_oPCAN_RADAR_2f70b033_Tx: ComBitPosition=319, ComBitSize=8, ComSignalType=UINT8, ComSystemTemplateSystemSignalRef=OBJ_CLS_TYPE3_PROB_026
            OBJ_CLS_TYPE4_026_oRDR_TRACKER_OBJ_026_oPCAN_RADAR_df378a9f_Tx: ComBitPosition=275, ComBitSize=4, ComSignalType=UINT8, ComSystemTemplateSystemSignalRef=OBJ_CLS_TYPE4_026
            OBJ_CLS_TYPE4_PROB_026_oRDR_TRACKER_OBJ_026_oPCAN_RADAR_217a7693_Tx: ComBitPosition=327, ComBitSize=8, ComSignalType=UINT8, ComSystemTemplateSystemSignalRef=OBJ_CLS_TYPE4_PROB_026
            OBJ_CLS_TYPE5_026_oRDR_TRACKER_OBJ_026_oPCAN_RADAR_52bf777d_Tx: ComBitPosition=287, ComBitSize=4, ComSignalType=UINT8, ComSystemTemplateSystemSignalRef=OBJ_CLS_TYPE5_026
            OBJ_CLS_TYPE5_PROB_026_oRDR_TRACKER_OBJ_026_oPCAN_RADAR_66698068_Tx: ComBitPosition=335, ComBitSize=8, ComSignalType=UINT8, ComSystemTemplateSystemSignalRef=OBJ_CLS_TYPE5_PROB_026
            OBJ_CLS_TYPE6_026_oRDR_TRACKER_OBJ_026_oPCAN_RADAR_1f57771a_Tx: ComBitPosition=282, ComBitSize=4, ComSignalType=UINT8, ComSystemTemplateSystemSignalRef=OBJ_CLS_TYPE6_026
            OBJ_CLS_TYPE6_PROB_026_oRDR_TRACKER_OBJ_026_oPCAN_RADAR_af5d9b65_Tx: ComBitPosition=343, ComBitSize=8, ComSignalType=UINT8, ComSystemTemplateSystemSignalRef=OBJ_CLS_TYPE6_PROB_026
            OBJ_DIMENSION_LENGTH_026_oRDR_TRACKER_OBJ_026_oPCAN_RADAR_4b91d972_Tx: ComBitPosition=37, ComBitSize=12, ComSignalType=UINT16, ComSystemTemplateSystemSignalRef=OBJ_DIMENSION_LENGTH_026
            OBJ_DIMENSION_LENGTH_ERR_026_oRDR_TRACKER_OBJ_026_oPCAN_RADAR_7069c608_Tx: ComBitPosition=41, ComBitSize=10, ComSignalType=UINT16, ComSystemTemplateSystemSignalRef=OBJ_DIMENSION_LENGTH_ERR_026
            OBJ_DIMENSION_WIDTH_026_oRDR_TRACKER_OBJ_026_oPCAN_RADAR_685f2edf_Tx: ComBitPosition=17, ComBitSize=10, ComSignalType=UINT16, ComSystemTemplateSystemSignalRef=OBJ_DIMENSION_WIDTH_026
            OBJ_DIMENSION_WIDTH_ERR_026_oRDR_TRACKER_OBJ_026_oPCAN_RADAR_88fde937_Tx: ComBitPosition=23, ComBitSize=6, ComSignalType=UINT8, ComSystemTemplateSystemSignalRef=OBJ_DIMENSION_WIDTH_ERR_026
            OBJ_EXISTENCE_PROB_026_oRDR_TRACKER_OBJ_026_oPCAN_RADAR_63e3aae2_Tx: ComBitPosition=229, ComBitSize=14, ComSignalType=UINT16, ComSystemTemplateSystemSignalRef=OBJ_EXISTENCE_PROB_026
            OBJ_GROUP_ID_026_oRDR_TRACKER_OBJ_026_oPCAN_RADAR_ea91be4f_Tx: ComBitPosition=405, ComBitSize=6, ComSignalType=UINT8, ComSystemTemplateSystemSignalRef=OBJ_GROUP_ID_026
            OBJ_ID_026_oRDR_TRACKER_OBJ_026_oPCAN_RADAR_19bf9548_Tx: ComBitPosition=7, ComBitSize=8, ComSignalType=UINT8, ComSystemTemplateSystemSignalRef=OBJ_ID_026
            OBJ_MEASUREMENT_STATUS_026_oRDR_TRACKER_OBJ_026_oPCAN_RADAR_666de7f5_Tx: ComBitPosition=14, ComBitSize=3, ComSignalType=UINT8, ComSystemTemplateSystemSignalRef=OBJ_MEASUREMENT_STATUS_026
            OBJ_MH_CRC16_026_oRDR_TRACKER_OBJ_026_oPCAN_RADAR_1a0d50c9_Tx: ComBitPosition=495, ComBitSize=16, ComSignalType=UINT16, ComSystemTemplateSystemSignalRef=OBJ_MH_CRC16_026
            OBJ_MH_CYCLE_COUNTER_026_oRDR_TRACKER_OBJ_026_oPCAN_RADAR_6be90a28_Tx: ComBitPosition=487, ComBitSize=8, ComSignalType=UINT8, ComSystemTemplateSystemSignalRef=OBJ_MH_CYCLE_COUNTER_026
            OBJ_MOVEMENT_STATUS_026_oRDR_TRACKER_OBJ_026_oPCAN_RADAR_49c372b9_Tx: ComBitPosition=196, ComBitSize=3, ComSignalType=UINT8, ComSystemTemplateSystemSignalRef=OBJ_MOVEMENT_STATUS_026
            OBJ_POS_ERR_CRR_COEF_026_oRDR_TRACKER_OBJ_026_oPCAN_RADAR_d9bcb283_Tx: ComBitPosition=415, ComBitSize=8, ComSignalType=UINT8, ComSystemTemplateSystemSignalRef=OBJ_POS_ERR_CRR_COEF_026
            OBJ_POS_LAT_026_oRDR_TRACKER_OBJ_026_oPCAN_RADAR_3b134fcf_Tx: ComBitPosition=79, ComBitSize=16, ComSignalType=UINT16, ComSystemTemplateSystemSignalRef=OBJ_POS_LAT_026
            OBJ_POS_LAT_ERR_026_oRDR_TRACKER_OBJ_026_oPCAN_RADAR_3f5f1ff8_Tx: ComBitPosition=103, ComBitSize=8, ComSignalType=UINT8, ComSystemTemplateSystemSignalRef=OBJ_POS_LAT_ERR_026
            OBJ_POS_LONG_026_oRDR_TRACKER_OBJ_026_oPCAN_RADAR_8ab3a400_Tx: ComBitPosition=63, ComBitSize=16, ComSignalType=UINT16, ComSystemTemplateSystemSignalRef=OBJ_POS_LONG_026
            OBJ_POS_LONG_ERR_026_oRDR_TRACKER_OBJ_026_oPCAN_RADAR_a6a7e11a_Tx: ComBitPosition=95, ComBitSize=8, ComSignalType=UINT8, ComSystemTemplateSystemSignalRef=OBJ_POS_LONG_ERR_026
            OBJ_RCS_026_oRDR_TRACKER_OBJ_026_oPCAN_RADAR_19dc19c8_Tx: ComBitPosition=351, ComBitSize=7, ComSignalType=UINT8, ComSystemTemplateSystemSignalRef=OBJ_RCS_026
            OBJ_REF_PT_LAT_OFFSET_026_oRDR_TRACKER_OBJ_026_oPCAN_RADAR_ece172bd_Tx: ComBitPosition=370, ComBitSize=14, ComSignalType=UINT16, ComSystemTemplateSystemSignalRef=OBJ_REF_PT_LAT_OFFSET_026
            OBJ_REF_PT_LONG_OFFSET_026_oRDR_TRACKER_OBJ_026_oPCAN_RADAR_a3b382be_Tx: ComBitPosition=357, ComBitSize=14, ComSignalType=UINT16, ComSystemTemplateSystemSignalRef=OBJ_REF_PT_LONG_OFFSET_026
            OBJ_TIMESTAMP_OFFSET_026_oRDR_TRACKER_OBJ_026_oPCAN_RADAR_1970199e_Tx: ComBitPosition=247, ComBitSize=8, ComSignalType=UINT8, ComSystemTemplateSystemSignalRef=OBJ_TIMESTAMP_OFFSET_026
            OBJ_TRACK_MOTION_MODEL_026_oRDR_TRACKER_OBJ_026_oPCAN_RADAR_d5731843_Tx: ComBitPosition=9, ComBitSize=2, ComSignalType=UINT8, ComSystemTemplateSystemSignalRef=OBJ_TRACK_MOTION_MODEL_026
            OBJ_VEH_TRACK_FLAG_026_oRDR_TRACKER_OBJ_026_oPCAN_RADAR_5759ee1e_Tx: ComBitPosition=10, ComBitSize=1, ComSignalType=BOOLEAN, ComSystemTemplateSystemSignalRef=OBJ_VEH_TRACK_FLAG_026
            OBJ_VELOCITY_ERR_CRR_COEF_026_oRDR_TRACKER_OBJ_026_oPCAN_RADAR_70c68f62_Tx: ComBitPosition=423, ComBitSize=8, ComSignalType=UINT8, ComSystemTemplateSystemSignalRef=OBJ_VELOCITY_ERR_CRR_COEF_026
            OBJ_VELOCITY_LAT_026_oRDR_TRACKER_OBJ_026_oPCAN_RADAR_7f700ae8_Tx: ComBitPosition=126, ComBitSize=15, ComSignalType=UINT16, ComSystemTemplateSystemSignalRef=OBJ_VELOCITY_LAT_026
            OBJ_VELOCITY_LAT_ERR_026_oRDR_TRACKER_OBJ_026_oPCAN_RADAR_4b8a7ab9_Tx: ComBitPosition=151, ComBitSize=8, ComSignalType=UINT8, ComSystemTemplateSystemSignalRef=OBJ_VELOCITY_LAT_ERR_026
            OBJ_VELOCITY_LONG_026_oRDR_TRACKER_OBJ_026_oPCAN_RADAR_2ffd722e_Tx: ComBitPosition=110, ComBitSize=15, ComSignalType=UINT16, ComSystemTemplateSystemSignalRef=OBJ_VELOCITY_LONG_026
            OBJ_VELOCITY_LONG_ERR_026_oRDR_TRACKER_OBJ_026_oPCAN_RADAR_a7084579_Tx: ComBitPosition=143, ComBitSize=8, ComSignalType=UINT8, ComSystemTemplateSystemSignalRef=OBJ_VELOCITY_LONG_ERR_026
            OBJ_YAW_ANGLE_026_oRDR_TRACKER_OBJ_026_oPCAN_RADAR_93cc4ea8_Tx: ComBitPosition=155, ComBitSize=12, ComSignalType=UINT16, ComSystemTemplateSystemSignalRef=OBJ_YAW_ANGLE_026
            OBJ_YAW_ANGLE_ERR_026_oRDR_TRACKER_OBJ_026_oPCAN_RADAR_46c1487f_Tx: ComBitPosition=175, ComBitSize=7, ComSignalType=UINT8, ComSystemTemplateSystemSignalRef=OBJ_YAW_ANGLE_ERR_026
            OBJ_YAW_RATE_026_oRDR_TRACKER_OBJ_026_oPCAN_RADAR_b6436bef_Tx: ComBitPosition=399, ComBitSize=10, ComSignalType=UINT16, ComSystemTemplateSystemSignalRef=OBJ_YAW_RATE_026
            OBJ_YAW_RATE_ERR_026_oRDR_TRACKER_OBJ_026_oPCAN_RADAR_899bfc33_Tx: ComBitPosition=388, ComBitSize=5, ComSignalType=UINT8, ComSystemTemplateSystemSignalRef=OBJ_YAW_RATE_ERR_026
        SG_TrackerObject027_oRDR_TRACKER_OBJ_027_oPCAN_RADAR_7b75aa88_Tx: ComSystemTemplateSignalGroupRef=SG_TrackerObject027
          49 x ComGroupSignal, all with ComSignalEndianness=BIG_ENDIAN, ComSignalInitValue=0, ComTransferProperty=PENDING:
            OBJ_ACCELERATION_LAT_027_oRDR_TRACKER_OBJ_027_oPCAN_RADAR_7551f1ff_Tx: ComBitPosition=177, ComBitSize=10, ComSignalType=UINT16, ComSystemTemplateSystemSignalRef=OBJ_ACCELERATION_LAT_027
            OBJ_ACCELERATION_LAT_ERR_027_oRDR_TRACKER_OBJ_027_oPCAN_RADAR_a0a5cb41_Tx: ComBitPosition=223, ComBitSize=8, ComSignalType=UINT8, ComSystemTemplateSystemSignalRef=OBJ_ACCELERATION_LAT_ERR_027
            OBJ_ACCELERATION_LONG_027_oRDR_TRACKER_OBJ_027_oPCAN_RADAR_07a1a81f_Tx: ComBitPosition=193, ComBitSize=10, ComSignalType=UINT16, ComSystemTemplateSystemSignalRef=OBJ_ACCELERATION_LONG_027
            OBJ_ACCELERATION_LONG_ERR_027_oRDR_TRACKER_OBJ_027_oPCAN_RADAR_bf006eeb_Tx: ComBitPosition=215, ComBitSize=8, ComSignalType=UINT8, ComSystemTemplateSystemSignalRef=OBJ_ACCELERATION_LONG_ERR_027
            OBJ_ACCEL_ERR_CRR_COEF_027_oRDR_TRACKER_OBJ_027_oPCAN_RADAR_1fa34f8d_Tx: ComBitPosition=431, ComBitSize=8, ComSignalType=UINT8, ComSystemTemplateSystemSignalRef=OBJ_ACCEL_ERR_CRR_COEF_027
            OBJ_ALIVE_TIME_027_oRDR_TRACKER_OBJ_027_oPCAN_RADAR_67c0e3a3_Tx: ComBitPosition=255, ComBitSize=16, ComSignalType=UINT16, ComSystemTemplateSystemSignalRef=OBJ_ALIVE_TIME_027
            OBJ_CLS_TYPE1_027_oRDR_TRACKER_OBJ_027_oPCAN_RADAR_f01b0285_Tx: ComBitPosition=271, ComBitSize=4, ComSignalType=UINT8, ComSystemTemplateSystemSignalRef=OBJ_CLS_TYPE1_027
            OBJ_CLS_TYPE1_PROB_027_oRDR_TRACKER_OBJ_027_oPCAN_RADAR_5843d576_Tx: ComBitPosition=303, ComBitSize=8, ComSignalType=UINT8, ComSystemTemplateSystemSignalRef=OBJ_CLS_TYPE1_PROB_027
            OBJ_CLS_TYPE2_027_oRDR_TRACKER_OBJ_027_oPCAN_RADAR_bdf302e2_Tx: ComBitPosition=267, ComBitSize=4, ComSignalType=UINT8, ComSystemTemplateSystemSignalRef=OBJ_CLS_TYPE2_027
            OBJ_CLS_TYPE2_PROB_027_oRDR_TRACKER_OBJ_027_oPCAN_RADAR_9177ce7b_Tx: ComBitPosition=311, ComBitSize=8, ComSignalType=UINT8, ComSystemTemplateSystemSignalRef=OBJ_CLS_TYPE2_PROB_027
            OBJ_CLS_TYPE3_027_oRDR_TRACKER_OBJ_027_oPCAN_RADAR_307bff00_Tx: ComBitPosition=279, ComBitSize=4, ComSignalType=UINT8, ComSystemTemplateSystemSignalRef=OBJ_CLS_TYPE3_027
            OBJ_CLS_TYPE3_PROB_027_oRDR_TRACKER_OBJ_027_oPCAN_RADAR_d6643880_Tx: ComBitPosition=319, ComBitSize=8, ComSignalType=UINT8, ComSystemTemplateSystemSignalRef=OBJ_CLS_TYPE3_PROB_027
            OBJ_CLS_TYPE4_027_oRDR_TRACKER_OBJ_027_oPCAN_RADAR_2623022c_Tx: ComBitPosition=275, ComBitSize=4, ComSignalType=UINT8, ComSystemTemplateSystemSignalRef=OBJ_CLS_TYPE4_027
            OBJ_CLS_TYPE4_PROB_027_oRDR_TRACKER_OBJ_027_oPCAN_RADAR_d86efe20_Tx: ComBitPosition=327, ComBitSize=8, ComSignalType=UINT8, ComSystemTemplateSystemSignalRef=OBJ_CLS_TYPE4_PROB_027
            OBJ_CLS_TYPE5_027_oRDR_TRACKER_OBJ_027_oPCAN_RADAR_ababffce_Tx: ComBitPosition=287, ComBitSize=4, ComSignalType=UINT8, ComSystemTemplateSystemSignalRef=OBJ_CLS_TYPE5_027
            OBJ_CLS_TYPE5_PROB_027_oRDR_TRACKER_OBJ_027_oPCAN_RADAR_9f7d08db_Tx: ComBitPosition=335, ComBitSize=8, ComSignalType=UINT8, ComSystemTemplateSystemSignalRef=OBJ_CLS_TYPE5_PROB_027
            OBJ_CLS_TYPE6_027_oRDR_TRACKER_OBJ_027_oPCAN_RADAR_e643ffa9_Tx: ComBitPosition=282, ComBitSize=4, ComSignalType=UINT8, ComSystemTemplateSystemSignalRef=OBJ_CLS_TYPE6_027
            OBJ_CLS_TYPE6_PROB_027_oRDR_TRACKER_OBJ_027_oPCAN_RADAR_564913d6_Tx: ComBitPosition=343, ComBitSize=8, ComSignalType=UINT8, ComSystemTemplateSystemSignalRef=OBJ_CLS_TYPE6_PROB_027
            OBJ_DIMENSION_LENGTH_027_oRDR_TRACKER_OBJ_027_oPCAN_RADAR_b28551c1_Tx: ComBitPosition=37, ComBitSize=12, ComSignalType=UINT16, ComSystemTemplateSystemSignalRef=OBJ_DIMENSION_LENGTH_027
            OBJ_DIMENSION_LENGTH_ERR_027_oRDR_TRACKER_OBJ_027_oPCAN_RADAR_897d4ebb_Tx: ComBitPosition=41, ComBitSize=10, ComSignalType=UINT16, ComSystemTemplateSystemSignalRef=OBJ_DIMENSION_LENGTH_ERR_027
            OBJ_DIMENSION_WIDTH_027_oRDR_TRACKER_OBJ_027_oPCAN_RADAR_914ba66c_Tx: ComBitPosition=17, ComBitSize=10, ComSignalType=UINT16, ComSystemTemplateSystemSignalRef=OBJ_DIMENSION_WIDTH_027
            OBJ_DIMENSION_WIDTH_ERR_027_oRDR_TRACKER_OBJ_027_oPCAN_RADAR_71e96184_Tx: ComBitPosition=23, ComBitSize=6, ComSignalType=UINT8, ComSystemTemplateSystemSignalRef=OBJ_DIMENSION_WIDTH_ERR_027
            OBJ_EXISTENCE_PROB_027_oRDR_TRACKER_OBJ_027_oPCAN_RADAR_9af72251_Tx: ComBitPosition=229, ComBitSize=14, ComSignalType=UINT16, ComSystemTemplateSystemSignalRef=OBJ_EXISTENCE_PROB_027
            OBJ_GROUP_ID_027_oRDR_TRACKER_OBJ_027_oPCAN_RADAR_138536fc_Tx: ComBitPosition=405, ComBitSize=6, ComSignalType=UINT8, ComSystemTemplateSystemSignalRef=OBJ_GROUP_ID_027
            OBJ_ID_027_oRDR_TRACKER_OBJ_027_oPCAN_RADAR_e0ab1dfb_Tx: ComBitPosition=7, ComBitSize=8, ComSignalType=UINT8, ComSystemTemplateSystemSignalRef=OBJ_ID_027
            OBJ_MEASUREMENT_STATUS_027_oRDR_TRACKER_OBJ_027_oPCAN_RADAR_9f796f46_Tx: ComBitPosition=14, ComBitSize=3, ComSignalType=UINT8, ComSystemTemplateSystemSignalRef=OBJ_MEASUREMENT_STATUS_027
            OBJ_MH_CRC16_027_oRDR_TRACKER_OBJ_027_oPCAN_RADAR_e319d87a_Tx: ComBitPosition=495, ComBitSize=16, ComSignalType=UINT16, ComSystemTemplateSystemSignalRef=OBJ_MH_CRC16_027
            OBJ_MH_CYCLE_COUNTER_027_oRDR_TRACKER_OBJ_027_oPCAN_RADAR_92fd829b_Tx: ComBitPosition=487, ComBitSize=8, ComSignalType=UINT8, ComSystemTemplateSystemSignalRef=OBJ_MH_CYCLE_COUNTER_027
            OBJ_MOVEMENT_STATUS_027_oRDR_TRACKER_OBJ_027_oPCAN_RADAR_b0d7fa0a_Tx: ComBitPosition=196, ComBitSize=3, ComSignalType=UINT8, ComSystemTemplateSystemSignalRef=OBJ_MOVEMENT_STATUS_027
            OBJ_POS_ERR_CRR_COEF_027_oRDR_TRACKER_OBJ_027_oPCAN_RADAR_20a83a30_Tx: ComBitPosition=415, ComBitSize=8, ComSignalType=UINT8, ComSystemTemplateSystemSignalRef=OBJ_POS_ERR_CRR_COEF_027
            OBJ_POS_LAT_027_oRDR_TRACKER_OBJ_027_oPCAN_RADAR_c207c77c_Tx: ComBitPosition=79, ComBitSize=16, ComSignalType=UINT16, ComSystemTemplateSystemSignalRef=OBJ_POS_LAT_027
            OBJ_POS_LAT_ERR_027_oRDR_TRACKER_OBJ_027_oPCAN_RADAR_c64b974b_Tx: ComBitPosition=103, ComBitSize=8, ComSignalType=UINT8, ComSystemTemplateSystemSignalRef=OBJ_POS_LAT_ERR_027
            OBJ_POS_LONG_027_oRDR_TRACKER_OBJ_027_oPCAN_RADAR_73a72cb3_Tx: ComBitPosition=63, ComBitSize=16, ComSignalType=UINT16, ComSystemTemplateSystemSignalRef=OBJ_POS_LONG_027
            OBJ_POS_LONG_ERR_027_oRDR_TRACKER_OBJ_027_oPCAN_RADAR_5fb369a9_Tx: ComBitPosition=95, ComBitSize=8, ComSignalType=UINT8, ComSystemTemplateSystemSignalRef=OBJ_POS_LONG_ERR_027
            OBJ_RCS_027_oRDR_TRACKER_OBJ_027_oPCAN_RADAR_e0c8917b_Tx: ComBitPosition=351, ComBitSize=7, ComSignalType=UINT8, ComSystemTemplateSystemSignalRef=OBJ_RCS_027
            OBJ_REF_PT_LAT_OFFSET_027_oRDR_TRACKER_OBJ_027_oPCAN_RADAR_15f5fa0e_Tx: ComBitPosition=370, ComBitSize=14, ComSignalType=UINT16, ComSystemTemplateSystemSignalRef=OBJ_REF_PT_LAT_OFFSET_027
            OBJ_REF_PT_LONG_OFFSET_027_oRDR_TRACKER_OBJ_027_oPCAN_RADAR_5aa70a0d_Tx: ComBitPosition=357, ComBitSize=14, ComSignalType=UINT16, ComSystemTemplateSystemSignalRef=OBJ_REF_PT_LONG_OFFSET_027
            OBJ_TIMESTAMP_OFFSET_027_oRDR_TRACKER_OBJ_027_oPCAN_RADAR_e064912d_Tx: ComBitPosition=247, ComBitSize=8, ComSignalType=UINT8, ComSystemTemplateSystemSignalRef=OBJ_TIMESTAMP_OFFSET_027
            OBJ_TRACK_MOTION_MODEL_027_oRDR_TRACKER_OBJ_027_oPCAN_RADAR_2c6790f0_Tx: ComBitPosition=9, ComBitSize=2, ComSignalType=UINT8, ComSystemTemplateSystemSignalRef=OBJ_TRACK_MOTION_MODEL_027
            OBJ_VEH_TRACK_FLAG_027_oRDR_TRACKER_OBJ_027_oPCAN_RADAR_ae4d66ad_Tx: ComBitPosition=10, ComBitSize=1, ComSignalType=BOOLEAN, ComSystemTemplateSystemSignalRef=OBJ_VEH_TRACK_FLAG_027
            OBJ_VELOCITY_ERR_CRR_COEF_027_oRDR_TRACKER_OBJ_027_oPCAN_RADAR_89d207d1_Tx: ComBitPosition=423, ComBitSize=8, ComSignalType=UINT8, ComSystemTemplateSystemSignalRef=OBJ_VELOCITY_ERR_CRR_COEF_027
            OBJ_VELOCITY_LAT_027_oRDR_TRACKER_OBJ_027_oPCAN_RADAR_8664825b_Tx: ComBitPosition=126, ComBitSize=15, ComSignalType=UINT16, ComSystemTemplateSystemSignalRef=OBJ_VELOCITY_LAT_027
            OBJ_VELOCITY_LAT_ERR_027_oRDR_TRACKER_OBJ_027_oPCAN_RADAR_b29ef20a_Tx: ComBitPosition=151, ComBitSize=8, ComSignalType=UINT8, ComSystemTemplateSystemSignalRef=OBJ_VELOCITY_LAT_ERR_027
            OBJ_VELOCITY_LONG_027_oRDR_TRACKER_OBJ_027_oPCAN_RADAR_d6e9fa9d_Tx: ComBitPosition=110, ComBitSize=15, ComSignalType=UINT16, ComSystemTemplateSystemSignalRef=OBJ_VELOCITY_LONG_027
            OBJ_VELOCITY_LONG_ERR_027_oRDR_TRACKER_OBJ_027_oPCAN_RADAR_5e1ccdca_Tx: ComBitPosition=143, ComBitSize=8, ComSignalType=UINT8, ComSystemTemplateSystemSignalRef=OBJ_VELOCITY_LONG_ERR_027
            OBJ_YAW_ANGLE_027_oRDR_TRACKER_OBJ_027_oPCAN_RADAR_6ad8c61b_Tx: ComBitPosition=155, ComBitSize=12, ComSignalType=UINT16, ComSystemTemplateSystemSignalRef=OBJ_YAW_ANGLE_027
            OBJ_YAW_ANGLE_ERR_027_oRDR_TRACKER_OBJ_027_oPCAN_RADAR_bfd5c0cc_Tx: ComBitPosition=175, ComBitSize=7, ComSignalType=UINT8, ComSystemTemplateSystemSignalRef=OBJ_YAW_ANGLE_ERR_027
            OBJ_YAW_RATE_027_oRDR_TRACKER_OBJ_027_oPCAN_RADAR_4f57e35c_Tx: ComBitPosition=399, ComBitSize=10, ComSignalType=UINT16, ComSystemTemplateSystemSignalRef=OBJ_YAW_RATE_027
            OBJ_YAW_RATE_ERR_027_oRDR_TRACKER_OBJ_027_oPCAN_RADAR_708f7480_Tx: ComBitPosition=388, ComBitSize=5, ComSignalType=UINT8, ComSystemTemplateSystemSignalRef=OBJ_YAW_RATE_ERR_027
        SG_TrackerObject028_oRDR_TRACKER_OBJ_028_oPCAN_RADAR_5ce947ce_Tx: ComSystemTemplateSignalGroupRef=SG_TrackerObject028
          49 x ComGroupSignal, all with ComSignalEndianness=BIG_ENDIAN, ComSignalInitValue=0, ComTransferProperty=PENDING:
            OBJ_ACCELERATION_LAT_028_oRDR_TRACKER_OBJ_028_oPCAN_RADAR_52cd1cb9_Tx: ComBitPosition=177, ComBitSize=10, ComSignalType=UINT16, ComSystemTemplateSystemSignalRef=OBJ_ACCELERATION_LAT_028
            OBJ_ACCELERATION_LAT_ERR_028_oRDR_TRACKER_OBJ_028_oPCAN_RADAR_87392607_Tx: ComBitPosition=223, ComBitSize=8, ComSignalType=UINT8, ComSystemTemplateSystemSignalRef=OBJ_ACCELERATION_LAT_ERR_028
            OBJ_ACCELERATION_LONG_028_oRDR_TRACKER_OBJ_028_oPCAN_RADAR_203d4559_Tx: ComBitPosition=193, ComBitSize=10, ComSignalType=UINT16, ComSystemTemplateSystemSignalRef=OBJ_ACCELERATION_LONG_028
            OBJ_ACCELERATION_LONG_ERR_028_oRDR_TRACKER_OBJ_028_oPCAN_RADAR_989c83ad_Tx: ComBitPosition=215, ComBitSize=8, ComSignalType=UINT8, ComSystemTemplateSystemSignalRef=OBJ_ACCELERATION_LONG_ERR_028
            OBJ_ACCEL_ERR_CRR_COEF_028_oRDR_TRACKER_OBJ_028_oPCAN_RADAR_383fa2cb_Tx: ComBitPosition=431, ComBitSize=8, ComSignalType=UINT8, ComSystemTemplateSystemSignalRef=OBJ_ACCEL_ERR_CRR_COEF_028
            OBJ_ALIVE_TIME_028_oRDR_TRACKER_OBJ_028_oPCAN_RADAR_405c0ee5_Tx: ComBitPosition=255, ComBitSize=16, ComSignalType=UINT16, ComSystemTemplateSystemSignalRef=OBJ_ALIVE_TIME_028
            OBJ_CLS_TYPE1_028_oRDR_TRACKER_OBJ_028_oPCAN_RADAR_d787efc3_Tx: ComBitPosition=271, ComBitSize=4, ComSignalType=UINT8, ComSystemTemplateSystemSignalRef=OBJ_CLS_TYPE1_028
            OBJ_CLS_TYPE1_PROB_028_oRDR_TRACKER_OBJ_028_oPCAN_RADAR_7fdf3830_Tx: ComBitPosition=303, ComBitSize=8, ComSignalType=UINT8, ComSystemTemplateSystemSignalRef=OBJ_CLS_TYPE1_PROB_028
            OBJ_CLS_TYPE2_028_oRDR_TRACKER_OBJ_028_oPCAN_RADAR_9a6fefa4_Tx: ComBitPosition=267, ComBitSize=4, ComSignalType=UINT8, ComSystemTemplateSystemSignalRef=OBJ_CLS_TYPE2_028
            OBJ_CLS_TYPE2_PROB_028_oRDR_TRACKER_OBJ_028_oPCAN_RADAR_b6eb233d_Tx: ComBitPosition=311, ComBitSize=8, ComSignalType=UINT8, ComSystemTemplateSystemSignalRef=OBJ_CLS_TYPE2_PROB_028
            OBJ_CLS_TYPE3_028_oRDR_TRACKER_OBJ_028_oPCAN_RADAR_17e71246_Tx: ComBitPosition=279, ComBitSize=4, ComSignalType=UINT8, ComSystemTemplateSystemSignalRef=OBJ_CLS_TYPE3_028
            OBJ_CLS_TYPE3_PROB_028_oRDR_TRACKER_OBJ_028_oPCAN_RADAR_f1f8d5c6_Tx: ComBitPosition=319, ComBitSize=8, ComSignalType=UINT8, ComSystemTemplateSystemSignalRef=OBJ_CLS_TYPE3_PROB_028
            OBJ_CLS_TYPE4_028_oRDR_TRACKER_OBJ_028_oPCAN_RADAR_01bfef6a_Tx: ComBitPosition=275, ComBitSize=4, ComSignalType=UINT8, ComSystemTemplateSystemSignalRef=OBJ_CLS_TYPE4_028
            OBJ_CLS_TYPE4_PROB_028_oRDR_TRACKER_OBJ_028_oPCAN_RADAR_fff21366_Tx: ComBitPosition=327, ComBitSize=8, ComSignalType=UINT8, ComSystemTemplateSystemSignalRef=OBJ_CLS_TYPE4_PROB_028
            OBJ_CLS_TYPE5_028_oRDR_TRACKER_OBJ_028_oPCAN_RADAR_8c371288_Tx: ComBitPosition=287, ComBitSize=4, ComSignalType=UINT8, ComSystemTemplateSystemSignalRef=OBJ_CLS_TYPE5_028
            OBJ_CLS_TYPE5_PROB_028_oRDR_TRACKER_OBJ_028_oPCAN_RADAR_b8e1e59d_Tx: ComBitPosition=335, ComBitSize=8, ComSignalType=UINT8, ComSystemTemplateSystemSignalRef=OBJ_CLS_TYPE5_PROB_028
            OBJ_CLS_TYPE6_028_oRDR_TRACKER_OBJ_028_oPCAN_RADAR_c1df12ef_Tx: ComBitPosition=282, ComBitSize=4, ComSignalType=UINT8, ComSystemTemplateSystemSignalRef=OBJ_CLS_TYPE6_028
            OBJ_CLS_TYPE6_PROB_028_oRDR_TRACKER_OBJ_028_oPCAN_RADAR_71d5fe90_Tx: ComBitPosition=343, ComBitSize=8, ComSignalType=UINT8, ComSystemTemplateSystemSignalRef=OBJ_CLS_TYPE6_PROB_028
            OBJ_DIMENSION_LENGTH_028_oRDR_TRACKER_OBJ_028_oPCAN_RADAR_9519bc87_Tx: ComBitPosition=37, ComBitSize=12, ComSignalType=UINT16, ComSystemTemplateSystemSignalRef=OBJ_DIMENSION_LENGTH_028
            OBJ_DIMENSION_LENGTH_ERR_028_oRDR_TRACKER_OBJ_028_oPCAN_RADAR_aee1a3fd_Tx: ComBitPosition=41, ComBitSize=10, ComSignalType=UINT16, ComSystemTemplateSystemSignalRef=OBJ_DIMENSION_LENGTH_ERR_028
            OBJ_DIMENSION_WIDTH_028_oRDR_TRACKER_OBJ_028_oPCAN_RADAR_b6d74b2a_Tx: ComBitPosition=17, ComBitSize=10, ComSignalType=UINT16, ComSystemTemplateSystemSignalRef=OBJ_DIMENSION_WIDTH_028
            OBJ_DIMENSION_WIDTH_ERR_028_oRDR_TRACKER_OBJ_028_oPCAN_RADAR_56758cc2_Tx: ComBitPosition=23, ComBitSize=6, ComSignalType=UINT8, ComSystemTemplateSystemSignalRef=OBJ_DIMENSION_WIDTH_ERR_028
            OBJ_EXISTENCE_PROB_028_oRDR_TRACKER_OBJ_028_oPCAN_RADAR_bd6bcf17_Tx: ComBitPosition=229, ComBitSize=14, ComSignalType=UINT16, ComSystemTemplateSystemSignalRef=OBJ_EXISTENCE_PROB_028
            OBJ_GROUP_ID_028_oRDR_TRACKER_OBJ_028_oPCAN_RADAR_3419dbba_Tx: ComBitPosition=405, ComBitSize=6, ComSignalType=UINT8, ComSystemTemplateSystemSignalRef=OBJ_GROUP_ID_028
            OBJ_ID_028_oRDR_TRACKER_OBJ_028_oPCAN_RADAR_c737f0bd_Tx: ComBitPosition=7, ComBitSize=8, ComSignalType=UINT8, ComSystemTemplateSystemSignalRef=OBJ_ID_028
            OBJ_MEASUREMENT_STATUS_028_oRDR_TRACKER_OBJ_028_oPCAN_RADAR_b8e58200_Tx: ComBitPosition=14, ComBitSize=3, ComSignalType=UINT8, ComSystemTemplateSystemSignalRef=OBJ_MEASUREMENT_STATUS_028
            OBJ_MH_CRC16_028_oRDR_TRACKER_OBJ_028_oPCAN_RADAR_c485353c_Tx: ComBitPosition=495, ComBitSize=16, ComSignalType=UINT16, ComSystemTemplateSystemSignalRef=OBJ_MH_CRC16_028
            OBJ_MH_CYCLE_COUNTER_028_oRDR_TRACKER_OBJ_028_oPCAN_RADAR_b5616fdd_Tx: ComBitPosition=487, ComBitSize=8, ComSignalType=UINT8, ComSystemTemplateSystemSignalRef=OBJ_MH_CYCLE_COUNTER_028
            OBJ_MOVEMENT_STATUS_028_oRDR_TRACKER_OBJ_028_oPCAN_RADAR_974b174c_Tx: ComBitPosition=196, ComBitSize=3, ComSignalType=UINT8, ComSystemTemplateSystemSignalRef=OBJ_MOVEMENT_STATUS_028
            OBJ_POS_ERR_CRR_COEF_028_oRDR_TRACKER_OBJ_028_oPCAN_RADAR_0734d776_Tx: ComBitPosition=415, ComBitSize=8, ComSignalType=UINT8, ComSystemTemplateSystemSignalRef=OBJ_POS_ERR_CRR_COEF_028
            OBJ_POS_LAT_028_oRDR_TRACKER_OBJ_028_oPCAN_RADAR_e59b2a3a_Tx: ComBitPosition=79, ComBitSize=16, ComSignalType=UINT16, ComSystemTemplateSystemSignalRef=OBJ_POS_LAT_028
            OBJ_POS_LAT_ERR_028_oRDR_TRACKER_OBJ_028_oPCAN_RADAR_e1d77a0d_Tx: ComBitPosition=103, ComBitSize=8, ComSignalType=UINT8, ComSystemTemplateSystemSignalRef=OBJ_POS_LAT_ERR_028
            OBJ_POS_LONG_028_oRDR_TRACKER_OBJ_028_oPCAN_RADAR_543bc1f5_Tx: ComBitPosition=63, ComBitSize=16, ComSignalType=UINT16, ComSystemTemplateSystemSignalRef=OBJ_POS_LONG_028
            OBJ_POS_LONG_ERR_028_oRDR_TRACKER_OBJ_028_oPCAN_RADAR_782f84ef_Tx: ComBitPosition=95, ComBitSize=8, ComSignalType=UINT8, ComSystemTemplateSystemSignalRef=OBJ_POS_LONG_ERR_028
            OBJ_RCS_028_oRDR_TRACKER_OBJ_028_oPCAN_RADAR_c7547c3d_Tx: ComBitPosition=351, ComBitSize=7, ComSignalType=UINT8, ComSystemTemplateSystemSignalRef=OBJ_RCS_028
            OBJ_REF_PT_LAT_OFFSET_028_oRDR_TRACKER_OBJ_028_oPCAN_RADAR_32691748_Tx: ComBitPosition=370, ComBitSize=14, ComSignalType=UINT16, ComSystemTemplateSystemSignalRef=OBJ_REF_PT_LAT_OFFSET_028
            OBJ_REF_PT_LONG_OFFSET_028_oRDR_TRACKER_OBJ_028_oPCAN_RADAR_7d3be74b_Tx: ComBitPosition=357, ComBitSize=14, ComSignalType=UINT16, ComSystemTemplateSystemSignalRef=OBJ_REF_PT_LONG_OFFSET_028
            OBJ_TIMESTAMP_OFFSET_028_oRDR_TRACKER_OBJ_028_oPCAN_RADAR_c7f87c6b_Tx: ComBitPosition=247, ComBitSize=8, ComSignalType=UINT8, ComSystemTemplateSystemSignalRef=OBJ_TIMESTAMP_OFFSET_028
            OBJ_TRACK_MOTION_MODEL_028_oRDR_TRACKER_OBJ_028_oPCAN_RADAR_0bfb7db6_Tx: ComBitPosition=9, ComBitSize=2, ComSignalType=UINT8, ComSystemTemplateSystemSignalRef=OBJ_TRACK_MOTION_MODEL_028
            OBJ_VEH_TRACK_FLAG_028_oRDR_TRACKER_OBJ_028_oPCAN_RADAR_89d18beb_Tx: ComBitPosition=10, ComBitSize=1, ComSignalType=BOOLEAN, ComSystemTemplateSystemSignalRef=OBJ_VEH_TRACK_FLAG_028
            OBJ_VELOCITY_ERR_CRR_COEF_028_oRDR_TRACKER_OBJ_028_oPCAN_RADAR_ae4eea97_Tx: ComBitPosition=423, ComBitSize=8, ComSignalType=UINT8, ComSystemTemplateSystemSignalRef=OBJ_VELOCITY_ERR_CRR_COEF_028
            OBJ_VELOCITY_LAT_028_oRDR_TRACKER_OBJ_028_oPCAN_RADAR_a1f86f1d_Tx: ComBitPosition=126, ComBitSize=15, ComSignalType=UINT16, ComSystemTemplateSystemSignalRef=OBJ_VELOCITY_LAT_028
            OBJ_VELOCITY_LAT_ERR_028_oRDR_TRACKER_OBJ_028_oPCAN_RADAR_95021f4c_Tx: ComBitPosition=151, ComBitSize=8, ComSignalType=UINT8, ComSystemTemplateSystemSignalRef=OBJ_VELOCITY_LAT_ERR_028
            OBJ_VELOCITY_LONG_028_oRDR_TRACKER_OBJ_028_oPCAN_RADAR_f17517db_Tx: ComBitPosition=110, ComBitSize=15, ComSignalType=UINT16, ComSystemTemplateSystemSignalRef=OBJ_VELOCITY_LONG_028
            OBJ_VELOCITY_LONG_ERR_028_oRDR_TRACKER_OBJ_028_oPCAN_RADAR_7980208c_Tx: ComBitPosition=143, ComBitSize=8, ComSignalType=UINT8, ComSystemTemplateSystemSignalRef=OBJ_VELOCITY_LONG_ERR_028
            OBJ_YAW_ANGLE_028_oRDR_TRACKER_OBJ_028_oPCAN_RADAR_4d442b5d_Tx: ComBitPosition=155, ComBitSize=12, ComSignalType=UINT16, ComSystemTemplateSystemSignalRef=OBJ_YAW_ANGLE_028
            OBJ_YAW_ANGLE_ERR_028_oRDR_TRACKER_OBJ_028_oPCAN_RADAR_98492d8a_Tx: ComBitPosition=175, ComBitSize=7, ComSignalType=UINT8, ComSystemTemplateSystemSignalRef=OBJ_YAW_ANGLE_ERR_028
            OBJ_YAW_RATE_028_oRDR_TRACKER_OBJ_028_oPCAN_RADAR_68cb0e1a_Tx: ComBitPosition=399, ComBitSize=10, ComSignalType=UINT16, ComSystemTemplateSystemSignalRef=OBJ_YAW_RATE_028
            OBJ_YAW_RATE_ERR_028_oRDR_TRACKER_OBJ_028_oPCAN_RADAR_571399c6_Tx: ComBitPosition=388, ComBitSize=5, ComSignalType=UINT8, ComSystemTemplateSystemSignalRef=OBJ_YAW_RATE_ERR_028
        SG_TrackerObject029_oRDR_TRACKER_OBJ_029_oPCAN_RADAR_a5fdcf7d_Tx: ComSystemTemplateSignalGroupRef=SG_TrackerObject029
          49 x ComGroupSignal, all with ComSignalEndianness=BIG_ENDIAN, ComSignalInitValue=0, ComTransferProperty=PENDING:
            OBJ_ACCELERATION_LAT_029_oRDR_TRACKER_OBJ_029_oPCAN_RADAR_abd9940a_Tx: ComBitPosition=177, ComBitSize=10, ComSignalType=UINT16, ComSystemTemplateSystemSignalRef=OBJ_ACCELERATION_LAT_029
            OBJ_ACCELERATION_LAT_ERR_029_oRDR_TRACKER_OBJ_029_oPCAN_RADAR_7e2daeb4_Tx: ComBitPosition=223, ComBitSize=8, ComSignalType=UINT8, ComSystemTemplateSystemSignalRef=OBJ_ACCELERATION_LAT_ERR_029
            OBJ_ACCELERATION_LONG_029_oRDR_TRACKER_OBJ_029_oPCAN_RADAR_d929cdea_Tx: ComBitPosition=193, ComBitSize=10, ComSignalType=UINT16, ComSystemTemplateSystemSignalRef=OBJ_ACCELERATION_LONG_029
            OBJ_ACCELERATION_LONG_ERR_029_oRDR_TRACKER_OBJ_029_oPCAN_RADAR_61880b1e_Tx: ComBitPosition=215, ComBitSize=8, ComSignalType=UINT8, ComSystemTemplateSystemSignalRef=OBJ_ACCELERATION_LONG_ERR_029
            OBJ_ACCEL_ERR_CRR_COEF_029_oRDR_TRACKER_OBJ_029_oPCAN_RADAR_c12b2a78_Tx: ComBitPosition=431, ComBitSize=8, ComSignalType=UINT8, ComSystemTemplateSystemSignalRef=OBJ_ACCEL_ERR_CRR_COEF_029
            OBJ_ALIVE_TIME_029_oRDR_TRACKER_OBJ_029_oPCAN_RADAR_b9488656_Tx: ComBitPosition=255, ComBitSize=16, ComSignalType=UINT16, ComSystemTemplateSystemSignalRef=OBJ_ALIVE_TIME_029
            OBJ_CLS_TYPE1_029_oRDR_TRACKER_OBJ_029_oPCAN_RADAR_2e936770_Tx: ComBitPosition=271, ComBitSize=4, ComSignalType=UINT8, ComSystemTemplateSystemSignalRef=OBJ_CLS_TYPE1_029
            OBJ_CLS_TYPE1_PROB_029_oRDR_TRACKER_OBJ_029_oPCAN_RADAR_86cbb083_Tx: ComBitPosition=303, ComBitSize=8, ComSignalType=UINT8, ComSystemTemplateSystemSignalRef=OBJ_CLS_TYPE1_PROB_029
            OBJ_CLS_TYPE2_029_oRDR_TRACKER_OBJ_029_oPCAN_RADAR_637b6717_Tx: ComBitPosition=267, ComBitSize=4, ComSignalType=UINT8, ComSystemTemplateSystemSignalRef=OBJ_CLS_TYPE2_029
            OBJ_CLS_TYPE2_PROB_029_oRDR_TRACKER_OBJ_029_oPCAN_RADAR_4fffab8e_Tx: ComBitPosition=311, ComBitSize=8, ComSignalType=UINT8, ComSystemTemplateSystemSignalRef=OBJ_CLS_TYPE2_PROB_029
            OBJ_CLS_TYPE3_029_oRDR_TRACKER_OBJ_029_oPCAN_RADAR_eef39af5_Tx: ComBitPosition=279, ComBitSize=4, ComSignalType=UINT8, ComSystemTemplateSystemSignalRef=OBJ_CLS_TYPE3_029
            OBJ_CLS_TYPE3_PROB_029_oRDR_TRACKER_OBJ_029_oPCAN_RADAR_08ec5d75_Tx: ComBitPosition=319, ComBitSize=8, ComSignalType=UINT8, ComSystemTemplateSystemSignalRef=OBJ_CLS_TYPE3_PROB_029
            OBJ_CLS_TYPE4_029_oRDR_TRACKER_OBJ_029_oPCAN_RADAR_f8ab67d9_Tx: ComBitPosition=275, ComBitSize=4, ComSignalType=UINT8, ComSystemTemplateSystemSignalRef=OBJ_CLS_TYPE4_029
            OBJ_CLS_TYPE4_PROB_029_oRDR_TRACKER_OBJ_029_oPCAN_RADAR_06e69bd5_Tx: ComBitPosition=327, ComBitSize=8, ComSignalType=UINT8, ComSystemTemplateSystemSignalRef=OBJ_CLS_TYPE4_PROB_029
            OBJ_CLS_TYPE5_029_oRDR_TRACKER_OBJ_029_oPCAN_RADAR_75239a3b_Tx: ComBitPosition=287, ComBitSize=4, ComSignalType=UINT8, ComSystemTemplateSystemSignalRef=OBJ_CLS_TYPE5_029
            OBJ_CLS_TYPE5_PROB_029_oRDR_TRACKER_OBJ_029_oPCAN_RADAR_41f56d2e_Tx: ComBitPosition=335, ComBitSize=8, ComSignalType=UINT8, ComSystemTemplateSystemSignalRef=OBJ_CLS_TYPE5_PROB_029
            OBJ_CLS_TYPE6_029_oRDR_TRACKER_OBJ_029_oPCAN_RADAR_38cb9a5c_Tx: ComBitPosition=282, ComBitSize=4, ComSignalType=UINT8, ComSystemTemplateSystemSignalRef=OBJ_CLS_TYPE6_029
            OBJ_CLS_TYPE6_PROB_029_oRDR_TRACKER_OBJ_029_oPCAN_RADAR_88c17623_Tx: ComBitPosition=343, ComBitSize=8, ComSignalType=UINT8, ComSystemTemplateSystemSignalRef=OBJ_CLS_TYPE6_PROB_029
            OBJ_DIMENSION_LENGTH_029_oRDR_TRACKER_OBJ_029_oPCAN_RADAR_6c0d3434_Tx: ComBitPosition=37, ComBitSize=12, ComSignalType=UINT16, ComSystemTemplateSystemSignalRef=OBJ_DIMENSION_LENGTH_029
            OBJ_DIMENSION_LENGTH_ERR_029_oRDR_TRACKER_OBJ_029_oPCAN_RADAR_57f52b4e_Tx: ComBitPosition=41, ComBitSize=10, ComSignalType=UINT16, ComSystemTemplateSystemSignalRef=OBJ_DIMENSION_LENGTH_ERR_029
            OBJ_DIMENSION_WIDTH_029_oRDR_TRACKER_OBJ_029_oPCAN_RADAR_4fc3c399_Tx: ComBitPosition=17, ComBitSize=10, ComSignalType=UINT16, ComSystemTemplateSystemSignalRef=OBJ_DIMENSION_WIDTH_029
            OBJ_DIMENSION_WIDTH_ERR_029_oRDR_TRACKER_OBJ_029_oPCAN_RADAR_af610471_Tx: ComBitPosition=23, ComBitSize=6, ComSignalType=UINT8, ComSystemTemplateSystemSignalRef=OBJ_DIMENSION_WIDTH_ERR_029
            OBJ_EXISTENCE_PROB_029_oRDR_TRACKER_OBJ_029_oPCAN_RADAR_447f47a4_Tx: ComBitPosition=229, ComBitSize=14, ComSignalType=UINT16, ComSystemTemplateSystemSignalRef=OBJ_EXISTENCE_PROB_029
            OBJ_GROUP_ID_029_oRDR_TRACKER_OBJ_029_oPCAN_RADAR_cd0d5309_Tx: ComBitPosition=405, ComBitSize=6, ComSignalType=UINT8, ComSystemTemplateSystemSignalRef=OBJ_GROUP_ID_029
            OBJ_ID_029_oRDR_TRACKER_OBJ_029_oPCAN_RADAR_3e23780e_Tx: ComBitPosition=7, ComBitSize=8, ComSignalType=UINT8, ComSystemTemplateSystemSignalRef=OBJ_ID_029
            OBJ_MEASUREMENT_STATUS_029_oRDR_TRACKER_OBJ_029_oPCAN_RADAR_41f10ab3_Tx: ComBitPosition=14, ComBitSize=3, ComSignalType=UINT8, ComSystemTemplateSystemSignalRef=OBJ_MEASUREMENT_STATUS_029
            OBJ_MH_CRC16_029_oRDR_TRACKER_OBJ_029_oPCAN_RADAR_3d91bd8f_Tx: ComBitPosition=495, ComBitSize=16, ComSignalType=UINT16, ComSystemTemplateSystemSignalRef=OBJ_MH_CRC16_029
            OBJ_MH_CYCLE_COUNTER_029_oRDR_TRACKER_OBJ_029_oPCAN_RADAR_4c75e76e_Tx: ComBitPosition=487, ComBitSize=8, ComSignalType=UINT8, ComSystemTemplateSystemSignalRef=OBJ_MH_CYCLE_COUNTER_029
            OBJ_MOVEMENT_STATUS_029_oRDR_TRACKER_OBJ_029_oPCAN_RADAR_6e5f9fff_Tx: ComBitPosition=196, ComBitSize=3, ComSignalType=UINT8, ComSystemTemplateSystemSignalRef=OBJ_MOVEMENT_STATUS_029
            OBJ_POS_ERR_CRR_COEF_029_oRDR_TRACKER_OBJ_029_oPCAN_RADAR_fe205fc5_Tx: ComBitPosition=415, ComBitSize=8, ComSignalType=UINT8, ComSystemTemplateSystemSignalRef=OBJ_POS_ERR_CRR_COEF_029
            OBJ_POS_LAT_029_oRDR_TRACKER_OBJ_029_oPCAN_RADAR_1c8fa289_Tx: ComBitPosition=79, ComBitSize=16, ComSignalType=UINT16, ComSystemTemplateSystemSignalRef=OBJ_POS_LAT_029
            OBJ_POS_LAT_ERR_029_oRDR_TRACKER_OBJ_029_oPCAN_RADAR_18c3f2be_Tx: ComBitPosition=103, ComBitSize=8, ComSignalType=UINT8, ComSystemTemplateSystemSignalRef=OBJ_POS_LAT_ERR_029
            OBJ_POS_LONG_029_oRDR_TRACKER_OBJ_029_oPCAN_RADAR_ad2f4946_Tx: ComBitPosition=63, ComBitSize=16, ComSignalType=UINT16, ComSystemTemplateSystemSignalRef=OBJ_POS_LONG_029
            OBJ_POS_LONG_ERR_029_oRDR_TRACKER_OBJ_029_oPCAN_RADAR_813b0c5c_Tx: ComBitPosition=95, ComBitSize=8, ComSignalType=UINT8, ComSystemTemplateSystemSignalRef=OBJ_POS_LONG_ERR_029
            OBJ_RCS_029_oRDR_TRACKER_OBJ_029_oPCAN_RADAR_3e40f48e_Tx: ComBitPosition=351, ComBitSize=7, ComSignalType=UINT8, ComSystemTemplateSystemSignalRef=OBJ_RCS_029
            OBJ_REF_PT_LAT_OFFSET_029_oRDR_TRACKER_OBJ_029_oPCAN_RADAR_cb7d9ffb_Tx: ComBitPosition=370, ComBitSize=14, ComSignalType=UINT16, ComSystemTemplateSystemSignalRef=OBJ_REF_PT_LAT_OFFSET_029
            OBJ_REF_PT_LONG_OFFSET_029_oRDR_TRACKER_OBJ_029_oPCAN_RADAR_842f6ff8_Tx: ComBitPosition=357, ComBitSize=14, ComSignalType=UINT16, ComSystemTemplateSystemSignalRef=OBJ_REF_PT_LONG_OFFSET_029
            OBJ_TIMESTAMP_OFFSET_029_oRDR_TRACKER_OBJ_029_oPCAN_RADAR_3eecf4d8_Tx: ComBitPosition=247, ComBitSize=8, ComSignalType=UINT8, ComSystemTemplateSystemSignalRef=OBJ_TIMESTAMP_OFFSET_029
            OBJ_TRACK_MOTION_MODEL_029_oRDR_TRACKER_OBJ_029_oPCAN_RADAR_f2eff505_Tx: ComBitPosition=9, ComBitSize=2, ComSignalType=UINT8, ComSystemTemplateSystemSignalRef=OBJ_TRACK_MOTION_MODEL_029
            OBJ_VEH_TRACK_FLAG_029_oRDR_TRACKER_OBJ_029_oPCAN_RADAR_70c50358_Tx: ComBitPosition=10, ComBitSize=1, ComSignalType=BOOLEAN, ComSystemTemplateSystemSignalRef=OBJ_VEH_TRACK_FLAG_029
            OBJ_VELOCITY_ERR_CRR_COEF_029_oRDR_TRACKER_OBJ_029_oPCAN_RADAR_575a6224_Tx: ComBitPosition=423, ComBitSize=8, ComSignalType=UINT8, ComSystemTemplateSystemSignalRef=OBJ_VELOCITY_ERR_CRR_COEF_029
            OBJ_VELOCITY_LAT_029_oRDR_TRACKER_OBJ_029_oPCAN_RADAR_58ece7ae_Tx: ComBitPosition=126, ComBitSize=15, ComSignalType=UINT16, ComSystemTemplateSystemSignalRef=OBJ_VELOCITY_LAT_029
            OBJ_VELOCITY_LAT_ERR_029_oRDR_TRACKER_OBJ_029_oPCAN_RADAR_6c1697ff_Tx: ComBitPosition=151, ComBitSize=8, ComSignalType=UINT8, ComSystemTemplateSystemSignalRef=OBJ_VELOCITY_LAT_ERR_029
            OBJ_VELOCITY_LONG_029_oRDR_TRACKER_OBJ_029_oPCAN_RADAR_08619f68_Tx: ComBitPosition=110, ComBitSize=15, ComSignalType=UINT16, ComSystemTemplateSystemSignalRef=OBJ_VELOCITY_LONG_029
            OBJ_VELOCITY_LONG_ERR_029_oRDR_TRACKER_OBJ_029_oPCAN_RADAR_8094a83f_Tx: ComBitPosition=143, ComBitSize=8, ComSignalType=UINT8, ComSystemTemplateSystemSignalRef=OBJ_VELOCITY_LONG_ERR_029
            OBJ_YAW_ANGLE_029_oRDR_TRACKER_OBJ_029_oPCAN_RADAR_b450a3ee_Tx: ComBitPosition=155, ComBitSize=12, ComSignalType=UINT16, ComSystemTemplateSystemSignalRef=OBJ_YAW_ANGLE_029
            OBJ_YAW_ANGLE_ERR_029_oRDR_TRACKER_OBJ_029_oPCAN_RADAR_615da539_Tx: ComBitPosition=175, ComBitSize=7, ComSignalType=UINT8, ComSystemTemplateSystemSignalRef=OBJ_YAW_ANGLE_ERR_029
            OBJ_YAW_RATE_029_oRDR_TRACKER_OBJ_029_oPCAN_RADAR_91df86a9_Tx: ComBitPosition=399, ComBitSize=10, ComSignalType=UINT16, ComSystemTemplateSystemSignalRef=OBJ_YAW_RATE_029
            OBJ_YAW_RATE_ERR_029_oRDR_TRACKER_OBJ_029_oPCAN_RADAR_ae071175_Tx: ComBitPosition=388, ComBitSize=5, ComSignalType=UINT8, ComSystemTemplateSystemSignalRef=OBJ_YAW_RATE_ERR_029
        SG_TrackerObject030_oRDR_TRACKER_OBJ_030_oPCAN_RADAR_ab18edec_Tx: ComSystemTemplateSignalGroupRef=SG_TrackerObject030
          49 x ComGroupSignal, all with ComSignalEndianness=BIG_ENDIAN, ComSignalInitValue=0, ComTransferProperty=PENDING:
            OBJ_ACCELERATION_LAT_030_oRDR_TRACKER_OBJ_030_oPCAN_RADAR_a53cb69b_Tx: ComBitPosition=177, ComBitSize=10, ComSignalType=UINT16, ComSystemTemplateSystemSignalRef=OBJ_ACCELERATION_LAT_030
            OBJ_ACCELERATION_LAT_ERR_030_oRDR_TRACKER_OBJ_030_oPCAN_RADAR_70c88c25_Tx: ComBitPosition=223, ComBitSize=8, ComSignalType=UINT8, ComSystemTemplateSystemSignalRef=OBJ_ACCELERATION_LAT_ERR_030
            OBJ_ACCELERATION_LONG_030_oRDR_TRACKER_OBJ_030_oPCAN_RADAR_d7ccef7b_Tx: ComBitPosition=193, ComBitSize=10, ComSignalType=UINT16, ComSystemTemplateSystemSignalRef=OBJ_ACCELERATION_LONG_030
            OBJ_ACCELERATION_LONG_ERR_030_oRDR_TRACKER_OBJ_030_oPCAN_RADAR_6f6d298f_Tx: ComBitPosition=215, ComBitSize=8, ComSignalType=UINT8, ComSystemTemplateSystemSignalRef=OBJ_ACCELERATION_LONG_ERR_030
            OBJ_ACCEL_ERR_CRR_COEF_030_oRDR_TRACKER_OBJ_030_oPCAN_RADAR_cfce08e9_Tx: ComBitPosition=431, ComBitSize=8, ComSignalType=UINT8, ComSystemTemplateSystemSignalRef=OBJ_ACCEL_ERR_CRR_COEF_030
            OBJ_ALIVE_TIME_030_oRDR_TRACKER_OBJ_030_oPCAN_RADAR_b7ada4c7_Tx: ComBitPosition=255, ComBitSize=16, ComSignalType=UINT16, ComSystemTemplateSystemSignalRef=OBJ_ALIVE_TIME_030
            OBJ_CLS_TYPE1_030_oRDR_TRACKER_OBJ_030_oPCAN_RADAR_207645e1_Tx: ComBitPosition=271, ComBitSize=4, ComSignalType=UINT8, ComSystemTemplateSystemSignalRef=OBJ_CLS_TYPE1_030
            OBJ_CLS_TYPE1_PROB_030_oRDR_TRACKER_OBJ_030_oPCAN_RADAR_882e9212_Tx: ComBitPosition=303, ComBitSize=8, ComSignalType=UINT8, ComSystemTemplateSystemSignalRef=OBJ_CLS_TYPE1_PROB_030
            OBJ_CLS_TYPE2_030_oRDR_TRACKER_OBJ_030_oPCAN_RADAR_6d9e4586_Tx: ComBitPosition=267, ComBitSize=4, ComSignalType=UINT8, ComSystemTemplateSystemSignalRef=OBJ_CLS_TYPE2_030
            OBJ_CLS_TYPE2_PROB_030_oRDR_TRACKER_OBJ_030_oPCAN_RADAR_411a891f_Tx: ComBitPosition=311, ComBitSize=8, ComSignalType=UINT8, ComSystemTemplateSystemSignalRef=OBJ_CLS_TYPE2_PROB_030
            OBJ_CLS_TYPE3_030_oRDR_TRACKER_OBJ_030_oPCAN_RADAR_e016b864_Tx: ComBitPosition=279, ComBitSize=4, ComSignalType=UINT8, ComSystemTemplateSystemSignalRef=OBJ_CLS_TYPE3_030
            OBJ_CLS_TYPE3_PROB_030_oRDR_TRACKER_OBJ_030_oPCAN_RADAR_06097fe4_Tx: ComBitPosition=319, ComBitSize=8, ComSignalType=UINT8, ComSystemTemplateSystemSignalRef=OBJ_CLS_TYPE3_PROB_030
            OBJ_CLS_TYPE4_030_oRDR_TRACKER_OBJ_030_oPCAN_RADAR_f64e4548_Tx: ComBitPosition=275, ComBitSize=4, ComSignalType=UINT8, ComSystemTemplateSystemSignalRef=OBJ_CLS_TYPE4_030
            OBJ_CLS_TYPE4_PROB_030_oRDR_TRACKER_OBJ_030_oPCAN_RADAR_0803b944_Tx: ComBitPosition=327, ComBitSize=8, ComSignalType=UINT8, ComSystemTemplateSystemSignalRef=OBJ_CLS_TYPE4_PROB_030
            OBJ_CLS_TYPE5_030_oRDR_TRACKER_OBJ_030_oPCAN_RADAR_7bc6b8aa_Tx: ComBitPosition=287, ComBitSize=4, ComSignalType=UINT8, ComSystemTemplateSystemSignalRef=OBJ_CLS_TYPE5_030
            OBJ_CLS_TYPE5_PROB_030_oRDR_TRACKER_OBJ_030_oPCAN_RADAR_4f104fbf_Tx: ComBitPosition=335, ComBitSize=8, ComSignalType=UINT8, ComSystemTemplateSystemSignalRef=OBJ_CLS_TYPE5_PROB_030
            OBJ_CLS_TYPE6_030_oRDR_TRACKER_OBJ_030_oPCAN_RADAR_362eb8cd_Tx: ComBitPosition=282, ComBitSize=4, ComSignalType=UINT8, ComSystemTemplateSystemSignalRef=OBJ_CLS_TYPE6_030
            OBJ_CLS_TYPE6_PROB_030_oRDR_TRACKER_OBJ_030_oPCAN_RADAR_862454b2_Tx: ComBitPosition=343, ComBitSize=8, ComSignalType=UINT8, ComSystemTemplateSystemSignalRef=OBJ_CLS_TYPE6_PROB_030
            OBJ_DIMENSION_LENGTH_030_oRDR_TRACKER_OBJ_030_oPCAN_RADAR_62e816a5_Tx: ComBitPosition=37, ComBitSize=12, ComSignalType=UINT16, ComSystemTemplateSystemSignalRef=OBJ_DIMENSION_LENGTH_030
            OBJ_DIMENSION_LENGTH_ERR_030_oRDR_TRACKER_OBJ_030_oPCAN_RADAR_591009df_Tx: ComBitPosition=41, ComBitSize=10, ComSignalType=UINT16, ComSystemTemplateSystemSignalRef=OBJ_DIMENSION_LENGTH_ERR_030
            OBJ_DIMENSION_WIDTH_030_oRDR_TRACKER_OBJ_030_oPCAN_RADAR_4126e108_Tx: ComBitPosition=17, ComBitSize=10, ComSignalType=UINT16, ComSystemTemplateSystemSignalRef=OBJ_DIMENSION_WIDTH_030
            OBJ_DIMENSION_WIDTH_ERR_030_oRDR_TRACKER_OBJ_030_oPCAN_RADAR_a18426e0_Tx: ComBitPosition=23, ComBitSize=6, ComSignalType=UINT8, ComSystemTemplateSystemSignalRef=OBJ_DIMENSION_WIDTH_ERR_030
            OBJ_EXISTENCE_PROB_030_oRDR_TRACKER_OBJ_030_oPCAN_RADAR_4a9a6535_Tx: ComBitPosition=229, ComBitSize=14, ComSignalType=UINT16, ComSystemTemplateSystemSignalRef=OBJ_EXISTENCE_PROB_030
            OBJ_GROUP_ID_030_oRDR_TRACKER_OBJ_030_oPCAN_RADAR_c3e87198_Tx: ComBitPosition=405, ComBitSize=6, ComSignalType=UINT8, ComSystemTemplateSystemSignalRef=OBJ_GROUP_ID_030
            OBJ_ID_030_oRDR_TRACKER_OBJ_030_oPCAN_RADAR_30c65a9f_Tx: ComBitPosition=7, ComBitSize=8, ComSignalType=UINT8, ComSystemTemplateSystemSignalRef=OBJ_ID_030
            OBJ_MEASUREMENT_STATUS_030_oRDR_TRACKER_OBJ_030_oPCAN_RADAR_4f142822_Tx: ComBitPosition=14, ComBitSize=3, ComSignalType=UINT8, ComSystemTemplateSystemSignalRef=OBJ_MEASUREMENT_STATUS_030
            OBJ_MH_CRC16_030_oRDR_TRACKER_OBJ_030_oPCAN_RADAR_33749f1e_Tx: ComBitPosition=495, ComBitSize=16, ComSignalType=UINT16, ComSystemTemplateSystemSignalRef=OBJ_MH_CRC16_030
            OBJ_MH_CYCLE_COUNTER_030_oRDR_TRACKER_OBJ_030_oPCAN_RADAR_4290c5ff_Tx: ComBitPosition=487, ComBitSize=8, ComSignalType=UINT8, ComSystemTemplateSystemSignalRef=OBJ_MH_CYCLE_COUNTER_030
            OBJ_MOVEMENT_STATUS_030_oRDR_TRACKER_OBJ_030_oPCAN_RADAR_60babd6e_Tx: ComBitPosition=196, ComBitSize=3, ComSignalType=UINT8, ComSystemTemplateSystemSignalRef=OBJ_MOVEMENT_STATUS_030
            OBJ_POS_ERR_CRR_COEF_030_oRDR_TRACKER_OBJ_030_oPCAN_RADAR_f0c57d54_Tx: ComBitPosition=415, ComBitSize=8, ComSignalType=UINT8, ComSystemTemplateSystemSignalRef=OBJ_POS_ERR_CRR_COEF_030
            OBJ_POS_LAT_030_oRDR_TRACKER_OBJ_030_oPCAN_RADAR_126a8018_Tx: ComBitPosition=79, ComBitSize=16, ComSignalType=UINT16, ComSystemTemplateSystemSignalRef=OBJ_POS_LAT_030
            OBJ_POS_LAT_ERR_030_oRDR_TRACKER_OBJ_030_oPCAN_RADAR_1626d02f_Tx: ComBitPosition=103, ComBitSize=8, ComSignalType=UINT8, ComSystemTemplateSystemSignalRef=OBJ_POS_LAT_ERR_030
            OBJ_POS_LONG_030_oRDR_TRACKER_OBJ_030_oPCAN_RADAR_a3ca6bd7_Tx: ComBitPosition=63, ComBitSize=16, ComSignalType=UINT16, ComSystemTemplateSystemSignalRef=OBJ_POS_LONG_030
            OBJ_POS_LONG_ERR_030_oRDR_TRACKER_OBJ_030_oPCAN_RADAR_8fde2ecd_Tx: ComBitPosition=95, ComBitSize=8, ComSignalType=UINT8, ComSystemTemplateSystemSignalRef=OBJ_POS_LONG_ERR_030
            OBJ_RCS_030_oRDR_TRACKER_OBJ_030_oPCAN_RADAR_30a5d61f_Tx: ComBitPosition=351, ComBitSize=7, ComSignalType=UINT8, ComSystemTemplateSystemSignalRef=OBJ_RCS_030
            OBJ_REF_PT_LAT_OFFSET_030_oRDR_TRACKER_OBJ_030_oPCAN_RADAR_c598bd6a_Tx: ComBitPosition=370, ComBitSize=14, ComSignalType=UINT16, ComSystemTemplateSystemSignalRef=OBJ_REF_PT_LAT_OFFSET_030
            OBJ_REF_PT_LONG_OFFSET_030_oRDR_TRACKER_OBJ_030_oPCAN_RADAR_8aca4d69_Tx: ComBitPosition=357, ComBitSize=14, ComSignalType=UINT16, ComSystemTemplateSystemSignalRef=OBJ_REF_PT_LONG_OFFSET_030
            OBJ_TIMESTAMP_OFFSET_030_oRDR_TRACKER_OBJ_030_oPCAN_RADAR_3009d649_Tx: ComBitPosition=247, ComBitSize=8, ComSignalType=UINT8, ComSystemTemplateSystemSignalRef=OBJ_TIMESTAMP_OFFSET_030
            OBJ_TRACK_MOTION_MODEL_030_oRDR_TRACKER_OBJ_030_oPCAN_RADAR_fc0ad794_Tx: ComBitPosition=9, ComBitSize=2, ComSignalType=UINT8, ComSystemTemplateSystemSignalRef=OBJ_TRACK_MOTION_MODEL_030
            OBJ_VEH_TRACK_FLAG_030_oRDR_TRACKER_OBJ_030_oPCAN_RADAR_7e2021c9_Tx: ComBitPosition=10, ComBitSize=1, ComSignalType=BOOLEAN, ComSystemTemplateSystemSignalRef=OBJ_VEH_TRACK_FLAG_030
            OBJ_VELOCITY_ERR_CRR_COEF_030_oRDR_TRACKER_OBJ_030_oPCAN_RADAR_59bf40b5_Tx: ComBitPosition=423, ComBitSize=8, ComSignalType=UINT8, ComSystemTemplateSystemSignalRef=OBJ_VELOCITY_ERR_CRR_COEF_030
            OBJ_VELOCITY_LAT_030_oRDR_TRACKER_OBJ_030_oPCAN_RADAR_5609c53f_Tx: ComBitPosition=126, ComBitSize=15, ComSignalType=UINT16, ComSystemTemplateSystemSignalRef=OBJ_VELOCITY_LAT_030
            OBJ_VELOCITY_LAT_ERR_030_oRDR_TRACKER_OBJ_030_oPCAN_RADAR_62f3b56e_Tx: ComBitPosition=151, ComBitSize=8, ComSignalType=UINT8, ComSystemTemplateSystemSignalRef=OBJ_VELOCITY_LAT_ERR_030
            OBJ_VELOCITY_LONG_030_oRDR_TRACKER_OBJ_030_oPCAN_RADAR_0684bdf9_Tx: ComBitPosition=110, ComBitSize=15, ComSignalType=UINT16, ComSystemTemplateSystemSignalRef=OBJ_VELOCITY_LONG_030
            OBJ_VELOCITY_LONG_ERR_030_oRDR_TRACKER_OBJ_030_oPCAN_RADAR_8e718aae_Tx: ComBitPosition=143, ComBitSize=8, ComSignalType=UINT8, ComSystemTemplateSystemSignalRef=OBJ_VELOCITY_LONG_ERR_030
            OBJ_YAW_ANGLE_030_oRDR_TRACKER_OBJ_030_oPCAN_RADAR_bab5817f_Tx: ComBitPosition=155, ComBitSize=12, ComSignalType=UINT16, ComSystemTemplateSystemSignalRef=OBJ_YAW_ANGLE_030
            OBJ_YAW_ANGLE_ERR_030_oRDR_TRACKER_OBJ_030_oPCAN_RADAR_6fb887a8_Tx: ComBitPosition=175, ComBitSize=7, ComSignalType=UINT8, ComSystemTemplateSystemSignalRef=OBJ_YAW_ANGLE_ERR_030
            OBJ_YAW_RATE_030_oRDR_TRACKER_OBJ_030_oPCAN_RADAR_9f3aa438_Tx: ComBitPosition=399, ComBitSize=10, ComSignalType=UINT16, ComSystemTemplateSystemSignalRef=OBJ_YAW_RATE_030
            OBJ_YAW_RATE_ERR_030_oRDR_TRACKER_OBJ_030_oPCAN_RADAR_a0e233e4_Tx: ComBitPosition=388, ComBitSize=5, ComSignalType=UINT8, ComSystemTemplateSystemSignalRef=OBJ_YAW_RATE_ERR_030
        SG_TrackerObject031_oRDR_TRACKER_OBJ_031_oPCAN_RADAR_520c655f_Tx: ComSystemTemplateSignalGroupRef=SG_TrackerObject031
          49 x ComGroupSignal, all with ComSignalEndianness=BIG_ENDIAN, ComSignalInitValue=0, ComTransferProperty=PENDING:
            OBJ_ACCELERATION_LAT_031_oRDR_TRACKER_OBJ_031_oPCAN_RADAR_5c283e28_Tx: ComBitPosition=177, ComBitSize=10, ComSignalType=UINT16, ComSystemTemplateSystemSignalRef=OBJ_ACCELERATION_LAT_031
            OBJ_ACCELERATION_LAT_ERR_031_oRDR_TRACKER_OBJ_031_oPCAN_RADAR_89dc0496_Tx: ComBitPosition=223, ComBitSize=8, ComSignalType=UINT8, ComSystemTemplateSystemSignalRef=OBJ_ACCELERATION_LAT_ERR_031
            OBJ_ACCELERATION_LONG_031_oRDR_TRACKER_OBJ_031_oPCAN_RADAR_2ed867c8_Tx: ComBitPosition=193, ComBitSize=10, ComSignalType=UINT16, ComSystemTemplateSystemSignalRef=OBJ_ACCELERATION_LONG_031
            OBJ_ACCELERATION_LONG_ERR_031_oRDR_TRACKER_OBJ_031_oPCAN_RADAR_9679a13c_Tx: ComBitPosition=215, ComBitSize=8, ComSignalType=UINT8, ComSystemTemplateSystemSignalRef=OBJ_ACCELERATION_LONG_ERR_031
            OBJ_ACCEL_ERR_CRR_COEF_031_oRDR_TRACKER_OBJ_031_oPCAN_RADAR_36da805a_Tx: ComBitPosition=431, ComBitSize=8, ComSignalType=UINT8, ComSystemTemplateSystemSignalRef=OBJ_ACCEL_ERR_CRR_COEF_031
            OBJ_ALIVE_TIME_031_oRDR_TRACKER_OBJ_031_oPCAN_RADAR_4eb92c74_Tx: ComBitPosition=255, ComBitSize=16, ComSignalType=UINT16, ComSystemTemplateSystemSignalRef=OBJ_ALIVE_TIME_031
            OBJ_CLS_TYPE1_031_oRDR_TRACKER_OBJ_031_oPCAN_RADAR_d962cd52_Tx: ComBitPosition=271, ComBitSize=4, ComSignalType=UINT8, ComSystemTemplateSystemSignalRef=OBJ_CLS_TYPE1_031
            OBJ_CLS_TYPE1_PROB_031_oRDR_TRACKER_OBJ_031_oPCAN_RADAR_713a1aa1_Tx: ComBitPosition=303, ComBitSize=8, ComSignalType=UINT8, ComSystemTemplateSystemSignalRef=OBJ_CLS_TYPE1_PROB_031
            OBJ_CLS_TYPE2_031_oRDR_TRACKER_OBJ_031_oPCAN_RADAR_948acd35_Tx: ComBitPosition=267, ComBitSize=4, ComSignalType=UINT8, ComSystemTemplateSystemSignalRef=OBJ_CLS_TYPE2_031
            OBJ_CLS_TYPE2_PROB_031_oRDR_TRACKER_OBJ_031_oPCAN_RADAR_b80e01ac_Tx: ComBitPosition=311, ComBitSize=8, ComSignalType=UINT8, ComSystemTemplateSystemSignalRef=OBJ_CLS_TYPE2_PROB_031
            OBJ_CLS_TYPE3_031_oRDR_TRACKER_OBJ_031_oPCAN_RADAR_190230d7_Tx: ComBitPosition=279, ComBitSize=4, ComSignalType=UINT8, ComSystemTemplateSystemSignalRef=OBJ_CLS_TYPE3_031
            OBJ_CLS_TYPE3_PROB_031_oRDR_TRACKER_OBJ_031_oPCAN_RADAR_ff1df757_Tx: ComBitPosition=319, ComBitSize=8, ComSignalType=UINT8, ComSystemTemplateSystemSignalRef=OBJ_CLS_TYPE3_PROB_031
            OBJ_CLS_TYPE4_031_oRDR_TRACKER_OBJ_031_oPCAN_RADAR_0f5acdfb_Tx: ComBitPosition=275, ComBitSize=4, ComSignalType=UINT8, ComSystemTemplateSystemSignalRef=OBJ_CLS_TYPE4_031
            OBJ_CLS_TYPE4_PROB_031_oRDR_TRACKER_OBJ_031_oPCAN_RADAR_f11731f7_Tx: ComBitPosition=327, ComBitSize=8, ComSignalType=UINT8, ComSystemTemplateSystemSignalRef=OBJ_CLS_TYPE4_PROB_031
            OBJ_CLS_TYPE5_031_oRDR_TRACKER_OBJ_031_oPCAN_RADAR_82d23019_Tx: ComBitPosition=287, ComBitSize=4, ComSignalType=UINT8, ComSystemTemplateSystemSignalRef=OBJ_CLS_TYPE5_031
            OBJ_CLS_TYPE5_PROB_031_oRDR_TRACKER_OBJ_031_oPCAN_RADAR_b604c70c_Tx: ComBitPosition=335, ComBitSize=8, ComSignalType=UINT8, ComSystemTemplateSystemSignalRef=OBJ_CLS_TYPE5_PROB_031
            OBJ_CLS_TYPE6_031_oRDR_TRACKER_OBJ_031_oPCAN_RADAR_cf3a307e_Tx: ComBitPosition=282, ComBitSize=4, ComSignalType=UINT8, ComSystemTemplateSystemSignalRef=OBJ_CLS_TYPE6_031
            OBJ_CLS_TYPE6_PROB_031_oRDR_TRACKER_OBJ_031_oPCAN_RADAR_7f30dc01_Tx: ComBitPosition=343, ComBitSize=8, ComSignalType=UINT8, ComSystemTemplateSystemSignalRef=OBJ_CLS_TYPE6_PROB_031
            OBJ_DIMENSION_LENGTH_031_oRDR_TRACKER_OBJ_031_oPCAN_RADAR_9bfc9e16_Tx: ComBitPosition=37, ComBitSize=12, ComSignalType=UINT16, ComSystemTemplateSystemSignalRef=OBJ_DIMENSION_LENGTH_031
            OBJ_DIMENSION_LENGTH_ERR_031_oRDR_TRACKER_OBJ_031_oPCAN_RADAR_a004816c_Tx: ComBitPosition=41, ComBitSize=10, ComSignalType=UINT16, ComSystemTemplateSystemSignalRef=OBJ_DIMENSION_LENGTH_ERR_031
            OBJ_DIMENSION_WIDTH_031_oRDR_TRACKER_OBJ_031_oPCAN_RADAR_b83269bb_Tx: ComBitPosition=17, ComBitSize=10, ComSignalType=UINT16, ComSystemTemplateSystemSignalRef=OBJ_DIMENSION_WIDTH_031
            OBJ_DIMENSION_WIDTH_ERR_031_oRDR_TRACKER_OBJ_031_oPCAN_RADAR_5890ae53_Tx: ComBitPosition=23, ComBitSize=6, ComSignalType=UINT8, ComSystemTemplateSystemSignalRef=OBJ_DIMENSION_WIDTH_ERR_031
            OBJ_EXISTENCE_PROB_031_oRDR_TRACKER_OBJ_031_oPCAN_RADAR_b38eed86_Tx: ComBitPosition=229, ComBitSize=14, ComSignalType=UINT16, ComSystemTemplateSystemSignalRef=OBJ_EXISTENCE_PROB_031
            OBJ_GROUP_ID_031_oRDR_TRACKER_OBJ_031_oPCAN_RADAR_3afcf92b_Tx: ComBitPosition=405, ComBitSize=6, ComSignalType=UINT8, ComSystemTemplateSystemSignalRef=OBJ_GROUP_ID_031
            OBJ_ID_031_oRDR_TRACKER_OBJ_031_oPCAN_RADAR_c9d2d22c_Tx: ComBitPosition=7, ComBitSize=8, ComSignalType=UINT8, ComSystemTemplateSystemSignalRef=OBJ_ID_031
            OBJ_MEASUREMENT_STATUS_031_oRDR_TRACKER_OBJ_031_oPCAN_RADAR_b600a091_Tx: ComBitPosition=14, ComBitSize=3, ComSignalType=UINT8, ComSystemTemplateSystemSignalRef=OBJ_MEASUREMENT_STATUS_031
            OBJ_MH_CRC16_031_oRDR_TRACKER_OBJ_031_oPCAN_RADAR_ca6017ad_Tx: ComBitPosition=495, ComBitSize=16, ComSignalType=UINT16, ComSystemTemplateSystemSignalRef=OBJ_MH_CRC16_031
            OBJ_MH_CYCLE_COUNTER_031_oRDR_TRACKER_OBJ_031_oPCAN_RADAR_bb844d4c_Tx: ComBitPosition=487, ComBitSize=8, ComSignalType=UINT8, ComSystemTemplateSystemSignalRef=OBJ_MH_CYCLE_COUNTER_031
            OBJ_MOVEMENT_STATUS_031_oRDR_TRACKER_OBJ_031_oPCAN_RADAR_99ae35dd_Tx: ComBitPosition=196, ComBitSize=3, ComSignalType=UINT8, ComSystemTemplateSystemSignalRef=OBJ_MOVEMENT_STATUS_031
            OBJ_POS_ERR_CRR_COEF_031_oRDR_TRACKER_OBJ_031_oPCAN_RADAR_09d1f5e7_Tx: ComBitPosition=415, ComBitSize=8, ComSignalType=UINT8, ComSystemTemplateSystemSignalRef=OBJ_POS_ERR_CRR_COEF_031
            OBJ_POS_LAT_031_oRDR_TRACKER_OBJ_031_oPCAN_RADAR_eb7e08ab_Tx: ComBitPosition=79, ComBitSize=16, ComSignalType=UINT16, ComSystemTemplateSystemSignalRef=OBJ_POS_LAT_031
            OBJ_POS_LAT_ERR_031_oRDR_TRACKER_OBJ_031_oPCAN_RADAR_ef32589c_Tx: ComBitPosition=103, ComBitSize=8, ComSignalType=UINT8, ComSystemTemplateSystemSignalRef=OBJ_POS_LAT_ERR_031
            OBJ_POS_LONG_031_oRDR_TRACKER_OBJ_031_oPCAN_RADAR_5adee364_Tx: ComBitPosition=63, ComBitSize=16, ComSignalType=UINT16, ComSystemTemplateSystemSignalRef=OBJ_POS_LONG_031
            OBJ_POS_LONG_ERR_031_oRDR_TRACKER_OBJ_031_oPCAN_RADAR_76caa67e_Tx: ComBitPosition=95, ComBitSize=8, ComSignalType=UINT8, ComSystemTemplateSystemSignalRef=OBJ_POS_LONG_ERR_031
            OBJ_RCS_031_oRDR_TRACKER_OBJ_031_oPCAN_RADAR_c9b15eac_Tx: ComBitPosition=351, ComBitSize=7, ComSignalType=UINT8, ComSystemTemplateSystemSignalRef=OBJ_RCS_031
            OBJ_REF_PT_LAT_OFFSET_031_oRDR_TRACKER_OBJ_031_oPCAN_RADAR_3c8c35d9_Tx: ComBitPosition=370, ComBitSize=14, ComSignalType=UINT16, ComSystemTemplateSystemSignalRef=OBJ_REF_PT_LAT_OFFSET_031
            OBJ_REF_PT_LONG_OFFSET_031_oRDR_TRACKER_OBJ_031_oPCAN_RADAR_73dec5da_Tx: ComBitPosition=357, ComBitSize=14, ComSignalType=UINT16, ComSystemTemplateSystemSignalRef=OBJ_REF_PT_LONG_OFFSET_031
            OBJ_TIMESTAMP_OFFSET_031_oRDR_TRACKER_OBJ_031_oPCAN_RADAR_c91d5efa_Tx: ComBitPosition=247, ComBitSize=8, ComSignalType=UINT8, ComSystemTemplateSystemSignalRef=OBJ_TIMESTAMP_OFFSET_031
            OBJ_TRACK_MOTION_MODEL_031_oRDR_TRACKER_OBJ_031_oPCAN_RADAR_051e5f27_Tx: ComBitPosition=9, ComBitSize=2, ComSignalType=UINT8, ComSystemTemplateSystemSignalRef=OBJ_TRACK_MOTION_MODEL_031
            OBJ_VEH_TRACK_FLAG_031_oRDR_TRACKER_OBJ_031_oPCAN_RADAR_8734a97a_Tx: ComBitPosition=10, ComBitSize=1, ComSignalType=BOOLEAN, ComSystemTemplateSystemSignalRef=OBJ_VEH_TRACK_FLAG_031
            OBJ_VELOCITY_ERR_CRR_COEF_031_oRDR_TRACKER_OBJ_031_oPCAN_RADAR_a0abc806_Tx: ComBitPosition=423, ComBitSize=8, ComSignalType=UINT8, ComSystemTemplateSystemSignalRef=OBJ_VELOCITY_ERR_CRR_COEF_031
            OBJ_VELOCITY_LAT_031_oRDR_TRACKER_OBJ_031_oPCAN_RADAR_af1d4d8c_Tx: ComBitPosition=126, ComBitSize=15, ComSignalType=UINT16, ComSystemTemplateSystemSignalRef=OBJ_VELOCITY_LAT_031
            OBJ_VELOCITY_LAT_ERR_031_oRDR_TRACKER_OBJ_031_oPCAN_RADAR_9be73ddd_Tx: ComBitPosition=151, ComBitSize=8, ComSignalType=UINT8, ComSystemTemplateSystemSignalRef=OBJ_VELOCITY_LAT_ERR_031
            OBJ_VELOCITY_LONG_031_oRDR_TRACKER_OBJ_031_oPCAN_RADAR_ff90354a_Tx: ComBitPosition=110, ComBitSize=15, ComSignalType=UINT16, ComSystemTemplateSystemSignalRef=OBJ_VELOCITY_LONG_031
            OBJ_VELOCITY_LONG_ERR_031_oRDR_TRACKER_OBJ_031_oPCAN_RADAR_7765021d_Tx: ComBitPosition=143, ComBitSize=8, ComSignalType=UINT8, ComSystemTemplateSystemSignalRef=OBJ_VELOCITY_LONG_ERR_031
            OBJ_YAW_ANGLE_031_oRDR_TRACKER_OBJ_031_oPCAN_RADAR_43a109cc_Tx: ComBitPosition=155, ComBitSize=12, ComSignalType=UINT16, ComSystemTemplateSystemSignalRef=OBJ_YAW_ANGLE_031
            OBJ_YAW_ANGLE_ERR_031_oRDR_TRACKER_OBJ_031_oPCAN_RADAR_96ac0f1b_Tx: ComBitPosition=175, ComBitSize=7, ComSignalType=UINT8, ComSystemTemplateSystemSignalRef=OBJ_YAW_ANGLE_ERR_031
            OBJ_YAW_RATE_031_oRDR_TRACKER_OBJ_031_oPCAN_RADAR_662e2c8b_Tx: ComBitPosition=399, ComBitSize=10, ComSignalType=UINT16, ComSystemTemplateSystemSignalRef=OBJ_YAW_RATE_031
            OBJ_YAW_RATE_ERR_031_oRDR_TRACKER_OBJ_031_oPCAN_RADAR_59f6bb57_Tx: ComBitPosition=388, ComBitSize=5, ComSignalType=UINT8, ComSystemTemplateSystemSignalRef=OBJ_YAW_RATE_ERR_031
        SG_TrackerObject032_oRDR_TRACKER_OBJ_032_oPCAN_RADAR_8240facb_Tx: ComSystemTemplateSignalGroupRef=SG_TrackerObject032
          49 x ComGroupSignal, all with ComSignalEndianness=BIG_ENDIAN, ComSignalInitValue=0, ComTransferProperty=PENDING:
            OBJ_ACCELERATION_LAT_032_oRDR_TRACKER_OBJ_032_oPCAN_RADAR_8c64a1bc_Tx: ComBitPosition=177, ComBitSize=10, ComSignalType=UINT16, ComSystemTemplateSystemSignalRef=OBJ_ACCELERATION_LAT_032
            OBJ_ACCELERATION_LAT_ERR_032_oRDR_TRACKER_OBJ_032_oPCAN_RADAR_59909b02_Tx: ComBitPosition=223, ComBitSize=8, ComSignalType=UINT8, ComSystemTemplateSystemSignalRef=OBJ_ACCELERATION_LAT_ERR_032
            OBJ_ACCELERATION_LONG_032_oRDR_TRACKER_OBJ_032_oPCAN_RADAR_fe94f85c_Tx: ComBitPosition=193, ComBitSize=10, ComSignalType=UINT16, ComSystemTemplateSystemSignalRef=OBJ_ACCELERATION_LONG_032
            OBJ_ACCELERATION_LONG_ERR_032_oRDR_TRACKER_OBJ_032_oPCAN_RADAR_46353ea8_Tx: ComBitPosition=215, ComBitSize=8, ComSignalType=UINT8, ComSystemTemplateSystemSignalRef=OBJ_ACCELERATION_LONG_ERR_032
            OBJ_ACCEL_ERR_CRR_COEF_032_oRDR_TRACKER_OBJ_032_oPCAN_RADAR_e6961fce_Tx: ComBitPosition=431, ComBitSize=8, ComSignalType=UINT8, ComSystemTemplateSystemSignalRef=OBJ_ACCEL_ERR_CRR_COEF_032
            OBJ_ALIVE_TIME_032_oRDR_TRACKER_OBJ_032_oPCAN_RADAR_9ef5b3e0_Tx: ComBitPosition=255, ComBitSize=16, ComSignalType=UINT16, ComSystemTemplateSystemSignalRef=OBJ_ALIVE_TIME_032
            OBJ_CLS_TYPE1_032_oRDR_TRACKER_OBJ_032_oPCAN_RADAR_092e52c6_Tx: ComBitPosition=271, ComBitSize=4, ComSignalType=UINT8, ComSystemTemplateSystemSignalRef=OBJ_CLS_TYPE1_032
            OBJ_CLS_TYPE1_PROB_032_oRDR_TRACKER_OBJ_032_oPCAN_RADAR_a1768535_Tx: ComBitPosition=303, ComBitSize=8, ComSignalType=UINT8, ComSystemTemplateSystemSignalRef=OBJ_CLS_TYPE1_PROB_032
            OBJ_CLS_TYPE2_032_oRDR_TRACKER_OBJ_032_oPCAN_RADAR_44c652a1_Tx: ComBitPosition=267, ComBitSize=4, ComSignalType=UINT8, ComSystemTemplateSystemSignalRef=OBJ_CLS_TYPE2_032
            OBJ_CLS_TYPE2_PROB_032_oRDR_TRACKER_OBJ_032_oPCAN_RADAR_68429e38_Tx: ComBitPosition=311, ComBitSize=8, ComSignalType=UINT8, ComSystemTemplateSystemSignalRef=OBJ_CLS_TYPE2_PROB_032
            OBJ_CLS_TYPE3_032_oRDR_TRACKER_OBJ_032_oPCAN_RADAR_c94eaf43_Tx: ComBitPosition=279, ComBitSize=4, ComSignalType=UINT8, ComSystemTemplateSystemSignalRef=OBJ_CLS_TYPE3_032
            OBJ_CLS_TYPE3_PROB_032_oRDR_TRACKER_OBJ_032_oPCAN_RADAR_2f5168c3_Tx: ComBitPosition=319, ComBitSize=8, ComSignalType=UINT8, ComSystemTemplateSystemSignalRef=OBJ_CLS_TYPE3_PROB_032
            OBJ_CLS_TYPE4_032_oRDR_TRACKER_OBJ_032_oPCAN_RADAR_df16526f_Tx: ComBitPosition=275, ComBitSize=4, ComSignalType=UINT8, ComSystemTemplateSystemSignalRef=OBJ_CLS_TYPE4_032
            OBJ_CLS_TYPE4_PROB_032_oRDR_TRACKER_OBJ_032_oPCAN_RADAR_215bae63_Tx: ComBitPosition=327, ComBitSize=8, ComSignalType=UINT8, ComSystemTemplateSystemSignalRef=OBJ_CLS_TYPE4_PROB_032
            OBJ_CLS_TYPE5_032_oRDR_TRACKER_OBJ_032_oPCAN_RADAR_529eaf8d_Tx: ComBitPosition=287, ComBitSize=4, ComSignalType=UINT8, ComSystemTemplateSystemSignalRef=OBJ_CLS_TYPE5_032
            OBJ_CLS_TYPE5_PROB_032_oRDR_TRACKER_OBJ_032_oPCAN_RADAR_66485898_Tx: ComBitPosition=335, ComBitSize=8, ComSignalType=UINT8, ComSystemTemplateSystemSignalRef=OBJ_CLS_TYPE5_PROB_032
            OBJ_CLS_TYPE6_032_oRDR_TRACKER_OBJ_032_oPCAN_RADAR_1f76afea_Tx: ComBitPosition=282, ComBitSize=4, ComSignalType=UINT8, ComSystemTemplateSystemSignalRef=OBJ_CLS_TYPE6_032
            OBJ_CLS_TYPE6_PROB_032_oRDR_TRACKER_OBJ_032_oPCAN_RADAR_af7c4395_Tx: ComBitPosition=343, ComBitSize=8, ComSignalType=UINT8, ComSystemTemplateSystemSignalRef=OBJ_CLS_TYPE6_PROB_032
            OBJ_DIMENSION_LENGTH_032_oRDR_TRACKER_OBJ_032_oPCAN_RADAR_4bb00182_Tx: ComBitPosition=37, ComBitSize=12, ComSignalType=UINT16, ComSystemTemplateSystemSignalRef=OBJ_DIMENSION_LENGTH_032
            OBJ_DIMENSION_LENGTH_ERR_032_oRDR_TRACKER_OBJ_032_oPCAN_RADAR_70481ef8_Tx: ComBitPosition=41, ComBitSize=10, ComSignalType=UINT16, ComSystemTemplateSystemSignalRef=OBJ_DIMENSION_LENGTH_ERR_032
            OBJ_DIMENSION_WIDTH_032_oRDR_TRACKER_OBJ_032_oPCAN_RADAR_687ef62f_Tx: ComBitPosition=17, ComBitSize=10, ComSignalType=UINT16, ComSystemTemplateSystemSignalRef=OBJ_DIMENSION_WIDTH_032
            OBJ_DIMENSION_WIDTH_ERR_032_oRDR_TRACKER_OBJ_032_oPCAN_RADAR_88dc31c7_Tx: ComBitPosition=23, ComBitSize=6, ComSignalType=UINT8, ComSystemTemplateSystemSignalRef=OBJ_DIMENSION_WIDTH_ERR_032
            OBJ_EXISTENCE_PROB_032_oRDR_TRACKER_OBJ_032_oPCAN_RADAR_63c27212_Tx: ComBitPosition=229, ComBitSize=14, ComSignalType=UINT16, ComSystemTemplateSystemSignalRef=OBJ_EXISTENCE_PROB_032
            OBJ_GROUP_ID_032_oRDR_TRACKER_OBJ_032_oPCAN_RADAR_eab066bf_Tx: ComBitPosition=405, ComBitSize=6, ComSignalType=UINT8, ComSystemTemplateSystemSignalRef=OBJ_GROUP_ID_032
            OBJ_ID_032_oRDR_TRACKER_OBJ_032_oPCAN_RADAR_199e4db8_Tx: ComBitPosition=7, ComBitSize=8, ComSignalType=UINT8, ComSystemTemplateSystemSignalRef=OBJ_ID_032
            OBJ_MEASUREMENT_STATUS_032_oRDR_TRACKER_OBJ_032_oPCAN_RADAR_664c3f05_Tx: ComBitPosition=14, ComBitSize=3, ComSignalType=UINT8, ComSystemTemplateSystemSignalRef=OBJ_MEASUREMENT_STATUS_032
            OBJ_MH_CRC16_032_oRDR_TRACKER_OBJ_032_oPCAN_RADAR_1a2c8839_Tx: ComBitPosition=495, ComBitSize=16, ComSignalType=UINT16, ComSystemTemplateSystemSignalRef=OBJ_MH_CRC16_032
            OBJ_MH_CYCLE_COUNTER_032_oRDR_TRACKER_OBJ_032_oPCAN_RADAR_6bc8d2d8_Tx: ComBitPosition=487, ComBitSize=8, ComSignalType=UINT8, ComSystemTemplateSystemSignalRef=OBJ_MH_CYCLE_COUNTER_032
            OBJ_MOVEMENT_STATUS_032_oRDR_TRACKER_OBJ_032_oPCAN_RADAR_49e2aa49_Tx: ComBitPosition=196, ComBitSize=3, ComSignalType=UINT8, ComSystemTemplateSystemSignalRef=OBJ_MOVEMENT_STATUS_032
            OBJ_POS_ERR_CRR_COEF_032_oRDR_TRACKER_OBJ_032_oPCAN_RADAR_d99d6a73_Tx: ComBitPosition=415, ComBitSize=8, ComSignalType=UINT8, ComSystemTemplateSystemSignalRef=OBJ_POS_ERR_CRR_COEF_032
            OBJ_POS_LAT_032_oRDR_TRACKER_OBJ_032_oPCAN_RADAR_3b32973f_Tx: ComBitPosition=79, ComBitSize=16, ComSignalType=UINT16, ComSystemTemplateSystemSignalRef=OBJ_POS_LAT_032
            OBJ_POS_LAT_ERR_032_oRDR_TRACKER_OBJ_032_oPCAN_RADAR_3f7ec708_Tx: ComBitPosition=103, ComBitSize=8, ComSignalType=UINT8, ComSystemTemplateSystemSignalRef=OBJ_POS_LAT_ERR_032
            OBJ_POS_LONG_032_oRDR_TRACKER_OBJ_032_oPCAN_RADAR_8a927cf0_Tx: ComBitPosition=63, ComBitSize=16, ComSignalType=UINT16, ComSystemTemplateSystemSignalRef=OBJ_POS_LONG_032
            OBJ_POS_LONG_ERR_032_oRDR_TRACKER_OBJ_032_oPCAN_RADAR_a68639ea_Tx: ComBitPosition=95, ComBitSize=8, ComSignalType=UINT8, ComSystemTemplateSystemSignalRef=OBJ_POS_LONG_ERR_032
            OBJ_RCS_032_oRDR_TRACKER_OBJ_032_oPCAN_RADAR_19fdc138_Tx: ComBitPosition=351, ComBitSize=7, ComSignalType=UINT8, ComSystemTemplateSystemSignalRef=OBJ_RCS_032
            OBJ_REF_PT_LAT_OFFSET_032_oRDR_TRACKER_OBJ_032_oPCAN_RADAR_ecc0aa4d_Tx: ComBitPosition=370, ComBitSize=14, ComSignalType=UINT16, ComSystemTemplateSystemSignalRef=OBJ_REF_PT_LAT_OFFSET_032
            OBJ_REF_PT_LONG_OFFSET_032_oRDR_TRACKER_OBJ_032_oPCAN_RADAR_a3925a4e_Tx: ComBitPosition=357, ComBitSize=14, ComSignalType=UINT16, ComSystemTemplateSystemSignalRef=OBJ_REF_PT_LONG_OFFSET_032
            OBJ_TIMESTAMP_OFFSET_032_oRDR_TRACKER_OBJ_032_oPCAN_RADAR_1951c16e_Tx: ComBitPosition=247, ComBitSize=8, ComSignalType=UINT8, ComSystemTemplateSystemSignalRef=OBJ_TIMESTAMP_OFFSET_032
            OBJ_TRACK_MOTION_MODEL_032_oRDR_TRACKER_OBJ_032_oPCAN_RADAR_d552c0b3_Tx: ComBitPosition=9, ComBitSize=2, ComSignalType=UINT8, ComSystemTemplateSystemSignalRef=OBJ_TRACK_MOTION_MODEL_032
            OBJ_VEH_TRACK_FLAG_032_oRDR_TRACKER_OBJ_032_oPCAN_RADAR_577836ee_Tx: ComBitPosition=10, ComBitSize=1, ComSignalType=BOOLEAN, ComSystemTemplateSystemSignalRef=OBJ_VEH_TRACK_FLAG_032
            OBJ_VELOCITY_ERR_CRR_COEF_032_oRDR_TRACKER_OBJ_032_oPCAN_RADAR_70e75792_Tx: ComBitPosition=423, ComBitSize=8, ComSignalType=UINT8, ComSystemTemplateSystemSignalRef=OBJ_VELOCITY_ERR_CRR_COEF_032
            OBJ_VELOCITY_LAT_032_oRDR_TRACKER_OBJ_032_oPCAN_RADAR_7f51d218_Tx: ComBitPosition=126, ComBitSize=15, ComSignalType=UINT16, ComSystemTemplateSystemSignalRef=OBJ_VELOCITY_LAT_032
            OBJ_VELOCITY_LAT_ERR_032_oRDR_TRACKER_OBJ_032_oPCAN_RADAR_4baba249_Tx: ComBitPosition=151, ComBitSize=8, ComSignalType=UINT8, ComSystemTemplateSystemSignalRef=OBJ_VELOCITY_LAT_ERR_032
            OBJ_VELOCITY_LONG_032_oRDR_TRACKER_OBJ_032_oPCAN_RADAR_2fdcaade_Tx: ComBitPosition=110, ComBitSize=15, ComSignalType=UINT16, ComSystemTemplateSystemSignalRef=OBJ_VELOCITY_LONG_032
            OBJ_VELOCITY_LONG_ERR_032_oRDR_TRACKER_OBJ_032_oPCAN_RADAR_a7299d89_Tx: ComBitPosition=143, ComBitSize=8, ComSignalType=UINT8, ComSystemTemplateSystemSignalRef=OBJ_VELOCITY_LONG_ERR_032
            OBJ_YAW_ANGLE_032_oRDR_TRACKER_OBJ_032_oPCAN_RADAR_93ed9658_Tx: ComBitPosition=155, ComBitSize=12, ComSignalType=UINT16, ComSystemTemplateSystemSignalRef=OBJ_YAW_ANGLE_032
            OBJ_YAW_ANGLE_ERR_032_oRDR_TRACKER_OBJ_032_oPCAN_RADAR_46e0908f_Tx: ComBitPosition=175, ComBitSize=7, ComSignalType=UINT8, ComSystemTemplateSystemSignalRef=OBJ_YAW_ANGLE_ERR_032
            OBJ_YAW_RATE_032_oRDR_TRACKER_OBJ_032_oPCAN_RADAR_b662b31f_Tx: ComBitPosition=399, ComBitSize=10, ComSignalType=UINT16, ComSystemTemplateSystemSignalRef=OBJ_YAW_RATE_032
            OBJ_YAW_RATE_ERR_032_oRDR_TRACKER_OBJ_032_oPCAN_RADAR_89ba24c3_Tx: ComBitPosition=388, ComBitSize=5, ComSignalType=UINT8, ComSystemTemplateSystemSignalRef=OBJ_YAW_RATE_ERR_032
        SG_TrackerObject033_oRDR_TRACKER_OBJ_033_oPCAN_RADAR_7b547278_Tx: ComSystemTemplateSignalGroupRef=SG_TrackerObject033
          49 x ComGroupSignal, all with ComSignalEndianness=BIG_ENDIAN, ComSignalInitValue=0, ComTransferProperty=PENDING:
            OBJ_ACCELERATION_LAT_033_oRDR_TRACKER_OBJ_033_oPCAN_RADAR_7570290f_Tx: ComBitPosition=177, ComBitSize=10, ComSignalType=UINT16, ComSystemTemplateSystemSignalRef=OBJ_ACCELERATION_LAT_033
            OBJ_ACCELERATION_LAT_ERR_033_oRDR_TRACKER_OBJ_033_oPCAN_RADAR_a08413b1_Tx: ComBitPosition=223, ComBitSize=8, ComSignalType=UINT8, ComSystemTemplateSystemSignalRef=OBJ_ACCELERATION_LAT_ERR_033
            OBJ_ACCELERATION_LONG_033_oRDR_TRACKER_OBJ_033_oPCAN_RADAR_078070ef_Tx: ComBitPosition=193, ComBitSize=10, ComSignalType=UINT16, ComSystemTemplateSystemSignalRef=OBJ_ACCELERATION_LONG_033
            OBJ_ACCELERATION_LONG_ERR_033_oRDR_TRACKER_OBJ_033_oPCAN_RADAR_bf21b61b_Tx: ComBitPosition=215, ComBitSize=8, ComSignalType=UINT8, ComSystemTemplateSystemSignalRef=OBJ_ACCELERATION_LONG_ERR_033
            OBJ_ACCEL_ERR_CRR_COEF_033_oRDR_TRACKER_OBJ_033_oPCAN_RADAR_1f82977d_Tx: ComBitPosition=431, ComBitSize=8, ComSignalType=UINT8, ComSystemTemplateSystemSignalRef=OBJ_ACCEL_ERR_CRR_COEF_033
            OBJ_ALIVE_TIME_033_oRDR_TRACKER_OBJ_033_oPCAN_RADAR_67e13b53_Tx: ComBitPosition=255, ComBitSize=16, ComSignalType=UINT16, ComSystemTemplateSystemSignalRef=OBJ_ALIVE_TIME_033
            OBJ_CLS_TYPE1_033_oRDR_TRACKER_OBJ_033_oPCAN_RADAR_f03ada75_Tx: ComBitPosition=271, ComBitSize=4, ComSignalType=UINT8, ComSystemTemplateSystemSignalRef=OBJ_CLS_TYPE1_033
            OBJ_CLS_TYPE1_PROB_033_oRDR_TRACKER_OBJ_033_oPCAN_RADAR_58620d86_Tx: ComBitPosition=303, ComBitSize=8, ComSignalType=UINT8, ComSystemTemplateSystemSignalRef=OBJ_CLS_TYPE1_PROB_033
            OBJ_CLS_TYPE2_033_oRDR_TRACKER_OBJ_033_oPCAN_RADAR_bdd2da12_Tx: ComBitPosition=267, ComBitSize=4, ComSignalType=UINT8, ComSystemTemplateSystemSignalRef=OBJ_CLS_TYPE2_033
            OBJ_CLS_TYPE2_PROB_033_oRDR_TRACKER_OBJ_033_oPCAN_RADAR_9156168b_Tx: ComBitPosition=311, ComBitSize=8, ComSignalType=UINT8, ComSystemTemplateSystemSignalRef=OBJ_CLS_TYPE2_PROB_033
            OBJ_CLS_TYPE3_033_oRDR_TRACKER_OBJ_033_oPCAN_RADAR_305a27f0_Tx: ComBitPosition=279, ComBitSize=4, ComSignalType=UINT8, ComSystemTemplateSystemSignalRef=OBJ_CLS_TYPE3_033
            OBJ_CLS_TYPE3_PROB_033_oRDR_TRACKER_OBJ_033_oPCAN_RADAR_d645e070_Tx: ComBitPosition=319, ComBitSize=8, ComSignalType=UINT8, ComSystemTemplateSystemSignalRef=OBJ_CLS_TYPE3_PROB_033
            OBJ_CLS_TYPE4_033_oRDR_TRACKER_OBJ_033_oPCAN_RADAR_2602dadc_Tx: ComBitPosition=275, ComBitSize=4, ComSignalType=UINT8, ComSystemTemplateSystemSignalRef=OBJ_CLS_TYPE4_033
            OBJ_CLS_TYPE4_PROB_033_oRDR_TRACKER_OBJ_033_oPCAN_RADAR_d84f26d0_Tx: ComBitPosition=327, ComBitSize=8, ComSignalType=UINT8, ComSystemTemplateSystemSignalRef=OBJ_CLS_TYPE4_PROB_033
            OBJ_CLS_TYPE5_033_oRDR_TRACKER_OBJ_033_oPCAN_RADAR_ab8a273e_Tx: ComBitPosition=287, ComBitSize=4, ComSignalType=UINT8, ComSystemTemplateSystemSignalRef=OBJ_CLS_TYPE5_033
            OBJ_CLS_TYPE5_PROB_033_oRDR_TRACKER_OBJ_033_oPCAN_RADAR_9f5cd02b_Tx: ComBitPosition=335, ComBitSize=8, ComSignalType=UINT8, ComSystemTemplateSystemSignalRef=OBJ_CLS_TYPE5_PROB_033
            OBJ_CLS_TYPE6_033_oRDR_TRACKER_OBJ_033_oPCAN_RADAR_e6622759_Tx: ComBitPosition=282, ComBitSize=4, ComSignalType=UINT8, ComSystemTemplateSystemSignalRef=OBJ_CLS_TYPE6_033
            OBJ_CLS_TYPE6_PROB_033_oRDR_TRACKER_OBJ_033_oPCAN_RADAR_5668cb26_Tx: ComBitPosition=343, ComBitSize=8, ComSignalType=UINT8, ComSystemTemplateSystemSignalRef=OBJ_CLS_TYPE6_PROB_033
            OBJ_DIMENSION_LENGTH_033_oRDR_TRACKER_OBJ_033_oPCAN_RADAR_b2a48931_Tx: ComBitPosition=37, ComBitSize=12, ComSignalType=UINT16, ComSystemTemplateSystemSignalRef=OBJ_DIMENSION_LENGTH_033
            OBJ_DIMENSION_LENGTH_ERR_033_oRDR_TRACKER_OBJ_033_oPCAN_RADAR_895c964b_Tx: ComBitPosition=41, ComBitSize=10, ComSignalType=UINT16, ComSystemTemplateSystemSignalRef=OBJ_DIMENSION_LENGTH_ERR_033
            OBJ_DIMENSION_WIDTH_033_oRDR_TRACKER_OBJ_033_oPCAN_RADAR_916a7e9c_Tx: ComBitPosition=17, ComBitSize=10, ComSignalType=UINT16, ComSystemTemplateSystemSignalRef=OBJ_DIMENSION_WIDTH_033
            OBJ_DIMENSION_WIDTH_ERR_033_oRDR_TRACKER_OBJ_033_oPCAN_RADAR_71c8b974_Tx: ComBitPosition=23, ComBitSize=6, ComSignalType=UINT8, ComSystemTemplateSystemSignalRef=OBJ_DIMENSION_WIDTH_ERR_033
            OBJ_EXISTENCE_PROB_033_oRDR_TRACKER_OBJ_033_oPCAN_RADAR_9ad6faa1_Tx: ComBitPosition=229, ComBitSize=14, ComSignalType=UINT16, ComSystemTemplateSystemSignalRef=OBJ_EXISTENCE_PROB_033
            OBJ_GROUP_ID_033_oRDR_TRACKER_OBJ_033_oPCAN_RADAR_13a4ee0c_Tx: ComBitPosition=405, ComBitSize=6, ComSignalType=UINT8, ComSystemTemplateSystemSignalRef=OBJ_GROUP_ID_033
            OBJ_ID_033_oRDR_TRACKER_OBJ_033_oPCAN_RADAR_e08ac50b_Tx: ComBitPosition=7, ComBitSize=8, ComSignalType=UINT8, ComSystemTemplateSystemSignalRef=OBJ_ID_033
            OBJ_MEASUREMENT_STATUS_033_oRDR_TRACKER_OBJ_033_oPCAN_RADAR_9f58b7b6_Tx: ComBitPosition=14, ComBitSize=3, ComSignalType=UINT8, ComSystemTemplateSystemSignalRef=OBJ_MEASUREMENT_STATUS_033
            OBJ_MH_CRC16_033_oRDR_TRACKER_OBJ_033_oPCAN_RADAR_e338008a_Tx: ComBitPosition=495, ComBitSize=16, ComSignalType=UINT16, ComSystemTemplateSystemSignalRef=OBJ_MH_CRC16_033
            OBJ_MH_CYCLE_COUNTER_033_oRDR_TRACKER_OBJ_033_oPCAN_RADAR_92dc5a6b_Tx: ComBitPosition=487, ComBitSize=8, ComSignalType=UINT8, ComSystemTemplateSystemSignalRef=OBJ_MH_CYCLE_COUNTER_033
            OBJ_MOVEMENT_STATUS_033_oRDR_TRACKER_OBJ_033_oPCAN_RADAR_b0f622fa_Tx: ComBitPosition=196, ComBitSize=3, ComSignalType=UINT8, ComSystemTemplateSystemSignalRef=OBJ_MOVEMENT_STATUS_033
            OBJ_POS_ERR_CRR_COEF_033_oRDR_TRACKER_OBJ_033_oPCAN_RADAR_2089e2c0_Tx: ComBitPosition=415, ComBitSize=8, ComSignalType=UINT8, ComSystemTemplateSystemSignalRef=OBJ_POS_ERR_CRR_COEF_033
            OBJ_POS_LAT_033_oRDR_TRACKER_OBJ_033_oPCAN_RADAR_c2261f8c_Tx: ComBitPosition=79, ComBitSize=16, ComSignalType=UINT16, ComSystemTemplateSystemSignalRef=OBJ_POS_LAT_033
            OBJ_POS_LAT_ERR_033_oRDR_TRACKER_OBJ_033_oPCAN_RADAR_c66a4fbb_Tx: ComBitPosition=103, ComBitSize=8, ComSignalType=UINT8, ComSystemTemplateSystemSignalRef=OBJ_POS_LAT_ERR_033
            OBJ_POS_LONG_033_oRDR_TRACKER_OBJ_033_oPCAN_RADAR_7386f443_Tx: ComBitPosition=63, ComBitSize=16, ComSignalType=UINT16, ComSystemTemplateSystemSignalRef=OBJ_POS_LONG_033
            OBJ_POS_LONG_ERR_033_oRDR_TRACKER_OBJ_033_oPCAN_RADAR_5f92b159_Tx: ComBitPosition=95, ComBitSize=8, ComSignalType=UINT8, ComSystemTemplateSystemSignalRef=OBJ_POS_LONG_ERR_033
            OBJ_RCS_033_oRDR_TRACKER_OBJ_033_oPCAN_RADAR_e0e9498b_Tx: ComBitPosition=351, ComBitSize=7, ComSignalType=UINT8, ComSystemTemplateSystemSignalRef=OBJ_RCS_033
            OBJ_REF_PT_LAT_OFFSET_033_oRDR_TRACKER_OBJ_033_oPCAN_RADAR_15d422fe_Tx: ComBitPosition=370, ComBitSize=14, ComSignalType=UINT16, ComSystemTemplateSystemSignalRef=OBJ_REF_PT_LAT_OFFSET_033
            OBJ_REF_PT_LONG_OFFSET_033_oRDR_TRACKER_OBJ_033_oPCAN_RADAR_5a86d2fd_Tx: ComBitPosition=357, ComBitSize=14, ComSignalType=UINT16, ComSystemTemplateSystemSignalRef=OBJ_REF_PT_LONG_OFFSET_033
            OBJ_TIMESTAMP_OFFSET_033_oRDR_TRACKER_OBJ_033_oPCAN_RADAR_e04549dd_Tx: ComBitPosition=247, ComBitSize=8, ComSignalType=UINT8, ComSystemTemplateSystemSignalRef=OBJ_TIMESTAMP_OFFSET_033
            OBJ_TRACK_MOTION_MODEL_033_oRDR_TRACKER_OBJ_033_oPCAN_RADAR_2c464800_Tx: ComBitPosition=9, ComBitSize=2, ComSignalType=UINT8, ComSystemTemplateSystemSignalRef=OBJ_TRACK_MOTION_MODEL_033
            OBJ_VEH_TRACK_FLAG_033_oRDR_TRACKER_OBJ_033_oPCAN_RADAR_ae6cbe5d_Tx: ComBitPosition=10, ComBitSize=1, ComSignalType=BOOLEAN, ComSystemTemplateSystemSignalRef=OBJ_VEH_TRACK_FLAG_033
            OBJ_VELOCITY_ERR_CRR_COEF_033_oRDR_TRACKER_OBJ_033_oPCAN_RADAR_89f3df21_Tx: ComBitPosition=423, ComBitSize=8, ComSignalType=UINT8, ComSystemTemplateSystemSignalRef=OBJ_VELOCITY_ERR_CRR_COEF_033
            OBJ_VELOCITY_LAT_033_oRDR_TRACKER_OBJ_033_oPCAN_RADAR_86455aab_Tx: ComBitPosition=126, ComBitSize=15, ComSignalType=UINT16, ComSystemTemplateSystemSignalRef=OBJ_VELOCITY_LAT_033
            OBJ_VELOCITY_LAT_ERR_033_oRDR_TRACKER_OBJ_033_oPCAN_RADAR_b2bf2afa_Tx: ComBitPosition=151, ComBitSize=8, ComSignalType=UINT8, ComSystemTemplateSystemSignalRef=OBJ_VELOCITY_LAT_ERR_033
            OBJ_VELOCITY_LONG_033_oRDR_TRACKER_OBJ_033_oPCAN_RADAR_d6c8226d_Tx: ComBitPosition=110, ComBitSize=15, ComSignalType=UINT16, ComSystemTemplateSystemSignalRef=OBJ_VELOCITY_LONG_033
            OBJ_VELOCITY_LONG_ERR_033_oRDR_TRACKER_OBJ_033_oPCAN_RADAR_5e3d153a_Tx: ComBitPosition=143, ComBitSize=8, ComSignalType=UINT8, ComSystemTemplateSystemSignalRef=OBJ_VELOCITY_LONG_ERR_033
            OBJ_YAW_ANGLE_033_oRDR_TRACKER_OBJ_033_oPCAN_RADAR_6af91eeb_Tx: ComBitPosition=155, ComBitSize=12, ComSignalType=UINT16, ComSystemTemplateSystemSignalRef=OBJ_YAW_ANGLE_033
            OBJ_YAW_ANGLE_ERR_033_oRDR_TRACKER_OBJ_033_oPCAN_RADAR_bff4183c_Tx: ComBitPosition=175, ComBitSize=7, ComSignalType=UINT8, ComSystemTemplateSystemSignalRef=OBJ_YAW_ANGLE_ERR_033
            OBJ_YAW_RATE_033_oRDR_TRACKER_OBJ_033_oPCAN_RADAR_4f763bac_Tx: ComBitPosition=399, ComBitSize=10, ComSignalType=UINT16, ComSystemTemplateSystemSignalRef=OBJ_YAW_RATE_033
            OBJ_YAW_RATE_ERR_033_oRDR_TRACKER_OBJ_033_oPCAN_RADAR_70aeac70_Tx: ComBitPosition=388, ComBitSize=5, ComSignalType=UINT8, ComSystemTemplateSystemSignalRef=OBJ_YAW_RATE_ERR_033
        SG_TrackerObject034_oRDR_TRACKER_OBJ_034_oPCAN_RADAR_f9a8c3a2_Tx: ComSystemTemplateSignalGroupRef=SG_TrackerObject034
          49 x ComGroupSignal, all with ComSignalEndianness=BIG_ENDIAN, ComSignalInitValue=0, ComTransferProperty=PENDING:
            OBJ_ACCELERATION_LAT_034_oRDR_TRACKER_OBJ_034_oPCAN_RADAR_f78c98d5_Tx: ComBitPosition=177, ComBitSize=10, ComSignalType=UINT16, ComSystemTemplateSystemSignalRef=OBJ_ACCELERATION_LAT_034
            OBJ_ACCELERATION_LAT_ERR_034_oRDR_TRACKER_OBJ_034_oPCAN_RADAR_2278a26b_Tx: ComBitPosition=223, ComBitSize=8, ComSignalType=UINT8, ComSystemTemplateSystemSignalRef=OBJ_ACCELERATION_LAT_ERR_034
            OBJ_ACCELERATION_LONG_034_oRDR_TRACKER_OBJ_034_oPCAN_RADAR_857cc135_Tx: ComBitPosition=193, ComBitSize=10, ComSignalType=UINT16, ComSystemTemplateSystemSignalRef=OBJ_ACCELERATION_LONG_034
            OBJ_ACCELERATION_LONG_ERR_034_oRDR_TRACKER_OBJ_034_oPCAN_RADAR_3ddd07c1_Tx: ComBitPosition=215, ComBitSize=8, ComSignalType=UINT8, ComSystemTemplateSystemSignalRef=OBJ_ACCELERATION_LONG_ERR_034
            OBJ_ACCEL_ERR_CRR_COEF_034_oRDR_TRACKER_OBJ_034_oPCAN_RADAR_9d7e26a7_Tx: ComBitPosition=431, ComBitSize=8, ComSignalType=UINT8, ComSystemTemplateSystemSignalRef=OBJ_ACCEL_ERR_CRR_COEF_034
            OBJ_ALIVE_TIME_034_oRDR_TRACKER_OBJ_034_oPCAN_RADAR_e51d8a89_Tx: ComBitPosition=255, ComBitSize=16, ComSignalType=UINT16, ComSystemTemplateSystemSignalRef=OBJ_ALIVE_TIME_034
            OBJ_CLS_TYPE1_034_oRDR_TRACKER_OBJ_034_oPCAN_RADAR_72c66baf_Tx: ComBitPosition=271, ComBitSize=4, ComSignalType=UINT8, ComSystemTemplateSystemSignalRef=OBJ_CLS_TYPE1_034
            OBJ_CLS_TYPE1_PROB_034_oRDR_TRACKER_OBJ_034_oPCAN_RADAR_da9ebc5c_Tx: ComBitPosition=303, ComBitSize=8, ComSignalType=UINT8, ComSystemTemplateSystemSignalRef=OBJ_CLS_TYPE1_PROB_034
            OBJ_CLS_TYPE2_034_oRDR_TRACKER_OBJ_034_oPCAN_RADAR_3f2e6bc8_Tx: ComBitPosition=267, ComBitSize=4, ComSignalType=UINT8, ComSystemTemplateSystemSignalRef=OBJ_CLS_TYPE2_034
            OBJ_CLS_TYPE2_PROB_034_oRDR_TRACKER_OBJ_034_oPCAN_RADAR_13aaa751_Tx: ComBitPosition=311, ComBitSize=8, ComSignalType=UINT8, ComSystemTemplateSystemSignalRef=OBJ_CLS_TYPE2_PROB_034
            OBJ_CLS_TYPE3_034_oRDR_TRACKER_OBJ_034_oPCAN_RADAR_b2a6962a_Tx: ComBitPosition=279, ComBitSize=4, ComSignalType=UINT8, ComSystemTemplateSystemSignalRef=OBJ_CLS_TYPE3_034
            OBJ_CLS_TYPE3_PROB_034_oRDR_TRACKER_OBJ_034_oPCAN_RADAR_54b951aa_Tx: ComBitPosition=319, ComBitSize=8, ComSignalType=UINT8, ComSystemTemplateSystemSignalRef=OBJ_CLS_TYPE3_PROB_034
            OBJ_CLS_TYPE4_034_oRDR_TRACKER_OBJ_034_oPCAN_RADAR_a4fe6b06_Tx: ComBitPosition=275, ComBitSize=4, ComSignalType=UINT8, ComSystemTemplateSystemSignalRef=OBJ_CLS_TYPE4_034
            OBJ_CLS_TYPE4_PROB_034_oRDR_TRACKER_OBJ_034_oPCAN_RADAR_5ab3970a_Tx: ComBitPosition=327, ComBitSize=8, ComSignalType=UINT8, ComSystemTemplateSystemSignalRef=OBJ_CLS_TYPE4_PROB_034
            OBJ_CLS_TYPE5_034_oRDR_TRACKER_OBJ_034_oPCAN_RADAR_297696e4_Tx: ComBitPosition=287, ComBitSize=4, ComSignalType=UINT8, ComSystemTemplateSystemSignalRef=OBJ_CLS_TYPE5_034
            OBJ_CLS_TYPE5_PROB_034_oRDR_TRACKER_OBJ_034_oPCAN_RADAR_1da061f1_Tx: ComBitPosition=335, ComBitSize=8, ComSignalType=UINT8, ComSystemTemplateSystemSignalRef=OBJ_CLS_TYPE5_PROB_034
            OBJ_CLS_TYPE6_034_oRDR_TRACKER_OBJ_034_oPCAN_RADAR_649e9683_Tx: ComBitPosition=282, ComBitSize=4, ComSignalType=UINT8, ComSystemTemplateSystemSignalRef=OBJ_CLS_TYPE6_034
            OBJ_CLS_TYPE6_PROB_034_oRDR_TRACKER_OBJ_034_oPCAN_RADAR_d4947afc_Tx: ComBitPosition=343, ComBitSize=8, ComSignalType=UINT8, ComSystemTemplateSystemSignalRef=OBJ_CLS_TYPE6_PROB_034
            OBJ_DIMENSION_LENGTH_034_oRDR_TRACKER_OBJ_034_oPCAN_RADAR_305838eb_Tx: ComBitPosition=37, ComBitSize=12, ComSignalType=UINT16, ComSystemTemplateSystemSignalRef=OBJ_DIMENSION_LENGTH_034
            OBJ_DIMENSION_LENGTH_ERR_034_oRDR_TRACKER_OBJ_034_oPCAN_RADAR_0ba02791_Tx: ComBitPosition=41, ComBitSize=10, ComSignalType=UINT16, ComSystemTemplateSystemSignalRef=OBJ_DIMENSION_LENGTH_ERR_034
            OBJ_DIMENSION_WIDTH_034_oRDR_TRACKER_OBJ_034_oPCAN_RADAR_1396cf46_Tx: ComBitPosition=17, ComBitSize=10, ComSignalType=UINT16, ComSystemTemplateSystemSignalRef=OBJ_DIMENSION_WIDTH_034
            OBJ_DIMENSION_WIDTH_ERR_034_oRDR_TRACKER_OBJ_034_oPCAN_RADAR_f33408ae_Tx: ComBitPosition=23, ComBitSize=6, ComSignalType=UINT8, ComSystemTemplateSystemSignalRef=OBJ_DIMENSION_WIDTH_ERR_034
            OBJ_EXISTENCE_PROB_034_oRDR_TRACKER_OBJ_034_oPCAN_RADAR_182a4b7b_Tx: ComBitPosition=229, ComBitSize=14, ComSignalType=UINT16, ComSystemTemplateSystemSignalRef=OBJ_EXISTENCE_PROB_034
            OBJ_GROUP_ID_034_oRDR_TRACKER_OBJ_034_oPCAN_RADAR_91585fd6_Tx: ComBitPosition=405, ComBitSize=6, ComSignalType=UINT8, ComSystemTemplateSystemSignalRef=OBJ_GROUP_ID_034
            OBJ_ID_034_oRDR_TRACKER_OBJ_034_oPCAN_RADAR_627674d1_Tx: ComBitPosition=7, ComBitSize=8, ComSignalType=UINT8, ComSystemTemplateSystemSignalRef=OBJ_ID_034
            OBJ_MEASUREMENT_STATUS_034_oRDR_TRACKER_OBJ_034_oPCAN_RADAR_1da4066c_Tx: ComBitPosition=14, ComBitSize=3, ComSignalType=UINT8, ComSystemTemplateSystemSignalRef=OBJ_MEASUREMENT_STATUS_034
            OBJ_MH_CRC16_034_oRDR_TRACKER_OBJ_034_oPCAN_RADAR_61c4b150_Tx: ComBitPosition=495, ComBitSize=16, ComSignalType=UINT16, ComSystemTemplateSystemSignalRef=OBJ_MH_CRC16_034
            OBJ_MH_CYCLE_COUNTER_034_oRDR_TRACKER_OBJ_034_oPCAN_RADAR_1020ebb1_Tx: ComBitPosition=487, ComBitSize=8, ComSignalType=UINT8, ComSystemTemplateSystemSignalRef=OBJ_MH_CYCLE_COUNTER_034
            OBJ_MOVEMENT_STATUS_034_oRDR_TRACKER_OBJ_034_oPCAN_RADAR_320a9320_Tx: ComBitPosition=196, ComBitSize=3, ComSignalType=UINT8, ComSystemTemplateSystemSignalRef=OBJ_MOVEMENT_STATUS_034
            OBJ_POS_ERR_CRR_COEF_034_oRDR_TRACKER_OBJ_034_oPCAN_RADAR_a275531a_Tx: ComBitPosition=415, ComBitSize=8, ComSignalType=UINT8, ComSystemTemplateSystemSignalRef=OBJ_POS_ERR_CRR_COEF_034
            OBJ_POS_LAT_034_oRDR_TRACKER_OBJ_034_oPCAN_RADAR_40daae56_Tx: ComBitPosition=79, ComBitSize=16, ComSignalType=UINT16, ComSystemTemplateSystemSignalRef=OBJ_POS_LAT_034
            OBJ_POS_LAT_ERR_034_oRDR_TRACKER_OBJ_034_oPCAN_RADAR_4496fe61_Tx: ComBitPosition=103, ComBitSize=8, ComSignalType=UINT8, ComSystemTemplateSystemSignalRef=OBJ_POS_LAT_ERR_034
            OBJ_POS_LONG_034_oRDR_TRACKER_OBJ_034_oPCAN_RADAR_f17a4599_Tx: ComBitPosition=63, ComBitSize=16, ComSignalType=UINT16, ComSystemTemplateSystemSignalRef=OBJ_POS_LONG_034
            OBJ_POS_LONG_ERR_034_oRDR_TRACKER_OBJ_034_oPCAN_RADAR_dd6e0083_Tx: ComBitPosition=95, ComBitSize=8, ComSignalType=UINT8, ComSystemTemplateSystemSignalRef=OBJ_POS_LONG_ERR_034
            OBJ_RCS_034_oRDR_TRACKER_OBJ_034_oPCAN_RADAR_6215f851_Tx: ComBitPosition=351, ComBitSize=7, ComSignalType=UINT8, ComSystemTemplateSystemSignalRef=OBJ_RCS_034
            OBJ_REF_PT_LAT_OFFSET_034_oRDR_TRACKER_OBJ_034_oPCAN_RADAR_97289324_Tx: ComBitPosition=370, ComBitSize=14, ComSignalType=UINT16, ComSystemTemplateSystemSignalRef=OBJ_REF_PT_LAT_OFFSET_034
            OBJ_REF_PT_LONG_OFFSET_034_oRDR_TRACKER_OBJ_034_oPCAN_RADAR_d87a6327_Tx: ComBitPosition=357, ComBitSize=14, ComSignalType=UINT16, ComSystemTemplateSystemSignalRef=OBJ_REF_PT_LONG_OFFSET_034
            OBJ_TIMESTAMP_OFFSET_034_oRDR_TRACKER_OBJ_034_oPCAN_RADAR_62b9f807_Tx: ComBitPosition=247, ComBitSize=8, ComSignalType=UINT8, ComSystemTemplateSystemSignalRef=OBJ_TIMESTAMP_OFFSET_034
            OBJ_TRACK_MOTION_MODEL_034_oRDR_TRACKER_OBJ_034_oPCAN_RADAR_aebaf9da_Tx: ComBitPosition=9, ComBitSize=2, ComSignalType=UINT8, ComSystemTemplateSystemSignalRef=OBJ_TRACK_MOTION_MODEL_034
            OBJ_VEH_TRACK_FLAG_034_oRDR_TRACKER_OBJ_034_oPCAN_RADAR_2c900f87_Tx: ComBitPosition=10, ComBitSize=1, ComSignalType=BOOLEAN, ComSystemTemplateSystemSignalRef=OBJ_VEH_TRACK_FLAG_034
            OBJ_VELOCITY_ERR_CRR_COEF_034_oRDR_TRACKER_OBJ_034_oPCAN_RADAR_0b0f6efb_Tx: ComBitPosition=423, ComBitSize=8, ComSignalType=UINT8, ComSystemTemplateSystemSignalRef=OBJ_VELOCITY_ERR_CRR_COEF_034
            OBJ_VELOCITY_LAT_034_oRDR_TRACKER_OBJ_034_oPCAN_RADAR_04b9eb71_Tx: ComBitPosition=126, ComBitSize=15, ComSignalType=UINT16, ComSystemTemplateSystemSignalRef=OBJ_VELOCITY_LAT_034
            OBJ_VELOCITY_LAT_ERR_034_oRDR_TRACKER_OBJ_034_oPCAN_RADAR_30439b20_Tx: ComBitPosition=151, ComBitSize=8, ComSignalType=UINT8, ComSystemTemplateSystemSignalRef=OBJ_VELOCITY_LAT_ERR_034
            OBJ_VELOCITY_LONG_034_oRDR_TRACKER_OBJ_034_oPCAN_RADAR_543493b7_Tx: ComBitPosition=110, ComBitSize=15, ComSignalType=UINT16, ComSystemTemplateSystemSignalRef=OBJ_VELOCITY_LONG_034
            OBJ_VELOCITY_LONG_ERR_034_oRDR_TRACKER_OBJ_034_oPCAN_RADAR_dcc1a4e0_Tx: ComBitPosition=143, ComBitSize=8, ComSignalType=UINT8, ComSystemTemplateSystemSignalRef=OBJ_VELOCITY_LONG_ERR_034
            OBJ_YAW_ANGLE_034_oRDR_TRACKER_OBJ_034_oPCAN_RADAR_e805af31_Tx: ComBitPosition=155, ComBitSize=12, ComSignalType=UINT16, ComSystemTemplateSystemSignalRef=OBJ_YAW_ANGLE_034
            OBJ_YAW_ANGLE_ERR_034_oRDR_TRACKER_OBJ_034_oPCAN_RADAR_3d08a9e6_Tx: ComBitPosition=175, ComBitSize=7, ComSignalType=UINT8, ComSystemTemplateSystemSignalRef=OBJ_YAW_ANGLE_ERR_034
            OBJ_YAW_RATE_034_oRDR_TRACKER_OBJ_034_oPCAN_RADAR_cd8a8a76_Tx: ComBitPosition=399, ComBitSize=10, ComSignalType=UINT16, ComSystemTemplateSystemSignalRef=OBJ_YAW_RATE_034
            OBJ_YAW_RATE_ERR_034_oRDR_TRACKER_OBJ_034_oPCAN_RADAR_f2521daa_Tx: ComBitPosition=388, ComBitSize=5, ComSignalType=UINT8, ComSystemTemplateSystemSignalRef=OBJ_YAW_RATE_ERR_034
        SG_TrackerObject035_oRDR_TRACKER_OBJ_035_oPCAN_RADAR_00bc4b11_Tx: ComSystemTemplateSignalGroupRef=SG_TrackerObject035
          49 x ComGroupSignal, all with ComSignalEndianness=BIG_ENDIAN, ComSignalInitValue=0, ComTransferProperty=PENDING:
            OBJ_ACCELERATION_LAT_035_oRDR_TRACKER_OBJ_035_oPCAN_RADAR_0e981066_Tx: ComBitPosition=177, ComBitSize=10, ComSignalType=UINT16, ComSystemTemplateSystemSignalRef=OBJ_ACCELERATION_LAT_035
            OBJ_ACCELERATION_LAT_ERR_035_oRDR_TRACKER_OBJ_035_oPCAN_RADAR_db6c2ad8_Tx: ComBitPosition=223, ComBitSize=8, ComSignalType=UINT8, ComSystemTemplateSystemSignalRef=OBJ_ACCELERATION_LAT_ERR_035
            OBJ_ACCELERATION_LONG_035_oRDR_TRACKER_OBJ_035_oPCAN_RADAR_7c684986_Tx: ComBitPosition=193, ComBitSize=10, ComSignalType=UINT16, ComSystemTemplateSystemSignalRef=OBJ_ACCELERATION_LONG_035
            OBJ_ACCELERATION_LONG_ERR_035_oRDR_TRACKER_OBJ_035_oPCAN_RADAR_c4c98f72_Tx: ComBitPosition=215, ComBitSize=8, ComSignalType=UINT8, ComSystemTemplateSystemSignalRef=OBJ_ACCELERATION_LONG_ERR_035
            OBJ_ACCEL_ERR_CRR_COEF_035_oRDR_TRACKER_OBJ_035_oPCAN_RADAR_646aae14_Tx: ComBitPosition=431, ComBitSize=8, ComSignalType=UINT8, ComSystemTemplateSystemSignalRef=OBJ_ACCEL_ERR_CRR_COEF_035
            OBJ_ALIVE_TIME_035_oRDR_TRACKER_OBJ_035_oPCAN_RADAR_1c09023a_Tx: ComBitPosition=255, ComBitSize=16, ComSignalType=UINT16, ComSystemTemplateSystemSignalRef=OBJ_ALIVE_TIME_035
            OBJ_CLS_TYPE1_035_oRDR_TRACKER_OBJ_035_oPCAN_RADAR_8bd2e31c_Tx: ComBitPosition=271, ComBitSize=4, ComSignalType=UINT8, ComSystemTemplateSystemSignalRef=OBJ_CLS_TYPE1_035
            OBJ_CLS_TYPE1_PROB_035_oRDR_TRACKER_OBJ_035_oPCAN_RADAR_238a34ef_Tx: ComBitPosition=303, ComBitSize=8, ComSignalType=UINT8, ComSystemTemplateSystemSignalRef=OBJ_CLS_TYPE1_PROB_035
            OBJ_CLS_TYPE2_035_oRDR_TRACKER_OBJ_035_oPCAN_RADAR_c63ae37b_Tx: ComBitPosition=267, ComBitSize=4, ComSignalType=UINT8, ComSystemTemplateSystemSignalRef=OBJ_CLS_TYPE2_035
            OBJ_CLS_TYPE2_PROB_035_oRDR_TRACKER_OBJ_035_oPCAN_RADAR_eabe2fe2_Tx: ComBitPosition=311, ComBitSize=8, ComSignalType=UINT8, ComSystemTemplateSystemSignalRef=OBJ_CLS_TYPE2_PROB_035
            OBJ_CLS_TYPE3_035_oRDR_TRACKER_OBJ_035_oPCAN_RADAR_4bb21e99_Tx: ComBitPosition=279, ComBitSize=4, ComSignalType=UINT8, ComSystemTemplateSystemSignalRef=OBJ_CLS_TYPE3_035
            OBJ_CLS_TYPE3_PROB_035_oRDR_TRACKER_OBJ_035_oPCAN_RADAR_adadd919_Tx: ComBitPosition=319, ComBitSize=8, ComSignalType=UINT8, ComSystemTemplateSystemSignalRef=OBJ_CLS_TYPE3_PROB_035
            OBJ_CLS_TYPE4_035_oRDR_TRACKER_OBJ_035_oPCAN_RADAR_5deae3b5_Tx: ComBitPosition=275, ComBitSize=4, ComSignalType=UINT8, ComSystemTemplateSystemSignalRef=OBJ_CLS_TYPE4_035
            OBJ_CLS_TYPE4_PROB_035_oRDR_TRACKER_OBJ_035_oPCAN_RADAR_a3a71fb9_Tx: ComBitPosition=327, ComBitSize=8, ComSignalType=UINT8, ComSystemTemplateSystemSignalRef=OBJ_CLS_TYPE4_PROB_035
            OBJ_CLS_TYPE5_035_oRDR_TRACKER_OBJ_035_oPCAN_RADAR_d0621e57_Tx: ComBitPosition=287, ComBitSize=4, ComSignalType=UINT8, ComSystemTemplateSystemSignalRef=OBJ_CLS_TYPE5_035
            OBJ_CLS_TYPE5_PROB_035_oRDR_TRACKER_OBJ_035_oPCAN_RADAR_e4b4e942_Tx: ComBitPosition=335, ComBitSize=8, ComSignalType=UINT8, ComSystemTemplateSystemSignalRef=OBJ_CLS_TYPE5_PROB_035
            OBJ_CLS_TYPE6_035_oRDR_TRACKER_OBJ_035_oPCAN_RADAR_9d8a1e30_Tx: ComBitPosition=282, ComBitSize=4, ComSignalType=UINT8, ComSystemTemplateSystemSignalRef=OBJ_CLS_TYPE6_035
            OBJ_CLS_TYPE6_PROB_035_oRDR_TRACKER_OBJ_035_oPCAN_RADAR_2d80f24f_Tx: ComBitPosition=343, ComBitSize=8, ComSignalType=UINT8, ComSystemTemplateSystemSignalRef=OBJ_CLS_TYPE6_PROB_035
            OBJ_DIMENSION_LENGTH_035_oRDR_TRACKER_OBJ_035_oPCAN_RADAR_c94cb058_Tx: ComBitPosition=37, ComBitSize=12, ComSignalType=UINT16, ComSystemTemplateSystemSignalRef=OBJ_DIMENSION_LENGTH_035
            OBJ_DIMENSION_LENGTH_ERR_035_oRDR_TRACKER_OBJ_035_oPCAN_RADAR_f2b4af22_Tx: ComBitPosition=41, ComBitSize=10, ComSignalType=UINT16, ComSystemTemplateSystemSignalRef=OBJ_DIMENSION_LENGTH_ERR_035
            OBJ_DIMENSION_WIDTH_035_oRDR_TRACKER_OBJ_035_oPCAN_RADAR_ea8247f5_Tx: ComBitPosition=17, ComBitSize=10, ComSignalType=UINT16, ComSystemTemplateSystemSignalRef=OBJ_DIMENSION_WIDTH_035
            OBJ_DIMENSION_WIDTH_ERR_035_oRDR_TRACKER_OBJ_035_oPCAN_RADAR_0a20801d_Tx: ComBitPosition=23, ComBitSize=6, ComSignalType=UINT8, ComSystemTemplateSystemSignalRef=OBJ_DIMENSION_WIDTH_ERR_035
            OBJ_EXISTENCE_PROB_035_oRDR_TRACKER_OBJ_035_oPCAN_RADAR_e13ec3c8_Tx: ComBitPosition=229, ComBitSize=14, ComSignalType=UINT16, ComSystemTemplateSystemSignalRef=OBJ_EXISTENCE_PROB_035
            OBJ_GROUP_ID_035_oRDR_TRACKER_OBJ_035_oPCAN_RADAR_684cd765_Tx: ComBitPosition=405, ComBitSize=6, ComSignalType=UINT8, ComSystemTemplateSystemSignalRef=OBJ_GROUP_ID_035
            OBJ_ID_035_oRDR_TRACKER_OBJ_035_oPCAN_RADAR_9b62fc62_Tx: ComBitPosition=7, ComBitSize=8, ComSignalType=UINT8, ComSystemTemplateSystemSignalRef=OBJ_ID_035
            OBJ_MEASUREMENT_STATUS_035_oRDR_TRACKER_OBJ_035_oPCAN_RADAR_e4b08edf_Tx: ComBitPosition=14, ComBitSize=3, ComSignalType=UINT8, ComSystemTemplateSystemSignalRef=OBJ_MEASUREMENT_STATUS_035
            OBJ_MH_CRC16_035_oRDR_TRACKER_OBJ_035_oPCAN_RADAR_98d039e3_Tx: ComBitPosition=495, ComBitSize=16, ComSignalType=UINT16, ComSystemTemplateSystemSignalRef=OBJ_MH_CRC16_035
            OBJ_MH_CYCLE_COUNTER_035_oRDR_TRACKER_OBJ_035_oPCAN_RADAR_e9346302_Tx: ComBitPosition=487, ComBitSize=8, ComSignalType=UINT8, ComSystemTemplateSystemSignalRef=OBJ_MH_CYCLE_COUNTER_035
            OBJ_MOVEMENT_STATUS_035_oRDR_TRACKER_OBJ_035_oPCAN_RADAR_cb1e1b93_Tx: ComBitPosition=196, ComBitSize=3, ComSignalType=UINT8, ComSystemTemplateSystemSignalRef=OBJ_MOVEMENT_STATUS_035
            OBJ_POS_ERR_CRR_COEF_035_oRDR_TRACKER_OBJ_035_oPCAN_RADAR_5b61dba9_Tx: ComBitPosition=415, ComBitSize=8, ComSignalType=UINT8, ComSystemTemplateSystemSignalRef=OBJ_POS_ERR_CRR_COEF_035
            OBJ_POS_LAT_035_oRDR_TRACKER_OBJ_035_oPCAN_RADAR_b9ce26e5_Tx: ComBitPosition=79, ComBitSize=16, ComSignalType=UINT16, ComSystemTemplateSystemSignalRef=OBJ_POS_LAT_035
            OBJ_POS_LAT_ERR_035_oRDR_TRACKER_OBJ_035_oPCAN_RADAR_bd8276d2_Tx: ComBitPosition=103, ComBitSize=8, ComSignalType=UINT8, ComSystemTemplateSystemSignalRef=OBJ_POS_LAT_ERR_035
            OBJ_POS_LONG_035_oRDR_TRACKER_OBJ_035_oPCAN_RADAR_086ecd2a_Tx: ComBitPosition=63, ComBitSize=16, ComSignalType=UINT16, ComSystemTemplateSystemSignalRef=OBJ_POS_LONG_035
            OBJ_POS_LONG_ERR_035_oRDR_TRACKER_OBJ_035_oPCAN_RADAR_247a8830_Tx: ComBitPosition=95, ComBitSize=8, ComSignalType=UINT8, ComSystemTemplateSystemSignalRef=OBJ_POS_LONG_ERR_035
            OBJ_RCS_035_oRDR_TRACKER_OBJ_035_oPCAN_RADAR_9b0170e2_Tx: ComBitPosition=351, ComBitSize=7, ComSignalType=UINT8, ComSystemTemplateSystemSignalRef=OBJ_RCS_035
            OBJ_REF_PT_LAT_OFFSET_035_oRDR_TRACKER_OBJ_035_oPCAN_RADAR_6e3c1b97_Tx: ComBitPosition=370, ComBitSize=14, ComSignalType=UINT16, ComSystemTemplateSystemSignalRef=OBJ_REF_PT_LAT_OFFSET_035
            OBJ_REF_PT_LONG_OFFSET_035_oRDR_TRACKER_OBJ_035_oPCAN_RADAR_216eeb94_Tx: ComBitPosition=357, ComBitSize=14, ComSignalType=UINT16, ComSystemTemplateSystemSignalRef=OBJ_REF_PT_LONG_OFFSET_035
            OBJ_TIMESTAMP_OFFSET_035_oRDR_TRACKER_OBJ_035_oPCAN_RADAR_9bad70b4_Tx: ComBitPosition=247, ComBitSize=8, ComSignalType=UINT8, ComSystemTemplateSystemSignalRef=OBJ_TIMESTAMP_OFFSET_035
            OBJ_TRACK_MOTION_MODEL_035_oRDR_TRACKER_OBJ_035_oPCAN_RADAR_57ae7169_Tx: ComBitPosition=9, ComBitSize=2, ComSignalType=UINT8, ComSystemTemplateSystemSignalRef=OBJ_TRACK_MOTION_MODEL_035
            OBJ_VEH_TRACK_FLAG_035_oRDR_TRACKER_OBJ_035_oPCAN_RADAR_d5848734_Tx: ComBitPosition=10, ComBitSize=1, ComSignalType=BOOLEAN, ComSystemTemplateSystemSignalRef=OBJ_VEH_TRACK_FLAG_035
            OBJ_VELOCITY_ERR_CRR_COEF_035_oRDR_TRACKER_OBJ_035_oPCAN_RADAR_f21be648_Tx: ComBitPosition=423, ComBitSize=8, ComSignalType=UINT8, ComSystemTemplateSystemSignalRef=OBJ_VELOCITY_ERR_CRR_COEF_035
            OBJ_VELOCITY_LAT_035_oRDR_TRACKER_OBJ_035_oPCAN_RADAR_fdad63c2_Tx: ComBitPosition=126, ComBitSize=15, ComSignalType=UINT16, ComSystemTemplateSystemSignalRef=OBJ_VELOCITY_LAT_035
            OBJ_VELOCITY_LAT_ERR_035_oRDR_TRACKER_OBJ_035_oPCAN_RADAR_c9571393_Tx: ComBitPosition=151, ComBitSize=8, ComSignalType=UINT8, ComSystemTemplateSystemSignalRef=OBJ_VELOCITY_LAT_ERR_035
            OBJ_VELOCITY_LONG_035_oRDR_TRACKER_OBJ_035_oPCAN_RADAR_ad201b04_Tx: ComBitPosition=110, ComBitSize=15, ComSignalType=UINT16, ComSystemTemplateSystemSignalRef=OBJ_VELOCITY_LONG_035
            OBJ_VELOCITY_LONG_ERR_035_oRDR_TRACKER_OBJ_035_oPCAN_RADAR_25d52c53_Tx: ComBitPosition=143, ComBitSize=8, ComSignalType=UINT8, ComSystemTemplateSystemSignalRef=OBJ_VELOCITY_LONG_ERR_035
            OBJ_YAW_ANGLE_035_oRDR_TRACKER_OBJ_035_oPCAN_RADAR_11112782_Tx: ComBitPosition=155, ComBitSize=12, ComSignalType=UINT16, ComSystemTemplateSystemSignalRef=OBJ_YAW_ANGLE_035
            OBJ_YAW_ANGLE_ERR_035_oRDR_TRACKER_OBJ_035_oPCAN_RADAR_c41c2155_Tx: ComBitPosition=175, ComBitSize=7, ComSignalType=UINT8, ComSystemTemplateSystemSignalRef=OBJ_YAW_ANGLE_ERR_035
            OBJ_YAW_RATE_035_oRDR_TRACKER_OBJ_035_oPCAN_RADAR_349e02c5_Tx: ComBitPosition=399, ComBitSize=10, ComSignalType=UINT16, ComSystemTemplateSystemSignalRef=OBJ_YAW_RATE_035
            OBJ_YAW_RATE_ERR_035_oRDR_TRACKER_OBJ_035_oPCAN_RADAR_0b469519_Tx: ComBitPosition=388, ComBitSize=5, ComSignalType=UINT8, ComSystemTemplateSystemSignalRef=OBJ_YAW_RATE_ERR_035
        SG_TrackerObject036_oRDR_TRACKER_OBJ_036_oPCAN_RADAR_d0f0d485_Tx: ComSystemTemplateSignalGroupRef=SG_TrackerObject036
          49 x ComGroupSignal, all with ComSignalEndianness=BIG_ENDIAN, ComSignalInitValue=0, ComTransferProperty=PENDING:
            OBJ_ACCELERATION_LAT_036_oRDR_TRACKER_OBJ_036_oPCAN_RADAR_ded48ff2_Tx: ComBitPosition=177, ComBitSize=10, ComSignalType=UINT16, ComSystemTemplateSystemSignalRef=OBJ_ACCELERATION_LAT_036
            OBJ_ACCELERATION_LAT_ERR_036_oRDR_TRACKER_OBJ_036_oPCAN_RADAR_0b20b54c_Tx: ComBitPosition=223, ComBitSize=8, ComSignalType=UINT8, ComSystemTemplateSystemSignalRef=OBJ_ACCELERATION_LAT_ERR_036
            OBJ_ACCELERATION_LONG_036_oRDR_TRACKER_OBJ_036_oPCAN_RADAR_ac24d612_Tx: ComBitPosition=193, ComBitSize=10, ComSignalType=UINT16, ComSystemTemplateSystemSignalRef=OBJ_ACCELERATION_LONG_036
            OBJ_ACCELERATION_LONG_ERR_036_oRDR_TRACKER_OBJ_036_oPCAN_RADAR_148510e6_Tx: ComBitPosition=215, ComBitSize=8, ComSignalType=UINT8, ComSystemTemplateSystemSignalRef=OBJ_ACCELERATION_LONG_ERR_036
            OBJ_ACCEL_ERR_CRR_COEF_036_oRDR_TRACKER_OBJ_036_oPCAN_RADAR_b4263180_Tx: ComBitPosition=431, ComBitSize=8, ComSignalType=UINT8, ComSystemTemplateSystemSignalRef=OBJ_ACCEL_ERR_CRR_COEF_036
            OBJ_ALIVE_TIME_036_oRDR_TRACKER_OBJ_036_oPCAN_RADAR_cc459dae_Tx: ComBitPosition=255, ComBitSize=16, ComSignalType=UINT16, ComSystemTemplateSystemSignalRef=OBJ_ALIVE_TIME_036
            OBJ_CLS_TYPE1_036_oRDR_TRACKER_OBJ_036_oPCAN_RADAR_5b9e7c88_Tx: ComBitPosition=271, ComBitSize=4, ComSignalType=UINT8, ComSystemTemplateSystemSignalRef=OBJ_CLS_TYPE1_036
            OBJ_CLS_TYPE1_PROB_036_oRDR_TRACKER_OBJ_036_oPCAN_RADAR_f3c6ab7b_Tx: ComBitPosition=303, ComBitSize=8, ComSignalType=UINT8, ComSystemTemplateSystemSignalRef=OBJ_CLS_TYPE1_PROB_036
            OBJ_CLS_TYPE2_036_oRDR_TRACKER_OBJ_036_oPCAN_RADAR_16767cef_Tx: ComBitPosition=267, ComBitSize=4, ComSignalType=UINT8, ComSystemTemplateSystemSignalRef=OBJ_CLS_TYPE2_036
            OBJ_CLS_TYPE2_PROB_036_oRDR_TRACKER_OBJ_036_oPCAN_RADAR_3af2b076_Tx: ComBitPosition=311, ComBitSize=8, ComSignalType=UINT8, ComSystemTemplateSystemSignalRef=OBJ_CLS_TYPE2_PROB_036
            OBJ_CLS_TYPE3_036_oRDR_TRACKER_OBJ_036_oPCAN_RADAR_9bfe810d_Tx: ComBitPosition=279, ComBitSize=4, ComSignalType=UINT8, ComSystemTemplateSystemSignalRef=OBJ_CLS_TYPE3_036
            OBJ_CLS_TYPE3_PROB_036_oRDR_TRACKER_OBJ_036_oPCAN_RADAR_7de1468d_Tx: ComBitPosition=319, ComBitSize=8, ComSignalType=UINT8, ComSystemTemplateSystemSignalRef=OBJ_CLS_TYPE3_PROB_036
            OBJ_CLS_TYPE4_036_oRDR_TRACKER_OBJ_036_oPCAN_RADAR_8da67c21_Tx: ComBitPosition=275, ComBitSize=4, ComSignalType=UINT8, ComSystemTemplateSystemSignalRef=OBJ_CLS_TYPE4_036
            OBJ_CLS_TYPE4_PROB_036_oRDR_TRACKER_OBJ_036_oPCAN_RADAR_73eb802d_Tx: ComBitPosition=327, ComBitSize=8, ComSignalType=UINT8, ComSystemTemplateSystemSignalRef=OBJ_CLS_TYPE4_PROB_036
            OBJ_CLS_TYPE5_036_oRDR_TRACKER_OBJ_036_oPCAN_RADAR_002e81c3_Tx: ComBitPosition=287, ComBitSize=4, ComSignalType=UINT8, ComSystemTemplateSystemSignalRef=OBJ_CLS_TYPE5_036
            OBJ_CLS_TYPE5_PROB_036_oRDR_TRACKER_OBJ_036_oPCAN_RADAR_34f876d6_Tx: ComBitPosition=335, ComBitSize=8, ComSignalType=UINT8, ComSystemTemplateSystemSignalRef=OBJ_CLS_TYPE5_PROB_036
            OBJ_CLS_TYPE6_036_oRDR_TRACKER_OBJ_036_oPCAN_RADAR_4dc681a4_Tx: ComBitPosition=282, ComBitSize=4, ComSignalType=UINT8, ComSystemTemplateSystemSignalRef=OBJ_CLS_TYPE6_036
            OBJ_CLS_TYPE6_PROB_036_oRDR_TRACKER_OBJ_036_oPCAN_RADAR_fdcc6ddb_Tx: ComBitPosition=343, ComBitSize=8, ComSignalType=UINT8, ComSystemTemplateSystemSignalRef=OBJ_CLS_TYPE6_PROB_036
            OBJ_DIMENSION_LENGTH_036_oRDR_TRACKER_OBJ_036_oPCAN_RADAR_19002fcc_Tx: ComBitPosition=37, ComBitSize=12, ComSignalType=UINT16, ComSystemTemplateSystemSignalRef=OBJ_DIMENSION_LENGTH_036
            OBJ_DIMENSION_LENGTH_ERR_036_oRDR_TRACKER_OBJ_036_oPCAN_RADAR_22f830b6_Tx: ComBitPosition=41, ComBitSize=10, ComSignalType=UINT16, ComSystemTemplateSystemSignalRef=OBJ_DIMENSION_LENGTH_ERR_036
            OBJ_DIMENSION_WIDTH_036_oRDR_TRACKER_OBJ_036_oPCAN_RADAR_3aced861_Tx: ComBitPosition=17, ComBitSize=10, ComSignalType=UINT16, ComSystemTemplateSystemSignalRef=OBJ_DIMENSION_WIDTH_036
            OBJ_DIMENSION_WIDTH_ERR_036_oRDR_TRACKER_OBJ_036_oPCAN_RADAR_da6c1f89_Tx: ComBitPosition=23, ComBitSize=6, ComSignalType=UINT8, ComSystemTemplateSystemSignalRef=OBJ_DIMENSION_WIDTH_ERR_036
            OBJ_EXISTENCE_PROB_036_oRDR_TRACKER_OBJ_036_oPCAN_RADAR_31725c5c_Tx: ComBitPosition=229, ComBitSize=14, ComSignalType=UINT16, ComSystemTemplateSystemSignalRef=OBJ_EXISTENCE_PROB_036
            OBJ_GROUP_ID_036_oRDR_TRACKER_OBJ_036_oPCAN_RADAR_b80048f1_Tx: ComBitPosition=405, ComBitSize=6, ComSignalType=UINT8, ComSystemTemplateSystemSignalRef=OBJ_GROUP_ID_036
            OBJ_ID_036_oRDR_TRACKER_OBJ_036_oPCAN_RADAR_4b2e63f6_Tx: ComBitPosition=7, ComBitSize=8, ComSignalType=UINT8, ComSystemTemplateSystemSignalRef=OBJ_ID_036
            OBJ_MEASUREMENT_STATUS_036_oRDR_TRACKER_OBJ_036_oPCAN_RADAR_34fc114b_Tx: ComBitPosition=14, ComBitSize=3, ComSignalType=UINT8, ComSystemTemplateSystemSignalRef=OBJ_MEASUREMENT_STATUS_036
            OBJ_MH_CRC16_036_oRDR_TRACKER_OBJ_036_oPCAN_RADAR_489ca677_Tx: ComBitPosition=495, ComBitSize=16, ComSignalType=UINT16, ComSystemTemplateSystemSignalRef=OBJ_MH_CRC16_036
            OBJ_MH_CYCLE_COUNTER_036_oRDR_TRACKER_OBJ_036_oPCAN_RADAR_3978fc96_Tx: ComBitPosition=487, ComBitSize=8, ComSignalType=UINT8, ComSystemTemplateSystemSignalRef=OBJ_MH_CYCLE_COUNTER_036
            OBJ_MOVEMENT_STATUS_036_oRDR_TRACKER_OBJ_036_oPCAN_RADAR_1b528407_Tx: ComBitPosition=196, ComBitSize=3, ComSignalType=UINT8, ComSystemTemplateSystemSignalRef=OBJ_MOVEMENT_STATUS_036
            OBJ_POS_ERR_CRR_COEF_036_oRDR_TRACKER_OBJ_036_oPCAN_RADAR_8b2d443d_Tx: ComBitPosition=415, ComBitSize=8, ComSignalType=UINT8, ComSystemTemplateSystemSignalRef=OBJ_POS_ERR_CRR_COEF_036
            OBJ_POS_LAT_036_oRDR_TRACKER_OBJ_036_oPCAN_RADAR_6982b971_Tx: ComBitPosition=79, ComBitSize=16, ComSignalType=UINT16, ComSystemTemplateSystemSignalRef=OBJ_POS_LAT_036
            OBJ_POS_LAT_ERR_036_oRDR_TRACKER_OBJ_036_oPCAN_RADAR_6dcee946_Tx: ComBitPosition=103, ComBitSize=8, ComSignalType=UINT8, ComSystemTemplateSystemSignalRef=OBJ_POS_LAT_ERR_036
            OBJ_POS_LONG_036_oRDR_TRACKER_OBJ_036_oPCAN_RADAR_d82252be_Tx: ComBitPosition=63, ComBitSize=16, ComSignalType=UINT16, ComSystemTemplateSystemSignalRef=OBJ_POS_LONG_036
            OBJ_POS_LONG_ERR_036_oRDR_TRACKER_OBJ_036_oPCAN_RADAR_f43617a4_Tx: ComBitPosition=95, ComBitSize=8, ComSignalType=UINT8, ComSystemTemplateSystemSignalRef=OBJ_POS_LONG_ERR_036
            OBJ_RCS_036_oRDR_TRACKER_OBJ_036_oPCAN_RADAR_4b4def76_Tx: ComBitPosition=351, ComBitSize=7, ComSignalType=UINT8, ComSystemTemplateSystemSignalRef=OBJ_RCS_036
            OBJ_REF_PT_LAT_OFFSET_036_oRDR_TRACKER_OBJ_036_oPCAN_RADAR_be708403_Tx: ComBitPosition=370, ComBitSize=14, ComSignalType=UINT16, ComSystemTemplateSystemSignalRef=OBJ_REF_PT_LAT_OFFSET_036
            OBJ_REF_PT_LONG_OFFSET_036_oRDR_TRACKER_OBJ_036_oPCAN_RADAR_f1227400_Tx: ComBitPosition=357, ComBitSize=14, ComSignalType=UINT16, ComSystemTemplateSystemSignalRef=OBJ_REF_PT_LONG_OFFSET_036
            OBJ_TIMESTAMP_OFFSET_036_oRDR_TRACKER_OBJ_036_oPCAN_RADAR_4be1ef20_Tx: ComBitPosition=247, ComBitSize=8, ComSignalType=UINT8, ComSystemTemplateSystemSignalRef=OBJ_TIMESTAMP_OFFSET_036
            OBJ_TRACK_MOTION_MODEL_036_oRDR_TRACKER_OBJ_036_oPCAN_RADAR_87e2eefd_Tx: ComBitPosition=9, ComBitSize=2, ComSignalType=UINT8, ComSystemTemplateSystemSignalRef=OBJ_TRACK_MOTION_MODEL_036
            OBJ_VEH_TRACK_FLAG_036_oRDR_TRACKER_OBJ_036_oPCAN_RADAR_05c818a0_Tx: ComBitPosition=10, ComBitSize=1, ComSignalType=BOOLEAN, ComSystemTemplateSystemSignalRef=OBJ_VEH_TRACK_FLAG_036
            OBJ_VELOCITY_ERR_CRR_COEF_036_oRDR_TRACKER_OBJ_036_oPCAN_RADAR_225779dc_Tx: ComBitPosition=423, ComBitSize=8, ComSignalType=UINT8, ComSystemTemplateSystemSignalRef=OBJ_VELOCITY_ERR_CRR_COEF_036
            OBJ_VELOCITY_LAT_036_oRDR_TRACKER_OBJ_036_oPCAN_RADAR_2de1fc56_Tx: ComBitPosition=126, ComBitSize=15, ComSignalType=UINT16, ComSystemTemplateSystemSignalRef=OBJ_VELOCITY_LAT_036
            OBJ_VELOCITY_LAT_ERR_036_oRDR_TRACKER_OBJ_036_oPCAN_RADAR_191b8c07_Tx: ComBitPosition=151, ComBitSize=8, ComSignalType=UINT8, ComSystemTemplateSystemSignalRef=OBJ_VELOCITY_LAT_ERR_036
            OBJ_VELOCITY_LONG_036_oRDR_TRACKER_OBJ_036_oPCAN_RADAR_7d6c8490_Tx: ComBitPosition=110, ComBitSize=15, ComSignalType=UINT16, ComSystemTemplateSystemSignalRef=OBJ_VELOCITY_LONG_036
            OBJ_VELOCITY_LONG_ERR_036_oRDR_TRACKER_OBJ_036_oPCAN_RADAR_f599b3c7_Tx: ComBitPosition=143, ComBitSize=8, ComSignalType=UINT8, ComSystemTemplateSystemSignalRef=OBJ_VELOCITY_LONG_ERR_036
            OBJ_YAW_ANGLE_036_oRDR_TRACKER_OBJ_036_oPCAN_RADAR_c15db816_Tx: ComBitPosition=155, ComBitSize=12, ComSignalType=UINT16, ComSystemTemplateSystemSignalRef=OBJ_YAW_ANGLE_036
            OBJ_YAW_ANGLE_ERR_036_oRDR_TRACKER_OBJ_036_oPCAN_RADAR_1450bec1_Tx: ComBitPosition=175, ComBitSize=7, ComSignalType=UINT8, ComSystemTemplateSystemSignalRef=OBJ_YAW_ANGLE_ERR_036
            OBJ_YAW_RATE_036_oRDR_TRACKER_OBJ_036_oPCAN_RADAR_e4d29d51_Tx: ComBitPosition=399, ComBitSize=10, ComSignalType=UINT16, ComSystemTemplateSystemSignalRef=OBJ_YAW_RATE_036
            OBJ_YAW_RATE_ERR_036_oRDR_TRACKER_OBJ_036_oPCAN_RADAR_db0a0a8d_Tx: ComBitPosition=388, ComBitSize=5, ComSignalType=UINT8, ComSystemTemplateSystemSignalRef=OBJ_YAW_RATE_ERR_036
        SG_TrackerObject037_oRDR_TRACKER_OBJ_037_oPCAN_RADAR_29e45c36_Tx: ComSystemTemplateSignalGroupRef=SG_TrackerObject037
          49 x ComGroupSignal, all with ComSignalEndianness=BIG_ENDIAN, ComSignalInitValue=0, ComTransferProperty=PENDING:
            OBJ_ACCELERATION_LAT_037_oRDR_TRACKER_OBJ_037_oPCAN_RADAR_27c00741_Tx: ComBitPosition=177, ComBitSize=10, ComSignalType=UINT16, ComSystemTemplateSystemSignalRef=OBJ_ACCELERATION_LAT_037
            OBJ_ACCELERATION_LAT_ERR_037_oRDR_TRACKER_OBJ_037_oPCAN_RADAR_f2343dff_Tx: ComBitPosition=223, ComBitSize=8, ComSignalType=UINT8, ComSystemTemplateSystemSignalRef=OBJ_ACCELERATION_LAT_ERR_037
            OBJ_ACCELERATION_LONG_037_oRDR_TRACKER_OBJ_037_oPCAN_RADAR_55305ea1_Tx: ComBitPosition=193, ComBitSize=10, ComSignalType=UINT16, ComSystemTemplateSystemSignalRef=OBJ_ACCELERATION_LONG_037
            OBJ_ACCELERATION_LONG_ERR_037_oRDR_TRACKER_OBJ_037_oPCAN_RADAR_ed919855_Tx: ComBitPosition=215, ComBitSize=8, ComSignalType=UINT8, ComSystemTemplateSystemSignalRef=OBJ_ACCELERATION_LONG_ERR_037
            OBJ_ACCEL_ERR_CRR_COEF_037_oRDR_TRACKER_OBJ_037_oPCAN_RADAR_4d32b933_Tx: ComBitPosition=431, ComBitSize=8, ComSignalType=UINT8, ComSystemTemplateSystemSignalRef=OBJ_ACCEL_ERR_CRR_COEF_037
            OBJ_ALIVE_TIME_037_oRDR_TRACKER_OBJ_037_oPCAN_RADAR_3551151d_Tx: ComBitPosition=255, ComBitSize=16, ComSignalType=UINT16, ComSystemTemplateSystemSignalRef=OBJ_ALIVE_TIME_037
            OBJ_CLS_TYPE1_037_oRDR_TRACKER_OBJ_037_oPCAN_RADAR_a28af43b_Tx: ComBitPosition=271, ComBitSize=4, ComSignalType=UINT8, ComSystemTemplateSystemSignalRef=OBJ_CLS_TYPE1_037
            OBJ_CLS_TYPE1_PROB_037_oRDR_TRACKER_OBJ_037_oPCAN_RADAR_0ad223c8_Tx: ComBitPosition=303, ComBitSize=8, ComSignalType=UINT8, ComSystemTemplateSystemSignalRef=OBJ_CLS_TYPE1_PROB_037
            OBJ_CLS_TYPE2_037_oRDR_TRACKER_OBJ_037_oPCAN_RADAR_ef62f45c_Tx: ComBitPosition=267, ComBitSize=4, ComSignalType=UINT8, ComSystemTemplateSystemSignalRef=OBJ_CLS_TYPE2_037
            OBJ_CLS_TYPE2_PROB_037_oRDR_TRACKER_OBJ_037_oPCAN_RADAR_c3e638c5_Tx: ComBitPosition=311, ComBitSize=8, ComSignalType=UINT8, ComSystemTemplateSystemSignalRef=OBJ_CLS_TYPE2_PROB_037
            OBJ_CLS_TYPE3_037_oRDR_TRACKER_OBJ_037_oPCAN_RADAR_62ea09be_Tx: ComBitPosition=279, ComBitSize=4, ComSignalType=UINT8, ComSystemTemplateSystemSignalRef=OBJ_CLS_TYPE3_037
            OBJ_CLS_TYPE3_PROB_037_oRDR_TRACKER_OBJ_037_oPCAN_RADAR_84f5ce3e_Tx: ComBitPosition=319, ComBitSize=8, ComSignalType=UINT8, ComSystemTemplateSystemSignalRef=OBJ_CLS_TYPE3_PROB_037
            OBJ_CLS_TYPE4_037_oRDR_TRACKER_OBJ_037_oPCAN_RADAR_74b2f492_Tx: ComBitPosition=275, ComBitSize=4, ComSignalType=UINT8, ComSystemTemplateSystemSignalRef=OBJ_CLS_TYPE4_037
            OBJ_CLS_TYPE4_PROB_037_oRDR_TRACKER_OBJ_037_oPCAN_RADAR_8aff089e_Tx: ComBitPosition=327, ComBitSize=8, ComSignalType=UINT8, ComSystemTemplateSystemSignalRef=OBJ_CLS_TYPE4_PROB_037
            OBJ_CLS_TYPE5_037_oRDR_TRACKER_OBJ_037_oPCAN_RADAR_f93a0970_Tx: ComBitPosition=287, ComBitSize=4, ComSignalType=UINT8, ComSystemTemplateSystemSignalRef=OBJ_CLS_TYPE5_037
            OBJ_CLS_TYPE5_PROB_037_oRDR_TRACKER_OBJ_037_oPCAN_RADAR_cdecfe65_Tx: ComBitPosition=335, ComBitSize=8, ComSignalType=UINT8, ComSystemTemplateSystemSignalRef=OBJ_CLS_TYPE5_PROB_037
            OBJ_CLS_TYPE6_037_oRDR_TRACKER_OBJ_037_oPCAN_RADAR_b4d20917_Tx: ComBitPosition=282, ComBitSize=4, ComSignalType=UINT8, ComSystemTemplateSystemSignalRef=OBJ_CLS_TYPE6_037
            OBJ_CLS_TYPE6_PROB_037_oRDR_TRACKER_OBJ_037_oPCAN_RADAR_04d8e568_Tx: ComBitPosition=343, ComBitSize=8, ComSignalType=UINT8, ComSystemTemplateSystemSignalRef=OBJ_CLS_TYPE6_PROB_037
            OBJ_DIMENSION_LENGTH_037_oRDR_TRACKER_OBJ_037_oPCAN_RADAR_e014a77f_Tx: ComBitPosition=37, ComBitSize=12, ComSignalType=UINT16, ComSystemTemplateSystemSignalRef=OBJ_DIMENSION_LENGTH_037
            OBJ_DIMENSION_LENGTH_ERR_037_oRDR_TRACKER_OBJ_037_oPCAN_RADAR_dbecb805_Tx: ComBitPosition=41, ComBitSize=10, ComSignalType=UINT16, ComSystemTemplateSystemSignalRef=OBJ_DIMENSION_LENGTH_ERR_037
            OBJ_DIMENSION_WIDTH_037_oRDR_TRACKER_OBJ_037_oPCAN_RADAR_c3da50d2_Tx: ComBitPosition=17, ComBitSize=10, ComSignalType=UINT16, ComSystemTemplateSystemSignalRef=OBJ_DIMENSION_WIDTH_037
            OBJ_DIMENSION_WIDTH_ERR_037_oRDR_TRACKER_OBJ_037_oPCAN_RADAR_2378973a_Tx: ComBitPosition=23, ComBitSize=6, ComSignalType=UINT8, ComSystemTemplateSystemSignalRef=OBJ_DIMENSION_WIDTH_ERR_037
            OBJ_EXISTENCE_PROB_037_oRDR_TRACKER_OBJ_037_oPCAN_RADAR_c866d4ef_Tx: ComBitPosition=229, ComBitSize=14, ComSignalType=UINT16, ComSystemTemplateSystemSignalRef=OBJ_EXISTENCE_PROB_037
            OBJ_GROUP_ID_037_oRDR_TRACKER_OBJ_037_oPCAN_RADAR_4114c042_Tx: ComBitPosition=405, ComBitSize=6, ComSignalType=UINT8, ComSystemTemplateSystemSignalRef=OBJ_GROUP_ID_037
            OBJ_ID_037_oRDR_TRACKER_OBJ_037_oPCAN_RADAR_b23aeb45_Tx: ComBitPosition=7, ComBitSize=8, ComSignalType=UINT8, ComSystemTemplateSystemSignalRef=OBJ_ID_037
            OBJ_MEASUREMENT_STATUS_037_oRDR_TRACKER_OBJ_037_oPCAN_RADAR_cde899f8_Tx: ComBitPosition=14, ComBitSize=3, ComSignalType=UINT8, ComSystemTemplateSystemSignalRef=OBJ_MEASUREMENT_STATUS_037
            OBJ_MH_CRC16_037_oRDR_TRACKER_OBJ_037_oPCAN_RADAR_b1882ec4_Tx: ComBitPosition=495, ComBitSize=16, ComSignalType=UINT16, ComSystemTemplateSystemSignalRef=OBJ_MH_CRC16_037
            OBJ_MH_CYCLE_COUNTER_037_oRDR_TRACKER_OBJ_037_oPCAN_RADAR_c06c7425_Tx: ComBitPosition=487, ComBitSize=8, ComSignalType=UINT8, ComSystemTemplateSystemSignalRef=OBJ_MH_CYCLE_COUNTER_037
            OBJ_MOVEMENT_STATUS_037_oRDR_TRACKER_OBJ_037_oPCAN_RADAR_e2460cb4_Tx: ComBitPosition=196, ComBitSize=3, ComSignalType=UINT8, ComSystemTemplateSystemSignalRef=OBJ_MOVEMENT_STATUS_037
            OBJ_POS_ERR_CRR_COEF_037_oRDR_TRACKER_OBJ_037_oPCAN_RADAR_7239cc8e_Tx: ComBitPosition=415, ComBitSize=8, ComSignalType=UINT8, ComSystemTemplateSystemSignalRef=OBJ_POS_ERR_CRR_COEF_037
            OBJ_POS_LAT_037_oRDR_TRACKER_OBJ_037_oPCAN_RADAR_909631c2_Tx: ComBitPosition=79, ComBitSize=16, ComSignalType=UINT16, ComSystemTemplateSystemSignalRef=OBJ_POS_LAT_037
            OBJ_POS_LAT_ERR_037_oRDR_TRACKER_OBJ_037_oPCAN_RADAR_94da61f5_Tx: ComBitPosition=103, ComBitSize=8, ComSignalType=UINT8, ComSystemTemplateSystemSignalRef=OBJ_POS_LAT_ERR_037
            OBJ_POS_LONG_037_oRDR_TRACKER_OBJ_037_oPCAN_RADAR_2136da0d_Tx: ComBitPosition=63, ComBitSize=16, ComSignalType=UINT16, ComSystemTemplateSystemSignalRef=OBJ_POS_LONG_037
            OBJ_POS_LONG_ERR_037_oRDR_TRACKER_OBJ_037_oPCAN_RADAR_0d229f17_Tx: ComBitPosition=95, ComBitSize=8, ComSignalType=UINT8, ComSystemTemplateSystemSignalRef=OBJ_POS_LONG_ERR_037
            OBJ_RCS_037_oRDR_TRACKER_OBJ_037_oPCAN_RADAR_b25967c5_Tx: ComBitPosition=351, ComBitSize=7, ComSignalType=UINT8, ComSystemTemplateSystemSignalRef=OBJ_RCS_037
            OBJ_REF_PT_LAT_OFFSET_037_oRDR_TRACKER_OBJ_037_oPCAN_RADAR_47640cb0_Tx: ComBitPosition=370, ComBitSize=14, ComSignalType=UINT16, ComSystemTemplateSystemSignalRef=OBJ_REF_PT_LAT_OFFSET_037
            OBJ_REF_PT_LONG_OFFSET_037_oRDR_TRACKER_OBJ_037_oPCAN_RADAR_0836fcb3_Tx: ComBitPosition=357, ComBitSize=14, ComSignalType=UINT16, ComSystemTemplateSystemSignalRef=OBJ_REF_PT_LONG_OFFSET_037
            OBJ_TIMESTAMP_OFFSET_037_oRDR_TRACKER_OBJ_037_oPCAN_RADAR_b2f56793_Tx: ComBitPosition=247, ComBitSize=8, ComSignalType=UINT8, ComSystemTemplateSystemSignalRef=OBJ_TIMESTAMP_OFFSET_037
            OBJ_TRACK_MOTION_MODEL_037_oRDR_TRACKER_OBJ_037_oPCAN_RADAR_7ef6664e_Tx: ComBitPosition=9, ComBitSize=2, ComSignalType=UINT8, ComSystemTemplateSystemSignalRef=OBJ_TRACK_MOTION_MODEL_037
            OBJ_VEH_TRACK_FLAG_037_oRDR_TRACKER_OBJ_037_oPCAN_RADAR_fcdc9013_Tx: ComBitPosition=10, ComBitSize=1, ComSignalType=BOOLEAN, ComSystemTemplateSystemSignalRef=OBJ_VEH_TRACK_FLAG_037
            OBJ_VELOCITY_ERR_CRR_COEF_037_oRDR_TRACKER_OBJ_037_oPCAN_RADAR_db43f16f_Tx: ComBitPosition=423, ComBitSize=8, ComSignalType=UINT8, ComSystemTemplateSystemSignalRef=OBJ_VELOCITY_ERR_CRR_COEF_037
            OBJ_VELOCITY_LAT_037_oRDR_TRACKER_OBJ_037_oPCAN_RADAR_d4f574e5_Tx: ComBitPosition=126, ComBitSize=15, ComSignalType=UINT16, ComSystemTemplateSystemSignalRef=OBJ_VELOCITY_LAT_037
            OBJ_VELOCITY_LAT_ERR_037_oRDR_TRACKER_OBJ_037_oPCAN_RADAR_e00f04b4_Tx: ComBitPosition=151, ComBitSize=8, ComSignalType=UINT8, ComSystemTemplateSystemSignalRef=OBJ_VELOCITY_LAT_ERR_037
            OBJ_VELOCITY_LONG_037_oRDR_TRACKER_OBJ_037_oPCAN_RADAR_84780c23_Tx: ComBitPosition=110, ComBitSize=15, ComSignalType=UINT16, ComSystemTemplateSystemSignalRef=OBJ_VELOCITY_LONG_037
            OBJ_VELOCITY_LONG_ERR_037_oRDR_TRACKER_OBJ_037_oPCAN_RADAR_0c8d3b74_Tx: ComBitPosition=143, ComBitSize=8, ComSignalType=UINT8, ComSystemTemplateSystemSignalRef=OBJ_VELOCITY_LONG_ERR_037
            OBJ_YAW_ANGLE_037_oRDR_TRACKER_OBJ_037_oPCAN_RADAR_384930a5_Tx: ComBitPosition=155, ComBitSize=12, ComSignalType=UINT16, ComSystemTemplateSystemSignalRef=OBJ_YAW_ANGLE_037
            OBJ_YAW_ANGLE_ERR_037_oRDR_TRACKER_OBJ_037_oPCAN_RADAR_ed443672_Tx: ComBitPosition=175, ComBitSize=7, ComSignalType=UINT8, ComSystemTemplateSystemSignalRef=OBJ_YAW_ANGLE_ERR_037
            OBJ_YAW_RATE_037_oRDR_TRACKER_OBJ_037_oPCAN_RADAR_1dc615e2_Tx: ComBitPosition=399, ComBitSize=10, ComSignalType=UINT16, ComSystemTemplateSystemSignalRef=OBJ_YAW_RATE_037
            OBJ_YAW_RATE_ERR_037_oRDR_TRACKER_OBJ_037_oPCAN_RADAR_221e823e_Tx: ComBitPosition=388, ComBitSize=5, ComSignalType=UINT8, ComSystemTemplateSystemSignalRef=OBJ_YAW_RATE_ERR_037
        SG_TrackerObject038_oRDR_TRACKER_OBJ_038_oPCAN_RADAR_0e78b170_Tx: ComSystemTemplateSignalGroupRef=SG_TrackerObject038
          49 x ComGroupSignal, all with ComSignalEndianness=BIG_ENDIAN, ComSignalInitValue=0, ComTransferProperty=PENDING:
            OBJ_ACCELERATION_LAT_038_oRDR_TRACKER_OBJ_038_oPCAN_RADAR_005cea07_Tx: ComBitPosition=177, ComBitSize=10, ComSignalType=UINT16, ComSystemTemplateSystemSignalRef=OBJ_ACCELERATION_LAT_038
            OBJ_ACCELERATION_LAT_ERR_038_oRDR_TRACKER_OBJ_038_oPCAN_RADAR_d5a8d0b9_Tx: ComBitPosition=223, ComBitSize=8, ComSignalType=UINT8, ComSystemTemplateSystemSignalRef=OBJ_ACCELERATION_LAT_ERR_038
            OBJ_ACCELERATION_LONG_038_oRDR_TRACKER_OBJ_038_oPCAN_RADAR_72acb3e7_Tx: ComBitPosition=193, ComBitSize=10, ComSignalType=UINT16, ComSystemTemplateSystemSignalRef=OBJ_ACCELERATION_LONG_038
            OBJ_ACCELERATION_LONG_ERR_038_oRDR_TRACKER_OBJ_038_oPCAN_RADAR_ca0d7513_Tx: ComBitPosition=215, ComBitSize=8, ComSignalType=UINT8, ComSystemTemplateSystemSignalRef=OBJ_ACCELERATION_LONG_ERR_038
            OBJ_ACCEL_ERR_CRR_COEF_038_oRDR_TRACKER_OBJ_038_oPCAN_RADAR_6aae5475_Tx: ComBitPosition=431, ComBitSize=8, ComSignalType=UINT8, ComSystemTemplateSystemSignalRef=OBJ_ACCEL_ERR_CRR_COEF_038
            OBJ_ALIVE_TIME_038_oRDR_TRACKER_OBJ_038_oPCAN_RADAR_12cdf85b_Tx: ComBitPosition=255, ComBitSize=16, ComSignalType=UINT16, ComSystemTemplateSystemSignalRef=OBJ_ALIVE_TIME_038
            OBJ_CLS_TYPE1_038_oRDR_TRACKER_OBJ_038_oPCAN_RADAR_8516197d_Tx: ComBitPosition=271, ComBitSize=4, ComSignalType=UINT8, ComSystemTemplateSystemSignalRef=OBJ_CLS_TYPE1_038
            OBJ_CLS_TYPE1_PROB_038_oRDR_TRACKER_OBJ_038_oPCAN_RADAR_2d4ece8e_Tx: ComBitPosition=303, ComBitSize=8, ComSignalType=UINT8, ComSystemTemplateSystemSignalRef=OBJ_CLS_TYPE1_PROB_038
            OBJ_CLS_TYPE2_038_oRDR_TRACKER_OBJ_038_oPCAN_RADAR_c8fe191a_Tx: ComBitPosition=267, ComBitSize=4, ComSignalType=UINT8, ComSystemTemplateSystemSignalRef=OBJ_CLS_TYPE2_038
            OBJ_CLS_TYPE2_PROB_038_oRDR_TRACKER_OBJ_038_oPCAN_RADAR_e47ad583_Tx: ComBitPosition=311, ComBitSize=8, ComSignalType=UINT8, ComSystemTemplateSystemSignalRef=OBJ_CLS_TYPE2_PROB_038
            OBJ_CLS_TYPE3_038_oRDR_TRACKER_OBJ_038_oPCAN_RADAR_4576e4f8_Tx: ComBitPosition=279, ComBitSize=4, ComSignalType=UINT8, ComSystemTemplateSystemSignalRef=OBJ_CLS_TYPE3_038
            OBJ_CLS_TYPE3_PROB_038_oRDR_TRACKER_OBJ_038_oPCAN_RADAR_a3692378_Tx: ComBitPosition=319, ComBitSize=8, ComSignalType=UINT8, ComSystemTemplateSystemSignalRef=OBJ_CLS_TYPE3_PROB_038
            OBJ_CLS_TYPE4_038_oRDR_TRACKER_OBJ_038_oPCAN_RADAR_532e19d4_Tx: ComBitPosition=275, ComBitSize=4, ComSignalType=UINT8, ComSystemTemplateSystemSignalRef=OBJ_CLS_TYPE4_038
            OBJ_CLS_TYPE4_PROB_038_oRDR_TRACKER_OBJ_038_oPCAN_RADAR_ad63e5d8_Tx: ComBitPosition=327, ComBitSize=8, ComSignalType=UINT8, ComSystemTemplateSystemSignalRef=OBJ_CLS_TYPE4_PROB_038
            OBJ_CLS_TYPE5_038_oRDR_TRACKER_OBJ_038_oPCAN_RADAR_dea6e436_Tx: ComBitPosition=287, ComBitSize=4, ComSignalType=UINT8, ComSystemTemplateSystemSignalRef=OBJ_CLS_TYPE5_038
            OBJ_CLS_TYPE5_PROB_038_oRDR_TRACKER_OBJ_038_oPCAN_RADAR_ea701323_Tx: ComBitPosition=335, ComBitSize=8, ComSignalType=UINT8, ComSystemTemplateSystemSignalRef=OBJ_CLS_TYPE5_PROB_038
            OBJ_CLS_TYPE6_038_oRDR_TRACKER_OBJ_038_oPCAN_RADAR_934ee451_Tx: ComBitPosition=282, ComBitSize=4, ComSignalType=UINT8, ComSystemTemplateSystemSignalRef=OBJ_CLS_TYPE6_038
            OBJ_CLS_TYPE6_PROB_038_oRDR_TRACKER_OBJ_038_oPCAN_RADAR_2344082e_Tx: ComBitPosition=343, ComBitSize=8, ComSignalType=UINT8, ComSystemTemplateSystemSignalRef=OBJ_CLS_TYPE6_PROB_038
            OBJ_DIMENSION_LENGTH_038_oRDR_TRACKER_OBJ_038_oPCAN_RADAR_c7884a39_Tx: ComBitPosition=37, ComBitSize=12, ComSignalType=UINT16, ComSystemTemplateSystemSignalRef=OBJ_DIMENSION_LENGTH_038
            OBJ_DIMENSION_LENGTH_ERR_038_oRDR_TRACKER_OBJ_038_oPCAN_RADAR_fc705543_Tx: ComBitPosition=41, ComBitSize=10, ComSignalType=UINT16, ComSystemTemplateSystemSignalRef=OBJ_DIMENSION_LENGTH_ERR_038
            OBJ_DIMENSION_WIDTH_038_oRDR_TRACKER_OBJ_038_oPCAN_RADAR_e446bd94_Tx: ComBitPosition=17, ComBitSize=10, ComSignalType=UINT16, ComSystemTemplateSystemSignalRef=OBJ_DIMENSION_WIDTH_038
            OBJ_DIMENSION_WIDTH_ERR_038_oRDR_TRACKER_OBJ_038_oPCAN_RADAR_04e47a7c_Tx: ComBitPosition=23, ComBitSize=6, ComSignalType=UINT8, ComSystemTemplateSystemSignalRef=OBJ_DIMENSION_WIDTH_ERR_038
            OBJ_EXISTENCE_PROB_038_oRDR_TRACKER_OBJ_038_oPCAN_RADAR_effa39a9_Tx: ComBitPosition=229, ComBitSize=14, ComSignalType=UINT16, ComSystemTemplateSystemSignalRef=OBJ_EXISTENCE_PROB_038
            OBJ_GROUP_ID_038_oRDR_TRACKER_OBJ_038_oPCAN_RADAR_66882d04_Tx: ComBitPosition=405, ComBitSize=6, ComSignalType=UINT8, ComSystemTemplateSystemSignalRef=OBJ_GROUP_ID_038
            OBJ_ID_038_oRDR_TRACKER_OBJ_038_oPCAN_RADAR_95a60603_Tx: ComBitPosition=7, ComBitSize=8, ComSignalType=UINT8, ComSystemTemplateSystemSignalRef=OBJ_ID_038
            OBJ_MEASUREMENT_STATUS_038_oRDR_TRACKER_OBJ_038_oPCAN_RADAR_ea7474be_Tx: ComBitPosition=14, ComBitSize=3, ComSignalType=UINT8, ComSystemTemplateSystemSignalRef=OBJ_MEASUREMENT_STATUS_038
            OBJ_MH_CRC16_038_oRDR_TRACKER_OBJ_038_oPCAN_RADAR_9614c382_Tx: ComBitPosition=495, ComBitSize=16, ComSignalType=UINT16, ComSystemTemplateSystemSignalRef=OBJ_MH_CRC16_038
            OBJ_MH_CYCLE_COUNTER_038_oRDR_TRACKER_OBJ_038_oPCAN_RADAR_e7f09963_Tx: ComBitPosition=487, ComBitSize=8, ComSignalType=UINT8, ComSystemTemplateSystemSignalRef=OBJ_MH_CYCLE_COUNTER_038
            OBJ_MOVEMENT_STATUS_038_oRDR_TRACKER_OBJ_038_oPCAN_RADAR_c5dae1f2_Tx: ComBitPosition=196, ComBitSize=3, ComSignalType=UINT8, ComSystemTemplateSystemSignalRef=OBJ_MOVEMENT_STATUS_038
            OBJ_POS_ERR_CRR_COEF_038_oRDR_TRACKER_OBJ_038_oPCAN_RADAR_55a521c8_Tx: ComBitPosition=415, ComBitSize=8, ComSignalType=UINT8, ComSystemTemplateSystemSignalRef=OBJ_POS_ERR_CRR_COEF_038
            OBJ_POS_LAT_038_oRDR_TRACKER_OBJ_038_oPCAN_RADAR_b70adc84_Tx: ComBitPosition=79, ComBitSize=16, ComSignalType=UINT16, ComSystemTemplateSystemSignalRef=OBJ_POS_LAT_038
            OBJ_POS_LAT_ERR_038_oRDR_TRACKER_OBJ_038_oPCAN_RADAR_b3468cb3_Tx: ComBitPosition=103, ComBitSize=8, ComSignalType=UINT8, ComSystemTemplateSystemSignalRef=OBJ_POS_LAT_ERR_038
            OBJ_POS_LONG_038_oRDR_TRACKER_OBJ_038_oPCAN_RADAR_06aa374b_Tx: ComBitPosition=63, ComBitSize=16, ComSignalType=UINT16, ComSystemTemplateSystemSignalRef=OBJ_POS_LONG_038
            OBJ_POS_LONG_ERR_038_oRDR_TRACKER_OBJ_038_oPCAN_RADAR_2abe7251_Tx: ComBitPosition=95, ComBitSize=8, ComSignalType=UINT8, ComSystemTemplateSystemSignalRef=OBJ_POS_LONG_ERR_038
            OBJ_RCS_038_oRDR_TRACKER_OBJ_038_oPCAN_RADAR_95c58a83_Tx: ComBitPosition=351, ComBitSize=7, ComSignalType=UINT8, ComSystemTemplateSystemSignalRef=OBJ_RCS_038
            OBJ_REF_PT_LAT_OFFSET_038_oRDR_TRACKER_OBJ_038_oPCAN_RADAR_60f8e1f6_Tx: ComBitPosition=370, ComBitSize=14, ComSignalType=UINT16, ComSystemTemplateSystemSignalRef=OBJ_REF_PT_LAT_OFFSET_038
            OBJ_REF_PT_LONG_OFFSET_038_oRDR_TRACKER_OBJ_038_oPCAN_RADAR_2faa11f5_Tx: ComBitPosition=357, ComBitSize=14, ComSignalType=UINT16, ComSystemTemplateSystemSignalRef=OBJ_REF_PT_LONG_OFFSET_038
            OBJ_TIMESTAMP_OFFSET_038_oRDR_TRACKER_OBJ_038_oPCAN_RADAR_95698ad5_Tx: ComBitPosition=247, ComBitSize=8, ComSignalType=UINT8, ComSystemTemplateSystemSignalRef=OBJ_TIMESTAMP_OFFSET_038
            OBJ_TRACK_MOTION_MODEL_038_oRDR_TRACKER_OBJ_038_oPCAN_RADAR_596a8b08_Tx: ComBitPosition=9, ComBitSize=2, ComSignalType=UINT8, ComSystemTemplateSystemSignalRef=OBJ_TRACK_MOTION_MODEL_038
            OBJ_VEH_TRACK_FLAG_038_oRDR_TRACKER_OBJ_038_oPCAN_RADAR_db407d55_Tx: ComBitPosition=10, ComBitSize=1, ComSignalType=BOOLEAN, ComSystemTemplateSystemSignalRef=OBJ_VEH_TRACK_FLAG_038
            OBJ_VELOCITY_ERR_CRR_COEF_038_oRDR_TRACKER_OBJ_038_oPCAN_RADAR_fcdf1c29_Tx: ComBitPosition=423, ComBitSize=8, ComSignalType=UINT8, ComSystemTemplateSystemSignalRef=OBJ_VELOCITY_ERR_CRR_COEF_038
            OBJ_VELOCITY_LAT_038_oRDR_TRACKER_OBJ_038_oPCAN_RADAR_f36999a3_Tx: ComBitPosition=126, ComBitSize=15, ComSignalType=UINT16, ComSystemTemplateSystemSignalRef=OBJ_VELOCITY_LAT_038
            OBJ_VELOCITY_LAT_ERR_038_oRDR_TRACKER_OBJ_038_oPCAN_RADAR_c793e9f2_Tx: ComBitPosition=151, ComBitSize=8, ComSignalType=UINT8, ComSystemTemplateSystemSignalRef=OBJ_VELOCITY_LAT_ERR_038
            OBJ_VELOCITY_LONG_038_oRDR_TRACKER_OBJ_038_oPCAN_RADAR_a3e4e165_Tx: ComBitPosition=110, ComBitSize=15, ComSignalType=UINT16, ComSystemTemplateSystemSignalRef=OBJ_VELOCITY_LONG_038
            OBJ_VELOCITY_LONG_ERR_038_oRDR_TRACKER_OBJ_038_oPCAN_RADAR_2b11d632_Tx: ComBitPosition=143, ComBitSize=8, ComSignalType=UINT8, ComSystemTemplateSystemSignalRef=OBJ_VELOCITY_LONG_ERR_038
            OBJ_YAW_ANGLE_038_oRDR_TRACKER_OBJ_038_oPCAN_RADAR_1fd5dde3_Tx: ComBitPosition=155, ComBitSize=12, ComSignalType=UINT16, ComSystemTemplateSystemSignalRef=OBJ_YAW_ANGLE_038
            OBJ_YAW_ANGLE_ERR_038_oRDR_TRACKER_OBJ_038_oPCAN_RADAR_cad8db34_Tx: ComBitPosition=175, ComBitSize=7, ComSignalType=UINT8, ComSystemTemplateSystemSignalRef=OBJ_YAW_ANGLE_ERR_038
            OBJ_YAW_RATE_038_oRDR_TRACKER_OBJ_038_oPCAN_RADAR_3a5af8a4_Tx: ComBitPosition=399, ComBitSize=10, ComSignalType=UINT16, ComSystemTemplateSystemSignalRef=OBJ_YAW_RATE_038
            OBJ_YAW_RATE_ERR_038_oRDR_TRACKER_OBJ_038_oPCAN_RADAR_05826f78_Tx: ComBitPosition=388, ComBitSize=5, ComSignalType=UINT8, ComSystemTemplateSystemSignalRef=OBJ_YAW_RATE_ERR_038
        SG_TrackerObject039_oRDR_TRACKER_OBJ_039_oPCAN_RADAR_f76c39c3_Tx: ComSystemTemplateSignalGroupRef=SG_TrackerObject039
          49 x ComGroupSignal, all with ComSignalEndianness=BIG_ENDIAN, ComSignalInitValue=0, ComTransferProperty=PENDING:
            OBJ_ACCELERATION_LAT_039_oRDR_TRACKER_OBJ_039_oPCAN_RADAR_f94862b4_Tx: ComBitPosition=177, ComBitSize=10, ComSignalType=UINT16, ComSystemTemplateSystemSignalRef=OBJ_ACCELERATION_LAT_039
            OBJ_ACCELERATION_LAT_ERR_039_oRDR_TRACKER_OBJ_039_oPCAN_RADAR_2cbc580a_Tx: ComBitPosition=223, ComBitSize=8, ComSignalType=UINT8, ComSystemTemplateSystemSignalRef=OBJ_ACCELERATION_LAT_ERR_039
            OBJ_ACCELERATION_LONG_039_oRDR_TRACKER_OBJ_039_oPCAN_RADAR_8bb83b54_Tx: ComBitPosition=193, ComBitSize=10, ComSignalType=UINT16, ComSystemTemplateSystemSignalRef=OBJ_ACCELERATION_LONG_039
            OBJ_ACCELERATION_LONG_ERR_039_oRDR_TRACKER_OBJ_039_oPCAN_RADAR_3319fda0_Tx: ComBitPosition=215, ComBitSize=8, ComSignalType=UINT8, ComSystemTemplateSystemSignalRef=OBJ_ACCELERATION_LONG_ERR_039
            OBJ_ACCEL_ERR_CRR_COEF_039_oRDR_TRACKER_OBJ_039_oPCAN_RADAR_93badcc6_Tx: ComBitPosition=431, ComBitSize=8, ComSignalType=UINT8, ComSystemTemplateSystemSignalRef=OBJ_ACCEL_ERR_CRR_COEF_039
            OBJ_ALIVE_TIME_039_oRDR_TRACKER_OBJ_039_oPCAN_RADAR_ebd970e8_Tx: ComBitPosition=255, ComBitSize=16, ComSignalType=UINT16, ComSystemTemplateSystemSignalRef=OBJ_ALIVE_TIME_039
            OBJ_CLS_TYPE1_039_oRDR_TRACKER_OBJ_039_oPCAN_RADAR_7c0291ce_Tx: ComBitPosition=271, ComBitSize=4, ComSignalType=UINT8, ComSystemTemplateSystemSignalRef=OBJ_CLS_TYPE1_039
            OBJ_CLS_TYPE1_PROB_039_oRDR_TRACKER_OBJ_039_oPCAN_RADAR_d45a463d_Tx: ComBitPosition=303, ComBitSize=8, ComSignalType=UINT8, ComSystemTemplateSystemSignalRef=OBJ_CLS_TYPE1_PROB_039
            OBJ_CLS_TYPE2_039_oRDR_TRACKER_OBJ_039_oPCAN_RADAR_31ea91a9_Tx: ComBitPosition=267, ComBitSize=4, ComSignalType=UINT8, ComSystemTemplateSystemSignalRef=OBJ_CLS_TYPE2_039
            OBJ_CLS_TYPE2_PROB_039_oRDR_TRACKER_OBJ_039_oPCAN_RADAR_1d6e5d30_Tx: ComBitPosition=311, ComBitSize=8, ComSignalType=UINT8, ComSystemTemplateSystemSignalRef=OBJ_CLS_TYPE2_PROB_039
            OBJ_CLS_TYPE3_039_oRDR_TRACKER_OBJ_039_oPCAN_RADAR_bc626c4b_Tx: ComBitPosition=279, ComBitSize=4, ComSignalType=UINT8, ComSystemTemplateSystemSignalRef=OBJ_CLS_TYPE3_039
            OBJ_CLS_TYPE3_PROB_039_oRDR_TRACKER_OBJ_039_oPCAN_RADAR_5a7dabcb_Tx: ComBitPosition=319, ComBitSize=8, ComSignalType=UINT8, ComSystemTemplateSystemSignalRef=OBJ_CLS_TYPE3_PROB_039
            OBJ_CLS_TYPE4_039_oRDR_TRACKER_OBJ_039_oPCAN_RADAR_aa3a9167_Tx: ComBitPosition=275, ComBitSize=4, ComSignalType=UINT8, ComSystemTemplateSystemSignalRef=OBJ_CLS_TYPE4_039
            OBJ_CLS_TYPE4_PROB_039_oRDR_TRACKER_OBJ_039_oPCAN_RADAR_54776d6b_Tx: ComBitPosition=327, ComBitSize=8, ComSignalType=UINT8, ComSystemTemplateSystemSignalRef=OBJ_CLS_TYPE4_PROB_039
            OBJ_CLS_TYPE5_039_oRDR_TRACKER_OBJ_039_oPCAN_RADAR_27b26c85_Tx: ComBitPosition=287, ComBitSize=4, ComSignalType=UINT8, ComSystemTemplateSystemSignalRef=OBJ_CLS_TYPE5_039
            OBJ_CLS_TYPE5_PROB_039_oRDR_TRACKER_OBJ_039_oPCAN_RADAR_13649b90_Tx: ComBitPosition=335, ComBitSize=8, ComSignalType=UINT8, ComSystemTemplateSystemSignalRef=OBJ_CLS_TYPE5_PROB_039
            OBJ_CLS_TYPE6_039_oRDR_TRACKER_OBJ_039_oPCAN_RADAR_6a5a6ce2_Tx: ComBitPosition=282, ComBitSize=4, ComSignalType=UINT8, ComSystemTemplateSystemSignalRef=OBJ_CLS_TYPE6_039
            OBJ_CLS_TYPE6_PROB_039_oRDR_TRACKER_OBJ_039_oPCAN_RADAR_da50809d_Tx: ComBitPosition=343, ComBitSize=8, ComSignalType=UINT8, ComSystemTemplateSystemSignalRef=OBJ_CLS_TYPE6_PROB_039
            OBJ_DIMENSION_LENGTH_039_oRDR_TRACKER_OBJ_039_oPCAN_RADAR_3e9cc28a_Tx: ComBitPosition=37, ComBitSize=12, ComSignalType=UINT16, ComSystemTemplateSystemSignalRef=OBJ_DIMENSION_LENGTH_039
            OBJ_DIMENSION_LENGTH_ERR_039_oRDR_TRACKER_OBJ_039_oPCAN_RADAR_0564ddf0_Tx: ComBitPosition=41, ComBitSize=10, ComSignalType=UINT16, ComSystemTemplateSystemSignalRef=OBJ_DIMENSION_LENGTH_ERR_039
            OBJ_DIMENSION_WIDTH_039_oRDR_TRACKER_OBJ_039_oPCAN_RADAR_1d523527_Tx: ComBitPosition=17, ComBitSize=10, ComSignalType=UINT16, ComSystemTemplateSystemSignalRef=OBJ_DIMENSION_WIDTH_039
            OBJ_DIMENSION_WIDTH_ERR_039_oRDR_TRACKER_OBJ_039_oPCAN_RADAR_fdf0f2cf_Tx: ComBitPosition=23, ComBitSize=6, ComSignalType=UINT8, ComSystemTemplateSystemSignalRef=OBJ_DIMENSION_WIDTH_ERR_039
            OBJ_EXISTENCE_PROB_039_oRDR_TRACKER_OBJ_039_oPCAN_RADAR_16eeb11a_Tx: ComBitPosition=229, ComBitSize=14, ComSignalType=UINT16, ComSystemTemplateSystemSignalRef=OBJ_EXISTENCE_PROB_039
            OBJ_GROUP_ID_039_oRDR_TRACKER_OBJ_039_oPCAN_RADAR_9f9ca5b7_Tx: ComBitPosition=405, ComBitSize=6, ComSignalType=UINT8, ComSystemTemplateSystemSignalRef=OBJ_GROUP_ID_039
            OBJ_ID_039_oRDR_TRACKER_OBJ_039_oPCAN_RADAR_6cb28eb0_Tx: ComBitPosition=7, ComBitSize=8, ComSignalType=UINT8, ComSystemTemplateSystemSignalRef=OBJ_ID_039
            OBJ_MEASUREMENT_STATUS_039_oRDR_TRACKER_OBJ_039_oPCAN_RADAR_1360fc0d_Tx: ComBitPosition=14, ComBitSize=3, ComSignalType=UINT8, ComSystemTemplateSystemSignalRef=OBJ_MEASUREMENT_STATUS_039
            OBJ_MH_CRC16_039_oRDR_TRACKER_OBJ_039_oPCAN_RADAR_6f004b31_Tx: ComBitPosition=495, ComBitSize=16, ComSignalType=UINT16, ComSystemTemplateSystemSignalRef=OBJ_MH_CRC16_039
            OBJ_MH_CYCLE_COUNTER_039_oRDR_TRACKER_OBJ_039_oPCAN_RADAR_1ee411d0_Tx: ComBitPosition=487, ComBitSize=8, ComSignalType=UINT8, ComSystemTemplateSystemSignalRef=OBJ_MH_CYCLE_COUNTER_039
            OBJ_MOVEMENT_STATUS_039_oRDR_TRACKER_OBJ_039_oPCAN_RADAR_3cce6941_Tx: ComBitPosition=196, ComBitSize=3, ComSignalType=UINT8, ComSystemTemplateSystemSignalRef=OBJ_MOVEMENT_STATUS_039
            OBJ_POS_ERR_CRR_COEF_039_oRDR_TRACKER_OBJ_039_oPCAN_RADAR_acb1a97b_Tx: ComBitPosition=415, ComBitSize=8, ComSignalType=UINT8, ComSystemTemplateSystemSignalRef=OBJ_POS_ERR_CRR_COEF_039
            OBJ_POS_LAT_039_oRDR_TRACKER_OBJ_039_oPCAN_RADAR_4e1e5437_Tx: ComBitPosition=79, ComBitSize=16, ComSignalType=UINT16, ComSystemTemplateSystemSignalRef=OBJ_POS_LAT_039
            OBJ_POS_LAT_ERR_039_oRDR_TRACKER_OBJ_039_oPCAN_RADAR_4a520400_Tx: ComBitPosition=103, ComBitSize=8, ComSignalType=UINT8, ComSystemTemplateSystemSignalRef=OBJ_POS_LAT_ERR_039
            OBJ_POS_LONG_039_oRDR_TRACKER_OBJ_039_oPCAN_RADAR_ffbebff8_Tx: ComBitPosition=63, ComBitSize=16, ComSignalType=UINT16, ComSystemTemplateSystemSignalRef=OBJ_POS_LONG_039
            OBJ_POS_LONG_ERR_039_oRDR_TRACKER_OBJ_039_oPCAN_RADAR_d3aafae2_Tx: ComBitPosition=95, ComBitSize=8, ComSignalType=UINT8, ComSystemTemplateSystemSignalRef=OBJ_POS_LONG_ERR_039
            OBJ_RCS_039_oRDR_TRACKER_OBJ_039_oPCAN_RADAR_6cd10230_Tx: ComBitPosition=351, ComBitSize=7, ComSignalType=UINT8, ComSystemTemplateSystemSignalRef=OBJ_RCS_039
            OBJ_REF_PT_LAT_OFFSET_039_oRDR_TRACKER_OBJ_039_oPCAN_RADAR_99ec6945_Tx: ComBitPosition=370, ComBitSize=14, ComSignalType=UINT16, ComSystemTemplateSystemSignalRef=OBJ_REF_PT_LAT_OFFSET_039
            OBJ_REF_PT_LONG_OFFSET_039_oRDR_TRACKER_OBJ_039_oPCAN_RADAR_d6be9946_Tx: ComBitPosition=357, ComBitSize=14, ComSignalType=UINT16, ComSystemTemplateSystemSignalRef=OBJ_REF_PT_LONG_OFFSET_039
            OBJ_TIMESTAMP_OFFSET_039_oRDR_TRACKER_OBJ_039_oPCAN_RADAR_6c7d0266_Tx: ComBitPosition=247, ComBitSize=8, ComSignalType=UINT8, ComSystemTemplateSystemSignalRef=OBJ_TIMESTAMP_OFFSET_039
            OBJ_TRACK_MOTION_MODEL_039_oRDR_TRACKER_OBJ_039_oPCAN_RADAR_a07e03bb_Tx: ComBitPosition=9, ComBitSize=2, ComSignalType=UINT8, ComSystemTemplateSystemSignalRef=OBJ_TRACK_MOTION_MODEL_039
            OBJ_VEH_TRACK_FLAG_039_oRDR_TRACKER_OBJ_039_oPCAN_RADAR_2254f5e6_Tx: ComBitPosition=10, ComBitSize=1, ComSignalType=BOOLEAN, ComSystemTemplateSystemSignalRef=OBJ_VEH_TRACK_FLAG_039
            OBJ_VELOCITY_ERR_CRR_COEF_039_oRDR_TRACKER_OBJ_039_oPCAN_RADAR_05cb949a_Tx: ComBitPosition=423, ComBitSize=8, ComSignalType=UINT8, ComSystemTemplateSystemSignalRef=OBJ_VELOCITY_ERR_CRR_COEF_039
            OBJ_VELOCITY_LAT_039_oRDR_TRACKER_OBJ_039_oPCAN_RADAR_0a7d1110_Tx: ComBitPosition=126, ComBitSize=15, ComSignalType=UINT16, ComSystemTemplateSystemSignalRef=OBJ_VELOCITY_LAT_039
            OBJ_VELOCITY_LAT_ERR_039_oRDR_TRACKER_OBJ_039_oPCAN_RADAR_3e876141_Tx: ComBitPosition=151, ComBitSize=8, ComSignalType=UINT8, ComSystemTemplateSystemSignalRef=OBJ_VELOCITY_LAT_ERR_039
            OBJ_VELOCITY_LONG_039_oRDR_TRACKER_OBJ_039_oPCAN_RADAR_5af069d6_Tx: ComBitPosition=110, ComBitSize=15, ComSignalType=UINT16, ComSystemTemplateSystemSignalRef=OBJ_VELOCITY_LONG_039
            OBJ_VELOCITY_LONG_ERR_039_oRDR_TRACKER_OBJ_039_oPCAN_RADAR_d2055e81_Tx: ComBitPosition=143, ComBitSize=8, ComSignalType=UINT8, ComSystemTemplateSystemSignalRef=OBJ_VELOCITY_LONG_ERR_039
            OBJ_YAW_ANGLE_039_oRDR_TRACKER_OBJ_039_oPCAN_RADAR_e6c15550_Tx: ComBitPosition=155, ComBitSize=12, ComSignalType=UINT16, ComSystemTemplateSystemSignalRef=OBJ_YAW_ANGLE_039
            OBJ_YAW_ANGLE_ERR_039_oRDR_TRACKER_OBJ_039_oPCAN_RADAR_33cc5387_Tx: ComBitPosition=175, ComBitSize=7, ComSignalType=UINT8, ComSystemTemplateSystemSignalRef=OBJ_YAW_ANGLE_ERR_039
            OBJ_YAW_RATE_039_oRDR_TRACKER_OBJ_039_oPCAN_RADAR_c34e7017_Tx: ComBitPosition=399, ComBitSize=10, ComSignalType=UINT16, ComSystemTemplateSystemSignalRef=OBJ_YAW_RATE_039
            OBJ_YAW_RATE_ERR_039_oRDR_TRACKER_OBJ_039_oPCAN_RADAR_fc96e7cb_Tx: ComBitPosition=388, ComBitSize=5, ComSignalType=UINT8, ComSystemTemplateSystemSignalRef=OBJ_YAW_RATE_ERR_039
