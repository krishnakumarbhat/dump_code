[part 3 of 24: package /InitialEcuC]
AUTOSAR XML (schema 00053)
package /InitialEcuC  (continued)
  module config CanTp
    CanTpConfig: CanTpMainFunctionPeriod=0.005
      192 x CanTpChannel, all with CanTpChannelMode=CANTP_MODE_FULL_DUPLEX:
        TPCH_02987720: variation-point=post-build-variant-condition{matching-criterion=RDR_POS, value=0}
          CanTpRxNSdu_0d8cb540 (CanTpRxNSdu):
            CanTpRxAddressingFormat = CANTP_STANDARD
            CanTpRxDl = 8
            CanTpRxTaType = CANTP_FUNCTIONAL
            CanTpRxNSduRef = EcucPduCollection/PCAN_DIAG_REQ_FUNC_OBD2_oPCAN_RADAR_20_41244182_Rx
            CanTpRxNPdu_2f78abfb (CanTpRxNPdu): CanTpRxNPduRef=PCAN_DIAG_REQ_FUNC_OBD2_Tp_oPCAN_RADAR_20_400c7f70_Rx
        TPCH_1466068d: variation-point=post-build-variant-condition{matching-criterion=RDR_POS, value=0}
          CanTpRxNSdu_e66ca3b9 (CanTpRxNSdu):
            CanTpRxAddressingFormat = CANTP_STANDARD
            CanTpRxDl = 64
            CanTpRxTaType = CANTP_CANFD_PHYSICAL
            CanTpRxNSduRef = EcucPduCollection/PCAN_DIAG_REQ_PHYS_OBD1_oPCAN_RADAR_bb22f7fc_Rx
            CanTpRxNPdu_bea21a30 (CanTpRxNPdu): CanTpRxNPduRef=PCAN_DIAG_REQ_PHYS_OBD1_Tp_oPCAN_RADAR_6e232c89_Rx
            CanTpTxFcNPdu_bea21a30 (CanTpTxFcNPdu): CanTpTxFcNPduRef=PCAN_DIAG_RESP_PHYS_OBD1_Tp_oPCAN_RADAR_0aebd6ab_Tx
          CanTpTxNSdu_e66ca3b9 (CanTpTxNSdu):
            CanTpTxAddressingFormat = CANTP_STANDARD
            CanTpTxDl = 64
            CanTpTxTaType = CANTP_CANFD_PHYSICAL
            CanTpTxNSduRef = EcucPduCollection/PCAN_DIAG_RESP_PHYS_OBD1_oPCAN_RADAR_572eb9fe_Tx
            CanTpRxFcNPdu_9c58cec2 (CanTpRxFcNPdu): CanTpRxFcNPduRef=PCAN_DIAG_REQ_PHYS_OBD1_Tp_oPCAN_RADAR_6e232c89_Rx
            CanTpTxNPdu_9c58cec2 (CanTpTxNPdu): CanTpTxNPduRef=PCAN_DIAG_RESP_PHYS_OBD1_Tp_oPCAN_RADAR_0aebd6ab_Tx
        TPCH_308e4c57: variation-point=post-build-variant-condition{matching-criterion=RDR_POS, value=0}
          CanTpRxNSdu_b76651b3 (CanTpRxNSdu):
            CanTpRxAddressingFormat = CANTP_STANDARD
            CanTpRxDl = 8
            CanTpRxTaType = CANTP_FUNCTIONAL
            CanTpRxNSduRef = EcucPduCollection/DIAG_REQ_FNC_PLANT_oVCAN_RADAR_42eb2f27_Rx
            CanTpRxNPdu_ec7f19dd (CanTpRxNPdu): CanTpRxNPduRef=DIAG_REQ_FNC_PLANT_Tp_oVCAN_RADAR_d6304422_Rx
        TPCH_481339a9: variation-point=post-build-variant-condition{matching-criterion=RDR_POS, value=0}
          CanTpRxNSdu_db835be6 (CanTpRxNSdu):
            CanTpRxAddressingFormat = CANTP_STANDARD
            CanTpRxDl = 8
            CanTpRxTaType = CANTP_PHYSICAL
            CanTpRxNSduRef = EcucPduCollection/PCAN_DIAG_REQ_PHYS_OBD2_oPCAN_RADAR_20_95757328_Rx
            CanTpRxNPdu_a9d0cc61 (CanTpRxNPdu): CanTpRxNPduRef=PCAN_DIAG_REQ_PHYS_OBD2_Tp_oPCAN_RADAR_20_65ff9201_Rx
            CanTpTxFcNPdu_a9d0cc61 (CanTpTxFcNPdu): CanTpTxFcNPduRef=PCAN_DIAG_RESP_PHYS_OBD2_Tp_oPCAN_RADAR_20_25da435e_Tx
          CanTpTxNSdu_db835be6 (CanTpTxNSdu):
            CanTpTxAddressingFormat = CANTP_STANDARD
            CanTpTxDl = 8
            CanTpTxTaType = CANTP_PHYSICAL
            CanTpTxNSduRef = EcucPduCollection/PCAN_DIAG_RESP_PHYS_OBD2_oPCAN_RADAR_20_f1bd890a_Tx
            CanTpRxFcNPdu_8b2a1893 (CanTpRxFcNPdu): CanTpRxFcNPduRef=PCAN_DIAG_REQ_PHYS_OBD2_Tp_oPCAN_RADAR_20_65ff9201_Rx
            CanTpTxNPdu_8b2a1893 (CanTpTxNPdu): CanTpTxNPduRef=PCAN_DIAG_RESP_PHYS_OBD2_Tp_oPCAN_RADAR_20_25da435e_Tx
        TPCH_4ac61397: variation-point=post-build-variant-condition{matching-criterion=RDR_POS, value=0}
          CanTpRxNSdu_d62c6608 (CanTpRxNSdu):
            CanTpRxAddressingFormat = CANTP_STANDARD
            CanTpRxDl = 64
            CanTpRxTaType = CANTP_CANFD_FUNCTIONAL
            CanTpRxNSduRef = EcucPduCollection/PCAN_DIAG_REQ_FUNC_OBD2_oPCAN_RADAR_e2bd2c08_Rx
            CanTpRxNPdu_7c29b324 (CanTpRxNPdu): CanTpRxNPduRef=PCAN_DIAG_REQ_FUNC_OBD2_Tp_oPCAN_RADAR_de9265dd_Rx
        TPCH_4dce67f4: variation-point=post-build-variant-condition{matching-criterion=RDR_POS, value=0}
          CanTpRxNSdu_c5537cf0 (CanTpRxNSdu):
            CanTpRxAddressingFormat = CANTP_STANDARD
            CanTpRxDl = 8
            CanTpRxTaType = CANTP_PHYSICAL
            CanTpRxNSduRef = EcucPduCollection/FR_DIAG_REQ_PHY_OBD2_oVCAN_RADAR_0f521c1d_Rx
            CanTpRxNPdu_25c8f584 (CanTpRxNPdu): CanTpRxNPduRef=FR_DIAG_REQ_PHY_OBD2_Tp_oVCAN_RADAR_b91a4a31_Rx
            CanTpTxFcNPdu_25c8f584 (CanTpTxFcNPdu): CanTpTxFcNPduRef=FR_DIAG_RES_PHY_OBD2_Tp_oVCAN_RADAR_25471ce8_Tx
          CanTpTxNSdu_c5537cf0 (CanTpTxNSdu):
            CanTpTxAddressingFormat = CANTP_STANDARD
            CanTpTxDl = 8
            CanTpTxTaType = CANTP_PHYSICAL
            CanTpTxNSduRef = EcucPduCollection/FR_DIAG_RES_PHY_OBD2_oVCAN_RADAR_96501380_Tx
            CanTpRxFcNPdu_07322176 (CanTpRxFcNPdu): CanTpRxFcNPduRef=FR_DIAG_REQ_PHY_OBD2_Tp_oVCAN_RADAR_b91a4a31_Rx
            CanTpTxNPdu_07322176 (CanTpTxNPdu): CanTpTxNPduRef=FR_DIAG_RES_PHY_OBD2_Tp_oVCAN_RADAR_25471ce8_Tx
        TPCH_54b76144: variation-point=post-build-variant-condition{matching-criterion=RDR_POS, value=0}
          CanTpRxNSdu_2fa399b3 (CanTpRxNSdu):
            CanTpRxAddressingFormat = CANTP_STANDARD
            CanTpRxDl = 8
            CanTpRxTaType = CANTP_PHYSICAL
            CanTpRxNSduRef = EcucPduCollection/FR_DIAG_REQ_PHY_OTA_oVCAN_RADAR_9187f4da_Rx
            CanTpRxNPdu_1c8dcaf8 (CanTpRxNPdu): CanTpRxNPduRef=FR_DIAG_REQ_PHY_OTA_Tp_oVCAN_RADAR_4de495d5_Rx
            CanTpTxFcNPdu_1c8dcaf8 (CanTpTxFcNPdu): CanTpTxFcNPduRef=FR_DIAG_RES_PHY_OTA_Tp_oVCAN_RADAR_19b4e511_Tx
          CanTpTxNSdu_2fa399b3 (CanTpTxNSdu):
            CanTpTxAddressingFormat = CANTP_STANDARD
            CanTpTxDl = 8
            CanTpTxTaType = CANTP_PHYSICAL
            CanTpTxNSduRef = EcucPduCollection/FR_DIAG_RES_PHY_OTA_oVCAN_RADAR_9ad9d3d9_Tx
            CanTpRxFcNPdu_3e771e0a (CanTpRxFcNPdu): CanTpRxFcNPduRef=FR_DIAG_REQ_PHY_OTA_Tp_oVCAN_RADAR_4de495d5_Rx
            CanTpTxNPdu_3e771e0a (CanTpTxNPdu): CanTpTxNPduRef=FR_DIAG_RES_PHY_OTA_Tp_oVCAN_RADAR_19b4e511_Tx
        TPCH_5e8efa28: variation-point=post-build-variant-condition{matching-criterion=RDR_POS, value=0}
          CanTpRxNSdu_bd9a0635 (CanTpRxNSdu):
            CanTpRxAddressingFormat = CANTP_STANDARD
            CanTpRxDl = 8
            CanTpRxTaType = CANTP_PHYSICAL
            CanTpRxNSduRef = EcucPduCollection/PCAN_DIAG_REQ_PHYS_OTA_oPCAN_RADAR_20_0b124a16_Rx
            CanTpRxNPdu_1d12fd25 (CanTpRxNPdu): CanTpRxNPduRef=PCAN_DIAG_REQ_PHYS_OTA_Tp_oPCAN_RADAR_20_96582344_Rx
            CanTpTxFcNPdu_1d12fd25 (CanTpTxFcNPdu): CanTpTxFcNPduRef=PCAN_DIAG_RESP_PHYS_OTA_Tp_oPCAN_RADAR_20_6c821aae_Tx
          CanTpTxNSdu_bd9a0635 (CanTpTxNSdu):
            CanTpTxAddressingFormat = CANTP_STANDARD
            CanTpTxDl = 8
            CanTpTxTaType = CANTP_PHYSICAL
            CanTpTxNSduRef = EcucPduCollection/PCAN_DIAG_RESP_PHYS_OTA_oPCAN_RADAR_20_a840a80f_Tx
            CanTpRxFcNPdu_3fe829d7 (CanTpRxFcNPdu): CanTpRxFcNPduRef=PCAN_DIAG_REQ_PHYS_OTA_Tp_oPCAN_RADAR_20_96582344_Rx
            CanTpTxNPdu_3fe829d7 (CanTpTxNPdu): CanTpTxNPduRef=PCAN_DIAG_RESP_PHYS_OTA_Tp_oPCAN_RADAR_20_6c821aae_Tx
        TPCH_636ba87a: variation-point=post-build-variant-condition{matching-criterion=RDR_POS, value=0}
          CanTpRxNSdu_6a4050a8 (CanTpRxNSdu):
            CanTpRxAddressingFormat = CANTP_STANDARD
            CanTpRxDl = 8
            CanTpRxTaType = CANTP_FUNCTIONAL
            CanTpRxNSduRef = EcucPduCollection/PCAN_DIAG_REQ_FUNC_OBD1_oPCAN_RADAR_20_25c43a7c_Rx
            CanTpRxNPdu_007a5691 (CanTpRxNPdu): CanTpRxNPduRef=PCAN_DIAG_REQ_FUNC_OBD1_Tp_oPCAN_RADAR_20_9397638b_Rx
        TPCH_88d405ee: variation-point=post-build-variant-condition{matching-criterion=RDR_POS, value=0}
          CanTpRxNSdu_7f5185ac (CanTpRxNSdu):
            CanTpRxAddressingFormat = CANTP_STANDARD
            CanTpRxDl = 8
            CanTpRxTaType = CANTP_PHYSICAL
            CanTpRxNSduRef = EcucPduCollection/FR_DIAG_REQ_PHY_OBD1_oVCAN_RADAR_5445ad08_Rx
            CanTpRxNPdu_7e1619c8 (CanTpRxNPdu): CanTpRxNPduRef=FR_DIAG_REQ_PHY_OBD1_Tp_oVCAN_RADAR_ddfa31cf_Rx
            CanTpTxFcNPdu_7e1619c8 (CanTpTxFcNPdu): CanTpTxFcNPduRef=FR_DIAG_RES_PHY_OBD1_Tp_oVCAN_RADAR_41a76716_Tx
          CanTpTxNSdu_7f5185ac (CanTpTxNSdu):
            CanTpTxAddressingFormat = CANTP_STANDARD
            CanTpTxDl = 8
            CanTpTxTaType = CANTP_PHYSICAL
            CanTpTxNSduRef = EcucPduCollection/FR_DIAG_RES_PHY_OBD1_oVCAN_RADAR_cd47a295_Tx
            CanTpRxFcNPdu_5ceccd3a (CanTpRxFcNPdu): CanTpRxFcNPduRef=FR_DIAG_REQ_PHY_OBD1_Tp_oVCAN_RADAR_ddfa31cf_Rx
            CanTpTxNPdu_5ceccd3a (CanTpTxNPdu): CanTpTxNPduRef=FR_DIAG_RES_PHY_OBD1_Tp_oVCAN_RADAR_41a76716_Tx
        TPCH_8a355ab8: variation-point=post-build-variant-condition{matching-criterion=RDR_POS, value=0}
          CanTpRxNSdu_e307f5e7 (CanTpRxNSdu):
            CanTpRxAddressingFormat = CANTP_STANDARD
            CanTpRxDl = 8
            CanTpRxTaType = CANTP_FUNCTIONAL
            CanTpRxNSduRef = EcucPduCollection/PCAN_DIAG_REQ_FUNC_PLANT_oPCAN_RADAR_20_c17463fa_Rx
            CanTpRxNPdu_dea5e5f6 (CanTpRxNPdu): CanTpRxNPduRef=PCAN_DIAG_REQ_FUNC_PLANT_Tp_oPCAN_RADAR_20_d63751cc_Rx
        TPCH_8fe3d063: variation-point=post-build-variant-condition{matching-criterion=RDR_POS, value=0}
          CanTpRxNSdu_24fdb8bb (CanTpRxNSdu):
            CanTpRxAddressingFormat = CANTP_STANDARD
            CanTpRxDl = 8
            CanTpRxTaType = CANTP_PHYSICAL
            CanTpRxNSduRef = EcucPduCollection/PCAN_DIAG_REQ_PHYS_OBD1_oPCAN_RADAR_20_f19508d6_Rx
            CanTpRxNPdu_53da4212 (CanTpRxNPdu): CanTpRxNPduRef=PCAN_DIAG_REQ_PHYS_OBD1_Tp_oPCAN_RADAR_20_b6648efa_Rx
            CanTpTxFcNPdu_53da4212 (CanTpTxFcNPdu): CanTpTxFcNPduRef=PCAN_DIAG_RESP_PHYS_OBD1_Tp_oPCAN_RADAR_20_f6415fa5_Tx
          CanTpTxNSdu_24fdb8bb (CanTpTxNSdu):
            CanTpTxAddressingFormat = CANTP_STANDARD
            CanTpTxDl = 8
            CanTpTxTaType = CANTP_PHYSICAL
            CanTpTxNSduRef = EcucPduCollection/PCAN_DIAG_RESP_PHYS_OBD1_oPCAN_RADAR_20_955df2f4_Tx
            CanTpRxFcNPdu_712096e0 (CanTpRxFcNPdu): CanTpRxFcNPduRef=PCAN_DIAG_REQ_PHYS_OBD1_Tp_oPCAN_RADAR_20_b6648efa_Rx
            CanTpTxNPdu_712096e0 (CanTpTxNPdu): CanTpTxNPduRef=PCAN_DIAG_RESP_PHYS_OBD1_Tp_oPCAN_RADAR_20_f6415fa5_Tx
        TPCH_9592843e: variation-point=post-build-variant-condition{matching-criterion=RDR_POS, value=0}
          CanTpRxNSdu_c5ebb271 (CanTpRxNSdu):
            CanTpRxAddressingFormat = CANTP_STANDARD
            CanTpRxDl = 8
            CanTpRxTaType = CANTP_FUNCTIONAL
            CanTpRxNSduRef = EcucPduCollection/DIAG_REQ_FNC_OTA_oVCAN_RADAR_e787ed21_Rx
            CanTpRxNPdu_25d1c137 (CanTpRxNPdu): CanTpRxNPduRef=DIAG_REQ_FNC_OTA_Tp_oVCAN_RADAR_6f75a08a_Rx
        TPCH_a6a7d371: variation-point=post-build-variant-condition{matching-criterion=RDR_POS, value=0}
          CanTpRxNSdu_d603b303 (CanTpRxNSdu):
            CanTpRxAddressingFormat = CANTP_STANDARD
            CanTpRxDl = 8
            CanTpRxTaType = CANTP_FUNCTIONAL
            CanTpRxNSduRef = EcucPduCollection/PCAN_DIAG_REQ_FUNC_OTA_oPCAN_RADAR_20_e1100275_Rx
            CanTpRxNPdu_7236ae3d (CanTpRxNPdu): CanTpRxNPduRef=PCAN_DIAG_REQ_FUNC_OTA_Tp_oPCAN_RADAR_20_0a67f2f6_Rx
        TPCH_a9725309: variation-point=post-build-variant-condition{matching-criterion=RDR_POS, value=0}
          CanTpRxNSdu_0057d142 (CanTpRxNSdu):
            CanTpRxAddressingFormat = CANTP_STANDARD
            CanTpRxDl = 64
            CanTpRxTaType = CANTP_CANFD_PHYSICAL
            CanTpRxNSduRef = EcucPduCollection/PCAN_DIAG_REQ_PHYS_OTA_oPCAN_RADAR_45eab9fd_Rx
            CanTpRxNPdu_5da9cb2a (CanTpRxNPdu): CanTpRxNPduRef=PCAN_DIAG_REQ_PHYS_OTA_Tp_oPCAN_RADAR_94a46e49_Rx
            CanTpTxFcNPdu_5da9cb2a (CanTpTxFcNPdu): CanTpTxFcNPduRef=PCAN_DIAG_RESP_PHYS_OTA_Tp_oPCAN_RADAR_37f68c50_Tx
          CanTpTxNSdu_0057d142 (CanTpTxNSdu):
            CanTpTxAddressingFormat = CANTP_STANDARD
            CanTpTxDl = 64
            CanTpTxTaType = CANTP_CANFD_PHYSICAL
            CanTpTxNSduRef = EcucPduCollection/PCAN_DIAG_RESP_PHYS_OTA_oPCAN_RADAR_2a569d3c_Tx
            CanTpRxFcNPdu_7f531fd8 (CanTpRxFcNPdu): CanTpRxFcNPduRef=PCAN_DIAG_REQ_PHYS_OTA_Tp_oPCAN_RADAR_94a46e49_Rx
            CanTpTxNPdu_7f531fd8 (CanTpTxNPdu): CanTpTxNPduRef=PCAN_DIAG_RESP_PHYS_OTA_Tp_oPCAN_RADAR_37f68c50_Tx
        TPCH_b747c4e0: variation-point=post-build-variant-condition{matching-criterion=RDR_POS, value=0}
          CanTpRxNSdu_c5aa076c (CanTpRxNSdu):
            CanTpRxAddressingFormat = CANTP_STANDARD
            CanTpRxDl = 64
            CanTpRxTaType = CANTP_CANFD_FUNCTIONAL
            CanTpRxNSduRef = EcucPduCollection/PCAN_DIAG_REQ_FUNC_PLANT_oPCAN_RADAR_f6414098_Rx
            CanTpRxNPdu_c1cf6678 (CanTpRxNPdu): CanTpRxNPduRef=PCAN_DIAG_REQ_FUNC_PLANT_Tp_oPCAN_RADAR_5ec247a5_Rx
        TPCH_c3135cc4: variation-point=post-build-variant-condition{matching-criterion=RDR_POS, value=0}
          CanTpRxNSdu_8ea01f46 (CanTpRxNSdu):
            CanTpRxAddressingFormat = CANTP_STANDARD
            CanTpRxDl = 64
            CanTpRxTaType = CANTP_CANFD_FUNCTIONAL
            CanTpRxNSduRef = EcucPduCollection/PCAN_DIAG_REQ_FUNC_OBD1_oPCAN_RADAR_b9aa9d1d_Rx
            CanTpRxNPdu_027c2a01 (CanTpRxNPdu): CanTpRxNPduRef=PCAN_DIAG_REQ_FUNC_OBD1_Tp_oPCAN_RADAR_ba721e23_Rx
        TPCH_c8085a38: variation-point=post-build-variant-condition{matching-criterion=RDR_POS, value=0}
          CanTpRxNSdu_80a26c19 (CanTpRxNSdu):
            CanTpRxAddressingFormat = CANTP_STANDARD
            CanTpRxDl = 8
            CanTpRxTaType = CANTP_FUNCTIONAL
            CanTpRxNSduRef = EcucPduCollection/DIAG_REQ_FNC_OBD1_oVCAN_RADAR_7e5c8685_Rx
            CanTpRxNPdu_81677e4e (CanTpRxNPdu): CanTpRxNPduRef=DIAG_REQ_FNC_OBD1_Tp_oVCAN_RADAR_260cec9f_Rx
        TPCH_c9a12f24: variation-point=post-build-variant-condition{matching-criterion=RDR_POS, value=0}
          CanTpRxNSdu_64228dd8 (CanTpRxNSdu):
            CanTpRxAddressingFormat = CANTP_STANDARD
            CanTpRxDl = 64
            CanTpRxTaType = CANTP_CANFD_PHYSICAL
            CanTpRxNSduRef = EcucPduCollection/PCAN_DIAG_REQ_PHYS_OBD2_oPCAN_RADAR_e03546e9_Rx
            CanTpRxNPdu_1fe0333b (CanTpRxNPdu): CanTpRxNPduRef=PCAN_DIAG_REQ_PHYS_OBD2_Tp_oPCAN_RADAR_0ac35777_Rx
            CanTpTxFcNPdu_1fe0333b (CanTpTxFcNPdu): CanTpTxFcNPduRef=PCAN_DIAG_RESP_PHYS_OBD2_Tp_oPCAN_RADAR_6e0bad55_Tx
          CanTpTxNSdu_64228dd8 (CanTpTxNSdu):
            CanTpTxAddressingFormat = CANTP_STANDARD
            CanTpTxDl = 64
            CanTpTxTaType = CANTP_CANFD_PHYSICAL
            CanTpTxNSduRef = EcucPduCollection/PCAN_DIAG_RESP_PHYS_OBD2_oPCAN_RADAR_0c3908eb_Tx
            CanTpRxFcNPdu_3d1ae7c9 (CanTpRxFcNPdu): CanTpRxFcNPduRef=PCAN_DIAG_REQ_PHYS_OBD2_Tp_oPCAN_RADAR_0ac35777_Rx
            CanTpTxNPdu_3d1ae7c9 (CanTpTxNPdu): CanTpTxNPduRef=PCAN_DIAG_RESP_PHYS_OBD2_Tp_oPCAN_RADAR_6e0bad55_Tx
        TPCH_d25c1521: variation-point=post-build-variant-condition{matching-criterion=RDR_POS, value=0}
          CanTpRxNSdu_b509cdf9 (CanTpRxNSdu):
            CanTpRxAddressingFormat = CANTP_STANDARD
            CanTpRxDl = 64
            CanTpRxTaType = CANTP_CANFD_FUNCTIONAL
            CanTpRxNSduRef = EcucPduCollection/PCAN_DIAG_REQ_FUNC_OTA_oPCAN_RADAR_a013523e_Rx
            CanTpRxNPdu_6f50186e (CanTpRxNPdu): CanTpRxNPduRef=PCAN_DIAG_REQ_FUNC_OTA_Tp_oPCAN_RADAR_7ea6262a_Rx
        TPCH_e216a5fe: variation-point=post-build-variant-condition{matching-criterion=RDR_POS, value=0}
          CanTpRxNSdu_6b1dcdd5 (CanTpRxNSdu):
            CanTpRxAddressingFormat = CANTP_STANDARD
            CanTpRxDl = 8
            CanTpRxTaType = CANTP_PHYSICAL
            CanTpRxNSduRef = EcucPduCollection/FR_DIAG_REQ_PHY_PLANT_oVCAN_RADAR_d1c8c991_Rx
            CanTpRxNPdu_11900290 (CanTpRxNPdu): CanTpRxNPduRef=FR_DIAG_REQ_PHY_PLANT_Tp_oVCAN_RADAR_bda0e30b_Rx
            CanTpTxFcNPdu_11900290 (CanTpTxFcNPdu): CanTpTxFcNPduRef=FR_DIAG_RES_PHY_PLANT_Tp_oVCAN_RADAR_4233d42d_Tx
          CanTpTxNSdu_6b1dcdd5 (CanTpTxNSdu):
            CanTpTxAddressingFormat = CANTP_STANDARD
            CanTpTxDl = 8
            CanTpTxTaType = CANTP_PHYSICAL
            CanTpTxNSduRef = EcucPduCollection/FR_DIAG_RES_PHY_PLANT_oVCAN_RADAR_5fef2467_Tx
            CanTpRxFcNPdu_336ad662 (CanTpRxFcNPdu): CanTpRxFcNPduRef=FR_DIAG_REQ_PHY_PLANT_Tp_oVCAN_RADAR_bda0e30b_Rx
            CanTpTxNPdu_336ad662 (CanTpTxNPdu): CanTpTxNPduRef=FR_DIAG_RES_PHY_PLANT_Tp_oVCAN_RADAR_4233d42d_Tx
        TPCH_ee74934f: variation-point=post-build-variant-condition{matching-criterion=RDR_POS, value=0}
          CanTpRxNSdu_3a469f02 (CanTpRxNSdu):
            CanTpRxAddressingFormat = CANTP_STANDARD
            CanTpRxDl = 8
            CanTpRxTaType = CANTP_PHYSICAL
            CanTpRxNSduRef = EcucPduCollection/PCAN_DIAG_REQ_PHYS_PLANT_oPCAN_RADAR_20_f7a3783e_Rx
            CanTpRxNPdu_e961c2e4 (CanTpRxNPdu): CanTpRxNPduRef=PCAN_DIAG_REQ_PHYS_PLANT_Tp_oPCAN_RADAR_20_f110e38b_Rx
            CanTpTxFcNPdu_e961c2e4 (CanTpTxFcNPdu): CanTpTxFcNPduRef=PCAN_DIAG_RESP_PHYS_PLANT_Tp_oPCAN_RADAR_20_0a848a3f_Tx
          CanTpTxNSdu_3a469f02 (CanTpTxNSdu):
            CanTpTxAddressingFormat = CANTP_STANDARD
            CanTpTxDl = 8
            CanTpTxTaType = CANTP_PHYSICAL
            CanTpTxNSduRef = EcucPduCollection/PCAN_DIAG_RESP_PHYS_PLANT_oPCAN_RADAR_20_22a7f120_Tx
            CanTpRxFcNPdu_cb9b1616 (CanTpRxFcNPdu): CanTpRxFcNPduRef=PCAN_DIAG_REQ_PHYS_PLANT_Tp_oPCAN_RADAR_20_f110e38b_Rx
            CanTpTxNPdu_cb9b1616 (CanTpTxNPdu): CanTpTxNPduRef=PCAN_DIAG_RESP_PHYS_PLANT_Tp_oPCAN_RADAR_20_0a848a3f_Tx
        TPCH_f33d22d7: variation-point=post-build-variant-condition{matching-criterion=RDR_POS, value=0}
          CanTpRxNSdu_275a18b1 (CanTpRxNSdu):
            CanTpRxAddressingFormat = CANTP_STANDARD
            CanTpRxDl = 8
            CanTpRxTaType = CANTP_FUNCTIONAL
            CanTpRxNSduRef = EcucPduCollection/DIAG_REQ_FNC_OBD2_oVCAN_RADAR_254b3790_Rx
            CanTpRxNPdu_a704ede5 (CanTpRxNPdu): CanTpRxNPduRef=DIAG_REQ_FNC_OBD2_Tp_oVCAN_RADAR_42ec9761_Rx
        TPCH_fa4054ff: variation-point=post-build-variant-condition{matching-criterion=RDR_POS, value=0}
          CanTpRxNSdu_f486fe77 (CanTpRxNSdu):
            CanTpRxAddressingFormat = CANTP_STANDARD
            CanTpRxDl = 64
            CanTpRxTaType = CANTP_CANFD_PHYSICAL
            CanTpRxNSduRef = EcucPduCollection/PCAN_DIAG_REQ_PHYS_PLANT_oPCAN_RADAR_214e1a1c_Rx
            CanTpRxNPdu_69d47c63 (CanTpRxNPdu): CanTpRxNPduRef=PCAN_DIAG_REQ_PHYS_PLANT_Tp_oPCAN_RADAR_68155c61_Rx
            CanTpTxFcNPdu_69d47c63 (CanTpTxFcNPdu): CanTpTxFcNPduRef=PCAN_DIAG_RESP_PHYS_PLANT_Tp_oPCAN_RADAR_bd11d57f_Tx
          CanTpTxNSdu_f486fe77 (CanTpTxNSdu):
            CanTpTxAddressingFormat = CANTP_STANDARD
            CanTpTxDl = 64
            CanTpTxTaType = CANTP_CANFD_PHYSICAL
            CanTpTxNSduRef = EcucPduCollection/PCAN_DIAG_RESP_PHYS_PLANT_oPCAN_RADAR_cfac777e_Tx
            CanTpRxFcNPdu_4b2ea891 (CanTpRxFcNPdu): CanTpRxFcNPduRef=PCAN_DIAG_REQ_PHYS_PLANT_Tp_oPCAN_RADAR_68155c61_Rx
            CanTpTxNPdu_4b2ea891 (CanTpTxNPdu): CanTpTxNPduRef=PCAN_DIAG_RESP_PHYS_PLANT_Tp_oPCAN_RADAR_bd11d57f_Tx
        TPCH_0543284c: variation-point=post-build-variant-condition{matching-criterion=RDR_POS, value=1}
          CanTpRxNSdu_9bdfb9c6 (CanTpRxNSdu):
            CanTpRxAddressingFormat = CANTP_STANDARD
            CanTpRxDl = 8
            CanTpRxTaType = CANTP_PHYSICAL
            CanTpRxNSduRef = EcucPduCollection/PCAN_DIAG_REQ_PHYS_PLANT_oPCAN_RADAR_20_f7a3783e_Rx
            CanTpRxNPdu_91d8a7cd (CanTpRxNPdu): CanTpRxNPduRef=PCAN_DIAG_REQ_PHYS_PLANT_Tp_oPCAN_RADAR_20_f110e38b_Rx
            CanTpTxFcNPdu_91d8a7cd (CanTpTxFcNPdu): CanTpTxFcNPduRef=PCAN_DIAG_RESP_PHYS_PLANT_Tp_oPCAN_RADAR_20_0a848a3f_Tx
          CanTpTxNSdu_9bdfb9c6 (CanTpTxNSdu):
            CanTpTxAddressingFormat = CANTP_STANDARD
            CanTpTxDl = 8
            CanTpTxTaType = CANTP_PHYSICAL
            CanTpTxNSduRef = EcucPduCollection/PCAN_DIAG_RESP_PHYS_PLANT_oPCAN_RADAR_20_22a7f120_Tx
            CanTpRxFcNPdu_b322733f (CanTpRxFcNPdu): CanTpRxFcNPduRef=PCAN_DIAG_REQ_PHYS_PLANT_Tp_oPCAN_RADAR_20_f110e38b_Rx
            CanTpTxNPdu_b322733f (CanTpTxNPdu): CanTpTxNPduRef=PCAN_DIAG_RESP_PHYS_PLANT_Tp_oPCAN_RADAR_20_0a848a3f_Tx
        TPCH_06db1ec3: variation-point=post-build-variant-condition{matching-criterion=RDR_POS, value=1}
          CanTpRxNSdu_4b8ac5bd (CanTpRxNSdu):
            CanTpRxAddressingFormat = CANTP_STANDARD
            CanTpRxDl = 64
            CanTpRxTaType = CANTP_CANFD_PHYSICAL
            CanTpRxNSduRef = EcucPduCollection/PCAN_DIAG_REQ_PHYS_OTA_oPCAN_RADAR_45eab9fd_Rx
            CanTpRxNPdu_de393efa (CanTpRxNPdu): CanTpRxNPduRef=PCAN_DIAG_REQ_PHYS_OTA_Tp_oPCAN_RADAR_94a46e49_Rx
            CanTpTxFcNPdu_de393efa (CanTpTxFcNPdu): CanTpTxFcNPduRef=PCAN_DIAG_RESP_PHYS_OTA_Tp_oPCAN_RADAR_37f68c50_Tx
          CanTpTxNSdu_4b8ac5bd (CanTpTxNSdu):
            CanTpTxAddressingFormat = CANTP_STANDARD
            CanTpTxDl = 64
            CanTpTxTaType = CANTP_CANFD_PHYSICAL
            CanTpTxNSduRef = EcucPduCollection/PCAN_DIAG_RESP_PHYS_OTA_oPCAN_RADAR_2a569d3c_Tx
            CanTpRxFcNPdu_fcc3ea08 (CanTpRxFcNPdu): CanTpRxFcNPduRef=PCAN_DIAG_REQ_PHYS_OTA_Tp_oPCAN_RADAR_94a46e49_Rx
            CanTpTxNPdu_fcc3ea08 (CanTpTxNPdu): CanTpTxNPduRef=PCAN_DIAG_RESP_PHYS_OTA_Tp_oPCAN_RADAR_37f68c50_Tx
        TPCH_09211efd: variation-point=post-build-variant-condition{matching-criterion=RDR_POS, value=1}
          CanTpRxNSdu_90dedbb7 (CanTpRxNSdu):
            CanTpRxAddressingFormat = CANTP_STANDARD
            CanTpRxDl = 8
            CanTpRxTaType = CANTP_PHYSICAL
            CanTpRxNSduRef = EcucPduCollection/FR_DIAG_REQ_PHY_PLANT_oVCAN_RADAR_d1c8c991_Rx
            CanTpRxNPdu_31443625 (CanTpRxNPdu): CanTpRxNPduRef=FR_DIAG_REQ_PHY_PLANT_Tp_oVCAN_RADAR_bda0e30b_Rx
            CanTpTxFcNPdu_31443625 (CanTpTxFcNPdu): CanTpTxFcNPduRef=FR_DIAG_RES_PHY_PLANT_Tp_oVCAN_RADAR_4233d42d_Tx
          CanTpTxNSdu_90dedbb7 (CanTpTxNSdu):
            CanTpTxAddressingFormat = CANTP_STANDARD
            CanTpTxDl = 8
            CanTpTxTaType = CANTP_PHYSICAL
            CanTpTxNSduRef = EcucPduCollection/FR_DIAG_RES_PHY_PLANT_oVCAN_RADAR_5fef2467_Tx
            CanTpRxFcNPdu_13bee2d7 (CanTpRxFcNPdu): CanTpRxFcNPduRef=FR_DIAG_REQ_PHY_PLANT_Tp_oVCAN_RADAR_bda0e30b_Rx
            CanTpTxNPdu_13bee2d7 (CanTpTxNPdu): CanTpTxNPduRef=FR_DIAG_RES_PHY_PLANT_Tp_oVCAN_RADAR_4233d42d_Tx
        TPCH_14f57a8a: variation-point=post-build-variant-condition{matching-criterion=RDR_POS, value=1}
          CanTpRxNSdu_290c259d (CanTpRxNSdu):
            CanTpRxAddressingFormat = CANTP_STANDARD
            CanTpRxDl = 8
            CanTpRxTaType = CANTP_FUNCTIONAL
            CanTpRxNSduRef = EcucPduCollection/PCAN_DIAG_REQ_FUNC_OBD1_oPCAN_RADAR_20_25c43a7c_Rx
            CanTpRxNPdu_b306521c (CanTpRxNPdu): CanTpRxNPduRef=PCAN_DIAG_REQ_FUNC_OBD1_Tp_oPCAN_RADAR_20_9397638b_Rx
        TPCH_47109ea7: variation-point=post-build-variant-condition{matching-criterion=RDR_POS, value=1}
          CanTpRxNSdu_87c84b68 (CanTpRxNSdu):
            CanTpRxAddressingFormat = CANTP_STANDARD
            CanTpRxDl = 8
            CanTpRxTaType = CANTP_FUNCTIONAL
            CanTpRxNSduRef = EcucPduCollection/DIAG_REQ_FNC_PLANT_oVCAN_RADAR_42eb2f27_Rx
            CanTpRxNPdu_6b2d7968 (CanTpRxNPdu): CanTpRxNPduRef=DIAG_REQ_FNC_PLANT_Tp_oVCAN_RADAR_d6304422_Rx
        TPCH_55e91935: variation-point=post-build-variant-condition{matching-criterion=RDR_POS, value=1}
          CanTpRxNSdu_8063d38e (CanTpRxNSdu):
            CanTpRxAddressingFormat = CANTP_STANDARD
            CanTpRxDl = 64
            CanTpRxTaType = CANTP_CANFD_PHYSICAL
            CanTpRxNSduRef = EcucPduCollection/PCAN_DIAG_REQ_PHYS_PLANT_oPCAN_RADAR_214e1a1c_Rx
            CanTpRxNPdu_ee3456aa (CanTpRxNPdu): CanTpRxNPduRef=PCAN_DIAG_REQ_PHYS_PLANT_Tp_oPCAN_RADAR_68155c61_Rx
            CanTpTxFcNPdu_ee3456aa (CanTpTxFcNPdu): CanTpTxFcNPduRef=PCAN_DIAG_RESP_PHYS_PLANT_Tp_oPCAN_RADAR_bd11d57f_Tx
          CanTpTxNSdu_8063d38e (CanTpTxNSdu):
            CanTpTxAddressingFormat = CANTP_STANDARD
            CanTpTxDl = 64
            CanTpTxTaType = CANTP_CANFD_PHYSICAL
            CanTpTxNSduRef = EcucPduCollection/PCAN_DIAG_RESP_PHYS_PLANT_oPCAN_RADAR_cfac777e_Tx
            CanTpRxFcNPdu_ccce8258 (CanTpRxFcNPdu): CanTpRxFcNPduRef=PCAN_DIAG_REQ_PHYS_PLANT_Tp_oPCAN_RADAR_68155c61_Rx
            CanTpTxNPdu_ccce8258 (CanTpTxNPdu): CanTpTxNPduRef=PCAN_DIAG_RESP_PHYS_PLANT_Tp_oPCAN_RADAR_bd11d57f_Tx
        TPCH_63e3beed: variation-point=post-build-variant-condition{matching-criterion=RDR_POS, value=1}
          CanTpRxNSdu_6b1f15de (CanTpRxNSdu):
            CanTpRxAddressingFormat = CANTP_STANDARD
            CanTpRxDl = 8
            CanTpRxTaType = CANTP_PHYSICAL
            CanTpRxNSduRef = EcucPduCollection/FR_DIAG_REQ_PHY_OBD1_oVCAN_RADAR_5445ad08_Rx
            CanTpRxNPdu_050d9363 (CanTpRxNPdu): CanTpRxNPduRef=FR_DIAG_REQ_PHY_OBD1_Tp_oVCAN_RADAR_ddfa31cf_Rx
            CanTpTxFcNPdu_050d9363 (CanTpTxFcNPdu): CanTpTxFcNPduRef=FR_DIAG_RES_PHY_OBD1_Tp_oVCAN_RADAR_41a76716_Tx
          CanTpTxNSdu_6b1f15de (CanTpTxNSdu):
            CanTpTxAddressingFormat = CANTP_STANDARD
            CanTpTxDl = 8
            CanTpTxTaType = CANTP_PHYSICAL
            CanTpTxNSduRef = EcucPduCollection/FR_DIAG_RES_PHY_OBD1_oVCAN_RADAR_cd47a295_Tx
            CanTpRxFcNPdu_27f74791 (CanTpRxFcNPdu): CanTpRxFcNPduRef=FR_DIAG_REQ_PHY_OBD1_Tp_oVCAN_RADAR_ddfa31cf_Rx
            CanTpTxNPdu_27f74791 (CanTpTxNPdu): CanTpTxNPduRef=FR_DIAG_RES_PHY_OBD1_Tp_oVCAN_RADAR_41a76716_Tx
        TPCH_64d46b60: variation-point=post-build-variant-condition{matching-criterion=RDR_POS, value=1}
          CanTpRxNSdu_6b7431ef (CanTpRxNSdu):
            CanTpRxAddressingFormat = CANTP_STANDARD
            CanTpRxDl = 8
            CanTpRxTaType = CANTP_PHYSICAL
            CanTpRxNSduRef = EcucPduCollection/PCAN_DIAG_REQ_PHYS_OBD1_oPCAN_RADAR_20_f19508d6_Rx
            CanTpRxNPdu_6a09e291 (CanTpRxNPdu): CanTpRxNPduRef=PCAN_DIAG_REQ_PHYS_OBD1_Tp_oPCAN_RADAR_20_b6648efa_Rx
            CanTpTxFcNPdu_6a09e291 (CanTpTxFcNPdu): CanTpTxFcNPduRef=PCAN_DIAG_RESP_PHYS_OBD1_Tp_oPCAN_RADAR_20_f6415fa5_Tx
          CanTpTxNSdu_6b7431ef (CanTpTxNSdu):
            CanTpTxAddressingFormat = CANTP_STANDARD
            CanTpTxDl = 8
            CanTpTxTaType = CANTP_PHYSICAL
            CanTpTxNSduRef = EcucPduCollection/PCAN_DIAG_RESP_PHYS_OBD1_oPCAN_RADAR_20_955df2f4_Tx
            CanTpRxFcNPdu_48f33663 (CanTpRxFcNPdu): CanTpRxFcNPduRef=PCAN_DIAG_REQ_PHYS_OBD1_Tp_oPCAN_RADAR_20_b6648efa_Rx
            CanTpTxNPdu_48f33663 (CanTpTxNPdu): CanTpTxNPduRef=PCAN_DIAG_RESP_PHYS_OBD1_Tp_oPCAN_RADAR_20_f6415fa5_Tx
        TPCH_660862ee: variation-point=post-build-variant-condition{matching-criterion=RDR_POS, value=1}
          CanTpRxNSdu_482f027a (CanTpRxNSdu):
            CanTpRxAddressingFormat = CANTP_STANDARD
            CanTpRxDl = 64
            CanTpRxTaType = CANTP_CANFD_PHYSICAL
            CanTpRxNSduRef = EcucPduCollection/PCAN_DIAG_REQ_PHYS_OBD2_oPCAN_RADAR_e03546e9_Rx
            CanTpRxNPdu_5917721d (CanTpRxNPdu): CanTpRxNPduRef=PCAN_DIAG_REQ_PHYS_OBD2_Tp_oPCAN_RADAR_0ac35777_Rx
            CanTpTxFcNPdu_5917721d (CanTpTxFcNPdu): CanTpTxFcNPduRef=PCAN_DIAG_RESP_PHYS_OBD2_Tp_oPCAN_RADAR_6e0bad55_Tx
          CanTpTxNSdu_482f027a (CanTpTxNSdu):
            CanTpTxAddressingFormat = CANTP_STANDARD
            CanTpTxDl = 64
            CanTpTxTaType = CANTP_CANFD_PHYSICAL
            CanTpTxNSduRef = EcucPduCollection/PCAN_DIAG_RESP_PHYS_OBD2_oPCAN_RADAR_0c3908eb_Tx
            CanTpRxFcNPdu_7beda6ef (CanTpRxFcNPdu): CanTpRxFcNPduRef=PCAN_DIAG_REQ_PHYS_OBD2_Tp_oPCAN_RADAR_0ac35777_Rx
            CanTpTxNPdu_7beda6ef (CanTpTxNPdu): CanTpTxNPduRef=PCAN_DIAG_RESP_PHYS_OBD2_Tp_oPCAN_RADAR_6e0bad55_Tx
        TPCH_73bebed7: variation-point=post-build-variant-condition{matching-criterion=RDR_POS, value=1}
          CanTpRxNSdu_e69a2e9c (CanTpRxNSdu):
            CanTpRxAddressingFormat = CANTP_STANDARD
            CanTpRxDl = 64
            CanTpRxTaType = CANTP_CANFD_FUNCTIONAL
            CanTpRxNSduRef = EcucPduCollection/PCAN_DIAG_REQ_FUNC_OBD2_oPCAN_RADAR_e2bd2c08_Rx
            CanTpRxNPdu_ee04a3b7 (CanTpRxNPdu): CanTpRxNPduRef=PCAN_DIAG_REQ_FUNC_OBD2_Tp_oPCAN_RADAR_de9265dd_Rx
        TPCH_7506a5d0: variation-point=post-build-variant-condition{matching-criterion=RDR_POS, value=1}
          CanTpRxNSdu_5bd213bc (CanTpRxNSdu):
            CanTpRxAddressingFormat = CANTP_STANDARD
            CanTpRxDl = 8
            CanTpRxTaType = CANTP_FUNCTIONAL
            CanTpRxNSduRef = EcucPduCollection/PCAN_DIAG_REQ_FUNC_OBD2_oPCAN_RADAR_20_41244182_Rx
            CanTpRxNPdu_31ffae20 (CanTpRxNPdu): CanTpRxNPduRef=PCAN_DIAG_REQ_FUNC_OBD2_Tp_oPCAN_RADAR_20_400c7f70_Rx
        TPCH_84a3f027: variation-point=post-build-variant-condition{matching-criterion=RDR_POS, value=1}
          CanTpRxNSdu_c22ecba5 (CanTpRxNSdu):
            CanTpRxAddressingFormat = CANTP_STANDARD
            CanTpRxDl = 8
            CanTpRxTaType = CANTP_FUNCTIONAL
            CanTpRxNSduRef = EcucPduCollection/DIAG_REQ_FNC_OBD2_oVCAN_RADAR_254b3790_Rx
            CanTpRxNPdu_dcddaf97 (CanTpRxNPdu): CanTpRxNPduRef=DIAG_REQ_FNC_OBD2_Tp_oVCAN_RADAR_42ec9761_Rx
        TPCH_8e3f69a0: variation-point=post-build-variant-condition{matching-criterion=RDR_POS, value=1}
          CanTpRxNSdu_3d176ff8 (CanTpRxNSdu):
            CanTpRxAddressingFormat = CANTP_STANDARD
            CanTpRxDl = 64
            CanTpRxTaType = CANTP_CANFD_FUNCTIONAL
            CanTpRxNSduRef = EcucPduCollection/PCAN_DIAG_REQ_FUNC_PLANT_oPCAN_RADAR_f6414098_Rx
            CanTpRxNPdu_955effbd (CanTpRxNPdu): CanTpRxNPduRef=PCAN_DIAG_REQ_FUNC_PLANT_Tp_oPCAN_RADAR_5ec247a5_Rx
        TPCH_a32482aa: variation-point=post-build-variant-condition{matching-criterion=RDR_POS, value=1}
          CanTpRxNSdu_4e12ed26 (CanTpRxNSdu):
            CanTpRxAddressingFormat = CANTP_STANDARD
            CanTpRxDl = 8
            CanTpRxTaType = CANTP_PHYSICAL
            CanTpRxNSduRef = EcucPduCollection/PCAN_DIAG_REQ_PHYS_OBD2_oPCAN_RADAR_20_95757328_Rx
            CanTpRxNPdu_f07d8f2b (CanTpRxNPdu): CanTpRxNPduRef=PCAN_DIAG_REQ_PHYS_OBD2_Tp_oPCAN_RADAR_20_65ff9201_Rx
            CanTpTxFcNPdu_f07d8f2b (CanTpTxFcNPdu): CanTpTxFcNPduRef=PCAN_DIAG_RESP_PHYS_OBD2_Tp_oPCAN_RADAR_20_25da435e_Tx
          CanTpTxNSdu_4e12ed26 (CanTpTxNSdu):
            CanTpTxAddressingFormat = CANTP_STANDARD
            CanTpTxDl = 8
            CanTpTxTaType = CANTP_PHYSICAL
            CanTpTxNSduRef = EcucPduCollection/PCAN_DIAG_RESP_PHYS_OBD2_oPCAN_RADAR_20_f1bd890a_Tx
            CanTpRxFcNPdu_d2875bd9 (CanTpRxFcNPdu): CanTpRxFcNPduRef=PCAN_DIAG_REQ_PHYS_OBD2_Tp_oPCAN_RADAR_20_65ff9201_Rx
            CanTpTxNPdu_d2875bd9 (CanTpTxNPdu): CanTpTxNPduRef=PCAN_DIAG_RESP_PHYS_OBD2_Tp_oPCAN_RADAR_20_25da435e_Tx
        TPCH_a6f9dcf7: variation-point=post-build-variant-condition{matching-criterion=RDR_POS, value=1}
          CanTpRxNSdu_5249da4a (CanTpRxNSdu):
            CanTpRxAddressingFormat = CANTP_STANDARD
            CanTpRxDl = 8
            CanTpRxTaType = CANTP_PHYSICAL
            CanTpRxNSduRef = EcucPduCollection/FR_DIAG_REQ_PHY_OBD2_oVCAN_RADAR_0f521c1d_Rx
            CanTpRxNPdu_69216f34 (CanTpRxNPdu): CanTpRxNPduRef=FR_DIAG_REQ_PHY_OBD2_Tp_oVCAN_RADAR_b91a4a31_Rx
            CanTpTxFcNPdu_69216f34 (CanTpTxFcNPdu): CanTpTxFcNPduRef=FR_DIAG_RES_PHY_OBD2_Tp_oVCAN_RADAR_25471ce8_Tx
          CanTpTxNSdu_5249da4a (CanTpTxNSdu):
            CanTpTxAddressingFormat = CANTP_STANDARD
            CanTpTxDl = 8
            CanTpTxTaType = CANTP_PHYSICAL
            CanTpTxNSduRef = EcucPduCollection/FR_DIAG_RES_PHY_OBD2_oVCAN_RADAR_96501380_Tx
            CanTpRxFcNPdu_4bdbbbc6 (CanTpRxFcNPdu): CanTpRxFcNPduRef=FR_DIAG_REQ_PHY_OBD2_Tp_oVCAN_RADAR_b91a4a31_Rx
            CanTpTxNPdu_4bdbbbc6 (CanTpTxNPdu): CanTpTxNPduRef=FR_DIAG_RES_PHY_OBD2_Tp_oVCAN_RADAR_25471ce8_Tx
        TPCH_b5b9412b: variation-point=post-build-variant-condition{matching-criterion=RDR_POS, value=1}
          CanTpRxNSdu_175c4d75 (CanTpRxNSdu):
            CanTpRxAddressingFormat = CANTP_STANDARD
            CanTpRxDl = 8
            CanTpRxTaType = CANTP_PHYSICAL
            CanTpRxNSduRef = EcucPduCollection/PCAN_DIAG_REQ_PHYS_OTA_oPCAN_RADAR_20_0b124a16_Rx
            CanTpRxNPdu_05b41376 (CanTpRxNPdu): CanTpRxNPduRef=PCAN_DIAG_REQ_PHYS_OTA_Tp_oPCAN_RADAR_20_96582344_Rx
            CanTpTxFcNPdu_05b41376 (CanTpTxFcNPdu): CanTpTxFcNPduRef=PCAN_DIAG_RESP_PHYS_OTA_Tp_oPCAN_RADAR_20_6c821aae_Tx
          CanTpTxNSdu_175c4d75 (CanTpTxNSdu):
            CanTpTxAddressingFormat = CANTP_STANDARD
            CanTpTxDl = 8
            CanTpTxTaType = CANTP_PHYSICAL
            CanTpTxNSduRef = EcucPduCollection/PCAN_DIAG_RESP_PHYS_OTA_oPCAN_RADAR_20_a840a80f_Tx
            CanTpRxFcNPdu_274ec784 (CanTpRxFcNPdu): CanTpRxFcNPduRef=PCAN_DIAG_REQ_PHYS_OTA_Tp_oPCAN_RADAR_20_96582344_Rx
            CanTpTxNPdu_274ec784 (CanTpTxNPdu): CanTpTxNPduRef=PCAN_DIAG_RESP_PHYS_OTA_Tp_oPCAN_RADAR_20_6c821aae_Tx
        TPCH_bbcf4b47: variation-point=post-build-variant-condition{matching-criterion=RDR_POS, value=1}
          CanTpRxNSdu_a39083e7 (CanTpRxNSdu):
            CanTpRxAddressingFormat = CANTP_STANDARD
            CanTpRxDl = 64
            CanTpRxTaType = CANTP_CANFD_PHYSICAL
            CanTpRxNSduRef = EcucPduCollection/PCAN_DIAG_REQ_PHYS_OBD1_oPCAN_RADAR_bb22f7fc_Rx
            CanTpRxNPdu_d29ebc6b (CanTpRxNPdu): CanTpRxNPduRef=PCAN_DIAG_REQ_PHYS_OBD1_Tp_oPCAN_RADAR_6e232c89_Rx
            CanTpTxFcNPdu_d29ebc6b (CanTpTxFcNPdu): CanTpTxFcNPduRef=PCAN_DIAG_RESP_PHYS_OBD1_Tp_oPCAN_RADAR_0aebd6ab_Tx
          CanTpTxNSdu_a39083e7 (CanTpTxNSdu):
            CanTpTxAddressingFormat = CANTP_STANDARD
            CanTpTxDl = 64
            CanTpTxTaType = CANTP_CANFD_PHYSICAL
            CanTpTxNSduRef = EcucPduCollection/PCAN_DIAG_RESP_PHYS_OBD1_oPCAN_RADAR_572eb9fe_Tx
            CanTpRxFcNPdu_f0646899 (CanTpRxFcNPdu): CanTpRxFcNPduRef=PCAN_DIAG_REQ_PHYS_OBD1_Tp_oPCAN_RADAR_6e232c89_Rx
            CanTpTxNPdu_f0646899 (CanTpTxNPdu): CanTpTxNPduRef=PCAN_DIAG_RESP_PHYS_OBD1_Tp_oPCAN_RADAR_0aebd6ab_Tx
        TPCH_bf80da47: variation-point=post-build-variant-condition{matching-criterion=RDR_POS, value=1}
          CanTpRxNSdu_4f8ed450 (CanTpRxNSdu):
            CanTpRxAddressingFormat = CANTP_STANDARD
            CanTpRxDl = 8
            CanTpRxTaType = CANTP_PHYSICAL
            CanTpRxNSduRef = EcucPduCollection/FR_DIAG_REQ_PHY_OTA_oVCAN_RADAR_9187f4da_Rx
            CanTpRxNPdu_44358187 (CanTpRxNPdu): CanTpRxNPduRef=FR_DIAG_REQ_PHY_OTA_Tp_oVCAN_RADAR_4de495d5_Rx
            CanTpTxFcNPdu_44358187 (CanTpTxFcNPdu): CanTpTxFcNPduRef=FR_DIAG_RES_PHY_OTA_Tp_oVCAN_RADAR_19b4e511_Tx
          CanTpTxNSdu_4f8ed450 (CanTpTxNSdu):
            CanTpTxAddressingFormat = CANTP_STANDARD
            CanTpTxDl = 8
            CanTpTxTaType = CANTP_PHYSICAL
            CanTpTxNSduRef = EcucPduCollection/FR_DIAG_RES_PHY_OTA_oVCAN_RADAR_9ad9d3d9_Tx
            CanTpRxFcNPdu_66cf5575 (CanTpRxFcNPdu): CanTpRxFcNPduRef=FR_DIAG_REQ_PHY_OTA_Tp_oVCAN_RADAR_4de495d5_Rx
            CanTpTxNPdu_66cf5575 (CanTpTxNPdu): CanTpTxNPduRef=FR_DIAG_RES_PHY_OTA_Tp_oVCAN_RADAR_19b4e511_Tx
        TPCH_bf9688c8: variation-point=post-build-variant-condition{matching-criterion=RDR_POS, value=1}
          CanTpRxNSdu_8c618172 (CanTpRxNSdu):
            CanTpRxAddressingFormat = CANTP_STANDARD
            CanTpRxDl = 8
            CanTpRxTaType = CANTP_FUNCTIONAL
            CanTpRxNSduRef = EcucPduCollection/DIAG_REQ_FNC_OBD1_oVCAN_RADAR_7e5c8685_Rx
            CanTpRxNPdu_2cc9a2e3 (CanTpRxNPdu): CanTpRxNPduRef=DIAG_REQ_FNC_OBD1_Tp_oVCAN_RADAR_260cec9f_Rx
        TPCH_d1390181: variation-point=post-build-variant-condition{matching-criterion=RDR_POS, value=1}
          CanTpRxNSdu_6541c420 (CanTpRxNSdu):
            CanTpRxAddressingFormat = CANTP_STANDARD
            CanTpRxDl = 8
            CanTpRxTaType = CANTP_FUNCTIONAL
            CanTpRxNSduRef = EcucPduCollection/PCAN_DIAG_REQ_FUNC_OTA_oPCAN_RADAR_20_e1100275_Rx
            CanTpRxNPdu_6fa47c37 (CanTpRxNPdu): CanTpRxNPduRef=PCAN_DIAG_REQ_FUNC_OTA_Tp_oPCAN_RADAR_20_0a67f2f6_Rx
        TPCH_e20c56ce: variation-point=post-build-variant-condition{matching-criterion=RDR_POS, value=1}
          CanTpRxNSdu_6bec8c22 (CanTpRxNSdu):
            CanTpRxAddressingFormat = CANTP_STANDARD
            CanTpRxDl = 8
            CanTpRxTaType = CANTP_FUNCTIONAL
            CanTpRxNSduRef = EcucPduCollection/DIAG_REQ_FNC_OTA_oVCAN_RADAR_e787ed21_Rx
            CanTpRxNPdu_49526666 (CanTpRxNPdu): CanTpRxNPduRef=DIAG_REQ_FNC_OTA_Tp_oVCAN_RADAR_6f75a08a_Rx
        TPCH_eb24b861: variation-point=post-build-variant-condition{matching-criterion=RDR_POS, value=1}
          CanTpRxNSdu_784cf1a8 (CanTpRxNSdu):
            CanTpRxAddressingFormat = CANTP_STANDARD
            CanTpRxDl = 64
            CanTpRxTaType = CANTP_CANFD_FUNCTIONAL
            CanTpRxNSduRef = EcucPduCollection/PCAN_DIAG_REQ_FUNC_OTA_oPCAN_RADAR_a013523e_Rx
            CanTpRxNPdu_02808996 (CanTpRxNPdu): CanTpRxNPduRef=PCAN_DIAG_REQ_FUNC_OTA_Tp_oPCAN_RADAR_7ea6262a_Rx
        TPCH_fa6bf184: variation-point=post-build-variant-condition{matching-criterion=RDR_POS, value=1}
          CanTpRxNSdu_85b3e172 (CanTpRxNSdu):
            CanTpRxAddressingFormat = CANTP_STANDARD
            CanTpRxDl = 64
            CanTpRxTaType = CANTP_CANFD_FUNCTIONAL
            CanTpRxNSduRef = EcucPduCollection/PCAN_DIAG_REQ_FUNC_OBD1_oPCAN_RADAR_b9aa9d1d_Rx
            CanTpRxNPdu_df9c51e3 (CanTpRxNPdu): CanTpRxNPduRef=PCAN_DIAG_REQ_FUNC_OBD1_Tp_oPCAN_RADAR_ba721e23_Rx
        TPCH_fdab8848: variation-point=post-build-variant-condition{matching-criterion=RDR_POS, value=1}
          CanTpRxNSdu_4700b6a3 (CanTpRxNSdu):
            CanTpRxAddressingFormat = CANTP_STANDARD
            CanTpRxDl = 8
            CanTpRxTaType = CANTP_FUNCTIONAL
            CanTpRxNSduRef = EcucPduCollection/PCAN_DIAG_REQ_FUNC_PLANT_oPCAN_RADAR_20_c17463fa_Rx
            CanTpRxNPdu_219160d4 (CanTpRxNPdu): CanTpRxNPduRef=PCAN_DIAG_REQ_FUNC_PLANT_Tp_oPCAN_RADAR_20_d63751cc_Rx
        TPCH_036f59a8: variation-point=post-build-variant-condition{matching-criterion=RDR_POS, value=2}
          CanTpRxNSdu_e2541eaf (CanTpRxNSdu):
            CanTpRxAddressingFormat = CANTP_STANDARD
            CanTpRxDl = 64
            CanTpRxTaType = CANTP_CANFD_PHYSICAL
            CanTpRxNSduRef = EcucPduCollection/PCAN_DIAG_REQ_PHYS_OBD2_oPCAN_RADAR_e03546e9_Rx
            CanTpRxNPdu_98033048 (CanTpRxNPdu): CanTpRxNPduRef=PCAN_DIAG_REQ_PHYS_OBD2_Tp_oPCAN_RADAR_0ac35777_Rx
            CanTpTxFcNPdu_98033048 (CanTpTxFcNPdu): CanTpTxFcNPduRef=PCAN_DIAG_RESP_PHYS_OBD2_Tp_oPCAN_RADAR_6e0bad55_Tx
          CanTpTxNSdu_e2541eaf (CanTpTxNSdu):
            CanTpTxAddressingFormat = CANTP_STANDARD
            CanTpTxDl = 64
            CanTpTxTaType = CANTP_CANFD_PHYSICAL
            CanTpTxNSduRef = EcucPduCollection/PCAN_DIAG_RESP_PHYS_OBD2_oPCAN_RADAR_0c3908eb_Tx
            CanTpRxFcNPdu_baf9e4ba (CanTpRxFcNPdu): CanTpRxFcNPduRef=PCAN_DIAG_REQ_PHYS_OBD2_Tp_oPCAN_RADAR_0ac35777_Rx
            CanTpTxNPdu_baf9e4ba (CanTpTxNPdu): CanTpTxNPduRef=PCAN_DIAG_RESP_PHYS_OBD2_Tp_oPCAN_RADAR_6e0bad55_Tx
        TPCH_1f06bc48: variation-point=post-build-variant-condition{matching-criterion=RDR_POS, value=2}
          CanTpRxNSdu_4164c19b (CanTpRxNSdu):
            CanTpRxAddressingFormat = CANTP_STANDARD
            CanTpRxDl = 8
            CanTpRxTaType = CANTP_FUNCTIONAL
            CanTpRxNSduRef = EcucPduCollection/DIAG_REQ_FNC_OBD2_oVCAN_RADAR_254b3790_Rx
            CanTpRxNPdu_e9a53f5f (CanTpRxNPdu): CanTpRxNPduRef=DIAG_REQ_FNC_OBD2_Tp_oVCAN_RADAR_42ec9761_Rx
        TPCH_2433c4a7: variation-point=post-build-variant-condition{matching-criterion=RDR_POS, value=2}
          CanTpRxNSdu_b3e928e8 (CanTpRxNSdu):
            CanTpRxAddressingFormat = CANTP_STANDARD
            CanTpRxDl = 8
            CanTpRxTaType = CANTP_FUNCTIONAL
            CanTpRxNSduRef = EcucPduCollection/DIAG_REQ_FNC_OBD1_oVCAN_RADAR_7e5c8685_Rx
            CanTpRxNPdu_5e5e67e3 (CanTpRxNPdu): CanTpRxNPduRef=DIAG_REQ_FNC_OBD1_Tp_oVCAN_RADAR_260cec9f_Rx
        TPCH_308e2273: variation-point=post-build-variant-condition{matching-criterion=RDR_POS, value=2}
          CanTpRxNSdu_ca28ec73 (CanTpRxNSdu):
            CanTpRxAddressingFormat = CANTP_STANDARD
            CanTpRxDl = 64
            CanTpRxTaType = CANTP_CANFD_PHYSICAL
            CanTpRxNSduRef = EcucPduCollection/PCAN_DIAG_REQ_PHYS_PLANT_oPCAN_RADAR_214e1a1c_Rx
            CanTpRxNPdu_25f6a934 (CanTpRxNPdu): CanTpRxNPduRef=PCAN_DIAG_REQ_PHYS_PLANT_Tp_oPCAN_RADAR_68155c61_Rx
            CanTpTxFcNPdu_25f6a934 (CanTpTxFcNPdu): CanTpTxFcNPduRef=PCAN_DIAG_RESP_PHYS_PLANT_Tp_oPCAN_RADAR_bd11d57f_Tx
          CanTpTxNSdu_ca28ec73 (CanTpTxNSdu):
            CanTpTxAddressingFormat = CANTP_STANDARD
            CanTpTxDl = 64
            CanTpTxTaType = CANTP_CANFD_PHYSICAL
            CanTpTxNSduRef = EcucPduCollection/PCAN_DIAG_RESP_PHYS_PLANT_oPCAN_RADAR_cfac777e_Tx
            CanTpRxFcNPdu_070c7dc6 (CanTpRxFcNPdu): CanTpRxFcNPduRef=PCAN_DIAG_REQ_PHYS_PLANT_Tp_oPCAN_RADAR_68155c61_Rx
            CanTpTxNPdu_070c7dc6 (CanTpTxNPdu): CanTpTxNPduRef=PCAN_DIAG_RESP_PHYS_PLANT_Tp_oPCAN_RADAR_bd11d57f_Tx
        TPCH_493bb7c9: variation-point=post-build-variant-condition{matching-criterion=RDR_POS, value=2}
          CanTpRxNSdu_7e56306d (CanTpRxNSdu):
            CanTpRxAddressingFormat = CANTP_STANDARD
            CanTpRxDl = 8
            CanTpRxTaType = CANTP_PHYSICAL
            CanTpRxNSduRef = EcucPduCollection/FR_DIAG_REQ_PHY_OBD2_oVCAN_RADAR_0f521c1d_Rx
            CanTpRxNPdu_012fc1e4 (CanTpRxNPdu): CanTpRxNPduRef=FR_DIAG_REQ_PHY_OBD2_Tp_oVCAN_RADAR_b91a4a31_Rx
            CanTpTxFcNPdu_012fc1e4 (CanTpTxFcNPdu): CanTpTxFcNPduRef=FR_DIAG_RES_PHY_OBD2_Tp_oVCAN_RADAR_25471ce8_Tx
          CanTpTxNSdu_7e56306d (CanTpTxNSdu):
            CanTpTxAddressingFormat = CANTP_STANDARD
            CanTpTxDl = 8
            CanTpTxTaType = CANTP_PHYSICAL
            CanTpTxNSduRef = EcucPduCollection/FR_DIAG_RES_PHY_OBD2_oVCAN_RADAR_96501380_Tx
            CanTpRxFcNPdu_23d51516 (CanTpRxFcNPdu): CanTpRxFcNPduRef=FR_DIAG_REQ_PHY_OBD2_Tp_oVCAN_RADAR_b91a4a31_Rx
            CanTpTxNPdu_23d51516 (CanTpTxNPdu): CanTpTxNPduRef=FR_DIAG_RES_PHY_OBD2_Tp_oVCAN_RADAR_25471ce8_Tx
        TPCH_4a9c4dee: variation-point=post-build-variant-condition{matching-criterion=RDR_POS, value=2}
          CanTpRxNSdu_468ce7a5 (CanTpRxNSdu):
            CanTpRxAddressingFormat = CANTP_STANDARD
            CanTpRxDl = 8
            CanTpRxTaType = CANTP_FUNCTIONAL
            CanTpRxNSduRef = EcucPduCollection/PCAN_DIAG_REQ_FUNC_OTA_oPCAN_RADAR_20_e1100275_Rx
            CanTpRxNPdu_b29ee0c8 (CanTpRxNPdu): CanTpRxNPduRef=PCAN_DIAG_REQ_FUNC_OTA_Tp_oPCAN_RADAR_20_0a67f2f6_Rx
        TPCH_4ce6e994: variation-point=post-build-variant-condition{matching-criterion=RDR_POS, value=2}
          CanTpRxNSdu_471bd8a5 (CanTpRxNSdu):
            CanTpRxAddressingFormat = CANTP_STANDARD
            CanTpRxDl = 8
            CanTpRxTaType = CANTP_PHYSICAL
            CanTpRxNSduRef = EcucPduCollection/PCAN_DIAG_REQ_PHYS_OBD2_oPCAN_RADAR_20_95757328_Rx
            CanTpRxNPdu_17fce6a3 (CanTpRxNPdu): CanTpRxNPduRef=PCAN_DIAG_REQ_PHYS_OBD2_Tp_oPCAN_RADAR_20_65ff9201_Rx
            CanTpTxFcNPdu_17fce6a3 (CanTpTxFcNPdu): CanTpTxFcNPduRef=PCAN_DIAG_RESP_PHYS_OBD2_Tp_oPCAN_RADAR_20_25da435e_Tx
          CanTpTxNSdu_471bd8a5 (CanTpTxNSdu):
            CanTpTxAddressingFormat = CANTP_STANDARD
            CanTpTxDl = 8
            CanTpTxTaType = CANTP_PHYSICAL
            CanTpTxNSduRef = EcucPduCollection/PCAN_DIAG_RESP_PHYS_OBD2_oPCAN_RADAR_20_f1bd890a_Tx
            CanTpRxFcNPdu_35063251 (CanTpRxFcNPdu): CanTpRxFcNPduRef=PCAN_DIAG_REQ_PHYS_OBD2_Tp_oPCAN_RADAR_20_65ff9201_Rx
            CanTpTxNPdu_35063251 (CanTpTxNPdu): CanTpTxNPduRef=PCAN_DIAG_RESP_PHYS_OBD2_Tp_oPCAN_RADAR_20_25da435e_Tx
        TPCH_5042b179: variation-point=post-build-variant-condition{matching-criterion=RDR_POS, value=2}
          CanTpRxNSdu_d8286eb1 (CanTpRxNSdu):
            CanTpRxAddressingFormat = CANTP_STANDARD
            CanTpRxDl = 8
            CanTpRxTaType = CANTP_PHYSICAL
            CanTpRxNSduRef = EcucPduCollection/FR_DIAG_REQ_PHY_OTA_oVCAN_RADAR_9187f4da_Rx
            CanTpRxNPdu_c557c89e (CanTpRxNPdu): CanTpRxNPduRef=FR_DIAG_REQ_PHY_OTA_Tp_oVCAN_RADAR_4de495d5_Rx
            CanTpTxFcNPdu_c557c89e (CanTpTxFcNPdu): CanTpTxFcNPduRef=FR_DIAG_RES_PHY_OTA_Tp_oVCAN_RADAR_19b4e511_Tx
          CanTpTxNSdu_d8286eb1 (CanTpTxNSdu):
            CanTpTxAddressingFormat = CANTP_STANDARD
            CanTpTxDl = 8
            CanTpTxTaType = CANTP_PHYSICAL
            CanTpTxNSduRef = EcucPduCollection/FR_DIAG_RES_PHY_OTA_oVCAN_RADAR_9ad9d3d9_Tx
            CanTpRxFcNPdu_e7ad1c6c (CanTpRxFcNPdu): CanTpRxFcNPduRef=FR_DIAG_REQ_PHY_OTA_Tp_oVCAN_RADAR_4de495d5_Rx
            CanTpTxNPdu_e7ad1c6c (CanTpTxNPdu): CanTpTxNPduRef=FR_DIAG_RES_PHY_OTA_Tp_oVCAN_RADAR_19b4e511_Tx
        TPCH_5a7b2a15: variation-point=post-build-variant-condition{matching-criterion=RDR_POS, value=2}
          CanTpRxNSdu_1b50fb68 (CanTpRxNSdu):
            CanTpRxAddressingFormat = CANTP_STANDARD
            CanTpRxDl = 8
            CanTpRxTaType = CANTP_PHYSICAL
            CanTpRxNSduRef = EcucPduCollection/PCAN_DIAG_REQ_PHYS_OTA_oPCAN_RADAR_20_0b124a16_Rx
            CanTpRxNPdu_0324451f (CanTpRxNPdu): CanTpRxNPduRef=PCAN_DIAG_REQ_PHYS_OTA_Tp_oPCAN_RADAR_20_96582344_Rx
            CanTpTxFcNPdu_0324451f (CanTpTxFcNPdu): CanTpTxFcNPduRef=PCAN_DIAG_RESP_PHYS_OTA_Tp_oPCAN_RADAR_20_6c821aae_Tx
          CanTpTxNSdu_1b50fb68 (CanTpTxNSdu):
            CanTpTxAddressingFormat = CANTP_STANDARD
            CanTpTxDl = 8
            CanTpTxTaType = CANTP_PHYSICAL
            CanTpTxNSduRef = EcucPduCollection/PCAN_DIAG_RESP_PHYS_OTA_oPCAN_RADAR_20_a840a80f_Tx
            CanTpRxFcNPdu_21de91ed (CanTpRxFcNPdu): CanTpRxFcNPduRef=PCAN_DIAG_REQ_PHYS_OTA_Tp_oPCAN_RADAR_20_96582344_Rx
            CanTpTxNPdu_21de91ed (CanTpTxNPdu): CanTpTxNPduRef=PCAN_DIAG_RESP_PHYS_OTA_Tp_oPCAN_RADAR_20_6c821aae_Tx
        TPCH_63bc2585: variation-point=post-build-variant-condition{matching-criterion=RDR_POS, value=2}
          CanTpRxNSdu_fac189c4 (CanTpRxNSdu):
            CanTpRxAddressingFormat = CANTP_STANDARD
            CanTpRxDl = 64
            CanTpRxTaType = CANTP_CANFD_PHYSICAL
            CanTpRxNSduRef = EcucPduCollection/PCAN_DIAG_REQ_PHYS_OTA_oPCAN_RADAR_45eab9fd_Rx
            CanTpRxNPdu_60e658cd (CanTpRxNPdu): CanTpRxNPduRef=PCAN_DIAG_REQ_PHYS_OTA_Tp_oPCAN_RADAR_94a46e49_Rx
            CanTpTxFcNPdu_60e658cd (CanTpTxFcNPdu): CanTpTxFcNPduRef=PCAN_DIAG_RESP_PHYS_OTA_Tp_oPCAN_RADAR_37f68c50_Tx
          CanTpTxNSdu_fac189c4 (CanTpTxNSdu):
            CanTpTxAddressingFormat = CANTP_STANDARD
            CanTpTxDl = 64
            CanTpTxTaType = CANTP_CANFD_PHYSICAL
            CanTpTxNSduRef = EcucPduCollection/PCAN_DIAG_RESP_PHYS_OTA_oPCAN_RADAR_2a569d3c_Tx
            CanTpRxFcNPdu_421c8c3f (CanTpRxFcNPdu): CanTpRxFcNPduRef=PCAN_DIAG_REQ_PHYS_OTA_Tp_oPCAN_RADAR_94a46e49_Rx
            CanTpTxNPdu_421c8c3f (CanTpTxNPdu): CanTpTxNPduRef=PCAN_DIAG_RESP_PHYS_OTA_Tp_oPCAN_RADAR_37f68c50_Tx
        TPCH_6496da17: variation-point=post-build-variant-condition{matching-criterion=RDR_POS, value=2}
          CanTpRxNSdu_13c303b2 (CanTpRxNSdu):
            CanTpRxAddressingFormat = CANTP_STANDARD
            CanTpRxDl = 64
            CanTpRxTaType = CANTP_CANFD_FUNCTIONAL
            CanTpRxNSduRef = EcucPduCollection/PCAN_DIAG_REQ_FUNC_OBD2_oPCAN_RADAR_e2bd2c08_Rx
            CanTpRxNPdu_eed79f7d (CanTpRxNPdu): CanTpRxNPduRef=PCAN_DIAG_REQ_FUNC_OBD2_Tp_oPCAN_RADAR_de9265dd_Rx
        TPCH_660ec427: variation-point=post-build-variant-condition{matching-criterion=RDR_POS, value=2}
          CanTpRxNSdu_006d7169 (CanTpRxNSdu):
            CanTpRxAddressingFormat = CANTP_STANDARD
            CanTpRxDl = 8
            CanTpRxTaType = CANTP_FUNCTIONAL
            CanTpRxNSduRef = EcucPduCollection/PCAN_DIAG_REQ_FUNC_PLANT_oPCAN_RADAR_20_c17463fa_Rx
            CanTpRxNPdu_2828ffd9 (CanTpRxNPdu): CanTpRxNPduRef=PCAN_DIAG_REQ_FUNC_PLANT_Tp_oPCAN_RADAR_20_d63751cc_Rx
        TPCH_79a91aa1: variation-point=post-build-variant-condition{matching-criterion=RDR_POS, value=2}
          CanTpRxNSdu_73387856 (CanTpRxNSdu):
            CanTpRxAddressingFormat = CANTP_STANDARD
            CanTpRxDl = 8
            CanTpRxTaType = CANTP_FUNCTIONAL
            CanTpRxNSduRef = EcucPduCollection/DIAG_REQ_FNC_OTA_oVCAN_RADAR_e787ed21_Rx
            CanTpRxNPdu_21c36ca5 (CanTpRxNPdu): CanTpRxNPduRef=DIAG_REQ_FNC_OTA_Tp_oVCAN_RADAR_6f75a08a_Rx
        TPCH_8b16005e: variation-point=post-build-variant-condition{matching-criterion=RDR_POS, value=2}
          CanTpRxNSdu_620766ce (CanTpRxNSdu):
            CanTpRxAddressingFormat = CANTP_STANDARD
            CanTpRxDl = 8
            CanTpRxTaType = CANTP_PHYSICAL
            CanTpRxNSduRef = EcucPduCollection/PCAN_DIAG_REQ_PHYS_OBD1_oPCAN_RADAR_20_f19508d6_Rx
            CanTpRxNPdu_f1486551 (CanTpRxNPdu): CanTpRxNPduRef=PCAN_DIAG_REQ_PHYS_OBD1_Tp_oPCAN_RADAR_20_b6648efa_Rx
            CanTpTxFcNPdu_f1486551 (CanTpTxFcNPdu): CanTpTxFcNPduRef=PCAN_DIAG_RESP_PHYS_OBD1_Tp_oPCAN_RADAR_20_f6415fa5_Tx
          CanTpTxNSdu_620766ce (CanTpTxNSdu):
            CanTpTxAddressingFormat = CANTP_STANDARD
            CanTpTxDl = 8
            CanTpTxTaType = CANTP_PHYSICAL
            CanTpTxNSduRef = EcucPduCollection/PCAN_DIAG_RESP_PHYS_OBD1_oPCAN_RADAR_20_955df2f4_Tx
            CanTpRxFcNPdu_d3b2b1a3 (CanTpRxFcNPdu): CanTpRxFcNPduRef=PCAN_DIAG_REQ_PHYS_OBD1_Tp_oPCAN_RADAR_20_b6648efa_Rx
            CanTpTxNPdu_d3b2b1a3 (CanTpTxNPdu): CanTpTxNPduRef=PCAN_DIAG_RESP_PHYS_OBD1_Tp_oPCAN_RADAR_20_f6415fa5_Tx
        TPCH_8c21d5d3: variation-point=post-build-variant-condition{matching-criterion=RDR_POS, value=2}
          CanTpRxNSdu_93c8010e (CanTpRxNSdu):
            CanTpRxAddressingFormat = CANTP_STANDARD
            CanTpRxDl = 8
            CanTpRxTaType = CANTP_PHYSICAL
            CanTpRxNSduRef = EcucPduCollection/FR_DIAG_REQ_PHY_OBD1_oVCAN_RADAR_5445ad08_Rx
            CanTpRxNPdu_2322364d (CanTpRxNPdu): CanTpRxNPduRef=FR_DIAG_REQ_PHY_OBD1_Tp_oVCAN_RADAR_ddfa31cf_Rx
            CanTpTxFcNPdu_2322364d (CanTpTxFcNPdu): CanTpTxFcNPduRef=FR_DIAG_RES_PHY_OBD1_Tp_oVCAN_RADAR_41a76716_Tx
          CanTpTxNSdu_93c8010e (CanTpTxNSdu):
            CanTpTxAddressingFormat = CANTP_STANDARD
            CanTpTxDl = 8
            CanTpTxTaType = CANTP_PHYSICAL
            CanTpTxNSduRef = EcucPduCollection/FR_DIAG_RES_PHY_OBD1_oVCAN_RADAR_cd47a295_Tx
            CanTpRxFcNPdu_01d8e2bf (CanTpRxFcNPdu): CanTpRxFcNPduRef=FR_DIAG_REQ_PHY_OBD1_Tp_oVCAN_RADAR_ddfa31cf_Rx
            CanTpTxNPdu_01d8e2bf (CanTpTxNPdu): CanTpTxNPduRef=FR_DIAG_RES_PHY_OBD1_Tp_oVCAN_RADAR_41a76716_Tx
        TPCH_8f5036e5: variation-point=post-build-variant-condition{matching-criterion=RDR_POS, value=2}
          CanTpRxNSdu_45712a97 (CanTpRxNSdu):
            CanTpRxAddressingFormat = CANTP_STANDARD
            CanTpRxDl = 8
            CanTpRxTaType = CANTP_FUNCTIONAL
            CanTpRxNSduRef = EcucPduCollection/PCAN_DIAG_REQ_FUNC_OBD1_oPCAN_RADAR_20_25c43a7c_Rx
            CanTpRxNPdu_7db6e3a7 (CanTpRxNPdu): CanTpRxNPduRef=PCAN_DIAG_REQ_FUNC_OBD1_Tp_oPCAN_RADAR_20_9397638b_Rx
        TPCH_99170d60: variation-point=post-build-variant-condition{matching-criterion=RDR_POS, value=2}
          CanTpRxNSdu_e9868279 (CanTpRxNSdu):
            CanTpRxAddressingFormat = CANTP_STANDARD
            CanTpRxDl = 64
            CanTpRxTaType = CANTP_CANFD_FUNCTIONAL
            CanTpRxNSduRef = EcucPduCollection/PCAN_DIAG_REQ_FUNC_PLANT_oPCAN_RADAR_f6414098_Rx
            CanTpRxNPdu_31268e73 (CanTpRxNPdu): CanTpRxNPduRef=PCAN_DIAG_REQ_FUNC_PLANT_Tp_oPCAN_RADAR_5ec247a5_Rx
        TPCH_dcb5d2c8: variation-point=post-build-variant-condition{matching-criterion=RDR_POS, value=2}
          CanTpRxNSdu_b593107a (CanTpRxNSdu):
            CanTpRxAddressingFormat = CANTP_STANDARD
            CanTpRxDl = 8
            CanTpRxTaType = CANTP_FUNCTIONAL
            CanTpRxNSduRef = EcucPduCollection/DIAG_REQ_FNC_PLANT_oVCAN_RADAR_42eb2f27_Rx
            CanTpRxNPdu_7b3b0f4d (CanTpRxNPdu): CanTpRxNPduRef=DIAG_REQ_FNC_PLANT_Tp_oVCAN_RADAR_d6304422_Rx
        TPCH_dea87001: variation-point=post-build-variant-condition{matching-criterion=RDR_POS, value=2}
          CanTpRxNSdu_9a31514e (CanTpRxNSdu):
            CanTpRxAddressingFormat = CANTP_STANDARD
            CanTpRxDl = 64
            CanTpRxTaType = CANTP_CANFD_PHYSICAL
            CanTpRxNSduRef = EcucPduCollection/PCAN_DIAG_REQ_PHYS_OBD1_oPCAN_RADAR_bb22f7fc_Rx
            CanTpRxNPdu_20042bf7 (CanTpRxNPdu): CanTpRxNPduRef=PCAN_DIAG_REQ_PHYS_OBD1_Tp_oPCAN_RADAR_6e232c89_Rx
            CanTpTxFcNPdu_20042bf7 (CanTpTxFcNPdu): CanTpTxFcNPduRef=PCAN_DIAG_RESP_PHYS_OBD1_Tp_oPCAN_RADAR_0aebd6ab_Tx
          CanTpTxNSdu_9a31514e (CanTpTxNSdu):
            CanTpTxAddressingFormat = CANTP_STANDARD
            CanTpTxDl = 64
            CanTpTxTaType = CANTP_CANFD_PHYSICAL
            CanTpTxNSduRef = EcucPduCollection/PCAN_DIAG_RESP_PHYS_OBD1_oPCAN_RADAR_572eb9fe_Tx
            CanTpRxFcNPdu_02feff05 (CanTpRxFcNPdu): CanTpRxFcNPduRef=PCAN_DIAG_REQ_PHYS_OBD1_Tp_oPCAN_RADAR_6e232c89_Rx
            CanTpTxNPdu_02feff05 (CanTpTxNPdu): CanTpTxNPduRef=PCAN_DIAG_RESP_PHYS_OBD1_Tp_oPCAN_RADAR_0aebd6ab_Tx
        TPCH_e6e375c3: variation-point=post-build-variant-condition{matching-criterion=RDR_POS, value=2}
          CanTpRxNSdu_d1b47cad (CanTpRxNSdu):
            CanTpRxAddressingFormat = CANTP_STANDARD
            CanTpRxDl = 8
            CanTpRxTaType = CANTP_PHYSICAL
            CanTpRxNSduRef = EcucPduCollection/FR_DIAG_REQ_PHY_PLANT_oVCAN_RADAR_d1c8c991_Rx
            CanTpRxNPdu_d2d2ac8c (CanTpRxNPdu): CanTpRxNPduRef=FR_DIAG_REQ_PHY_PLANT_Tp_oVCAN_RADAR_bda0e30b_Rx
            CanTpTxFcNPdu_d2d2ac8c (CanTpTxFcNPdu): CanTpTxFcNPduRef=FR_DIAG_RES_PHY_PLANT_Tp_oVCAN_RADAR_4233d42d_Tx
          CanTpTxNSdu_d1b47cad (CanTpTxNSdu):
            CanTpTxAddressingFormat = CANTP_STANDARD
            CanTpTxDl = 8
            CanTpTxTaType = CANTP_PHYSICAL
            CanTpTxNSduRef = EcucPduCollection/FR_DIAG_RES_PHY_PLANT_oVCAN_RADAR_5fef2467_Tx
            CanTpRxFcNPdu_f028787e (CanTpRxFcNPdu): CanTpRxFcNPduRef=FR_DIAG_REQ_PHY_PLANT_Tp_oVCAN_RADAR_bda0e30b_Rx
            CanTpTxNPdu_f028787e (CanTpTxNPdu): CanTpTxNPduRef=FR_DIAG_RES_PHY_PLANT_Tp_oVCAN_RADAR_4233d42d_Tx
        TPCH_ea814372: variation-point=post-build-variant-condition{matching-criterion=RDR_POS, value=2}
          CanTpRxNSdu_42fe9847 (CanTpRxNSdu):
            CanTpRxAddressingFormat = CANTP_STANDARD
            CanTpRxDl = 8
            CanTpRxTaType = CANTP_PHYSICAL
            CanTpRxNSduRef = EcucPduCollection/PCAN_DIAG_REQ_PHYS_PLANT_oPCAN_RADAR_20_f7a3783e_Rx
            CanTpRxNPdu_5d81c8c9 (CanTpRxNPdu): CanTpRxNPduRef=PCAN_DIAG_REQ_PHYS_PLANT_Tp_oPCAN_RADAR_20_f110e38b_Rx
            CanTpTxFcNPdu_5d81c8c9 (CanTpTxFcNPdu): CanTpTxFcNPduRef=PCAN_DIAG_RESP_PHYS_PLANT_Tp_oPCAN_RADAR_20_0a848a3f_Tx
          CanTpTxNSdu_42fe9847 (CanTpTxNSdu):
            CanTpTxAddressingFormat = CANTP_STANDARD
            CanTpTxDl = 8
            CanTpTxTaType = CANTP_PHYSICAL
            CanTpTxNSduRef = EcucPduCollection/PCAN_DIAG_RESP_PHYS_PLANT_oPCAN_RADAR_20_22a7f120_Tx
            CanTpRxFcNPdu_7f7b1c3b (CanTpRxFcNPdu): CanTpRxFcNPduRef=PCAN_DIAG_REQ_PHYS_PLANT_Tp_oPCAN_RADAR_20_f110e38b_Rx
            CanTpTxNPdu_7f7b1c3b (CanTpTxNPdu): CanTpTxNPduRef=PCAN_DIAG_RESP_PHYS_PLANT_Tp_oPCAN_RADAR_20_0a848a3f_Tx
        TPCH_ed439544: variation-point=post-build-variant-condition{matching-criterion=RDR_POS, value=2}
          CanTpRxNSdu_296d7662 (CanTpRxNSdu):
            CanTpRxAddressingFormat = CANTP_STANDARD
            CanTpRxDl = 64
            CanTpRxTaType = CANTP_CANFD_FUNCTIONAL
            CanTpRxNSduRef = EcucPduCollection/PCAN_DIAG_REQ_FUNC_OBD1_oPCAN_RADAR_b9aa9d1d_Rx
            CanTpRxNPdu_77e5ffa1 (CanTpRxNPdu): CanTpRxNPduRef=PCAN_DIAG_REQ_FUNC_OBD1_Tp_oPCAN_RADAR_ba721e23_Rx
        TPCH_eea3e9bf: variation-point=post-build-variant-condition{matching-criterion=RDR_POS, value=2}
          CanTpRxNSdu_321c67e6 (CanTpRxNSdu):
            CanTpRxAddressingFormat = CANTP_STANDARD
            CanTpRxDl = 8
            CanTpRxTaType = CANTP_FUNCTIONAL
            CanTpRxNSduRef = EcucPduCollection/PCAN_DIAG_REQ_FUNC_OBD2_oPCAN_RADAR_20_41244182_Rx
            CanTpRxNPdu_e05b87d2 (CanTpRxNPdu): CanTpRxNPduRef=PCAN_DIAG_REQ_FUNC_OBD2_Tp_oPCAN_RADAR_20_400c7f70_Rx
        TPCH_fc0cdca1: variation-point=post-build-variant-condition{matching-criterion=RDR_POS, value=2}
          CanTpRxNSdu_27371a31 (CanTpRxNSdu):
            CanTpRxAddressingFormat = CANTP_STANDARD
            CanTpRxDl = 64
            CanTpRxTaType = CANTP_CANFD_FUNCTIONAL
            CanTpRxNSduRef = EcucPduCollection/PCAN_DIAG_REQ_FUNC_OTA_oPCAN_RADAR_a013523e_Rx
            CanTpRxNPdu_a219ac95 (CanTpRxNPdu): CanTpRxNPduRef=PCAN_DIAG_REQ_FUNC_OTA_Tp_oPCAN_RADAR_7ea6262a_Rx
        TPCH_014fe457: variation-point=post-build-variant-condition{matching-criterion=RDR_POS, value=3}
          CanTpRxNSdu_b5beb7bd (CanTpRxNSdu):
            CanTpRxAddressingFormat = CANTP_STANDARD
            CanTpRxDl = 64
            CanTpRxTaType = CANTP_CANFD_FUNCTIONAL
            CanTpRxNSduRef = EcucPduCollection/PCAN_DIAG_REQ_FUNC_OBD2_oPCAN_RADAR_e2bd2c08_Rx
            CanTpRxNPdu_ef2320d0 (CanTpRxNPdu): CanTpRxNPduRef=PCAN_DIAG_REQ_FUNC_OBD2_Tp_oPCAN_RADAR_de9265dd_Rx
        TPCH_043f6eba: variation-point=post-build-variant-condition{matching-criterion=RDR_POS, value=3}
          CanTpRxNSdu_39b7733b (CanTpRxNSdu):
            CanTpRxAddressingFormat = CANTP_STANDARD
            CanTpRxDl = 8
            CanTpRxTaType = CANTP_PHYSICAL
            CanTpRxNSduRef = EcucPduCollection/FR_DIAG_REQ_PHY_PLANT_oVCAN_RADAR_d1c8c991_Rx
            CanTpRxNPdu_fa7e2a6b (CanTpRxNPdu): CanTpRxNPduRef=FR_DIAG_REQ_PHY_PLANT_Tp_oVCAN_RADAR_bda0e30b_Rx
            CanTpTxFcNPdu_fa7e2a6b (CanTpTxFcNPdu): CanTpTxFcNPduRef=FR_DIAG_RES_PHY_PLANT_Tp_oVCAN_RADAR_4233d42d_Tx
          CanTpTxNSdu_39b7733b (CanTpTxNSdu):
            CanTpTxAddressingFormat = CANTP_STANDARD
            CanTpTxDl = 8
            CanTpTxTaType = CANTP_PHYSICAL
            CanTpTxNSduRef = EcucPduCollection/FR_DIAG_RES_PHY_PLANT_oVCAN_RADAR_5fef2467_Tx
            CanTpRxFcNPdu_d884fe99 (CanTpRxFcNPdu): CanTpRxFcNPduRef=FR_DIAG_REQ_PHY_PLANT_Tp_oVCAN_RADAR_bda0e30b_Rx
            CanTpTxNPdu_d884fe99 (CanTpTxNPdu): CanTpTxNPduRef=FR_DIAG_RES_PHY_PLANT_Tp_oVCAN_RADAR_4233d42d_Tx
        TPCH_085d580b: variation-point=post-build-variant-condition{matching-criterion=RDR_POS, value=3}
          CanTpRxNSdu_35dbd553 (CanTpRxNSdu):
            CanTpRxAddressingFormat = CANTP_STANDARD
            CanTpRxDl = 8
            CanTpRxTaType = CANTP_PHYSICAL
            CanTpRxNSduRef = EcucPduCollection/PCAN_DIAG_REQ_PHYS_PLANT_oPCAN_RADAR_20_f7a3783e_Rx
            CanTpRxNPdu_a83ee65f (CanTpRxNPdu): CanTpRxNPduRef=PCAN_DIAG_REQ_PHYS_PLANT_Tp_oPCAN_RADAR_20_f110e38b_Rx
            CanTpTxFcNPdu_a83ee65f (CanTpTxFcNPdu): CanTpTxFcNPduRef=PCAN_DIAG_RESP_PHYS_PLANT_Tp_oPCAN_RADAR_20_0a848a3f_Tx
          CanTpTxNSdu_35dbd553 (CanTpTxNSdu):
            CanTpTxAddressingFormat = CANTP_STANDARD
            CanTpTxDl = 8
            CanTpTxTaType = CANTP_PHYSICAL
            CanTpTxNSduRef = EcucPduCollection/PCAN_DIAG_RESP_PHYS_PLANT_oPCAN_RADAR_20_22a7f120_Tx
            CanTpRxFcNPdu_8ac432ad (CanTpRxFcNPdu): CanTpRxFcNPduRef=PCAN_DIAG_REQ_PHYS_PLANT_Tp_oPCAN_RADAR_20_f110e38b_Rx
            CanTpTxNPdu_8ac432ad (CanTpTxNPdu): CanTpTxNPduRef=PCAN_DIAG_RESP_PHYS_PLANT_Tp_oPCAN_RADAR_20_0a848a3f_Tx
        TPCH_0d31f32e: variation-point=post-build-variant-condition{matching-criterion=RDR_POS, value=3}
          CanTpRxNSdu_8ebb4dba (CanTpRxNSdu):
            CanTpRxAddressingFormat = CANTP_STANDARD
            CanTpRxDl = 8
            CanTpRxTaType = CANTP_FUNCTIONAL
            CanTpRxNSduRef = EcucPduCollection/DIAG_REQ_FNC_OTA_oVCAN_RADAR_e787ed21_Rx
            CanTpRxNPdu_60bfe9ef (CanTpRxNPdu): CanTpRxNPduRef=DIAG_REQ_FNC_OTA_Tp_oVCAN_RADAR_6f75a08a_Rx
        TPCH_12962da8: variation-point=post-build-variant-condition{matching-criterion=RDR_POS, value=3}
          CanTpRxNSdu_b87fedc1 (CanTpRxNSdu):
            CanTpRxAddressingFormat = CANTP_STANDARD
            CanTpRxDl = 8
            CanTpRxTaType = CANTP_FUNCTIONAL
            CanTpRxNSduRef = EcucPduCollection/PCAN_DIAG_REQ_FUNC_PLANT_oPCAN_RADAR_20_c17463fa_Rx
            CanTpRxNPdu_0a9d3920 (CanTpRxNPdu): CanTpRxNPduRef=PCAN_DIAG_REQ_FUNC_PLANT_Tp_oPCAN_RADAR_20_d63751cc_Rx
        TPCH_3e04a461: variation-point=post-build-variant-condition{matching-criterion=RDR_POS, value=3}
          CanTpRxNSdu_78c5c2e6 (CanTpRxNSdu):
            CanTpRxAddressingFormat = CANTP_STANDARD
            CanTpRxDl = 8
            CanTpRxTaType = CANTP_FUNCTIONAL
            CanTpRxNSduRef = EcucPduCollection/PCAN_DIAG_REQ_FUNC_OTA_oPCAN_RADAR_20_e1100275_Rx
            CanTpRxNPdu_24fb9ff2 (CanTpRxNPdu): CanTpRxNPduRef=PCAN_DIAG_REQ_FUNC_OTA_Tp_oPCAN_RADAR_20_0a67f2f6_Rx
        TPCH_3fecd692: variation-point=post-build-variant-condition{matching-criterion=RDR_POS, value=3}
          CanTpRxNSdu_b5963bcd (CanTpRxNSdu):
            CanTpRxAddressingFormat = CANTP_STANDARD
            CanTpRxDl = 64
            CanTpRxTaType = CANTP_CANFD_PHYSICAL
            CanTpRxNSduRef = EcucPduCollection/PCAN_DIAG_REQ_PHYS_OBD1_oPCAN_RADAR_bb22f7fc_Rx
            CanTpRxNPdu_492bb4b1 (CanTpRxNPdu): CanTpRxNPduRef=PCAN_DIAG_REQ_PHYS_OBD1_Tp_oPCAN_RADAR_6e232c89_Rx
            CanTpTxFcNPdu_492bb4b1 (CanTpTxFcNPdu): CanTpTxFcNPduRef=PCAN_DIAG_RESP_PHYS_OBD1_Tp_oPCAN_RADAR_0aebd6ab_Tx
          CanTpTxNSdu_b5963bcd (CanTpTxNSdu):
            CanTpTxAddressingFormat = CANTP_STANDARD
            CanTpTxDl = 64
            CanTpTxTaType = CANTP_CANFD_PHYSICAL
            CanTpTxNSduRef = EcucPduCollection/PCAN_DIAG_RESP_PHYS_OBD1_oPCAN_RADAR_572eb9fe_Tx
            CanTpRxFcNPdu_6bd16043 (CanTpRxFcNPdu): CanTpRxFcNPduRef=PCAN_DIAG_REQ_PHYS_OBD1_Tp_oPCAN_RADAR_6e232c89_Rx
            CanTpTxNPdu_6bd16043 (CanTpTxNPdu): CanTpTxNPduRef=PCAN_DIAG_RESP_PHYS_OBD1_Tp_oPCAN_RADAR_0aebd6ab_Tx
        TPCH_50ab2d28: variation-point=post-build-variant-condition{matching-criterion=RDR_POS, value=3}
          CanTpRxNSdu_17721f14 (CanTpRxNSdu):
            CanTpRxAddressingFormat = CANTP_STANDARD
            CanTpRxDl = 8
            CanTpRxTaType = CANTP_FUNCTIONAL
            CanTpRxNSduRef = EcucPduCollection/DIAG_REQ_FNC_OBD1_oVCAN_RADAR_7e5c8685_Rx
            CanTpRxNPdu_09f211c0 (CanTpRxNPdu): CanTpRxNPduRef=DIAG_REQ_FNC_OBD1_Tp_oVCAN_RADAR_260cec9f_Rx
        TPCH_69ca1b27: variation-point=post-build-variant-condition{matching-criterion=RDR_POS, value=3}
          CanTpRxNSdu_808a4832 (CanTpRxNSdu):
            CanTpRxAddressingFormat = CANTP_STANDARD
            CanTpRxDl = 8
            CanTpRxTaType = CANTP_PHYSICAL
            CanTpRxNSduRef = EcucPduCollection/PCAN_DIAG_REQ_PHYS_OBD1_oPCAN_RADAR_20_f19508d6_Rx
            CanTpRxNPdu_08415e34 (CanTpRxNPdu): CanTpRxNPduRef=PCAN_DIAG_REQ_PHYS_OBD1_Tp_oPCAN_RADAR_20_b6648efa_Rx
            CanTpTxFcNPdu_08415e34 (CanTpTxFcNPdu): CanTpTxFcNPduRef=PCAN_DIAG_RESP_PHYS_OBD1_Tp_oPCAN_RADAR_20_f6415fa5_Tx
          CanTpTxNSdu_808a4832 (CanTpTxNSdu):
            CanTpTxAddressingFormat = CANTP_STANDARD
            CanTpTxDl = 8
            CanTpTxTaType = CANTP_PHYSICAL
            CanTpTxNSduRef = EcucPduCollection/PCAN_DIAG_RESP_PHYS_OBD1_oPCAN_RADAR_20_955df2f4_Tx
            CanTpRxFcNPdu_2abb8ac6 (CanTpRxFcNPdu): CanTpRxFcNPduRef=PCAN_DIAG_REQ_PHYS_OBD1_Tp_oPCAN_RADAR_20_b6648efa_Rx
            CanTpTxNPdu_2abb8ac6 (CanTpTxNPdu): CanTpTxNPduRef=PCAN_DIAG_RESP_PHYS_OBD1_Tp_oPCAN_RADAR_20_f6415fa5_Tx
        TPCH_6b9e55c7: variation-point=post-build-variant-condition{matching-criterion=RDR_POS, value=3}
          CanTpRxNSdu_bcfcbb59 (CanTpRxNSdu):
            CanTpRxAddressingFormat = CANTP_STANDARD
            CanTpRxDl = 8
            CanTpRxTaType = CANTP_FUNCTIONAL
            CanTpRxNSduRef = EcucPduCollection/DIAG_REQ_FNC_OBD2_oVCAN_RADAR_254b3790_Rx
            CanTpRxNPdu_604a7f84 (CanTpRxNPdu): CanTpRxNPduRef=DIAG_REQ_FNC_OBD2_Tp_oVCAN_RADAR_42ec9761_Rx
        TPCH_6efdceaa: variation-point=post-build-variant-condition{matching-criterion=RDR_POS, value=3}
          CanTpRxNSdu_8b07fec8 (CanTpRxNSdu):
            CanTpRxAddressingFormat = CANTP_STANDARD
            CanTpRxDl = 8
            CanTpRxTaType = CANTP_PHYSICAL
            CanTpRxNSduRef = EcucPduCollection/FR_DIAG_REQ_PHY_OBD1_oVCAN_RADAR_5445ad08_Rx
            CanTpRxNPdu_26482297 (CanTpRxNPdu): CanTpRxNPduRef=FR_DIAG_REQ_PHY_OBD1_Tp_oVCAN_RADAR_ddfa31cf_Rx
            CanTpTxFcNPdu_26482297 (CanTpTxFcNPdu): CanTpTxFcNPduRef=FR_DIAG_RES_PHY_OBD1_Tp_oVCAN_RADAR_41a76716_Tx
          CanTpTxNSdu_8b07fec8 (CanTpTxNSdu):
            CanTpTxAddressingFormat = CANTP_STANDARD
            CanTpTxDl = 8
            CanTpTxTaType = CANTP_PHYSICAL
            CanTpTxNSduRef = EcucPduCollection/FR_DIAG_RES_PHY_OBD1_oVCAN_RADAR_cd47a295_Tx
            CanTpRxFcNPdu_04b2f665 (CanTpRxFcNPdu): CanTpRxFcNPduRef=FR_DIAG_REQ_PHY_OBD1_Tp_oVCAN_RADAR_ddfa31cf_Rx
            CanTpTxNPdu_04b2f665 (CanTpTxNPdu): CanTpTxNPduRef=FR_DIAG_RES_PHY_OBD1_Tp_oVCAN_RADAR_41a76716_Tx
        TPCH_82f88316: variation-point=post-build-variant-condition{matching-criterion=RDR_POS, value=3}
          CanTpRxNSdu_be955aab (CanTpRxNSdu):
            CanTpRxAddressingFormat = CANTP_STANDARD
            CanTpRxDl = 64
            CanTpRxTaType = CANTP_CANFD_PHYSICAL
            CanTpRxNSduRef = EcucPduCollection/PCAN_DIAG_REQ_PHYS_OTA_oPCAN_RADAR_45eab9fd_Rx
            CanTpRxNPdu_50d05297 (CanTpRxNPdu): CanTpRxNPduRef=PCAN_DIAG_REQ_PHYS_OTA_Tp_oPCAN_RADAR_94a46e49_Rx
            CanTpTxFcNPdu_50d05297 (CanTpTxFcNPdu): CanTpTxFcNPduRef=PCAN_DIAG_RESP_PHYS_OTA_Tp_oPCAN_RADAR_37f68c50_Tx
          CanTpTxNSdu_be955aab (CanTpTxNSdu):
            CanTpTxAddressingFormat = CANTP_STANDARD
            CanTpTxDl = 64
            CanTpTxTaType = CANTP_CANFD_PHYSICAL
            CanTpTxNSduRef = EcucPduCollection/PCAN_DIAG_RESP_PHYS_OTA_oPCAN_RADAR_2a569d3c_Tx
            CanTpRxFcNPdu_722a8665 (CanTpRxFcNPdu): CanTpRxFcNPduRef=PCAN_DIAG_REQ_PHYS_OTA_Tp_oPCAN_RADAR_94a46e49_Rx
            CanTpTxNPdu_722a8665 (CanTpTxNPdu): CanTpTxNPduRef=PCAN_DIAG_RESP_PHYS_OTA_Tp_oPCAN_RADAR_37f68c50_Tx
        TPCH_889aab04: variation-point=post-build-variant-condition{matching-criterion=RDR_POS, value=3}
          CanTpRxNSdu_fe5046bf (CanTpRxNSdu):
            CanTpRxAddressingFormat = CANTP_STANDARD
            CanTpRxDl = 64
            CanTpRxTaType = CANTP_CANFD_FUNCTIONAL
            CanTpRxNSduRef = EcucPduCollection/PCAN_DIAG_REQ_FUNC_OBD1_oPCAN_RADAR_b9aa9d1d_Rx
            CanTpRxNPdu_af4492d7 (CanTpRxNPdu): CanTpRxNPduRef=PCAN_DIAG_REQ_FUNC_OBD1_Tp_oPCAN_RADAR_ba721e23_Rx
        TPCH_99d5e2e1: variation-point=post-build-variant-condition{matching-criterion=RDR_POS, value=3}
          CanTpRxNSdu_bd76dbce (CanTpRxNSdu):
            CanTpRxAddressingFormat = CANTP_STANDARD
            CanTpRxDl = 64
            CanTpRxTaType = CANTP_CANFD_FUNCTIONAL
            CanTpRxNSduRef = EcucPduCollection/PCAN_DIAG_REQ_FUNC_OTA_oPCAN_RADAR_a013523e_Rx
            CanTpRxNPdu_0e79eefd (CanTpRxNPdu): CanTpRxNPduRef=PCAN_DIAG_REQ_FUNC_OTA_Tp_oPCAN_RADAR_7ea6262a_Rx
        TPCH_9a3b0030: variation-point=post-build-variant-condition{matching-criterion=RDR_POS, value=3}
          CanTpRxNSdu_5245b630 (CanTpRxNSdu):
            CanTpRxAddressingFormat = CANTP_STANDARD
            CanTpRxDl = 8
            CanTpRxTaType = CANTP_FUNCTIONAL
            CanTpRxNSduRef = EcucPduCollection/PCAN_DIAG_REQ_FUNC_OBD2_oPCAN_RADAR_20_41244182_Rx
            CanTpRxNPdu_4664bd26 (CanTpRxNPdu): CanTpRxNPduRef=PCAN_DIAG_REQ_FUNC_OBD2_Tp_oPCAN_RADAR_20_400c7f70_Rx
        TPCH_a82d3b47: variation-point=post-build-variant-condition{matching-criterion=RDR_POS, value=3}
          CanTpRxNSdu_8a7f8276 (CanTpRxNSdu):
            CanTpRxAddressingFormat = CANTP_STANDARD
            CanTpRxDl = 8
            CanTpRxTaType = CANTP_FUNCTIONAL
            CanTpRxNSduRef = EcucPduCollection/DIAG_REQ_FNC_PLANT_oVCAN_RADAR_42eb2f27_Rx
            CanTpRxNPdu_cb01d19c (CanTpRxNPdu): CanTpRxNPduRef=DIAG_REQ_FNC_PLANT_Tp_oVCAN_RADAR_d6304422_Rx
        TPCH_abe7acb0: variation-point=post-build-variant-condition{matching-criterion=RDR_POS, value=3}
          CanTpRxNSdu_71a17bb4 (CanTpRxNSdu):
            CanTpRxAddressingFormat = CANTP_STANDARD
            CanTpRxDl = 8
            CanTpRxTaType = CANTP_PHYSICAL
            CanTpRxNSduRef = EcucPduCollection/FR_DIAG_REQ_PHY_OBD2_oVCAN_RADAR_0f521c1d_Rx
            CanTpRxNPdu_c8e61be1 (CanTpRxNPdu): CanTpRxNPduRef=FR_DIAG_REQ_PHY_OBD2_Tp_oVCAN_RADAR_b91a4a31_Rx
            CanTpTxFcNPdu_c8e61be1 (CanTpTxFcNPdu): CanTpTxFcNPduRef=FR_DIAG_RES_PHY_OBD2_Tp_oVCAN_RADAR_25471ce8_Tx
          CanTpTxNSdu_71a17bb4 (CanTpTxNSdu):
            CanTpTxAddressingFormat = CANTP_STANDARD
            CanTpTxDl = 8
            CanTpTxTaType = CANTP_PHYSICAL
            CanTpTxNSduRef = EcucPduCollection/FR_DIAG_RES_PHY_OBD2_oVCAN_RADAR_96501380_Tx
            CanTpRxFcNPdu_ea1ccf13 (CanTpRxFcNPdu): CanTpRxFcNPduRef=FR_DIAG_REQ_PHY_OBD2_Tp_oVCAN_RADAR_b91a4a31_Rx
            CanTpTxNPdu_ea1ccf13 (CanTpTxNPdu): CanTpTxNPduRef=FR_DIAG_RES_PHY_OBD2_Tp_oVCAN_RADAR_25471ce8_Tx
        TPCH_ae3af2ed: variation-point=post-build-variant-condition{matching-criterion=RDR_POS, value=3}
          CanTpRxNSdu_0a6cebaf (CanTpRxNSdu):
            CanTpRxAddressingFormat = CANTP_STANDARD
            CanTpRxDl = 8
            CanTpRxTaType = CANTP_PHYSICAL
            CanTpRxNSduRef = EcucPduCollection/PCAN_DIAG_REQ_PHYS_OBD2_oPCAN_RADAR_20_95757328_Rx
            CanTpRxNPdu_3750ca88 (CanTpRxNPdu): CanTpRxNPduRef=PCAN_DIAG_REQ_PHYS_OBD2_Tp_oPCAN_RADAR_20_65ff9201_Rx
            CanTpTxFcNPdu_3750ca88 (CanTpTxFcNPdu): CanTpTxFcNPduRef=PCAN_DIAG_RESP_PHYS_OBD2_Tp_oPCAN_RADAR_20_25da435e_Tx
          CanTpTxNSdu_0a6cebaf (CanTpTxNSdu):
            CanTpTxAddressingFormat = CANTP_STANDARD
            CanTpTxDl = 8
            CanTpTxTaType = CANTP_PHYSICAL
            CanTpTxNSduRef = EcucPduCollection/PCAN_DIAG_RESP_PHYS_OBD2_oPCAN_RADAR_20_f1bd890a_Tx
            CanTpRxFcNPdu_15aa1e7a (CanTpRxFcNPdu): CanTpRxFcNPduRef=PCAN_DIAG_REQ_PHYS_OBD2_Tp_oPCAN_RADAR_20_65ff9201_Rx
            CanTpTxNPdu_15aa1e7a (CanTpTxNPdu): CanTpTxNPduRef=PCAN_DIAG_RESP_PHYS_OBD2_Tp_oPCAN_RADAR_20_25da435e_Tx
        TPCH_b29eaa00: variation-point=post-build-variant-condition{matching-criterion=RDR_POS, value=3}
          CanTpRxNSdu_6e6d2a7f (CanTpRxNSdu):
            CanTpRxAddressingFormat = CANTP_STANDARD
            CanTpRxDl = 8
            CanTpRxTaType = CANTP_PHYSICAL
            CanTpRxNSduRef = EcucPduCollection/FR_DIAG_REQ_PHY_OTA_oVCAN_RADAR_9187f4da_Rx
            CanTpRxNPdu_8274ce50 (CanTpRxNPdu): CanTpRxNPduRef=FR_DIAG_REQ_PHY_OTA_Tp_oVCAN_RADAR_4de495d5_Rx
            CanTpTxFcNPdu_8274ce50 (CanTpTxFcNPdu): CanTpTxFcNPduRef=FR_DIAG_RES_PHY_OTA_Tp_oVCAN_RADAR_19b4e511_Tx
          CanTpTxNSdu_6e6d2a7f (CanTpTxNSdu):
            CanTpTxAddressingFormat = CANTP_STANDARD
            CanTpTxDl = 8
            CanTpTxTaType = CANTP_PHYSICAL
            CanTpTxNSduRef = EcucPduCollection/FR_DIAG_RES_PHY_OTA_oVCAN_RADAR_9ad9d3d9_Tx
            CanTpRxFcNPdu_a08e1aa2 (CanTpRxFcNPdu): CanTpRxFcNPduRef=FR_DIAG_REQ_PHY_OTA_Tp_oVCAN_RADAR_4de495d5_Rx
            CanTpTxNPdu_a08e1aa2 (CanTpTxNPdu): CanTpTxNPduRef=FR_DIAG_RES_PHY_OTA_Tp_oVCAN_RADAR_19b4e511_Tx
        TPCH_b8a7316c: variation-point=post-build-variant-condition{matching-criterion=RDR_POS, value=3}
          CanTpRxNSdu_c1932d51 (CanTpRxNSdu):
            CanTpRxAddressingFormat = CANTP_STANDARD
            CanTpRxDl = 8
            CanTpRxTaType = CANTP_PHYSICAL
            CanTpRxNSduRef = EcucPduCollection/PCAN_DIAG_REQ_PHYS_OTA_oPCAN_RADAR_20_0b124a16_Rx
            CanTpRxNPdu_240c21b4 (CanTpRxNPdu): CanTpRxNPduRef=PCAN_DIAG_REQ_PHYS_OTA_Tp_oPCAN_RADAR_20_96582344_Rx
            CanTpTxFcNPdu_240c21b4 (CanTpTxFcNPdu): CanTpTxFcNPduRef=PCAN_DIAG_RESP_PHYS_OTA_Tp_oPCAN_RADAR_20_6c821aae_Tx
          CanTpTxNSdu_c1932d51 (CanTpTxNSdu):
            CanTpTxAddressingFormat = CANTP_STANDARD
            CanTpTxDl = 8
            CanTpTxTaType = CANTP_PHYSICAL
            CanTpTxNSduRef = EcucPduCollection/PCAN_DIAG_RESP_PHYS_OTA_oPCAN_RADAR_20_a840a80f_Tx
            CanTpRxFcNPdu_06f6f546 (CanTpRxFcNPdu): CanTpRxFcNPduRef=PCAN_DIAG_REQ_PHYS_OTA_Tp_oPCAN_RADAR_20_96582344_Rx
            CanTpTxNPdu_06f6f546 (CanTpTxNPdu): CanTpTxNPduRef=PCAN_DIAG_RESP_PHYS_OTA_Tp_oPCAN_RADAR_20_6c821aae_Tx
        TPCH_d1ca84e0: variation-point=post-build-variant-condition{matching-criterion=RDR_POS, value=3}
          CanTpRxNSdu_dac1b156 (CanTpRxNSdu):
            CanTpRxAddressingFormat = CANTP_STANDARD
            CanTpRxDl = 64
            CanTpRxTaType = CANTP_CANFD_PHYSICAL
            CanTpRxNSduRef = EcucPduCollection/PCAN_DIAG_REQ_PHYS_PLANT_oPCAN_RADAR_214e1a1c_Rx
            CanTpRxNPdu_2dbb61ae (CanTpRxNPdu): CanTpRxNPduRef=PCAN_DIAG_REQ_PHYS_PLANT_Tp_oPCAN_RADAR_68155c61_Rx
            CanTpTxFcNPdu_2dbb61ae (CanTpTxFcNPdu): CanTpTxFcNPduRef=PCAN_DIAG_RESP_PHYS_PLANT_Tp_oPCAN_RADAR_bd11d57f_Tx
          CanTpTxNSdu_dac1b156 (CanTpTxNSdu):
            CanTpTxAddressingFormat = CANTP_STANDARD
            CanTpTxDl = 64
            CanTpTxTaType = CANTP_CANFD_PHYSICAL
            CanTpTxNSduRef = EcucPduCollection/PCAN_DIAG_RESP_PHYS_PLANT_oPCAN_RADAR_cfac777e_Tx
            CanTpRxFcNPdu_0f41b55c (CanTpRxFcNPdu): CanTpRxFcNPduRef=PCAN_DIAG_REQ_PHYS_PLANT_Tp_oPCAN_RADAR_68155c61_Rx
            CanTpTxNPdu_0f41b55c (CanTpTxNPdu): CanTpTxNPduRef=PCAN_DIAG_RESP_PHYS_PLANT_Tp_oPCAN_RADAR_bd11d57f_Tx
        TPCH_e22bff3b: variation-point=post-build-variant-condition{matching-criterion=RDR_POS, value=3}
          CanTpRxNSdu_8a9f4292 (CanTpRxNSdu):
            CanTpRxAddressingFormat = CANTP_STANDARD
            CanTpRxDl = 64
            CanTpRxTaType = CANTP_CANFD_PHYSICAL
            CanTpRxNSduRef = EcucPduCollection/PCAN_DIAG_REQ_PHYS_OBD2_oPCAN_RADAR_e03546e9_Rx
            CanTpRxNPdu_cec4b5a4 (CanTpRxNPdu): CanTpRxNPduRef=PCAN_DIAG_REQ_PHYS_OBD2_Tp_oPCAN_RADAR_0ac35777_Rx
            CanTpTxFcNPdu_cec4b5a4 (CanTpTxFcNPdu): CanTpTxFcNPduRef=PCAN_DIAG_RESP_PHYS_OBD2_Tp_oPCAN_RADAR_6e0bad55_Tx
          CanTpTxNSdu_8a9f4292 (CanTpTxNSdu):
            CanTpTxAddressingFormat = CANTP_STANDARD
            CanTpTxDl = 64
            CanTpTxTaType = CANTP_CANFD_PHYSICAL
            CanTpTxNSduRef = EcucPduCollection/PCAN_DIAG_RESP_PHYS_OBD2_oPCAN_RADAR_0c3908eb_Tx
            CanTpRxFcNPdu_ec3e6156 (CanTpRxFcNPdu): CanTpRxFcNPduRef=PCAN_DIAG_REQ_PHYS_OBD2_Tp_oPCAN_RADAR_0ac35777_Rx
            CanTpTxNPdu_ec3e6156 (CanTpTxNPdu): CanTpTxNPduRef=PCAN_DIAG_RESP_PHYS_OBD2_Tp_oPCAN_RADAR_6e0bad55_Tx
        TPCH_fbc8df6a: variation-point=post-build-variant-condition{matching-criterion=RDR_POS, value=3}
          CanTpRxNSdu_dcc3cd8a (CanTpRxNSdu):
            CanTpRxAddressingFormat = CANTP_STANDARD
            CanTpRxDl = 8
            CanTpRxTaType = CANTP_FUNCTIONAL
            CanTpRxNSduRef = EcucPduCollection/PCAN_DIAG_REQ_FUNC_OBD1_oPCAN_RADAR_20_25c43a7c_Rx
            CanTpRxNPdu_8e0f0117 (CanTpRxNPdu): CanTpRxNPduRef=PCAN_DIAG_REQ_FUNC_OBD1_Tp_oPCAN_RADAR_20_9397638b_Rx
        TPCH_fcce3320: variation-point=post-build-variant-condition{matching-criterion=RDR_POS, value=3}
          CanTpRxNSdu_fe9ab262 (CanTpRxNSdu):
            CanTpRxAddressingFormat = CANTP_STANDARD
            CanTpRxDl = 64
            CanTpRxTaType = CANTP_CANFD_FUNCTIONAL
            CanTpRxNSduRef = EcucPduCollection/PCAN_DIAG_REQ_FUNC_PLANT_oPCAN_RADAR_f6414098_Rx
            CanTpRxNPdu_e3fed264 (CanTpRxNPdu): CanTpRxNPduRef=PCAN_DIAG_REQ_FUNC_PLANT_Tp_oPCAN_RADAR_5ec247a5_Rx
        TPCH_019e4c5f: variation-point=post-build-variant-condition{matching-criterion=RDR_POS, value=4}
          CanTpRxNSdu_48aeef23 (CanTpRxNSdu):
            CanTpRxAddressingFormat = CANTP_STANDARD
            CanTpRxDl = 8
            CanTpRxTaType = CANTP_FUNCTIONAL
            CanTpRxNSduRef = EcucPduCollection/PCAN_DIAG_REQ_FUNC_OBD2_oPCAN_RADAR_20_41244182_Rx
            CanTpRxNPdu_41a3f494 (CanTpRxNPdu): CanTpRxNPduRef=PCAN_DIAG_REQ_FUNC_OBD2_Tp_oPCAN_RADAR_20_400c7f70_Rx
        TPCH_16678097: variation-point=post-build-variant-condition{matching-criterion=RDR_POS, value=4}
          CanTpRxNSdu_66d3fe72 (CanTpRxNSdu):
            CanTpRxAddressingFormat = CANTP_STANDARD
            CanTpRxDl = 64
            CanTpRxTaType = CANTP_CANFD_FUNCTIONAL
            CanTpRxNSduRef = EcucPduCollection/PCAN_DIAG_REQ_FUNC_OBD2_oPCAN_RADAR_e2bd2c08_Rx
            CanTpRxNPdu_00542158 (CanTpRxNPdu): CanTpRxNPduRef=PCAN_DIAG_REQ_FUNC_OBD2_Tp_oPCAN_RADAR_de9265dd_Rx
        TPCH_33887728: variation-point=post-build-variant-condition{matching-criterion=RDR_POS, value=4}
          CanTpRxNSdu_e0f3e280 (CanTpRxNSdu):
            CanTpRxAddressingFormat = CANTP_STANDARD
            CanTpRxDl = 8
            CanTpRxTaType = CANTP_FUNCTIONAL
            CanTpRxNSduRef = EcucPduCollection/DIAG_REQ_FNC_PLANT_oVCAN_RADAR_42eb2f27_Rx
            CanTpRxNPdu_acecf7b1 (CanTpRxNPdu): CanTpRxNPduRef=DIAG_REQ_FNC_PLANT_Tp_oVCAN_RADAR_d6304422_Rx
        TPCH_41f899d3: variation-point=post-build-variant-condition{matching-criterion=RDR_POS, value=4}
          CanTpRxNSdu_da5fea54 (CanTpRxNSdu):
            CanTpRxAddressingFormat = CANTP_STANDARD
            CanTpRxDl = 8
            CanTpRxTaType = CANTP_PHYSICAL
            CanTpRxNSduRef = EcucPduCollection/PCAN_DIAG_REQ_PHYS_OBD2_oPCAN_RADAR_20_95757328_Rx
            CanTpRxNPdu_7c9c8a40 (CanTpRxNPdu): CanTpRxNPduRef=PCAN_DIAG_REQ_PHYS_OBD2_Tp_oPCAN_RADAR_20_65ff9201_Rx
            CanTpTxFcNPdu_7c9c8a40 (CanTpTxFcNPdu): CanTpTxFcNPduRef=PCAN_DIAG_RESP_PHYS_OBD2_Tp_oPCAN_RADAR_20_25da435e_Tx
          CanTpTxNSdu_da5fea54 (CanTpTxNSdu):
            CanTpTxAddressingFormat = CANTP_STANDARD
            CanTpTxDl = 8
            CanTpTxTaType = CANTP_PHYSICAL
            CanTpTxNSduRef = EcucPduCollection/PCAN_DIAG_RESP_PHYS_OBD2_oPCAN_RADAR_20_f1bd890a_Tx
            CanTpRxFcNPdu_5e665eb2 (CanTpRxFcNPdu): CanTpRxFcNPduRef=PCAN_DIAG_REQ_PHYS_OBD2_Tp_oPCAN_RADAR_20_65ff9201_Rx
            CanTpTxNPdu_5e665eb2 (CanTpTxNPdu): CanTpTxNPduRef=PCAN_DIAG_RESP_PHYS_OBD2_Tp_oPCAN_RADAR_20_25da435e_Tx
        TPCH_4425c78e: variation-point=post-build-variant-condition{matching-criterion=RDR_POS, value=4}
          CanTpRxNSdu_ddc06ff6 (CanTpRxNSdu):
            CanTpRxAddressingFormat = CANTP_STANDARD
            CanTpRxDl = 8
            CanTpRxTaType = CANTP_PHYSICAL
            CanTpRxNSduRef = EcucPduCollection/FR_DIAG_REQ_PHY_OBD2_oVCAN_RADAR_0f521c1d_Rx
            CanTpRxNPdu_ca69fbd1 (CanTpRxNPdu): CanTpRxNPduRef=FR_DIAG_REQ_PHY_OBD2_Tp_oVCAN_RADAR_b91a4a31_Rx
            CanTpTxFcNPdu_ca69fbd1 (CanTpTxFcNPdu): CanTpTxFcNPduRef=FR_DIAG_RES_PHY_OBD2_Tp_oVCAN_RADAR_25471ce8_Tx
          CanTpTxNSdu_ddc06ff6 (CanTpTxNSdu):
            CanTpTxAddressingFormat = CANTP_STANDARD
            CanTpTxDl = 8
            CanTpTxTaType = CANTP_PHYSICAL
            CanTpTxNSduRef = EcucPduCollection/FR_DIAG_RES_PHY_OBD2_oVCAN_RADAR_96501380_Tx
            CanTpRxFcNPdu_e8932f23 (CanTpRxFcNPdu): CanTpRxFcNPduRef=FR_DIAG_REQ_PHY_OBD2_Tp_oVCAN_RADAR_b91a4a31_Rx
            CanTpTxNPdu_e8932f23 (CanTpTxNPdu): CanTpTxNPduRef=FR_DIAG_RES_PHY_OBD2_Tp_oVCAN_RADAR_25471ce8_Tx
        TPCH_57655a52: variation-point=post-build-variant-condition{matching-criterion=RDR_POS, value=4}
          CanTpRxNSdu_7de58f85 (CanTpRxNSdu):
            CanTpRxAddressingFormat = CANTP_STANDARD
            CanTpRxDl = 8
            CanTpRxTaType = CANTP_PHYSICAL
            CanTpRxNSduRef = EcucPduCollection/PCAN_DIAG_REQ_PHYS_OTA_oPCAN_RADAR_20_0b124a16_Rx
            CanTpRxNPdu_ae92d8c2 (CanTpRxNPdu): CanTpRxNPduRef=PCAN_DIAG_REQ_PHYS_OTA_Tp_oPCAN_RADAR_20_96582344_Rx
            CanTpTxFcNPdu_ae92d8c2 (CanTpTxFcNPdu): CanTpTxFcNPduRef=PCAN_DIAG_RESP_PHYS_OTA_Tp_oPCAN_RADAR_20_6c821aae_Tx
          CanTpTxNSdu_7de58f85 (CanTpTxNSdu):
            CanTpTxAddressingFormat = CANTP_STANDARD
            CanTpTxDl = 8
            CanTpTxTaType = CANTP_PHYSICAL
            CanTpTxNSduRef = EcucPduCollection/PCAN_DIAG_RESP_PHYS_OTA_oPCAN_RADAR_20_a840a80f_Tx
            CanTpRxFcNPdu_8c680c30 (CanTpRxFcNPdu): CanTpRxFcNPduRef=PCAN_DIAG_REQ_PHYS_OTA_Tp_oPCAN_RADAR_20_96582344_Rx
            CanTpTxNPdu_8c680c30 (CanTpTxNPdu): CanTpTxNPduRef=PCAN_DIAG_RESP_PHYS_OTA_Tp_oPCAN_RADAR_20_6c821aae_Tx
        TPCH_5a8bedd4: variation-point=post-build-variant-condition{matching-criterion=RDR_POS, value=4}
          CanTpRxNSdu_0adc25ca (CanTpRxNSdu):
            CanTpRxAddressingFormat = CANTP_STANDARD
            CanTpRxDl = 64
            CanTpRxTaType = CANTP_CANFD_PHYSICAL
            CanTpRxNSduRef = EcucPduCollection/PCAN_DIAG_REQ_PHYS_OBD1_oPCAN_RADAR_bb22f7fc_Rx
            CanTpRxNPdu_e3414a64 (CanTpRxNPdu): CanTpRxNPduRef=PCAN_DIAG_REQ_PHYS_OBD1_Tp_oPCAN_RADAR_6e232c89_Rx
            CanTpTxFcNPdu_e3414a64 (CanTpTxFcNPdu): CanTpTxFcNPduRef=PCAN_DIAG_RESP_PHYS_OBD1_Tp_oPCAN_RADAR_0aebd6ab_Tx
          CanTpTxNSdu_0adc25ca (CanTpTxNSdu):
            CanTpTxAddressingFormat = CANTP_STANDARD
            CanTpTxDl = 64
            CanTpTxTaType = CANTP_CANFD_PHYSICAL
            CanTpTxNSduRef = EcucPduCollection/PCAN_DIAG_RESP_PHYS_OBD1_oPCAN_RADAR_572eb9fe_Tx
            CanTpRxFcNPdu_c1bb9e96 (CanTpRxFcNPdu): CanTpRxFcNPduRef=PCAN_DIAG_REQ_PHYS_OBD1_Tp_oPCAN_RADAR_6e232c89_Rx
            CanTpTxNPdu_c1bb9e96 (CanTpTxNPdu): CanTpTxNPduRef=PCAN_DIAG_RESP_PHYS_OBD1_Tp_oPCAN_RADAR_0aebd6ab_Tx
        TPCH_5d5cc13e: variation-point=post-build-variant-condition{matching-criterion=RDR_POS, value=4}
          CanTpRxNSdu_7f902975 (CanTpRxNSdu):
            CanTpRxAddressingFormat = CANTP_STANDARD
            CanTpRxDl = 8
            CanTpRxTaType = CANTP_PHYSICAL
            CanTpRxNSduRef = EcucPduCollection/FR_DIAG_REQ_PHY_OTA_oVCAN_RADAR_9187f4da_Rx
            CanTpRxNPdu_a9a436aa (CanTpRxNPdu): CanTpRxNPduRef=FR_DIAG_REQ_PHY_OTA_Tp_oVCAN_RADAR_4de495d5_Rx
            CanTpTxFcNPdu_a9a436aa (CanTpTxFcNPdu): CanTpTxFcNPduRef=FR_DIAG_RES_PHY_OTA_Tp_oVCAN_RADAR_19b4e511_Tx
          CanTpTxNSdu_7f902975 (CanTpTxNSdu):
            CanTpTxAddressingFormat = CANTP_STANDARD
            CanTpTxDl = 8
            CanTpTxTaType = CANTP_PHYSICAL
            CanTpTxNSduRef = EcucPduCollection/FR_DIAG_RES_PHY_OTA_oVCAN_RADAR_9ad9d3d9_Tx
            CanTpRxFcNPdu_8b5ee258 (CanTpRxFcNPdu): CanTpRxFcNPduRef=FR_DIAG_REQ_PHY_OTA_Tp_oVCAN_RADAR_4de495d5_Rx
            CanTpTxNPdu_8b5ee258 (CanTpTxNPdu): CanTpTxNPduRef=FR_DIAG_RES_PHY_OTA_Tp_oVCAN_RADAR_19b4e511_Tx
        TPCH_606d9305: variation-point=post-build-variant-condition{matching-criterion=RDR_POS, value=4}
          CanTpRxNSdu_f5437413 (CanTpRxNSdu):
            CanTpRxAddressingFormat = CANTP_STANDARD
            CanTpRxDl = 8
            CanTpRxTaType = CANTP_FUNCTIONAL
            CanTpRxNSduRef = EcucPduCollection/PCAN_DIAG_REQ_FUNC_OBD1_oPCAN_RADAR_20_25c43a7c_Rx
            CanTpRxNPdu_748cf4a0 (CanTpRxNPdu): CanTpRxNPduRef=PCAN_DIAG_REQ_FUNC_OBD1_Tp_oPCAN_RADAR_20_9397638b_Rx
        TPCH_813fa594: variation-point=post-build-variant-condition{matching-criterion=RDR_POS, value=4}
          CanTpRxNSdu_c0427f66 (CanTpRxNSdu):
            CanTpRxAddressingFormat = CANTP_STANDARD
            CanTpRxDl = 8
            CanTpRxTaType = CANTP_PHYSICAL
            CanTpRxNSduRef = EcucPduCollection/FR_DIAG_REQ_PHY_OBD1_oVCAN_RADAR_5445ad08_Rx
            CanTpRxNPdu_d446074a (CanTpRxNPdu): CanTpRxNPduRef=FR_DIAG_REQ_PHY_OBD1_Tp_oVCAN_RADAR_ddfa31cf_Rx
            CanTpTxFcNPdu_d446074a (CanTpTxFcNPdu): CanTpTxFcNPduRef=FR_DIAG_RES_PHY_OBD1_Tp_oVCAN_RADAR_41a76716_Tx
          CanTpTxNSdu_c0427f66 (CanTpTxNSdu):
            CanTpTxAddressingFormat = CANTP_STANDARD
            CanTpTxDl = 8
            CanTpTxTaType = CANTP_PHYSICAL
            CanTpTxNSduRef = EcucPduCollection/FR_DIAG_RES_PHY_OBD1_oVCAN_RADAR_cd47a295_Tx
            CanTpRxFcNPdu_f6bcd3b8 (CanTpRxFcNPdu): CanTpRxFcNPduRef=FR_DIAG_REQ_PHY_OBD1_Tp_oVCAN_RADAR_ddfa31cf_Rx
            CanTpTxNPdu_f6bcd3b8 (CanTpTxNPdu): CanTpTxNPduRef=FR_DIAG_RES_PHY_OBD1_Tp_oVCAN_RADAR_41a76716_Tx
        TPCH_86087019: variation-point=post-build-variant-condition{matching-criterion=RDR_POS, value=4}
          CanTpRxNSdu_5a9726cc (CanTpRxNSdu):
            CanTpRxAddressingFormat = CANTP_STANDARD
            CanTpRxDl = 8
            CanTpRxTaType = CANTP_PHYSICAL
            CanTpRxNSduRef = EcucPduCollection/PCAN_DIAG_REQ_PHYS_OBD1_oPCAN_RADAR_20_f19508d6_Rx
            CanTpRxNPdu_102ffa27 (CanTpRxNPdu): CanTpRxNPduRef=PCAN_DIAG_REQ_PHYS_OBD1_Tp_oPCAN_RADAR_20_b6648efa_Rx
            CanTpTxFcNPdu_102ffa27 (CanTpTxFcNPdu): CanTpTxFcNPduRef=PCAN_DIAG_RESP_PHYS_OBD1_Tp_oPCAN_RADAR_20_f6415fa5_Tx
          CanTpTxNSdu_5a9726cc (CanTpTxNSdu):
            CanTpTxAddressingFormat = CANTP_STANDARD
            CanTpTxDl = 8
            CanTpTxTaType = CANTP_PHYSICAL
            CanTpTxNSduRef = EcucPduCollection/PCAN_DIAG_RESP_PHYS_OBD1_oPCAN_RADAR_20_955df2f4_Tx
            CanTpRxFcNPdu_32d52ed5 (CanTpRxFcNPdu): CanTpRxFcNPduRef=PCAN_DIAG_REQ_PHYS_OBD1_Tp_oPCAN_RADAR_20_b6648efa_Rx
            CanTpTxNPdu_32d52ed5 (CanTpTxNPdu): CanTpTxNPduRef=PCAN_DIAG_RESP_PHYS_OBD1_Tp_oPCAN_RADAR_20_f6415fa5_Tx
        TPCH_874cc47d: variation-point=post-build-variant-condition{matching-criterion=RDR_POS, value=4}
          CanTpRxNSdu_28542b52 (CanTpRxNSdu):
            CanTpRxAddressingFormat = CANTP_STANDARD
            CanTpRxDl = 64
            CanTpRxTaType = CANTP_CANFD_PHYSICAL
            CanTpRxNSduRef = EcucPduCollection/PCAN_DIAG_REQ_PHYS_OBD2_oPCAN_RADAR_e03546e9_Rx
            CanTpRxNPdu_a3c73065 (CanTpRxNPdu): CanTpRxNPduRef=PCAN_DIAG_REQ_PHYS_OBD2_Tp_oPCAN_RADAR_0ac35777_Rx
            CanTpTxFcNPdu_a3c73065 (CanTpTxFcNPdu): CanTpTxFcNPduRef=PCAN_DIAG_RESP_PHYS_OBD2_Tp_oPCAN_RADAR_6e0bad55_Tx
          CanTpTxNSdu_28542b52 (CanTpTxNSdu):
            CanTpTxAddressingFormat = CANTP_STANDARD
            CanTpTxDl = 64
            CanTpTxTaType = CANTP_CANFD_PHYSICAL
            CanTpTxNSduRef = EcucPduCollection/PCAN_DIAG_RESP_PHYS_OBD2_oPCAN_RADAR_0c3908eb_Tx
            CanTpRxFcNPdu_813de497 (CanTpRxFcNPdu): CanTpRxFcNPduRef=PCAN_DIAG_REQ_PHYS_OBD2_Tp_oPCAN_RADAR_0ac35777_Rx
            CanTpTxNPdu_813de497 (CanTpTxNPdu): CanTpTxNPduRef=PCAN_DIAG_RESP_PHYS_OBD2_Tp_oPCAN_RADAR_6e0bad55_Tx
        TPCH_893361c7: variation-point=post-build-variant-condition{matching-criterion=RDR_POS, value=4}
          CanTpRxNSdu_8bd00a19 (CanTpRxNSdu):
            CanTpRxAddressingFormat = CANTP_STANDARD
            CanTpRxDl = 8
            CanTpRxTaType = CANTP_FUNCTIONAL
            CanTpRxNSduRef = EcucPduCollection/PCAN_DIAG_REQ_FUNC_PLANT_oPCAN_RADAR_20_c17463fa_Rx
            CanTpRxNPdu_634576d0 (CanTpRxNPdu): CanTpRxNPduRef=PCAN_DIAG_REQ_FUNC_PLANT_Tp_oPCAN_RADAR_20_d63751cc_Rx
        TPCH_8efd8621: variation-point=post-build-variant-condition{matching-criterion=RDR_POS, value=4}
          CanTpRxNSdu_1686abd3 (CanTpRxNSdu):
            CanTpRxAddressingFormat = CANTP_STANDARD
            CanTpRxDl = 64
            CanTpRxTaType = CANTP_CANFD_FUNCTIONAL
            CanTpRxNSduRef = EcucPduCollection/PCAN_DIAG_REQ_FUNC_OTA_oPCAN_RADAR_a013523e_Rx
            CanTpRxNPdu_aa895199 (CanTpRxNPdu): CanTpRxNPduRef=PCAN_DIAG_REQ_FUNC_OTA_Tp_oPCAN_RADAR_7ea6262a_Rx
        TPCH_9694bf41: variation-point=post-build-variant-condition{matching-criterion=RDR_POS, value=4}
          CanTpRxNSdu_938c4b7e (CanTpRxNSdu):
            CanTpRxAddressingFormat = CANTP_STANDARD
            CanTpRxDl = 8
            CanTpRxTaType = CANTP_FUNCTIONAL
            CanTpRxNSduRef = EcucPduCollection/DIAG_REQ_FNC_OTA_oVCAN_RADAR_e787ed21_Rx
            CanTpRxNPdu_4a313afd (CanTpRxNPdu): CanTpRxNPduRef=DIAG_REQ_FNC_OTA_Tp_oVCAN_RADAR_6f75a08a_Rx
        TPCH_9fb2cfc4: variation-point=post-build-variant-condition{matching-criterion=RDR_POS, value=4}
          CanTpRxNSdu_647cf724 (CanTpRxNSdu):
            CanTpRxAddressingFormat = CANTP_STANDARD
            CanTpRxDl = 64
            CanTpRxTaType = CANTP_CANFD_FUNCTIONAL
            CanTpRxNSduRef = EcucPduCollection/PCAN_DIAG_REQ_FUNC_OBD1_oPCAN_RADAR_b9aa9d1d_Rx
            CanTpRxNPdu_95b4ca6b (CanTpRxNPdu): CanTpRxNPduRef=PCAN_DIAG_REQ_FUNC_OBD1_Tp_oPCAN_RADAR_ba721e23_Rx
        TPCH_a5a1e80e: variation-point=post-build-variant-condition{matching-criterion=RDR_POS, value=4}
          CanTpRxNSdu_ff05d790 (CanTpRxNSdu):
            CanTpRxAddressingFormat = CANTP_STANDARD
            CanTpRxDl = 8
            CanTpRxTaType = CANTP_FUNCTIONAL
            CanTpRxNSduRef = EcucPduCollection/PCAN_DIAG_REQ_FUNC_OTA_oPCAN_RADAR_20_e1100275_Rx
            CanTpRxNPdu_ad161582 (CanTpRxNPdu): CanTpRxNPduRef=PCAN_DIAG_REQ_FUNC_OTA_Tp_oPCAN_RADAR_20_0a67f2f6_Rx
        TPCH_b4adbfa6: variation-point=post-build-variant-condition{matching-criterion=RDR_POS, value=4}
          CanTpRxNSdu_8d39cc24 (CanTpRxNSdu):
            CanTpRxAddressingFormat = CANTP_STANDARD
            CanTpRxDl = 64
            CanTpRxTaType = CANTP_CANFD_PHYSICAL
            CanTpRxNSduRef = EcucPduCollection/PCAN_DIAG_REQ_PHYS_PLANT_oPCAN_RADAR_214e1a1c_Rx
            CanTpRxNPdu_1cdbe534 (CanTpRxNPdu): CanTpRxNPduRef=PCAN_DIAG_REQ_PHYS_PLANT_Tp_oPCAN_RADAR_68155c61_Rx
            CanTpTxFcNPdu_1cdbe534 (CanTpTxFcNPdu): CanTpTxFcNPduRef=PCAN_DIAG_RESP_PHYS_PLANT_Tp_oPCAN_RADAR_bd11d57f_Tx
          CanTpTxNSdu_8d39cc24 (CanTpTxNSdu):
            CanTpTxAddressingFormat = CANTP_STANDARD
            CanTpTxDl = 64
            CanTpTxTaType = CANTP_CANFD_PHYSICAL
            CanTpTxNSduRef = EcucPduCollection/PCAN_DIAG_RESP_PHYS_PLANT_oPCAN_RADAR_cfac777e_Tx
            CanTpRxFcNPdu_3e2131c6 (CanTpRxFcNPdu): CanTpRxFcNPduRef=PCAN_DIAG_REQ_PHYS_PLANT_Tp_oPCAN_RADAR_68155c61_Rx
            CanTpTxNPdu_3e2131c6 (CanTpTxNPdu): CanTpTxNPduRef=PCAN_DIAG_RESP_PHYS_PLANT_Tp_oPCAN_RADAR_bd11d57f_Tx
        TPCH_cb0e6147: variation-point=post-build-variant-condition{matching-criterion=RDR_POS, value=4}
          CanTpRxNSdu_6673db92 (CanTpRxNSdu):
            CanTpRxAddressingFormat = CANTP_STANDARD
            CanTpRxDl = 8
            CanTpRxTaType = CANTP_FUNCTIONAL
            CanTpRxNSduRef = EcucPduCollection/DIAG_REQ_FNC_OBD1_oVCAN_RADAR_7e5c8685_Rx
            CanTpRxNPdu_67f2735b (CanTpRxNPdu): CanTpRxNPduRef=DIAG_REQ_FNC_OBD1_Tp_oVCAN_RADAR_260cec9f_Rx
        TPCH_e79f3335: variation-point=post-build-variant-condition{matching-criterion=RDR_POS, value=4}
          CanTpRxNSdu_244becaa (CanTpRxNSdu):
            CanTpRxAddressingFormat = CANTP_STANDARD
            CanTpRxDl = 8
            CanTpRxTaType = CANTP_PHYSICAL
            CanTpRxNSduRef = EcucPduCollection/PCAN_DIAG_REQ_PHYS_PLANT_oPCAN_RADAR_20_f7a3783e_Rx
            CanTpRxNPdu_af200a9a (CanTpRxNPdu): CanTpRxNPduRef=PCAN_DIAG_REQ_PHYS_PLANT_Tp_oPCAN_RADAR_20_f110e38b_Rx
            CanTpTxFcNPdu_af200a9a (CanTpTxFcNPdu): CanTpTxFcNPduRef=PCAN_DIAG_RESP_PHYS_PLANT_Tp_oPCAN_RADAR_20_0a848a3f_Tx
          CanTpTxNSdu_244becaa (CanTpTxNSdu):
            CanTpTxAddressingFormat = CANTP_STANDARD
            CanTpTxDl = 8
            CanTpTxTaType = CANTP_PHYSICAL
            CanTpTxNSduRef = EcucPduCollection/PCAN_DIAG_RESP_PHYS_PLANT_oPCAN_RADAR_20_22a7f120_Tx
            CanTpRxFcNPdu_8ddade68 (CanTpRxFcNPdu): CanTpRxFcNPduRef=PCAN_DIAG_REQ_PHYS_PLANT_Tp_oPCAN_RADAR_20_f110e38b_Rx
            CanTpTxNPdu_8ddade68 (CanTpTxNPdu): CanTpTxNPduRef=PCAN_DIAG_RESP_PHYS_PLANT_Tp_oPCAN_RADAR_20_0a848a3f_Tx
        TPCH_e79fb850: variation-point=post-build-variant-condition{matching-criterion=RDR_POS, value=4}
          CanTpRxNSdu_7d9f3885 (CanTpRxNSdu):
            CanTpRxAddressingFormat = CANTP_STANDARD
            CanTpRxDl = 64
            CanTpRxTaType = CANTP_CANFD_PHYSICAL
            CanTpRxNSduRef = EcucPduCollection/PCAN_DIAG_REQ_PHYS_OTA_oPCAN_RADAR_45eab9fd_Rx
            CanTpRxNPdu_6e1a863d (CanTpRxNPdu): CanTpRxNPduRef=PCAN_DIAG_REQ_PHYS_OTA_Tp_oPCAN_RADAR_94a46e49_Rx
            CanTpTxFcNPdu_6e1a863d (CanTpTxFcNPdu): CanTpTxFcNPduRef=PCAN_DIAG_RESP_PHYS_OTA_Tp_oPCAN_RADAR_37f68c50_Tx
          CanTpTxNSdu_7d9f3885 (CanTpTxNSdu):
            CanTpTxAddressingFormat = CANTP_STANDARD
            CanTpTxDl = 64
            CanTpTxTaType = CANTP_CANFD_PHYSICAL
            CanTpTxNSduRef = EcucPduCollection/PCAN_DIAG_RESP_PHYS_OTA_oPCAN_RADAR_2a569d3c_Tx
            CanTpRxFcNPdu_4ce052cf (CanTpRxFcNPdu): CanTpRxFcNPduRef=PCAN_DIAG_REQ_PHYS_OTA_Tp_oPCAN_RADAR_94a46e49_Rx
            CanTpTxNPdu_4ce052cf (CanTpTxNPdu): CanTpTxNPduRef=PCAN_DIAG_RESP_PHYS_OTA_Tp_oPCAN_RADAR_37f68c50_Tx
        TPCH_ebe657e0: variation-point=post-build-variant-condition{matching-criterion=RDR_POS, value=4}
          CanTpRxNSdu_a810d4a0 (CanTpRxNSdu):
            CanTpRxAddressingFormat = CANTP_STANDARD
            CanTpRxDl = 64
            CanTpRxTaType = CANTP_CANFD_FUNCTIONAL
            CanTpRxNSduRef = EcucPduCollection/PCAN_DIAG_REQ_FUNC_PLANT_oPCAN_RADAR_f6414098_Rx
            CanTpRxNPdu_8cec51f3 (CanTpRxNPdu): CanTpRxNPduRef=PCAN_DIAG_REQ_FUNC_PLANT_Tp_oPCAN_RADAR_5ec247a5_Rx
        TPCH_ebfd0584: variation-point=post-build-variant-condition{matching-criterion=RDR_POS, value=4}
          CanTpRxNSdu_5075f9f9 (CanTpRxNSdu):
            CanTpRxAddressingFormat = CANTP_STANDARD
            CanTpRxDl = 8
            CanTpRxTaType = CANTP_PHYSICAL
            CanTpRxNSduRef = EcucPduCollection/FR_DIAG_REQ_PHY_PLANT_oVCAN_RADAR_d1c8c991_Rx
            CanTpRxNPdu_684eb36e (CanTpRxNPdu): CanTpRxNPduRef=FR_DIAG_REQ_PHY_PLANT_Tp_oVCAN_RADAR_bda0e30b_Rx
            CanTpTxFcNPdu_684eb36e (CanTpTxFcNPdu): CanTpTxFcNPduRef=FR_DIAG_RES_PHY_PLANT_Tp_oVCAN_RADAR_4233d42d_Tx
          CanTpTxNSdu_5075f9f9 (CanTpTxNSdu):
            CanTpTxAddressingFormat = CANTP_STANDARD
            CanTpTxDl = 8
            CanTpTxTaType = CANTP_PHYSICAL
            CanTpTxNSduRef = EcucPduCollection/FR_DIAG_RES_PHY_PLANT_oVCAN_RADAR_5fef2467_Tx
            CanTpRxFcNPdu_4ab4679c (CanTpRxFcNPdu): CanTpRxFcNPduRef=FR_DIAG_REQ_PHY_PLANT_Tp_oVCAN_RADAR_bda0e30b_Rx
            CanTpTxNPdu_4ab4679c (CanTpTxNPdu): CanTpTxNPduRef=FR_DIAG_RES_PHY_PLANT_Tp_oVCAN_RADAR_4233d42d_Tx
        TPCH_f03b19a8: variation-point=post-build-variant-condition{matching-criterion=RDR_POS, value=4}
          CanTpRxNSdu_6ada5e57 (CanTpRxNSdu):
            CanTpRxAddressingFormat = CANTP_STANDARD
            CanTpRxDl = 8
            CanTpRxTaType = CANTP_FUNCTIONAL
            CanTpRxNSduRef = EcucPduCollection/DIAG_REQ_FNC_OBD2_oVCAN_RADAR_254b3790_Rx
            CanTpRxNPdu_964d0a86 (CanTpRxNPdu): CanTpRxNPduRef=DIAG_REQ_FNC_OBD2_Tp_oVCAN_RADAR_42ec9761_Rx
        TPCH_00cabe87: variation-point=post-build-variant-condition{matching-criterion=RDR_POS, value=5}
          CanTpRxNSdu_f5655a25 (CanTpRxNSdu):
            CanTpRxAddressingFormat = CANTP_STANDARD
            CanTpRxDl = 8
            CanTpRxTaType = CANTP_PHYSICAL
            CanTpRxNSduRef = EcucPduCollection/FR_DIAG_REQ_PHY_PLANT_oVCAN_RADAR_d1c8c991_Rx
            CanTpRxNPdu_267926b4 (CanTpRxNPdu): CanTpRxNPduRef=FR_DIAG_REQ_PHY_PLANT_Tp_oVCAN_RADAR_bda0e30b_Rx
            CanTpTxFcNPdu_267926b4 (CanTpTxFcNPdu): CanTpTxFcNPduRef=FR_DIAG_RES_PHY_PLANT_Tp_oVCAN_RADAR_4233d42d_Tx
          CanTpTxNSdu_f5655a25 (CanTpTxNSdu):
            CanTpTxAddressingFormat = CANTP_STANDARD
            CanTpTxDl = 8
            CanTpTxTaType = CANTP_PHYSICAL
            CanTpTxNSduRef = EcucPduCollection/FR_DIAG_RES_PHY_PLANT_oVCAN_RADAR_5fef2467_Tx
            CanTpRxFcNPdu_0483f246 (CanTpRxFcNPdu): CanTpRxFcNPduRef=FR_DIAG_REQ_PHY_PLANT_Tp_oVCAN_RADAR_bda0e30b_Rx
            CanTpTxNPdu_0483f246 (CanTpTxNPdu): CanTpTxNPduRef=FR_DIAG_RES_PHY_PLANT_Tp_oVCAN_RADAR_4233d42d_Tx
        TPCH_0ca88836: variation-point=post-build-variant-condition{matching-criterion=RDR_POS, value=5}
          CanTpRxNSdu_cbb41ec6 (CanTpRxNSdu):
            CanTpRxAddressingFormat = CANTP_STANDARD
            CanTpRxDl = 8
            CanTpRxTaType = CANTP_PHYSICAL
            CanTpRxNSduRef = EcucPduCollection/PCAN_DIAG_REQ_PHYS_PLANT_oPCAN_RADAR_20_f7a3783e_Rx
            CanTpRxNPdu_b8b6db31 (CanTpRxNPdu): CanTpRxNPduRef=PCAN_DIAG_REQ_PHYS_PLANT_Tp_oPCAN_RADAR_20_f110e38b_Rx
            CanTpTxFcNPdu_b8b6db31 (CanTpTxFcNPdu): CanTpTxFcNPduRef=PCAN_DIAG_RESP_PHYS_PLANT_Tp_oPCAN_RADAR_20_0a848a3f_Tx
          CanTpTxNSdu_cbb41ec6 (CanTpTxNSdu):
            CanTpTxAddressingFormat = CANTP_STANDARD
            CanTpTxDl = 8
            CanTpTxTaType = CANTP_PHYSICAL
            CanTpTxNSduRef = EcucPduCollection/PCAN_DIAG_RESP_PHYS_PLANT_oPCAN_RADAR_20_22a7f120_Tx
            CanTpRxFcNPdu_9a4c0fc3 (CanTpRxFcNPdu): CanTpRxFcNPduRef=PCAN_DIAG_REQ_PHYS_PLANT_Tp_oPCAN_RADAR_20_f110e38b_Rx
            CanTpTxNPdu_9a4c0fc3 (CanTpTxNPdu): CanTpTxNPduRef=PCAN_DIAG_RESP_PHYS_PLANT_Tp_oPCAN_RADAR_20_0a848a3f_Tx
        TPCH_17f341f5: variation-point=post-build-variant-condition{matching-criterion=RDR_POS, value=5}
          CanTpRxNSdu_a193aec9 (CanTpRxNSdu):
            CanTpRxAddressingFormat = CANTP_STANDARD
            CanTpRxDl = 8
            CanTpRxTaType = CANTP_FUNCTIONAL
            CanTpRxNSduRef = EcucPduCollection/PCAN_DIAG_REQ_FUNC_OBD1_oPCAN_RADAR_20_25c43a7c_Rx
            CanTpRxNPdu_235fdddd (CanTpRxNPdu): CanTpRxNPduRef=PCAN_DIAG_REQ_FUNC_OBD1_Tp_oPCAN_RADAR_20_9397638b_Rx
        TPCH_1b04f26c: variation-point=post-build-variant-condition{matching-criterion=RDR_POS, value=5}
          CanTpRxNSdu_e3788fc6 (CanTpRxNSdu):
            CanTpRxAddressingFormat = CANTP_STANDARD
            CanTpRxDl = 64
            CanTpRxTaType = CANTP_CANFD_PHYSICAL
            CanTpRxNSduRef = EcucPduCollection/PCAN_DIAG_REQ_PHYS_PLANT_oPCAN_RADAR_214e1a1c_Rx
            CanTpRxNPdu_8e11574f (CanTpRxNPdu): CanTpRxNPduRef=PCAN_DIAG_REQ_PHYS_PLANT_Tp_oPCAN_RADAR_68155c61_Rx
            CanTpTxFcNPdu_8e11574f (CanTpTxFcNPdu): CanTpTxFcNPduRef=PCAN_DIAG_RESP_PHYS_PLANT_Tp_oPCAN_RADAR_bd11d57f_Tx
          CanTpTxNSdu_e3788fc6 (CanTpTxNSdu):
            CanTpTxAddressingFormat = CANTP_STANDARD
            CanTpTxDl = 64
            CanTpTxTaType = CANTP_CANFD_PHYSICAL
            CanTpTxNSduRef = EcucPduCollection/PCAN_DIAG_RESP_PHYS_PLANT_oPCAN_RADAR_cfac777e_Tx
            CanTpRxFcNPdu_aceb83bd (CanTpRxFcNPdu): CanTpRxFcNPduRef=PCAN_DIAG_REQ_PHYS_PLANT_Tp_oPCAN_RADAR_68155c61_Rx
            CanTpTxNPdu_aceb83bd (CanTpTxNPdu): CanTpTxNPduRef=PCAN_DIAG_RESP_PHYS_PLANT_Tp_oPCAN_RADAR_bd11d57f_Tx
        TPCH_28e589b7: variation-point=post-build-variant-condition{matching-criterion=RDR_POS, value=5}
          CanTpRxNSdu_1e2714e5 (CanTpRxNSdu):
            CanTpRxAddressingFormat = CANTP_STANDARD
            CanTpRxDl = 64
            CanTpRxTaType = CANTP_CANFD_PHYSICAL
            CanTpRxNSduRef = EcucPduCollection/PCAN_DIAG_REQ_PHYS_OBD2_oPCAN_RADAR_e03546e9_Rx
            CanTpRxNPdu_cc681870 (CanTpRxNPdu): CanTpRxNPduRef=PCAN_DIAG_REQ_PHYS_OBD2_Tp_oPCAN_RADAR_0ac35777_Rx
            CanTpTxFcNPdu_cc681870 (CanTpTxFcNPdu): CanTpTxFcNPduRef=PCAN_DIAG_RESP_PHYS_OBD2_Tp_oPCAN_RADAR_6e0bad55_Tx
          CanTpTxNSdu_1e2714e5 (CanTpTxNSdu):
            CanTpTxAddressingFormat = CANTP_STANDARD
            CanTpTxDl = 64
            CanTpTxTaType = CANTP_CANFD_PHYSICAL
            CanTpTxNSduRef = EcucPduCollection/PCAN_DIAG_RESP_PHYS_OBD2_oPCAN_RADAR_0c3908eb_Tx
            CanTpRxFcNPdu_ee92cc82 (CanTpRxFcNPdu): CanTpRxFcNPduRef=PCAN_DIAG_REQ_PHYS_OBD2_Tp_oPCAN_RADAR_0ac35777_Rx
            CanTpTxNPdu_ee92cc82 (CanTpTxNPdu): CanTpTxNPduRef=PCAN_DIAG_RESP_PHYS_OBD2_Tp_oPCAN_RADAR_6e0bad55_Tx
        TPCH_2f1f2dd7: variation-point=post-build-variant-condition{matching-criterion=RDR_POS, value=5}
          CanTpRxNSdu_d8e283f4 (CanTpRxNSdu):
            CanTpRxAddressingFormat = CANTP_STANDARD
            CanTpRxDl = 64
            CanTpRxTaType = CANTP_CANFD_FUNCTIONAL
            CanTpRxNSduRef = EcucPduCollection/PCAN_DIAG_REQ_FUNC_OBD2_oPCAN_RADAR_e2bd2c08_Rx
            CanTpRxNPdu_23eeaf8e (CanTpRxNPdu): CanTpRxNPduRef=PCAN_DIAG_REQ_FUNC_OBD2_Tp_oPCAN_RADAR_de9265dd_Rx
        TPCH_4416a5d8: variation-point=post-build-variant-condition{matching-criterion=RDR_POS, value=5}
          CanTpRxNSdu_b6ad447c (CanTpRxNSdu):
            CanTpRxAddressingFormat = CANTP_STANDARD
            CanTpRxDl = 8
            CanTpRxTaType = CANTP_FUNCTIONAL
            CanTpRxNSduRef = EcucPduCollection/DIAG_REQ_FNC_PLANT_oVCAN_RADAR_42eb2f27_Rx
            CanTpRxNPdu_d837d615 (CanTpRxNPdu): CanTpRxNPduRef=DIAG_REQ_FNC_PLANT_Tp_oVCAN_RADAR_d6304422_Rx
        TPCH_4836f59a: variation-point=post-build-variant-condition{matching-criterion=RDR_POS, value=5}
          CanTpRxNSdu_bcb07df3 (CanTpRxNSdu):
            CanTpRxAddressingFormat = CANTP_STANDARD
            CanTpRxDl = 64
            CanTpRxTaType = CANTP_CANFD_PHYSICAL
            CanTpRxNSduRef = EcucPduCollection/PCAN_DIAG_REQ_PHYS_OTA_oPCAN_RADAR_45eab9fd_Rx
            CanTpRxNPdu_1ed3ddf2 (CanTpRxNPdu): CanTpRxNPduRef=PCAN_DIAG_REQ_PHYS_OTA_Tp_oPCAN_RADAR_94a46e49_Rx
            CanTpTxFcNPdu_1ed3ddf2 (CanTpTxFcNPdu): CanTpTxFcNPduRef=PCAN_DIAG_RESP_PHYS_OTA_Tp_oPCAN_RADAR_37f68c50_Tx
          CanTpTxNSdu_bcb07df3 (CanTpTxNSdu):
            CanTpTxAddressingFormat = CANTP_STANDARD
            CanTpTxDl = 64
            CanTpTxTaType = CANTP_CANFD_PHYSICAL
            CanTpTxNSduRef = EcucPduCollection/PCAN_DIAG_RESP_PHYS_OTA_oPCAN_RADAR_2a569d3c_Tx
            CanTpRxFcNPdu_3c290900 (CanTpRxFcNPdu): CanTpRxFcNPduRef=PCAN_DIAG_REQ_PHYS_OTA_Tp_oPCAN_RADAR_94a46e49_Rx
            CanTpTxNPdu_3c290900 (CanTpTxNPdu): CanTpTxNPduRef=PCAN_DIAG_RESP_PHYS_OTA_Tp_oPCAN_RADAR_37f68c50_Tx
        TPCH_6a081e97: variation-point=post-build-variant-condition{matching-criterion=RDR_POS, value=5}
          CanTpRxNSdu_c912f74f (CanTpRxNSdu):
            CanTpRxAddressingFormat = CANTP_STANDARD
            CanTpRxDl = 8
            CanTpRxTaType = CANTP_PHYSICAL
            CanTpRxNSduRef = EcucPduCollection/FR_DIAG_REQ_PHY_OBD1_oVCAN_RADAR_5445ad08_Rx
            CanTpRxNPdu_2b023a7d (CanTpRxNPdu): CanTpRxNPduRef=FR_DIAG_REQ_PHY_OBD1_Tp_oVCAN_RADAR_ddfa31cf_Rx
            CanTpTxFcNPdu_2b023a7d (CanTpTxFcNPdu): CanTpTxFcNPduRef=FR_DIAG_RES_PHY_OBD1_Tp_oVCAN_RADAR_41a76716_Tx
          CanTpTxNSdu_c912f74f (CanTpTxNSdu):
            CanTpTxAddressingFormat = CANTP_STANDARD
            CanTpTxDl = 8
            CanTpTxTaType = CANTP_PHYSICAL
            CanTpTxNSduRef = EcucPduCollection/FR_DIAG_RES_PHY_OBD1_oVCAN_RADAR_cd47a295_Tx
            CanTpRxFcNPdu_09f8ee8f (CanTpRxFcNPdu): CanTpRxFcNPduRef=FR_DIAG_REQ_PHY_OBD1_Tp_oVCAN_RADAR_ddfa31cf_Rx
            CanTpTxNPdu_09f8ee8f (CanTpTxNPdu): CanTpTxNPduRef=FR_DIAG_RES_PHY_OBD1_Tp_oVCAN_RADAR_41a76716_Tx
        TPCH_6d3fcb1a: variation-point=post-build-variant-condition{matching-criterion=RDR_POS, value=5}
          CanTpRxNSdu_b4077489 (CanTpRxNSdu):
            CanTpRxAddressingFormat = CANTP_STANDARD
            CanTpRxDl = 8
            CanTpRxTaType = CANTP_PHYSICAL
            CanTpRxNSduRef = EcucPduCollection/PCAN_DIAG_REQ_PHYS_OBD1_oPCAN_RADAR_20_f19508d6_Rx
            CanTpRxNPdu_4069e760 (CanTpRxNPdu): CanTpRxNPduRef=PCAN_DIAG_REQ_PHYS_OBD1_Tp_oPCAN_RADAR_20_b6648efa_Rx
            CanTpTxFcNPdu_4069e760 (CanTpTxFcNPdu): CanTpTxFcNPduRef=PCAN_DIAG_RESP_PHYS_OBD1_Tp_oPCAN_RADAR_20_f6415fa5_Tx
          CanTpTxNSdu_b4077489 (CanTpTxNSdu):
            CanTpTxAddressingFormat = CANTP_STANDARD
            CanTpTxDl = 8
            CanTpTxTaType = CANTP_PHYSICAL
            CanTpTxNSduRef = EcucPduCollection/PCAN_DIAG_RESP_PHYS_OBD1_oPCAN_RADAR_20_955df2f4_Tx
            CanTpRxFcNPdu_62933392 (CanTpRxFcNPdu): CanTpRxFcNPduRef=PCAN_DIAG_REQ_PHYS_OBD1_Tp_oPCAN_RADAR_20_b6648efa_Rx
            CanTpTxNPdu_62933392 (CanTpTxNPdu): CanTpTxNPduRef=PCAN_DIAG_RESP_PHYS_OBD1_Tp_oPCAN_RADAR_20_f6415fa5_Tx
        TPCH_76009eaf: variation-point=post-build-variant-condition{matching-criterion=RDR_POS, value=5}
          CanTpRxNSdu_7800f5f8 (CanTpRxNSdu):
            CanTpRxAddressingFormat = CANTP_STANDARD
            CanTpRxDl = 8
            CanTpRxTaType = CANTP_FUNCTIONAL
            CanTpRxNSduRef = EcucPduCollection/PCAN_DIAG_REQ_FUNC_OBD2_oPCAN_RADAR_20_41244182_Rx
            CanTpRxNPdu_f2c3088b (CanTpRxNPdu): CanTpRxNPduRef=PCAN_DIAG_REQ_FUNC_OBD2_Tp_oPCAN_RADAR_20_400c7f70_Rx
        TPCH_87a5cb58: variation-point=post-build-variant-condition{matching-criterion=RDR_POS, value=5}
          CanTpRxNSdu_fb9ea522 (CanTpRxNSdu):
            CanTpRxAddressingFormat = CANTP_STANDARD
            CanTpRxDl = 8
            CanTpRxTaType = CANTP_FUNCTIONAL
            CanTpRxNSduRef = EcucPduCollection/DIAG_REQ_FNC_OBD2_oVCAN_RADAR_254b3790_Rx
            CanTpRxNPdu_58be1a07 (CanTpRxNPdu): CanTpRxNPduRef=DIAG_REQ_FNC_OBD2_Tp_oVCAN_RADAR_42ec9761_Rx
        TPCH_a6ca6284: variation-point=post-build-variant-condition{matching-criterion=RDR_POS, value=5}
          CanTpRxNSdu_bbac6d3d (CanTpRxNSdu):
            CanTpRxAddressingFormat = CANTP_STANDARD
            CanTpRxDl = 64
            CanTpRxTaType = CANTP_CANFD_FUNCTIONAL
            CanTpRxNSduRef = EcucPduCollection/PCAN_DIAG_REQ_FUNC_OBD1_oPCAN_RADAR_b9aa9d1d_Rx
            CanTpRxNPdu_2c024d1e (CanTpRxNPdu): CanTpRxNPduRef=PCAN_DIAG_REQ_FUNC_OBD1_Tp_oPCAN_RADAR_ba721e23_Rx
        TPCH_aacf22d0: variation-point=post-build-variant-condition{matching-criterion=RDR_POS, value=5}
          CanTpRxNSdu_71ff2702 (CanTpRxNSdu):
            CanTpRxAddressingFormat = CANTP_STANDARD
            CanTpRxDl = 8
            CanTpRxTaType = CANTP_PHYSICAL
            CanTpRxNSduRef = EcucPduCollection/PCAN_DIAG_REQ_PHYS_OBD2_oPCAN_RADAR_20_95757328_Rx
            CanTpRxNPdu_b70ae635 (CanTpRxNPdu): CanTpRxNPduRef=PCAN_DIAG_REQ_PHYS_OBD2_Tp_oPCAN_RADAR_20_65ff9201_Rx
            CanTpTxFcNPdu_b70ae635 (CanTpTxFcNPdu): CanTpTxFcNPduRef=PCAN_DIAG_RESP_PHYS_OBD2_Tp_oPCAN_RADAR_20_25da435e_Tx
          CanTpTxNSdu_71ff2702 (CanTpTxNSdu):
            CanTpTxAddressingFormat = CANTP_STANDARD
            CanTpTxDl = 8
            CanTpTxTaType = CANTP_PHYSICAL
            CanTpTxNSduRef = EcucPduCollection/PCAN_DIAG_RESP_PHYS_OBD2_oPCAN_RADAR_20_f1bd890a_Tx
            CanTpRxFcNPdu_95f032c7 (CanTpRxFcNPdu): CanTpRxFcNPduRef=PCAN_DIAG_REQ_PHYS_OBD2_Tp_oPCAN_RADAR_20_65ff9201_Rx
            CanTpTxNPdu_95f032c7 (CanTpTxNPdu): CanTpTxNPduRef=PCAN_DIAG_RESP_PHYS_OBD2_Tp_oPCAN_RADAR_20_25da435e_Tx
        TPCH_af127c8d: variation-point=post-build-variant-condition{matching-criterion=RDR_POS, value=5}
          CanTpRxNSdu_1825ea7b (CanTpRxNSdu):
            CanTpRxAddressingFormat = CANTP_STANDARD
            CanTpRxDl = 8
            CanTpRxTaType = CANTP_PHYSICAL
            CanTpRxNSduRef = EcucPduCollection/FR_DIAG_REQ_PHY_OBD2_oVCAN_RADAR_0f521c1d_Rx
            CanTpRxNPdu_caab25b0 (CanTpRxNPdu): CanTpRxNPduRef=FR_DIAG_REQ_PHY_OBD2_Tp_oVCAN_RADAR_b91a4a31_Rx
            CanTpTxFcNPdu_caab25b0 (CanTpTxFcNPdu): CanTpTxFcNPduRef=FR_DIAG_RES_PHY_OBD2_Tp_oVCAN_RADAR_25471ce8_Tx
          CanTpTxNSdu_1825ea7b (CanTpTxNSdu):
            CanTpTxAddressingFormat = CANTP_STANDARD
            CanTpTxDl = 8
            CanTpTxTaType = CANTP_PHYSICAL
            CanTpTxNSduRef = EcucPduCollection/FR_DIAG_RES_PHY_OBD2_oVCAN_RADAR_96501380_Tx
            CanTpRxFcNPdu_e851f142 (CanTpRxFcNPdu): CanTpRxFcNPduRef=FR_DIAG_REQ_PHY_OBD2_Tp_oVCAN_RADAR_b91a4a31_Rx
            CanTpTxNPdu_e851f142 (CanTpTxNPdu): CanTpTxNPduRef=FR_DIAG_RES_PHY_OBD2_Tp_oVCAN_RADAR_25471ce8_Tx
        TPCH_b66b7a3d: variation-point=post-build-variant-condition{matching-criterion=RDR_POS, value=5}
          CanTpRxNSdu_7019f6f9 (CanTpRxNSdu):
            CanTpRxAddressingFormat = CANTP_STANDARD
            CanTpRxDl = 8
            CanTpRxTaType = CANTP_PHYSICAL
            CanTpRxNSduRef = EcucPduCollection/FR_DIAG_REQ_PHY_OTA_oVCAN_RADAR_9187f4da_Rx
            CanTpRxNPdu_9802bf78 (CanTpRxNPdu): CanTpRxNPduRef=FR_DIAG_REQ_PHY_OTA_Tp_oVCAN_RADAR_4de495d5_Rx
            CanTpTxFcNPdu_9802bf78 (CanTpTxFcNPdu): CanTpTxFcNPduRef=FR_DIAG_RES_PHY_OTA_Tp_oVCAN_RADAR_19b4e511_Tx
          CanTpTxNSdu_7019f6f9 (CanTpTxNSdu):
            CanTpTxAddressingFormat = CANTP_STANDARD
            CanTpTxDl = 8
            CanTpTxTaType = CANTP_PHYSICAL
            CanTpTxNSduRef = EcucPduCollection/FR_DIAG_RES_PHY_OTA_oVCAN_RADAR_9ad9d3d9_Tx
            CanTpRxFcNPdu_baf86b8a (CanTpRxFcNPdu): CanTpRxFcNPduRef=FR_DIAG_REQ_PHY_OTA_Tp_oVCAN_RADAR_4de495d5_Rx
            CanTpTxNPdu_baf86b8a (CanTpTxNPdu): CanTpTxNPduRef=FR_DIAG_RES_PHY_OTA_Tp_oVCAN_RADAR_19b4e511_Tx
        TPCH_b7852b61: variation-point=post-build-variant-condition{matching-criterion=RDR_POS, value=5}
          CanTpRxNSdu_35b990b3 (CanTpRxNSdu):
            CanTpRxAddressingFormat = CANTP_STANDARD
            CanTpRxDl = 64
            CanTpRxTaType = CANTP_CANFD_FUNCTIONAL
            CanTpRxNSduRef = EcucPduCollection/PCAN_DIAG_REQ_FUNC_OTA_oPCAN_RADAR_a013523e_Rx
            CanTpRxNPdu_ab223cd1 (CanTpRxNPdu): CanTpRxNPduRef=PCAN_DIAG_REQ_FUNC_OTA_Tp_oPCAN_RADAR_7ea6262a_Rx
        TPCH_bc52e151: variation-point=post-build-variant-condition{matching-criterion=RDR_POS, value=5}
          CanTpRxNSdu_ff9066e8 (CanTpRxNSdu):
            CanTpRxAddressingFormat = CANTP_STANDARD
            CanTpRxDl = 8
            CanTpRxTaType = CANTP_PHYSICAL
            CanTpRxNSduRef = EcucPduCollection/PCAN_DIAG_REQ_PHYS_OTA_oPCAN_RADAR_20_0b124a16_Rx
            CanTpRxNPdu_74a06159 (CanTpRxNPdu): CanTpRxNPduRef=PCAN_DIAG_REQ_PHYS_OTA_Tp_oPCAN_RADAR_20_96582344_Rx
            CanTpTxFcNPdu_74a06159 (CanTpTxFcNPdu): CanTpTxFcNPduRef=PCAN_DIAG_RESP_PHYS_OTA_Tp_oPCAN_RADAR_20_6c821aae_Tx
          CanTpTxNSdu_ff9066e8 (CanTpTxNSdu):
            CanTpTxAddressingFormat = CANTP_STANDARD
            CanTpTxDl = 8
            CanTpTxTaType = CANTP_PHYSICAL
            CanTpTxNSduRef = EcucPduCollection/PCAN_DIAG_RESP_PHYS_OTA_oPCAN_RADAR_20_a840a80f_Tx
            CanTpRxFcNPdu_565ab5ab (CanTpRxFcNPdu): CanTpRxFcNPduRef=PCAN_DIAG_REQ_PHYS_OTA_Tp_oPCAN_RADAR_20_96582344_Rx
            CanTpTxNPdu_565ab5ab (CanTpTxNPdu): CanTpTxNPduRef=PCAN_DIAG_RESP_PHYS_OTA_Tp_oPCAN_RADAR_20_6c821aae_Tx
        TPCH_bc90b3b7: variation-point=post-build-variant-condition{matching-criterion=RDR_POS, value=5}
          CanTpRxNSdu_70587782 (CanTpRxNSdu):
            CanTpRxAddressingFormat = CANTP_STANDARD
            CanTpRxDl = 8
            CanTpRxTaType = CANTP_FUNCTIONAL
            CanTpRxNSduRef = EcucPduCollection/DIAG_REQ_FNC_OBD1_oVCAN_RADAR_7e5c8685_Rx
            CanTpRxNPdu_1d379936 (CanTpRxNPdu): CanTpRxNPduRef=DIAG_REQ_FNC_OBD1_Tp_oVCAN_RADAR_260cec9f_Rx
        TPCH_d23f3afe: variation-point=post-build-variant-condition{matching-criterion=RDR_POS, value=5}
          CanTpRxNSdu_d8dde2ce (CanTpRxNSdu):
            CanTpRxAddressingFormat = CANTP_STANDARD
            CanTpRxDl = 8
            CanTpRxTaType = CANTP_FUNCTIONAL
            CanTpRxNSduRef = EcucPduCollection/PCAN_DIAG_REQ_FUNC_OTA_oPCAN_RADAR_20_e1100275_Rx
            CanTpRxNPdu_277f419b (CanTpRxNPdu): CanTpRxNPduRef=PCAN_DIAG_REQ_FUNC_OTA_Tp_oPCAN_RADAR_20_0a67f2f6_Rx
        TPCH_d29efaa0: variation-point=post-build-variant-condition{matching-criterion=RDR_POS, value=5}
          CanTpRxNSdu_96757754 (CanTpRxNSdu):
            CanTpRxAddressingFormat = CANTP_STANDARD
            CanTpRxDl = 64
            CanTpRxTaType = CANTP_CANFD_FUNCTIONAL
            CanTpRxNSduRef = EcucPduCollection/PCAN_DIAG_REQ_FUNC_PLANT_oPCAN_RADAR_f6414098_Rx
            CanTpRxNPdu_af00b3fb (CanTpRxNPdu): CanTpRxNPduRef=PCAN_DIAG_REQ_FUNC_PLANT_Tp_oPCAN_RADAR_5ec247a5_Rx
        TPCH_e10a6db1: variation-point=post-build-variant-condition{matching-criterion=RDR_POS, value=5}
          CanTpRxNSdu_28543443 (CanTpRxNSdu):
            CanTpRxAddressingFormat = CANTP_STANDARD
            CanTpRxDl = 8
            CanTpRxTaType = CANTP_FUNCTIONAL
            CanTpRxNSduRef = EcucPduCollection/DIAG_REQ_FNC_OTA_oVCAN_RADAR_e787ed21_Rx
            CanTpRxNPdu_55314ea3 (CanTpRxNPdu): CanTpRxNPduRef=DIAG_REQ_FNC_OTA_Tp_oVCAN_RADAR_6f75a08a_Rx
        TPCH_f522a01e: variation-point=post-build-variant-condition{matching-criterion=RDR_POS, value=5}
          CanTpRxNSdu_a01029ae (CanTpRxNSdu):
            CanTpRxAddressingFormat = CANTP_STANDARD
            CanTpRxDl = 64
            CanTpRxTaType = CANTP_CANFD_PHYSICAL
            CanTpRxNSduRef = EcucPduCollection/PCAN_DIAG_REQ_PHYS_OBD1_oPCAN_RADAR_bb22f7fc_Rx
            CanTpRxNPdu_9440c6c7 (CanTpRxNPdu): CanTpRxNPduRef=PCAN_DIAG_REQ_PHYS_OBD1_Tp_oPCAN_RADAR_6e232c89_Rx
            CanTpTxFcNPdu_9440c6c7 (CanTpTxFcNPdu): CanTpTxFcNPduRef=PCAN_DIAG_RESP_PHYS_OBD1_Tp_oPCAN_RADAR_0aebd6ab_Tx
          CanTpTxNSdu_a01029ae (CanTpTxNSdu):
            CanTpTxAddressingFormat = CANTP_STANDARD
            CanTpTxDl = 64
            CanTpTxTaType = CANTP_CANFD_PHYSICAL
            CanTpTxNSduRef = EcucPduCollection/PCAN_DIAG_RESP_PHYS_OBD1_oPCAN_RADAR_572eb9fe_Tx
            CanTpRxFcNPdu_b6ba1235 (CanTpRxFcNPdu): CanTpRxFcNPduRef=PCAN_DIAG_REQ_PHYS_OBD1_Tp_oPCAN_RADAR_6e232c89_Rx
            CanTpTxNPdu_b6ba1235 (CanTpTxNPdu): CanTpTxNPduRef=PCAN_DIAG_RESP_PHYS_OBD1_Tp_oPCAN_RADAR_0aebd6ab_Tx
        TPCH_feadb337: variation-point=post-build-variant-condition{matching-criterion=RDR_POS, value=5}
          CanTpRxNSdu_192cc3c6 (CanTpRxNSdu):
            CanTpRxAddressingFormat = CANTP_STANDARD
            CanTpRxDl = 8
            CanTpRxTaType = CANTP_FUNCTIONAL
            CanTpRxNSduRef = EcucPduCollection/PCAN_DIAG_REQ_FUNC_PLANT_oPCAN_RADAR_20_c17463fa_Rx
            CanTpRxNPdu_b6120ed7 (CanTpRxNPdu): CanTpRxNPduRef=PCAN_DIAG_REQ_FUNC_PLANT_Tp_oPCAN_RADAR_20_d63751cc_Rx
        TPCH_1c008737: variation-point=post-build-variant-condition{matching-criterion=RDR_POS, value=6}
          CanTpRxNSdu_8ce7f960 (CanTpRxNSdu):
            CanTpRxAddressingFormat = CANTP_STANDARD
            CanTpRxDl = 8
            CanTpRxTaType = CANTP_FUNCTIONAL
            CanTpRxNSduRef = EcucPduCollection/DIAG_REQ_FNC_OBD2_oVCAN_RADAR_254b3790_Rx
            CanTpRxNPdu_01b31906 (CanTpRxNPdu): CanTpRxNPduRef=DIAG_REQ_FNC_OBD2_Tp_oVCAN_RADAR_42ec9761_Rx
        TPCH_2735ffd8: variation-point=post-build-variant-condition{matching-criterion=RDR_POS, value=6}
          CanTpRxNSdu_b86f24ed (CanTpRxNSdu):
            CanTpRxAddressingFormat = CANTP_STANDARD
            CanTpRxDl = 8
            CanTpRxTaType = CANTP_FUNCTIONAL
            CanTpRxNSduRef = EcucPduCollection/DIAG_REQ_FNC_OBD1_oVCAN_RADAR_7e5c8685_Rx
            CanTpRxNPdu_a3c8ef02 (CanTpRxNPdu): CanTpRxNPduRef=DIAG_REQ_FNC_OBD1_Tp_oVCAN_RADAR_260cec9f_Rx
        TPCH_2d51cedc: variation-point=post-build-variant-condition{matching-criterion=RDR_POS, value=6}
          CanTpRxNSdu_40aa540d (CanTpRxNSdu):
            CanTpRxAddressingFormat = CANTP_STANDARD
            CanTpRxDl = 64
            CanTpRxTaType = CANTP_CANFD_PHYSICAL
            CanTpRxNSduRef = EcucPduCollection/PCAN_DIAG_REQ_PHYS_OTA_oPCAN_RADAR_45eab9fd_Rx
            CanTpRxNPdu_fd47e566 (CanTpRxNPdu): CanTpRxNPduRef=PCAN_DIAG_REQ_PHYS_OTA_Tp_oPCAN_RADAR_94a46e49_Rx
            CanTpTxFcNPdu_fd47e566 (CanTpTxFcNPdu): CanTpTxFcNPduRef=PCAN_DIAG_RESP_PHYS_OTA_Tp_oPCAN_RADAR_37f68c50_Tx
          CanTpTxNSdu_40aa540d (CanTpTxNSdu):
            CanTpTxAddressingFormat = CANTP_STANDARD
            CanTpTxDl = 64
            CanTpTxTaType = CANTP_CANFD_PHYSICAL
            CanTpTxNSduRef = EcucPduCollection/PCAN_DIAG_RESP_PHYS_OTA_oPCAN_RADAR_2a569d3c_Tx
            CanTpRxFcNPdu_dfbd3194 (CanTpRxFcNPdu): CanTpRxFcNPduRef=PCAN_DIAG_REQ_PHYS_OTA_Tp_oPCAN_RADAR_94a46e49_Rx
            CanTpTxNPdu_dfbd3194 (CanTpTxNPdu): CanTpTxNPduRef=PCAN_DIAG_RESP_PHYS_OTA_Tp_oPCAN_RADAR_37f68c50_Tx
        TPCH_38374917: variation-point=post-build-variant-condition{matching-criterion=RDR_POS, value=6}
          CanTpRxNSdu_a9da1dde (CanTpRxNSdu):
            CanTpRxAddressingFormat = CANTP_STANDARD
            CanTpRxDl = 64
            CanTpRxTaType = CANTP_CANFD_FUNCTIONAL
            CanTpRxNSduRef = EcucPduCollection/PCAN_DIAG_REQ_FUNC_OBD2_oPCAN_RADAR_e2bd2c08_Rx
            CanTpRxNPdu_9d5b4730 (CanTpRxNPdu): CanTpRxNPduRef=PCAN_DIAG_REQ_FUNC_OBD2_Tp_oPCAN_RADAR_de9265dd_Rx
        TPCH_40d017b3: variation-point=post-build-variant-condition{matching-criterion=RDR_POS, value=6}
          CanTpRxNSdu_98e0a949 (CanTpRxNSdu):
            CanTpRxAddressingFormat = CANTP_STANDARD
            CanTpRxDl = 8
            CanTpRxTaType = CANTP_PHYSICAL
            CanTpRxNSduRef = EcucPduCollection/FR_DIAG_REQ_PHY_OBD2_oVCAN_RADAR_0f521c1d_Rx
            CanTpRxNPdu_1f3d3e0c (CanTpRxNPdu): CanTpRxNPduRef=FR_DIAG_REQ_PHY_OBD2_Tp_oVCAN_RADAR_b91a4a31_Rx
            CanTpTxFcNPdu_1f3d3e0c (CanTpTxFcNPdu): CanTpTxFcNPduRef=FR_DIAG_RES_PHY_OBD2_Tp_oVCAN_RADAR_25471ce8_Tx
          CanTpTxNSdu_98e0a949 (CanTpTxNSdu):
            CanTpTxAddressingFormat = CANTP_STANDARD
            CanTpTxDl = 8
            CanTpTxTaType = CANTP_PHYSICAL
            CanTpTxNSduRef = EcucPduCollection/FR_DIAG_RES_PHY_OBD2_oVCAN_RADAR_96501380_Tx
            CanTpRxFcNPdu_3dc7eafe (CanTpRxFcNPdu): CanTpRxFcNPduRef=FR_DIAG_REQ_PHY_OBD2_Tp_oVCAN_RADAR_b91a4a31_Rx
            CanTpTxNPdu_3dc7eafe (CanTpTxNPdu): CanTpTxNPduRef=FR_DIAG_RES_PHY_OBD2_Tp_oVCAN_RADAR_25471ce8_Tx
        TPCH_450d49ee: variation-point=post-build-variant-condition{matching-criterion=RDR_POS, value=6}
          CanTpRxNSdu_605d1a3a (CanTpRxNSdu):
            CanTpRxAddressingFormat = CANTP_STANDARD
            CanTpRxDl = 8
            CanTpRxTaType = CANTP_PHYSICAL
            CanTpRxNSduRef = EcucPduCollection/PCAN_DIAG_REQ_PHYS_OBD2_oPCAN_RADAR_20_95757328_Rx
            CanTpRxNPdu_32a3ebca (CanTpRxNPdu): CanTpRxNPduRef=PCAN_DIAG_REQ_PHYS_OBD2_Tp_oPCAN_RADAR_20_65ff9201_Rx
            CanTpTxFcNPdu_32a3ebca (CanTpTxFcNPdu): CanTpTxFcNPduRef=PCAN_DIAG_RESP_PHYS_OBD2_Tp_oPCAN_RADAR_20_25da435e_Tx
          CanTpTxNSdu_605d1a3a (CanTpTxNSdu):
            CanTpTxAddressingFormat = CANTP_STANDARD
            CanTpTxDl = 8
            CanTpTxTaType = CANTP_PHYSICAL
            CanTpTxNSduRef = EcucPduCollection/PCAN_DIAG_RESP_PHYS_OBD2_oPCAN_RADAR_20_f1bd890a_Tx
            CanTpRxFcNPdu_10593f38 (CanTpRxFcNPdu): CanTpRxFcNPduRef=PCAN_DIAG_REQ_PHYS_OBD2_Tp_oPCAN_RADAR_20_65ff9201_Rx
            CanTpTxNPdu_10593f38 (CanTpTxNPdu): CanTpTxNPduRef=PCAN_DIAG_RESP_PHYS_OBD2_Tp_oPCAN_RADAR_20_25da435e_Tx
        TPCH_499a7691: variation-point=post-build-variant-condition{matching-criterion=RDR_POS, value=6}
          CanTpRxNSdu_2bf3c190 (CanTpRxNSdu):
            CanTpRxAddressingFormat = CANTP_STANDARD
            CanTpRxDl = 8
            CanTpRxTaType = CANTP_FUNCTIONAL
            CanTpRxNSduRef = EcucPduCollection/PCAN_DIAG_REQ_FUNC_OTA_oPCAN_RADAR_20_e1100275_Rx
            CanTpRxNPdu_6ef3cf96 (CanTpRxNPdu): CanTpRxNPduRef=PCAN_DIAG_REQ_FUNC_OTA_Tp_oPCAN_RADAR_20_0a67f2f6_Rx
        TPCH_4d82b2f1: variation-point=post-build-variant-condition{matching-criterion=RDR_POS, value=6}
          CanTpRxNSdu_1be7398e (CanTpRxNSdu):
            CanTpRxAddressingFormat = CANTP_STANDARD
            CanTpRxDl = 64
            CanTpRxTaType = CANTP_CANFD_PHYSICAL
            CanTpRxNSduRef = EcucPduCollection/PCAN_DIAG_REQ_PHYS_OBD2_oPCAN_RADAR_e03546e9_Rx
            CanTpRxNPdu_7c60d701 (CanTpRxNPdu): CanTpRxNPduRef=PCAN_DIAG_REQ_PHYS_OBD2_Tp_oPCAN_RADAR_0ac35777_Rx
            CanTpTxFcNPdu_7c60d701 (CanTpTxFcNPdu): CanTpTxFcNPduRef=PCAN_DIAG_RESP_PHYS_OBD2_Tp_oPCAN_RADAR_6e0bad55_Tx
          CanTpTxNSdu_1be7398e (CanTpTxNSdu):
            CanTpTxAddressingFormat = CANTP_STANDARD
            CanTpTxDl = 64
            CanTpTxTaType = CANTP_CANFD_PHYSICAL
            CanTpTxNSduRef = EcucPduCollection/PCAN_DIAG_RESP_PHYS_OBD2_oPCAN_RADAR_0c3908eb_Tx
            CanTpRxFcNPdu_5e9a03f3 (CanTpRxFcNPdu): CanTpRxFcNPduRef=PCAN_DIAG_REQ_PHYS_OBD2_Tp_oPCAN_RADAR_0ac35777_Rx
            CanTpTxNPdu_5e9a03f3 (CanTpTxNPdu): CanTpTxNPduRef=PCAN_DIAG_RESP_PHYS_OBD2_Tp_oPCAN_RADAR_6e0bad55_Tx
        TPCH_53908a6f: variation-point=post-build-variant-condition{matching-criterion=RDR_POS, value=6}
          CanTpRxNSdu_055d88c0 (CanTpRxNSdu):
            CanTpRxAddressingFormat = CANTP_STANDARD
            CanTpRxDl = 8
            CanTpRxTaType = CANTP_PHYSICAL
            CanTpRxNSduRef = EcucPduCollection/PCAN_DIAG_REQ_PHYS_OTA_oPCAN_RADAR_20_0b124a16_Rx
            CanTpRxNPdu_87c67036 (CanTpRxNPdu): CanTpRxNPduRef=PCAN_DIAG_REQ_PHYS_OTA_Tp_oPCAN_RADAR_20_96582344_Rx
            CanTpTxFcNPdu_87c67036 (CanTpTxFcNPdu): CanTpTxFcNPduRef=PCAN_DIAG_RESP_PHYS_OTA_Tp_oPCAN_RADAR_20_6c821aae_Tx
          CanTpTxNSdu_055d88c0 (CanTpTxNSdu):
            CanTpTxAddressingFormat = CANTP_STANDARD
            CanTpTxDl = 8
            CanTpTxTaType = CANTP_PHYSICAL
            CanTpTxNSduRef = EcucPduCollection/PCAN_DIAG_RESP_PHYS_OTA_oPCAN_RADAR_20_a840a80f_Tx
            CanTpRxFcNPdu_a53ca4c4 (CanTpRxFcNPdu): CanTpRxFcNPduRef=PCAN_DIAG_REQ_PHYS_OTA_Tp_oPCAN_RADAR_20_96582344_Rx
            CanTpTxNPdu_a53ca4c4 (CanTpTxNPdu): CanTpTxNPduRef=PCAN_DIAG_RESP_PHYS_OTA_Tp_oPCAN_RADAR_20_6c821aae_Tx
        TPCH_59a91103: variation-point=post-build-variant-condition{matching-criterion=RDR_POS, value=6}
          CanTpRxNSdu_100f5ca2 (CanTpRxNSdu):
            CanTpRxAddressingFormat = CANTP_STANDARD
            CanTpRxDl = 8
            CanTpRxTaType = CANTP_PHYSICAL
            CanTpRxNSduRef = EcucPduCollection/FR_DIAG_REQ_PHY_OTA_oVCAN_RADAR_9187f4da_Rx
            CanTpRxNPdu_ea8aa2c0 (CanTpRxNPdu): CanTpRxNPduRef=FR_DIAG_REQ_PHY_OTA_Tp_oVCAN_RADAR_4de495d5_Rx
            CanTpTxFcNPdu_ea8aa2c0 (CanTpTxFcNPdu): CanTpTxFcNPduRef=FR_DIAG_RES_PHY_OTA_Tp_oVCAN_RADAR_19b4e511_Tx
          CanTpTxNSdu_100f5ca2 (CanTpTxNSdu):
            CanTpTxAddressingFormat = CANTP_STANDARD
            CanTpTxDl = 8
            CanTpTxTaType = CANTP_PHYSICAL
            CanTpTxNSduRef = EcucPduCollection/FR_DIAG_RES_PHY_OTA_oVCAN_RADAR_9ad9d3d9_Tx
            CanTpRxFcNPdu_c8707632 (CanTpRxFcNPdu): CanTpRxFcNPduRef=FR_DIAG_REQ_PHY_OTA_Tp_oVCAN_RADAR_4de495d5_Rx
            CanTpTxNPdu_c8707632 (CanTpTxNPdu): CanTpTxNPduRef=FR_DIAG_RES_PHY_OTA_Tp_oVCAN_RADAR_19b4e511_Tx
        TPCH_6508ff58: variation-point=post-build-variant-condition{matching-criterion=RDR_POS, value=6}
          CanTpRxNSdu_761ee134 (CanTpRxNSdu):
            CanTpRxAddressingFormat = CANTP_STANDARD
            CanTpRxDl = 8
            CanTpRxTaType = CANTP_FUNCTIONAL
            CanTpRxNSduRef = EcucPduCollection/PCAN_DIAG_REQ_FUNC_PLANT_oPCAN_RADAR_20_c17463fa_Rx
            CanTpRxNPdu_83f5a036 (CanTpRxNPdu): CanTpRxNPduRef=PCAN_DIAG_REQ_FUNC_PLANT_Tp_oPCAN_RADAR_20_d63751cc_Rx
        TPCH_7aaf21de: variation-point=post-build-variant-condition{matching-criterion=RDR_POS, value=6}
          CanTpRxNSdu_b639676a (CanTpRxNSdu):
            CanTpRxAddressingFormat = CANTP_STANDARD
            CanTpRxDl = 8
            CanTpRxTaType = CANTP_FUNCTIONAL
            CanTpRxNSduRef = EcucPduCollection/DIAG_REQ_FNC_OTA_oVCAN_RADAR_e787ed21_Rx
            CanTpRxNPdu_6e1fb67f (CanTpRxNPdu): CanTpRxNPduRef=DIAG_REQ_FNC_OTA_Tp_oVCAN_RADAR_6f75a08a_Rx
        TPCH_7e63c92a: variation-point=post-build-variant-condition{matching-criterion=RDR_POS, value=6}
          CanTpRxNSdu_35203c39 (CanTpRxNSdu):
            CanTpRxAddressingFormat = CANTP_STANDARD
            CanTpRxDl = 64
            CanTpRxTaType = CANTP_CANFD_PHYSICAL
            CanTpRxNSduRef = EcucPduCollection/PCAN_DIAG_REQ_PHYS_PLANT_oPCAN_RADAR_214e1a1c_Rx
            CanTpRxNPdu_ee206532 (CanTpRxNPdu): CanTpRxNPduRef=PCAN_DIAG_REQ_PHYS_PLANT_Tp_oPCAN_RADAR_68155c61_Rx
            CanTpTxFcNPdu_ee206532 (CanTpTxFcNPdu): CanTpTxFcNPduRef=PCAN_DIAG_RESP_PHYS_PLANT_Tp_oPCAN_RADAR_bd11d57f_Tx
          CanTpTxNSdu_35203c39 (CanTpTxNSdu):
            CanTpTxAddressingFormat = CANTP_STANDARD
            CanTpTxDl = 64
            CanTpTxTaType = CANTP_CANFD_PHYSICAL
            CanTpTxNSduRef = EcucPduCollection/PCAN_DIAG_RESP_PHYS_PLANT_oPCAN_RADAR_cfac777e_Tx
            CanTpRxFcNPdu_ccdab1c0 (CanTpRxFcNPdu): CanTpRxFcNPduRef=PCAN_DIAG_REQ_PHYS_PLANT_Tp_oPCAN_RADAR_68155c61_Rx
            CanTpTxNPdu_ccdab1c0 (CanTpTxNPdu): CanTpTxNPduRef=PCAN_DIAG_RESP_PHYS_PLANT_Tp_oPCAN_RADAR_bd11d57f_Tx
        TPCH_82fda024: variation-point=post-build-variant-condition{matching-criterion=RDR_POS, value=6}
          CanTpRxNSdu_3216b4ff (CanTpRxNSdu):
            CanTpRxAddressingFormat = CANTP_STANDARD
            CanTpRxDl = 8
            CanTpRxTaType = CANTP_PHYSICAL
            CanTpRxNSduRef = EcucPduCollection/PCAN_DIAG_REQ_PHYS_OBD1_oPCAN_RADAR_20_f19508d6_Rx
            CanTpRxNPdu_8b786657 (CanTpRxNPdu): CanTpRxNPduRef=PCAN_DIAG_REQ_PHYS_OBD1_Tp_oPCAN_RADAR_20_b6648efa_Rx
            CanTpTxFcNPdu_8b786657 (CanTpTxFcNPdu): CanTpTxFcNPduRef=PCAN_DIAG_RESP_PHYS_OBD1_Tp_oPCAN_RADAR_20_f6415fa5_Tx
          CanTpTxNSdu_3216b4ff (CanTpTxNSdu):
            CanTpTxAddressingFormat = CANTP_STANDARD
            CanTpTxDl = 8
            CanTpTxTaType = CANTP_PHYSICAL
            CanTpTxNSduRef = EcucPduCollection/PCAN_DIAG_RESP_PHYS_OBD1_oPCAN_RADAR_20_955df2f4_Tx
            CanTpRxFcNPdu_a982b2a5 (CanTpRxFcNPdu): CanTpRxFcNPduRef=PCAN_DIAG_REQ_PHYS_OBD1_Tp_oPCAN_RADAR_20_b6648efa_Rx
            CanTpTxNPdu_a982b2a5 (CanTpTxNPdu): CanTpTxNPduRef=PCAN_DIAG_RESP_PHYS_OBD1_Tp_oPCAN_RADAR_20_f6415fa5_Tx
        TPCH_85ca75a9: variation-point=post-build-variant-condition{matching-criterion=RDR_POS, value=6}
          CanTpRxNSdu_6816740d (CanTpRxNSdu):
            CanTpRxAddressingFormat = CANTP_STANDARD
            CanTpRxDl = 8
            CanTpRxTaType = CANTP_PHYSICAL
            CanTpRxNSduRef = EcucPduCollection/FR_DIAG_REQ_PHY_OBD1_oVCAN_RADAR_5445ad08_Rx
            CanTpRxNPdu_bfccbcc5 (CanTpRxNPdu): CanTpRxNPduRef=FR_DIAG_REQ_PHY_OBD1_Tp_oVCAN_RADAR_ddfa31cf_Rx
            CanTpTxFcNPdu_bfccbcc5 (CanTpTxFcNPdu): CanTpTxFcNPduRef=FR_DIAG_RES_PHY_OBD1_Tp_oVCAN_RADAR_41a76716_Tx
          CanTpTxNSdu_6816740d (CanTpTxNSdu):
            CanTpTxAddressingFormat = CANTP_STANDARD
            CanTpTxDl = 8
            CanTpTxTaType = CANTP_PHYSICAL
            CanTpTxNSduRef = EcucPduCollection/FR_DIAG_RES_PHY_OBD1_oVCAN_RADAR_cd47a295_Tx
            CanTpRxFcNPdu_9d366837 (CanTpRxFcNPdu): CanTpRxFcNPduRef=FR_DIAG_REQ_PHY_OBD1_Tp_oVCAN_RADAR_ddfa31cf_Rx
            CanTpTxNPdu_9d366837 (CanTpTxNPdu): CanTpTxNPduRef=FR_DIAG_RES_PHY_OBD1_Tp_oVCAN_RADAR_41a76716_Tx
        TPCH_8c560d9a: variation-point=post-build-variant-condition{matching-criterion=RDR_POS, value=6}
          CanTpRxNSdu_9f8c2215 (CanTpRxNSdu):
            CanTpRxAddressingFormat = CANTP_STANDARD
            CanTpRxDl = 8
            CanTpRxTaType = CANTP_FUNCTIONAL
            CanTpRxNSduRef = EcucPduCollection/PCAN_DIAG_REQ_FUNC_OBD1_oPCAN_RADAR_20_25c43a7c_Rx
            CanTpRxNPdu_b9befcac (CanTpRxNPdu): CanTpRxNPduRef=PCAN_DIAG_REQ_FUNC_OBD1_Tp_oPCAN_RADAR_20_9397638b_Rx
        TPCH_90459b58: variation-point=post-build-variant-condition{matching-criterion=RDR_POS, value=6}
          CanTpRxNSdu_0a60edb0 (CanTpRxNSdu):
            CanTpRxAddressingFormat = CANTP_STANDARD
            CanTpRxDl = 64
            CanTpRxTaType = CANTP_CANFD_PHYSICAL
            CanTpRxNSduRef = EcucPduCollection/PCAN_DIAG_REQ_PHYS_OBD1_oPCAN_RADAR_bb22f7fc_Rx
            CanTpRxNPdu_8650b453 (CanTpRxNPdu): CanTpRxNPduRef=PCAN_DIAG_REQ_PHYS_OBD1_Tp_oPCAN_RADAR_6e232c89_Rx
            CanTpTxFcNPdu_8650b453 (CanTpTxFcNPdu): CanTpTxFcNPduRef=PCAN_DIAG_RESP_PHYS_OBD1_Tp_oPCAN_RADAR_0aebd6ab_Tx
          CanTpTxNSdu_0a60edb0 (CanTpTxNSdu):
            CanTpTxAddressingFormat = CANTP_STANDARD
            CanTpTxDl = 64
            CanTpTxTaType = CANTP_CANFD_PHYSICAL
            CanTpTxNSduRef = EcucPduCollection/PCAN_DIAG_RESP_PHYS_OBD1_oPCAN_RADAR_572eb9fe_Tx
            CanTpRxFcNPdu_a4aa60a1 (CanTpRxFcNPdu): CanTpRxFcNPduRef=PCAN_DIAG_REQ_PHYS_OBD1_Tp_oPCAN_RADAR_6e232c89_Rx
            CanTpTxNPdu_a4aa60a1 (CanTpTxNPdu): CanTpTxNPduRef=PCAN_DIAG_RESP_PHYS_OBD1_Tp_oPCAN_RADAR_0aebd6ab_Tx
        TPCH_a0ad4fa1: variation-point=post-build-variant-condition{matching-criterion=RDR_POS, value=6}
          CanTpRxNSdu_87fb2a09 (CanTpRxNSdu):
            CanTpRxAddressingFormat = CANTP_STANDARD
            CanTpRxDl = 64
            CanTpRxTaType = CANTP_CANFD_FUNCTIONAL
            CanTpRxNSduRef = EcucPduCollection/PCAN_DIAG_REQ_FUNC_OTA_oPCAN_RADAR_a013523e_Rx
            CanTpRxNPdu_6f33a27f (CanTpRxNPdu): CanTpRxNPduRef=PCAN_DIAG_REQ_FUNC_OTA_Tp_oPCAN_RADAR_7ea6262a_Rx
        TPCH_b1e20644: variation-point=post-build-variant-condition{matching-criterion=RDR_POS, value=6}
          CanTpRxNSdu_d7b9ba5a (CanTpRxNSdu):
            CanTpRxAddressingFormat = CANTP_STANDARD
            CanTpRxDl = 64
            CanTpRxTaType = CANTP_CANFD_FUNCTIONAL
            CanTpRxNSduRef = EcucPduCollection/PCAN_DIAG_REQ_FUNC_OBD1_oPCAN_RADAR_b9aa9d1d_Rx
            CanTpRxNPdu_889c2a4d (CanTpRxNPdu): CanTpRxNPduRef=PCAN_DIAG_REQ_FUNC_OBD1_Tp_oPCAN_RADAR_ba721e23_Rx
        TPCH_c5b69e60: variation-point=post-build-variant-condition{matching-criterion=RDR_POS, value=6}
          CanTpRxNSdu_21707157 (CanTpRxNSdu):
            CanTpRxAddressingFormat = CANTP_STANDARD
            CanTpRxDl = 64
            CanTpRxTaType = CANTP_CANFD_FUNCTIONAL
            CanTpRxNSduRef = EcucPduCollection/PCAN_DIAG_REQ_FUNC_PLANT_oPCAN_RADAR_f6414098_Rx
            CanTpRxNPdu_9fbea91a (CanTpRxNPdu): CanTpRxNPduRef=PCAN_DIAG_REQ_FUNC_PLANT_Tp_oPCAN_RADAR_5ec247a5_Rx
        TPCH_dfb3e9b7: variation-point=post-build-variant-condition{matching-criterion=RDR_POS, value=6}
          CanTpRxNSdu_55a66e29 (CanTpRxNSdu):
            CanTpRxAddressingFormat = CANTP_STANDARD
            CanTpRxDl = 8
            CanTpRxTaType = CANTP_FUNCTIONAL
            CanTpRxNSduRef = EcucPduCollection/DIAG_REQ_FNC_PLANT_oVCAN_RADAR_42eb2f27_Rx
            CanTpRxNPdu_b34f2acd (CanTpRxNPdu): CanTpRxNPduRef=DIAG_REQ_FNC_PLANT_Tp_oVCAN_RADAR_d6304422_Rx
        TPCH_e36ae308: variation-point=post-build-variant-condition{matching-criterion=RDR_POS, value=6}
          CanTpRxNSdu_2888d97c (CanTpRxNSdu):
            CanTpRxAddressingFormat = CANTP_STANDARD
            CanTpRxDl = 8
            CanTpRxTaType = CANTP_PHYSICAL
            CanTpRxNSduRef = EcucPduCollection/PCAN_DIAG_REQ_PHYS_PLANT_oPCAN_RADAR_20_f7a3783e_Rx
            CanTpRxNPdu_74140790 (CanTpRxNPdu): CanTpRxNPduRef=PCAN_DIAG_REQ_PHYS_PLANT_Tp_oPCAN_RADAR_20_f110e38b_Rx
            CanTpTxFcNPdu_74140790 (CanTpTxFcNPdu): CanTpTxFcNPduRef=PCAN_DIAG_RESP_PHYS_PLANT_Tp_oPCAN_RADAR_20_0a848a3f_Tx
          CanTpTxNSdu_2888d97c (CanTpTxNSdu):
            CanTpTxAddressingFormat = CANTP_STANDARD
            CanTpTxDl = 8
            CanTpTxTaType = CANTP_PHYSICAL
            CanTpTxNSduRef = EcucPduCollection/PCAN_DIAG_RESP_PHYS_PLANT_oPCAN_RADAR_20_22a7f120_Tx
            CanTpRxFcNPdu_56eed362 (CanTpRxFcNPdu): CanTpRxFcNPduRef=PCAN_DIAG_REQ_PHYS_PLANT_Tp_oPCAN_RADAR_20_f110e38b_Rx
            CanTpTxNPdu_56eed362 (CanTpTxNPdu): CanTpTxNPduRef=PCAN_DIAG_RESP_PHYS_PLANT_Tp_oPCAN_RADAR_20_0a848a3f_Tx
        TPCH_eda5d2c0: variation-point=post-build-variant-condition{matching-criterion=RDR_POS, value=6}
          CanTpRxNSdu_34d1d4f6 (CanTpRxNSdu):
            CanTpRxAddressingFormat = CANTP_STANDARD
            CanTpRxDl = 8
            CanTpRxTaType = CANTP_FUNCTIONAL
            CanTpRxNSduRef = EcucPduCollection/PCAN_DIAG_REQ_FUNC_OBD2_oPCAN_RADAR_20_41244182_Rx
            CanTpRxNPdu_4ebc6152 (CanTpRxNPdu): CanTpRxNPduRef=PCAN_DIAG_REQ_FUNC_OBD2_Tp_oPCAN_RADAR_20_400c7f70_Rx
        TPCH_ef08d5b9: variation-point=post-build-variant-condition{matching-criterion=RDR_POS, value=6}
          CanTpRxNSdu_f984455c (CanTpRxNSdu):
            CanTpRxAddressingFormat = CANTP_STANDARD
            CanTpRxDl = 8
            CanTpRxTaType = CANTP_PHYSICAL
            CanTpRxNSduRef = EcucPduCollection/FR_DIAG_REQ_PHY_PLANT_oVCAN_RADAR_d1c8c991_Rx
            CanTpRxNPdu_ccc91718 (CanTpRxNPdu): CanTpRxNPduRef=FR_DIAG_REQ_PHY_PLANT_Tp_oVCAN_RADAR_bda0e30b_Rx
            CanTpTxFcNPdu_ccc91718 (CanTpTxFcNPdu): CanTpTxFcNPduRef=FR_DIAG_RES_PHY_PLANT_Tp_oVCAN_RADAR_4233d42d_Tx
          CanTpTxNSdu_f984455c (CanTpTxNSdu):
            CanTpTxAddressingFormat = CANTP_STANDARD
            CanTpTxDl = 8
            CanTpTxTaType = CANTP_PHYSICAL
            CanTpTxNSduRef = EcucPduCollection/FR_DIAG_RES_PHY_PLANT_oVCAN_RADAR_5fef2467_Tx
            CanTpRxFcNPdu_ee33c3ea (CanTpRxFcNPdu): CanTpRxFcNPduRef=FR_DIAG_REQ_PHY_PLANT_Tp_oVCAN_RADAR_bda0e30b_Rx
            CanTpTxNPdu_ee33c3ea (CanTpTxNPdu): CanTpTxNPduRef=FR_DIAG_RES_PHY_PLANT_Tp_oVCAN_RADAR_4233d42d_Tx
        TPCH_02fcb90b: variation-point=post-build-variant-condition{matching-criterion=RDR_POS, value=7}
          CanTpRxNSdu_fe897178 (CanTpRxNSdu):
            CanTpRxAddressingFormat = CANTP_STANDARD
            CanTpRxDl = 64
            CanTpRxTaType = CANTP_CANFD_PHYSICAL
            CanTpRxNSduRef = EcucPduCollection/PCAN_DIAG_REQ_PHYS_PLANT_oPCAN_RADAR_214e1a1c_Rx
            CanTpRxNPdu_ecfc16e9 (CanTpRxNPdu): CanTpRxNPduRef=PCAN_DIAG_REQ_PHYS_PLANT_Tp_oPCAN_RADAR_68155c61_Rx
            CanTpTxFcNPdu_ecfc16e9 (CanTpTxFcNPdu): CanTpTxFcNPduRef=PCAN_DIAG_RESP_PHYS_PLANT_Tp_oPCAN_RADAR_bd11d57f_Tx
          CanTpTxNSdu_fe897178 (CanTpTxNSdu):
            CanTpTxAddressingFormat = CANTP_STANDARD
            CanTpTxDl = 64
            CanTpTxTaType = CANTP_CANFD_PHYSICAL
            CanTpTxNSduRef = EcucPduCollection/PCAN_DIAG_RESP_PHYS_PLANT_oPCAN_RADAR_cfac777e_Tx
            CanTpRxFcNPdu_ce06c21b (CanTpRxFcNPdu): CanTpRxFcNPduRef=PCAN_DIAG_REQ_PHYS_PLANT_Tp_oPCAN_RADAR_68155c61_Rx
            CanTpTxNPdu_ce06c21b (CanTpTxNPdu): CanTpTxNPduRef=PCAN_DIAG_RESP_PHYS_PLANT_Tp_oPCAN_RADAR_bd11d57f_Tx
        TPCH_083bbeaf: variation-point=post-build-variant-condition{matching-criterion=RDR_POS, value=7}
          CanTpRxNSdu_fab1e11a (CanTpRxNSdu):
            CanTpRxAddressingFormat = CANTP_STANDARD
            CanTpRxDl = 8
            CanTpRxTaType = CANTP_FUNCTIONAL
            CanTpRxNSduRef = EcucPduCollection/DIAG_REQ_FNC_OTA_oVCAN_RADAR_e787ed21_Rx
            CanTpRxNPdu_9b2ade95 (CanTpRxNPdu): CanTpRxNPduRef=DIAG_REQ_FNC_OTA_Tp_oVCAN_RADAR_6f75a08a_Rx
        TPCH_1261b885: variation-point=post-build-variant-condition{matching-criterion=RDR_POS, value=7}
          CanTpRxNSdu_406ac1d2 (CanTpRxNSdu):
            CanTpRxAddressingFormat = CANTP_STANDARD
            CanTpRxDl = 8
            CanTpRxTaType = CANTP_PHYSICAL
            CanTpRxNSduRef = EcucPduCollection/PCAN_DIAG_REQ_PHYS_PLANT_oPCAN_RADAR_20_f7a3783e_Rx
            CanTpRxNPdu_eeb961d3 (CanTpRxNPdu): CanTpRxNPduRef=PCAN_DIAG_REQ_PHYS_PLANT_Tp_oPCAN_RADAR_20_f110e38b_Rx
            CanTpTxFcNPdu_eeb961d3 (CanTpTxFcNPdu): CanTpTxFcNPduRef=PCAN_DIAG_RESP_PHYS_PLANT_Tp_oPCAN_RADAR_20_0a848a3f_Tx
          CanTpTxNSdu_406ac1d2 (CanTpTxNSdu):
            CanTpTxAddressingFormat = CANTP_STANDARD
            CanTpTxDl = 8
            CanTpTxTaType = CANTP_PHYSICAL
            CanTpTxNSduRef = EcucPduCollection/PCAN_DIAG_RESP_PHYS_PLANT_oPCAN_RADAR_20_22a7f120_Tx
            CanTpRxFcNPdu_cc43b521 (CanTpRxFcNPdu): CanTpRxFcNPduRef=PCAN_DIAG_REQ_PHYS_PLANT_Tp_oPCAN_RADAR_20_f110e38b_Rx
            CanTpTxNPdu_cc43b521 (CanTpTxNPdu): CanTpTxNPduRef=PCAN_DIAG_RESP_PHYS_PLANT_Tp_oPCAN_RADAR_20_0a848a3f_Tx
        TPCH_179c6029: variation-point=post-build-variant-condition{matching-criterion=RDR_POS, value=7}
          CanTpRxNSdu_18f2ade7 (CanTpRxNSdu):
            CanTpRxAddressingFormat = CANTP_STANDARD
            CanTpRxDl = 8
            CanTpRxTaType = CANTP_FUNCTIONAL
            CanTpRxNSduRef = EcucPduCollection/PCAN_DIAG_REQ_FUNC_PLANT_oPCAN_RADAR_20_c17463fa_Rx
            CanTpRxNPdu_e1347c6e (CanTpRxNPdu): CanTpRxNPduRef=PCAN_DIAG_REQ_FUNC_PLANT_Tp_oPCAN_RADAR_20_d63751cc_Rx
        TPCH_192c8620: variation-point=post-build-variant-condition{matching-criterion=RDR_POS, value=7}
          CanTpRxNSdu_bf84955c (CanTpRxNSdu):
            CanTpRxAddressingFormat = CANTP_STANDARD
            CanTpRxDl = 64
            CanTpRxTaType = CANTP_CANFD_FUNCTIONAL
            CanTpRxNSduRef = EcucPduCollection/PCAN_DIAG_REQ_FUNC_PLANT_oPCAN_RADAR_f6414098_Rx
            CanTpRxNPdu_654adf9b (CanTpRxNPdu): CanTpRxNPduRef=PCAN_DIAG_REQ_FUNC_PLANT_Tp_oPCAN_RADAR_5ec247a5_Rx
        TPCH_1e038e34: variation-point=post-build-variant-condition{matching-criterion=RDR_POS, value=7}
          CanTpRxNSdu_5ea61dee (CanTpRxNSdu):
            CanTpRxAddressingFormat = CANTP_STANDARD
            CanTpRxDl = 8
            CanTpRxTaType = CANTP_PHYSICAL
            CanTpRxNSduRef = EcucPduCollection/FR_DIAG_REQ_PHY_PLANT_oVCAN_RADAR_d1c8c991_Rx
            CanTpRxNPdu_a9a1742e (CanTpRxNPdu): CanTpRxNPduRef=FR_DIAG_REQ_PHY_PLANT_Tp_oVCAN_RADAR_bda0e30b_Rx
            CanTpTxFcNPdu_a9a1742e (CanTpTxFcNPdu): CanTpTxFcNPduRef=FR_DIAG_RES_PHY_PLANT_Tp_oVCAN_RADAR_4233d42d_Tx
          CanTpTxNSdu_5ea61dee (CanTpTxNSdu):
            CanTpTxAddressingFormat = CANTP_STANDARD
            CanTpTxDl = 8
            CanTpTxTaType = CANTP_PHYSICAL
            CanTpTxNSduRef = EcucPduCollection/FR_DIAG_RES_PHY_PLANT_oVCAN_RADAR_5fef2467_Tx
            CanTpRxFcNPdu_8b5ba0dc (CanTpRxFcNPdu): CanTpRxFcNPduRef=FR_DIAG_REQ_PHY_PLANT_Tp_oVCAN_RADAR_bda0e30b_Rx
            CanTpTxNPdu_8b5ba0dc (CanTpTxNPdu): CanTpTxNPduRef=FR_DIAG_RES_PHY_PLANT_Tp_oVCAN_RADAR_4233d42d_Tx
        TPCH_311dc2d0: variation-point=post-build-variant-condition{matching-criterion=RDR_POS, value=7}
          CanTpRxNSdu_0d1ea855 (CanTpRxNSdu):
            CanTpRxAddressingFormat = CANTP_STANDARD
            CanTpRxDl = 64
            CanTpRxTaType = CANTP_CANFD_PHYSICAL
            CanTpRxNSduRef = EcucPduCollection/PCAN_DIAG_REQ_PHYS_OBD2_oPCAN_RADAR_e03546e9_Rx
            CanTpRxNPdu_999c2b0a (CanTpRxNPdu): CanTpRxNPduRef=PCAN_DIAG_REQ_PHYS_OBD2_Tp_oPCAN_RADAR_0ac35777_Rx
            CanTpTxFcNPdu_999c2b0a (CanTpTxFcNPdu): CanTpTxFcNPduRef=PCAN_DIAG_RESP_PHYS_OBD2_Tp_oPCAN_RADAR_6e0bad55_Tx
          CanTpTxNSdu_0d1ea855 (CanTpTxNSdu):
            CanTpTxAddressingFormat = CANTP_STANDARD
            CanTpTxDl = 64
            CanTpTxTaType = CANTP_CANFD_PHYSICAL
            CanTpTxNSduRef = EcucPduCollection/PCAN_DIAG_RESP_PHYS_OBD2_oPCAN_RADAR_0c3908eb_Tx
            CanTpRxFcNPdu_bb66fff8 (CanTpRxFcNPdu): CanTpRxFcNPduRef=PCAN_DIAG_REQ_PHYS_OBD2_Tp_oPCAN_RADAR_0ac35777_Rx
            CanTpTxNPdu_bb66fff8 (CanTpTxNPdu): CanTpTxNPduRef=PCAN_DIAG_RESP_PHYS_OBD2_Tp_oPCAN_RADAR_6e0bad55_Tx
        TPCH_3b0ee9e0: variation-point=post-build-variant-condition{matching-criterion=RDR_POS, value=7}
          CanTpRxNSdu_d93a2016 (CanTpRxNSdu):
            CanTpRxAddressingFormat = CANTP_STANDARD
            CanTpRxDl = 8
            CanTpRxTaType = CANTP_FUNCTIONAL
            CanTpRxNSduRef = EcucPduCollection/PCAN_DIAG_REQ_FUNC_OTA_oPCAN_RADAR_20_e1100275_Rx
            CanTpRxNPdu_1fa00345 (CanTpRxNPdu): CanTpRxNPduRef=PCAN_DIAG_REQ_FUNC_OTA_Tp_oPCAN_RADAR_20_0a67f2f6_Rx
        TPCH_51cebefd: variation-point=post-build-variant-condition{matching-criterion=RDR_POS, value=7}
          CanTpRxNSdu_382889a1 (CanTpRxNSdu):
            CanTpRxAddressingFormat = CANTP_STANDARD
            CanTpRxDl = 64
            CanTpRxTaType = CANTP_CANFD_PHYSICAL
            CanTpRxNSduRef = EcucPduCollection/PCAN_DIAG_REQ_PHYS_OTA_oPCAN_RADAR_45eab9fd_Rx
            CanTpRxNPdu_9315ebfa (CanTpRxNPdu): CanTpRxNPduRef=PCAN_DIAG_REQ_PHYS_OTA_Tp_oPCAN_RADAR_94a46e49_Rx
            CanTpTxFcNPdu_9315ebfa (CanTpTxFcNPdu): CanTpTxFcNPduRef=PCAN_DIAG_RESP_PHYS_OTA_Tp_oPCAN_RADAR_37f68c50_Tx
          CanTpTxNSdu_382889a1 (CanTpTxNSdu):
            CanTpTxAddressingFormat = CANTP_STANDARD
            CanTpTxDl = 64
            CanTpTxTaType = CANTP_CANFD_PHYSICAL
            CanTpTxNSduRef = EcucPduCollection/PCAN_DIAG_RESP_PHYS_OTA_oPCAN_RADAR_2a569d3c_Tx
            CanTpRxFcNPdu_b1ef3f08 (CanTpRxFcNPdu): CanTpRxFcNPduRef=PCAN_DIAG_REQ_PHYS_OTA_Tp_oPCAN_RADAR_94a46e49_Rx
            CanTpTxNPdu_b1ef3f08 (CanTpTxNPdu): CanTpTxNPduRef=PCAN_DIAG_RESP_PHYS_OTA_Tp_oPCAN_RADAR_37f68c50_Tx
        TPCH_55a160a9: variation-point=post-build-variant-condition{matching-criterion=RDR_POS, value=7}
          CanTpRxNSdu_38bfaa92 (CanTpRxNSdu):
            CanTpRxAddressingFormat = CANTP_STANDARD
            CanTpRxDl = 8
            CanTpRxTaType = CANTP_FUNCTIONAL
            CanTpRxNSduRef = EcucPduCollection/DIAG_REQ_FNC_OBD1_oVCAN_RADAR_7e5c8685_Rx
            CanTpRxNPdu_f673eb66 (CanTpRxNPdu): CanTpRxNPduRef=DIAG_REQ_FNC_OBD1_Tp_oVCAN_RADAR_260cec9f_Rx
        TPCH_6d781e04: variation-point=post-build-variant-condition{matching-criterion=RDR_POS, value=7}
          CanTpRxNSdu_cee402a3 (CanTpRxNSdu):
            CanTpRxAddressingFormat = CANTP_STANDARD
            CanTpRxDl = 64
            CanTpRxTaType = CANTP_CANFD_FUNCTIONAL
            CanTpRxNSduRef = EcucPduCollection/PCAN_DIAG_REQ_FUNC_OBD1_oPCAN_RADAR_b9aa9d1d_Rx
            CanTpRxNPdu_944dd35d (CanTpRxNPdu): CanTpRxNPduRef=PCAN_DIAG_REQ_FUNC_OBD1_Tp_oPCAN_RADAR_ba721e23_Rx
        TPCH_6e941846: variation-point=post-build-variant-condition{matching-criterion=RDR_POS, value=7}
          CanTpRxNSdu_796f9cad (CanTpRxNSdu):
            CanTpRxAddressingFormat = CANTP_STANDARD
            CanTpRxDl = 8
            CanTpRxTaType = CANTP_FUNCTIONAL
            CanTpRxNSduRef = EcucPduCollection/DIAG_REQ_FNC_OBD2_oVCAN_RADAR_254b3790_Rx
            CanTpRxNPdu_c1a26365 (CanTpRxNPdu): CanTpRxNPduRef=DIAG_REQ_FNC_OBD2_Tp_oVCAN_RADAR_42ec9761_Rx
        TPCH_73f6fba9: variation-point=post-build-variant-condition{matching-criterion=RDR_POS, value=7}
          CanTpRxNSdu_125a8101 (CanTpRxNSdu):
            CanTpRxAddressingFormat = CANTP_STANDARD
            CanTpRxDl = 8
            CanTpRxTaType = CANTP_PHYSICAL
            CanTpRxNSduRef = EcucPduCollection/PCAN_DIAG_REQ_PHYS_OBD1_oPCAN_RADAR_20_f19508d6_Rx
            CanTpRxNPdu_8beca7d7 (CanTpRxNPdu): CanTpRxNPduRef=PCAN_DIAG_REQ_PHYS_OBD1_Tp_oPCAN_RADAR_20_b6648efa_Rx
            CanTpTxFcNPdu_8beca7d7 (CanTpTxFcNPdu): CanTpTxFcNPduRef=PCAN_DIAG_RESP_PHYS_OBD1_Tp_oPCAN_RADAR_20_f6415fa5_Tx
          CanTpTxNSdu_125a8101 (CanTpTxNSdu):
            CanTpTxAddressingFormat = CANTP_STANDARD
            CanTpTxDl = 8
            CanTpTxTaType = CANTP_PHYSICAL
            CanTpTxNSduRef = EcucPduCollection/PCAN_DIAG_RESP_PHYS_OBD1_oPCAN_RADAR_20_955df2f4_Tx
            CanTpRxFcNPdu_a9167325 (CanTpRxFcNPdu): CanTpRxFcNPduRef=PCAN_DIAG_REQ_PHYS_OBD1_Tp_oPCAN_RADAR_20_b6648efa_Rx
            CanTpTxNPdu_a9167325 (CanTpTxNPdu): CanTpTxNPduRef=PCAN_DIAG_RESP_PHYS_OBD1_Tp_oPCAN_RADAR_20_f6415fa5_Tx
        TPCH_74c12e24: variation-point=post-build-variant-condition{matching-criterion=RDR_POS, value=7}
          CanTpRxNSdu_9b170e76 (CanTpRxNSdu):
            CanTpRxAddressingFormat = CANTP_STANDARD
            CanTpRxDl = 8
            CanTpRxTaType = CANTP_PHYSICAL
            CanTpRxNSduRef = EcucPduCollection/FR_DIAG_REQ_PHY_OBD1_oVCAN_RADAR_5445ad08_Rx
            CanTpRxNPdu_5235cea4 (CanTpRxNPdu): CanTpRxNPduRef=FR_DIAG_REQ_PHY_OBD1_Tp_oVCAN_RADAR_ddfa31cf_Rx
            CanTpTxFcNPdu_5235cea4 (CanTpTxFcNPdu): CanTpTxFcNPduRef=FR_DIAG_RES_PHY_OBD1_Tp_oVCAN_RADAR_41a76716_Tx
          CanTpTxNSdu_9b170e76 (CanTpTxNSdu):
            CanTpTxAddressingFormat = CANTP_STANDARD
            CanTpTxDl = 8
            CanTpTxTaType = CANTP_PHYSICAL
            CanTpTxNSduRef = EcucPduCollection/FR_DIAG_RES_PHY_OBD1_oVCAN_RADAR_cd47a295_Tx
            CanTpRxFcNPdu_70cf1a56 (CanTpRxFcNPdu): CanTpRxFcNPduRef=FR_DIAG_REQ_PHY_OBD1_Tp_oVCAN_RADAR_ddfa31cf_Rx
            CanTpTxNPdu_70cf1a56 (CanTpTxNPdu): CanTpTxNPduRef=FR_DIAG_RES_PHY_OBD1_Tp_oVCAN_RADAR_41a76716_Tx
        TPCH_7c3757e1: variation-point=post-build-variant-condition{matching-criterion=RDR_POS, value=7}
          CanTpRxNSdu_89d4d963 (CanTpRxNSdu):
            CanTpRxAddressingFormat = CANTP_STANDARD
            CanTpRxDl = 64
            CanTpRxTaType = CANTP_CANFD_FUNCTIONAL
            CanTpRxNSduRef = EcucPduCollection/PCAN_DIAG_REQ_FUNC_OTA_oPCAN_RADAR_a013523e_Rx
            CanTpRxNPdu_2a62e703 (CanTpRxNPdu): CanTpRxNPduRef=PCAN_DIAG_REQ_FUNC_OTA_Tp_oPCAN_RADAR_7ea6262a_Rx
        TPCH_9f314db1: variation-point=post-build-variant-condition{matching-criterion=RDR_POS, value=7}
          CanTpRxNSdu_d821701d (CanTpRxNSdu):
            CanTpRxAddressingFormat = CANTP_STANDARD
            CanTpRxDl = 8
            CanTpRxTaType = CANTP_FUNCTIONAL
            CanTpRxNSduRef = EcucPduCollection/PCAN_DIAG_REQ_FUNC_OBD2_oPCAN_RADAR_20_41244182_Rx
            CanTpRxNPdu_25164214 (CanTpRxNPdu): CanTpRxNPduRef=PCAN_DIAG_REQ_FUNC_OBD2_Tp_oPCAN_RADAR_20_400c7f70_Rx
        TPCH_a29bd1e2: variation-point=post-build-variant-condition{matching-criterion=RDR_POS, value=7}
          CanTpRxNSdu_2062e733 (CanTpRxNSdu):
            CanTpRxAddressingFormat = CANTP_STANDARD
            CanTpRxDl = 8
            CanTpRxTaType = CANTP_PHYSICAL
            CanTpRxNSduRef = EcucPduCollection/PCAN_DIAG_REQ_PHYS_OTA_oPCAN_RADAR_20_0b124a16_Rx
            CanTpRxNPdu_4a8b6b3b (CanTpRxNPdu): CanTpRxNPduRef=PCAN_DIAG_REQ_PHYS_OTA_Tp_oPCAN_RADAR_20_96582344_Rx
            CanTpTxFcNPdu_4a8b6b3b (CanTpTxFcNPdu): CanTpTxFcNPduRef=PCAN_DIAG_RESP_PHYS_OTA_Tp_oPCAN_RADAR_20_6c821aae_Tx
          CanTpTxNSdu_2062e733 (CanTpTxNSdu):
            CanTpTxAddressingFormat = CANTP_STANDARD
            CanTpTxDl = 8
            CanTpTxTaType = CANTP_PHYSICAL
            CanTpTxNSduRef = EcucPduCollection/PCAN_DIAG_RESP_PHYS_OTA_oPCAN_RADAR_20_a840a80f_Tx
            CanTpRxFcNPdu_6871bfc9 (CanTpRxFcNPdu): CanTpRxFcNPduRef=PCAN_DIAG_REQ_PHYS_OTA_Tp_oPCAN_RADAR_20_96582344_Rx
            CanTpTxNPdu_6871bfc9 (CanTpTxNPdu): CanTpTxNPduRef=PCAN_DIAG_RESP_PHYS_OTA_Tp_oPCAN_RADAR_20_6c821aae_Tx
        TPCH_a8a24a8e: variation-point=post-build-variant-condition{matching-criterion=RDR_POS, value=7}
          CanTpRxNSdu_01773b70 (CanTpRxNSdu):
            CanTpRxAddressingFormat = CANTP_STANDARD
            CanTpRxDl = 8
            CanTpRxTaType = CANTP_PHYSICAL
            CanTpRxNSduRef = EcucPduCollection/FR_DIAG_REQ_PHY_OTA_oVCAN_RADAR_9187f4da_Rx
            CanTpRxNPdu_a9cb123b (CanTpRxNPdu): CanTpRxNPduRef=FR_DIAG_REQ_PHY_OTA_Tp_oVCAN_RADAR_4de495d5_Rx
            CanTpTxFcNPdu_a9cb123b (CanTpTxFcNPdu): CanTpTxFcNPduRef=FR_DIAG_RES_PHY_OTA_Tp_oVCAN_RADAR_19b4e511_Tx
          CanTpTxNSdu_01773b70 (CanTpTxNSdu):
            CanTpTxAddressingFormat = CANTP_STANDARD
            CanTpTxDl = 8
            CanTpTxTaType = CANTP_PHYSICAL
            CanTpTxNSduRef = EcucPduCollection/FR_DIAG_RES_PHY_OTA_oVCAN_RADAR_9ad9d3d9_Tx
            CanTpRxFcNPdu_8b31c6c9 (CanTpRxFcNPdu): CanTpRxFcNPduRef=FR_DIAG_REQ_PHY_OTA_Tp_oVCAN_RADAR_4de495d5_Rx
            CanTpTxNPdu_8b31c6c9 (CanTpTxNPdu): CanTpTxNPduRef=FR_DIAG_RES_PHY_OTA_Tp_oVCAN_RADAR_19b4e511_Tx
        TPCH_ad2776c6: variation-point=post-build-variant-condition{matching-criterion=RDR_POS, value=7}
          CanTpRxNSdu_77935e90 (CanTpRxNSdu):
            CanTpRxAddressingFormat = CANTP_STANDARD
            CanTpRxDl = 8
            CanTpRxTaType = CANTP_FUNCTIONAL
            CanTpRxNSduRef = EcucPduCollection/DIAG_REQ_FNC_PLANT_oVCAN_RADAR_42eb2f27_Rx
            CanTpRxNPdu_3b063fb4 (CanTpRxNPdu): CanTpRxNPduRef=DIAG_REQ_FNC_PLANT_Tp_oVCAN_RADAR_d6304422_Rx
        TPCH_b1db4c3e: variation-point=post-build-variant-condition{matching-criterion=RDR_POS, value=7}
          CanTpRxNSdu_92ce2a9d (CanTpRxNSdu):
            CanTpRxAddressingFormat = CANTP_STANDARD
            CanTpRxDl = 8
            CanTpRxTaType = CANTP_PHYSICAL
            CanTpRxNSduRef = EcucPduCollection/FR_DIAG_REQ_PHY_OBD2_oVCAN_RADAR_0f521c1d_Rx
            CanTpRxNPdu_7def204a (CanTpRxNPdu): CanTpRxNPduRef=FR_DIAG_REQ_PHY_OBD2_Tp_oVCAN_RADAR_b91a4a31_Rx
            CanTpTxFcNPdu_7def204a (CanTpTxFcNPdu): CanTpTxFcNPduRef=FR_DIAG_RES_PHY_OBD2_Tp_oVCAN_RADAR_25471ce8_Tx
          CanTpTxNSdu_92ce2a9d (CanTpTxNSdu):
            CanTpTxAddressingFormat = CANTP_STANDARD
            CanTpTxDl = 8
            CanTpTxTaType = CANTP_PHYSICAL
            CanTpTxNSduRef = EcucPduCollection/FR_DIAG_RES_PHY_OBD2_oVCAN_RADAR_96501380_Tx
            CanTpRxFcNPdu_5f15f4b8 (CanTpRxFcNPdu): CanTpRxFcNPduRef=FR_DIAG_REQ_PHY_OBD2_Tp_oVCAN_RADAR_b91a4a31_Rx
            CanTpTxNPdu_5f15f4b8 (CanTpTxNPdu): CanTpTxNPduRef=FR_DIAG_RES_PHY_OBD2_Tp_oVCAN_RADAR_25471ce8_Tx
        TPCH_b4061263: variation-point=post-build-variant-condition{matching-criterion=RDR_POS, value=7}
          CanTpRxNSdu_3fa592e1 (CanTpRxNSdu):
            CanTpRxAddressingFormat = CANTP_STANDARD
            CanTpRxDl = 8
            CanTpRxTaType = CANTP_PHYSICAL
            CanTpRxNSduRef = EcucPduCollection/PCAN_DIAG_REQ_PHYS_OBD2_oPCAN_RADAR_20_95757328_Rx
            CanTpRxNPdu_28b1b5df (CanTpRxNPdu): CanTpRxNPduRef=PCAN_DIAG_REQ_PHYS_OBD2_Tp_oPCAN_RADAR_20_65ff9201_Rx
            CanTpTxFcNPdu_28b1b5df (CanTpTxFcNPdu): CanTpTxFcNPduRef=PCAN_DIAG_RESP_PHYS_OBD2_Tp_oPCAN_RADAR_20_25da435e_Tx
          CanTpTxNSdu_3fa592e1 (CanTpTxNSdu):
            CanTpTxAddressingFormat = CANTP_STANDARD
            CanTpTxDl = 8
            CanTpTxTaType = CANTP_PHYSICAL
            CanTpTxNSduRef = EcucPduCollection/PCAN_DIAG_RESP_PHYS_OBD2_oPCAN_RADAR_20_f1bd890a_Tx
            CanTpRxFcNPdu_0a4b612d (CanTpRxFcNPdu): CanTpRxFcNPduRef=PCAN_DIAG_REQ_PHYS_OBD2_Tp_oPCAN_RADAR_20_65ff9201_Rx
            CanTpTxNPdu_0a4b612d (CanTpTxNPdu): CanTpTxNPduRef=PCAN_DIAG_RESP_PHYS_OBD2_Tp_oPCAN_RADAR_20_25da435e_Tx
        TPCH_e4ad5157: variation-point=post-build-variant-condition{matching-criterion=RDR_POS, value=7}
          CanTpRxNSdu_110562d5 (CanTpRxNSdu):
            CanTpRxAddressingFormat = CANTP_STANDARD
            CanTpRxDl = 64
            CanTpRxTaType = CANTP_CANFD_FUNCTIONAL
            CanTpRxNSduRef = EcucPduCollection/PCAN_DIAG_REQ_FUNC_OBD2_oPCAN_RADAR_e2bd2c08_Rx
            CanTpRxNPdu_9f3977a1 (CanTpRxNPdu): CanTpRxNPduRef=PCAN_DIAG_REQ_FUNC_OBD2_Tp_oPCAN_RADAR_de9265dd_Rx
        TPCH_ecdaeb79: variation-point=post-build-variant-condition{matching-criterion=RDR_POS, value=7}
          CanTpRxNSdu_1f237be1 (CanTpRxNSdu):
            CanTpRxAddressingFormat = CANTP_STANDARD
            CanTpRxDl = 64
            CanTpRxTaType = CANTP_CANFD_PHYSICAL
            CanTpRxNSduRef = EcucPduCollection/PCAN_DIAG_REQ_PHYS_OBD1_oPCAN_RADAR_bb22f7fc_Rx
            CanTpRxNPdu_056f526e (CanTpRxNPdu): CanTpRxNPduRef=PCAN_DIAG_REQ_PHYS_OBD1_Tp_oPCAN_RADAR_6e232c89_Rx
            CanTpTxFcNPdu_056f526e (CanTpTxFcNPdu): CanTpTxFcNPduRef=PCAN_DIAG_RESP_PHYS_OBD1_Tp_oPCAN_RADAR_0aebd6ab_Tx
          CanTpTxNSdu_1f237be1 (CanTpTxNSdu):
            CanTpTxAddressingFormat = CANTP_STANDARD
            CanTpTxDl = 64
            CanTpTxTaType = CANTP_CANFD_PHYSICAL
            CanTpTxNSduRef = EcucPduCollection/PCAN_DIAG_RESP_PHYS_OBD1_oPCAN_RADAR_572eb9fe_Tx
            CanTpRxFcNPdu_2795869c (CanTpRxFcNPdu): CanTpRxFcNPduRef=PCAN_DIAG_REQ_PHYS_OBD1_Tp_oPCAN_RADAR_6e232c89_Rx
            CanTpTxNPdu_2795869c (CanTpTxNPdu): CanTpTxNPduRef=PCAN_DIAG_RESP_PHYS_OBD1_Tp_oPCAN_RADAR_0aebd6ab_Tx
        TPCH_fec292eb: variation-point=post-build-variant-condition{matching-criterion=RDR_POS, value=7}
          CanTpRxNSdu_0999e59b (CanTpRxNSdu):
            CanTpRxAddressingFormat = CANTP_STANDARD
            CanTpRxDl = 8
            CanTpRxTaType = CANTP_FUNCTIONAL
            CanTpRxNSduRef = EcucPduCollection/PCAN_DIAG_REQ_FUNC_OBD1_oPCAN_RADAR_20_25c43a7c_Rx
            CanTpRxNPdu_599d72c1 (CanTpRxNPdu): CanTpRxNPduRef=PCAN_DIAG_REQ_FUNC_OBD1_Tp_oPCAN_RADAR_20_9397638b_Rx
  module config Com
    ComConfig
      246 x ComIPdu, all with ComIPduType=NORMAL:
        ADAS_FN_Enable_disable_sts_oVCAN_RADAR_dbe1c88d_Rx: ComIPduDirection=RECEIVE, ComIPduChannelRef=ComMConfigSet/CN_VCAN_RADAR_489180b6, ComIPduGroupRef=RDR01_oVCAN_RADAR_Rx_BC_7567adec if post-build-variant-condition{matching-criterion=RDR_POS, value=0}, ComIPduSignalGroupRef=SG_ADAS_FN_Enable_disable_sts_oADAS_FN_Enable_disable_sts_oVCAN_RADAR_46faeb96_Rx, ComPduIdRef=EcucPduCollection/ADAS_FN_Enable_disable_sts_oVCAN_RADAR_dbe1c88d_Rx, ComIPduGroupRef=RDR02_oVCAN_RADAR_Rx_BC_d6312b45 if post-build-variant-condition{matching-criterion=RDR_POS, value=1}, ComIPduGroupRef=RDR03_oVCAN_RADAR_Rx_BC_01d3ab1d if post-build-variant-condition{matching-criterion=RDR_POS, value=2}, ComIPduGroupRef=RDR04_oVCAN_RADAR_Rx_BC_4bed2056 if post-build-variant-condition{matching-criterion=RDR_POS, value=3}, ComIPduGroupRef=RDR05_oVCAN_RADAR_Rx_BC_9c0fa00e if post-build-variant-condition{matching-criterion=RDR_POS, value=4}, ComIPduGroupRef=RDR06_oVCAN_RADAR_Rx_BC_3f5926a7 if post-build-variant-condition{matching-criterion=RDR_POS, value=5}, ComIPduGroupRef=RDR07_oVCAN_RADAR_Rx_BC_e8bba6ff if post-build-variant-condition{matching-criterion=RDR_POS, value=6}, ComIPduGroupRef=RDR08_oVCAN_RADAR_Rx_BC_ab243031 if post-build-variant-condition{matching-criterion=RDR_POS, value=7}
        CCVS1_oVCAN_RADAR_7fab2fed_Rx: ComIPduDirection=RECEIVE, ComIPduChannelRef=ComMConfigSet/CN_VCAN_RADAR_489180b6, ComIPduGroupRef=RDR01_oVCAN_RADAR_Rx_BC_7567adec if post-build-variant-condition{matching-criterion=RDR_POS, value=0}, ComIPduSignalGroupRef=SG_CCVS1_oCCVS1_oVCAN_RADAR_1b2d3da2_Rx, ComPduIdRef=EcucPduCollection/CCVS1_oVCAN_RADAR_7fab2fed_Rx, ComIPduGroupRef=RDR02_oVCAN_RADAR_Rx_BC_d6312b45 if post-build-variant-condition{matching-criterion=RDR_POS, value=1}, ComIPduGroupRef=RDR03_oVCAN_RADAR_Rx_BC_01d3ab1d if post-build-variant-condition{matching-criterion=RDR_POS, value=2}, ComIPduGroupRef=RDR04_oVCAN_RADAR_Rx_BC_4bed2056 if post-build-variant-condition{matching-criterion=RDR_POS, value=3}, ComIPduGroupRef=RDR05_oVCAN_RADAR_Rx_BC_9c0fa00e if post-build-variant-condition{matching-criterion=RDR_POS, value=4}, ComIPduGroupRef=RDR06_oVCAN_RADAR_Rx_BC_3f5926a7 if post-build-variant-condition{matching-criterion=RDR_POS, value=5}, ComIPduGroupRef=RDR07_oVCAN_RADAR_Rx_BC_e8bba6ff if post-build-variant-condition{matching-criterion=RDR_POS, value=6}, ComIPduGroupRef=RDR08_oVCAN_RADAR_Rx_BC_ab243031 if post-build-variant-condition{matching-criterion=RDR_POS, value=7}
        CLS_Tx_16_oVCAN_RADAR_4a01c26f_Rx: ComIPduDirection=RECEIVE, ComIPduChannelRef=ComMConfigSet/CN_VCAN_RADAR_489180b6, ComIPduGroupRef=RDR01_oVCAN_RADAR_Rx_BC_7567adec if post-build-variant-condition{matching-criterion=RDR_POS, value=0}, ComIPduSignalGroupRef=SG_CLS_Tx_16_oCLS_Tx_16_oVCAN_RADAR_ce7ac5cf_Rx, ComPduIdRef=EcucPduCollection/CLS_Tx_16_oVCAN_RADAR_4a01c26f_Rx, ComIPduGroupRef=RDR02_oVCAN_RADAR_Rx_BC_d6312b45 if post-build-variant-condition{matching-criterion=RDR_POS, value=1}, ComIPduGroupRef=RDR03_oVCAN_RADAR_Rx_BC_01d3ab1d if post-build-variant-condition{matching-criterion=RDR_POS, value=2}, ComIPduGroupRef=RDR04_oVCAN_RADAR_Rx_BC_4bed2056 if post-build-variant-condition{matching-criterion=RDR_POS, value=3}, ComIPduGroupRef=RDR05_oVCAN_RADAR_Rx_BC_9c0fa00e if post-build-variant-condition{matching-criterion=RDR_POS, value=4}, ComIPduGroupRef=RDR06_oVCAN_RADAR_Rx_BC_3f5926a7 if post-build-variant-condition{matching-criterion=RDR_POS, value=5}, ComIPduGroupRef=RDR07_oVCAN_RADAR_Rx_BC_e8bba6ff if post-build-variant-condition{matching-criterion=RDR_POS, value=6}, ComIPduGroupRef=RDR08_oVCAN_RADAR_Rx_BC_ab243031 if post-build-variant-condition{matching-criterion=RDR_POS, value=7}
        CLS_Tx_4_oVCAN_RADAR_1adbb350_Rx: ComIPduDirection=RECEIVE, ComIPduChannelRef=ComMConfigSet/CN_VCAN_RADAR_489180b6, ComIPduGroupRef=RDR01_oVCAN_RADAR_Rx_BC_7567adec if post-build-variant-condition{matching-criterion=RDR_POS, value=0}, ComIPduSignalGroupRef=SG_CLS_Tx_4_oCLS_Tx_4_oVCAN_RADAR_72dadf8e_Rx, ComPduIdRef=EcucPduCollection/CLS_Tx_4_oVCAN_RADAR_1adbb350_Rx, ComIPduGroupRef=RDR02_oVCAN_RADAR_Rx_BC_d6312b45 if post-build-variant-condition{matching-criterion=RDR_POS, value=1}, ComIPduGroupRef=RDR03_oVCAN_RADAR_Rx_BC_01d3ab1d if post-build-variant-condition{matching-criterion=RDR_POS, value=2}, ComIPduGroupRef=RDR04_oVCAN_RADAR_Rx_BC_4bed2056 if post-build-variant-condition{matching-criterion=RDR_POS, value=3}, ComIPduGroupRef=RDR05_oVCAN_RADAR_Rx_BC_9c0fa00e if post-build-variant-condition{matching-criterion=RDR_POS, value=4}, ComIPduGroupRef=RDR06_oVCAN_RADAR_Rx_BC_3f5926a7 if post-build-variant-condition{matching-criterion=RDR_POS, value=5}, ComIPduGroupRef=RDR07_oVCAN_RADAR_Rx_BC_e8bba6ff if post-build-variant-condition{matching-criterion=RDR_POS, value=6}, ComIPduGroupRef=RDR08_oVCAN_RADAR_Rx_BC_ab243031 if post-build-variant-condition{matching-criterion=RDR_POS, value=7}
        ETC2_00_oVCAN_RADAR_322c725a_Rx: ComIPduDirection=RECEIVE, ComIPduChannelRef=ComMConfigSet/CN_VCAN_RADAR_489180b6, ComIPduGroupRef=RDR01_oVCAN_RADAR_Rx_BC_7567adec if post-build-variant-condition{matching-criterion=RDR_POS, value=0}, ComIPduSignalGroupRef=SG_ETC2_00_oETC2_00_oVCAN_RADAR_efbda90a_Rx, ComPduIdRef=EcucPduCollection/ETC2_00_oVCAN_RADAR_322c725a_Rx, ComIPduGroupRef=RDR02_oVCAN_RADAR_Rx_BC_d6312b45 if post-build-variant-condition{matching-criterion=RDR_POS, value=1}, ComIPduGroupRef=RDR03_oVCAN_RADAR_Rx_BC_01d3ab1d if post-build-variant-condition{matching-criterion=RDR_POS, value=2}, ComIPduGroupRef=RDR04_oVCAN_RADAR_Rx_BC_4bed2056 if post-build-variant-condition{matching-criterion=RDR_POS, value=3}, ComIPduGroupRef=RDR05_oVCAN_RADAR_Rx_BC_9c0fa00e if post-build-variant-condition{matching-criterion=RDR_POS, value=4}, ComIPduGroupRef=RDR06_oVCAN_RADAR_Rx_BC_3f5926a7 if post-build-variant-condition{matching-criterion=RDR_POS, value=5}, ComIPduGroupRef=RDR07_oVCAN_RADAR_Rx_BC_e8bba6ff if post-build-variant-condition{matching-criterion=RDR_POS, value=6}, ComIPduGroupRef=RDR08_oVCAN_RADAR_Rx_BC_ab243031 if post-build-variant-condition{matching-criterion=RDR_POS, value=7}
        ETC2_03_oVCAN_RADAR_8fe61e94_Rx: ComIPduDirection=RECEIVE, ComIPduChannelRef=ComMConfigSet/CN_VCAN_RADAR_489180b6, ComIPduGroupRef=RDR01_oVCAN_RADAR_Rx_BC_7567adec if post-build-variant-condition{matching-criterion=RDR_POS, value=0}, ComIPduSignalGroupRef=SG_ETC2_03_oETC2_03_oVCAN_RADAR_6b0f6884_Rx, ComPduIdRef=EcucPduCollection/ETC2_03_oVCAN_RADAR_8fe61e94_Rx, ComIPduGroupRef=RDR02_oVCAN_RADAR_Rx_BC_d6312b45 if post-build-variant-condition{matching-criterion=RDR_POS, value=1}, ComIPduGroupRef=RDR03_oVCAN_RADAR_Rx_BC_01d3ab1d if post-build-variant-condition{matching-criterion=RDR_POS, value=2}, ComIPduGroupRef=RDR04_oVCAN_RADAR_Rx_BC_4bed2056 if post-build-variant-condition{matching-criterion=RDR_POS, value=3}, ComIPduGroupRef=RDR05_oVCAN_RADAR_Rx_BC_9c0fa00e if post-build-variant-condition{matching-criterion=RDR_POS, value=4}, ComIPduGroupRef=RDR06_oVCAN_RADAR_Rx_BC_3f5926a7 if post-build-variant-condition{matching-criterion=RDR_POS, value=5}, ComIPduGroupRef=RDR07_oVCAN_RADAR_Rx_BC_e8bba6ff if post-build-variant-condition{matching-criterion=RDR_POS, value=6}, ComIPduGroupRef=RDR08_oVCAN_RADAR_Rx_BC_ab243031 if post-build-variant-condition{matching-criterion=RDR_POS, value=7}
        GW_ADAS_FN_Enable_disable_sts_oPCAN_RADAR_a2ffe33c_Rx: ComIPduDirection=RECEIVE, ComIPduChannelRef=ComMConfigSet/CN_PCAN_RADAR_458ff0f1, ComIPduGroupRef=RDR01_oPCAN_RADAR_Rx_e0e717e1 if post-build-variant-condition{matching-criterion=RDR_POS, value=0}, ComIPduSignalGroupRef=SG_GW_ADAS_FN_Enable_disable_sts_oGW_ADAS_FN_Enable_disable_sts_oPCAN_RADAR_9a8054b4_Rx, ComPduIdRef=EcucPduCollection/GW_ADAS_FN_Enable_disable_sts_oPCAN_RADAR_a2ffe33c_Rx, ComIPduGroupRef=RDR02_oPCAN_RADAR_Rx_c92fa313 if post-build-variant-condition{matching-criterion=RDR_POS, value=1}, ComIPduGroupRef=RDR03_oPCAN_RADAR_Rx_67473282 if post-build-variant-condition{matching-criterion=RDR_POS, value=2}, ComIPduGroupRef=RDR04_oPCAN_RADAR_Rx_9abecaf7 if post-build-variant-condition{matching-criterion=RDR_POS, value=3}, ComIPduGroupRef=RDR05_oPCAN_RADAR_Rx_34d65b66 if post-build-variant-condition{matching-criterion=RDR_POS, value=4}, ComIPduGroupRef=RDR06_oPCAN_RADAR_Rx_1d1eef94 if post-build-variant-condition{matching-criterion=RDR_POS, value=5}, ComIPduGroupRef=RDR07_oPCAN_RADAR_Rx_b3767e05 if post-build-variant-condition{matching-criterion=RDR_POS, value=6}, ComIPduGroupRef=RDR08_oPCAN_RADAR_Rx_3d9c193f if post-build-variant-condition{matching-criterion=RDR_POS, value=7}
        GW_CCVS1_oPCAN_RADAR_379fc270_Rx: ComIPduDirection=RECEIVE, ComIPduChannelRef=ComMConfigSet/CN_PCAN_RADAR_458ff0f1, ComIPduGroupRef=RDR01_oPCAN_RADAR_Rx_e0e717e1 if post-build-variant-condition{matching-criterion=RDR_POS, value=0}, ComIPduSignalGroupRef=SG_GW_CCVS1_oGW_CCVS1_oPCAN_RADAR_70857376_Rx, ComPduIdRef=EcucPduCollection/GW_CCVS1_oPCAN_RADAR_379fc270_Rx, ComIPduGroupRef=RDR02_oPCAN_RADAR_Rx_c92fa313 if post-build-variant-condition{matching-criterion=RDR_POS, value=1}, ComIPduGroupRef=RDR03_oPCAN_RADAR_Rx_67473282 if post-build-variant-condition{matching-criterion=RDR_POS, value=2}, ComIPduGroupRef=RDR04_oPCAN_RADAR_Rx_9abecaf7 if post-build-variant-condition{matching-criterion=RDR_POS, value=3}, ComIPduGroupRef=RDR05_oPCAN_RADAR_Rx_34d65b66 if post-build-variant-condition{matching-criterion=RDR_POS, value=4}, ComIPduGroupRef=RDR06_oPCAN_RADAR_Rx_1d1eef94 if post-build-variant-condition{matching-criterion=RDR_POS, value=5}, ComIPduGroupRef=RDR07_oPCAN_RADAR_Rx_b3767e05 if post-build-variant-condition{matching-criterion=RDR_POS, value=6}, ComIPduGroupRef=RDR08_oPCAN_RADAR_Rx_3d9c193f if post-build-variant-condition{matching-criterion=RDR_POS, value=7}
        GW_CLS_Tx_16_oPCAN_RADAR_92e0b941_Rx: ComIPduDirection=RECEIVE, ComIPduChannelRef=ComMConfigSet/CN_PCAN_RADAR_458ff0f1, ComIPduGroupRef=RDR01_oPCAN_RADAR_Rx_e0e717e1 if post-build-variant-condition{matching-criterion=RDR_POS, value=0}, ComIPduSignalGroupRef=SG_GW_CLS_Tx_16_oGW_CLS_Tx_16_oPCAN_RADAR_ecf85999_Rx, ComPduIdRef=EcucPduCollection/GW_CLS_Tx_16_oPCAN_RADAR_92e0b941_Rx, ComIPduGroupRef=RDR02_oPCAN_RADAR_Rx_c92fa313 if post-build-variant-condition{matching-criterion=RDR_POS, value=1}, ComIPduGroupRef=RDR03_oPCAN_RADAR_Rx_67473282 if post-build-variant-condition{matching-criterion=RDR_POS, value=2}, ComIPduGroupRef=RDR04_oPCAN_RADAR_Rx_9abecaf7 if post-build-variant-condition{matching-criterion=RDR_POS, value=3}, ComIPduGroupRef=RDR05_oPCAN_RADAR_Rx_34d65b66 if post-build-variant-condition{matching-criterion=RDR_POS, value=4}, ComIPduGroupRef=RDR06_oPCAN_RADAR_Rx_1d1eef94 if post-build-variant-condition{matching-criterion=RDR_POS, value=5}, ComIPduGroupRef=RDR07_oPCAN_RADAR_Rx_b3767e05 if post-build-variant-condition{matching-criterion=RDR_POS, value=6}, ComIPduGroupRef=RDR08_oPCAN_RADAR_Rx_3d9c193f if post-build-variant-condition{matching-criterion=RDR_POS, value=7}
        GW_CLS_Tx_4_oPCAN_RADAR_888f4e35_Rx: ComIPduDirection=RECEIVE, ComIPduChannelRef=ComMConfigSet/CN_PCAN_RADAR_458ff0f1, ComIPduGroupRef=RDR01_oPCAN_RADAR_Rx_e0e717e1 if post-build-variant-condition{matching-criterion=RDR_POS, value=0}, ComIPduSignalGroupRef=SG_GW_CLS_Tx_4_oGW_CLS_Tx_4_oPCAN_RADAR_474ec459_Rx, ComPduIdRef=EcucPduCollection/GW_CLS_Tx_4_oPCAN_RADAR_888f4e35_Rx, ComIPduGroupRef=RDR02_oPCAN_RADAR_Rx_c92fa313 if post-build-variant-condition{matching-criterion=RDR_POS, value=1}, ComIPduGroupRef=RDR03_oPCAN_RADAR_Rx_67473282 if post-build-variant-condition{matching-criterion=RDR_POS, value=2}, ComIPduGroupRef=RDR04_oPCAN_RADAR_Rx_9abecaf7 if post-build-variant-condition{matching-criterion=RDR_POS, value=3}, ComIPduGroupRef=RDR05_oPCAN_RADAR_Rx_34d65b66 if post-build-variant-condition{matching-criterion=RDR_POS, value=4}, ComIPduGroupRef=RDR06_oPCAN_RADAR_Rx_1d1eef94 if post-build-variant-condition{matching-criterion=RDR_POS, value=5}, ComIPduGroupRef=RDR07_oPCAN_RADAR_Rx_b3767e05 if post-build-variant-condition{matching-criterion=RDR_POS, value=6}, ComIPduGroupRef=RDR08_oPCAN_RADAR_Rx_3d9c193f if post-build-variant-condition{matching-criterion=RDR_POS, value=7}
        GW_ETC2_03_oPCAN_RADAR_7791e995_Rx: ComIPduDirection=RECEIVE, ComIPduChannelRef=ComMConfigSet/CN_PCAN_RADAR_458ff0f1, ComIPduGroupRef=RDR01_oPCAN_RADAR_Rx_e0e717e1 if post-build-variant-condition{matching-criterion=RDR_POS, value=0}, ComIPduSignalGroupRef=SG_GW_ETC2_03_oGW_ETC2_03_oPCAN_RADAR_04d9a8d8_Rx, ComPduIdRef=EcucPduCollection/GW_ETC2_03_oPCAN_RADAR_7791e995_Rx, ComIPduGroupRef=RDR02_oPCAN_RADAR_Rx_c92fa313 if post-build-variant-condition{matching-criterion=RDR_POS, value=1}, ComIPduGroupRef=RDR03_oPCAN_RADAR_Rx_67473282 if post-build-variant-condition{matching-criterion=RDR_POS, value=2}, ComIPduGroupRef=RDR04_oPCAN_RADAR_Rx_9abecaf7 if post-build-variant-condition{matching-criterion=RDR_POS, value=3}, ComIPduGroupRef=RDR05_oPCAN_RADAR_Rx_34d65b66 if post-build-variant-condition{matching-criterion=RDR_POS, value=4}, ComIPduGroupRef=RDR06_oPCAN_RADAR_Rx_1d1eef94 if post-build-variant-condition{matching-criterion=RDR_POS, value=5}, ComIPduGroupRef=RDR07_oPCAN_RADAR_Rx_b3767e05 if post-build-variant-condition{matching-criterion=RDR_POS, value=6}, ComIPduGroupRef=RDR08_oPCAN_RADAR_Rx_3d9c193f if post-build-variant-condition{matching-criterion=RDR_POS, value=7}
        GW_ETC2_oPCAN_RADAR_2970e6e5_Rx: ComIPduDirection=RECEIVE, ComIPduChannelRef=ComMConfigSet/CN_PCAN_RADAR_458ff0f1, ComIPduGroupRef=RDR01_oPCAN_RADAR_Rx_e0e717e1 if post-build-variant-condition{matching-criterion=RDR_POS, value=0}, ComIPduSignalGroupRef=SG_GW_ETC2_oGW_ETC2_oPCAN_RADAR_d84ef27a_Rx, ComPduIdRef=EcucPduCollection/GW_ETC2_oPCAN_RADAR_2970e6e5_Rx, ComIPduGroupRef=RDR02_oPCAN_RADAR_Rx_c92fa313 if post-build-variant-condition{matching-criterion=RDR_POS, value=1}, ComIPduGroupRef=RDR03_oPCAN_RADAR_Rx_67473282 if post-build-variant-condition{matching-criterion=RDR_POS, value=2}, ComIPduGroupRef=RDR04_oPCAN_RADAR_Rx_9abecaf7 if post-build-variant-condition{matching-criterion=RDR_POS, value=3}, ComIPduGroupRef=RDR05_oPCAN_RADAR_Rx_34d65b66 if post-build-variant-condition{matching-criterion=RDR_POS, value=4}, ComIPduGroupRef=RDR06_oPCAN_RADAR_Rx_1d1eef94 if post-build-variant-condition{matching-criterion=RDR_POS, value=5}, ComIPduGroupRef=RDR07_oPCAN_RADAR_Rx_b3767e05 if post-build-variant-condition{matching-criterion=RDR_POS, value=6}, ComIPduGroupRef=RDR08_oPCAN_RADAR_Rx_3d9c193f if post-build-variant-condition{matching-criterion=RDR_POS, value=7}
        GW_OEL_oPCAN_RADAR_b67c14d5_Rx: ComIPduDirection=RECEIVE, ComIPduChannelRef=ComMConfigSet/CN_PCAN_RADAR_458ff0f1, ComIPduGroupRef=RDR01_oPCAN_RADAR_Rx_e0e717e1 if post-build-variant-condition{matching-criterion=RDR_POS, value=0}, ComIPduSignalGroupRef=SG_GW_OEL_oGW_OEL_oPCAN_RADAR_dcaa9b38_Rx, ComPduIdRef=EcucPduCollection/GW_OEL_oPCAN_RADAR_b67c14d5_Rx, ComIPduGroupRef=RDR02_oPCAN_RADAR_Rx_c92fa313 if post-build-variant-condition{matching-criterion=RDR_POS, value=1}, ComIPduGroupRef=RDR03_oPCAN_RADAR_Rx_67473282 if post-build-variant-condition{matching-criterion=RDR_POS, value=2}, ComIPduGroupRef=RDR04_oPCAN_RADAR_Rx_9abecaf7 if post-build-variant-condition{matching-criterion=RDR_POS, value=3}, ComIPduGroupRef=RDR05_oPCAN_RADAR_Rx_34d65b66 if post-build-variant-condition{matching-criterion=RDR_POS, value=4}, ComIPduGroupRef=RDR06_oPCAN_RADAR_Rx_1d1eef94 if post-build-variant-condition{matching-criterion=RDR_POS, value=5}, ComIPduGroupRef=RDR07_oPCAN_RADAR_Rx_b3767e05 if post-build-variant-condition{matching-criterion=RDR_POS, value=6}, ComIPduGroupRef=RDR08_oPCAN_RADAR_Rx_3d9c193f if post-build-variant-condition{matching-criterion=RDR_POS, value=7}
        GW_SAS_oPCAN_RADAR_3d30de8a_Rx: ComIPduDirection=RECEIVE, ComIPduChannelRef=ComMConfigSet/CN_PCAN_RADAR_458ff0f1, ComIPduGroupRef=RDR01_oPCAN_RADAR_Rx_e0e717e1 if post-build-variant-condition{matching-criterion=RDR_POS, value=0}, ComIPduSignalGroupRef=SG_GW_SAS_oGW_SAS_oPCAN_RADAR_0d213b5c_Rx, ComPduIdRef=EcucPduCollection/GW_SAS_oPCAN_RADAR_3d30de8a_Rx, ComIPduGroupRef=RDR02_oPCAN_RADAR_Rx_c92fa313 if post-build-variant-condition{matching-criterion=RDR_POS, value=1}, ComIPduGroupRef=RDR03_oPCAN_RADAR_Rx_67473282 if post-build-variant-condition{matching-criterion=RDR_POS, value=2}, ComIPduGroupRef=RDR04_oPCAN_RADAR_Rx_9abecaf7 if post-build-variant-condition{matching-criterion=RDR_POS, value=3}, ComIPduGroupRef=RDR05_oPCAN_RADAR_Rx_34d65b66 if post-build-variant-condition{matching-criterion=RDR_POS, value=4}, ComIPduGroupRef=RDR06_oPCAN_RADAR_Rx_1d1eef94 if post-build-variant-condition{matching-criterion=RDR_POS, value=5}, ComIPduGroupRef=RDR07_oPCAN_RADAR_Rx_b3767e05 if post-build-variant-condition{matching-criterion=RDR_POS, value=6}, ComIPduGroupRef=RDR08_oPCAN_RADAR_Rx_3d9c193f if post-build-variant-condition{matching-criterion=RDR_POS, value=7}
        GW_TD_oPCAN_RADAR_87cf7844_Rx: ComIPduDirection=RECEIVE, ComIPduChannelRef=ComMConfigSet/CN_PCAN_RADAR_458ff0f1, ComIPduGroupRef=RDR01_oPCAN_RADAR_Rx_e0e717e1 if post-build-variant-condition{matching-criterion=RDR_POS, value=0}, ComIPduSignalGroupRef=SG_GW_TD_oGW_TD_oPCAN_RADAR_a8a59c34_Rx, ComPduIdRef=EcucPduCollection/GW_TD_oPCAN_RADAR_87cf7844_Rx, ComIPduGroupRef=RDR02_oPCAN_RADAR_Rx_c92fa313 if post-build-variant-condition{matching-criterion=RDR_POS, value=1}, ComIPduGroupRef=RDR03_oPCAN_RADAR_Rx_67473282 if post-build-variant-condition{matching-criterion=RDR_POS, value=2}, ComIPduGroupRef=RDR04_oPCAN_RADAR_Rx_9abecaf7 if post-build-variant-condition{matching-criterion=RDR_POS, value=3}, ComIPduGroupRef=RDR05_oPCAN_RADAR_Rx_34d65b66 if post-build-variant-condition{matching-criterion=RDR_POS, value=4}, ComIPduGroupRef=RDR06_oPCAN_RADAR_Rx_1d1eef94 if post-build-variant-condition{matching-criterion=RDR_POS, value=5}, ComIPduGroupRef=RDR07_oPCAN_RADAR_Rx_b3767e05 if post-build-variant-condition{matching-criterion=RDR_POS, value=6}, ComIPduGroupRef=RDR08_oPCAN_RADAR_Rx_3d9c193f if post-build-variant-condition{matching-criterion=RDR_POS, value=7}
        GW_VDC2_oPCAN_RADAR_a2fdf3c6_Rx: ComIPduDirection=RECEIVE, ComIPduChannelRef=ComMConfigSet/CN_PCAN_RADAR_458ff0f1, ComIPduGroupRef=RDR01_oPCAN_RADAR_Rx_e0e717e1 if post-build-variant-condition{matching-criterion=RDR_POS, value=0}, ComIPduSignalGroupRef=SG_GW_VDC2_oGW_VDC2_oPCAN_RADAR_41520959_Rx, ComPduIdRef=EcucPduCollection/GW_VDC2_oPCAN_RADAR_a2fdf3c6_Rx, ComIPduGroupRef=RDR02_oPCAN_RADAR_Rx_c92fa313 if post-build-variant-condition{matching-criterion=RDR_POS, value=1}, ComIPduGroupRef=RDR03_oPCAN_RADAR_Rx_67473282 if post-build-variant-condition{matching-criterion=RDR_POS, value=2}, ComIPduGroupRef=RDR04_oPCAN_RADAR_Rx_9abecaf7 if post-build-variant-condition{matching-criterion=RDR_POS, value=3}, ComIPduGroupRef=RDR05_oPCAN_RADAR_Rx_34d65b66 if post-build-variant-condition{matching-criterion=RDR_POS, value=4}, ComIPduGroupRef=RDR06_oPCAN_RADAR_Rx_1d1eef94 if post-build-variant-condition{matching-criterion=RDR_POS, value=5}, ComIPduGroupRef=RDR07_oPCAN_RADAR_Rx_b3767e05 if post-build-variant-condition{matching-criterion=RDR_POS, value=6}, ComIPduGroupRef=RDR08_oPCAN_RADAR_Rx_3d9c193f if post-build-variant-condition{matching-criterion=RDR_POS, value=7}
        GW_VD_oPCAN_RADAR_66a1bce9_Rx: ComIPduDirection=RECEIVE, ComIPduChannelRef=ComMConfigSet/CN_PCAN_RADAR_458ff0f1, ComIPduGroupRef=RDR01_oPCAN_RADAR_Rx_e0e717e1 if post-build-variant-condition{matching-criterion=RDR_POS, value=0}, ComIPduSignalGroupRef=SG_GW_VD_oGW_VD_oPCAN_RADAR_ad0f59e4_Rx, ComPduIdRef=EcucPduCollection/GW_VD_oPCAN_RADAR_66a1bce9_Rx, ComIPduGroupRef=RDR02_oPCAN_RADAR_Rx_c92fa313 if post-build-variant-condition{matching-criterion=RDR_POS, value=1}, ComIPduGroupRef=RDR03_oPCAN_RADAR_Rx_67473282 if post-build-variant-condition{matching-criterion=RDR_POS, value=2}, ComIPduGroupRef=RDR04_oPCAN_RADAR_Rx_9abecaf7 if post-build-variant-condition{matching-criterion=RDR_POS, value=3}, ComIPduGroupRef=RDR05_oPCAN_RADAR_Rx_34d65b66 if post-build-variant-condition{matching-criterion=RDR_POS, value=4}, ComIPduGroupRef=RDR06_oPCAN_RADAR_Rx_1d1eef94 if post-build-variant-condition{matching-criterion=RDR_POS, value=5}, ComIPduGroupRef=RDR07_oPCAN_RADAR_Rx_b3767e05 if post-build-variant-condition{matching-criterion=RDR_POS, value=6}, ComIPduGroupRef=RDR08_oPCAN_RADAR_Rx_3d9c193f if post-build-variant-condition{matching-criterion=RDR_POS, value=7}
        GW_VI_oPCAN_RADAR_218ddc97_Rx: ComIPduDirection=RECEIVE, ComIPduChannelRef=ComMConfigSet/CN_PCAN_RADAR_458ff0f1, ComIPduGroupRef=RDR01_oPCAN_RADAR_Rx_e0e717e1 if post-build-variant-condition{matching-criterion=RDR_POS, value=0}, ComIPduSignalGroupRef=SG_GW_VI_oGW_VI_oPCAN_RADAR_5c723f37_Rx, ComPduIdRef=EcucPduCollection/GW_VI_oPCAN_RADAR_218ddc97_Rx, ComIPduGroupRef=RDR02_oPCAN_RADAR_Rx_c92fa313 if post-build-variant-condition{matching-criterion=RDR_POS, value=1}, ComIPduGroupRef=RDR03_oPCAN_RADAR_Rx_67473282 if post-build-variant-condition{matching-criterion=RDR_POS, value=2}, ComIPduGroupRef=RDR04_oPCAN_RADAR_Rx_9abecaf7 if post-build-variant-condition{matching-criterion=RDR_POS, value=3}, ComIPduGroupRef=RDR05_oPCAN_RADAR_Rx_34d65b66 if post-build-variant-condition{matching-criterion=RDR_POS, value=4}, ComIPduGroupRef=RDR06_oPCAN_RADAR_Rx_1d1eef94 if post-build-variant-condition{matching-criterion=RDR_POS, value=5}, ComIPduGroupRef=RDR07_oPCAN_RADAR_Rx_b3767e05 if post-build-variant-condition{matching-criterion=RDR_POS, value=6}, ComIPduGroupRef=RDR08_oPCAN_RADAR_Rx_3d9c193f if post-build-variant-condition{matching-criterion=RDR_POS, value=7}
        GW_prop_ADAS_BSIS_info_oPCAN_RADAR_f2d61fec_Tx: ComIPduDirection=SEND, ComIPduChannelRef=ComMConfigSet/CN_PCAN_RADAR_458ff0f1, ComIPduGroupRef=RDR01_oPCAN_RADAR_Tx_b6bdb067 if post-build-variant-condition{matching-criterion=RDR_POS, value=0}, ComIPduSignalGroupRef=SG_GW_prop_ADAS_BSIS_info_oGW_prop_ADAS_BSIS_info_oPCAN_RADAR_e9da8865_Tx, ComPduIdRef=EcucPduCollection/GW_prop_ADAS_BSIS_info_oPCAN_RADAR_f2d61fec_Tx, ComIPduGroupRef=RDR02_oPCAN_RADAR_Tx_9f750495 if post-build-variant-condition{matching-criterion=RDR_POS, value=1}, ComIPduGroupRef=RDR03_oPCAN_RADAR_Tx_311d9504 if post-build-variant-condition{matching-criterion=RDR_POS, value=2}, ComIPduGroupRef=RDR04_oPCAN_RADAR_Tx_cce46d71 if post-build-variant-condition{matching-criterion=RDR_POS, value=3}, ComIPduGroupRef=RDR05_oPCAN_RADAR_Tx_628cfce0 if post-build-variant-condition{matching-criterion=RDR_POS, value=4}, ComIPduGroupRef=RDR06_oPCAN_RADAR_Tx_4b444812 if post-build-variant-condition{matching-criterion=RDR_POS, value=5}, ComIPduGroupRef=RDR07_oPCAN_RADAR_Tx_e52cd983 if post-build-variant-condition{matching-criterion=RDR_POS, value=6}, ComIPduGroupRef=RDR08_oPCAN_RADAR_Tx_6bc6beb9 if post-build-variant-condition{matching-criterion=RDR_POS, value=7}
          ComTxIPdu: ComMinimumDelayTime=0, ComTxIPduUnusedAreasDefault=0
        MOIS_oVCAN_RADAR_39784631_Tx: ComIPduDirection=SEND, ComIPduChannelRef=ComMConfigSet/CN_VCAN_RADAR_489180b6, ComIPduGroupRef=RDR01_oVCAN_RADAR_Tx_0xD0_2361e9dc if post-build-variant-condition{matching-criterion=RDR_POS, value=0}, ComIPduSignalGroupRef=SG_MOIS_oMOIS_oVCAN_RADAR_f9ec408e_Tx, ComPduIdRef=EcucPduCollection/MOIS_oVCAN_RADAR_39784631_Tx, ComIPduGroupRef=RDR02_oVCAN_RADAR_Tx_0xD0_587f6b3f if post-build-variant-condition{matching-criterion=RDR_POS, value=1}, ComIPduGroupRef=RDR03_oVCAN_RADAR_Tx_0xD0_c7a5e8a1 if post-build-variant-condition{matching-criterion=RDR_POS, value=2}, ComIPduGroupRef=RDR04_oVCAN_RADAR_Tx_0xD0_ae426ef9 if post-build-variant-condition{matching-criterion=RDR_POS, value=3}, ComIPduGroupRef=RDR05_oVCAN_RADAR_Tx_0xD0_3198ed67 if post-build-variant-condition{matching-criterion=RDR_POS, value=4}, ComIPduGroupRef=RDR06_oVCAN_RADAR_Tx_0xD0_4a866f84 if post-build-variant-condition{matching-criterion=RDR_POS, value=5}, ComIPduGroupRef=RDR07_oVCAN_RADAR_Tx_0xD0_d55cec1a if post-build-variant-condition{matching-criterion=RDR_POS, value=6}, ComIPduGroupRef=RDR08_oVCAN_RADAR_Tx_0xD0_99496334 if post-build-variant-condition{matching-criterion=RDR_POS, value=7}
          ComTxIPdu: ComMinimumDelayTime=0, ComTxIPduUnusedAreasDefault=255
            ComTxModeFalse
              ComTxMode: ComTxModeMode=PERIODIC, ComTxModeTimeOffset=0, ComTxModeTimePeriod=0.05
            ComTxModeTrue
              ComTxMode: ComTxModeMode=PERIODIC, ComTxModeTimeOffset=0, ComTxModeTimePeriod=0.05
        OEL_oVCAN_RADAR_75091ec5_Rx: ComIPduDirection=RECEIVE, ComIPduChannelRef=ComMConfigSet/CN_VCAN_RADAR_489180b6, ComIPduGroupRef=RDR01_oVCAN_RADAR_Rx_BC_7567adec if post-build-variant-condition{matching-criterion=RDR_POS, value=0}, ComIPduSignalGroupRef=SG_OEL_oOEL_oVCAN_RADAR_400a2f4d_Rx, ComPduIdRef=EcucPduCollection/OEL_oVCAN_RADAR_75091ec5_Rx, ComIPduGroupRef=RDR02_oVCAN_RADAR_Rx_BC_d6312b45 if post-build-variant-condition{matching-criterion=RDR_POS, value=1}, ComIPduGroupRef=RDR03_oVCAN_RADAR_Rx_BC_01d3ab1d if post-build-variant-condition{matching-criterion=RDR_POS, value=2}, ComIPduGroupRef=RDR04_oVCAN_RADAR_Rx_BC_4bed2056 if post-build-variant-condition{matching-criterion=RDR_POS, value=3}, ComIPduGroupRef=RDR05_oVCAN_RADAR_Rx_BC_9c0fa00e if post-build-variant-condition{matching-criterion=RDR_POS, value=4}, ComIPduGroupRef=RDR06_oVCAN_RADAR_Rx_BC_3f5926a7 if post-build-variant-condition{matching-criterion=RDR_POS, value=5}, ComIPduGroupRef=RDR07_oVCAN_RADAR_Rx_BC_e8bba6ff if post-build-variant-condition{matching-criterion=RDR_POS, value=6}, ComIPduGroupRef=RDR08_oVCAN_RADAR_Rx_BC_ab243031 if post-build-variant-condition{matching-criterion=RDR_POS, value=7}
        RDR_ALIGNMENT_STATUS_001_oPCAN_RADAR_dd819ed8_Tx: ComIPduDirection=SEND, ComIPduChannelRef=ComMConfigSet/CN_PCAN_RADAR_458ff0f1, ComIPduGroupRef=RDR01_oPCAN_RADAR_Tx_b6bdb067 if post-build-variant-condition{matching-criterion=RDR_POS, value=0}, ComIPduSignalGroupRef=SG_AlignmentStatus1_oRDR_ALIGNMENT_STATUS_001_oPCAN_RADAR_7714a623_Tx, ComPduIdRef=EcucPduCollection/RDR_ALIGNMENT_STATUS_001_oPCAN_RADAR_dd819ed8_Tx, ComIPduGroupRef=RDR02_oPCAN_RADAR_Tx_9f750495 if post-build-variant-condition{matching-criterion=RDR_POS, value=1}, ComIPduGroupRef=RDR03_oPCAN_RADAR_Tx_311d9504 if post-build-variant-condition{matching-criterion=RDR_POS, value=2}, ComIPduGroupRef=RDR04_oPCAN_RADAR_Tx_cce46d71 if post-build-variant-condition{matching-criterion=RDR_POS, value=3}, ComIPduGroupRef=RDR05_oPCAN_RADAR_Tx_628cfce0 if post-build-variant-condition{matching-criterion=RDR_POS, value=4}, ComIPduGroupRef=RDR06_oPCAN_RADAR_Tx_4b444812 if post-build-variant-condition{matching-criterion=RDR_POS, value=5}, ComIPduGroupRef=RDR07_oPCAN_RADAR_Tx_e52cd983 if post-build-variant-condition{matching-criterion=RDR_POS, value=6}, ComIPduGroupRef=RDR08_oPCAN_RADAR_Tx_6bc6beb9 if post-build-variant-condition{matching-criterion=RDR_POS, value=7}
          ComTxIPdu: ComMinimumDelayTime=0, ComTxIPduUnusedAreasDefault=0
            ComTxModeFalse
              ComTxMode: ComTxModeMode=PERIODIC, ComTxModeTimeOffset=0, ComTxModeTimePeriod=0.05
            ComTxModeTrue
              ComTxMode: ComTxModeMode=PERIODIC, ComTxModeTimeOffset=0, ComTxModeTimePeriod=0.05
        RDR_ALIGNMENT_STATUS_002_oPCAN_RADAR_604bf216_Tx: ComIPduDirection=SEND, ComIPduChannelRef=ComMConfigSet/CN_PCAN_RADAR_458ff0f1, ComIPduGroupRef=RDR01_oPCAN_RADAR_Tx_b6bdb067 if post-build-variant-condition{matching-criterion=RDR_POS, value=0}, ComIPduSignalGroupRef=SG_AlignmentStatus2_oRDR_ALIGNMENT_STATUS_002_oPCAN_RADAR_1945d616_Tx, ComPduIdRef=EcucPduCollection/RDR_ALIGNMENT_STATUS_002_oPCAN_RADAR_604bf216_Tx, ComIPduGroupRef=RDR02_oPCAN_RADAR_Tx_9f750495 if post-build-variant-condition{matching-criterion=RDR_POS, value=1}, ComIPduGroupRef=RDR03_oPCAN_RADAR_Tx_311d9504 if post-build-variant-condition{matching-criterion=RDR_POS, value=2}, ComIPduGroupRef=RDR04_oPCAN_RADAR_Tx_cce46d71 if post-build-variant-condition{matching-criterion=RDR_POS, value=3}, ComIPduGroupRef=RDR05_oPCAN_RADAR_Tx_628cfce0 if post-build-variant-condition{matching-criterion=RDR_POS, value=4}, ComIPduGroupRef=RDR06_oPCAN_RADAR_Tx_4b444812 if post-build-variant-condition{matching-criterion=RDR_POS, value=5}, ComIPduGroupRef=RDR07_oPCAN_RADAR_Tx_e52cd983 if post-build-variant-condition{matching-criterion=RDR_POS, value=6}, ComIPduGroupRef=RDR08_oPCAN_RADAR_Tx_6bc6beb9 if post-build-variant-condition{matching-criterion=RDR_POS, value=7}
          ComTxIPdu: ComMinimumDelayTime=0, ComTxIPduUnusedAreasDefault=0
        RDR_BSD1_Tx_oPCAN_RADAR_170995fb_Tx: ComIPduDirection=SEND, ComIPduChannelRef=ComMConfigSet/CN_PCAN_RADAR_458ff0f1, ComIPduGroupRef=RDR01_oPCAN_RADAR_Tx_b6bdb067 if post-build-variant-condition{matching-criterion=RDR_POS, value=0}, ComIPduSignalGroupRef=SG_RDR_BSD1_Tx_oRDR_BSD1_Tx_oPCAN_RADAR_bd131ac1_Tx, ComPduIdRef=EcucPduCollection/RDR_BSD1_Tx_oPCAN_RADAR_170995fb_Tx, ComIPduGroupRef=RDR02_oPCAN_RADAR_Tx_9f750495 if post-build-variant-condition{matching-criterion=RDR_POS, value=1}, ComIPduGroupRef=RDR03_oPCAN_RADAR_Tx_311d9504 if post-build-variant-condition{matching-criterion=RDR_POS, value=2}, ComIPduGroupRef=RDR04_oPCAN_RADAR_Tx_cce46d71 if post-build-variant-condition{matching-criterion=RDR_POS, value=3}, ComIPduGroupRef=RDR05_oPCAN_RADAR_Tx_628cfce0 if post-build-variant-condition{matching-criterion=RDR_POS, value=4}, ComIPduGroupRef=RDR06_oPCAN_RADAR_Tx_4b444812 if post-build-variant-condition{matching-criterion=RDR_POS, value=5}, ComIPduGroupRef=RDR07_oPCAN_RADAR_Tx_e52cd983 if post-build-variant-condition{matching-criterion=RDR_POS, value=6}, ComIPduGroupRef=RDR08_oPCAN_RADAR_Tx_6bc6beb9 if post-build-variant-condition{matching-criterion=RDR_POS, value=7}
          ComTxIPdu: ComMinimumDelayTime=0, ComTxIPduUnusedAreasDefault=0
        RDR_CAPABILITY_oPCAN_RADAR_18844568_Tx: ComIPduDirection=SEND, ComIPduChannelRef=ComMConfigSet/CN_PCAN_RADAR_458ff0f1, ComIPduGroupRef=RDR01_oPCAN_RADAR_Tx_b6bdb067 if post-build-variant-condition{matching-criterion=RDR_POS, value=0}, ComIPduSignalGroupRef=SG_RadarCapability_oRDR_CAPABILITY_oPCAN_RADAR_be2920f1_Tx, ComPduIdRef=EcucPduCollection/RDR_CAPABILITY_oPCAN_RADAR_18844568_Tx, ComIPduGroupRef=RDR02_oPCAN_RADAR_Tx_9f750495 if post-build-variant-condition{matching-criterion=RDR_POS, value=1}, ComIPduGroupRef=RDR03_oPCAN_RADAR_Tx_311d9504 if post-build-variant-condition{matching-criterion=RDR_POS, value=2}, ComIPduGroupRef=RDR04_oPCAN_RADAR_Tx_cce46d71 if post-build-variant-condition{matching-criterion=RDR_POS, value=3}, ComIPduGroupRef=RDR05_oPCAN_RADAR_Tx_628cfce0 if post-build-variant-condition{matching-criterion=RDR_POS, value=4}, ComIPduGroupRef=RDR06_oPCAN_RADAR_Tx_4b444812 if post-build-variant-condition{matching-criterion=RDR_POS, value=5}, ComIPduGroupRef=RDR07_oPCAN_RADAR_Tx_e52cd983 if post-build-variant-condition{matching-criterion=RDR_POS, value=6}, ComIPduGroupRef=RDR08_oPCAN_RADAR_Tx_6bc6beb9 if post-build-variant-condition{matching-criterion=RDR_POS, value=7}
          ComTxIPdu: ComMinimumDelayTime=0, ComTxIPduUnusedAreasDefault=0
            ComTxModeFalse
              ComTxMode: ComTxModeMode=PERIODIC, ComTxModeTimeOffset=0, ComTxModeTimePeriod=0.05
            ComTxModeTrue
              ComTxMode: ComTxModeMode=PERIODIC, ComTxModeTimeOffset=0, ComTxModeTimePeriod=0.05
        RDR_DETECTION_001_004_oPCAN_RADAR_b0420040_Tx: ComIPduDirection=SEND, ComIPduChannelRef=ComMConfigSet/CN_PCAN_RADAR_458ff0f1, ComIPduGroupRef=RDR01_oPCAN_RADAR_Tx_b6bdb067 if post-build-variant-condition{matching-criterion=RDR_POS, value=0}, ComIPduSignalGroupRef=SG_Detections_001_004_oRDR_DETECTION_001_004_oPCAN_RADAR_df4895a5_Tx, ComPduIdRef=EcucPduCollection/RDR_DETECTION_001_004_oPCAN_RADAR_b0420040_Tx, ComIPduGroupRef=RDR02_oPCAN_RADAR_Tx_9f750495 if post-build-variant-condition{matching-criterion=RDR_POS, value=1}, ComIPduGroupRef=RDR03_oPCAN_RADAR_Tx_311d9504 if post-build-variant-condition{matching-criterion=RDR_POS, value=2}, ComIPduGroupRef=RDR04_oPCAN_RADAR_Tx_cce46d71 if post-build-variant-condition{matching-criterion=RDR_POS, value=3}, ComIPduGroupRef=RDR05_oPCAN_RADAR_Tx_628cfce0 if post-build-variant-condition{matching-criterion=RDR_POS, value=4}, ComIPduGroupRef=RDR06_oPCAN_RADAR_Tx_4b444812 if post-build-variant-condition{matching-criterion=RDR_POS, value=5}, ComIPduGroupRef=RDR07_oPCAN_RADAR_Tx_e52cd983 if post-build-variant-condition{matching-criterion=RDR_POS, value=6}, ComIPduGroupRef=RDR08_oPCAN_RADAR_Tx_6bc6beb9 if post-build-variant-condition{matching-criterion=RDR_POS, value=7}
          ComTxIPdu: ComMinimumDelayTime=0, ComTxIPduUnusedAreasDefault=0
        RDR_DETECTION_005_008_oPCAN_RADAR_59f09e74_Tx: ComIPduDirection=SEND, ComIPduChannelRef=ComMConfigSet/CN_PCAN_RADAR_458ff0f1, ComIPduGroupRef=RDR01_oPCAN_RADAR_Tx_b6bdb067 if post-build-variant-condition{matching-criterion=RDR_POS, value=0}, ComIPduSignalGroupRef=SG_Detections_005_008_oRDR_DETECTION_005_008_oPCAN_RADAR_ae8ba1f7_Tx, ComPduIdRef=EcucPduCollection/RDR_DETECTION_005_008_oPCAN_RADAR_59f09e74_Tx, ComIPduGroupRef=RDR02_oPCAN_RADAR_Tx_9f750495 if post-build-variant-condition{matching-criterion=RDR_POS, value=1}, ComIPduGroupRef=RDR03_oPCAN_RADAR_Tx_311d9504 if post-build-variant-condition{matching-criterion=RDR_POS, value=2}, ComIPduGroupRef=RDR04_oPCAN_RADAR_Tx_cce46d71 if post-build-variant-condition{matching-criterion=RDR_POS, value=3}, ComIPduGroupRef=RDR05_oPCAN_RADAR_Tx_628cfce0 if post-build-variant-condition{matching-criterion=RDR_POS, value=4}, ComIPduGroupRef=RDR06_oPCAN_RADAR_Tx_4b444812 if post-build-variant-condition{matching-criterion=RDR_POS, value=5}, ComIPduGroupRef=RDR07_oPCAN_RADAR_Tx_e52cd983 if post-build-variant-condition{matching-criterion=RDR_POS, value=6}, ComIPduGroupRef=RDR08_oPCAN_RADAR_Tx_6bc6beb9 if post-build-variant-condition{matching-criterion=RDR_POS, value=7}
          ComTxIPdu: ComMinimumDelayTime=0, ComTxIPduUnusedAreasDefault=0
        RDR_DETECTION_009_012_oPCAN_RADAR_6bb87175_Tx: ComIPduDirection=SEND, ComIPduChannelRef=ComMConfigSet/CN_PCAN_RADAR_458ff0f1, ComIPduGroupRef=RDR01_oPCAN_RADAR_Tx_b6bdb067 if post-build-variant-condition{matching-criterion=RDR_POS, value=0}, ComIPduSignalGroupRef=SG_Detections_009_012_oRDR_DETECTION_009_012_oPCAN_RADAR_37f1858c_Tx, ComPduIdRef=EcucPduCollection/RDR_DETECTION_009_012_oPCAN_RADAR_6bb87175_Tx, ComIPduGroupRef=RDR02_oPCAN_RADAR_Tx_9f750495 if post-build-variant-condition{matching-criterion=RDR_POS, value=1}, ComIPduGroupRef=RDR03_oPCAN_RADAR_Tx_311d9504 if post-build-variant-condition{matching-criterion=RDR_POS, value=2}, ComIPduGroupRef=RDR04_oPCAN_RADAR_Tx_cce46d71 if post-build-variant-condition{matching-criterion=RDR_POS, value=3}, ComIPduGroupRef=RDR05_oPCAN_RADAR_Tx_628cfce0 if post-build-variant-condition{matching-criterion=RDR_POS, value=4}, ComIPduGroupRef=RDR06_oPCAN_RADAR_Tx_4b444812 if post-build-variant-condition{matching-criterion=RDR_POS, value=5}, ComIPduGroupRef=RDR07_oPCAN_RADAR_Tx_e52cd983 if post-build-variant-condition{matching-criterion=RDR_POS, value=6}, ComIPduGroupRef=RDR08_oPCAN_RADAR_Tx_6bc6beb9 if post-build-variant-condition{matching-criterion=RDR_POS, value=7}
          ComTxIPdu: ComMinimumDelayTime=0, ComTxIPduUnusedAreasDefault=0
        RDR_DETECTION_013_016_oPCAN_RADAR_767f725b_Tx: ComIPduDirection=SEND, ComIPduChannelRef=ComMConfigSet/CN_PCAN_RADAR_458ff0f1, ComIPduGroupRef=RDR01_oPCAN_RADAR_Tx_b6bdb067 if post-build-variant-condition{matching-criterion=RDR_POS, value=0}, ComIPduSignalGroupRef=SG_Detections_013_016_oRDR_DETECTION_013_016_oPCAN_RADAR_05faeda4_Tx, ComPduIdRef=EcucPduCollection/RDR_DETECTION_013_016_oPCAN_RADAR_767f725b_Tx, ComIPduGroupRef=RDR02_oPCAN_RADAR_Tx_9f750495 if post-build-variant-condition{matching-criterion=RDR_POS, value=1}, ComIPduGroupRef=RDR03_oPCAN_RADAR_Tx_311d9504 if post-build-variant-condition{matching-criterion=RDR_POS, value=2}, ComIPduGroupRef=RDR04_oPCAN_RADAR_Tx_cce46d71 if post-build-variant-condition{matching-criterion=RDR_POS, value=3}, ComIPduGroupRef=RDR05_oPCAN_RADAR_Tx_628cfce0 if post-build-variant-condition{matching-criterion=RDR_POS, value=4}, ComIPduGroupRef=RDR06_oPCAN_RADAR_Tx_4b444812 if post-build-variant-condition{matching-criterion=RDR_POS, value=5}, ComIPduGroupRef=RDR07_oPCAN_RADAR_Tx_e52cd983 if post-build-variant-condition{matching-criterion=RDR_POS, value=6}, ComIPduGroupRef=RDR08_oPCAN_RADAR_Tx_6bc6beb9 if post-build-variant-condition{matching-criterion=RDR_POS, value=7}
          ComTxIPdu: ComMinimumDelayTime=0, ComTxIPduUnusedAreasDefault=0
        RDR_DETECTION_017_020_oPCAN_RADAR_d9f3af92_Tx: ComIPduDirection=SEND, ComIPduChannelRef=ComMConfigSet/CN_PCAN_RADAR_458ff0f1, ComIPduGroupRef=RDR01_oPCAN_RADAR_Tx_b6bdb067 if post-build-variant-condition{matching-criterion=RDR_POS, value=0}, ComIPduSignalGroupRef=SG_Detections_017_020_oRDR_DETECTION_017_020_oPCAN_RADAR_e956bb2e_Tx, ComPduIdRef=EcucPduCollection/RDR_DETECTION_017_020_oPCAN_RADAR_d9f3af92_Tx, ComIPduGroupRef=RDR02_oPCAN_RADAR_Tx_9f750495 if post-build-variant-condition{matching-criterion=RDR_POS, value=1}, ComIPduGroupRef=RDR03_oPCAN_RADAR_Tx_311d9504 if post-build-variant-condition{matching-criterion=RDR_POS, value=2}, ComIPduGroupRef=RDR04_oPCAN_RADAR_Tx_cce46d71 if post-build-variant-condition{matching-criterion=RDR_POS, value=3}, ComIPduGroupRef=RDR05_oPCAN_RADAR_Tx_628cfce0 if post-build-variant-condition{matching-criterion=RDR_POS, value=4}, ComIPduGroupRef=RDR06_oPCAN_RADAR_Tx_4b444812 if post-build-variant-condition{matching-criterion=RDR_POS, value=5}, ComIPduGroupRef=RDR07_oPCAN_RADAR_Tx_e52cd983 if post-build-variant-condition{matching-criterion=RDR_POS, value=6}, ComIPduGroupRef=RDR08_oPCAN_RADAR_Tx_6bc6beb9 if post-build-variant-condition{matching-criterion=RDR_POS, value=7}
          ComTxIPdu: ComMinimumDelayTime=0, ComTxIPduUnusedAreasDefault=0
        RDR_DETECTION_021_024_oPCAN_RADAR_54f8af6e_Tx: ComIPduDirection=SEND, ComIPduChannelRef=ComMConfigSet/CN_PCAN_RADAR_458ff0f1, ComIPduGroupRef=RDR01_oPCAN_RADAR_Tx_b6bdb067 if post-build-variant-condition{matching-criterion=RDR_POS, value=0}, ComIPduSignalGroupRef=SG_Detections_021_024_oRDR_DETECTION_021_024_oPCAN_RADAR_ea3d35f7_Tx, ComPduIdRef=EcucPduCollection/RDR_DETECTION_021_024_oPCAN_RADAR_54f8af6e_Tx, ComIPduGroupRef=RDR02_oPCAN_RADAR_Tx_9f750495 if post-build-variant-condition{matching-criterion=RDR_POS, value=1}, ComIPduGroupRef=RDR03_oPCAN_RADAR_Tx_311d9504 if post-build-variant-condition{matching-criterion=RDR_POS, value=2}, ComIPduGroupRef=RDR04_oPCAN_RADAR_Tx_cce46d71 if post-build-variant-condition{matching-criterion=RDR_POS, value=3}, ComIPduGroupRef=RDR05_oPCAN_RADAR_Tx_628cfce0 if post-build-variant-condition{matching-criterion=RDR_POS, value=4}, ComIPduGroupRef=RDR06_oPCAN_RADAR_Tx_4b444812 if post-build-variant-condition{matching-criterion=RDR_POS, value=5}, ComIPduGroupRef=RDR07_oPCAN_RADAR_Tx_e52cd983 if post-build-variant-condition{matching-criterion=RDR_POS, value=6}, ComIPduGroupRef=RDR08_oPCAN_RADAR_Tx_6bc6beb9 if post-build-variant-condition{matching-criterion=RDR_POS, value=7}
          ComTxIPdu: ComMinimumDelayTime=0, ComTxIPduUnusedAreasDefault=0
        RDR_DETECTION_025_028_oPCAN_RADAR_bd4a315a_Tx: ComIPduDirection=SEND, ComIPduChannelRef=ComMConfigSet/CN_PCAN_RADAR_458ff0f1, ComIPduGroupRef=RDR01_oPCAN_RADAR_Tx_b6bdb067 if post-build-variant-condition{matching-criterion=RDR_POS, value=0}, ComIPduSignalGroupRef=SG_Detections_025_028_oRDR_DETECTION_025_028_oPCAN_RADAR_9bfe01a5_Tx, ComPduIdRef=EcucPduCollection/RDR_DETECTION_025_028_oPCAN_RADAR_bd4a315a_Tx, ComIPduGroupRef=RDR02_oPCAN_RADAR_Tx_9f750495 if post-build-variant-condition{matching-criterion=RDR_POS, value=1}, ComIPduGroupRef=RDR03_oPCAN_RADAR_Tx_311d9504 if post-build-variant-condition{matching-criterion=RDR_POS, value=2}, ComIPduGroupRef=RDR04_oPCAN_RADAR_Tx_cce46d71 if post-build-variant-condition{matching-criterion=RDR_POS, value=3}, ComIPduGroupRef=RDR05_oPCAN_RADAR_Tx_628cfce0 if post-build-variant-condition{matching-criterion=RDR_POS, value=4}, ComIPduGroupRef=RDR06_oPCAN_RADAR_Tx_4b444812 if post-build-variant-condition{matching-criterion=RDR_POS, value=5}, ComIPduGroupRef=RDR07_oPCAN_RADAR_Tx_e52cd983 if post-build-variant-condition{matching-criterion=RDR_POS, value=6}, ComIPduGroupRef=RDR08_oPCAN_RADAR_Tx_6bc6beb9 if post-build-variant-condition{matching-criterion=RDR_POS, value=7}
          ComTxIPdu: ComMinimumDelayTime=0, ComTxIPduUnusedAreasDefault=0
        RDR_DETECTION_029_032_oPCAN_RADAR_8f02de5b_Tx: ComIPduDirection=SEND, ComIPduChannelRef=ComMConfigSet/CN_PCAN_RADAR_458ff0f1, ComIPduGroupRef=RDR01_oPCAN_RADAR_Tx_b6bdb067 if post-build-variant-condition{matching-criterion=RDR_POS, value=0}, ComIPduSignalGroupRef=SG_Detections_029_032_oRDR_DETECTION_029_032_oPCAN_RADAR_028425de_Tx, ComPduIdRef=EcucPduCollection/RDR_DETECTION_029_032_oPCAN_RADAR_8f02de5b_Tx, ComIPduGroupRef=RDR02_oPCAN_RADAR_Tx_9f750495 if post-build-variant-condition{matching-criterion=RDR_POS, value=1}, ComIPduGroupRef=RDR03_oPCAN_RADAR_Tx_311d9504 if post-build-variant-condition{matching-criterion=RDR_POS, value=2}, ComIPduGroupRef=RDR04_oPCAN_RADAR_Tx_cce46d71 if post-build-variant-condition{matching-criterion=RDR_POS, value=3}, ComIPduGroupRef=RDR05_oPCAN_RADAR_Tx_628cfce0 if post-build-variant-condition{matching-criterion=RDR_POS, value=4}, ComIPduGroupRef=RDR06_oPCAN_RADAR_Tx_4b444812 if post-build-variant-condition{matching-criterion=RDR_POS, value=5}, ComIPduGroupRef=RDR07_oPCAN_RADAR_Tx_e52cd983 if post-build-variant-condition{matching-criterion=RDR_POS, value=6}, ComIPduGroupRef=RDR08_oPCAN_RADAR_Tx_6bc6beb9 if post-build-variant-condition{matching-criterion=RDR_POS, value=7}
          ComTxIPdu: ComMinimumDelayTime=0, ComTxIPduUnusedAreasDefault=0
