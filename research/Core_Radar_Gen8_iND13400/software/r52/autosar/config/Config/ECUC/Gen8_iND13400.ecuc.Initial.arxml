[part 23 of 24: package /InitialEcuC]
AUTOSAR XML (schema 00053)
package /InitialEcuC  (continued)
  module config Dem
    DemGeneral:  # Diagnostics Data Import
      DemOBDSupport = DEM_OBD_NO_OBD_SUPPORT
      DemAgingCycleCounterProcessing = DEM_PROCESS_AGINGCTR_INTERN
      DemDebounceCounterBasedSupport = true
      DemPTOSupport = false
      DemDtcStatusAvailabilityMask = 255
      7 x DemDataClass:
        Data_AgingCounter_Aging_Counter: DemDataElementDataSize=1, DemDataElementInternalData=DEM_AGINGCTR_UPCNT, DemDataElementUsePort=USE_DATA_INTERNAL  # Diagnostics Data Import
        Data_OccurrenceCounter_Occurrence_Counter: DemDataElementDataSize=1, DemDataElementInternalData=DEM_OCCCTR, DemDataElementUsePort=USE_DATA_INTERNAL  # Diagnostics Data Import
        Data_DID_0x1116_CombinedSignal: DemDataElementDataSize=7, DemDataElementDataType=UINT8_N, DemDataElementEndianness=opaque, DemDataElementUsePort=USE_DATA_CLIENT_SERVER_PORT, DemDataElementStoreNonVolatile=true  # Diagnostics Data Import
        Data_DID_0x1112_VehicleSpeed: DemDataElementDataSize=2, DemDataElementDataType=UINT8_N, DemDataElementEndianness=opaque, DemDataElementUsePort=USE_DATA_CLIENT_SERVER_PORT, DemDataElementStoreNonVolatile=true  # Diagnostics Data Import
        Data_DID_0x1111_ECUVoltage: DemDataElementDataSize=2, DemDataElementDataType=UINT8_N, DemDataElementEndianness=opaque, DemDataElementUsePort=USE_DATA_CLIENT_SERVER_PORT, DemDataElementStoreNonVolatile=true  # Diagnostics Data Import
        Data_DID_0x1117_Sensor_Availability_Flag_Information: DemDataElementDataSize=1, DemDataElementDataType=UINT8_N, DemDataElementEndianness=opaque, DemDataElementUsePort=USE_DATA_CLIENT_SERVER_PORT, DemDataElementStoreNonVolatile=true  # Diagnostics Data Import
        Data_DID_0xa004_Ego_Acceleration: DemDataElementDataSize=1, DemDataElementDataType=UINT8_N, DemDataElementEndianness=opaque, DemDataElementUsePort=USE_DATA_CLIENT_SERVER_PORT, DemDataElementStoreNonVolatile=true  # Diagnostics Data Import
      Power_On_Off (DemOperationCycle): DemOperationCycleAutostart=true, DemOperationCycleType=DEM_OPCYC_POWER  # Diagnostics Data Import
      4 x DemIndicator:
        HVIL_Open_Circuit  # Diagnostics Data Import
        ESC_Fault  # Diagnostics Data Import
        Brake_system_fault  # Diagnostics Data Import
        ABS_Fault  # Diagnostics Data Import
      FreezeFrameRecNum_8514b953 (DemFreezeFrameRecNumClass): DemFreezeFrameRecordClassRef=Last_Occurrence  # Diagnostics Data Import
      Last_Occurrence (DemFreezeFrameRecordClass): DemFreezeFrameRecordNumber=1, DemFreezeFrameRecordTrigger=DEM_TRIGGER_ON_TEST_FAILED, DemFreezeFrameRecordUpdate=DEM_UPDATE_RECORD_YES  # Diagnostics Data Import
      FreezeFrame_d41460f8 (DemFreezeFrameClass):  # Diagnostics Data Import
        DemDidClassRef = DID_ECUVoltage_Read_0x1111
        DemDidClassRef = DID_VehicleSpeed_Read_0x1112
        DemDidClassRef = DID_DateandTime_Read_0x1116
        DemDidClassRef = DID_Sensor_Availability_Flag_Read_0x1117
        DemDidClassRef = DID_Ego_Acceleration_Read_0xa004
      ExtendedDataRecord_AgingCounter (DemExtendedDataRecordClass):  # Diagnostics Data Import
        DemExtendedDataRecordNumber = 2
        DemExtendedDataRecordTrigger = DEM_TRIGGER_ON_CONFIRMED
        DemExtendedDataRecordUpdate = DEM_UPDATE_RECORD_YES
        DemDataClassRef = Data_AgingCounter_Aging_Counter
      ExtendedDataRecord_OccurrenceCounter (DemExtendedDataRecordClass):  # Diagnostics Data Import
        DemExtendedDataRecordNumber = 1
        DemExtendedDataRecordTrigger = DEM_TRIGGER_ON_CONFIRMED
        DemExtendedDataRecordUpdate = DEM_UPDATE_RECORD_YES
        DemDataClassRef = Data_OccurrenceCounter_Occurrence_Counter
      ExtendedDataClass_6d15841f (DemExtendedDataClass): DemExtendedDataRecordClassRef=ExtendedDataRecord_OccurrenceCounter, DemExtendedDataRecordClassRef=ExtendedDataRecord_AgingCounter  # Diagnostics Data Import
      5 x DemDidClass:
        DID_Ego_Acceleration_Read_0xa004: DemDidIdentifier=40964, DemDidDataClassRef=Data_DID_0xa004_Ego_Acceleration  # Diagnostics Data Import
        DID_Sensor_Availability_Flag_Read_0x1117: DemDidIdentifier=4375, DemDidDataClassRef=Data_DID_0x1117_Sensor_Availability_Flag_Information  # Diagnostics Data Import
        DID_DateandTime_Read_0x1116: DemDidIdentifier=4374, DemDidDataClassRef=Data_DID_0x1116_CombinedSignal  # Diagnostics Data Import
        DID_VehicleSpeed_Read_0x1112: DemDidIdentifier=4370, DemDidDataClassRef=Data_DID_0x1112_VehicleSpeed  # Diagnostics Data Import
        DID_ECUVoltage_Read_0x1111: DemDidIdentifier=4369, DemDidDataClassRef=Data_DID_0x1111_ECUVoltage  # Diagnostics Data Import
      DemEventMemorySet  # Diagnostics Data Import
        PrimaryMemory (DemPrimaryMemory): DemTypeOfFreezeFrameRecordNumeration=DEM_FF_RECNUM_CONFIGURED  # Diagnostics Data Import
    DemConfigSet  # Diagnostics Data Import
      Counter_Based_Debouncing (DemDebounceCounterBasedClass):  # Diagnostics Data Import
        DemDebounceCounterDecrementStepSize = 20
        DemDebounceCounterIncrementStepSize = 20
        DemDebounceCounterJumpDown = true
        DemDebounceCounterJumpDownValue = 0
        DemDebounceCounterJumpUp = false
        DemDebounceCounterJumpUpValue = 0
        DemDebounceCounterFailedThreshold = 127
        DemDebounceCounterPassedThreshold = -128
      Exceeded_Security_Access_0x27_Attempt_Threshold_Authentication_Failure (DemEventParameter):  # Diagnostics Data Import
        DemEventKind = DEM_EVENT_KIND_SWC
        DemDTCClassRef = DTCClass_DtcClass_DTC_0xD4438A
        DemExtendedDataClassRef = ExtendedDataClass_6d15841f
        DemFreezeFrameClassRef = FreezeFrame_d41460f8
        DemFreezeFrameRecNumClassRef = FreezeFrameRecNum_8514b953
        DemEventClass:  # Diagnostics Data Import
          DemAgingAllowed = true
          DemAgingCycleCounterThreshold = 40
          DemEventPriority = 2
          DemEventSignificance = DEM_EVENT_SIGNIFICANCE_FAULT
          DemFFPrestorageSupported = false
          DemAgingCycleRef = Power_On_Off
          DemOperationCycleRef = Power_On_Off
        DemDebounceAlgorithmClass  # Diagnostics Data Import
          DemDebounceCounterBased: DemDebounceCounterBasedClassRef=Counter_Based_Debouncing  # Diagnostics Data Import
      DTCClass_DtcClass_DTC_0xD4438A (DemDTCClass): DemDTCSeverity=DEM_DTC_SEV_NO_SEVERITY, DemUdsDTC=13910922, DemDTCAttributesRef=DtcAttributes_41914fb7  # Diagnostics Data Import
      PCAN_TimeSync_Missing_Message (DemEventParameter):  # Diagnostics Data Import
        DemEventKind = DEM_EVENT_KIND_SWC
        DemEventAvailableInVariant = true if post-build-variant-condition{matching-criterion=RDR_POS, value=0}
        DemEventAvailableInVariant = false if post-build-variant-condition{matching-criterion=RDR_POS, value=1}
        DemEventAvailableInVariant = false if post-build-variant-condition{matching-criterion=RDR_POS, value=2}
        DemEventAvailableInVariant = true if post-build-variant-condition{matching-criterion=RDR_POS, value=3}
        DemEventAvailableInVariant = false if post-build-variant-condition{matching-criterion=RDR_POS, value={4..7}}
        DemDTCClassRef = DTCClass_DtcClass_DTC_0xD44187
        DemExtendedDataClassRef = ExtendedDataClass_6d15841f
        DemFreezeFrameClassRef = FreezeFrame_d41460f8
        DemFreezeFrameRecNumClassRef = FreezeFrameRecNum_8514b953
        DemEventClass:  # Diagnostics Data Import
          DemAgingAllowed = true
          DemAgingCycleCounterThreshold = 40
          DemEventPriority = 2
          DemEventSignificance = DEM_EVENT_SIGNIFICANCE_FAULT
          DemFFPrestorageSupported = false
          DemAgingCycleRef = Power_On_Off
          DemOperationCycleRef = Power_On_Off
        DemDebounceAlgorithmClass  # Diagnostics Data Import
          DemDebounceCounterBased: DemDebounceCounterBasedClassRef=Counter_Based_Debouncing  # Diagnostics Data Import
      DTCClass_DtcClass_DTC_0xD44187 (DemDTCClass): DemDTCSeverity=DEM_DTC_SEV_NO_SEVERITY, DemUdsDTC=13910407, DemDTCAttributesRef=DtcAttributes_41914fb7  # Diagnostics Data Import
      Front_Left_Side_Radar_value_of_signal_protection_calculation_Incorrect (DemEventParameter):  # Diagnostics Data Import
        DemEventKind = DEM_EVENT_KIND_SWC
        DemEventAvailableInVariant = true if post-build-variant-condition{matching-criterion=RDR_POS, value=0}
        DemEventAvailableInVariant = false if post-build-variant-condition{matching-criterion=RDR_POS, value={1..7}}
        DemDTCClassRef = DTCClass_DtcClass_DTC_0xD44083
        DemExtendedDataClassRef = ExtendedDataClass_6d15841f
        DemFreezeFrameClassRef = FreezeFrame_d41460f8
        DemFreezeFrameRecNumClassRef = FreezeFrameRecNum_8514b953
        DemEventClass:  # Diagnostics Data Import
          DemAgingAllowed = true
          DemAgingCycleCounterThreshold = 40
          DemEventPriority = 2
          DemEventSignificance = DEM_EVENT_SIGNIFICANCE_FAULT
          DemFFPrestorageSupported = false
          DemAgingCycleRef = Power_On_Off
          DemOperationCycleRef = Power_On_Off
        DemDebounceAlgorithmClass  # Diagnostics Data Import
          DemDebounceCounterBased: DemDebounceCounterBasedClassRef=Counter_Based_Debouncing  # Diagnostics Data Import
      DTCClass_DtcClass_DTC_0xD44083 (DemDTCClass): DemDTCSeverity=DEM_DTC_SEV_NO_SEVERITY, DemUdsDTC=13910147, DemDTCAttributesRef=DtcAttributes_41914fb7  # Diagnostics Data Import
      Front_Left_Side_Radar_Missing_Message (DemEventParameter):  # Diagnostics Data Import
        DemEventKind = DEM_EVENT_KIND_SWC
        DemEventAvailableInVariant = true if post-build-variant-condition{matching-criterion=RDR_POS, value=0}
        DemEventAvailableInVariant = false if post-build-variant-condition{matching-criterion=RDR_POS, value={1..7}}
        DemDTCClassRef = DTCClass_DtcClass_DTC_0xD43987
        DemExtendedDataClassRef = ExtendedDataClass_6d15841f
        DemFreezeFrameClassRef = FreezeFrame_d41460f8
        DemFreezeFrameRecNumClassRef = FreezeFrameRecNum_8514b953
        DemEventClass:  # Diagnostics Data Import
          DemAgingAllowed = true
          DemAgingCycleCounterThreshold = 40
          DemEventPriority = 2
          DemEventSignificance = DEM_EVENT_SIGNIFICANCE_FAULT
          DemFFPrestorageSupported = false
          DemAgingCycleRef = Power_On_Off
          DemOperationCycleRef = Power_On_Off
        DemDebounceAlgorithmClass  # Diagnostics Data Import
          DemDebounceCounterBased: DemDebounceCounterBasedClassRef=Counter_Based_Debouncing  # Diagnostics Data Import
      DTCClass_DtcClass_DTC_0xD43987 (DemDTCClass): DemDTCSeverity=DEM_DTC_SEV_NO_SEVERITY, DemUdsDTC=13908359, DemDTCAttributesRef=DtcAttributes_41914fb7  # Diagnostics Data Import
      ADAS_FN_STS_message_MOIS_FN_Switch_STS_Invalid_Serial_Data_Received (DemEventParameter):  # Diagnostics Data Import
        DemEventKind = DEM_EVENT_KIND_SWC
        DemDTCClassRef = DTCClass_DtcClass_DTC_0xD43781
        DemExtendedDataClassRef = ExtendedDataClass_6d15841f
        DemFreezeFrameClassRef = FreezeFrame_d41460f8
        DemFreezeFrameRecNumClassRef = FreezeFrameRecNum_8514b953
        DemEventClass:  # Diagnostics Data Import
          DemAgingAllowed = true
          DemAgingCycleCounterThreshold = 40
          DemEventPriority = 2
          DemEventSignificance = DEM_EVENT_SIGNIFICANCE_FAULT
          DemFFPrestorageSupported = false
          DemAgingCycleRef = Power_On_Off
          DemOperationCycleRef = Power_On_Off
        DemDebounceAlgorithmClass  # Diagnostics Data Import
          DemDebounceCounterBased: DemDebounceCounterBasedClassRef=Counter_Based_Debouncing  # Diagnostics Data Import
      DTCClass_DtcClass_DTC_0xD43781 (DemDTCClass): DemDTCSeverity=DEM_DTC_SEV_NO_SEVERITY, DemUdsDTC=13907841, DemDTCAttributesRef=DtcAttributes_41914fb7  # Diagnostics Data Import
      ADAS_FN_STS_message_BSIS_FN_Switch_STS_Invalid_Serial_Data_Received (DemEventParameter):  # Diagnostics Data Import
        DemEventKind = DEM_EVENT_KIND_SWC
        DemDTCClassRef = DTCClass_DtcClass_DTC_0xD43681
        DemExtendedDataClassRef = ExtendedDataClass_6d15841f
        DemFreezeFrameClassRef = FreezeFrame_d41460f8
        DemFreezeFrameRecNumClassRef = FreezeFrameRecNum_8514b953
        DemEventClass:  # Diagnostics Data Import
          DemAgingAllowed = true
          DemAgingCycleCounterThreshold = 40
          DemEventPriority = 2
          DemEventSignificance = DEM_EVENT_SIGNIFICANCE_FAULT
          DemFFPrestorageSupported = false
          DemAgingCycleRef = Power_On_Off
          DemOperationCycleRef = Power_On_Off
        DemDebounceAlgorithmClass  # Diagnostics Data Import
          DemDebounceCounterBased: DemDebounceCounterBasedClassRef=Counter_Based_Debouncing  # Diagnostics Data Import
      DTCClass_DtcClass_DTC_0xD43681 (DemDTCClass): DemDTCSeverity=DEM_DTC_SEV_NO_SEVERITY, DemUdsDTC=13907585, DemDTCAttributesRef=DtcAttributes_41914fb7  # Diagnostics Data Import
      VDC2_message_LongitudinalAcceleration_Invalid_Serial_Data_Received (DemEventParameter):  # Diagnostics Data Import
        DemEventKind = DEM_EVENT_KIND_SWC
        DemDTCClassRef = DTCClass_DtcClass_DTC_0xD43581
        DemExtendedDataClassRef = ExtendedDataClass_6d15841f
        DemFreezeFrameClassRef = FreezeFrame_d41460f8
        DemFreezeFrameRecNumClassRef = FreezeFrameRecNum_8514b953
        DemEventClass:  # Diagnostics Data Import
          DemAgingAllowed = true
          DemAgingCycleCounterThreshold = 40
          DemEventPriority = 2
          DemEventSignificance = DEM_EVENT_SIGNIFICANCE_FAULT
          DemFFPrestorageSupported = false
          DemAgingCycleRef = Power_On_Off
          DemOperationCycleRef = Power_On_Off
        DemDebounceAlgorithmClass  # Diagnostics Data Import
          DemDebounceCounterBased: DemDebounceCounterBasedClassRef=Counter_Based_Debouncing  # Diagnostics Data Import
      DTCClass_DtcClass_DTC_0xD43581 (DemDTCClass): DemDTCSeverity=DEM_DTC_SEV_NO_SEVERITY, DemUdsDTC=13907329, DemDTCAttributesRef=DtcAttributes_41914fb7  # Diagnostics Data Import
      VDC2_message_Lateral_Accleration_Invalid_Serial_Data_Received (DemEventParameter):  # Diagnostics Data Import
        DemEventKind = DEM_EVENT_KIND_SWC
        DemDTCClassRef = DTCClass_DtcClass_DTC_0xD43481
        DemExtendedDataClassRef = ExtendedDataClass_6d15841f
        DemFreezeFrameClassRef = FreezeFrame_d41460f8
        DemFreezeFrameRecNumClassRef = FreezeFrameRecNum_8514b953
        DemEventClass:  # Diagnostics Data Import
          DemAgingAllowed = true
          DemAgingCycleCounterThreshold = 40
          DemEventPriority = 2
          DemEventSignificance = DEM_EVENT_SIGNIFICANCE_FAULT
          DemFFPrestorageSupported = false
          DemAgingCycleRef = Power_On_Off
          DemOperationCycleRef = Power_On_Off
        DemDebounceAlgorithmClass  # Diagnostics Data Import
          DemDebounceCounterBased: DemDebounceCounterBasedClassRef=Counter_Based_Debouncing  # Diagnostics Data Import
      DTCClass_DtcClass_DTC_0xD43481 (DemDTCClass): DemDTCSeverity=DEM_DTC_SEV_NO_SEVERITY, DemUdsDTC=13907073, DemDTCAttributesRef=DtcAttributes_41914fb7  # Diagnostics Data Import
      VDC2_message_Yaw_rate_Invalid_Serial_Data_Received (DemEventParameter):  # Diagnostics Data Import
        DemEventKind = DEM_EVENT_KIND_SWC
        DemDTCClassRef = DTCClass_DtcClass_DTC_0xD43381
        DemExtendedDataClassRef = ExtendedDataClass_6d15841f
        DemFreezeFrameClassRef = FreezeFrame_d41460f8
        DemFreezeFrameRecNumClassRef = FreezeFrameRecNum_8514b953
        DemEventClass:  # Diagnostics Data Import
          DemAgingAllowed = true
          DemAgingCycleCounterThreshold = 40
          DemEventPriority = 2
          DemEventSignificance = DEM_EVENT_SIGNIFICANCE_FAULT
          DemFFPrestorageSupported = false
          DemAgingCycleRef = Power_On_Off
          DemOperationCycleRef = Power_On_Off
        DemDebounceAlgorithmClass  # Diagnostics Data Import
          DemDebounceCounterBased: DemDebounceCounterBasedClassRef=Counter_Based_Debouncing  # Diagnostics Data Import
      DTCClass_DtcClass_DTC_0xD43381 (DemDTCClass): DemDTCSeverity=DEM_DTC_SEV_NO_SEVERITY, DemUdsDTC=13906817, DemDTCAttributesRef=DtcAttributes_41914fb7  # Diagnostics Data Import
      SAS_message_Steering_Wheel_Angle_Invalid_Serial_Data_Received (DemEventParameter):  # Diagnostics Data Import
        DemEventKind = DEM_EVENT_KIND_SWC
        DemDTCClassRef = DTCClass_DtcClass_DTC_0xD43281
        DemExtendedDataClassRef = ExtendedDataClass_6d15841f
        DemFreezeFrameClassRef = FreezeFrame_d41460f8
        DemFreezeFrameRecNumClassRef = FreezeFrameRecNum_8514b953
        DemEventClass:  # Diagnostics Data Import
          DemAgingAllowed = true
          DemAgingCycleCounterThreshold = 40
          DemEventPriority = 2
          DemEventSignificance = DEM_EVENT_SIGNIFICANCE_FAULT
          DemFFPrestorageSupported = false
          DemAgingCycleRef = Power_On_Off
          DemOperationCycleRef = Power_On_Off
        DemDebounceAlgorithmClass  # Diagnostics Data Import
          DemDebounceCounterBased: DemDebounceCounterBasedClassRef=Counter_Based_Debouncing  # Diagnostics Data Import
      DTCClass_DtcClass_DTC_0xD43281 (DemDTCClass): DemDTCSeverity=DEM_DTC_SEV_NO_SEVERITY, DemUdsDTC=13906561, DemDTCAttributesRef=DtcAttributes_41914fb7  # Diagnostics Data Import
      OEL_message_Turn_Signal_Switch_Invalid_Serial_Data_Received (DemEventParameter):  # Diagnostics Data Import
        DemEventKind = DEM_EVENT_KIND_SWC
        DemDTCClassRef = DTCClass_DtcClass_DTC_0xD43181
        DemExtendedDataClassRef = ExtendedDataClass_6d15841f
        DemFreezeFrameClassRef = FreezeFrame_d41460f8
        DemFreezeFrameRecNumClassRef = FreezeFrameRecNum_8514b953
        DemEventClass:  # Diagnostics Data Import
          DemAgingAllowed = true
          DemAgingCycleCounterThreshold = 40
          DemEventPriority = 2
          DemEventSignificance = DEM_EVENT_SIGNIFICANCE_FAULT
          DemFFPrestorageSupported = false
          DemAgingCycleRef = Power_On_Off
          DemOperationCycleRef = Power_On_Off
        DemDebounceAlgorithmClass  # Diagnostics Data Import
          DemDebounceCounterBased: DemDebounceCounterBasedClassRef=Counter_Based_Debouncing  # Diagnostics Data Import
      DTCClass_DtcClass_DTC_0xD43181 (DemDTCClass): DemDTCSeverity=DEM_DTC_SEV_NO_SEVERITY, DemUdsDTC=13906305, DemDTCAttributesRef=DtcAttributes_41914fb7  # Diagnostics Data Import
      AT_AMT_ETC2_message_Transcurrent_gear_Invalid_Serial_Data_Received (DemEventParameter):  # Diagnostics Data Import
        DemEventKind = DEM_EVENT_KIND_SWC
        DemDTCClassRef = DTCClass_DtcClass_DTC_0xD43081
        DemExtendedDataClassRef = ExtendedDataClass_6d15841f
        DemFreezeFrameClassRef = FreezeFrame_d41460f8
        DemFreezeFrameRecNumClassRef = FreezeFrameRecNum_8514b953
        DemEventClass:  # Diagnostics Data Import
          DemAgingAllowed = true
          DemAgingCycleCounterThreshold = 40
          DemEventPriority = 2
          DemEventSignificance = DEM_EVENT_SIGNIFICANCE_FAULT
          DemFFPrestorageSupported = false
          DemAgingCycleRef = Power_On_Off
          DemOperationCycleRef = Power_On_Off
        DemDebounceAlgorithmClass  # Diagnostics Data Import
          DemDebounceCounterBased: DemDebounceCounterBasedClassRef=Counter_Based_Debouncing  # Diagnostics Data Import
      DTCClass_DtcClass_DTC_0xD43081 (DemDTCClass): DemDTCSeverity=DEM_DTC_SEV_NO_SEVERITY, DemUdsDTC=13906049, DemDTCAttributesRef=DtcAttributes_41914fb7  # Diagnostics Data Import
      Manual_ETC2_message_Transcurrent_gear_Invalid_Serial_Data_Received (DemEventParameter):  # Diagnostics Data Import
        DemEventKind = DEM_EVENT_KIND_SWC
        DemDTCClassRef = DTCClass_DtcClass_DTC_0xD42981
        DemExtendedDataClassRef = ExtendedDataClass_6d15841f
        DemFreezeFrameClassRef = FreezeFrame_d41460f8
        DemFreezeFrameRecNumClassRef = FreezeFrameRecNum_8514b953
        DemEventClass:  # Diagnostics Data Import
          DemAgingAllowed = true
          DemAgingCycleCounterThreshold = 40
          DemEventPriority = 2
          DemEventSignificance = DEM_EVENT_SIGNIFICANCE_FAULT
          DemFFPrestorageSupported = false
          DemAgingCycleRef = Power_On_Off
          DemOperationCycleRef = Power_On_Off
        DemDebounceAlgorithmClass  # Diagnostics Data Import
          DemDebounceCounterBased: DemDebounceCounterBasedClassRef=Counter_Based_Debouncing  # Diagnostics Data Import
      DTCClass_DtcClass_DTC_0xD42981 (DemDTCClass): DemDTCSeverity=DEM_DTC_SEV_NO_SEVERITY, DemUdsDTC=13904257, DemDTCAttributesRef=DtcAttributes_41914fb7  # Diagnostics Data Import
      CLS_TX_16_message_Transmission_Type_info_Invalid_Serial_Data_Received (DemEventParameter):  # Diagnostics Data Import
        DemEventKind = DEM_EVENT_KIND_SWC
        DemDTCClassRef = DTCClass_DtcClass_DTC_0xD42781
        DemExtendedDataClassRef = ExtendedDataClass_6d15841f
        DemFreezeFrameClassRef = FreezeFrame_d41460f8
        DemFreezeFrameRecNumClassRef = FreezeFrameRecNum_8514b953
        DemEventClass:  # Diagnostics Data Import
          DemAgingAllowed = true
          DemAgingCycleCounterThreshold = 40
          DemEventPriority = 2
          DemEventSignificance = DEM_EVENT_SIGNIFICANCE_FAULT
          DemFFPrestorageSupported = false
          DemAgingCycleRef = Power_On_Off
          DemOperationCycleRef = Power_On_Off
        DemDebounceAlgorithmClass  # Diagnostics Data Import
          DemDebounceCounterBased: DemDebounceCounterBasedClassRef=Counter_Based_Debouncing  # Diagnostics Data Import
      DTCClass_DtcClass_DTC_0xD42781 (DemDTCClass): DemDTCSeverity=DEM_DTC_SEV_NO_SEVERITY, DemUdsDTC=13903745, DemDTCAttributesRef=DtcAttributes_41914fb7  # Diagnostics Data Import
      CCVS1_message_Vehicle_Speed_Invalid_Serial_Data_Received (DemEventParameter):  # Diagnostics Data Import
        DemEventKind = DEM_EVENT_KIND_SWC
        DemDTCClassRef = DTCClass_DtcClass_DTC_0xD42681
        DemExtendedDataClassRef = ExtendedDataClass_6d15841f
        DemFreezeFrameClassRef = FreezeFrame_d41460f8
        DemFreezeFrameRecNumClassRef = FreezeFrameRecNum_8514b953
        DemEventClass:  # Diagnostics Data Import
          DemAgingAllowed = true
          DemAgingCycleCounterThreshold = 40
          DemEventPriority = 2
          DemEventSignificance = DEM_EVENT_SIGNIFICANCE_FAULT
          DemFFPrestorageSupported = false
          DemAgingCycleRef = Power_On_Off
          DemOperationCycleRef = Power_On_Off
        DemDebounceAlgorithmClass  # Diagnostics Data Import
          DemDebounceCounterBased: DemDebounceCounterBasedClassRef=Counter_Based_Debouncing  # Diagnostics Data Import
      DTCClass_DtcClass_DTC_0xD42681 (DemDTCClass): DemDTCSeverity=DEM_DTC_SEV_NO_SEVERITY, DemUdsDTC=13903489, DemDTCAttributesRef=DtcAttributes_41914fb7  # Diagnostics Data Import
      SAS_ECU_erratic_communication_Erratic (DemEventParameter):  # Diagnostics Data Import
        DemEventKind = DEM_EVENT_KIND_SWC
        DemDTCClassRef = DTCClass_DtcClass_DTC_0xD4258F
        DemExtendedDataClassRef = ExtendedDataClass_6d15841f
        DemFreezeFrameClassRef = FreezeFrame_d41460f8
        DemFreezeFrameRecNumClassRef = FreezeFrameRecNum_8514b953
        DemEventClass:  # Diagnostics Data Import
          DemAgingAllowed = true
          DemAgingCycleCounterThreshold = 40
          DemEventPriority = 2
          DemEventSignificance = DEM_EVENT_SIGNIFICANCE_FAULT
          DemFFPrestorageSupported = false
          DemAgingCycleRef = Power_On_Off
          DemOperationCycleRef = Power_On_Off
        DemDebounceAlgorithmClass  # Diagnostics Data Import
          DemDebounceCounterBased: DemDebounceCounterBasedClassRef=Counter_Based_Debouncing  # Diagnostics Data Import
      DTCClass_DtcClass_DTC_0xD4258F (DemDTCClass): DemDTCSeverity=DEM_DTC_SEV_NO_SEVERITY, DemUdsDTC=13903247, DemDTCAttributesRef=DtcAttributes_41914fb7  # Diagnostics Data Import
      Cluster_ECU_TD_erratic_communication_Erratic (DemEventParameter):  # Diagnostics Data Import
        DemEventKind = DEM_EVENT_KIND_SWC
        DemDTCClassRef = DTCClass_DtcClass_DTC_0xD4248F
        DemExtendedDataClassRef = ExtendedDataClass_6d15841f
        DemFreezeFrameClassRef = FreezeFrame_d41460f8
        DemFreezeFrameRecNumClassRef = FreezeFrameRecNum_8514b953
        DemEventClass:  # Diagnostics Data Import
          DemAgingAllowed = true
          DemAgingCycleCounterThreshold = 40
          DemEventPriority = 2
          DemEventSignificance = DEM_EVENT_SIGNIFICANCE_FAULT
          DemFFPrestorageSupported = false
          DemAgingCycleRef = Power_On_Off
          DemOperationCycleRef = Power_On_Off
        DemDebounceAlgorithmClass  # Diagnostics Data Import
          DemDebounceCounterBased: DemDebounceCounterBasedClassRef=Counter_Based_Debouncing  # Diagnostics Data Import
      DTCClass_DtcClass_DTC_0xD4248F (DemDTCClass): DemDTCSeverity=DEM_DTC_SEV_NO_SEVERITY, DemUdsDTC=13902991, DemDTCAttributesRef=DtcAttributes_41914fb7  # Diagnostics Data Import
      Cluster_ECU_ADAS_FN_STS_erratic_communication_Erratic (DemEventParameter):  # Diagnostics Data Import
        DemEventKind = DEM_EVENT_KIND_SWC
        DemDTCClassRef = DTCClass_DtcClass_DTC_0xD4238F
        DemExtendedDataClassRef = ExtendedDataClass_6d15841f
        DemFreezeFrameClassRef = FreezeFrame_d41460f8
        DemFreezeFrameRecNumClassRef = FreezeFrameRecNum_8514b953
        DemEventClass:  # Diagnostics Data Import
          DemAgingAllowed = true
          DemAgingCycleCounterThreshold = 40
          DemEventPriority = 2
          DemEventSignificance = DEM_EVENT_SIGNIFICANCE_FAULT
          DemFFPrestorageSupported = false
          DemAgingCycleRef = Power_On_Off
          DemOperationCycleRef = Power_On_Off
        DemDebounceAlgorithmClass  # Diagnostics Data Import
          DemDebounceCounterBased: DemDebounceCounterBasedClassRef=Counter_Based_Debouncing  # Diagnostics Data Import
      DTCClass_DtcClass_DTC_0xD4238F (DemDTCClass): DemDTCSeverity=DEM_DTC_SEV_NO_SEVERITY, DemUdsDTC=13902735, DemDTCAttributesRef=DtcAttributes_41914fb7  # Diagnostics Data Import
      Cluster_ECU_OEL_erratic_communication_Erratic (DemEventParameter):  # Diagnostics Data Import
        DemEventKind = DEM_EVENT_KIND_SWC
        DemDTCClassRef = DTCClass_DtcClass_DTC_0xD4228F
        DemExtendedDataClassRef = ExtendedDataClass_6d15841f
        DemFreezeFrameClassRef = FreezeFrame_d41460f8
        DemFreezeFrameRecNumClassRef = FreezeFrameRecNum_8514b953
        DemEventClass:  # Diagnostics Data Import
          DemAgingAllowed = true
          DemAgingCycleCounterThreshold = 40
          DemEventPriority = 2
          DemEventSignificance = DEM_EVENT_SIGNIFICANCE_FAULT
          DemFFPrestorageSupported = false
          DemAgingCycleRef = Power_On_Off
          DemOperationCycleRef = Power_On_Off
        DemDebounceAlgorithmClass  # Diagnostics Data Import
          DemDebounceCounterBased: DemDebounceCounterBasedClassRef=Counter_Based_Debouncing  # Diagnostics Data Import
      DTCClass_DtcClass_DTC_0xD4228F (DemDTCClass): DemDTCSeverity=DEM_DTC_SEV_NO_SEVERITY, DemUdsDTC=13902479, DemDTCAttributesRef=DtcAttributes_41914fb7  # Diagnostics Data Import
      Cluster_ECU_CLS_Tx_16_erratic_communication_Erratic (DemEventParameter):  # Diagnostics Data Import
        DemEventKind = DEM_EVENT_KIND_SWC
        DemDTCClassRef = DTCClass_DtcClass_DTC_0xD4218F
        DemExtendedDataClassRef = ExtendedDataClass_6d15841f
        DemFreezeFrameClassRef = FreezeFrame_d41460f8
        DemFreezeFrameRecNumClassRef = FreezeFrameRecNum_8514b953
        DemEventClass:  # Diagnostics Data Import
          DemAgingAllowed = true
          DemAgingCycleCounterThreshold = 40
          DemEventPriority = 2
          DemEventSignificance = DEM_EVENT_SIGNIFICANCE_FAULT
          DemFFPrestorageSupported = false
          DemAgingCycleRef = Power_On_Off
          DemOperationCycleRef = Power_On_Off
        DemDebounceAlgorithmClass  # Diagnostics Data Import
          DemDebounceCounterBased: DemDebounceCounterBasedClassRef=Counter_Based_Debouncing  # Diagnostics Data Import
      DTCClass_DtcClass_DTC_0xD4218F (DemDTCClass): DemDTCSeverity=DEM_DTC_SEV_NO_SEVERITY, DemUdsDTC=13902223, DemDTCAttributesRef=DtcAttributes_41914fb7  # Diagnostics Data Import
      Cluster_ECU_CLS_Tx_4_erratic_communication_Erratic (DemEventParameter):  # Diagnostics Data Import
        DemEventKind = DEM_EVENT_KIND_SWC
        DemDTCClassRef = DTCClass_DtcClass_DTC_0xD4208F
        DemExtendedDataClassRef = ExtendedDataClass_6d15841f
        DemFreezeFrameClassRef = FreezeFrame_d41460f8
        DemFreezeFrameRecNumClassRef = FreezeFrameRecNum_8514b953
        DemEventClass:  # Diagnostics Data Import
          DemAgingAllowed = true
          DemAgingCycleCounterThreshold = 40
          DemEventPriority = 2
          DemEventSignificance = DEM_EVENT_SIGNIFICANCE_FAULT
          DemFFPrestorageSupported = false
          DemAgingCycleRef = Power_On_Off
          DemOperationCycleRef = Power_On_Off
        DemDebounceAlgorithmClass  # Diagnostics Data Import
          DemDebounceCounterBased: DemDebounceCounterBasedClassRef=Counter_Based_Debouncing  # Diagnostics Data Import
      DTCClass_DtcClass_DTC_0xD4208F (DemDTCClass): DemDTCSeverity=DEM_DTC_SEV_NO_SEVERITY, DemUdsDTC=13901967, DemDTCAttributesRef=DtcAttributes_41914fb7  # Diagnostics Data Import
      AT_AMT_ETC2_erratic_communication_Erratic (DemEventParameter):  # Diagnostics Data Import
        DemEventKind = DEM_EVENT_KIND_SWC
        DemDTCClassRef = DTCClass_DtcClass_DTC_0xD4198F
        DemExtendedDataClassRef = ExtendedDataClass_6d15841f
        DemFreezeFrameClassRef = FreezeFrame_d41460f8
        DemFreezeFrameRecNumClassRef = FreezeFrameRecNum_8514b953
        DemEventClass:  # Diagnostics Data Import
          DemAgingAllowed = true
          DemAgingCycleCounterThreshold = 40
          DemEventPriority = 2
          DemEventSignificance = DEM_EVENT_SIGNIFICANCE_FAULT
          DemFFPrestorageSupported = false
          DemAgingCycleRef = Power_On_Off
          DemOperationCycleRef = Power_On_Off
        DemDebounceAlgorithmClass  # Diagnostics Data Import
          DemDebounceCounterBased: DemDebounceCounterBasedClassRef=Counter_Based_Debouncing  # Diagnostics Data Import
      DTCClass_DtcClass_DTC_0xD4198F (DemDTCClass): DemDTCSeverity=DEM_DTC_SEV_NO_SEVERITY, DemUdsDTC=13900175, DemDTCAttributesRef=DtcAttributes_41914fb7  # Diagnostics Data Import
      ESC_ECU_VDC2_erratic_communication_Erratic (DemEventParameter):  # Diagnostics Data Import
        DemEventKind = DEM_EVENT_KIND_SWC
        DemDTCClassRef = DTCClass_DtcClass_DTC_0xD4188F
        DemExtendedDataClassRef = ExtendedDataClass_6d15841f
        DemFreezeFrameClassRef = FreezeFrame_d41460f8
        DemFreezeFrameRecNumClassRef = FreezeFrameRecNum_8514b953
        DemEventClass:  # Diagnostics Data Import
          DemAgingAllowed = true
          DemAgingCycleCounterThreshold = 40
          DemEventPriority = 2
          DemEventSignificance = DEM_EVENT_SIGNIFICANCE_FAULT
          DemFFPrestorageSupported = false
          DemAgingCycleRef = Power_On_Off
          DemOperationCycleRef = Power_On_Off
        DemDebounceAlgorithmClass  # Diagnostics Data Import
          DemDebounceCounterBased: DemDebounceCounterBasedClassRef=Counter_Based_Debouncing  # Diagnostics Data Import
      DTCClass_DtcClass_DTC_0xD4188F (DemDTCClass): DemDTCSeverity=DEM_DTC_SEV_NO_SEVERITY, DemUdsDTC=13899919, DemDTCAttributesRef=DtcAttributes_41914fb7  # Diagnostics Data Import
      EMS_ECU_VD_erratic_communication_Erratic (DemEventParameter):  # Diagnostics Data Import
        DemEventKind = DEM_EVENT_KIND_SWC
        DemDTCClassRef = DTCClass_DtcClass_DTC_0xD4178F
        DemExtendedDataClassRef = ExtendedDataClass_6d15841f
        DemFreezeFrameClassRef = FreezeFrame_d41460f8
        DemFreezeFrameRecNumClassRef = FreezeFrameRecNum_8514b953
        DemEventClass:  # Diagnostics Data Import
          DemAgingAllowed = true
          DemAgingCycleCounterThreshold = 40
          DemEventPriority = 2
          DemEventSignificance = DEM_EVENT_SIGNIFICANCE_FAULT
          DemFFPrestorageSupported = false
          DemAgingCycleRef = Power_On_Off
          DemOperationCycleRef = Power_On_Off
        DemDebounceAlgorithmClass  # Diagnostics Data Import
          DemDebounceCounterBased: DemDebounceCounterBasedClassRef=Counter_Based_Debouncing  # Diagnostics Data Import
      DTCClass_DtcClass_DTC_0xD4178F (DemDTCClass): DemDTCSeverity=DEM_DTC_SEV_NO_SEVERITY, DemUdsDTC=13899663, DemDTCAttributesRef=DtcAttributes_41914fb7  # Diagnostics Data Import
      EMS_ECU_ETC2_erratic_communication_Erractic (DemEventParameter):  # Diagnostics Data Import
        DemEventKind = DEM_EVENT_KIND_SWC
        DemDTCClassRef = DTCClass_DtcClass_DTC_0xD4168F
        DemExtendedDataClassRef = ExtendedDataClass_6d15841f
        DemFreezeFrameClassRef = FreezeFrame_d41460f8
        DemFreezeFrameRecNumClassRef = FreezeFrameRecNum_8514b953
        DemEventClass:  # Diagnostics Data Import
          DemAgingAllowed = true
          DemAgingCycleCounterThreshold = 40
          DemEventPriority = 2
          DemEventSignificance = DEM_EVENT_SIGNIFICANCE_FAULT
          DemFFPrestorageSupported = false
          DemAgingCycleRef = Power_On_Off
          DemOperationCycleRef = Power_On_Off
        DemDebounceAlgorithmClass  # Diagnostics Data Import
          DemDebounceCounterBased: DemDebounceCounterBasedClassRef=Counter_Based_Debouncing  # Diagnostics Data Import
      DTCClass_DtcClass_DTC_0xD4168F (DemDTCClass): DemDTCSeverity=DEM_DTC_SEV_NO_SEVERITY, DemUdsDTC=13899407, DemDTCAttributesRef=DtcAttributes_41914fb7  # Diagnostics Data Import
      EMS_ECU_CCVS1_erratic_communication_Erractic (DemEventParameter):  # Diagnostics Data Import
        DemEventKind = DEM_EVENT_KIND_SWC
        DemDTCClassRef = DTCClass_DtcClass_DTC_0xD4158F
        DemExtendedDataClassRef = ExtendedDataClass_6d15841f
        DemFreezeFrameClassRef = FreezeFrame_d41460f8
        DemFreezeFrameRecNumClassRef = FreezeFrameRecNum_8514b953
        DemEventClass:  # Diagnostics Data Import
          DemAgingAllowed = true
          DemAgingCycleCounterThreshold = 40
          DemEventPriority = 2
          DemEventSignificance = DEM_EVENT_SIGNIFICANCE_FAULT
          DemFFPrestorageSupported = false
          DemAgingCycleRef = Power_On_Off
          DemOperationCycleRef = Power_On_Off
        DemDebounceAlgorithmClass  # Diagnostics Data Import
          DemDebounceCounterBased: DemDebounceCounterBasedClassRef=Counter_Based_Debouncing  # Diagnostics Data Import
      DTCClass_DtcClass_DTC_0xD4158F (DemDTCClass): DemDTCSeverity=DEM_DTC_SEV_NO_SEVERITY, DemUdsDTC=13899151, DemDTCAttributesRef=DtcAttributes_41914fb7  # Diagnostics Data Import
      SAS_ECU_SAS_message_Missing_Message (DemEventParameter):  # Diagnostics Data Import
        DemEventKind = DEM_EVENT_KIND_SWC
        DemDTCClassRef = DTCClass_DtcClass_DTC_0xD41387
        DemExtendedDataClassRef = ExtendedDataClass_6d15841f
        DemFreezeFrameClassRef = FreezeFrame_d41460f8
        DemFreezeFrameRecNumClassRef = FreezeFrameRecNum_8514b953
        DemEventClass:  # Diagnostics Data Import
          DemAgingAllowed = true
          DemAgingCycleCounterThreshold = 40
          DemEventPriority = 2
          DemEventSignificance = DEM_EVENT_SIGNIFICANCE_FAULT
          DemFFPrestorageSupported = false
          DemAgingCycleRef = Power_On_Off
          DemOperationCycleRef = Power_On_Off
        DemDebounceAlgorithmClass  # Diagnostics Data Import
          DemDebounceCounterBased: DemDebounceCounterBasedClassRef=Counter_Based_Debouncing  # Diagnostics Data Import
      DTCClass_DtcClass_DTC_0xD41387 (DemDTCClass): DemDTCSeverity=DEM_DTC_SEV_NO_SEVERITY, DemUdsDTC=13898631, DemDTCAttributesRef=DtcAttributes_41914fb7  # Diagnostics Data Import
      Cluster_ECU_TD_message_Missing_Message (DemEventParameter):  # Diagnostics Data Import
        DemEventKind = DEM_EVENT_KIND_SWC
        DemDTCClassRef = DTCClass_DtcClass_DTC_0xD41287
        DemExtendedDataClassRef = ExtendedDataClass_6d15841f
        DemFreezeFrameClassRef = FreezeFrame_d41460f8
        DemFreezeFrameRecNumClassRef = FreezeFrameRecNum_8514b953
        DemEventClass:  # Diagnostics Data Import
          DemAgingAllowed = true
          DemAgingCycleCounterThreshold = 40
          DemEventPriority = 2
          DemEventSignificance = DEM_EVENT_SIGNIFICANCE_FAULT
          DemFFPrestorageSupported = false
          DemAgingCycleRef = Power_On_Off
          DemOperationCycleRef = Power_On_Off
        DemDebounceAlgorithmClass  # Diagnostics Data Import
          DemDebounceCounterBased: DemDebounceCounterBasedClassRef=Counter_Based_Debouncing  # Diagnostics Data Import
      DTCClass_DtcClass_DTC_0xD41287 (DemDTCClass): DemDTCSeverity=DEM_DTC_SEV_NO_SEVERITY, DemUdsDTC=13898375, DemDTCAttributesRef=DtcAttributes_41914fb7  # Diagnostics Data Import
      Cluster_ECU_OEL_message_Missing_Message (DemEventParameter):  # Diagnostics Data Import
        DemEventKind = DEM_EVENT_KIND_SWC
        DemDTCClassRef = DTCClass_DtcClass_DTC_0xD41187
        DemExtendedDataClassRef = ExtendedDataClass_6d15841f
        DemFreezeFrameClassRef = FreezeFrame_d41460f8
        DemFreezeFrameRecNumClassRef = FreezeFrameRecNum_8514b953
        DemEventClass:  # Diagnostics Data Import
          DemAgingAllowed = true
          DemAgingCycleCounterThreshold = 40
          DemEventPriority = 2
          DemEventSignificance = DEM_EVENT_SIGNIFICANCE_FAULT
          DemFFPrestorageSupported = false
          DemAgingCycleRef = Power_On_Off
          DemOperationCycleRef = Power_On_Off
        DemDebounceAlgorithmClass  # Diagnostics Data Import
          DemDebounceCounterBased: DemDebounceCounterBasedClassRef=Counter_Based_Debouncing  # Diagnostics Data Import
      DTCClass_DtcClass_DTC_0xD41187 (DemDTCClass): DemDTCSeverity=DEM_DTC_SEV_NO_SEVERITY, DemUdsDTC=13898119, DemDTCAttributesRef=DtcAttributes_41914fb7  # Diagnostics Data Import
      Cluster_ECU_CLS_Tx_4_message_Missing_Message (DemEventParameter):  # Diagnostics Data Import
        DemEventKind = DEM_EVENT_KIND_SWC
        DemDTCClassRef = DTCClass_DtcClass_DTC_0xD41087
        DemExtendedDataClassRef = ExtendedDataClass_6d15841f
        DemFreezeFrameClassRef = FreezeFrame_d41460f8
        DemFreezeFrameRecNumClassRef = FreezeFrameRecNum_8514b953
        DemEventClass:  # Diagnostics Data Import
          DemAgingAllowed = true
          DemAgingCycleCounterThreshold = 40
          DemEventPriority = 2
          DemEventSignificance = DEM_EVENT_SIGNIFICANCE_FAULT
          DemFFPrestorageSupported = false
          DemAgingCycleRef = Power_On_Off
          DemOperationCycleRef = Power_On_Off
        DemDebounceAlgorithmClass  # Diagnostics Data Import
          DemDebounceCounterBased: DemDebounceCounterBasedClassRef=Counter_Based_Debouncing  # Diagnostics Data Import
      DTCClass_DtcClass_DTC_0xD41087 (DemDTCClass): DemDTCSeverity=DEM_DTC_SEV_NO_SEVERITY, DemUdsDTC=13897863, DemDTCAttributesRef=DtcAttributes_41914fb7  # Diagnostics Data Import
      Cluster_ECU_CLS_Tx_16_message_Missing_Message (DemEventParameter):  # Diagnostics Data Import
        DemEventKind = DEM_EVENT_KIND_SWC
        DemDTCClassRef = DTCClass_DtcClass_DTC_0xD40987
        DemExtendedDataClassRef = ExtendedDataClass_6d15841f
        DemFreezeFrameClassRef = FreezeFrame_d41460f8
        DemFreezeFrameRecNumClassRef = FreezeFrameRecNum_8514b953
        DemEventClass:  # Diagnostics Data Import
          DemAgingAllowed = true
          DemAgingCycleCounterThreshold = 40
          DemEventPriority = 2
          DemEventSignificance = DEM_EVENT_SIGNIFICANCE_FAULT
          DemFFPrestorageSupported = false
          DemAgingCycleRef = Power_On_Off
          DemOperationCycleRef = Power_On_Off
        DemDebounceAlgorithmClass  # Diagnostics Data Import
          DemDebounceCounterBased: DemDebounceCounterBasedClassRef=Counter_Based_Debouncing  # Diagnostics Data Import
      DTCClass_DtcClass_DTC_0xD40987 (DemDTCClass): DemDTCSeverity=DEM_DTC_SEV_NO_SEVERITY, DemUdsDTC=13896071, DemDTCAttributesRef=DtcAttributes_41914fb7  # Diagnostics Data Import
      Cluster_ECU_ADAS_FN_STS_message_Missing_Message (DemEventParameter):  # Diagnostics Data Import
        DemEventKind = DEM_EVENT_KIND_SWC
        DemDTCClassRef = DTCClass_DtcClass_DTC_0xD40887
        DemExtendedDataClassRef = ExtendedDataClass_6d15841f
        DemFreezeFrameClassRef = FreezeFrame_d41460f8
        DemFreezeFrameRecNumClassRef = FreezeFrameRecNum_8514b953
        DemEventClass:  # Diagnostics Data Import
          DemAgingAllowed = true
          DemAgingCycleCounterThreshold = 40
          DemEventPriority = 2
          DemEventSignificance = DEM_EVENT_SIGNIFICANCE_FAULT
          DemFFPrestorageSupported = false
          DemAgingCycleRef = Power_On_Off
          DemOperationCycleRef = Power_On_Off
        DemDebounceAlgorithmClass  # Diagnostics Data Import
          DemDebounceCounterBased: DemDebounceCounterBasedClassRef=Counter_Based_Debouncing  # Diagnostics Data Import
      DTCClass_DtcClass_DTC_0xD40887 (DemDTCClass): DemDTCSeverity=DEM_DTC_SEV_NO_SEVERITY, DemUdsDTC=13895815, DemDTCAttributesRef=DtcAttributes_41914fb7  # Diagnostics Data Import
      AT_AMT_ECU_ETC2_03_message_Missing_Message (DemEventParameter):  # Diagnostics Data Import
        DemEventKind = DEM_EVENT_KIND_SWC
        DemDTCClassRef = DTCClass_DtcClass_DTC_0xD40787
        DemExtendedDataClassRef = ExtendedDataClass_6d15841f
        DemFreezeFrameClassRef = FreezeFrame_d41460f8
        DemFreezeFrameRecNumClassRef = FreezeFrameRecNum_8514b953
        DemEventClass:  # Diagnostics Data Import
          DemAgingAllowed = true
          DemAgingCycleCounterThreshold = 40
          DemEventPriority = 2
          DemEventSignificance = DEM_EVENT_SIGNIFICANCE_FAULT
          DemFFPrestorageSupported = false
          DemAgingCycleRef = Power_On_Off
          DemOperationCycleRef = Power_On_Off
        DemDebounceAlgorithmClass  # Diagnostics Data Import
          DemDebounceCounterBased: DemDebounceCounterBasedClassRef=Counter_Based_Debouncing  # Diagnostics Data Import
      DTCClass_DtcClass_DTC_0xD40787 (DemDTCClass): DemDTCSeverity=DEM_DTC_SEV_NO_SEVERITY, DemUdsDTC=13895559, DemDTCAttributesRef=DtcAttributes_41914fb7  # Diagnostics Data Import
      ESC_ECU_VDC2_message_Missing_Message (DemEventParameter):  # Diagnostics Data Import
        DemEventKind = DEM_EVENT_KIND_SWC
        DemDTCClassRef = DTCClass_DtcClass_DTC_0xD40687
        DemExtendedDataClassRef = ExtendedDataClass_6d15841f
        DemFreezeFrameClassRef = FreezeFrame_d41460f8
        DemFreezeFrameRecNumClassRef = FreezeFrameRecNum_8514b953
        DemEventClass:  # Diagnostics Data Import
          DemAgingAllowed = true
          DemAgingCycleCounterThreshold = 40
          DemEventPriority = 2
          DemEventSignificance = DEM_EVENT_SIGNIFICANCE_FAULT
          DemFFPrestorageSupported = false
          DemAgingCycleRef = Power_On_Off
          DemOperationCycleRef = Power_On_Off
        DemDebounceAlgorithmClass  # Diagnostics Data Import
          DemDebounceCounterBased: DemDebounceCounterBasedClassRef=Counter_Based_Debouncing  # Diagnostics Data Import
      DTCClass_DtcClass_DTC_0xD40687 (DemDTCClass): DemDTCSeverity=DEM_DTC_SEV_NO_SEVERITY, DemUdsDTC=13895303, DemDTCAttributesRef=DtcAttributes_41914fb7  # Diagnostics Data Import
      EMS_ECU_VD_message_Missing_Message (DemEventParameter):  # Diagnostics Data Import
        DemEventKind = DEM_EVENT_KIND_SWC
        DemDTCClassRef = DTCClass_DtcClass_DTC_0xD40587
        DemExtendedDataClassRef = ExtendedDataClass_6d15841f
        DemFreezeFrameClassRef = FreezeFrame_d41460f8
        DemFreezeFrameRecNumClassRef = FreezeFrameRecNum_8514b953
        DemEventClass:  # Diagnostics Data Import
          DemAgingAllowed = true
          DemAgingCycleCounterThreshold = 40
          DemEventPriority = 2
          DemEventSignificance = DEM_EVENT_SIGNIFICANCE_FAULT
          DemFFPrestorageSupported = false
          DemAgingCycleRef = Power_On_Off
          DemOperationCycleRef = Power_On_Off
        DemDebounceAlgorithmClass  # Diagnostics Data Import
          DemDebounceCounterBased: DemDebounceCounterBasedClassRef=Counter_Based_Debouncing  # Diagnostics Data Import
      DTCClass_DtcClass_DTC_0xD40587 (DemDTCClass): DemDTCSeverity=DEM_DTC_SEV_NO_SEVERITY, DemUdsDTC=13895047, DemDTCAttributesRef=DtcAttributes_41914fb7  # Diagnostics Data Import
      EMS_ECU_ETC2_00_message_Missing_Message (DemEventParameter):  # Diagnostics Data Import
        DemEventKind = DEM_EVENT_KIND_SWC
        DemDTCClassRef = DTCClass_DtcClass_DTC_0xD40487
        DemExtendedDataClassRef = ExtendedDataClass_6d15841f
        DemFreezeFrameClassRef = FreezeFrame_d41460f8
        DemFreezeFrameRecNumClassRef = FreezeFrameRecNum_8514b953
        DemEventClass:  # Diagnostics Data Import
          DemAgingAllowed = true
          DemAgingCycleCounterThreshold = 40
          DemEventPriority = 2
          DemEventSignificance = DEM_EVENT_SIGNIFICANCE_FAULT
          DemFFPrestorageSupported = false
          DemAgingCycleRef = Power_On_Off
          DemOperationCycleRef = Power_On_Off
        DemDebounceAlgorithmClass  # Diagnostics Data Import
          DemDebounceCounterBased: DemDebounceCounterBasedClassRef=Counter_Based_Debouncing  # Diagnostics Data Import
      DTCClass_DtcClass_DTC_0xD40487 (DemDTCClass): DemDTCSeverity=DEM_DTC_SEV_NO_SEVERITY, DemUdsDTC=13894791, DemDTCAttributesRef=DtcAttributes_41914fb7  # Diagnostics Data Import
      EMS_ECU_CCVS1_message_Missing_Message (DemEventParameter):  # Diagnostics Data Import
        DemEventKind = DEM_EVENT_KIND_SWC
        DemDTCClassRef = DTCClass_DtcClass_DTC_0xD40387
        DemExtendedDataClassRef = ExtendedDataClass_6d15841f
        DemFreezeFrameClassRef = FreezeFrame_d41460f8
        DemFreezeFrameRecNumClassRef = FreezeFrameRecNum_8514b953
        DemEventClass:  # Diagnostics Data Import
          DemAgingAllowed = true
          DemAgingCycleCounterThreshold = 40
          DemEventPriority = 2
          DemEventSignificance = DEM_EVENT_SIGNIFICANCE_FAULT
          DemFFPrestorageSupported = false
          DemAgingCycleRef = Power_On_Off
          DemOperationCycleRef = Power_On_Off
        DemDebounceAlgorithmClass  # Diagnostics Data Import
          DemDebounceCounterBased: DemDebounceCounterBasedClassRef=Counter_Based_Debouncing  # Diagnostics Data Import
      DTCClass_DtcClass_DTC_0xD40387 (DemDTCClass): DemDTCSeverity=DEM_DTC_SEV_NO_SEVERITY, DemUdsDTC=13894535, DemDTCAttributesRef=DtcAttributes_41914fb7  # Diagnostics Data Import
      PCAN_Communication_Bus_Off (DemEventParameter):  # Diagnostics Data Import
        DemEventKind = DEM_EVENT_KIND_SWC
        DemDTCClassRef = DTCClass_DtcClass_DTC_0xD40288
        DemExtendedDataClassRef = ExtendedDataClass_6d15841f
        DemFreezeFrameClassRef = FreezeFrame_d41460f8
        DemFreezeFrameRecNumClassRef = FreezeFrameRecNum_8514b953
        DemEventClass:  # Diagnostics Data Import
          DemAgingAllowed = true
          DemAgingCycleCounterThreshold = 40
          DemEventPriority = 2
          DemEventSignificance = DEM_EVENT_SIGNIFICANCE_FAULT
          DemFFPrestorageSupported = false
          DemAgingCycleRef = Power_On_Off
          DemOperationCycleRef = Power_On_Off
        DemDebounceAlgorithmClass  # Diagnostics Data Import
          DemDebounceCounterBased: DemDebounceCounterBasedClassRef=Counter_Based_Debouncing  # Diagnostics Data Import
      DTCClass_DtcClass_DTC_0xD40288 (DemDTCClass): DemDTCSeverity=DEM_DTC_SEV_NO_SEVERITY, DemUdsDTC=13894280, DemDTCAttributesRef=DtcAttributes_41914fb7  # Diagnostics Data Import
      VCAN_Communication_Bus_Off (DemEventParameter):  # Diagnostics Data Import
        DemEventKind = DEM_EVENT_KIND_SWC
        DemDTCClassRef = DTCClass_DtcClass_DTC_0xD40188
        DemExtendedDataClassRef = ExtendedDataClass_6d15841f
        DemFreezeFrameClassRef = FreezeFrame_d41460f8
        DemFreezeFrameRecNumClassRef = FreezeFrameRecNum_8514b953
        DemEventClass:  # Diagnostics Data Import
          DemAgingAllowed = true
          DemAgingCycleCounterThreshold = 40
          DemEventPriority = 2
          DemEventSignificance = DEM_EVENT_SIGNIFICANCE_FAULT
          DemFFPrestorageSupported = false
          DemAgingCycleRef = Power_On_Off
          DemOperationCycleRef = Power_On_Off
        DemDebounceAlgorithmClass  # Diagnostics Data Import
          DemDebounceCounterBased: DemDebounceCounterBasedClassRef=Counter_Based_Debouncing  # Diagnostics Data Import
      DTCClass_DtcClass_DTC_0xD40188 (DemDTCClass): DemDTCSeverity=DEM_DTC_SEV_NO_SEVERITY, DemUdsDTC=13894024, DemDTCAttributesRef=DtcAttributes_41914fb7  # Diagnostics Data Import
      Radar_Module_Over_Temperature (DemEventParameter):  # Diagnostics Data Import
        DemEventKind = DEM_EVENT_KIND_SWC
        DemDTCClassRef = DTCClass_DtcClass_DTC_0xD4004B
        DemExtendedDataClassRef = ExtendedDataClass_6d15841f
        DemFreezeFrameClassRef = FreezeFrame_d41460f8
        DemFreezeFrameRecNumClassRef = FreezeFrameRecNum_8514b953
        DemEventClass:  # Diagnostics Data Import
          DemAgingAllowed = true
          DemAgingCycleCounterThreshold = 40
          DemEventPriority = 2
          DemEventSignificance = DEM_EVENT_SIGNIFICANCE_FAULT
          DemFFPrestorageSupported = false
          DemAgingCycleRef = Power_On_Off
          DemOperationCycleRef = Power_On_Off
        DemDebounceAlgorithmClass  # Diagnostics Data Import
          DemDebounceCounterBased: DemDebounceCounterBasedClassRef=Counter_Based_Debouncing  # Diagnostics Data Import
      DTCClass_DtcClass_DTC_0xD4004B (DemDTCClass): DemDTCSeverity=DEM_DTC_SEV_NO_SEVERITY, DemUdsDTC=13893707, DemDTCAttributesRef=DtcAttributes_41914fb7  # Diagnostics Data Import
      ECU_NVM_Corruption_Program_memory_Failure (DemEventParameter):  # Diagnostics Data Import
        DemEventKind = DEM_EVENT_KIND_SWC
        DemDTCClassRef = DTCClass_DtcClass_DTC_0x561745
        DemExtendedDataClassRef = ExtendedDataClass_6d15841f
        DemFreezeFrameClassRef = FreezeFrame_d41460f8
        DemFreezeFrameRecNumClassRef = FreezeFrameRecNum_8514b953
        DemEventClass:  # Diagnostics Data Import
          DemAgingAllowed = true
          DemAgingCycleCounterThreshold = 40
          DemEventPriority = 2
          DemEventSignificance = DEM_EVENT_SIGNIFICANCE_FAULT
          DemFFPrestorageSupported = false
          DemAgingCycleRef = Power_On_Off
          DemOperationCycleRef = Power_On_Off
        DemDebounceAlgorithmClass  # Diagnostics Data Import
          DemDebounceCounterBased: DemDebounceCounterBasedClassRef=Counter_Based_Debouncing  # Diagnostics Data Import
      DTCClass_DtcClass_DTC_0x561745 (DemDTCClass): DemDTCSeverity=DEM_DTC_SEV_NO_SEVERITY, DemUdsDTC=5642565, DemDTCAttributesRef=DtcAttributes_41914fb7  # Diagnostics Data Import
      Vehicle_DataSet_Not_Configured (DemEventParameter):  # Diagnostics Data Import
        DemEventKind = DEM_EVENT_KIND_SWC
        DemDTCClassRef = DTCClass_DtcClass_DTC_0x561655
        DemExtendedDataClassRef = ExtendedDataClass_6d15841f
        DemFreezeFrameClassRef = FreezeFrame_d41460f8
        DemFreezeFrameRecNumClassRef = FreezeFrameRecNum_8514b953
        DemEventClass:  # Diagnostics Data Import
          DemAgingAllowed = true
          DemAgingCycleCounterThreshold = 40
          DemEventPriority = 2
          DemEventSignificance = DEM_EVENT_SIGNIFICANCE_FAULT
          DemFFPrestorageSupported = false
          DemAgingCycleRef = Power_On_Off
          DemOperationCycleRef = Power_On_Off
        DemDebounceAlgorithmClass  # Diagnostics Data Import
          DemDebounceCounterBased: DemDebounceCounterBasedClassRef=Counter_Based_Debouncing  # Diagnostics Data Import
      DTCClass_DtcClass_DTC_0x561655 (DemDTCClass): DemDTCSeverity=DEM_DTC_SEV_NO_SEVERITY, DemUdsDTC=5641813, DemDTCAttributesRef=DtcAttributes_41914fb7  # Diagnostics Data Import
      Vehicle_Dataset_value_of_signal_protection_calculation_Incorrect (DemEventParameter):  # Diagnostics Data Import
        DemEventKind = DEM_EVENT_KIND_SWC
        DemDTCClassRef = DTCClass_DtcClass_DTC_0x561583
        DemExtendedDataClassRef = ExtendedDataClass_6d15841f
        DemFreezeFrameClassRef = FreezeFrame_d41460f8
        DemFreezeFrameRecNumClassRef = FreezeFrameRecNum_8514b953
        DemEventClass:  # Diagnostics Data Import
          DemAgingAllowed = true
          DemAgingCycleCounterThreshold = 40
          DemEventPriority = 2
          DemEventSignificance = DEM_EVENT_SIGNIFICANCE_FAULT
          DemFFPrestorageSupported = false
          DemAgingCycleRef = Power_On_Off
          DemOperationCycleRef = Power_On_Off
        DemDebounceAlgorithmClass  # Diagnostics Data Import
          DemDebounceCounterBased: DemDebounceCounterBasedClassRef=Counter_Based_Debouncing  # Diagnostics Data Import
      DTCClass_DtcClass_DTC_0x561583 (DemDTCClass): DemDTCSeverity=DEM_DTC_SEV_NO_SEVERITY, DemUdsDTC=5641603, DemDTCAttributesRef=DtcAttributes_41914fb7  # Diagnostics Data Import
      Radar_Platform_Time_System_Programming_Failure (DemEventParameter):  # Diagnostics Data Import
        DemEventKind = DEM_EVENT_KIND_SWC
        DemDTCClassRef = DTCClass_DtcClass_DTC_0x561305
        DemExtendedDataClassRef = ExtendedDataClass_6d15841f
        DemFreezeFrameClassRef = FreezeFrame_d41460f8
        DemFreezeFrameRecNumClassRef = FreezeFrameRecNum_8514b953
        DemEventClass:  # Diagnostics Data Import
          DemAgingAllowed = true
          DemAgingCycleCounterThreshold = 40
          DemEventPriority = 2
          DemEventSignificance = DEM_EVENT_SIGNIFICANCE_FAULT
          DemFFPrestorageSupported = false
          DemAgingCycleRef = Power_On_Off
          DemOperationCycleRef = Power_On_Off
        DemDebounceAlgorithmClass  # Diagnostics Data Import
          DemDebounceCounterBased: DemDebounceCounterBasedClassRef=Counter_Based_Debouncing  # Diagnostics Data Import
      DTCClass_DtcClass_DTC_0x561305 (DemDTCClass): DemDTCSeverity=DEM_DTC_SEV_NO_SEVERITY, DemUdsDTC=5640965, DemDTCAttributesRef=DtcAttributes_41914fb7  # Diagnostics Data Import
      Radar_Mounting_Orientation_Incorrect_Assembly (DemEventParameter):  # Diagnostics Data Import
        DemEventKind = DEM_EVENT_KIND_SWC
        DemDTCClassRef = DTCClass_DtcClass_DTC_0x561195
        DemExtendedDataClassRef = ExtendedDataClass_6d15841f
        DemFreezeFrameClassRef = FreezeFrame_d41460f8
        DemFreezeFrameRecNumClassRef = FreezeFrameRecNum_8514b953
        DemEventClass:  # Diagnostics Data Import
          DemAgingAllowed = true
          DemAgingCycleCounterThreshold = 40
          DemEventPriority = 2
          DemEventSignificance = DEM_EVENT_SIGNIFICANCE_FAULT
          DemFFPrestorageSupported = false
          DemAgingCycleRef = Power_On_Off
          DemOperationCycleRef = Power_On_Off
        DemDebounceAlgorithmClass  # Diagnostics Data Import
          DemDebounceCounterBased: DemDebounceCounterBasedClassRef=Counter_Based_Debouncing  # Diagnostics Data Import
      DTCClass_DtcClass_DTC_0x561195 (DemDTCClass): DemDTCSeverity=DEM_DTC_SEV_NO_SEVERITY, DemUdsDTC=5640597, DemDTCAttributesRef=DtcAttributes_41914fb7  # Diagnostics Data Import
      Radar_AutoAlignment_Misalignment_Performance_or_Incorrect_Operation (DemEventParameter):  # Diagnostics Data Import
        DemEventKind = DEM_EVENT_KIND_SWC
        DemDTCClassRef = DTCClass_DtcClass_DTC_0x561092
        DemExtendedDataClassRef = ExtendedDataClass_6d15841f
        DemFreezeFrameClassRef = FreezeFrame_d41460f8
        DemFreezeFrameRecNumClassRef = FreezeFrameRecNum_8514b953
        DemEventClass:  # Diagnostics Data Import
          DemAgingAllowed = true
          DemAgingCycleCounterThreshold = 40
          DemEventPriority = 2
          DemEventSignificance = DEM_EVENT_SIGNIFICANCE_FAULT
          DemFFPrestorageSupported = false
          DemAgingCycleRef = Power_On_Off
          DemOperationCycleRef = Power_On_Off
        DemDebounceAlgorithmClass  # Diagnostics Data Import
          DemDebounceCounterBased: DemDebounceCounterBasedClassRef=Counter_Based_Debouncing  # Diagnostics Data Import
      DTCClass_DtcClass_DTC_0x561092 (DemDTCClass): DemDTCSeverity=DEM_DTC_SEV_NO_SEVERITY, DemUdsDTC=5640338, DemDTCAttributesRef=DtcAttributes_41914fb7  # Diagnostics Data Import
      Radar_Pin_Position_Wrong_Mounting_Position (DemEventParameter):  # Diagnostics Data Import
        DemEventKind = DEM_EVENT_KIND_SWC
        DemDTCClassRef = DTCClass_DtcClass_DTC_0x560F76
        DemExtendedDataClassRef = ExtendedDataClass_6d15841f
        DemFreezeFrameClassRef = FreezeFrame_d41460f8
        DemFreezeFrameRecNumClassRef = FreezeFrameRecNum_8514b953
        DemEventClass:  # Diagnostics Data Import
          DemAgingAllowed = true
          DemAgingCycleCounterThreshold = 40
          DemEventPriority = 2
          DemEventSignificance = DEM_EVENT_SIGNIFICANCE_FAULT
          DemFFPrestorageSupported = false
          DemAgingCycleRef = Power_On_Off
          DemOperationCycleRef = Power_On_Off
        DemDebounceAlgorithmClass  # Diagnostics Data Import
          DemDebounceCounterBased: DemDebounceCounterBasedClassRef=Counter_Based_Debouncing  # Diagnostics Data Import
      DTCClass_DtcClass_DTC_0x560F76 (DemDTCClass): DemDTCSeverity=DEM_DTC_SEV_NO_SEVERITY, DemUdsDTC=5640054, DemDTCAttributesRef=DtcAttributes_41914fb7  # Diagnostics Data Import
      Radar_SMC_General_Checksum_Failure (DemEventParameter):  # Diagnostics Data Import
        DemEventKind = DEM_EVENT_KIND_SWC
        DemDTCClassRef = DTCClass_DtcClass_DTC_0x560E41
        DemExtendedDataClassRef = ExtendedDataClass_6d15841f
        DemFreezeFrameClassRef = FreezeFrame_d41460f8
        DemFreezeFrameRecNumClassRef = FreezeFrameRecNum_8514b953
        DemEventClass:  # Diagnostics Data Import
          DemAgingAllowed = true
          DemAgingCycleCounterThreshold = 40
          DemEventPriority = 2
          DemEventSignificance = DEM_EVENT_SIGNIFICANCE_FAULT
          DemFFPrestorageSupported = false
          DemAgingCycleRef = Power_On_Off
          DemOperationCycleRef = Power_On_Off
        DemDebounceAlgorithmClass  # Diagnostics Data Import
          DemDebounceCounterBased: DemDebounceCounterBasedClassRef=Counter_Based_Debouncing  # Diagnostics Data Import
      DTCClass_DtcClass_DTC_0x560E41 (DemDTCClass): DemDTCSeverity=DEM_DTC_SEV_NO_SEVERITY, DemUdsDTC=5639745, DemDTCAttributesRef=DtcAttributes_41914fb7  # Diagnostics Data Import
      Radar_calibration_Calibration_or_Paramater_Memory_Failure (DemEventParameter):  # Diagnostics Data Import
        DemEventKind = DEM_EVENT_KIND_SWC
        DemDTCClassRef = DTCClass_DtcClass_DTC_0x560D46
        DemExtendedDataClassRef = ExtendedDataClass_6d15841f
        DemFreezeFrameClassRef = FreezeFrame_d41460f8
        DemFreezeFrameRecNumClassRef = FreezeFrameRecNum_8514b953
        DemEventClass:  # Diagnostics Data Import
          DemAgingAllowed = true
          DemAgingCycleCounterThreshold = 40
          DemEventPriority = 2
          DemEventSignificance = DEM_EVENT_SIGNIFICANCE_FAULT
          DemFFPrestorageSupported = false
          DemAgingCycleRef = Power_On_Off
          DemOperationCycleRef = Power_On_Off
        DemDebounceAlgorithmClass  # Diagnostics Data Import
          DemDebounceCounterBased: DemDebounceCounterBasedClassRef=Counter_Based_Debouncing  # Diagnostics Data Import
      DTCClass_DtcClass_DTC_0x560D46 (DemDTCClass): DemDTCSeverity=DEM_DTC_SEV_NO_SEVERITY, DemUdsDTC=5639494, DemDTCAttributesRef=DtcAttributes_41914fb7  # Diagnostics Data Import
      Radar_AutoAlignment_Algorithm_Signal_Calculation_Failure (DemEventParameter):  # Diagnostics Data Import
        DemEventKind = DEM_EVENT_KIND_SWC
        DemDTCClassRef = DTCClass_DtcClass_DTC_0x560C61
        DemExtendedDataClassRef = ExtendedDataClass_6d15841f
        DemFreezeFrameClassRef = FreezeFrame_d41460f8
        DemFreezeFrameRecNumClassRef = FreezeFrameRecNum_8514b953
        DemEventClass:  # Diagnostics Data Import
          DemAgingAllowed = true
          DemAgingCycleCounterThreshold = 40
          DemEventPriority = 2
          DemEventSignificance = DEM_EVENT_SIGNIFICANCE_FAULT
          DemFFPrestorageSupported = false
          DemAgingCycleRef = Power_On_Off
          DemOperationCycleRef = Power_On_Off
        DemDebounceAlgorithmClass  # Diagnostics Data Import
          DemDebounceCounterBased: DemDebounceCounterBasedClassRef=Counter_Based_Debouncing  # Diagnostics Data Import
      DTCClass_DtcClass_DTC_0x560C61 (DemDTCClass): DemDTCSeverity=DEM_DTC_SEV_NO_SEVERITY, DemUdsDTC=5639265, DemDTCAttributesRef=DtcAttributes_41914fb7  # Diagnostics Data Import
      Radar_AutoAlignment_Range_Alignment_or_Adjustement_Incorrect (DemEventParameter):  # Diagnostics Data Import
        DemEventKind = DEM_EVENT_KIND_SWC
        DemDTCClassRef = DTCClass_DtcClass_DTC_0x560B78
        DemExtendedDataClassRef = ExtendedDataClass_6d15841f
        DemFreezeFrameClassRef = FreezeFrame_d41460f8
        DemFreezeFrameRecNumClassRef = FreezeFrameRecNum_8514b953
        DemEventClass:  # Diagnostics Data Import
          DemAgingAllowed = true
          DemAgingCycleCounterThreshold = 40
          DemEventPriority = 2
          DemEventSignificance = DEM_EVENT_SIGNIFICANCE_FAULT
          DemFFPrestorageSupported = false
          DemAgingCycleRef = Power_On_Off
          DemOperationCycleRef = Power_On_Off
        DemDebounceAlgorithmClass  # Diagnostics Data Import
          DemDebounceCounterBased: DemDebounceCounterBasedClassRef=Counter_Based_Debouncing  # Diagnostics Data Import
      DTCClass_DtcClass_DTC_0x560B78 (DemDTCClass): DemDTCSeverity=DEM_DTC_SEV_NO_SEVERITY, DemUdsDTC=5639032, DemDTCAttributesRef=DtcAttributes_41914fb7  # Diagnostics Data Import
      Radar_Initial_Alignment_Missing_Calibration (DemEventParameter):  # Diagnostics Data Import
        DemEventKind = DEM_EVENT_KIND_SWC
        DemDTCClassRef = DTCClass_DtcClass_DTC_0x560A54
        DemExtendedDataClassRef = ExtendedDataClass_6d15841f
        DemFreezeFrameClassRef = FreezeFrame_d41460f8
        DemFreezeFrameRecNumClassRef = FreezeFrameRecNum_8514b953
        DemEventClass:  # Diagnostics Data Import
          DemAgingAllowed = true
          DemAgingCycleCounterThreshold = 40
          DemEventPriority = 2
          DemEventSignificance = DEM_EVENT_SIGNIFICANCE_FAULT
          DemFFPrestorageSupported = false
          DemAgingCycleRef = Power_On_Off
          DemOperationCycleRef = Power_On_Off
        DemDebounceAlgorithmClass  # Diagnostics Data Import
          DemDebounceCounterBased: DemDebounceCounterBasedClassRef=Counter_Based_Debouncing  # Diagnostics Data Import
      DTCClass_DtcClass_DTC_0x560A54 (DemDTCClass): DemDTCSeverity=DEM_DTC_SEV_NO_SEVERITY, DemUdsDTC=5638740, DemDTCAttributesRef=DtcAttributes_41914fb7  # Diagnostics Data Import
      Radar_System_Battery_High_Voltage_System_Voltage_High (DemEventParameter):  # Diagnostics Data Import
        DemEventKind = DEM_EVENT_KIND_SWC
        DemDTCClassRef = DTCClass_DtcClass_DTC_0x5609A3
        DemExtendedDataClassRef = ExtendedDataClass_6d15841f
        DemFreezeFrameClassRef = FreezeFrame_d41460f8
        DemFreezeFrameRecNumClassRef = FreezeFrameRecNum_8514b953
        DemEventClass:  # Diagnostics Data Import
          DemAgingAllowed = true
          DemAgingCycleCounterThreshold = 40
          DemEventPriority = 2
          DemEventSignificance = DEM_EVENT_SIGNIFICANCE_FAULT
          DemFFPrestorageSupported = false
          DemAgingCycleRef = Power_On_Off
          DemOperationCycleRef = Power_On_Off
        DemDebounceAlgorithmClass  # Diagnostics Data Import
          DemDebounceCounterBased: DemDebounceCounterBasedClassRef=Counter_Based_Debouncing  # Diagnostics Data Import
      DTCClass_DtcClass_DTC_0x5609A3 (DemDTCClass): DemDTCSeverity=DEM_DTC_SEV_NO_SEVERITY, DemUdsDTC=5638563, DemDTCAttributesRef=DtcAttributes_41914fb7  # Diagnostics Data Import
      Radar_System_Battery_Low_Voltage_System_Voltage_Low (DemEventParameter):  # Diagnostics Data Import
        DemEventKind = DEM_EVENT_KIND_SWC
        DemDTCClassRef = DTCClass_DtcClass_DTC_0x5608A2
        DemExtendedDataClassRef = ExtendedDataClass_6d15841f
        DemFreezeFrameClassRef = FreezeFrame_d41460f8
        DemFreezeFrameRecNumClassRef = FreezeFrameRecNum_8514b953
        DemEventClass:  # Diagnostics Data Import
          DemAgingAllowed = true
          DemAgingCycleCounterThreshold = 40
          DemEventPriority = 2
          DemEventSignificance = DEM_EVENT_SIGNIFICANCE_FAULT
          DemFFPrestorageSupported = false
          DemAgingCycleRef = Power_On_Off
          DemOperationCycleRef = Power_On_Off
        DemDebounceAlgorithmClass  # Diagnostics Data Import
          DemDebounceCounterBased: DemDebounceCounterBasedClassRef=Counter_Based_Debouncing  # Diagnostics Data Import
      DTCClass_DtcClass_DTC_0x5608A2 (DemDTCClass): DemDTCSeverity=DEM_DTC_SEV_NO_SEVERITY, DemUdsDTC=5638306, DemDTCAttributesRef=DtcAttributes_41914fb7  # Diagnostics Data Import
      Radar_Module_Watchdog_Failure (DemEventParameter):  # Diagnostics Data Import
        DemEventKind = DEM_EVENT_KIND_SWC
        DemDTCClassRef = DTCClass_DtcClass_DTC_0x560747
        DemExtendedDataClassRef = ExtendedDataClass_6d15841f
        DemFreezeFrameClassRef = FreezeFrame_d41460f8
        DemFreezeFrameRecNumClassRef = FreezeFrameRecNum_8514b953
        DemEventClass:  # Diagnostics Data Import
          DemAgingAllowed = true
          DemAgingCycleCounterThreshold = 40
          DemEventPriority = 2
          DemEventSignificance = DEM_EVENT_SIGNIFICANCE_FAULT
          DemFFPrestorageSupported = false
          DemAgingCycleRef = Power_On_Off
          DemOperationCycleRef = Power_On_Off
        DemDebounceAlgorithmClass  # Diagnostics Data Import
          DemDebounceCounterBased: DemDebounceCounterBasedClassRef=Counter_Based_Debouncing  # Diagnostics Data Import
      DTCClass_DtcClass_DTC_0x560747 (DemDTCClass): DemDTCSeverity=DEM_DTC_SEV_NO_SEVERITY, DemUdsDTC=5637959, DemDTCAttributesRef=DtcAttributes_41914fb7  # Diagnostics Data Import
      Radar_Module_General_Memory_Failure (DemEventParameter):  # Diagnostics Data Import
        DemEventKind = DEM_EVENT_KIND_SWC
        DemDTCClassRef = DTCClass_DtcClass_DTC_0x560642
        DemExtendedDataClassRef = ExtendedDataClass_6d15841f
        DemFreezeFrameClassRef = FreezeFrame_d41460f8
        DemFreezeFrameRecNumClassRef = FreezeFrameRecNum_8514b953
        DemEventClass:  # Diagnostics Data Import
          DemAgingAllowed = true
          DemAgingCycleCounterThreshold = 40
          DemEventPriority = 2
          DemEventSignificance = DEM_EVENT_SIGNIFICANCE_FAULT
          DemFFPrestorageSupported = false
          DemAgingCycleRef = Power_On_Off
          DemOperationCycleRef = Power_On_Off
        DemDebounceAlgorithmClass  # Diagnostics Data Import
          DemDebounceCounterBased: DemDebounceCounterBasedClassRef=Counter_Based_Debouncing  # Diagnostics Data Import
      DTCClass_DtcClass_DTC_0x560642 (DemDTCClass): DemDTCSeverity=DEM_DTC_SEV_NO_SEVERITY, DemUdsDTC=5637698, DemDTCAttributesRef=DtcAttributes_41914fb7  # Diagnostics Data Import
      Application_Interface_Lookup_Performance_or_Incorrect_Operation (DemEventParameter):  # Diagnostics Data Import
        DemEventKind = DEM_EVENT_KIND_SWC
        DemDTCClassRef = DTCClass_DtcClass_DTC_0x561792_001
        DemExtendedDataClassRef = ExtendedDataClass_6d15841f
        DemFreezeFrameClassRef = FreezeFrame_d41460f8
        DemFreezeFrameRecNumClassRef = FreezeFrameRecNum_8514b953
        DemEventClass:  # Diagnostics Data Import
          DemAgingAllowed = true
          DemAgingCycleCounterThreshold = 40
          DemEventPriority = 2
          DemEventSignificance = DEM_EVENT_SIGNIFICANCE_FAULT
          DemFFPrestorageSupported = false
          DemAgingCycleRef = Power_On_Off
          DemOperationCycleRef = Power_On_Off
        DemDebounceAlgorithmClass  # Diagnostics Data Import
          DemDebounceCounterBased: DemDebounceCounterBasedClassRef=Counter_Based_Debouncing  # Diagnostics Data Import
      DTCClass_DtcClass_DTC_0x561792_001 (DemDTCClass): DemDTCSeverity=DEM_DTC_SEV_NO_SEVERITY, DemUdsDTC=5637266, DemDTCAttributesRef=DtcAttributes_41914fb7  # Diagnostics Data Import
      Radar_MMIC_RFBIST_Component_Internal_Failure (DemEventParameter):  # Diagnostics Data Import
        DemEventKind = DEM_EVENT_KIND_SWC
        DemDTCClassRef = DTCClass_DtcClass_DTC_0x561792
        DemExtendedDataClassRef = ExtendedDataClass_6d15841f
        DemFreezeFrameClassRef = FreezeFrame_d41460f8
        DemFreezeFrameRecNumClassRef = FreezeFrameRecNum_8514b953
        DemEventClass:  # Diagnostics Data Import
          DemAgingAllowed = true
          DemAgingCycleCounterThreshold = 40
          DemEventPriority = 2
          DemEventSignificance = DEM_EVENT_SIGNIFICANCE_FAULT
          DemFFPrestorageSupported = false
          DemAgingCycleRef = Power_On_Off
          DemOperationCycleRef = Power_On_Off
        DemDebounceAlgorithmClass  # Diagnostics Data Import
          DemDebounceCounterBased: DemDebounceCounterBasedClassRef=Counter_Based_Debouncing  # Diagnostics Data Import
      DTCClass_DtcClass_DTC_0x561792 (DemDTCClass): DemDTCSeverity=DEM_DTC_SEV_NO_SEVERITY, DemUdsDTC=5637014, DemDTCAttributesRef=DtcAttributes_41914fb7  # Diagnostics Data Import
      Radar_MMIC_Component_Failure (DemEventParameter):  # Diagnostics Data Import
        DemEventKind = DEM_EVENT_KIND_SWC
        DemDTCClassRef = DTCClass_DtcClass_DTC_0x560209
        DemExtendedDataClassRef = ExtendedDataClass_6d15841f
        DemFreezeFrameClassRef = FreezeFrame_d41460f8
        DemFreezeFrameRecNumClassRef = FreezeFrameRecNum_8514b953
        DemEventClass:  # Diagnostics Data Import
          DemAgingAllowed = true
          DemAgingCycleCounterThreshold = 40
          DemEventPriority = 2
          DemEventSignificance = DEM_EVENT_SIGNIFICANCE_FAULT
          DemFFPrestorageSupported = false
          DemAgingCycleRef = Power_On_Off
          DemOperationCycleRef = Power_On_Off
        DemDebounceAlgorithmClass  # Diagnostics Data Import
          DemDebounceCounterBased: DemDebounceCounterBasedClassRef=Counter_Based_Debouncing  # Diagnostics Data Import
      DTCClass_DtcClass_DTC_0x560209 (DemDTCClass): DemDTCSeverity=DEM_DTC_SEV_NO_SEVERITY, DemUdsDTC=5636617, DemDTCAttributesRef=DtcAttributes_41914fb7  # Diagnostics Data Import
      Radar_Performance_Capability_Algorithm_Based_Failure (DemEventParameter):  # Diagnostics Data Import
        DemEventKind = DEM_EVENT_KIND_SWC
        DemDTCClassRef = DTCClass_DtcClass_DTC_0x560106
        DemExtendedDataClassRef = ExtendedDataClass_6d15841f
        DemFreezeFrameClassRef = FreezeFrame_d41460f8
        DemFreezeFrameRecNumClassRef = FreezeFrameRecNum_8514b953
        DemEventClass:  # Diagnostics Data Import
          DemAgingAllowed = true
          DemAgingCycleCounterThreshold = 40
          DemEventPriority = 2
          DemEventSignificance = DEM_EVENT_SIGNIFICANCE_FAULT
          DemFFPrestorageSupported = false
          DemAgingCycleRef = Power_On_Off
          DemOperationCycleRef = Power_On_Off
        DemDebounceAlgorithmClass  # Diagnostics Data Import
          DemDebounceCounterBased: DemDebounceCounterBasedClassRef=Counter_Based_Debouncing  # Diagnostics Data Import
      DTCClass_DtcClass_DTC_0x560106 (DemDTCClass): DemDTCSeverity=DEM_DTC_SEV_NO_SEVERITY, DemUdsDTC=5636358, DemDTCAttributesRef=DtcAttributes_41914fb7  # Diagnostics Data Import
      Radar_Module_System_Internal_Failure (DemEventParameter):  # Diagnostics Data Import
        DemEventKind = DEM_EVENT_KIND_SWC
        DemDTCClassRef = DTCClass_DtcClass_DTC_0x560004
        DemExtendedDataClassRef = ExtendedDataClass_6d15841f
        DemFreezeFrameClassRef = FreezeFrame_d41460f8
        DemFreezeFrameRecNumClassRef = FreezeFrameRecNum_8514b953
        DemEventClass:  # Diagnostics Data Import
          DemAgingAllowed = true
          DemAgingCycleCounterThreshold = 40
          DemEventPriority = 2
          DemEventSignificance = DEM_EVENT_SIGNIFICANCE_FAULT
          DemFFPrestorageSupported = false
          DemAgingCycleRef = Power_On_Off
          DemOperationCycleRef = Power_On_Off
        DemDebounceAlgorithmClass  # Diagnostics Data Import
          DemDebounceCounterBased: DemDebounceCounterBasedClassRef=Counter_Based_Debouncing  # Diagnostics Data Import
      DTCClass_DtcClass_DTC_0x560004 (DemDTCClass): DemDTCSeverity=DEM_DTC_SEV_NO_SEVERITY, DemUdsDTC=5636100, DemDTCAttributesRef=DtcAttributes_41914fb7  # Diagnostics Data Import
      DtcAttributes_41914fb7 (DemDTCAttributes): DemMemoryDestinationRef=PrimaryMemory  # Diagnostics Data Import
  module config EcuC
    EcucConfigSet
      EcucPduCollection
        CAN_ID_32 (MetaDataType)
          CAN_ID_32 (MetaDataItem): index=0, MetaDataItemLength=4, MetaDataItemType=CAN_ID_32
        TARGET_ADDRESS_16 (MetaDataType)
          TARGET_ADDRESS_16 (MetaDataItem): index=0, MetaDataItemLength=2, MetaDataItemType=TARGET_ADDRESS_16
    EcucPduCollection: PduIdTypeEnum=UINT16, PduLengthTypeEnum=UINT16
      758 x Pdu:
        ADAS_FN_Enable_disable_sts_oVCAN_RADAR_3f57de57_Rx: DynamicLength=false, J1939Requestable=true, PduLength=8, SysTPduToFrameMappingRef=ADAS_FN_Enable_disable_sts
        ADAS_FN_Enable_disable_sts_oVCAN_RADAR_dbe1c88d_Rx: DynamicLength=false, J1939Requestable=true, PduLength=8
        BSD1_oVCAN_RADAR_6f5008ee_Tx: DynamicLength=false, J1939Requestable=true, PduLength=8
        BSD1_oVCAN_RADAR_aa49a410_Tx: DynamicLength=false, J1939Requestable=true, PduLength=8, SysTPduToFrameMappingRef=BSD1
        CCVS1_oVCAN_RADAR_7fab2fed_Rx: DynamicLength=false, J1939Requestable=true, PduLength=8
        CCVS1_oVCAN_RADAR_e4df8c5f_Rx: DynamicLength=false, J1939Requestable=true, PduLength=8, SysTPduToFrameMappingRef=CCVS1
        CLS_Tx_16_oVCAN_RADAR_4a01c26f_Rx: DynamicLength=false, J1939Requestable=true, PduLength=8
        CLS_Tx_16_oVCAN_RADAR_afa2b499_Rx: DynamicLength=false, J1939Requestable=true, PduLength=8, SysTPduToFrameMappingRef=CLS_Tx_16
        CLS_Tx_4_oVCAN_RADAR_1adbb350_Rx: DynamicLength=false, J1939Requestable=true, PduLength=8
        CLS_Tx_4_oVCAN_RADAR_e4fced07_Rx: DynamicLength=false, J1939Requestable=true, PduLength=8, SysTPduToFrameMappingRef=CLS_Tx_4
        DIAG_REQ_FNC_OBD1_Tp_oVCAN_RADAR_260cec9f_Rx: DynamicLength=false, PduLength=8, SysTPduToFrameMappingRef=DIAG_REQ_FNC_OBD1_Tp
        DIAG_REQ_FNC_OBD1_oVCAN_RADAR_7e5c8685_Rx: DynamicLength=true, PduLength=7
        DIAG_REQ_FNC_OBD1_oVCAN_RADAR_ea4d23fb_Rx: DynamicLength=true, PduLength=7
        DIAG_REQ_FNC_OBD2_Tp_oVCAN_RADAR_42ec9761_Rx: DynamicLength=false, PduLength=8, SysTPduToFrameMappingRef=DIAG_REQ_FNC_OBD2_Tp
        DIAG_REQ_FNC_OBD2_oVCAN_RADAR_254b3790_Rx: DynamicLength=true, PduLength=7
        DIAG_REQ_FNC_OBD2_oVCAN_RADAR_57874f35_Rx: DynamicLength=true, PduLength=7
        DIAG_REQ_FNC_OTA_Tp_oVCAN_RADAR_6f75a08a_Rx: DynamicLength=false, PduLength=8, SysTPduToFrameMappingRef=DIAG_REQ_FNC_OTA_Tp
        DIAG_REQ_FNC_OTA_oVCAN_RADAR_b630c1e5_Rx: DynamicLength=true, PduLength=7
        DIAG_REQ_FNC_OTA_oVCAN_RADAR_e787ed21_Rx: DynamicLength=true, PduLength=7
        DIAG_REQ_FNC_PLANT_Tp_oVCAN_RADAR_d6304422_Rx: DynamicLength=false, PduLength=8, SysTPduToFrameMappingRef=DIAG_REQ_FNC_PLANT_Tp
        DIAG_REQ_FNC_PLANT_oVCAN_RADAR_42eb2f27_Rx: DynamicLength=true, PduLength=7
        DIAG_REQ_FNC_PLANT_oVCAN_RADAR_9fd4cadc_Rx: DynamicLength=true, PduLength=7
        DM1_B0_Rx_oPCAN_RADAR_6b6541a3_Rx: PduLength=22, SysTPduToFrameMappingRef=DM1_B0_Rx
        DM1_B0_oVCAN_RADAR_15753e9e_Tx: DynamicLength=true, J1939Requestable=true, PduLength=8, MetaDataTypeRef=EcucPduCollection/CAN_ID_32, SysTPduToFrameMappingRef=DM1_B0
        DM1_B0_oVCAN_RADAR_6cbb7408_Tx: DynamicLength=true, J1939Requestable=true, PduLength=8, MetaDataTypeRef=EcucPduCollection/CAN_ID_32
        DM1_B1_Rx_oPCAN_RADAR_fe159536_Rx: PduLength=22, SysTPduToFrameMappingRef=DM1_B1_Rx
        DM1_B1_oVCAN_RADAR_2387ae6d_Tx: DynamicLength=true, J1939Requestable=true, PduLength=8, MetaDataTypeRef=EcucPduCollection/CAN_ID_32, SysTPduToFrameMappingRef=DM1_B1
        DM1_B1_oVCAN_RADAR_b12dad8d_Tx: DynamicLength=true, J1939Requestable=true, PduLength=8, MetaDataTypeRef=EcucPduCollection/CAN_ID_32
        DM1_D0_oVCAN_RADAR_94793fbe_Tx: DynamicLength=true, J1939Requestable=true, PduLength=22, MetaDataTypeRef=EcucPduCollection/TARGET_ADDRESS_16
        DM1_D0_oVCAN_RADAR_ce78d82a_Tx: DynamicLength=true, J1939Requestable=true, PduLength=22, MetaDataTypeRef=EcucPduCollection/TARGET_ADDRESS_16
        ETC2_00_oVCAN_RADAR_322c725a_Rx: DynamicLength=false, J1939Requestable=true, PduLength=8
        ETC2_00_oVCAN_RADAR_fd8cfcd0_Rx: DynamicLength=false, J1939Requestable=true, PduLength=8, SysTPduToFrameMappingRef=ETC2_00
        ETC2_03_oVCAN_RADAR_8fe61e94_Rx: DynamicLength=false, J1939Requestable=true, PduLength=8
        ETC2_03_oVCAN_RADAR_a69b4dc5_Rx: DynamicLength=false, J1939Requestable=true, PduLength=8, SysTPduToFrameMappingRef=ETC2_03
        FR_DIAG_REQ_PHY_OBD1_Tp_oVCAN_RADAR_ddfa31cf_Rx: DynamicLength=false, PduLength=8, SysTPduToFrameMappingRef=FR_DIAG_REQ_PHY_OBD1_Tp
        FR_DIAG_REQ_PHY_OBD1_oVCAN_RADAR_5445ad08_Rx: DynamicLength=true, PduLength=8
        FR_DIAG_REQ_PHY_OBD1_oVCAN_RADAR_83827d3f_Rx: DynamicLength=true, PduLength=8
        FR_DIAG_REQ_PHY_OBD2_Tp_oVCAN_RADAR_b91a4a31_Rx: DynamicLength=false, PduLength=8, SysTPduToFrameMappingRef=FR_DIAG_REQ_PHY_OBD2_Tp
        FR_DIAG_REQ_PHY_OBD2_oVCAN_RADAR_0f521c1d_Rx: DynamicLength=true, PduLength=8
        FR_DIAG_REQ_PHY_OBD2_oVCAN_RADAR_3e4811f1_Rx: DynamicLength=true, PduLength=8
        FR_DIAG_REQ_PHY_OTA_Tp_oVCAN_RADAR_4de495d5_Rx: DynamicLength=false, PduLength=8, SysTPduToFrameMappingRef=FR_DIAG_REQ_PHY_OTA_Tp
        FR_DIAG_REQ_PHY_OTA_oVCAN_RADAR_7facfb76_Rx: DynamicLength=true, PduLength=8
        FR_DIAG_REQ_PHY_OTA_oVCAN_RADAR_9187f4da_Rx: DynamicLength=true, PduLength=8
        FR_DIAG_REQ_PHY_PLANT_Tp_oVCAN_RADAR_bda0e30b_Rx: DynamicLength=false, PduLength=8, SysTPduToFrameMappingRef=FR_DIAG_REQ_PHY_PLANT_Tp
        FR_DIAG_REQ_PHY_PLANT_oVCAN_RADAR_03b4032b_Rx: DynamicLength=true, PduLength=8
        FR_DIAG_REQ_PHY_PLANT_oVCAN_RADAR_d1c8c991_Rx: DynamicLength=true, PduLength=8
        FR_DIAG_RES_PHY_OBD1_Tp_oVCAN_RADAR_41a76716_Tx: DynamicLength=false, PduLength=8, SysTPduToFrameMappingRef=FR_DIAG_RES_PHY_OBD1_Tp
        FR_DIAG_RES_PHY_OBD1_oVCAN_RADAR_add2b4bf_Tx: DynamicLength=true, PduLength=8
        FR_DIAG_RES_PHY_OBD1_oVCAN_RADAR_cd47a295_Tx: DynamicLength=true, PduLength=8
        FR_DIAG_RES_PHY_OBD2_Tp_oVCAN_RADAR_25471ce8_Tx: DynamicLength=false, PduLength=8, SysTPduToFrameMappingRef=FR_DIAG_RES_PHY_OBD2_Tp
        FR_DIAG_RES_PHY_OBD2_oVCAN_RADAR_1018d871_Tx: DynamicLength=true, PduLength=8
        FR_DIAG_RES_PHY_OBD2_oVCAN_RADAR_96501380_Tx: DynamicLength=true, PduLength=8
        FR_DIAG_RES_PHY_OTA_Tp_oVCAN_RADAR_19b4e511_Tx: DynamicLength=false, PduLength=8, SysTPduToFrameMappingRef=FR_DIAG_RES_PHY_OTA_Tp
        FR_DIAG_RES_PHY_OTA_oVCAN_RADAR_9ad9d3d9_Tx: DynamicLength=true, PduLength=8
        FR_DIAG_RES_PHY_OTA_oVCAN_RADAR_9b68fa0b_Tx: DynamicLength=true, PduLength=8
        FR_DIAG_RES_PHY_PLANT_Tp_oVCAN_RADAR_4233d42d_Tx: DynamicLength=false, PduLength=8, SysTPduToFrameMappingRef=FR_DIAG_RES_PHY_PLANT_Tp
        FR_DIAG_RES_PHY_PLANT_oVCAN_RADAR_5fef2467_Tx: DynamicLength=true, PduLength=8
        FR_DIAG_RES_PHY_PLANT_oVCAN_RADAR_ee22d0c2_Tx: DynamicLength=true, PduLength=8
        GW_ADAS_FN_Enable_disable_sts_Tx_oPCAN_RADAR_27a639a3_Tx: PduLength=8, SysTPduToFrameMappingRef=GW_ADAS_FN_Enable_disable_sts_Tx
        GW_ADAS_FN_Enable_disable_sts_oPCAN_RADAR_781ac753_Rx: DynamicLength=false, PduLength=8, SysTPduToFrameMappingRef=GW_ADAS_FN_Enable_disable_sts
        GW_ADAS_FN_Enable_disable_sts_oPCAN_RADAR_a2ffe33c_Rx: DynamicLength=false, PduLength=8
        GW_CCVS1_Tx_oPCAN_RADAR_7eaa671a_Tx: PduLength=8, SysTPduToFrameMappingRef=GW_CCVS1_Tx
        GW_CCVS1_oPCAN_RADAR_379fc270_Rx: DynamicLength=false, PduLength=8
        GW_CCVS1_oPCAN_RADAR_d10adaab_Rx: DynamicLength=false, PduLength=8, SysTPduToFrameMappingRef=GW_CCVS1
        GW_CLS_Tx_16_Tx_oPCAN_RADAR_b30c42cc_Tx: PduLength=8, SysTPduToFrameMappingRef=GW_CLS_Tx_16_Tx
        GW_CLS_Tx_16_oPCAN_RADAR_92e0b941_Rx: DynamicLength=false, PduLength=8
        GW_CLS_Tx_16_oPCAN_RADAR_c3f80567_Rx: DynamicLength=false, PduLength=8, SysTPduToFrameMappingRef=GW_CLS_Tx_16
        GW_CLS_Tx_4_Tx_oPCAN_RADAR_ecf0186d_Tx: PduLength=8, SysTPduToFrameMappingRef=GW_CLS_Tx_4_Tx
        GW_CLS_Tx_4_oPCAN_RADAR_888f4e35_Rx: DynamicLength=false, PduLength=8
        GW_CLS_Tx_4_oPCAN_RADAR_deff6d37_Rx: DynamicLength=false, PduLength=8, SysTPduToFrameMappingRef=GW_CLS_Tx_4
        GW_DIAG_REQ_FUNC_OBD1_Tx_oPCAN_RADAR_922af4be_Tx: PduLength=64, SysTPduToFrameMappingRef=GW_DIAG_REQ_FUNC_OBD1_Tx
        GW_DIAG_REQ_FUNC_OBD2_Tx_oPCAN_RADAR_f6ca8f40_Tx: PduLength=64, SysTPduToFrameMappingRef=GW_DIAG_REQ_FUNC_OBD2_Tx
        GW_DIAG_REQ_FUNC_OTA_Tx_oPCAN_RADAR_ab05909f_Tx: PduLength=64, SysTPduToFrameMappingRef=GW_DIAG_REQ_FUNC_OTA_Tx
        GW_DIAG_REQ_FUNC_PLANT_Tx_oPCAN_RADAR_43d2fe9e_Tx: PduLength=64, SysTPduToFrameMappingRef=GW_DIAG_REQ_FUNC_PLANT_Tx
        GW_ETC2_03_Tx_oPCAN_RADAR_07adbeb0_Tx: PduLength=8, SysTPduToFrameMappingRef=GW_ETC2_03_Tx
        GW_ETC2_03_oPCAN_RADAR_766d20c0_Rx: DynamicLength=false, PduLength=8, SysTPduToFrameMappingRef=GW_ETC2_03
        GW_ETC2_03_oPCAN_RADAR_7791e995_Rx: DynamicLength=false, PduLength=8
        GW_ETC2_Tx_oPCAN_RADAR_dfec0354_Tx: PduLength=8, SysTPduToFrameMappingRef=GW_ETC2_Tx
        GW_ETC2_oPCAN_RADAR_2970e6e5_Rx: DynamicLength=false, PduLength=8
        GW_ETC2_oPCAN_RADAR_57f17119_Rx: DynamicLength=false, PduLength=8, SysTPduToFrameMappingRef=GW_ETC2
        GW_OEL_Tx_oPCAN_RADAR_96436c6f_Tx: PduLength=8, SysTPduToFrameMappingRef=GW_OEL_Tx
        GW_OEL_oPCAN_RADAR_4c06edea_Rx: DynamicLength=false, PduLength=8, SysTPduToFrameMappingRef=GW_OEL
        GW_OEL_oPCAN_RADAR_b67c14d5_Rx: DynamicLength=false, PduLength=8
        GW_SAS_Tx_oPCAN_RADAR_6c223e7b_Tx: PduLength=8, SysTPduToFrameMappingRef=GW_SAS_Tx
        GW_SAS_oPCAN_RADAR_3d30de8a_Rx: DynamicLength=false, PduLength=8
        GW_SAS_oPCAN_RADAR_e6d96f6c_Rx: DynamicLength=false, PduLength=8, SysTPduToFrameMappingRef=GW_SAS
        GW_TD_Tx_oPCAN_RADAR_aa39de8f_Tx: PduLength=8, SysTPduToFrameMappingRef=GW_TD_Tx
        GW_TD_oPCAN_RADAR_87cf7844_Rx: DynamicLength=false, PduLength=8
        GW_TD_oPCAN_RADAR_a04f08f1_Rx: DynamicLength=false, PduLength=8, SysTPduToFrameMappingRef=GW_TD
        GW_VDC2_Tx_oPCAN_RADAR_8a7343d4_Tx: PduLength=8, SysTPduToFrameMappingRef=GW_VDC2_Tx
        GW_VDC2_oPCAN_RADAR_9daa2cf0_Rx: DynamicLength=false, PduLength=8, SysTPduToFrameMappingRef=GW_VDC2
        GW_VDC2_oPCAN_RADAR_a2fdf3c6_Rx: DynamicLength=false, PduLength=8
        GW_VD_Tx_oPCAN_RADAR_70a8f6f0_Tx: PduLength=8, SysTPduToFrameMappingRef=GW_VD_Tx
        GW_VD_oPCAN_RADAR_66a1bce9_Rx: DynamicLength=false, PduLength=8
        GW_VD_oPCAN_RADAR_e94baa9d_Rx: DynamicLength=false, PduLength=8, SysTPduToFrameMappingRef=GW_VD
        GW_VI_Tx_oPCAN_RADAR_ad28cbdc_Tx: PduLength=8, SysTPduToFrameMappingRef=GW_VI_Tx
        GW_VI_oPCAN_RADAR_218ddc97_Rx: DynamicLength=false, PduLength=8
        GW_VI_oPCAN_RADAR_6896f87b_Rx: DynamicLength=false, PduLength=8, SysTPduToFrameMappingRef=GW_VI
        GW_prop_ADAS_BSIS_info_oPCAN_RADAR_2b91b919_Tx: DynamicLength=false, PduLength=8, SysTPduToFrameMappingRef=GW_prop_ADAS_BSIS_info
        GW_prop_ADAS_BSIS_info_oPCAN_RADAR_f2d61fec_Tx: DynamicLength=false, PduLength=8
        GenerelPurposePDU3_a3a5c5ac_Tx: DynamicLength=true, PduLength=0
        GenerelPurposePDU4_a7ac36ff_Rx: DynamicLength=true, PduLength=0
        GenerelPurposePDU7_a57231d8_Rx: DynamicLength=true, PduLength=0
        MOIS_oVCAN_RADAR_1658382d_Tx: DynamicLength=false, J1939Requestable=true, PduLength=8, SysTPduToFrameMappingRef=MOIS
        MOIS_oVCAN_RADAR_39784631_Tx: DynamicLength=false, J1939Requestable=true, PduLength=8
        OEL_oVCAN_RADAR_45092dcb_Rx: DynamicLength=false, J1939Requestable=true, PduLength=8, SysTPduToFrameMappingRef=OEL
        OEL_oVCAN_RADAR_75091ec5_Rx: DynamicLength=false, J1939Requestable=true, PduLength=8
        PCAN_DIAG_REQ_FUNC_OBD1_Tp_oPCAN_RADAR_20_9397638b_Rx: DynamicLength=false, PduLength=8, SysTPduToFrameMappingRef=PCAN_DIAG_REQ_FUNC_OBD1_Tp
        PCAN_DIAG_REQ_FUNC_OBD1_Tp_oPCAN_RADAR_ba721e23_Rx: DynamicLength=false, PduLength=64, SysTPduToFrameMappingRef=PCAN_DIAG_REQ_FUNC_OBD1_Tp
        PCAN_DIAG_REQ_FUNC_OBD1_oPCAN_RADAR_20_25c43a7c_Rx: DynamicLength=true, PduLength=7
        PCAN_DIAG_REQ_FUNC_OBD1_oPCAN_RADAR_20_e986e253_Rx: DynamicLength=true, PduLength=7
        PCAN_DIAG_REQ_FUNC_OBD1_oPCAN_RADAR_5664bded_Rx: DynamicLength=true, PduLength=62
        PCAN_DIAG_REQ_FUNC_OBD1_oPCAN_RADAR_b9aa9d1d_Rx: DynamicLength=true, PduLength=62
        PCAN_DIAG_REQ_FUNC_OBD2_Tp_oPCAN_RADAR_20_400c7f70_Rx: DynamicLength=false, PduLength=8, SysTPduToFrameMappingRef=PCAN_DIAG_REQ_FUNC_OBD2_Tp
        PCAN_DIAG_REQ_FUNC_OBD2_Tp_oPCAN_RADAR_de9265dd_Rx: DynamicLength=false, PduLength=64, SysTPduToFrameMappingRef=PCAN_DIAG_REQ_FUNC_OBD2_Tp
        PCAN_DIAG_REQ_FUNC_OBD2_oPCAN_RADAR_20_41244182_Rx: DynamicLength=true, PduLength=7
        PCAN_DIAG_REQ_FUNC_OBD2_oPCAN_RADAR_20_c04e56a1_Rx: DynamicLength=true, PduLength=7
        PCAN_DIAG_REQ_FUNC_OBD2_oPCAN_RADAR_e2bd2c08_Rx: DynamicLength=true, PduLength=62
        PCAN_DIAG_REQ_FUNC_OBD2_oPCAN_RADAR_ebaed123_Rx: DynamicLength=true, PduLength=62
        PCAN_DIAG_REQ_FUNC_OTA_Tp_oPCAN_RADAR_20_0a67f2f6_Rx: DynamicLength=false, PduLength=8, SysTPduToFrameMappingRef=PCAN_DIAG_REQ_FUNC_OTA_Tp
        PCAN_DIAG_REQ_FUNC_OTA_Tp_oPCAN_RADAR_7ea6262a_Rx: DynamicLength=false, PduLength=64, SysTPduToFrameMappingRef=PCAN_DIAG_REQ_FUNC_OTA_Tp
        PCAN_DIAG_REQ_FUNC_OTA_oPCAN_RADAR_20_4ceedd9c_Rx: DynamicLength=true, PduLength=7
        PCAN_DIAG_REQ_FUNC_OTA_oPCAN_RADAR_20_e1100275_Rx: DynamicLength=true, PduLength=7
        PCAN_DIAG_REQ_FUNC_OTA_oPCAN_RADAR_8729c499_Rx: DynamicLength=true, PduLength=62
        PCAN_DIAG_REQ_FUNC_OTA_oPCAN_RADAR_a013523e_Rx: DynamicLength=true, PduLength=62
        PCAN_DIAG_REQ_FUNC_PLANT_Tp_oPCAN_RADAR_20_d63751cc_Rx: DynamicLength=false, PduLength=8, SysTPduToFrameMappingRef=PCAN_DIAG_REQ_FUNC_PLANT_Tp
        PCAN_DIAG_REQ_FUNC_PLANT_Tp_oPCAN_RADAR_5ec247a5_Rx: DynamicLength=false, PduLength=64, SysTPduToFrameMappingRef=PCAN_DIAG_REQ_FUNC_PLANT_Tp
        PCAN_DIAG_REQ_FUNC_PLANT_oPCAN_RADAR_20_3b79581e_Rx: DynamicLength=true, PduLength=7
        PCAN_DIAG_REQ_FUNC_PLANT_oPCAN_RADAR_20_c17463fa_Rx: DynamicLength=true, PduLength=7
        PCAN_DIAG_REQ_FUNC_PLANT_oPCAN_RADAR_8e17ec17_Rx: DynamicLength=true, PduLength=62
        PCAN_DIAG_REQ_FUNC_PLANT_oPCAN_RADAR_f6414098_Rx: DynamicLength=true, PduLength=62
        PCAN_DIAG_REQ_PHYS_OBD1_Tp_oPCAN_RADAR_20_b6648efa_Rx: DynamicLength=false, PduLength=8, SysTPduToFrameMappingRef=PCAN_DIAG_REQ_PHYS_OBD1_Tp
        PCAN_DIAG_REQ_PHYS_OBD1_Tp_oPCAN_RADAR_6e232c89_Rx: DynamicLength=false, PduLength=64, SysTPduToFrameMappingRef=PCAN_DIAG_REQ_PHYS_OBD1_Tp
        PCAN_DIAG_REQ_PHYS_OBD1_oPCAN_RADAR_20_3bfe27fe_Rx: DynamicLength=true, PduLength=8
        PCAN_DIAG_REQ_PHYS_OBD1_oPCAN_RADAR_20_f19508d6_Rx: DynamicLength=true, PduLength=8
        PCAN_DIAG_REQ_PHYS_OBD1_oPCAN_RADAR_bb22f7fc_Rx: DynamicLength=true, PduLength=64
        PCAN_DIAG_REQ_PHYS_OBD1_oPCAN_RADAR_caf5eb16_Rx: DynamicLength=true, PduLength=64
        PCAN_DIAG_REQ_PHYS_OBD2_Tp_oPCAN_RADAR_0ac35777_Rx: DynamicLength=false, PduLength=64, SysTPduToFrameMappingRef=PCAN_DIAG_REQ_PHYS_OBD2_Tp
        PCAN_DIAG_REQ_PHYS_OBD2_Tp_oPCAN_RADAR_20_65ff9201_Rx: DynamicLength=false, PduLength=8, SysTPduToFrameMappingRef=PCAN_DIAG_REQ_PHYS_OBD2_Tp
        PCAN_DIAG_REQ_PHYS_OBD2_oPCAN_RADAR_20_1236930c_Rx: DynamicLength=true, PduLength=8
        PCAN_DIAG_REQ_PHYS_OBD2_oPCAN_RADAR_20_95757328_Rx: DynamicLength=true, PduLength=8
        PCAN_DIAG_REQ_PHYS_OBD2_oPCAN_RADAR_773f87d8_Rx: DynamicLength=true, PduLength=64
        PCAN_DIAG_REQ_PHYS_OBD2_oPCAN_RADAR_e03546e9_Rx: DynamicLength=true, PduLength=64
        PCAN_DIAG_REQ_PHYS_OTA_Tp_oPCAN_RADAR_20_96582344_Rx: DynamicLength=false, PduLength=8, SysTPduToFrameMappingRef=PCAN_DIAG_REQ_PHYS_OTA_Tp
        PCAN_DIAG_REQ_PHYS_OTA_Tp_oPCAN_RADAR_94a46e49_Rx: DynamicLength=false, PduLength=64, SysTPduToFrameMappingRef=PCAN_DIAG_REQ_PHYS_OTA_Tp
        PCAN_DIAG_REQ_PHYS_OTA_oPCAN_RADAR_1f79965d_Rx: DynamicLength=true, PduLength=64
        PCAN_DIAG_REQ_PHYS_OTA_oPCAN_RADAR_20_0b124a16_Rx: DynamicLength=true, PduLength=8
        PCAN_DIAG_REQ_PHYS_OTA_oPCAN_RADAR_20_39ae8dba_Rx: DynamicLength=true, PduLength=8
        PCAN_DIAG_REQ_PHYS_OTA_oPCAN_RADAR_45eab9fd_Rx: DynamicLength=true, PduLength=64
        PCAN_DIAG_REQ_PHYS_PLANT_Tp_oPCAN_RADAR_20_f110e38b_Rx: DynamicLength=false, PduLength=8, SysTPduToFrameMappingRef=PCAN_DIAG_REQ_PHYS_PLANT_Tp
        PCAN_DIAG_REQ_PHYS_PLANT_Tp_oPCAN_RADAR_68155c61_Rx: DynamicLength=false, PduLength=64, SysTPduToFrameMappingRef=PCAN_DIAG_REQ_PHYS_PLANT_Tp
        PCAN_DIAG_REQ_PHYS_PLANT_oPCAN_RADAR_20_93ccff8e_Rx: DynamicLength=true, PduLength=8
        PCAN_DIAG_REQ_PHYS_PLANT_oPCAN_RADAR_20_f7a3783e_Rx: DynamicLength=true, PduLength=8
        PCAN_DIAG_REQ_PHYS_PLANT_oPCAN_RADAR_214e1a1c_Rx: DynamicLength=true, PduLength=64
        PCAN_DIAG_REQ_PHYS_PLANT_oPCAN_RADAR_a4e456d5_Rx: DynamicLength=true, PduLength=64
        PCAN_DIAG_RESP_PHYS_OBD1_Tp_oPCAN_RADAR_0aebd6ab_Tx: DynamicLength=false, PduLength=64, SysTPduToFrameMappingRef=PCAN_DIAG_RESP_PHYS_OBD1_Tp
        PCAN_DIAG_RESP_PHYS_OBD1_Tp_oPCAN_RADAR_20_f6415fa5_Tx: DynamicLength=false, PduLength=8, SysTPduToFrameMappingRef=PCAN_DIAG_RESP_PHYS_OBD1_Tp
        PCAN_DIAG_RESP_PHYS_OBD1_oPCAN_RADAR_20_955df2f4_Tx: DynamicLength=true, PduLength=8
        PCAN_DIAG_RESP_PHYS_OBD1_oPCAN_RADAR_20_f26199fd_Tx: DynamicLength=true, PduLength=8
        PCAN_DIAG_RESP_PHYS_OBD1_oPCAN_RADAR_572eb9fe_Tx: DynamicLength=true, PduLength=64
        PCAN_DIAG_RESP_PHYS_OBD1_oPCAN_RADAR_62c2ee1d_Tx: DynamicLength=true, PduLength=64
        PCAN_DIAG_RESP_PHYS_OBD2_Tp_oPCAN_RADAR_20_25da435e_Tx: DynamicLength=false, PduLength=8, SysTPduToFrameMappingRef=PCAN_DIAG_RESP_PHYS_OBD2_Tp
        PCAN_DIAG_RESP_PHYS_OBD2_Tp_oPCAN_RADAR_6e0bad55_Tx: DynamicLength=false, PduLength=64, SysTPduToFrameMappingRef=PCAN_DIAG_RESP_PHYS_OBD2_Tp
        PCAN_DIAG_RESP_PHYS_OBD2_oPCAN_RADAR_0c3908eb_Tx: DynamicLength=true, PduLength=64
        PCAN_DIAG_RESP_PHYS_OBD2_oPCAN_RADAR_20_dba92d0f_Tx: DynamicLength=true, PduLength=8
        PCAN_DIAG_RESP_PHYS_OBD2_oPCAN_RADAR_20_f1bd890a_Tx: DynamicLength=true, PduLength=8
        PCAN_DIAG_RESP_PHYS_OBD2_oPCAN_RADAR_df0882d3_Tx: DynamicLength=true, PduLength=64
        PCAN_DIAG_RESP_PHYS_OTA_Tp_oPCAN_RADAR_20_6c821aae_Tx: DynamicLength=false, PduLength=8, SysTPduToFrameMappingRef=PCAN_DIAG_RESP_PHYS_OTA_Tp
        PCAN_DIAG_RESP_PHYS_OTA_Tp_oPCAN_RADAR_37f68c50_Tx: DynamicLength=false, PduLength=64, SysTPduToFrameMappingRef=PCAN_DIAG_RESP_PHYS_OTA_Tp
        PCAN_DIAG_RESP_PHYS_OTA_oPCAN_RADAR_20_a840a80f_Tx: DynamicLength=true, PduLength=8
        PCAN_DIAG_RESP_PHYS_OTA_oPCAN_RADAR_20_aa3008c9_Tx: DynamicLength=true, PduLength=8
        PCAN_DIAG_RESP_PHYS_OTA_oPCAN_RADAR_2a569d3c_Tx: DynamicLength=true, PduLength=64
        PCAN_DIAG_RESP_PHYS_OTA_oPCAN_RADAR_4fa3c8f0_Tx: DynamicLength=true, PduLength=64
        PCAN_DIAG_RESP_PHYS_PLANT_Tp_oPCAN_RADAR_20_0a848a3f_Tx: DynamicLength=false, PduLength=8, SysTPduToFrameMappingRef=PCAN_DIAG_RESP_PHYS_PLANT_Tp
        PCAN_DIAG_RESP_PHYS_PLANT_Tp_oPCAN_RADAR_bd11d57f_Tx: DynamicLength=false, PduLength=64, SysTPduToFrameMappingRef=PCAN_DIAG_RESP_PHYS_PLANT_Tp
        PCAN_DIAG_RESP_PHYS_PLANT_oPCAN_RADAR_20_0a0c318a_Tx: DynamicLength=true, PduLength=8
        PCAN_DIAG_RESP_PHYS_PLANT_oPCAN_RADAR_20_22a7f120_Tx: DynamicLength=true, PduLength=8
        PCAN_DIAG_RESP_PHYS_PLANT_oPCAN_RADAR_339eb858_Tx: DynamicLength=true, PduLength=64
        PCAN_DIAG_RESP_PHYS_PLANT_oPCAN_RADAR_cfac777e_Tx: DynamicLength=true, PduLength=64
        RDR_ALIGNMENT_STATUS_001_oPCAN_RADAR_4f94d655_Tx: DynamicLength=false, PduLength=64, SysTPduToFrameMappingRef=RDR_ALIGNMENT_STATUS_001
        RDR_ALIGNMENT_STATUS_001_oPCAN_RADAR_dd819ed8_Tx: DynamicLength=false, PduLength=64
        RDR_ALIGNMENT_STATUS_002_oPCAN_RADAR_14836740_Tx: DynamicLength=false, PduLength=64, SysTPduToFrameMappingRef=RDR_ALIGNMENT_STATUS_002
        RDR_ALIGNMENT_STATUS_002_oPCAN_RADAR_604bf216_Tx: DynamicLength=false, PduLength=64
        RDR_BSD1_Tx_oPCAN_RADAR_170995fb_Tx: DynamicLength=false, PduLength=8
        RDR_BSD1_Tx_oPCAN_RADAR_3cea6970_Tx: DynamicLength=false, PduLength=8, SysTPduToFrameMappingRef=RDR_BSD1_Tx
        RDR_BSD1_oPCAN_RADAR_03d8d8bd_Rx: PduLength=8, SysTPduToFrameMappingRef=RDR_BSD1
        RDR_BSD1_oPCAN_RADAR_a3b58398_Rx: PduLength=8
        RDR_CAPABILITY_oPCAN_RADAR_18844568_Tx: DynamicLength=false, PduLength=64
        RDR_CAPABILITY_oPCAN_RADAR_476dda7e_Tx: DynamicLength=false, PduLength=64, SysTPduToFrameMappingRef=RDR_CAPABILITY
        RDR_CM_B0_Rx_oPCAN_RADAR_3544966f_Rx: PduLength=8, SysTPduToFrameMappingRef=RDR_CM_B0_Rx
        RDR_CM_B0_Rx_oPCAN_RADAR_5d656100_Rx: PduLength=8
        RDR_CM_B1_Rx_oPCAN_RADAR_a03442fa_Rx: PduLength=8, SysTPduToFrameMappingRef=RDR_CM_B1_Rx
        RDR_CM_B1_Rx_oPCAN_RADAR_f30df091_Rx: PduLength=8
        RDR_DETECTION_001_004_oPCAN_RADAR_b0420040_Tx: DynamicLength=false, PduLength=64
        RDR_DETECTION_001_004_oPCAN_RADAR_db6da1bd_Tx: DynamicLength=false, PduLength=64, SysTPduToFrameMappingRef=RDR_DETECTION_001_004
        RDR_DETECTION_005_008_oPCAN_RADAR_02113517_Tx: DynamicLength=false, PduLength=64, SysTPduToFrameMappingRef=RDR_DETECTION_005_008
        RDR_DETECTION_005_008_oPCAN_RADAR_59f09e74_Tx: DynamicLength=false, PduLength=64
        RDR_DETECTION_009_012_oPCAN_RADAR_6bb87175_Tx: DynamicLength=false, PduLength=64
        RDR_DETECTION_009_012_oPCAN_RADAR_95663fdf_Tx: DynamicLength=false, PduLength=64, SysTPduToFrameMappingRef=RDR_DETECTION_009_012
        RDR_DETECTION_013_016_oPCAN_RADAR_767f725b_Tx: DynamicLength=false, PduLength=64
        RDR_DETECTION_013_016_oPCAN_RADAR_c51304f0_Tx: DynamicLength=false, PduLength=64, SysTPduToFrameMappingRef=RDR_DETECTION_013_016
        RDR_DETECTION_017_020_oPCAN_RADAR_70e9c33f_Tx: DynamicLength=false, PduLength=64, SysTPduToFrameMappingRef=RDR_DETECTION_017_020
        RDR_DETECTION_017_020_oPCAN_RADAR_d9f3af92_Tx: DynamicLength=false, PduLength=64
        RDR_DETECTION_021_024_oPCAN_RADAR_5209fe54_Tx: DynamicLength=false, PduLength=64, SysTPduToFrameMappingRef=RDR_DETECTION_021_024
        RDR_DETECTION_021_024_oPCAN_RADAR_54f8af6e_Tx: DynamicLength=false, PduLength=64
        RDR_DETECTION_025_028_oPCAN_RADAR_8b756afe_Tx: DynamicLength=false, PduLength=64, SysTPduToFrameMappingRef=RDR_DETECTION_025_028
        RDR_DETECTION_025_028_oPCAN_RADAR_bd4a315a_Tx: DynamicLength=false, PduLength=64
        RDR_DETECTION_029_032_oPCAN_RADAR_1c026036_Tx: DynamicLength=false, PduLength=64, SysTPduToFrameMappingRef=RDR_DETECTION_029_032
        RDR_DETECTION_029_032_oPCAN_RADAR_8f02de5b_Tx: DynamicLength=false, PduLength=64
        RDR_DETECTION_033_036_oPCAN_RADAR_4c775b19_Tx: DynamicLength=false, PduLength=64, SysTPduToFrameMappingRef=RDR_DETECTION_033_036
        RDR_DETECTION_033_036_oPCAN_RADAR_92c5dd75_Tx: DynamicLength=false, PduLength=64
        RDR_DETECTION_037_040_oPCAN_RADAR_24e58fa7_Tx: DynamicLength=false, PduLength=64
        RDR_DETECTION_037_040_oPCAN_RADAR_6b84d80e_Tx: DynamicLength=false, PduLength=64, SysTPduToFrameMappingRef=RDR_DETECTION_037_040
        RDR_DETECTION_041_044_oPCAN_RADAR_12d4182e_Tx: DynamicLength=false, PduLength=64, SysTPduToFrameMappingRef=RDR_DETECTION_041_044
        RDR_DETECTION_041_044_oPCAN_RADAR_a246585d_Tx: DynamicLength=false, PduLength=64
        RDR_DETECTION_045_048_oPCAN_RADAR_4bf4c669_Tx: DynamicLength=false, PduLength=64
        RDR_DETECTION_045_048_oPCAN_RADAR_cba88c84_Tx: DynamicLength=false, PduLength=64, SysTPduToFrameMappingRef=RDR_DETECTION_045_048
        RDR_DETECTION_049_052_oPCAN_RADAR_5cdf864c_Tx: DynamicLength=false, PduLength=64, SysTPduToFrameMappingRef=RDR_DETECTION_049_052
        RDR_DETECTION_049_052_oPCAN_RADAR_79bc2968_Tx: DynamicLength=false, PduLength=64
        RDR_DETECTION_053_056_oPCAN_RADAR_0caabd63_Tx: DynamicLength=false, PduLength=64, SysTPduToFrameMappingRef=RDR_DETECTION_053_056
        RDR_DETECTION_053_056_oPCAN_RADAR_647b2a46_Tx: DynamicLength=false, PduLength=64
        RDR_DETECTION_057_060_oPCAN_RADAR_b9507aac_Tx: DynamicLength=false, PduLength=64, SysTPduToFrameMappingRef=RDR_DETECTION_057_060
        RDR_DETECTION_057_060_oPCAN_RADAR_cbf7f78f_Tx: DynamicLength=false, PduLength=64
        RDR_DETECTION_061_064_oPCAN_RADAR_46fcf773_Tx: DynamicLength=false, PduLength=64
        RDR_DETECTION_061_064_oPCAN_RADAR_9bb047c7_Tx: DynamicLength=false, PduLength=64, SysTPduToFrameMappingRef=RDR_DETECTION_061_064
        RDR_DETECTION_065_068_oPCAN_RADAR_42ccd36d_Tx: DynamicLength=false, PduLength=64, SysTPduToFrameMappingRef=RDR_DETECTION_065_068
        RDR_DETECTION_065_068_oPCAN_RADAR_af4e6947_Tx: DynamicLength=false, PduLength=64
        RDR_DETECTION_069_072_oPCAN_RADAR_9d068646_Tx: DynamicLength=false, PduLength=64
        RDR_DETECTION_069_072_oPCAN_RADAR_d5bbd9a5_Tx: DynamicLength=false, PduLength=64, SysTPduToFrameMappingRef=RDR_DETECTION_069_072
        RDR_DETECTION_073_076_oPCAN_RADAR_80c18568_Tx: DynamicLength=false, PduLength=64
        RDR_DETECTION_073_076_oPCAN_RADAR_85cee28a_Tx: DynamicLength=false, PduLength=64, SysTPduToFrameMappingRef=RDR_DETECTION_073_076
        RDR_DETECTION_077_080_oPCAN_RADAR_05b8c98c_Tx: DynamicLength=false, PduLength=64
        RDR_DETECTION_077_080_oPCAN_RADAR_5d5eee6c_Tx: DynamicLength=false, PduLength=64, SysTPduToFrameMappingRef=RDR_DETECTION_077_080
        RDR_DETECTION_081_084_oPCAN_RADAR_936fd4da_Tx: DynamicLength=false, PduLength=64, SysTPduToFrameMappingRef=RDR_DETECTION_081_084
        RDR_DETECTION_081_084_oPCAN_RADAR_944ab07a_Tx: DynamicLength=false, PduLength=64
        RDR_DETECTION_085_088_oPCAN_RADAR_4a134070_Tx: DynamicLength=false, PduLength=64, SysTPduToFrameMappingRef=RDR_DETECTION_085_088
        RDR_DETECTION_085_088_oPCAN_RADAR_7df82e4e_Tx: DynamicLength=false, PduLength=64
        RDR_DETECTION_089_092_oPCAN_RADAR_4fb0c14f_Tx: DynamicLength=false, PduLength=64
        RDR_DETECTION_089_092_oPCAN_RADAR_dd644ab8_Tx: DynamicLength=false, PduLength=64, SysTPduToFrameMappingRef=RDR_DETECTION_089_092
        RDR_DETECTION_093_096_oPCAN_RADAR_5277c261_Tx: DynamicLength=false, PduLength=64
        RDR_DETECTION_093_096_oPCAN_RADAR_8d117197_Tx: DynamicLength=false, PduLength=64, SysTPduToFrameMappingRef=RDR_DETECTION_093_096
        RDR_DETECTION_097_100_oPCAN_RADAR_41128c0d_Tx: DynamicLength=false, PduLength=64, SysTPduToFrameMappingRef=RDR_DETECTION_097_100
        RDR_DETECTION_097_100_oPCAN_RADAR_96371edb_Tx: DynamicLength=false, PduLength=64
        RDR_DETECTION_101_104_oPCAN_RADAR_5a7abddc_Tx: DynamicLength=false, PduLength=64, SysTPduToFrameMappingRef=RDR_DETECTION_101_104
        RDR_DETECTION_101_104_oPCAN_RADAR_de5b5bf0_Tx: DynamicLength=false, PduLength=64
        RDR_DETECTION_105_108_oPCAN_RADAR_37e9c5c4_Tx: DynamicLength=false, PduLength=64
        RDR_DETECTION_105_108_oPCAN_RADAR_83062976_Tx: DynamicLength=false, PduLength=64, SysTPduToFrameMappingRef=RDR_DETECTION_105_108
        RDR_DETECTION_109_112_oPCAN_RADAR_05a12ac5_Tx: DynamicLength=false, PduLength=64
        RDR_DETECTION_109_112_oPCAN_RADAR_147123be_Tx: DynamicLength=false, PduLength=64, SysTPduToFrameMappingRef=RDR_DETECTION_109_112
        RDR_DETECTION_113_116_oPCAN_RADAR_186629eb_Tx: DynamicLength=false, PduLength=64
        RDR_DETECTION_113_116_oPCAN_RADAR_44041891_Tx: DynamicLength=false, PduLength=64, SysTPduToFrameMappingRef=RDR_DETECTION_113_116
        RDR_DETECTION_117_120_oPCAN_RADAR_b7eaf422_Tx: DynamicLength=false, PduLength=64
        RDR_DETECTION_117_120_oPCAN_RADAR_f1fedf5e_Tx: DynamicLength=false, PduLength=64, SysTPduToFrameMappingRef=RDR_DETECTION_117_120
        RDR_DETECTION_121_124_oPCAN_RADAR_3ae1f4de_Tx: DynamicLength=false, PduLength=64
        RDR_DETECTION_121_124_oPCAN_RADAR_d31ee235_Tx: DynamicLength=false, PduLength=64, SysTPduToFrameMappingRef=RDR_DETECTION_121_124
        RDR_DETECTION_125_128_oPCAN_RADAR_0a62769f_Tx: DynamicLength=false, PduLength=64, SysTPduToFrameMappingRef=RDR_DETECTION_125_128
        RDR_DETECTION_125_128_oPCAN_RADAR_d3536aea_Tx: DynamicLength=false, PduLength=64
        RDR_DETECTION_129_132_oPCAN_RADAR_9d157c57_Tx: DynamicLength=false, PduLength=64, SysTPduToFrameMappingRef=RDR_DETECTION_129_132
        RDR_DETECTION_129_132_oPCAN_RADAR_e11b85eb_Tx: DynamicLength=false, PduLength=64
        RDR_DETECTION_133_136_oPCAN_RADAR_cd604778_Tx: DynamicLength=false, PduLength=64, SysTPduToFrameMappingRef=RDR_DETECTION_133_136
        RDR_DETECTION_133_136_oPCAN_RADAR_fcdc86c5_Tx: DynamicLength=false, PduLength=64
        RDR_DETECTION_137_140_oPCAN_RADAR_4afcd417_Tx: DynamicLength=false, PduLength=64
        RDR_DETECTION_137_140_oPCAN_RADAR_ea93c46f_Tx: DynamicLength=false, PduLength=64, SysTPduToFrameMappingRef=RDR_DETECTION_137_140
        RDR_DETECTION_141_144_oPCAN_RADAR_93c3044f_Tx: DynamicLength=false, PduLength=64, SysTPduToFrameMappingRef=RDR_DETECTION_141_144
        RDR_DETECTION_141_144_oPCAN_RADAR_cc5f03ed_Tx: DynamicLength=false, PduLength=64
        RDR_DETECTION_145_148_oPCAN_RADAR_25ed9dd9_Tx: DynamicLength=false, PduLength=64
        RDR_DETECTION_145_148_oPCAN_RADAR_4abf90e5_Tx: DynamicLength=false, PduLength=64, SysTPduToFrameMappingRef=RDR_DETECTION_145_148
        RDR_DETECTION_149_152_oPCAN_RADAR_17a572d8_Tx: DynamicLength=false, PduLength=64
        RDR_DETECTION_149_152_oPCAN_RADAR_ddc89a2d_Tx: DynamicLength=false, PduLength=64, SysTPduToFrameMappingRef=RDR_DETECTION_149_152
        RDR_DETECTION_153_156_oPCAN_RADAR_0a6271f6_Tx: DynamicLength=false, PduLength=64
        RDR_DETECTION_153_156_oPCAN_RADAR_8dbda102_Tx: DynamicLength=false, PduLength=64, SysTPduToFrameMappingRef=RDR_DETECTION_153_156
        RDR_DETECTION_157_160_oPCAN_RADAR_384766cd_Tx: DynamicLength=false, PduLength=64, SysTPduToFrameMappingRef=RDR_DETECTION_157_160
        RDR_DETECTION_157_160_oPCAN_RADAR_a5eeac3f_Tx: DynamicLength=false, PduLength=64
        RDR_DETECTION_161_164_oPCAN_RADAR_1aa75ba6_Tx: DynamicLength=false, PduLength=64, SysTPduToFrameMappingRef=RDR_DETECTION_161_164
        RDR_DETECTION_161_164_oPCAN_RADAR_28e5acc3_Tx: DynamicLength=false, PduLength=64
        RDR_DETECTION_165_168_oPCAN_RADAR_c15732f7_Tx: DynamicLength=false, PduLength=64
        RDR_DETECTION_165_168_oPCAN_RADAR_c3dbcf0c_Tx: DynamicLength=false, PduLength=64, SysTPduToFrameMappingRef=RDR_DETECTION_165_168
        RDR_DETECTION_169_172_oPCAN_RADAR_54acc5c4_Tx: DynamicLength=false, PduLength=64, SysTPduToFrameMappingRef=RDR_DETECTION_169_172
        RDR_DETECTION_169_172_oPCAN_RADAR_f31fddf6_Tx: DynamicLength=false, PduLength=64
        RDR_DETECTION_173_176_oPCAN_RADAR_04d9feeb_Tx: DynamicLength=false, PduLength=64, SysTPduToFrameMappingRef=RDR_DETECTION_173_176
        RDR_DETECTION_173_176_oPCAN_RADAR_eed8ded8_Tx: DynamicLength=false, PduLength=64
        RDR_DETECTION_177_180_oPCAN_RADAR_6ba1923c_Tx: DynamicLength=false, PduLength=64
        RDR_DETECTION_177_180_oPCAN_RADAR_dc49f20d_Tx: DynamicLength=false, PduLength=64, SysTPduToFrameMappingRef=RDR_DETECTION_177_180
        RDR_DETECTION_181_184_oPCAN_RADAR_1278c8bb_Tx: DynamicLength=false, PduLength=64, SysTPduToFrameMappingRef=RDR_DETECTION_181_184
        RDR_DETECTION_181_184_oPCAN_RADAR_fa53ebca_Tx: DynamicLength=false, PduLength=64
        RDR_DETECTION_185_188_oPCAN_RADAR_13e175fe_Tx: DynamicLength=false, PduLength=64
        RDR_DETECTION_185_188_oPCAN_RADAR_cb045c11_Tx: DynamicLength=false, PduLength=64, SysTPduToFrameMappingRef=RDR_DETECTION_185_188
        RDR_DETECTION_189_192_oPCAN_RADAR_21a99aff_Tx: DynamicLength=false, PduLength=64
        RDR_DETECTION_189_192_oPCAN_RADAR_5c7356d9_Tx: DynamicLength=false, PduLength=64, SysTPduToFrameMappingRef=RDR_DETECTION_189_192
        RDR_DETECTION_193_196_oPCAN_RADAR_0c066df6_Tx: DynamicLength=false, PduLength=64, SysTPduToFrameMappingRef=RDR_DETECTION_193_196
        RDR_DETECTION_193_196_oPCAN_RADAR_3c6e99d1_Tx: DynamicLength=false, PduLength=64
        RDR_DETECTION_197_200_oPCAN_RADAR_50a8f4fa_Tx: DynamicLength=false, PduLength=64
        RDR_DETECTION_197_200_oPCAN_RADAR_8448b9bd_Tx: DynamicLength=false, PduLength=64, SysTPduToFrameMappingRef=RDR_DETECTION_197_200
        RDR_DETECTION_201_204_oPCAN_RADAR_02329f3e_Tx: DynamicLength=false, PduLength=64, SysTPduToFrameMappingRef=RDR_DETECTION_201_204
        RDR_DETECTION_201_204_oPCAN_RADAR_6c70b720_Tx: DynamicLength=false, PduLength=64
        RDR_DETECTION_205_208_oPCAN_RADAR_85c22914_Tx: DynamicLength=false, PduLength=64
        RDR_DETECTION_205_208_oPCAN_RADAR_db4e0b94_Tx: DynamicLength=false, PduLength=64, SysTPduToFrameMappingRef=RDR_DETECTION_205_208
        RDR_DETECTION_209_212_oPCAN_RADAR_4c39015c_Tx: DynamicLength=false, PduLength=64, SysTPduToFrameMappingRef=RDR_DETECTION_209_212
        RDR_DETECTION_209_212_oPCAN_RADAR_b78ac615_Tx: DynamicLength=false, PduLength=64
        RDR_DETECTION_213_216_oPCAN_RADAR_1c4c3a73_Tx: DynamicLength=false, PduLength=64, SysTPduToFrameMappingRef=RDR_DETECTION_213_216
        RDR_DETECTION_213_216_oPCAN_RADAR_aa4dc53b_Tx: DynamicLength=false, PduLength=64
        RDR_DETECTION_217_220_oPCAN_RADAR_05c118f2_Tx: DynamicLength=false, PduLength=64
        RDR_DETECTION_217_220_oPCAN_RADAR_a9b6fdbc_Tx: DynamicLength=false, PduLength=64, SysTPduToFrameMappingRef=RDR_DETECTION_217_220
        RDR_DETECTION_221_224_oPCAN_RADAR_88ca180e_Tx: DynamicLength=false, PduLength=64
        RDR_DETECTION_221_224_oPCAN_RADAR_8b56c0d7_Tx: DynamicLength=false, PduLength=64, SysTPduToFrameMappingRef=RDR_DETECTION_221_224
        RDR_DETECTION_225_228_oPCAN_RADAR_522a547d_Tx: DynamicLength=false, PduLength=64, SysTPduToFrameMappingRef=RDR_DETECTION_225_228
        RDR_DETECTION_225_228_oPCAN_RADAR_6178863a_Tx: DynamicLength=false, PduLength=64
        RDR_DETECTION_229_232_oPCAN_RADAR_5330693b_Tx: DynamicLength=false, PduLength=64
        RDR_DETECTION_229_232_oPCAN_RADAR_c55d5eb5_Tx: DynamicLength=false, PduLength=64, SysTPduToFrameMappingRef=RDR_DETECTION_229_232
        RDR_DETECTION_233_236_oPCAN_RADAR_4ef76a15_Tx: DynamicLength=false, PduLength=64
        RDR_DETECTION_233_236_oPCAN_RADAR_9528659a_Tx: DynamicLength=false, PduLength=64, SysTPduToFrameMappingRef=RDR_DETECTION_233_236
        RDR_DETECTION_237_240_oPCAN_RADAR_b2dbe68d_Tx: DynamicLength=false, PduLength=64, SysTPduToFrameMappingRef=RDR_DETECTION_237_240
        RDR_DETECTION_237_240_oPCAN_RADAR_f8d738c7_Tx: DynamicLength=false, PduLength=64
        RDR_DETECTION_241_244_oPCAN_RADAR_7e74ef3d_Tx: DynamicLength=false, PduLength=64
        RDR_DETECTION_241_244_oPCAN_RADAR_cb8b26ad_Tx: DynamicLength=false, PduLength=64, SysTPduToFrameMappingRef=RDR_DETECTION_241_244
        RDR_DETECTION_245_248_oPCAN_RADAR_12f7b207_Tx: DynamicLength=false, PduLength=64, SysTPduToFrameMappingRef=RDR_DETECTION_245_248
        RDR_DETECTION_245_248_oPCAN_RADAR_97c67109_Tx: DynamicLength=false, PduLength=64
        RDR_DETECTION_249_252_oPCAN_RADAR_8580b8cf_Tx: DynamicLength=false, PduLength=64, SysTPduToFrameMappingRef=RDR_DETECTION_249_252
        RDR_DETECTION_249_252_oPCAN_RADAR_a58e9e08_Tx: DynamicLength=false, PduLength=64
        RDR_DETECTION_253_256_oPCAN_RADAR_b8499d26_Tx: DynamicLength=false, PduLength=64
        RDR_DETECTION_253_256_oPCAN_RADAR_d5f583e0_Tx: DynamicLength=false, PduLength=64, SysTPduToFrameMappingRef=RDR_DETECTION_253_256
        RDR_DETECTION_257_260_oPCAN_RADAR_17c540ef_Tx: DynamicLength=false, PduLength=64
        RDR_DETECTION_257_260_oPCAN_RADAR_600f442f_Tx: DynamicLength=false, PduLength=64, SysTPduToFrameMappingRef=RDR_DETECTION_257_260
        RDR_DETECTION_261_264_oPCAN_RADAR_42ef7944_Tx: DynamicLength=false, PduLength=64, SysTPduToFrameMappingRef=RDR_DETECTION_261_264
        RDR_DETECTION_261_264_oPCAN_RADAR_9ace4013_Tx: DynamicLength=false, PduLength=64
        RDR_DETECTION_265_268_oPCAN_RADAR_737cde27_Tx: DynamicLength=false, PduLength=64
        RDR_DETECTION_265_268_oPCAN_RADAR_9b93edee_Tx: DynamicLength=false, PduLength=64, SysTPduToFrameMappingRef=RDR_DETECTION_265_268
        RDR_DETECTION_269_272_oPCAN_RADAR_0ce4e726_Tx: DynamicLength=false, PduLength=64, SysTPduToFrameMappingRef=RDR_DETECTION_269_272
        RDR_DETECTION_269_272_oPCAN_RADAR_41343126_Tx: DynamicLength=false, PduLength=64
        RDR_DETECTION_273_276_oPCAN_RADAR_5c91dc09_Tx: DynamicLength=false, PduLength=64, SysTPduToFrameMappingRef=RDR_DETECTION_273_276
        RDR_DETECTION_273_276_oPCAN_RADAR_5cf33208_Tx: DynamicLength=false, PduLength=64
        RDR_DETECTION_277_280_oPCAN_RADAR_8401d0ef_Tx: DynamicLength=false, PduLength=64, SysTPduToFrameMappingRef=RDR_DETECTION_277_280
        RDR_DETECTION_277_280_oPCAN_RADAR_d98a7eec_Tx: DynamicLength=false, PduLength=64
        RDR_DETECTION_281_284_oPCAN_RADAR_4878071a_Tx: DynamicLength=false, PduLength=64
        RDR_DETECTION_281_284_oPCAN_RADAR_4a30ea59_Tx: DynamicLength=false, PduLength=64, SysTPduToFrameMappingRef=RDR_DETECTION_281_284
        RDR_DETECTION_285_288_oPCAN_RADAR_934c7ef3_Tx: DynamicLength=false, PduLength=64, SysTPduToFrameMappingRef=RDR_DETECTION_285_288
        RDR_DETECTION_285_288_oPCAN_RADAR_a1ca992e_Tx: DynamicLength=false, PduLength=64
        RDR_DETECTION_289_292_oPCAN_RADAR_043b743b_Tx: DynamicLength=false, PduLength=64, SysTPduToFrameMappingRef=RDR_DETECTION_289_292
        RDR_DETECTION_289_292_oPCAN_RADAR_9382762f_Tx: DynamicLength=false, PduLength=64
        RDR_DETECTION_293_296_oPCAN_RADAR_544e4f14_Tx: DynamicLength=false, PduLength=64, SysTPduToFrameMappingRef=RDR_DETECTION_293_296
        RDR_DETECTION_293_296_oPCAN_RADAR_8e457501_Tx: DynamicLength=false, PduLength=64
        RDR_DETECTION_297_300_oPCAN_RADAR_4a05a9bb_Tx: DynamicLength=false, PduLength=64
        RDR_DETECTION_297_300_oPCAN_RADAR_984db28e_Tx: DynamicLength=false, PduLength=64, SysTPduToFrameMappingRef=RDR_DETECTION_297_300
        RDR_DETECTION_301_304_oPCAN_RADAR_0269ec90_Tx: DynamicLength=false, PduLength=64
        RDR_DETECTION_301_304_oPCAN_RADAR_8325835f_Tx: DynamicLength=false, PduLength=64, SysTPduToFrameMappingRef=RDR_DETECTION_301_304
        RDR_DETECTION_305_308_oPCAN_RADAR_5a5917f5_Tx: DynamicLength=false, PduLength=64, SysTPduToFrameMappingRef=RDR_DETECTION_305_308
        RDR_DETECTION_305_308_oPCAN_RADAR_ebdb72a4_Tx: DynamicLength=false, PduLength=64
        RDR_DETECTION_309_312_oPCAN_RADAR_cd2e1d3d_Tx: DynamicLength=false, PduLength=64, SysTPduToFrameMappingRef=RDR_DETECTION_309_312
        RDR_DETECTION_309_312_oPCAN_RADAR_d9939da5_Tx: DynamicLength=false, PduLength=64
        RDR_DETECTION_313_316_oPCAN_RADAR_9d5b2612_Tx: DynamicLength=false, PduLength=64, SysTPduToFrameMappingRef=RDR_DETECTION_313_316
        RDR_DETECTION_313_316_oPCAN_RADAR_c4549e8b_Tx: DynamicLength=false, PduLength=64
        RDR_DETECTION_317_320_oPCAN_RADAR_28a1e1dd_Tx: DynamicLength=false, PduLength=64, SysTPduToFrameMappingRef=RDR_DETECTION_317_320
        RDR_DETECTION_317_320_oPCAN_RADAR_6bd84342_Tx: DynamicLength=false, PduLength=64
        RDR_DETECTION_321_324_oPCAN_RADAR_0a41dcb6_Tx: DynamicLength=false, PduLength=64, SysTPduToFrameMappingRef=RDR_DETECTION_321_324
        RDR_DETECTION_321_324_oPCAN_RADAR_e6d343be_Tx: DynamicLength=false, PduLength=64
        RDR_DETECTION_325_328_oPCAN_RADAR_0f61dd8a_Tx: DynamicLength=false, PduLength=64
        RDR_DETECTION_325_328_oPCAN_RADAR_d33d481c_Tx: DynamicLength=false, PduLength=64, SysTPduToFrameMappingRef=RDR_DETECTION_325_328
        RDR_DETECTION_329_332_oPCAN_RADAR_3d29328b_Tx: DynamicLength=false, PduLength=64
        RDR_DETECTION_329_332_oPCAN_RADAR_444a42d4_Tx: DynamicLength=false, PduLength=64, SysTPduToFrameMappingRef=RDR_DETECTION_329_332
        RDR_DETECTION_333_336_oPCAN_RADAR_143f79fb_Tx: DynamicLength=false, PduLength=64, SysTPduToFrameMappingRef=RDR_DETECTION_333_336
        RDR_DETECTION_333_336_oPCAN_RADAR_20ee31a5_Tx: DynamicLength=false, PduLength=64
        RDR_DETECTION_337_340_oPCAN_RADAR_33ccfaec_Tx: DynamicLength=false, PduLength=64, SysTPduToFrameMappingRef=RDR_DETECTION_337_340
        RDR_DETECTION_337_340_oPCAN_RADAR_96ce6377_Tx: DynamicLength=false, PduLength=64
        RDR_DETECTION_341_344_oPCAN_RADAR_106db48d_Tx: DynamicLength=false, PduLength=64
        RDR_DETECTION_341_344_oPCAN_RADAR_4a9c3acc_Tx: DynamicLength=false, PduLength=64, SysTPduToFrameMappingRef=RDR_DETECTION_341_344
        RDR_DETECTION_345_348_oPCAN_RADAR_93e0ae66_Tx: DynamicLength=false, PduLength=64, SysTPduToFrameMappingRef=RDR_DETECTION_345_348
        RDR_DETECTION_345_348_oPCAN_RADAR_f9df2ab9_Tx: DynamicLength=false, PduLength=64
        RDR_DETECTION_349_352_oPCAN_RADAR_0497a4ae_Tx: DynamicLength=false, PduLength=64, SysTPduToFrameMappingRef=RDR_DETECTION_349_352
        RDR_DETECTION_349_352_oPCAN_RADAR_cb97c5b8_Tx: DynamicLength=false, PduLength=64
        RDR_DETECTION_353_356_oPCAN_RADAR_54e29f81_Tx: DynamicLength=false, PduLength=64, SysTPduToFrameMappingRef=RDR_DETECTION_353_356
        RDR_DETECTION_353_356_oPCAN_RADAR_d650c696_Tx: DynamicLength=false, PduLength=64
        RDR_DETECTION_357_360_oPCAN_RADAR_79dc1b5f_Tx: DynamicLength=false, PduLength=64
        RDR_DETECTION_357_360_oPCAN_RADAR_e118584e_Tx: DynamicLength=false, PduLength=64, SysTPduToFrameMappingRef=RDR_DETECTION_357_360
        RDR_DETECTION_361_364_oPCAN_RADAR_c3f86525_Tx: DynamicLength=false, PduLength=64, SysTPduToFrameMappingRef=RDR_DETECTION_361_364
        RDR_DETECTION_361_364_oPCAN_RADAR_f4d71ba3_Tx: DynamicLength=false, PduLength=64
        RDR_DETECTION_365_368_oPCAN_RADAR_1a84f18f_Tx: DynamicLength=false, PduLength=64, SysTPduToFrameMappingRef=RDR_DETECTION_365_368
        RDR_DETECTION_365_368_oPCAN_RADAR_1d658597_Tx: DynamicLength=false, PduLength=64
        RDR_DETECTION_369_372_oPCAN_RADAR_2f2d6a96_Tx: DynamicLength=false, PduLength=64
        RDR_DETECTION_369_372_oPCAN_RADAR_8df3fb47_Tx: DynamicLength=false, PduLength=64, SysTPduToFrameMappingRef=RDR_DETECTION_369_372
        RDR_DETECTION_373_376_oPCAN_RADAR_32ea69b8_Tx: DynamicLength=false, PduLength=64
        RDR_DETECTION_373_376_oPCAN_RADAR_dd86c068_Tx: DynamicLength=false, PduLength=64, SysTPduToFrameMappingRef=RDR_DETECTION_373_376
        RDR_DETECTION_377_380_oPCAN_RADAR_0516cc8e_Tx: DynamicLength=false, PduLength=64, SysTPduToFrameMappingRef=RDR_DETECTION_377_380
        RDR_DETECTION_377_380_oPCAN_RADAR_b793255c_Tx: DynamicLength=false, PduLength=64
        RDR_DETECTION_381_384_oPCAN_RADAR_26615caa_Tx: DynamicLength=false, PduLength=64
        RDR_DETECTION_381_384_oPCAN_RADAR_cb27f638_Tx: DynamicLength=false, PduLength=64, SysTPduToFrameMappingRef=RDR_DETECTION_381_384
        RDR_DETECTION_385_388_oPCAN_RADAR_125b6292_Tx: DynamicLength=false, PduLength=64, SysTPduToFrameMappingRef=RDR_DETECTION_385_388
        RDR_DETECTION_385_388_oPCAN_RADAR_cfd3c29e_Tx: DynamicLength=false, PduLength=64
        RDR_DETECTION_389_392_oPCAN_RADAR_852c685a_Tx: DynamicLength=false, PduLength=64, SysTPduToFrameMappingRef=RDR_DETECTION_389_392
        RDR_DETECTION_389_392_oPCAN_RADAR_fd9b2d9f_Tx: DynamicLength=false, PduLength=64
        RDR_DETECTION_393_396_oPCAN_RADAR_d5595375_Tx: DynamicLength=false, PduLength=64, SysTPduToFrameMappingRef=RDR_DETECTION_393_396
        RDR_DETECTION_393_396_oPCAN_RADAR_e05c2eb1_Tx: DynamicLength=false, PduLength=64
        RDR_DETECTION_397_400_oPCAN_RADAR_06e626f9_Tx: DynamicLength=false, PduLength=64
        RDR_DETECTION_397_400_oPCAN_RADAR_d58dd49c_Tx: DynamicLength=false, PduLength=64, SysTPduToFrameMappingRef=RDR_DETECTION_397_400
        RDR_DIAG_REQ_PHYS_Tp_oPCAN_RADAR_20_e3912bde_Rx: DynamicLength=false, PduLength=8, SysTPduToFrameMappingRef=RDR_DIAG_REQ_PHYS_Tp
        RDR_DIAG_REQ_PHYS_Tp_oPCAN_RADAR_25ac4fd7_Rx: DynamicLength=false, PduLength=64, SysTPduToFrameMappingRef=RDR_DIAG_REQ_PHYS_Tp
        RDR_DIAG_REQ_PHYS_oPCAN_RADAR_18f1addb_Rx: DynamicLength=true, PduLength=64
        RDR_DIAG_REQ_PHYS_oPCAN_RADAR_20_03c70ea5_Rx: DynamicLength=true, PduLength=8
        RDR_DIAG_REQ_PHYS_oPCAN_RADAR_20_ba1a6b88_Rx: DynamicLength=true, PduLength=8
        RDR_DIAG_REQ_PHYS_oPCAN_RADAR_aca186f0_Rx: DynamicLength=true, PduLength=64
        RDR_DIAG_RESP_PHYS_Tp_oPCAN_RADAR_20_66cb5f46_Tx: DynamicLength=false, PduLength=8, SysTPduToFrameMappingRef=RDR_DIAG_RESP_PHYS_Tp
        RDR_DIAG_RESP_PHYS_Tp_oPCAN_RADAR_b7c1ab06_Tx: DynamicLength=false, PduLength=64, SysTPduToFrameMappingRef=RDR_DIAG_RESP_PHYS_Tp
        RDR_DIAG_RESP_PHYS_oPCAN_RADAR_20_28778f59_Tx: DynamicLength=true, PduLength=8
        RDR_DIAG_RESP_PHYS_oPCAN_RADAR_20_2bb8c2dd_Tx: DynamicLength=true, PduLength=8
        RDR_DIAG_RESP_PHYS_oPCAN_RADAR_574db004_Tx: DynamicLength=true, PduLength=64
        RDR_DIAG_RESP_PHYS_oPCAN_RADAR_bc6ea15c_Tx: DynamicLength=true, PduLength=64
        RDR_DT_B0_Rx_oPCAN_RADAR_71206144_Rx: PduLength=8
        RDR_DT_B0_Rx_oPCAN_RADAR_ab9d960c_Rx: PduLength=8, SysTPduToFrameMappingRef=RDR_DT_B0_Rx
        RDR_DT_B1_Rx_oPCAN_RADAR_3eed4299_Rx: PduLength=8, SysTPduToFrameMappingRef=RDR_DT_B1_Rx
        RDR_DT_B1_Rx_oPCAN_RADAR_df48f0d5_Rx: PduLength=8
        RDR_FUSION_ALIGNMENT_STATUS_001_oPCAN_RADAR_5cbb3751_Rx: DynamicLength=false, PduLength=64
        RDR_FUSION_ALIGNMENT_STATUS_001_oPCAN_RADAR_e2456918_Rx: DynamicLength=false, PduLength=64, SysTPduToFrameMappingRef=RDR_FUSION_ALIGNMENT_STATUS_001
        RDR_FUSION_ALIGNMENT_STATUS_002_oPCAN_RADAR_b952d80d_Rx: DynamicLength=false, PduLength=64, SysTPduToFrameMappingRef=RDR_FUSION_ALIGNMENT_STATUS_002
        RDR_FUSION_ALIGNMENT_STATUS_002_oPCAN_RADAR_e1715b9f_Rx: DynamicLength=false, PduLength=64
        RDR_FUSION_CAPABILITY_oPCAN_RADAR_2f1662f1_Rx: DynamicLength=false, PduLength=64, SysTPduToFrameMappingRef=RDR_FUSION_CAPABILITY
        RDR_FUSION_CAPABILITY_oPCAN_RADAR_d81ad430_Rx: DynamicLength=false, PduLength=64
        RDR_FUSION_DET_001_004_oPCAN_RADAR_d39eadb5_Rx: DynamicLength=false, PduLength=64
        RDR_FUSION_DET_001_004_oPCAN_RADAR_d9a9ebb4_Rx: DynamicLength=false, PduLength=64, SysTPduToFrameMappingRef=RDR_FUSION_DET_001_004
        RDR_FUSION_DET_005_008_oPCAN_RADAR_00d57f1e_Rx: DynamicLength=false, PduLength=64, SysTPduToFrameMappingRef=RDR_FUSION_DET_005_008
        RDR_FUSION_DET_005_008_oPCAN_RADAR_3a2c3381_Rx: DynamicLength=false, PduLength=64
        RDR_FUSION_DET_009_012_oPCAN_RADAR_0864dc80_Rx: DynamicLength=false, PduLength=64
        RDR_FUSION_DET_009_012_oPCAN_RADAR_97a275d6_Rx: DynamicLength=false, PduLength=64, SysTPduToFrameMappingRef=RDR_FUSION_DET_009_012
        RDR_FUSION_DET_013_016_oPCAN_RADAR_15a3dfae_Rx: DynamicLength=false, PduLength=64
        RDR_FUSION_DET_013_016_oPCAN_RADAR_c7d74ef9_Rx: DynamicLength=false, PduLength=64, SysTPduToFrameMappingRef=RDR_FUSION_DET_013_016
        RDR_FUSION_DET_017_020_oPCAN_RADAR_722d8936_Rx: DynamicLength=false, PduLength=64, SysTPduToFrameMappingRef=RDR_FUSION_DET_017_020
        RDR_FUSION_DET_017_020_oPCAN_RADAR_ba2f0267_Rx: DynamicLength=false, PduLength=64
        RDR_FUSION_DET_021_024_oPCAN_RADAR_3724029b_Rx: DynamicLength=false, PduLength=64
        RDR_FUSION_DET_021_024_oPCAN_RADAR_50cdb45d_Rx: DynamicLength=false, PduLength=64, SysTPduToFrameMappingRef=RDR_FUSION_DET_021_024
        RDR_FUSION_DET_025_028_oPCAN_RADAR_89b120f7_Rx: DynamicLength=false, PduLength=64, SysTPduToFrameMappingRef=RDR_FUSION_DET_025_028
        RDR_FUSION_DET_025_028_oPCAN_RADAR_de969caf_Rx: DynamicLength=false, PduLength=64
        RDR_FUSION_DET_029_032_oPCAN_RADAR_1ec62a3f_Rx: DynamicLength=false, PduLength=64, SysTPduToFrameMappingRef=RDR_FUSION_DET_029_032
        RDR_FUSION_DET_029_032_oPCAN_RADAR_ecde73ae_Rx: DynamicLength=false, PduLength=64
        RDR_FUSION_DET_033_036_oPCAN_RADAR_4eb31110_Rx: DynamicLength=false, PduLength=64, SysTPduToFrameMappingRef=RDR_FUSION_DET_033_036
        RDR_FUSION_DET_033_036_oPCAN_RADAR_f1197080_Rx: DynamicLength=false, PduLength=64
        RDR_FUSION_DET_037_040_oPCAN_RADAR_47392252_Rx: DynamicLength=false, PduLength=64
        RDR_FUSION_DET_037_040_oPCAN_RADAR_69409207_Rx: DynamicLength=false, PduLength=64, SysTPduToFrameMappingRef=RDR_FUSION_DET_037_040
        RDR_FUSION_DET_041_044_oPCAN_RADAR_10105227_Rx: DynamicLength=false, PduLength=64, SysTPduToFrameMappingRef=RDR_FUSION_DET_041_044
        RDR_FUSION_DET_041_044_oPCAN_RADAR_c19af5a8_Rx: DynamicLength=false, PduLength=64
        RDR_FUSION_DET_045_048_oPCAN_RADAR_28286b9c_Rx: DynamicLength=false, PduLength=64
        RDR_FUSION_DET_045_048_oPCAN_RADAR_c96cc68d_Rx: DynamicLength=false, PduLength=64, SysTPduToFrameMappingRef=RDR_FUSION_DET_045_048
        RDR_FUSION_DET_049_052_oPCAN_RADAR_1a60849d_Rx: DynamicLength=false, PduLength=64
        RDR_FUSION_DET_049_052_oPCAN_RADAR_5e1bcc45_Rx: DynamicLength=false, PduLength=64, SysTPduToFrameMappingRef=RDR_FUSION_DET_049_052
        RDR_FUSION_DET_053_056_oPCAN_RADAR_07a787b3_Rx: DynamicLength=false, PduLength=64
        RDR_FUSION_DET_053_056_oPCAN_RADAR_0e6ef76a_Rx: DynamicLength=false, PduLength=64, SysTPduToFrameMappingRef=RDR_FUSION_DET_053_056
        RDR_FUSION_DET_057_060_oPCAN_RADAR_a82b5a7a_Rx: DynamicLength=false, PduLength=64
        RDR_FUSION_DET_057_060_oPCAN_RADAR_bb9430a5_Rx: DynamicLength=false, PduLength=64, SysTPduToFrameMappingRef=RDR_FUSION_DET_057_060
        RDR_FUSION_DET_061_064_oPCAN_RADAR_25205a86_Rx: DynamicLength=false, PduLength=64
        RDR_FUSION_DET_061_064_oPCAN_RADAR_99740dce_Rx: DynamicLength=false, PduLength=64, SysTPduToFrameMappingRef=RDR_FUSION_DET_061_064
        RDR_FUSION_DET_065_068_oPCAN_RADAR_40089964_Rx: DynamicLength=false, PduLength=64, SysTPduToFrameMappingRef=RDR_FUSION_DET_065_068
        RDR_FUSION_DET_065_068_oPCAN_RADAR_cc92c4b2_Rx: DynamicLength=false, PduLength=64
        RDR_FUSION_DET_069_072_oPCAN_RADAR_d77f93ac_Rx: DynamicLength=false, PduLength=64, SysTPduToFrameMappingRef=RDR_FUSION_DET_069_072
        RDR_FUSION_DET_069_072_oPCAN_RADAR_feda2bb3_Rx: DynamicLength=false, PduLength=64
        RDR_FUSION_DET_073_076_oPCAN_RADAR_870aa883_Rx: DynamicLength=false, PduLength=64, SysTPduToFrameMappingRef=RDR_FUSION_DET_073_076
        RDR_FUSION_DET_073_076_oPCAN_RADAR_e31d289d_Rx: DynamicLength=false, PduLength=64
        RDR_FUSION_DET_077_080_oPCAN_RADAR_5f9aa465_Rx: DynamicLength=false, PduLength=64, SysTPduToFrameMappingRef=RDR_FUSION_DET_077_080
        RDR_FUSION_DET_077_080_oPCAN_RADAR_66646479_Rx: DynamicLength=false, PduLength=64
        RDR_FUSION_DET_081_084_oPCAN_RADAR_91ab9ed3_Rx: DynamicLength=false, PduLength=64, SysTPduToFrameMappingRef=RDR_FUSION_DET_081_084
        RDR_FUSION_DET_081_084_oPCAN_RADAR_f7961d8f_Rx: DynamicLength=false, PduLength=64
        RDR_FUSION_DET_085_088_oPCAN_RADAR_1e2483bb_Rx: DynamicLength=false, PduLength=64
        RDR_FUSION_DET_085_088_oPCAN_RADAR_48d70a79_Rx: DynamicLength=false, PduLength=64, SysTPduToFrameMappingRef=RDR_FUSION_DET_085_088
        RDR_FUSION_DET_089_092_oPCAN_RADAR_2c6c6cba_Rx: DynamicLength=false, PduLength=64
        RDR_FUSION_DET_089_092_oPCAN_RADAR_dfa000b1_Rx: DynamicLength=false, PduLength=64, SysTPduToFrameMappingRef=RDR_FUSION_DET_089_092
        RDR_FUSION_DET_093_096_oPCAN_RADAR_31ab6f94_Rx: DynamicLength=false, PduLength=64
        RDR_FUSION_DET_093_096_oPCAN_RADAR_8fd53b9e_Rx: DynamicLength=false, PduLength=64, SysTPduToFrameMappingRef=RDR_FUSION_DET_093_096
        RDR_FUSION_DET_097_100_oPCAN_RADAR_43d6c604_Rx: DynamicLength=false, PduLength=64, SysTPduToFrameMappingRef=RDR_FUSION_DET_097_100
        RDR_FUSION_DET_097_100_oPCAN_RADAR_f5ebb32e_Rx: DynamicLength=false, PduLength=64
        RDR_FUSION_DET_101_104_oPCAN_RADAR_58bef7d5_Rx: DynamicLength=false, PduLength=64, SysTPduToFrameMappingRef=RDR_FUSION_DET_101_104
        RDR_FUSION_DET_101_104_oPCAN_RADAR_bd87f605_Rx: DynamicLength=false, PduLength=64
        RDR_FUSION_DET_105_108_oPCAN_RADAR_54356831_Rx: DynamicLength=false, PduLength=64
        RDR_FUSION_DET_105_108_oPCAN_RADAR_81c2637f_Rx: DynamicLength=false, PduLength=64, SysTPduToFrameMappingRef=RDR_FUSION_DET_105_108
        RDR_FUSION_DET_109_112_oPCAN_RADAR_16b569b7_Rx: DynamicLength=false, PduLength=64, SysTPduToFrameMappingRef=RDR_FUSION_DET_109_112
        RDR_FUSION_DET_109_112_oPCAN_RADAR_667d8730_Rx: DynamicLength=false, PduLength=64
        RDR_FUSION_DET_113_116_oPCAN_RADAR_46c05298_Rx: DynamicLength=false, PduLength=64, SysTPduToFrameMappingRef=RDR_FUSION_DET_113_116
        RDR_FUSION_DET_113_116_oPCAN_RADAR_7bba841e_Rx: DynamicLength=false, PduLength=64
        RDR_FUSION_DET_117_120_oPCAN_RADAR_d43659d7_Rx: DynamicLength=false, PduLength=64
        RDR_FUSION_DET_117_120_oPCAN_RADAR_f33a9557_Rx: DynamicLength=false, PduLength=64, SysTPduToFrameMappingRef=RDR_FUSION_DET_117_120
        RDR_FUSION_DET_121_124_oPCAN_RADAR_593d592b_Rx: DynamicLength=false, PduLength=64
        RDR_FUSION_DET_121_124_oPCAN_RADAR_d1daa83c_Rx: DynamicLength=false, PduLength=64, SysTPduToFrameMappingRef=RDR_FUSION_DET_121_124
        RDR_FUSION_DET_125_128_oPCAN_RADAR_08a63c96_Rx: DynamicLength=false, PduLength=64, SysTPduToFrameMappingRef=RDR_FUSION_DET_125_128
        RDR_FUSION_DET_125_128_oPCAN_RADAR_b08fc71f_Rx: DynamicLength=false, PduLength=64
        RDR_FUSION_HEADER_001_oPCAN_RADAR_204bf532_Rx: DynamicLength=false, PduLength=64, SysTPduToFrameMappingRef=RDR_FUSION_HEADER_001
        RDR_FUSION_HEADER_001_oPCAN_RADAR_cc468fbf_Rx: DynamicLength=false, PduLength=64
        RDR_FUSION_STATUS_001_oPCAN_RADAR_8bf3739d_Rx: DynamicLength=false, PduLength=64
        RDR_FUSION_STATUS_001_oPCAN_RADAR_b6cfc045_Rx: DynamicLength=false, PduLength=64, SysTPduToFrameMappingRef=RDR_FUSION_STATUS_001
        RDR_FUSION_STATUS_002_oPCAN_RADAR_36391f53_Rx: DynamicLength=false, PduLength=64
        RDR_FUSION_STATUS_002_oPCAN_RADAR_edd87150_Rx: DynamicLength=false, PduLength=64, SysTPduToFrameMappingRef=RDR_FUSION_STATUS_002
        RDR_HEADER_001_oPCAN_RADAR_0cd81ee7_Tx: DynamicLength=false, PduLength=64
        RDR_HEADER_001_oPCAN_RADAR_48304dbd_Tx: DynamicLength=false, PduLength=64, SysTPduToFrameMappingRef=RDR_HEADER_001
        RDR_IDSM_Audit_Log_Tp_oPCAN_RADAR_ea04d42a_Tx: DynamicLength=false, PduLength=64, SysTPduToFrameMappingRef=RDR_IDSM_Audit_Log_Tp
        RDR_NM_oPCAN_RADAR_21bce8cc_Tx: DynamicLength=false, PduLength=64, SysTPduToFrameMappingRef=RDR_NM
        RDR_NM_oPCAN_RADAR_e768d4ad_Tx
        RDR_OBJ_HEADER_002_oPCAN_RADAR_018ea437_Tx: DynamicLength=false, PduLength=64, SysTPduToFrameMappingRef=RDR_OBJ_HEADER_002
        RDR_OBJ_HEADER_002_oPCAN_RADAR_1ea433e3_Tx: DynamicLength=false, PduLength=64
        RDR_OBJ_STATUS_003_oPCAN_RADAR_84871644_Tx: DynamicLength=false, PduLength=64
        RDR_OBJ_STATUS_003_oPCAN_RADAR_a1f801b3_Tx: DynamicLength=false, PduLength=64, SysTPduToFrameMappingRef=RDR_OBJ_STATUS_003
        RDR_STATUS_001_oPCAN_RADAR_4b6de2c5_Tx: DynamicLength=false, PduLength=64
        RDR_STATUS_001_oPCAN_RADAR_deb478ca_Tx: DynamicLength=false, PduLength=64, SysTPduToFrameMappingRef=RDR_STATUS_001
        RDR_STATUS_002_oPCAN_RADAR_85a3c9df_Tx: DynamicLength=false, PduLength=64, SysTPduToFrameMappingRef=RDR_STATUS_002
        RDR_STATUS_002_oPCAN_RADAR_f6a78e0b_Tx: DynamicLength=false, PduLength=64
        RDR_TRACKER_OBJ_001_oPCAN_RADAR_2e87fb56_Tx: DynamicLength=false, PduLength=64
        RDR_TRACKER_OBJ_001_oPCAN_RADAR_eb452802_Tx: DynamicLength=false, PduLength=64, SysTPduToFrameMappingRef=RDR_TRACKER_OBJ_001
        RDR_TRACKER_OBJ_002_oPCAN_RADAR_934d9798_Tx: DynamicLength=false, PduLength=64
        RDR_TRACKER_OBJ_002_oPCAN_RADAR_b0529917_Tx: DynamicLength=false, PduLength=64, SysTPduToFrameMappingRef=RDR_TRACKER_OBJ_002
        RDR_TRACKER_OBJ_003_oPCAN_RADAR_4edb4e1d_Tx: DynamicLength=false, PduLength=64
        RDR_TRACKER_OBJ_003_oPCAN_RADAR_86a009e4_Tx: DynamicLength=false, PduLength=64, SysTPduToFrameMappingRef=RDR_TRACKER_OBJ_003
        RDR_TRACKER_OBJ_004_oPCAN_RADAR_067dfb3d_Tx: DynamicLength=false, PduLength=64, SysTPduToFrameMappingRef=RDR_TRACKER_OBJ_004
        RDR_TRACKER_OBJ_004_oPCAN_RADAR_33a84845_Tx: DynamicLength=false, PduLength=64
        RDR_TRACKER_OBJ_005_oPCAN_RADAR_308f6bce_Tx: DynamicLength=false, PduLength=64, SysTPduToFrameMappingRef=RDR_TRACKER_OBJ_005
        RDR_TRACKER_OBJ_005_oPCAN_RADAR_ee3e91c0_Tx: DynamicLength=false, PduLength=64
        RDR_TRACKER_OBJ_006_oPCAN_RADAR_53f4fd0e_Tx: DynamicLength=false, PduLength=64
        RDR_TRACKER_OBJ_006_oPCAN_RADAR_6b98dadb_Tx: DynamicLength=false, PduLength=64, SysTPduToFrameMappingRef=RDR_TRACKER_OBJ_006
        RDR_TRACKER_OBJ_007_oPCAN_RADAR_5d6a4a28_Tx: DynamicLength=false, PduLength=64, SysTPduToFrameMappingRef=RDR_TRACKER_OBJ_007
        RDR_TRACKER_OBJ_007_oPCAN_RADAR_8e62248b_Tx: DynamicLength=false, PduLength=64
        RDR_TRACKER_OBJ_008_oPCAN_RADAR_a912f1be_Tx: DynamicLength=false, PduLength=64
        RDR_TRACKER_OBJ_008_oPCAN_RADAR_b1523928_Tx: DynamicLength=false, PduLength=64, SysTPduToFrameMappingRef=RDR_TRACKER_OBJ_008
        RDR_TRACKER_OBJ_009_oPCAN_RADAR_7484283b_Tx: DynamicLength=false, PduLength=64
        RDR_TRACKER_OBJ_009_oPCAN_RADAR_87a0a9db_Tx: DynamicLength=false, PduLength=64, SysTPduToFrameMappingRef=RDR_TRACKER_OBJ_009
        RDR_TRACKER_OBJ_010_oPCAN_RADAR_6e1ec3a5_Tx: DynamicLength=false, PduLength=64
        RDR_TRACKER_OBJ_010_oPCAN_RADAR_f935e9c7_Tx: DynamicLength=false, PduLength=64, SysTPduToFrameMappingRef=RDR_TRACKER_OBJ_010
        RDR_TRACKER_OBJ_011_oPCAN_RADAR_b3881a20_Tx: DynamicLength=false, PduLength=64
        RDR_TRACKER_OBJ_011_oPCAN_RADAR_cfc77934_Tx: DynamicLength=false, PduLength=64, SysTPduToFrameMappingRef=RDR_TRACKER_OBJ_011
        RDR_TRACKER_OBJ_012_oPCAN_RADAR_0e4276ee_Tx: DynamicLength=false, PduLength=64
        RDR_TRACKER_OBJ_012_oPCAN_RADAR_94d0c821_Tx: DynamicLength=false, PduLength=64, SysTPduToFrameMappingRef=RDR_TRACKER_OBJ_012
        RDR_TRACKER_OBJ_013_oPCAN_RADAR_a22258d2_Tx: DynamicLength=false, PduLength=64, SysTPduToFrameMappingRef=RDR_TRACKER_OBJ_013
        RDR_TRACKER_OBJ_013_oPCAN_RADAR_d3d4af6b_Tx: DynamicLength=false, PduLength=64
        RDR_TRACKER_OBJ_014_oPCAN_RADAR_22ffaa0b_Tx: DynamicLength=false, PduLength=64, SysTPduToFrameMappingRef=RDR_TRACKER_OBJ_014
        RDR_TRACKER_OBJ_014_oPCAN_RADAR_aea7a933_Tx: DynamicLength=false, PduLength=64
        RDR_TRACKER_OBJ_015_oPCAN_RADAR_140d3af8_Tx: DynamicLength=false, PduLength=64, SysTPduToFrameMappingRef=RDR_TRACKER_OBJ_015
        RDR_TRACKER_OBJ_015_oPCAN_RADAR_733170b6_Tx: DynamicLength=false, PduLength=64
        RDR_TRACKER_OBJ_016_oPCAN_RADAR_4f1a8bed_Tx: DynamicLength=false, PduLength=64, SysTPduToFrameMappingRef=RDR_TRACKER_OBJ_016
        RDR_TRACKER_OBJ_016_oPCAN_RADAR_cefb1c78_Tx: DynamicLength=false, PduLength=64
        RDR_TRACKER_OBJ_017_oPCAN_RADAR_136dc5fd_Tx: DynamicLength=false, PduLength=64
        RDR_TRACKER_OBJ_017_oPCAN_RADAR_79e81b1e_Tx: DynamicLength=false, PduLength=64, SysTPduToFrameMappingRef=RDR_TRACKER_OBJ_017
        RDR_TRACKER_OBJ_018_oPCAN_RADAR_341d10c8_Tx: DynamicLength=false, PduLength=64
        RDR_TRACKER_OBJ_018_oPCAN_RADAR_95d0681e_Tx: DynamicLength=false, PduLength=64, SysTPduToFrameMappingRef=RDR_TRACKER_OBJ_018
        RDR_TRACKER_OBJ_019_oPCAN_RADAR_a322f8ed_Tx: DynamicLength=false, PduLength=64, SysTPduToFrameMappingRef=RDR_TRACKER_OBJ_019
        RDR_TRACKER_OBJ_019_oPCAN_RADAR_e98bc94d_Tx: DynamicLength=false, PduLength=64
        RDR_TRACKER_OBJ_020_oPCAN_RADAR_127fe67e_Tx: DynamicLength=false, PduLength=64
        RDR_TRACKER_OBJ_020_oPCAN_RADAR_94b31a9d_Tx: DynamicLength=false, PduLength=64, SysTPduToFrameMappingRef=RDR_TRACKER_OBJ_020
        RDR_TRACKER_OBJ_021_oPCAN_RADAR_a2418a6e_Tx: DynamicLength=false, PduLength=64, SysTPduToFrameMappingRef=RDR_TRACKER_OBJ_021
        RDR_TRACKER_OBJ_021_oPCAN_RADAR_cfe93ffb_Tx: DynamicLength=false, PduLength=64
        RDR_TRACKER_OBJ_022_oPCAN_RADAR_72235335_Tx: DynamicLength=false, PduLength=64
        RDR_TRACKER_OBJ_022_oPCAN_RADAR_f9563b7b_Tx: DynamicLength=false, PduLength=64, SysTPduToFrameMappingRef=RDR_TRACKER_OBJ_022
        RDR_TRACKER_OBJ_023_oPCAN_RADAR_afb58ab0_Tx: DynamicLength=false, PduLength=64
        RDR_TRACKER_OBJ_023_oPCAN_RADAR_cfa4ab88_Tx: DynamicLength=false, PduLength=64, SysTPduToFrameMappingRef=RDR_TRACKER_OBJ_023
        RDR_TRACKER_OBJ_024_oPCAN_RADAR_4f795951_Tx: DynamicLength=false, PduLength=64, SysTPduToFrameMappingRef=RDR_TRACKER_OBJ_024
        RDR_TRACKER_OBJ_024_oPCAN_RADAR_d2c68ce8_Tx: DynamicLength=false, PduLength=64
        RDR_TRACKER_OBJ_025_oPCAN_RADAR_0f50556d_Tx: DynamicLength=false, PduLength=64
        RDR_TRACKER_OBJ_025_oPCAN_RADAR_798bc9a2_Tx: DynamicLength=false, PduLength=64, SysTPduToFrameMappingRef=RDR_TRACKER_OBJ_025
        RDR_TRACKER_OBJ_026_oPCAN_RADAR_229c78b7_Tx: DynamicLength=false, PduLength=64, SysTPduToFrameMappingRef=RDR_TRACKER_OBJ_026
        RDR_TRACKER_OBJ_026_oPCAN_RADAR_b29a39a3_Tx: DynamicLength=false, PduLength=64
        RDR_TRACKER_OBJ_027_oPCAN_RADAR_146ee844_Tx: DynamicLength=false, PduLength=64, SysTPduToFrameMappingRef=RDR_TRACKER_OBJ_027
        RDR_TRACKER_OBJ_027_oPCAN_RADAR_6f0ce026_Tx: DynamicLength=false, PduLength=64
        RDR_TRACKER_OBJ_028_oPCAN_RADAR_487c3513_Tx: DynamicLength=false, PduLength=64
        RDR_TRACKER_OBJ_028_oPCAN_RADAR_f8569b44_Tx: DynamicLength=false, PduLength=64, SysTPduToFrameMappingRef=RDR_TRACKER_OBJ_028
        RDR_TRACKER_OBJ_029_oPCAN_RADAR_95eaec96_Tx: DynamicLength=false, PduLength=64
        RDR_TRACKER_OBJ_029_oPCAN_RADAR_cea40bb7_Tx: DynamicLength=false, PduLength=64, SysTPduToFrameMappingRef=RDR_TRACKER_OBJ_029
        RDR_TRACKER_OBJ_030_oPCAN_RADAR_8f700708_Tx: DynamicLength=false, PduLength=64
        RDR_TRACKER_OBJ_030_oPCAN_RADAR_b0314bab_Tx: DynamicLength=false, PduLength=64, SysTPduToFrameMappingRef=RDR_TRACKER_OBJ_030
        RDR_TRACKER_OBJ_031_oPCAN_RADAR_52e6de8d_Tx: DynamicLength=false, PduLength=64
        RDR_TRACKER_OBJ_031_oPCAN_RADAR_86c3db58_Tx: DynamicLength=false, PduLength=64, SysTPduToFrameMappingRef=RDR_TRACKER_OBJ_031
        RDR_TRACKER_OBJ_032_oPCAN_RADAR_ddd46a4d_Tx: DynamicLength=false, PduLength=64, SysTPduToFrameMappingRef=RDR_TRACKER_OBJ_032
        RDR_TRACKER_OBJ_032_oPCAN_RADAR_ef2cb243_Tx: DynamicLength=false, PduLength=64
        RDR_TRACKER_OBJ_033_oPCAN_RADAR_32ba6bc6_Tx: DynamicLength=false, PduLength=64
        RDR_TRACKER_OBJ_033_oPCAN_RADAR_eb26fabe_Tx: DynamicLength=false, PduLength=64, SysTPduToFrameMappingRef=RDR_TRACKER_OBJ_033
        RDR_TRACKER_OBJ_034_oPCAN_RADAR_4fc96d9e_Tx: DynamicLength=false, PduLength=64
        RDR_TRACKER_OBJ_034_oPCAN_RADAR_6bfb0867_Tx: DynamicLength=false, PduLength=64, SysTPduToFrameMappingRef=RDR_TRACKER_OBJ_034
        RDR_TRACKER_OBJ_035_oPCAN_RADAR_5d099894_Tx: DynamicLength=false, PduLength=64, SysTPduToFrameMappingRef=RDR_TRACKER_OBJ_035
        RDR_TRACKER_OBJ_035_oPCAN_RADAR_925fb41b_Tx: DynamicLength=false, PduLength=64
        RDR_TRACKER_OBJ_036_oPCAN_RADAR_061e2981_Tx: DynamicLength=false, PduLength=64, SysTPduToFrameMappingRef=RDR_TRACKER_OBJ_036
        RDR_TRACKER_OBJ_036_oPCAN_RADAR_2f95d8d5_Tx: DynamicLength=false, PduLength=64
        RDR_TRACKER_OBJ_037_oPCAN_RADAR_30ecb972_Tx: DynamicLength=false, PduLength=64, SysTPduToFrameMappingRef=RDR_TRACKER_OBJ_037
        RDR_TRACKER_OBJ_037_oPCAN_RADAR_f2030150_Tx: DynamicLength=false, PduLength=64
        RDR_TRACKER_OBJ_038_oPCAN_RADAR_d573d465_Tx: DynamicLength=false, PduLength=64
        RDR_TRACKER_OBJ_038_oPCAN_RADAR_dcd4ca72_Tx: DynamicLength=false, PduLength=64, SysTPduToFrameMappingRef=RDR_TRACKER_OBJ_038
        RDR_TRACKER_OBJ_039_oPCAN_RADAR_08e50de0_Tx: DynamicLength=false, PduLength=64
        RDR_TRACKER_OBJ_039_oPCAN_RADAR_ea265a81_Tx: DynamicLength=false, PduLength=64, SysTPduToFrameMappingRef=RDR_TRACKER_OBJ_039
        RDR_TRACKER_OBJ_040_oPCAN_RADAR_4fbefc29_Tx: DynamicLength=false, PduLength=64, SysTPduToFrameMappingRef=RDR_TRACKER_OBJ_040
        RDR_TRACKER_OBJ_040_oPCAN_RADAR_eabdadc8_Tx: DynamicLength=false, PduLength=64
        RDR_TRACKER_OBJ_041_oPCAN_RADAR_372b744d_Tx: DynamicLength=false, PduLength=64
        RDR_TRACKER_OBJ_041_oPCAN_RADAR_794c6cda_Tx: DynamicLength=false, PduLength=64, SysTPduToFrameMappingRef=RDR_TRACKER_OBJ_041
        RDR_TRACKER_OBJ_042_oPCAN_RADAR_225bddcf_Tx: DynamicLength=false, PduLength=64, SysTPduToFrameMappingRef=RDR_TRACKER_OBJ_042
        RDR_TRACKER_OBJ_042_oPCAN_RADAR_8ae11883_Tx: DynamicLength=false, PduLength=64
        RDR_TRACKER_OBJ_043_oPCAN_RADAR_14a94d3c_Tx: DynamicLength=false, PduLength=64, SysTPduToFrameMappingRef=RDR_TRACKER_OBJ_043
        RDR_TRACKER_OBJ_043_oPCAN_RADAR_5777c106_Tx: DynamicLength=false, PduLength=64
        RDR_TRACKER_OBJ_044_oPCAN_RADAR_2a04c75e_Tx: DynamicLength=false, PduLength=64
        RDR_TRACKER_OBJ_044_oPCAN_RADAR_9474bfe5_Tx: DynamicLength=false, PduLength=64, SysTPduToFrameMappingRef=RDR_TRACKER_OBJ_044
        RDR_TRACKER_OBJ_045_oPCAN_RADAR_a2862f16_Tx: DynamicLength=false, PduLength=64, SysTPduToFrameMappingRef=RDR_TRACKER_OBJ_045
        RDR_TRACKER_OBJ_045_oPCAN_RADAR_f7921edb_Tx: DynamicLength=false, PduLength=64
        RDR_TRACKER_OBJ_046_oPCAN_RADAR_4a587215_Tx: DynamicLength=false, PduLength=64
        RDR_TRACKER_OBJ_046_oPCAN_RADAR_f9919e03_Tx: DynamicLength=false, PduLength=64, SysTPduToFrameMappingRef=RDR_TRACKER_OBJ_046
        RDR_TRACKER_OBJ_047_oPCAN_RADAR_97ceab90_Tx: DynamicLength=false, PduLength=64
        RDR_TRACKER_OBJ_047_oPCAN_RADAR_cf630ef0_Tx: DynamicLength=false, PduLength=64, SysTPduToFrameMappingRef=RDR_TRACKER_OBJ_047
        RDR_TRACKER_OBJ_048_oPCAN_RADAR_235b7df0_Tx: DynamicLength=false, PduLength=64, SysTPduToFrameMappingRef=RDR_TRACKER_OBJ_048
        RDR_TRACKER_OBJ_048_oPCAN_RADAR_b0be7ea5_Tx: DynamicLength=false, PduLength=64
        RDR_TRACKER_OBJ_049_oPCAN_RADAR_15a9ed03_Tx: DynamicLength=false, PduLength=64, SysTPduToFrameMappingRef=RDR_TRACKER_OBJ_049
        RDR_TRACKER_OBJ_049_oPCAN_RADAR_6d28a720_Tx: DynamicLength=false, PduLength=64
        RDR_TRACKER_OBJ_050_oPCAN_RADAR_6b3cad1f_Tx: DynamicLength=false, PduLength=64, SysTPduToFrameMappingRef=RDR_TRACKER_OBJ_050
        RDR_TRACKER_OBJ_050_oPCAN_RADAR_77b24cbe_Tx: DynamicLength=false, PduLength=64
        RDR_TRACKER_OBJ_051_oPCAN_RADAR_5dce3dec_Tx: DynamicLength=false, PduLength=64, SysTPduToFrameMappingRef=RDR_TRACKER_OBJ_051
        RDR_TRACKER_OBJ_051_oPCAN_RADAR_aa24953b_Tx: DynamicLength=false, PduLength=64
        RDR_TRACKER_OBJ_052_oPCAN_RADAR_06d98cf9_Tx: DynamicLength=false, PduLength=64, SysTPduToFrameMappingRef=RDR_TRACKER_OBJ_052
        RDR_TRACKER_OBJ_052_oPCAN_RADAR_17eef9f5_Tx: DynamicLength=false, PduLength=64
        RDR_TRACKER_OBJ_053_oPCAN_RADAR_302b1c0a_Tx: DynamicLength=false, PduLength=64, SysTPduToFrameMappingRef=RDR_TRACKER_OBJ_053
        RDR_TRACKER_OBJ_053_oPCAN_RADAR_ca782070_Tx: DynamicLength=false, PduLength=64
        RDR_TRACKER_OBJ_054_oPCAN_RADAR_b0f6eed3_Tx: DynamicLength=false, PduLength=64, SysTPduToFrameMappingRef=RDR_TRACKER_OBJ_054
        RDR_TRACKER_OBJ_054_oPCAN_RADAR_b70b2628_Tx: DynamicLength=false, PduLength=64
        RDR_TRACKER_OBJ_055_oPCAN_RADAR_6a9dffad_Tx: DynamicLength=false, PduLength=64
        RDR_TRACKER_OBJ_055_oPCAN_RADAR_86047e20_Tx: DynamicLength=false, PduLength=64, SysTPduToFrameMappingRef=RDR_TRACKER_OBJ_055
        RDR_TRACKER_OBJ_056_oPCAN_RADAR_d7579363_Tx: DynamicLength=false, PduLength=64
        RDR_TRACKER_OBJ_056_oPCAN_RADAR_dd13cf35_Tx: DynamicLength=false, PduLength=64, SysTPduToFrameMappingRef=RDR_TRACKER_OBJ_056
        RDR_TRACKER_OBJ_057_oPCAN_RADAR_0ac14ae6_Tx: DynamicLength=false, PduLength=64
        RDR_TRACKER_OBJ_057_oPCAN_RADAR_ebe15fc6_Tx: DynamicLength=false, PduLength=64, SysTPduToFrameMappingRef=RDR_TRACKER_OBJ_057
        RDR_TRACKER_OBJ_058_oPCAN_RADAR_07d92cc6_Tx: DynamicLength=false, PduLength=64, SysTPduToFrameMappingRef=RDR_TRACKER_OBJ_058
        RDR_TRACKER_OBJ_058_oPCAN_RADAR_2db19fd3_Tx: DynamicLength=false, PduLength=64
        RDR_TRACKER_OBJ_059_oPCAN_RADAR_312bbc35_Tx: DynamicLength=false, PduLength=64, SysTPduToFrameMappingRef=RDR_TRACKER_OBJ_059
        RDR_TRACKER_OBJ_059_oPCAN_RADAR_f0274656_Tx: DynamicLength=false, PduLength=64
        RDR_TRACKER_OBJ_060_oPCAN_RADAR_06ba5e45_Tx: DynamicLength=false, PduLength=64, SysTPduToFrameMappingRef=RDR_TRACKER_OBJ_060
        RDR_TRACKER_OBJ_060_oPCAN_RADAR_0bd36965_Tx: DynamicLength=false, PduLength=64
        RDR_TRACKER_OBJ_061_oPCAN_RADAR_3048ceb6_Tx: DynamicLength=false, PduLength=64, SysTPduToFrameMappingRef=RDR_TRACKER_OBJ_061
        RDR_TRACKER_OBJ_061_oPCAN_RADAR_d645b0e0_Tx: DynamicLength=false, PduLength=64
        RDR_TRACKER_OBJ_062_oPCAN_RADAR_6b5f7fa3_Tx: DynamicLength=false, PduLength=64, SysTPduToFrameMappingRef=RDR_TRACKER_OBJ_062
        RDR_TRACKER_OBJ_062_oPCAN_RADAR_6b8fdc2e_Tx: DynamicLength=false, PduLength=64
        RDR_TRACKER_OBJ_063_oPCAN_RADAR_5dadef50_Tx: DynamicLength=false, PduLength=64, SysTPduToFrameMappingRef=RDR_TRACKER_OBJ_063
        RDR_TRACKER_OBJ_063_oPCAN_RADAR_b61905ab_Tx: DynamicLength=false, PduLength=64
        RDR_TRACKER_OBJ_064_oPCAN_RADAR_cb6a03f3_Tx: DynamicLength=false, PduLength=64
        RDR_TRACKER_OBJ_064_oPCAN_RADAR_dd701d89_Tx: DynamicLength=false, PduLength=64, SysTPduToFrameMappingRef=RDR_TRACKER_OBJ_064
        RDR_XCP_CTO_REQ_oPCAN_RADAR_52b29e1b_Rx: DynamicLength=false, PduLength=64
        RDR_XCP_CTO_REQ_oPCAN_RADAR_5b59bad2_Rx: DynamicLength=false, PduLength=64, SysTPduToFrameMappingRef=RDR_XCP_CTO_REQ
        RDR_XCP_CTO_RESP_oPCAN_RADAR_8537261d_Tx: DynamicLength=false, PduLength=64
        RDR_XCP_CTO_RESP_oPCAN_RADAR_e3946380_Tx: DynamicLength=false, PduLength=64, SysTPduToFrameMappingRef=RDR_XCP_CTO_RESP
        RDR_XCP_DAQ_RESP_oPCAN_RADAR_1cc015b8_Tx: DynamicLength=false, PduLength=64, SysTPduToFrameMappingRef=RDR_XCP_DAQ_RESP
        RDR_XCP_DAQ_RESP_oPCAN_RADAR_7e3578af_Tx: DynamicLength=false, PduLength=64
        RDR_prop_ADAS_BSIS_info_oPCAN_RADAR_e19e3fbb_Rx: PduLength=8, SysTPduToFrameMappingRef=RDR_prop_ADAS_BSIS_info
        SAS_oVCAN_RADAR_efd6af4d_Rx: DynamicLength=false, J1939Requestable=true, PduLength=8, SysTPduToFrameMappingRef=SAS
        SAS_oVCAN_RADAR_fe45d49a_Rx: DynamicLength=false, J1939Requestable=true, PduLength=8
        SOFT_D0_oVCAN_RADAR_027b5984_Tx: DynamicLength=false, J1939Requestable=true, PduLength=8
        SOFT_D0_oVCAN_RADAR_9a3a9c0b_Tx: DynamicLength=false, J1939Requestable=true, PduLength=8, SysTPduToFrameMappingRef=SOFT_D0
        SR1_DIAG_REQ_PHY_OBD1_oVCAN_RADAR_8465887d_Rx: DynamicLength=false, J1939Requestable=true, PduLength=8
        SR1_DIAG_REQ_PHY_OBD1_oVCAN_RADAR_ff3ad7b0_Rx: DynamicLength=false, J1939Requestable=true, PduLength=8, SysTPduToFrameMappingRef=SR1_DIAG_REQ_PHY_OBD1
        SR1_DIAG_REQ_PHY_OBD2_oVCAN_RADAR_39afe4b3_Rx: DynamicLength=false, J1939Requestable=true, PduLength=8
        SR1_DIAG_REQ_PHY_OBD2_oVCAN_RADAR_a42d66a5_Rx: DynamicLength=false, J1939Requestable=true, PduLength=8, SysTPduToFrameMappingRef=SR1_DIAG_REQ_PHY_OBD2
        SR1_DIAG_REQ_PHY_OTA_oVCAN_RADAR_3fc015f5_Rx: DynamicLength=false, J1939Requestable=true, PduLength=8, SysTPduToFrameMappingRef=SR1_DIAG_REQ_PHY_OTA
        SR1_DIAG_REQ_PHY_OTA_oVCAN_RADAR_f59da072_Rx: DynamicLength=false, J1939Requestable=true, PduLength=8
        SR1_DIAG_REQ_PHY_PLANT_oVCAN_RADAR_14d98d55_Rx: DynamicLength=false, J1939Requestable=true, PduLength=8, SysTPduToFrameMappingRef=SR1_DIAG_REQ_PHY_PLANT
        SR1_DIAG_REQ_PHY_PLANT_oVCAN_RADAR_9b61c462_Rx: DynamicLength=false, J1939Requestable=true, PduLength=8
        SR1_DIAG_RES_PHY_OBD1_oVCAN_RADAR_6638d82d_Tx: DynamicLength=false, J1939Requestable=true, PduLength=8, MetaDataTypeRef=EcucPduCollection/CAN_ID_32, SysTPduToFrameMappingRef=SR1_DIAG_RES_PHY_OBD1
        SR1_DIAG_RES_PHY_OBD1_oVCAN_RADAR_aa3541fd_Tx: DynamicLength=false, J1939Requestable=true, PduLength=8, MetaDataTypeRef=EcucPduCollection/CAN_ID_32
        SR1_DIAG_RES_PHY_OBD2_oVCAN_RADAR_17ff2d33_Tx: DynamicLength=false, J1939Requestable=true, PduLength=8, MetaDataTypeRef=EcucPduCollection/CAN_ID_32
        SR1_DIAG_RES_PHY_OBD2_oVCAN_RADAR_3d2f6938_Tx: DynamicLength=false, J1939Requestable=true, PduLength=8, MetaDataTypeRef=EcucPduCollection/CAN_ID_32, SysTPduToFrameMappingRef=SR1_DIAG_RES_PHY_OBD2
        SR1_DIAG_RES_PHY_OTA_oVCAN_RADAR_1159a10f_Tx: DynamicLength=false, J1939Requestable=true, PduLength=8, MetaDataTypeRef=EcucPduCollection/CAN_ID_32
        SR1_DIAG_RES_PHY_OTA_oVCAN_RADAR_349e32f6_Tx: DynamicLength=false, J1939Requestable=true, PduLength=8, MetaDataTypeRef=EcucPduCollection/CAN_ID_32, SysTPduToFrameMappingRef=SR1_DIAG_RES_PHY_OTA
        SR1_DIAG_RES_PHY_PLANT_oVCAN_RADAR_76f7178b_Tx: DynamicLength=false, J1939Requestable=true, PduLength=8, MetaDataTypeRef=EcucPduCollection/CAN_ID_32
        SR1_DIAG_RES_PHY_PLANT_oVCAN_RADAR_9afe60a3_Tx: DynamicLength=false, J1939Requestable=true, PduLength=8, MetaDataTypeRef=EcucPduCollection/CAN_ID_32, SysTPduToFrameMappingRef=SR1_DIAG_RES_PHY_PLANT
        SR2_DIAG_REQ_PHY_OBD1_oVCAN_RADAR_7a08c544_Rx: DynamicLength=false, J1939Requestable=true, PduLength=8, SysTPduToFrameMappingRef=SR2_DIAG_REQ_PHY_OBD1
        SR2_DIAG_REQ_PHY_OBD1_oVCAN_RADAR_974db10e_Rx: DynamicLength=false, J1939Requestable=true, PduLength=8
        SR2_DIAG_REQ_PHY_OBD2_oVCAN_RADAR_211f7451_Rx: DynamicLength=false, J1939Requestable=true, PduLength=8, SysTPduToFrameMappingRef=SR2_DIAG_REQ_PHY_OBD2
        SR2_DIAG_REQ_PHY_OBD2_oVCAN_RADAR_2a87ddc0_Rx: DynamicLength=false, J1939Requestable=true, PduLength=8
        SR2_DIAG_REQ_PHY_OTA_oVCAN_RADAR_68e239a7_Rx: DynamicLength=false, J1939Requestable=true, PduLength=8, SysTPduToFrameMappingRef=SR2_DIAG_REQ_PHY_OTA
        SR2_DIAG_REQ_PHY_OTA_oVCAN_RADAR_b13c856a_Rx: DynamicLength=false, J1939Requestable=true, PduLength=8
        SR2_DIAG_REQ_PHY_PLANT_oVCAN_RADAR_527eccdd_Rx: DynamicLength=false, J1939Requestable=true, PduLength=8
        SR2_DIAG_REQ_PHY_PLANT_oVCAN_RADAR_ae8c8942_Rx: DynamicLength=false, J1939Requestable=true, PduLength=8, SysTPduToFrameMappingRef=SR2_DIAG_REQ_PHY_PLANT
        SR2_DIAG_RES_PHY_OBD1_oVCAN_RADAR_b91d788e_Tx: DynamicLength=false, J1939Requestable=true, PduLength=8, MetaDataTypeRef=EcucPduCollection/CAN_ID_32
        SR2_DIAG_RES_PHY_OBD1_oVCAN_RADAR_e30acad9_Tx: DynamicLength=false, J1939Requestable=true, PduLength=8, MetaDataTypeRef=EcucPduCollection/CAN_ID_32, SysTPduToFrameMappingRef=SR2_DIAG_RES_PHY_OBD1
        SR2_DIAG_RES_PHY_OBD2_oVCAN_RADAR_04d71440_Tx: DynamicLength=false, J1939Requestable=true, PduLength=8, MetaDataTypeRef=EcucPduCollection/CAN_ID_32
        SR2_DIAG_RES_PHY_OBD2_oVCAN_RADAR_b81d7bcc_Tx: DynamicLength=false, J1939Requestable=true, PduLength=8, MetaDataTypeRef=EcucPduCollection/CAN_ID_32, SysTPduToFrameMappingRef=SR2_DIAG_RES_PHY_OBD2
        SR2_DIAG_RES_PHY_OTA_oVCAN_RADAR_55f88417_Tx: DynamicLength=false, J1939Requestable=true, PduLength=8, MetaDataTypeRef=EcucPduCollection/CAN_ID_32
        SR2_DIAG_RES_PHY_OTA_oVCAN_RADAR_63bc1ea4_Tx: DynamicLength=false, J1939Requestable=true, PduLength=8, MetaDataTypeRef=EcucPduCollection/CAN_ID_32, SysTPduToFrameMappingRef=SR2_DIAG_RES_PHY_OTA
        SR2_DIAG_RES_PHY_PLANT_oVCAN_RADAR_20ab64b4_Tx: DynamicLength=false, J1939Requestable=true, PduLength=8, MetaDataTypeRef=EcucPduCollection/CAN_ID_32, SysTPduToFrameMappingRef=SR2_DIAG_RES_PHY_PLANT
        SR2_DIAG_RES_PHY_PLANT_oVCAN_RADAR_bfe81f34_Tx: DynamicLength=false, J1939Requestable=true, PduLength=8, MetaDataTypeRef=EcucPduCollection/CAN_ID_32
        SRR_FL_DIAG_REQ_PHYS_OBD1_Tx_oPCAN_RADAR_1d0fb5b4_Tx: PduLength=64, SysTPduToFrameMappingRef=SRR_FL_DIAG_REQ_PHYS_OBD1_Tx
        SRR_FL_DIAG_REQ_PHYS_OBD2_Tx_oPCAN_RADAR_79efce4a_Tx: PduLength=64, SysTPduToFrameMappingRef=SRR_FL_DIAG_REQ_PHYS_OBD2_Tx
        SRR_FL_DIAG_REQ_PHYS_OTA_Tx_oPCAN_RADAR_ebda6543_Tx: PduLength=64, SysTPduToFrameMappingRef=SRR_FL_DIAG_REQ_PHYS_OTA_Tx
        SRR_FL_DIAG_REQ_PHYS_PLANT_Tx_oPCAN_RADAR_a38832c1_Tx: PduLength=64, SysTPduToFrameMappingRef=SRR_FL_DIAG_REQ_PHYS_PLANT_Tx
        SRR_FL_DIAG_RESP_PHYS_OBD1_Rx_oPCAN_RADAR_1a7b5ebf_Rx: PduLength=64, SysTPduToFrameMappingRef=SRR_FL_DIAG_RESP_PHYS_OBD1_Rx
        SRR_FL_DIAG_RESP_PHYS_OBD2_Rx_oPCAN_RADAR_7e9b2541_Rx: PduLength=64, SysTPduToFrameMappingRef=SRR_FL_DIAG_RESP_PHYS_OBD2_Rx
        SRR_FL_DIAG_RESP_PHYS_OTA_Rx_oPCAN_RADAR_9fd7f3d9_Rx: PduLength=64, SysTPduToFrameMappingRef=SRR_FL_DIAG_RESP_PHYS_OTA_Rx
        SRR_FL_DIAG_RESP_PHYS_PLANT_Rx_oPCAN_RADAR_23870365_Rx: PduLength=64, SysTPduToFrameMappingRef=SRR_FL_DIAG_RESP_PHYS_PLANT_Rx
        SRR_RL_DIAG_REQ_PHYS_OBD1_Tx_oPCAN_RADAR_697bc1d9_Tx: PduLength=64, SysTPduToFrameMappingRef=SRR_RL_DIAG_REQ_PHYS_OBD1_Tx
        SRR_RL_DIAG_REQ_PHYS_OBD2_Tx_oPCAN_RADAR_0d9bba27_Tx: PduLength=64, SysTPduToFrameMappingRef=SRR_RL_DIAG_REQ_PHYS_OBD2_Tx
        SRR_RL_DIAG_REQ_PHYS_OTA_Tx_oPCAN_RADAR_2e7c92c0_Tx: PduLength=64, SysTPduToFrameMappingRef=SRR_RL_DIAG_REQ_PHYS_OTA_Tx
        SRR_RL_DIAG_REQ_PHYS_PLANT_Tx_oPCAN_RADAR_90ff5b50_Tx: PduLength=64, SysTPduToFrameMappingRef=SRR_RL_DIAG_REQ_PHYS_PLANT_Tx
        SRR_RL_DIAG_RESP_PHYS_OBD1_Rx_oPCAN_RADAR_290c372e_Rx: PduLength=64, SysTPduToFrameMappingRef=SRR_RL_DIAG_RESP_PHYS_OBD1_Rx
        SRR_RL_DIAG_RESP_PHYS_OBD2_Rx_oPCAN_RADAR_4dec4cd0_Rx: PduLength=64, SysTPduToFrameMappingRef=SRR_RL_DIAG_RESP_PHYS_OBD2_Rx
        SRR_RL_DIAG_RESP_PHYS_OTA_Rx_oPCAN_RADAR_eba387b4_Rx: PduLength=64, SysTPduToFrameMappingRef=SRR_RL_DIAG_RESP_PHYS_OTA_Rx
        SRR_RL_DIAG_RESP_PHYS_PLANT_Rx_oPCAN_RADAR_a4bcd7de_Rx: PduLength=64, SysTPduToFrameMappingRef=SRR_RL_DIAG_RESP_PHYS_PLANT_Rx
        SYS_NM_oPCAN_RADAR_697d71d8_Rx: DynamicLength=false, PduLength=64, SysTPduToFrameMappingRef=SYS_NM
        SYS_TIME_SYNC_Mx20_oPCAN_RADAR_7e798636_Rx: DynamicLength=false, PduLength=8, variation-point=post-build-variant-condition{matching-criterion=RDR_POS, value=0}
        SYS_TIME_SYNC_Mx28_oPCAN_RADAR_247a555b_Rx: DynamicLength=false, PduLength=8, variation-point=post-build-variant-condition{matching-criterion=RDR_POS, value=0}
        SYS_TIME_SYNC_Mx_oPCAN_RADAR_91ffd000_Rx: DynamicLength=false, PduLength=8, variation-point=post-build-variant-condition{matching-criterion=RDR_POS, value=0}
        SYS_TIME_SYNC_oPCAN_RADAR_ba7b9b28_Rx: DynamicLength=false, PduLength=8, SysTPduToFrameMappingRef=SYS_TIME_SYNC, variation-point=post-build-variant-condition{matching-criterion=RDR_POS, value=0}
        SYS_TIME_SYNC_oPCAN_RADAR_e9d0a20b_Rx: DynamicLength=false, PduLength=8, variation-point=post-build-variant-condition{matching-criterion=RDR_POS, value=0}
        SYS_VEHICLE_STATUS_oPCAN_RADAR_43e5dd0e_Rx: DynamicLength=false, PduLength=64
        SYS_VEHICLE_STATUS_oPCAN_RADAR_9bbcdf4b_Rx: DynamicLength=false, PduLength=64, SysTPduToFrameMappingRef=SYS_VEHICLE_STATUS
        TD_oVCAN_RADAR_7fe49199_Rx: DynamicLength=false, J1939Requestable=true, PduLength=8, SysTPduToFrameMappingRef=TD
        TD_oVCAN_RADAR_804fc074_Rx: DynamicLength=false, J1939Requestable=true, PduLength=8
        TPCM_SR1_oVCAN_RADAR_42f3de03_Tx: DynamicLength=false, J1939Requestable=true, PduLength=8, MetaDataTypeRef=EcucPduCollection/CAN_ID_32, SysTPduToFrameMappingRef=TPCM_SR1
        TPCM_SR1_oVCAN_RADAR_a323b0bc_Tx: DynamicLength=false, J1939Requestable=true, PduLength=8, MetaDataTypeRef=EcucPduCollection/CAN_ID_32
        TPCM_SR2_oVCAN_RADAR_19e46f16_Tx: DynamicLength=false, J1939Requestable=true, PduLength=8, MetaDataTypeRef=EcucPduCollection/CAN_ID_32, SysTPduToFrameMappingRef=TPCM_SR2
        TPCM_SR2_oVCAN_RADAR_1ee9dc72_Tx: DynamicLength=false, J1939Requestable=true, PduLength=8, MetaDataTypeRef=EcucPduCollection/CAN_ID_32
        TPCM_Tp_oVCAN_RADAR_a235016c_Tx: DynamicLength=false, PduLength=8, MetaDataTypeRef=EcucPduCollection/CAN_ID_32, SysTPduToFrameMappingRef=TPCM_Tp
        TPDT_B0_oVCAN_RADAR_bc67f1ce_Tx: DynamicLength=false, J1939Requestable=true, PduLength=8, MetaDataTypeRef=EcucPduCollection/CAN_ID_32
        TPDT_B0_oVCAN_RADAR_bde39209_Tx: DynamicLength=false, J1939Requestable=true, PduLength=8, MetaDataTypeRef=EcucPduCollection/CAN_ID_32, SysTPduToFrameMappingRef=TPDT_B0
        TPDT_B1_oVCAN_RADAR_61f1284b_Tx: DynamicLength=false, J1939Requestable=true, PduLength=8, MetaDataTypeRef=EcucPduCollection/CAN_ID_32
        TPDT_B1_oVCAN_RADAR_8b1102fa_Tx: DynamicLength=false, J1939Requestable=true, PduLength=8, MetaDataTypeRef=EcucPduCollection/CAN_ID_32, SysTPduToFrameMappingRef=TPDT_B1
        TPDT_Tp_oVCAN_RADAR_92966f54_Tx: DynamicLength=false, PduLength=8, MetaDataTypeRef=EcucPduCollection/CAN_ID_32, SysTPduToFrameMappingRef=TPDT_Tp
        VDC2_oVCAN_RADAR_5a222cac_Rx: DynamicLength=false, J1939Requestable=true, PduLength=8
        VDC2_oVCAN_RADAR_9b73b1bc_Rx: DynamicLength=false, J1939Requestable=true, PduLength=8, SysTPduToFrameMappingRef=VDC2
        VD_oVCAN_RADAR_36e033f5_Rx: DynamicLength=false, J1939Requestable=true, PduLength=8, SysTPduToFrameMappingRef=VD
        VD_oVCAN_RADAR_612104d9_Rx: DynamicLength=false, J1939Requestable=true, PduLength=8
        VI_oVCAN_RADAR_260d64a7_Rx: DynamicLength=false, J1939Requestable=true, PduLength=8
        VI_oVCAN_RADAR_b73d6113_Rx: DynamicLength=false, J1939Requestable=true, PduLength=8, SysTPduToFrameMappingRef=VI
        prop_ADAS_BSIS_info_oVCAN_RADAR_8fdff4c8_Tx: DynamicLength=false, J1939Requestable=true, PduLength=8
        prop_ADAS_BSIS_info_oVCAN_RADAR_a7fddec0_Tx: DynamicLength=false, J1939Requestable=true, PduLength=8, SysTPduToFrameMappingRef=prop_ADAS_BSIS_info
        prop_ADAS_MOIS_info_oVCAN_RADAR_21657ab6_Tx: DynamicLength=false, J1939Requestable=true, PduLength=8, SysTPduToFrameMappingRef=prop_ADAS_MOIS_info
        prop_ADAS_MOIS_info_oVCAN_RADAR_f03aed28_Tx: DynamicLength=false, J1939Requestable=true, PduLength=8
        signalPdu_ADAS_Vehicle_Status_638dcd82_Rx: DynamicLength=false, PduLength=79
        signalPdu_ADAS_Vehicle_Status_71b7c213_Rx: DynamicLength=false, PduLength=79
        signalPdu_RDR_1_Detections_52b391ee_Tx: DynamicLength=false, PduLength=38632
        signalPdu_RDR_1_Detections_Transport_d322aa23_Tx: DynamicLength=true, PduLength=1404
        signalPdu_RDR_1_SW_Info_14232baa_Tx: DynamicLength=false, PduLength=90
        signalPdu_RDR_1_SW_Info_b4e751e3_Tx: DynamicLength=false, PduLength=90
        signalPdu_RDR_1_Status_67c6fd21_Tx: DynamicLength=false, PduLength=269
        signalPdu_RDR_1_Status_9d482741_Tx: DynamicLength=false, PduLength=269
        SYS_TIME_SYNC_Mx20_oPCAN_RADAR_7e798636_Tx: DynamicLength=false, PduLength=8, variation-point=post-build-variant-condition{matching-criterion=RDR_POS, value=4}
        SYS_TIME_SYNC_Mx28_oPCAN_RADAR_247a555b_Tx: DynamicLength=false, PduLength=8, variation-point=post-build-variant-condition{matching-criterion=RDR_POS, value=4}
        SYS_TIME_SYNC_Mx_oPCAN_RADAR_91ffd000_Tx: DynamicLength=false, PduLength=8, variation-point=post-build-variant-condition{matching-criterion=RDR_POS, value=4}
        SYS_TIME_SYNC_oPCAN_RADAR_ba7b9b28_Tx: DynamicLength=false, PduLength=8, SysTPduToFrameMappingRef=SYS_TIME_SYNC, variation-point=post-build-variant-condition{matching-criterion=RDR_POS, value=4}
        SYS_TIME_SYNC_oPCAN_RADAR_e9d0a20b_Tx: DynamicLength=false, PduLength=8, variation-point=post-build-variant-condition{matching-criterion=RDR_POS, value=4}
        SYS_TIME_SYNC_Mx20_oPCAN_RADAR_7e798636_Rx: DynamicLength=false, PduLength=8, variation-point=post-build-variant-condition{matching-criterion=RDR_POS, value={1..3}}
        SYS_TIME_SYNC_Mx28_oPCAN_RADAR_247a555b_Rx: DynamicLength=false, PduLength=8, variation-point=post-build-variant-condition{matching-criterion=RDR_POS, value={1..3}}
        SYS_TIME_SYNC_Mx_oPCAN_RADAR_91ffd000_Rx: DynamicLength=false, PduLength=8, variation-point=post-build-variant-condition{matching-criterion=RDR_POS, value={1..3}}
        SYS_TIME_SYNC_oPCAN_RADAR_ba7b9b28_Rx: DynamicLength=false, PduLength=8, SysTPduToFrameMappingRef=SYS_TIME_SYNC, variation-point=post-build-variant-condition{matching-criterion=RDR_POS, value={1..3}}
        SYS_TIME_SYNC_oPCAN_RADAR_e9d0a20b_Rx: DynamicLength=false, PduLength=8, variation-point=post-build-variant-condition{matching-criterion=RDR_POS, value={1..3}}
        SYS_TIME_SYNC_Mx20_oPCAN_RADAR_7e798636_Rx: DynamicLength=false, PduLength=8, variation-point=post-build-variant-condition{matching-criterion=RDR_POS, value=5}
        SYS_TIME_SYNC_Mx28_oPCAN_RADAR_247a555b_Rx: DynamicLength=false, PduLength=8, variation-point=post-build-variant-condition{matching-criterion=RDR_POS, value=5}
        SYS_TIME_SYNC_Mx_oPCAN_RADAR_91ffd000_Rx: DynamicLength=false, PduLength=8, variation-point=post-build-variant-condition{matching-criterion=RDR_POS, value=5}
        SYS_TIME_SYNC_oPCAN_RADAR_ba7b9b28_Rx: DynamicLength=false, PduLength=8, SysTPduToFrameMappingRef=SYS_TIME_SYNC, variation-point=post-build-variant-condition{matching-criterion=RDR_POS, value=5}
        SYS_TIME_SYNC_oPCAN_RADAR_e9d0a20b_Rx: DynamicLength=false, PduLength=8, variation-point=post-build-variant-condition{matching-criterion=RDR_POS, value=5}
        SYS_TIME_SYNC_Mx20_oPCAN_RADAR_7e798636_Rx: DynamicLength=false, PduLength=8, variation-point=post-build-variant-condition{matching-criterion=RDR_POS, value=6}
        SYS_TIME_SYNC_Mx28_oPCAN_RADAR_247a555b_Rx: DynamicLength=false, PduLength=8, variation-point=post-build-variant-condition{matching-criterion=RDR_POS, value=6}
        SYS_TIME_SYNC_Mx_oPCAN_RADAR_91ffd000_Rx: DynamicLength=false, PduLength=8, variation-point=post-build-variant-condition{matching-criterion=RDR_POS, value=6}
        SYS_TIME_SYNC_oPCAN_RADAR_ba7b9b28_Rx: DynamicLength=false, PduLength=8, SysTPduToFrameMappingRef=SYS_TIME_SYNC, variation-point=post-build-variant-condition{matching-criterion=RDR_POS, value=6}
        SYS_TIME_SYNC_oPCAN_RADAR_e9d0a20b_Rx: DynamicLength=false, PduLength=8, variation-point=post-build-variant-condition{matching-criterion=RDR_POS, value=6}
        SYS_TIME_SYNC_Mx20_oPCAN_RADAR_7e798636_Rx: DynamicLength=false, PduLength=8, variation-point=post-build-variant-condition{matching-criterion=RDR_POS, value=7}
        SYS_TIME_SYNC_Mx28_oPCAN_RADAR_247a555b_Rx: DynamicLength=false, PduLength=8, variation-point=post-build-variant-condition{matching-criterion=RDR_POS, value=7}
        SYS_TIME_SYNC_Mx_oPCAN_RADAR_91ffd000_Rx: DynamicLength=false, PduLength=8, variation-point=post-build-variant-condition{matching-criterion=RDR_POS, value=7}
        SYS_TIME_SYNC_oPCAN_RADAR_ba7b9b28_Rx: DynamicLength=false, PduLength=8, SysTPduToFrameMappingRef=SYS_TIME_SYNC, variation-point=post-build-variant-condition{matching-criterion=RDR_POS, value=7}
        SYS_TIME_SYNC_oPCAN_RADAR_e9d0a20b_Rx: DynamicLength=false, PduLength=8, variation-point=post-build-variant-condition{matching-criterion=RDR_POS, value=7}
  module config EcuM
    EcuMConfiguration
      EcuMCommonConfiguration
        EcuMDriverInitListOne
        EcuMDriverRestartList
        3 x EcuMWakeupSource:
          CN_PCAN_RADAR_458ff0f1: EcuMWakeupSourceId=5, EcuMComMChannelRef=ComMConfigSet/CN_PCAN_RADAR_458ff0f1
          CN_VCAN_RADAR_489180b6: EcuMWakeupSourceId=6, EcuMComMChannelRef=ComMConfigSet/CN_VCAN_RADAR_489180b6
          cnctr_RDR_RdrNet_5172a59b: EcuMWakeupSourceId=7, EcuMComMChannelRef=ComMConfigSet/cnctr_RDR_RdrNet_5172a59b
      EcuMFlexConfiguration: EcuMFlexModuleConfigurationRef=CanConfigSet
  module config Eth
    EthConfigSet
      RDR_1_Eth_Controller_1_6addc1bb (EthCtrlConfig): EthCtrlIdx=0, EthCtrlPhysAddr=00:1A:A0:22:0E:B0  # EthernetCluster1
    EthGeneral
  module config EthIf
    EthIfConfigSet
      cnctr_RDR_RdrNet_5172a59b (EthIfController): EthIfCtrlIdx=0, EthIfCtrlMtu=1500, EthIfEnableVLAN=false, EthIfPhysControllerRef=RDR_1_Eth_Controller_1_6addc1bb
    EthIfGeneral
  module config EthSM
    EthSMGeneral
    cnctr_RDR_RdrNet_5172a59b (EthSMNetwork): EthSMComMNetworkHandleRef=ComMConfigSet/cnctr_RDR_RdrNet_5172a59b, EthSMEthIfControllerRef=EthIfConfigSet/cnctr_RDR_RdrNet_5172a59b
  module config IpduM
    IpduMConfig
      SYS_TIME_SYNC_oPCAN_RADAR_e9d0a20b_Rx (IpduMRxPathway): variation-point=post-build-variant-condition{matching-criterion=RDR_POS, value=0}
        IpduMRxIndication_e606cb8f (IpduMRxIndication): IpduMByteOrder=BIG_ENDIAN, IpduMRxIndicationPduRef=EcucPduCollection/SYS_TIME_SYNC_oPCAN_RADAR_e9d0a20b_Rx
          SYS_TIME_SYNC_oPCAN_RADAR_ba4622ba (IpduMRxDynamicPart): IpduMRxSelectorValue=40, IpduMOutgoingDynamicPduRef=EcucPduCollection/SYS_TIME_SYNC_Mx28_oPCAN_RADAR_247a555b_Rx
            IpduMSegment_31 (IpduMSegment): IpduMSegmentLength=40, IpduMSegmentPosition=31
            IpduMSegment_7 (IpduMSegment): IpduMSegmentLength=8, IpduMSegmentPosition=7
          SYS_TIME_SYNC_oPCAN_RADAR_e045f1d7 (IpduMRxDynamicPart): IpduMRxSelectorValue=32, IpduMOutgoingDynamicPduRef=EcucPduCollection/SYS_TIME_SYNC_Mx20_oPCAN_RADAR_7e798636_Rx
            IpduMSegment_31 (IpduMSegment): IpduMSegmentLength=40, IpduMSegmentPosition=31
            IpduMSegment_7 (IpduMSegment): IpduMSegmentLength=8, IpduMSegmentPosition=7
          IpduMRxStaticPart: IpduMOutgoingStaticPduRef=EcucPduCollection/SYS_TIME_SYNC_Mx_oPCAN_RADAR_91ffd000_Rx
            IpduMSegment_15 (IpduMSegment): IpduMSegmentLength=16, IpduMSegmentPosition=15
          IpduMSelectorFieldPosition: IpduMSelectorFieldLength=8, IpduMSelectorFieldPosition=7
      SYS_TIME_SYNC_oPCAN_RADAR_e9d0a20b_Tx (IpduMTxPathway): variation-point=post-build-variant-condition{matching-criterion=RDR_POS, value=4}
        IpduMTxRequest_b05c6c09 (IpduMTxRequest):
          IpduMByteOrder = BIG_ENDIAN
          IpduMIPduUnusedAreasDefault = 0
          IpduMInitialDynamicPart = IpduMTxRequest_b05c6c09/SYS_TIME_SYNC_oPCAN_RADAR_e045f1d7
          IpduMOutgoingPduRef = EcucPduCollection/SYS_TIME_SYNC_oPCAN_RADAR_e9d0a20b_Tx
          IpduMSelectorFieldPosition: IpduMSelectorFieldLength=8, IpduMSelectorFieldPosition=7
          SYS_TIME_SYNC_oPCAN_RADAR_ba4622ba (IpduMTxDynamicPart): IpduMTxDynamicPduRef=EcucPduCollection/SYS_TIME_SYNC_Mx28_oPCAN_RADAR_247a555b_Tx
            IpduMSegment_31 (IpduMSegment): IpduMSegmentLength=40, IpduMSegmentPosition=31
            IpduMSegment_7 (IpduMSegment): IpduMSegmentLength=8, IpduMSegmentPosition=7
          SYS_TIME_SYNC_oPCAN_RADAR_e045f1d7 (IpduMTxDynamicPart): IpduMTxDynamicPduRef=EcucPduCollection/SYS_TIME_SYNC_Mx20_oPCAN_RADAR_7e798636_Tx
            IpduMSegment_31 (IpduMSegment): IpduMSegmentLength=40, IpduMSegmentPosition=31
            IpduMSegment_7 (IpduMSegment): IpduMSegmentLength=8, IpduMSegmentPosition=7
          SYS_TIME_SYNC_oPCAN_RADAR_1bf1c63d (IpduMTxStaticPart): IpduMTxStaticPduRef=EcucPduCollection/SYS_TIME_SYNC_Mx_oPCAN_RADAR_91ffd000_Tx
            IpduMSegment_15 (IpduMSegment): IpduMSegmentLength=16, IpduMSegmentPosition=15
      6 x IpduMRxPathway:
        SYS_TIME_SYNC_oPCAN_RADAR_e9d0a20b_Rx: variation-point=post-build-variant-condition{matching-criterion=RDR_POS, value=1}
          IpduMRxIndication_e606cb8f (IpduMRxIndication): IpduMByteOrder=BIG_ENDIAN, IpduMRxIndicationPduRef=EcucPduCollection/SYS_TIME_SYNC_oPCAN_RADAR_e9d0a20b_Rx
            SYS_TIME_SYNC_oPCAN_RADAR_ba4622ba (IpduMRxDynamicPart): IpduMRxSelectorValue=40, IpduMOutgoingDynamicPduRef=EcucPduCollection/SYS_TIME_SYNC_Mx28_oPCAN_RADAR_247a555b_Rx
              IpduMSegment_31 (IpduMSegment): IpduMSegmentLength=40, IpduMSegmentPosition=31
              IpduMSegment_7 (IpduMSegment): IpduMSegmentLength=8, IpduMSegmentPosition=7
            SYS_TIME_SYNC_oPCAN_RADAR_e045f1d7 (IpduMRxDynamicPart): IpduMRxSelectorValue=32, IpduMOutgoingDynamicPduRef=EcucPduCollection/SYS_TIME_SYNC_Mx20_oPCAN_RADAR_7e798636_Rx
              IpduMSegment_31 (IpduMSegment): IpduMSegmentLength=40, IpduMSegmentPosition=31
              IpduMSegment_7 (IpduMSegment): IpduMSegmentLength=8, IpduMSegmentPosition=7
            IpduMRxStaticPart: IpduMOutgoingStaticPduRef=EcucPduCollection/SYS_TIME_SYNC_Mx_oPCAN_RADAR_91ffd000_Rx
              IpduMSegment_15 (IpduMSegment): IpduMSegmentLength=16, IpduMSegmentPosition=15
            IpduMSelectorFieldPosition: IpduMSelectorFieldLength=8, IpduMSelectorFieldPosition=7
        SYS_TIME_SYNC_oPCAN_RADAR_e9d0a20b_Rx: variation-point=post-build-variant-condition{matching-criterion=RDR_POS, value=2}
          IpduMRxIndication_e606cb8f (IpduMRxIndication): IpduMByteOrder=BIG_ENDIAN, IpduMRxIndicationPduRef=EcucPduCollection/SYS_TIME_SYNC_oPCAN_RADAR_e9d0a20b_Rx
            SYS_TIME_SYNC_oPCAN_RADAR_ba4622ba (IpduMRxDynamicPart): IpduMRxSelectorValue=40, IpduMOutgoingDynamicPduRef=EcucPduCollection/SYS_TIME_SYNC_Mx28_oPCAN_RADAR_247a555b_Rx
              IpduMSegment_31 (IpduMSegment): IpduMSegmentLength=40, IpduMSegmentPosition=31
              IpduMSegment_7 (IpduMSegment): IpduMSegmentLength=8, IpduMSegmentPosition=7
            SYS_TIME_SYNC_oPCAN_RADAR_e045f1d7 (IpduMRxDynamicPart): IpduMRxSelectorValue=32, IpduMOutgoingDynamicPduRef=EcucPduCollection/SYS_TIME_SYNC_Mx20_oPCAN_RADAR_7e798636_Rx
              IpduMSegment_31 (IpduMSegment): IpduMSegmentLength=40, IpduMSegmentPosition=31
              IpduMSegment_7 (IpduMSegment): IpduMSegmentLength=8, IpduMSegmentPosition=7
            IpduMRxStaticPart: IpduMOutgoingStaticPduRef=EcucPduCollection/SYS_TIME_SYNC_Mx_oPCAN_RADAR_91ffd000_Rx
              IpduMSegment_15 (IpduMSegment): IpduMSegmentLength=16, IpduMSegmentPosition=15
            IpduMSelectorFieldPosition: IpduMSelectorFieldLength=8, IpduMSelectorFieldPosition=7
        SYS_TIME_SYNC_oPCAN_RADAR_e9d0a20b_Rx: variation-point=post-build-variant-condition{matching-criterion=RDR_POS, value=3}
          IpduMRxIndication_e606cb8f (IpduMRxIndication): IpduMByteOrder=BIG_ENDIAN, IpduMRxIndicationPduRef=EcucPduCollection/SYS_TIME_SYNC_oPCAN_RADAR_e9d0a20b_Rx
            SYS_TIME_SYNC_oPCAN_RADAR_ba4622ba (IpduMRxDynamicPart): IpduMRxSelectorValue=40, IpduMOutgoingDynamicPduRef=EcucPduCollection/SYS_TIME_SYNC_Mx28_oPCAN_RADAR_247a555b_Rx
              IpduMSegment_31 (IpduMSegment): IpduMSegmentLength=40, IpduMSegmentPosition=31
              IpduMSegment_7 (IpduMSegment): IpduMSegmentLength=8, IpduMSegmentPosition=7
            SYS_TIME_SYNC_oPCAN_RADAR_e045f1d7 (IpduMRxDynamicPart): IpduMRxSelectorValue=32, IpduMOutgoingDynamicPduRef=EcucPduCollection/SYS_TIME_SYNC_Mx20_oPCAN_RADAR_7e798636_Rx
              IpduMSegment_31 (IpduMSegment): IpduMSegmentLength=40, IpduMSegmentPosition=31
              IpduMSegment_7 (IpduMSegment): IpduMSegmentLength=8, IpduMSegmentPosition=7
            IpduMRxStaticPart: IpduMOutgoingStaticPduRef=EcucPduCollection/SYS_TIME_SYNC_Mx_oPCAN_RADAR_91ffd000_Rx
              IpduMSegment_15 (IpduMSegment): IpduMSegmentLength=16, IpduMSegmentPosition=15
            IpduMSelectorFieldPosition: IpduMSelectorFieldLength=8, IpduMSelectorFieldPosition=7
        SYS_TIME_SYNC_oPCAN_RADAR_e9d0a20b_Rx: variation-point=post-build-variant-condition{matching-criterion=RDR_POS, value=5}
          IpduMRxIndication_e606cb8f (IpduMRxIndication): IpduMByteOrder=BIG_ENDIAN, IpduMRxIndicationPduRef=EcucPduCollection/SYS_TIME_SYNC_oPCAN_RADAR_e9d0a20b_Rx
            SYS_TIME_SYNC_oPCAN_RADAR_ba4622ba (IpduMRxDynamicPart): IpduMRxSelectorValue=40, IpduMOutgoingDynamicPduRef=EcucPduCollection/SYS_TIME_SYNC_Mx28_oPCAN_RADAR_247a555b_Rx
              IpduMSegment_31 (IpduMSegment): IpduMSegmentLength=40, IpduMSegmentPosition=31
              IpduMSegment_7 (IpduMSegment): IpduMSegmentLength=8, IpduMSegmentPosition=7
            SYS_TIME_SYNC_oPCAN_RADAR_e045f1d7 (IpduMRxDynamicPart): IpduMRxSelectorValue=32, IpduMOutgoingDynamicPduRef=EcucPduCollection/SYS_TIME_SYNC_Mx20_oPCAN_RADAR_7e798636_Rx
              IpduMSegment_31 (IpduMSegment): IpduMSegmentLength=40, IpduMSegmentPosition=31
              IpduMSegment_7 (IpduMSegment): IpduMSegmentLength=8, IpduMSegmentPosition=7
            IpduMRxStaticPart: IpduMOutgoingStaticPduRef=EcucPduCollection/SYS_TIME_SYNC_Mx_oPCAN_RADAR_91ffd000_Rx
              IpduMSegment_15 (IpduMSegment): IpduMSegmentLength=16, IpduMSegmentPosition=15
            IpduMSelectorFieldPosition: IpduMSelectorFieldLength=8, IpduMSelectorFieldPosition=7
        SYS_TIME_SYNC_oPCAN_RADAR_e9d0a20b_Rx: variation-point=post-build-variant-condition{matching-criterion=RDR_POS, value=6}
          IpduMRxIndication_e606cb8f (IpduMRxIndication): IpduMByteOrder=BIG_ENDIAN, IpduMRxIndicationPduRef=EcucPduCollection/SYS_TIME_SYNC_oPCAN_RADAR_e9d0a20b_Rx
            SYS_TIME_SYNC_oPCAN_RADAR_ba4622ba (IpduMRxDynamicPart): IpduMRxSelectorValue=40, IpduMOutgoingDynamicPduRef=EcucPduCollection/SYS_TIME_SYNC_Mx28_oPCAN_RADAR_247a555b_Rx
              IpduMSegment_31 (IpduMSegment): IpduMSegmentLength=40, IpduMSegmentPosition=31
              IpduMSegment_7 (IpduMSegment): IpduMSegmentLength=8, IpduMSegmentPosition=7
            SYS_TIME_SYNC_oPCAN_RADAR_e045f1d7 (IpduMRxDynamicPart): IpduMRxSelectorValue=32, IpduMOutgoingDynamicPduRef=EcucPduCollection/SYS_TIME_SYNC_Mx20_oPCAN_RADAR_7e798636_Rx
              IpduMSegment_31 (IpduMSegment): IpduMSegmentLength=40, IpduMSegmentPosition=31
              IpduMSegment_7 (IpduMSegment): IpduMSegmentLength=8, IpduMSegmentPosition=7
            IpduMRxStaticPart: IpduMOutgoingStaticPduRef=EcucPduCollection/SYS_TIME_SYNC_Mx_oPCAN_RADAR_91ffd000_Rx
              IpduMSegment_15 (IpduMSegment): IpduMSegmentLength=16, IpduMSegmentPosition=15
            IpduMSelectorFieldPosition: IpduMSelectorFieldLength=8, IpduMSelectorFieldPosition=7
        SYS_TIME_SYNC_oPCAN_RADAR_e9d0a20b_Rx: variation-point=post-build-variant-condition{matching-criterion=RDR_POS, value=7}
          IpduMRxIndication_e606cb8f (IpduMRxIndication): IpduMByteOrder=BIG_ENDIAN, IpduMRxIndicationPduRef=EcucPduCollection/SYS_TIME_SYNC_oPCAN_RADAR_e9d0a20b_Rx
            SYS_TIME_SYNC_oPCAN_RADAR_ba4622ba (IpduMRxDynamicPart): IpduMRxSelectorValue=40, IpduMOutgoingDynamicPduRef=EcucPduCollection/SYS_TIME_SYNC_Mx28_oPCAN_RADAR_247a555b_Rx
              IpduMSegment_31 (IpduMSegment): IpduMSegmentLength=40, IpduMSegmentPosition=31
              IpduMSegment_7 (IpduMSegment): IpduMSegmentLength=8, IpduMSegmentPosition=7
            SYS_TIME_SYNC_oPCAN_RADAR_e045f1d7 (IpduMRxDynamicPart): IpduMRxSelectorValue=32, IpduMOutgoingDynamicPduRef=EcucPduCollection/SYS_TIME_SYNC_Mx20_oPCAN_RADAR_7e798636_Rx
              IpduMSegment_31 (IpduMSegment): IpduMSegmentLength=40, IpduMSegmentPosition=31
              IpduMSegment_7 (IpduMSegment): IpduMSegmentLength=8, IpduMSegmentPosition=7
            IpduMRxStaticPart: IpduMOutgoingStaticPduRef=EcucPduCollection/SYS_TIME_SYNC_Mx_oPCAN_RADAR_91ffd000_Rx
              IpduMSegment_15 (IpduMSegment): IpduMSegmentLength=16, IpduMSegmentPosition=15
            IpduMSelectorFieldPosition: IpduMSelectorFieldLength=8, IpduMSelectorFieldPosition=7
    IpduMGeneral: IpduMStaticPartExists=true
  module config J1939Nm
    J1939NmConfigSet
      VCAN_RADAR_J1939_0bcb74f6 (J1939NmChannel): J1939NmComMNetworkHandleRef=ComMConfigSet/CN_VCAN_RADAR_489180b6
        J1939NmRxPdu_ad6d2a99 (J1939NmRxPdu)
        J1939NmTxPdu_ad6d2a99 (J1939NmTxPdu)
    J1939NmGeneral
  module config J1939Rm
    J1939RmConfigSet
      VCAN_RADAR_J1939_0bcb74f6 (J1939RmChannel): J1939RmComMNetworkHandleRef=ComMConfigSet/CN_VCAN_RADAR_489180b6
    J1939RmGeneral
  module config J1939Tp
    J1939TpConfiguration
      8 x J1939TpTxChannel, all with J1939TpTxChannelUsesMultiPG=false, J1939TpTxPriority=6, J1939TpTxSa=208, J1939TpTxUseNonDefaultTpPriority=true, J1939TpTxChannelComMNetworkHandleRef=ComMConfigSet/CN_VCAN_RADAR_489180b6:
        VCAN_RADAR_J1939_3cea4416: variation-point=post-build-variant-condition{matching-criterion=RDR_POS, value=0}
          J1939TpTxCmNPdu_2210d016 (J1939TpTxCmNPdu): J1939TpTxCmNPduRef=TPCM_Tp_oVCAN_RADAR_a235016c_Tx
          J1939TpTxDtNPdu_2210d016 (J1939TpTxDtNPdu): J1939TpTxDtNPduRef=TPDT_Tp_oVCAN_RADAR_92966f54_Tx
          DM1_D0_oVCAN_RADAR_51899be1 (J1939TpTxPg): J1939TpTxDirectPriority=6, J1939TpTxPgDynLength=true, J1939TpTxPgPGN=65226
            DM1_D0_oVCAN_RADAR_ce78d82a_Tx (J1939TpTxNSdu): J1939TpTxNSduRef=EcucPduCollection/DM1_D0_oVCAN_RADAR_ce78d82a_Tx
        VCAN_RADAR_J1939_0907f245: variation-point=post-build-variant-condition{matching-criterion=RDR_POS, value=1}
          J1939TpTxCmNPdu_41dddc47 (J1939TpTxCmNPdu): J1939TpTxCmNPduRef=TPCM_Tp_oVCAN_RADAR_a235016c_Tx
          J1939TpTxDtNPdu_41dddc47 (J1939TpTxDtNPdu): J1939TpTxDtNPduRef=TPDT_Tp_oVCAN_RADAR_92966f54_Tx
          DM1_D0_oVCAN_RADAR_51899be1 (J1939TpTxPg): J1939TpTxDirectPriority=6, J1939TpTxPgDynLength=true, J1939TpTxPgPGN=65226
            DM1_D0_oVCAN_RADAR_ce78d82a_Tx (J1939TpTxNSdu): J1939TpTxNSduRef=EcucPduCollection/DM1_D0_oVCAN_RADAR_ce78d82a_Tx
        VCAN_RADAR_J1939_ac8c624b: variation-point=post-build-variant-condition{matching-criterion=RDR_POS, value=2}
          J1939TpTxCmNPdu_4036b975 (J1939TpTxCmNPdu): J1939TpTxCmNPduRef=TPCM_Tp_oVCAN_RADAR_a235016c_Tx
          J1939TpTxDtNPdu_4036b975 (J1939TpTxDtNPdu): J1939TpTxDtNPduRef=TPDT_Tp_oVCAN_RADAR_92966f54_Tx
          DM1_D0_oVCAN_RADAR_51899be1 (J1939TpTxPg): J1939TpTxDirectPriority=6, J1939TpTxPgDynLength=true, J1939TpTxPgPGN=65226
            DM1_D0_oVCAN_RADAR_ce78d82a_Tx (J1939TpTxNSdu): J1939TpTxNSduRef=EcucPduCollection/DM1_D0_oVCAN_RADAR_ce78d82a_Tx
        VCAN_RADAR_J1939_62dc9ee3: variation-point=post-build-variant-condition{matching-criterion=RDR_POS, value=3}
          J1939TpTxCmNPdu_6f674c31 (J1939TpTxCmNPdu): J1939TpTxCmNPduRef=TPCM_Tp_oVCAN_RADAR_a235016c_Tx
          J1939TpTxDtNPdu_6f674c31 (J1939TpTxDtNPdu): J1939TpTxDtNPduRef=TPDT_Tp_oVCAN_RADAR_92966f54_Tx
          DM1_D0_oVCAN_RADAR_51899be1 (J1939TpTxPg): J1939TpTxDirectPriority=6, J1939TpTxPgDynLength=true, J1939TpTxPgPGN=65226
            DM1_D0_oVCAN_RADAR_ce78d82a_Tx (J1939TpTxNSdu): J1939TpTxNSduRef=EcucPduCollection/DM1_D0_oVCAN_RADAR_ce78d82a_Tx
        VCAN_RADAR_J1939_c7570eed: variation-point=post-build-variant-condition{matching-criterion=RDR_POS, value=4}
          J1939TpTxCmNPdu_a2dfa7b0 (J1939TpTxCmNPdu): J1939TpTxCmNPduRef=TPCM_Tp_oVCAN_RADAR_a235016c_Tx
          J1939TpTxDtNPdu_a2dfa7b0 (J1939TpTxDtNPdu): J1939TpTxDtNPduRef=TPDT_Tp_oVCAN_RADAR_92966f54_Tx
          DM1_D0_oVCAN_RADAR_51899be1 (J1939TpTxPg): J1939TpTxDirectPriority=6, J1939TpTxPgDynLength=true, J1939TpTxPgPGN=65226
            DM1_D0_oVCAN_RADAR_ce78d82a_Tx (J1939TpTxNSdu): J1939TpTxNSduRef=EcucPduCollection/DM1_D0_oVCAN_RADAR_ce78d82a_Tx
        VCAN_RADAR_J1939_f2bab8be: variation-point=post-build-variant-condition{matching-criterion=RDR_POS, value=5}
          J1939TpTxCmNPdu_23f958cc (J1939TpTxCmNPdu): J1939TpTxCmNPduRef=TPCM_Tp_oVCAN_RADAR_a235016c_Tx
          J1939TpTxDtNPdu_23f958cc (J1939TpTxDtNPdu): J1939TpTxDtNPduRef=TPDT_Tp_oVCAN_RADAR_92966f54_Tx
          DM1_D0_oVCAN_RADAR_51899be1 (J1939TpTxPg): J1939TpTxDirectPriority=6, J1939TpTxPgDynLength=true, J1939TpTxPgPGN=65226
            DM1_D0_oVCAN_RADAR_ce78d82a_Tx (J1939TpTxNSdu): J1939TpTxNSduRef=EcucPduCollection/DM1_D0_oVCAN_RADAR_ce78d82a_Tx
        VCAN_RADAR_J1939_573128b0: variation-point=post-build-variant-condition{matching-criterion=RDR_POS, value=6}
          J1939TpTxCmNPdu_85a53d0e (J1939TpTxCmNPdu): J1939TpTxCmNPduRef=TPCM_Tp_oVCAN_RADAR_a235016c_Tx
          J1939TpTxDtNPdu_85a53d0e (J1939TpTxDtNPdu): J1939TpTxDtNPduRef=TPDT_Tp_oVCAN_RADAR_92966f54_Tx
          DM1_D0_oVCAN_RADAR_51899be1 (J1939TpTxPg): J1939TpTxDirectPriority=6, J1939TpTxPgDynLength=true, J1939TpTxPgPGN=65226
            DM1_D0_oVCAN_RADAR_ce78d82a_Tx (J1939TpTxNSdu): J1939TpTxNSduRef=EcucPduCollection/DM1_D0_oVCAN_RADAR_ce78d82a_Tx
        VCAN_RADAR_J1939_b56a47af: variation-point=post-build-variant-condition{matching-criterion=RDR_POS, value=7}
          J1939TpTxCmNPdu_a2153763 (J1939TpTxCmNPdu): J1939TpTxCmNPduRef=TPCM_Tp_oVCAN_RADAR_a235016c_Tx
          J1939TpTxDtNPdu_a2153763 (J1939TpTxDtNPdu): J1939TpTxDtNPduRef=TPDT_Tp_oVCAN_RADAR_92966f54_Tx
          DM1_D0_oVCAN_RADAR_51899be1 (J1939TpTxPg): J1939TpTxDirectPriority=6, J1939TpTxPgDynLength=true, J1939TpTxPgPGN=65226
            DM1_D0_oVCAN_RADAR_ce78d82a_Tx (J1939TpTxNSdu): J1939TpTxNSduRef=EcucPduCollection/DM1_D0_oVCAN_RADAR_ce78d82a_Tx
    J1939TpGeneral
  module config LdCom
    LdComConfig
      4 x LdComIPdu, all with LdComSystemTemplateSignalRef=Mapping1:
        signalPdu_ADAS_Vehicle_Status_638dcd82_Rx: LdComApiType=LDCOM_IF, LdComIPduDirection=LDCOM_RECEIVE, LdComPduRef=EcucPduCollection/signalPdu_ADAS_Vehicle_Status_638dcd82_Rx
        signalPdu_RDR_1_Detections_52b391ee_Tx: LdComApiType=LDCOM_TP, LdComIPduDirection=LDCOM_SEND, LdComPduRef=EcucPduCollection/signalPdu_RDR_1_Detections_52b391ee_Tx
        signalPdu_RDR_1_SW_Info_b4e751e3_Tx: LdComApiType=LDCOM_IF, LdComIPduDirection=LDCOM_SEND, LdComPduRef=EcucPduCollection/signalPdu_RDR_1_SW_Info_b4e751e3_Tx
        signalPdu_RDR_1_Status_9d482741_Tx: LdComApiType=LDCOM_IF, LdComIPduDirection=LDCOM_SEND, LdComPduRef=EcucPduCollection/signalPdu_RDR_1_Status_9d482741_Tx
    LdComGeneral
  module config Nm
    CN_VCAN_RADAR_489180b6 (NmChannelConfig): NmComMChannelRef=ComMConfigSet/CN_VCAN_RADAR_489180b6
      VCAN_RADAR_J1939_0bcb74f6 (NmBusType)
        NmStandardBusNmConfig: NmStandardBusType=NM_BUSNM_J1939NM  # VCAN_RADAR_J1939
    NmGlobalConfig
      NmGlobalFeatures: NmNodeIdEnabled=true
      NmGlobalProperties
