[part 5 of 24: package /InitialEcuC]
AUTOSAR XML (schema 00053)
package /InitialEcuC  (continued)
  module config Com  (continued)
    ComConfig  (continued)
      246 x ComIPdu, all with ComIPduType=NORMAL:  (continued)
        RDR_TRACKER_OBJ_016_oPCAN_RADAR_cefb1c78_Tx: ComIPduDirection=SEND, ComIPduChannelRef=ComMConfigSet/CN_PCAN_RADAR_458ff0f1, ComIPduGroupRef=RDR01_oPCAN_RADAR_Tx_b6bdb067 if post-build-variant-condition{matching-criterion=RDR_POS, value=0}, ComIPduSignalGroupRef=SG_TrackerObject016_oRDR_TRACKER_OBJ_016_oPCAN_RADAR_75d339f9_Tx, ComPduIdRef=EcucPduCollection/RDR_TRACKER_OBJ_016_oPCAN_RADAR_cefb1c78_Tx, ComIPduGroupRef=RDR02_oPCAN_RADAR_Tx_9f750495 if post-build-variant-condition{matching-criterion=RDR_POS, value=1}, ComIPduGroupRef=RDR03_oPCAN_RADAR_Tx_311d9504 if post-build-variant-condition{matching-criterion=RDR_POS, value=2}, ComIPduGroupRef=RDR04_oPCAN_RADAR_Tx_cce46d71 if post-build-variant-condition{matching-criterion=RDR_POS, value=3}, ComIPduGroupRef=RDR05_oPCAN_RADAR_Tx_628cfce0 if post-build-variant-condition{matching-criterion=RDR_POS, value=4}, ComIPduGroupRef=RDR06_oPCAN_RADAR_Tx_4b444812 if post-build-variant-condition{matching-criterion=RDR_POS, value=5}, ComIPduGroupRef=RDR07_oPCAN_RADAR_Tx_e52cd983 if post-build-variant-condition{matching-criterion=RDR_POS, value=6}, ComIPduGroupRef=RDR08_oPCAN_RADAR_Tx_6bc6beb9 if post-build-variant-condition{matching-criterion=RDR_POS, value=7}
          ComTxIPdu: ComMinimumDelayTime=0, ComTxIPduUnusedAreasDefault=0
        RDR_TRACKER_OBJ_017_oPCAN_RADAR_136dc5fd_Tx: ComIPduDirection=SEND, ComIPduChannelRef=ComMConfigSet/CN_PCAN_RADAR_458ff0f1, ComIPduGroupRef=RDR01_oPCAN_RADAR_Tx_b6bdb067 if post-build-variant-condition{matching-criterion=RDR_POS, value=0}, ComIPduSignalGroupRef=SG_TrackerObject017_oRDR_TRACKER_OBJ_017_oPCAN_RADAR_8cc7b14a_Tx, ComPduIdRef=EcucPduCollection/RDR_TRACKER_OBJ_017_oPCAN_RADAR_136dc5fd_Tx, ComIPduGroupRef=RDR02_oPCAN_RADAR_Tx_9f750495 if post-build-variant-condition{matching-criterion=RDR_POS, value=1}, ComIPduGroupRef=RDR03_oPCAN_RADAR_Tx_311d9504 if post-build-variant-condition{matching-criterion=RDR_POS, value=2}, ComIPduGroupRef=RDR04_oPCAN_RADAR_Tx_cce46d71 if post-build-variant-condition{matching-criterion=RDR_POS, value=3}, ComIPduGroupRef=RDR05_oPCAN_RADAR_Tx_628cfce0 if post-build-variant-condition{matching-criterion=RDR_POS, value=4}, ComIPduGroupRef=RDR06_oPCAN_RADAR_Tx_4b444812 if post-build-variant-condition{matching-criterion=RDR_POS, value=5}, ComIPduGroupRef=RDR07_oPCAN_RADAR_Tx_e52cd983 if post-build-variant-condition{matching-criterion=RDR_POS, value=6}, ComIPduGroupRef=RDR08_oPCAN_RADAR_Tx_6bc6beb9 if post-build-variant-condition{matching-criterion=RDR_POS, value=7}
          ComTxIPdu: ComMinimumDelayTime=0, ComTxIPduUnusedAreasDefault=0
        RDR_TRACKER_OBJ_018_oPCAN_RADAR_341d10c8_Tx: ComIPduDirection=SEND, ComIPduChannelRef=ComMConfigSet/CN_PCAN_RADAR_458ff0f1, ComIPduGroupRef=RDR01_oPCAN_RADAR_Tx_b6bdb067 if post-build-variant-condition{matching-criterion=RDR_POS, value=0}, ComIPduSignalGroupRef=SG_TrackerObject018_oRDR_TRACKER_OBJ_018_oPCAN_RADAR_ab5b5c0c_Tx, ComPduIdRef=EcucPduCollection/RDR_TRACKER_OBJ_018_oPCAN_RADAR_341d10c8_Tx, ComIPduGroupRef=RDR02_oPCAN_RADAR_Tx_9f750495 if post-build-variant-condition{matching-criterion=RDR_POS, value=1}, ComIPduGroupRef=RDR03_oPCAN_RADAR_Tx_311d9504 if post-build-variant-condition{matching-criterion=RDR_POS, value=2}, ComIPduGroupRef=RDR04_oPCAN_RADAR_Tx_cce46d71 if post-build-variant-condition{matching-criterion=RDR_POS, value=3}, ComIPduGroupRef=RDR05_oPCAN_RADAR_Tx_628cfce0 if post-build-variant-condition{matching-criterion=RDR_POS, value=4}, ComIPduGroupRef=RDR06_oPCAN_RADAR_Tx_4b444812 if post-build-variant-condition{matching-criterion=RDR_POS, value=5}, ComIPduGroupRef=RDR07_oPCAN_RADAR_Tx_e52cd983 if post-build-variant-condition{matching-criterion=RDR_POS, value=6}, ComIPduGroupRef=RDR08_oPCAN_RADAR_Tx_6bc6beb9 if post-build-variant-condition{matching-criterion=RDR_POS, value=7}
          ComTxIPdu: ComMinimumDelayTime=0, ComTxIPduUnusedAreasDefault=0
        RDR_TRACKER_OBJ_019_oPCAN_RADAR_e98bc94d_Tx: ComIPduDirection=SEND, ComIPduChannelRef=ComMConfigSet/CN_PCAN_RADAR_458ff0f1, ComIPduGroupRef=RDR01_oPCAN_RADAR_Tx_b6bdb067 if post-build-variant-condition{matching-criterion=RDR_POS, value=0}, ComIPduSignalGroupRef=SG_TrackerObject019_oRDR_TRACKER_OBJ_019_oPCAN_RADAR_524fd4bf_Tx, ComPduIdRef=EcucPduCollection/RDR_TRACKER_OBJ_019_oPCAN_RADAR_e98bc94d_Tx, ComIPduGroupRef=RDR02_oPCAN_RADAR_Tx_9f750495 if post-build-variant-condition{matching-criterion=RDR_POS, value=1}, ComIPduGroupRef=RDR03_oPCAN_RADAR_Tx_311d9504 if post-build-variant-condition{matching-criterion=RDR_POS, value=2}, ComIPduGroupRef=RDR04_oPCAN_RADAR_Tx_cce46d71 if post-build-variant-condition{matching-criterion=RDR_POS, value=3}, ComIPduGroupRef=RDR05_oPCAN_RADAR_Tx_628cfce0 if post-build-variant-condition{matching-criterion=RDR_POS, value=4}, ComIPduGroupRef=RDR06_oPCAN_RADAR_Tx_4b444812 if post-build-variant-condition{matching-criterion=RDR_POS, value=5}, ComIPduGroupRef=RDR07_oPCAN_RADAR_Tx_e52cd983 if post-build-variant-condition{matching-criterion=RDR_POS, value=6}, ComIPduGroupRef=RDR08_oPCAN_RADAR_Tx_6bc6beb9 if post-build-variant-condition{matching-criterion=RDR_POS, value=7}
          ComTxIPdu: ComMinimumDelayTime=0, ComTxIPduUnusedAreasDefault=0
        RDR_TRACKER_OBJ_020_oPCAN_RADAR_127fe67e_Tx: ComIPduDirection=SEND, ComIPduChannelRef=ComMConfigSet/CN_PCAN_RADAR_458ff0f1, ComIPduGroupRef=RDR01_oPCAN_RADAR_Tx_b6bdb067 if post-build-variant-condition{matching-criterion=RDR_POS, value=0}, ComIPduSignalGroupRef=SG_TrackerObject020_oRDR_TRACKER_OBJ_020_oPCAN_RADAR_f9891b52_Tx, ComPduIdRef=EcucPduCollection/RDR_TRACKER_OBJ_020_oPCAN_RADAR_127fe67e_Tx, ComIPduGroupRef=RDR02_oPCAN_RADAR_Tx_9f750495 if post-build-variant-condition{matching-criterion=RDR_POS, value=1}, ComIPduGroupRef=RDR03_oPCAN_RADAR_Tx_311d9504 if post-build-variant-condition{matching-criterion=RDR_POS, value=2}, ComIPduGroupRef=RDR04_oPCAN_RADAR_Tx_cce46d71 if post-build-variant-condition{matching-criterion=RDR_POS, value=3}, ComIPduGroupRef=RDR05_oPCAN_RADAR_Tx_628cfce0 if post-build-variant-condition{matching-criterion=RDR_POS, value=4}, ComIPduGroupRef=RDR06_oPCAN_RADAR_Tx_4b444812 if post-build-variant-condition{matching-criterion=RDR_POS, value=5}, ComIPduGroupRef=RDR07_oPCAN_RADAR_Tx_e52cd983 if post-build-variant-condition{matching-criterion=RDR_POS, value=6}, ComIPduGroupRef=RDR08_oPCAN_RADAR_Tx_6bc6beb9 if post-build-variant-condition{matching-criterion=RDR_POS, value=7}
          ComTxIPdu: ComMinimumDelayTime=0, ComTxIPduUnusedAreasDefault=0
        RDR_TRACKER_OBJ_021_oPCAN_RADAR_cfe93ffb_Tx: ComIPduDirection=SEND, ComIPduChannelRef=ComMConfigSet/CN_PCAN_RADAR_458ff0f1, ComIPduGroupRef=RDR01_oPCAN_RADAR_Tx_b6bdb067 if post-build-variant-condition{matching-criterion=RDR_POS, value=0}, ComIPduSignalGroupRef=SG_TrackerObject021_oRDR_TRACKER_OBJ_021_oPCAN_RADAR_009d93e1_Tx, ComPduIdRef=EcucPduCollection/RDR_TRACKER_OBJ_021_oPCAN_RADAR_cfe93ffb_Tx, ComIPduGroupRef=RDR02_oPCAN_RADAR_Tx_9f750495 if post-build-variant-condition{matching-criterion=RDR_POS, value=1}, ComIPduGroupRef=RDR03_oPCAN_RADAR_Tx_311d9504 if post-build-variant-condition{matching-criterion=RDR_POS, value=2}, ComIPduGroupRef=RDR04_oPCAN_RADAR_Tx_cce46d71 if post-build-variant-condition{matching-criterion=RDR_POS, value=3}, ComIPduGroupRef=RDR05_oPCAN_RADAR_Tx_628cfce0 if post-build-variant-condition{matching-criterion=RDR_POS, value=4}, ComIPduGroupRef=RDR06_oPCAN_RADAR_Tx_4b444812 if post-build-variant-condition{matching-criterion=RDR_POS, value=5}, ComIPduGroupRef=RDR07_oPCAN_RADAR_Tx_e52cd983 if post-build-variant-condition{matching-criterion=RDR_POS, value=6}, ComIPduGroupRef=RDR08_oPCAN_RADAR_Tx_6bc6beb9 if post-build-variant-condition{matching-criterion=RDR_POS, value=7}
          ComTxIPdu: ComMinimumDelayTime=0, ComTxIPduUnusedAreasDefault=0
        RDR_TRACKER_OBJ_022_oPCAN_RADAR_72235335_Tx: ComIPduDirection=SEND, ComIPduChannelRef=ComMConfigSet/CN_PCAN_RADAR_458ff0f1, ComIPduGroupRef=RDR01_oPCAN_RADAR_Tx_b6bdb067 if post-build-variant-condition{matching-criterion=RDR_POS, value=0}, ComIPduSignalGroupRef=SG_TrackerObject022_oRDR_TRACKER_OBJ_022_oPCAN_RADAR_d0d10c75_Tx, ComPduIdRef=EcucPduCollection/RDR_TRACKER_OBJ_022_oPCAN_RADAR_72235335_Tx, ComIPduGroupRef=RDR02_oPCAN_RADAR_Tx_9f750495 if post-build-variant-condition{matching-criterion=RDR_POS, value=1}, ComIPduGroupRef=RDR03_oPCAN_RADAR_Tx_311d9504 if post-build-variant-condition{matching-criterion=RDR_POS, value=2}, ComIPduGroupRef=RDR04_oPCAN_RADAR_Tx_cce46d71 if post-build-variant-condition{matching-criterion=RDR_POS, value=3}, ComIPduGroupRef=RDR05_oPCAN_RADAR_Tx_628cfce0 if post-build-variant-condition{matching-criterion=RDR_POS, value=4}, ComIPduGroupRef=RDR06_oPCAN_RADAR_Tx_4b444812 if post-build-variant-condition{matching-criterion=RDR_POS, value=5}, ComIPduGroupRef=RDR07_oPCAN_RADAR_Tx_e52cd983 if post-build-variant-condition{matching-criterion=RDR_POS, value=6}, ComIPduGroupRef=RDR08_oPCAN_RADAR_Tx_6bc6beb9 if post-build-variant-condition{matching-criterion=RDR_POS, value=7}
          ComTxIPdu: ComMinimumDelayTime=0, ComTxIPduUnusedAreasDefault=0
        RDR_TRACKER_OBJ_023_oPCAN_RADAR_afb58ab0_Tx: ComIPduDirection=SEND, ComIPduChannelRef=ComMConfigSet/CN_PCAN_RADAR_458ff0f1, ComIPduGroupRef=RDR01_oPCAN_RADAR_Tx_b6bdb067 if post-build-variant-condition{matching-criterion=RDR_POS, value=0}, ComIPduSignalGroupRef=SG_TrackerObject023_oRDR_TRACKER_OBJ_023_oPCAN_RADAR_29c584c6_Tx, ComPduIdRef=EcucPduCollection/RDR_TRACKER_OBJ_023_oPCAN_RADAR_afb58ab0_Tx, ComIPduGroupRef=RDR02_oPCAN_RADAR_Tx_9f750495 if post-build-variant-condition{matching-criterion=RDR_POS, value=1}, ComIPduGroupRef=RDR03_oPCAN_RADAR_Tx_311d9504 if post-build-variant-condition{matching-criterion=RDR_POS, value=2}, ComIPduGroupRef=RDR04_oPCAN_RADAR_Tx_cce46d71 if post-build-variant-condition{matching-criterion=RDR_POS, value=3}, ComIPduGroupRef=RDR05_oPCAN_RADAR_Tx_628cfce0 if post-build-variant-condition{matching-criterion=RDR_POS, value=4}, ComIPduGroupRef=RDR06_oPCAN_RADAR_Tx_4b444812 if post-build-variant-condition{matching-criterion=RDR_POS, value=5}, ComIPduGroupRef=RDR07_oPCAN_RADAR_Tx_e52cd983 if post-build-variant-condition{matching-criterion=RDR_POS, value=6}, ComIPduGroupRef=RDR08_oPCAN_RADAR_Tx_6bc6beb9 if post-build-variant-condition{matching-criterion=RDR_POS, value=7}
          ComTxIPdu: ComMinimumDelayTime=0, ComTxIPduUnusedAreasDefault=0
        RDR_TRACKER_OBJ_024_oPCAN_RADAR_d2c68ce8_Tx: ComIPduDirection=SEND, ComIPduChannelRef=ComMConfigSet/CN_PCAN_RADAR_458ff0f1, ComIPduGroupRef=RDR01_oPCAN_RADAR_Tx_b6bdb067 if post-build-variant-condition{matching-criterion=RDR_POS, value=0}, ComIPduSignalGroupRef=SG_TrackerObject024_oRDR_TRACKER_OBJ_024_oPCAN_RADAR_ab39351c_Tx, ComPduIdRef=EcucPduCollection/RDR_TRACKER_OBJ_024_oPCAN_RADAR_d2c68ce8_Tx, ComIPduGroupRef=RDR02_oPCAN_RADAR_Tx_9f750495 if post-build-variant-condition{matching-criterion=RDR_POS, value=1}, ComIPduGroupRef=RDR03_oPCAN_RADAR_Tx_311d9504 if post-build-variant-condition{matching-criterion=RDR_POS, value=2}, ComIPduGroupRef=RDR04_oPCAN_RADAR_Tx_cce46d71 if post-build-variant-condition{matching-criterion=RDR_POS, value=3}, ComIPduGroupRef=RDR05_oPCAN_RADAR_Tx_628cfce0 if post-build-variant-condition{matching-criterion=RDR_POS, value=4}, ComIPduGroupRef=RDR06_oPCAN_RADAR_Tx_4b444812 if post-build-variant-condition{matching-criterion=RDR_POS, value=5}, ComIPduGroupRef=RDR07_oPCAN_RADAR_Tx_e52cd983 if post-build-variant-condition{matching-criterion=RDR_POS, value=6}, ComIPduGroupRef=RDR08_oPCAN_RADAR_Tx_6bc6beb9 if post-build-variant-condition{matching-criterion=RDR_POS, value=7}
          ComTxIPdu: ComMinimumDelayTime=0, ComTxIPduUnusedAreasDefault=0
        RDR_TRACKER_OBJ_025_oPCAN_RADAR_0f50556d_Tx: ComIPduDirection=SEND, ComIPduChannelRef=ComMConfigSet/CN_PCAN_RADAR_458ff0f1, ComIPduGroupRef=RDR01_oPCAN_RADAR_Tx_b6bdb067 if post-build-variant-condition{matching-criterion=RDR_POS, value=0}, ComIPduSignalGroupRef=SG_TrackerObject025_oRDR_TRACKER_OBJ_025_oPCAN_RADAR_522dbdaf_Tx, ComPduIdRef=EcucPduCollection/RDR_TRACKER_OBJ_025_oPCAN_RADAR_0f50556d_Tx, ComIPduGroupRef=RDR02_oPCAN_RADAR_Tx_9f750495 if post-build-variant-condition{matching-criterion=RDR_POS, value=1}, ComIPduGroupRef=RDR03_oPCAN_RADAR_Tx_311d9504 if post-build-variant-condition{matching-criterion=RDR_POS, value=2}, ComIPduGroupRef=RDR04_oPCAN_RADAR_Tx_cce46d71 if post-build-variant-condition{matching-criterion=RDR_POS, value=3}, ComIPduGroupRef=RDR05_oPCAN_RADAR_Tx_628cfce0 if post-build-variant-condition{matching-criterion=RDR_POS, value=4}, ComIPduGroupRef=RDR06_oPCAN_RADAR_Tx_4b444812 if post-build-variant-condition{matching-criterion=RDR_POS, value=5}, ComIPduGroupRef=RDR07_oPCAN_RADAR_Tx_e52cd983 if post-build-variant-condition{matching-criterion=RDR_POS, value=6}, ComIPduGroupRef=RDR08_oPCAN_RADAR_Tx_6bc6beb9 if post-build-variant-condition{matching-criterion=RDR_POS, value=7}
          ComTxIPdu: ComMinimumDelayTime=0, ComTxIPduUnusedAreasDefault=0
        RDR_TRACKER_OBJ_026_oPCAN_RADAR_b29a39a3_Tx: ComIPduDirection=SEND, ComIPduChannelRef=ComMConfigSet/CN_PCAN_RADAR_458ff0f1, ComIPduGroupRef=RDR01_oPCAN_RADAR_Tx_b6bdb067 if post-build-variant-condition{matching-criterion=RDR_POS, value=0}, ComIPduSignalGroupRef=SG_TrackerObject026_oRDR_TRACKER_OBJ_026_oPCAN_RADAR_8261223b_Tx, ComPduIdRef=EcucPduCollection/RDR_TRACKER_OBJ_026_oPCAN_RADAR_b29a39a3_Tx, ComIPduGroupRef=RDR02_oPCAN_RADAR_Tx_9f750495 if post-build-variant-condition{matching-criterion=RDR_POS, value=1}, ComIPduGroupRef=RDR03_oPCAN_RADAR_Tx_311d9504 if post-build-variant-condition{matching-criterion=RDR_POS, value=2}, ComIPduGroupRef=RDR04_oPCAN_RADAR_Tx_cce46d71 if post-build-variant-condition{matching-criterion=RDR_POS, value=3}, ComIPduGroupRef=RDR05_oPCAN_RADAR_Tx_628cfce0 if post-build-variant-condition{matching-criterion=RDR_POS, value=4}, ComIPduGroupRef=RDR06_oPCAN_RADAR_Tx_4b444812 if post-build-variant-condition{matching-criterion=RDR_POS, value=5}, ComIPduGroupRef=RDR07_oPCAN_RADAR_Tx_e52cd983 if post-build-variant-condition{matching-criterion=RDR_POS, value=6}, ComIPduGroupRef=RDR08_oPCAN_RADAR_Tx_6bc6beb9 if post-build-variant-condition{matching-criterion=RDR_POS, value=7}
          ComTxIPdu: ComMinimumDelayTime=0, ComTxIPduUnusedAreasDefault=0
        RDR_TRACKER_OBJ_027_oPCAN_RADAR_6f0ce026_Tx: ComIPduDirection=SEND, ComIPduChannelRef=ComMConfigSet/CN_PCAN_RADAR_458ff0f1, ComIPduGroupRef=RDR01_oPCAN_RADAR_Tx_b6bdb067 if post-build-variant-condition{matching-criterion=RDR_POS, value=0}, ComIPduSignalGroupRef=SG_TrackerObject027_oRDR_TRACKER_OBJ_027_oPCAN_RADAR_7b75aa88_Tx, ComPduIdRef=EcucPduCollection/RDR_TRACKER_OBJ_027_oPCAN_RADAR_6f0ce026_Tx, ComIPduGroupRef=RDR02_oPCAN_RADAR_Tx_9f750495 if post-build-variant-condition{matching-criterion=RDR_POS, value=1}, ComIPduGroupRef=RDR03_oPCAN_RADAR_Tx_311d9504 if post-build-variant-condition{matching-criterion=RDR_POS, value=2}, ComIPduGroupRef=RDR04_oPCAN_RADAR_Tx_cce46d71 if post-build-variant-condition{matching-criterion=RDR_POS, value=3}, ComIPduGroupRef=RDR05_oPCAN_RADAR_Tx_628cfce0 if post-build-variant-condition{matching-criterion=RDR_POS, value=4}, ComIPduGroupRef=RDR06_oPCAN_RADAR_Tx_4b444812 if post-build-variant-condition{matching-criterion=RDR_POS, value=5}, ComIPduGroupRef=RDR07_oPCAN_RADAR_Tx_e52cd983 if post-build-variant-condition{matching-criterion=RDR_POS, value=6}, ComIPduGroupRef=RDR08_oPCAN_RADAR_Tx_6bc6beb9 if post-build-variant-condition{matching-criterion=RDR_POS, value=7}
          ComTxIPdu: ComMinimumDelayTime=0, ComTxIPduUnusedAreasDefault=0
        RDR_TRACKER_OBJ_028_oPCAN_RADAR_487c3513_Tx: ComIPduDirection=SEND, ComIPduChannelRef=ComMConfigSet/CN_PCAN_RADAR_458ff0f1, ComIPduGroupRef=RDR01_oPCAN_RADAR_Tx_b6bdb067 if post-build-variant-condition{matching-criterion=RDR_POS, value=0}, ComIPduSignalGroupRef=SG_TrackerObject028_oRDR_TRACKER_OBJ_028_oPCAN_RADAR_5ce947ce_Tx, ComPduIdRef=EcucPduCollection/RDR_TRACKER_OBJ_028_oPCAN_RADAR_487c3513_Tx, ComIPduGroupRef=RDR02_oPCAN_RADAR_Tx_9f750495 if post-build-variant-condition{matching-criterion=RDR_POS, value=1}, ComIPduGroupRef=RDR03_oPCAN_RADAR_Tx_311d9504 if post-build-variant-condition{matching-criterion=RDR_POS, value=2}, ComIPduGroupRef=RDR04_oPCAN_RADAR_Tx_cce46d71 if post-build-variant-condition{matching-criterion=RDR_POS, value=3}, ComIPduGroupRef=RDR05_oPCAN_RADAR_Tx_628cfce0 if post-build-variant-condition{matching-criterion=RDR_POS, value=4}, ComIPduGroupRef=RDR06_oPCAN_RADAR_Tx_4b444812 if post-build-variant-condition{matching-criterion=RDR_POS, value=5}, ComIPduGroupRef=RDR07_oPCAN_RADAR_Tx_e52cd983 if post-build-variant-condition{matching-criterion=RDR_POS, value=6}, ComIPduGroupRef=RDR08_oPCAN_RADAR_Tx_6bc6beb9 if post-build-variant-condition{matching-criterion=RDR_POS, value=7}
          ComTxIPdu: ComMinimumDelayTime=0, ComTxIPduUnusedAreasDefault=0
        RDR_TRACKER_OBJ_029_oPCAN_RADAR_95eaec96_Tx: ComIPduDirection=SEND, ComIPduChannelRef=ComMConfigSet/CN_PCAN_RADAR_458ff0f1, ComIPduGroupRef=RDR01_oPCAN_RADAR_Tx_b6bdb067 if post-build-variant-condition{matching-criterion=RDR_POS, value=0}, ComIPduSignalGroupRef=SG_TrackerObject029_oRDR_TRACKER_OBJ_029_oPCAN_RADAR_a5fdcf7d_Tx, ComPduIdRef=EcucPduCollection/RDR_TRACKER_OBJ_029_oPCAN_RADAR_95eaec96_Tx, ComIPduGroupRef=RDR02_oPCAN_RADAR_Tx_9f750495 if post-build-variant-condition{matching-criterion=RDR_POS, value=1}, ComIPduGroupRef=RDR03_oPCAN_RADAR_Tx_311d9504 if post-build-variant-condition{matching-criterion=RDR_POS, value=2}, ComIPduGroupRef=RDR04_oPCAN_RADAR_Tx_cce46d71 if post-build-variant-condition{matching-criterion=RDR_POS, value=3}, ComIPduGroupRef=RDR05_oPCAN_RADAR_Tx_628cfce0 if post-build-variant-condition{matching-criterion=RDR_POS, value=4}, ComIPduGroupRef=RDR06_oPCAN_RADAR_Tx_4b444812 if post-build-variant-condition{matching-criterion=RDR_POS, value=5}, ComIPduGroupRef=RDR07_oPCAN_RADAR_Tx_e52cd983 if post-build-variant-condition{matching-criterion=RDR_POS, value=6}, ComIPduGroupRef=RDR08_oPCAN_RADAR_Tx_6bc6beb9 if post-build-variant-condition{matching-criterion=RDR_POS, value=7}
          ComTxIPdu: ComMinimumDelayTime=0, ComTxIPduUnusedAreasDefault=0
        RDR_TRACKER_OBJ_030_oPCAN_RADAR_8f700708_Tx: ComIPduDirection=SEND, ComIPduChannelRef=ComMConfigSet/CN_PCAN_RADAR_458ff0f1, ComIPduGroupRef=RDR01_oPCAN_RADAR_Tx_b6bdb067 if post-build-variant-condition{matching-criterion=RDR_POS, value=0}, ComIPduSignalGroupRef=SG_TrackerObject030_oRDR_TRACKER_OBJ_030_oPCAN_RADAR_ab18edec_Tx, ComPduIdRef=EcucPduCollection/RDR_TRACKER_OBJ_030_oPCAN_RADAR_8f700708_Tx, ComIPduGroupRef=RDR02_oPCAN_RADAR_Tx_9f750495 if post-build-variant-condition{matching-criterion=RDR_POS, value=1}, ComIPduGroupRef=RDR03_oPCAN_RADAR_Tx_311d9504 if post-build-variant-condition{matching-criterion=RDR_POS, value=2}, ComIPduGroupRef=RDR04_oPCAN_RADAR_Tx_cce46d71 if post-build-variant-condition{matching-criterion=RDR_POS, value=3}, ComIPduGroupRef=RDR05_oPCAN_RADAR_Tx_628cfce0 if post-build-variant-condition{matching-criterion=RDR_POS, value=4}, ComIPduGroupRef=RDR06_oPCAN_RADAR_Tx_4b444812 if post-build-variant-condition{matching-criterion=RDR_POS, value=5}, ComIPduGroupRef=RDR07_oPCAN_RADAR_Tx_e52cd983 if post-build-variant-condition{matching-criterion=RDR_POS, value=6}, ComIPduGroupRef=RDR08_oPCAN_RADAR_Tx_6bc6beb9 if post-build-variant-condition{matching-criterion=RDR_POS, value=7}
          ComTxIPdu: ComMinimumDelayTime=0, ComTxIPduUnusedAreasDefault=0
        RDR_TRACKER_OBJ_031_oPCAN_RADAR_52e6de8d_Tx: ComIPduDirection=SEND, ComIPduChannelRef=ComMConfigSet/CN_PCAN_RADAR_458ff0f1, ComIPduGroupRef=RDR01_oPCAN_RADAR_Tx_b6bdb067 if post-build-variant-condition{matching-criterion=RDR_POS, value=0}, ComIPduSignalGroupRef=SG_TrackerObject031_oRDR_TRACKER_OBJ_031_oPCAN_RADAR_520c655f_Tx, ComPduIdRef=EcucPduCollection/RDR_TRACKER_OBJ_031_oPCAN_RADAR_52e6de8d_Tx, ComIPduGroupRef=RDR02_oPCAN_RADAR_Tx_9f750495 if post-build-variant-condition{matching-criterion=RDR_POS, value=1}, ComIPduGroupRef=RDR03_oPCAN_RADAR_Tx_311d9504 if post-build-variant-condition{matching-criterion=RDR_POS, value=2}, ComIPduGroupRef=RDR04_oPCAN_RADAR_Tx_cce46d71 if post-build-variant-condition{matching-criterion=RDR_POS, value=3}, ComIPduGroupRef=RDR05_oPCAN_RADAR_Tx_628cfce0 if post-build-variant-condition{matching-criterion=RDR_POS, value=4}, ComIPduGroupRef=RDR06_oPCAN_RADAR_Tx_4b444812 if post-build-variant-condition{matching-criterion=RDR_POS, value=5}, ComIPduGroupRef=RDR07_oPCAN_RADAR_Tx_e52cd983 if post-build-variant-condition{matching-criterion=RDR_POS, value=6}, ComIPduGroupRef=RDR08_oPCAN_RADAR_Tx_6bc6beb9 if post-build-variant-condition{matching-criterion=RDR_POS, value=7}
          ComTxIPdu: ComMinimumDelayTime=0, ComTxIPduUnusedAreasDefault=0
        RDR_TRACKER_OBJ_032_oPCAN_RADAR_ef2cb243_Tx: ComIPduDirection=SEND, ComIPduChannelRef=ComMConfigSet/CN_PCAN_RADAR_458ff0f1, ComIPduGroupRef=RDR01_oPCAN_RADAR_Tx_b6bdb067 if post-build-variant-condition{matching-criterion=RDR_POS, value=0}, ComIPduSignalGroupRef=SG_TrackerObject032_oRDR_TRACKER_OBJ_032_oPCAN_RADAR_8240facb_Tx, ComPduIdRef=EcucPduCollection/RDR_TRACKER_OBJ_032_oPCAN_RADAR_ef2cb243_Tx, ComIPduGroupRef=RDR02_oPCAN_RADAR_Tx_9f750495 if post-build-variant-condition{matching-criterion=RDR_POS, value=1}, ComIPduGroupRef=RDR03_oPCAN_RADAR_Tx_311d9504 if post-build-variant-condition{matching-criterion=RDR_POS, value=2}, ComIPduGroupRef=RDR04_oPCAN_RADAR_Tx_cce46d71 if post-build-variant-condition{matching-criterion=RDR_POS, value=3}, ComIPduGroupRef=RDR05_oPCAN_RADAR_Tx_628cfce0 if post-build-variant-condition{matching-criterion=RDR_POS, value=4}, ComIPduGroupRef=RDR06_oPCAN_RADAR_Tx_4b444812 if post-build-variant-condition{matching-criterion=RDR_POS, value=5}, ComIPduGroupRef=RDR07_oPCAN_RADAR_Tx_e52cd983 if post-build-variant-condition{matching-criterion=RDR_POS, value=6}, ComIPduGroupRef=RDR08_oPCAN_RADAR_Tx_6bc6beb9 if post-build-variant-condition{matching-criterion=RDR_POS, value=7}
          ComTxIPdu: ComMinimumDelayTime=0, ComTxIPduUnusedAreasDefault=0
        RDR_TRACKER_OBJ_033_oPCAN_RADAR_32ba6bc6_Tx: ComIPduDirection=SEND, ComIPduChannelRef=ComMConfigSet/CN_PCAN_RADAR_458ff0f1, ComIPduGroupRef=RDR01_oPCAN_RADAR_Tx_b6bdb067 if post-build-variant-condition{matching-criterion=RDR_POS, value=0}, ComIPduSignalGroupRef=SG_TrackerObject033_oRDR_TRACKER_OBJ_033_oPCAN_RADAR_7b547278_Tx, ComPduIdRef=EcucPduCollection/RDR_TRACKER_OBJ_033_oPCAN_RADAR_32ba6bc6_Tx, ComIPduGroupRef=RDR02_oPCAN_RADAR_Tx_9f750495 if post-build-variant-condition{matching-criterion=RDR_POS, value=1}, ComIPduGroupRef=RDR03_oPCAN_RADAR_Tx_311d9504 if post-build-variant-condition{matching-criterion=RDR_POS, value=2}, ComIPduGroupRef=RDR04_oPCAN_RADAR_Tx_cce46d71 if post-build-variant-condition{matching-criterion=RDR_POS, value=3}, ComIPduGroupRef=RDR05_oPCAN_RADAR_Tx_628cfce0 if post-build-variant-condition{matching-criterion=RDR_POS, value=4}, ComIPduGroupRef=RDR06_oPCAN_RADAR_Tx_4b444812 if post-build-variant-condition{matching-criterion=RDR_POS, value=5}, ComIPduGroupRef=RDR07_oPCAN_RADAR_Tx_e52cd983 if post-build-variant-condition{matching-criterion=RDR_POS, value=6}, ComIPduGroupRef=RDR08_oPCAN_RADAR_Tx_6bc6beb9 if post-build-variant-condition{matching-criterion=RDR_POS, value=7}
          ComTxIPdu: ComMinimumDelayTime=0, ComTxIPduUnusedAreasDefault=0
        RDR_TRACKER_OBJ_034_oPCAN_RADAR_4fc96d9e_Tx: ComIPduDirection=SEND, ComIPduChannelRef=ComMConfigSet/CN_PCAN_RADAR_458ff0f1, ComIPduGroupRef=RDR01_oPCAN_RADAR_Tx_b6bdb067 if post-build-variant-condition{matching-criterion=RDR_POS, value=0}, ComIPduSignalGroupRef=SG_TrackerObject034_oRDR_TRACKER_OBJ_034_oPCAN_RADAR_f9a8c3a2_Tx, ComPduIdRef=EcucPduCollection/RDR_TRACKER_OBJ_034_oPCAN_RADAR_4fc96d9e_Tx, ComIPduGroupRef=RDR02_oPCAN_RADAR_Tx_9f750495 if post-build-variant-condition{matching-criterion=RDR_POS, value=1}, ComIPduGroupRef=RDR03_oPCAN_RADAR_Tx_311d9504 if post-build-variant-condition{matching-criterion=RDR_POS, value=2}, ComIPduGroupRef=RDR04_oPCAN_RADAR_Tx_cce46d71 if post-build-variant-condition{matching-criterion=RDR_POS, value=3}, ComIPduGroupRef=RDR05_oPCAN_RADAR_Tx_628cfce0 if post-build-variant-condition{matching-criterion=RDR_POS, value=4}, ComIPduGroupRef=RDR06_oPCAN_RADAR_Tx_4b444812 if post-build-variant-condition{matching-criterion=RDR_POS, value=5}, ComIPduGroupRef=RDR07_oPCAN_RADAR_Tx_e52cd983 if post-build-variant-condition{matching-criterion=RDR_POS, value=6}, ComIPduGroupRef=RDR08_oPCAN_RADAR_Tx_6bc6beb9 if post-build-variant-condition{matching-criterion=RDR_POS, value=7}
          ComTxIPdu: ComMinimumDelayTime=0, ComTxIPduUnusedAreasDefault=0
        RDR_TRACKER_OBJ_035_oPCAN_RADAR_925fb41b_Tx: ComIPduDirection=SEND, ComIPduChannelRef=ComMConfigSet/CN_PCAN_RADAR_458ff0f1, ComIPduGroupRef=RDR01_oPCAN_RADAR_Tx_b6bdb067 if post-build-variant-condition{matching-criterion=RDR_POS, value=0}, ComIPduSignalGroupRef=SG_TrackerObject035_oRDR_TRACKER_OBJ_035_oPCAN_RADAR_00bc4b11_Tx, ComPduIdRef=EcucPduCollection/RDR_TRACKER_OBJ_035_oPCAN_RADAR_925fb41b_Tx, ComIPduGroupRef=RDR02_oPCAN_RADAR_Tx_9f750495 if post-build-variant-condition{matching-criterion=RDR_POS, value=1}, ComIPduGroupRef=RDR03_oPCAN_RADAR_Tx_311d9504 if post-build-variant-condition{matching-criterion=RDR_POS, value=2}, ComIPduGroupRef=RDR04_oPCAN_RADAR_Tx_cce46d71 if post-build-variant-condition{matching-criterion=RDR_POS, value=3}, ComIPduGroupRef=RDR05_oPCAN_RADAR_Tx_628cfce0 if post-build-variant-condition{matching-criterion=RDR_POS, value=4}, ComIPduGroupRef=RDR06_oPCAN_RADAR_Tx_4b444812 if post-build-variant-condition{matching-criterion=RDR_POS, value=5}, ComIPduGroupRef=RDR07_oPCAN_RADAR_Tx_e52cd983 if post-build-variant-condition{matching-criterion=RDR_POS, value=6}, ComIPduGroupRef=RDR08_oPCAN_RADAR_Tx_6bc6beb9 if post-build-variant-condition{matching-criterion=RDR_POS, value=7}
          ComTxIPdu: ComMinimumDelayTime=0, ComTxIPduUnusedAreasDefault=0
        RDR_TRACKER_OBJ_036_oPCAN_RADAR_2f95d8d5_Tx: ComIPduDirection=SEND, ComIPduChannelRef=ComMConfigSet/CN_PCAN_RADAR_458ff0f1, ComIPduGroupRef=RDR01_oPCAN_RADAR_Tx_b6bdb067 if post-build-variant-condition{matching-criterion=RDR_POS, value=0}, ComIPduSignalGroupRef=SG_TrackerObject036_oRDR_TRACKER_OBJ_036_oPCAN_RADAR_d0f0d485_Tx, ComPduIdRef=EcucPduCollection/RDR_TRACKER_OBJ_036_oPCAN_RADAR_2f95d8d5_Tx, ComIPduGroupRef=RDR02_oPCAN_RADAR_Tx_9f750495 if post-build-variant-condition{matching-criterion=RDR_POS, value=1}, ComIPduGroupRef=RDR03_oPCAN_RADAR_Tx_311d9504 if post-build-variant-condition{matching-criterion=RDR_POS, value=2}, ComIPduGroupRef=RDR04_oPCAN_RADAR_Tx_cce46d71 if post-build-variant-condition{matching-criterion=RDR_POS, value=3}, ComIPduGroupRef=RDR05_oPCAN_RADAR_Tx_628cfce0 if post-build-variant-condition{matching-criterion=RDR_POS, value=4}, ComIPduGroupRef=RDR06_oPCAN_RADAR_Tx_4b444812 if post-build-variant-condition{matching-criterion=RDR_POS, value=5}, ComIPduGroupRef=RDR07_oPCAN_RADAR_Tx_e52cd983 if post-build-variant-condition{matching-criterion=RDR_POS, value=6}, ComIPduGroupRef=RDR08_oPCAN_RADAR_Tx_6bc6beb9 if post-build-variant-condition{matching-criterion=RDR_POS, value=7}
          ComTxIPdu: ComMinimumDelayTime=0, ComTxIPduUnusedAreasDefault=0
        RDR_TRACKER_OBJ_037_oPCAN_RADAR_f2030150_Tx: ComIPduDirection=SEND, ComIPduChannelRef=ComMConfigSet/CN_PCAN_RADAR_458ff0f1, ComIPduGroupRef=RDR01_oPCAN_RADAR_Tx_b6bdb067 if post-build-variant-condition{matching-criterion=RDR_POS, value=0}, ComIPduSignalGroupRef=SG_TrackerObject037_oRDR_TRACKER_OBJ_037_oPCAN_RADAR_29e45c36_Tx, ComPduIdRef=EcucPduCollection/RDR_TRACKER_OBJ_037_oPCAN_RADAR_f2030150_Tx, ComIPduGroupRef=RDR02_oPCAN_RADAR_Tx_9f750495 if post-build-variant-condition{matching-criterion=RDR_POS, value=1}, ComIPduGroupRef=RDR03_oPCAN_RADAR_Tx_311d9504 if post-build-variant-condition{matching-criterion=RDR_POS, value=2}, ComIPduGroupRef=RDR04_oPCAN_RADAR_Tx_cce46d71 if post-build-variant-condition{matching-criterion=RDR_POS, value=3}, ComIPduGroupRef=RDR05_oPCAN_RADAR_Tx_628cfce0 if post-build-variant-condition{matching-criterion=RDR_POS, value=4}, ComIPduGroupRef=RDR06_oPCAN_RADAR_Tx_4b444812 if post-build-variant-condition{matching-criterion=RDR_POS, value=5}, ComIPduGroupRef=RDR07_oPCAN_RADAR_Tx_e52cd983 if post-build-variant-condition{matching-criterion=RDR_POS, value=6}, ComIPduGroupRef=RDR08_oPCAN_RADAR_Tx_6bc6beb9 if post-build-variant-condition{matching-criterion=RDR_POS, value=7}
          ComTxIPdu: ComMinimumDelayTime=0, ComTxIPduUnusedAreasDefault=0
        RDR_TRACKER_OBJ_038_oPCAN_RADAR_d573d465_Tx: ComIPduDirection=SEND, ComIPduChannelRef=ComMConfigSet/CN_PCAN_RADAR_458ff0f1, ComIPduGroupRef=RDR01_oPCAN_RADAR_Tx_b6bdb067 if post-build-variant-condition{matching-criterion=RDR_POS, value=0}, ComIPduSignalGroupRef=SG_TrackerObject038_oRDR_TRACKER_OBJ_038_oPCAN_RADAR_0e78b170_Tx, ComPduIdRef=EcucPduCollection/RDR_TRACKER_OBJ_038_oPCAN_RADAR_d573d465_Tx, ComIPduGroupRef=RDR02_oPCAN_RADAR_Tx_9f750495 if post-build-variant-condition{matching-criterion=RDR_POS, value=1}, ComIPduGroupRef=RDR03_oPCAN_RADAR_Tx_311d9504 if post-build-variant-condition{matching-criterion=RDR_POS, value=2}, ComIPduGroupRef=RDR04_oPCAN_RADAR_Tx_cce46d71 if post-build-variant-condition{matching-criterion=RDR_POS, value=3}, ComIPduGroupRef=RDR05_oPCAN_RADAR_Tx_628cfce0 if post-build-variant-condition{matching-criterion=RDR_POS, value=4}, ComIPduGroupRef=RDR06_oPCAN_RADAR_Tx_4b444812 if post-build-variant-condition{matching-criterion=RDR_POS, value=5}, ComIPduGroupRef=RDR07_oPCAN_RADAR_Tx_e52cd983 if post-build-variant-condition{matching-criterion=RDR_POS, value=6}, ComIPduGroupRef=RDR08_oPCAN_RADAR_Tx_6bc6beb9 if post-build-variant-condition{matching-criterion=RDR_POS, value=7}
          ComTxIPdu: ComMinimumDelayTime=0, ComTxIPduUnusedAreasDefault=0
        RDR_TRACKER_OBJ_039_oPCAN_RADAR_08e50de0_Tx: ComIPduDirection=SEND, ComIPduChannelRef=ComMConfigSet/CN_PCAN_RADAR_458ff0f1, ComIPduGroupRef=RDR01_oPCAN_RADAR_Tx_b6bdb067 if post-build-variant-condition{matching-criterion=RDR_POS, value=0}, ComIPduSignalGroupRef=SG_TrackerObject039_oRDR_TRACKER_OBJ_039_oPCAN_RADAR_f76c39c3_Tx, ComPduIdRef=EcucPduCollection/RDR_TRACKER_OBJ_039_oPCAN_RADAR_08e50de0_Tx, ComIPduGroupRef=RDR02_oPCAN_RADAR_Tx_9f750495 if post-build-variant-condition{matching-criterion=RDR_POS, value=1}, ComIPduGroupRef=RDR03_oPCAN_RADAR_Tx_311d9504 if post-build-variant-condition{matching-criterion=RDR_POS, value=2}, ComIPduGroupRef=RDR04_oPCAN_RADAR_Tx_cce46d71 if post-build-variant-condition{matching-criterion=RDR_POS, value=3}, ComIPduGroupRef=RDR05_oPCAN_RADAR_Tx_628cfce0 if post-build-variant-condition{matching-criterion=RDR_POS, value=4}, ComIPduGroupRef=RDR06_oPCAN_RADAR_Tx_4b444812 if post-build-variant-condition{matching-criterion=RDR_POS, value=5}, ComIPduGroupRef=RDR07_oPCAN_RADAR_Tx_e52cd983 if post-build-variant-condition{matching-criterion=RDR_POS, value=6}, ComIPduGroupRef=RDR08_oPCAN_RADAR_Tx_6bc6beb9 if post-build-variant-condition{matching-criterion=RDR_POS, value=7}
          ComTxIPdu: ComMinimumDelayTime=0, ComTxIPduUnusedAreasDefault=0
        RDR_TRACKER_OBJ_040_oPCAN_RADAR_eabdadc8_Tx: ComIPduDirection=SEND, ComIPduChannelRef=ComMConfigSet/CN_PCAN_RADAR_458ff0f1, ComIPduGroupRef=RDR01_oPCAN_RADAR_Tx_b6bdb067 if post-build-variant-condition{matching-criterion=RDR_POS, value=0}, ComIPduSignalGroupRef=SG_TrackerObject040_oRDR_TRACKER_OBJ_040_oPCAN_RADAR_cd9c2a97_Tx, ComPduIdRef=EcucPduCollection/RDR_TRACKER_OBJ_040_oPCAN_RADAR_eabdadc8_Tx, ComIPduGroupRef=RDR02_oPCAN_RADAR_Tx_9f750495 if post-build-variant-condition{matching-criterion=RDR_POS, value=1}, ComIPduGroupRef=RDR03_oPCAN_RADAR_Tx_311d9504 if post-build-variant-condition{matching-criterion=RDR_POS, value=2}, ComIPduGroupRef=RDR04_oPCAN_RADAR_Tx_cce46d71 if post-build-variant-condition{matching-criterion=RDR_POS, value=3}, ComIPduGroupRef=RDR05_oPCAN_RADAR_Tx_628cfce0 if post-build-variant-condition{matching-criterion=RDR_POS, value=4}, ComIPduGroupRef=RDR06_oPCAN_RADAR_Tx_4b444812 if post-build-variant-condition{matching-criterion=RDR_POS, value=5}, ComIPduGroupRef=RDR07_oPCAN_RADAR_Tx_e52cd983 if post-build-variant-condition{matching-criterion=RDR_POS, value=6}, ComIPduGroupRef=RDR08_oPCAN_RADAR_Tx_6bc6beb9 if post-build-variant-condition{matching-criterion=RDR_POS, value=7}
          ComTxIPdu: ComMinimumDelayTime=0, ComTxIPduUnusedAreasDefault=0
        RDR_TRACKER_OBJ_041_oPCAN_RADAR_372b744d_Tx: ComIPduDirection=SEND, ComIPduChannelRef=ComMConfigSet/CN_PCAN_RADAR_458ff0f1, ComIPduGroupRef=RDR01_oPCAN_RADAR_Tx_b6bdb067 if post-build-variant-condition{matching-criterion=RDR_POS, value=0}, ComIPduSignalGroupRef=SG_TrackerObject041_oRDR_TRACKER_OBJ_041_oPCAN_RADAR_3488a224_Tx, ComPduIdRef=EcucPduCollection/RDR_TRACKER_OBJ_041_oPCAN_RADAR_372b744d_Tx, ComIPduGroupRef=RDR02_oPCAN_RADAR_Tx_9f750495 if post-build-variant-condition{matching-criterion=RDR_POS, value=1}, ComIPduGroupRef=RDR03_oPCAN_RADAR_Tx_311d9504 if post-build-variant-condition{matching-criterion=RDR_POS, value=2}, ComIPduGroupRef=RDR04_oPCAN_RADAR_Tx_cce46d71 if post-build-variant-condition{matching-criterion=RDR_POS, value=3}, ComIPduGroupRef=RDR05_oPCAN_RADAR_Tx_628cfce0 if post-build-variant-condition{matching-criterion=RDR_POS, value=4}, ComIPduGroupRef=RDR06_oPCAN_RADAR_Tx_4b444812 if post-build-variant-condition{matching-criterion=RDR_POS, value=5}, ComIPduGroupRef=RDR07_oPCAN_RADAR_Tx_e52cd983 if post-build-variant-condition{matching-criterion=RDR_POS, value=6}, ComIPduGroupRef=RDR08_oPCAN_RADAR_Tx_6bc6beb9 if post-build-variant-condition{matching-criterion=RDR_POS, value=7}
          ComTxIPdu: ComMinimumDelayTime=0, ComTxIPduUnusedAreasDefault=0
        RDR_TRACKER_OBJ_042_oPCAN_RADAR_8ae11883_Tx: ComIPduDirection=SEND, ComIPduChannelRef=ComMConfigSet/CN_PCAN_RADAR_458ff0f1, ComIPduGroupRef=RDR01_oPCAN_RADAR_Tx_b6bdb067 if post-build-variant-condition{matching-criterion=RDR_POS, value=0}, ComIPduSignalGroupRef=SG_TrackerObject042_oRDR_TRACKER_OBJ_042_oPCAN_RADAR_e4c43db0_Tx, ComPduIdRef=EcucPduCollection/RDR_TRACKER_OBJ_042_oPCAN_RADAR_8ae11883_Tx, ComIPduGroupRef=RDR02_oPCAN_RADAR_Tx_9f750495 if post-build-variant-condition{matching-criterion=RDR_POS, value=1}, ComIPduGroupRef=RDR03_oPCAN_RADAR_Tx_311d9504 if post-build-variant-condition{matching-criterion=RDR_POS, value=2}, ComIPduGroupRef=RDR04_oPCAN_RADAR_Tx_cce46d71 if post-build-variant-condition{matching-criterion=RDR_POS, value=3}, ComIPduGroupRef=RDR05_oPCAN_RADAR_Tx_628cfce0 if post-build-variant-condition{matching-criterion=RDR_POS, value=4}, ComIPduGroupRef=RDR06_oPCAN_RADAR_Tx_4b444812 if post-build-variant-condition{matching-criterion=RDR_POS, value=5}, ComIPduGroupRef=RDR07_oPCAN_RADAR_Tx_e52cd983 if post-build-variant-condition{matching-criterion=RDR_POS, value=6}, ComIPduGroupRef=RDR08_oPCAN_RADAR_Tx_6bc6beb9 if post-build-variant-condition{matching-criterion=RDR_POS, value=7}
          ComTxIPdu: ComMinimumDelayTime=0, ComTxIPduUnusedAreasDefault=0
        RDR_TRACKER_OBJ_043_oPCAN_RADAR_5777c106_Tx: ComIPduDirection=SEND, ComIPduChannelRef=ComMConfigSet/CN_PCAN_RADAR_458ff0f1, ComIPduGroupRef=RDR01_oPCAN_RADAR_Tx_b6bdb067 if post-build-variant-condition{matching-criterion=RDR_POS, value=0}, ComIPduSignalGroupRef=SG_TrackerObject043_oRDR_TRACKER_OBJ_043_oPCAN_RADAR_1dd0b503_Tx, ComPduIdRef=EcucPduCollection/RDR_TRACKER_OBJ_043_oPCAN_RADAR_5777c106_Tx, ComIPduGroupRef=RDR02_oPCAN_RADAR_Tx_9f750495 if post-build-variant-condition{matching-criterion=RDR_POS, value=1}, ComIPduGroupRef=RDR03_oPCAN_RADAR_Tx_311d9504 if post-build-variant-condition{matching-criterion=RDR_POS, value=2}, ComIPduGroupRef=RDR04_oPCAN_RADAR_Tx_cce46d71 if post-build-variant-condition{matching-criterion=RDR_POS, value=3}, ComIPduGroupRef=RDR05_oPCAN_RADAR_Tx_628cfce0 if post-build-variant-condition{matching-criterion=RDR_POS, value=4}, ComIPduGroupRef=RDR06_oPCAN_RADAR_Tx_4b444812 if post-build-variant-condition{matching-criterion=RDR_POS, value=5}, ComIPduGroupRef=RDR07_oPCAN_RADAR_Tx_e52cd983 if post-build-variant-condition{matching-criterion=RDR_POS, value=6}, ComIPduGroupRef=RDR08_oPCAN_RADAR_Tx_6bc6beb9 if post-build-variant-condition{matching-criterion=RDR_POS, value=7}
          ComTxIPdu: ComMinimumDelayTime=0, ComTxIPduUnusedAreasDefault=0
        RDR_TRACKER_OBJ_044_oPCAN_RADAR_2a04c75e_Tx: ComIPduDirection=SEND, ComIPduChannelRef=ComMConfigSet/CN_PCAN_RADAR_458ff0f1, ComIPduGroupRef=RDR01_oPCAN_RADAR_Tx_b6bdb067 if post-build-variant-condition{matching-criterion=RDR_POS, value=0}, ComIPduSignalGroupRef=SG_TrackerObject044_oRDR_TRACKER_OBJ_044_oPCAN_RADAR_9f2c04d9_Tx, ComPduIdRef=EcucPduCollection/RDR_TRACKER_OBJ_044_oPCAN_RADAR_2a04c75e_Tx, ComIPduGroupRef=RDR02_oPCAN_RADAR_Tx_9f750495 if post-build-variant-condition{matching-criterion=RDR_POS, value=1}, ComIPduGroupRef=RDR03_oPCAN_RADAR_Tx_311d9504 if post-build-variant-condition{matching-criterion=RDR_POS, value=2}, ComIPduGroupRef=RDR04_oPCAN_RADAR_Tx_cce46d71 if post-build-variant-condition{matching-criterion=RDR_POS, value=3}, ComIPduGroupRef=RDR05_oPCAN_RADAR_Tx_628cfce0 if post-build-variant-condition{matching-criterion=RDR_POS, value=4}, ComIPduGroupRef=RDR06_oPCAN_RADAR_Tx_4b444812 if post-build-variant-condition{matching-criterion=RDR_POS, value=5}, ComIPduGroupRef=RDR07_oPCAN_RADAR_Tx_e52cd983 if post-build-variant-condition{matching-criterion=RDR_POS, value=6}, ComIPduGroupRef=RDR08_oPCAN_RADAR_Tx_6bc6beb9 if post-build-variant-condition{matching-criterion=RDR_POS, value=7}
          ComTxIPdu: ComMinimumDelayTime=0, ComTxIPduUnusedAreasDefault=0
        RDR_TRACKER_OBJ_045_oPCAN_RADAR_f7921edb_Tx: ComIPduDirection=SEND, ComIPduChannelRef=ComMConfigSet/CN_PCAN_RADAR_458ff0f1, ComIPduGroupRef=RDR01_oPCAN_RADAR_Tx_b6bdb067 if post-build-variant-condition{matching-criterion=RDR_POS, value=0}, ComIPduSignalGroupRef=SG_TrackerObject045_oRDR_TRACKER_OBJ_045_oPCAN_RADAR_66388c6a_Tx, ComPduIdRef=EcucPduCollection/RDR_TRACKER_OBJ_045_oPCAN_RADAR_f7921edb_Tx, ComIPduGroupRef=RDR02_oPCAN_RADAR_Tx_9f750495 if post-build-variant-condition{matching-criterion=RDR_POS, value=1}, ComIPduGroupRef=RDR03_oPCAN_RADAR_Tx_311d9504 if post-build-variant-condition{matching-criterion=RDR_POS, value=2}, ComIPduGroupRef=RDR04_oPCAN_RADAR_Tx_cce46d71 if post-build-variant-condition{matching-criterion=RDR_POS, value=3}, ComIPduGroupRef=RDR05_oPCAN_RADAR_Tx_628cfce0 if post-build-variant-condition{matching-criterion=RDR_POS, value=4}, ComIPduGroupRef=RDR06_oPCAN_RADAR_Tx_4b444812 if post-build-variant-condition{matching-criterion=RDR_POS, value=5}, ComIPduGroupRef=RDR07_oPCAN_RADAR_Tx_e52cd983 if post-build-variant-condition{matching-criterion=RDR_POS, value=6}, ComIPduGroupRef=RDR08_oPCAN_RADAR_Tx_6bc6beb9 if post-build-variant-condition{matching-criterion=RDR_POS, value=7}
          ComTxIPdu: ComMinimumDelayTime=0, ComTxIPduUnusedAreasDefault=0
        RDR_TRACKER_OBJ_046_oPCAN_RADAR_4a587215_Tx: ComIPduDirection=SEND, ComIPduChannelRef=ComMConfigSet/CN_PCAN_RADAR_458ff0f1, ComIPduGroupRef=RDR01_oPCAN_RADAR_Tx_b6bdb067 if post-build-variant-condition{matching-criterion=RDR_POS, value=0}, ComIPduSignalGroupRef=SG_TrackerObject046_oRDR_TRACKER_OBJ_046_oPCAN_RADAR_b67413fe_Tx, ComPduIdRef=EcucPduCollection/RDR_TRACKER_OBJ_046_oPCAN_RADAR_4a587215_Tx, ComIPduGroupRef=RDR02_oPCAN_RADAR_Tx_9f750495 if post-build-variant-condition{matching-criterion=RDR_POS, value=1}, ComIPduGroupRef=RDR03_oPCAN_RADAR_Tx_311d9504 if post-build-variant-condition{matching-criterion=RDR_POS, value=2}, ComIPduGroupRef=RDR04_oPCAN_RADAR_Tx_cce46d71 if post-build-variant-condition{matching-criterion=RDR_POS, value=3}, ComIPduGroupRef=RDR05_oPCAN_RADAR_Tx_628cfce0 if post-build-variant-condition{matching-criterion=RDR_POS, value=4}, ComIPduGroupRef=RDR06_oPCAN_RADAR_Tx_4b444812 if post-build-variant-condition{matching-criterion=RDR_POS, value=5}, ComIPduGroupRef=RDR07_oPCAN_RADAR_Tx_e52cd983 if post-build-variant-condition{matching-criterion=RDR_POS, value=6}, ComIPduGroupRef=RDR08_oPCAN_RADAR_Tx_6bc6beb9 if post-build-variant-condition{matching-criterion=RDR_POS, value=7}
          ComTxIPdu: ComMinimumDelayTime=0, ComTxIPduUnusedAreasDefault=0
        RDR_TRACKER_OBJ_047_oPCAN_RADAR_97ceab90_Tx: ComIPduDirection=SEND, ComIPduChannelRef=ComMConfigSet/CN_PCAN_RADAR_458ff0f1, ComIPduGroupRef=RDR01_oPCAN_RADAR_Tx_b6bdb067 if post-build-variant-condition{matching-criterion=RDR_POS, value=0}, ComIPduSignalGroupRef=SG_TrackerObject047_oRDR_TRACKER_OBJ_047_oPCAN_RADAR_4f609b4d_Tx, ComPduIdRef=EcucPduCollection/RDR_TRACKER_OBJ_047_oPCAN_RADAR_97ceab90_Tx, ComIPduGroupRef=RDR02_oPCAN_RADAR_Tx_9f750495 if post-build-variant-condition{matching-criterion=RDR_POS, value=1}, ComIPduGroupRef=RDR03_oPCAN_RADAR_Tx_311d9504 if post-build-variant-condition{matching-criterion=RDR_POS, value=2}, ComIPduGroupRef=RDR04_oPCAN_RADAR_Tx_cce46d71 if post-build-variant-condition{matching-criterion=RDR_POS, value=3}, ComIPduGroupRef=RDR05_oPCAN_RADAR_Tx_628cfce0 if post-build-variant-condition{matching-criterion=RDR_POS, value=4}, ComIPduGroupRef=RDR06_oPCAN_RADAR_Tx_4b444812 if post-build-variant-condition{matching-criterion=RDR_POS, value=5}, ComIPduGroupRef=RDR07_oPCAN_RADAR_Tx_e52cd983 if post-build-variant-condition{matching-criterion=RDR_POS, value=6}, ComIPduGroupRef=RDR08_oPCAN_RADAR_Tx_6bc6beb9 if post-build-variant-condition{matching-criterion=RDR_POS, value=7}
          ComTxIPdu: ComMinimumDelayTime=0, ComTxIPduUnusedAreasDefault=0
        RDR_TRACKER_OBJ_048_oPCAN_RADAR_b0be7ea5_Tx: ComIPduDirection=SEND, ComIPduChannelRef=ComMConfigSet/CN_PCAN_RADAR_458ff0f1, ComIPduGroupRef=RDR01_oPCAN_RADAR_Tx_b6bdb067 if post-build-variant-condition{matching-criterion=RDR_POS, value=0}, ComIPduSignalGroupRef=SG_TrackerObject048_oRDR_TRACKER_OBJ_048_oPCAN_RADAR_68fc760b_Tx, ComPduIdRef=EcucPduCollection/RDR_TRACKER_OBJ_048_oPCAN_RADAR_b0be7ea5_Tx, ComIPduGroupRef=RDR02_oPCAN_RADAR_Tx_9f750495 if post-build-variant-condition{matching-criterion=RDR_POS, value=1}, ComIPduGroupRef=RDR03_oPCAN_RADAR_Tx_311d9504 if post-build-variant-condition{matching-criterion=RDR_POS, value=2}, ComIPduGroupRef=RDR04_oPCAN_RADAR_Tx_cce46d71 if post-build-variant-condition{matching-criterion=RDR_POS, value=3}, ComIPduGroupRef=RDR05_oPCAN_RADAR_Tx_628cfce0 if post-build-variant-condition{matching-criterion=RDR_POS, value=4}, ComIPduGroupRef=RDR06_oPCAN_RADAR_Tx_4b444812 if post-build-variant-condition{matching-criterion=RDR_POS, value=5}, ComIPduGroupRef=RDR07_oPCAN_RADAR_Tx_e52cd983 if post-build-variant-condition{matching-criterion=RDR_POS, value=6}, ComIPduGroupRef=RDR08_oPCAN_RADAR_Tx_6bc6beb9 if post-build-variant-condition{matching-criterion=RDR_POS, value=7}
          ComTxIPdu: ComMinimumDelayTime=0, ComTxIPduUnusedAreasDefault=0
        RDR_TRACKER_OBJ_049_oPCAN_RADAR_6d28a720_Tx: ComIPduDirection=SEND, ComIPduChannelRef=ComMConfigSet/CN_PCAN_RADAR_458ff0f1, ComIPduGroupRef=RDR01_oPCAN_RADAR_Tx_b6bdb067 if post-build-variant-condition{matching-criterion=RDR_POS, value=0}, ComIPduSignalGroupRef=SG_TrackerObject049_oRDR_TRACKER_OBJ_049_oPCAN_RADAR_91e8feb8_Tx, ComPduIdRef=EcucPduCollection/RDR_TRACKER_OBJ_049_oPCAN_RADAR_6d28a720_Tx, ComIPduGroupRef=RDR02_oPCAN_RADAR_Tx_9f750495 if post-build-variant-condition{matching-criterion=RDR_POS, value=1}, ComIPduGroupRef=RDR03_oPCAN_RADAR_Tx_311d9504 if post-build-variant-condition{matching-criterion=RDR_POS, value=2}, ComIPduGroupRef=RDR04_oPCAN_RADAR_Tx_cce46d71 if post-build-variant-condition{matching-criterion=RDR_POS, value=3}, ComIPduGroupRef=RDR05_oPCAN_RADAR_Tx_628cfce0 if post-build-variant-condition{matching-criterion=RDR_POS, value=4}, ComIPduGroupRef=RDR06_oPCAN_RADAR_Tx_4b444812 if post-build-variant-condition{matching-criterion=RDR_POS, value=5}, ComIPduGroupRef=RDR07_oPCAN_RADAR_Tx_e52cd983 if post-build-variant-condition{matching-criterion=RDR_POS, value=6}, ComIPduGroupRef=RDR08_oPCAN_RADAR_Tx_6bc6beb9 if post-build-variant-condition{matching-criterion=RDR_POS, value=7}
          ComTxIPdu: ComMinimumDelayTime=0, ComTxIPduUnusedAreasDefault=0
        RDR_TRACKER_OBJ_050_oPCAN_RADAR_77b24cbe_Tx: ComIPduDirection=SEND, ComIPduChannelRef=ComMConfigSet/CN_PCAN_RADAR_458ff0f1, ComIPduGroupRef=RDR01_oPCAN_RADAR_Tx_b6bdb067 if post-build-variant-condition{matching-criterion=RDR_POS, value=0}, ComIPduSignalGroupRef=SG_TrackerObject050_oRDR_TRACKER_OBJ_050_oPCAN_RADAR_9f0ddc29_Tx, ComPduIdRef=EcucPduCollection/RDR_TRACKER_OBJ_050_oPCAN_RADAR_77b24cbe_Tx, ComIPduGroupRef=RDR02_oPCAN_RADAR_Tx_9f750495 if post-build-variant-condition{matching-criterion=RDR_POS, value=1}, ComIPduGroupRef=RDR03_oPCAN_RADAR_Tx_311d9504 if post-build-variant-condition{matching-criterion=RDR_POS, value=2}, ComIPduGroupRef=RDR04_oPCAN_RADAR_Tx_cce46d71 if post-build-variant-condition{matching-criterion=RDR_POS, value=3}, ComIPduGroupRef=RDR05_oPCAN_RADAR_Tx_628cfce0 if post-build-variant-condition{matching-criterion=RDR_POS, value=4}, ComIPduGroupRef=RDR06_oPCAN_RADAR_Tx_4b444812 if post-build-variant-condition{matching-criterion=RDR_POS, value=5}, ComIPduGroupRef=RDR07_oPCAN_RADAR_Tx_e52cd983 if post-build-variant-condition{matching-criterion=RDR_POS, value=6}, ComIPduGroupRef=RDR08_oPCAN_RADAR_Tx_6bc6beb9 if post-build-variant-condition{matching-criterion=RDR_POS, value=7}
          ComTxIPdu: ComMinimumDelayTime=0, ComTxIPduUnusedAreasDefault=0
        RDR_TRACKER_OBJ_051_oPCAN_RADAR_aa24953b_Tx: ComIPduDirection=SEND, ComIPduChannelRef=ComMConfigSet/CN_PCAN_RADAR_458ff0f1, ComIPduGroupRef=RDR01_oPCAN_RADAR_Tx_b6bdb067 if post-build-variant-condition{matching-criterion=RDR_POS, value=0}, ComIPduSignalGroupRef=SG_TrackerObject051_oRDR_TRACKER_OBJ_051_oPCAN_RADAR_6619549a_Tx, ComPduIdRef=EcucPduCollection/RDR_TRACKER_OBJ_051_oPCAN_RADAR_aa24953b_Tx, ComIPduGroupRef=RDR02_oPCAN_RADAR_Tx_9f750495 if post-build-variant-condition{matching-criterion=RDR_POS, value=1}, ComIPduGroupRef=RDR03_oPCAN_RADAR_Tx_311d9504 if post-build-variant-condition{matching-criterion=RDR_POS, value=2}, ComIPduGroupRef=RDR04_oPCAN_RADAR_Tx_cce46d71 if post-build-variant-condition{matching-criterion=RDR_POS, value=3}, ComIPduGroupRef=RDR05_oPCAN_RADAR_Tx_628cfce0 if post-build-variant-condition{matching-criterion=RDR_POS, value=4}, ComIPduGroupRef=RDR06_oPCAN_RADAR_Tx_4b444812 if post-build-variant-condition{matching-criterion=RDR_POS, value=5}, ComIPduGroupRef=RDR07_oPCAN_RADAR_Tx_e52cd983 if post-build-variant-condition{matching-criterion=RDR_POS, value=6}, ComIPduGroupRef=RDR08_oPCAN_RADAR_Tx_6bc6beb9 if post-build-variant-condition{matching-criterion=RDR_POS, value=7}
          ComTxIPdu: ComMinimumDelayTime=0, ComTxIPduUnusedAreasDefault=0
        RDR_TRACKER_OBJ_052_oPCAN_RADAR_17eef9f5_Tx: ComIPduDirection=SEND, ComIPduChannelRef=ComMConfigSet/CN_PCAN_RADAR_458ff0f1, ComIPduGroupRef=RDR01_oPCAN_RADAR_Tx_b6bdb067 if post-build-variant-condition{matching-criterion=RDR_POS, value=0}, ComIPduSignalGroupRef=SG_TrackerObject052_oRDR_TRACKER_OBJ_052_oPCAN_RADAR_b655cb0e_Tx, ComPduIdRef=EcucPduCollection/RDR_TRACKER_OBJ_052_oPCAN_RADAR_17eef9f5_Tx, ComIPduGroupRef=RDR02_oPCAN_RADAR_Tx_9f750495 if post-build-variant-condition{matching-criterion=RDR_POS, value=1}, ComIPduGroupRef=RDR03_oPCAN_RADAR_Tx_311d9504 if post-build-variant-condition{matching-criterion=RDR_POS, value=2}, ComIPduGroupRef=RDR04_oPCAN_RADAR_Tx_cce46d71 if post-build-variant-condition{matching-criterion=RDR_POS, value=3}, ComIPduGroupRef=RDR05_oPCAN_RADAR_Tx_628cfce0 if post-build-variant-condition{matching-criterion=RDR_POS, value=4}, ComIPduGroupRef=RDR06_oPCAN_RADAR_Tx_4b444812 if post-build-variant-condition{matching-criterion=RDR_POS, value=5}, ComIPduGroupRef=RDR07_oPCAN_RADAR_Tx_e52cd983 if post-build-variant-condition{matching-criterion=RDR_POS, value=6}, ComIPduGroupRef=RDR08_oPCAN_RADAR_Tx_6bc6beb9 if post-build-variant-condition{matching-criterion=RDR_POS, value=7}
          ComTxIPdu: ComMinimumDelayTime=0, ComTxIPduUnusedAreasDefault=0
        RDR_TRACKER_OBJ_053_oPCAN_RADAR_ca782070_Tx: ComIPduDirection=SEND, ComIPduChannelRef=ComMConfigSet/CN_PCAN_RADAR_458ff0f1, ComIPduGroupRef=RDR01_oPCAN_RADAR_Tx_b6bdb067 if post-build-variant-condition{matching-criterion=RDR_POS, value=0}, ComIPduSignalGroupRef=SG_TrackerObject053_oRDR_TRACKER_OBJ_053_oPCAN_RADAR_4f4143bd_Tx, ComPduIdRef=EcucPduCollection/RDR_TRACKER_OBJ_053_oPCAN_RADAR_ca782070_Tx, ComIPduGroupRef=RDR02_oPCAN_RADAR_Tx_9f750495 if post-build-variant-condition{matching-criterion=RDR_POS, value=1}, ComIPduGroupRef=RDR03_oPCAN_RADAR_Tx_311d9504 if post-build-variant-condition{matching-criterion=RDR_POS, value=2}, ComIPduGroupRef=RDR04_oPCAN_RADAR_Tx_cce46d71 if post-build-variant-condition{matching-criterion=RDR_POS, value=3}, ComIPduGroupRef=RDR05_oPCAN_RADAR_Tx_628cfce0 if post-build-variant-condition{matching-criterion=RDR_POS, value=4}, ComIPduGroupRef=RDR06_oPCAN_RADAR_Tx_4b444812 if post-build-variant-condition{matching-criterion=RDR_POS, value=5}, ComIPduGroupRef=RDR07_oPCAN_RADAR_Tx_e52cd983 if post-build-variant-condition{matching-criterion=RDR_POS, value=6}, ComIPduGroupRef=RDR08_oPCAN_RADAR_Tx_6bc6beb9 if post-build-variant-condition{matching-criterion=RDR_POS, value=7}
          ComTxIPdu: ComMinimumDelayTime=0, ComTxIPduUnusedAreasDefault=0
        RDR_TRACKER_OBJ_054_oPCAN_RADAR_b70b2628_Tx: ComIPduDirection=SEND, ComIPduChannelRef=ComMConfigSet/CN_PCAN_RADAR_458ff0f1, ComIPduGroupRef=RDR01_oPCAN_RADAR_Tx_b6bdb067 if post-build-variant-condition{matching-criterion=RDR_POS, value=0}, ComIPduSignalGroupRef=SG_TrackerObject054_oRDR_TRACKER_OBJ_054_oPCAN_RADAR_cdbdf267_Tx, ComPduIdRef=EcucPduCollection/RDR_TRACKER_OBJ_054_oPCAN_RADAR_b70b2628_Tx, ComIPduGroupRef=RDR02_oPCAN_RADAR_Tx_9f750495 if post-build-variant-condition{matching-criterion=RDR_POS, value=1}, ComIPduGroupRef=RDR03_oPCAN_RADAR_Tx_311d9504 if post-build-variant-condition{matching-criterion=RDR_POS, value=2}, ComIPduGroupRef=RDR04_oPCAN_RADAR_Tx_cce46d71 if post-build-variant-condition{matching-criterion=RDR_POS, value=3}, ComIPduGroupRef=RDR05_oPCAN_RADAR_Tx_628cfce0 if post-build-variant-condition{matching-criterion=RDR_POS, value=4}, ComIPduGroupRef=RDR06_oPCAN_RADAR_Tx_4b444812 if post-build-variant-condition{matching-criterion=RDR_POS, value=5}, ComIPduGroupRef=RDR07_oPCAN_RADAR_Tx_e52cd983 if post-build-variant-condition{matching-criterion=RDR_POS, value=6}, ComIPduGroupRef=RDR08_oPCAN_RADAR_Tx_6bc6beb9 if post-build-variant-condition{matching-criterion=RDR_POS, value=7}
          ComTxIPdu: ComMinimumDelayTime=0, ComTxIPduUnusedAreasDefault=0
        RDR_TRACKER_OBJ_055_oPCAN_RADAR_6a9dffad_Tx: ComIPduDirection=SEND, ComIPduChannelRef=ComMConfigSet/CN_PCAN_RADAR_458ff0f1, ComIPduGroupRef=RDR01_oPCAN_RADAR_Tx_b6bdb067 if post-build-variant-condition{matching-criterion=RDR_POS, value=0}, ComIPduSignalGroupRef=SG_TrackerObject055_oRDR_TRACKER_OBJ_055_oPCAN_RADAR_34a97ad4_Tx, ComPduIdRef=EcucPduCollection/RDR_TRACKER_OBJ_055_oPCAN_RADAR_6a9dffad_Tx, ComIPduGroupRef=RDR02_oPCAN_RADAR_Tx_9f750495 if post-build-variant-condition{matching-criterion=RDR_POS, value=1}, ComIPduGroupRef=RDR03_oPCAN_RADAR_Tx_311d9504 if post-build-variant-condition{matching-criterion=RDR_POS, value=2}, ComIPduGroupRef=RDR04_oPCAN_RADAR_Tx_cce46d71 if post-build-variant-condition{matching-criterion=RDR_POS, value=3}, ComIPduGroupRef=RDR05_oPCAN_RADAR_Tx_628cfce0 if post-build-variant-condition{matching-criterion=RDR_POS, value=4}, ComIPduGroupRef=RDR06_oPCAN_RADAR_Tx_4b444812 if post-build-variant-condition{matching-criterion=RDR_POS, value=5}, ComIPduGroupRef=RDR07_oPCAN_RADAR_Tx_e52cd983 if post-build-variant-condition{matching-criterion=RDR_POS, value=6}, ComIPduGroupRef=RDR08_oPCAN_RADAR_Tx_6bc6beb9 if post-build-variant-condition{matching-criterion=RDR_POS, value=7}
          ComTxIPdu: ComMinimumDelayTime=0, ComTxIPduUnusedAreasDefault=0
        RDR_TRACKER_OBJ_056_oPCAN_RADAR_d7579363_Tx: ComIPduDirection=SEND, ComIPduChannelRef=ComMConfigSet/CN_PCAN_RADAR_458ff0f1, ComIPduGroupRef=RDR01_oPCAN_RADAR_Tx_b6bdb067 if post-build-variant-condition{matching-criterion=RDR_POS, value=0}, ComIPduSignalGroupRef=SG_TrackerObject056_oRDR_TRACKER_OBJ_056_oPCAN_RADAR_e4e5e540_Tx, ComPduIdRef=EcucPduCollection/RDR_TRACKER_OBJ_056_oPCAN_RADAR_d7579363_Tx, ComIPduGroupRef=RDR02_oPCAN_RADAR_Tx_9f750495 if post-build-variant-condition{matching-criterion=RDR_POS, value=1}, ComIPduGroupRef=RDR03_oPCAN_RADAR_Tx_311d9504 if post-build-variant-condition{matching-criterion=RDR_POS, value=2}, ComIPduGroupRef=RDR04_oPCAN_RADAR_Tx_cce46d71 if post-build-variant-condition{matching-criterion=RDR_POS, value=3}, ComIPduGroupRef=RDR05_oPCAN_RADAR_Tx_628cfce0 if post-build-variant-condition{matching-criterion=RDR_POS, value=4}, ComIPduGroupRef=RDR06_oPCAN_RADAR_Tx_4b444812 if post-build-variant-condition{matching-criterion=RDR_POS, value=5}, ComIPduGroupRef=RDR07_oPCAN_RADAR_Tx_e52cd983 if post-build-variant-condition{matching-criterion=RDR_POS, value=6}, ComIPduGroupRef=RDR08_oPCAN_RADAR_Tx_6bc6beb9 if post-build-variant-condition{matching-criterion=RDR_POS, value=7}
          ComTxIPdu: ComMinimumDelayTime=0, ComTxIPduUnusedAreasDefault=0
        RDR_TRACKER_OBJ_057_oPCAN_RADAR_0ac14ae6_Tx: ComIPduDirection=SEND, ComIPduChannelRef=ComMConfigSet/CN_PCAN_RADAR_458ff0f1, ComIPduGroupRef=RDR01_oPCAN_RADAR_Tx_b6bdb067 if post-build-variant-condition{matching-criterion=RDR_POS, value=0}, ComIPduSignalGroupRef=SG_TrackerObject057_oRDR_TRACKER_OBJ_057_oPCAN_RADAR_1df16df3_Tx, ComPduIdRef=EcucPduCollection/RDR_TRACKER_OBJ_057_oPCAN_RADAR_0ac14ae6_Tx, ComIPduGroupRef=RDR02_oPCAN_RADAR_Tx_9f750495 if post-build-variant-condition{matching-criterion=RDR_POS, value=1}, ComIPduGroupRef=RDR03_oPCAN_RADAR_Tx_311d9504 if post-build-variant-condition{matching-criterion=RDR_POS, value=2}, ComIPduGroupRef=RDR04_oPCAN_RADAR_Tx_cce46d71 if post-build-variant-condition{matching-criterion=RDR_POS, value=3}, ComIPduGroupRef=RDR05_oPCAN_RADAR_Tx_628cfce0 if post-build-variant-condition{matching-criterion=RDR_POS, value=4}, ComIPduGroupRef=RDR06_oPCAN_RADAR_Tx_4b444812 if post-build-variant-condition{matching-criterion=RDR_POS, value=5}, ComIPduGroupRef=RDR07_oPCAN_RADAR_Tx_e52cd983 if post-build-variant-condition{matching-criterion=RDR_POS, value=6}, ComIPduGroupRef=RDR08_oPCAN_RADAR_Tx_6bc6beb9 if post-build-variant-condition{matching-criterion=RDR_POS, value=7}
          ComTxIPdu: ComMinimumDelayTime=0, ComTxIPduUnusedAreasDefault=0
        RDR_TRACKER_OBJ_058_oPCAN_RADAR_2db19fd3_Tx: ComIPduDirection=SEND, ComIPduChannelRef=ComMConfigSet/CN_PCAN_RADAR_458ff0f1, ComIPduGroupRef=RDR01_oPCAN_RADAR_Tx_b6bdb067 if post-build-variant-condition{matching-criterion=RDR_POS, value=0}, ComIPduSignalGroupRef=SG_TrackerObject058_oRDR_TRACKER_OBJ_058_oPCAN_RADAR_3a6d80b5_Tx, ComPduIdRef=EcucPduCollection/RDR_TRACKER_OBJ_058_oPCAN_RADAR_2db19fd3_Tx, ComIPduGroupRef=RDR02_oPCAN_RADAR_Tx_9f750495 if post-build-variant-condition{matching-criterion=RDR_POS, value=1}, ComIPduGroupRef=RDR03_oPCAN_RADAR_Tx_311d9504 if post-build-variant-condition{matching-criterion=RDR_POS, value=2}, ComIPduGroupRef=RDR04_oPCAN_RADAR_Tx_cce46d71 if post-build-variant-condition{matching-criterion=RDR_POS, value=3}, ComIPduGroupRef=RDR05_oPCAN_RADAR_Tx_628cfce0 if post-build-variant-condition{matching-criterion=RDR_POS, value=4}, ComIPduGroupRef=RDR06_oPCAN_RADAR_Tx_4b444812 if post-build-variant-condition{matching-criterion=RDR_POS, value=5}, ComIPduGroupRef=RDR07_oPCAN_RADAR_Tx_e52cd983 if post-build-variant-condition{matching-criterion=RDR_POS, value=6}, ComIPduGroupRef=RDR08_oPCAN_RADAR_Tx_6bc6beb9 if post-build-variant-condition{matching-criterion=RDR_POS, value=7}
          ComTxIPdu: ComMinimumDelayTime=0, ComTxIPduUnusedAreasDefault=0
        RDR_TRACKER_OBJ_059_oPCAN_RADAR_f0274656_Tx: ComIPduDirection=SEND, ComIPduChannelRef=ComMConfigSet/CN_PCAN_RADAR_458ff0f1, ComIPduGroupRef=RDR01_oPCAN_RADAR_Tx_b6bdb067 if post-build-variant-condition{matching-criterion=RDR_POS, value=0}, ComIPduSignalGroupRef=SG_TrackerObject059_oRDR_TRACKER_OBJ_059_oPCAN_RADAR_c3790806_Tx, ComPduIdRef=EcucPduCollection/RDR_TRACKER_OBJ_059_oPCAN_RADAR_f0274656_Tx, ComIPduGroupRef=RDR02_oPCAN_RADAR_Tx_9f750495 if post-build-variant-condition{matching-criterion=RDR_POS, value=1}, ComIPduGroupRef=RDR03_oPCAN_RADAR_Tx_311d9504 if post-build-variant-condition{matching-criterion=RDR_POS, value=2}, ComIPduGroupRef=RDR04_oPCAN_RADAR_Tx_cce46d71 if post-build-variant-condition{matching-criterion=RDR_POS, value=3}, ComIPduGroupRef=RDR05_oPCAN_RADAR_Tx_628cfce0 if post-build-variant-condition{matching-criterion=RDR_POS, value=4}, ComIPduGroupRef=RDR06_oPCAN_RADAR_Tx_4b444812 if post-build-variant-condition{matching-criterion=RDR_POS, value=5}, ComIPduGroupRef=RDR07_oPCAN_RADAR_Tx_e52cd983 if post-build-variant-condition{matching-criterion=RDR_POS, value=6}, ComIPduGroupRef=RDR08_oPCAN_RADAR_Tx_6bc6beb9 if post-build-variant-condition{matching-criterion=RDR_POS, value=7}
          ComTxIPdu: ComMinimumDelayTime=0, ComTxIPduUnusedAreasDefault=0
        RDR_TRACKER_OBJ_060_oPCAN_RADAR_0bd36965_Tx: ComIPduDirection=SEND, ComIPduChannelRef=ComMConfigSet/CN_PCAN_RADAR_458ff0f1, ComIPduGroupRef=RDR01_oPCAN_RADAR_Tx_b6bdb067 if post-build-variant-condition{matching-criterion=RDR_POS, value=0}, ComIPduSignalGroupRef=SG_TrackerObject060_oRDR_TRACKER_OBJ_060_oPCAN_RADAR_68bfc7eb_Tx, ComPduIdRef=EcucPduCollection/RDR_TRACKER_OBJ_060_oPCAN_RADAR_0bd36965_Tx, ComIPduGroupRef=RDR02_oPCAN_RADAR_Tx_9f750495 if post-build-variant-condition{matching-criterion=RDR_POS, value=1}, ComIPduGroupRef=RDR03_oPCAN_RADAR_Tx_311d9504 if post-build-variant-condition{matching-criterion=RDR_POS, value=2}, ComIPduGroupRef=RDR04_oPCAN_RADAR_Tx_cce46d71 if post-build-variant-condition{matching-criterion=RDR_POS, value=3}, ComIPduGroupRef=RDR05_oPCAN_RADAR_Tx_628cfce0 if post-build-variant-condition{matching-criterion=RDR_POS, value=4}, ComIPduGroupRef=RDR06_oPCAN_RADAR_Tx_4b444812 if post-build-variant-condition{matching-criterion=RDR_POS, value=5}, ComIPduGroupRef=RDR07_oPCAN_RADAR_Tx_e52cd983 if post-build-variant-condition{matching-criterion=RDR_POS, value=6}, ComIPduGroupRef=RDR08_oPCAN_RADAR_Tx_6bc6beb9 if post-build-variant-condition{matching-criterion=RDR_POS, value=7}
          ComTxIPdu: ComMinimumDelayTime=0, ComTxIPduUnusedAreasDefault=0
        RDR_TRACKER_OBJ_061_oPCAN_RADAR_d645b0e0_Tx: ComIPduDirection=SEND, ComIPduChannelRef=ComMConfigSet/CN_PCAN_RADAR_458ff0f1, ComIPduGroupRef=RDR01_oPCAN_RADAR_Tx_b6bdb067 if post-build-variant-condition{matching-criterion=RDR_POS, value=0}, ComIPduSignalGroupRef=SG_TrackerObject061_oRDR_TRACKER_OBJ_061_oPCAN_RADAR_91ab4f58_Tx, ComPduIdRef=EcucPduCollection/RDR_TRACKER_OBJ_061_oPCAN_RADAR_d645b0e0_Tx, ComIPduGroupRef=RDR02_oPCAN_RADAR_Tx_9f750495 if post-build-variant-condition{matching-criterion=RDR_POS, value=1}, ComIPduGroupRef=RDR03_oPCAN_RADAR_Tx_311d9504 if post-build-variant-condition{matching-criterion=RDR_POS, value=2}, ComIPduGroupRef=RDR04_oPCAN_RADAR_Tx_cce46d71 if post-build-variant-condition{matching-criterion=RDR_POS, value=3}, ComIPduGroupRef=RDR05_oPCAN_RADAR_Tx_628cfce0 if post-build-variant-condition{matching-criterion=RDR_POS, value=4}, ComIPduGroupRef=RDR06_oPCAN_RADAR_Tx_4b444812 if post-build-variant-condition{matching-criterion=RDR_POS, value=5}, ComIPduGroupRef=RDR07_oPCAN_RADAR_Tx_e52cd983 if post-build-variant-condition{matching-criterion=RDR_POS, value=6}, ComIPduGroupRef=RDR08_oPCAN_RADAR_Tx_6bc6beb9 if post-build-variant-condition{matching-criterion=RDR_POS, value=7}
          ComTxIPdu: ComMinimumDelayTime=0, ComTxIPduUnusedAreasDefault=0
        RDR_TRACKER_OBJ_062_oPCAN_RADAR_6b8fdc2e_Tx: ComIPduDirection=SEND, ComIPduChannelRef=ComMConfigSet/CN_PCAN_RADAR_458ff0f1, ComIPduGroupRef=RDR01_oPCAN_RADAR_Tx_b6bdb067 if post-build-variant-condition{matching-criterion=RDR_POS, value=0}, ComIPduSignalGroupRef=SG_TrackerObject062_oRDR_TRACKER_OBJ_062_oPCAN_RADAR_41e7d0cc_Tx, ComPduIdRef=EcucPduCollection/RDR_TRACKER_OBJ_062_oPCAN_RADAR_6b8fdc2e_Tx, ComIPduGroupRef=RDR02_oPCAN_RADAR_Tx_9f750495 if post-build-variant-condition{matching-criterion=RDR_POS, value=1}, ComIPduGroupRef=RDR03_oPCAN_RADAR_Tx_311d9504 if post-build-variant-condition{matching-criterion=RDR_POS, value=2}, ComIPduGroupRef=RDR04_oPCAN_RADAR_Tx_cce46d71 if post-build-variant-condition{matching-criterion=RDR_POS, value=3}, ComIPduGroupRef=RDR05_oPCAN_RADAR_Tx_628cfce0 if post-build-variant-condition{matching-criterion=RDR_POS, value=4}, ComIPduGroupRef=RDR06_oPCAN_RADAR_Tx_4b444812 if post-build-variant-condition{matching-criterion=RDR_POS, value=5}, ComIPduGroupRef=RDR07_oPCAN_RADAR_Tx_e52cd983 if post-build-variant-condition{matching-criterion=RDR_POS, value=6}, ComIPduGroupRef=RDR08_oPCAN_RADAR_Tx_6bc6beb9 if post-build-variant-condition{matching-criterion=RDR_POS, value=7}
          ComTxIPdu: ComMinimumDelayTime=0, ComTxIPduUnusedAreasDefault=0
        RDR_TRACKER_OBJ_063_oPCAN_RADAR_b61905ab_Tx: ComIPduDirection=SEND, ComIPduChannelRef=ComMConfigSet/CN_PCAN_RADAR_458ff0f1, ComIPduGroupRef=RDR01_oPCAN_RADAR_Tx_b6bdb067 if post-build-variant-condition{matching-criterion=RDR_POS, value=0}, ComIPduSignalGroupRef=SG_TrackerObject063_oRDR_TRACKER_OBJ_063_oPCAN_RADAR_b8f3587f_Tx, ComPduIdRef=EcucPduCollection/RDR_TRACKER_OBJ_063_oPCAN_RADAR_b61905ab_Tx, ComIPduGroupRef=RDR02_oPCAN_RADAR_Tx_9f750495 if post-build-variant-condition{matching-criterion=RDR_POS, value=1}, ComIPduGroupRef=RDR03_oPCAN_RADAR_Tx_311d9504 if post-build-variant-condition{matching-criterion=RDR_POS, value=2}, ComIPduGroupRef=RDR04_oPCAN_RADAR_Tx_cce46d71 if post-build-variant-condition{matching-criterion=RDR_POS, value=3}, ComIPduGroupRef=RDR05_oPCAN_RADAR_Tx_628cfce0 if post-build-variant-condition{matching-criterion=RDR_POS, value=4}, ComIPduGroupRef=RDR06_oPCAN_RADAR_Tx_4b444812 if post-build-variant-condition{matching-criterion=RDR_POS, value=5}, ComIPduGroupRef=RDR07_oPCAN_RADAR_Tx_e52cd983 if post-build-variant-condition{matching-criterion=RDR_POS, value=6}, ComIPduGroupRef=RDR08_oPCAN_RADAR_Tx_6bc6beb9 if post-build-variant-condition{matching-criterion=RDR_POS, value=7}
          ComTxIPdu: ComMinimumDelayTime=0, ComTxIPduUnusedAreasDefault=0
        RDR_TRACKER_OBJ_064_oPCAN_RADAR_cb6a03f3_Tx: ComIPduDirection=SEND, ComIPduChannelRef=ComMConfigSet/CN_PCAN_RADAR_458ff0f1, ComIPduGroupRef=RDR01_oPCAN_RADAR_Tx_b6bdb067 if post-build-variant-condition{matching-criterion=RDR_POS, value=0}, ComIPduSignalGroupRef=SG_TrackerObject064_oRDR_TRACKER_OBJ_064_oPCAN_RADAR_3a0fe9a5_Tx, ComPduIdRef=EcucPduCollection/RDR_TRACKER_OBJ_064_oPCAN_RADAR_cb6a03f3_Tx, ComIPduGroupRef=RDR02_oPCAN_RADAR_Tx_9f750495 if post-build-variant-condition{matching-criterion=RDR_POS, value=1}, ComIPduGroupRef=RDR03_oPCAN_RADAR_Tx_311d9504 if post-build-variant-condition{matching-criterion=RDR_POS, value=2}, ComIPduGroupRef=RDR04_oPCAN_RADAR_Tx_cce46d71 if post-build-variant-condition{matching-criterion=RDR_POS, value=3}, ComIPduGroupRef=RDR05_oPCAN_RADAR_Tx_628cfce0 if post-build-variant-condition{matching-criterion=RDR_POS, value=4}, ComIPduGroupRef=RDR06_oPCAN_RADAR_Tx_4b444812 if post-build-variant-condition{matching-criterion=RDR_POS, value=5}, ComIPduGroupRef=RDR07_oPCAN_RADAR_Tx_e52cd983 if post-build-variant-condition{matching-criterion=RDR_POS, value=6}, ComIPduGroupRef=RDR08_oPCAN_RADAR_Tx_6bc6beb9 if post-build-variant-condition{matching-criterion=RDR_POS, value=7}
          ComTxIPdu: ComMinimumDelayTime=0, ComTxIPduUnusedAreasDefault=0
        RDR_XCP_CTO_REQ_oPCAN_RADAR_52b29e1b_Rx: ComIPduDirection=RECEIVE, ComIPduChannelRef=ComMConfigSet/CN_PCAN_RADAR_458ff0f1, ComIPduGroupRef=RDR01_oPCAN_RADAR_Rx_e0e717e1 if post-build-variant-condition{matching-criterion=RDR_POS, value=0}, ComIPduSignalGroupRef=SG_XcpCTOReq_oRDR_XCP_CTO_REQ_oPCAN_RADAR_95c22ef5_Rx, ComPduIdRef=EcucPduCollection/RDR_XCP_CTO_REQ_oPCAN_RADAR_52b29e1b_Rx, ComIPduGroupRef=RDR02_oPCAN_RADAR_Rx_c92fa313 if post-build-variant-condition{matching-criterion=RDR_POS, value=1}, ComIPduGroupRef=RDR03_oPCAN_RADAR_Rx_67473282 if post-build-variant-condition{matching-criterion=RDR_POS, value=2}, ComIPduGroupRef=RDR04_oPCAN_RADAR_Rx_9abecaf7 if post-build-variant-condition{matching-criterion=RDR_POS, value=3}, ComIPduGroupRef=RDR05_oPCAN_RADAR_Rx_34d65b66 if post-build-variant-condition{matching-criterion=RDR_POS, value=4}, ComIPduGroupRef=RDR06_oPCAN_RADAR_Rx_1d1eef94 if post-build-variant-condition{matching-criterion=RDR_POS, value=5}, ComIPduGroupRef=RDR07_oPCAN_RADAR_Rx_b3767e05 if post-build-variant-condition{matching-criterion=RDR_POS, value=6}, ComIPduGroupRef=RDR08_oPCAN_RADAR_Rx_3d9c193f if post-build-variant-condition{matching-criterion=RDR_POS, value=7}
        RDR_XCP_CTO_RESP_oPCAN_RADAR_8537261d_Tx: ComIPduDirection=SEND, ComIPduChannelRef=ComMConfigSet/CN_PCAN_RADAR_458ff0f1, ComIPduGroupRef=RDR01_oPCAN_RADAR_Tx_b6bdb067 if post-build-variant-condition{matching-criterion=RDR_POS, value=0}, ComIPduSignalGroupRef=SG_XcpCTOResp_oRDR_XCP_CTO_RESP_oPCAN_RADAR_b0b06e8a_Tx, ComPduIdRef=EcucPduCollection/RDR_XCP_CTO_RESP_oPCAN_RADAR_8537261d_Tx, ComIPduGroupRef=RDR02_oPCAN_RADAR_Tx_9f750495 if post-build-variant-condition{matching-criterion=RDR_POS, value=1}, ComIPduGroupRef=RDR03_oPCAN_RADAR_Tx_311d9504 if post-build-variant-condition{matching-criterion=RDR_POS, value=2}, ComIPduGroupRef=RDR04_oPCAN_RADAR_Tx_cce46d71 if post-build-variant-condition{matching-criterion=RDR_POS, value=3}, ComIPduGroupRef=RDR05_oPCAN_RADAR_Tx_628cfce0 if post-build-variant-condition{matching-criterion=RDR_POS, value=4}, ComIPduGroupRef=RDR06_oPCAN_RADAR_Tx_4b444812 if post-build-variant-condition{matching-criterion=RDR_POS, value=5}, ComIPduGroupRef=RDR07_oPCAN_RADAR_Tx_e52cd983 if post-build-variant-condition{matching-criterion=RDR_POS, value=6}, ComIPduGroupRef=RDR08_oPCAN_RADAR_Tx_6bc6beb9 if post-build-variant-condition{matching-criterion=RDR_POS, value=7}
          ComTxIPdu: ComMinimumDelayTime=0, ComTxIPduUnusedAreasDefault=0
        RDR_XCP_DAQ_RESP_oPCAN_RADAR_7e3578af_Tx: ComIPduDirection=SEND, ComIPduChannelRef=ComMConfigSet/CN_PCAN_RADAR_458ff0f1, ComIPduGroupRef=RDR01_oPCAN_RADAR_Tx_b6bdb067 if post-build-variant-condition{matching-criterion=RDR_POS, value=0}, ComIPduSignalGroupRef=SG_XcpDAQResp_oRDR_XCP_DAQ_RESP_oPCAN_RADAR_7a892884_Tx, ComPduIdRef=EcucPduCollection/RDR_XCP_DAQ_RESP_oPCAN_RADAR_7e3578af_Tx, ComIPduGroupRef=RDR02_oPCAN_RADAR_Tx_9f750495 if post-build-variant-condition{matching-criterion=RDR_POS, value=1}, ComIPduGroupRef=RDR03_oPCAN_RADAR_Tx_311d9504 if post-build-variant-condition{matching-criterion=RDR_POS, value=2}, ComIPduGroupRef=RDR04_oPCAN_RADAR_Tx_cce46d71 if post-build-variant-condition{matching-criterion=RDR_POS, value=3}, ComIPduGroupRef=RDR05_oPCAN_RADAR_Tx_628cfce0 if post-build-variant-condition{matching-criterion=RDR_POS, value=4}, ComIPduGroupRef=RDR06_oPCAN_RADAR_Tx_4b444812 if post-build-variant-condition{matching-criterion=RDR_POS, value=5}, ComIPduGroupRef=RDR07_oPCAN_RADAR_Tx_e52cd983 if post-build-variant-condition{matching-criterion=RDR_POS, value=6}, ComIPduGroupRef=RDR08_oPCAN_RADAR_Tx_6bc6beb9 if post-build-variant-condition{matching-criterion=RDR_POS, value=7}
          ComTxIPdu: ComMinimumDelayTime=0, ComTxIPduUnusedAreasDefault=0
        SAS_oVCAN_RADAR_fe45d49a_Rx: ComIPduDirection=RECEIVE, ComIPduChannelRef=ComMConfigSet/CN_VCAN_RADAR_489180b6, ComIPduGroupRef=RDR01_oVCAN_RADAR_Rx_BC_7567adec if post-build-variant-condition{matching-criterion=RDR_POS, value=0}, ComIPduSignalGroupRef=SG_SAS_oSAS_oVCAN_RADAR_c902864e_Rx, ComPduIdRef=EcucPduCollection/SAS_oVCAN_RADAR_fe45d49a_Rx, ComIPduGroupRef=RDR02_oVCAN_RADAR_Rx_BC_d6312b45 if post-build-variant-condition{matching-criterion=RDR_POS, value=1}, ComIPduGroupRef=RDR03_oVCAN_RADAR_Rx_BC_01d3ab1d if post-build-variant-condition{matching-criterion=RDR_POS, value=2}, ComIPduGroupRef=RDR04_oVCAN_RADAR_Rx_BC_4bed2056 if post-build-variant-condition{matching-criterion=RDR_POS, value=3}, ComIPduGroupRef=RDR05_oVCAN_RADAR_Rx_BC_9c0fa00e if post-build-variant-condition{matching-criterion=RDR_POS, value=4}, ComIPduGroupRef=RDR06_oVCAN_RADAR_Rx_BC_3f5926a7 if post-build-variant-condition{matching-criterion=RDR_POS, value=5}, ComIPduGroupRef=RDR07_oVCAN_RADAR_Rx_BC_e8bba6ff if post-build-variant-condition{matching-criterion=RDR_POS, value=6}, ComIPduGroupRef=RDR08_oVCAN_RADAR_Rx_BC_ab243031 if post-build-variant-condition{matching-criterion=RDR_POS, value=7}
        SYS_TIME_SYNC_Mx20_oPCAN_RADAR_7e798636_Rx: ComIPduDirection=RECEIVE, ComIPduChannelRef=ComMConfigSet/CN_PCAN_RADAR_458ff0f1, ComIPduGroupRef=RDR01_oPCAN_RADAR_Rx_e0e717e1, ComIPduSignalRef=ComConfig/TSYN_PDU_Mx20_oSYS_TIME_SYNC_oPCAN_RADAR_e2fd289b_Rx, ComIPduSignalRef=ComConfig/TSYN_SYNCTIME_SEC_Mx20_oSYS_TIME_SYNC_oPCAN_RADAR_eefbe385_Rx, ComIPduSignalRef=ComConfig/TSYN_USERBYTE_Mx20_oSYS_TIME_SYNC_oPCAN_RADAR_0d5c8681_Rx, ComPduIdRef=EcucPduCollection/SYS_TIME_SYNC_Mx20_oPCAN_RADAR_7e798636_Rx, variation-point=post-build-variant-condition{matching-criterion=RDR_POS, value=0}
        SYS_TIME_SYNC_Mx28_oPCAN_RADAR_247a555b_Rx: ComIPduDirection=RECEIVE, ComIPduChannelRef=ComMConfigSet/CN_PCAN_RADAR_458ff0f1, ComIPduGroupRef=RDR01_oPCAN_RADAR_Rx_e0e717e1, ComIPduSignalRef=ComConfig/TSYN_OVS_Mx28_oSYS_TIME_SYNC_oPCAN_RADAR_b3399163_Rx, ComIPduSignalRef=ComConfig/TSYN_PDU_Mx28_oSYS_TIME_SYNC_oPCAN_RADAR_ef52c073_Rx, ComIPduSignalRef=ComConfig/TSYN_RESERVED_Mx28_oSYS_TIME_SYNC_oPCAN_RADAR_d2d8bdda_Rx, ComIPduSignalRef=ComConfig/TSYN_SGW_Mx28_oSYS_TIME_SYNC_oPCAN_RADAR_64e22cd6_Rx, ComIPduSignalRef=ComConfig/TSYN_SYNCTIME_NANOSEC_Mx28_oSYS_TIME_SYNC_oPCAN_RADAR_4ec44b38_Rx, ComPduIdRef=EcucPduCollection/SYS_TIME_SYNC_Mx28_oPCAN_RADAR_247a555b_Rx, variation-point=post-build-variant-condition{matching-criterion=RDR_POS, value=0}
        SYS_TIME_SYNC_Mx_oPCAN_RADAR_91ffd000_Rx: ComIPduDirection=RECEIVE, ComIPduChannelRef=ComMConfigSet/CN_PCAN_RADAR_458ff0f1, ComIPduGroupRef=RDR01_oPCAN_RADAR_Rx_e0e717e1, ComIPduSignalRef=ComConfig/TSYNC_CRC_Mx_oSYS_TIME_SYNC_oPCAN_RADAR_860ba5d2_Rx, ComIPduSignalRef=ComConfig/TSYN_SEQUENCE_COUNTER_Mx_oSYS_TIME_SYNC_oPCAN_RADAR_b1c17f84_Rx, ComIPduSignalRef=ComConfig/TSYN_TIMEDOMAIN_Mx_oSYS_TIME_SYNC_oPCAN_RADAR_924f2426_Rx, ComPduIdRef=EcucPduCollection/SYS_TIME_SYNC_Mx_oPCAN_RADAR_91ffd000_Rx, variation-point=post-build-variant-condition{matching-criterion=RDR_POS, value=0}
        SYS_VEHICLE_STATUS_oPCAN_RADAR_43e5dd0e_Rx: ComIPduDirection=RECEIVE, ComIPduChannelRef=ComMConfigSet/CN_PCAN_RADAR_458ff0f1, ComIPduGroupRef=RDR01_oPCAN_RADAR_Rx_e0e717e1 if post-build-variant-condition{matching-criterion=RDR_POS, value=0}, ComIPduSignalGroupRef=SG_VehicleStatus_oSYS_VEHICLE_STATUS_oPCAN_RADAR_0411a809_Rx, ComPduIdRef=EcucPduCollection/SYS_VEHICLE_STATUS_oPCAN_RADAR_43e5dd0e_Rx, ComIPduGroupRef=RDR02_oPCAN_RADAR_Rx_c92fa313 if post-build-variant-condition{matching-criterion=RDR_POS, value=1}, ComIPduGroupRef=RDR03_oPCAN_RADAR_Rx_67473282 if post-build-variant-condition{matching-criterion=RDR_POS, value=2}, ComIPduGroupRef=RDR04_oPCAN_RADAR_Rx_9abecaf7 if post-build-variant-condition{matching-criterion=RDR_POS, value=3}, ComIPduGroupRef=RDR05_oPCAN_RADAR_Rx_34d65b66 if post-build-variant-condition{matching-criterion=RDR_POS, value=4}, ComIPduGroupRef=RDR06_oPCAN_RADAR_Rx_1d1eef94 if post-build-variant-condition{matching-criterion=RDR_POS, value=5}, ComIPduGroupRef=RDR07_oPCAN_RADAR_Rx_b3767e05 if post-build-variant-condition{matching-criterion=RDR_POS, value=6}, ComIPduGroupRef=RDR08_oPCAN_RADAR_Rx_3d9c193f if post-build-variant-condition{matching-criterion=RDR_POS, value=7}
        TD_oVCAN_RADAR_804fc074_Rx: ComIPduDirection=RECEIVE, ComIPduChannelRef=ComMConfigSet/CN_VCAN_RADAR_489180b6, ComIPduGroupRef=RDR01_oVCAN_RADAR_Rx_BC_7567adec if post-build-variant-condition{matching-criterion=RDR_POS, value=0}, ComIPduSignalGroupRef=SG_TD_oTD_oVCAN_RADAR_c3698ded_Rx, ComPduIdRef=EcucPduCollection/TD_oVCAN_RADAR_804fc074_Rx, ComIPduGroupRef=RDR02_oVCAN_RADAR_Rx_BC_d6312b45 if post-build-variant-condition{matching-criterion=RDR_POS, value=1}, ComIPduGroupRef=RDR03_oVCAN_RADAR_Rx_BC_01d3ab1d if post-build-variant-condition{matching-criterion=RDR_POS, value=2}, ComIPduGroupRef=RDR04_oVCAN_RADAR_Rx_BC_4bed2056 if post-build-variant-condition{matching-criterion=RDR_POS, value=3}, ComIPduGroupRef=RDR05_oVCAN_RADAR_Rx_BC_9c0fa00e if post-build-variant-condition{matching-criterion=RDR_POS, value=4}, ComIPduGroupRef=RDR06_oVCAN_RADAR_Rx_BC_3f5926a7 if post-build-variant-condition{matching-criterion=RDR_POS, value=5}, ComIPduGroupRef=RDR07_oVCAN_RADAR_Rx_BC_e8bba6ff if post-build-variant-condition{matching-criterion=RDR_POS, value=6}, ComIPduGroupRef=RDR08_oVCAN_RADAR_Rx_BC_ab243031 if post-build-variant-condition{matching-criterion=RDR_POS, value=7}
        VDC2_oVCAN_RADAR_5a222cac_Rx: ComIPduDirection=RECEIVE, ComIPduChannelRef=ComMConfigSet/CN_VCAN_RADAR_489180b6, ComIPduGroupRef=RDR01_oVCAN_RADAR_Rx_BC_7567adec if post-build-variant-condition{matching-criterion=RDR_POS, value=0}, ComIPduSignalGroupRef=SG_VDC2_oVDC2_oVCAN_RADAR_06eddadd_Rx, ComPduIdRef=EcucPduCollection/VDC2_oVCAN_RADAR_5a222cac_Rx, ComIPduGroupRef=RDR02_oVCAN_RADAR_Rx_BC_d6312b45 if post-build-variant-condition{matching-criterion=RDR_POS, value=1}, ComIPduGroupRef=RDR03_oVCAN_RADAR_Rx_BC_01d3ab1d if post-build-variant-condition{matching-criterion=RDR_POS, value=2}, ComIPduGroupRef=RDR04_oVCAN_RADAR_Rx_BC_4bed2056 if post-build-variant-condition{matching-criterion=RDR_POS, value=3}, ComIPduGroupRef=RDR05_oVCAN_RADAR_Rx_BC_9c0fa00e if post-build-variant-condition{matching-criterion=RDR_POS, value=4}, ComIPduGroupRef=RDR06_oVCAN_RADAR_Rx_BC_3f5926a7 if post-build-variant-condition{matching-criterion=RDR_POS, value=5}, ComIPduGroupRef=RDR07_oVCAN_RADAR_Rx_BC_e8bba6ff if post-build-variant-condition{matching-criterion=RDR_POS, value=6}, ComIPduGroupRef=RDR08_oVCAN_RADAR_Rx_BC_ab243031 if post-build-variant-condition{matching-criterion=RDR_POS, value=7}
        VD_oVCAN_RADAR_612104d9_Rx: ComIPduDirection=RECEIVE, ComIPduChannelRef=ComMConfigSet/CN_VCAN_RADAR_489180b6, ComIPduGroupRef=RDR01_oVCAN_RADAR_Rx_BC_7567adec if post-build-variant-condition{matching-criterion=RDR_POS, value=0}, ComIPduSignalGroupRef=SG_VD_oVD_oVCAN_RADAR_27d322c3_Rx, ComPduIdRef=EcucPduCollection/VD_oVCAN_RADAR_612104d9_Rx, ComIPduGroupRef=RDR02_oVCAN_RADAR_Rx_BC_d6312b45 if post-build-variant-condition{matching-criterion=RDR_POS, value=1}, ComIPduGroupRef=RDR03_oVCAN_RADAR_Rx_BC_01d3ab1d if post-build-variant-condition{matching-criterion=RDR_POS, value=2}, ComIPduGroupRef=RDR04_oVCAN_RADAR_Rx_BC_4bed2056 if post-build-variant-condition{matching-criterion=RDR_POS, value=3}, ComIPduGroupRef=RDR05_oVCAN_RADAR_Rx_BC_9c0fa00e if post-build-variant-condition{matching-criterion=RDR_POS, value=4}, ComIPduGroupRef=RDR06_oVCAN_RADAR_Rx_BC_3f5926a7 if post-build-variant-condition{matching-criterion=RDR_POS, value=5}, ComIPduGroupRef=RDR07_oVCAN_RADAR_Rx_BC_e8bba6ff if post-build-variant-condition{matching-criterion=RDR_POS, value=6}, ComIPduGroupRef=RDR08_oVCAN_RADAR_Rx_BC_ab243031 if post-build-variant-condition{matching-criterion=RDR_POS, value=7}
        VI_oVCAN_RADAR_260d64a7_Rx: ComIPduDirection=RECEIVE, ComIPduChannelRef=ComMConfigSet/CN_VCAN_RADAR_489180b6, ComIPduGroupRef=RDR01_oVCAN_RADAR_Rx_BC_7567adec if post-build-variant-condition{matching-criterion=RDR_POS, value=0}, ComIPduSignalGroupRef=SG_VI_oVI_oVCAN_RADAR_7241e1af_Rx, ComPduIdRef=EcucPduCollection/VI_oVCAN_RADAR_260d64a7_Rx, ComIPduGroupRef=RDR02_oVCAN_RADAR_Rx_BC_d6312b45 if post-build-variant-condition{matching-criterion=RDR_POS, value=1}, ComIPduGroupRef=RDR03_oVCAN_RADAR_Rx_BC_01d3ab1d if post-build-variant-condition{matching-criterion=RDR_POS, value=2}, ComIPduGroupRef=RDR04_oVCAN_RADAR_Rx_BC_4bed2056 if post-build-variant-condition{matching-criterion=RDR_POS, value=3}, ComIPduGroupRef=RDR05_oVCAN_RADAR_Rx_BC_9c0fa00e if post-build-variant-condition{matching-criterion=RDR_POS, value=4}, ComIPduGroupRef=RDR06_oVCAN_RADAR_Rx_BC_3f5926a7 if post-build-variant-condition{matching-criterion=RDR_POS, value=5}, ComIPduGroupRef=RDR07_oVCAN_RADAR_Rx_BC_e8bba6ff if post-build-variant-condition{matching-criterion=RDR_POS, value=6}, ComIPduGroupRef=RDR08_oVCAN_RADAR_Rx_BC_ab243031 if post-build-variant-condition{matching-criterion=RDR_POS, value=7}
        prop_ADAS_MOIS_info_oVCAN_RADAR_f03aed28_Tx: ComIPduDirection=SEND, ComIPduChannelRef=ComMConfigSet/CN_VCAN_RADAR_489180b6, ComIPduGroupRef=RDR01_oVCAN_RADAR_Tx_0xD0_2361e9dc if post-build-variant-condition{matching-criterion=RDR_POS, value=0}, ComIPduSignalGroupRef=SG_prop_ADAS_MOIS_info_oprop_ADAS_MOIS_info_oVCAN_RADAR_cb191e50_Tx, ComPduIdRef=EcucPduCollection/prop_ADAS_MOIS_info_oVCAN_RADAR_f03aed28_Tx, ComIPduGroupRef=RDR02_oVCAN_RADAR_Tx_0xD0_587f6b3f if post-build-variant-condition{matching-criterion=RDR_POS, value=1}, ComIPduGroupRef=RDR03_oVCAN_RADAR_Tx_0xD0_c7a5e8a1 if post-build-variant-condition{matching-criterion=RDR_POS, value=2}, ComIPduGroupRef=RDR04_oVCAN_RADAR_Tx_0xD0_ae426ef9 if post-build-variant-condition{matching-criterion=RDR_POS, value=3}, ComIPduGroupRef=RDR05_oVCAN_RADAR_Tx_0xD0_3198ed67 if post-build-variant-condition{matching-criterion=RDR_POS, value=4}, ComIPduGroupRef=RDR06_oVCAN_RADAR_Tx_0xD0_4a866f84 if post-build-variant-condition{matching-criterion=RDR_POS, value=5}, ComIPduGroupRef=RDR07_oVCAN_RADAR_Tx_0xD0_d55cec1a if post-build-variant-condition{matching-criterion=RDR_POS, value=6}, ComIPduGroupRef=RDR08_oVCAN_RADAR_Tx_0xD0_99496334 if post-build-variant-condition{matching-criterion=RDR_POS, value=7}
          ComTxIPdu: ComMinimumDelayTime=0, ComTxIPduUnusedAreasDefault=255
            ComTxModeFalse
              ComTxMode: ComTxModeMode=PERIODIC, ComTxModeTimeOffset=0, ComTxModeTimePeriod=1
            ComTxModeTrue
              ComTxMode: ComTxModeMode=PERIODIC, ComTxModeTimeOffset=0, ComTxModeTimePeriod=1
      4 x ComIPduGroup, all with variation-point=post-build-variant-condition{matching-criterion=RDR_POS, value=0}:
        RDR01_oPCAN_RADAR_Rx_e0e717e1
        RDR01_oPCAN_RADAR_Tx_b6bdb067
        RDR01_oVCAN_RADAR_Rx_BC_7567adec
        RDR01_oVCAN_RADAR_Tx_0xD0_2361e9dc
      25 x ComSignal, all with ComSignalEndianness=BIG_ENDIAN:
        RDR_NM_CAN_NM_State_oRDR_NM_oPCAN_RADAR_1bab6607_Tx: ComBitPosition=31, ComBitSize=8, ComSignalInitValue=0, ComSignalType=UINT8, ComTransferProperty=PENDING, ComSystemTemplateSystemSignalRef=RDR_NM_CAN_NM_State
        RDR_NM_CBV_ActWakeBit_4_oRDR_NM_oPCAN_RADAR_0227ef40_Tx: ComBitPosition=12, ComBitSize=1, ComSignalInitValue=0, ComSignalType=BOOLEAN, ComTransferProperty=PENDING, ComSystemTemplateSystemSignalRef=RDR_NM_CBV_ActWakeBit_4
        RDR_NM_CBV_NMCoordBit_3_oRDR_NM_oPCAN_RADAR_a134f8ab_Tx: ComBitPosition=11, ComBitSize=1, ComSignalInitValue=0, ComSignalType=BOOLEAN, ComTransferProperty=PENDING, ComSystemTemplateSystemSignalRef=RDR_NM_CBV_NMCoordBit_3
        RDR_NM_CBV_PNIBit_6_oRDR_NM_oPCAN_RADAR_9b76e7e6_Tx: ComBitPosition=14, ComBitSize=1, ComSignalInitValue=0, ComSignalType=BOOLEAN, ComTransferProperty=PENDING, ComSystemTemplateSystemSignalRef=RDR_NM_CBV_PNIBit_6
        RDR_NM_CBV_ReptMsgBit0_oRDR_NM_oPCAN_RADAR_e7779b42_Tx: ComBitPosition=8, ComBitSize=1, ComSignalInitValue=0, ComSignalType=BOOLEAN, ComTransferProperty=PENDING, ComSystemTemplateSystemSignalRef=RDR_NM_CBV_ReptMsgBit0
        RDR_NM_CBV_ResdBit_1_oRDR_NM_oPCAN_RADAR_c2cd19c3_Tx: ComBitPosition=9, ComBitSize=1, ComSignalInitValue=0, ComSignalType=BOOLEAN, ComTransferProperty=PENDING, ComSystemTemplateSystemSignalRef=RDR_NM_CBV_ResdBit_1
        RDR_NM_CBV_ResdBit_2_oRDR_NM_oPCAN_RADAR_b9d39b20_Tx: ComBitPosition=10, ComBitSize=1, ComSignalInitValue=0, ComSignalType=BOOLEAN, ComTransferProperty=PENDING, ComSystemTemplateSystemSignalRef=RDR_NM_CBV_ResdBit_2
        RDR_NM_CBV_ResdBit_5_oRDR_NM_oPCAN_RADAR_d0341d78_Tx: ComBitPosition=13, ComBitSize=1, ComSignalInitValue=0, ComSignalType=BOOLEAN, ComTransferProperty=PENDING, ComSystemTemplateSystemSignalRef=RDR_NM_CBV_ResdBit_5
        RDR_NM_CBV_ResdBit_7_oRDR_NM_oPCAN_RADAR_34f01c05_Tx: ComBitPosition=15, ComBitSize=1, ComSignalInitValue=0, ComSignalType=BOOLEAN, ComTransferProperty=PENDING, ComSystemTemplateSystemSignalRef=RDR_NM_CBV_ResdBit_7
        RDR_NM_PNC_Reserved1_oRDR_NM_oPCAN_RADAR_a181c714_Tx: ComBitPosition=47, ComBitSize=8, ComSignalInitValue=0, ComSignalType=UINT8, ComTransferProperty=PENDING, ComSystemTemplateSystemSignalRef=RDR_NM_PNC_Reserved1
        RDR_NM_PNC_Reserved2_oRDR_NM_oPCAN_RADAR_da9f45f7_Tx: ComBitPosition=55, ComBitSize=8, ComSignalInitValue=0, ComSignalType=UINT8, ComTransferProperty=PENDING, ComSystemTemplateSystemSignalRef=RDR_NM_PNC_Reserved2
        RDR_NM_PNC_Reserved3_oRDR_NM_oPCAN_RADAR_4545c669_Tx: ComBitPosition=63, ComBitSize=8, ComSignalInitValue=0, ComSignalType=UINT8, ComTransferProperty=PENDING, ComSystemTemplateSystemSignalRef=RDR_NM_PNC_Reserved3
        RDR_NM_PN_User_Data_oRDR_NM_oPCAN_RADAR_befb962b_Tx: ComBitPosition=23, ComBitSize=8, ComSignalInitValue=0, ComSignalType=UINT8, ComTransferProperty=PENDING, ComSystemTemplateSystemSignalRef=RDR_NM_PN_User_Data
        RDR_NM_Wakeup_And_Reason_oRDR_NM_oPCAN_RADAR_bb9c29d2_Tx: ComBitPosition=39, ComBitSize=8, ComSignalInitValue=0, ComSignalType=UINT8, ComTransferProperty=PENDING, ComSystemTemplateSystemSignalRef=RDR_NM_Wakeup_And_Reason
        TSYNC_CRC_Mx_oSYS_TIME_SYNC_oPCAN_RADAR_860ba5d2_Rx: ComBitPosition=15, ComBitSize=8, ComSignalInitValue=0, ComSignalType=UINT8, ComTimeout=0, ComSystemTemplateSystemSignalRef=TSYNC_CRC, variation-point=post-build-variant-condition{matching-criterion=RDR_POS, value=0}
        TSYN_OVS_Mx28_oSYS_TIME_SYNC_oPCAN_RADAR_b3399163_Rx: ComBitPosition=25, ComBitSize=2, ComSignalInitValue=0, ComSignalType=UINT8, ComTimeout=0, ComSystemTemplateSystemSignalRef=TSYN_OVS, variation-point=post-build-variant-condition{matching-criterion=RDR_POS, value=0}
        TSYN_PDU_Mx20_oSYS_TIME_SYNC_oPCAN_RADAR_e2fd289b_Rx: ComBitPosition=7, ComBitSize=8, ComSignalInitValue=32, ComSignalType=UINT8, ComTimeout=0, ComSystemTemplateSystemSignalRef=TSYN_PDU, variation-point=post-build-variant-condition{matching-criterion=RDR_POS, value=0}
        TSYN_PDU_Mx28_oSYS_TIME_SYNC_oPCAN_RADAR_ef52c073_Rx: ComBitPosition=7, ComBitSize=8, ComSignalInitValue=40, ComSignalType=UINT8, ComTimeout=0, ComSystemTemplateSystemSignalRef=TSYN_PDU, variation-point=post-build-variant-condition{matching-criterion=RDR_POS, value=0}
        TSYN_RESERVED_Mx28_oSYS_TIME_SYNC_oPCAN_RADAR_d2d8bdda_Rx: ComBitPosition=31, ComBitSize=5, ComSignalInitValue=0, ComSignalType=UINT8, ComTimeout=0, ComSystemTemplateSystemSignalRef=TSYN_RESERVED, variation-point=post-build-variant-condition{matching-criterion=RDR_POS, value=0}
        TSYN_SEQUENCE_COUNTER_Mx_oSYS_TIME_SYNC_oPCAN_RADAR_b1c17f84_Rx: ComBitPosition=19, ComBitSize=4, ComSignalInitValue=0, ComSignalType=UINT8, ComTimeout=0, ComSystemTemplateSystemSignalRef=TSYN_SEQUENCE_COUNTER, variation-point=post-build-variant-condition{matching-criterion=RDR_POS, value=0}
        TSYN_SGW_Mx28_oSYS_TIME_SYNC_oPCAN_RADAR_64e22cd6_Rx: ComBitPosition=26, ComBitSize=1, ComSignalInitValue=0, ComSignalType=BOOLEAN, ComTimeout=0, ComSystemTemplateSystemSignalRef=TSYN_SGW, variation-point=post-build-variant-condition{matching-criterion=RDR_POS, value=0}
        TSYN_SYNCTIME_NANOSEC_Mx28_oSYS_TIME_SYNC_oPCAN_RADAR_4ec44b38_Rx: ComBitPosition=39, ComBitSize=32, ComSignalInitValue=0, ComSignalType=UINT32, ComTimeout=0, ComSystemTemplateSystemSignalRef=TSYN_SYNCTIME_NANOSEC, variation-point=post-build-variant-condition{matching-criterion=RDR_POS, value=0}
        TSYN_SYNCTIME_SEC_Mx20_oSYS_TIME_SYNC_oPCAN_RADAR_eefbe385_Rx: ComBitPosition=39, ComBitSize=32, ComSignalInitValue=0, ComSignalType=UINT32, ComTimeout=0, ComSystemTemplateSystemSignalRef=TSYN_SYNCTIME_SEC, variation-point=post-build-variant-condition{matching-criterion=RDR_POS, value=0}
        TSYN_TIMEDOMAIN_Mx_oSYS_TIME_SYNC_oPCAN_RADAR_924f2426_Rx: ComBitPosition=23, ComBitSize=4, ComSignalInitValue=0, ComSignalType=UINT8, ComTimeout=0, ComSystemTemplateSystemSignalRef=TSYN_TIMEDOMAIN, variation-point=post-build-variant-condition{matching-criterion=RDR_POS, value=0}
        TSYN_USERBYTE_Mx20_oSYS_TIME_SYNC_oPCAN_RADAR_0d5c8681_Rx: ComBitPosition=31, ComBitSize=8, ComSignalInitValue=0, ComSignalType=UINT8, ComTimeout=0, ComSystemTemplateSystemSignalRef=TSYN_USERBYTE, variation-point=post-build-variant-condition{matching-criterion=RDR_POS, value=0}
      242 x ComSignalGroup, all with ComTransferProperty=PENDING:
        SG_ADAS_FN_Enable_disable_sts_oADAS_FN_Enable_disable_sts_oVCAN_RADAR_46faeb96_Rx: ComSystemTemplateSignalGroupRef=SG_ADAS_FN_Enable_disable_sts
          4 x ComGroupSignal, all with ComSignalEndianness=LITTLE_ENDIAN, ComSignalInitValue=0, ComSignalType=UINT8:
            BSIS_Fn_Switch_Sts_oADAS_FN_Enable_disable_sts_oVCAN_RADAR_8602f31d_Rx: ComBitPosition=3, ComBitSize=3, ComSystemTemplateSystemSignalRef=BSIS_Fn_Switch_Sts
            MOIS_Fn_Switch_sts_oADAS_FN_Enable_disable_sts_oVCAN_RADAR_ebefa562_Rx: ComBitPosition=0, ComBitSize=3, ComSystemTemplateSystemSignalRef=MOIS_Fn_Switch_sts
            MessageAliveCounter_oADAS_FN_Enable_disable_sts_oVCAN_RADAR_2a6971aa_Rx: ComBitPosition=52, ComBitSize=4, ComSystemTemplateSystemSignalRef=MessageAliveCounter
            MessageCRC_oADAS_FN_Enable_disable_sts_oVCAN_RADAR_332c8084_Rx: ComBitPosition=56, ComBitSize=8, ComSystemTemplateSystemSignalRef=MessageCRC
        SG_AlignmentStatus1_oRDR_ALIGNMENT_STATUS_001_oPCAN_RADAR_7714a623_Tx: ComSignalGroupArrayAccess=true, ComSystemTemplateSignalGroupRef=SG_AlignmentStatus1
          42 x ComGroupSignal, all with ComSignalEndianness=LITTLE_ENDIAN, ComTransferProperty=PENDING:
            AL_STS_001_CYCLE_COUNTER_oRDR_ALIGNMENT_STATUS_001_oPCAN_RADAR_92b2855f_Tx: ComBitPosition=16, ComBitSize=8, ComSignalInitValue=0, ComSignalType=UINT8, ComSystemTemplateSystemSignalRef=AL_STS_001_CYCLE_COUNTER
            AL_STS_001_MH_CRC16_oRDR_ALIGNMENT_STATUS_001_oPCAN_RADAR_065b6dda_Tx: ComBitPosition=0, ComBitSize=16, ComSignalInitValue=0, ComSignalType=UINT16, ComSystemTemplateSystemSignalRef=AL_STS_001_MH_CRC16
            STS_AAAzimuthStd_oRDR_ALIGNMENT_STATUS_001_oPCAN_RADAR_226582e8_Tx: ComBitPosition=243, ComBitSize=14, ComSignalInitValue=0, ComSignalType=UINT16, ComSystemTemplateSystemSignalRef=STS_AAAzimuthStd
            STS_AACurrentAzimuth_oRDR_ALIGNMENT_STATUS_001_oPCAN_RADAR_fa4b534a_Tx: ComBitPosition=177, ComBitSize=15, ComSignalInitValue=15708, ComSignalType=UINT16, ComSystemTemplateSystemSignalRef=STS_AACurrentAzimuth
            STS_AACurrentElevation_oRDR_ALIGNMENT_STATUS_001_oPCAN_RADAR_68c02683_Tx: ComBitPosition=207, ComBitSize=11, ComSignalType=UINT16, ComSystemTemplateSystemSignalRef=STS_AACurrentElevation
            STS_AACurrentRoll_oRDR_ALIGNMENT_STATUS_001_oPCAN_RADAR_4f5a9f3e_Tx: ComBitPosition=481, ComBitSize=15, ComSignalInitValue=0, ComSignalType=SINT16, ComSystemTemplateSystemSignalRef=STS_AACurrentRoll
            STS_AAElevationStd_oRDR_ALIGNMENT_STATUS_001_oPCAN_RADAR_36e93c09_Tx: ComBitPosition=257, ComBitSize=14, ComSignalInitValue=0, ComSignalType=UINT16, ComSystemTemplateSystemSignalRef=STS_AAElevationStd
            STS_AARoll_Std_oRDR_ALIGNMENT_STATUS_001_oPCAN_RADAR_d9930952_Tx: ComBitPosition=464, ComBitSize=14, ComSignalInitValue=0, ComSignalType=UINT16, ComSystemTemplateSystemSignalRef=STS_AARoll_Std
            STS_AlignmentAutoStatus_oRDR_ALIGNMENT_STATUS_001_oPCAN_RADAR_3df406fe_Tx: ComBitPosition=133, ComBitSize=3, ComSignalInitValue=0, ComSignalType=UINT8, ComSystemTemplateSystemSignalRef=STS_AlignmentAutoStatus
            STS_AlignmentAzimuth_oRDR_ALIGNMENT_STATUS_001_oPCAN_RADAR_90bea827_Tx: ComBitPosition=384, ComBitSize=15, ComSignalInitValue=10000, ComSignalType=UINT16, ComSystemTemplateSystemSignalRef=STS_AlignmentAzimuth
            STS_AlignmentElevation_oRDR_ALIGNMENT_STATUS_001_oPCAN_RADAR_92fc7208_Tx: ComBitPosition=400, ComBitSize=15, ComSignalInitValue=10000, ComSignalType=UINT16, ComSystemTemplateSystemSignalRef=STS_AlignmentElevation
            STS_AlignmentError_oRDR_ALIGNMENT_STATUS_001_oPCAN_RADAR_c2060acd_Tx: ComBitPosition=128, ComBitSize=5, ComSignalInitValue=0, ComSignalType=UINT8, ComSystemTemplateSystemSignalRef=STS_AlignmentError
            STS_AlignmentModeIn_oRDR_ALIGNMENT_STATUS_001_oPCAN_RADAR_b9199e71_Tx: ComBitPosition=92, ComBitSize=3, ComSignalInitValue=0, ComSignalType=UINT8, ComSystemTemplateSystemSignalRef=STS_AlignmentModeIn
            STS_AlignmentModeOut_oRDR_ALIGNMENT_STATUS_001_oPCAN_RADAR_53f81498_Tx: ComBitPosition=218, ComBitSize=3, ComSignalInitValue=0, ComSignalType=UINT8, ComSystemTemplateSystemSignalRef=STS_AlignmentModeOut
            STS_AutoAlignmentFailRootCause_oRDR_ALIGNMENT_STATUS_001_oPCAN_RADAR_e1073ec5_Tx: ComBitPosition=144, ComBitSize=5, ComSignalInitValue=5, ComSignalType=UINT8, ComSystemTemplateSystemSignalRef=STS_AutoAlignmentFailRootCause
            STS_AzimuthErrorNegative_oRDR_ALIGNMENT_STATUS_001_oPCAN_RADAR_6e4fe47d_Tx: ComBitPosition=96, ComBitSize=15, ComSignalInitValue=0, ComSignalType=SINT16, ComSystemTemplateSystemSignalRef=STS_AzimuthErrorNegative
            STS_AzimuthErrorPositive_oRDR_ALIGNMENT_STATUS_001_oPCAN_RADAR_de7f1c76_Tx: ComBitPosition=192, ComBitSize=15, ComSignalInitValue=0, ComSignalType=SINT16, ComSystemTemplateSystemSignalRef=STS_AzimuthErrorPositive
            STS_AzimuthStd_oRDR_ALIGNMENT_STATUS_001_oPCAN_RADAR_b46beb44_Tx: ComBitPosition=164, ComBitSize=13, ComSignalInitValue=0, ComSignalType=UINT16, ComSystemTemplateSystemSignalRef=STS_AzimuthStd
            STS_AzimuthUpdates_oRDR_ALIGNMENT_STATUS_001_oPCAN_RADAR_57325300_Tx: ComBitPosition=320, ComBitSize=32, ComSignalInitValue=0, ComSignalType=UINT32, ComSystemTemplateSystemSignalRef=STS_AzimuthUpdates
            STS_CalDisplay_oRDR_ALIGNMENT_STATUS_001_oPCAN_RADAR_ffd10a71_Tx: ComBitPosition=95, ComBitSize=1, ComSignalInitValue=0, ComSignalType=BOOLEAN, ComSystemTemplateSystemSignalRef=STS_CalDisplay
            STS_CalTime_oRDR_ALIGNMENT_STATUS_001_oPCAN_RADAR_429dbd7e_Tx: ComBitPosition=80, ComBitSize=12, ComSignalInitValue=0, ComSignalType=UINT16, ComSystemTemplateSystemSignalRef=STS_CalTime
            STS_CoordinateSystemInput_oRDR_ALIGNMENT_STATUS_001_oPCAN_RADAR_ac54169a_Tx: ComBitPosition=59, ComBitSize=2, ComSignalInitValue=0, ComSignalType=UINT8, ComSystemTemplateSystemSignalRef=STS_CoordinateSystemInput
            STS_ElevationErrorNegative_oRDR_ALIGNMENT_STATUS_001_oPCAN_RADAR_8ad967c2_Tx: ComBitPosition=287, ComBitSize=11, ComSignalInitValue=0, ComSignalType=SINT16, ComSystemTemplateSystemSignalRef=STS_ElevationErrorNegative
            STS_ElevationErrorPositive_oRDR_ALIGNMENT_STATUS_001_oPCAN_RADAR_3ae99fc9_Tx: ComBitPosition=232, ComBitSize=11, ComSignalInitValue=0, ComSignalType=SINT16, ComSystemTemplateSystemSignalRef=STS_ElevationErrorPositive
            STS_ElevationStd_oRDR_ALIGNMENT_STATUS_001_oPCAN_RADAR_0035801e_Tx: ComBitPosition=111, ComBitSize=13, ComSignalInitValue=0, ComSignalType=UINT16, ComSystemTemplateSystemSignalRef=STS_ElevationStd
            STS_ElevationUpdates_oRDR_ALIGNMENT_STATUS_001_oPCAN_RADAR_5f349f48_Tx: ComBitPosition=352, ComBitSize=32, ComSignalInitValue=0, ComSignalType=UINT32, ComSystemTemplateSystemSignalRef=STS_ElevationUpdates
            STS_HostSpdCompensationFactorQF_oRDR_ALIGNMENT_STATUS_001_oPCAN_RADAR_23e2637e_Tx: ComBitPosition=61, ComBitSize=2, ComSignalInitValue=0, ComSignalType=UINT8, ComSystemTemplateSystemSignalRef=STS_HostSpdCompensationFactorQF
            STS_HostSpeedCompensationFactor_oRDR_ALIGNMENT_STATUS_001_oPCAN_RADAR_9815558a_Tx: ComBitPosition=313, ComBitSize=7, ComSignalInitValue=100, ComSignalType=UINT8, ComSystemTemplateSystemSignalRef=STS_HostSpeedCompensationFactor
            STS_InitAlignResultAzimuthUpdate_oRDR_ALIGNMENT_STATUS_001_oPCAN_RADAR_450388ed_Tx: ComBitPosition=64, ComBitSize=16, ComSignalInitValue=0, ComSignalType=UINT16, ComSystemTemplateSystemSignalRef=STS_InitAlignResultAzimuthUpdate
            STS_InitAlignRsltElevationUpdate_oRDR_ALIGNMENT_STATUS_001_oPCAN_RADAR_25205dfc_Tx: ComBitPosition=24, ComBitSize=16, ComSignalInitValue=0, ComSignalType=UINT16, ComSystemTemplateSystemSignalRef=STS_InitAlignRsltElevationUpdate
            STS_InitAlignRsltHostSpdCompFac_oRDR_ALIGNMENT_STATUS_001_oPCAN_RADAR_cdf9488e_Tx: ComBitPosition=40, ComBitSize=7, ComSignalInitValue=100, ComSignalType=UINT8, ComSystemTemplateSystemSignalRef=STS_InitAlignRsltHostSpdCompFac
            STS_InitAlignmentResultAzimuth_oRDR_ALIGNMENT_STATUS_001_oPCAN_RADAR_ae7ace17_Tx: ComBitPosition=272, ComBitSize=15, ComSignalInitValue=0, ComSignalType=SINT16, ComSystemTemplateSystemSignalRef=STS_InitAlignmentResultAzimuth
            STS_InitAlignmentResultElevation_oRDR_ALIGNMENT_STATUS_001_oPCAN_RADAR_e96bbe52_Tx: ComBitPosition=298, ComBitSize=14, ComSignalInitValue=0, ComSignalType=SINT16, ComSystemTemplateSystemSignalRef=STS_InitAlignmentResultElevation
            STS_InitLastSuccessfulAlignMode_oRDR_ALIGNMENT_STATUS_001_oPCAN_RADAR_b93d4ccd_Tx: ComBitPosition=478, ComBitSize=3, ComSignalInitValue=0, ComSignalType=UINT8, ComSystemTemplateSystemSignalRef=STS_InitLastSuccessfulAlignMode
            STS_ProgressPercent_oRDR_ALIGNMENT_STATUS_001_oPCAN_RADAR_357c0985_Tx: ComBitPosition=136, ComBitSize=7, ComSignalInitValue=0, ComSignalType=UINT8, ComSystemTemplateSystemSignalRef=STS_ProgressPercent
            STS_RadarTypeInput_oRDR_ALIGNMENT_STATUS_001_oPCAN_RADAR_72f1a9b3_Tx: ComBitPosition=124, ComBitSize=3, ComSignalInitValue=0, ComSignalType=UINT8, ComSystemTemplateSystemSignalRef=STS_RadarTypeInput
            STS_RollErrorNegative_oRDR_ALIGNMENT_STATUS_001_oPCAN_RADAR_86945eda_Tx: ComBitPosition=448, ComBitSize=15, ComSignalInitValue=0, ComSignalType=SINT16, ComSystemTemplateSystemSignalRef=STS_RollErrorNegative
            STS_RollErrorPositive_oRDR_ALIGNMENT_STATUS_001_oPCAN_RADAR_36a4a6d1_Tx: ComBitPosition=221, ComBitSize=10, ComSignalInitValue=0, ComSignalType=SINT16, ComSystemTemplateSystemSignalRef=STS_RollErrorPositive
            STS_Roll_Updates_oRDR_ALIGNMENT_STATUS_001_oPCAN_RADAR_519c95ca_Tx: ComBitPosition=416, ComBitSize=32, ComSignalInitValue=0, ComSignalType=UINT32, ComSystemTemplateSystemSignalRef=STS_Roll_Updates
            STS_StartAzimuth_oRDR_ALIGNMENT_STATUS_001_oPCAN_RADAR_61586fd0_Tx: ComBitPosition=149, ComBitSize=15, ComSignalInitValue=0, ComSignalType=SINT16, ComSystemTemplateSystemSignalRef=STS_StartAzimuth
            STS_StartElevation_oRDR_ALIGNMENT_STATUS_001_oPCAN_RADAR_cc01a387_Tx: ComBitPosition=48, ComBitSize=11, ComSignalInitValue=0, ComSignalType=SINT16, ComSystemTemplateSystemSignalRef=STS_StartElevation
            STS_StartRoll_oRDR_ALIGNMENT_STATUS_001_oPCAN_RADAR_ecd3f1a2_Tx: ComBitPosition=496, ComBitSize=15, ComSignalInitValue=0, ComSignalType=SINT16, ComSystemTemplateSystemSignalRef=STS_StartRoll
        SG_AlignmentStatus2_oRDR_ALIGNMENT_STATUS_002_oPCAN_RADAR_1945d616_Tx: ComSignalGroupArrayAccess=true, ComSystemTemplateSignalGroupRef=SG_AlignmentStatus2
          19 x ComGroupSignal, all with ComSignalEndianness=LITTLE_ENDIAN, ComTransferProperty=PENDING:
            AL_STS_002_CYCLE_COUNTER_oRDR_ALIGNMENT_STATUS_002_oPCAN_RADAR_ac113952_Tx: ComBitPosition=16, ComBitSize=8, ComSignalInitValue=0, ComSignalType=UINT8, ComSystemTemplateSystemSignalRef=AL_STS_002_CYCLE_COUNTER
            AL_STS_002_MH_CRC16_oRDR_ALIGNMENT_STATUS_002_oPCAN_RADAR_fd433470_Tx: ComBitPosition=0, ComBitSize=16, ComSignalInitValue=0, ComSignalType=UINT16, ComSystemTemplateSystemSignalRef=AL_STS_002_MH_CRC16
            STS_AlignmentServiceStatus_oRDR_ALIGNMENT_STATUS_002_oPCAN_RADAR_d03a7577_Tx: ComBitPosition=308, ComBitSize=3, ComSignalInitValue=0, ComSignalType=UINT8, ComSystemTemplateSystemSignalRef=STS_AlignmentServiceStatus
            STS_AlignmentShortTrackStatus_oRDR_ALIGNMENT_STATUS_002_oPCAN_RADAR_a985d45d_Tx: ComBitPosition=107, ComBitSize=3, ComSignalInitValue=0, ComSignalType=UINT8, ComSystemTemplateSystemSignalRef=STS_AlignmentShortTrackStatus
            STS_AlignmentStaticStatus_oRDR_ALIGNMENT_STATUS_002_oPCAN_RADAR_ed9fe891_Tx: ComBitPosition=304, ComBitSize=3, ComSignalInitValue=0, ComSignalType=UINT8, ComSystemTemplateSystemSignalRef=STS_AlignmentStaticStatus
            STS_AverageNumberOfDetections_oRDR_ALIGNMENT_STATUS_002_oPCAN_RADAR_e5f0325a_Tx: ComBitPosition=144, ComBitSize=32, ComSignalInitValue=0, ComSignalType=UINT32, ComSystemTemplateSystemSignalRef=STS_AverageNumberOfDetections
            STS_AverageSpeed_oRDR_ALIGNMENT_STATUS_002_oPCAN_RADAR_12d3a902_Tx: ComBitPosition=240, ComBitSize=32, ComSignalInitValue=0, ComSignalType=UINT32, ComSystemTemplateSystemSignalRef=STS_AverageSpeed
            STS_DistanceAbsolute_oRDR_ALIGNMENT_STATUS_002_oPCAN_RADAR_350fb8c0_Tx: ComBitPosition=112, ComBitSize=32, ComSignalInitValue=0, ComSignalType=UINT32, ComSystemTemplateSystemSignalRef=STS_DistanceAbsolute
            STS_DistanceEffective_oRDR_ALIGNMENT_STATUS_002_oPCAN_RADAR_ba39d7ae_Tx: ComBitPosition=176, ComBitSize=32, ComSignalInitValue=0, ComSignalType=UINT32, ComSystemTemplateSystemSignalRef=STS_DistanceEffective
            STS_DurationAbsolute_oRDR_ALIGNMENT_STATUS_002_oPCAN_RADAR_b6d3be34_Tx: ComBitPosition=208, ComBitSize=32, ComSignalInitValue=0, ComSignalType=UINT32, ComSystemTemplateSystemSignalRef=STS_DurationAbsolute
            STS_DurationEffective_oRDR_ALIGNMENT_STATUS_002_oPCAN_RADAR_006a3dad_Tx: ComBitPosition=272, ComBitSize=32, ComSignalInitValue=0, ComSignalType=UINT32, ComSystemTemplateSystemSignalRef=STS_DurationEffective
            STS_ImpactByInterference_oRDR_ALIGNMENT_STATUS_002_oPCAN_RADAR_ea495887_Tx: ComBitPosition=307, ComBitSize=1, ComSignalInitValue=0, ComSignalType=BOOLEAN, ComSystemTemplateSystemSignalRef=STS_ImpactByInterference
            STS_MeasuredAmpSTD_oRDR_ALIGNMENT_STATUS_002_oPCAN_RADAR_c894f01f_Tx: ComBitPosition=88, ComBitSize=15, ComSignalInitValue=0, ComSignalType=UINT16, ComSystemTemplateSystemSignalRef=STS_MeasuredAmpSTD
            STS_MeasuredRangeRateStd_oRDR_ALIGNMENT_STATUS_002_oPCAN_RADAR_f4643d07_Tx: ComBitPosition=40, ComBitSize=16, ComSignalInitValue=0, ComSignalType=SINT16, ComSystemTemplateSystemSignalRef=STS_MeasuredRangeRateStd
            STS_MeasuredRangeRate_oRDR_ALIGNMENT_STATUS_002_oPCAN_RADAR_d6bd6aa0_Tx: ComBitPosition=69, ComBitSize=18, ComSignalInitValue=0, ComSignalType=SINT32, ComSystemTemplateSystemSignalRef=STS_MeasuredRangeRate
            STS_MeasuredRangeStd_oRDR_ALIGNMENT_STATUS_002_oPCAN_RADAR_9735a635_Tx: ComBitPosition=24, ComBitSize=16, ComSignalInitValue=0, ComSignalType=UINT16, ComSystemTemplateSystemSignalRef=STS_MeasuredRangeStd
            STS_MeasuredRawAmplitude_oRDR_ALIGNMENT_STATUS_002_oPCAN_RADAR_0c70d370_Tx: ComBitPosition=56, ComBitSize=13, ComSignalInitValue=0, ComSignalType=SINT16, ComSystemTemplateSystemSignalRef=STS_MeasuredRawAmplitude
            STS_Measured_Range_oRDR_ALIGNMENT_STATUS_002_oPCAN_RADAR_44d7db0c_Tx: ComBitPosition=312, ComBitSize=14, ComSignalInitValue=0, ComSignalType=UINT16, ComSystemTemplateSystemSignalRef=STS_Measured_Range
            STS_VehicleCondition_oRDR_ALIGNMENT_STATUS_002_oPCAN_RADAR_27e73dc1_Tx: ComBitPosition=104, ComBitSize=3, ComSignalInitValue=6, ComSignalType=UINT8, ComSystemTemplateSystemSignalRef=STS_VehicleCondition
        SG_CCVS1_oCCVS1_oVCAN_RADAR_1b2d3da2_Rx: ComSystemTemplateSignalGroupRef=SG_CCVS1
          3 x ComGroupSignal, all with ComSignalEndianness=LITTLE_ENDIAN, ComSignalInitValue=0:
            BrakeSwitch_oCCVS1_oVCAN_RADAR_1059096c_Rx: ComBitPosition=28, ComBitSize=2, ComSignalType=UINT8, ComSystemTemplateSystemSignalRef=BrakeSwitch
            ParkingBrakeSwitch_oCCVS1_oVCAN_RADAR_fe400b10_Rx: ComBitPosition=2, ComBitSize=2, ComSignalType=UINT8, ComSystemTemplateSystemSignalRef=ParkingBrakeSwitch
            WheelBasedVehicleSpeed_oCCVS1_oVCAN_RADAR_c435b4dd_Rx: ComBitPosition=8, ComBitSize=16, ComSignalType=UINT16, ComSystemTemplateSystemSignalRef=WheelBasedVehicleSpeed
        SG_CLS_Tx_16_oCLS_Tx_16_oVCAN_RADAR_ce7ac5cf_Rx: ComSystemTemplateSignalGroupRef=SG_CLS_Tx_16
          Crawler_confi_status_info_oCLS_Tx_16_oVCAN_RADAR_9635d3b9_Rx (ComGroupSignal):
            ComBitPosition = 40
            ComBitSize = 1
            ComSignalEndianness = LITTLE_ENDIAN
            ComSignalInitValue = 0
            ComSignalType = BOOLEAN
            ComSystemTemplateSystemSignalRef = Crawler_confi_status_info
          Transmission_type_info_oCLS_Tx_16_oVCAN_RADAR_d6d97de8_Rx (ComGroupSignal):
            ComBitPosition = 41
            ComBitSize = 3
            ComSignalEndianness = LITTLE_ENDIAN
            ComSignalInitValue = 0
            ComSignalType = UINT8
            ComSystemTemplateSystemSignalRef = Transmission_type_info
        SG_CLS_Tx_4_oCLS_Tx_4_oVCAN_RADAR_72dadf8e_Rx: ComSystemTemplateSignalGroupRef=SG_CLS_Tx_4
          Ignition_oCLS_Tx_4_oVCAN_RADAR_cb871f88_Rx (ComGroupSignal):
            ComBitPosition = 32
            ComBitSize = 2
            ComSignalEndianness = LITTLE_ENDIAN
            ComSignalInitValue = 0
            ComSignalType = UINT8
            ComSystemTemplateSystemSignalRef = Ignition
          ReverseSwitchInfo_oCLS_Tx_4_oVCAN_RADAR_b4b1941a_Rx (ComGroupSignal):
            ComBitPosition = 28
            ComBitSize = 2
            ComSignalEndianness = LITTLE_ENDIAN
            ComSignalInitValue = 0
            ComSignalType = UINT8
            ComSystemTemplateSystemSignalRef = ReverseSwitchInfo
        SG_Detections_001_004_oRDR_DETECTION_001_004_oPCAN_RADAR_df4895a5_Tx: ComSystemTemplateSignalGroupRef=SG_Detections_001_004
          83 x ComGroupSignal, all with ComSignalEndianness=LITTLE_ENDIAN, ComTransferProperty=PENDING:
            DET_AZIMUTH_001_oRDR_DETECTION_001_004_oPCAN_RADAR_c49dc547_Tx: ComBitPosition=88, ComBitSize=13, ComSignalInitValue=0, ComSignalType=UINT16, ComSystemTemplateSystemSignalRef=DET_AZIMUTH_001
            DET_AZIMUTH_002_oRDR_DETECTION_001_004_oPCAN_RADAR_a07dbeb9_Tx: ComBitPosition=200, ComBitSize=13, ComSignalInitValue=0, ComSignalType=UINT16, ComSystemTemplateSystemSignalRef=DET_AZIMUTH_002
            DET_AZIMUTH_003_oRDR_DETECTION_001_004_oPCAN_RADAR_350d6a2c_Tx: ComBitPosition=312, ComBitSize=13, ComSignalInitValue=0, ComSignalType=UINT16, ComSystemTemplateSystemSignalRef=DET_AZIMUTH_003
            DET_AZIMUTH_004_oRDR_DETECTION_001_004_oPCAN_RADAR_69bd4945_Tx: ComBitPosition=424, ComBitSize=13, ComSignalInitValue=0, ComSignalType=UINT16, ComSystemTemplateSystemSignalRef=DET_AZIMUTH_004
            DET_AZIMUTH_ERR_001_oRDR_DETECTION_001_004_oPCAN_RADAR_602850b2_Tx: ComBitPosition=105, ComBitSize=7, ComSignalInitValue=0, ComSignalType=UINT8, ComSystemTemplateSystemSignalRef=DET_AZIMUTH_ERR_001
            DET_AZIMUTH_ERR_002_oRDR_DETECTION_001_004_oPCAN_RADAR_04c82b4c_Tx: ComBitPosition=217, ComBitSize=7, ComSignalInitValue=0, ComSignalType=UINT8, ComSystemTemplateSystemSignalRef=DET_AZIMUTH_ERR_002
            DET_AZIMUTH_ERR_003_oRDR_DETECTION_001_004_oPCAN_RADAR_91b8ffd9_Tx: ComBitPosition=329, ComBitSize=7, ComSignalInitValue=0, ComSignalType=UINT8, ComSystemTemplateSystemSignalRef=DET_AZIMUTH_ERR_003
            DET_AZIMUTH_ERR_004_oRDR_DETECTION_001_004_oPCAN_RADAR_cd08dcb0_Tx: ComBitPosition=441, ComBitSize=7, ComSignalInitValue=0, ComSignalType=UINT8, ComSystemTemplateSystemSignalRef=DET_AZIMUTH_ERR_004
            DET_BELOW_RAIN_THOLD_001_oRDR_DETECTION_001_004_oPCAN_RADAR_119c5687_Tx: ComBitPosition=39, ComBitSize=1, ComSignalInitValue=0, ComSignalType=BOOLEAN, ComSystemTemplateSystemSignalRef=DET_BELOW_RAIN_THOLD_001
            DET_BELOW_RAIN_THOLD_002_oRDR_DETECTION_001_004_oPCAN_RADAR_757c2d79_Tx: ComBitPosition=151, ComBitSize=1, ComSignalInitValue=0, ComSignalType=BOOLEAN, ComSystemTemplateSystemSignalRef=DET_BELOW_RAIN_THOLD_002
            DET_BELOW_RAIN_THOLD_003_oRDR_DETECTION_001_004_oPCAN_RADAR_e00cf9ec_Tx: ComBitPosition=263, ComBitSize=1, ComSignalInitValue=0, ComSignalType=BOOLEAN, ComSystemTemplateSystemSignalRef=DET_BELOW_RAIN_THOLD_003
            DET_BELOW_RAIN_THOLD_004_oRDR_DETECTION_001_004_oPCAN_RADAR_bcbcda85_Tx: ComBitPosition=375, ComBitSize=1, ComSignalInitValue=0, ComSignalType=BOOLEAN, ComSystemTemplateSystemSignalRef=DET_BELOW_RAIN_THOLD_004
            DET_BI_STATIC_FLAG_001_oRDR_DETECTION_001_004_oPCAN_RADAR_92b185c2_Tx: ComBitPosition=104, ComBitSize=1, ComSignalInitValue=0, ComSignalType=BOOLEAN, ComSystemTemplateSystemSignalRef=DET_BI_STATIC_FLAG_001
            DET_BI_STATIC_FLAG_002_oRDR_DETECTION_001_004_oPCAN_RADAR_f651fe3c_Tx: ComBitPosition=216, ComBitSize=1, ComSignalInitValue=0, ComSignalType=BOOLEAN, ComSystemTemplateSystemSignalRef=DET_BI_STATIC_FLAG_002
            DET_BI_STATIC_FLAG_003_oRDR_DETECTION_001_004_oPCAN_RADAR_63212aa9_Tx: ComBitPosition=328, ComBitSize=1, ComSignalInitValue=0, ComSignalType=BOOLEAN, ComSystemTemplateSystemSignalRef=DET_BI_STATIC_FLAG_003
            DET_BI_STATIC_FLAG_004_oRDR_DETECTION_001_004_oPCAN_RADAR_3f9109c0_Tx: ComBitPosition=440, ComBitSize=1, ComSignalInitValue=0, ComSignalType=BOOLEAN, ComSystemTemplateSystemSignalRef=DET_BI_STATIC_FLAG_004
            DET_CONFD_AZIMUTH_001_oRDR_DETECTION_001_004_oPCAN_RADAR_c67bcf8d_Tx: ComBitPosition=118, ComBitSize=2, ComSignalInitValue=0, ComSignalType=UINT8, ComSystemTemplateSystemSignalRef=DET_CONFD_AZIMUTH_001
            DET_CONFD_AZIMUTH_002_oRDR_DETECTION_001_004_oPCAN_RADAR_a29bb473_Tx: ComBitPosition=230, ComBitSize=2, ComSignalInitValue=0, ComSignalType=UINT8, ComSystemTemplateSystemSignalRef=DET_CONFD_AZIMUTH_002
            DET_CONFD_AZIMUTH_003_oRDR_DETECTION_001_004_oPCAN_RADAR_37eb60e6_Tx: ComBitPosition=342, ComBitSize=2, ComSignalInitValue=0, ComSignalType=UINT8, ComSystemTemplateSystemSignalRef=DET_CONFD_AZIMUTH_003
            DET_CONFD_AZIMUTH_004_oRDR_DETECTION_001_004_oPCAN_RADAR_6b5b438f_Tx: ComBitPosition=454, ComBitSize=2, ComSignalInitValue=0, ComSignalType=UINT8, ComSystemTemplateSystemSignalRef=DET_CONFD_AZIMUTH_004
            DET_CONFD_ELEVATION_001_oRDR_DETECTION_001_004_oPCAN_RADAR_c4eece77_Tx: ComBitPosition=101, ComBitSize=2, ComSignalInitValue=0, ComSignalType=UINT8, ComSystemTemplateSystemSignalRef=DET_CONFD_ELEVATION_001
            DET_CONFD_ELEVATION_002_oRDR_DETECTION_001_004_oPCAN_RADAR_a00eb589_Tx: ComBitPosition=213, ComBitSize=2, ComSignalInitValue=0, ComSignalType=UINT8, ComSystemTemplateSystemSignalRef=DET_CONFD_ELEVATION_002
            DET_CONFD_ELEVATION_003_oRDR_DETECTION_001_004_oPCAN_RADAR_357e611c_Tx: ComBitPosition=325, ComBitSize=2, ComSignalInitValue=0, ComSignalType=UINT8, ComSystemTemplateSystemSignalRef=DET_CONFD_ELEVATION_003
            DET_CONFD_ELEVATION_004_oRDR_DETECTION_001_004_oPCAN_RADAR_69ce4275_Tx: ComBitPosition=437, ComBitSize=2, ComSignalInitValue=0, ComSignalType=UINT8, ComSystemTemplateSystemSignalRef=DET_CONFD_ELEVATION_004
            DET_ELEVATION_001_oRDR_DETECTION_001_004_oPCAN_RADAR_152e1a4b_Tx: ComBitPosition=72, ComBitSize=8, ComSignalInitValue=0, ComSignalType=UINT8, ComSystemTemplateSystemSignalRef=DET_ELEVATION_001
            DET_ELEVATION_002_oRDR_DETECTION_001_004_oPCAN_RADAR_71ce61b5_Tx: ComBitPosition=184, ComBitSize=8, ComSignalInitValue=0, ComSignalType=UINT8, ComSystemTemplateSystemSignalRef=DET_ELEVATION_002
            DET_ELEVATION_003_oRDR_DETECTION_001_004_oPCAN_RADAR_e4beb520_Tx: ComBitPosition=296, ComBitSize=8, ComSignalInitValue=0, ComSignalType=UINT8, ComSystemTemplateSystemSignalRef=DET_ELEVATION_003
            DET_ELEVATION_004_oRDR_DETECTION_001_004_oPCAN_RADAR_b80e9649_Tx: ComBitPosition=408, ComBitSize=8, ComSignalInitValue=0, ComSignalType=UINT8, ComSystemTemplateSystemSignalRef=DET_ELEVATION_004
            DET_ELEVATION_ERR_001_oRDR_DETECTION_001_004_oPCAN_RADAR_9217823e_Tx: ComBitPosition=80, ComBitSize=6, ComSignalInitValue=0, ComSignalType=UINT8, ComSystemTemplateSystemSignalRef=DET_ELEVATION_ERR_001
            DET_ELEVATION_ERR_002_oRDR_DETECTION_001_004_oPCAN_RADAR_f6f7f9c0_Tx: ComBitPosition=192, ComBitSize=6, ComSignalInitValue=0, ComSignalType=UINT8, ComSystemTemplateSystemSignalRef=DET_ELEVATION_ERR_002
            DET_ELEVATION_ERR_003_oRDR_DETECTION_001_004_oPCAN_RADAR_63872d55_Tx: ComBitPosition=304, ComBitSize=6, ComSignalInitValue=0, ComSignalType=UINT8, ComSystemTemplateSystemSignalRef=DET_ELEVATION_ERR_003
            DET_ELEVATION_ERR_004_oRDR_DETECTION_001_004_oPCAN_RADAR_3f370e3c_Tx: ComBitPosition=416, ComBitSize=6, ComSignalInitValue=0, ComSignalType=UINT8, ComSystemTemplateSystemSignalRef=DET_ELEVATION_ERR_004
            DET_EXISTENCE_PROB_001_oRDR_DETECTION_001_004_oPCAN_RADAR_4088f75e_Tx: ComBitPosition=112, ComBitSize=6, ComSignalInitValue=0, ComSignalType=UINT8, ComSystemTemplateSystemSignalRef=DET_EXISTENCE_PROB_001
            DET_EXISTENCE_PROB_002_oRDR_DETECTION_001_004_oPCAN_RADAR_24688ca0_Tx: ComBitPosition=224, ComBitSize=6, ComSignalInitValue=0, ComSignalType=UINT8, ComSystemTemplateSystemSignalRef=DET_EXISTENCE_PROB_002
            DET_EXISTENCE_PROB_003_oRDR_DETECTION_001_004_oPCAN_RADAR_b1185835_Tx: ComBitPosition=336, ComBitSize=6, ComSignalInitValue=0, ComSignalType=UINT8, ComSystemTemplateSystemSignalRef=DET_EXISTENCE_PROB_003
            DET_EXISTENCE_PROB_004_oRDR_DETECTION_001_004_oPCAN_RADAR_eda87b5c_Tx: ComBitPosition=448, ComBitSize=6, ComSignalInitValue=0, ComSignalType=UINT8, ComSystemTemplateSystemSignalRef=DET_EXISTENCE_PROB_004
            DET_HVC_FLAG_001_oRDR_DETECTION_001_004_oPCAN_RADAR_a1fcb421_Tx: ComBitPosition=86, ComBitSize=1, ComSignalInitValue=0, ComSignalType=BOOLEAN, ComSystemTemplateSystemSignalRef=DET_HVC_FLAG_001
            DET_HVC_FLAG_002_oRDR_DETECTION_001_004_oPCAN_RADAR_c51ccfdf_Tx: ComBitPosition=198, ComBitSize=1, ComSignalInitValue=0, ComSignalType=BOOLEAN, ComSystemTemplateSystemSignalRef=DET_HVC_FLAG_002
            DET_HVC_FLAG_003_oRDR_DETECTION_001_004_oPCAN_RADAR_506c1b4a_Tx: ComBitPosition=310, ComBitSize=1, ComSignalInitValue=0, ComSignalType=BOOLEAN, ComSystemTemplateSystemSignalRef=DET_HVC_FLAG_003
            DET_HVC_FLAG_004_oRDR_DETECTION_001_004_oPCAN_RADAR_0cdc3823_Tx: ComBitPosition=422, ComBitSize=1, ComSignalInitValue=0, ComSignalType=BOOLEAN, ComSystemTemplateSystemSignalRef=DET_HVC_FLAG_004
            DET_IDM_001_oRDR_DETECTION_001_004_oPCAN_RADAR_2aae8f9c_Tx: ComBitPosition=63, ComBitSize=1, ComSignalInitValue=0, ComSignalType=BOOLEAN, ComSystemTemplateSystemSignalRef=DET_IDM_001
            DET_IDM_002_oRDR_DETECTION_001_004_oPCAN_RADAR_4e4ef462_Tx: ComBitPosition=175, ComBitSize=1, ComSignalInitValue=0, ComSignalType=BOOLEAN, ComSystemTemplateSystemSignalRef=DET_IDM_002
            DET_IDM_003_oRDR_DETECTION_001_004_oPCAN_RADAR_db3e20f7_Tx: ComBitPosition=287, ComBitSize=1, ComSignalInitValue=0, ComSignalType=BOOLEAN, ComSystemTemplateSystemSignalRef=DET_IDM_003
            DET_IDM_004_oRDR_DETECTION_001_004_oPCAN_RADAR_878e039e_Tx: ComBitPosition=399, ComBitSize=1, ComSignalInitValue=0, ComSignalType=BOOLEAN, ComSystemTemplateSystemSignalRef=DET_IDM_004
            DET_MH_CRC16_001_004_oRDR_DETECTION_001_004_oPCAN_RADAR_5bc047ae_Tx: ComBitPosition=0, ComBitSize=16, ComSignalInitValue=0, ComSignalType=UINT16, ComSystemTemplateSystemSignalRef=DET_MH_CRC16_001_004
            DET_MH_CYCLE_COUNTER_001_004_oRDR_DETECTION_001_004_oPCAN_RADAR_dfb5e699_Tx: ComBitPosition=16, ComBitSize=8, ComSignalInitValue=0, ComSignalType=UINT8, ComSystemTemplateSystemSignalRef=DET_MH_CYCLE_COUNTER_001_004
            DET_MH_SCAN_INDEX_4LSB_001_004_oRDR_DETECTION_001_004_oPCAN_RADAR_139fc315_Tx: ComBitPosition=476, ComBitSize=4, ComSignalInitValue=0, ComSignalType=UINT8, ComSystemTemplateSystemSignalRef=DET_MH_SCAN_INDEX_4LSB_001_004
            DET_MTD_001_oRDR_DETECTION_001_004_oPCAN_RADAR_4c1dbd47_Tx: ComBitPosition=47, ComBitSize=1, ComSignalInitValue=0, ComSignalType=BOOLEAN, ComSystemTemplateSystemSignalRef=DET_MTD_001
            DET_MTD_002_oRDR_DETECTION_001_004_oPCAN_RADAR_28fdc6b9_Tx: ComBitPosition=159, ComBitSize=1, ComSignalInitValue=0, ComSignalType=BOOLEAN, ComSystemTemplateSystemSignalRef=DET_MTD_002
            DET_MTD_003_oRDR_DETECTION_001_004_oPCAN_RADAR_bd8d122c_Tx: ComBitPosition=271, ComBitSize=1, ComSignalInitValue=0, ComSignalType=BOOLEAN, ComSystemTemplateSystemSignalRef=DET_MTD_003
            DET_MTD_004_oRDR_DETECTION_001_004_oPCAN_RADAR_e13d3145_Tx: ComBitPosition=383, ComBitSize=1, ComSignalInitValue=0, ComSignalType=BOOLEAN, ComSystemTemplateSystemSignalRef=DET_MTD_004
            DET_PROB_1STAZHYPO_001_oRDR_DETECTION_001_004_oPCAN_RADAR_dfa9558a_Tx: ComBitPosition=103, ComBitSize=1, ComSignalInitValue=0, ComSignalType=BOOLEAN, ComSystemTemplateSystemSignalRef=DET_PROB_1STAZHYPO_001
            DET_PROB_1STAZHYPO_002_oRDR_DETECTION_001_004_oPCAN_RADAR_bb492e74_Tx: ComBitPosition=215, ComBitSize=1, ComSignalInitValue=0, ComSignalType=BOOLEAN, ComSystemTemplateSystemSignalRef=DET_PROB_1STAZHYPO_002
            DET_PROB_1STAZHYPO_003_oRDR_DETECTION_001_004_oPCAN_RADAR_2e39fae1_Tx: ComBitPosition=327, ComBitSize=1, ComSignalInitValue=0, ComSignalType=BOOLEAN, ComSystemTemplateSystemSignalRef=DET_PROB_1STAZHYPO_003
            DET_PROB_1STAZHYPO_004_oRDR_DETECTION_001_004_oPCAN_RADAR_7289d988_Tx: ComBitPosition=439, ComBitSize=1, ComSignalInitValue=0, ComSignalType=BOOLEAN, ComSystemTemplateSystemSignalRef=DET_PROB_1STAZHYPO_004
            DET_RANGE_001_oRDR_DETECTION_001_004_oPCAN_RADAR_d406b6fc_Tx: ComBitPosition=24, ComBitSize=15, ComSignalInitValue=0, ComSignalType=UINT16, ComSystemTemplateSystemSignalRef=DET_RANGE_001
            DET_RANGE_002_oRDR_DETECTION_001_004_oPCAN_RADAR_b0e6cd02_Tx: ComBitPosition=136, ComBitSize=15, ComSignalInitValue=0, ComSignalType=UINT16, ComSystemTemplateSystemSignalRef=DET_RANGE_002
            DET_RANGE_003_oRDR_DETECTION_001_004_oPCAN_RADAR_25961997_Tx: ComBitPosition=248, ComBitSize=15, ComSignalInitValue=0, ComSignalType=UINT16, ComSystemTemplateSystemSignalRef=DET_RANGE_003
            DET_RANGE_004_oRDR_DETECTION_001_004_oPCAN_RADAR_79263afe_Tx: ComBitPosition=360, ComBitSize=15, ComSignalInitValue=0, ComSignalType=UINT16, ComSystemTemplateSystemSignalRef=DET_RANGE_004
            DET_RANGE_ERR_001_oRDR_DETECTION_001_004_oPCAN_RADAR_73ee0c95_Tx: ComBitPosition=40, ComBitSize=7, ComSignalInitValue=0, ComSignalType=UINT8, ComSystemTemplateSystemSignalRef=DET_RANGE_ERR_001
            DET_RANGE_ERR_002_oRDR_DETECTION_001_004_oPCAN_RADAR_170e776b_Tx: ComBitPosition=152, ComBitSize=7, ComSignalInitValue=0, ComSignalType=UINT8, ComSystemTemplateSystemSignalRef=DET_RANGE_ERR_002
            DET_RANGE_ERR_003_oRDR_DETECTION_001_004_oPCAN_RADAR_827ea3fe_Tx: ComBitPosition=264, ComBitSize=7, ComSignalInitValue=0, ComSignalType=UINT8, ComSystemTemplateSystemSignalRef=DET_RANGE_ERR_003
            DET_RANGE_ERR_004_oRDR_DETECTION_001_004_oPCAN_RADAR_dece8097_Tx: ComBitPosition=376, ComBitSize=7, ComSignalInitValue=0, ComSignalType=UINT8, ComSystemTemplateSystemSignalRef=DET_RANGE_ERR_004
            DET_RANGE_VELOCITY_001_oRDR_DETECTION_001_004_oPCAN_RADAR_a1a074d9_Tx: ComBitPosition=48, ComBitSize=15, ComSignalInitValue=16384, ComSignalType=UINT16, ComSystemTemplateSystemSignalRef=DET_RANGE_VELOCITY_001
            DET_RANGE_VELOCITY_002_oRDR_DETECTION_001_004_oPCAN_RADAR_c5400f27_Tx: ComBitPosition=160, ComBitSize=15, ComSignalInitValue=16384, ComSignalType=UINT16, ComSystemTemplateSystemSignalRef=DET_RANGE_VELOCITY_002
            DET_RANGE_VELOCITY_003_oRDR_DETECTION_001_004_oPCAN_RADAR_5030dbb2_Tx: ComBitPosition=272, ComBitSize=15, ComSignalInitValue=16384, ComSignalType=UINT16, ComSystemTemplateSystemSignalRef=DET_RANGE_VELOCITY_003
            DET_RANGE_VELOCITY_004_oRDR_DETECTION_001_004_oPCAN_RADAR_0c80f8db_Tx: ComBitPosition=384, ComBitSize=15, ComSignalInitValue=16384, ComSignalType=UINT16, ComSystemTemplateSystemSignalRef=DET_RANGE_VELOCITY_004
            DET_RANGE_VELOCITY_ERR_001_oRDR_DETECTION_001_004_oPCAN_RADAR_ae1b8f6b_Tx: ComBitPosition=64, ComBitSize=8, ComSignalInitValue=0, ComSignalType=UINT8, ComSystemTemplateSystemSignalRef=DET_RANGE_VELOCITY_ERR_001
            DET_RANGE_VELOCITY_ERR_002_oRDR_DETECTION_001_004_oPCAN_RADAR_cafbf495_Tx: ComBitPosition=176, ComBitSize=8, ComSignalInitValue=0, ComSignalType=UINT8, ComSystemTemplateSystemSignalRef=DET_RANGE_VELOCITY_ERR_002
            DET_RANGE_VELOCITY_ERR_003_oRDR_DETECTION_001_004_oPCAN_RADAR_5f8b2000_Tx: ComBitPosition=288, ComBitSize=8, ComSignalInitValue=0, ComSignalType=UINT8, ComSystemTemplateSystemSignalRef=DET_RANGE_VELOCITY_ERR_003
            DET_RANGE_VELOCITY_ERR_004_oRDR_DETECTION_001_004_oPCAN_RADAR_033b0369_Tx: ComBitPosition=400, ComBitSize=8, ComSignalInitValue=0, ComSignalType=UINT8, ComSystemTemplateSystemSignalRef=DET_RANGE_VELOCITY_ERR_004
            DET_RCS_001_oRDR_DETECTION_001_004_oPCAN_RADAR_26204383_Tx: ComBitPosition=128, ComBitSize=8, ComSignalInitValue=128, ComSignalType=UINT8, ComSystemTemplateSystemSignalRef=DET_RCS_001
            DET_RCS_002_oRDR_DETECTION_001_004_oPCAN_RADAR_42c0387d_Tx: ComBitPosition=240, ComBitSize=8, ComSignalInitValue=128, ComSignalType=UINT8, ComSystemTemplateSystemSignalRef=DET_RCS_002
            DET_RCS_003_oRDR_DETECTION_001_004_oPCAN_RADAR_d7b0ece8_Tx: ComBitPosition=352, ComBitSize=8, ComSignalInitValue=128, ComSignalType=UINT8, ComSystemTemplateSystemSignalRef=DET_RCS_003
            DET_RCS_004_oRDR_DETECTION_001_004_oPCAN_RADAR_8b00cf81_Tx: ComBitPosition=464, ComBitSize=8, ComSignalInitValue=128, ComSignalType=UINT8, ComSystemTemplateSystemSignalRef=DET_RCS_004
            DET_SNR_001_oRDR_DETECTION_001_004_oPCAN_RADAR_fb8e1781_Tx: ComBitPosition=120, ComBitSize=8, ComSignalInitValue=0, ComSignalType=UINT8, ComSystemTemplateSystemSignalRef=DET_SNR_001
            DET_SNR_002_oRDR_DETECTION_001_004_oPCAN_RADAR_9f6e6c7f_Tx: ComBitPosition=232, ComBitSize=8, ComSignalInitValue=0, ComSignalType=UINT8, ComSystemTemplateSystemSignalRef=DET_SNR_002
            DET_SNR_003_oRDR_DETECTION_001_004_oPCAN_RADAR_0a1eb8ea_Tx: ComBitPosition=344, ComBitSize=8, ComSignalInitValue=0, ComSignalType=UINT8, ComSystemTemplateSystemSignalRef=DET_SNR_003
            DET_SNR_004_oRDR_DETECTION_001_004_oPCAN_RADAR_56ae9b83_Tx: ComBitPosition=456, ComBitSize=8, ComSignalInitValue=0, ComSignalType=UINT8, ComSystemTemplateSystemSignalRef=DET_SNR_004
            DET_SUPER_RES_TARGET_001_oRDR_DETECTION_001_004_oPCAN_RADAR_ca173fe4_Tx: ComBitPosition=87, ComBitSize=1, ComSignalInitValue=0, ComSignalType=BOOLEAN, ComSystemTemplateSystemSignalRef=DET_SUPER_RES_TARGET_001
            DET_SUPER_RES_TARGET_002_oRDR_DETECTION_001_004_oPCAN_RADAR_aef7441a_Tx: ComBitPosition=199, ComBitSize=1, ComSignalInitValue=0, ComSignalType=BOOLEAN, ComSystemTemplateSystemSignalRef=DET_SUPER_RES_TARGET_002
            DET_SUPER_RES_TARGET_003_oRDR_DETECTION_001_004_oPCAN_RADAR_3b87908f_Tx: ComBitPosition=311, ComBitSize=1, ComSignalInitValue=0, ComSignalType=BOOLEAN, ComSystemTemplateSystemSignalRef=DET_SUPER_RES_TARGET_003
            DET_SUPER_RES_TARGET_004_oRDR_DETECTION_001_004_oPCAN_RADAR_6737b3e6_Tx: ComBitPosition=423, ComBitSize=1, ComSignalInitValue=0, ComSignalType=BOOLEAN, ComSystemTemplateSystemSignalRef=DET_SUPER_RES_TARGET_004
        SG_Detections_005_008_oRDR_DETECTION_005_008_oPCAN_RADAR_ae8ba1f7_Tx: ComSystemTemplateSignalGroupRef=SG_Detections_005_008
          83 x ComGroupSignal, all with ComSignalEndianness=LITTLE_ENDIAN, ComTransferProperty=PENDING:
            DET_AZIMUTH_005_oRDR_DETECTION_005_008_oPCAN_RADAR_157f03e4_Tx: ComBitPosition=88, ComBitSize=13, ComSignalInitValue=0, ComSignalType=UINT16, ComSystemTemplateSystemSignalRef=DET_AZIMUTH_005
            DET_AZIMUTH_006_oRDR_DETECTION_005_008_oPCAN_RADAR_719f781a_Tx: ComBitPosition=200, ComBitSize=13, ComSignalInitValue=0, ComSignalType=UINT16, ComSystemTemplateSystemSignalRef=DET_AZIMUTH_006
            DET_AZIMUTH_007_oRDR_DETECTION_005_008_oPCAN_RADAR_e4efac8f_Tx: ComBitPosition=312, ComBitSize=13, ComSignalInitValue=0, ComSignalType=UINT16, ComSystemTemplateSystemSignalRef=DET_AZIMUTH_007
            DET_AZIMUTH_008_oRDR_DETECTION_005_008_oPCAN_RADAR_c8ff3ec8_Tx: ComBitPosition=424, ComBitSize=13, ComSignalInitValue=0, ComSignalType=UINT16, ComSystemTemplateSystemSignalRef=DET_AZIMUTH_008
            DET_AZIMUTH_ERR_005_oRDR_DETECTION_005_008_oPCAN_RADAR_b1ca9611_Tx: ComBitPosition=105, ComBitSize=7, ComSignalInitValue=0, ComSignalType=UINT8, ComSystemTemplateSystemSignalRef=DET_AZIMUTH_ERR_005
            DET_AZIMUTH_ERR_006_oRDR_DETECTION_005_008_oPCAN_RADAR_d52aedef_Tx: ComBitPosition=217, ComBitSize=7, ComSignalInitValue=0, ComSignalType=UINT8, ComSystemTemplateSystemSignalRef=DET_AZIMUTH_ERR_006
            DET_AZIMUTH_ERR_007_oRDR_DETECTION_005_008_oPCAN_RADAR_405a397a_Tx: ComBitPosition=329, ComBitSize=7, ComSignalInitValue=0, ComSignalType=UINT8, ComSystemTemplateSystemSignalRef=DET_AZIMUTH_ERR_007
            DET_AZIMUTH_ERR_008_oRDR_DETECTION_005_008_oPCAN_RADAR_6c4aab3d_Tx: ComBitPosition=441, ComBitSize=7, ComSignalInitValue=0, ComSignalType=UINT8, ComSystemTemplateSystemSignalRef=DET_AZIMUTH_ERR_008
            DET_BELOW_RAIN_THOLD_005_oRDR_DETECTION_005_008_oPCAN_RADAR_c07e9024_Tx: ComBitPosition=39, ComBitSize=1, ComSignalInitValue=0, ComSignalType=BOOLEAN, ComSystemTemplateSystemSignalRef=DET_BELOW_RAIN_THOLD_005
            DET_BELOW_RAIN_THOLD_006_oRDR_DETECTION_005_008_oPCAN_RADAR_a49eebda_Tx: ComBitPosition=151, ComBitSize=1, ComSignalInitValue=0, ComSignalType=BOOLEAN, ComSystemTemplateSystemSignalRef=DET_BELOW_RAIN_THOLD_006
            DET_BELOW_RAIN_THOLD_007_oRDR_DETECTION_005_008_oPCAN_RADAR_31ee3f4f_Tx: ComBitPosition=263, ComBitSize=1, ComSignalInitValue=0, ComSignalType=BOOLEAN, ComSystemTemplateSystemSignalRef=DET_BELOW_RAIN_THOLD_007
            DET_BELOW_RAIN_THOLD_008_oRDR_DETECTION_005_008_oPCAN_RADAR_1dfead08_Tx: ComBitPosition=375, ComBitSize=1, ComSignalInitValue=0, ComSignalType=BOOLEAN, ComSystemTemplateSystemSignalRef=DET_BELOW_RAIN_THOLD_008
            DET_BI_STATIC_FLAG_005_oRDR_DETECTION_005_008_oPCAN_RADAR_43534361_Tx: ComBitPosition=104, ComBitSize=1, ComSignalInitValue=0, ComSignalType=BOOLEAN, ComSystemTemplateSystemSignalRef=DET_BI_STATIC_FLAG_005
            DET_BI_STATIC_FLAG_006_oRDR_DETECTION_005_008_oPCAN_RADAR_27b3389f_Tx: ComBitPosition=216, ComBitSize=1, ComSignalInitValue=0, ComSignalType=BOOLEAN, ComSystemTemplateSystemSignalRef=DET_BI_STATIC_FLAG_006
            DET_BI_STATIC_FLAG_007_oRDR_DETECTION_005_008_oPCAN_RADAR_b2c3ec0a_Tx: ComBitPosition=328, ComBitSize=1, ComSignalInitValue=0, ComSignalType=BOOLEAN, ComSystemTemplateSystemSignalRef=DET_BI_STATIC_FLAG_007
            DET_BI_STATIC_FLAG_008_oRDR_DETECTION_005_008_oPCAN_RADAR_9ed37e4d_Tx: ComBitPosition=440, ComBitSize=1, ComSignalInitValue=0, ComSignalType=BOOLEAN, ComSystemTemplateSystemSignalRef=DET_BI_STATIC_FLAG_008
            DET_CONFD_AZIMUTH_005_oRDR_DETECTION_005_008_oPCAN_RADAR_1799092e_Tx: ComBitPosition=118, ComBitSize=2, ComSignalInitValue=0, ComSignalType=UINT8, ComSystemTemplateSystemSignalRef=DET_CONFD_AZIMUTH_005
            DET_CONFD_AZIMUTH_006_oRDR_DETECTION_005_008_oPCAN_RADAR_737972d0_Tx: ComBitPosition=230, ComBitSize=2, ComSignalInitValue=0, ComSignalType=UINT8, ComSystemTemplateSystemSignalRef=DET_CONFD_AZIMUTH_006
            DET_CONFD_AZIMUTH_007_oRDR_DETECTION_005_008_oPCAN_RADAR_e609a645_Tx: ComBitPosition=342, ComBitSize=2, ComSignalInitValue=0, ComSignalType=UINT8, ComSystemTemplateSystemSignalRef=DET_CONFD_AZIMUTH_007
            DET_CONFD_AZIMUTH_008_oRDR_DETECTION_005_008_oPCAN_RADAR_ca193402_Tx: ComBitPosition=454, ComBitSize=2, ComSignalInitValue=0, ComSignalType=UINT8, ComSystemTemplateSystemSignalRef=DET_CONFD_AZIMUTH_008
            DET_CONFD_ELEVATION_005_oRDR_DETECTION_005_008_oPCAN_RADAR_150c08d4_Tx: ComBitPosition=101, ComBitSize=2, ComSignalInitValue=0, ComSignalType=UINT8, ComSystemTemplateSystemSignalRef=DET_CONFD_ELEVATION_005
            DET_CONFD_ELEVATION_006_oRDR_DETECTION_005_008_oPCAN_RADAR_71ec732a_Tx: ComBitPosition=213, ComBitSize=2, ComSignalInitValue=0, ComSignalType=UINT8, ComSystemTemplateSystemSignalRef=DET_CONFD_ELEVATION_006
            DET_CONFD_ELEVATION_007_oRDR_DETECTION_005_008_oPCAN_RADAR_e49ca7bf_Tx: ComBitPosition=325, ComBitSize=2, ComSignalInitValue=0, ComSignalType=UINT8, ComSystemTemplateSystemSignalRef=DET_CONFD_ELEVATION_007
            DET_CONFD_ELEVATION_008_oRDR_DETECTION_005_008_oPCAN_RADAR_c88c35f8_Tx: ComBitPosition=437, ComBitSize=2, ComSignalInitValue=0, ComSignalType=UINT8, ComSystemTemplateSystemSignalRef=DET_CONFD_ELEVATION_008
            DET_ELEVATION_005_oRDR_DETECTION_005_008_oPCAN_RADAR_c4ccdce8_Tx: ComBitPosition=72, ComBitSize=8, ComSignalInitValue=0, ComSignalType=UINT8, ComSystemTemplateSystemSignalRef=DET_ELEVATION_005
            DET_ELEVATION_006_oRDR_DETECTION_005_008_oPCAN_RADAR_a02ca716_Tx: ComBitPosition=184, ComBitSize=8, ComSignalInitValue=0, ComSignalType=UINT8, ComSystemTemplateSystemSignalRef=DET_ELEVATION_006
            DET_ELEVATION_007_oRDR_DETECTION_005_008_oPCAN_RADAR_355c7383_Tx: ComBitPosition=296, ComBitSize=8, ComSignalInitValue=0, ComSignalType=UINT8, ComSystemTemplateSystemSignalRef=DET_ELEVATION_007
            DET_ELEVATION_008_oRDR_DETECTION_005_008_oPCAN_RADAR_194ce1c4_Tx: ComBitPosition=408, ComBitSize=8, ComSignalInitValue=0, ComSignalType=UINT8, ComSystemTemplateSystemSignalRef=DET_ELEVATION_008
            DET_ELEVATION_ERR_005_oRDR_DETECTION_005_008_oPCAN_RADAR_43f5449d_Tx: ComBitPosition=80, ComBitSize=6, ComSignalInitValue=0, ComSignalType=UINT8, ComSystemTemplateSystemSignalRef=DET_ELEVATION_ERR_005
            DET_ELEVATION_ERR_006_oRDR_DETECTION_005_008_oPCAN_RADAR_27153f63_Tx: ComBitPosition=192, ComBitSize=6, ComSignalInitValue=0, ComSignalType=UINT8, ComSystemTemplateSystemSignalRef=DET_ELEVATION_ERR_006
            DET_ELEVATION_ERR_007_oRDR_DETECTION_005_008_oPCAN_RADAR_b265ebf6_Tx: ComBitPosition=304, ComBitSize=6, ComSignalInitValue=0, ComSignalType=UINT8, ComSystemTemplateSystemSignalRef=DET_ELEVATION_ERR_007
            DET_ELEVATION_ERR_008_oRDR_DETECTION_005_008_oPCAN_RADAR_9e7579b1_Tx: ComBitPosition=416, ComBitSize=6, ComSignalInitValue=0, ComSignalType=UINT8, ComSystemTemplateSystemSignalRef=DET_ELEVATION_ERR_008
            DET_EXISTENCE_PROB_005_oRDR_DETECTION_005_008_oPCAN_RADAR_916a31fd_Tx: ComBitPosition=112, ComBitSize=6, ComSignalInitValue=0, ComSignalType=UINT8, ComSystemTemplateSystemSignalRef=DET_EXISTENCE_PROB_005
            DET_EXISTENCE_PROB_006_oRDR_DETECTION_005_008_oPCAN_RADAR_f58a4a03_Tx: ComBitPosition=224, ComBitSize=6, ComSignalInitValue=0, ComSignalType=UINT8, ComSystemTemplateSystemSignalRef=DET_EXISTENCE_PROB_006
            DET_EXISTENCE_PROB_007_oRDR_DETECTION_005_008_oPCAN_RADAR_60fa9e96_Tx: ComBitPosition=336, ComBitSize=6, ComSignalInitValue=0, ComSignalType=UINT8, ComSystemTemplateSystemSignalRef=DET_EXISTENCE_PROB_007
            DET_EXISTENCE_PROB_008_oRDR_DETECTION_005_008_oPCAN_RADAR_4cea0cd1_Tx: ComBitPosition=448, ComBitSize=6, ComSignalInitValue=0, ComSignalType=UINT8, ComSystemTemplateSystemSignalRef=DET_EXISTENCE_PROB_008
            DET_HVC_FLAG_005_oRDR_DETECTION_005_008_oPCAN_RADAR_701e7282_Tx: ComBitPosition=86, ComBitSize=1, ComSignalInitValue=0, ComSignalType=BOOLEAN, ComSystemTemplateSystemSignalRef=DET_HVC_FLAG_005
            DET_HVC_FLAG_006_oRDR_DETECTION_005_008_oPCAN_RADAR_14fe097c_Tx: ComBitPosition=198, ComBitSize=1, ComSignalInitValue=0, ComSignalType=BOOLEAN, ComSystemTemplateSystemSignalRef=DET_HVC_FLAG_006
            DET_HVC_FLAG_007_oRDR_DETECTION_005_008_oPCAN_RADAR_818edde9_Tx: ComBitPosition=310, ComBitSize=1, ComSignalInitValue=0, ComSignalType=BOOLEAN, ComSystemTemplateSystemSignalRef=DET_HVC_FLAG_007
            DET_HVC_FLAG_008_oRDR_DETECTION_005_008_oPCAN_RADAR_ad9e4fae_Tx: ComBitPosition=422, ComBitSize=1, ComSignalInitValue=0, ComSignalType=BOOLEAN, ComSystemTemplateSystemSignalRef=DET_HVC_FLAG_008
            DET_IDM_005_oRDR_DETECTION_005_008_oPCAN_RADAR_fb4c493f_Tx: ComBitPosition=63, ComBitSize=1, ComSignalInitValue=0, ComSignalType=BOOLEAN, ComSystemTemplateSystemSignalRef=DET_IDM_005
            DET_IDM_006_oRDR_DETECTION_005_008_oPCAN_RADAR_9fac32c1_Tx: ComBitPosition=175, ComBitSize=1, ComSignalInitValue=0, ComSignalType=BOOLEAN, ComSystemTemplateSystemSignalRef=DET_IDM_006
            DET_IDM_007_oRDR_DETECTION_005_008_oPCAN_RADAR_0adce654_Tx: ComBitPosition=287, ComBitSize=1, ComSignalInitValue=0, ComSignalType=BOOLEAN, ComSystemTemplateSystemSignalRef=DET_IDM_007
            DET_IDM_008_oRDR_DETECTION_005_008_oPCAN_RADAR_26cc7413_Tx: ComBitPosition=399, ComBitSize=1, ComSignalInitValue=0, ComSignalType=BOOLEAN, ComSystemTemplateSystemSignalRef=DET_IDM_008
            DET_MH_CRC16_005_008_oRDR_DETECTION_005_008_oPCAN_RADAR_2a0373fc_Tx: ComBitPosition=0, ComBitSize=16, ComSignalInitValue=0, ComSignalType=UINT16, ComSystemTemplateSystemSignalRef=DET_MH_CRC16_005_008
            DET_MH_CYCLE_COUNTER_005_008_oRDR_DETECTION_005_008_oPCAN_RADAR_ae76d2cb_Tx: ComBitPosition=16, ComBitSize=8, ComSignalInitValue=0, ComSignalType=UINT8, ComSystemTemplateSystemSignalRef=DET_MH_CYCLE_COUNTER_005_008
            DET_MH_SCAN_INDEX_4LSB_005_008_oRDR_DETECTION_005_008_oPCAN_RADAR_625cf747_Tx: ComBitPosition=476, ComBitSize=4, ComSignalInitValue=0, ComSignalType=UINT8, ComSystemTemplateSystemSignalRef=DET_MH_SCAN_INDEX_4LSB_005_008
            DET_MTD_005_oRDR_DETECTION_005_008_oPCAN_RADAR_9dff7be4_Tx: ComBitPosition=47, ComBitSize=1, ComSignalInitValue=0, ComSignalType=BOOLEAN, ComSystemTemplateSystemSignalRef=DET_MTD_005
            DET_MTD_006_oRDR_DETECTION_005_008_oPCAN_RADAR_f91f001a_Tx: ComBitPosition=159, ComBitSize=1, ComSignalInitValue=0, ComSignalType=BOOLEAN, ComSystemTemplateSystemSignalRef=DET_MTD_006
            DET_MTD_007_oRDR_DETECTION_005_008_oPCAN_RADAR_6c6fd48f_Tx: ComBitPosition=271, ComBitSize=1, ComSignalInitValue=0, ComSignalType=BOOLEAN, ComSystemTemplateSystemSignalRef=DET_MTD_007
            DET_MTD_008_oRDR_DETECTION_005_008_oPCAN_RADAR_407f46c8_Tx: ComBitPosition=383, ComBitSize=1, ComSignalInitValue=0, ComSignalType=BOOLEAN, ComSystemTemplateSystemSignalRef=DET_MTD_008
            DET_PROB_1STAZHYPO_005_oRDR_DETECTION_005_008_oPCAN_RADAR_0e4b9329_Tx: ComBitPosition=103, ComBitSize=1, ComSignalInitValue=0, ComSignalType=BOOLEAN, ComSystemTemplateSystemSignalRef=DET_PROB_1STAZHYPO_005
            DET_PROB_1STAZHYPO_006_oRDR_DETECTION_005_008_oPCAN_RADAR_6aabe8d7_Tx: ComBitPosition=215, ComBitSize=1, ComSignalInitValue=0, ComSignalType=BOOLEAN, ComSystemTemplateSystemSignalRef=DET_PROB_1STAZHYPO_006
            DET_PROB_1STAZHYPO_007_oRDR_DETECTION_005_008_oPCAN_RADAR_ffdb3c42_Tx: ComBitPosition=327, ComBitSize=1, ComSignalInitValue=0, ComSignalType=BOOLEAN, ComSystemTemplateSystemSignalRef=DET_PROB_1STAZHYPO_007
            DET_PROB_1STAZHYPO_008_oRDR_DETECTION_005_008_oPCAN_RADAR_d3cbae05_Tx: ComBitPosition=439, ComBitSize=1, ComSignalInitValue=0, ComSignalType=BOOLEAN, ComSystemTemplateSystemSignalRef=DET_PROB_1STAZHYPO_008
            DET_RANGE_005_oRDR_DETECTION_005_008_oPCAN_RADAR_05e4705f_Tx: ComBitPosition=24, ComBitSize=15, ComSignalInitValue=0, ComSignalType=UINT16, ComSystemTemplateSystemSignalRef=DET_RANGE_005
            DET_RANGE_006_oRDR_DETECTION_005_008_oPCAN_RADAR_61040ba1_Tx: ComBitPosition=136, ComBitSize=15, ComSignalInitValue=0, ComSignalType=UINT16, ComSystemTemplateSystemSignalRef=DET_RANGE_006
            DET_RANGE_007_oRDR_DETECTION_005_008_oPCAN_RADAR_f474df34_Tx: ComBitPosition=248, ComBitSize=15, ComSignalInitValue=0, ComSignalType=UINT16, ComSystemTemplateSystemSignalRef=DET_RANGE_007
            DET_RANGE_008_oRDR_DETECTION_005_008_oPCAN_RADAR_d8644d73_Tx: ComBitPosition=360, ComBitSize=15, ComSignalInitValue=0, ComSignalType=UINT16, ComSystemTemplateSystemSignalRef=DET_RANGE_008
            DET_RANGE_ERR_005_oRDR_DETECTION_005_008_oPCAN_RADAR_a20cca36_Tx: ComBitPosition=40, ComBitSize=7, ComSignalInitValue=0, ComSignalType=UINT8, ComSystemTemplateSystemSignalRef=DET_RANGE_ERR_005
            DET_RANGE_ERR_006_oRDR_DETECTION_005_008_oPCAN_RADAR_c6ecb1c8_Tx: ComBitPosition=152, ComBitSize=7, ComSignalInitValue=0, ComSignalType=UINT8, ComSystemTemplateSystemSignalRef=DET_RANGE_ERR_006
            DET_RANGE_ERR_007_oRDR_DETECTION_005_008_oPCAN_RADAR_539c655d_Tx: ComBitPosition=264, ComBitSize=7, ComSignalInitValue=0, ComSignalType=UINT8, ComSystemTemplateSystemSignalRef=DET_RANGE_ERR_007
            DET_RANGE_ERR_008_oRDR_DETECTION_005_008_oPCAN_RADAR_7f8cf71a_Tx: ComBitPosition=376, ComBitSize=7, ComSignalInitValue=0, ComSignalType=UINT8, ComSystemTemplateSystemSignalRef=DET_RANGE_ERR_008
            DET_RANGE_VELOCITY_005_oRDR_DETECTION_005_008_oPCAN_RADAR_7042b27a_Tx: ComBitPosition=48, ComBitSize=15, ComSignalInitValue=16384, ComSignalType=UINT16, ComSystemTemplateSystemSignalRef=DET_RANGE_VELOCITY_005
            DET_RANGE_VELOCITY_006_oRDR_DETECTION_005_008_oPCAN_RADAR_14a2c984_Tx: ComBitPosition=160, ComBitSize=15, ComSignalInitValue=16384, ComSignalType=UINT16, ComSystemTemplateSystemSignalRef=DET_RANGE_VELOCITY_006
            DET_RANGE_VELOCITY_007_oRDR_DETECTION_005_008_oPCAN_RADAR_81d21d11_Tx: ComBitPosition=272, ComBitSize=15, ComSignalInitValue=16384, ComSignalType=UINT16, ComSystemTemplateSystemSignalRef=DET_RANGE_VELOCITY_007
            DET_RANGE_VELOCITY_008_oRDR_DETECTION_005_008_oPCAN_RADAR_adc28f56_Tx: ComBitPosition=384, ComBitSize=15, ComSignalInitValue=16384, ComSignalType=UINT16, ComSystemTemplateSystemSignalRef=DET_RANGE_VELOCITY_008
            DET_RANGE_VELOCITY_ERR_005_oRDR_DETECTION_005_008_oPCAN_RADAR_7ff949c8_Tx: ComBitPosition=64, ComBitSize=8, ComSignalInitValue=0, ComSignalType=UINT8, ComSystemTemplateSystemSignalRef=DET_RANGE_VELOCITY_ERR_005
            DET_RANGE_VELOCITY_ERR_006_oRDR_DETECTION_005_008_oPCAN_RADAR_1b193236_Tx: ComBitPosition=176, ComBitSize=8, ComSignalInitValue=0, ComSignalType=UINT8, ComSystemTemplateSystemSignalRef=DET_RANGE_VELOCITY_ERR_006
            DET_RANGE_VELOCITY_ERR_007_oRDR_DETECTION_005_008_oPCAN_RADAR_8e69e6a3_Tx: ComBitPosition=288, ComBitSize=8, ComSignalInitValue=0, ComSignalType=UINT8, ComSystemTemplateSystemSignalRef=DET_RANGE_VELOCITY_ERR_007
            DET_RANGE_VELOCITY_ERR_008_oRDR_DETECTION_005_008_oPCAN_RADAR_a27974e4_Tx: ComBitPosition=400, ComBitSize=8, ComSignalInitValue=0, ComSignalType=UINT8, ComSystemTemplateSystemSignalRef=DET_RANGE_VELOCITY_ERR_008
            DET_RCS_005_oRDR_DETECTION_005_008_oPCAN_RADAR_f7c28520_Tx: ComBitPosition=128, ComBitSize=8, ComSignalInitValue=128, ComSignalType=UINT8, ComSystemTemplateSystemSignalRef=DET_RCS_005
            DET_RCS_006_oRDR_DETECTION_005_008_oPCAN_RADAR_9322fede_Tx: ComBitPosition=240, ComBitSize=8, ComSignalInitValue=128, ComSignalType=UINT8, ComSystemTemplateSystemSignalRef=DET_RCS_006
            DET_RCS_007_oRDR_DETECTION_005_008_oPCAN_RADAR_06522a4b_Tx: ComBitPosition=352, ComBitSize=8, ComSignalInitValue=128, ComSignalType=UINT8, ComSystemTemplateSystemSignalRef=DET_RCS_007
            DET_RCS_008_oRDR_DETECTION_005_008_oPCAN_RADAR_2a42b80c_Tx: ComBitPosition=464, ComBitSize=8, ComSignalInitValue=128, ComSignalType=UINT8, ComSystemTemplateSystemSignalRef=DET_RCS_008
            DET_SNR_005_oRDR_DETECTION_005_008_oPCAN_RADAR_2a6cd122_Tx: ComBitPosition=120, ComBitSize=8, ComSignalInitValue=0, ComSignalType=UINT8, ComSystemTemplateSystemSignalRef=DET_SNR_005
            DET_SNR_006_oRDR_DETECTION_005_008_oPCAN_RADAR_4e8caadc_Tx: ComBitPosition=232, ComBitSize=8, ComSignalInitValue=0, ComSignalType=UINT8, ComSystemTemplateSystemSignalRef=DET_SNR_006
            DET_SNR_007_oRDR_DETECTION_005_008_oPCAN_RADAR_dbfc7e49_Tx: ComBitPosition=344, ComBitSize=8, ComSignalInitValue=0, ComSignalType=UINT8, ComSystemTemplateSystemSignalRef=DET_SNR_007
            DET_SNR_008_oRDR_DETECTION_005_008_oPCAN_RADAR_f7ecec0e_Tx: ComBitPosition=456, ComBitSize=8, ComSignalInitValue=0, ComSignalType=UINT8, ComSystemTemplateSystemSignalRef=DET_SNR_008
            DET_SUPER_RES_TARGET_005_oRDR_DETECTION_005_008_oPCAN_RADAR_1bf5f947_Tx: ComBitPosition=87, ComBitSize=1, ComSignalInitValue=0, ComSignalType=BOOLEAN, ComSystemTemplateSystemSignalRef=DET_SUPER_RES_TARGET_005
            DET_SUPER_RES_TARGET_006_oRDR_DETECTION_005_008_oPCAN_RADAR_7f1582b9_Tx: ComBitPosition=199, ComBitSize=1, ComSignalInitValue=0, ComSignalType=BOOLEAN, ComSystemTemplateSystemSignalRef=DET_SUPER_RES_TARGET_006
            DET_SUPER_RES_TARGET_007_oRDR_DETECTION_005_008_oPCAN_RADAR_ea65562c_Tx: ComBitPosition=311, ComBitSize=1, ComSignalInitValue=0, ComSignalType=BOOLEAN, ComSystemTemplateSystemSignalRef=DET_SUPER_RES_TARGET_007
            DET_SUPER_RES_TARGET_008_oRDR_DETECTION_005_008_oPCAN_RADAR_c675c46b_Tx: ComBitPosition=423, ComBitSize=1, ComSignalInitValue=0, ComSignalType=BOOLEAN, ComSystemTemplateSystemSignalRef=DET_SUPER_RES_TARGET_008
        SG_Detections_009_012_oRDR_DETECTION_009_012_oPCAN_RADAR_37f1858c_Tx: ComSystemTemplateSignalGroupRef=SG_Detections_009_012
          83 x ComGroupSignal, all with ComSignalEndianness=LITTLE_ENDIAN, ComTransferProperty=PENDING:
            DET_AZIMUTH_009_oRDR_DETECTION_009_012_oPCAN_RADAR_6fc7055c_Tx: ComBitPosition=88, ComBitSize=13, ComSignalInitValue=0, ComSignalType=UINT16, ComSystemTemplateSystemSignalRef=DET_AZIMUTH_009
            DET_AZIMUTH_010_oRDR_DETECTION_009_012_oPCAN_RADAR_0ae777f8_Tx: ComBitPosition=200, ComBitSize=13, ComSignalInitValue=0, ComSignalType=UINT16, ComSystemTemplateSystemSignalRef=DET_AZIMUTH_010
            DET_AZIMUTH_011_oRDR_DETECTION_009_012_oPCAN_RADAR_9f97a36d_Tx: ComBitPosition=312, ComBitSize=13, ComSignalInitValue=0, ComSignalType=UINT16, ComSystemTemplateSystemSignalRef=DET_AZIMUTH_011
            DET_AZIMUTH_012_oRDR_DETECTION_009_012_oPCAN_RADAR_fb77d893_Tx: ComBitPosition=424, ComBitSize=13, ComSignalInitValue=0, ComSignalType=UINT16, ComSystemTemplateSystemSignalRef=DET_AZIMUTH_012
            DET_AZIMUTH_ERR_009_oRDR_DETECTION_009_012_oPCAN_RADAR_cb7290a9_Tx: ComBitPosition=105, ComBitSize=7, ComSignalInitValue=0, ComSignalType=UINT8, ComSystemTemplateSystemSignalRef=DET_AZIMUTH_ERR_009
            DET_AZIMUTH_ERR_010_oRDR_DETECTION_009_012_oPCAN_RADAR_ae52e20d_Tx: ComBitPosition=217, ComBitSize=7, ComSignalInitValue=0, ComSignalType=UINT8, ComSystemTemplateSystemSignalRef=DET_AZIMUTH_ERR_010
            DET_AZIMUTH_ERR_011_oRDR_DETECTION_009_012_oPCAN_RADAR_3b223698_Tx: ComBitPosition=329, ComBitSize=7, ComSignalInitValue=0, ComSignalType=UINT8, ComSystemTemplateSystemSignalRef=DET_AZIMUTH_ERR_011
            DET_AZIMUTH_ERR_012_oRDR_DETECTION_009_012_oPCAN_RADAR_5fc24d66_Tx: ComBitPosition=441, ComBitSize=7, ComSignalInitValue=0, ComSignalType=UINT8, ComSystemTemplateSystemSignalRef=DET_AZIMUTH_ERR_012
            DET_BELOW_RAIN_THOLD_009_oRDR_DETECTION_009_012_oPCAN_RADAR_bac6969c_Tx: ComBitPosition=39, ComBitSize=1, ComSignalInitValue=0, ComSignalType=BOOLEAN, ComSystemTemplateSystemSignalRef=DET_BELOW_RAIN_THOLD_009
            DET_BELOW_RAIN_THOLD_010_oRDR_DETECTION_009_012_oPCAN_RADAR_dfe6e438_Tx: ComBitPosition=151, ComBitSize=1, ComSignalInitValue=0, ComSignalType=BOOLEAN, ComSystemTemplateSystemSignalRef=DET_BELOW_RAIN_THOLD_010
            DET_BELOW_RAIN_THOLD_011_oRDR_DETECTION_009_012_oPCAN_RADAR_4a9630ad_Tx: ComBitPosition=263, ComBitSize=1, ComSignalInitValue=0, ComSignalType=BOOLEAN, ComSystemTemplateSystemSignalRef=DET_BELOW_RAIN_THOLD_011
            DET_BELOW_RAIN_THOLD_012_oRDR_DETECTION_009_012_oPCAN_RADAR_2e764b53_Tx: ComBitPosition=375, ComBitSize=1, ComSignalInitValue=0, ComSignalType=BOOLEAN, ComSystemTemplateSystemSignalRef=DET_BELOW_RAIN_THOLD_012
            DET_BI_STATIC_FLAG_009_oRDR_DETECTION_009_012_oPCAN_RADAR_39eb45d9_Tx: ComBitPosition=104, ComBitSize=1, ComSignalInitValue=0, ComSignalType=BOOLEAN, ComSystemTemplateSystemSignalRef=DET_BI_STATIC_FLAG_009
            DET_BI_STATIC_FLAG_010_oRDR_DETECTION_009_012_oPCAN_RADAR_5ccb377d_Tx: ComBitPosition=216, ComBitSize=1, ComSignalInitValue=0, ComSignalType=BOOLEAN, ComSystemTemplateSystemSignalRef=DET_BI_STATIC_FLAG_010
            DET_BI_STATIC_FLAG_011_oRDR_DETECTION_009_012_oPCAN_RADAR_c9bbe3e8_Tx: ComBitPosition=328, ComBitSize=1, ComSignalInitValue=0, ComSignalType=BOOLEAN, ComSystemTemplateSystemSignalRef=DET_BI_STATIC_FLAG_011
            DET_BI_STATIC_FLAG_012_oRDR_DETECTION_009_012_oPCAN_RADAR_ad5b9816_Tx: ComBitPosition=440, ComBitSize=1, ComSignalInitValue=0, ComSignalType=BOOLEAN, ComSystemTemplateSystemSignalRef=DET_BI_STATIC_FLAG_012
            DET_CONFD_AZIMUTH_009_oRDR_DETECTION_009_012_oPCAN_RADAR_6d210f96_Tx: ComBitPosition=118, ComBitSize=2, ComSignalInitValue=0, ComSignalType=UINT8, ComSystemTemplateSystemSignalRef=DET_CONFD_AZIMUTH_009
            DET_CONFD_AZIMUTH_010_oRDR_DETECTION_009_012_oPCAN_RADAR_08017d32_Tx: ComBitPosition=230, ComBitSize=2, ComSignalInitValue=0, ComSignalType=UINT8, ComSystemTemplateSystemSignalRef=DET_CONFD_AZIMUTH_010
            DET_CONFD_AZIMUTH_011_oRDR_DETECTION_009_012_oPCAN_RADAR_9d71a9a7_Tx: ComBitPosition=342, ComBitSize=2, ComSignalInitValue=0, ComSignalType=UINT8, ComSystemTemplateSystemSignalRef=DET_CONFD_AZIMUTH_011
            DET_CONFD_AZIMUTH_012_oRDR_DETECTION_009_012_oPCAN_RADAR_f991d259_Tx: ComBitPosition=454, ComBitSize=2, ComSignalInitValue=0, ComSignalType=UINT8, ComSystemTemplateSystemSignalRef=DET_CONFD_AZIMUTH_012
            DET_CONFD_ELEVATION_009_oRDR_DETECTION_009_012_oPCAN_RADAR_6fb40e6c_Tx: ComBitPosition=101, ComBitSize=2, ComSignalInitValue=0, ComSignalType=UINT8, ComSystemTemplateSystemSignalRef=DET_CONFD_ELEVATION_009
            DET_CONFD_ELEVATION_010_oRDR_DETECTION_009_012_oPCAN_RADAR_0a947cc8_Tx: ComBitPosition=213, ComBitSize=2, ComSignalInitValue=0, ComSignalType=UINT8, ComSystemTemplateSystemSignalRef=DET_CONFD_ELEVATION_010
            DET_CONFD_ELEVATION_011_oRDR_DETECTION_009_012_oPCAN_RADAR_9fe4a85d_Tx: ComBitPosition=325, ComBitSize=2, ComSignalInitValue=0, ComSignalType=UINT8, ComSystemTemplateSystemSignalRef=DET_CONFD_ELEVATION_011
            DET_CONFD_ELEVATION_012_oRDR_DETECTION_009_012_oPCAN_RADAR_fb04d3a3_Tx: ComBitPosition=437, ComBitSize=2, ComSignalInitValue=0, ComSignalType=UINT8, ComSystemTemplateSystemSignalRef=DET_CONFD_ELEVATION_012
            DET_ELEVATION_009_oRDR_DETECTION_009_012_oPCAN_RADAR_be74da50_Tx: ComBitPosition=72, ComBitSize=8, ComSignalInitValue=0, ComSignalType=UINT8, ComSystemTemplateSystemSignalRef=DET_ELEVATION_009
            DET_ELEVATION_010_oRDR_DETECTION_009_012_oPCAN_RADAR_db54a8f4_Tx: ComBitPosition=184, ComBitSize=8, ComSignalInitValue=0, ComSignalType=UINT8, ComSystemTemplateSystemSignalRef=DET_ELEVATION_010
            DET_ELEVATION_011_oRDR_DETECTION_009_012_oPCAN_RADAR_4e247c61_Tx: ComBitPosition=296, ComBitSize=8, ComSignalInitValue=0, ComSignalType=UINT8, ComSystemTemplateSystemSignalRef=DET_ELEVATION_011
            DET_ELEVATION_012_oRDR_DETECTION_009_012_oPCAN_RADAR_2ac4079f_Tx: ComBitPosition=408, ComBitSize=8, ComSignalInitValue=0, ComSignalType=UINT8, ComSystemTemplateSystemSignalRef=DET_ELEVATION_012
            DET_ELEVATION_ERR_009_oRDR_DETECTION_009_012_oPCAN_RADAR_394d4225_Tx: ComBitPosition=80, ComBitSize=6, ComSignalInitValue=0, ComSignalType=UINT8, ComSystemTemplateSystemSignalRef=DET_ELEVATION_ERR_009
            DET_ELEVATION_ERR_010_oRDR_DETECTION_009_012_oPCAN_RADAR_5c6d3081_Tx: ComBitPosition=192, ComBitSize=6, ComSignalInitValue=0, ComSignalType=UINT8, ComSystemTemplateSystemSignalRef=DET_ELEVATION_ERR_010
            DET_ELEVATION_ERR_011_oRDR_DETECTION_009_012_oPCAN_RADAR_c91de414_Tx: ComBitPosition=304, ComBitSize=6, ComSignalInitValue=0, ComSignalType=UINT8, ComSystemTemplateSystemSignalRef=DET_ELEVATION_ERR_011
            DET_ELEVATION_ERR_012_oRDR_DETECTION_009_012_oPCAN_RADAR_adfd9fea_Tx: ComBitPosition=416, ComBitSize=6, ComSignalInitValue=0, ComSignalType=UINT8, ComSystemTemplateSystemSignalRef=DET_ELEVATION_ERR_012
            DET_EXISTENCE_PROB_009_oRDR_DETECTION_009_012_oPCAN_RADAR_ebd23745_Tx: ComBitPosition=112, ComBitSize=6, ComSignalInitValue=0, ComSignalType=UINT8, ComSystemTemplateSystemSignalRef=DET_EXISTENCE_PROB_009
            DET_EXISTENCE_PROB_010_oRDR_DETECTION_009_012_oPCAN_RADAR_8ef245e1_Tx: ComBitPosition=224, ComBitSize=6, ComSignalInitValue=0, ComSignalType=UINT8, ComSystemTemplateSystemSignalRef=DET_EXISTENCE_PROB_010
            DET_EXISTENCE_PROB_011_oRDR_DETECTION_009_012_oPCAN_RADAR_1b829174_Tx: ComBitPosition=336, ComBitSize=6, ComSignalInitValue=0, ComSignalType=UINT8, ComSystemTemplateSystemSignalRef=DET_EXISTENCE_PROB_011
            DET_EXISTENCE_PROB_012_oRDR_DETECTION_009_012_oPCAN_RADAR_7f62ea8a_Tx: ComBitPosition=448, ComBitSize=6, ComSignalInitValue=0, ComSignalType=UINT8, ComSystemTemplateSystemSignalRef=DET_EXISTENCE_PROB_012
            DET_HVC_FLAG_009_oRDR_DETECTION_009_012_oPCAN_RADAR_0aa6743a_Tx: ComBitPosition=86, ComBitSize=1, ComSignalInitValue=0, ComSignalType=BOOLEAN, ComSystemTemplateSystemSignalRef=DET_HVC_FLAG_009
            DET_HVC_FLAG_010_oRDR_DETECTION_009_012_oPCAN_RADAR_6f86069e_Tx: ComBitPosition=198, ComBitSize=1, ComSignalInitValue=0, ComSignalType=BOOLEAN, ComSystemTemplateSystemSignalRef=DET_HVC_FLAG_010
            DET_HVC_FLAG_011_oRDR_DETECTION_009_012_oPCAN_RADAR_faf6d20b_Tx: ComBitPosition=310, ComBitSize=1, ComSignalInitValue=0, ComSignalType=BOOLEAN, ComSystemTemplateSystemSignalRef=DET_HVC_FLAG_011
            DET_HVC_FLAG_012_oRDR_DETECTION_009_012_oPCAN_RADAR_9e16a9f5_Tx: ComBitPosition=422, ComBitSize=1, ComSignalInitValue=0, ComSignalType=BOOLEAN, ComSystemTemplateSystemSignalRef=DET_HVC_FLAG_012
            DET_IDM_009_oRDR_DETECTION_009_012_oPCAN_RADAR_81f44f87_Tx: ComBitPosition=63, ComBitSize=1, ComSignalInitValue=0, ComSignalType=BOOLEAN, ComSystemTemplateSystemSignalRef=DET_IDM_009
            DET_IDM_010_oRDR_DETECTION_009_012_oPCAN_RADAR_e4d43d23_Tx: ComBitPosition=175, ComBitSize=1, ComSignalInitValue=0, ComSignalType=BOOLEAN, ComSystemTemplateSystemSignalRef=DET_IDM_010
            DET_IDM_011_oRDR_DETECTION_009_012_oPCAN_RADAR_71a4e9b6_Tx: ComBitPosition=287, ComBitSize=1, ComSignalInitValue=0, ComSignalType=BOOLEAN, ComSystemTemplateSystemSignalRef=DET_IDM_011
            DET_IDM_012_oRDR_DETECTION_009_012_oPCAN_RADAR_15449248_Tx: ComBitPosition=399, ComBitSize=1, ComSignalInitValue=0, ComSignalType=BOOLEAN, ComSystemTemplateSystemSignalRef=DET_IDM_012
            DET_MH_CRC16_009_012_oRDR_DETECTION_009_012_oPCAN_RADAR_b3795787_Tx: ComBitPosition=0, ComBitSize=16, ComSignalInitValue=0, ComSignalType=UINT16, ComSystemTemplateSystemSignalRef=DET_MH_CRC16_009_012
            DET_MH_CYCLE_COUNTER_009_012_oRDR_DETECTION_009_012_oPCAN_RADAR_370cf6b0_Tx: ComBitPosition=16, ComBitSize=8, ComSignalInitValue=0, ComSignalType=UINT8, ComSystemTemplateSystemSignalRef=DET_MH_CYCLE_COUNTER_009_012
            DET_MH_SCAN_INDEX_4LSB_009_012_oRDR_DETECTION_009_012_oPCAN_RADAR_fb26d33c_Tx: ComBitPosition=476, ComBitSize=4, ComSignalInitValue=0, ComSignalType=UINT8, ComSystemTemplateSystemSignalRef=DET_MH_SCAN_INDEX_4LSB_009_012
            DET_MTD_009_oRDR_DETECTION_009_012_oPCAN_RADAR_e7477d5c_Tx: ComBitPosition=47, ComBitSize=1, ComSignalInitValue=0, ComSignalType=BOOLEAN, ComSystemTemplateSystemSignalRef=DET_MTD_009
            DET_MTD_010_oRDR_DETECTION_009_012_oPCAN_RADAR_82670ff8_Tx: ComBitPosition=159, ComBitSize=1, ComSignalInitValue=0, ComSignalType=BOOLEAN, ComSystemTemplateSystemSignalRef=DET_MTD_010
            DET_MTD_011_oRDR_DETECTION_009_012_oPCAN_RADAR_1717db6d_Tx: ComBitPosition=271, ComBitSize=1, ComSignalInitValue=0, ComSignalType=BOOLEAN, ComSystemTemplateSystemSignalRef=DET_MTD_011
            DET_MTD_012_oRDR_DETECTION_009_012_oPCAN_RADAR_73f7a093_Tx: ComBitPosition=383, ComBitSize=1, ComSignalInitValue=0, ComSignalType=BOOLEAN, ComSystemTemplateSystemSignalRef=DET_MTD_012
            DET_PROB_1STAZHYPO_009_oRDR_DETECTION_009_012_oPCAN_RADAR_74f39591_Tx: ComBitPosition=103, ComBitSize=1, ComSignalInitValue=0, ComSignalType=BOOLEAN, ComSystemTemplateSystemSignalRef=DET_PROB_1STAZHYPO_009
            DET_PROB_1STAZHYPO_010_oRDR_DETECTION_009_012_oPCAN_RADAR_11d3e735_Tx: ComBitPosition=215, ComBitSize=1, ComSignalInitValue=0, ComSignalType=BOOLEAN, ComSystemTemplateSystemSignalRef=DET_PROB_1STAZHYPO_010
            DET_PROB_1STAZHYPO_011_oRDR_DETECTION_009_012_oPCAN_RADAR_84a333a0_Tx: ComBitPosition=327, ComBitSize=1, ComSignalInitValue=0, ComSignalType=BOOLEAN, ComSystemTemplateSystemSignalRef=DET_PROB_1STAZHYPO_011
            DET_PROB_1STAZHYPO_012_oRDR_DETECTION_009_012_oPCAN_RADAR_e043485e_Tx: ComBitPosition=439, ComBitSize=1, ComSignalInitValue=0, ComSignalType=BOOLEAN, ComSystemTemplateSystemSignalRef=DET_PROB_1STAZHYPO_012
            DET_RANGE_009_oRDR_DETECTION_009_012_oPCAN_RADAR_7f5c76e7_Tx: ComBitPosition=24, ComBitSize=15, ComSignalInitValue=0, ComSignalType=UINT16, ComSystemTemplateSystemSignalRef=DET_RANGE_009
            DET_RANGE_010_oRDR_DETECTION_009_012_oPCAN_RADAR_1a7c0443_Tx: ComBitPosition=136, ComBitSize=15, ComSignalInitValue=0, ComSignalType=UINT16, ComSystemTemplateSystemSignalRef=DET_RANGE_010
            DET_RANGE_011_oRDR_DETECTION_009_012_oPCAN_RADAR_8f0cd0d6_Tx: ComBitPosition=248, ComBitSize=15, ComSignalInitValue=0, ComSignalType=UINT16, ComSystemTemplateSystemSignalRef=DET_RANGE_011
            DET_RANGE_012_oRDR_DETECTION_009_012_oPCAN_RADAR_ebecab28_Tx: ComBitPosition=360, ComBitSize=15, ComSignalInitValue=0, ComSignalType=UINT16, ComSystemTemplateSystemSignalRef=DET_RANGE_012
            DET_RANGE_ERR_009_oRDR_DETECTION_009_012_oPCAN_RADAR_d8b4cc8e_Tx: ComBitPosition=40, ComBitSize=7, ComSignalInitValue=0, ComSignalType=UINT8, ComSystemTemplateSystemSignalRef=DET_RANGE_ERR_009
            DET_RANGE_ERR_010_oRDR_DETECTION_009_012_oPCAN_RADAR_bd94be2a_Tx: ComBitPosition=152, ComBitSize=7, ComSignalInitValue=0, ComSignalType=UINT8, ComSystemTemplateSystemSignalRef=DET_RANGE_ERR_010
            DET_RANGE_ERR_011_oRDR_DETECTION_009_012_oPCAN_RADAR_28e46abf_Tx: ComBitPosition=264, ComBitSize=7, ComSignalInitValue=0, ComSignalType=UINT8, ComSystemTemplateSystemSignalRef=DET_RANGE_ERR_011
            DET_RANGE_ERR_012_oRDR_DETECTION_009_012_oPCAN_RADAR_4c041141_Tx: ComBitPosition=376, ComBitSize=7, ComSignalInitValue=0, ComSignalType=UINT8, ComSystemTemplateSystemSignalRef=DET_RANGE_ERR_012
            DET_RANGE_VELOCITY_009_oRDR_DETECTION_009_012_oPCAN_RADAR_0afab4c2_Tx: ComBitPosition=48, ComBitSize=15, ComSignalInitValue=16384, ComSignalType=UINT16, ComSystemTemplateSystemSignalRef=DET_RANGE_VELOCITY_009
            DET_RANGE_VELOCITY_010_oRDR_DETECTION_009_012_oPCAN_RADAR_6fdac666_Tx: ComBitPosition=160, ComBitSize=15, ComSignalInitValue=16384, ComSignalType=UINT16, ComSystemTemplateSystemSignalRef=DET_RANGE_VELOCITY_010
            DET_RANGE_VELOCITY_011_oRDR_DETECTION_009_012_oPCAN_RADAR_faaa12f3_Tx: ComBitPosition=272, ComBitSize=15, ComSignalInitValue=16384, ComSignalType=UINT16, ComSystemTemplateSystemSignalRef=DET_RANGE_VELOCITY_011
            DET_RANGE_VELOCITY_012_oRDR_DETECTION_009_012_oPCAN_RADAR_9e4a690d_Tx: ComBitPosition=384, ComBitSize=15, ComSignalInitValue=16384, ComSignalType=UINT16, ComSystemTemplateSystemSignalRef=DET_RANGE_VELOCITY_012
            DET_RANGE_VELOCITY_ERR_009_oRDR_DETECTION_009_012_oPCAN_RADAR_05414f70_Tx: ComBitPosition=64, ComBitSize=8, ComSignalInitValue=0, ComSignalType=UINT8, ComSystemTemplateSystemSignalRef=DET_RANGE_VELOCITY_ERR_009
            DET_RANGE_VELOCITY_ERR_010_oRDR_DETECTION_009_012_oPCAN_RADAR_60613dd4_Tx: ComBitPosition=176, ComBitSize=8, ComSignalInitValue=0, ComSignalType=UINT8, ComSystemTemplateSystemSignalRef=DET_RANGE_VELOCITY_ERR_010
            DET_RANGE_VELOCITY_ERR_011_oRDR_DETECTION_009_012_oPCAN_RADAR_f511e941_Tx: ComBitPosition=288, ComBitSize=8, ComSignalInitValue=0, ComSignalType=UINT8, ComSystemTemplateSystemSignalRef=DET_RANGE_VELOCITY_ERR_011
            DET_RANGE_VELOCITY_ERR_012_oRDR_DETECTION_009_012_oPCAN_RADAR_91f192bf_Tx: ComBitPosition=400, ComBitSize=8, ComSignalInitValue=0, ComSignalType=UINT8, ComSystemTemplateSystemSignalRef=DET_RANGE_VELOCITY_ERR_012
            DET_RCS_009_oRDR_DETECTION_009_012_oPCAN_RADAR_8d7a8398_Tx: ComBitPosition=128, ComBitSize=8, ComSignalInitValue=128, ComSignalType=UINT8, ComSystemTemplateSystemSignalRef=DET_RCS_009
            DET_RCS_010_oRDR_DETECTION_009_012_oPCAN_RADAR_e85af13c_Tx: ComBitPosition=240, ComBitSize=8, ComSignalInitValue=128, ComSignalType=UINT8, ComSystemTemplateSystemSignalRef=DET_RCS_010
            DET_RCS_011_oRDR_DETECTION_009_012_oPCAN_RADAR_7d2a25a9_Tx: ComBitPosition=352, ComBitSize=8, ComSignalInitValue=128, ComSignalType=UINT8, ComSystemTemplateSystemSignalRef=DET_RCS_011
            DET_RCS_012_oRDR_DETECTION_009_012_oPCAN_RADAR_19ca5e57_Tx: ComBitPosition=464, ComBitSize=8, ComSignalInitValue=128, ComSignalType=UINT8, ComSystemTemplateSystemSignalRef=DET_RCS_012
            DET_SNR_009_oRDR_DETECTION_009_012_oPCAN_RADAR_50d4d79a_Tx: ComBitPosition=120, ComBitSize=8, ComSignalInitValue=0, ComSignalType=UINT8, ComSystemTemplateSystemSignalRef=DET_SNR_009
            DET_SNR_010_oRDR_DETECTION_009_012_oPCAN_RADAR_35f4a53e_Tx: ComBitPosition=232, ComBitSize=8, ComSignalInitValue=0, ComSignalType=UINT8, ComSystemTemplateSystemSignalRef=DET_SNR_010
            DET_SNR_011_oRDR_DETECTION_009_012_oPCAN_RADAR_a08471ab_Tx: ComBitPosition=344, ComBitSize=8, ComSignalInitValue=0, ComSignalType=UINT8, ComSystemTemplateSystemSignalRef=DET_SNR_011
            DET_SNR_012_oRDR_DETECTION_009_012_oPCAN_RADAR_c4640a55_Tx: ComBitPosition=456, ComBitSize=8, ComSignalInitValue=0, ComSignalType=UINT8, ComSystemTemplateSystemSignalRef=DET_SNR_012
            DET_SUPER_RES_TARGET_009_oRDR_DETECTION_009_012_oPCAN_RADAR_614dffff_Tx: ComBitPosition=87, ComBitSize=1, ComSignalInitValue=0, ComSignalType=BOOLEAN, ComSystemTemplateSystemSignalRef=DET_SUPER_RES_TARGET_009
            DET_SUPER_RES_TARGET_010_oRDR_DETECTION_009_012_oPCAN_RADAR_046d8d5b_Tx: ComBitPosition=199, ComBitSize=1, ComSignalInitValue=0, ComSignalType=BOOLEAN, ComSystemTemplateSystemSignalRef=DET_SUPER_RES_TARGET_010
            DET_SUPER_RES_TARGET_011_oRDR_DETECTION_009_012_oPCAN_RADAR_911d59ce_Tx: ComBitPosition=311, ComBitSize=1, ComSignalInitValue=0, ComSignalType=BOOLEAN, ComSystemTemplateSystemSignalRef=DET_SUPER_RES_TARGET_011
            DET_SUPER_RES_TARGET_012_oRDR_DETECTION_009_012_oPCAN_RADAR_f5fd2230_Tx: ComBitPosition=423, ComBitSize=1, ComSignalInitValue=0, ComSignalType=BOOLEAN, ComSystemTemplateSystemSignalRef=DET_SUPER_RES_TARGET_012
        SG_Detections_013_016_oRDR_DETECTION_013_016_oPCAN_RADAR_05faeda4_Tx: ComSystemTemplateSignalGroupRef=SG_Detections_013_016
          83 x ComGroupSignal, all with ComSignalEndianness=LITTLE_ENDIAN, ComTransferProperty=PENDING:
            DET_AZIMUTH_013_oRDR_DETECTION_013_016_oPCAN_RADAR_73c00f28_Tx: ComBitPosition=88, ComBitSize=13, ComSignalInitValue=0, ComSignalType=UINT16, ComSystemTemplateSystemSignalRef=DET_AZIMUTH_013
            DET_AZIMUTH_014_oRDR_DETECTION_013_016_oPCAN_RADAR_2f702c41_Tx: ComBitPosition=200, ComBitSize=13, ComSignalInitValue=0, ComSignalType=UINT16, ComSystemTemplateSystemSignalRef=DET_AZIMUTH_014
            DET_AZIMUTH_015_oRDR_DETECTION_013_016_oPCAN_RADAR_ba00f8d4_Tx: ComBitPosition=312, ComBitSize=13, ComSignalInitValue=0, ComSignalType=UINT16, ComSystemTemplateSystemSignalRef=DET_AZIMUTH_015
            DET_AZIMUTH_016_oRDR_DETECTION_013_016_oPCAN_RADAR_dee0832a_Tx: ComBitPosition=424, ComBitSize=13, ComSignalInitValue=0, ComSignalType=UINT16, ComSystemTemplateSystemSignalRef=DET_AZIMUTH_016
            DET_AZIMUTH_ERR_013_oRDR_DETECTION_013_016_oPCAN_RADAR_d7759add_Tx: ComBitPosition=105, ComBitSize=7, ComSignalInitValue=0, ComSignalType=UINT8, ComSystemTemplateSystemSignalRef=DET_AZIMUTH_ERR_013
            DET_AZIMUTH_ERR_014_oRDR_DETECTION_013_016_oPCAN_RADAR_8bc5b9b4_Tx: ComBitPosition=217, ComBitSize=7, ComSignalInitValue=0, ComSignalType=UINT8, ComSystemTemplateSystemSignalRef=DET_AZIMUTH_ERR_014
            DET_AZIMUTH_ERR_015_oRDR_DETECTION_013_016_oPCAN_RADAR_1eb56d21_Tx: ComBitPosition=329, ComBitSize=7, ComSignalInitValue=0, ComSignalType=UINT8, ComSystemTemplateSystemSignalRef=DET_AZIMUTH_ERR_015
            DET_AZIMUTH_ERR_016_oRDR_DETECTION_013_016_oPCAN_RADAR_7a5516df_Tx: ComBitPosition=441, ComBitSize=7, ComSignalInitValue=0, ComSignalType=UINT8, ComSystemTemplateSystemSignalRef=DET_AZIMUTH_ERR_016
            DET_BELOW_RAIN_THOLD_013_oRDR_DETECTION_013_016_oPCAN_RADAR_a6c19ce8_Tx: ComBitPosition=39, ComBitSize=1, ComSignalInitValue=0, ComSignalType=BOOLEAN, ComSystemTemplateSystemSignalRef=DET_BELOW_RAIN_THOLD_013
            DET_BELOW_RAIN_THOLD_014_oRDR_DETECTION_013_016_oPCAN_RADAR_fa71bf81_Tx: ComBitPosition=151, ComBitSize=1, ComSignalInitValue=0, ComSignalType=BOOLEAN, ComSystemTemplateSystemSignalRef=DET_BELOW_RAIN_THOLD_014
            DET_BELOW_RAIN_THOLD_015_oRDR_DETECTION_013_016_oPCAN_RADAR_6f016b14_Tx: ComBitPosition=263, ComBitSize=1, ComSignalInitValue=0, ComSignalType=BOOLEAN, ComSystemTemplateSystemSignalRef=DET_BELOW_RAIN_THOLD_015
            DET_BELOW_RAIN_THOLD_016_oRDR_DETECTION_013_016_oPCAN_RADAR_0be110ea_Tx: ComBitPosition=375, ComBitSize=1, ComSignalInitValue=0, ComSignalType=BOOLEAN, ComSystemTemplateSystemSignalRef=DET_BELOW_RAIN_THOLD_016
            DET_BI_STATIC_FLAG_013_oRDR_DETECTION_013_016_oPCAN_RADAR_25ec4fad_Tx: ComBitPosition=104, ComBitSize=1, ComSignalInitValue=0, ComSignalType=BOOLEAN, ComSystemTemplateSystemSignalRef=DET_BI_STATIC_FLAG_013
            DET_BI_STATIC_FLAG_014_oRDR_DETECTION_013_016_oPCAN_RADAR_795c6cc4_Tx: ComBitPosition=216, ComBitSize=1, ComSignalInitValue=0, ComSignalType=BOOLEAN, ComSystemTemplateSystemSignalRef=DET_BI_STATIC_FLAG_014
            DET_BI_STATIC_FLAG_015_oRDR_DETECTION_013_016_oPCAN_RADAR_ec2cb851_Tx: ComBitPosition=328, ComBitSize=1, ComSignalInitValue=0, ComSignalType=BOOLEAN, ComSystemTemplateSystemSignalRef=DET_BI_STATIC_FLAG_015
            DET_BI_STATIC_FLAG_016_oRDR_DETECTION_013_016_oPCAN_RADAR_88ccc3af_Tx: ComBitPosition=440, ComBitSize=1, ComSignalInitValue=0, ComSignalType=BOOLEAN, ComSystemTemplateSystemSignalRef=DET_BI_STATIC_FLAG_016
            DET_CONFD_AZIMUTH_013_oRDR_DETECTION_013_016_oPCAN_RADAR_712605e2_Tx: ComBitPosition=118, ComBitSize=2, ComSignalInitValue=0, ComSignalType=UINT8, ComSystemTemplateSystemSignalRef=DET_CONFD_AZIMUTH_013
            DET_CONFD_AZIMUTH_014_oRDR_DETECTION_013_016_oPCAN_RADAR_2d96268b_Tx: ComBitPosition=230, ComBitSize=2, ComSignalInitValue=0, ComSignalType=UINT8, ComSystemTemplateSystemSignalRef=DET_CONFD_AZIMUTH_014
            DET_CONFD_AZIMUTH_015_oRDR_DETECTION_013_016_oPCAN_RADAR_b8e6f21e_Tx: ComBitPosition=342, ComBitSize=2, ComSignalInitValue=0, ComSignalType=UINT8, ComSystemTemplateSystemSignalRef=DET_CONFD_AZIMUTH_015
            DET_CONFD_AZIMUTH_016_oRDR_DETECTION_013_016_oPCAN_RADAR_dc0689e0_Tx: ComBitPosition=454, ComBitSize=2, ComSignalInitValue=0, ComSignalType=UINT8, ComSystemTemplateSystemSignalRef=DET_CONFD_AZIMUTH_016
            DET_CONFD_ELEVATION_013_oRDR_DETECTION_013_016_oPCAN_RADAR_73b30418_Tx: ComBitPosition=101, ComBitSize=2, ComSignalInitValue=0, ComSignalType=UINT8, ComSystemTemplateSystemSignalRef=DET_CONFD_ELEVATION_013
            DET_CONFD_ELEVATION_014_oRDR_DETECTION_013_016_oPCAN_RADAR_2f032771_Tx: ComBitPosition=213, ComBitSize=2, ComSignalInitValue=0, ComSignalType=UINT8, ComSystemTemplateSystemSignalRef=DET_CONFD_ELEVATION_014
            DET_CONFD_ELEVATION_015_oRDR_DETECTION_013_016_oPCAN_RADAR_ba73f3e4_Tx: ComBitPosition=325, ComBitSize=2, ComSignalInitValue=0, ComSignalType=UINT8, ComSystemTemplateSystemSignalRef=DET_CONFD_ELEVATION_015
            DET_CONFD_ELEVATION_016_oRDR_DETECTION_013_016_oPCAN_RADAR_de93881a_Tx: ComBitPosition=437, ComBitSize=2, ComSignalInitValue=0, ComSignalType=UINT8, ComSystemTemplateSystemSignalRef=DET_CONFD_ELEVATION_016
            DET_ELEVATION_013_oRDR_DETECTION_013_016_oPCAN_RADAR_a273d024_Tx: ComBitPosition=72, ComBitSize=8, ComSignalInitValue=0, ComSignalType=UINT8, ComSystemTemplateSystemSignalRef=DET_ELEVATION_013
            DET_ELEVATION_014_oRDR_DETECTION_013_016_oPCAN_RADAR_fec3f34d_Tx: ComBitPosition=184, ComBitSize=8, ComSignalInitValue=0, ComSignalType=UINT8, ComSystemTemplateSystemSignalRef=DET_ELEVATION_014
            DET_ELEVATION_015_oRDR_DETECTION_013_016_oPCAN_RADAR_6bb327d8_Tx: ComBitPosition=296, ComBitSize=8, ComSignalInitValue=0, ComSignalType=UINT8, ComSystemTemplateSystemSignalRef=DET_ELEVATION_015
            DET_ELEVATION_016_oRDR_DETECTION_013_016_oPCAN_RADAR_0f535c26_Tx: ComBitPosition=408, ComBitSize=8, ComSignalInitValue=0, ComSignalType=UINT8, ComSystemTemplateSystemSignalRef=DET_ELEVATION_016
            DET_ELEVATION_ERR_013_oRDR_DETECTION_013_016_oPCAN_RADAR_254a4851_Tx: ComBitPosition=80, ComBitSize=6, ComSignalInitValue=0, ComSignalType=UINT8, ComSystemTemplateSystemSignalRef=DET_ELEVATION_ERR_013
            DET_ELEVATION_ERR_014_oRDR_DETECTION_013_016_oPCAN_RADAR_79fa6b38_Tx: ComBitPosition=192, ComBitSize=6, ComSignalInitValue=0, ComSignalType=UINT8, ComSystemTemplateSystemSignalRef=DET_ELEVATION_ERR_014
            DET_ELEVATION_ERR_015_oRDR_DETECTION_013_016_oPCAN_RADAR_ec8abfad_Tx: ComBitPosition=304, ComBitSize=6, ComSignalInitValue=0, ComSignalType=UINT8, ComSystemTemplateSystemSignalRef=DET_ELEVATION_ERR_015
            DET_ELEVATION_ERR_016_oRDR_DETECTION_013_016_oPCAN_RADAR_886ac453_Tx: ComBitPosition=416, ComBitSize=6, ComSignalInitValue=0, ComSignalType=UINT8, ComSystemTemplateSystemSignalRef=DET_ELEVATION_ERR_016
            DET_EXISTENCE_PROB_013_oRDR_DETECTION_013_016_oPCAN_RADAR_f7d53d31_Tx: ComBitPosition=112, ComBitSize=6, ComSignalInitValue=0, ComSignalType=UINT8, ComSystemTemplateSystemSignalRef=DET_EXISTENCE_PROB_013
            DET_EXISTENCE_PROB_014_oRDR_DETECTION_013_016_oPCAN_RADAR_ab651e58_Tx: ComBitPosition=224, ComBitSize=6, ComSignalInitValue=0, ComSignalType=UINT8, ComSystemTemplateSystemSignalRef=DET_EXISTENCE_PROB_014
            DET_EXISTENCE_PROB_015_oRDR_DETECTION_013_016_oPCAN_RADAR_3e15cacd_Tx: ComBitPosition=336, ComBitSize=6, ComSignalInitValue=0, ComSignalType=UINT8, ComSystemTemplateSystemSignalRef=DET_EXISTENCE_PROB_015
            DET_EXISTENCE_PROB_016_oRDR_DETECTION_013_016_oPCAN_RADAR_5af5b133_Tx: ComBitPosition=448, ComBitSize=6, ComSignalInitValue=0, ComSignalType=UINT8, ComSystemTemplateSystemSignalRef=DET_EXISTENCE_PROB_016
            DET_HVC_FLAG_013_oRDR_DETECTION_013_016_oPCAN_RADAR_16a17e4e_Tx: ComBitPosition=86, ComBitSize=1, ComSignalInitValue=0, ComSignalType=BOOLEAN, ComSystemTemplateSystemSignalRef=DET_HVC_FLAG_013
            DET_HVC_FLAG_014_oRDR_DETECTION_013_016_oPCAN_RADAR_4a115d27_Tx: ComBitPosition=198, ComBitSize=1, ComSignalInitValue=0, ComSignalType=BOOLEAN, ComSystemTemplateSystemSignalRef=DET_HVC_FLAG_014
            DET_HVC_FLAG_015_oRDR_DETECTION_013_016_oPCAN_RADAR_df6189b2_Tx: ComBitPosition=310, ComBitSize=1, ComSignalInitValue=0, ComSignalType=BOOLEAN, ComSystemTemplateSystemSignalRef=DET_HVC_FLAG_015
            DET_HVC_FLAG_016_oRDR_DETECTION_013_016_oPCAN_RADAR_bb81f24c_Tx: ComBitPosition=422, ComBitSize=1, ComSignalInitValue=0, ComSignalType=BOOLEAN, ComSystemTemplateSystemSignalRef=DET_HVC_FLAG_016
            DET_IDM_013_oRDR_DETECTION_013_016_oPCAN_RADAR_9df345f3_Tx: ComBitPosition=63, ComBitSize=1, ComSignalInitValue=0, ComSignalType=BOOLEAN, ComSystemTemplateSystemSignalRef=DET_IDM_013
            DET_IDM_014_oRDR_DETECTION_013_016_oPCAN_RADAR_c143669a_Tx: ComBitPosition=175, ComBitSize=1, ComSignalInitValue=0, ComSignalType=BOOLEAN, ComSystemTemplateSystemSignalRef=DET_IDM_014
            DET_IDM_015_oRDR_DETECTION_013_016_oPCAN_RADAR_5433b20f_Tx: ComBitPosition=287, ComBitSize=1, ComSignalInitValue=0, ComSignalType=BOOLEAN, ComSystemTemplateSystemSignalRef=DET_IDM_015
            DET_IDM_016_oRDR_DETECTION_013_016_oPCAN_RADAR_30d3c9f1_Tx: ComBitPosition=399, ComBitSize=1, ComSignalInitValue=0, ComSignalType=BOOLEAN, ComSystemTemplateSystemSignalRef=DET_IDM_016
            DET_MH_CRC16_013_016_oRDR_DETECTION_013_016_oPCAN_RADAR_81723faf_Tx: ComBitPosition=0, ComBitSize=16, ComSignalInitValue=0, ComSignalType=UINT16, ComSystemTemplateSystemSignalRef=DET_MH_CRC16_013_016
            DET_MH_CYCLE_COUNTER_013_016_oRDR_DETECTION_013_016_oPCAN_RADAR_05079e98_Tx: ComBitPosition=16, ComBitSize=8, ComSignalInitValue=0, ComSignalType=UINT8, ComSystemTemplateSystemSignalRef=DET_MH_CYCLE_COUNTER_013_016
            DET_MH_SCAN_INDEX_4LSB_013_016_oRDR_DETECTION_013_016_oPCAN_RADAR_c92dbb14_Tx: ComBitPosition=476, ComBitSize=4, ComSignalInitValue=0, ComSignalType=UINT8, ComSystemTemplateSystemSignalRef=DET_MH_SCAN_INDEX_4LSB_013_016
            DET_MTD_013_oRDR_DETECTION_013_016_oPCAN_RADAR_fb407728_Tx: ComBitPosition=47, ComBitSize=1, ComSignalInitValue=0, ComSignalType=BOOLEAN, ComSystemTemplateSystemSignalRef=DET_MTD_013
            DET_MTD_014_oRDR_DETECTION_013_016_oPCAN_RADAR_a7f05441_Tx: ComBitPosition=159, ComBitSize=1, ComSignalInitValue=0, ComSignalType=BOOLEAN, ComSystemTemplateSystemSignalRef=DET_MTD_014
            DET_MTD_015_oRDR_DETECTION_013_016_oPCAN_RADAR_328080d4_Tx: ComBitPosition=271, ComBitSize=1, ComSignalInitValue=0, ComSignalType=BOOLEAN, ComSystemTemplateSystemSignalRef=DET_MTD_015
            DET_MTD_016_oRDR_DETECTION_013_016_oPCAN_RADAR_5660fb2a_Tx: ComBitPosition=383, ComBitSize=1, ComSignalInitValue=0, ComSignalType=BOOLEAN, ComSystemTemplateSystemSignalRef=DET_MTD_016
            DET_PROB_1STAZHYPO_013_oRDR_DETECTION_013_016_oPCAN_RADAR_68f49fe5_Tx: ComBitPosition=103, ComBitSize=1, ComSignalInitValue=0, ComSignalType=BOOLEAN, ComSystemTemplateSystemSignalRef=DET_PROB_1STAZHYPO_013
            DET_PROB_1STAZHYPO_014_oRDR_DETECTION_013_016_oPCAN_RADAR_3444bc8c_Tx: ComBitPosition=215, ComBitSize=1, ComSignalInitValue=0, ComSignalType=BOOLEAN, ComSystemTemplateSystemSignalRef=DET_PROB_1STAZHYPO_014
            DET_PROB_1STAZHYPO_015_oRDR_DETECTION_013_016_oPCAN_RADAR_a1346819_Tx: ComBitPosition=327, ComBitSize=1, ComSignalInitValue=0, ComSignalType=BOOLEAN, ComSystemTemplateSystemSignalRef=DET_PROB_1STAZHYPO_015
            DET_PROB_1STAZHYPO_016_oRDR_DETECTION_013_016_oPCAN_RADAR_c5d413e7_Tx: ComBitPosition=439, ComBitSize=1, ComSignalInitValue=0, ComSignalType=BOOLEAN, ComSystemTemplateSystemSignalRef=DET_PROB_1STAZHYPO_016
            DET_RANGE_013_oRDR_DETECTION_013_016_oPCAN_RADAR_635b7c93_Tx: ComBitPosition=24, ComBitSize=15, ComSignalInitValue=0, ComSignalType=UINT16, ComSystemTemplateSystemSignalRef=DET_RANGE_013
            DET_RANGE_014_oRDR_DETECTION_013_016_oPCAN_RADAR_3feb5ffa_Tx: ComBitPosition=136, ComBitSize=15, ComSignalInitValue=0, ComSignalType=UINT16, ComSystemTemplateSystemSignalRef=DET_RANGE_014
            DET_RANGE_015_oRDR_DETECTION_013_016_oPCAN_RADAR_aa9b8b6f_Tx: ComBitPosition=248, ComBitSize=15, ComSignalInitValue=0, ComSignalType=UINT16, ComSystemTemplateSystemSignalRef=DET_RANGE_015
            DET_RANGE_016_oRDR_DETECTION_013_016_oPCAN_RADAR_ce7bf091_Tx: ComBitPosition=360, ComBitSize=15, ComSignalInitValue=0, ComSignalType=UINT16, ComSystemTemplateSystemSignalRef=DET_RANGE_016
            DET_RANGE_ERR_013_oRDR_DETECTION_013_016_oPCAN_RADAR_c4b3c6fa_Tx: ComBitPosition=40, ComBitSize=7, ComSignalInitValue=0, ComSignalType=UINT8, ComSystemTemplateSystemSignalRef=DET_RANGE_ERR_013
            DET_RANGE_ERR_014_oRDR_DETECTION_013_016_oPCAN_RADAR_9803e593_Tx: ComBitPosition=152, ComBitSize=7, ComSignalInitValue=0, ComSignalType=UINT8, ComSystemTemplateSystemSignalRef=DET_RANGE_ERR_014
            DET_RANGE_ERR_015_oRDR_DETECTION_013_016_oPCAN_RADAR_0d733106_Tx: ComBitPosition=264, ComBitSize=7, ComSignalInitValue=0, ComSignalType=UINT8, ComSystemTemplateSystemSignalRef=DET_RANGE_ERR_015
            DET_RANGE_ERR_016_oRDR_DETECTION_013_016_oPCAN_RADAR_69934af8_Tx: ComBitPosition=376, ComBitSize=7, ComSignalInitValue=0, ComSignalType=UINT8, ComSystemTemplateSystemSignalRef=DET_RANGE_ERR_016
            DET_RANGE_VELOCITY_013_oRDR_DETECTION_013_016_oPCAN_RADAR_16fdbeb6_Tx: ComBitPosition=48, ComBitSize=15, ComSignalInitValue=16384, ComSignalType=UINT16, ComSystemTemplateSystemSignalRef=DET_RANGE_VELOCITY_013
            DET_RANGE_VELOCITY_014_oRDR_DETECTION_013_016_oPCAN_RADAR_4a4d9ddf_Tx: ComBitPosition=160, ComBitSize=15, ComSignalInitValue=16384, ComSignalType=UINT16, ComSystemTemplateSystemSignalRef=DET_RANGE_VELOCITY_014
            DET_RANGE_VELOCITY_015_oRDR_DETECTION_013_016_oPCAN_RADAR_df3d494a_Tx: ComBitPosition=272, ComBitSize=15, ComSignalInitValue=16384, ComSignalType=UINT16, ComSystemTemplateSystemSignalRef=DET_RANGE_VELOCITY_015
            DET_RANGE_VELOCITY_016_oRDR_DETECTION_013_016_oPCAN_RADAR_bbdd32b4_Tx: ComBitPosition=384, ComBitSize=15, ComSignalInitValue=16384, ComSignalType=UINT16, ComSystemTemplateSystemSignalRef=DET_RANGE_VELOCITY_016
            DET_RANGE_VELOCITY_ERR_013_oRDR_DETECTION_013_016_oPCAN_RADAR_19464504_Tx: ComBitPosition=64, ComBitSize=8, ComSignalInitValue=0, ComSignalType=UINT8, ComSystemTemplateSystemSignalRef=DET_RANGE_VELOCITY_ERR_013
            DET_RANGE_VELOCITY_ERR_014_oRDR_DETECTION_013_016_oPCAN_RADAR_45f6666d_Tx: ComBitPosition=176, ComBitSize=8, ComSignalInitValue=0, ComSignalType=UINT8, ComSystemTemplateSystemSignalRef=DET_RANGE_VELOCITY_ERR_014
            DET_RANGE_VELOCITY_ERR_015_oRDR_DETECTION_013_016_oPCAN_RADAR_d086b2f8_Tx: ComBitPosition=288, ComBitSize=8, ComSignalInitValue=0, ComSignalType=UINT8, ComSystemTemplateSystemSignalRef=DET_RANGE_VELOCITY_ERR_015
            DET_RANGE_VELOCITY_ERR_016_oRDR_DETECTION_013_016_oPCAN_RADAR_b466c906_Tx: ComBitPosition=400, ComBitSize=8, ComSignalInitValue=0, ComSignalType=UINT8, ComSystemTemplateSystemSignalRef=DET_RANGE_VELOCITY_ERR_016
            DET_RCS_013_oRDR_DETECTION_013_016_oPCAN_RADAR_917d89ec_Tx: ComBitPosition=128, ComBitSize=8, ComSignalInitValue=128, ComSignalType=UINT8, ComSystemTemplateSystemSignalRef=DET_RCS_013
            DET_RCS_014_oRDR_DETECTION_013_016_oPCAN_RADAR_cdcdaa85_Tx: ComBitPosition=240, ComBitSize=8, ComSignalInitValue=128, ComSignalType=UINT8, ComSystemTemplateSystemSignalRef=DET_RCS_014
            DET_RCS_015_oRDR_DETECTION_013_016_oPCAN_RADAR_58bd7e10_Tx: ComBitPosition=352, ComBitSize=8, ComSignalInitValue=128, ComSignalType=UINT8, ComSystemTemplateSystemSignalRef=DET_RCS_015
            DET_RCS_016_oRDR_DETECTION_013_016_oPCAN_RADAR_3c5d05ee_Tx: ComBitPosition=464, ComBitSize=8, ComSignalInitValue=128, ComSignalType=UINT8, ComSystemTemplateSystemSignalRef=DET_RCS_016
            DET_SNR_013_oRDR_DETECTION_013_016_oPCAN_RADAR_4cd3ddee_Tx: ComBitPosition=120, ComBitSize=8, ComSignalInitValue=0, ComSignalType=UINT8, ComSystemTemplateSystemSignalRef=DET_SNR_013
            DET_SNR_014_oRDR_DETECTION_013_016_oPCAN_RADAR_1063fe87_Tx: ComBitPosition=232, ComBitSize=8, ComSignalInitValue=0, ComSignalType=UINT8, ComSystemTemplateSystemSignalRef=DET_SNR_014
            DET_SNR_015_oRDR_DETECTION_013_016_oPCAN_RADAR_85132a12_Tx: ComBitPosition=344, ComBitSize=8, ComSignalInitValue=0, ComSignalType=UINT8, ComSystemTemplateSystemSignalRef=DET_SNR_015
            DET_SNR_016_oRDR_DETECTION_013_016_oPCAN_RADAR_e1f351ec_Tx: ComBitPosition=456, ComBitSize=8, ComSignalInitValue=0, ComSignalType=UINT8, ComSystemTemplateSystemSignalRef=DET_SNR_016
            DET_SUPER_RES_TARGET_013_oRDR_DETECTION_013_016_oPCAN_RADAR_7d4af58b_Tx: ComBitPosition=87, ComBitSize=1, ComSignalInitValue=0, ComSignalType=BOOLEAN, ComSystemTemplateSystemSignalRef=DET_SUPER_RES_TARGET_013
            DET_SUPER_RES_TARGET_014_oRDR_DETECTION_013_016_oPCAN_RADAR_21fad6e2_Tx: ComBitPosition=199, ComBitSize=1, ComSignalInitValue=0, ComSignalType=BOOLEAN, ComSystemTemplateSystemSignalRef=DET_SUPER_RES_TARGET_014
            DET_SUPER_RES_TARGET_015_oRDR_DETECTION_013_016_oPCAN_RADAR_b48a0277_Tx: ComBitPosition=311, ComBitSize=1, ComSignalInitValue=0, ComSignalType=BOOLEAN, ComSystemTemplateSystemSignalRef=DET_SUPER_RES_TARGET_015
            DET_SUPER_RES_TARGET_016_oRDR_DETECTION_013_016_oPCAN_RADAR_d06a7989_Tx: ComBitPosition=423, ComBitSize=1, ComSignalInitValue=0, ComSignalType=BOOLEAN, ComSystemTemplateSystemSignalRef=DET_SUPER_RES_TARGET_016
        SG_Detections_017_020_oRDR_DETECTION_017_020_oPCAN_RADAR_e956bb2e_Tx: ComSystemTemplateSignalGroupRef=SG_Detections_017_020
          83 x ComGroupSignal, all with ComSignalEndianness=LITTLE_ENDIAN, ComTransferProperty=PENDING:
            DET_AZIMUTH_017_oRDR_DETECTION_017_020_oPCAN_RADAR_e41c8a76_Tx: ComBitPosition=88, ComBitSize=13, ComSignalInitValue=0, ComSignalType=UINT16, ComSystemTemplateSystemSignalRef=DET_AZIMUTH_017
            DET_AZIMUTH_018_oRDR_DETECTION_017_020_oPCAN_RADAR_c80c1831_Tx: ComBitPosition=200, ComBitSize=13, ComSignalInitValue=0, ComSignalType=UINT16, ComSystemTemplateSystemSignalRef=DET_AZIMUTH_018
            DET_AZIMUTH_019_oRDR_DETECTION_017_020_oPCAN_RADAR_5d7ccca4_Tx: ComBitPosition=312, ComBitSize=13, ComSignalInitValue=0, ComSignalType=UINT16, ComSystemTemplateSystemSignalRef=DET_AZIMUTH_019
            DET_AZIMUTH_020_oRDR_DETECTION_017_020_oPCAN_RADAR_e2cd967f_Tx: ComBitPosition=424, ComBitSize=13, ComSignalInitValue=0, ComSignalType=UINT16, ComSystemTemplateSystemSignalRef=DET_AZIMUTH_020
            DET_AZIMUTH_ERR_017_oRDR_DETECTION_017_020_oPCAN_RADAR_40a91f83_Tx: ComBitPosition=105, ComBitSize=7, ComSignalInitValue=0, ComSignalType=UINT8, ComSystemTemplateSystemSignalRef=DET_AZIMUTH_ERR_017
            DET_AZIMUTH_ERR_018_oRDR_DETECTION_017_020_oPCAN_RADAR_6cb98dc4_Tx: ComBitPosition=217, ComBitSize=7, ComSignalInitValue=0, ComSignalType=UINT8, ComSystemTemplateSystemSignalRef=DET_AZIMUTH_ERR_018
            DET_AZIMUTH_ERR_019_oRDR_DETECTION_017_020_oPCAN_RADAR_f9c95951_Tx: ComBitPosition=329, ComBitSize=7, ComSignalInitValue=0, ComSignalType=UINT8, ComSystemTemplateSystemSignalRef=DET_AZIMUTH_ERR_019
            DET_AZIMUTH_ERR_020_oRDR_DETECTION_017_020_oPCAN_RADAR_4678038a_Tx: ComBitPosition=441, ComBitSize=7, ComSignalInitValue=0, ComSignalType=UINT8, ComSystemTemplateSystemSignalRef=DET_AZIMUTH_ERR_020
            DET_BELOW_RAIN_THOLD_017_oRDR_DETECTION_017_020_oPCAN_RADAR_311d19b6_Tx: ComBitPosition=39, ComBitSize=1, ComSignalInitValue=0, ComSignalType=BOOLEAN, ComSystemTemplateSystemSignalRef=DET_BELOW_RAIN_THOLD_017
            DET_BELOW_RAIN_THOLD_018_oRDR_DETECTION_017_020_oPCAN_RADAR_1d0d8bf1_Tx: ComBitPosition=151, ComBitSize=1, ComSignalInitValue=0, ComSignalType=BOOLEAN, ComSystemTemplateSystemSignalRef=DET_BELOW_RAIN_THOLD_018
            DET_BELOW_RAIN_THOLD_019_oRDR_DETECTION_017_020_oPCAN_RADAR_887d5f64_Tx: ComBitPosition=263, ComBitSize=1, ComSignalInitValue=0, ComSignalType=BOOLEAN, ComSystemTemplateSystemSignalRef=DET_BELOW_RAIN_THOLD_019
            DET_BELOW_RAIN_THOLD_020_oRDR_DETECTION_017_020_oPCAN_RADAR_37cc05bf_Tx: ComBitPosition=375, ComBitSize=1, ComSignalInitValue=0, ComSignalType=BOOLEAN, ComSystemTemplateSystemSignalRef=DET_BELOW_RAIN_THOLD_020
            DET_BI_STATIC_FLAG_017_oRDR_DETECTION_017_020_oPCAN_RADAR_b230caf3_Tx: ComBitPosition=104, ComBitSize=1, ComSignalInitValue=0, ComSignalType=BOOLEAN, ComSystemTemplateSystemSignalRef=DET_BI_STATIC_FLAG_017
            DET_BI_STATIC_FLAG_018_oRDR_DETECTION_017_020_oPCAN_RADAR_9e2058b4_Tx: ComBitPosition=216, ComBitSize=1, ComSignalInitValue=0, ComSignalType=BOOLEAN, ComSystemTemplateSystemSignalRef=DET_BI_STATIC_FLAG_018
            DET_BI_STATIC_FLAG_019_oRDR_DETECTION_017_020_oPCAN_RADAR_0b508c21_Tx: ComBitPosition=328, ComBitSize=1, ComSignalInitValue=0, ComSignalType=BOOLEAN, ComSystemTemplateSystemSignalRef=DET_BI_STATIC_FLAG_019
            DET_BI_STATIC_FLAG_020_oRDR_DETECTION_017_020_oPCAN_RADAR_b4e1d6fa_Tx: ComBitPosition=440, ComBitSize=1, ComSignalInitValue=0, ComSignalType=BOOLEAN, ComSystemTemplateSystemSignalRef=DET_BI_STATIC_FLAG_020
            DET_CONFD_AZIMUTH_017_oRDR_DETECTION_017_020_oPCAN_RADAR_e6fa80bc_Tx: ComBitPosition=118, ComBitSize=2, ComSignalInitValue=0, ComSignalType=UINT8, ComSystemTemplateSystemSignalRef=DET_CONFD_AZIMUTH_017
            DET_CONFD_AZIMUTH_018_oRDR_DETECTION_017_020_oPCAN_RADAR_caea12fb_Tx: ComBitPosition=230, ComBitSize=2, ComSignalInitValue=0, ComSignalType=UINT8, ComSystemTemplateSystemSignalRef=DET_CONFD_AZIMUTH_018
            DET_CONFD_AZIMUTH_019_oRDR_DETECTION_017_020_oPCAN_RADAR_5f9ac66e_Tx: ComBitPosition=342, ComBitSize=2, ComSignalInitValue=0, ComSignalType=UINT8, ComSystemTemplateSystemSignalRef=DET_CONFD_AZIMUTH_019
            DET_CONFD_AZIMUTH_020_oRDR_DETECTION_017_020_oPCAN_RADAR_e02b9cb5_Tx: ComBitPosition=454, ComBitSize=2, ComSignalInitValue=0, ComSignalType=UINT8, ComSystemTemplateSystemSignalRef=DET_CONFD_AZIMUTH_020
            DET_CONFD_ELEVATION_017_oRDR_DETECTION_017_020_oPCAN_RADAR_e46f8146_Tx: ComBitPosition=101, ComBitSize=2, ComSignalInitValue=0, ComSignalType=UINT8, ComSystemTemplateSystemSignalRef=DET_CONFD_ELEVATION_017
            DET_CONFD_ELEVATION_018_oRDR_DETECTION_017_020_oPCAN_RADAR_c87f1301_Tx: ComBitPosition=213, ComBitSize=2, ComSignalInitValue=0, ComSignalType=UINT8, ComSystemTemplateSystemSignalRef=DET_CONFD_ELEVATION_018
            DET_CONFD_ELEVATION_019_oRDR_DETECTION_017_020_oPCAN_RADAR_5d0fc794_Tx: ComBitPosition=325, ComBitSize=2, ComSignalInitValue=0, ComSignalType=UINT8, ComSystemTemplateSystemSignalRef=DET_CONFD_ELEVATION_019
            DET_CONFD_ELEVATION_020_oRDR_DETECTION_017_020_oPCAN_RADAR_e2be9d4f_Tx: ComBitPosition=437, ComBitSize=2, ComSignalInitValue=0, ComSignalType=UINT8, ComSystemTemplateSystemSignalRef=DET_CONFD_ELEVATION_020
            DET_ELEVATION_017_oRDR_DETECTION_017_020_oPCAN_RADAR_35af557a_Tx: ComBitPosition=72, ComBitSize=8, ComSignalInitValue=0, ComSignalType=UINT8, ComSystemTemplateSystemSignalRef=DET_ELEVATION_017
            DET_ELEVATION_018_oRDR_DETECTION_017_020_oPCAN_RADAR_19bfc73d_Tx: ComBitPosition=184, ComBitSize=8, ComSignalInitValue=0, ComSignalType=UINT8, ComSystemTemplateSystemSignalRef=DET_ELEVATION_018
            DET_ELEVATION_019_oRDR_DETECTION_017_020_oPCAN_RADAR_8ccf13a8_Tx: ComBitPosition=296, ComBitSize=8, ComSignalInitValue=0, ComSignalType=UINT8, ComSystemTemplateSystemSignalRef=DET_ELEVATION_019
            DET_ELEVATION_020_oRDR_DETECTION_017_020_oPCAN_RADAR_337e4973_Tx: ComBitPosition=408, ComBitSize=8, ComSignalInitValue=0, ComSignalType=UINT8, ComSystemTemplateSystemSignalRef=DET_ELEVATION_020
            DET_ELEVATION_ERR_017_oRDR_DETECTION_017_020_oPCAN_RADAR_b296cd0f_Tx: ComBitPosition=80, ComBitSize=6, ComSignalInitValue=0, ComSignalType=UINT8, ComSystemTemplateSystemSignalRef=DET_ELEVATION_ERR_017
            DET_ELEVATION_ERR_018_oRDR_DETECTION_017_020_oPCAN_RADAR_9e865f48_Tx: ComBitPosition=192, ComBitSize=6, ComSignalInitValue=0, ComSignalType=UINT8, ComSystemTemplateSystemSignalRef=DET_ELEVATION_ERR_018
            DET_ELEVATION_ERR_019_oRDR_DETECTION_017_020_oPCAN_RADAR_0bf68bdd_Tx: ComBitPosition=304, ComBitSize=6, ComSignalInitValue=0, ComSignalType=UINT8, ComSystemTemplateSystemSignalRef=DET_ELEVATION_ERR_019
            DET_ELEVATION_ERR_020_oRDR_DETECTION_017_020_oPCAN_RADAR_b447d106_Tx: ComBitPosition=416, ComBitSize=6, ComSignalInitValue=0, ComSignalType=UINT8, ComSystemTemplateSystemSignalRef=DET_ELEVATION_ERR_020
            DET_EXISTENCE_PROB_017_oRDR_DETECTION_017_020_oPCAN_RADAR_6009b86f_Tx: ComBitPosition=112, ComBitSize=6, ComSignalInitValue=0, ComSignalType=UINT8, ComSystemTemplateSystemSignalRef=DET_EXISTENCE_PROB_017
            DET_EXISTENCE_PROB_018_oRDR_DETECTION_017_020_oPCAN_RADAR_4c192a28_Tx: ComBitPosition=224, ComBitSize=6, ComSignalInitValue=0, ComSignalType=UINT8, ComSystemTemplateSystemSignalRef=DET_EXISTENCE_PROB_018
            DET_EXISTENCE_PROB_019_oRDR_DETECTION_017_020_oPCAN_RADAR_d969febd_Tx: ComBitPosition=336, ComBitSize=6, ComSignalInitValue=0, ComSignalType=UINT8, ComSystemTemplateSystemSignalRef=DET_EXISTENCE_PROB_019
            DET_EXISTENCE_PROB_020_oRDR_DETECTION_017_020_oPCAN_RADAR_66d8a466_Tx: ComBitPosition=448, ComBitSize=6, ComSignalInitValue=0, ComSignalType=UINT8, ComSystemTemplateSystemSignalRef=DET_EXISTENCE_PROB_020
            DET_HVC_FLAG_017_oRDR_DETECTION_017_020_oPCAN_RADAR_817dfb10_Tx: ComBitPosition=86, ComBitSize=1, ComSignalInitValue=0, ComSignalType=BOOLEAN, ComSystemTemplateSystemSignalRef=DET_HVC_FLAG_017
            DET_HVC_FLAG_018_oRDR_DETECTION_017_020_oPCAN_RADAR_ad6d6957_Tx: ComBitPosition=198, ComBitSize=1, ComSignalInitValue=0, ComSignalType=BOOLEAN, ComSystemTemplateSystemSignalRef=DET_HVC_FLAG_018
            DET_HVC_FLAG_019_oRDR_DETECTION_017_020_oPCAN_RADAR_381dbdc2_Tx: ComBitPosition=310, ComBitSize=1, ComSignalInitValue=0, ComSignalType=BOOLEAN, ComSystemTemplateSystemSignalRef=DET_HVC_FLAG_019
            DET_HVC_FLAG_020_oRDR_DETECTION_017_020_oPCAN_RADAR_87ace719_Tx: ComBitPosition=422, ComBitSize=1, ComSignalInitValue=0, ComSignalType=BOOLEAN, ComSystemTemplateSystemSignalRef=DET_HVC_FLAG_020
            DET_IDM_017_oRDR_DETECTION_017_020_oPCAN_RADAR_0a2fc0ad_Tx: ComBitPosition=63, ComBitSize=1, ComSignalInitValue=0, ComSignalType=BOOLEAN, ComSystemTemplateSystemSignalRef=DET_IDM_017
            DET_IDM_018_oRDR_DETECTION_017_020_oPCAN_RADAR_263f52ea_Tx: ComBitPosition=175, ComBitSize=1, ComSignalInitValue=0, ComSignalType=BOOLEAN, ComSystemTemplateSystemSignalRef=DET_IDM_018
            DET_IDM_019_oRDR_DETECTION_017_020_oPCAN_RADAR_b34f867f_Tx: ComBitPosition=287, ComBitSize=1, ComSignalInitValue=0, ComSignalType=BOOLEAN, ComSystemTemplateSystemSignalRef=DET_IDM_019
            DET_IDM_020_oRDR_DETECTION_017_020_oPCAN_RADAR_0cfedca4_Tx: ComBitPosition=399, ComBitSize=1, ComSignalInitValue=0, ComSignalType=BOOLEAN, ComSystemTemplateSystemSignalRef=DET_IDM_020
            DET_MH_CRC16_017_020_oRDR_DETECTION_017_020_oPCAN_RADAR_6dde6925_Tx: ComBitPosition=0, ComBitSize=16, ComSignalInitValue=0, ComSignalType=UINT16, ComSystemTemplateSystemSignalRef=DET_MH_CRC16_017_020
            DET_MH_CYCLE_COUNTER_017_020_oRDR_DETECTION_017_020_oPCAN_RADAR_e9abc812_Tx: ComBitPosition=16, ComBitSize=8, ComSignalInitValue=0, ComSignalType=UINT8, ComSystemTemplateSystemSignalRef=DET_MH_CYCLE_COUNTER_017_020
            DET_MH_SCAN_INDEX_4LSB_017_020_oRDR_DETECTION_017_020_oPCAN_RADAR_2581ed9e_Tx: ComBitPosition=476, ComBitSize=4, ComSignalInitValue=0, ComSignalType=UINT8, ComSystemTemplateSystemSignalRef=DET_MH_SCAN_INDEX_4LSB_017_020
            DET_MTD_017_oRDR_DETECTION_017_020_oPCAN_RADAR_6c9cf276_Tx: ComBitPosition=47, ComBitSize=1, ComSignalInitValue=0, ComSignalType=BOOLEAN, ComSystemTemplateSystemSignalRef=DET_MTD_017
            DET_MTD_018_oRDR_DETECTION_017_020_oPCAN_RADAR_408c6031_Tx: ComBitPosition=159, ComBitSize=1, ComSignalInitValue=0, ComSignalType=BOOLEAN, ComSystemTemplateSystemSignalRef=DET_MTD_018
            DET_MTD_019_oRDR_DETECTION_017_020_oPCAN_RADAR_d5fcb4a4_Tx: ComBitPosition=271, ComBitSize=1, ComSignalInitValue=0, ComSignalType=BOOLEAN, ComSystemTemplateSystemSignalRef=DET_MTD_019
            DET_MTD_020_oRDR_DETECTION_017_020_oPCAN_RADAR_6a4dee7f_Tx: ComBitPosition=383, ComBitSize=1, ComSignalInitValue=0, ComSignalType=BOOLEAN, ComSystemTemplateSystemSignalRef=DET_MTD_020
            DET_PROB_1STAZHYPO_017_oRDR_DETECTION_017_020_oPCAN_RADAR_ff281abb_Tx: ComBitPosition=103, ComBitSize=1, ComSignalInitValue=0, ComSignalType=BOOLEAN, ComSystemTemplateSystemSignalRef=DET_PROB_1STAZHYPO_017
            DET_PROB_1STAZHYPO_018_oRDR_DETECTION_017_020_oPCAN_RADAR_d33888fc_Tx: ComBitPosition=215, ComBitSize=1, ComSignalInitValue=0, ComSignalType=BOOLEAN, ComSystemTemplateSystemSignalRef=DET_PROB_1STAZHYPO_018
            DET_PROB_1STAZHYPO_019_oRDR_DETECTION_017_020_oPCAN_RADAR_46485c69_Tx: ComBitPosition=327, ComBitSize=1, ComSignalInitValue=0, ComSignalType=BOOLEAN, ComSystemTemplateSystemSignalRef=DET_PROB_1STAZHYPO_019
            DET_PROB_1STAZHYPO_020_oRDR_DETECTION_017_020_oPCAN_RADAR_f9f906b2_Tx: ComBitPosition=439, ComBitSize=1, ComSignalInitValue=0, ComSignalType=BOOLEAN, ComSystemTemplateSystemSignalRef=DET_PROB_1STAZHYPO_020
            DET_RANGE_017_oRDR_DETECTION_017_020_oPCAN_RADAR_f487f9cd_Tx: ComBitPosition=24, ComBitSize=15, ComSignalInitValue=0, ComSignalType=UINT16, ComSystemTemplateSystemSignalRef=DET_RANGE_017
            DET_RANGE_018_oRDR_DETECTION_017_020_oPCAN_RADAR_d8976b8a_Tx: ComBitPosition=136, ComBitSize=15, ComSignalInitValue=0, ComSignalType=UINT16, ComSystemTemplateSystemSignalRef=DET_RANGE_018
            DET_RANGE_019_oRDR_DETECTION_017_020_oPCAN_RADAR_4de7bf1f_Tx: ComBitPosition=248, ComBitSize=15, ComSignalInitValue=0, ComSignalType=UINT16, ComSystemTemplateSystemSignalRef=DET_RANGE_019
            DET_RANGE_020_oRDR_DETECTION_017_020_oPCAN_RADAR_f256e5c4_Tx: ComBitPosition=360, ComBitSize=15, ComSignalInitValue=0, ComSignalType=UINT16, ComSystemTemplateSystemSignalRef=DET_RANGE_020
            DET_RANGE_ERR_017_oRDR_DETECTION_017_020_oPCAN_RADAR_536f43a4_Tx: ComBitPosition=40, ComBitSize=7, ComSignalInitValue=0, ComSignalType=UINT8, ComSystemTemplateSystemSignalRef=DET_RANGE_ERR_017
            DET_RANGE_ERR_018_oRDR_DETECTION_017_020_oPCAN_RADAR_7f7fd1e3_Tx: ComBitPosition=152, ComBitSize=7, ComSignalInitValue=0, ComSignalType=UINT8, ComSystemTemplateSystemSignalRef=DET_RANGE_ERR_018
            DET_RANGE_ERR_019_oRDR_DETECTION_017_020_oPCAN_RADAR_ea0f0576_Tx: ComBitPosition=264, ComBitSize=7, ComSignalInitValue=0, ComSignalType=UINT8, ComSystemTemplateSystemSignalRef=DET_RANGE_ERR_019
            DET_RANGE_ERR_020_oRDR_DETECTION_017_020_oPCAN_RADAR_55be5fad_Tx: ComBitPosition=376, ComBitSize=7, ComSignalInitValue=0, ComSignalType=UINT8, ComSystemTemplateSystemSignalRef=DET_RANGE_ERR_020
            DET_RANGE_VELOCITY_017_oRDR_DETECTION_017_020_oPCAN_RADAR_81213be8_Tx: ComBitPosition=48, ComBitSize=15, ComSignalInitValue=16384, ComSignalType=UINT16, ComSystemTemplateSystemSignalRef=DET_RANGE_VELOCITY_017
            DET_RANGE_VELOCITY_018_oRDR_DETECTION_017_020_oPCAN_RADAR_ad31a9af_Tx: ComBitPosition=160, ComBitSize=15, ComSignalInitValue=16384, ComSignalType=UINT16, ComSystemTemplateSystemSignalRef=DET_RANGE_VELOCITY_018
            DET_RANGE_VELOCITY_019_oRDR_DETECTION_017_020_oPCAN_RADAR_38417d3a_Tx: ComBitPosition=272, ComBitSize=15, ComSignalInitValue=16384, ComSignalType=UINT16, ComSystemTemplateSystemSignalRef=DET_RANGE_VELOCITY_019
            DET_RANGE_VELOCITY_020_oRDR_DETECTION_017_020_oPCAN_RADAR_87f027e1_Tx: ComBitPosition=384, ComBitSize=15, ComSignalInitValue=16384, ComSignalType=UINT16, ComSystemTemplateSystemSignalRef=DET_RANGE_VELOCITY_020
            DET_RANGE_VELOCITY_ERR_017_oRDR_DETECTION_017_020_oPCAN_RADAR_8e9ac05a_Tx: ComBitPosition=64, ComBitSize=8, ComSignalInitValue=0, ComSignalType=UINT8, ComSystemTemplateSystemSignalRef=DET_RANGE_VELOCITY_ERR_017
            DET_RANGE_VELOCITY_ERR_018_oRDR_DETECTION_017_020_oPCAN_RADAR_a28a521d_Tx: ComBitPosition=176, ComBitSize=8, ComSignalInitValue=0, ComSignalType=UINT8, ComSystemTemplateSystemSignalRef=DET_RANGE_VELOCITY_ERR_018
            DET_RANGE_VELOCITY_ERR_019_oRDR_DETECTION_017_020_oPCAN_RADAR_37fa8688_Tx: ComBitPosition=288, ComBitSize=8, ComSignalInitValue=0, ComSignalType=UINT8, ComSystemTemplateSystemSignalRef=DET_RANGE_VELOCITY_ERR_019
            DET_RANGE_VELOCITY_ERR_020_oRDR_DETECTION_017_020_oPCAN_RADAR_884bdc53_Tx: ComBitPosition=400, ComBitSize=8, ComSignalInitValue=0, ComSignalType=UINT8, ComSystemTemplateSystemSignalRef=DET_RANGE_VELOCITY_ERR_020
            DET_RCS_017_oRDR_DETECTION_017_020_oPCAN_RADAR_06a10cb2_Tx: ComBitPosition=128, ComBitSize=8, ComSignalInitValue=128, ComSignalType=UINT8, ComSystemTemplateSystemSignalRef=DET_RCS_017
            DET_RCS_018_oRDR_DETECTION_017_020_oPCAN_RADAR_2ab19ef5_Tx: ComBitPosition=240, ComBitSize=8, ComSignalInitValue=128, ComSignalType=UINT8, ComSystemTemplateSystemSignalRef=DET_RCS_018
            DET_RCS_019_oRDR_DETECTION_017_020_oPCAN_RADAR_bfc14a60_Tx: ComBitPosition=352, ComBitSize=8, ComSignalInitValue=128, ComSignalType=UINT8, ComSystemTemplateSystemSignalRef=DET_RCS_019
            DET_RCS_020_oRDR_DETECTION_017_020_oPCAN_RADAR_007010bb_Tx: ComBitPosition=464, ComBitSize=8, ComSignalInitValue=128, ComSignalType=UINT8, ComSystemTemplateSystemSignalRef=DET_RCS_020
            DET_SNR_017_oRDR_DETECTION_017_020_oPCAN_RADAR_db0f58b0_Tx: ComBitPosition=120, ComBitSize=8, ComSignalInitValue=0, ComSignalType=UINT8, ComSystemTemplateSystemSignalRef=DET_SNR_017
            DET_SNR_018_oRDR_DETECTION_017_020_oPCAN_RADAR_f71fcaf7_Tx: ComBitPosition=232, ComBitSize=8, ComSignalInitValue=0, ComSignalType=UINT8, ComSystemTemplateSystemSignalRef=DET_SNR_018
            DET_SNR_019_oRDR_DETECTION_017_020_oPCAN_RADAR_626f1e62_Tx: ComBitPosition=344, ComBitSize=8, ComSignalInitValue=0, ComSignalType=UINT8, ComSystemTemplateSystemSignalRef=DET_SNR_019
            DET_SNR_020_oRDR_DETECTION_017_020_oPCAN_RADAR_ddde44b9_Tx: ComBitPosition=456, ComBitSize=8, ComSignalInitValue=0, ComSignalType=UINT8, ComSystemTemplateSystemSignalRef=DET_SNR_020
            DET_SUPER_RES_TARGET_017_oRDR_DETECTION_017_020_oPCAN_RADAR_ea9670d5_Tx: ComBitPosition=87, ComBitSize=1, ComSignalInitValue=0, ComSignalType=BOOLEAN, ComSystemTemplateSystemSignalRef=DET_SUPER_RES_TARGET_017
            DET_SUPER_RES_TARGET_018_oRDR_DETECTION_017_020_oPCAN_RADAR_c686e292_Tx: ComBitPosition=199, ComBitSize=1, ComSignalInitValue=0, ComSignalType=BOOLEAN, ComSystemTemplateSystemSignalRef=DET_SUPER_RES_TARGET_018
            DET_SUPER_RES_TARGET_019_oRDR_DETECTION_017_020_oPCAN_RADAR_53f63607_Tx: ComBitPosition=311, ComBitSize=1, ComSignalInitValue=0, ComSignalType=BOOLEAN, ComSystemTemplateSystemSignalRef=DET_SUPER_RES_TARGET_019
            DET_SUPER_RES_TARGET_020_oRDR_DETECTION_017_020_oPCAN_RADAR_ec476cdc_Tx: ComBitPosition=423, ComBitSize=1, ComSignalInitValue=0, ComSignalType=BOOLEAN, ComSystemTemplateSystemSignalRef=DET_SUPER_RES_TARGET_020
