[part 15 of 24: package /InitialEcuC]
AUTOSAR XML (schema 00053)
package /InitialEcuC  (continued)
  module config Com  (continued)
    ComConfig  (continued)
      242 x ComSignalGroup, all with ComTransferProperty=PENDING:  (continued)
        SG_Fusion_Detections_013_016_oRDR_FUSION_DET_013_016_oPCAN_RADAR_713b89f4_Rx: ComTimeout=0, ComSystemTemplateSignalGroupRef=SG_Fusion_Detections_013_016
          83 x ComGroupSignal, all with ComSignalEndianness=LITTLE_ENDIAN, ComSignalInitValue=0:
            DET_AZIMUTH_013_Rx_oRDR_FUSION_DET_013_016_oPCAN_RADAR_f2417b64_Rx: ComBitPosition=88, ComBitSize=13, ComSignalType=UINT16, ComSystemTemplateSystemSignalRef=DET_AZIMUTH_013_Rx
            DET_AZIMUTH_014_Rx_oRDR_FUSION_DET_013_016_oPCAN_RADAR_087c8833_Rx: ComBitPosition=200, ComBitSize=13, ComSignalType=UINT16, ComSystemTemplateSystemSignalRef=DET_AZIMUTH_014_Rx
            DET_AZIMUTH_015_Rx_oRDR_FUSION_DET_013_016_oPCAN_RADAR_a7381a74_Rx: ComBitPosition=312, ComBitSize=13, ComSignalType=UINT16, ComSystemTemplateSystemSignalRef=DET_AZIMUTH_015_Rx
            DET_AZIMUTH_016_Rx_oRDR_FUSION_DET_013_016_oPCAN_RADAR_8d84aafc_Rx: ComBitPosition=424, ComBitSize=13, ComSignalType=UINT16, ComSystemTemplateSystemSignalRef=DET_AZIMUTH_016_Rx
            DET_AZIMUTH_ERR_013_Rx_oRDR_FUSION_DET_013_016_oPCAN_RADAR_f028dae6_Rx: ComBitPosition=105, ComBitSize=7, ComSignalType=UINT8, ComSystemTemplateSystemSignalRef=DET_AZIMUTH_ERR_013_Rx
            DET_AZIMUTH_ERR_014_Rx_oRDR_FUSION_DET_013_016_oPCAN_RADAR_0a1529b1_Rx: ComBitPosition=217, ComBitSize=7, ComSignalType=UINT8, ComSystemTemplateSystemSignalRef=DET_AZIMUTH_ERR_014_Rx
            DET_AZIMUTH_ERR_015_Rx_oRDR_FUSION_DET_013_016_oPCAN_RADAR_a551bbf6_Rx: ComBitPosition=329, ComBitSize=7, ComSignalType=UINT8, ComSystemTemplateSystemSignalRef=DET_AZIMUTH_ERR_015_Rx
            DET_AZIMUTH_ERR_016_Rx_oRDR_FUSION_DET_013_016_oPCAN_RADAR_8fed0b7e_Rx: ComBitPosition=441, ComBitSize=7, ComSignalType=UINT8, ComSystemTemplateSystemSignalRef=DET_AZIMUTH_ERR_016_Rx
            DET_BELOW_RAIN_THOLD_013_Rx_oRDR_FUSION_DET_013_016_oPCAN_RADAR_94fb84d1_Rx: ComBitPosition=39, ComBitSize=1, ComSignalType=BOOLEAN, ComSystemTemplateSystemSignalRef=DET_BELOW_RAIN_THOLD_013_Rx
            DET_BELOW_RAIN_THOLD_014_Rx_oRDR_FUSION_DET_013_016_oPCAN_RADAR_6ec67786_Rx: ComBitPosition=151, ComBitSize=1, ComSignalType=BOOLEAN, ComSystemTemplateSystemSignalRef=DET_BELOW_RAIN_THOLD_014_Rx
            DET_BELOW_RAIN_THOLD_015_Rx_oRDR_FUSION_DET_013_016_oPCAN_RADAR_c182e5c1_Rx: ComBitPosition=263, ComBitSize=1, ComSignalType=BOOLEAN, ComSystemTemplateSystemSignalRef=DET_BELOW_RAIN_THOLD_015_Rx
            DET_BELOW_RAIN_THOLD_016_Rx_oRDR_FUSION_DET_013_016_oPCAN_RADAR_eb3e5549_Rx: ComBitPosition=375, ComBitSize=1, ComSignalType=BOOLEAN, ComSystemTemplateSystemSignalRef=DET_BELOW_RAIN_THOLD_016_Rx
            DET_BI_STATIC_FLAG_013_Rx_oRDR_FUSION_DET_013_016_oPCAN_RADAR_e3652fc2_Rx: ComBitPosition=104, ComBitSize=1, ComSignalType=BOOLEAN, ComSystemTemplateSystemSignalRef=DET_BI_STATIC_FLAG_013_Rx
            DET_BI_STATIC_FLAG_014_Rx_oRDR_FUSION_DET_013_016_oPCAN_RADAR_1958dc95_Rx: ComBitPosition=216, ComBitSize=1, ComSignalType=BOOLEAN, ComSystemTemplateSystemSignalRef=DET_BI_STATIC_FLAG_014_Rx
            DET_BI_STATIC_FLAG_015_Rx_oRDR_FUSION_DET_013_016_oPCAN_RADAR_b61c4ed2_Rx: ComBitPosition=328, ComBitSize=1, ComSignalType=BOOLEAN, ComSystemTemplateSystemSignalRef=DET_BI_STATIC_FLAG_015_Rx
            DET_BI_STATIC_FLAG_016_Rx_oRDR_FUSION_DET_013_016_oPCAN_RADAR_9ca0fe5a_Rx: ComBitPosition=440, ComBitSize=1, ComSignalType=BOOLEAN, ComSystemTemplateSystemSignalRef=DET_BI_STATIC_FLAG_016_Rx
            DET_CONFD_AZIMUTH_013_Rx_oRDR_FUSION_DET_013_016_oPCAN_RADAR_000cc596_Rx: ComBitPosition=118, ComBitSize=2, ComSignalType=UINT8, ComSystemTemplateSystemSignalRef=DET_CONFD_AZIMUTH_013_Rx
            DET_CONFD_AZIMUTH_014_Rx_oRDR_FUSION_DET_013_016_oPCAN_RADAR_fa3136c1_Rx: ComBitPosition=230, ComBitSize=2, ComSignalType=UINT8, ComSystemTemplateSystemSignalRef=DET_CONFD_AZIMUTH_014_Rx
            DET_CONFD_AZIMUTH_015_Rx_oRDR_FUSION_DET_013_016_oPCAN_RADAR_5575a486_Rx: ComBitPosition=342, ComBitSize=2, ComSignalType=UINT8, ComSystemTemplateSystemSignalRef=DET_CONFD_AZIMUTH_015_Rx
            DET_CONFD_AZIMUTH_016_Rx_oRDR_FUSION_DET_013_016_oPCAN_RADAR_7fc9140e_Rx: ComBitPosition=454, ComBitSize=2, ComSignalType=UINT8, ComSystemTemplateSystemSignalRef=DET_CONFD_AZIMUTH_016_Rx
            DET_CONFD_ELEVATION_013_Rx_oRDR_FUSION_DET_013_016_oPCAN_RADAR_0a2d4611_Rx: ComBitPosition=101, ComBitSize=2, ComSignalType=UINT8, ComSystemTemplateSystemSignalRef=DET_CONFD_ELEVATION_013_Rx
            DET_CONFD_ELEVATION_014_Rx_oRDR_FUSION_DET_013_016_oPCAN_RADAR_f010b546_Rx: ComBitPosition=213, ComBitSize=2, ComSignalType=UINT8, ComSystemTemplateSystemSignalRef=DET_CONFD_ELEVATION_014_Rx
            DET_CONFD_ELEVATION_015_Rx_oRDR_FUSION_DET_013_016_oPCAN_RADAR_5f542701_Rx: ComBitPosition=325, ComBitSize=2, ComSignalType=UINT8, ComSystemTemplateSystemSignalRef=DET_CONFD_ELEVATION_015_Rx
            DET_CONFD_ELEVATION_016_Rx_oRDR_FUSION_DET_013_016_oPCAN_RADAR_75e89789_Rx: ComBitPosition=437, ComBitSize=2, ComSignalType=UINT8, ComSystemTemplateSystemSignalRef=DET_CONFD_ELEVATION_016_Rx
            DET_ELEVATION_013_Rx_oRDR_FUSION_DET_013_016_oPCAN_RADAR_007ea9e8_Rx: ComBitPosition=72, ComBitSize=8, ComSignalType=UINT8, ComSystemTemplateSystemSignalRef=DET_ELEVATION_013_Rx
            DET_ELEVATION_014_Rx_oRDR_FUSION_DET_013_016_oPCAN_RADAR_fa435abf_Rx: ComBitPosition=184, ComBitSize=8, ComSignalType=UINT8, ComSystemTemplateSystemSignalRef=DET_ELEVATION_014_Rx
            DET_ELEVATION_015_Rx_oRDR_FUSION_DET_013_016_oPCAN_RADAR_5507c8f8_Rx: ComBitPosition=296, ComBitSize=8, ComSignalType=UINT8, ComSystemTemplateSystemSignalRef=DET_ELEVATION_015_Rx
            DET_ELEVATION_016_Rx_oRDR_FUSION_DET_013_016_oPCAN_RADAR_7fbb7870_Rx: ComBitPosition=408, ComBitSize=8, ComSignalType=UINT8, ComSystemTemplateSystemSignalRef=DET_ELEVATION_016_Rx
            DET_ELEVATION_ERR_013_Rx_oRDR_FUSION_DET_013_016_oPCAN_RADAR_d2c78b37_Rx: ComBitPosition=80, ComBitSize=6, ComSignalType=UINT8, ComSystemTemplateSystemSignalRef=DET_ELEVATION_ERR_013_Rx
            DET_ELEVATION_ERR_014_Rx_oRDR_FUSION_DET_013_016_oPCAN_RADAR_28fa7860_Rx: ComBitPosition=192, ComBitSize=6, ComSignalType=UINT8, ComSystemTemplateSystemSignalRef=DET_ELEVATION_ERR_014_Rx
            DET_ELEVATION_ERR_015_Rx_oRDR_FUSION_DET_013_016_oPCAN_RADAR_87beea27_Rx: ComBitPosition=304, ComBitSize=6, ComSignalType=UINT8, ComSystemTemplateSystemSignalRef=DET_ELEVATION_ERR_015_Rx
            DET_ELEVATION_ERR_016_Rx_oRDR_FUSION_DET_013_016_oPCAN_RADAR_ad025aaf_Rx: ComBitPosition=416, ComBitSize=6, ComSignalType=UINT8, ComSystemTemplateSystemSignalRef=DET_ELEVATION_ERR_016_Rx
            DET_EXISTENCE_PROB_013_Rx_oRDR_FUSION_DET_013_016_oPCAN_RADAR_25dff3a2_Rx: ComBitPosition=112, ComBitSize=6, ComSignalType=UINT8, ComSystemTemplateSystemSignalRef=DET_EXISTENCE_PROB_013_Rx
            DET_EXISTENCE_PROB_014_Rx_oRDR_FUSION_DET_013_016_oPCAN_RADAR_dfe200f5_Rx: ComBitPosition=224, ComBitSize=6, ComSignalType=UINT8, ComSystemTemplateSystemSignalRef=DET_EXISTENCE_PROB_014_Rx
            DET_EXISTENCE_PROB_015_Rx_oRDR_FUSION_DET_013_016_oPCAN_RADAR_70a692b2_Rx: ComBitPosition=336, ComBitSize=6, ComSignalType=UINT8, ComSystemTemplateSystemSignalRef=DET_EXISTENCE_PROB_015_Rx
            DET_EXISTENCE_PROB_016_Rx_oRDR_FUSION_DET_013_016_oPCAN_RADAR_5a1a223a_Rx: ComBitPosition=448, ComBitSize=6, ComSignalType=UINT8, ComSystemTemplateSystemSignalRef=DET_EXISTENCE_PROB_016_Rx
            DET_HVC_FLAG_013_Rx_oRDR_FUSION_DET_013_016_oPCAN_RADAR_f8011eed_Rx: ComBitPosition=86, ComBitSize=1, ComSignalType=BOOLEAN, ComSystemTemplateSystemSignalRef=DET_HVC_FLAG_013_Rx
            DET_HVC_FLAG_014_Rx_oRDR_FUSION_DET_013_016_oPCAN_RADAR_023cedba_Rx: ComBitPosition=198, ComBitSize=1, ComSignalType=BOOLEAN, ComSystemTemplateSystemSignalRef=DET_HVC_FLAG_014_Rx
            DET_HVC_FLAG_015_Rx_oRDR_FUSION_DET_013_016_oPCAN_RADAR_ad787ffd_Rx: ComBitPosition=310, ComBitSize=1, ComSignalType=BOOLEAN, ComSystemTemplateSystemSignalRef=DET_HVC_FLAG_015_Rx
            DET_HVC_FLAG_016_Rx_oRDR_FUSION_DET_013_016_oPCAN_RADAR_87c4cf75_Rx: ComBitPosition=422, ComBitSize=1, ComSignalType=BOOLEAN, ComSystemTemplateSystemSignalRef=DET_HVC_FLAG_016_Rx
            DET_IDM_013_Rx_oRDR_FUSION_DET_013_016_oPCAN_RADAR_cdc0e7a5_Rx: ComBitPosition=63, ComBitSize=1, ComSignalType=BOOLEAN, ComSystemTemplateSystemSignalRef=DET_IDM_013_Rx
            DET_IDM_014_Rx_oRDR_FUSION_DET_013_016_oPCAN_RADAR_37fd14f2_Rx: ComBitPosition=175, ComBitSize=1, ComSignalType=BOOLEAN, ComSystemTemplateSystemSignalRef=DET_IDM_014_Rx
            DET_IDM_015_Rx_oRDR_FUSION_DET_013_016_oPCAN_RADAR_98b986b5_Rx: ComBitPosition=287, ComBitSize=1, ComSignalType=BOOLEAN, ComSystemTemplateSystemSignalRef=DET_IDM_015_Rx
            DET_IDM_016_Rx_oRDR_FUSION_DET_013_016_oPCAN_RADAR_b205363d_Rx: ComBitPosition=399, ComBitSize=1, ComSignalType=BOOLEAN, ComSystemTemplateSystemSignalRef=DET_IDM_016_Rx
            DET_MH_CRC16_013_016_Rx_oRDR_FUSION_DET_013_016_oPCAN_RADAR_23e44f7c_Rx: ComBitPosition=0, ComBitSize=16, ComSignalType=UINT16, ComSystemTemplateSystemSignalRef=DET_MH_CRC16_013_016_Rx
            DET_MH_CYCLE_COUNTER_013_016_Rx_oRDR_FUSION_DET_013_016_oPCAN_RADAR_2e3f72b9_Rx: ComBitPosition=16, ComBitSize=8, ComSignalType=UINT8, ComSystemTemplateSystemSignalRef=DET_MH_CYCLE_COUNTER_013_016_Rx
            DET_MH_SCAN_INDEX_4LSB_013_016_Rx_oRDR_FUSION_DET_013_016_oPCAN_RADAR_4a8fbd82_Rx: ComBitPosition=476, ComBitSize=4, ComSignalType=UINT8, ComSystemTemplateSystemSignalRef=DET_MH_SCAN_INDEX_4LSB_013_016_Rx
            DET_MTD_013_Rx_oRDR_FUSION_DET_013_016_oPCAN_RADAR_7043d1d5_Rx: ComBitPosition=47, ComBitSize=1, ComSignalType=BOOLEAN, ComSystemTemplateSystemSignalRef=DET_MTD_013_Rx
            DET_MTD_014_Rx_oRDR_FUSION_DET_013_016_oPCAN_RADAR_8a7e2282_Rx: ComBitPosition=159, ComBitSize=1, ComSignalType=BOOLEAN, ComSystemTemplateSystemSignalRef=DET_MTD_014_Rx
            DET_MTD_015_Rx_oRDR_FUSION_DET_013_016_oPCAN_RADAR_253ab0c5_Rx: ComBitPosition=271, ComBitSize=1, ComSignalType=BOOLEAN, ComSystemTemplateSystemSignalRef=DET_MTD_015_Rx
            DET_MTD_016_Rx_oRDR_FUSION_DET_013_016_oPCAN_RADAR_0f86004d_Rx: ComBitPosition=383, ComBitSize=1, ComSignalType=BOOLEAN, ComSystemTemplateSystemSignalRef=DET_MTD_016_Rx
            DET_PROB_1STAZHYPO_013_Rx_oRDR_FUSION_DET_013_016_oPCAN_RADAR_ba3acf54_Rx: ComBitPosition=103, ComBitSize=1, ComSignalType=BOOLEAN, ComSystemTemplateSystemSignalRef=DET_PROB_1STAZHYPO_013_Rx
            DET_PROB_1STAZHYPO_014_Rx_oRDR_FUSION_DET_013_016_oPCAN_RADAR_40073c03_Rx: ComBitPosition=215, ComBitSize=1, ComSignalType=BOOLEAN, ComSystemTemplateSystemSignalRef=DET_PROB_1STAZHYPO_014_Rx
            DET_PROB_1STAZHYPO_015_Rx_oRDR_FUSION_DET_013_016_oPCAN_RADAR_ef43ae44_Rx: ComBitPosition=327, ComBitSize=1, ComSignalType=BOOLEAN, ComSystemTemplateSystemSignalRef=DET_PROB_1STAZHYPO_015_Rx
            DET_PROB_1STAZHYPO_016_Rx_oRDR_FUSION_DET_013_016_oPCAN_RADAR_c5ff1ecc_Rx: ComBitPosition=439, ComBitSize=1, ComSignalType=BOOLEAN, ComSystemTemplateSystemSignalRef=DET_PROB_1STAZHYPO_016_Rx
            DET_RANGE_013_Rx_oRDR_FUSION_DET_013_016_oPCAN_RADAR_e1872743_Rx: ComBitPosition=24, ComBitSize=15, ComSignalType=UINT16, ComSystemTemplateSystemSignalRef=DET_RANGE_013_Rx
            DET_RANGE_014_Rx_oRDR_FUSION_DET_013_016_oPCAN_RADAR_1bbad414_Rx: ComBitPosition=136, ComBitSize=15, ComSignalType=UINT16, ComSystemTemplateSystemSignalRef=DET_RANGE_014_Rx
            DET_RANGE_015_Rx_oRDR_FUSION_DET_013_016_oPCAN_RADAR_b4fe4653_Rx: ComBitPosition=248, ComBitSize=15, ComSignalType=UINT16, ComSystemTemplateSystemSignalRef=DET_RANGE_015_Rx
            DET_RANGE_016_Rx_oRDR_FUSION_DET_013_016_oPCAN_RADAR_9e42f6db_Rx: ComBitPosition=360, ComBitSize=15, ComSignalType=UINT16, ComSystemTemplateSystemSignalRef=DET_RANGE_016_Rx
            DET_RANGE_ERR_013_Rx_oRDR_FUSION_DET_013_016_oPCAN_RADAR_b175aba3_Rx: ComBitPosition=40, ComBitSize=7, ComSignalType=UINT8, ComSystemTemplateSystemSignalRef=DET_RANGE_ERR_013_Rx
            DET_RANGE_ERR_014_Rx_oRDR_FUSION_DET_013_016_oPCAN_RADAR_4b4858f4_Rx: ComBitPosition=152, ComBitSize=7, ComSignalType=UINT8, ComSystemTemplateSystemSignalRef=DET_RANGE_ERR_014_Rx
            DET_RANGE_ERR_015_Rx_oRDR_FUSION_DET_013_016_oPCAN_RADAR_e40ccab3_Rx: ComBitPosition=264, ComBitSize=7, ComSignalType=UINT8, ComSystemTemplateSystemSignalRef=DET_RANGE_ERR_015_Rx
            DET_RANGE_ERR_016_Rx_oRDR_FUSION_DET_013_016_oPCAN_RADAR_ceb07a3b_Rx: ComBitPosition=376, ComBitSize=7, ComSignalType=UINT8, ComSystemTemplateSystemSignalRef=DET_RANGE_ERR_016_Rx
            DET_RANGE_VELOCITY_013_Rx_oRDR_FUSION_DET_013_016_oPCAN_RADAR_3c72a4bd_Rx: ComBitPosition=48, ComBitSize=15, ComSignalType=UINT16, ComSystemTemplateSystemSignalRef=DET_RANGE_VELOCITY_013_Rx
            DET_RANGE_VELOCITY_014_Rx_oRDR_FUSION_DET_013_016_oPCAN_RADAR_c64f57ea_Rx: ComBitPosition=160, ComBitSize=15, ComSignalType=UINT16, ComSystemTemplateSystemSignalRef=DET_RANGE_VELOCITY_014_Rx
            DET_RANGE_VELOCITY_015_Rx_oRDR_FUSION_DET_013_016_oPCAN_RADAR_690bc5ad_Rx: ComBitPosition=272, ComBitSize=15, ComSignalType=UINT16, ComSystemTemplateSystemSignalRef=DET_RANGE_VELOCITY_015_Rx
            DET_RANGE_VELOCITY_016_Rx_oRDR_FUSION_DET_013_016_oPCAN_RADAR_43b77525_Rx: ComBitPosition=384, ComBitSize=15, ComSignalType=UINT16, ComSystemTemplateSystemSignalRef=DET_RANGE_VELOCITY_016_Rx
            DET_RANGE_VELOCITY_ERR_013_Rx_oRDR_FUSION_DET_013_016_oPCAN_RADAR_a516d47f_Rx: ComBitPosition=64, ComBitSize=8, ComSignalType=UINT8, ComSystemTemplateSystemSignalRef=DET_RANGE_VELOCITY_ERR_013_Rx
            DET_RANGE_VELOCITY_ERR_014_Rx_oRDR_FUSION_DET_013_016_oPCAN_RADAR_5f2b2728_Rx: ComBitPosition=176, ComBitSize=8, ComSignalType=UINT8, ComSystemTemplateSystemSignalRef=DET_RANGE_VELOCITY_ERR_014_Rx
            DET_RANGE_VELOCITY_ERR_015_Rx_oRDR_FUSION_DET_013_016_oPCAN_RADAR_f06fb56f_Rx: ComBitPosition=288, ComBitSize=8, ComSignalType=UINT8, ComSystemTemplateSystemSignalRef=DET_RANGE_VELOCITY_ERR_015_Rx
            DET_RANGE_VELOCITY_ERR_016_Rx_oRDR_FUSION_DET_013_016_oPCAN_RADAR_dad305e7_Rx: ComBitPosition=400, ComBitSize=8, ComSignalType=UINT8, ComSystemTemplateSystemSignalRef=DET_RANGE_VELOCITY_ERR_016_Rx
            DET_RCS_013_Rx_oRDR_FUSION_DET_013_016_oPCAN_RADAR_f1b936a6_Rx: ComBitPosition=128, ComBitSize=8, ComSignalType=UINT8, ComSystemTemplateSystemSignalRef=DET_RCS_013_Rx
            DET_RCS_014_Rx_oRDR_FUSION_DET_013_016_oPCAN_RADAR_0b84c5f1_Rx: ComBitPosition=240, ComBitSize=8, ComSignalType=UINT8, ComSystemTemplateSystemSignalRef=DET_RCS_014_Rx
            DET_RCS_015_Rx_oRDR_FUSION_DET_013_016_oPCAN_RADAR_a4c057b6_Rx: ComBitPosition=352, ComBitSize=8, ComSignalType=UINT8, ComSystemTemplateSystemSignalRef=DET_RCS_015_Rx
            DET_RCS_016_Rx_oRDR_FUSION_DET_013_016_oPCAN_RADAR_8e7ce73e_Rx: ComBitPosition=464, ComBitSize=8, ComSignalType=UINT8, ComSystemTemplateSystemSignalRef=DET_RCS_016_Rx
            DET_SNR_013_Rx_oRDR_FUSION_DET_013_016_oPCAN_RADAR_f8e3474f_Rx: ComBitPosition=120, ComBitSize=8, ComSignalType=UINT8, ComSystemTemplateSystemSignalRef=DET_SNR_013_Rx
            DET_SNR_014_Rx_oRDR_FUSION_DET_013_016_oPCAN_RADAR_02deb418_Rx: ComBitPosition=232, ComBitSize=8, ComSignalType=UINT8, ComSystemTemplateSystemSignalRef=DET_SNR_014_Rx
            DET_SNR_015_Rx_oRDR_FUSION_DET_013_016_oPCAN_RADAR_ad9a265f_Rx: ComBitPosition=344, ComBitSize=8, ComSignalType=UINT8, ComSystemTemplateSystemSignalRef=DET_SNR_015_Rx
            DET_SNR_016_Rx_oRDR_FUSION_DET_013_016_oPCAN_RADAR_872696d7_Rx: ComBitPosition=456, ComBitSize=8, ComSignalType=UINT8, ComSystemTemplateSystemSignalRef=DET_SNR_016_Rx
            DET_SUPER_RES_TARGET_013_Rx_oRDR_FUSION_DET_013_016_oPCAN_RADAR_3318664f_Rx: ComBitPosition=87, ComBitSize=1, ComSignalType=BOOLEAN, ComSystemTemplateSystemSignalRef=DET_SUPER_RES_TARGET_013_Rx
            DET_SUPER_RES_TARGET_014_Rx_oRDR_FUSION_DET_013_016_oPCAN_RADAR_c9259518_Rx: ComBitPosition=199, ComBitSize=1, ComSignalType=BOOLEAN, ComSystemTemplateSystemSignalRef=DET_SUPER_RES_TARGET_014_Rx
            DET_SUPER_RES_TARGET_015_Rx_oRDR_FUSION_DET_013_016_oPCAN_RADAR_6661075f_Rx: ComBitPosition=311, ComBitSize=1, ComSignalType=BOOLEAN, ComSystemTemplateSystemSignalRef=DET_SUPER_RES_TARGET_015_Rx
            DET_SUPER_RES_TARGET_016_Rx_oRDR_FUSION_DET_013_016_oPCAN_RADAR_4cddb7d7_Rx: ComBitPosition=423, ComBitSize=1, ComSignalType=BOOLEAN, ComSystemTemplateSystemSignalRef=DET_SUPER_RES_TARGET_016_Rx
        SG_Fusion_Detections_017_020_oRDR_FUSION_DET_017_020_oPCAN_RADAR_3121649c_Rx: ComTimeout=0, ComSystemTemplateSignalGroupRef=SG_Fusion_Detections_017_020
          83 x ComGroupSignal, all with ComSignalEndianness=LITTLE_ENDIAN, ComSignalInitValue=0:
            DET_AZIMUTH_017_Rx_oRDR_FUSION_DET_017_020_oPCAN_RADAR_8d4ce572_Rx: ComBitPosition=88, ComBitSize=13, ComSignalType=UINT16, ComSystemTemplateSystemSignalRef=DET_AZIMUTH_017_Rx
            DET_AZIMUTH_018_Rx_oRDR_FUSION_DET_017_020_oPCAN_RADAR_0d0297da_Rx: ComBitPosition=200, ComBitSize=13, ComSignalType=UINT16, ComSystemTemplateSystemSignalRef=DET_AZIMUTH_018_Rx
            DET_AZIMUTH_019_Rx_oRDR_FUSION_DET_017_020_oPCAN_RADAR_a246059d_Rx: ComBitPosition=312, ComBitSize=13, ComSignalType=UINT16, ComSystemTemplateSystemSignalRef=DET_AZIMUTH_019_Rx
            DET_AZIMUTH_020_Rx_oRDR_FUSION_DET_017_020_oPCAN_RADAR_9438a187_Rx: ComBitPosition=424, ComBitSize=13, ComSignalType=UINT16, ComSystemTemplateSystemSignalRef=DET_AZIMUTH_020_Rx
            DET_AZIMUTH_ERR_017_Rx_oRDR_FUSION_DET_017_020_oPCAN_RADAR_8f2544f0_Rx: ComBitPosition=105, ComBitSize=7, ComSignalType=UINT8, ComSystemTemplateSystemSignalRef=DET_AZIMUTH_ERR_017_Rx
            DET_AZIMUTH_ERR_018_Rx_oRDR_FUSION_DET_017_020_oPCAN_RADAR_0f6b3658_Rx: ComBitPosition=217, ComBitSize=7, ComSignalType=UINT8, ComSystemTemplateSystemSignalRef=DET_AZIMUTH_ERR_018_Rx
            DET_AZIMUTH_ERR_019_Rx_oRDR_FUSION_DET_017_020_oPCAN_RADAR_a02fa41f_Rx: ComBitPosition=329, ComBitSize=7, ComSignalType=UINT8, ComSystemTemplateSystemSignalRef=DET_AZIMUTH_ERR_019_Rx
            DET_AZIMUTH_ERR_020_Rx_oRDR_FUSION_DET_017_020_oPCAN_RADAR_96510005_Rx: ComBitPosition=441, ComBitSize=7, ComSignalType=UINT8, ComSystemTemplateSystemSignalRef=DET_AZIMUTH_ERR_020_Rx
            DET_BELOW_RAIN_THOLD_017_Rx_oRDR_FUSION_DET_017_020_oPCAN_RADAR_ebf61ac7_Rx: ComBitPosition=39, ComBitSize=1, ComSignalType=BOOLEAN, ComSystemTemplateSystemSignalRef=DET_BELOW_RAIN_THOLD_017_Rx
            DET_BELOW_RAIN_THOLD_018_Rx_oRDR_FUSION_DET_017_020_oPCAN_RADAR_6bb8686f_Rx: ComBitPosition=151, ComBitSize=1, ComSignalType=BOOLEAN, ComSystemTemplateSystemSignalRef=DET_BELOW_RAIN_THOLD_018_Rx
            DET_BELOW_RAIN_THOLD_019_Rx_oRDR_FUSION_DET_017_020_oPCAN_RADAR_c4fcfa28_Rx: ComBitPosition=263, ComBitSize=1, ComSignalType=BOOLEAN, ComSystemTemplateSystemSignalRef=DET_BELOW_RAIN_THOLD_019_Rx
            DET_BELOW_RAIN_THOLD_020_Rx_oRDR_FUSION_DET_017_020_oPCAN_RADAR_f2825e32_Rx: ComBitPosition=375, ComBitSize=1, ComSignalType=BOOLEAN, ComSystemTemplateSystemSignalRef=DET_BELOW_RAIN_THOLD_020_Rx
            DET_BI_STATIC_FLAG_017_Rx_oRDR_FUSION_DET_017_020_oPCAN_RADAR_9c68b1d4_Rx: ComBitPosition=104, ComBitSize=1, ComSignalType=BOOLEAN, ComSystemTemplateSystemSignalRef=DET_BI_STATIC_FLAG_017_Rx
            DET_BI_STATIC_FLAG_018_Rx_oRDR_FUSION_DET_017_020_oPCAN_RADAR_1c26c37c_Rx: ComBitPosition=216, ComBitSize=1, ComSignalType=BOOLEAN, ComSystemTemplateSystemSignalRef=DET_BI_STATIC_FLAG_018_Rx
            DET_BI_STATIC_FLAG_019_Rx_oRDR_FUSION_DET_017_020_oPCAN_RADAR_b362513b_Rx: ComBitPosition=328, ComBitSize=1, ComSignalType=BOOLEAN, ComSystemTemplateSystemSignalRef=DET_BI_STATIC_FLAG_019_Rx
            DET_BI_STATIC_FLAG_020_Rx_oRDR_FUSION_DET_017_020_oPCAN_RADAR_851cf521_Rx: ComBitPosition=440, ComBitSize=1, ComSignalType=BOOLEAN, ComSystemTemplateSystemSignalRef=DET_BI_STATIC_FLAG_020_Rx
            DET_CONFD_AZIMUTH_017_Rx_oRDR_FUSION_DET_017_020_oPCAN_RADAR_7f015b80_Rx: ComBitPosition=118, ComBitSize=2, ComSignalType=UINT8, ComSystemTemplateSystemSignalRef=DET_CONFD_AZIMUTH_017_Rx
            DET_CONFD_AZIMUTH_018_Rx_oRDR_FUSION_DET_017_020_oPCAN_RADAR_ff4f2928_Rx: ComBitPosition=230, ComBitSize=2, ComSignalType=UINT8, ComSystemTemplateSystemSignalRef=DET_CONFD_AZIMUTH_018_Rx
            DET_CONFD_AZIMUTH_019_Rx_oRDR_FUSION_DET_017_020_oPCAN_RADAR_500bbb6f_Rx: ComBitPosition=342, ComBitSize=2, ComSignalType=UINT8, ComSystemTemplateSystemSignalRef=DET_CONFD_AZIMUTH_019_Rx
            DET_CONFD_AZIMUTH_020_Rx_oRDR_FUSION_DET_017_020_oPCAN_RADAR_66751f75_Rx: ComBitPosition=454, ComBitSize=2, ComSignalType=UINT8, ComSystemTemplateSystemSignalRef=DET_CONFD_AZIMUTH_020_Rx
            DET_CONFD_ELEVATION_017_Rx_oRDR_FUSION_DET_017_020_oPCAN_RADAR_7520d807_Rx: ComBitPosition=101, ComBitSize=2, ComSignalType=UINT8, ComSystemTemplateSystemSignalRef=DET_CONFD_ELEVATION_017_Rx
            DET_CONFD_ELEVATION_018_Rx_oRDR_FUSION_DET_017_020_oPCAN_RADAR_f56eaaaf_Rx: ComBitPosition=213, ComBitSize=2, ComSignalType=UINT8, ComSystemTemplateSystemSignalRef=DET_CONFD_ELEVATION_018_Rx
            DET_CONFD_ELEVATION_019_Rx_oRDR_FUSION_DET_017_020_oPCAN_RADAR_5a2a38e8_Rx: ComBitPosition=325, ComBitSize=2, ComSignalType=UINT8, ComSystemTemplateSystemSignalRef=DET_CONFD_ELEVATION_019_Rx
            DET_CONFD_ELEVATION_020_Rx_oRDR_FUSION_DET_017_020_oPCAN_RADAR_6c549cf2_Rx: ComBitPosition=437, ComBitSize=2, ComSignalType=UINT8, ComSystemTemplateSystemSignalRef=DET_CONFD_ELEVATION_020_Rx
            DET_ELEVATION_017_Rx_oRDR_FUSION_DET_017_020_oPCAN_RADAR_7f7337fe_Rx: ComBitPosition=72, ComBitSize=8, ComSignalType=UINT8, ComSystemTemplateSystemSignalRef=DET_ELEVATION_017_Rx
            DET_ELEVATION_018_Rx_oRDR_FUSION_DET_017_020_oPCAN_RADAR_ff3d4556_Rx: ComBitPosition=184, ComBitSize=8, ComSignalType=UINT8, ComSystemTemplateSystemSignalRef=DET_ELEVATION_018_Rx
            DET_ELEVATION_019_Rx_oRDR_FUSION_DET_017_020_oPCAN_RADAR_5079d711_Rx: ComBitPosition=296, ComBitSize=8, ComSignalType=UINT8, ComSystemTemplateSystemSignalRef=DET_ELEVATION_019_Rx
            DET_ELEVATION_020_Rx_oRDR_FUSION_DET_017_020_oPCAN_RADAR_6607730b_Rx: ComBitPosition=408, ComBitSize=8, ComSignalType=UINT8, ComSystemTemplateSystemSignalRef=DET_ELEVATION_020_Rx
            DET_ELEVATION_ERR_017_Rx_oRDR_FUSION_DET_017_020_oPCAN_RADAR_adca1521_Rx: ComBitPosition=80, ComBitSize=6, ComSignalType=UINT8, ComSystemTemplateSystemSignalRef=DET_ELEVATION_ERR_017_Rx
            DET_ELEVATION_ERR_018_Rx_oRDR_FUSION_DET_017_020_oPCAN_RADAR_2d846789_Rx: ComBitPosition=192, ComBitSize=6, ComSignalType=UINT8, ComSystemTemplateSystemSignalRef=DET_ELEVATION_ERR_018_Rx
            DET_ELEVATION_ERR_019_Rx_oRDR_FUSION_DET_017_020_oPCAN_RADAR_82c0f5ce_Rx: ComBitPosition=304, ComBitSize=6, ComSignalType=UINT8, ComSystemTemplateSystemSignalRef=DET_ELEVATION_ERR_019_Rx
            DET_ELEVATION_ERR_020_Rx_oRDR_FUSION_DET_017_020_oPCAN_RADAR_b4be51d4_Rx: ComBitPosition=416, ComBitSize=6, ComSignalType=UINT8, ComSystemTemplateSystemSignalRef=DET_ELEVATION_ERR_020_Rx
            DET_EXISTENCE_PROB_017_Rx_oRDR_FUSION_DET_017_020_oPCAN_RADAR_5ad26db4_Rx: ComBitPosition=112, ComBitSize=6, ComSignalType=UINT8, ComSystemTemplateSystemSignalRef=DET_EXISTENCE_PROB_017_Rx
            DET_EXISTENCE_PROB_018_Rx_oRDR_FUSION_DET_017_020_oPCAN_RADAR_da9c1f1c_Rx: ComBitPosition=224, ComBitSize=6, ComSignalType=UINT8, ComSystemTemplateSystemSignalRef=DET_EXISTENCE_PROB_018_Rx
            DET_EXISTENCE_PROB_019_Rx_oRDR_FUSION_DET_017_020_oPCAN_RADAR_75d88d5b_Rx: ComBitPosition=336, ComBitSize=6, ComSignalType=UINT8, ComSystemTemplateSystemSignalRef=DET_EXISTENCE_PROB_019_Rx
            DET_EXISTENCE_PROB_020_Rx_oRDR_FUSION_DET_017_020_oPCAN_RADAR_43a62941_Rx: ComBitPosition=448, ComBitSize=6, ComSignalType=UINT8, ComSystemTemplateSystemSignalRef=DET_EXISTENCE_PROB_020_Rx
            DET_HVC_FLAG_017_Rx_oRDR_FUSION_DET_017_020_oPCAN_RADAR_870c80fb_Rx: ComBitPosition=86, ComBitSize=1, ComSignalType=BOOLEAN, ComSystemTemplateSystemSignalRef=DET_HVC_FLAG_017_Rx
            DET_HVC_FLAG_018_Rx_oRDR_FUSION_DET_017_020_oPCAN_RADAR_0742f253_Rx: ComBitPosition=198, ComBitSize=1, ComSignalType=BOOLEAN, ComSystemTemplateSystemSignalRef=DET_HVC_FLAG_018_Rx
            DET_HVC_FLAG_019_Rx_oRDR_FUSION_DET_017_020_oPCAN_RADAR_a8066014_Rx: ComBitPosition=310, ComBitSize=1, ComSignalType=BOOLEAN, ComSystemTemplateSystemSignalRef=DET_HVC_FLAG_019_Rx
            DET_HVC_FLAG_020_Rx_oRDR_FUSION_DET_017_020_oPCAN_RADAR_9e78c40e_Rx: ComBitPosition=422, ComBitSize=1, ComSignalType=BOOLEAN, ComSystemTemplateSystemSignalRef=DET_HVC_FLAG_020_Rx
            DET_IDM_017_Rx_oRDR_FUSION_DET_017_020_oPCAN_RADAR_b2cd79b3_Rx: ComBitPosition=63, ComBitSize=1, ComSignalType=BOOLEAN, ComSystemTemplateSystemSignalRef=DET_IDM_017_Rx
            DET_IDM_018_Rx_oRDR_FUSION_DET_017_020_oPCAN_RADAR_32830b1b_Rx: ComBitPosition=175, ComBitSize=1, ComSignalType=BOOLEAN, ComSystemTemplateSystemSignalRef=DET_IDM_018_Rx
            DET_IDM_019_Rx_oRDR_FUSION_DET_017_020_oPCAN_RADAR_9dc7995c_Rx: ComBitPosition=287, ComBitSize=1, ComSignalType=BOOLEAN, ComSystemTemplateSystemSignalRef=DET_IDM_019_Rx
            DET_IDM_020_Rx_oRDR_FUSION_DET_017_020_oPCAN_RADAR_abb93d46_Rx: ComBitPosition=399, ComBitSize=1, ComSignalType=BOOLEAN, ComSystemTemplateSystemSignalRef=DET_IDM_020_Rx
            DET_MH_CRC16_017_020_Rx_oRDR_FUSION_DET_017_020_oPCAN_RADAR_92f8a58f_Rx: ComBitPosition=0, ComBitSize=16, ComSignalType=UINT16, ComSystemTemplateSystemSignalRef=DET_MH_CRC16_017_020_Rx
            DET_MH_CYCLE_COUNTER_017_020_Rx_oRDR_FUSION_DET_017_020_oPCAN_RADAR_9f23984a_Rx: ComBitPosition=16, ComBitSize=8, ComSignalType=UINT8, ComSystemTemplateSystemSignalRef=DET_MH_CYCLE_COUNTER_017_020_Rx
            DET_MH_SCAN_INDEX_4LSB_017_020_Rx_oRDR_FUSION_DET_017_020_oPCAN_RADAR_fb935771_Rx: ComBitPosition=476, ComBitSize=4, ComSignalType=UINT8, ComSystemTemplateSystemSignalRef=DET_MH_SCAN_INDEX_4LSB_017_020_Rx
            DET_MTD_017_Rx_oRDR_FUSION_DET_017_020_oPCAN_RADAR_0f4e4fc3_Rx: ComBitPosition=47, ComBitSize=1, ComSignalType=BOOLEAN, ComSystemTemplateSystemSignalRef=DET_MTD_017_Rx
            DET_MTD_018_Rx_oRDR_FUSION_DET_017_020_oPCAN_RADAR_8f003d6b_Rx: ComBitPosition=159, ComBitSize=1, ComSignalType=BOOLEAN, ComSystemTemplateSystemSignalRef=DET_MTD_018_Rx
            DET_MTD_019_Rx_oRDR_FUSION_DET_017_020_oPCAN_RADAR_2044af2c_Rx: ComBitPosition=271, ComBitSize=1, ComSignalType=BOOLEAN, ComSystemTemplateSystemSignalRef=DET_MTD_019_Rx
            DET_MTD_020_Rx_oRDR_FUSION_DET_017_020_oPCAN_RADAR_163a0b36_Rx: ComBitPosition=383, ComBitSize=1, ComSignalType=BOOLEAN, ComSystemTemplateSystemSignalRef=DET_MTD_020_Rx
            DET_PROB_1STAZHYPO_017_Rx_oRDR_FUSION_DET_017_020_oPCAN_RADAR_c5375142_Rx: ComBitPosition=103, ComBitSize=1, ComSignalType=BOOLEAN, ComSystemTemplateSystemSignalRef=DET_PROB_1STAZHYPO_017_Rx
            DET_PROB_1STAZHYPO_018_Rx_oRDR_FUSION_DET_017_020_oPCAN_RADAR_457923ea_Rx: ComBitPosition=215, ComBitSize=1, ComSignalType=BOOLEAN, ComSystemTemplateSystemSignalRef=DET_PROB_1STAZHYPO_018_Rx
            DET_PROB_1STAZHYPO_019_Rx_oRDR_FUSION_DET_017_020_oPCAN_RADAR_ea3db1ad_Rx: ComBitPosition=327, ComBitSize=1, ComSignalType=BOOLEAN, ComSystemTemplateSystemSignalRef=DET_PROB_1STAZHYPO_019_Rx
            DET_PROB_1STAZHYPO_020_Rx_oRDR_FUSION_DET_017_020_oPCAN_RADAR_dc4315b7_Rx: ComBitPosition=439, ComBitSize=1, ComSignalType=BOOLEAN, ComSystemTemplateSystemSignalRef=DET_PROB_1STAZHYPO_020_Rx
            DET_RANGE_017_Rx_oRDR_FUSION_DET_017_020_oPCAN_RADAR_9e8ab955_Rx: ComBitPosition=24, ComBitSize=15, ComSignalType=UINT16, ComSystemTemplateSystemSignalRef=DET_RANGE_017_Rx
            DET_RANGE_018_Rx_oRDR_FUSION_DET_017_020_oPCAN_RADAR_1ec4cbfd_Rx: ComBitPosition=136, ComBitSize=15, ComSignalType=UINT16, ComSystemTemplateSystemSignalRef=DET_RANGE_018_Rx
            DET_RANGE_019_Rx_oRDR_FUSION_DET_017_020_oPCAN_RADAR_b18059ba_Rx: ComBitPosition=248, ComBitSize=15, ComSignalType=UINT16, ComSystemTemplateSystemSignalRef=DET_RANGE_019_Rx
            DET_RANGE_020_Rx_oRDR_FUSION_DET_017_020_oPCAN_RADAR_87fefda0_Rx: ComBitPosition=360, ComBitSize=15, ComSignalType=UINT16, ComSystemTemplateSystemSignalRef=DET_RANGE_020_Rx
            DET_RANGE_ERR_017_Rx_oRDR_FUSION_DET_017_020_oPCAN_RADAR_ce7835b5_Rx: ComBitPosition=40, ComBitSize=7, ComSignalType=UINT8, ComSystemTemplateSystemSignalRef=DET_RANGE_ERR_017_Rx
            DET_RANGE_ERR_018_Rx_oRDR_FUSION_DET_017_020_oPCAN_RADAR_4e36471d_Rx: ComBitPosition=152, ComBitSize=7, ComSignalType=UINT8, ComSystemTemplateSystemSignalRef=DET_RANGE_ERR_018_Rx
            DET_RANGE_ERR_019_Rx_oRDR_FUSION_DET_017_020_oPCAN_RADAR_e172d55a_Rx: ComBitPosition=264, ComBitSize=7, ComSignalType=UINT8, ComSystemTemplateSystemSignalRef=DET_RANGE_ERR_019_Rx
            DET_RANGE_ERR_020_Rx_oRDR_FUSION_DET_017_020_oPCAN_RADAR_d70c7140_Rx: ComBitPosition=376, ComBitSize=7, ComSignalType=UINT8, ComSystemTemplateSystemSignalRef=DET_RANGE_ERR_020_Rx
            DET_RANGE_VELOCITY_017_Rx_oRDR_FUSION_DET_017_020_oPCAN_RADAR_437f3aab_Rx: ComBitPosition=48, ComBitSize=15, ComSignalType=UINT16, ComSystemTemplateSystemSignalRef=DET_RANGE_VELOCITY_017_Rx
            DET_RANGE_VELOCITY_018_Rx_oRDR_FUSION_DET_017_020_oPCAN_RADAR_c3314803_Rx: ComBitPosition=160, ComBitSize=15, ComSignalType=UINT16, ComSystemTemplateSystemSignalRef=DET_RANGE_VELOCITY_018_Rx
            DET_RANGE_VELOCITY_019_Rx_oRDR_FUSION_DET_017_020_oPCAN_RADAR_6c75da44_Rx: ComBitPosition=272, ComBitSize=15, ComSignalType=UINT16, ComSystemTemplateSystemSignalRef=DET_RANGE_VELOCITY_019_Rx
            DET_RANGE_VELOCITY_020_Rx_oRDR_FUSION_DET_017_020_oPCAN_RADAR_5a0b7e5e_Rx: ComBitPosition=384, ComBitSize=15, ComSignalType=UINT16, ComSystemTemplateSystemSignalRef=DET_RANGE_VELOCITY_020_Rx
            DET_RANGE_VELOCITY_ERR_017_Rx_oRDR_FUSION_DET_017_020_oPCAN_RADAR_da1b4a69_Rx: ComBitPosition=64, ComBitSize=8, ComSignalType=UINT8, ComSystemTemplateSystemSignalRef=DET_RANGE_VELOCITY_ERR_017_Rx
            DET_RANGE_VELOCITY_ERR_018_Rx_oRDR_FUSION_DET_017_020_oPCAN_RADAR_5a5538c1_Rx: ComBitPosition=176, ComBitSize=8, ComSignalType=UINT8, ComSystemTemplateSystemSignalRef=DET_RANGE_VELOCITY_ERR_018_Rx
            DET_RANGE_VELOCITY_ERR_019_Rx_oRDR_FUSION_DET_017_020_oPCAN_RADAR_f511aa86_Rx: ComBitPosition=288, ComBitSize=8, ComSignalType=UINT8, ComSystemTemplateSystemSignalRef=DET_RANGE_VELOCITY_ERR_019_Rx
            DET_RANGE_VELOCITY_ERR_020_Rx_oRDR_FUSION_DET_017_020_oPCAN_RADAR_c36f0e9c_Rx: ComBitPosition=400, ComBitSize=8, ComSignalType=UINT8, ComSystemTemplateSystemSignalRef=DET_RANGE_VELOCITY_ERR_020_Rx
            DET_RCS_017_Rx_oRDR_FUSION_DET_017_020_oPCAN_RADAR_8eb4a8b0_Rx: ComBitPosition=128, ComBitSize=8, ComSignalType=UINT8, ComSystemTemplateSystemSignalRef=DET_RCS_017_Rx
            DET_RCS_018_Rx_oRDR_FUSION_DET_017_020_oPCAN_RADAR_0efada18_Rx: ComBitPosition=240, ComBitSize=8, ComSignalType=UINT8, ComSystemTemplateSystemSignalRef=DET_RCS_018_Rx
            DET_RCS_019_Rx_oRDR_FUSION_DET_017_020_oPCAN_RADAR_a1be485f_Rx: ComBitPosition=352, ComBitSize=8, ComSignalType=UINT8, ComSystemTemplateSystemSignalRef=DET_RCS_019_Rx
            DET_RCS_020_Rx_oRDR_FUSION_DET_017_020_oPCAN_RADAR_97c0ec45_Rx: ComBitPosition=464, ComBitSize=8, ComSignalType=UINT8, ComSystemTemplateSystemSignalRef=DET_RCS_020_Rx
            DET_SNR_017_Rx_oRDR_FUSION_DET_017_020_oPCAN_RADAR_87eed959_Rx: ComBitPosition=120, ComBitSize=8, ComSignalType=UINT8, ComSystemTemplateSystemSignalRef=DET_SNR_017_Rx
            DET_SNR_018_Rx_oRDR_FUSION_DET_017_020_oPCAN_RADAR_07a0abf1_Rx: ComBitPosition=232, ComBitSize=8, ComSignalType=UINT8, ComSystemTemplateSystemSignalRef=DET_SNR_018_Rx
            DET_SNR_019_Rx_oRDR_FUSION_DET_017_020_oPCAN_RADAR_a8e439b6_Rx: ComBitPosition=344, ComBitSize=8, ComSignalType=UINT8, ComSystemTemplateSystemSignalRef=DET_SNR_019_Rx
            DET_SNR_020_Rx_oRDR_FUSION_DET_017_020_oPCAN_RADAR_9e9a9dac_Rx: ComBitPosition=456, ComBitSize=8, ComSignalType=UINT8, ComSystemTemplateSystemSignalRef=DET_SNR_020_Rx
            DET_SUPER_RES_TARGET_017_Rx_oRDR_FUSION_DET_017_020_oPCAN_RADAR_4c15f859_Rx: ComBitPosition=87, ComBitSize=1, ComSignalType=BOOLEAN, ComSystemTemplateSystemSignalRef=DET_SUPER_RES_TARGET_017_Rx
            DET_SUPER_RES_TARGET_018_Rx_oRDR_FUSION_DET_017_020_oPCAN_RADAR_cc5b8af1_Rx: ComBitPosition=199, ComBitSize=1, ComSignalType=BOOLEAN, ComSystemTemplateSystemSignalRef=DET_SUPER_RES_TARGET_018_Rx
            DET_SUPER_RES_TARGET_019_Rx_oRDR_FUSION_DET_017_020_oPCAN_RADAR_631f18b6_Rx: ComBitPosition=311, ComBitSize=1, ComSignalType=BOOLEAN, ComSystemTemplateSystemSignalRef=DET_SUPER_RES_TARGET_019_Rx
            DET_SUPER_RES_TARGET_020_Rx_oRDR_FUSION_DET_017_020_oPCAN_RADAR_5561bcac_Rx: ComBitPosition=423, ComBitSize=1, ComSignalType=BOOLEAN, ComSystemTemplateSystemSignalRef=DET_SUPER_RES_TARGET_020_Rx
        SG_Fusion_Detections_021_024_oRDR_FUSION_DET_021_024_oPCAN_RADAR_f7a0d0a9_Rx: ComTimeout=0, ComSystemTemplateSignalGroupRef=SG_Fusion_Detections_021_024
          83 x ComGroupSignal, all with ComSignalEndianness=LITTLE_ENDIAN, ComSignalInitValue=0:
            DET_AZIMUTH_021_Rx_oRDR_FUSION_DET_021_024_oPCAN_RADAR_b677333c_Rx: ComBitPosition=88, ComBitSize=13, ComSignalType=UINT16, ComSystemTemplateSystemSignalRef=DET_AZIMUTH_021_Rx
            DET_AZIMUTH_022_Rx_oRDR_FUSION_DET_021_024_oPCAN_RADAR_9ccb83b4_Rx: ComBitPosition=200, ComBitSize=13, ComSignalType=UINT16, ComSystemTemplateSystemSignalRef=DET_AZIMUTH_022_Rx
            DET_AZIMUTH_023_Rx_oRDR_FUSION_DET_021_024_oPCAN_RADAR_338f11f3_Rx: ComBitPosition=312, ComBitSize=13, ComSignalType=UINT16, ComSystemTemplateSystemSignalRef=DET_AZIMUTH_023_Rx
            DET_AZIMUTH_024_Rx_oRDR_FUSION_DET_021_024_oPCAN_RADAR_c9b2e2a4_Rx: ComBitPosition=424, ComBitSize=13, ComSignalType=UINT16, ComSystemTemplateSystemSignalRef=DET_AZIMUTH_024_Rx
            DET_AZIMUTH_ERR_021_Rx_oRDR_FUSION_DET_021_024_oPCAN_RADAR_b41e92be_Rx: ComBitPosition=105, ComBitSize=7, ComSignalType=UINT8, ComSystemTemplateSystemSignalRef=DET_AZIMUTH_ERR_021_Rx
            DET_AZIMUTH_ERR_022_Rx_oRDR_FUSION_DET_021_024_oPCAN_RADAR_9ea22236_Rx: ComBitPosition=217, ComBitSize=7, ComSignalType=UINT8, ComSystemTemplateSystemSignalRef=DET_AZIMUTH_ERR_022_Rx
            DET_AZIMUTH_ERR_023_Rx_oRDR_FUSION_DET_021_024_oPCAN_RADAR_31e6b071_Rx: ComBitPosition=329, ComBitSize=7, ComSignalType=UINT8, ComSystemTemplateSystemSignalRef=DET_AZIMUTH_ERR_023_Rx
            DET_AZIMUTH_ERR_024_Rx_oRDR_FUSION_DET_021_024_oPCAN_RADAR_cbdb4326_Rx: ComBitPosition=441, ComBitSize=7, ComSignalType=UINT8, ComSystemTemplateSystemSignalRef=DET_AZIMUTH_ERR_024_Rx
            DET_BELOW_RAIN_THOLD_021_Rx_oRDR_FUSION_DET_021_024_oPCAN_RADAR_d0cdcc89_Rx: ComBitPosition=39, ComBitSize=1, ComSignalType=BOOLEAN, ComSystemTemplateSystemSignalRef=DET_BELOW_RAIN_THOLD_021_Rx
            DET_BELOW_RAIN_THOLD_022_Rx_oRDR_FUSION_DET_021_024_oPCAN_RADAR_fa717c01_Rx: ComBitPosition=151, ComBitSize=1, ComSignalType=BOOLEAN, ComSystemTemplateSystemSignalRef=DET_BELOW_RAIN_THOLD_022_Rx
            DET_BELOW_RAIN_THOLD_023_Rx_oRDR_FUSION_DET_021_024_oPCAN_RADAR_5535ee46_Rx: ComBitPosition=263, ComBitSize=1, ComSignalType=BOOLEAN, ComSystemTemplateSystemSignalRef=DET_BELOW_RAIN_THOLD_023_Rx
            DET_BELOW_RAIN_THOLD_024_Rx_oRDR_FUSION_DET_021_024_oPCAN_RADAR_af081d11_Rx: ComBitPosition=375, ComBitSize=1, ComSignalType=BOOLEAN, ComSystemTemplateSystemSignalRef=DET_BELOW_RAIN_THOLD_024_Rx
            DET_BI_STATIC_FLAG_021_Rx_oRDR_FUSION_DET_021_024_oPCAN_RADAR_a753679a_Rx: ComBitPosition=104, ComBitSize=1, ComSignalType=BOOLEAN, ComSystemTemplateSystemSignalRef=DET_BI_STATIC_FLAG_021_Rx
            DET_BI_STATIC_FLAG_022_Rx_oRDR_FUSION_DET_021_024_oPCAN_RADAR_8defd712_Rx: ComBitPosition=216, ComBitSize=1, ComSignalType=BOOLEAN, ComSystemTemplateSystemSignalRef=DET_BI_STATIC_FLAG_022_Rx
            DET_BI_STATIC_FLAG_023_Rx_oRDR_FUSION_DET_021_024_oPCAN_RADAR_22ab4555_Rx: ComBitPosition=328, ComBitSize=1, ComSignalType=BOOLEAN, ComSystemTemplateSystemSignalRef=DET_BI_STATIC_FLAG_023_Rx
            DET_BI_STATIC_FLAG_024_Rx_oRDR_FUSION_DET_021_024_oPCAN_RADAR_d896b602_Rx: ComBitPosition=440, ComBitSize=1, ComSignalType=BOOLEAN, ComSystemTemplateSystemSignalRef=DET_BI_STATIC_FLAG_024_Rx
            DET_CONFD_AZIMUTH_021_Rx_oRDR_FUSION_DET_021_024_oPCAN_RADAR_443a8dce_Rx: ComBitPosition=118, ComBitSize=2, ComSignalType=UINT8, ComSystemTemplateSystemSignalRef=DET_CONFD_AZIMUTH_021_Rx
            DET_CONFD_AZIMUTH_022_Rx_oRDR_FUSION_DET_021_024_oPCAN_RADAR_6e863d46_Rx: ComBitPosition=230, ComBitSize=2, ComSignalType=UINT8, ComSystemTemplateSystemSignalRef=DET_CONFD_AZIMUTH_022_Rx
            DET_CONFD_AZIMUTH_023_Rx_oRDR_FUSION_DET_021_024_oPCAN_RADAR_c1c2af01_Rx: ComBitPosition=342, ComBitSize=2, ComSignalType=UINT8, ComSystemTemplateSystemSignalRef=DET_CONFD_AZIMUTH_023_Rx
            DET_CONFD_AZIMUTH_024_Rx_oRDR_FUSION_DET_021_024_oPCAN_RADAR_3bff5c56_Rx: ComBitPosition=454, ComBitSize=2, ComSignalType=UINT8, ComSystemTemplateSystemSignalRef=DET_CONFD_AZIMUTH_024_Rx
            DET_CONFD_ELEVATION_021_Rx_oRDR_FUSION_DET_021_024_oPCAN_RADAR_4e1b0e49_Rx: ComBitPosition=101, ComBitSize=2, ComSignalType=UINT8, ComSystemTemplateSystemSignalRef=DET_CONFD_ELEVATION_021_Rx
            DET_CONFD_ELEVATION_022_Rx_oRDR_FUSION_DET_021_024_oPCAN_RADAR_64a7bec1_Rx: ComBitPosition=213, ComBitSize=2, ComSignalType=UINT8, ComSystemTemplateSystemSignalRef=DET_CONFD_ELEVATION_022_Rx
            DET_CONFD_ELEVATION_023_Rx_oRDR_FUSION_DET_021_024_oPCAN_RADAR_cbe32c86_Rx: ComBitPosition=325, ComBitSize=2, ComSignalType=UINT8, ComSystemTemplateSystemSignalRef=DET_CONFD_ELEVATION_023_Rx
            DET_CONFD_ELEVATION_024_Rx_oRDR_FUSION_DET_021_024_oPCAN_RADAR_31dedfd1_Rx: ComBitPosition=437, ComBitSize=2, ComSignalType=UINT8, ComSystemTemplateSystemSignalRef=DET_CONFD_ELEVATION_024_Rx
            DET_ELEVATION_021_Rx_oRDR_FUSION_DET_021_024_oPCAN_RADAR_4448e1b0_Rx: ComBitPosition=72, ComBitSize=8, ComSignalType=UINT8, ComSystemTemplateSystemSignalRef=DET_ELEVATION_021_Rx
            DET_ELEVATION_022_Rx_oRDR_FUSION_DET_021_024_oPCAN_RADAR_6ef45138_Rx: ComBitPosition=184, ComBitSize=8, ComSignalType=UINT8, ComSystemTemplateSystemSignalRef=DET_ELEVATION_022_Rx
            DET_ELEVATION_023_Rx_oRDR_FUSION_DET_021_024_oPCAN_RADAR_c1b0c37f_Rx: ComBitPosition=296, ComBitSize=8, ComSignalType=UINT8, ComSystemTemplateSystemSignalRef=DET_ELEVATION_023_Rx
            DET_ELEVATION_024_Rx_oRDR_FUSION_DET_021_024_oPCAN_RADAR_3b8d3028_Rx: ComBitPosition=408, ComBitSize=8, ComSignalType=UINT8, ComSystemTemplateSystemSignalRef=DET_ELEVATION_024_Rx
            DET_ELEVATION_ERR_021_Rx_oRDR_FUSION_DET_021_024_oPCAN_RADAR_96f1c36f_Rx: ComBitPosition=80, ComBitSize=6, ComSignalType=UINT8, ComSystemTemplateSystemSignalRef=DET_ELEVATION_ERR_021_Rx
            DET_ELEVATION_ERR_022_Rx_oRDR_FUSION_DET_021_024_oPCAN_RADAR_bc4d73e7_Rx: ComBitPosition=192, ComBitSize=6, ComSignalType=UINT8, ComSystemTemplateSystemSignalRef=DET_ELEVATION_ERR_022_Rx
            DET_ELEVATION_ERR_023_Rx_oRDR_FUSION_DET_021_024_oPCAN_RADAR_1309e1a0_Rx: ComBitPosition=304, ComBitSize=6, ComSignalType=UINT8, ComSystemTemplateSystemSignalRef=DET_ELEVATION_ERR_023_Rx
            DET_ELEVATION_ERR_024_Rx_oRDR_FUSION_DET_021_024_oPCAN_RADAR_e93412f7_Rx: ComBitPosition=416, ComBitSize=6, ComSignalType=UINT8, ComSystemTemplateSystemSignalRef=DET_ELEVATION_ERR_024_Rx
            DET_EXISTENCE_PROB_021_Rx_oRDR_FUSION_DET_021_024_oPCAN_RADAR_61e9bbfa_Rx: ComBitPosition=112, ComBitSize=6, ComSignalType=UINT8, ComSystemTemplateSystemSignalRef=DET_EXISTENCE_PROB_021_Rx
            DET_EXISTENCE_PROB_022_Rx_oRDR_FUSION_DET_021_024_oPCAN_RADAR_4b550b72_Rx: ComBitPosition=224, ComBitSize=6, ComSignalType=UINT8, ComSystemTemplateSystemSignalRef=DET_EXISTENCE_PROB_022_Rx
            DET_EXISTENCE_PROB_023_Rx_oRDR_FUSION_DET_021_024_oPCAN_RADAR_e4119935_Rx: ComBitPosition=336, ComBitSize=6, ComSignalType=UINT8, ComSystemTemplateSystemSignalRef=DET_EXISTENCE_PROB_023_Rx
            DET_EXISTENCE_PROB_024_Rx_oRDR_FUSION_DET_021_024_oPCAN_RADAR_1e2c6a62_Rx: ComBitPosition=448, ComBitSize=6, ComSignalType=UINT8, ComSystemTemplateSystemSignalRef=DET_EXISTENCE_PROB_024_Rx
            DET_HVC_FLAG_021_Rx_oRDR_FUSION_DET_021_024_oPCAN_RADAR_bc3756b5_Rx: ComBitPosition=86, ComBitSize=1, ComSignalType=BOOLEAN, ComSystemTemplateSystemSignalRef=DET_HVC_FLAG_021_Rx
            DET_HVC_FLAG_022_Rx_oRDR_FUSION_DET_021_024_oPCAN_RADAR_968be63d_Rx: ComBitPosition=198, ComBitSize=1, ComSignalType=BOOLEAN, ComSystemTemplateSystemSignalRef=DET_HVC_FLAG_022_Rx
            DET_HVC_FLAG_023_Rx_oRDR_FUSION_DET_021_024_oPCAN_RADAR_39cf747a_Rx: ComBitPosition=310, ComBitSize=1, ComSignalType=BOOLEAN, ComSystemTemplateSystemSignalRef=DET_HVC_FLAG_023_Rx
            DET_HVC_FLAG_024_Rx_oRDR_FUSION_DET_021_024_oPCAN_RADAR_c3f2872d_Rx: ComBitPosition=422, ComBitSize=1, ComSignalType=BOOLEAN, ComSystemTemplateSystemSignalRef=DET_HVC_FLAG_024_Rx
            DET_IDM_021_Rx_oRDR_FUSION_DET_021_024_oPCAN_RADAR_89f6affd_Rx: ComBitPosition=63, ComBitSize=1, ComSignalType=BOOLEAN, ComSystemTemplateSystemSignalRef=DET_IDM_021_Rx
            DET_IDM_022_Rx_oRDR_FUSION_DET_021_024_oPCAN_RADAR_a34a1f75_Rx: ComBitPosition=175, ComBitSize=1, ComSignalType=BOOLEAN, ComSystemTemplateSystemSignalRef=DET_IDM_022_Rx
            DET_IDM_023_Rx_oRDR_FUSION_DET_021_024_oPCAN_RADAR_0c0e8d32_Rx: ComBitPosition=287, ComBitSize=1, ComSignalType=BOOLEAN, ComSystemTemplateSystemSignalRef=DET_IDM_023_Rx
            DET_IDM_024_Rx_oRDR_FUSION_DET_021_024_oPCAN_RADAR_f6337e65_Rx: ComBitPosition=399, ComBitSize=1, ComSignalType=BOOLEAN, ComSystemTemplateSystemSignalRef=DET_IDM_024_Rx
            DET_MH_CRC16_021_024_Rx_oRDR_FUSION_DET_021_024_oPCAN_RADAR_0c490975_Rx: ComBitPosition=0, ComBitSize=16, ComSignalType=UINT16, ComSystemTemplateSystemSignalRef=DET_MH_CRC16_021_024_Rx
            DET_MH_CYCLE_COUNTER_021_024_Rx_oRDR_FUSION_DET_021_024_oPCAN_RADAR_019234b0_Rx: ComBitPosition=16, ComBitSize=8, ComSignalType=UINT8, ComSystemTemplateSystemSignalRef=DET_MH_CYCLE_COUNTER_021_024_Rx
            DET_MH_SCAN_INDEX_4LSB_021_024_Rx_oRDR_FUSION_DET_021_024_oPCAN_RADAR_6522fb8b_Rx: ComBitPosition=476, ComBitSize=4, ComSignalType=UINT8, ComSystemTemplateSystemSignalRef=DET_MH_SCAN_INDEX_4LSB_021_024_Rx
            DET_MTD_021_Rx_oRDR_FUSION_DET_021_024_oPCAN_RADAR_3475998d_Rx: ComBitPosition=47, ComBitSize=1, ComSignalType=BOOLEAN, ComSystemTemplateSystemSignalRef=DET_MTD_021_Rx
            DET_MTD_022_Rx_oRDR_FUSION_DET_021_024_oPCAN_RADAR_1ec92905_Rx: ComBitPosition=159, ComBitSize=1, ComSignalType=BOOLEAN, ComSystemTemplateSystemSignalRef=DET_MTD_022_Rx
            DET_MTD_023_Rx_oRDR_FUSION_DET_021_024_oPCAN_RADAR_b18dbb42_Rx: ComBitPosition=271, ComBitSize=1, ComSignalType=BOOLEAN, ComSystemTemplateSystemSignalRef=DET_MTD_023_Rx
            DET_MTD_024_Rx_oRDR_FUSION_DET_021_024_oPCAN_RADAR_4bb04815_Rx: ComBitPosition=383, ComBitSize=1, ComSignalType=BOOLEAN, ComSystemTemplateSystemSignalRef=DET_MTD_024_Rx
            DET_PROB_1STAZHYPO_021_Rx_oRDR_FUSION_DET_021_024_oPCAN_RADAR_fe0c870c_Rx: ComBitPosition=103, ComBitSize=1, ComSignalType=BOOLEAN, ComSystemTemplateSystemSignalRef=DET_PROB_1STAZHYPO_021_Rx
            DET_PROB_1STAZHYPO_022_Rx_oRDR_FUSION_DET_021_024_oPCAN_RADAR_d4b03784_Rx: ComBitPosition=215, ComBitSize=1, ComSignalType=BOOLEAN, ComSystemTemplateSystemSignalRef=DET_PROB_1STAZHYPO_022_Rx
            DET_PROB_1STAZHYPO_023_Rx_oRDR_FUSION_DET_021_024_oPCAN_RADAR_7bf4a5c3_Rx: ComBitPosition=327, ComBitSize=1, ComSignalType=BOOLEAN, ComSystemTemplateSystemSignalRef=DET_PROB_1STAZHYPO_023_Rx
            DET_PROB_1STAZHYPO_024_Rx_oRDR_FUSION_DET_021_024_oPCAN_RADAR_81c95694_Rx: ComBitPosition=439, ComBitSize=1, ComSignalType=BOOLEAN, ComSystemTemplateSystemSignalRef=DET_PROB_1STAZHYPO_024_Rx
            DET_RANGE_021_Rx_oRDR_FUSION_DET_021_024_oPCAN_RADAR_a5b16f1b_Rx: ComBitPosition=24, ComBitSize=15, ComSignalType=UINT16, ComSystemTemplateSystemSignalRef=DET_RANGE_021_Rx
            DET_RANGE_022_Rx_oRDR_FUSION_DET_021_024_oPCAN_RADAR_8f0ddf93_Rx: ComBitPosition=136, ComBitSize=15, ComSignalType=UINT16, ComSystemTemplateSystemSignalRef=DET_RANGE_022_Rx
            DET_RANGE_023_Rx_oRDR_FUSION_DET_021_024_oPCAN_RADAR_20494dd4_Rx: ComBitPosition=248, ComBitSize=15, ComSignalType=UINT16, ComSystemTemplateSystemSignalRef=DET_RANGE_023_Rx
            DET_RANGE_024_Rx_oRDR_FUSION_DET_021_024_oPCAN_RADAR_da74be83_Rx: ComBitPosition=360, ComBitSize=15, ComSignalType=UINT16, ComSystemTemplateSystemSignalRef=DET_RANGE_024_Rx
            DET_RANGE_ERR_021_Rx_oRDR_FUSION_DET_021_024_oPCAN_RADAR_f543e3fb_Rx: ComBitPosition=40, ComBitSize=7, ComSignalType=UINT8, ComSystemTemplateSystemSignalRef=DET_RANGE_ERR_021_Rx
            DET_RANGE_ERR_022_Rx_oRDR_FUSION_DET_021_024_oPCAN_RADAR_dfff5373_Rx: ComBitPosition=152, ComBitSize=7, ComSignalType=UINT8, ComSystemTemplateSystemSignalRef=DET_RANGE_ERR_022_Rx
            DET_RANGE_ERR_023_Rx_oRDR_FUSION_DET_021_024_oPCAN_RADAR_70bbc134_Rx: ComBitPosition=264, ComBitSize=7, ComSignalType=UINT8, ComSystemTemplateSystemSignalRef=DET_RANGE_ERR_023_Rx
            DET_RANGE_ERR_024_Rx_oRDR_FUSION_DET_021_024_oPCAN_RADAR_8a863263_Rx: ComBitPosition=376, ComBitSize=7, ComSignalType=UINT8, ComSystemTemplateSystemSignalRef=DET_RANGE_ERR_024_Rx
            DET_RANGE_VELOCITY_021_Rx_oRDR_FUSION_DET_021_024_oPCAN_RADAR_7844ece5_Rx: ComBitPosition=48, ComBitSize=15, ComSignalType=UINT16, ComSystemTemplateSystemSignalRef=DET_RANGE_VELOCITY_021_Rx
            DET_RANGE_VELOCITY_022_Rx_oRDR_FUSION_DET_021_024_oPCAN_RADAR_52f85c6d_Rx: ComBitPosition=160, ComBitSize=15, ComSignalType=UINT16, ComSystemTemplateSystemSignalRef=DET_RANGE_VELOCITY_022_Rx
            DET_RANGE_VELOCITY_023_Rx_oRDR_FUSION_DET_021_024_oPCAN_RADAR_fdbcce2a_Rx: ComBitPosition=272, ComBitSize=15, ComSignalType=UINT16, ComSystemTemplateSystemSignalRef=DET_RANGE_VELOCITY_023_Rx
            DET_RANGE_VELOCITY_024_Rx_oRDR_FUSION_DET_021_024_oPCAN_RADAR_07813d7d_Rx: ComBitPosition=384, ComBitSize=15, ComSignalType=UINT16, ComSystemTemplateSystemSignalRef=DET_RANGE_VELOCITY_024_Rx
            DET_RANGE_VELOCITY_ERR_021_Rx_oRDR_FUSION_DET_021_024_oPCAN_RADAR_e1209c27_Rx: ComBitPosition=64, ComBitSize=8, ComSignalType=UINT8, ComSystemTemplateSystemSignalRef=DET_RANGE_VELOCITY_ERR_021_Rx
            DET_RANGE_VELOCITY_ERR_022_Rx_oRDR_FUSION_DET_021_024_oPCAN_RADAR_cb9c2caf_Rx: ComBitPosition=176, ComBitSize=8, ComSignalType=UINT8, ComSystemTemplateSystemSignalRef=DET_RANGE_VELOCITY_ERR_022_Rx
            DET_RANGE_VELOCITY_ERR_023_Rx_oRDR_FUSION_DET_021_024_oPCAN_RADAR_64d8bee8_Rx: ComBitPosition=288, ComBitSize=8, ComSignalType=UINT8, ComSystemTemplateSystemSignalRef=DET_RANGE_VELOCITY_ERR_023_Rx
            DET_RANGE_VELOCITY_ERR_024_Rx_oRDR_FUSION_DET_021_024_oPCAN_RADAR_9ee54dbf_Rx: ComBitPosition=400, ComBitSize=8, ComSignalType=UINT8, ComSystemTemplateSystemSignalRef=DET_RANGE_VELOCITY_ERR_024_Rx
            DET_RCS_021_Rx_oRDR_FUSION_DET_021_024_oPCAN_RADAR_b58f7efe_Rx: ComBitPosition=128, ComBitSize=8, ComSignalType=UINT8, ComSystemTemplateSystemSignalRef=DET_RCS_021_Rx
            DET_RCS_022_Rx_oRDR_FUSION_DET_021_024_oPCAN_RADAR_9f33ce76_Rx: ComBitPosition=240, ComBitSize=8, ComSignalType=UINT8, ComSystemTemplateSystemSignalRef=DET_RCS_022_Rx
            DET_RCS_023_Rx_oRDR_FUSION_DET_021_024_oPCAN_RADAR_30775c31_Rx: ComBitPosition=352, ComBitSize=8, ComSignalType=UINT8, ComSystemTemplateSystemSignalRef=DET_RCS_023_Rx
            DET_RCS_024_Rx_oRDR_FUSION_DET_021_024_oPCAN_RADAR_ca4aaf66_Rx: ComBitPosition=464, ComBitSize=8, ComSignalType=UINT8, ComSystemTemplateSystemSignalRef=DET_RCS_024_Rx
            DET_SNR_021_Rx_oRDR_FUSION_DET_021_024_oPCAN_RADAR_bcd50f17_Rx: ComBitPosition=120, ComBitSize=8, ComSignalType=UINT8, ComSystemTemplateSystemSignalRef=DET_SNR_021_Rx
            DET_SNR_022_Rx_oRDR_FUSION_DET_021_024_oPCAN_RADAR_9669bf9f_Rx: ComBitPosition=232, ComBitSize=8, ComSignalType=UINT8, ComSystemTemplateSystemSignalRef=DET_SNR_022_Rx
            DET_SNR_023_Rx_oRDR_FUSION_DET_021_024_oPCAN_RADAR_392d2dd8_Rx: ComBitPosition=344, ComBitSize=8, ComSignalType=UINT8, ComSystemTemplateSystemSignalRef=DET_SNR_023_Rx
            DET_SNR_024_Rx_oRDR_FUSION_DET_021_024_oPCAN_RADAR_c310de8f_Rx: ComBitPosition=456, ComBitSize=8, ComSignalType=UINT8, ComSystemTemplateSystemSignalRef=DET_SNR_024_Rx
            DET_SUPER_RES_TARGET_021_Rx_oRDR_FUSION_DET_021_024_oPCAN_RADAR_772e2e17_Rx: ComBitPosition=87, ComBitSize=1, ComSignalType=BOOLEAN, ComSystemTemplateSystemSignalRef=DET_SUPER_RES_TARGET_021_Rx
            DET_SUPER_RES_TARGET_022_Rx_oRDR_FUSION_DET_021_024_oPCAN_RADAR_5d929e9f_Rx: ComBitPosition=199, ComBitSize=1, ComSignalType=BOOLEAN, ComSystemTemplateSystemSignalRef=DET_SUPER_RES_TARGET_022_Rx
            DET_SUPER_RES_TARGET_023_Rx_oRDR_FUSION_DET_021_024_oPCAN_RADAR_f2d60cd8_Rx: ComBitPosition=311, ComBitSize=1, ComSignalType=BOOLEAN, ComSystemTemplateSystemSignalRef=DET_SUPER_RES_TARGET_023_Rx
            DET_SUPER_RES_TARGET_024_Rx_oRDR_FUSION_DET_021_024_oPCAN_RADAR_08ebff8f_Rx: ComBitPosition=423, ComBitSize=1, ComSignalType=BOOLEAN, ComSystemTemplateSystemSignalRef=DET_SUPER_RES_TARGET_024_Rx
        SG_Fusion_Detections_025_028_oRDR_FUSION_DET_025_028_oPCAN_RADAR_ba5bfb5a_Rx: ComTimeout=0, ComSystemTemplateSignalGroupRef=SG_Fusion_Detections_025_028
          83 x ComGroupSignal, all with ComSignalEndianness=LITTLE_ENDIAN, ComSignalInitValue=0:
            DET_AZIMUTH_025_Rx_oRDR_FUSION_DET_025_028_oPCAN_RADAR_8f44eed7_Rx: ComBitPosition=88, ComBitSize=13, ComSignalType=UINT16, ComSystemTemplateSystemSignalRef=DET_AZIMUTH_025_Rx
            DET_AZIMUTH_026_Rx_oRDR_FUSION_DET_025_028_oPCAN_RADAR_a5f85e5f_Rx: ComBitPosition=200, ComBitSize=13, ComSignalType=UINT16, ComSystemTemplateSystemSignalRef=DET_AZIMUTH_026_Rx
            DET_AZIMUTH_027_Rx_oRDR_FUSION_DET_025_028_oPCAN_RADAR_0abccc18_Rx: ComBitPosition=312, ComBitSize=13, ComSignalType=UINT16, ComSystemTemplateSystemSignalRef=DET_AZIMUTH_027_Rx
            DET_AZIMUTH_028_Rx_oRDR_FUSION_DET_025_028_oPCAN_RADAR_8af2beb0_Rx: ComBitPosition=424, ComBitSize=13, ComSignalType=UINT16, ComSystemTemplateSystemSignalRef=DET_AZIMUTH_028_Rx
            DET_AZIMUTH_ERR_025_Rx_oRDR_FUSION_DET_025_028_oPCAN_RADAR_8d2d4f55_Rx: ComBitPosition=105, ComBitSize=7, ComSignalType=UINT8, ComSystemTemplateSystemSignalRef=DET_AZIMUTH_ERR_025_Rx
            DET_AZIMUTH_ERR_026_Rx_oRDR_FUSION_DET_025_028_oPCAN_RADAR_a791ffdd_Rx: ComBitPosition=217, ComBitSize=7, ComSignalType=UINT8, ComSystemTemplateSystemSignalRef=DET_AZIMUTH_ERR_026_Rx
            DET_AZIMUTH_ERR_027_Rx_oRDR_FUSION_DET_025_028_oPCAN_RADAR_08d56d9a_Rx: ComBitPosition=329, ComBitSize=7, ComSignalType=UINT8, ComSystemTemplateSystemSignalRef=DET_AZIMUTH_ERR_027_Rx
            DET_AZIMUTH_ERR_028_Rx_oRDR_FUSION_DET_025_028_oPCAN_RADAR_889b1f32_Rx: ComBitPosition=441, ComBitSize=7, ComSignalType=UINT8, ComSystemTemplateSystemSignalRef=DET_AZIMUTH_ERR_028_Rx
            DET_BELOW_RAIN_THOLD_025_Rx_oRDR_FUSION_DET_025_028_oPCAN_RADAR_e9fe1162_Rx: ComBitPosition=39, ComBitSize=1, ComSignalType=BOOLEAN, ComSystemTemplateSystemSignalRef=DET_BELOW_RAIN_THOLD_025_Rx
            DET_BELOW_RAIN_THOLD_026_Rx_oRDR_FUSION_DET_025_028_oPCAN_RADAR_c342a1ea_Rx: ComBitPosition=151, ComBitSize=1, ComSignalType=BOOLEAN, ComSystemTemplateSystemSignalRef=DET_BELOW_RAIN_THOLD_026_Rx
            DET_BELOW_RAIN_THOLD_027_Rx_oRDR_FUSION_DET_025_028_oPCAN_RADAR_6c0633ad_Rx: ComBitPosition=263, ComBitSize=1, ComSignalType=BOOLEAN, ComSystemTemplateSystemSignalRef=DET_BELOW_RAIN_THOLD_027_Rx
            DET_BELOW_RAIN_THOLD_028_Rx_oRDR_FUSION_DET_025_028_oPCAN_RADAR_ec484105_Rx: ComBitPosition=375, ComBitSize=1, ComSignalType=BOOLEAN, ComSystemTemplateSystemSignalRef=DET_BELOW_RAIN_THOLD_028_Rx
            DET_BI_STATIC_FLAG_025_Rx_oRDR_FUSION_DET_025_028_oPCAN_RADAR_9e60ba71_Rx: ComBitPosition=104, ComBitSize=1, ComSignalType=BOOLEAN, ComSystemTemplateSystemSignalRef=DET_BI_STATIC_FLAG_025_Rx
            DET_BI_STATIC_FLAG_026_Rx_oRDR_FUSION_DET_025_028_oPCAN_RADAR_b4dc0af9_Rx: ComBitPosition=216, ComBitSize=1, ComSignalType=BOOLEAN, ComSystemTemplateSystemSignalRef=DET_BI_STATIC_FLAG_026_Rx
            DET_BI_STATIC_FLAG_027_Rx_oRDR_FUSION_DET_025_028_oPCAN_RADAR_1b9898be_Rx: ComBitPosition=328, ComBitSize=1, ComSignalType=BOOLEAN, ComSystemTemplateSystemSignalRef=DET_BI_STATIC_FLAG_027_Rx
            DET_BI_STATIC_FLAG_028_Rx_oRDR_FUSION_DET_025_028_oPCAN_RADAR_9bd6ea16_Rx: ComBitPosition=440, ComBitSize=1, ComSignalType=BOOLEAN, ComSystemTemplateSystemSignalRef=DET_BI_STATIC_FLAG_028_Rx
            DET_CONFD_AZIMUTH_025_Rx_oRDR_FUSION_DET_025_028_oPCAN_RADAR_7d095025_Rx: ComBitPosition=118, ComBitSize=2, ComSignalType=UINT8, ComSystemTemplateSystemSignalRef=DET_CONFD_AZIMUTH_025_Rx
            DET_CONFD_AZIMUTH_026_Rx_oRDR_FUSION_DET_025_028_oPCAN_RADAR_57b5e0ad_Rx: ComBitPosition=230, ComBitSize=2, ComSignalType=UINT8, ComSystemTemplateSystemSignalRef=DET_CONFD_AZIMUTH_026_Rx
            DET_CONFD_AZIMUTH_027_Rx_oRDR_FUSION_DET_025_028_oPCAN_RADAR_f8f172ea_Rx: ComBitPosition=342, ComBitSize=2, ComSignalType=UINT8, ComSystemTemplateSystemSignalRef=DET_CONFD_AZIMUTH_027_Rx
            DET_CONFD_AZIMUTH_028_Rx_oRDR_FUSION_DET_025_028_oPCAN_RADAR_78bf0042_Rx: ComBitPosition=454, ComBitSize=2, ComSignalType=UINT8, ComSystemTemplateSystemSignalRef=DET_CONFD_AZIMUTH_028_Rx
            DET_CONFD_ELEVATION_025_Rx_oRDR_FUSION_DET_025_028_oPCAN_RADAR_7728d3a2_Rx: ComBitPosition=101, ComBitSize=2, ComSignalType=UINT8, ComSystemTemplateSystemSignalRef=DET_CONFD_ELEVATION_025_Rx
            DET_CONFD_ELEVATION_026_Rx_oRDR_FUSION_DET_025_028_oPCAN_RADAR_5d94632a_Rx: ComBitPosition=213, ComBitSize=2, ComSignalType=UINT8, ComSystemTemplateSystemSignalRef=DET_CONFD_ELEVATION_026_Rx
            DET_CONFD_ELEVATION_027_Rx_oRDR_FUSION_DET_025_028_oPCAN_RADAR_f2d0f16d_Rx: ComBitPosition=325, ComBitSize=2, ComSignalType=UINT8, ComSystemTemplateSystemSignalRef=DET_CONFD_ELEVATION_027_Rx
            DET_CONFD_ELEVATION_028_Rx_oRDR_FUSION_DET_025_028_oPCAN_RADAR_729e83c5_Rx: ComBitPosition=437, ComBitSize=2, ComSignalType=UINT8, ComSystemTemplateSystemSignalRef=DET_CONFD_ELEVATION_028_Rx
            DET_ELEVATION_025_Rx_oRDR_FUSION_DET_025_028_oPCAN_RADAR_7d7b3c5b_Rx: ComBitPosition=72, ComBitSize=8, ComSignalType=UINT8, ComSystemTemplateSystemSignalRef=DET_ELEVATION_025_Rx
            DET_ELEVATION_026_Rx_oRDR_FUSION_DET_025_028_oPCAN_RADAR_57c78cd3_Rx: ComBitPosition=184, ComBitSize=8, ComSignalType=UINT8, ComSystemTemplateSystemSignalRef=DET_ELEVATION_026_Rx
            DET_ELEVATION_027_Rx_oRDR_FUSION_DET_025_028_oPCAN_RADAR_f8831e94_Rx: ComBitPosition=296, ComBitSize=8, ComSignalType=UINT8, ComSystemTemplateSystemSignalRef=DET_ELEVATION_027_Rx
            DET_ELEVATION_028_Rx_oRDR_FUSION_DET_025_028_oPCAN_RADAR_78cd6c3c_Rx: ComBitPosition=408, ComBitSize=8, ComSignalType=UINT8, ComSystemTemplateSystemSignalRef=DET_ELEVATION_028_Rx
            DET_ELEVATION_ERR_025_Rx_oRDR_FUSION_DET_025_028_oPCAN_RADAR_afc21e84_Rx: ComBitPosition=80, ComBitSize=6, ComSignalType=UINT8, ComSystemTemplateSystemSignalRef=DET_ELEVATION_ERR_025_Rx
            DET_ELEVATION_ERR_026_Rx_oRDR_FUSION_DET_025_028_oPCAN_RADAR_857eae0c_Rx: ComBitPosition=192, ComBitSize=6, ComSignalType=UINT8, ComSystemTemplateSystemSignalRef=DET_ELEVATION_ERR_026_Rx
            DET_ELEVATION_ERR_027_Rx_oRDR_FUSION_DET_025_028_oPCAN_RADAR_2a3a3c4b_Rx: ComBitPosition=304, ComBitSize=6, ComSignalType=UINT8, ComSystemTemplateSystemSignalRef=DET_ELEVATION_ERR_027_Rx
            DET_ELEVATION_ERR_028_Rx_oRDR_FUSION_DET_025_028_oPCAN_RADAR_aa744ee3_Rx: ComBitPosition=416, ComBitSize=6, ComSignalType=UINT8, ComSystemTemplateSystemSignalRef=DET_ELEVATION_ERR_028_Rx
            DET_EXISTENCE_PROB_025_Rx_oRDR_FUSION_DET_025_028_oPCAN_RADAR_58da6611_Rx: ComBitPosition=112, ComBitSize=6, ComSignalType=UINT8, ComSystemTemplateSystemSignalRef=DET_EXISTENCE_PROB_025_Rx
            DET_EXISTENCE_PROB_026_Rx_oRDR_FUSION_DET_025_028_oPCAN_RADAR_7266d699_Rx: ComBitPosition=224, ComBitSize=6, ComSignalType=UINT8, ComSystemTemplateSystemSignalRef=DET_EXISTENCE_PROB_026_Rx
            DET_EXISTENCE_PROB_027_Rx_oRDR_FUSION_DET_025_028_oPCAN_RADAR_dd2244de_Rx: ComBitPosition=336, ComBitSize=6, ComSignalType=UINT8, ComSystemTemplateSystemSignalRef=DET_EXISTENCE_PROB_027_Rx
            DET_EXISTENCE_PROB_028_Rx_oRDR_FUSION_DET_025_028_oPCAN_RADAR_5d6c3676_Rx: ComBitPosition=448, ComBitSize=6, ComSignalType=UINT8, ComSystemTemplateSystemSignalRef=DET_EXISTENCE_PROB_028_Rx
            DET_HVC_FLAG_025_Rx_oRDR_FUSION_DET_025_028_oPCAN_RADAR_85048b5e_Rx: ComBitPosition=86, ComBitSize=1, ComSignalType=BOOLEAN, ComSystemTemplateSystemSignalRef=DET_HVC_FLAG_025_Rx
            DET_HVC_FLAG_026_Rx_oRDR_FUSION_DET_025_028_oPCAN_RADAR_afb83bd6_Rx: ComBitPosition=198, ComBitSize=1, ComSignalType=BOOLEAN, ComSystemTemplateSystemSignalRef=DET_HVC_FLAG_026_Rx
            DET_HVC_FLAG_027_Rx_oRDR_FUSION_DET_025_028_oPCAN_RADAR_00fca991_Rx: ComBitPosition=310, ComBitSize=1, ComSignalType=BOOLEAN, ComSystemTemplateSystemSignalRef=DET_HVC_FLAG_027_Rx
            DET_HVC_FLAG_028_Rx_oRDR_FUSION_DET_025_028_oPCAN_RADAR_80b2db39_Rx: ComBitPosition=422, ComBitSize=1, ComSignalType=BOOLEAN, ComSystemTemplateSystemSignalRef=DET_HVC_FLAG_028_Rx
            DET_IDM_025_Rx_oRDR_FUSION_DET_025_028_oPCAN_RADAR_b0c57216_Rx: ComBitPosition=63, ComBitSize=1, ComSignalType=BOOLEAN, ComSystemTemplateSystemSignalRef=DET_IDM_025_Rx
            DET_IDM_026_Rx_oRDR_FUSION_DET_025_028_oPCAN_RADAR_9a79c29e_Rx: ComBitPosition=175, ComBitSize=1, ComSignalType=BOOLEAN, ComSystemTemplateSystemSignalRef=DET_IDM_026_Rx
            DET_IDM_027_Rx_oRDR_FUSION_DET_025_028_oPCAN_RADAR_353d50d9_Rx: ComBitPosition=287, ComBitSize=1, ComSignalType=BOOLEAN, ComSystemTemplateSystemSignalRef=DET_IDM_027_Rx
            DET_IDM_028_Rx_oRDR_FUSION_DET_025_028_oPCAN_RADAR_b5732271_Rx: ComBitPosition=399, ComBitSize=1, ComSignalType=BOOLEAN, ComSystemTemplateSystemSignalRef=DET_IDM_028_Rx
            DET_MH_CRC16_025_028_Rx_oRDR_FUSION_DET_025_028_oPCAN_RADAR_e7a9b4e9_Rx: ComBitPosition=0, ComBitSize=16, ComSignalType=UINT16, ComSystemTemplateSystemSignalRef=DET_MH_CRC16_025_028_Rx
            DET_MH_CYCLE_COUNTER_025_028_Rx_oRDR_FUSION_DET_025_028_oPCAN_RADAR_ea72892c_Rx: ComBitPosition=16, ComBitSize=8, ComSignalType=UINT8, ComSystemTemplateSystemSignalRef=DET_MH_CYCLE_COUNTER_025_028_Rx
            DET_MH_SCAN_INDEX_4LSB_025_028_Rx_oRDR_FUSION_DET_025_028_oPCAN_RADAR_8ec24617_Rx: ComBitPosition=476, ComBitSize=4, ComSignalType=UINT8, ComSystemTemplateSystemSignalRef=DET_MH_SCAN_INDEX_4LSB_025_028_Rx
            DET_MTD_025_Rx_oRDR_FUSION_DET_025_028_oPCAN_RADAR_0d464466_Rx: ComBitPosition=47, ComBitSize=1, ComSignalType=BOOLEAN, ComSystemTemplateSystemSignalRef=DET_MTD_025_Rx
            DET_MTD_026_Rx_oRDR_FUSION_DET_025_028_oPCAN_RADAR_27faf4ee_Rx: ComBitPosition=159, ComBitSize=1, ComSignalType=BOOLEAN, ComSystemTemplateSystemSignalRef=DET_MTD_026_Rx
            DET_MTD_027_Rx_oRDR_FUSION_DET_025_028_oPCAN_RADAR_88be66a9_Rx: ComBitPosition=271, ComBitSize=1, ComSignalType=BOOLEAN, ComSystemTemplateSystemSignalRef=DET_MTD_027_Rx
            DET_MTD_028_Rx_oRDR_FUSION_DET_025_028_oPCAN_RADAR_08f01401_Rx: ComBitPosition=383, ComBitSize=1, ComSignalType=BOOLEAN, ComSystemTemplateSystemSignalRef=DET_MTD_028_Rx
            DET_PROB_1STAZHYPO_025_Rx_oRDR_FUSION_DET_025_028_oPCAN_RADAR_c73f5ae7_Rx: ComBitPosition=103, ComBitSize=1, ComSignalType=BOOLEAN, ComSystemTemplateSystemSignalRef=DET_PROB_1STAZHYPO_025_Rx
            DET_PROB_1STAZHYPO_026_Rx_oRDR_FUSION_DET_025_028_oPCAN_RADAR_ed83ea6f_Rx: ComBitPosition=215, ComBitSize=1, ComSignalType=BOOLEAN, ComSystemTemplateSystemSignalRef=DET_PROB_1STAZHYPO_026_Rx
            DET_PROB_1STAZHYPO_027_Rx_oRDR_FUSION_DET_025_028_oPCAN_RADAR_42c77828_Rx: ComBitPosition=327, ComBitSize=1, ComSignalType=BOOLEAN, ComSystemTemplateSystemSignalRef=DET_PROB_1STAZHYPO_027_Rx
            DET_PROB_1STAZHYPO_028_Rx_oRDR_FUSION_DET_025_028_oPCAN_RADAR_c2890a80_Rx: ComBitPosition=439, ComBitSize=1, ComSignalType=BOOLEAN, ComSystemTemplateSystemSignalRef=DET_PROB_1STAZHYPO_028_Rx
            DET_RANGE_025_Rx_oRDR_FUSION_DET_025_028_oPCAN_RADAR_9c82b2f0_Rx: ComBitPosition=24, ComBitSize=15, ComSignalType=UINT16, ComSystemTemplateSystemSignalRef=DET_RANGE_025_Rx
            DET_RANGE_026_Rx_oRDR_FUSION_DET_025_028_oPCAN_RADAR_b63e0278_Rx: ComBitPosition=136, ComBitSize=15, ComSignalType=UINT16, ComSystemTemplateSystemSignalRef=DET_RANGE_026_Rx
            DET_RANGE_027_Rx_oRDR_FUSION_DET_025_028_oPCAN_RADAR_197a903f_Rx: ComBitPosition=248, ComBitSize=15, ComSignalType=UINT16, ComSystemTemplateSystemSignalRef=DET_RANGE_027_Rx
            DET_RANGE_028_Rx_oRDR_FUSION_DET_025_028_oPCAN_RADAR_9934e297_Rx: ComBitPosition=360, ComBitSize=15, ComSignalType=UINT16, ComSystemTemplateSystemSignalRef=DET_RANGE_028_Rx
            DET_RANGE_ERR_025_Rx_oRDR_FUSION_DET_025_028_oPCAN_RADAR_cc703e10_Rx: ComBitPosition=40, ComBitSize=7, ComSignalType=UINT8, ComSystemTemplateSystemSignalRef=DET_RANGE_ERR_025_Rx
            DET_RANGE_ERR_026_Rx_oRDR_FUSION_DET_025_028_oPCAN_RADAR_e6cc8e98_Rx: ComBitPosition=152, ComBitSize=7, ComSignalType=UINT8, ComSystemTemplateSystemSignalRef=DET_RANGE_ERR_026_Rx
            DET_RANGE_ERR_027_Rx_oRDR_FUSION_DET_025_028_oPCAN_RADAR_49881cdf_Rx: ComBitPosition=264, ComBitSize=7, ComSignalType=UINT8, ComSystemTemplateSystemSignalRef=DET_RANGE_ERR_027_Rx
            DET_RANGE_ERR_028_Rx_oRDR_FUSION_DET_025_028_oPCAN_RADAR_c9c66e77_Rx: ComBitPosition=376, ComBitSize=7, ComSignalType=UINT8, ComSystemTemplateSystemSignalRef=DET_RANGE_ERR_028_Rx
            DET_RANGE_VELOCITY_025_Rx_oRDR_FUSION_DET_025_028_oPCAN_RADAR_4177310e_Rx: ComBitPosition=48, ComBitSize=15, ComSignalType=UINT16, ComSystemTemplateSystemSignalRef=DET_RANGE_VELOCITY_025_Rx
            DET_RANGE_VELOCITY_026_Rx_oRDR_FUSION_DET_025_028_oPCAN_RADAR_6bcb8186_Rx: ComBitPosition=160, ComBitSize=15, ComSignalType=UINT16, ComSystemTemplateSystemSignalRef=DET_RANGE_VELOCITY_026_Rx
            DET_RANGE_VELOCITY_027_Rx_oRDR_FUSION_DET_025_028_oPCAN_RADAR_c48f13c1_Rx: ComBitPosition=272, ComBitSize=15, ComSignalType=UINT16, ComSystemTemplateSystemSignalRef=DET_RANGE_VELOCITY_027_Rx
            DET_RANGE_VELOCITY_028_Rx_oRDR_FUSION_DET_025_028_oPCAN_RADAR_44c16169_Rx: ComBitPosition=384, ComBitSize=15, ComSignalType=UINT16, ComSystemTemplateSystemSignalRef=DET_RANGE_VELOCITY_028_Rx
            DET_RANGE_VELOCITY_ERR_025_Rx_oRDR_FUSION_DET_025_028_oPCAN_RADAR_d81341cc_Rx: ComBitPosition=64, ComBitSize=8, ComSignalType=UINT8, ComSystemTemplateSystemSignalRef=DET_RANGE_VELOCITY_ERR_025_Rx
            DET_RANGE_VELOCITY_ERR_026_Rx_oRDR_FUSION_DET_025_028_oPCAN_RADAR_f2aff144_Rx: ComBitPosition=176, ComBitSize=8, ComSignalType=UINT8, ComSystemTemplateSystemSignalRef=DET_RANGE_VELOCITY_ERR_026_Rx
            DET_RANGE_VELOCITY_ERR_027_Rx_oRDR_FUSION_DET_025_028_oPCAN_RADAR_5deb6303_Rx: ComBitPosition=288, ComBitSize=8, ComSignalType=UINT8, ComSystemTemplateSystemSignalRef=DET_RANGE_VELOCITY_ERR_027_Rx
            DET_RANGE_VELOCITY_ERR_028_Rx_oRDR_FUSION_DET_025_028_oPCAN_RADAR_dda511ab_Rx: ComBitPosition=400, ComBitSize=8, ComSignalType=UINT8, ComSystemTemplateSystemSignalRef=DET_RANGE_VELOCITY_ERR_028_Rx
            DET_RCS_025_Rx_oRDR_FUSION_DET_025_028_oPCAN_RADAR_8cbca315_Rx: ComBitPosition=128, ComBitSize=8, ComSignalType=UINT8, ComSystemTemplateSystemSignalRef=DET_RCS_025_Rx
            DET_RCS_026_Rx_oRDR_FUSION_DET_025_028_oPCAN_RADAR_a600139d_Rx: ComBitPosition=240, ComBitSize=8, ComSignalType=UINT8, ComSystemTemplateSystemSignalRef=DET_RCS_026_Rx
            DET_RCS_027_Rx_oRDR_FUSION_DET_025_028_oPCAN_RADAR_094481da_Rx: ComBitPosition=352, ComBitSize=8, ComSignalType=UINT8, ComSystemTemplateSystemSignalRef=DET_RCS_027_Rx
            DET_RCS_028_Rx_oRDR_FUSION_DET_025_028_oPCAN_RADAR_890af372_Rx: ComBitPosition=464, ComBitSize=8, ComSignalType=UINT8, ComSystemTemplateSystemSignalRef=DET_RCS_028_Rx
            DET_SNR_025_Rx_oRDR_FUSION_DET_025_028_oPCAN_RADAR_85e6d2fc_Rx: ComBitPosition=120, ComBitSize=8, ComSignalType=UINT8, ComSystemTemplateSystemSignalRef=DET_SNR_025_Rx
            DET_SNR_026_Rx_oRDR_FUSION_DET_025_028_oPCAN_RADAR_af5a6274_Rx: ComBitPosition=232, ComBitSize=8, ComSignalType=UINT8, ComSystemTemplateSystemSignalRef=DET_SNR_026_Rx
            DET_SNR_027_Rx_oRDR_FUSION_DET_025_028_oPCAN_RADAR_001ef033_Rx: ComBitPosition=344, ComBitSize=8, ComSignalType=UINT8, ComSystemTemplateSystemSignalRef=DET_SNR_027_Rx
            DET_SNR_028_Rx_oRDR_FUSION_DET_025_028_oPCAN_RADAR_8050829b_Rx: ComBitPosition=456, ComBitSize=8, ComSignalType=UINT8, ComSystemTemplateSystemSignalRef=DET_SNR_028_Rx
            DET_SUPER_RES_TARGET_025_Rx_oRDR_FUSION_DET_025_028_oPCAN_RADAR_4e1df3fc_Rx: ComBitPosition=87, ComBitSize=1, ComSignalType=BOOLEAN, ComSystemTemplateSystemSignalRef=DET_SUPER_RES_TARGET_025_Rx
            DET_SUPER_RES_TARGET_026_Rx_oRDR_FUSION_DET_025_028_oPCAN_RADAR_64a14374_Rx: ComBitPosition=199, ComBitSize=1, ComSignalType=BOOLEAN, ComSystemTemplateSystemSignalRef=DET_SUPER_RES_TARGET_026_Rx
            DET_SUPER_RES_TARGET_027_Rx_oRDR_FUSION_DET_025_028_oPCAN_RADAR_cbe5d133_Rx: ComBitPosition=311, ComBitSize=1, ComSignalType=BOOLEAN, ComSystemTemplateSystemSignalRef=DET_SUPER_RES_TARGET_027_Rx
            DET_SUPER_RES_TARGET_028_Rx_oRDR_FUSION_DET_025_028_oPCAN_RADAR_4baba39b_Rx: ComBitPosition=423, ComBitSize=1, ComSignalType=BOOLEAN, ComSystemTemplateSystemSignalRef=DET_SUPER_RES_TARGET_028_Rx
        SG_Fusion_Detections_029_032_oRDR_FUSION_DET_029_032_oPCAN_RADAR_3868beb2_Rx: ComTimeout=0, ComSystemTemplateSignalGroupRef=SG_Fusion_Detections_029_032
          83 x ComGroupSignal, all with ComSignalEndianness=LITTLE_ENDIAN, ComSignalInitValue=0:
            DET_AZIMUTH_029_Rx_oRDR_FUSION_DET_029_032_oPCAN_RADAR_17fec3f6_Rx: ComBitPosition=88, ComBitSize=13, ComSignalType=UINT16, ComSystemTemplateSystemSignalRef=DET_AZIMUTH_029_Rx
            DET_AZIMUTH_030_Rx_oRDR_FUSION_DET_029_032_oPCAN_RADAR_2ade40ef_Rx: ComBitPosition=200, ComBitSize=13, ComSignalType=UINT16, ComSystemTemplateSystemSignalRef=DET_AZIMUTH_030_Rx
            DET_AZIMUTH_031_Rx_oRDR_FUSION_DET_029_032_oPCAN_RADAR_859ad2a8_Rx: ComBitPosition=312, ComBitSize=13, ComSignalType=UINT16, ComSystemTemplateSystemSignalRef=DET_AZIMUTH_031_Rx
            DET_AZIMUTH_032_Rx_oRDR_FUSION_DET_029_032_oPCAN_RADAR_af266220_Rx: ComBitPosition=424, ComBitSize=13, ComSignalType=UINT16, ComSystemTemplateSystemSignalRef=DET_AZIMUTH_032_Rx
            DET_AZIMUTH_ERR_029_Rx_oRDR_FUSION_DET_029_032_oPCAN_RADAR_15976274_Rx: ComBitPosition=105, ComBitSize=7, ComSignalType=UINT8, ComSystemTemplateSystemSignalRef=DET_AZIMUTH_ERR_029_Rx
            DET_AZIMUTH_ERR_030_Rx_oRDR_FUSION_DET_029_032_oPCAN_RADAR_28b7e16d_Rx: ComBitPosition=217, ComBitSize=7, ComSignalType=UINT8, ComSystemTemplateSystemSignalRef=DET_AZIMUTH_ERR_030_Rx
            DET_AZIMUTH_ERR_031_Rx_oRDR_FUSION_DET_029_032_oPCAN_RADAR_87f3732a_Rx: ComBitPosition=329, ComBitSize=7, ComSignalType=UINT8, ComSystemTemplateSystemSignalRef=DET_AZIMUTH_ERR_031_Rx
            DET_AZIMUTH_ERR_032_Rx_oRDR_FUSION_DET_029_032_oPCAN_RADAR_ad4fc3a2_Rx: ComBitPosition=441, ComBitSize=7, ComSignalType=UINT8, ComSystemTemplateSystemSignalRef=DET_AZIMUTH_ERR_032_Rx
            DET_BELOW_RAIN_THOLD_029_Rx_oRDR_FUSION_DET_029_032_oPCAN_RADAR_71443c43_Rx: ComBitPosition=39, ComBitSize=1, ComSignalType=BOOLEAN, ComSystemTemplateSystemSignalRef=DET_BELOW_RAIN_THOLD_029_Rx
            DET_BELOW_RAIN_THOLD_030_Rx_oRDR_FUSION_DET_029_032_oPCAN_RADAR_4c64bf5a_Rx: ComBitPosition=151, ComBitSize=1, ComSignalType=BOOLEAN, ComSystemTemplateSystemSignalRef=DET_BELOW_RAIN_THOLD_030_Rx
            DET_BELOW_RAIN_THOLD_031_Rx_oRDR_FUSION_DET_029_032_oPCAN_RADAR_e3202d1d_Rx: ComBitPosition=263, ComBitSize=1, ComSignalType=BOOLEAN, ComSystemTemplateSystemSignalRef=DET_BELOW_RAIN_THOLD_031_Rx
            DET_BELOW_RAIN_THOLD_032_Rx_oRDR_FUSION_DET_029_032_oPCAN_RADAR_c99c9d95_Rx: ComBitPosition=375, ComBitSize=1, ComSignalType=BOOLEAN, ComSystemTemplateSystemSignalRef=DET_BELOW_RAIN_THOLD_032_Rx
            DET_BI_STATIC_FLAG_029_Rx_oRDR_FUSION_DET_029_032_oPCAN_RADAR_06da9750_Rx: ComBitPosition=104, ComBitSize=1, ComSignalType=BOOLEAN, ComSystemTemplateSystemSignalRef=DET_BI_STATIC_FLAG_029_Rx
            DET_BI_STATIC_FLAG_030_Rx_oRDR_FUSION_DET_029_032_oPCAN_RADAR_3bfa1449_Rx: ComBitPosition=216, ComBitSize=1, ComSignalType=BOOLEAN, ComSystemTemplateSystemSignalRef=DET_BI_STATIC_FLAG_030_Rx
            DET_BI_STATIC_FLAG_031_Rx_oRDR_FUSION_DET_029_032_oPCAN_RADAR_94be860e_Rx: ComBitPosition=328, ComBitSize=1, ComSignalType=BOOLEAN, ComSystemTemplateSystemSignalRef=DET_BI_STATIC_FLAG_031_Rx
            DET_BI_STATIC_FLAG_032_Rx_oRDR_FUSION_DET_029_032_oPCAN_RADAR_be023686_Rx: ComBitPosition=440, ComBitSize=1, ComSignalType=BOOLEAN, ComSystemTemplateSystemSignalRef=DET_BI_STATIC_FLAG_032_Rx
            DET_CONFD_AZIMUTH_029_Rx_oRDR_FUSION_DET_029_032_oPCAN_RADAR_e5b37d04_Rx: ComBitPosition=118, ComBitSize=2, ComSignalType=UINT8, ComSystemTemplateSystemSignalRef=DET_CONFD_AZIMUTH_029_Rx
            DET_CONFD_AZIMUTH_030_Rx_oRDR_FUSION_DET_029_032_oPCAN_RADAR_d893fe1d_Rx: ComBitPosition=230, ComBitSize=2, ComSignalType=UINT8, ComSystemTemplateSystemSignalRef=DET_CONFD_AZIMUTH_030_Rx
            DET_CONFD_AZIMUTH_031_Rx_oRDR_FUSION_DET_029_032_oPCAN_RADAR_77d76c5a_Rx: ComBitPosition=342, ComBitSize=2, ComSignalType=UINT8, ComSystemTemplateSystemSignalRef=DET_CONFD_AZIMUTH_031_Rx
            DET_CONFD_AZIMUTH_032_Rx_oRDR_FUSION_DET_029_032_oPCAN_RADAR_5d6bdcd2_Rx: ComBitPosition=454, ComBitSize=2, ComSignalType=UINT8, ComSystemTemplateSystemSignalRef=DET_CONFD_AZIMUTH_032_Rx
            DET_CONFD_ELEVATION_029_Rx_oRDR_FUSION_DET_029_032_oPCAN_RADAR_ef92fe83_Rx: ComBitPosition=101, ComBitSize=2, ComSignalType=UINT8, ComSystemTemplateSystemSignalRef=DET_CONFD_ELEVATION_029_Rx
            DET_CONFD_ELEVATION_030_Rx_oRDR_FUSION_DET_029_032_oPCAN_RADAR_d2b27d9a_Rx: ComBitPosition=213, ComBitSize=2, ComSignalType=UINT8, ComSystemTemplateSystemSignalRef=DET_CONFD_ELEVATION_030_Rx
            DET_CONFD_ELEVATION_031_Rx_oRDR_FUSION_DET_029_032_oPCAN_RADAR_7df6efdd_Rx: ComBitPosition=325, ComBitSize=2, ComSignalType=UINT8, ComSystemTemplateSystemSignalRef=DET_CONFD_ELEVATION_031_Rx
            DET_CONFD_ELEVATION_032_Rx_oRDR_FUSION_DET_029_032_oPCAN_RADAR_574a5f55_Rx: ComBitPosition=437, ComBitSize=2, ComSignalType=UINT8, ComSystemTemplateSystemSignalRef=DET_CONFD_ELEVATION_032_Rx
            DET_ELEVATION_029_Rx_oRDR_FUSION_DET_029_032_oPCAN_RADAR_e5c1117a_Rx: ComBitPosition=72, ComBitSize=8, ComSignalType=UINT8, ComSystemTemplateSystemSignalRef=DET_ELEVATION_029_Rx
            DET_ELEVATION_030_Rx_oRDR_FUSION_DET_029_032_oPCAN_RADAR_d8e19263_Rx: ComBitPosition=184, ComBitSize=8, ComSignalType=UINT8, ComSystemTemplateSystemSignalRef=DET_ELEVATION_030_Rx
            DET_ELEVATION_031_Rx_oRDR_FUSION_DET_029_032_oPCAN_RADAR_77a50024_Rx: ComBitPosition=296, ComBitSize=8, ComSignalType=UINT8, ComSystemTemplateSystemSignalRef=DET_ELEVATION_031_Rx
            DET_ELEVATION_032_Rx_oRDR_FUSION_DET_029_032_oPCAN_RADAR_5d19b0ac_Rx: ComBitPosition=408, ComBitSize=8, ComSignalType=UINT8, ComSystemTemplateSystemSignalRef=DET_ELEVATION_032_Rx
            DET_ELEVATION_ERR_029_Rx_oRDR_FUSION_DET_029_032_oPCAN_RADAR_377833a5_Rx: ComBitPosition=80, ComBitSize=6, ComSignalType=UINT8, ComSystemTemplateSystemSignalRef=DET_ELEVATION_ERR_029_Rx
            DET_ELEVATION_ERR_030_Rx_oRDR_FUSION_DET_029_032_oPCAN_RADAR_0a58b0bc_Rx: ComBitPosition=192, ComBitSize=6, ComSignalType=UINT8, ComSystemTemplateSystemSignalRef=DET_ELEVATION_ERR_030_Rx
            DET_ELEVATION_ERR_031_Rx_oRDR_FUSION_DET_029_032_oPCAN_RADAR_a51c22fb_Rx: ComBitPosition=304, ComBitSize=6, ComSignalType=UINT8, ComSystemTemplateSystemSignalRef=DET_ELEVATION_ERR_031_Rx
            DET_ELEVATION_ERR_032_Rx_oRDR_FUSION_DET_029_032_oPCAN_RADAR_8fa09273_Rx: ComBitPosition=416, ComBitSize=6, ComSignalType=UINT8, ComSystemTemplateSystemSignalRef=DET_ELEVATION_ERR_032_Rx
            DET_EXISTENCE_PROB_029_Rx_oRDR_FUSION_DET_029_032_oPCAN_RADAR_c0604b30_Rx: ComBitPosition=112, ComBitSize=6, ComSignalType=UINT8, ComSystemTemplateSystemSignalRef=DET_EXISTENCE_PROB_029_Rx
            DET_EXISTENCE_PROB_030_Rx_oRDR_FUSION_DET_029_032_oPCAN_RADAR_fd40c829_Rx: ComBitPosition=224, ComBitSize=6, ComSignalType=UINT8, ComSystemTemplateSystemSignalRef=DET_EXISTENCE_PROB_030_Rx
            DET_EXISTENCE_PROB_031_Rx_oRDR_FUSION_DET_029_032_oPCAN_RADAR_52045a6e_Rx: ComBitPosition=336, ComBitSize=6, ComSignalType=UINT8, ComSystemTemplateSystemSignalRef=DET_EXISTENCE_PROB_031_Rx
            DET_EXISTENCE_PROB_032_Rx_oRDR_FUSION_DET_029_032_oPCAN_RADAR_78b8eae6_Rx: ComBitPosition=448, ComBitSize=6, ComSignalType=UINT8, ComSystemTemplateSystemSignalRef=DET_EXISTENCE_PROB_032_Rx
            DET_HVC_FLAG_029_Rx_oRDR_FUSION_DET_029_032_oPCAN_RADAR_1dbea67f_Rx: ComBitPosition=86, ComBitSize=1, ComSignalType=BOOLEAN, ComSystemTemplateSystemSignalRef=DET_HVC_FLAG_029_Rx
            DET_HVC_FLAG_030_Rx_oRDR_FUSION_DET_029_032_oPCAN_RADAR_209e2566_Rx: ComBitPosition=198, ComBitSize=1, ComSignalType=BOOLEAN, ComSystemTemplateSystemSignalRef=DET_HVC_FLAG_030_Rx
            DET_HVC_FLAG_031_Rx_oRDR_FUSION_DET_029_032_oPCAN_RADAR_8fdab721_Rx: ComBitPosition=310, ComBitSize=1, ComSignalType=BOOLEAN, ComSystemTemplateSystemSignalRef=DET_HVC_FLAG_031_Rx
            DET_HVC_FLAG_032_Rx_oRDR_FUSION_DET_029_032_oPCAN_RADAR_a56607a9_Rx: ComBitPosition=422, ComBitSize=1, ComSignalType=BOOLEAN, ComSystemTemplateSystemSignalRef=DET_HVC_FLAG_032_Rx
            DET_IDM_029_Rx_oRDR_FUSION_DET_029_032_oPCAN_RADAR_287f5f37_Rx: ComBitPosition=63, ComBitSize=1, ComSignalType=BOOLEAN, ComSystemTemplateSystemSignalRef=DET_IDM_029_Rx
            DET_IDM_030_Rx_oRDR_FUSION_DET_029_032_oPCAN_RADAR_155fdc2e_Rx: ComBitPosition=175, ComBitSize=1, ComSignalType=BOOLEAN, ComSystemTemplateSystemSignalRef=DET_IDM_030_Rx
            DET_IDM_031_Rx_oRDR_FUSION_DET_029_032_oPCAN_RADAR_ba1b4e69_Rx: ComBitPosition=287, ComBitSize=1, ComSignalType=BOOLEAN, ComSystemTemplateSystemSignalRef=DET_IDM_031_Rx
            DET_IDM_032_Rx_oRDR_FUSION_DET_029_032_oPCAN_RADAR_90a7fee1_Rx: ComBitPosition=399, ComBitSize=1, ComSignalType=BOOLEAN, ComSystemTemplateSystemSignalRef=DET_IDM_032_Rx
            DET_MH_CRC16_029_032_Rx_oRDR_FUSION_DET_029_032_oPCAN_RADAR_e0ed4ca0_Rx: ComBitPosition=0, ComBitSize=16, ComSignalType=UINT16, ComSystemTemplateSystemSignalRef=DET_MH_CRC16_029_032_Rx
            DET_MH_CYCLE_COUNTER_029_032_Rx_oRDR_FUSION_DET_029_032_oPCAN_RADAR_ed367165_Rx: ComBitPosition=16, ComBitSize=8, ComSignalType=UINT8, ComSystemTemplateSystemSignalRef=DET_MH_CYCLE_COUNTER_029_032_Rx
            DET_MH_SCAN_INDEX_4LSB_029_032_Rx_oRDR_FUSION_DET_029_032_oPCAN_RADAR_8986be5e_Rx: ComBitPosition=476, ComBitSize=4, ComSignalType=UINT8, ComSystemTemplateSystemSignalRef=DET_MH_SCAN_INDEX_4LSB_029_032_Rx
            DET_MTD_029_Rx_oRDR_FUSION_DET_029_032_oPCAN_RADAR_95fc6947_Rx: ComBitPosition=47, ComBitSize=1, ComSignalType=BOOLEAN, ComSystemTemplateSystemSignalRef=DET_MTD_029_Rx
            DET_MTD_030_Rx_oRDR_FUSION_DET_029_032_oPCAN_RADAR_a8dcea5e_Rx: ComBitPosition=159, ComBitSize=1, ComSignalType=BOOLEAN, ComSystemTemplateSystemSignalRef=DET_MTD_030_Rx
            DET_MTD_031_Rx_oRDR_FUSION_DET_029_032_oPCAN_RADAR_07987819_Rx: ComBitPosition=271, ComBitSize=1, ComSignalType=BOOLEAN, ComSystemTemplateSystemSignalRef=DET_MTD_031_Rx
            DET_MTD_032_Rx_oRDR_FUSION_DET_029_032_oPCAN_RADAR_2d24c891_Rx: ComBitPosition=383, ComBitSize=1, ComSignalType=BOOLEAN, ComSystemTemplateSystemSignalRef=DET_MTD_032_Rx
            DET_PROB_1STAZHYPO_029_Rx_oRDR_FUSION_DET_029_032_oPCAN_RADAR_5f8577c6_Rx: ComBitPosition=103, ComBitSize=1, ComSignalType=BOOLEAN, ComSystemTemplateSystemSignalRef=DET_PROB_1STAZHYPO_029_Rx
            DET_PROB_1STAZHYPO_030_Rx_oRDR_FUSION_DET_029_032_oPCAN_RADAR_62a5f4df_Rx: ComBitPosition=215, ComBitSize=1, ComSignalType=BOOLEAN, ComSystemTemplateSystemSignalRef=DET_PROB_1STAZHYPO_030_Rx
            DET_PROB_1STAZHYPO_031_Rx_oRDR_FUSION_DET_029_032_oPCAN_RADAR_cde16698_Rx: ComBitPosition=327, ComBitSize=1, ComSignalType=BOOLEAN, ComSystemTemplateSystemSignalRef=DET_PROB_1STAZHYPO_031_Rx
            DET_PROB_1STAZHYPO_032_Rx_oRDR_FUSION_DET_029_032_oPCAN_RADAR_e75dd610_Rx: ComBitPosition=439, ComBitSize=1, ComSignalType=BOOLEAN, ComSystemTemplateSystemSignalRef=DET_PROB_1STAZHYPO_032_Rx
            DET_RANGE_029_Rx_oRDR_FUSION_DET_029_032_oPCAN_RADAR_04389fd1_Rx: ComBitPosition=24, ComBitSize=15, ComSignalType=UINT16, ComSystemTemplateSystemSignalRef=DET_RANGE_029_Rx
            DET_RANGE_030_Rx_oRDR_FUSION_DET_029_032_oPCAN_RADAR_39181cc8_Rx: ComBitPosition=136, ComBitSize=15, ComSignalType=UINT16, ComSystemTemplateSystemSignalRef=DET_RANGE_030_Rx
            DET_RANGE_031_Rx_oRDR_FUSION_DET_029_032_oPCAN_RADAR_965c8e8f_Rx: ComBitPosition=248, ComBitSize=15, ComSignalType=UINT16, ComSystemTemplateSystemSignalRef=DET_RANGE_031_Rx
            DET_RANGE_032_Rx_oRDR_FUSION_DET_029_032_oPCAN_RADAR_bce03e07_Rx: ComBitPosition=360, ComBitSize=15, ComSignalType=UINT16, ComSystemTemplateSystemSignalRef=DET_RANGE_032_Rx
            DET_RANGE_ERR_029_Rx_oRDR_FUSION_DET_029_032_oPCAN_RADAR_54ca1331_Rx: ComBitPosition=40, ComBitSize=7, ComSignalType=UINT8, ComSystemTemplateSystemSignalRef=DET_RANGE_ERR_029_Rx
            DET_RANGE_ERR_030_Rx_oRDR_FUSION_DET_029_032_oPCAN_RADAR_69ea9028_Rx: ComBitPosition=152, ComBitSize=7, ComSignalType=UINT8, ComSystemTemplateSystemSignalRef=DET_RANGE_ERR_030_Rx
            DET_RANGE_ERR_031_Rx_oRDR_FUSION_DET_029_032_oPCAN_RADAR_c6ae026f_Rx: ComBitPosition=264, ComBitSize=7, ComSignalType=UINT8, ComSystemTemplateSystemSignalRef=DET_RANGE_ERR_031_Rx
            DET_RANGE_ERR_032_Rx_oRDR_FUSION_DET_029_032_oPCAN_RADAR_ec12b2e7_Rx: ComBitPosition=376, ComBitSize=7, ComSignalType=UINT8, ComSystemTemplateSystemSignalRef=DET_RANGE_ERR_032_Rx
            DET_RANGE_VELOCITY_029_Rx_oRDR_FUSION_DET_029_032_oPCAN_RADAR_d9cd1c2f_Rx: ComBitPosition=48, ComBitSize=15, ComSignalType=UINT16, ComSystemTemplateSystemSignalRef=DET_RANGE_VELOCITY_029_Rx
            DET_RANGE_VELOCITY_030_Rx_oRDR_FUSION_DET_029_032_oPCAN_RADAR_e4ed9f36_Rx: ComBitPosition=160, ComBitSize=15, ComSignalType=UINT16, ComSystemTemplateSystemSignalRef=DET_RANGE_VELOCITY_030_Rx
            DET_RANGE_VELOCITY_031_Rx_oRDR_FUSION_DET_029_032_oPCAN_RADAR_4ba90d71_Rx: ComBitPosition=272, ComBitSize=15, ComSignalType=UINT16, ComSystemTemplateSystemSignalRef=DET_RANGE_VELOCITY_031_Rx
            DET_RANGE_VELOCITY_032_Rx_oRDR_FUSION_DET_029_032_oPCAN_RADAR_6115bdf9_Rx: ComBitPosition=384, ComBitSize=15, ComSignalType=UINT16, ComSystemTemplateSystemSignalRef=DET_RANGE_VELOCITY_032_Rx
            DET_RANGE_VELOCITY_ERR_029_Rx_oRDR_FUSION_DET_029_032_oPCAN_RADAR_40a96ced_Rx: ComBitPosition=64, ComBitSize=8, ComSignalType=UINT8, ComSystemTemplateSystemSignalRef=DET_RANGE_VELOCITY_ERR_029_Rx
            DET_RANGE_VELOCITY_ERR_030_Rx_oRDR_FUSION_DET_029_032_oPCAN_RADAR_7d89eff4_Rx: ComBitPosition=176, ComBitSize=8, ComSignalType=UINT8, ComSystemTemplateSystemSignalRef=DET_RANGE_VELOCITY_ERR_030_Rx
            DET_RANGE_VELOCITY_ERR_031_Rx_oRDR_FUSION_DET_029_032_oPCAN_RADAR_d2cd7db3_Rx: ComBitPosition=288, ComBitSize=8, ComSignalType=UINT8, ComSystemTemplateSystemSignalRef=DET_RANGE_VELOCITY_ERR_031_Rx
            DET_RANGE_VELOCITY_ERR_032_Rx_oRDR_FUSION_DET_029_032_oPCAN_RADAR_f871cd3b_Rx: ComBitPosition=400, ComBitSize=8, ComSignalType=UINT8, ComSystemTemplateSystemSignalRef=DET_RANGE_VELOCITY_ERR_032_Rx
            DET_RCS_029_Rx_oRDR_FUSION_DET_029_032_oPCAN_RADAR_14068e34_Rx: ComBitPosition=128, ComBitSize=8, ComSignalType=UINT8, ComSystemTemplateSystemSignalRef=DET_RCS_029_Rx
            DET_RCS_030_Rx_oRDR_FUSION_DET_029_032_oPCAN_RADAR_29260d2d_Rx: ComBitPosition=240, ComBitSize=8, ComSignalType=UINT8, ComSystemTemplateSystemSignalRef=DET_RCS_030_Rx
            DET_RCS_031_Rx_oRDR_FUSION_DET_029_032_oPCAN_RADAR_86629f6a_Rx: ComBitPosition=352, ComBitSize=8, ComSignalType=UINT8, ComSystemTemplateSystemSignalRef=DET_RCS_031_Rx
            DET_RCS_032_Rx_oRDR_FUSION_DET_029_032_oPCAN_RADAR_acde2fe2_Rx: ComBitPosition=464, ComBitSize=8, ComSignalType=UINT8, ComSystemTemplateSystemSignalRef=DET_RCS_032_Rx
            DET_SNR_029_Rx_oRDR_FUSION_DET_029_032_oPCAN_RADAR_1d5cffdd_Rx: ComBitPosition=120, ComBitSize=8, ComSignalType=UINT8, ComSystemTemplateSystemSignalRef=DET_SNR_029_Rx
            DET_SNR_030_Rx_oRDR_FUSION_DET_029_032_oPCAN_RADAR_207c7cc4_Rx: ComBitPosition=232, ComBitSize=8, ComSignalType=UINT8, ComSystemTemplateSystemSignalRef=DET_SNR_030_Rx
            DET_SNR_031_Rx_oRDR_FUSION_DET_029_032_oPCAN_RADAR_8f38ee83_Rx: ComBitPosition=344, ComBitSize=8, ComSignalType=UINT8, ComSystemTemplateSystemSignalRef=DET_SNR_031_Rx
            DET_SNR_032_Rx_oRDR_FUSION_DET_029_032_oPCAN_RADAR_a5845e0b_Rx: ComBitPosition=456, ComBitSize=8, ComSignalType=UINT8, ComSystemTemplateSystemSignalRef=DET_SNR_032_Rx
            DET_SUPER_RES_TARGET_029_Rx_oRDR_FUSION_DET_029_032_oPCAN_RADAR_d6a7dedd_Rx: ComBitPosition=87, ComBitSize=1, ComSignalType=BOOLEAN, ComSystemTemplateSystemSignalRef=DET_SUPER_RES_TARGET_029_Rx
            DET_SUPER_RES_TARGET_030_Rx_oRDR_FUSION_DET_029_032_oPCAN_RADAR_eb875dc4_Rx: ComBitPosition=199, ComBitSize=1, ComSignalType=BOOLEAN, ComSystemTemplateSystemSignalRef=DET_SUPER_RES_TARGET_030_Rx
            DET_SUPER_RES_TARGET_031_Rx_oRDR_FUSION_DET_029_032_oPCAN_RADAR_44c3cf83_Rx: ComBitPosition=311, ComBitSize=1, ComSignalType=BOOLEAN, ComSystemTemplateSystemSignalRef=DET_SUPER_RES_TARGET_031_Rx
            DET_SUPER_RES_TARGET_032_Rx_oRDR_FUSION_DET_029_032_oPCAN_RADAR_6e7f7f0b_Rx: ComBitPosition=423, ComBitSize=1, ComSignalType=BOOLEAN, ComSystemTemplateSystemSignalRef=DET_SUPER_RES_TARGET_032_Rx
        SG_Fusion_Detections_033_036_oRDR_FUSION_DET_033_036_oPCAN_RADAR_cce3d4c2_Rx: ComTimeout=0, ComSystemTemplateSignalGroupRef=SG_Fusion_Detections_033_036
          83 x ComGroupSignal, all with ComSignalEndianness=LITTLE_ENDIAN, ComSignalInitValue=0:
            DET_AZIMUTH_033_Rx_oRDR_FUSION_DET_033_036_oPCAN_RADAR_1da5f349_Rx: ComBitPosition=88, ComBitSize=13, ComSignalType=UINT16, ComSystemTemplateSystemSignalRef=DET_AZIMUTH_033_Rx
            DET_AZIMUTH_034_Rx_oRDR_FUSION_DET_033_036_oPCAN_RADAR_e798001e_Rx: ComBitPosition=200, ComBitSize=13, ComSignalType=UINT16, ComSystemTemplateSystemSignalRef=DET_AZIMUTH_034_Rx
            DET_AZIMUTH_035_Rx_oRDR_FUSION_DET_033_036_oPCAN_RADAR_48dc9259_Rx: ComBitPosition=312, ComBitSize=13, ComSignalType=UINT16, ComSystemTemplateSystemSignalRef=DET_AZIMUTH_035_Rx
            DET_AZIMUTH_036_Rx_oRDR_FUSION_DET_033_036_oPCAN_RADAR_626022d1_Rx: ComBitPosition=424, ComBitSize=13, ComSignalType=UINT16, ComSystemTemplateSystemSignalRef=DET_AZIMUTH_036_Rx
            DET_AZIMUTH_ERR_033_Rx_oRDR_FUSION_DET_033_036_oPCAN_RADAR_1fcc52cb_Rx: ComBitPosition=105, ComBitSize=7, ComSignalType=UINT8, ComSystemTemplateSystemSignalRef=DET_AZIMUTH_ERR_033_Rx
            DET_AZIMUTH_ERR_034_Rx_oRDR_FUSION_DET_033_036_oPCAN_RADAR_e5f1a19c_Rx: ComBitPosition=217, ComBitSize=7, ComSignalType=UINT8, ComSystemTemplateSystemSignalRef=DET_AZIMUTH_ERR_034_Rx
            DET_AZIMUTH_ERR_035_Rx_oRDR_FUSION_DET_033_036_oPCAN_RADAR_4ab533db_Rx: ComBitPosition=329, ComBitSize=7, ComSignalType=UINT8, ComSystemTemplateSystemSignalRef=DET_AZIMUTH_ERR_035_Rx
            DET_AZIMUTH_ERR_036_Rx_oRDR_FUSION_DET_033_036_oPCAN_RADAR_60098353_Rx: ComBitPosition=441, ComBitSize=7, ComSignalType=UINT8, ComSystemTemplateSystemSignalRef=DET_AZIMUTH_ERR_036_Rx
            DET_BELOW_RAIN_THOLD_033_Rx_oRDR_FUSION_DET_033_036_oPCAN_RADAR_7b1f0cfc_Rx: ComBitPosition=39, ComBitSize=1, ComSignalType=BOOLEAN, ComSystemTemplateSystemSignalRef=DET_BELOW_RAIN_THOLD_033_Rx
            DET_BELOW_RAIN_THOLD_034_Rx_oRDR_FUSION_DET_033_036_oPCAN_RADAR_8122ffab_Rx: ComBitPosition=151, ComBitSize=1, ComSignalType=BOOLEAN, ComSystemTemplateSystemSignalRef=DET_BELOW_RAIN_THOLD_034_Rx
            DET_BELOW_RAIN_THOLD_035_Rx_oRDR_FUSION_DET_033_036_oPCAN_RADAR_2e666dec_Rx: ComBitPosition=263, ComBitSize=1, ComSignalType=BOOLEAN, ComSystemTemplateSystemSignalRef=DET_BELOW_RAIN_THOLD_035_Rx
            DET_BELOW_RAIN_THOLD_036_Rx_oRDR_FUSION_DET_033_036_oPCAN_RADAR_04dadd64_Rx: ComBitPosition=375, ComBitSize=1, ComSignalType=BOOLEAN, ComSystemTemplateSystemSignalRef=DET_BELOW_RAIN_THOLD_036_Rx
            DET_BI_STATIC_FLAG_033_Rx_oRDR_FUSION_DET_033_036_oPCAN_RADAR_0c81a7ef_Rx: ComBitPosition=104, ComBitSize=1, ComSignalType=BOOLEAN, ComSystemTemplateSystemSignalRef=DET_BI_STATIC_FLAG_033_Rx
            DET_BI_STATIC_FLAG_034_Rx_oRDR_FUSION_DET_033_036_oPCAN_RADAR_f6bc54b8_Rx: ComBitPosition=216, ComBitSize=1, ComSignalType=BOOLEAN, ComSystemTemplateSystemSignalRef=DET_BI_STATIC_FLAG_034_Rx
            DET_BI_STATIC_FLAG_035_Rx_oRDR_FUSION_DET_033_036_oPCAN_RADAR_59f8c6ff_Rx: ComBitPosition=328, ComBitSize=1, ComSignalType=BOOLEAN, ComSystemTemplateSystemSignalRef=DET_BI_STATIC_FLAG_035_Rx
            DET_BI_STATIC_FLAG_036_Rx_oRDR_FUSION_DET_033_036_oPCAN_RADAR_73447677_Rx: ComBitPosition=440, ComBitSize=1, ComSignalType=BOOLEAN, ComSystemTemplateSystemSignalRef=DET_BI_STATIC_FLAG_036_Rx
            DET_CONFD_AZIMUTH_033_Rx_oRDR_FUSION_DET_033_036_oPCAN_RADAR_efe84dbb_Rx: ComBitPosition=118, ComBitSize=2, ComSignalType=UINT8, ComSystemTemplateSystemSignalRef=DET_CONFD_AZIMUTH_033_Rx
            DET_CONFD_AZIMUTH_034_Rx_oRDR_FUSION_DET_033_036_oPCAN_RADAR_15d5beec_Rx: ComBitPosition=230, ComBitSize=2, ComSignalType=UINT8, ComSystemTemplateSystemSignalRef=DET_CONFD_AZIMUTH_034_Rx
            DET_CONFD_AZIMUTH_035_Rx_oRDR_FUSION_DET_033_036_oPCAN_RADAR_ba912cab_Rx: ComBitPosition=342, ComBitSize=2, ComSignalType=UINT8, ComSystemTemplateSystemSignalRef=DET_CONFD_AZIMUTH_035_Rx
            DET_CONFD_AZIMUTH_036_Rx_oRDR_FUSION_DET_033_036_oPCAN_RADAR_902d9c23_Rx: ComBitPosition=454, ComBitSize=2, ComSignalType=UINT8, ComSystemTemplateSystemSignalRef=DET_CONFD_AZIMUTH_036_Rx
            DET_CONFD_ELEVATION_033_Rx_oRDR_FUSION_DET_033_036_oPCAN_RADAR_e5c9ce3c_Rx: ComBitPosition=101, ComBitSize=2, ComSignalType=UINT8, ComSystemTemplateSystemSignalRef=DET_CONFD_ELEVATION_033_Rx
            DET_CONFD_ELEVATION_034_Rx_oRDR_FUSION_DET_033_036_oPCAN_RADAR_1ff43d6b_Rx: ComBitPosition=213, ComBitSize=2, ComSignalType=UINT8, ComSystemTemplateSystemSignalRef=DET_CONFD_ELEVATION_034_Rx
            DET_CONFD_ELEVATION_035_Rx_oRDR_FUSION_DET_033_036_oPCAN_RADAR_b0b0af2c_Rx: ComBitPosition=325, ComBitSize=2, ComSignalType=UINT8, ComSystemTemplateSystemSignalRef=DET_CONFD_ELEVATION_035_Rx
            DET_CONFD_ELEVATION_036_Rx_oRDR_FUSION_DET_033_036_oPCAN_RADAR_9a0c1fa4_Rx: ComBitPosition=437, ComBitSize=2, ComSignalType=UINT8, ComSystemTemplateSystemSignalRef=DET_CONFD_ELEVATION_036_Rx
            DET_ELEVATION_033_Rx_oRDR_FUSION_DET_033_036_oPCAN_RADAR_ef9a21c5_Rx: ComBitPosition=72, ComBitSize=8, ComSignalType=UINT8, ComSystemTemplateSystemSignalRef=DET_ELEVATION_033_Rx
            DET_ELEVATION_034_Rx_oRDR_FUSION_DET_033_036_oPCAN_RADAR_15a7d292_Rx: ComBitPosition=184, ComBitSize=8, ComSignalType=UINT8, ComSystemTemplateSystemSignalRef=DET_ELEVATION_034_Rx
            DET_ELEVATION_035_Rx_oRDR_FUSION_DET_033_036_oPCAN_RADAR_bae340d5_Rx: ComBitPosition=296, ComBitSize=8, ComSignalType=UINT8, ComSystemTemplateSystemSignalRef=DET_ELEVATION_035_Rx
            DET_ELEVATION_036_Rx_oRDR_FUSION_DET_033_036_oPCAN_RADAR_905ff05d_Rx: ComBitPosition=408, ComBitSize=8, ComSignalType=UINT8, ComSystemTemplateSystemSignalRef=DET_ELEVATION_036_Rx
            DET_ELEVATION_ERR_033_Rx_oRDR_FUSION_DET_033_036_oPCAN_RADAR_3d23031a_Rx: ComBitPosition=80, ComBitSize=6, ComSignalType=UINT8, ComSystemTemplateSystemSignalRef=DET_ELEVATION_ERR_033_Rx
            DET_ELEVATION_ERR_034_Rx_oRDR_FUSION_DET_033_036_oPCAN_RADAR_c71ef04d_Rx: ComBitPosition=192, ComBitSize=6, ComSignalType=UINT8, ComSystemTemplateSystemSignalRef=DET_ELEVATION_ERR_034_Rx
            DET_ELEVATION_ERR_035_Rx_oRDR_FUSION_DET_033_036_oPCAN_RADAR_685a620a_Rx: ComBitPosition=304, ComBitSize=6, ComSignalType=UINT8, ComSystemTemplateSystemSignalRef=DET_ELEVATION_ERR_035_Rx
            DET_ELEVATION_ERR_036_Rx_oRDR_FUSION_DET_033_036_oPCAN_RADAR_42e6d282_Rx: ComBitPosition=416, ComBitSize=6, ComSignalType=UINT8, ComSystemTemplateSystemSignalRef=DET_ELEVATION_ERR_036_Rx
            DET_EXISTENCE_PROB_033_Rx_oRDR_FUSION_DET_033_036_oPCAN_RADAR_ca3b7b8f_Rx: ComBitPosition=112, ComBitSize=6, ComSignalType=UINT8, ComSystemTemplateSystemSignalRef=DET_EXISTENCE_PROB_033_Rx
            DET_EXISTENCE_PROB_034_Rx_oRDR_FUSION_DET_033_036_oPCAN_RADAR_300688d8_Rx: ComBitPosition=224, ComBitSize=6, ComSignalType=UINT8, ComSystemTemplateSystemSignalRef=DET_EXISTENCE_PROB_034_Rx
            DET_EXISTENCE_PROB_035_Rx_oRDR_FUSION_DET_033_036_oPCAN_RADAR_9f421a9f_Rx: ComBitPosition=336, ComBitSize=6, ComSignalType=UINT8, ComSystemTemplateSystemSignalRef=DET_EXISTENCE_PROB_035_Rx
            DET_EXISTENCE_PROB_036_Rx_oRDR_FUSION_DET_033_036_oPCAN_RADAR_b5feaa17_Rx: ComBitPosition=448, ComBitSize=6, ComSignalType=UINT8, ComSystemTemplateSystemSignalRef=DET_EXISTENCE_PROB_036_Rx
            DET_HVC_FLAG_033_Rx_oRDR_FUSION_DET_033_036_oPCAN_RADAR_17e596c0_Rx: ComBitPosition=86, ComBitSize=1, ComSignalType=BOOLEAN, ComSystemTemplateSystemSignalRef=DET_HVC_FLAG_033_Rx
            DET_HVC_FLAG_034_Rx_oRDR_FUSION_DET_033_036_oPCAN_RADAR_edd86597_Rx: ComBitPosition=198, ComBitSize=1, ComSignalType=BOOLEAN, ComSystemTemplateSystemSignalRef=DET_HVC_FLAG_034_Rx
            DET_HVC_FLAG_035_Rx_oRDR_FUSION_DET_033_036_oPCAN_RADAR_429cf7d0_Rx: ComBitPosition=310, ComBitSize=1, ComSignalType=BOOLEAN, ComSystemTemplateSystemSignalRef=DET_HVC_FLAG_035_Rx
            DET_HVC_FLAG_036_Rx_oRDR_FUSION_DET_033_036_oPCAN_RADAR_68204758_Rx: ComBitPosition=422, ComBitSize=1, ComSignalType=BOOLEAN, ComSystemTemplateSystemSignalRef=DET_HVC_FLAG_036_Rx
            DET_IDM_033_Rx_oRDR_FUSION_DET_033_036_oPCAN_RADAR_22246f88_Rx: ComBitPosition=63, ComBitSize=1, ComSignalType=BOOLEAN, ComSystemTemplateSystemSignalRef=DET_IDM_033_Rx
            DET_IDM_034_Rx_oRDR_FUSION_DET_033_036_oPCAN_RADAR_d8199cdf_Rx: ComBitPosition=175, ComBitSize=1, ComSignalType=BOOLEAN, ComSystemTemplateSystemSignalRef=DET_IDM_034_Rx
            DET_IDM_035_Rx_oRDR_FUSION_DET_033_036_oPCAN_RADAR_775d0e98_Rx: ComBitPosition=287, ComBitSize=1, ComSignalType=BOOLEAN, ComSystemTemplateSystemSignalRef=DET_IDM_035_Rx
            DET_IDM_036_Rx_oRDR_FUSION_DET_033_036_oPCAN_RADAR_5de1be10_Rx: ComBitPosition=399, ComBitSize=1, ComSignalType=BOOLEAN, ComSystemTemplateSystemSignalRef=DET_IDM_036_Rx
            DET_MH_CRC16_033_036_Rx_oRDR_FUSION_DET_033_036_oPCAN_RADAR_505d9188_Rx: ComBitPosition=0, ComBitSize=16, ComSignalType=UINT16, ComSystemTemplateSystemSignalRef=DET_MH_CRC16_033_036_Rx
            DET_MH_CYCLE_COUNTER_033_036_Rx_oRDR_FUSION_DET_033_036_oPCAN_RADAR_5d86ac4d_Rx: ComBitPosition=16, ComBitSize=8, ComSignalType=UINT8, ComSystemTemplateSystemSignalRef=DET_MH_CYCLE_COUNTER_033_036_Rx
            DET_MH_SCAN_INDEX_4LSB_033_036_Rx_oRDR_FUSION_DET_033_036_oPCAN_RADAR_39366376_Rx: ComBitPosition=476, ComBitSize=4, ComSignalType=UINT8, ComSystemTemplateSystemSignalRef=DET_MH_SCAN_INDEX_4LSB_033_036_Rx
            DET_MTD_033_Rx_oRDR_FUSION_DET_033_036_oPCAN_RADAR_9fa759f8_Rx: ComBitPosition=47, ComBitSize=1, ComSignalType=BOOLEAN, ComSystemTemplateSystemSignalRef=DET_MTD_033_Rx
            DET_MTD_034_Rx_oRDR_FUSION_DET_033_036_oPCAN_RADAR_659aaaaf_Rx: ComBitPosition=159, ComBitSize=1, ComSignalType=BOOLEAN, ComSystemTemplateSystemSignalRef=DET_MTD_034_Rx
            DET_MTD_035_Rx_oRDR_FUSION_DET_033_036_oPCAN_RADAR_cade38e8_Rx: ComBitPosition=271, ComBitSize=1, ComSignalType=BOOLEAN, ComSystemTemplateSystemSignalRef=DET_MTD_035_Rx
            DET_MTD_036_Rx_oRDR_FUSION_DET_033_036_oPCAN_RADAR_e0628860_Rx: ComBitPosition=383, ComBitSize=1, ComSignalType=BOOLEAN, ComSystemTemplateSystemSignalRef=DET_MTD_036_Rx
            DET_PROB_1STAZHYPO_033_Rx_oRDR_FUSION_DET_033_036_oPCAN_RADAR_55de4779_Rx: ComBitPosition=103, ComBitSize=1, ComSignalType=BOOLEAN, ComSystemTemplateSystemSignalRef=DET_PROB_1STAZHYPO_033_Rx
            DET_PROB_1STAZHYPO_034_Rx_oRDR_FUSION_DET_033_036_oPCAN_RADAR_afe3b42e_Rx: ComBitPosition=215, ComBitSize=1, ComSignalType=BOOLEAN, ComSystemTemplateSystemSignalRef=DET_PROB_1STAZHYPO_034_Rx
            DET_PROB_1STAZHYPO_035_Rx_oRDR_FUSION_DET_033_036_oPCAN_RADAR_00a72669_Rx: ComBitPosition=327, ComBitSize=1, ComSignalType=BOOLEAN, ComSystemTemplateSystemSignalRef=DET_PROB_1STAZHYPO_035_Rx
            DET_PROB_1STAZHYPO_036_Rx_oRDR_FUSION_DET_033_036_oPCAN_RADAR_2a1b96e1_Rx: ComBitPosition=439, ComBitSize=1, ComSignalType=BOOLEAN, ComSystemTemplateSystemSignalRef=DET_PROB_1STAZHYPO_036_Rx
            DET_RANGE_033_Rx_oRDR_FUSION_DET_033_036_oPCAN_RADAR_0e63af6e_Rx: ComBitPosition=24, ComBitSize=15, ComSignalType=UINT16, ComSystemTemplateSystemSignalRef=DET_RANGE_033_Rx
            DET_RANGE_034_Rx_oRDR_FUSION_DET_033_036_oPCAN_RADAR_f45e5c39_Rx: ComBitPosition=136, ComBitSize=15, ComSignalType=UINT16, ComSystemTemplateSystemSignalRef=DET_RANGE_034_Rx
            DET_RANGE_035_Rx_oRDR_FUSION_DET_033_036_oPCAN_RADAR_5b1ace7e_Rx: ComBitPosition=248, ComBitSize=15, ComSignalType=UINT16, ComSystemTemplateSystemSignalRef=DET_RANGE_035_Rx
            DET_RANGE_036_Rx_oRDR_FUSION_DET_033_036_oPCAN_RADAR_71a67ef6_Rx: ComBitPosition=360, ComBitSize=15, ComSignalType=UINT16, ComSystemTemplateSystemSignalRef=DET_RANGE_036_Rx
            DET_RANGE_ERR_033_Rx_oRDR_FUSION_DET_033_036_oPCAN_RADAR_5e91238e_Rx: ComBitPosition=40, ComBitSize=7, ComSignalType=UINT8, ComSystemTemplateSystemSignalRef=DET_RANGE_ERR_033_Rx
            DET_RANGE_ERR_034_Rx_oRDR_FUSION_DET_033_036_oPCAN_RADAR_a4acd0d9_Rx: ComBitPosition=152, ComBitSize=7, ComSignalType=UINT8, ComSystemTemplateSystemSignalRef=DET_RANGE_ERR_034_Rx
            DET_RANGE_ERR_035_Rx_oRDR_FUSION_DET_033_036_oPCAN_RADAR_0be8429e_Rx: ComBitPosition=264, ComBitSize=7, ComSignalType=UINT8, ComSystemTemplateSystemSignalRef=DET_RANGE_ERR_035_Rx
            DET_RANGE_ERR_036_Rx_oRDR_FUSION_DET_033_036_oPCAN_RADAR_2154f216_Rx: ComBitPosition=376, ComBitSize=7, ComSignalType=UINT8, ComSystemTemplateSystemSignalRef=DET_RANGE_ERR_036_Rx
            DET_RANGE_VELOCITY_033_Rx_oRDR_FUSION_DET_033_036_oPCAN_RADAR_d3962c90_Rx: ComBitPosition=48, ComBitSize=15, ComSignalType=UINT16, ComSystemTemplateSystemSignalRef=DET_RANGE_VELOCITY_033_Rx
            DET_RANGE_VELOCITY_034_Rx_oRDR_FUSION_DET_033_036_oPCAN_RADAR_29abdfc7_Rx: ComBitPosition=160, ComBitSize=15, ComSignalType=UINT16, ComSystemTemplateSystemSignalRef=DET_RANGE_VELOCITY_034_Rx
            DET_RANGE_VELOCITY_035_Rx_oRDR_FUSION_DET_033_036_oPCAN_RADAR_86ef4d80_Rx: ComBitPosition=272, ComBitSize=15, ComSignalType=UINT16, ComSystemTemplateSystemSignalRef=DET_RANGE_VELOCITY_035_Rx
            DET_RANGE_VELOCITY_036_Rx_oRDR_FUSION_DET_033_036_oPCAN_RADAR_ac53fd08_Rx: ComBitPosition=384, ComBitSize=15, ComSignalType=UINT16, ComSystemTemplateSystemSignalRef=DET_RANGE_VELOCITY_036_Rx
            DET_RANGE_VELOCITY_ERR_033_Rx_oRDR_FUSION_DET_033_036_oPCAN_RADAR_4af25c52_Rx: ComBitPosition=64, ComBitSize=8, ComSignalType=UINT8, ComSystemTemplateSystemSignalRef=DET_RANGE_VELOCITY_ERR_033_Rx
            DET_RANGE_VELOCITY_ERR_034_Rx_oRDR_FUSION_DET_033_036_oPCAN_RADAR_b0cfaf05_Rx: ComBitPosition=176, ComBitSize=8, ComSignalType=UINT8, ComSystemTemplateSystemSignalRef=DET_RANGE_VELOCITY_ERR_034_Rx
            DET_RANGE_VELOCITY_ERR_035_Rx_oRDR_FUSION_DET_033_036_oPCAN_RADAR_1f8b3d42_Rx: ComBitPosition=288, ComBitSize=8, ComSignalType=UINT8, ComSystemTemplateSystemSignalRef=DET_RANGE_VELOCITY_ERR_035_Rx
            DET_RANGE_VELOCITY_ERR_036_Rx_oRDR_FUSION_DET_033_036_oPCAN_RADAR_35378dca_Rx: ComBitPosition=400, ComBitSize=8, ComSignalType=UINT8, ComSystemTemplateSystemSignalRef=DET_RANGE_VELOCITY_ERR_036_Rx
            DET_RCS_033_Rx_oRDR_FUSION_DET_033_036_oPCAN_RADAR_1e5dbe8b_Rx: ComBitPosition=128, ComBitSize=8, ComSignalType=UINT8, ComSystemTemplateSystemSignalRef=DET_RCS_033_Rx
            DET_RCS_034_Rx_oRDR_FUSION_DET_033_036_oPCAN_RADAR_e4604ddc_Rx: ComBitPosition=240, ComBitSize=8, ComSignalType=UINT8, ComSystemTemplateSystemSignalRef=DET_RCS_034_Rx
            DET_RCS_035_Rx_oRDR_FUSION_DET_033_036_oPCAN_RADAR_4b24df9b_Rx: ComBitPosition=352, ComBitSize=8, ComSignalType=UINT8, ComSystemTemplateSystemSignalRef=DET_RCS_035_Rx
            DET_RCS_036_Rx_oRDR_FUSION_DET_033_036_oPCAN_RADAR_61986f13_Rx: ComBitPosition=464, ComBitSize=8, ComSignalType=UINT8, ComSystemTemplateSystemSignalRef=DET_RCS_036_Rx
            DET_SNR_033_Rx_oRDR_FUSION_DET_033_036_oPCAN_RADAR_1707cf62_Rx: ComBitPosition=120, ComBitSize=8, ComSignalType=UINT8, ComSystemTemplateSystemSignalRef=DET_SNR_033_Rx
            DET_SNR_034_Rx_oRDR_FUSION_DET_033_036_oPCAN_RADAR_ed3a3c35_Rx: ComBitPosition=232, ComBitSize=8, ComSignalType=UINT8, ComSystemTemplateSystemSignalRef=DET_SNR_034_Rx
            DET_SNR_035_Rx_oRDR_FUSION_DET_033_036_oPCAN_RADAR_427eae72_Rx: ComBitPosition=344, ComBitSize=8, ComSignalType=UINT8, ComSystemTemplateSystemSignalRef=DET_SNR_035_Rx
            DET_SNR_036_Rx_oRDR_FUSION_DET_033_036_oPCAN_RADAR_68c21efa_Rx: ComBitPosition=456, ComBitSize=8, ComSignalType=UINT8, ComSystemTemplateSystemSignalRef=DET_SNR_036_Rx
            DET_SUPER_RES_TARGET_033_Rx_oRDR_FUSION_DET_033_036_oPCAN_RADAR_dcfcee62_Rx: ComBitPosition=87, ComBitSize=1, ComSignalType=BOOLEAN, ComSystemTemplateSystemSignalRef=DET_SUPER_RES_TARGET_033_Rx
            DET_SUPER_RES_TARGET_034_Rx_oRDR_FUSION_DET_033_036_oPCAN_RADAR_26c11d35_Rx: ComBitPosition=199, ComBitSize=1, ComSignalType=BOOLEAN, ComSystemTemplateSystemSignalRef=DET_SUPER_RES_TARGET_034_Rx
            DET_SUPER_RES_TARGET_035_Rx_oRDR_FUSION_DET_033_036_oPCAN_RADAR_89858f72_Rx: ComBitPosition=311, ComBitSize=1, ComSignalType=BOOLEAN, ComSystemTemplateSystemSignalRef=DET_SUPER_RES_TARGET_035_Rx
            DET_SUPER_RES_TARGET_036_Rx_oRDR_FUSION_DET_033_036_oPCAN_RADAR_a3393ffa_Rx: ComBitPosition=423, ComBitSize=1, ComSignalType=BOOLEAN, ComSystemTemplateSystemSignalRef=DET_SUPER_RES_TARGET_036_Rx
        SG_Fusion_Detections_037_040_oRDR_FUSION_DET_037_040_oPCAN_RADAR_cee54bfa_Rx: ComTimeout=0, ComSystemTemplateSignalGroupRef=SG_Fusion_Detections_037_040
          83 x ComGroupSignal, all with ComSignalEndianness=LITTLE_ENDIAN, ComSignalInitValue=0:
            DET_AZIMUTH_037_Rx_oRDR_FUSION_DET_037_040_oPCAN_RADAR_7b04e244_Rx: ComBitPosition=88, ComBitSize=13, ComSignalType=UINT16, ComSystemTemplateSystemSignalRef=DET_AZIMUTH_037_Rx
            DET_AZIMUTH_038_Rx_oRDR_FUSION_DET_037_040_oPCAN_RADAR_fb4a90ec_Rx: ComBitPosition=200, ComBitSize=13, ComSignalType=UINT16, ComSystemTemplateSystemSignalRef=DET_AZIMUTH_038_Rx
            DET_AZIMUTH_039_Rx_oRDR_FUSION_DET_037_040_oPCAN_RADAR_540e02ab_Rx: ComBitPosition=312, ComBitSize=13, ComSignalType=UINT16, ComSystemTemplateSystemSignalRef=DET_AZIMUTH_039_Rx
            DET_AZIMUTH_040_Rx_oRDR_FUSION_DET_037_040_oPCAN_RADAR_74cce8b7_Rx: ComBitPosition=424, ComBitSize=13, ComSignalType=UINT16, ComSystemTemplateSystemSignalRef=DET_AZIMUTH_040_Rx
            DET_AZIMUTH_ERR_037_Rx_oRDR_FUSION_DET_037_040_oPCAN_RADAR_796d43c6_Rx: ComBitPosition=105, ComBitSize=7, ComSignalType=UINT8, ComSystemTemplateSystemSignalRef=DET_AZIMUTH_ERR_037_Rx
            DET_AZIMUTH_ERR_038_Rx_oRDR_FUSION_DET_037_040_oPCAN_RADAR_f923316e_Rx: ComBitPosition=217, ComBitSize=7, ComSignalType=UINT8, ComSystemTemplateSystemSignalRef=DET_AZIMUTH_ERR_038_Rx
            DET_AZIMUTH_ERR_039_Rx_oRDR_FUSION_DET_037_040_oPCAN_RADAR_5667a329_Rx: ComBitPosition=329, ComBitSize=7, ComSignalType=UINT8, ComSystemTemplateSystemSignalRef=DET_AZIMUTH_ERR_039_Rx
            DET_AZIMUTH_ERR_040_Rx_oRDR_FUSION_DET_037_040_oPCAN_RADAR_76a54935_Rx: ComBitPosition=441, ComBitSize=7, ComSignalType=UINT8, ComSystemTemplateSystemSignalRef=DET_AZIMUTH_ERR_040_Rx
            DET_BELOW_RAIN_THOLD_037_Rx_oRDR_FUSION_DET_037_040_oPCAN_RADAR_1dbe1df1_Rx: ComBitPosition=39, ComBitSize=1, ComSignalType=BOOLEAN, ComSystemTemplateSystemSignalRef=DET_BELOW_RAIN_THOLD_037_Rx
            DET_BELOW_RAIN_THOLD_038_Rx_oRDR_FUSION_DET_037_040_oPCAN_RADAR_9df06f59_Rx: ComBitPosition=151, ComBitSize=1, ComSignalType=BOOLEAN, ComSystemTemplateSystemSignalRef=DET_BELOW_RAIN_THOLD_038_Rx
            DET_BELOW_RAIN_THOLD_039_Rx_oRDR_FUSION_DET_037_040_oPCAN_RADAR_32b4fd1e_Rx: ComBitPosition=263, ComBitSize=1, ComSignalType=BOOLEAN, ComSystemTemplateSystemSignalRef=DET_BELOW_RAIN_THOLD_039_Rx
            DET_BELOW_RAIN_THOLD_040_Rx_oRDR_FUSION_DET_037_040_oPCAN_RADAR_12761702_Rx: ComBitPosition=375, ComBitSize=1, ComSignalType=BOOLEAN, ComSystemTemplateSystemSignalRef=DET_BELOW_RAIN_THOLD_040_Rx
            DET_BI_STATIC_FLAG_037_Rx_oRDR_FUSION_DET_037_040_oPCAN_RADAR_6a20b6e2_Rx: ComBitPosition=104, ComBitSize=1, ComSignalType=BOOLEAN, ComSystemTemplateSystemSignalRef=DET_BI_STATIC_FLAG_037_Rx
            DET_BI_STATIC_FLAG_038_Rx_oRDR_FUSION_DET_037_040_oPCAN_RADAR_ea6ec44a_Rx: ComBitPosition=216, ComBitSize=1, ComSignalType=BOOLEAN, ComSystemTemplateSystemSignalRef=DET_BI_STATIC_FLAG_038_Rx
            DET_BI_STATIC_FLAG_039_Rx_oRDR_FUSION_DET_037_040_oPCAN_RADAR_452a560d_Rx: ComBitPosition=328, ComBitSize=1, ComSignalType=BOOLEAN, ComSystemTemplateSystemSignalRef=DET_BI_STATIC_FLAG_039_Rx
            DET_BI_STATIC_FLAG_040_Rx_oRDR_FUSION_DET_037_040_oPCAN_RADAR_65e8bc11_Rx: ComBitPosition=440, ComBitSize=1, ComSignalType=BOOLEAN, ComSystemTemplateSystemSignalRef=DET_BI_STATIC_FLAG_040_Rx
            DET_CONFD_AZIMUTH_037_Rx_oRDR_FUSION_DET_037_040_oPCAN_RADAR_89495cb6_Rx: ComBitPosition=118, ComBitSize=2, ComSignalType=UINT8, ComSystemTemplateSystemSignalRef=DET_CONFD_AZIMUTH_037_Rx
            DET_CONFD_AZIMUTH_038_Rx_oRDR_FUSION_DET_037_040_oPCAN_RADAR_09072e1e_Rx: ComBitPosition=230, ComBitSize=2, ComSignalType=UINT8, ComSystemTemplateSystemSignalRef=DET_CONFD_AZIMUTH_038_Rx
            DET_CONFD_AZIMUTH_039_Rx_oRDR_FUSION_DET_037_040_oPCAN_RADAR_a643bc59_Rx: ComBitPosition=342, ComBitSize=2, ComSignalType=UINT8, ComSystemTemplateSystemSignalRef=DET_CONFD_AZIMUTH_039_Rx
            DET_CONFD_AZIMUTH_040_Rx_oRDR_FUSION_DET_037_040_oPCAN_RADAR_86815645_Rx: ComBitPosition=454, ComBitSize=2, ComSignalType=UINT8, ComSystemTemplateSystemSignalRef=DET_CONFD_AZIMUTH_040_Rx
            DET_CONFD_ELEVATION_037_Rx_oRDR_FUSION_DET_037_040_oPCAN_RADAR_8368df31_Rx: ComBitPosition=101, ComBitSize=2, ComSignalType=UINT8, ComSystemTemplateSystemSignalRef=DET_CONFD_ELEVATION_037_Rx
            DET_CONFD_ELEVATION_038_Rx_oRDR_FUSION_DET_037_040_oPCAN_RADAR_0326ad99_Rx: ComBitPosition=213, ComBitSize=2, ComSignalType=UINT8, ComSystemTemplateSystemSignalRef=DET_CONFD_ELEVATION_038_Rx
            DET_CONFD_ELEVATION_039_Rx_oRDR_FUSION_DET_037_040_oPCAN_RADAR_ac623fde_Rx: ComBitPosition=325, ComBitSize=2, ComSignalType=UINT8, ComSystemTemplateSystemSignalRef=DET_CONFD_ELEVATION_039_Rx
            DET_CONFD_ELEVATION_040_Rx_oRDR_FUSION_DET_037_040_oPCAN_RADAR_8ca0d5c2_Rx: ComBitPosition=437, ComBitSize=2, ComSignalType=UINT8, ComSystemTemplateSystemSignalRef=DET_CONFD_ELEVATION_040_Rx
            DET_ELEVATION_037_Rx_oRDR_FUSION_DET_037_040_oPCAN_RADAR_893b30c8_Rx: ComBitPosition=72, ComBitSize=8, ComSignalType=UINT8, ComSystemTemplateSystemSignalRef=DET_ELEVATION_037_Rx
            DET_ELEVATION_038_Rx_oRDR_FUSION_DET_037_040_oPCAN_RADAR_09754260_Rx: ComBitPosition=184, ComBitSize=8, ComSignalType=UINT8, ComSystemTemplateSystemSignalRef=DET_ELEVATION_038_Rx
            DET_ELEVATION_039_Rx_oRDR_FUSION_DET_037_040_oPCAN_RADAR_a631d027_Rx: ComBitPosition=296, ComBitSize=8, ComSignalType=UINT8, ComSystemTemplateSystemSignalRef=DET_ELEVATION_039_Rx
            DET_ELEVATION_040_Rx_oRDR_FUSION_DET_037_040_oPCAN_RADAR_86f33a3b_Rx: ComBitPosition=408, ComBitSize=8, ComSignalType=UINT8, ComSystemTemplateSystemSignalRef=DET_ELEVATION_040_Rx
            DET_ELEVATION_ERR_037_Rx_oRDR_FUSION_DET_037_040_oPCAN_RADAR_5b821217_Rx: ComBitPosition=80, ComBitSize=6, ComSignalType=UINT8, ComSystemTemplateSystemSignalRef=DET_ELEVATION_ERR_037_Rx
            DET_ELEVATION_ERR_038_Rx_oRDR_FUSION_DET_037_040_oPCAN_RADAR_dbcc60bf_Rx: ComBitPosition=192, ComBitSize=6, ComSignalType=UINT8, ComSystemTemplateSystemSignalRef=DET_ELEVATION_ERR_038_Rx
            DET_ELEVATION_ERR_039_Rx_oRDR_FUSION_DET_037_040_oPCAN_RADAR_7488f2f8_Rx: ComBitPosition=304, ComBitSize=6, ComSignalType=UINT8, ComSystemTemplateSystemSignalRef=DET_ELEVATION_ERR_039_Rx
            DET_ELEVATION_ERR_040_Rx_oRDR_FUSION_DET_037_040_oPCAN_RADAR_544a18e4_Rx: ComBitPosition=416, ComBitSize=6, ComSignalType=UINT8, ComSystemTemplateSystemSignalRef=DET_ELEVATION_ERR_040_Rx
            DET_EXISTENCE_PROB_037_Rx_oRDR_FUSION_DET_037_040_oPCAN_RADAR_ac9a6a82_Rx: ComBitPosition=112, ComBitSize=6, ComSignalType=UINT8, ComSystemTemplateSystemSignalRef=DET_EXISTENCE_PROB_037_Rx
            DET_EXISTENCE_PROB_038_Rx_oRDR_FUSION_DET_037_040_oPCAN_RADAR_2cd4182a_Rx: ComBitPosition=224, ComBitSize=6, ComSignalType=UINT8, ComSystemTemplateSystemSignalRef=DET_EXISTENCE_PROB_038_Rx
            DET_EXISTENCE_PROB_039_Rx_oRDR_FUSION_DET_037_040_oPCAN_RADAR_83908a6d_Rx: ComBitPosition=336, ComBitSize=6, ComSignalType=UINT8, ComSystemTemplateSystemSignalRef=DET_EXISTENCE_PROB_039_Rx
            DET_EXISTENCE_PROB_040_Rx_oRDR_FUSION_DET_037_040_oPCAN_RADAR_a3526071_Rx: ComBitPosition=448, ComBitSize=6, ComSignalType=UINT8, ComSystemTemplateSystemSignalRef=DET_EXISTENCE_PROB_040_Rx
            DET_HVC_FLAG_037_Rx_oRDR_FUSION_DET_037_040_oPCAN_RADAR_714487cd_Rx: ComBitPosition=86, ComBitSize=1, ComSignalType=BOOLEAN, ComSystemTemplateSystemSignalRef=DET_HVC_FLAG_037_Rx
            DET_HVC_FLAG_038_Rx_oRDR_FUSION_DET_037_040_oPCAN_RADAR_f10af565_Rx: ComBitPosition=198, ComBitSize=1, ComSignalType=BOOLEAN, ComSystemTemplateSystemSignalRef=DET_HVC_FLAG_038_Rx
            DET_HVC_FLAG_039_Rx_oRDR_FUSION_DET_037_040_oPCAN_RADAR_5e4e6722_Rx: ComBitPosition=310, ComBitSize=1, ComSignalType=BOOLEAN, ComSystemTemplateSystemSignalRef=DET_HVC_FLAG_039_Rx
            DET_HVC_FLAG_040_Rx_oRDR_FUSION_DET_037_040_oPCAN_RADAR_7e8c8d3e_Rx: ComBitPosition=422, ComBitSize=1, ComSignalType=BOOLEAN, ComSystemTemplateSystemSignalRef=DET_HVC_FLAG_040_Rx
            DET_IDM_037_Rx_oRDR_FUSION_DET_037_040_oPCAN_RADAR_44857e85_Rx: ComBitPosition=63, ComBitSize=1, ComSignalType=BOOLEAN, ComSystemTemplateSystemSignalRef=DET_IDM_037_Rx
            DET_IDM_038_Rx_oRDR_FUSION_DET_037_040_oPCAN_RADAR_c4cb0c2d_Rx: ComBitPosition=175, ComBitSize=1, ComSignalType=BOOLEAN, ComSystemTemplateSystemSignalRef=DET_IDM_038_Rx
            DET_IDM_039_Rx_oRDR_FUSION_DET_037_040_oPCAN_RADAR_6b8f9e6a_Rx: ComBitPosition=287, ComBitSize=1, ComSignalType=BOOLEAN, ComSystemTemplateSystemSignalRef=DET_IDM_039_Rx
            DET_IDM_040_Rx_oRDR_FUSION_DET_037_040_oPCAN_RADAR_4b4d7476_Rx: ComBitPosition=399, ComBitSize=1, ComSignalType=BOOLEAN, ComSystemTemplateSystemSignalRef=DET_IDM_040_Rx
            DET_MH_CRC16_037_040_Rx_oRDR_FUSION_DET_037_040_oPCAN_RADAR_ee51ba66_Rx: ComBitPosition=0, ComBitSize=16, ComSignalType=UINT16, ComSystemTemplateSystemSignalRef=DET_MH_CRC16_037_040_Rx
            DET_MH_CYCLE_COUNTER_037_040_Rx_oRDR_FUSION_DET_037_040_oPCAN_RADAR_e38a87a3_Rx: ComBitPosition=16, ComBitSize=8, ComSignalType=UINT8, ComSystemTemplateSystemSignalRef=DET_MH_CYCLE_COUNTER_037_040_Rx
            DET_MH_SCAN_INDEX_4LSB_037_040_Rx_oRDR_FUSION_DET_037_040_oPCAN_RADAR_873a4898_Rx: ComBitPosition=476, ComBitSize=4, ComSignalType=UINT8, ComSystemTemplateSystemSignalRef=DET_MH_SCAN_INDEX_4LSB_037_040_Rx
            DET_MTD_037_Rx_oRDR_FUSION_DET_037_040_oPCAN_RADAR_f90648f5_Rx: ComBitPosition=47, ComBitSize=1, ComSignalType=BOOLEAN, ComSystemTemplateSystemSignalRef=DET_MTD_037_Rx
            DET_MTD_038_Rx_oRDR_FUSION_DET_037_040_oPCAN_RADAR_79483a5d_Rx: ComBitPosition=159, ComBitSize=1, ComSignalType=BOOLEAN, ComSystemTemplateSystemSignalRef=DET_MTD_038_Rx
            DET_MTD_039_Rx_oRDR_FUSION_DET_037_040_oPCAN_RADAR_d60ca81a_Rx: ComBitPosition=271, ComBitSize=1, ComSignalType=BOOLEAN, ComSystemTemplateSystemSignalRef=DET_MTD_039_Rx
            DET_MTD_040_Rx_oRDR_FUSION_DET_037_040_oPCAN_RADAR_f6ce4206_Rx: ComBitPosition=383, ComBitSize=1, ComSignalType=BOOLEAN, ComSystemTemplateSystemSignalRef=DET_MTD_040_Rx
            DET_PROB_1STAZHYPO_037_Rx_oRDR_FUSION_DET_037_040_oPCAN_RADAR_337f5674_Rx: ComBitPosition=103, ComBitSize=1, ComSignalType=BOOLEAN, ComSystemTemplateSystemSignalRef=DET_PROB_1STAZHYPO_037_Rx
            DET_PROB_1STAZHYPO_038_Rx_oRDR_FUSION_DET_037_040_oPCAN_RADAR_b33124dc_Rx: ComBitPosition=215, ComBitSize=1, ComSignalType=BOOLEAN, ComSystemTemplateSystemSignalRef=DET_PROB_1STAZHYPO_038_Rx
            DET_PROB_1STAZHYPO_039_Rx_oRDR_FUSION_DET_037_040_oPCAN_RADAR_1c75b69b_Rx: ComBitPosition=327, ComBitSize=1, ComSignalType=BOOLEAN, ComSystemTemplateSystemSignalRef=DET_PROB_1STAZHYPO_039_Rx
            DET_PROB_1STAZHYPO_040_Rx_oRDR_FUSION_DET_037_040_oPCAN_RADAR_3cb75c87_Rx: ComBitPosition=439, ComBitSize=1, ComSignalType=BOOLEAN, ComSystemTemplateSystemSignalRef=DET_PROB_1STAZHYPO_040_Rx
            DET_RANGE_037_Rx_oRDR_FUSION_DET_037_040_oPCAN_RADAR_68c2be63_Rx: ComBitPosition=24, ComBitSize=15, ComSignalType=UINT16, ComSystemTemplateSystemSignalRef=DET_RANGE_037_Rx
            DET_RANGE_038_Rx_oRDR_FUSION_DET_037_040_oPCAN_RADAR_e88ccccb_Rx: ComBitPosition=136, ComBitSize=15, ComSignalType=UINT16, ComSystemTemplateSystemSignalRef=DET_RANGE_038_Rx
            DET_RANGE_039_Rx_oRDR_FUSION_DET_037_040_oPCAN_RADAR_47c85e8c_Rx: ComBitPosition=248, ComBitSize=15, ComSignalType=UINT16, ComSystemTemplateSystemSignalRef=DET_RANGE_039_Rx
            DET_RANGE_040_Rx_oRDR_FUSION_DET_037_040_oPCAN_RADAR_670ab490_Rx: ComBitPosition=360, ComBitSize=15, ComSignalType=UINT16, ComSystemTemplateSystemSignalRef=DET_RANGE_040_Rx
            DET_RANGE_ERR_037_Rx_oRDR_FUSION_DET_037_040_oPCAN_RADAR_38303283_Rx: ComBitPosition=40, ComBitSize=7, ComSignalType=UINT8, ComSystemTemplateSystemSignalRef=DET_RANGE_ERR_037_Rx
            DET_RANGE_ERR_038_Rx_oRDR_FUSION_DET_037_040_oPCAN_RADAR_b87e402b_Rx: ComBitPosition=152, ComBitSize=7, ComSignalType=UINT8, ComSystemTemplateSystemSignalRef=DET_RANGE_ERR_038_Rx
            DET_RANGE_ERR_039_Rx_oRDR_FUSION_DET_037_040_oPCAN_RADAR_173ad26c_Rx: ComBitPosition=264, ComBitSize=7, ComSignalType=UINT8, ComSystemTemplateSystemSignalRef=DET_RANGE_ERR_039_Rx
            DET_RANGE_ERR_040_Rx_oRDR_FUSION_DET_037_040_oPCAN_RADAR_37f83870_Rx: ComBitPosition=376, ComBitSize=7, ComSignalType=UINT8, ComSystemTemplateSystemSignalRef=DET_RANGE_ERR_040_Rx
            DET_RANGE_VELOCITY_037_Rx_oRDR_FUSION_DET_037_040_oPCAN_RADAR_b5373d9d_Rx: ComBitPosition=48, ComBitSize=15, ComSignalType=UINT16, ComSystemTemplateSystemSignalRef=DET_RANGE_VELOCITY_037_Rx
            DET_RANGE_VELOCITY_038_Rx_oRDR_FUSION_DET_037_040_oPCAN_RADAR_35794f35_Rx: ComBitPosition=160, ComBitSize=15, ComSignalType=UINT16, ComSystemTemplateSystemSignalRef=DET_RANGE_VELOCITY_038_Rx
            DET_RANGE_VELOCITY_039_Rx_oRDR_FUSION_DET_037_040_oPCAN_RADAR_9a3ddd72_Rx: ComBitPosition=272, ComBitSize=15, ComSignalType=UINT16, ComSystemTemplateSystemSignalRef=DET_RANGE_VELOCITY_039_Rx
            DET_RANGE_VELOCITY_040_Rx_oRDR_FUSION_DET_037_040_oPCAN_RADAR_baff376e_Rx: ComBitPosition=384, ComBitSize=15, ComSignalType=UINT16, ComSystemTemplateSystemSignalRef=DET_RANGE_VELOCITY_040_Rx
            DET_RANGE_VELOCITY_ERR_037_Rx_oRDR_FUSION_DET_037_040_oPCAN_RADAR_2c534d5f_Rx: ComBitPosition=64, ComBitSize=8, ComSignalType=UINT8, ComSystemTemplateSystemSignalRef=DET_RANGE_VELOCITY_ERR_037_Rx
            DET_RANGE_VELOCITY_ERR_038_Rx_oRDR_FUSION_DET_037_040_oPCAN_RADAR_ac1d3ff7_Rx: ComBitPosition=176, ComBitSize=8, ComSignalType=UINT8, ComSystemTemplateSystemSignalRef=DET_RANGE_VELOCITY_ERR_038_Rx
            DET_RANGE_VELOCITY_ERR_039_Rx_oRDR_FUSION_DET_037_040_oPCAN_RADAR_0359adb0_Rx: ComBitPosition=288, ComBitSize=8, ComSignalType=UINT8, ComSystemTemplateSystemSignalRef=DET_RANGE_VELOCITY_ERR_039_Rx
            DET_RANGE_VELOCITY_ERR_040_Rx_oRDR_FUSION_DET_037_040_oPCAN_RADAR_239b47ac_Rx: ComBitPosition=400, ComBitSize=8, ComSignalType=UINT8, ComSystemTemplateSystemSignalRef=DET_RANGE_VELOCITY_ERR_040_Rx
            DET_RCS_037_Rx_oRDR_FUSION_DET_037_040_oPCAN_RADAR_78fcaf86_Rx: ComBitPosition=128, ComBitSize=8, ComSignalType=UINT8, ComSystemTemplateSystemSignalRef=DET_RCS_037_Rx
            DET_RCS_038_Rx_oRDR_FUSION_DET_037_040_oPCAN_RADAR_f8b2dd2e_Rx: ComBitPosition=240, ComBitSize=8, ComSignalType=UINT8, ComSystemTemplateSystemSignalRef=DET_RCS_038_Rx
            DET_RCS_039_Rx_oRDR_FUSION_DET_037_040_oPCAN_RADAR_57f64f69_Rx: ComBitPosition=352, ComBitSize=8, ComSignalType=UINT8, ComSystemTemplateSystemSignalRef=DET_RCS_039_Rx
            DET_RCS_040_Rx_oRDR_FUSION_DET_037_040_oPCAN_RADAR_7734a575_Rx: ComBitPosition=464, ComBitSize=8, ComSignalType=UINT8, ComSystemTemplateSystemSignalRef=DET_RCS_040_Rx
            DET_SNR_037_Rx_oRDR_FUSION_DET_037_040_oPCAN_RADAR_71a6de6f_Rx: ComBitPosition=120, ComBitSize=8, ComSignalType=UINT8, ComSystemTemplateSystemSignalRef=DET_SNR_037_Rx
            DET_SNR_038_Rx_oRDR_FUSION_DET_037_040_oPCAN_RADAR_f1e8acc7_Rx: ComBitPosition=232, ComBitSize=8, ComSignalType=UINT8, ComSystemTemplateSystemSignalRef=DET_SNR_038_Rx
            DET_SNR_039_Rx_oRDR_FUSION_DET_037_040_oPCAN_RADAR_5eac3e80_Rx: ComBitPosition=344, ComBitSize=8, ComSignalType=UINT8, ComSystemTemplateSystemSignalRef=DET_SNR_039_Rx
            DET_SNR_040_Rx_oRDR_FUSION_DET_037_040_oPCAN_RADAR_7e6ed49c_Rx: ComBitPosition=456, ComBitSize=8, ComSignalType=UINT8, ComSystemTemplateSystemSignalRef=DET_SNR_040_Rx
            DET_SUPER_RES_TARGET_037_Rx_oRDR_FUSION_DET_037_040_oPCAN_RADAR_ba5dff6f_Rx: ComBitPosition=87, ComBitSize=1, ComSignalType=BOOLEAN, ComSystemTemplateSystemSignalRef=DET_SUPER_RES_TARGET_037_Rx
            DET_SUPER_RES_TARGET_038_Rx_oRDR_FUSION_DET_037_040_oPCAN_RADAR_3a138dc7_Rx: ComBitPosition=199, ComBitSize=1, ComSignalType=BOOLEAN, ComSystemTemplateSystemSignalRef=DET_SUPER_RES_TARGET_038_Rx
            DET_SUPER_RES_TARGET_039_Rx_oRDR_FUSION_DET_037_040_oPCAN_RADAR_95571f80_Rx: ComBitPosition=311, ComBitSize=1, ComSignalType=BOOLEAN, ComSystemTemplateSystemSignalRef=DET_SUPER_RES_TARGET_039_Rx
            DET_SUPER_RES_TARGET_040_Rx_oRDR_FUSION_DET_037_040_oPCAN_RADAR_b595f59c_Rx: ComBitPosition=423, ComBitSize=1, ComSignalType=BOOLEAN, ComSystemTemplateSystemSignalRef=DET_SUPER_RES_TARGET_040_Rx
        SG_Fusion_Detections_041_044_oRDR_FUSION_DET_041_044_oPCAN_RADAR_eab931b2_Rx: ComTimeout=0, ComSystemTemplateSignalGroupRef=SG_Fusion_Detections_041_044
          83 x ComGroupSignal, all with ComSignalEndianness=LITTLE_ENDIAN, ComSignalInitValue=0:
            DET_AZIMUTH_041_Rx_oRDR_FUSION_DET_041_044_oPCAN_RADAR_5d2bad0a_Rx: ComBitPosition=88, ComBitSize=13, ComSignalType=UINT16, ComSystemTemplateSystemSignalRef=DET_AZIMUTH_041_Rx
            DET_AZIMUTH_042_Rx_oRDR_FUSION_DET_041_044_oPCAN_RADAR_77971d82_Rx: ComBitPosition=200, ComBitSize=13, ComSignalType=UINT16, ComSystemTemplateSystemSignalRef=DET_AZIMUTH_042_Rx
            DET_AZIMUTH_043_Rx_oRDR_FUSION_DET_041_044_oPCAN_RADAR_d8d38fc5_Rx: ComBitPosition=312, ComBitSize=13, ComSignalType=UINT16, ComSystemTemplateSystemSignalRef=DET_AZIMUTH_043_Rx
            DET_AZIMUTH_044_Rx_oRDR_FUSION_DET_041_044_oPCAN_RADAR_22ee7c92_Rx: ComBitPosition=424, ComBitSize=13, ComSignalType=UINT16, ComSystemTemplateSystemSignalRef=DET_AZIMUTH_044_Rx
            DET_AZIMUTH_ERR_041_Rx_oRDR_FUSION_DET_041_044_oPCAN_RADAR_5f420c88_Rx: ComBitPosition=105, ComBitSize=7, ComSignalType=UINT8, ComSystemTemplateSystemSignalRef=DET_AZIMUTH_ERR_041_Rx
            DET_AZIMUTH_ERR_042_Rx_oRDR_FUSION_DET_041_044_oPCAN_RADAR_75febc00_Rx: ComBitPosition=217, ComBitSize=7, ComSignalType=UINT8, ComSystemTemplateSystemSignalRef=DET_AZIMUTH_ERR_042_Rx
            DET_AZIMUTH_ERR_043_Rx_oRDR_FUSION_DET_041_044_oPCAN_RADAR_daba2e47_Rx: ComBitPosition=329, ComBitSize=7, ComSignalType=UINT8, ComSystemTemplateSystemSignalRef=DET_AZIMUTH_ERR_043_Rx
            DET_AZIMUTH_ERR_044_Rx_oRDR_FUSION_DET_041_044_oPCAN_RADAR_2087dd10_Rx: ComBitPosition=441, ComBitSize=7, ComSignalType=UINT8, ComSystemTemplateSystemSignalRef=DET_AZIMUTH_ERR_044_Rx
            DET_BELOW_RAIN_THOLD_041_Rx_oRDR_FUSION_DET_041_044_oPCAN_RADAR_3b9152bf_Rx: ComBitPosition=39, ComBitSize=1, ComSignalType=BOOLEAN, ComSystemTemplateSystemSignalRef=DET_BELOW_RAIN_THOLD_041_Rx
            DET_BELOW_RAIN_THOLD_042_Rx_oRDR_FUSION_DET_041_044_oPCAN_RADAR_112de237_Rx: ComBitPosition=151, ComBitSize=1, ComSignalType=BOOLEAN, ComSystemTemplateSystemSignalRef=DET_BELOW_RAIN_THOLD_042_Rx
            DET_BELOW_RAIN_THOLD_043_Rx_oRDR_FUSION_DET_041_044_oPCAN_RADAR_be697070_Rx: ComBitPosition=263, ComBitSize=1, ComSignalType=BOOLEAN, ComSystemTemplateSystemSignalRef=DET_BELOW_RAIN_THOLD_043_Rx
            DET_BELOW_RAIN_THOLD_044_Rx_oRDR_FUSION_DET_041_044_oPCAN_RADAR_44548327_Rx: ComBitPosition=375, ComBitSize=1, ComSignalType=BOOLEAN, ComSystemTemplateSystemSignalRef=DET_BELOW_RAIN_THOLD_044_Rx
            DET_BI_STATIC_FLAG_041_Rx_oRDR_FUSION_DET_041_044_oPCAN_RADAR_4c0ff9ac_Rx: ComBitPosition=104, ComBitSize=1, ComSignalType=BOOLEAN, ComSystemTemplateSystemSignalRef=DET_BI_STATIC_FLAG_041_Rx
            DET_BI_STATIC_FLAG_042_Rx_oRDR_FUSION_DET_041_044_oPCAN_RADAR_66b34924_Rx: ComBitPosition=216, ComBitSize=1, ComSignalType=BOOLEAN, ComSystemTemplateSystemSignalRef=DET_BI_STATIC_FLAG_042_Rx
            DET_BI_STATIC_FLAG_043_Rx_oRDR_FUSION_DET_041_044_oPCAN_RADAR_c9f7db63_Rx: ComBitPosition=328, ComBitSize=1, ComSignalType=BOOLEAN, ComSystemTemplateSystemSignalRef=DET_BI_STATIC_FLAG_043_Rx
            DET_BI_STATIC_FLAG_044_Rx_oRDR_FUSION_DET_041_044_oPCAN_RADAR_33ca2834_Rx: ComBitPosition=440, ComBitSize=1, ComSignalType=BOOLEAN, ComSystemTemplateSystemSignalRef=DET_BI_STATIC_FLAG_044_Rx
            DET_CONFD_AZIMUTH_041_Rx_oRDR_FUSION_DET_041_044_oPCAN_RADAR_af6613f8_Rx: ComBitPosition=118, ComBitSize=2, ComSignalType=UINT8, ComSystemTemplateSystemSignalRef=DET_CONFD_AZIMUTH_041_Rx
            DET_CONFD_AZIMUTH_042_Rx_oRDR_FUSION_DET_041_044_oPCAN_RADAR_85daa370_Rx: ComBitPosition=230, ComBitSize=2, ComSignalType=UINT8, ComSystemTemplateSystemSignalRef=DET_CONFD_AZIMUTH_042_Rx
            DET_CONFD_AZIMUTH_043_Rx_oRDR_FUSION_DET_041_044_oPCAN_RADAR_2a9e3137_Rx: ComBitPosition=342, ComBitSize=2, ComSignalType=UINT8, ComSystemTemplateSystemSignalRef=DET_CONFD_AZIMUTH_043_Rx
            DET_CONFD_AZIMUTH_044_Rx_oRDR_FUSION_DET_041_044_oPCAN_RADAR_d0a3c260_Rx: ComBitPosition=454, ComBitSize=2, ComSignalType=UINT8, ComSystemTemplateSystemSignalRef=DET_CONFD_AZIMUTH_044_Rx
            DET_CONFD_ELEVATION_041_Rx_oRDR_FUSION_DET_041_044_oPCAN_RADAR_a547907f_Rx: ComBitPosition=101, ComBitSize=2, ComSignalType=UINT8, ComSystemTemplateSystemSignalRef=DET_CONFD_ELEVATION_041_Rx
            DET_CONFD_ELEVATION_042_Rx_oRDR_FUSION_DET_041_044_oPCAN_RADAR_8ffb20f7_Rx: ComBitPosition=213, ComBitSize=2, ComSignalType=UINT8, ComSystemTemplateSystemSignalRef=DET_CONFD_ELEVATION_042_Rx
            DET_CONFD_ELEVATION_043_Rx_oRDR_FUSION_DET_041_044_oPCAN_RADAR_20bfb2b0_Rx: ComBitPosition=325, ComBitSize=2, ComSignalType=UINT8, ComSystemTemplateSystemSignalRef=DET_CONFD_ELEVATION_043_Rx
            DET_CONFD_ELEVATION_044_Rx_oRDR_FUSION_DET_041_044_oPCAN_RADAR_da8241e7_Rx: ComBitPosition=437, ComBitSize=2, ComSignalType=UINT8, ComSystemTemplateSystemSignalRef=DET_CONFD_ELEVATION_044_Rx
            DET_ELEVATION_041_Rx_oRDR_FUSION_DET_041_044_oPCAN_RADAR_af147f86_Rx: ComBitPosition=72, ComBitSize=8, ComSignalType=UINT8, ComSystemTemplateSystemSignalRef=DET_ELEVATION_041_Rx
            DET_ELEVATION_042_Rx_oRDR_FUSION_DET_041_044_oPCAN_RADAR_85a8cf0e_Rx: ComBitPosition=184, ComBitSize=8, ComSignalType=UINT8, ComSystemTemplateSystemSignalRef=DET_ELEVATION_042_Rx
            DET_ELEVATION_043_Rx_oRDR_FUSION_DET_041_044_oPCAN_RADAR_2aec5d49_Rx: ComBitPosition=296, ComBitSize=8, ComSignalType=UINT8, ComSystemTemplateSystemSignalRef=DET_ELEVATION_043_Rx
            DET_ELEVATION_044_Rx_oRDR_FUSION_DET_041_044_oPCAN_RADAR_d0d1ae1e_Rx: ComBitPosition=408, ComBitSize=8, ComSignalType=UINT8, ComSystemTemplateSystemSignalRef=DET_ELEVATION_044_Rx
            DET_ELEVATION_ERR_041_Rx_oRDR_FUSION_DET_041_044_oPCAN_RADAR_7dad5d59_Rx: ComBitPosition=80, ComBitSize=6, ComSignalType=UINT8, ComSystemTemplateSystemSignalRef=DET_ELEVATION_ERR_041_Rx
            DET_ELEVATION_ERR_042_Rx_oRDR_FUSION_DET_041_044_oPCAN_RADAR_5711edd1_Rx: ComBitPosition=192, ComBitSize=6, ComSignalType=UINT8, ComSystemTemplateSystemSignalRef=DET_ELEVATION_ERR_042_Rx
            DET_ELEVATION_ERR_043_Rx_oRDR_FUSION_DET_041_044_oPCAN_RADAR_f8557f96_Rx: ComBitPosition=304, ComBitSize=6, ComSignalType=UINT8, ComSystemTemplateSystemSignalRef=DET_ELEVATION_ERR_043_Rx
            DET_ELEVATION_ERR_044_Rx_oRDR_FUSION_DET_041_044_oPCAN_RADAR_02688cc1_Rx: ComBitPosition=416, ComBitSize=6, ComSignalType=UINT8, ComSystemTemplateSystemSignalRef=DET_ELEVATION_ERR_044_Rx
            DET_EXISTENCE_PROB_041_Rx_oRDR_FUSION_DET_041_044_oPCAN_RADAR_8ab525cc_Rx: ComBitPosition=112, ComBitSize=6, ComSignalType=UINT8, ComSystemTemplateSystemSignalRef=DET_EXISTENCE_PROB_041_Rx
            DET_EXISTENCE_PROB_042_Rx_oRDR_FUSION_DET_041_044_oPCAN_RADAR_a0099544_Rx: ComBitPosition=224, ComBitSize=6, ComSignalType=UINT8, ComSystemTemplateSystemSignalRef=DET_EXISTENCE_PROB_042_Rx
            DET_EXISTENCE_PROB_043_Rx_oRDR_FUSION_DET_041_044_oPCAN_RADAR_0f4d0703_Rx: ComBitPosition=336, ComBitSize=6, ComSignalType=UINT8, ComSystemTemplateSystemSignalRef=DET_EXISTENCE_PROB_043_Rx
            DET_EXISTENCE_PROB_044_Rx_oRDR_FUSION_DET_041_044_oPCAN_RADAR_f570f454_Rx: ComBitPosition=448, ComBitSize=6, ComSignalType=UINT8, ComSystemTemplateSystemSignalRef=DET_EXISTENCE_PROB_044_Rx
            DET_HVC_FLAG_041_Rx_oRDR_FUSION_DET_041_044_oPCAN_RADAR_576bc883_Rx: ComBitPosition=86, ComBitSize=1, ComSignalType=BOOLEAN, ComSystemTemplateSystemSignalRef=DET_HVC_FLAG_041_Rx
            DET_HVC_FLAG_042_Rx_oRDR_FUSION_DET_041_044_oPCAN_RADAR_7dd7780b_Rx: ComBitPosition=198, ComBitSize=1, ComSignalType=BOOLEAN, ComSystemTemplateSystemSignalRef=DET_HVC_FLAG_042_Rx
            DET_HVC_FLAG_043_Rx_oRDR_FUSION_DET_041_044_oPCAN_RADAR_d293ea4c_Rx: ComBitPosition=310, ComBitSize=1, ComSignalType=BOOLEAN, ComSystemTemplateSystemSignalRef=DET_HVC_FLAG_043_Rx
            DET_HVC_FLAG_044_Rx_oRDR_FUSION_DET_041_044_oPCAN_RADAR_28ae191b_Rx: ComBitPosition=422, ComBitSize=1, ComSignalType=BOOLEAN, ComSystemTemplateSystemSignalRef=DET_HVC_FLAG_044_Rx
            DET_IDM_041_Rx_oRDR_FUSION_DET_041_044_oPCAN_RADAR_62aa31cb_Rx: ComBitPosition=63, ComBitSize=1, ComSignalType=BOOLEAN, ComSystemTemplateSystemSignalRef=DET_IDM_041_Rx
            DET_IDM_042_Rx_oRDR_FUSION_DET_041_044_oPCAN_RADAR_48168143_Rx: ComBitPosition=175, ComBitSize=1, ComSignalType=BOOLEAN, ComSystemTemplateSystemSignalRef=DET_IDM_042_Rx
            DET_IDM_043_Rx_oRDR_FUSION_DET_041_044_oPCAN_RADAR_e7521304_Rx: ComBitPosition=287, ComBitSize=1, ComSignalType=BOOLEAN, ComSystemTemplateSystemSignalRef=DET_IDM_043_Rx
            DET_IDM_044_Rx_oRDR_FUSION_DET_041_044_oPCAN_RADAR_1d6fe053_Rx: ComBitPosition=399, ComBitSize=1, ComSignalType=BOOLEAN, ComSystemTemplateSystemSignalRef=DET_IDM_044_Rx
            DET_MH_CRC16_041_044_Rx_oRDR_FUSION_DET_041_044_oPCAN_RADAR_98836a69_Rx: ComBitPosition=0, ComBitSize=16, ComSignalType=UINT16, ComSystemTemplateSystemSignalRef=DET_MH_CRC16_041_044_Rx
            DET_MH_CYCLE_COUNTER_041_044_Rx_oRDR_FUSION_DET_041_044_oPCAN_RADAR_955857ac_Rx: ComBitPosition=16, ComBitSize=8, ComSignalType=UINT8, ComSystemTemplateSystemSignalRef=DET_MH_CYCLE_COUNTER_041_044_Rx
            DET_MH_SCAN_INDEX_4LSB_041_044_Rx_oRDR_FUSION_DET_041_044_oPCAN_RADAR_f1e89897_Rx: ComBitPosition=476, ComBitSize=4, ComSignalType=UINT8, ComSystemTemplateSystemSignalRef=DET_MH_SCAN_INDEX_4LSB_041_044_Rx
            DET_MTD_041_Rx_oRDR_FUSION_DET_041_044_oPCAN_RADAR_df2907bb_Rx: ComBitPosition=47, ComBitSize=1, ComSignalType=BOOLEAN, ComSystemTemplateSystemSignalRef=DET_MTD_041_Rx
            DET_MTD_042_Rx_oRDR_FUSION_DET_041_044_oPCAN_RADAR_f595b733_Rx: ComBitPosition=159, ComBitSize=1, ComSignalType=BOOLEAN, ComSystemTemplateSystemSignalRef=DET_MTD_042_Rx
            DET_MTD_043_Rx_oRDR_FUSION_DET_041_044_oPCAN_RADAR_5ad12574_Rx: ComBitPosition=271, ComBitSize=1, ComSignalType=BOOLEAN, ComSystemTemplateSystemSignalRef=DET_MTD_043_Rx
            DET_MTD_044_Rx_oRDR_FUSION_DET_041_044_oPCAN_RADAR_a0ecd623_Rx: ComBitPosition=383, ComBitSize=1, ComSignalType=BOOLEAN, ComSystemTemplateSystemSignalRef=DET_MTD_044_Rx
            DET_PROB_1STAZHYPO_041_Rx_oRDR_FUSION_DET_041_044_oPCAN_RADAR_1550193a_Rx: ComBitPosition=103, ComBitSize=1, ComSignalType=BOOLEAN, ComSystemTemplateSystemSignalRef=DET_PROB_1STAZHYPO_041_Rx
            DET_PROB_1STAZHYPO_042_Rx_oRDR_FUSION_DET_041_044_oPCAN_RADAR_3feca9b2_Rx: ComBitPosition=215, ComBitSize=1, ComSignalType=BOOLEAN, ComSystemTemplateSystemSignalRef=DET_PROB_1STAZHYPO_042_Rx
            DET_PROB_1STAZHYPO_043_Rx_oRDR_FUSION_DET_041_044_oPCAN_RADAR_90a83bf5_Rx: ComBitPosition=327, ComBitSize=1, ComSignalType=BOOLEAN, ComSystemTemplateSystemSignalRef=DET_PROB_1STAZHYPO_043_Rx
            DET_PROB_1STAZHYPO_044_Rx_oRDR_FUSION_DET_041_044_oPCAN_RADAR_6a95c8a2_Rx: ComBitPosition=439, ComBitSize=1, ComSignalType=BOOLEAN, ComSystemTemplateSystemSignalRef=DET_PROB_1STAZHYPO_044_Rx
            DET_RANGE_041_Rx_oRDR_FUSION_DET_041_044_oPCAN_RADAR_4eedf12d_Rx: ComBitPosition=24, ComBitSize=15, ComSignalType=UINT16, ComSystemTemplateSystemSignalRef=DET_RANGE_041_Rx
            DET_RANGE_042_Rx_oRDR_FUSION_DET_041_044_oPCAN_RADAR_645141a5_Rx: ComBitPosition=136, ComBitSize=15, ComSignalType=UINT16, ComSystemTemplateSystemSignalRef=DET_RANGE_042_Rx
            DET_RANGE_043_Rx_oRDR_FUSION_DET_041_044_oPCAN_RADAR_cb15d3e2_Rx: ComBitPosition=248, ComBitSize=15, ComSignalType=UINT16, ComSystemTemplateSystemSignalRef=DET_RANGE_043_Rx
            DET_RANGE_044_Rx_oRDR_FUSION_DET_041_044_oPCAN_RADAR_312820b5_Rx: ComBitPosition=360, ComBitSize=15, ComSignalType=UINT16, ComSystemTemplateSystemSignalRef=DET_RANGE_044_Rx
            DET_RANGE_ERR_041_Rx_oRDR_FUSION_DET_041_044_oPCAN_RADAR_1e1f7dcd_Rx: ComBitPosition=40, ComBitSize=7, ComSignalType=UINT8, ComSystemTemplateSystemSignalRef=DET_RANGE_ERR_041_Rx
            DET_RANGE_ERR_042_Rx_oRDR_FUSION_DET_041_044_oPCAN_RADAR_34a3cd45_Rx: ComBitPosition=152, ComBitSize=7, ComSignalType=UINT8, ComSystemTemplateSystemSignalRef=DET_RANGE_ERR_042_Rx
            DET_RANGE_ERR_043_Rx_oRDR_FUSION_DET_041_044_oPCAN_RADAR_9be75f02_Rx: ComBitPosition=264, ComBitSize=7, ComSignalType=UINT8, ComSystemTemplateSystemSignalRef=DET_RANGE_ERR_043_Rx
            DET_RANGE_ERR_044_Rx_oRDR_FUSION_DET_041_044_oPCAN_RADAR_61daac55_Rx: ComBitPosition=376, ComBitSize=7, ComSignalType=UINT8, ComSystemTemplateSystemSignalRef=DET_RANGE_ERR_044_Rx
            DET_RANGE_VELOCITY_041_Rx_oRDR_FUSION_DET_041_044_oPCAN_RADAR_931872d3_Rx: ComBitPosition=48, ComBitSize=15, ComSignalType=UINT16, ComSystemTemplateSystemSignalRef=DET_RANGE_VELOCITY_041_Rx
            DET_RANGE_VELOCITY_042_Rx_oRDR_FUSION_DET_041_044_oPCAN_RADAR_b9a4c25b_Rx: ComBitPosition=160, ComBitSize=15, ComSignalType=UINT16, ComSystemTemplateSystemSignalRef=DET_RANGE_VELOCITY_042_Rx
            DET_RANGE_VELOCITY_043_Rx_oRDR_FUSION_DET_041_044_oPCAN_RADAR_16e0501c_Rx: ComBitPosition=272, ComBitSize=15, ComSignalType=UINT16, ComSystemTemplateSystemSignalRef=DET_RANGE_VELOCITY_043_Rx
            DET_RANGE_VELOCITY_044_Rx_oRDR_FUSION_DET_041_044_oPCAN_RADAR_ecdda34b_Rx: ComBitPosition=384, ComBitSize=15, ComSignalType=UINT16, ComSystemTemplateSystemSignalRef=DET_RANGE_VELOCITY_044_Rx
            DET_RANGE_VELOCITY_ERR_041_Rx_oRDR_FUSION_DET_041_044_oPCAN_RADAR_0a7c0211_Rx: ComBitPosition=64, ComBitSize=8, ComSignalType=UINT8, ComSystemTemplateSystemSignalRef=DET_RANGE_VELOCITY_ERR_041_Rx
            DET_RANGE_VELOCITY_ERR_042_Rx_oRDR_FUSION_DET_041_044_oPCAN_RADAR_20c0b299_Rx: ComBitPosition=176, ComBitSize=8, ComSignalType=UINT8, ComSystemTemplateSystemSignalRef=DET_RANGE_VELOCITY_ERR_042_Rx
            DET_RANGE_VELOCITY_ERR_043_Rx_oRDR_FUSION_DET_041_044_oPCAN_RADAR_8f8420de_Rx: ComBitPosition=288, ComBitSize=8, ComSignalType=UINT8, ComSystemTemplateSystemSignalRef=DET_RANGE_VELOCITY_ERR_043_Rx
            DET_RANGE_VELOCITY_ERR_044_Rx_oRDR_FUSION_DET_041_044_oPCAN_RADAR_75b9d389_Rx: ComBitPosition=400, ComBitSize=8, ComSignalType=UINT8, ComSystemTemplateSystemSignalRef=DET_RANGE_VELOCITY_ERR_044_Rx
            DET_RCS_041_Rx_oRDR_FUSION_DET_041_044_oPCAN_RADAR_5ed3e0c8_Rx: ComBitPosition=128, ComBitSize=8, ComSignalType=UINT8, ComSystemTemplateSystemSignalRef=DET_RCS_041_Rx
            DET_RCS_042_Rx_oRDR_FUSION_DET_041_044_oPCAN_RADAR_746f5040_Rx: ComBitPosition=240, ComBitSize=8, ComSignalType=UINT8, ComSystemTemplateSystemSignalRef=DET_RCS_042_Rx
            DET_RCS_043_Rx_oRDR_FUSION_DET_041_044_oPCAN_RADAR_db2bc207_Rx: ComBitPosition=352, ComBitSize=8, ComSignalType=UINT8, ComSystemTemplateSystemSignalRef=DET_RCS_043_Rx
            DET_RCS_044_Rx_oRDR_FUSION_DET_041_044_oPCAN_RADAR_21163150_Rx: ComBitPosition=464, ComBitSize=8, ComSignalType=UINT8, ComSystemTemplateSystemSignalRef=DET_RCS_044_Rx
            DET_SNR_041_Rx_oRDR_FUSION_DET_041_044_oPCAN_RADAR_57899121_Rx: ComBitPosition=120, ComBitSize=8, ComSignalType=UINT8, ComSystemTemplateSystemSignalRef=DET_SNR_041_Rx
            DET_SNR_042_Rx_oRDR_FUSION_DET_041_044_oPCAN_RADAR_7d3521a9_Rx: ComBitPosition=232, ComBitSize=8, ComSignalType=UINT8, ComSystemTemplateSystemSignalRef=DET_SNR_042_Rx
            DET_SNR_043_Rx_oRDR_FUSION_DET_041_044_oPCAN_RADAR_d271b3ee_Rx: ComBitPosition=344, ComBitSize=8, ComSignalType=UINT8, ComSystemTemplateSystemSignalRef=DET_SNR_043_Rx
            DET_SNR_044_Rx_oRDR_FUSION_DET_041_044_oPCAN_RADAR_284c40b9_Rx: ComBitPosition=456, ComBitSize=8, ComSignalType=UINT8, ComSystemTemplateSystemSignalRef=DET_SNR_044_Rx
            DET_SUPER_RES_TARGET_041_Rx_oRDR_FUSION_DET_041_044_oPCAN_RADAR_9c72b021_Rx: ComBitPosition=87, ComBitSize=1, ComSignalType=BOOLEAN, ComSystemTemplateSystemSignalRef=DET_SUPER_RES_TARGET_041_Rx
            DET_SUPER_RES_TARGET_042_Rx_oRDR_FUSION_DET_041_044_oPCAN_RADAR_b6ce00a9_Rx: ComBitPosition=199, ComBitSize=1, ComSignalType=BOOLEAN, ComSystemTemplateSystemSignalRef=DET_SUPER_RES_TARGET_042_Rx
            DET_SUPER_RES_TARGET_043_Rx_oRDR_FUSION_DET_041_044_oPCAN_RADAR_198a92ee_Rx: ComBitPosition=311, ComBitSize=1, ComSignalType=BOOLEAN, ComSystemTemplateSystemSignalRef=DET_SUPER_RES_TARGET_043_Rx
            DET_SUPER_RES_TARGET_044_Rx_oRDR_FUSION_DET_041_044_oPCAN_RADAR_e3b761b9_Rx: ComBitPosition=423, ComBitSize=1, ComSignalType=BOOLEAN, ComSystemTemplateSystemSignalRef=DET_SUPER_RES_TARGET_044_Rx
        SG_Fusion_Detections_045_048_oRDR_FUSION_DET_045_048_oPCAN_RADAR_a7421a41_Rx: ComTimeout=0, ComSystemTemplateSignalGroupRef=SG_Fusion_Detections_045_048
          83 x ComGroupSignal, all with ComSignalEndianness=LITTLE_ENDIAN, ComSignalInitValue=0:
            DET_AZIMUTH_045_Rx_oRDR_FUSION_DET_045_048_oPCAN_RADAR_641870e1_Rx: ComBitPosition=88, ComBitSize=13, ComSignalType=UINT16, ComSystemTemplateSystemSignalRef=DET_AZIMUTH_045_Rx
            DET_AZIMUTH_046_Rx_oRDR_FUSION_DET_045_048_oPCAN_RADAR_4ea4c069_Rx: ComBitPosition=200, ComBitSize=13, ComSignalType=UINT16, ComSystemTemplateSystemSignalRef=DET_AZIMUTH_046_Rx
            DET_AZIMUTH_047_Rx_oRDR_FUSION_DET_045_048_oPCAN_RADAR_e1e0522e_Rx: ComBitPosition=312, ComBitSize=13, ComSignalType=UINT16, ComSystemTemplateSystemSignalRef=DET_AZIMUTH_047_Rx
            DET_AZIMUTH_048_Rx_oRDR_FUSION_DET_045_048_oPCAN_RADAR_61ae2086_Rx: ComBitPosition=424, ComBitSize=13, ComSignalType=UINT16, ComSystemTemplateSystemSignalRef=DET_AZIMUTH_048_Rx
            DET_AZIMUTH_ERR_045_Rx_oRDR_FUSION_DET_045_048_oPCAN_RADAR_6671d163_Rx: ComBitPosition=105, ComBitSize=7, ComSignalType=UINT8, ComSystemTemplateSystemSignalRef=DET_AZIMUTH_ERR_045_Rx
            DET_AZIMUTH_ERR_046_Rx_oRDR_FUSION_DET_045_048_oPCAN_RADAR_4ccd61eb_Rx: ComBitPosition=217, ComBitSize=7, ComSignalType=UINT8, ComSystemTemplateSystemSignalRef=DET_AZIMUTH_ERR_046_Rx
            DET_AZIMUTH_ERR_047_Rx_oRDR_FUSION_DET_045_048_oPCAN_RADAR_e389f3ac_Rx: ComBitPosition=329, ComBitSize=7, ComSignalType=UINT8, ComSystemTemplateSystemSignalRef=DET_AZIMUTH_ERR_047_Rx
            DET_AZIMUTH_ERR_048_Rx_oRDR_FUSION_DET_045_048_oPCAN_RADAR_63c78104_Rx: ComBitPosition=441, ComBitSize=7, ComSignalType=UINT8, ComSystemTemplateSystemSignalRef=DET_AZIMUTH_ERR_048_Rx
            DET_BELOW_RAIN_THOLD_045_Rx_oRDR_FUSION_DET_045_048_oPCAN_RADAR_02a28f54_Rx: ComBitPosition=39, ComBitSize=1, ComSignalType=BOOLEAN, ComSystemTemplateSystemSignalRef=DET_BELOW_RAIN_THOLD_045_Rx
            DET_BELOW_RAIN_THOLD_046_Rx_oRDR_FUSION_DET_045_048_oPCAN_RADAR_281e3fdc_Rx: ComBitPosition=151, ComBitSize=1, ComSignalType=BOOLEAN, ComSystemTemplateSystemSignalRef=DET_BELOW_RAIN_THOLD_046_Rx
            DET_BELOW_RAIN_THOLD_047_Rx_oRDR_FUSION_DET_045_048_oPCAN_RADAR_875aad9b_Rx: ComBitPosition=263, ComBitSize=1, ComSignalType=BOOLEAN, ComSystemTemplateSystemSignalRef=DET_BELOW_RAIN_THOLD_047_Rx
            DET_BELOW_RAIN_THOLD_048_Rx_oRDR_FUSION_DET_045_048_oPCAN_RADAR_0714df33_Rx: ComBitPosition=375, ComBitSize=1, ComSignalType=BOOLEAN, ComSystemTemplateSystemSignalRef=DET_BELOW_RAIN_THOLD_048_Rx
            DET_BI_STATIC_FLAG_045_Rx_oRDR_FUSION_DET_045_048_oPCAN_RADAR_753c2447_Rx: ComBitPosition=104, ComBitSize=1, ComSignalType=BOOLEAN, ComSystemTemplateSystemSignalRef=DET_BI_STATIC_FLAG_045_Rx
            DET_BI_STATIC_FLAG_046_Rx_oRDR_FUSION_DET_045_048_oPCAN_RADAR_5f8094cf_Rx: ComBitPosition=216, ComBitSize=1, ComSignalType=BOOLEAN, ComSystemTemplateSystemSignalRef=DET_BI_STATIC_FLAG_046_Rx
            DET_BI_STATIC_FLAG_047_Rx_oRDR_FUSION_DET_045_048_oPCAN_RADAR_f0c40688_Rx: ComBitPosition=328, ComBitSize=1, ComSignalType=BOOLEAN, ComSystemTemplateSystemSignalRef=DET_BI_STATIC_FLAG_047_Rx
            DET_BI_STATIC_FLAG_048_Rx_oRDR_FUSION_DET_045_048_oPCAN_RADAR_708a7420_Rx: ComBitPosition=440, ComBitSize=1, ComSignalType=BOOLEAN, ComSystemTemplateSystemSignalRef=DET_BI_STATIC_FLAG_048_Rx
            DET_CONFD_AZIMUTH_045_Rx_oRDR_FUSION_DET_045_048_oPCAN_RADAR_9655ce13_Rx: ComBitPosition=118, ComBitSize=2, ComSignalType=UINT8, ComSystemTemplateSystemSignalRef=DET_CONFD_AZIMUTH_045_Rx
            DET_CONFD_AZIMUTH_046_Rx_oRDR_FUSION_DET_045_048_oPCAN_RADAR_bce97e9b_Rx: ComBitPosition=230, ComBitSize=2, ComSignalType=UINT8, ComSystemTemplateSystemSignalRef=DET_CONFD_AZIMUTH_046_Rx
            DET_CONFD_AZIMUTH_047_Rx_oRDR_FUSION_DET_045_048_oPCAN_RADAR_13adecdc_Rx: ComBitPosition=342, ComBitSize=2, ComSignalType=UINT8, ComSystemTemplateSystemSignalRef=DET_CONFD_AZIMUTH_047_Rx
            DET_CONFD_AZIMUTH_048_Rx_oRDR_FUSION_DET_045_048_oPCAN_RADAR_93e39e74_Rx: ComBitPosition=454, ComBitSize=2, ComSignalType=UINT8, ComSystemTemplateSystemSignalRef=DET_CONFD_AZIMUTH_048_Rx
            DET_CONFD_ELEVATION_045_Rx_oRDR_FUSION_DET_045_048_oPCAN_RADAR_9c744d94_Rx: ComBitPosition=101, ComBitSize=2, ComSignalType=UINT8, ComSystemTemplateSystemSignalRef=DET_CONFD_ELEVATION_045_Rx
            DET_CONFD_ELEVATION_046_Rx_oRDR_FUSION_DET_045_048_oPCAN_RADAR_b6c8fd1c_Rx: ComBitPosition=213, ComBitSize=2, ComSignalType=UINT8, ComSystemTemplateSystemSignalRef=DET_CONFD_ELEVATION_046_Rx
            DET_CONFD_ELEVATION_047_Rx_oRDR_FUSION_DET_045_048_oPCAN_RADAR_198c6f5b_Rx: ComBitPosition=325, ComBitSize=2, ComSignalType=UINT8, ComSystemTemplateSystemSignalRef=DET_CONFD_ELEVATION_047_Rx
            DET_CONFD_ELEVATION_048_Rx_oRDR_FUSION_DET_045_048_oPCAN_RADAR_99c21df3_Rx: ComBitPosition=437, ComBitSize=2, ComSignalType=UINT8, ComSystemTemplateSystemSignalRef=DET_CONFD_ELEVATION_048_Rx
            DET_ELEVATION_045_Rx_oRDR_FUSION_DET_045_048_oPCAN_RADAR_9627a26d_Rx: ComBitPosition=72, ComBitSize=8, ComSignalType=UINT8, ComSystemTemplateSystemSignalRef=DET_ELEVATION_045_Rx
            DET_ELEVATION_046_Rx_oRDR_FUSION_DET_045_048_oPCAN_RADAR_bc9b12e5_Rx: ComBitPosition=184, ComBitSize=8, ComSignalType=UINT8, ComSystemTemplateSystemSignalRef=DET_ELEVATION_046_Rx
            DET_ELEVATION_047_Rx_oRDR_FUSION_DET_045_048_oPCAN_RADAR_13df80a2_Rx: ComBitPosition=296, ComBitSize=8, ComSignalType=UINT8, ComSystemTemplateSystemSignalRef=DET_ELEVATION_047_Rx
            DET_ELEVATION_048_Rx_oRDR_FUSION_DET_045_048_oPCAN_RADAR_9391f20a_Rx: ComBitPosition=408, ComBitSize=8, ComSignalType=UINT8, ComSystemTemplateSystemSignalRef=DET_ELEVATION_048_Rx
            DET_ELEVATION_ERR_045_Rx_oRDR_FUSION_DET_045_048_oPCAN_RADAR_449e80b2_Rx: ComBitPosition=80, ComBitSize=6, ComSignalType=UINT8, ComSystemTemplateSystemSignalRef=DET_ELEVATION_ERR_045_Rx
            DET_ELEVATION_ERR_046_Rx_oRDR_FUSION_DET_045_048_oPCAN_RADAR_6e22303a_Rx: ComBitPosition=192, ComBitSize=6, ComSignalType=UINT8, ComSystemTemplateSystemSignalRef=DET_ELEVATION_ERR_046_Rx
            DET_ELEVATION_ERR_047_Rx_oRDR_FUSION_DET_045_048_oPCAN_RADAR_c166a27d_Rx: ComBitPosition=304, ComBitSize=6, ComSignalType=UINT8, ComSystemTemplateSystemSignalRef=DET_ELEVATION_ERR_047_Rx
            DET_ELEVATION_ERR_048_Rx_oRDR_FUSION_DET_045_048_oPCAN_RADAR_4128d0d5_Rx: ComBitPosition=416, ComBitSize=6, ComSignalType=UINT8, ComSystemTemplateSystemSignalRef=DET_ELEVATION_ERR_048_Rx
            DET_EXISTENCE_PROB_045_Rx_oRDR_FUSION_DET_045_048_oPCAN_RADAR_b386f827_Rx: ComBitPosition=112, ComBitSize=6, ComSignalType=UINT8, ComSystemTemplateSystemSignalRef=DET_EXISTENCE_PROB_045_Rx
            DET_EXISTENCE_PROB_046_Rx_oRDR_FUSION_DET_045_048_oPCAN_RADAR_993a48af_Rx: ComBitPosition=224, ComBitSize=6, ComSignalType=UINT8, ComSystemTemplateSystemSignalRef=DET_EXISTENCE_PROB_046_Rx
            DET_EXISTENCE_PROB_047_Rx_oRDR_FUSION_DET_045_048_oPCAN_RADAR_367edae8_Rx: ComBitPosition=336, ComBitSize=6, ComSignalType=UINT8, ComSystemTemplateSystemSignalRef=DET_EXISTENCE_PROB_047_Rx
            DET_EXISTENCE_PROB_048_Rx_oRDR_FUSION_DET_045_048_oPCAN_RADAR_b630a840_Rx: ComBitPosition=448, ComBitSize=6, ComSignalType=UINT8, ComSystemTemplateSystemSignalRef=DET_EXISTENCE_PROB_048_Rx
            DET_HVC_FLAG_045_Rx_oRDR_FUSION_DET_045_048_oPCAN_RADAR_6e581568_Rx: ComBitPosition=86, ComBitSize=1, ComSignalType=BOOLEAN, ComSystemTemplateSystemSignalRef=DET_HVC_FLAG_045_Rx
            DET_HVC_FLAG_046_Rx_oRDR_FUSION_DET_045_048_oPCAN_RADAR_44e4a5e0_Rx: ComBitPosition=198, ComBitSize=1, ComSignalType=BOOLEAN, ComSystemTemplateSystemSignalRef=DET_HVC_FLAG_046_Rx
            DET_HVC_FLAG_047_Rx_oRDR_FUSION_DET_045_048_oPCAN_RADAR_eba037a7_Rx: ComBitPosition=310, ComBitSize=1, ComSignalType=BOOLEAN, ComSystemTemplateSystemSignalRef=DET_HVC_FLAG_047_Rx
            DET_HVC_FLAG_048_Rx_oRDR_FUSION_DET_045_048_oPCAN_RADAR_6bee450f_Rx: ComBitPosition=422, ComBitSize=1, ComSignalType=BOOLEAN, ComSystemTemplateSystemSignalRef=DET_HVC_FLAG_048_Rx
            DET_IDM_045_Rx_oRDR_FUSION_DET_045_048_oPCAN_RADAR_5b99ec20_Rx: ComBitPosition=63, ComBitSize=1, ComSignalType=BOOLEAN, ComSystemTemplateSystemSignalRef=DET_IDM_045_Rx
            DET_IDM_046_Rx_oRDR_FUSION_DET_045_048_oPCAN_RADAR_71255ca8_Rx: ComBitPosition=175, ComBitSize=1, ComSignalType=BOOLEAN, ComSystemTemplateSystemSignalRef=DET_IDM_046_Rx
            DET_IDM_047_Rx_oRDR_FUSION_DET_045_048_oPCAN_RADAR_de61ceef_Rx: ComBitPosition=287, ComBitSize=1, ComSignalType=BOOLEAN, ComSystemTemplateSystemSignalRef=DET_IDM_047_Rx
            DET_IDM_048_Rx_oRDR_FUSION_DET_045_048_oPCAN_RADAR_5e2fbc47_Rx: ComBitPosition=399, ComBitSize=1, ComSignalType=BOOLEAN, ComSystemTemplateSystemSignalRef=DET_IDM_048_Rx
            DET_MH_CRC16_045_048_Rx_oRDR_FUSION_DET_045_048_oPCAN_RADAR_7363d7f5_Rx: ComBitPosition=0, ComBitSize=16, ComSignalType=UINT16, ComSystemTemplateSystemSignalRef=DET_MH_CRC16_045_048_Rx
            DET_MH_CYCLE_COUNTER_045_048_Rx_oRDR_FUSION_DET_045_048_oPCAN_RADAR_7eb8ea30_Rx: ComBitPosition=16, ComBitSize=8, ComSignalType=UINT8, ComSystemTemplateSystemSignalRef=DET_MH_CYCLE_COUNTER_045_048_Rx
            DET_MH_SCAN_INDEX_4LSB_045_048_Rx_oRDR_FUSION_DET_045_048_oPCAN_RADAR_1a08250b_Rx: ComBitPosition=476, ComBitSize=4, ComSignalType=UINT8, ComSystemTemplateSystemSignalRef=DET_MH_SCAN_INDEX_4LSB_045_048_Rx
            DET_MTD_045_Rx_oRDR_FUSION_DET_045_048_oPCAN_RADAR_e61ada50_Rx: ComBitPosition=47, ComBitSize=1, ComSignalType=BOOLEAN, ComSystemTemplateSystemSignalRef=DET_MTD_045_Rx
            DET_MTD_046_Rx_oRDR_FUSION_DET_045_048_oPCAN_RADAR_cca66ad8_Rx: ComBitPosition=159, ComBitSize=1, ComSignalType=BOOLEAN, ComSystemTemplateSystemSignalRef=DET_MTD_046_Rx
            DET_MTD_047_Rx_oRDR_FUSION_DET_045_048_oPCAN_RADAR_63e2f89f_Rx: ComBitPosition=271, ComBitSize=1, ComSignalType=BOOLEAN, ComSystemTemplateSystemSignalRef=DET_MTD_047_Rx
            DET_MTD_048_Rx_oRDR_FUSION_DET_045_048_oPCAN_RADAR_e3ac8a37_Rx: ComBitPosition=383, ComBitSize=1, ComSignalType=BOOLEAN, ComSystemTemplateSystemSignalRef=DET_MTD_048_Rx
            DET_PROB_1STAZHYPO_045_Rx_oRDR_FUSION_DET_045_048_oPCAN_RADAR_2c63c4d1_Rx: ComBitPosition=103, ComBitSize=1, ComSignalType=BOOLEAN, ComSystemTemplateSystemSignalRef=DET_PROB_1STAZHYPO_045_Rx
            DET_PROB_1STAZHYPO_046_Rx_oRDR_FUSION_DET_045_048_oPCAN_RADAR_06df7459_Rx: ComBitPosition=215, ComBitSize=1, ComSignalType=BOOLEAN, ComSystemTemplateSystemSignalRef=DET_PROB_1STAZHYPO_046_Rx
            DET_PROB_1STAZHYPO_047_Rx_oRDR_FUSION_DET_045_048_oPCAN_RADAR_a99be61e_Rx: ComBitPosition=327, ComBitSize=1, ComSignalType=BOOLEAN, ComSystemTemplateSystemSignalRef=DET_PROB_1STAZHYPO_047_Rx
            DET_PROB_1STAZHYPO_048_Rx_oRDR_FUSION_DET_045_048_oPCAN_RADAR_29d594b6_Rx: ComBitPosition=439, ComBitSize=1, ComSignalType=BOOLEAN, ComSystemTemplateSystemSignalRef=DET_PROB_1STAZHYPO_048_Rx
            DET_RANGE_045_Rx_oRDR_FUSION_DET_045_048_oPCAN_RADAR_77de2cc6_Rx: ComBitPosition=24, ComBitSize=15, ComSignalType=UINT16, ComSystemTemplateSystemSignalRef=DET_RANGE_045_Rx
            DET_RANGE_046_Rx_oRDR_FUSION_DET_045_048_oPCAN_RADAR_5d629c4e_Rx: ComBitPosition=136, ComBitSize=15, ComSignalType=UINT16, ComSystemTemplateSystemSignalRef=DET_RANGE_046_Rx
            DET_RANGE_047_Rx_oRDR_FUSION_DET_045_048_oPCAN_RADAR_f2260e09_Rx: ComBitPosition=248, ComBitSize=15, ComSignalType=UINT16, ComSystemTemplateSystemSignalRef=DET_RANGE_047_Rx
            DET_RANGE_048_Rx_oRDR_FUSION_DET_045_048_oPCAN_RADAR_72687ca1_Rx: ComBitPosition=360, ComBitSize=15, ComSignalType=UINT16, ComSystemTemplateSystemSignalRef=DET_RANGE_048_Rx
            DET_RANGE_ERR_045_Rx_oRDR_FUSION_DET_045_048_oPCAN_RADAR_272ca026_Rx: ComBitPosition=40, ComBitSize=7, ComSignalType=UINT8, ComSystemTemplateSystemSignalRef=DET_RANGE_ERR_045_Rx
            DET_RANGE_ERR_046_Rx_oRDR_FUSION_DET_045_048_oPCAN_RADAR_0d9010ae_Rx: ComBitPosition=152, ComBitSize=7, ComSignalType=UINT8, ComSystemTemplateSystemSignalRef=DET_RANGE_ERR_046_Rx
            DET_RANGE_ERR_047_Rx_oRDR_FUSION_DET_045_048_oPCAN_RADAR_a2d482e9_Rx: ComBitPosition=264, ComBitSize=7, ComSignalType=UINT8, ComSystemTemplateSystemSignalRef=DET_RANGE_ERR_047_Rx
            DET_RANGE_ERR_048_Rx_oRDR_FUSION_DET_045_048_oPCAN_RADAR_229af041_Rx: ComBitPosition=376, ComBitSize=7, ComSignalType=UINT8, ComSystemTemplateSystemSignalRef=DET_RANGE_ERR_048_Rx
            DET_RANGE_VELOCITY_045_Rx_oRDR_FUSION_DET_045_048_oPCAN_RADAR_aa2baf38_Rx: ComBitPosition=48, ComBitSize=15, ComSignalType=UINT16, ComSystemTemplateSystemSignalRef=DET_RANGE_VELOCITY_045_Rx
            DET_RANGE_VELOCITY_046_Rx_oRDR_FUSION_DET_045_048_oPCAN_RADAR_80971fb0_Rx: ComBitPosition=160, ComBitSize=15, ComSignalType=UINT16, ComSystemTemplateSystemSignalRef=DET_RANGE_VELOCITY_046_Rx
            DET_RANGE_VELOCITY_047_Rx_oRDR_FUSION_DET_045_048_oPCAN_RADAR_2fd38df7_Rx: ComBitPosition=272, ComBitSize=15, ComSignalType=UINT16, ComSystemTemplateSystemSignalRef=DET_RANGE_VELOCITY_047_Rx
            DET_RANGE_VELOCITY_048_Rx_oRDR_FUSION_DET_045_048_oPCAN_RADAR_af9dff5f_Rx: ComBitPosition=384, ComBitSize=15, ComSignalType=UINT16, ComSystemTemplateSystemSignalRef=DET_RANGE_VELOCITY_048_Rx
            DET_RANGE_VELOCITY_ERR_045_Rx_oRDR_FUSION_DET_045_048_oPCAN_RADAR_334fdffa_Rx: ComBitPosition=64, ComBitSize=8, ComSignalType=UINT8, ComSystemTemplateSystemSignalRef=DET_RANGE_VELOCITY_ERR_045_Rx
            DET_RANGE_VELOCITY_ERR_046_Rx_oRDR_FUSION_DET_045_048_oPCAN_RADAR_19f36f72_Rx: ComBitPosition=176, ComBitSize=8, ComSignalType=UINT8, ComSystemTemplateSystemSignalRef=DET_RANGE_VELOCITY_ERR_046_Rx
            DET_RANGE_VELOCITY_ERR_047_Rx_oRDR_FUSION_DET_045_048_oPCAN_RADAR_b6b7fd35_Rx: ComBitPosition=288, ComBitSize=8, ComSignalType=UINT8, ComSystemTemplateSystemSignalRef=DET_RANGE_VELOCITY_ERR_047_Rx
            DET_RANGE_VELOCITY_ERR_048_Rx_oRDR_FUSION_DET_045_048_oPCAN_RADAR_36f98f9d_Rx: ComBitPosition=400, ComBitSize=8, ComSignalType=UINT8, ComSystemTemplateSystemSignalRef=DET_RANGE_VELOCITY_ERR_048_Rx
            DET_RCS_045_Rx_oRDR_FUSION_DET_045_048_oPCAN_RADAR_67e03d23_Rx: ComBitPosition=128, ComBitSize=8, ComSignalType=UINT8, ComSystemTemplateSystemSignalRef=DET_RCS_045_Rx
            DET_RCS_046_Rx_oRDR_FUSION_DET_045_048_oPCAN_RADAR_4d5c8dab_Rx: ComBitPosition=240, ComBitSize=8, ComSignalType=UINT8, ComSystemTemplateSystemSignalRef=DET_RCS_046_Rx
            DET_RCS_047_Rx_oRDR_FUSION_DET_045_048_oPCAN_RADAR_e2181fec_Rx: ComBitPosition=352, ComBitSize=8, ComSignalType=UINT8, ComSystemTemplateSystemSignalRef=DET_RCS_047_Rx
            DET_RCS_048_Rx_oRDR_FUSION_DET_045_048_oPCAN_RADAR_62566d44_Rx: ComBitPosition=464, ComBitSize=8, ComSignalType=UINT8, ComSystemTemplateSystemSignalRef=DET_RCS_048_Rx
            DET_SNR_045_Rx_oRDR_FUSION_DET_045_048_oPCAN_RADAR_6eba4cca_Rx: ComBitPosition=120, ComBitSize=8, ComSignalType=UINT8, ComSystemTemplateSystemSignalRef=DET_SNR_045_Rx
            DET_SNR_046_Rx_oRDR_FUSION_DET_045_048_oPCAN_RADAR_4406fc42_Rx: ComBitPosition=232, ComBitSize=8, ComSignalType=UINT8, ComSystemTemplateSystemSignalRef=DET_SNR_046_Rx
            DET_SNR_047_Rx_oRDR_FUSION_DET_045_048_oPCAN_RADAR_eb426e05_Rx: ComBitPosition=344, ComBitSize=8, ComSignalType=UINT8, ComSystemTemplateSystemSignalRef=DET_SNR_047_Rx
            DET_SNR_048_Rx_oRDR_FUSION_DET_045_048_oPCAN_RADAR_6b0c1cad_Rx: ComBitPosition=456, ComBitSize=8, ComSignalType=UINT8, ComSystemTemplateSystemSignalRef=DET_SNR_048_Rx
            DET_SUPER_RES_TARGET_045_Rx_oRDR_FUSION_DET_045_048_oPCAN_RADAR_a5416dca_Rx: ComBitPosition=87, ComBitSize=1, ComSignalType=BOOLEAN, ComSystemTemplateSystemSignalRef=DET_SUPER_RES_TARGET_045_Rx
            DET_SUPER_RES_TARGET_046_Rx_oRDR_FUSION_DET_045_048_oPCAN_RADAR_8ffddd42_Rx: ComBitPosition=199, ComBitSize=1, ComSignalType=BOOLEAN, ComSystemTemplateSystemSignalRef=DET_SUPER_RES_TARGET_046_Rx
            DET_SUPER_RES_TARGET_047_Rx_oRDR_FUSION_DET_045_048_oPCAN_RADAR_20b94f05_Rx: ComBitPosition=311, ComBitSize=1, ComSignalType=BOOLEAN, ComSystemTemplateSystemSignalRef=DET_SUPER_RES_TARGET_047_Rx
            DET_SUPER_RES_TARGET_048_Rx_oRDR_FUSION_DET_045_048_oPCAN_RADAR_a0f73dad_Rx: ComBitPosition=423, ComBitSize=1, ComSignalType=BOOLEAN, ComSystemTemplateSystemSignalRef=DET_SUPER_RES_TARGET_048_Rx
        SG_Fusion_Detections_049_052_oRDR_FUSION_DET_049_052_oPCAN_RADAR_25715fa9_Rx: ComTimeout=0, ComSystemTemplateSignalGroupRef=SG_Fusion_Detections_049_052
          83 x ComGroupSignal, all with ComSignalEndianness=LITTLE_ENDIAN, ComSignalInitValue=0:
            DET_AZIMUTH_049_Rx_oRDR_FUSION_DET_049_052_oPCAN_RADAR_fca25dc0_Rx: ComBitPosition=88, ComBitSize=13, ComSignalType=UINT16, ComSystemTemplateSystemSignalRef=DET_AZIMUTH_049_Rx
            DET_AZIMUTH_050_Rx_oRDR_FUSION_DET_049_052_oPCAN_RADAR_c182ded9_Rx: ComBitPosition=200, ComBitSize=13, ComSignalType=UINT16, ComSystemTemplateSystemSignalRef=DET_AZIMUTH_050_Rx
            DET_AZIMUTH_051_Rx_oRDR_FUSION_DET_049_052_oPCAN_RADAR_6ec64c9e_Rx: ComBitPosition=312, ComBitSize=13, ComSignalType=UINT16, ComSystemTemplateSystemSignalRef=DET_AZIMUTH_051_Rx
            DET_AZIMUTH_052_Rx_oRDR_FUSION_DET_049_052_oPCAN_RADAR_447afc16_Rx: ComBitPosition=424, ComBitSize=13, ComSignalType=UINT16, ComSystemTemplateSystemSignalRef=DET_AZIMUTH_052_Rx
            DET_AZIMUTH_ERR_049_Rx_oRDR_FUSION_DET_049_052_oPCAN_RADAR_fecbfc42_Rx: ComBitPosition=105, ComBitSize=7, ComSignalType=UINT8, ComSystemTemplateSystemSignalRef=DET_AZIMUTH_ERR_049_Rx
            DET_AZIMUTH_ERR_050_Rx_oRDR_FUSION_DET_049_052_oPCAN_RADAR_c3eb7f5b_Rx: ComBitPosition=217, ComBitSize=7, ComSignalType=UINT8, ComSystemTemplateSystemSignalRef=DET_AZIMUTH_ERR_050_Rx
            DET_AZIMUTH_ERR_051_Rx_oRDR_FUSION_DET_049_052_oPCAN_RADAR_6cafed1c_Rx: ComBitPosition=329, ComBitSize=7, ComSignalType=UINT8, ComSystemTemplateSystemSignalRef=DET_AZIMUTH_ERR_051_Rx
            DET_AZIMUTH_ERR_052_Rx_oRDR_FUSION_DET_049_052_oPCAN_RADAR_46135d94_Rx: ComBitPosition=441, ComBitSize=7, ComSignalType=UINT8, ComSystemTemplateSystemSignalRef=DET_AZIMUTH_ERR_052_Rx
            DET_BELOW_RAIN_THOLD_049_Rx_oRDR_FUSION_DET_049_052_oPCAN_RADAR_9a18a275_Rx: ComBitPosition=39, ComBitSize=1, ComSignalType=BOOLEAN, ComSystemTemplateSystemSignalRef=DET_BELOW_RAIN_THOLD_049_Rx
            DET_BELOW_RAIN_THOLD_050_Rx_oRDR_FUSION_DET_049_052_oPCAN_RADAR_a738216c_Rx: ComBitPosition=151, ComBitSize=1, ComSignalType=BOOLEAN, ComSystemTemplateSystemSignalRef=DET_BELOW_RAIN_THOLD_050_Rx
            DET_BELOW_RAIN_THOLD_051_Rx_oRDR_FUSION_DET_049_052_oPCAN_RADAR_087cb32b_Rx: ComBitPosition=263, ComBitSize=1, ComSignalType=BOOLEAN, ComSystemTemplateSystemSignalRef=DET_BELOW_RAIN_THOLD_051_Rx
            DET_BELOW_RAIN_THOLD_052_Rx_oRDR_FUSION_DET_049_052_oPCAN_RADAR_22c003a3_Rx: ComBitPosition=375, ComBitSize=1, ComSignalType=BOOLEAN, ComSystemTemplateSystemSignalRef=DET_BELOW_RAIN_THOLD_052_Rx
            DET_BI_STATIC_FLAG_049_Rx_oRDR_FUSION_DET_049_052_oPCAN_RADAR_ed860966_Rx: ComBitPosition=104, ComBitSize=1, ComSignalType=BOOLEAN, ComSystemTemplateSystemSignalRef=DET_BI_STATIC_FLAG_049_Rx
            DET_BI_STATIC_FLAG_050_Rx_oRDR_FUSION_DET_049_052_oPCAN_RADAR_d0a68a7f_Rx: ComBitPosition=216, ComBitSize=1, ComSignalType=BOOLEAN, ComSystemTemplateSystemSignalRef=DET_BI_STATIC_FLAG_050_Rx
            DET_BI_STATIC_FLAG_051_Rx_oRDR_FUSION_DET_049_052_oPCAN_RADAR_7fe21838_Rx: ComBitPosition=328, ComBitSize=1, ComSignalType=BOOLEAN, ComSystemTemplateSystemSignalRef=DET_BI_STATIC_FLAG_051_Rx
            DET_BI_STATIC_FLAG_052_Rx_oRDR_FUSION_DET_049_052_oPCAN_RADAR_555ea8b0_Rx: ComBitPosition=440, ComBitSize=1, ComSignalType=BOOLEAN, ComSystemTemplateSystemSignalRef=DET_BI_STATIC_FLAG_052_Rx
            DET_CONFD_AZIMUTH_049_Rx_oRDR_FUSION_DET_049_052_oPCAN_RADAR_0eefe332_Rx: ComBitPosition=118, ComBitSize=2, ComSignalType=UINT8, ComSystemTemplateSystemSignalRef=DET_CONFD_AZIMUTH_049_Rx
            DET_CONFD_AZIMUTH_050_Rx_oRDR_FUSION_DET_049_052_oPCAN_RADAR_33cf602b_Rx: ComBitPosition=230, ComBitSize=2, ComSignalType=UINT8, ComSystemTemplateSystemSignalRef=DET_CONFD_AZIMUTH_050_Rx
            DET_CONFD_AZIMUTH_051_Rx_oRDR_FUSION_DET_049_052_oPCAN_RADAR_9c8bf26c_Rx: ComBitPosition=342, ComBitSize=2, ComSignalType=UINT8, ComSystemTemplateSystemSignalRef=DET_CONFD_AZIMUTH_051_Rx
            DET_CONFD_AZIMUTH_052_Rx_oRDR_FUSION_DET_049_052_oPCAN_RADAR_b63742e4_Rx: ComBitPosition=454, ComBitSize=2, ComSignalType=UINT8, ComSystemTemplateSystemSignalRef=DET_CONFD_AZIMUTH_052_Rx
            DET_CONFD_ELEVATION_049_Rx_oRDR_FUSION_DET_049_052_oPCAN_RADAR_04ce60b5_Rx: ComBitPosition=101, ComBitSize=2, ComSignalType=UINT8, ComSystemTemplateSystemSignalRef=DET_CONFD_ELEVATION_049_Rx
            DET_CONFD_ELEVATION_050_Rx_oRDR_FUSION_DET_049_052_oPCAN_RADAR_39eee3ac_Rx: ComBitPosition=213, ComBitSize=2, ComSignalType=UINT8, ComSystemTemplateSystemSignalRef=DET_CONFD_ELEVATION_050_Rx
            DET_CONFD_ELEVATION_051_Rx_oRDR_FUSION_DET_049_052_oPCAN_RADAR_96aa71eb_Rx: ComBitPosition=325, ComBitSize=2, ComSignalType=UINT8, ComSystemTemplateSystemSignalRef=DET_CONFD_ELEVATION_051_Rx
            DET_CONFD_ELEVATION_052_Rx_oRDR_FUSION_DET_049_052_oPCAN_RADAR_bc16c163_Rx: ComBitPosition=437, ComBitSize=2, ComSignalType=UINT8, ComSystemTemplateSystemSignalRef=DET_CONFD_ELEVATION_052_Rx
            DET_ELEVATION_049_Rx_oRDR_FUSION_DET_049_052_oPCAN_RADAR_0e9d8f4c_Rx: ComBitPosition=72, ComBitSize=8, ComSignalType=UINT8, ComSystemTemplateSystemSignalRef=DET_ELEVATION_049_Rx
            DET_ELEVATION_050_Rx_oRDR_FUSION_DET_049_052_oPCAN_RADAR_33bd0c55_Rx: ComBitPosition=184, ComBitSize=8, ComSignalType=UINT8, ComSystemTemplateSystemSignalRef=DET_ELEVATION_050_Rx
            DET_ELEVATION_051_Rx_oRDR_FUSION_DET_049_052_oPCAN_RADAR_9cf99e12_Rx: ComBitPosition=296, ComBitSize=8, ComSignalType=UINT8, ComSystemTemplateSystemSignalRef=DET_ELEVATION_051_Rx
            DET_ELEVATION_052_Rx_oRDR_FUSION_DET_049_052_oPCAN_RADAR_b6452e9a_Rx: ComBitPosition=408, ComBitSize=8, ComSignalType=UINT8, ComSystemTemplateSystemSignalRef=DET_ELEVATION_052_Rx
            DET_ELEVATION_ERR_049_Rx_oRDR_FUSION_DET_049_052_oPCAN_RADAR_dc24ad93_Rx: ComBitPosition=80, ComBitSize=6, ComSignalType=UINT8, ComSystemTemplateSystemSignalRef=DET_ELEVATION_ERR_049_Rx
            DET_ELEVATION_ERR_050_Rx_oRDR_FUSION_DET_049_052_oPCAN_RADAR_e1042e8a_Rx: ComBitPosition=192, ComBitSize=6, ComSignalType=UINT8, ComSystemTemplateSystemSignalRef=DET_ELEVATION_ERR_050_Rx
            DET_ELEVATION_ERR_051_Rx_oRDR_FUSION_DET_049_052_oPCAN_RADAR_4e40bccd_Rx: ComBitPosition=304, ComBitSize=6, ComSignalType=UINT8, ComSystemTemplateSystemSignalRef=DET_ELEVATION_ERR_051_Rx
            DET_ELEVATION_ERR_052_Rx_oRDR_FUSION_DET_049_052_oPCAN_RADAR_64fc0c45_Rx: ComBitPosition=416, ComBitSize=6, ComSignalType=UINT8, ComSystemTemplateSystemSignalRef=DET_ELEVATION_ERR_052_Rx
            DET_EXISTENCE_PROB_049_Rx_oRDR_FUSION_DET_049_052_oPCAN_RADAR_2b3cd506_Rx: ComBitPosition=112, ComBitSize=6, ComSignalType=UINT8, ComSystemTemplateSystemSignalRef=DET_EXISTENCE_PROB_049_Rx
            DET_EXISTENCE_PROB_050_Rx_oRDR_FUSION_DET_049_052_oPCAN_RADAR_161c561f_Rx: ComBitPosition=224, ComBitSize=6, ComSignalType=UINT8, ComSystemTemplateSystemSignalRef=DET_EXISTENCE_PROB_050_Rx
            DET_EXISTENCE_PROB_051_Rx_oRDR_FUSION_DET_049_052_oPCAN_RADAR_b958c458_Rx: ComBitPosition=336, ComBitSize=6, ComSignalType=UINT8, ComSystemTemplateSystemSignalRef=DET_EXISTENCE_PROB_051_Rx
            DET_EXISTENCE_PROB_052_Rx_oRDR_FUSION_DET_049_052_oPCAN_RADAR_93e474d0_Rx: ComBitPosition=448, ComBitSize=6, ComSignalType=UINT8, ComSystemTemplateSystemSignalRef=DET_EXISTENCE_PROB_052_Rx
            DET_HVC_FLAG_049_Rx_oRDR_FUSION_DET_049_052_oPCAN_RADAR_f6e23849_Rx: ComBitPosition=86, ComBitSize=1, ComSignalType=BOOLEAN, ComSystemTemplateSystemSignalRef=DET_HVC_FLAG_049_Rx
            DET_HVC_FLAG_050_Rx_oRDR_FUSION_DET_049_052_oPCAN_RADAR_cbc2bb50_Rx: ComBitPosition=198, ComBitSize=1, ComSignalType=BOOLEAN, ComSystemTemplateSystemSignalRef=DET_HVC_FLAG_050_Rx
            DET_HVC_FLAG_051_Rx_oRDR_FUSION_DET_049_052_oPCAN_RADAR_64862917_Rx: ComBitPosition=310, ComBitSize=1, ComSignalType=BOOLEAN, ComSystemTemplateSystemSignalRef=DET_HVC_FLAG_051_Rx
            DET_HVC_FLAG_052_Rx_oRDR_FUSION_DET_049_052_oPCAN_RADAR_4e3a999f_Rx: ComBitPosition=422, ComBitSize=1, ComSignalType=BOOLEAN, ComSystemTemplateSystemSignalRef=DET_HVC_FLAG_052_Rx
            DET_IDM_049_Rx_oRDR_FUSION_DET_049_052_oPCAN_RADAR_c323c101_Rx: ComBitPosition=63, ComBitSize=1, ComSignalType=BOOLEAN, ComSystemTemplateSystemSignalRef=DET_IDM_049_Rx
            DET_IDM_050_Rx_oRDR_FUSION_DET_049_052_oPCAN_RADAR_fe034218_Rx: ComBitPosition=175, ComBitSize=1, ComSignalType=BOOLEAN, ComSystemTemplateSystemSignalRef=DET_IDM_050_Rx
            DET_IDM_051_Rx_oRDR_FUSION_DET_049_052_oPCAN_RADAR_5147d05f_Rx: ComBitPosition=287, ComBitSize=1, ComSignalType=BOOLEAN, ComSystemTemplateSystemSignalRef=DET_IDM_051_Rx
            DET_IDM_052_Rx_oRDR_FUSION_DET_049_052_oPCAN_RADAR_7bfb60d7_Rx: ComBitPosition=399, ComBitSize=1, ComSignalType=BOOLEAN, ComSystemTemplateSystemSignalRef=DET_IDM_052_Rx
            DET_MH_CRC16_049_052_Rx_oRDR_FUSION_DET_049_052_oPCAN_RADAR_74272fbc_Rx: ComBitPosition=0, ComBitSize=16, ComSignalType=UINT16, ComSystemTemplateSystemSignalRef=DET_MH_CRC16_049_052_Rx
            DET_MH_CYCLE_COUNTER_049_052_Rx_oRDR_FUSION_DET_049_052_oPCAN_RADAR_79fc1279_Rx: ComBitPosition=16, ComBitSize=8, ComSignalType=UINT8, ComSystemTemplateSystemSignalRef=DET_MH_CYCLE_COUNTER_049_052_Rx
            DET_MH_SCAN_INDEX_4LSB_049_052_Rx_oRDR_FUSION_DET_049_052_oPCAN_RADAR_1d4cdd42_Rx: ComBitPosition=476, ComBitSize=4, ComSignalType=UINT8, ComSystemTemplateSystemSignalRef=DET_MH_SCAN_INDEX_4LSB_049_052_Rx
            DET_MTD_049_Rx_oRDR_FUSION_DET_049_052_oPCAN_RADAR_7ea0f771_Rx: ComBitPosition=47, ComBitSize=1, ComSignalType=BOOLEAN, ComSystemTemplateSystemSignalRef=DET_MTD_049_Rx
            DET_MTD_050_Rx_oRDR_FUSION_DET_049_052_oPCAN_RADAR_43807468_Rx: ComBitPosition=159, ComBitSize=1, ComSignalType=BOOLEAN, ComSystemTemplateSystemSignalRef=DET_MTD_050_Rx
            DET_MTD_051_Rx_oRDR_FUSION_DET_049_052_oPCAN_RADAR_ecc4e62f_Rx: ComBitPosition=271, ComBitSize=1, ComSignalType=BOOLEAN, ComSystemTemplateSystemSignalRef=DET_MTD_051_Rx
            DET_MTD_052_Rx_oRDR_FUSION_DET_049_052_oPCAN_RADAR_c67856a7_Rx: ComBitPosition=383, ComBitSize=1, ComSignalType=BOOLEAN, ComSystemTemplateSystemSignalRef=DET_MTD_052_Rx
            DET_PROB_1STAZHYPO_049_Rx_oRDR_FUSION_DET_049_052_oPCAN_RADAR_b4d9e9f0_Rx: ComBitPosition=103, ComBitSize=1, ComSignalType=BOOLEAN, ComSystemTemplateSystemSignalRef=DET_PROB_1STAZHYPO_049_Rx
            DET_PROB_1STAZHYPO_050_Rx_oRDR_FUSION_DET_049_052_oPCAN_RADAR_89f96ae9_Rx: ComBitPosition=215, ComBitSize=1, ComSignalType=BOOLEAN, ComSystemTemplateSystemSignalRef=DET_PROB_1STAZHYPO_050_Rx
            DET_PROB_1STAZHYPO_051_Rx_oRDR_FUSION_DET_049_052_oPCAN_RADAR_26bdf8ae_Rx: ComBitPosition=327, ComBitSize=1, ComSignalType=BOOLEAN, ComSystemTemplateSystemSignalRef=DET_PROB_1STAZHYPO_051_Rx
            DET_PROB_1STAZHYPO_052_Rx_oRDR_FUSION_DET_049_052_oPCAN_RADAR_0c014826_Rx: ComBitPosition=439, ComBitSize=1, ComSignalType=BOOLEAN, ComSystemTemplateSystemSignalRef=DET_PROB_1STAZHYPO_052_Rx
            DET_RANGE_049_Rx_oRDR_FUSION_DET_049_052_oPCAN_RADAR_ef6401e7_Rx: ComBitPosition=24, ComBitSize=15, ComSignalType=UINT16, ComSystemTemplateSystemSignalRef=DET_RANGE_049_Rx
            DET_RANGE_050_Rx_oRDR_FUSION_DET_049_052_oPCAN_RADAR_d24482fe_Rx: ComBitPosition=136, ComBitSize=15, ComSignalType=UINT16, ComSystemTemplateSystemSignalRef=DET_RANGE_050_Rx
            DET_RANGE_051_Rx_oRDR_FUSION_DET_049_052_oPCAN_RADAR_7d0010b9_Rx: ComBitPosition=248, ComBitSize=15, ComSignalType=UINT16, ComSystemTemplateSystemSignalRef=DET_RANGE_051_Rx
            DET_RANGE_052_Rx_oRDR_FUSION_DET_049_052_oPCAN_RADAR_57bca031_Rx: ComBitPosition=360, ComBitSize=15, ComSignalType=UINT16, ComSystemTemplateSystemSignalRef=DET_RANGE_052_Rx
            DET_RANGE_ERR_049_Rx_oRDR_FUSION_DET_049_052_oPCAN_RADAR_bf968d07_Rx: ComBitPosition=40, ComBitSize=7, ComSignalType=UINT8, ComSystemTemplateSystemSignalRef=DET_RANGE_ERR_049_Rx
            DET_RANGE_ERR_050_Rx_oRDR_FUSION_DET_049_052_oPCAN_RADAR_82b60e1e_Rx: ComBitPosition=152, ComBitSize=7, ComSignalType=UINT8, ComSystemTemplateSystemSignalRef=DET_RANGE_ERR_050_Rx
            DET_RANGE_ERR_051_Rx_oRDR_FUSION_DET_049_052_oPCAN_RADAR_2df29c59_Rx: ComBitPosition=264, ComBitSize=7, ComSignalType=UINT8, ComSystemTemplateSystemSignalRef=DET_RANGE_ERR_051_Rx
            DET_RANGE_ERR_052_Rx_oRDR_FUSION_DET_049_052_oPCAN_RADAR_074e2cd1_Rx: ComBitPosition=376, ComBitSize=7, ComSignalType=UINT8, ComSystemTemplateSystemSignalRef=DET_RANGE_ERR_052_Rx
            DET_RANGE_VELOCITY_049_Rx_oRDR_FUSION_DET_049_052_oPCAN_RADAR_32918219_Rx: ComBitPosition=48, ComBitSize=15, ComSignalType=UINT16, ComSystemTemplateSystemSignalRef=DET_RANGE_VELOCITY_049_Rx
            DET_RANGE_VELOCITY_050_Rx_oRDR_FUSION_DET_049_052_oPCAN_RADAR_0fb10100_Rx: ComBitPosition=160, ComBitSize=15, ComSignalType=UINT16, ComSystemTemplateSystemSignalRef=DET_RANGE_VELOCITY_050_Rx
            DET_RANGE_VELOCITY_051_Rx_oRDR_FUSION_DET_049_052_oPCAN_RADAR_a0f59347_Rx: ComBitPosition=272, ComBitSize=15, ComSignalType=UINT16, ComSystemTemplateSystemSignalRef=DET_RANGE_VELOCITY_051_Rx
            DET_RANGE_VELOCITY_052_Rx_oRDR_FUSION_DET_049_052_oPCAN_RADAR_8a4923cf_Rx: ComBitPosition=384, ComBitSize=15, ComSignalType=UINT16, ComSystemTemplateSystemSignalRef=DET_RANGE_VELOCITY_052_Rx
            DET_RANGE_VELOCITY_ERR_049_Rx_oRDR_FUSION_DET_049_052_oPCAN_RADAR_abf5f2db_Rx: ComBitPosition=64, ComBitSize=8, ComSignalType=UINT8, ComSystemTemplateSystemSignalRef=DET_RANGE_VELOCITY_ERR_049_Rx
            DET_RANGE_VELOCITY_ERR_050_Rx_oRDR_FUSION_DET_049_052_oPCAN_RADAR_96d571c2_Rx: ComBitPosition=176, ComBitSize=8, ComSignalType=UINT8, ComSystemTemplateSystemSignalRef=DET_RANGE_VELOCITY_ERR_050_Rx
            DET_RANGE_VELOCITY_ERR_051_Rx_oRDR_FUSION_DET_049_052_oPCAN_RADAR_3991e385_Rx: ComBitPosition=288, ComBitSize=8, ComSignalType=UINT8, ComSystemTemplateSystemSignalRef=DET_RANGE_VELOCITY_ERR_051_Rx
            DET_RANGE_VELOCITY_ERR_052_Rx_oRDR_FUSION_DET_049_052_oPCAN_RADAR_132d530d_Rx: ComBitPosition=400, ComBitSize=8, ComSignalType=UINT8, ComSystemTemplateSystemSignalRef=DET_RANGE_VELOCITY_ERR_052_Rx
            DET_RCS_049_Rx_oRDR_FUSION_DET_049_052_oPCAN_RADAR_ff5a1002_Rx: ComBitPosition=128, ComBitSize=8, ComSignalType=UINT8, ComSystemTemplateSystemSignalRef=DET_RCS_049_Rx
            DET_RCS_050_Rx_oRDR_FUSION_DET_049_052_oPCAN_RADAR_c27a931b_Rx: ComBitPosition=240, ComBitSize=8, ComSignalType=UINT8, ComSystemTemplateSystemSignalRef=DET_RCS_050_Rx
            DET_RCS_051_Rx_oRDR_FUSION_DET_049_052_oPCAN_RADAR_6d3e015c_Rx: ComBitPosition=352, ComBitSize=8, ComSignalType=UINT8, ComSystemTemplateSystemSignalRef=DET_RCS_051_Rx
            DET_RCS_052_Rx_oRDR_FUSION_DET_049_052_oPCAN_RADAR_4782b1d4_Rx: ComBitPosition=464, ComBitSize=8, ComSignalType=UINT8, ComSystemTemplateSystemSignalRef=DET_RCS_052_Rx
            DET_SNR_049_Rx_oRDR_FUSION_DET_049_052_oPCAN_RADAR_f60061eb_Rx: ComBitPosition=120, ComBitSize=8, ComSignalType=UINT8, ComSystemTemplateSystemSignalRef=DET_SNR_049_Rx
            DET_SNR_050_Rx_oRDR_FUSION_DET_049_052_oPCAN_RADAR_cb20e2f2_Rx: ComBitPosition=232, ComBitSize=8, ComSignalType=UINT8, ComSystemTemplateSystemSignalRef=DET_SNR_050_Rx
            DET_SNR_051_Rx_oRDR_FUSION_DET_049_052_oPCAN_RADAR_646470b5_Rx: ComBitPosition=344, ComBitSize=8, ComSignalType=UINT8, ComSystemTemplateSystemSignalRef=DET_SNR_051_Rx
            DET_SNR_052_Rx_oRDR_FUSION_DET_049_052_oPCAN_RADAR_4ed8c03d_Rx: ComBitPosition=456, ComBitSize=8, ComSignalType=UINT8, ComSystemTemplateSystemSignalRef=DET_SNR_052_Rx
            DET_SUPER_RES_TARGET_049_Rx_oRDR_FUSION_DET_049_052_oPCAN_RADAR_3dfb40eb_Rx: ComBitPosition=87, ComBitSize=1, ComSignalType=BOOLEAN, ComSystemTemplateSystemSignalRef=DET_SUPER_RES_TARGET_049_Rx
            DET_SUPER_RES_TARGET_050_Rx_oRDR_FUSION_DET_049_052_oPCAN_RADAR_00dbc3f2_Rx: ComBitPosition=199, ComBitSize=1, ComSignalType=BOOLEAN, ComSystemTemplateSystemSignalRef=DET_SUPER_RES_TARGET_050_Rx
            DET_SUPER_RES_TARGET_051_Rx_oRDR_FUSION_DET_049_052_oPCAN_RADAR_af9f51b5_Rx: ComBitPosition=311, ComBitSize=1, ComSignalType=BOOLEAN, ComSystemTemplateSystemSignalRef=DET_SUPER_RES_TARGET_051_Rx
            DET_SUPER_RES_TARGET_052_Rx_oRDR_FUSION_DET_049_052_oPCAN_RADAR_8523e13d_Rx: ComBitPosition=423, ComBitSize=1, ComSignalType=BOOLEAN, ComSystemTemplateSystemSignalRef=DET_SUPER_RES_TARGET_052_Rx
        SG_Fusion_Detections_053_056_oRDR_FUSION_DET_053_056_oPCAN_RADAR_d1fa35d9_Rx: ComTimeout=0, ComSystemTemplateSignalGroupRef=SG_Fusion_Detections_053_056
          83 x ComGroupSignal, all with ComSignalEndianness=LITTLE_ENDIAN, ComSignalInitValue=0:
            DET_AZIMUTH_053_Rx_oRDR_FUSION_DET_053_056_oPCAN_RADAR_f6f96d7f_Rx: ComBitPosition=88, ComBitSize=13, ComSignalType=UINT16, ComSystemTemplateSystemSignalRef=DET_AZIMUTH_053_Rx
            DET_AZIMUTH_054_Rx_oRDR_FUSION_DET_053_056_oPCAN_RADAR_0cc49e28_Rx: ComBitPosition=200, ComBitSize=13, ComSignalType=UINT16, ComSystemTemplateSystemSignalRef=DET_AZIMUTH_054_Rx
            DET_AZIMUTH_055_Rx_oRDR_FUSION_DET_053_056_oPCAN_RADAR_a3800c6f_Rx: ComBitPosition=312, ComBitSize=13, ComSignalType=UINT16, ComSystemTemplateSystemSignalRef=DET_AZIMUTH_055_Rx
            DET_AZIMUTH_056_Rx_oRDR_FUSION_DET_053_056_oPCAN_RADAR_893cbce7_Rx: ComBitPosition=424, ComBitSize=13, ComSignalType=UINT16, ComSystemTemplateSystemSignalRef=DET_AZIMUTH_056_Rx
            DET_AZIMUTH_ERR_053_Rx_oRDR_FUSION_DET_053_056_oPCAN_RADAR_f490ccfd_Rx: ComBitPosition=105, ComBitSize=7, ComSignalType=UINT8, ComSystemTemplateSystemSignalRef=DET_AZIMUTH_ERR_053_Rx
            DET_AZIMUTH_ERR_054_Rx_oRDR_FUSION_DET_053_056_oPCAN_RADAR_0ead3faa_Rx: ComBitPosition=217, ComBitSize=7, ComSignalType=UINT8, ComSystemTemplateSystemSignalRef=DET_AZIMUTH_ERR_054_Rx
            DET_AZIMUTH_ERR_055_Rx_oRDR_FUSION_DET_053_056_oPCAN_RADAR_a1e9aded_Rx: ComBitPosition=329, ComBitSize=7, ComSignalType=UINT8, ComSystemTemplateSystemSignalRef=DET_AZIMUTH_ERR_055_Rx
            DET_AZIMUTH_ERR_056_Rx_oRDR_FUSION_DET_053_056_oPCAN_RADAR_8b551d65_Rx: ComBitPosition=441, ComBitSize=7, ComSignalType=UINT8, ComSystemTemplateSystemSignalRef=DET_AZIMUTH_ERR_056_Rx
            DET_BELOW_RAIN_THOLD_053_Rx_oRDR_FUSION_DET_053_056_oPCAN_RADAR_904392ca_Rx: ComBitPosition=39, ComBitSize=1, ComSignalType=BOOLEAN, ComSystemTemplateSystemSignalRef=DET_BELOW_RAIN_THOLD_053_Rx
            DET_BELOW_RAIN_THOLD_054_Rx_oRDR_FUSION_DET_053_056_oPCAN_RADAR_6a7e619d_Rx: ComBitPosition=151, ComBitSize=1, ComSignalType=BOOLEAN, ComSystemTemplateSystemSignalRef=DET_BELOW_RAIN_THOLD_054_Rx
            DET_BELOW_RAIN_THOLD_055_Rx_oRDR_FUSION_DET_053_056_oPCAN_RADAR_c53af3da_Rx: ComBitPosition=263, ComBitSize=1, ComSignalType=BOOLEAN, ComSystemTemplateSystemSignalRef=DET_BELOW_RAIN_THOLD_055_Rx
            DET_BELOW_RAIN_THOLD_056_Rx_oRDR_FUSION_DET_053_056_oPCAN_RADAR_ef864352_Rx: ComBitPosition=375, ComBitSize=1, ComSignalType=BOOLEAN, ComSystemTemplateSystemSignalRef=DET_BELOW_RAIN_THOLD_056_Rx
            DET_BI_STATIC_FLAG_053_Rx_oRDR_FUSION_DET_053_056_oPCAN_RADAR_e7dd39d9_Rx: ComBitPosition=104, ComBitSize=1, ComSignalType=BOOLEAN, ComSystemTemplateSystemSignalRef=DET_BI_STATIC_FLAG_053_Rx
            DET_BI_STATIC_FLAG_054_Rx_oRDR_FUSION_DET_053_056_oPCAN_RADAR_1de0ca8e_Rx: ComBitPosition=216, ComBitSize=1, ComSignalType=BOOLEAN, ComSystemTemplateSystemSignalRef=DET_BI_STATIC_FLAG_054_Rx
            DET_BI_STATIC_FLAG_055_Rx_oRDR_FUSION_DET_053_056_oPCAN_RADAR_b2a458c9_Rx: ComBitPosition=328, ComBitSize=1, ComSignalType=BOOLEAN, ComSystemTemplateSystemSignalRef=DET_BI_STATIC_FLAG_055_Rx
            DET_BI_STATIC_FLAG_056_Rx_oRDR_FUSION_DET_053_056_oPCAN_RADAR_9818e841_Rx: ComBitPosition=440, ComBitSize=1, ComSignalType=BOOLEAN, ComSystemTemplateSystemSignalRef=DET_BI_STATIC_FLAG_056_Rx
            DET_CONFD_AZIMUTH_053_Rx_oRDR_FUSION_DET_053_056_oPCAN_RADAR_04b4d38d_Rx: ComBitPosition=118, ComBitSize=2, ComSignalType=UINT8, ComSystemTemplateSystemSignalRef=DET_CONFD_AZIMUTH_053_Rx
            DET_CONFD_AZIMUTH_054_Rx_oRDR_FUSION_DET_053_056_oPCAN_RADAR_fe8920da_Rx: ComBitPosition=230, ComBitSize=2, ComSignalType=UINT8, ComSystemTemplateSystemSignalRef=DET_CONFD_AZIMUTH_054_Rx
            DET_CONFD_AZIMUTH_055_Rx_oRDR_FUSION_DET_053_056_oPCAN_RADAR_51cdb29d_Rx: ComBitPosition=342, ComBitSize=2, ComSignalType=UINT8, ComSystemTemplateSystemSignalRef=DET_CONFD_AZIMUTH_055_Rx
            DET_CONFD_AZIMUTH_056_Rx_oRDR_FUSION_DET_053_056_oPCAN_RADAR_7b710215_Rx: ComBitPosition=454, ComBitSize=2, ComSignalType=UINT8, ComSystemTemplateSystemSignalRef=DET_CONFD_AZIMUTH_056_Rx
            DET_CONFD_ELEVATION_053_Rx_oRDR_FUSION_DET_053_056_oPCAN_RADAR_0e95500a_Rx: ComBitPosition=101, ComBitSize=2, ComSignalType=UINT8, ComSystemTemplateSystemSignalRef=DET_CONFD_ELEVATION_053_Rx
            DET_CONFD_ELEVATION_054_Rx_oRDR_FUSION_DET_053_056_oPCAN_RADAR_f4a8a35d_Rx: ComBitPosition=213, ComBitSize=2, ComSignalType=UINT8, ComSystemTemplateSystemSignalRef=DET_CONFD_ELEVATION_054_Rx
            DET_CONFD_ELEVATION_055_Rx_oRDR_FUSION_DET_053_056_oPCAN_RADAR_5bec311a_Rx: ComBitPosition=325, ComBitSize=2, ComSignalType=UINT8, ComSystemTemplateSystemSignalRef=DET_CONFD_ELEVATION_055_Rx
            DET_CONFD_ELEVATION_056_Rx_oRDR_FUSION_DET_053_056_oPCAN_RADAR_71508192_Rx: ComBitPosition=437, ComBitSize=2, ComSignalType=UINT8, ComSystemTemplateSystemSignalRef=DET_CONFD_ELEVATION_056_Rx
            DET_ELEVATION_053_Rx_oRDR_FUSION_DET_053_056_oPCAN_RADAR_04c6bff3_Rx: ComBitPosition=72, ComBitSize=8, ComSignalType=UINT8, ComSystemTemplateSystemSignalRef=DET_ELEVATION_053_Rx
            DET_ELEVATION_054_Rx_oRDR_FUSION_DET_053_056_oPCAN_RADAR_fefb4ca4_Rx: ComBitPosition=184, ComBitSize=8, ComSignalType=UINT8, ComSystemTemplateSystemSignalRef=DET_ELEVATION_054_Rx
            DET_ELEVATION_055_Rx_oRDR_FUSION_DET_053_056_oPCAN_RADAR_51bfdee3_Rx: ComBitPosition=296, ComBitSize=8, ComSignalType=UINT8, ComSystemTemplateSystemSignalRef=DET_ELEVATION_055_Rx
            DET_ELEVATION_056_Rx_oRDR_FUSION_DET_053_056_oPCAN_RADAR_7b036e6b_Rx: ComBitPosition=408, ComBitSize=8, ComSignalType=UINT8, ComSystemTemplateSystemSignalRef=DET_ELEVATION_056_Rx
            DET_ELEVATION_ERR_053_Rx_oRDR_FUSION_DET_053_056_oPCAN_RADAR_d67f9d2c_Rx: ComBitPosition=80, ComBitSize=6, ComSignalType=UINT8, ComSystemTemplateSystemSignalRef=DET_ELEVATION_ERR_053_Rx
            DET_ELEVATION_ERR_054_Rx_oRDR_FUSION_DET_053_056_oPCAN_RADAR_2c426e7b_Rx: ComBitPosition=192, ComBitSize=6, ComSignalType=UINT8, ComSystemTemplateSystemSignalRef=DET_ELEVATION_ERR_054_Rx
            DET_ELEVATION_ERR_055_Rx_oRDR_FUSION_DET_053_056_oPCAN_RADAR_8306fc3c_Rx: ComBitPosition=304, ComBitSize=6, ComSignalType=UINT8, ComSystemTemplateSystemSignalRef=DET_ELEVATION_ERR_055_Rx
            DET_ELEVATION_ERR_056_Rx_oRDR_FUSION_DET_053_056_oPCAN_RADAR_a9ba4cb4_Rx: ComBitPosition=416, ComBitSize=6, ComSignalType=UINT8, ComSystemTemplateSystemSignalRef=DET_ELEVATION_ERR_056_Rx
            DET_EXISTENCE_PROB_053_Rx_oRDR_FUSION_DET_053_056_oPCAN_RADAR_2167e5b9_Rx: ComBitPosition=112, ComBitSize=6, ComSignalType=UINT8, ComSystemTemplateSystemSignalRef=DET_EXISTENCE_PROB_053_Rx
            DET_EXISTENCE_PROB_054_Rx_oRDR_FUSION_DET_053_056_oPCAN_RADAR_db5a16ee_Rx: ComBitPosition=224, ComBitSize=6, ComSignalType=UINT8, ComSystemTemplateSystemSignalRef=DET_EXISTENCE_PROB_054_Rx
            DET_EXISTENCE_PROB_055_Rx_oRDR_FUSION_DET_053_056_oPCAN_RADAR_741e84a9_Rx: ComBitPosition=336, ComBitSize=6, ComSignalType=UINT8, ComSystemTemplateSystemSignalRef=DET_EXISTENCE_PROB_055_Rx
            DET_EXISTENCE_PROB_056_Rx_oRDR_FUSION_DET_053_056_oPCAN_RADAR_5ea23421_Rx: ComBitPosition=448, ComBitSize=6, ComSignalType=UINT8, ComSystemTemplateSystemSignalRef=DET_EXISTENCE_PROB_056_Rx
            DET_HVC_FLAG_053_Rx_oRDR_FUSION_DET_053_056_oPCAN_RADAR_fcb908f6_Rx: ComBitPosition=86, ComBitSize=1, ComSignalType=BOOLEAN, ComSystemTemplateSystemSignalRef=DET_HVC_FLAG_053_Rx
            DET_HVC_FLAG_054_Rx_oRDR_FUSION_DET_053_056_oPCAN_RADAR_0684fba1_Rx: ComBitPosition=198, ComBitSize=1, ComSignalType=BOOLEAN, ComSystemTemplateSystemSignalRef=DET_HVC_FLAG_054_Rx
            DET_HVC_FLAG_055_Rx_oRDR_FUSION_DET_053_056_oPCAN_RADAR_a9c069e6_Rx: ComBitPosition=310, ComBitSize=1, ComSignalType=BOOLEAN, ComSystemTemplateSystemSignalRef=DET_HVC_FLAG_055_Rx
            DET_HVC_FLAG_056_Rx_oRDR_FUSION_DET_053_056_oPCAN_RADAR_837cd96e_Rx: ComBitPosition=422, ComBitSize=1, ComSignalType=BOOLEAN, ComSystemTemplateSystemSignalRef=DET_HVC_FLAG_056_Rx
            DET_IDM_053_Rx_oRDR_FUSION_DET_053_056_oPCAN_RADAR_c978f1be_Rx: ComBitPosition=63, ComBitSize=1, ComSignalType=BOOLEAN, ComSystemTemplateSystemSignalRef=DET_IDM_053_Rx
            DET_IDM_054_Rx_oRDR_FUSION_DET_053_056_oPCAN_RADAR_334502e9_Rx: ComBitPosition=175, ComBitSize=1, ComSignalType=BOOLEAN, ComSystemTemplateSystemSignalRef=DET_IDM_054_Rx
            DET_IDM_055_Rx_oRDR_FUSION_DET_053_056_oPCAN_RADAR_9c0190ae_Rx: ComBitPosition=287, ComBitSize=1, ComSignalType=BOOLEAN, ComSystemTemplateSystemSignalRef=DET_IDM_055_Rx
            DET_IDM_056_Rx_oRDR_FUSION_DET_053_056_oPCAN_RADAR_b6bd2026_Rx: ComBitPosition=399, ComBitSize=1, ComSignalType=BOOLEAN, ComSystemTemplateSystemSignalRef=DET_IDM_056_Rx
            DET_MH_CRC16_053_056_Rx_oRDR_FUSION_DET_053_056_oPCAN_RADAR_c497f294_Rx: ComBitPosition=0, ComBitSize=16, ComSignalType=UINT16, ComSystemTemplateSystemSignalRef=DET_MH_CRC16_053_056_Rx
            DET_MH_CYCLE_COUNTER_053_056_Rx_oRDR_FUSION_DET_053_056_oPCAN_RADAR_c94ccf51_Rx: ComBitPosition=16, ComBitSize=8, ComSignalType=UINT8, ComSystemTemplateSystemSignalRef=DET_MH_CYCLE_COUNTER_053_056_Rx
            DET_MH_SCAN_INDEX_4LSB_053_056_Rx_oRDR_FUSION_DET_053_056_oPCAN_RADAR_adfc006a_Rx: ComBitPosition=476, ComBitSize=4, ComSignalType=UINT8, ComSystemTemplateSystemSignalRef=DET_MH_SCAN_INDEX_4LSB_053_056_Rx
            DET_MTD_053_Rx_oRDR_FUSION_DET_053_056_oPCAN_RADAR_74fbc7ce_Rx: ComBitPosition=47, ComBitSize=1, ComSignalType=BOOLEAN, ComSystemTemplateSystemSignalRef=DET_MTD_053_Rx
            DET_MTD_054_Rx_oRDR_FUSION_DET_053_056_oPCAN_RADAR_8ec63499_Rx: ComBitPosition=159, ComBitSize=1, ComSignalType=BOOLEAN, ComSystemTemplateSystemSignalRef=DET_MTD_054_Rx
            DET_MTD_055_Rx_oRDR_FUSION_DET_053_056_oPCAN_RADAR_2182a6de_Rx: ComBitPosition=271, ComBitSize=1, ComSignalType=BOOLEAN, ComSystemTemplateSystemSignalRef=DET_MTD_055_Rx
            DET_MTD_056_Rx_oRDR_FUSION_DET_053_056_oPCAN_RADAR_0b3e1656_Rx: ComBitPosition=383, ComBitSize=1, ComSignalType=BOOLEAN, ComSystemTemplateSystemSignalRef=DET_MTD_056_Rx
            DET_PROB_1STAZHYPO_053_Rx_oRDR_FUSION_DET_053_056_oPCAN_RADAR_be82d94f_Rx: ComBitPosition=103, ComBitSize=1, ComSignalType=BOOLEAN, ComSystemTemplateSystemSignalRef=DET_PROB_1STAZHYPO_053_Rx
            DET_PROB_1STAZHYPO_054_Rx_oRDR_FUSION_DET_053_056_oPCAN_RADAR_44bf2a18_Rx: ComBitPosition=215, ComBitSize=1, ComSignalType=BOOLEAN, ComSystemTemplateSystemSignalRef=DET_PROB_1STAZHYPO_054_Rx
            DET_PROB_1STAZHYPO_055_Rx_oRDR_FUSION_DET_053_056_oPCAN_RADAR_ebfbb85f_Rx: ComBitPosition=327, ComBitSize=1, ComSignalType=BOOLEAN, ComSystemTemplateSystemSignalRef=DET_PROB_1STAZHYPO_055_Rx
            DET_PROB_1STAZHYPO_056_Rx_oRDR_FUSION_DET_053_056_oPCAN_RADAR_c14708d7_Rx: ComBitPosition=439, ComBitSize=1, ComSignalType=BOOLEAN, ComSystemTemplateSystemSignalRef=DET_PROB_1STAZHYPO_056_Rx
            DET_RANGE_053_Rx_oRDR_FUSION_DET_053_056_oPCAN_RADAR_e53f3158_Rx: ComBitPosition=24, ComBitSize=15, ComSignalType=UINT16, ComSystemTemplateSystemSignalRef=DET_RANGE_053_Rx
            DET_RANGE_054_Rx_oRDR_FUSION_DET_053_056_oPCAN_RADAR_1f02c20f_Rx: ComBitPosition=136, ComBitSize=15, ComSignalType=UINT16, ComSystemTemplateSystemSignalRef=DET_RANGE_054_Rx
            DET_RANGE_055_Rx_oRDR_FUSION_DET_053_056_oPCAN_RADAR_b0465048_Rx: ComBitPosition=248, ComBitSize=15, ComSignalType=UINT16, ComSystemTemplateSystemSignalRef=DET_RANGE_055_Rx
            DET_RANGE_056_Rx_oRDR_FUSION_DET_053_056_oPCAN_RADAR_9afae0c0_Rx: ComBitPosition=360, ComBitSize=15, ComSignalType=UINT16, ComSystemTemplateSystemSignalRef=DET_RANGE_056_Rx
            DET_RANGE_ERR_053_Rx_oRDR_FUSION_DET_053_056_oPCAN_RADAR_b5cdbdb8_Rx: ComBitPosition=40, ComBitSize=7, ComSignalType=UINT8, ComSystemTemplateSystemSignalRef=DET_RANGE_ERR_053_Rx
            DET_RANGE_ERR_054_Rx_oRDR_FUSION_DET_053_056_oPCAN_RADAR_4ff04eef_Rx: ComBitPosition=152, ComBitSize=7, ComSignalType=UINT8, ComSystemTemplateSystemSignalRef=DET_RANGE_ERR_054_Rx
            DET_RANGE_ERR_055_Rx_oRDR_FUSION_DET_053_056_oPCAN_RADAR_e0b4dca8_Rx: ComBitPosition=264, ComBitSize=7, ComSignalType=UINT8, ComSystemTemplateSystemSignalRef=DET_RANGE_ERR_055_Rx
            DET_RANGE_ERR_056_Rx_oRDR_FUSION_DET_053_056_oPCAN_RADAR_ca086c20_Rx: ComBitPosition=376, ComBitSize=7, ComSignalType=UINT8, ComSystemTemplateSystemSignalRef=DET_RANGE_ERR_056_Rx
            DET_RANGE_VELOCITY_053_Rx_oRDR_FUSION_DET_053_056_oPCAN_RADAR_38cab2a6_Rx: ComBitPosition=48, ComBitSize=15, ComSignalType=UINT16, ComSystemTemplateSystemSignalRef=DET_RANGE_VELOCITY_053_Rx
            DET_RANGE_VELOCITY_054_Rx_oRDR_FUSION_DET_053_056_oPCAN_RADAR_c2f741f1_Rx: ComBitPosition=160, ComBitSize=15, ComSignalType=UINT16, ComSystemTemplateSystemSignalRef=DET_RANGE_VELOCITY_054_Rx
            DET_RANGE_VELOCITY_055_Rx_oRDR_FUSION_DET_053_056_oPCAN_RADAR_6db3d3b6_Rx: ComBitPosition=272, ComBitSize=15, ComSignalType=UINT16, ComSystemTemplateSystemSignalRef=DET_RANGE_VELOCITY_055_Rx
            DET_RANGE_VELOCITY_056_Rx_oRDR_FUSION_DET_053_056_oPCAN_RADAR_470f633e_Rx: ComBitPosition=384, ComBitSize=15, ComSignalType=UINT16, ComSystemTemplateSystemSignalRef=DET_RANGE_VELOCITY_056_Rx
            DET_RANGE_VELOCITY_ERR_053_Rx_oRDR_FUSION_DET_053_056_oPCAN_RADAR_a1aec264_Rx: ComBitPosition=64, ComBitSize=8, ComSignalType=UINT8, ComSystemTemplateSystemSignalRef=DET_RANGE_VELOCITY_ERR_053_Rx
            DET_RANGE_VELOCITY_ERR_054_Rx_oRDR_FUSION_DET_053_056_oPCAN_RADAR_5b933133_Rx: ComBitPosition=176, ComBitSize=8, ComSignalType=UINT8, ComSystemTemplateSystemSignalRef=DET_RANGE_VELOCITY_ERR_054_Rx
            DET_RANGE_VELOCITY_ERR_055_Rx_oRDR_FUSION_DET_053_056_oPCAN_RADAR_f4d7a374_Rx: ComBitPosition=288, ComBitSize=8, ComSignalType=UINT8, ComSystemTemplateSystemSignalRef=DET_RANGE_VELOCITY_ERR_055_Rx
            DET_RANGE_VELOCITY_ERR_056_Rx_oRDR_FUSION_DET_053_056_oPCAN_RADAR_de6b13fc_Rx: ComBitPosition=400, ComBitSize=8, ComSignalType=UINT8, ComSystemTemplateSystemSignalRef=DET_RANGE_VELOCITY_ERR_056_Rx
            DET_RCS_053_Rx_oRDR_FUSION_DET_053_056_oPCAN_RADAR_f50120bd_Rx: ComBitPosition=128, ComBitSize=8, ComSignalType=UINT8, ComSystemTemplateSystemSignalRef=DET_RCS_053_Rx
            DET_RCS_054_Rx_oRDR_FUSION_DET_053_056_oPCAN_RADAR_0f3cd3ea_Rx: ComBitPosition=240, ComBitSize=8, ComSignalType=UINT8, ComSystemTemplateSystemSignalRef=DET_RCS_054_Rx
            DET_RCS_055_Rx_oRDR_FUSION_DET_053_056_oPCAN_RADAR_a07841ad_Rx: ComBitPosition=352, ComBitSize=8, ComSignalType=UINT8, ComSystemTemplateSystemSignalRef=DET_RCS_055_Rx
            DET_RCS_056_Rx_oRDR_FUSION_DET_053_056_oPCAN_RADAR_8ac4f125_Rx: ComBitPosition=464, ComBitSize=8, ComSignalType=UINT8, ComSystemTemplateSystemSignalRef=DET_RCS_056_Rx
            DET_SNR_053_Rx_oRDR_FUSION_DET_053_056_oPCAN_RADAR_fc5b5154_Rx: ComBitPosition=120, ComBitSize=8, ComSignalType=UINT8, ComSystemTemplateSystemSignalRef=DET_SNR_053_Rx
            DET_SNR_054_Rx_oRDR_FUSION_DET_053_056_oPCAN_RADAR_0666a203_Rx: ComBitPosition=232, ComBitSize=8, ComSignalType=UINT8, ComSystemTemplateSystemSignalRef=DET_SNR_054_Rx
            DET_SNR_055_Rx_oRDR_FUSION_DET_053_056_oPCAN_RADAR_a9223044_Rx: ComBitPosition=344, ComBitSize=8, ComSignalType=UINT8, ComSystemTemplateSystemSignalRef=DET_SNR_055_Rx
            DET_SNR_056_Rx_oRDR_FUSION_DET_053_056_oPCAN_RADAR_839e80cc_Rx: ComBitPosition=456, ComBitSize=8, ComSignalType=UINT8, ComSystemTemplateSystemSignalRef=DET_SNR_056_Rx
            DET_SUPER_RES_TARGET_053_Rx_oRDR_FUSION_DET_053_056_oPCAN_RADAR_37a07054_Rx: ComBitPosition=87, ComBitSize=1, ComSignalType=BOOLEAN, ComSystemTemplateSystemSignalRef=DET_SUPER_RES_TARGET_053_Rx
            DET_SUPER_RES_TARGET_054_Rx_oRDR_FUSION_DET_053_056_oPCAN_RADAR_cd9d8303_Rx: ComBitPosition=199, ComBitSize=1, ComSignalType=BOOLEAN, ComSystemTemplateSystemSignalRef=DET_SUPER_RES_TARGET_054_Rx
            DET_SUPER_RES_TARGET_055_Rx_oRDR_FUSION_DET_053_056_oPCAN_RADAR_62d91144_Rx: ComBitPosition=311, ComBitSize=1, ComSignalType=BOOLEAN, ComSystemTemplateSystemSignalRef=DET_SUPER_RES_TARGET_055_Rx
            DET_SUPER_RES_TARGET_056_Rx_oRDR_FUSION_DET_053_056_oPCAN_RADAR_4865a1cc_Rx: ComBitPosition=423, ComBitSize=1, ComSignalType=BOOLEAN, ComSystemTemplateSystemSignalRef=DET_SUPER_RES_TARGET_056_Rx
