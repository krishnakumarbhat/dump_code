[part 7 of 24: package /InitialEcuC]
AUTOSAR XML (schema 00053)
package /InitialEcuC  (continued)
  module config Com  (continued)
    ComConfig  (continued)
      242 x ComSignalGroup, all with ComTransferProperty=PENDING:  (continued)
        SG_Detections_065_068_oRDR_DETECTION_065_068_oPCAN_RADAR_f1154101_Tx: ComSystemTemplateSignalGroupRef=SG_Detections_065_068
          83 x ComGroupSignal, all with ComSignalEndianness=LITTLE_ENDIAN, ComTransferProperty=PENDING:
            DET_AZIMUTH_065_oRDR_DETECTION_065_068_oPCAN_RADAR_57038a17_Tx: ComBitPosition=88, ComBitSize=13, ComSignalInitValue=0, ComSignalType=UINT16, ComSystemTemplateSystemSignalRef=DET_AZIMUTH_065
            DET_AZIMUTH_066_oRDR_DETECTION_065_068_oPCAN_RADAR_33e3f1e9_Tx: ComBitPosition=200, ComBitSize=13, ComSignalInitValue=0, ComSignalType=UINT16, ComSystemTemplateSystemSignalRef=DET_AZIMUTH_066
            DET_AZIMUTH_067_oRDR_DETECTION_065_068_oPCAN_RADAR_a693257c_Tx: ComBitPosition=312, ComBitSize=13, ComSignalInitValue=0, ComSignalType=UINT16, ComSystemTemplateSystemSignalRef=DET_AZIMUTH_067
            DET_AZIMUTH_068_oRDR_DETECTION_065_068_oPCAN_RADAR_8a83b73b_Tx: ComBitPosition=424, ComBitSize=13, ComSignalInitValue=0, ComSignalType=UINT16, ComSystemTemplateSystemSignalRef=DET_AZIMUTH_068
            DET_AZIMUTH_ERR_065_oRDR_DETECTION_065_068_oPCAN_RADAR_f3b61fe2_Tx: ComBitPosition=105, ComBitSize=7, ComSignalInitValue=0, ComSignalType=UINT8, ComSystemTemplateSystemSignalRef=DET_AZIMUTH_ERR_065
            DET_AZIMUTH_ERR_066_oRDR_DETECTION_065_068_oPCAN_RADAR_9756641c_Tx: ComBitPosition=217, ComBitSize=7, ComSignalInitValue=0, ComSignalType=UINT8, ComSystemTemplateSystemSignalRef=DET_AZIMUTH_ERR_066
            DET_AZIMUTH_ERR_067_oRDR_DETECTION_065_068_oPCAN_RADAR_0226b089_Tx: ComBitPosition=329, ComBitSize=7, ComSignalInitValue=0, ComSignalType=UINT8, ComSystemTemplateSystemSignalRef=DET_AZIMUTH_ERR_067
            DET_AZIMUTH_ERR_068_oRDR_DETECTION_065_068_oPCAN_RADAR_2e3622ce_Tx: ComBitPosition=441, ComBitSize=7, ComSignalInitValue=0, ComSignalType=UINT8, ComSystemTemplateSystemSignalRef=DET_AZIMUTH_ERR_068
            DET_BELOW_RAIN_THOLD_065_oRDR_DETECTION_065_068_oPCAN_RADAR_820219d7_Tx: ComBitPosition=39, ComBitSize=1, ComSignalInitValue=0, ComSignalType=BOOLEAN, ComSystemTemplateSystemSignalRef=DET_BELOW_RAIN_THOLD_065
            DET_BELOW_RAIN_THOLD_066_oRDR_DETECTION_065_068_oPCAN_RADAR_e6e26229_Tx: ComBitPosition=151, ComBitSize=1, ComSignalInitValue=0, ComSignalType=BOOLEAN, ComSystemTemplateSystemSignalRef=DET_BELOW_RAIN_THOLD_066
            DET_BELOW_RAIN_THOLD_067_oRDR_DETECTION_065_068_oPCAN_RADAR_7392b6bc_Tx: ComBitPosition=263, ComBitSize=1, ComSignalInitValue=0, ComSignalType=BOOLEAN, ComSystemTemplateSystemSignalRef=DET_BELOW_RAIN_THOLD_067
            DET_BELOW_RAIN_THOLD_068_oRDR_DETECTION_065_068_oPCAN_RADAR_5f8224fb_Tx: ComBitPosition=375, ComBitSize=1, ComSignalInitValue=0, ComSignalType=BOOLEAN, ComSystemTemplateSystemSignalRef=DET_BELOW_RAIN_THOLD_068
            DET_BI_STATIC_FLAG_065_oRDR_DETECTION_065_068_oPCAN_RADAR_012fca92_Tx: ComBitPosition=104, ComBitSize=1, ComSignalInitValue=0, ComSignalType=BOOLEAN, ComSystemTemplateSystemSignalRef=DET_BI_STATIC_FLAG_065
            DET_BI_STATIC_FLAG_066_oRDR_DETECTION_065_068_oPCAN_RADAR_65cfb16c_Tx: ComBitPosition=216, ComBitSize=1, ComSignalInitValue=0, ComSignalType=BOOLEAN, ComSystemTemplateSystemSignalRef=DET_BI_STATIC_FLAG_066
            DET_BI_STATIC_FLAG_067_oRDR_DETECTION_065_068_oPCAN_RADAR_f0bf65f9_Tx: ComBitPosition=328, ComBitSize=1, ComSignalInitValue=0, ComSignalType=BOOLEAN, ComSystemTemplateSystemSignalRef=DET_BI_STATIC_FLAG_067
            DET_BI_STATIC_FLAG_068_oRDR_DETECTION_065_068_oPCAN_RADAR_dcaff7be_Tx: ComBitPosition=440, ComBitSize=1, ComSignalInitValue=0, ComSignalType=BOOLEAN, ComSystemTemplateSystemSignalRef=DET_BI_STATIC_FLAG_068
            DET_CONFD_AZIMUTH_065_oRDR_DETECTION_065_068_oPCAN_RADAR_55e580dd_Tx: ComBitPosition=118, ComBitSize=2, ComSignalInitValue=0, ComSignalType=UINT8, ComSystemTemplateSystemSignalRef=DET_CONFD_AZIMUTH_065
            DET_CONFD_AZIMUTH_066_oRDR_DETECTION_065_068_oPCAN_RADAR_3105fb23_Tx: ComBitPosition=230, ComBitSize=2, ComSignalInitValue=0, ComSignalType=UINT8, ComSystemTemplateSystemSignalRef=DET_CONFD_AZIMUTH_066
            DET_CONFD_AZIMUTH_067_oRDR_DETECTION_065_068_oPCAN_RADAR_a4752fb6_Tx: ComBitPosition=342, ComBitSize=2, ComSignalInitValue=0, ComSignalType=UINT8, ComSystemTemplateSystemSignalRef=DET_CONFD_AZIMUTH_067
            DET_CONFD_AZIMUTH_068_oRDR_DETECTION_065_068_oPCAN_RADAR_8865bdf1_Tx: ComBitPosition=454, ComBitSize=2, ComSignalInitValue=0, ComSignalType=UINT8, ComSystemTemplateSystemSignalRef=DET_CONFD_AZIMUTH_068
            DET_CONFD_ELEVATION_065_oRDR_DETECTION_065_068_oPCAN_RADAR_57708127_Tx: ComBitPosition=101, ComBitSize=2, ComSignalInitValue=0, ComSignalType=UINT8, ComSystemTemplateSystemSignalRef=DET_CONFD_ELEVATION_065
            DET_CONFD_ELEVATION_066_oRDR_DETECTION_065_068_oPCAN_RADAR_3390fad9_Tx: ComBitPosition=213, ComBitSize=2, ComSignalInitValue=0, ComSignalType=UINT8, ComSystemTemplateSystemSignalRef=DET_CONFD_ELEVATION_066
            DET_CONFD_ELEVATION_067_oRDR_DETECTION_065_068_oPCAN_RADAR_a6e02e4c_Tx: ComBitPosition=325, ComBitSize=2, ComSignalInitValue=0, ComSignalType=UINT8, ComSystemTemplateSystemSignalRef=DET_CONFD_ELEVATION_067
            DET_CONFD_ELEVATION_068_oRDR_DETECTION_065_068_oPCAN_RADAR_8af0bc0b_Tx: ComBitPosition=437, ComBitSize=2, ComSignalInitValue=0, ComSignalType=UINT8, ComSystemTemplateSystemSignalRef=DET_CONFD_ELEVATION_068
            DET_ELEVATION_065_oRDR_DETECTION_065_068_oPCAN_RADAR_86b0551b_Tx: ComBitPosition=72, ComBitSize=8, ComSignalInitValue=0, ComSignalType=UINT8, ComSystemTemplateSystemSignalRef=DET_ELEVATION_065
            DET_ELEVATION_066_oRDR_DETECTION_065_068_oPCAN_RADAR_e2502ee5_Tx: ComBitPosition=184, ComBitSize=8, ComSignalInitValue=0, ComSignalType=UINT8, ComSystemTemplateSystemSignalRef=DET_ELEVATION_066
            DET_ELEVATION_067_oRDR_DETECTION_065_068_oPCAN_RADAR_7720fa70_Tx: ComBitPosition=296, ComBitSize=8, ComSignalInitValue=0, ComSignalType=UINT8, ComSystemTemplateSystemSignalRef=DET_ELEVATION_067
            DET_ELEVATION_068_oRDR_DETECTION_065_068_oPCAN_RADAR_5b306837_Tx: ComBitPosition=408, ComBitSize=8, ComSignalInitValue=0, ComSignalType=UINT8, ComSystemTemplateSystemSignalRef=DET_ELEVATION_068
            DET_ELEVATION_ERR_065_oRDR_DETECTION_065_068_oPCAN_RADAR_0189cd6e_Tx: ComBitPosition=80, ComBitSize=6, ComSignalInitValue=0, ComSignalType=UINT8, ComSystemTemplateSystemSignalRef=DET_ELEVATION_ERR_065
            DET_ELEVATION_ERR_066_oRDR_DETECTION_065_068_oPCAN_RADAR_6569b690_Tx: ComBitPosition=192, ComBitSize=6, ComSignalInitValue=0, ComSignalType=UINT8, ComSystemTemplateSystemSignalRef=DET_ELEVATION_ERR_066
            DET_ELEVATION_ERR_067_oRDR_DETECTION_065_068_oPCAN_RADAR_f0196205_Tx: ComBitPosition=304, ComBitSize=6, ComSignalInitValue=0, ComSignalType=UINT8, ComSystemTemplateSystemSignalRef=DET_ELEVATION_ERR_067
            DET_ELEVATION_ERR_068_oRDR_DETECTION_065_068_oPCAN_RADAR_dc09f042_Tx: ComBitPosition=416, ComBitSize=6, ComSignalInitValue=0, ComSignalType=UINT8, ComSystemTemplateSystemSignalRef=DET_ELEVATION_ERR_068
            DET_EXISTENCE_PROB_065_oRDR_DETECTION_065_068_oPCAN_RADAR_d316b80e_Tx: ComBitPosition=112, ComBitSize=6, ComSignalInitValue=0, ComSignalType=UINT8, ComSystemTemplateSystemSignalRef=DET_EXISTENCE_PROB_065
            DET_EXISTENCE_PROB_066_oRDR_DETECTION_065_068_oPCAN_RADAR_b7f6c3f0_Tx: ComBitPosition=224, ComBitSize=6, ComSignalInitValue=0, ComSignalType=UINT8, ComSystemTemplateSystemSignalRef=DET_EXISTENCE_PROB_066
            DET_EXISTENCE_PROB_067_oRDR_DETECTION_065_068_oPCAN_RADAR_22861765_Tx: ComBitPosition=336, ComBitSize=6, ComSignalInitValue=0, ComSignalType=UINT8, ComSystemTemplateSystemSignalRef=DET_EXISTENCE_PROB_067
            DET_EXISTENCE_PROB_068_oRDR_DETECTION_065_068_oPCAN_RADAR_0e968522_Tx: ComBitPosition=448, ComBitSize=6, ComSignalInitValue=0, ComSignalType=UINT8, ComSystemTemplateSystemSignalRef=DET_EXISTENCE_PROB_068
            DET_HVC_FLAG_065_oRDR_DETECTION_065_068_oPCAN_RADAR_3262fb71_Tx: ComBitPosition=86, ComBitSize=1, ComSignalInitValue=0, ComSignalType=BOOLEAN, ComSystemTemplateSystemSignalRef=DET_HVC_FLAG_065
            DET_HVC_FLAG_066_oRDR_DETECTION_065_068_oPCAN_RADAR_5682808f_Tx: ComBitPosition=198, ComBitSize=1, ComSignalInitValue=0, ComSignalType=BOOLEAN, ComSystemTemplateSystemSignalRef=DET_HVC_FLAG_066
            DET_HVC_FLAG_067_oRDR_DETECTION_065_068_oPCAN_RADAR_c3f2541a_Tx: ComBitPosition=310, ComBitSize=1, ComSignalInitValue=0, ComSignalType=BOOLEAN, ComSystemTemplateSystemSignalRef=DET_HVC_FLAG_067
            DET_HVC_FLAG_068_oRDR_DETECTION_065_068_oPCAN_RADAR_efe2c65d_Tx: ComBitPosition=422, ComBitSize=1, ComSignalInitValue=0, ComSignalType=BOOLEAN, ComSystemTemplateSystemSignalRef=DET_HVC_FLAG_068
            DET_IDM_065_oRDR_DETECTION_065_068_oPCAN_RADAR_b930c0cc_Tx: ComBitPosition=63, ComBitSize=1, ComSignalInitValue=0, ComSignalType=BOOLEAN, ComSystemTemplateSystemSignalRef=DET_IDM_065
            DET_IDM_066_oRDR_DETECTION_065_068_oPCAN_RADAR_ddd0bb32_Tx: ComBitPosition=175, ComBitSize=1, ComSignalInitValue=0, ComSignalType=BOOLEAN, ComSystemTemplateSystemSignalRef=DET_IDM_066
            DET_IDM_067_oRDR_DETECTION_065_068_oPCAN_RADAR_48a06fa7_Tx: ComBitPosition=287, ComBitSize=1, ComSignalInitValue=0, ComSignalType=BOOLEAN, ComSystemTemplateSystemSignalRef=DET_IDM_067
            DET_IDM_068_oRDR_DETECTION_065_068_oPCAN_RADAR_64b0fde0_Tx: ComBitPosition=399, ComBitSize=1, ComSignalInitValue=0, ComSignalType=BOOLEAN, ComSystemTemplateSystemSignalRef=DET_IDM_068
            DET_MH_CRC16_065_068_oRDR_DETECTION_065_068_oPCAN_RADAR_759d930a_Tx: ComBitPosition=0, ComBitSize=16, ComSignalInitValue=0, ComSignalType=UINT16, ComSystemTemplateSystemSignalRef=DET_MH_CRC16_065_068
            DET_MH_CYCLE_COUNTER_065_068_oRDR_DETECTION_065_068_oPCAN_RADAR_f1e8323d_Tx: ComBitPosition=16, ComBitSize=8, ComSignalInitValue=0, ComSignalType=UINT8, ComSystemTemplateSystemSignalRef=DET_MH_CYCLE_COUNTER_065_068
            DET_MH_SCAN_INDEX_4LSB_065_068_oRDR_DETECTION_065_068_oPCAN_RADAR_3dc217b1_Tx: ComBitPosition=476, ComBitSize=4, ComSignalInitValue=0, ComSignalType=UINT8, ComSystemTemplateSystemSignalRef=DET_MH_SCAN_INDEX_4LSB_065_068
            DET_MTD_065_oRDR_DETECTION_065_068_oPCAN_RADAR_df83f217_Tx: ComBitPosition=47, ComBitSize=1, ComSignalInitValue=0, ComSignalType=BOOLEAN, ComSystemTemplateSystemSignalRef=DET_MTD_065
            DET_MTD_066_oRDR_DETECTION_065_068_oPCAN_RADAR_bb6389e9_Tx: ComBitPosition=159, ComBitSize=1, ComSignalInitValue=0, ComSignalType=BOOLEAN, ComSystemTemplateSystemSignalRef=DET_MTD_066
            DET_MTD_067_oRDR_DETECTION_065_068_oPCAN_RADAR_2e135d7c_Tx: ComBitPosition=271, ComBitSize=1, ComSignalInitValue=0, ComSignalType=BOOLEAN, ComSystemTemplateSystemSignalRef=DET_MTD_067
            DET_MTD_068_oRDR_DETECTION_065_068_oPCAN_RADAR_0203cf3b_Tx: ComBitPosition=383, ComBitSize=1, ComSignalInitValue=0, ComSignalType=BOOLEAN, ComSystemTemplateSystemSignalRef=DET_MTD_068
            DET_PROB_1STAZHYPO_065_oRDR_DETECTION_065_068_oPCAN_RADAR_4c371ada_Tx: ComBitPosition=103, ComBitSize=1, ComSignalInitValue=0, ComSignalType=BOOLEAN, ComSystemTemplateSystemSignalRef=DET_PROB_1STAZHYPO_065
            DET_PROB_1STAZHYPO_066_oRDR_DETECTION_065_068_oPCAN_RADAR_28d76124_Tx: ComBitPosition=215, ComBitSize=1, ComSignalInitValue=0, ComSignalType=BOOLEAN, ComSystemTemplateSystemSignalRef=DET_PROB_1STAZHYPO_066
            DET_PROB_1STAZHYPO_067_oRDR_DETECTION_065_068_oPCAN_RADAR_bda7b5b1_Tx: ComBitPosition=327, ComBitSize=1, ComSignalInitValue=0, ComSignalType=BOOLEAN, ComSystemTemplateSystemSignalRef=DET_PROB_1STAZHYPO_067
            DET_PROB_1STAZHYPO_068_oRDR_DETECTION_065_068_oPCAN_RADAR_91b727f6_Tx: ComBitPosition=439, ComBitSize=1, ComSignalInitValue=0, ComSignalType=BOOLEAN, ComSystemTemplateSystemSignalRef=DET_PROB_1STAZHYPO_068
            DET_RANGE_065_oRDR_DETECTION_065_068_oPCAN_RADAR_4798f9ac_Tx: ComBitPosition=24, ComBitSize=15, ComSignalInitValue=0, ComSignalType=UINT16, ComSystemTemplateSystemSignalRef=DET_RANGE_065
            DET_RANGE_066_oRDR_DETECTION_065_068_oPCAN_RADAR_23788252_Tx: ComBitPosition=136, ComBitSize=15, ComSignalInitValue=0, ComSignalType=UINT16, ComSystemTemplateSystemSignalRef=DET_RANGE_066
            DET_RANGE_067_oRDR_DETECTION_065_068_oPCAN_RADAR_b60856c7_Tx: ComBitPosition=248, ComBitSize=15, ComSignalInitValue=0, ComSignalType=UINT16, ComSystemTemplateSystemSignalRef=DET_RANGE_067
            DET_RANGE_068_oRDR_DETECTION_065_068_oPCAN_RADAR_9a18c480_Tx: ComBitPosition=360, ComBitSize=15, ComSignalInitValue=0, ComSignalType=UINT16, ComSystemTemplateSystemSignalRef=DET_RANGE_068
            DET_RANGE_ERR_065_oRDR_DETECTION_065_068_oPCAN_RADAR_e07043c5_Tx: ComBitPosition=40, ComBitSize=7, ComSignalInitValue=0, ComSignalType=UINT8, ComSystemTemplateSystemSignalRef=DET_RANGE_ERR_065
            DET_RANGE_ERR_066_oRDR_DETECTION_065_068_oPCAN_RADAR_8490383b_Tx: ComBitPosition=152, ComBitSize=7, ComSignalInitValue=0, ComSignalType=UINT8, ComSystemTemplateSystemSignalRef=DET_RANGE_ERR_066
            DET_RANGE_ERR_067_oRDR_DETECTION_065_068_oPCAN_RADAR_11e0ecae_Tx: ComBitPosition=264, ComBitSize=7, ComSignalInitValue=0, ComSignalType=UINT8, ComSystemTemplateSystemSignalRef=DET_RANGE_ERR_067
            DET_RANGE_ERR_068_oRDR_DETECTION_065_068_oPCAN_RADAR_3df07ee9_Tx: ComBitPosition=376, ComBitSize=7, ComSignalInitValue=0, ComSignalType=UINT8, ComSystemTemplateSystemSignalRef=DET_RANGE_ERR_068
            DET_RANGE_VELOCITY_065_oRDR_DETECTION_065_068_oPCAN_RADAR_323e3b89_Tx: ComBitPosition=48, ComBitSize=15, ComSignalInitValue=16384, ComSignalType=UINT16, ComSystemTemplateSystemSignalRef=DET_RANGE_VELOCITY_065
            DET_RANGE_VELOCITY_066_oRDR_DETECTION_065_068_oPCAN_RADAR_56de4077_Tx: ComBitPosition=160, ComBitSize=15, ComSignalInitValue=16384, ComSignalType=UINT16, ComSystemTemplateSystemSignalRef=DET_RANGE_VELOCITY_066
            DET_RANGE_VELOCITY_067_oRDR_DETECTION_065_068_oPCAN_RADAR_c3ae94e2_Tx: ComBitPosition=272, ComBitSize=15, ComSignalInitValue=16384, ComSignalType=UINT16, ComSystemTemplateSystemSignalRef=DET_RANGE_VELOCITY_067
            DET_RANGE_VELOCITY_068_oRDR_DETECTION_065_068_oPCAN_RADAR_efbe06a5_Tx: ComBitPosition=384, ComBitSize=15, ComSignalInitValue=16384, ComSignalType=UINT16, ComSystemTemplateSystemSignalRef=DET_RANGE_VELOCITY_068
            DET_RANGE_VELOCITY_ERR_065_oRDR_DETECTION_065_068_oPCAN_RADAR_3d85c03b_Tx: ComBitPosition=64, ComBitSize=8, ComSignalInitValue=0, ComSignalType=UINT8, ComSystemTemplateSystemSignalRef=DET_RANGE_VELOCITY_ERR_065
            DET_RANGE_VELOCITY_ERR_066_oRDR_DETECTION_065_068_oPCAN_RADAR_5965bbc5_Tx: ComBitPosition=176, ComBitSize=8, ComSignalInitValue=0, ComSignalType=UINT8, ComSystemTemplateSystemSignalRef=DET_RANGE_VELOCITY_ERR_066
            DET_RANGE_VELOCITY_ERR_067_oRDR_DETECTION_065_068_oPCAN_RADAR_cc156f50_Tx: ComBitPosition=288, ComBitSize=8, ComSignalInitValue=0, ComSignalType=UINT8, ComSystemTemplateSystemSignalRef=DET_RANGE_VELOCITY_ERR_067
            DET_RANGE_VELOCITY_ERR_068_oRDR_DETECTION_065_068_oPCAN_RADAR_e005fd17_Tx: ComBitPosition=400, ComBitSize=8, ComSignalInitValue=0, ComSignalType=UINT8, ComSystemTemplateSystemSignalRef=DET_RANGE_VELOCITY_ERR_068
            DET_RCS_065_oRDR_DETECTION_065_068_oPCAN_RADAR_b5be0cd3_Tx: ComBitPosition=128, ComBitSize=8, ComSignalInitValue=128, ComSignalType=UINT8, ComSystemTemplateSystemSignalRef=DET_RCS_065
            DET_RCS_066_oRDR_DETECTION_065_068_oPCAN_RADAR_d15e772d_Tx: ComBitPosition=240, ComBitSize=8, ComSignalInitValue=128, ComSignalType=UINT8, ComSystemTemplateSystemSignalRef=DET_RCS_066
            DET_RCS_067_oRDR_DETECTION_065_068_oPCAN_RADAR_442ea3b8_Tx: ComBitPosition=352, ComBitSize=8, ComSignalInitValue=128, ComSignalType=UINT8, ComSystemTemplateSystemSignalRef=DET_RCS_067
            DET_RCS_068_oRDR_DETECTION_065_068_oPCAN_RADAR_683e31ff_Tx: ComBitPosition=464, ComBitSize=8, ComSignalInitValue=128, ComSignalType=UINT8, ComSystemTemplateSystemSignalRef=DET_RCS_068
            DET_SNR_065_oRDR_DETECTION_065_068_oPCAN_RADAR_681058d1_Tx: ComBitPosition=120, ComBitSize=8, ComSignalInitValue=0, ComSignalType=UINT8, ComSystemTemplateSystemSignalRef=DET_SNR_065
            DET_SNR_066_oRDR_DETECTION_065_068_oPCAN_RADAR_0cf0232f_Tx: ComBitPosition=232, ComBitSize=8, ComSignalInitValue=0, ComSignalType=UINT8, ComSystemTemplateSystemSignalRef=DET_SNR_066
            DET_SNR_067_oRDR_DETECTION_065_068_oPCAN_RADAR_9980f7ba_Tx: ComBitPosition=344, ComBitSize=8, ComSignalInitValue=0, ComSignalType=UINT8, ComSystemTemplateSystemSignalRef=DET_SNR_067
            DET_SNR_068_oRDR_DETECTION_065_068_oPCAN_RADAR_b59065fd_Tx: ComBitPosition=456, ComBitSize=8, ComSignalInitValue=0, ComSignalType=UINT8, ComSystemTemplateSystemSignalRef=DET_SNR_068
            DET_SUPER_RES_TARGET_065_oRDR_DETECTION_065_068_oPCAN_RADAR_598970b4_Tx: ComBitPosition=87, ComBitSize=1, ComSignalInitValue=0, ComSignalType=BOOLEAN, ComSystemTemplateSystemSignalRef=DET_SUPER_RES_TARGET_065
            DET_SUPER_RES_TARGET_066_oRDR_DETECTION_065_068_oPCAN_RADAR_3d690b4a_Tx: ComBitPosition=199, ComBitSize=1, ComSignalInitValue=0, ComSignalType=BOOLEAN, ComSystemTemplateSystemSignalRef=DET_SUPER_RES_TARGET_066
            DET_SUPER_RES_TARGET_067_oRDR_DETECTION_065_068_oPCAN_RADAR_a819dfdf_Tx: ComBitPosition=311, ComBitSize=1, ComSignalInitValue=0, ComSignalType=BOOLEAN, ComSystemTemplateSystemSignalRef=DET_SUPER_RES_TARGET_067
            DET_SUPER_RES_TARGET_068_oRDR_DETECTION_065_068_oPCAN_RADAR_84094d98_Tx: ComBitPosition=423, ComBitSize=1, ComSignalInitValue=0, ComSignalType=BOOLEAN, ComSystemTemplateSystemSignalRef=DET_SUPER_RES_TARGET_068
        SG_Detections_069_072_oRDR_DETECTION_069_072_oPCAN_RADAR_686f657a_Tx: ComSystemTemplateSignalGroupRef=SG_Detections_069_072
          83 x ComGroupSignal, all with ComSignalEndianness=LITTLE_ENDIAN, ComTransferProperty=PENDING:
            DET_AZIMUTH_069_oRDR_DETECTION_069_072_oPCAN_RADAR_2dbb8caf_Tx: ComBitPosition=88, ComBitSize=13, ComSignalInitValue=0, ComSignalType=UINT16, ComSystemTemplateSystemSignalRef=DET_AZIMUTH_069
            DET_AZIMUTH_070_oRDR_DETECTION_069_072_oPCAN_RADAR_489bfe0b_Tx: ComBitPosition=200, ComBitSize=13, ComSignalInitValue=0, ComSignalType=UINT16, ComSystemTemplateSystemSignalRef=DET_AZIMUTH_070
            DET_AZIMUTH_071_oRDR_DETECTION_069_072_oPCAN_RADAR_ddeb2a9e_Tx: ComBitPosition=312, ComBitSize=13, ComSignalInitValue=0, ComSignalType=UINT16, ComSystemTemplateSystemSignalRef=DET_AZIMUTH_071
            DET_AZIMUTH_072_oRDR_DETECTION_069_072_oPCAN_RADAR_b90b5160_Tx: ComBitPosition=424, ComBitSize=13, ComSignalInitValue=0, ComSignalType=UINT16, ComSystemTemplateSystemSignalRef=DET_AZIMUTH_072
            DET_AZIMUTH_ERR_069_oRDR_DETECTION_069_072_oPCAN_RADAR_890e195a_Tx: ComBitPosition=105, ComBitSize=7, ComSignalInitValue=0, ComSignalType=UINT8, ComSystemTemplateSystemSignalRef=DET_AZIMUTH_ERR_069
            DET_AZIMUTH_ERR_070_oRDR_DETECTION_069_072_oPCAN_RADAR_ec2e6bfe_Tx: ComBitPosition=217, ComBitSize=7, ComSignalInitValue=0, ComSignalType=UINT8, ComSystemTemplateSystemSignalRef=DET_AZIMUTH_ERR_070
            DET_AZIMUTH_ERR_071_oRDR_DETECTION_069_072_oPCAN_RADAR_795ebf6b_Tx: ComBitPosition=329, ComBitSize=7, ComSignalInitValue=0, ComSignalType=UINT8, ComSystemTemplateSystemSignalRef=DET_AZIMUTH_ERR_071
            DET_AZIMUTH_ERR_072_oRDR_DETECTION_069_072_oPCAN_RADAR_1dbec495_Tx: ComBitPosition=441, ComBitSize=7, ComSignalInitValue=0, ComSignalType=UINT8, ComSystemTemplateSystemSignalRef=DET_AZIMUTH_ERR_072
            DET_BELOW_RAIN_THOLD_069_oRDR_DETECTION_069_072_oPCAN_RADAR_f8ba1f6f_Tx: ComBitPosition=39, ComBitSize=1, ComSignalInitValue=0, ComSignalType=BOOLEAN, ComSystemTemplateSystemSignalRef=DET_BELOW_RAIN_THOLD_069
            DET_BELOW_RAIN_THOLD_070_oRDR_DETECTION_069_072_oPCAN_RADAR_9d9a6dcb_Tx: ComBitPosition=151, ComBitSize=1, ComSignalInitValue=0, ComSignalType=BOOLEAN, ComSystemTemplateSystemSignalRef=DET_BELOW_RAIN_THOLD_070
            DET_BELOW_RAIN_THOLD_071_oRDR_DETECTION_069_072_oPCAN_RADAR_08eab95e_Tx: ComBitPosition=263, ComBitSize=1, ComSignalInitValue=0, ComSignalType=BOOLEAN, ComSystemTemplateSystemSignalRef=DET_BELOW_RAIN_THOLD_071
            DET_BELOW_RAIN_THOLD_072_oRDR_DETECTION_069_072_oPCAN_RADAR_6c0ac2a0_Tx: ComBitPosition=375, ComBitSize=1, ComSignalInitValue=0, ComSignalType=BOOLEAN, ComSystemTemplateSystemSignalRef=DET_BELOW_RAIN_THOLD_072
            DET_BI_STATIC_FLAG_069_oRDR_DETECTION_069_072_oPCAN_RADAR_7b97cc2a_Tx: ComBitPosition=104, ComBitSize=1, ComSignalInitValue=0, ComSignalType=BOOLEAN, ComSystemTemplateSystemSignalRef=DET_BI_STATIC_FLAG_069
            DET_BI_STATIC_FLAG_070_oRDR_DETECTION_069_072_oPCAN_RADAR_1eb7be8e_Tx: ComBitPosition=216, ComBitSize=1, ComSignalInitValue=0, ComSignalType=BOOLEAN, ComSystemTemplateSystemSignalRef=DET_BI_STATIC_FLAG_070
            DET_BI_STATIC_FLAG_071_oRDR_DETECTION_069_072_oPCAN_RADAR_8bc76a1b_Tx: ComBitPosition=328, ComBitSize=1, ComSignalInitValue=0, ComSignalType=BOOLEAN, ComSystemTemplateSystemSignalRef=DET_BI_STATIC_FLAG_071
            DET_BI_STATIC_FLAG_072_oRDR_DETECTION_069_072_oPCAN_RADAR_ef2711e5_Tx: ComBitPosition=440, ComBitSize=1, ComSignalInitValue=0, ComSignalType=BOOLEAN, ComSystemTemplateSystemSignalRef=DET_BI_STATIC_FLAG_072
            DET_CONFD_AZIMUTH_069_oRDR_DETECTION_069_072_oPCAN_RADAR_2f5d8665_Tx: ComBitPosition=118, ComBitSize=2, ComSignalInitValue=0, ComSignalType=UINT8, ComSystemTemplateSystemSignalRef=DET_CONFD_AZIMUTH_069
            DET_CONFD_AZIMUTH_070_oRDR_DETECTION_069_072_oPCAN_RADAR_4a7df4c1_Tx: ComBitPosition=230, ComBitSize=2, ComSignalInitValue=0, ComSignalType=UINT8, ComSystemTemplateSystemSignalRef=DET_CONFD_AZIMUTH_070
            DET_CONFD_AZIMUTH_071_oRDR_DETECTION_069_072_oPCAN_RADAR_df0d2054_Tx: ComBitPosition=342, ComBitSize=2, ComSignalInitValue=0, ComSignalType=UINT8, ComSystemTemplateSystemSignalRef=DET_CONFD_AZIMUTH_071
            DET_CONFD_AZIMUTH_072_oRDR_DETECTION_069_072_oPCAN_RADAR_bbed5baa_Tx: ComBitPosition=454, ComBitSize=2, ComSignalInitValue=0, ComSignalType=UINT8, ComSystemTemplateSystemSignalRef=DET_CONFD_AZIMUTH_072
            DET_CONFD_ELEVATION_069_oRDR_DETECTION_069_072_oPCAN_RADAR_2dc8879f_Tx: ComBitPosition=101, ComBitSize=2, ComSignalInitValue=0, ComSignalType=UINT8, ComSystemTemplateSystemSignalRef=DET_CONFD_ELEVATION_069
            DET_CONFD_ELEVATION_070_oRDR_DETECTION_069_072_oPCAN_RADAR_48e8f53b_Tx: ComBitPosition=213, ComBitSize=2, ComSignalInitValue=0, ComSignalType=UINT8, ComSystemTemplateSystemSignalRef=DET_CONFD_ELEVATION_070
            DET_CONFD_ELEVATION_071_oRDR_DETECTION_069_072_oPCAN_RADAR_dd9821ae_Tx: ComBitPosition=325, ComBitSize=2, ComSignalInitValue=0, ComSignalType=UINT8, ComSystemTemplateSystemSignalRef=DET_CONFD_ELEVATION_071
            DET_CONFD_ELEVATION_072_oRDR_DETECTION_069_072_oPCAN_RADAR_b9785a50_Tx: ComBitPosition=437, ComBitSize=2, ComSignalInitValue=0, ComSignalType=UINT8, ComSystemTemplateSystemSignalRef=DET_CONFD_ELEVATION_072
            DET_ELEVATION_069_oRDR_DETECTION_069_072_oPCAN_RADAR_fc0853a3_Tx: ComBitPosition=72, ComBitSize=8, ComSignalInitValue=0, ComSignalType=UINT8, ComSystemTemplateSystemSignalRef=DET_ELEVATION_069
            DET_ELEVATION_070_oRDR_DETECTION_069_072_oPCAN_RADAR_99282107_Tx: ComBitPosition=184, ComBitSize=8, ComSignalInitValue=0, ComSignalType=UINT8, ComSystemTemplateSystemSignalRef=DET_ELEVATION_070
            DET_ELEVATION_071_oRDR_DETECTION_069_072_oPCAN_RADAR_0c58f592_Tx: ComBitPosition=296, ComBitSize=8, ComSignalInitValue=0, ComSignalType=UINT8, ComSystemTemplateSystemSignalRef=DET_ELEVATION_071
            DET_ELEVATION_072_oRDR_DETECTION_069_072_oPCAN_RADAR_68b88e6c_Tx: ComBitPosition=408, ComBitSize=8, ComSignalInitValue=0, ComSignalType=UINT8, ComSystemTemplateSystemSignalRef=DET_ELEVATION_072
            DET_ELEVATION_ERR_069_oRDR_DETECTION_069_072_oPCAN_RADAR_7b31cbd6_Tx: ComBitPosition=80, ComBitSize=6, ComSignalInitValue=0, ComSignalType=UINT8, ComSystemTemplateSystemSignalRef=DET_ELEVATION_ERR_069
            DET_ELEVATION_ERR_070_oRDR_DETECTION_069_072_oPCAN_RADAR_1e11b972_Tx: ComBitPosition=192, ComBitSize=6, ComSignalInitValue=0, ComSignalType=UINT8, ComSystemTemplateSystemSignalRef=DET_ELEVATION_ERR_070
            DET_ELEVATION_ERR_071_oRDR_DETECTION_069_072_oPCAN_RADAR_8b616de7_Tx: ComBitPosition=304, ComBitSize=6, ComSignalInitValue=0, ComSignalType=UINT8, ComSystemTemplateSystemSignalRef=DET_ELEVATION_ERR_071
            DET_ELEVATION_ERR_072_oRDR_DETECTION_069_072_oPCAN_RADAR_ef811619_Tx: ComBitPosition=416, ComBitSize=6, ComSignalInitValue=0, ComSignalType=UINT8, ComSystemTemplateSystemSignalRef=DET_ELEVATION_ERR_072
            DET_EXISTENCE_PROB_069_oRDR_DETECTION_069_072_oPCAN_RADAR_a9aebeb6_Tx: ComBitPosition=112, ComBitSize=6, ComSignalInitValue=0, ComSignalType=UINT8, ComSystemTemplateSystemSignalRef=DET_EXISTENCE_PROB_069
            DET_EXISTENCE_PROB_070_oRDR_DETECTION_069_072_oPCAN_RADAR_cc8ecc12_Tx: ComBitPosition=224, ComBitSize=6, ComSignalInitValue=0, ComSignalType=UINT8, ComSystemTemplateSystemSignalRef=DET_EXISTENCE_PROB_070
            DET_EXISTENCE_PROB_071_oRDR_DETECTION_069_072_oPCAN_RADAR_59fe1887_Tx: ComBitPosition=336, ComBitSize=6, ComSignalInitValue=0, ComSignalType=UINT8, ComSystemTemplateSystemSignalRef=DET_EXISTENCE_PROB_071
            DET_EXISTENCE_PROB_072_oRDR_DETECTION_069_072_oPCAN_RADAR_3d1e6379_Tx: ComBitPosition=448, ComBitSize=6, ComSignalInitValue=0, ComSignalType=UINT8, ComSystemTemplateSystemSignalRef=DET_EXISTENCE_PROB_072
            DET_HVC_FLAG_069_oRDR_DETECTION_069_072_oPCAN_RADAR_48dafdc9_Tx: ComBitPosition=86, ComBitSize=1, ComSignalInitValue=0, ComSignalType=BOOLEAN, ComSystemTemplateSystemSignalRef=DET_HVC_FLAG_069
            DET_HVC_FLAG_070_oRDR_DETECTION_069_072_oPCAN_RADAR_2dfa8f6d_Tx: ComBitPosition=198, ComBitSize=1, ComSignalInitValue=0, ComSignalType=BOOLEAN, ComSystemTemplateSystemSignalRef=DET_HVC_FLAG_070
            DET_HVC_FLAG_071_oRDR_DETECTION_069_072_oPCAN_RADAR_b88a5bf8_Tx: ComBitPosition=310, ComBitSize=1, ComSignalInitValue=0, ComSignalType=BOOLEAN, ComSystemTemplateSystemSignalRef=DET_HVC_FLAG_071
            DET_HVC_FLAG_072_oRDR_DETECTION_069_072_oPCAN_RADAR_dc6a2006_Tx: ComBitPosition=422, ComBitSize=1, ComSignalInitValue=0, ComSignalType=BOOLEAN, ComSystemTemplateSystemSignalRef=DET_HVC_FLAG_072
            DET_IDM_069_oRDR_DETECTION_069_072_oPCAN_RADAR_c388c674_Tx: ComBitPosition=63, ComBitSize=1, ComSignalInitValue=0, ComSignalType=BOOLEAN, ComSystemTemplateSystemSignalRef=DET_IDM_069
            DET_IDM_070_oRDR_DETECTION_069_072_oPCAN_RADAR_a6a8b4d0_Tx: ComBitPosition=175, ComBitSize=1, ComSignalInitValue=0, ComSignalType=BOOLEAN, ComSystemTemplateSystemSignalRef=DET_IDM_070
            DET_IDM_071_oRDR_DETECTION_069_072_oPCAN_RADAR_33d86045_Tx: ComBitPosition=287, ComBitSize=1, ComSignalInitValue=0, ComSignalType=BOOLEAN, ComSystemTemplateSystemSignalRef=DET_IDM_071
            DET_IDM_072_oRDR_DETECTION_069_072_oPCAN_RADAR_57381bbb_Tx: ComBitPosition=399, ComBitSize=1, ComSignalInitValue=0, ComSignalType=BOOLEAN, ComSystemTemplateSystemSignalRef=DET_IDM_072
            DET_MH_CRC16_069_072_oRDR_DETECTION_069_072_oPCAN_RADAR_ece7b771_Tx: ComBitPosition=0, ComBitSize=16, ComSignalInitValue=0, ComSignalType=UINT16, ComSystemTemplateSystemSignalRef=DET_MH_CRC16_069_072
            DET_MH_CYCLE_COUNTER_069_072_oRDR_DETECTION_069_072_oPCAN_RADAR_68921646_Tx: ComBitPosition=16, ComBitSize=8, ComSignalInitValue=0, ComSignalType=UINT8, ComSystemTemplateSystemSignalRef=DET_MH_CYCLE_COUNTER_069_072
            DET_MH_SCAN_INDEX_4LSB_069_072_oRDR_DETECTION_069_072_oPCAN_RADAR_a4b833ca_Tx: ComBitPosition=476, ComBitSize=4, ComSignalInitValue=0, ComSignalType=UINT8, ComSystemTemplateSystemSignalRef=DET_MH_SCAN_INDEX_4LSB_069_072
            DET_MTD_069_oRDR_DETECTION_069_072_oPCAN_RADAR_a53bf4af_Tx: ComBitPosition=47, ComBitSize=1, ComSignalInitValue=0, ComSignalType=BOOLEAN, ComSystemTemplateSystemSignalRef=DET_MTD_069
            DET_MTD_070_oRDR_DETECTION_069_072_oPCAN_RADAR_c01b860b_Tx: ComBitPosition=159, ComBitSize=1, ComSignalInitValue=0, ComSignalType=BOOLEAN, ComSystemTemplateSystemSignalRef=DET_MTD_070
            DET_MTD_071_oRDR_DETECTION_069_072_oPCAN_RADAR_556b529e_Tx: ComBitPosition=271, ComBitSize=1, ComSignalInitValue=0, ComSignalType=BOOLEAN, ComSystemTemplateSystemSignalRef=DET_MTD_071
            DET_MTD_072_oRDR_DETECTION_069_072_oPCAN_RADAR_318b2960_Tx: ComBitPosition=383, ComBitSize=1, ComSignalInitValue=0, ComSignalType=BOOLEAN, ComSystemTemplateSystemSignalRef=DET_MTD_072
            DET_PROB_1STAZHYPO_069_oRDR_DETECTION_069_072_oPCAN_RADAR_368f1c62_Tx: ComBitPosition=103, ComBitSize=1, ComSignalInitValue=0, ComSignalType=BOOLEAN, ComSystemTemplateSystemSignalRef=DET_PROB_1STAZHYPO_069
            DET_PROB_1STAZHYPO_070_oRDR_DETECTION_069_072_oPCAN_RADAR_53af6ec6_Tx: ComBitPosition=215, ComBitSize=1, ComSignalInitValue=0, ComSignalType=BOOLEAN, ComSystemTemplateSystemSignalRef=DET_PROB_1STAZHYPO_070
            DET_PROB_1STAZHYPO_071_oRDR_DETECTION_069_072_oPCAN_RADAR_c6dfba53_Tx: ComBitPosition=327, ComBitSize=1, ComSignalInitValue=0, ComSignalType=BOOLEAN, ComSystemTemplateSystemSignalRef=DET_PROB_1STAZHYPO_071
            DET_PROB_1STAZHYPO_072_oRDR_DETECTION_069_072_oPCAN_RADAR_a23fc1ad_Tx: ComBitPosition=439, ComBitSize=1, ComSignalInitValue=0, ComSignalType=BOOLEAN, ComSystemTemplateSystemSignalRef=DET_PROB_1STAZHYPO_072
            DET_RANGE_069_oRDR_DETECTION_069_072_oPCAN_RADAR_3d20ff14_Tx: ComBitPosition=24, ComBitSize=15, ComSignalInitValue=0, ComSignalType=UINT16, ComSystemTemplateSystemSignalRef=DET_RANGE_069
            DET_RANGE_070_oRDR_DETECTION_069_072_oPCAN_RADAR_58008db0_Tx: ComBitPosition=136, ComBitSize=15, ComSignalInitValue=0, ComSignalType=UINT16, ComSystemTemplateSystemSignalRef=DET_RANGE_070
            DET_RANGE_071_oRDR_DETECTION_069_072_oPCAN_RADAR_cd705925_Tx: ComBitPosition=248, ComBitSize=15, ComSignalInitValue=0, ComSignalType=UINT16, ComSystemTemplateSystemSignalRef=DET_RANGE_071
            DET_RANGE_072_oRDR_DETECTION_069_072_oPCAN_RADAR_a99022db_Tx: ComBitPosition=360, ComBitSize=15, ComSignalInitValue=0, ComSignalType=UINT16, ComSystemTemplateSystemSignalRef=DET_RANGE_072
            DET_RANGE_ERR_069_oRDR_DETECTION_069_072_oPCAN_RADAR_9ac8457d_Tx: ComBitPosition=40, ComBitSize=7, ComSignalInitValue=0, ComSignalType=UINT8, ComSystemTemplateSystemSignalRef=DET_RANGE_ERR_069
            DET_RANGE_ERR_070_oRDR_DETECTION_069_072_oPCAN_RADAR_ffe837d9_Tx: ComBitPosition=152, ComBitSize=7, ComSignalInitValue=0, ComSignalType=UINT8, ComSystemTemplateSystemSignalRef=DET_RANGE_ERR_070
            DET_RANGE_ERR_071_oRDR_DETECTION_069_072_oPCAN_RADAR_6a98e34c_Tx: ComBitPosition=264, ComBitSize=7, ComSignalInitValue=0, ComSignalType=UINT8, ComSystemTemplateSystemSignalRef=DET_RANGE_ERR_071
            DET_RANGE_ERR_072_oRDR_DETECTION_069_072_oPCAN_RADAR_0e7898b2_Tx: ComBitPosition=376, ComBitSize=7, ComSignalInitValue=0, ComSignalType=UINT8, ComSystemTemplateSystemSignalRef=DET_RANGE_ERR_072
            DET_RANGE_VELOCITY_069_oRDR_DETECTION_069_072_oPCAN_RADAR_48863d31_Tx: ComBitPosition=48, ComBitSize=15, ComSignalInitValue=16384, ComSignalType=UINT16, ComSystemTemplateSystemSignalRef=DET_RANGE_VELOCITY_069
            DET_RANGE_VELOCITY_070_oRDR_DETECTION_069_072_oPCAN_RADAR_2da64f95_Tx: ComBitPosition=160, ComBitSize=15, ComSignalInitValue=16384, ComSignalType=UINT16, ComSystemTemplateSystemSignalRef=DET_RANGE_VELOCITY_070
            DET_RANGE_VELOCITY_071_oRDR_DETECTION_069_072_oPCAN_RADAR_b8d69b00_Tx: ComBitPosition=272, ComBitSize=15, ComSignalInitValue=16384, ComSignalType=UINT16, ComSystemTemplateSystemSignalRef=DET_RANGE_VELOCITY_071
            DET_RANGE_VELOCITY_072_oRDR_DETECTION_069_072_oPCAN_RADAR_dc36e0fe_Tx: ComBitPosition=384, ComBitSize=15, ComSignalInitValue=16384, ComSignalType=UINT16, ComSystemTemplateSystemSignalRef=DET_RANGE_VELOCITY_072
            DET_RANGE_VELOCITY_ERR_069_oRDR_DETECTION_069_072_oPCAN_RADAR_473dc683_Tx: ComBitPosition=64, ComBitSize=8, ComSignalInitValue=0, ComSignalType=UINT8, ComSystemTemplateSystemSignalRef=DET_RANGE_VELOCITY_ERR_069
            DET_RANGE_VELOCITY_ERR_070_oRDR_DETECTION_069_072_oPCAN_RADAR_221db427_Tx: ComBitPosition=176, ComBitSize=8, ComSignalInitValue=0, ComSignalType=UINT8, ComSystemTemplateSystemSignalRef=DET_RANGE_VELOCITY_ERR_070
            DET_RANGE_VELOCITY_ERR_071_oRDR_DETECTION_069_072_oPCAN_RADAR_b76d60b2_Tx: ComBitPosition=288, ComBitSize=8, ComSignalInitValue=0, ComSignalType=UINT8, ComSystemTemplateSystemSignalRef=DET_RANGE_VELOCITY_ERR_071
            DET_RANGE_VELOCITY_ERR_072_oRDR_DETECTION_069_072_oPCAN_RADAR_d38d1b4c_Tx: ComBitPosition=400, ComBitSize=8, ComSignalInitValue=0, ComSignalType=UINT8, ComSystemTemplateSystemSignalRef=DET_RANGE_VELOCITY_ERR_072
            DET_RCS_069_oRDR_DETECTION_069_072_oPCAN_RADAR_cf060a6b_Tx: ComBitPosition=128, ComBitSize=8, ComSignalInitValue=128, ComSignalType=UINT8, ComSystemTemplateSystemSignalRef=DET_RCS_069
            DET_RCS_070_oRDR_DETECTION_069_072_oPCAN_RADAR_aa2678cf_Tx: ComBitPosition=240, ComBitSize=8, ComSignalInitValue=128, ComSignalType=UINT8, ComSystemTemplateSystemSignalRef=DET_RCS_070
            DET_RCS_071_oRDR_DETECTION_069_072_oPCAN_RADAR_3f56ac5a_Tx: ComBitPosition=352, ComBitSize=8, ComSignalInitValue=128, ComSignalType=UINT8, ComSystemTemplateSystemSignalRef=DET_RCS_071
            DET_RCS_072_oRDR_DETECTION_069_072_oPCAN_RADAR_5bb6d7a4_Tx: ComBitPosition=464, ComBitSize=8, ComSignalInitValue=128, ComSignalType=UINT8, ComSystemTemplateSystemSignalRef=DET_RCS_072
            DET_SNR_069_oRDR_DETECTION_069_072_oPCAN_RADAR_12a85e69_Tx: ComBitPosition=120, ComBitSize=8, ComSignalInitValue=0, ComSignalType=UINT8, ComSystemTemplateSystemSignalRef=DET_SNR_069
            DET_SNR_070_oRDR_DETECTION_069_072_oPCAN_RADAR_77882ccd_Tx: ComBitPosition=232, ComBitSize=8, ComSignalInitValue=0, ComSignalType=UINT8, ComSystemTemplateSystemSignalRef=DET_SNR_070
            DET_SNR_071_oRDR_DETECTION_069_072_oPCAN_RADAR_e2f8f858_Tx: ComBitPosition=344, ComBitSize=8, ComSignalInitValue=0, ComSignalType=UINT8, ComSystemTemplateSystemSignalRef=DET_SNR_071
            DET_SNR_072_oRDR_DETECTION_069_072_oPCAN_RADAR_861883a6_Tx: ComBitPosition=456, ComBitSize=8, ComSignalInitValue=0, ComSignalType=UINT8, ComSystemTemplateSystemSignalRef=DET_SNR_072
            DET_SUPER_RES_TARGET_069_oRDR_DETECTION_069_072_oPCAN_RADAR_2331760c_Tx: ComBitPosition=87, ComBitSize=1, ComSignalInitValue=0, ComSignalType=BOOLEAN, ComSystemTemplateSystemSignalRef=DET_SUPER_RES_TARGET_069
            DET_SUPER_RES_TARGET_070_oRDR_DETECTION_069_072_oPCAN_RADAR_461104a8_Tx: ComBitPosition=199, ComBitSize=1, ComSignalInitValue=0, ComSignalType=BOOLEAN, ComSystemTemplateSystemSignalRef=DET_SUPER_RES_TARGET_070
            DET_SUPER_RES_TARGET_071_oRDR_DETECTION_069_072_oPCAN_RADAR_d361d03d_Tx: ComBitPosition=311, ComBitSize=1, ComSignalInitValue=0, ComSignalType=BOOLEAN, ComSystemTemplateSystemSignalRef=DET_SUPER_RES_TARGET_071
            DET_SUPER_RES_TARGET_072_oRDR_DETECTION_069_072_oPCAN_RADAR_b781abc3_Tx: ComBitPosition=423, ComBitSize=1, ComSignalInitValue=0, ComSignalType=BOOLEAN, ComSystemTemplateSystemSignalRef=DET_SUPER_RES_TARGET_072
        SG_Detections_073_076_oRDR_DETECTION_073_076_oPCAN_RADAR_5a640d52_Tx: ComSystemTemplateSignalGroupRef=SG_Detections_073_076
          83 x ComGroupSignal, all with ComSignalEndianness=LITTLE_ENDIAN, ComTransferProperty=PENDING:
            DET_AZIMUTH_073_oRDR_DETECTION_073_076_oPCAN_RADAR_31bc86db_Tx: ComBitPosition=88, ComBitSize=13, ComSignalInitValue=0, ComSignalType=UINT16, ComSystemTemplateSystemSignalRef=DET_AZIMUTH_073
            DET_AZIMUTH_074_oRDR_DETECTION_073_076_oPCAN_RADAR_6d0ca5b2_Tx: ComBitPosition=200, ComBitSize=13, ComSignalInitValue=0, ComSignalType=UINT16, ComSystemTemplateSystemSignalRef=DET_AZIMUTH_074
            DET_AZIMUTH_075_oRDR_DETECTION_073_076_oPCAN_RADAR_f87c7127_Tx: ComBitPosition=312, ComBitSize=13, ComSignalInitValue=0, ComSignalType=UINT16, ComSystemTemplateSystemSignalRef=DET_AZIMUTH_075
            DET_AZIMUTH_076_oRDR_DETECTION_073_076_oPCAN_RADAR_9c9c0ad9_Tx: ComBitPosition=424, ComBitSize=13, ComSignalInitValue=0, ComSignalType=UINT16, ComSystemTemplateSystemSignalRef=DET_AZIMUTH_076
            DET_AZIMUTH_ERR_073_oRDR_DETECTION_073_076_oPCAN_RADAR_9509132e_Tx: ComBitPosition=105, ComBitSize=7, ComSignalInitValue=0, ComSignalType=UINT8, ComSystemTemplateSystemSignalRef=DET_AZIMUTH_ERR_073
            DET_AZIMUTH_ERR_074_oRDR_DETECTION_073_076_oPCAN_RADAR_c9b93047_Tx: ComBitPosition=217, ComBitSize=7, ComSignalInitValue=0, ComSignalType=UINT8, ComSystemTemplateSystemSignalRef=DET_AZIMUTH_ERR_074
            DET_AZIMUTH_ERR_075_oRDR_DETECTION_073_076_oPCAN_RADAR_5cc9e4d2_Tx: ComBitPosition=329, ComBitSize=7, ComSignalInitValue=0, ComSignalType=UINT8, ComSystemTemplateSystemSignalRef=DET_AZIMUTH_ERR_075
            DET_AZIMUTH_ERR_076_oRDR_DETECTION_073_076_oPCAN_RADAR_38299f2c_Tx: ComBitPosition=441, ComBitSize=7, ComSignalInitValue=0, ComSignalType=UINT8, ComSystemTemplateSystemSignalRef=DET_AZIMUTH_ERR_076
            DET_BELOW_RAIN_THOLD_073_oRDR_DETECTION_073_076_oPCAN_RADAR_e4bd151b_Tx: ComBitPosition=39, ComBitSize=1, ComSignalInitValue=0, ComSignalType=BOOLEAN, ComSystemTemplateSystemSignalRef=DET_BELOW_RAIN_THOLD_073
            DET_BELOW_RAIN_THOLD_074_oRDR_DETECTION_073_076_oPCAN_RADAR_b80d3672_Tx: ComBitPosition=151, ComBitSize=1, ComSignalInitValue=0, ComSignalType=BOOLEAN, ComSystemTemplateSystemSignalRef=DET_BELOW_RAIN_THOLD_074
            DET_BELOW_RAIN_THOLD_075_oRDR_DETECTION_073_076_oPCAN_RADAR_2d7de2e7_Tx: ComBitPosition=263, ComBitSize=1, ComSignalInitValue=0, ComSignalType=BOOLEAN, ComSystemTemplateSystemSignalRef=DET_BELOW_RAIN_THOLD_075
            DET_BELOW_RAIN_THOLD_076_oRDR_DETECTION_073_076_oPCAN_RADAR_499d9919_Tx: ComBitPosition=375, ComBitSize=1, ComSignalInitValue=0, ComSignalType=BOOLEAN, ComSystemTemplateSystemSignalRef=DET_BELOW_RAIN_THOLD_076
            DET_BI_STATIC_FLAG_073_oRDR_DETECTION_073_076_oPCAN_RADAR_6790c65e_Tx: ComBitPosition=104, ComBitSize=1, ComSignalInitValue=0, ComSignalType=BOOLEAN, ComSystemTemplateSystemSignalRef=DET_BI_STATIC_FLAG_073
            DET_BI_STATIC_FLAG_074_oRDR_DETECTION_073_076_oPCAN_RADAR_3b20e537_Tx: ComBitPosition=216, ComBitSize=1, ComSignalInitValue=0, ComSignalType=BOOLEAN, ComSystemTemplateSystemSignalRef=DET_BI_STATIC_FLAG_074
            DET_BI_STATIC_FLAG_075_oRDR_DETECTION_073_076_oPCAN_RADAR_ae5031a2_Tx: ComBitPosition=328, ComBitSize=1, ComSignalInitValue=0, ComSignalType=BOOLEAN, ComSystemTemplateSystemSignalRef=DET_BI_STATIC_FLAG_075
            DET_BI_STATIC_FLAG_076_oRDR_DETECTION_073_076_oPCAN_RADAR_cab04a5c_Tx: ComBitPosition=440, ComBitSize=1, ComSignalInitValue=0, ComSignalType=BOOLEAN, ComSystemTemplateSystemSignalRef=DET_BI_STATIC_FLAG_076
            DET_CONFD_AZIMUTH_073_oRDR_DETECTION_073_076_oPCAN_RADAR_335a8c11_Tx: ComBitPosition=118, ComBitSize=2, ComSignalInitValue=0, ComSignalType=UINT8, ComSystemTemplateSystemSignalRef=DET_CONFD_AZIMUTH_073
            DET_CONFD_AZIMUTH_074_oRDR_DETECTION_073_076_oPCAN_RADAR_6feaaf78_Tx: ComBitPosition=230, ComBitSize=2, ComSignalInitValue=0, ComSignalType=UINT8, ComSystemTemplateSystemSignalRef=DET_CONFD_AZIMUTH_074
            DET_CONFD_AZIMUTH_075_oRDR_DETECTION_073_076_oPCAN_RADAR_fa9a7bed_Tx: ComBitPosition=342, ComBitSize=2, ComSignalInitValue=0, ComSignalType=UINT8, ComSystemTemplateSystemSignalRef=DET_CONFD_AZIMUTH_075
            DET_CONFD_AZIMUTH_076_oRDR_DETECTION_073_076_oPCAN_RADAR_9e7a0013_Tx: ComBitPosition=454, ComBitSize=2, ComSignalInitValue=0, ComSignalType=UINT8, ComSystemTemplateSystemSignalRef=DET_CONFD_AZIMUTH_076
            DET_CONFD_ELEVATION_073_oRDR_DETECTION_073_076_oPCAN_RADAR_31cf8deb_Tx: ComBitPosition=101, ComBitSize=2, ComSignalInitValue=0, ComSignalType=UINT8, ComSystemTemplateSystemSignalRef=DET_CONFD_ELEVATION_073
            DET_CONFD_ELEVATION_074_oRDR_DETECTION_073_076_oPCAN_RADAR_6d7fae82_Tx: ComBitPosition=213, ComBitSize=2, ComSignalInitValue=0, ComSignalType=UINT8, ComSystemTemplateSystemSignalRef=DET_CONFD_ELEVATION_074
            DET_CONFD_ELEVATION_075_oRDR_DETECTION_073_076_oPCAN_RADAR_f80f7a17_Tx: ComBitPosition=325, ComBitSize=2, ComSignalInitValue=0, ComSignalType=UINT8, ComSystemTemplateSystemSignalRef=DET_CONFD_ELEVATION_075
            DET_CONFD_ELEVATION_076_oRDR_DETECTION_073_076_oPCAN_RADAR_9cef01e9_Tx: ComBitPosition=437, ComBitSize=2, ComSignalInitValue=0, ComSignalType=UINT8, ComSystemTemplateSystemSignalRef=DET_CONFD_ELEVATION_076
            DET_ELEVATION_073_oRDR_DETECTION_073_076_oPCAN_RADAR_e00f59d7_Tx: ComBitPosition=72, ComBitSize=8, ComSignalInitValue=0, ComSignalType=UINT8, ComSystemTemplateSystemSignalRef=DET_ELEVATION_073
            DET_ELEVATION_074_oRDR_DETECTION_073_076_oPCAN_RADAR_bcbf7abe_Tx: ComBitPosition=184, ComBitSize=8, ComSignalInitValue=0, ComSignalType=UINT8, ComSystemTemplateSystemSignalRef=DET_ELEVATION_074
            DET_ELEVATION_075_oRDR_DETECTION_073_076_oPCAN_RADAR_29cfae2b_Tx: ComBitPosition=296, ComBitSize=8, ComSignalInitValue=0, ComSignalType=UINT8, ComSystemTemplateSystemSignalRef=DET_ELEVATION_075
            DET_ELEVATION_076_oRDR_DETECTION_073_076_oPCAN_RADAR_4d2fd5d5_Tx: ComBitPosition=408, ComBitSize=8, ComSignalInitValue=0, ComSignalType=UINT8, ComSystemTemplateSystemSignalRef=DET_ELEVATION_076
            DET_ELEVATION_ERR_073_oRDR_DETECTION_073_076_oPCAN_RADAR_6736c1a2_Tx: ComBitPosition=80, ComBitSize=6, ComSignalInitValue=0, ComSignalType=UINT8, ComSystemTemplateSystemSignalRef=DET_ELEVATION_ERR_073
            DET_ELEVATION_ERR_074_oRDR_DETECTION_073_076_oPCAN_RADAR_3b86e2cb_Tx: ComBitPosition=192, ComBitSize=6, ComSignalInitValue=0, ComSignalType=UINT8, ComSystemTemplateSystemSignalRef=DET_ELEVATION_ERR_074
            DET_ELEVATION_ERR_075_oRDR_DETECTION_073_076_oPCAN_RADAR_aef6365e_Tx: ComBitPosition=304, ComBitSize=6, ComSignalInitValue=0, ComSignalType=UINT8, ComSystemTemplateSystemSignalRef=DET_ELEVATION_ERR_075
            DET_ELEVATION_ERR_076_oRDR_DETECTION_073_076_oPCAN_RADAR_ca164da0_Tx: ComBitPosition=416, ComBitSize=6, ComSignalInitValue=0, ComSignalType=UINT8, ComSystemTemplateSystemSignalRef=DET_ELEVATION_ERR_076
            DET_EXISTENCE_PROB_073_oRDR_DETECTION_073_076_oPCAN_RADAR_b5a9b4c2_Tx: ComBitPosition=112, ComBitSize=6, ComSignalInitValue=0, ComSignalType=UINT8, ComSystemTemplateSystemSignalRef=DET_EXISTENCE_PROB_073
            DET_EXISTENCE_PROB_074_oRDR_DETECTION_073_076_oPCAN_RADAR_e91997ab_Tx: ComBitPosition=224, ComBitSize=6, ComSignalInitValue=0, ComSignalType=UINT8, ComSystemTemplateSystemSignalRef=DET_EXISTENCE_PROB_074
            DET_EXISTENCE_PROB_075_oRDR_DETECTION_073_076_oPCAN_RADAR_7c69433e_Tx: ComBitPosition=336, ComBitSize=6, ComSignalInitValue=0, ComSignalType=UINT8, ComSystemTemplateSystemSignalRef=DET_EXISTENCE_PROB_075
            DET_EXISTENCE_PROB_076_oRDR_DETECTION_073_076_oPCAN_RADAR_188938c0_Tx: ComBitPosition=448, ComBitSize=6, ComSignalInitValue=0, ComSignalType=UINT8, ComSystemTemplateSystemSignalRef=DET_EXISTENCE_PROB_076
            DET_HVC_FLAG_073_oRDR_DETECTION_073_076_oPCAN_RADAR_54ddf7bd_Tx: ComBitPosition=86, ComBitSize=1, ComSignalInitValue=0, ComSignalType=BOOLEAN, ComSystemTemplateSystemSignalRef=DET_HVC_FLAG_073
            DET_HVC_FLAG_074_oRDR_DETECTION_073_076_oPCAN_RADAR_086dd4d4_Tx: ComBitPosition=198, ComBitSize=1, ComSignalInitValue=0, ComSignalType=BOOLEAN, ComSystemTemplateSystemSignalRef=DET_HVC_FLAG_074
            DET_HVC_FLAG_075_oRDR_DETECTION_073_076_oPCAN_RADAR_9d1d0041_Tx: ComBitPosition=310, ComBitSize=1, ComSignalInitValue=0, ComSignalType=BOOLEAN, ComSystemTemplateSystemSignalRef=DET_HVC_FLAG_075
            DET_HVC_FLAG_076_oRDR_DETECTION_073_076_oPCAN_RADAR_f9fd7bbf_Tx: ComBitPosition=422, ComBitSize=1, ComSignalInitValue=0, ComSignalType=BOOLEAN, ComSystemTemplateSystemSignalRef=DET_HVC_FLAG_076
            DET_IDM_073_oRDR_DETECTION_073_076_oPCAN_RADAR_df8fcc00_Tx: ComBitPosition=63, ComBitSize=1, ComSignalInitValue=0, ComSignalType=BOOLEAN, ComSystemTemplateSystemSignalRef=DET_IDM_073
            DET_IDM_074_oRDR_DETECTION_073_076_oPCAN_RADAR_833fef69_Tx: ComBitPosition=175, ComBitSize=1, ComSignalInitValue=0, ComSignalType=BOOLEAN, ComSystemTemplateSystemSignalRef=DET_IDM_074
            DET_IDM_075_oRDR_DETECTION_073_076_oPCAN_RADAR_164f3bfc_Tx: ComBitPosition=287, ComBitSize=1, ComSignalInitValue=0, ComSignalType=BOOLEAN, ComSystemTemplateSystemSignalRef=DET_IDM_075
            DET_IDM_076_oRDR_DETECTION_073_076_oPCAN_RADAR_72af4002_Tx: ComBitPosition=399, ComBitSize=1, ComSignalInitValue=0, ComSignalType=BOOLEAN, ComSystemTemplateSystemSignalRef=DET_IDM_076
            DET_MH_CRC16_073_076_oRDR_DETECTION_073_076_oPCAN_RADAR_deecdf59_Tx: ComBitPosition=0, ComBitSize=16, ComSignalInitValue=0, ComSignalType=UINT16, ComSystemTemplateSystemSignalRef=DET_MH_CRC16_073_076
            DET_MH_CYCLE_COUNTER_073_076_oRDR_DETECTION_073_076_oPCAN_RADAR_5a997e6e_Tx: ComBitPosition=16, ComBitSize=8, ComSignalInitValue=0, ComSignalType=UINT8, ComSystemTemplateSystemSignalRef=DET_MH_CYCLE_COUNTER_073_076
            DET_MH_SCAN_INDEX_4LSB_073_076_oRDR_DETECTION_073_076_oPCAN_RADAR_96b35be2_Tx: ComBitPosition=476, ComBitSize=4, ComSignalInitValue=0, ComSignalType=UINT8, ComSystemTemplateSystemSignalRef=DET_MH_SCAN_INDEX_4LSB_073_076
            DET_MTD_073_oRDR_DETECTION_073_076_oPCAN_RADAR_b93cfedb_Tx: ComBitPosition=47, ComBitSize=1, ComSignalInitValue=0, ComSignalType=BOOLEAN, ComSystemTemplateSystemSignalRef=DET_MTD_073
            DET_MTD_074_oRDR_DETECTION_073_076_oPCAN_RADAR_e58cddb2_Tx: ComBitPosition=159, ComBitSize=1, ComSignalInitValue=0, ComSignalType=BOOLEAN, ComSystemTemplateSystemSignalRef=DET_MTD_074
            DET_MTD_075_oRDR_DETECTION_073_076_oPCAN_RADAR_70fc0927_Tx: ComBitPosition=271, ComBitSize=1, ComSignalInitValue=0, ComSignalType=BOOLEAN, ComSystemTemplateSystemSignalRef=DET_MTD_075
            DET_MTD_076_oRDR_DETECTION_073_076_oPCAN_RADAR_141c72d9_Tx: ComBitPosition=383, ComBitSize=1, ComSignalInitValue=0, ComSignalType=BOOLEAN, ComSystemTemplateSystemSignalRef=DET_MTD_076
            DET_PROB_1STAZHYPO_073_oRDR_DETECTION_073_076_oPCAN_RADAR_2a881616_Tx: ComBitPosition=103, ComBitSize=1, ComSignalInitValue=0, ComSignalType=BOOLEAN, ComSystemTemplateSystemSignalRef=DET_PROB_1STAZHYPO_073
            DET_PROB_1STAZHYPO_074_oRDR_DETECTION_073_076_oPCAN_RADAR_7638357f_Tx: ComBitPosition=215, ComBitSize=1, ComSignalInitValue=0, ComSignalType=BOOLEAN, ComSystemTemplateSystemSignalRef=DET_PROB_1STAZHYPO_074
            DET_PROB_1STAZHYPO_075_oRDR_DETECTION_073_076_oPCAN_RADAR_e348e1ea_Tx: ComBitPosition=327, ComBitSize=1, ComSignalInitValue=0, ComSignalType=BOOLEAN, ComSystemTemplateSystemSignalRef=DET_PROB_1STAZHYPO_075
            DET_PROB_1STAZHYPO_076_oRDR_DETECTION_073_076_oPCAN_RADAR_87a89a14_Tx: ComBitPosition=439, ComBitSize=1, ComSignalInitValue=0, ComSignalType=BOOLEAN, ComSystemTemplateSystemSignalRef=DET_PROB_1STAZHYPO_076
            DET_RANGE_073_oRDR_DETECTION_073_076_oPCAN_RADAR_2127f560_Tx: ComBitPosition=24, ComBitSize=15, ComSignalInitValue=0, ComSignalType=UINT16, ComSystemTemplateSystemSignalRef=DET_RANGE_073
            DET_RANGE_074_oRDR_DETECTION_073_076_oPCAN_RADAR_7d97d609_Tx: ComBitPosition=136, ComBitSize=15, ComSignalInitValue=0, ComSignalType=UINT16, ComSystemTemplateSystemSignalRef=DET_RANGE_074
            DET_RANGE_075_oRDR_DETECTION_073_076_oPCAN_RADAR_e8e7029c_Tx: ComBitPosition=248, ComBitSize=15, ComSignalInitValue=0, ComSignalType=UINT16, ComSystemTemplateSystemSignalRef=DET_RANGE_075
            DET_RANGE_076_oRDR_DETECTION_073_076_oPCAN_RADAR_8c077962_Tx: ComBitPosition=360, ComBitSize=15, ComSignalInitValue=0, ComSignalType=UINT16, ComSystemTemplateSystemSignalRef=DET_RANGE_076
            DET_RANGE_ERR_073_oRDR_DETECTION_073_076_oPCAN_RADAR_86cf4f09_Tx: ComBitPosition=40, ComBitSize=7, ComSignalInitValue=0, ComSignalType=UINT8, ComSystemTemplateSystemSignalRef=DET_RANGE_ERR_073
            DET_RANGE_ERR_074_oRDR_DETECTION_073_076_oPCAN_RADAR_da7f6c60_Tx: ComBitPosition=152, ComBitSize=7, ComSignalInitValue=0, ComSignalType=UINT8, ComSystemTemplateSystemSignalRef=DET_RANGE_ERR_074
            DET_RANGE_ERR_075_oRDR_DETECTION_073_076_oPCAN_RADAR_4f0fb8f5_Tx: ComBitPosition=264, ComBitSize=7, ComSignalInitValue=0, ComSignalType=UINT8, ComSystemTemplateSystemSignalRef=DET_RANGE_ERR_075
            DET_RANGE_ERR_076_oRDR_DETECTION_073_076_oPCAN_RADAR_2befc30b_Tx: ComBitPosition=376, ComBitSize=7, ComSignalInitValue=0, ComSignalType=UINT8, ComSystemTemplateSystemSignalRef=DET_RANGE_ERR_076
            DET_RANGE_VELOCITY_073_oRDR_DETECTION_073_076_oPCAN_RADAR_54813745_Tx: ComBitPosition=48, ComBitSize=15, ComSignalInitValue=16384, ComSignalType=UINT16, ComSystemTemplateSystemSignalRef=DET_RANGE_VELOCITY_073
            DET_RANGE_VELOCITY_074_oRDR_DETECTION_073_076_oPCAN_RADAR_0831142c_Tx: ComBitPosition=160, ComBitSize=15, ComSignalInitValue=16384, ComSignalType=UINT16, ComSystemTemplateSystemSignalRef=DET_RANGE_VELOCITY_074
            DET_RANGE_VELOCITY_075_oRDR_DETECTION_073_076_oPCAN_RADAR_9d41c0b9_Tx: ComBitPosition=272, ComBitSize=15, ComSignalInitValue=16384, ComSignalType=UINT16, ComSystemTemplateSystemSignalRef=DET_RANGE_VELOCITY_075
            DET_RANGE_VELOCITY_076_oRDR_DETECTION_073_076_oPCAN_RADAR_f9a1bb47_Tx: ComBitPosition=384, ComBitSize=15, ComSignalInitValue=16384, ComSignalType=UINT16, ComSystemTemplateSystemSignalRef=DET_RANGE_VELOCITY_076
            DET_RANGE_VELOCITY_ERR_073_oRDR_DETECTION_073_076_oPCAN_RADAR_5b3accf7_Tx: ComBitPosition=64, ComBitSize=8, ComSignalInitValue=0, ComSignalType=UINT8, ComSystemTemplateSystemSignalRef=DET_RANGE_VELOCITY_ERR_073
            DET_RANGE_VELOCITY_ERR_074_oRDR_DETECTION_073_076_oPCAN_RADAR_078aef9e_Tx: ComBitPosition=176, ComBitSize=8, ComSignalInitValue=0, ComSignalType=UINT8, ComSystemTemplateSystemSignalRef=DET_RANGE_VELOCITY_ERR_074
            DET_RANGE_VELOCITY_ERR_075_oRDR_DETECTION_073_076_oPCAN_RADAR_92fa3b0b_Tx: ComBitPosition=288, ComBitSize=8, ComSignalInitValue=0, ComSignalType=UINT8, ComSystemTemplateSystemSignalRef=DET_RANGE_VELOCITY_ERR_075
            DET_RANGE_VELOCITY_ERR_076_oRDR_DETECTION_073_076_oPCAN_RADAR_f61a40f5_Tx: ComBitPosition=400, ComBitSize=8, ComSignalInitValue=0, ComSignalType=UINT8, ComSystemTemplateSystemSignalRef=DET_RANGE_VELOCITY_ERR_076
            DET_RCS_073_oRDR_DETECTION_073_076_oPCAN_RADAR_d301001f_Tx: ComBitPosition=128, ComBitSize=8, ComSignalInitValue=128, ComSignalType=UINT8, ComSystemTemplateSystemSignalRef=DET_RCS_073
            DET_RCS_074_oRDR_DETECTION_073_076_oPCAN_RADAR_8fb12376_Tx: ComBitPosition=240, ComBitSize=8, ComSignalInitValue=128, ComSignalType=UINT8, ComSystemTemplateSystemSignalRef=DET_RCS_074
            DET_RCS_075_oRDR_DETECTION_073_076_oPCAN_RADAR_1ac1f7e3_Tx: ComBitPosition=352, ComBitSize=8, ComSignalInitValue=128, ComSignalType=UINT8, ComSystemTemplateSystemSignalRef=DET_RCS_075
            DET_RCS_076_oRDR_DETECTION_073_076_oPCAN_RADAR_7e218c1d_Tx: ComBitPosition=464, ComBitSize=8, ComSignalInitValue=128, ComSignalType=UINT8, ComSystemTemplateSystemSignalRef=DET_RCS_076
            DET_SNR_073_oRDR_DETECTION_073_076_oPCAN_RADAR_0eaf541d_Tx: ComBitPosition=120, ComBitSize=8, ComSignalInitValue=0, ComSignalType=UINT8, ComSystemTemplateSystemSignalRef=DET_SNR_073
            DET_SNR_074_oRDR_DETECTION_073_076_oPCAN_RADAR_521f7774_Tx: ComBitPosition=232, ComBitSize=8, ComSignalInitValue=0, ComSignalType=UINT8, ComSystemTemplateSystemSignalRef=DET_SNR_074
            DET_SNR_075_oRDR_DETECTION_073_076_oPCAN_RADAR_c76fa3e1_Tx: ComBitPosition=344, ComBitSize=8, ComSignalInitValue=0, ComSignalType=UINT8, ComSystemTemplateSystemSignalRef=DET_SNR_075
            DET_SNR_076_oRDR_DETECTION_073_076_oPCAN_RADAR_a38fd81f_Tx: ComBitPosition=456, ComBitSize=8, ComSignalInitValue=0, ComSignalType=UINT8, ComSystemTemplateSystemSignalRef=DET_SNR_076
            DET_SUPER_RES_TARGET_073_oRDR_DETECTION_073_076_oPCAN_RADAR_3f367c78_Tx: ComBitPosition=87, ComBitSize=1, ComSignalInitValue=0, ComSignalType=BOOLEAN, ComSystemTemplateSystemSignalRef=DET_SUPER_RES_TARGET_073
            DET_SUPER_RES_TARGET_074_oRDR_DETECTION_073_076_oPCAN_RADAR_63865f11_Tx: ComBitPosition=199, ComBitSize=1, ComSignalInitValue=0, ComSignalType=BOOLEAN, ComSystemTemplateSystemSignalRef=DET_SUPER_RES_TARGET_074
            DET_SUPER_RES_TARGET_075_oRDR_DETECTION_073_076_oPCAN_RADAR_f6f68b84_Tx: ComBitPosition=311, ComBitSize=1, ComSignalInitValue=0, ComSignalType=BOOLEAN, ComSystemTemplateSystemSignalRef=DET_SUPER_RES_TARGET_075
            DET_SUPER_RES_TARGET_076_oRDR_DETECTION_073_076_oPCAN_RADAR_9216f07a_Tx: ComBitPosition=423, ComBitSize=1, ComSignalInitValue=0, ComSignalType=BOOLEAN, ComSystemTemplateSystemSignalRef=DET_SUPER_RES_TARGET_076
        SG_Detections_077_080_oRDR_DETECTION_077_080_oPCAN_RADAR_2ec83134_Tx: ComSystemTemplateSignalGroupRef=SG_Detections_077_080
          83 x ComGroupSignal, all with ComSignalEndianness=LITTLE_ENDIAN, ComTransferProperty=PENDING:
            DET_AZIMUTH_077_oRDR_DETECTION_077_080_oPCAN_RADAR_8c9592a8_Tx: ComBitPosition=88, ComBitSize=13, ComSignalInitValue=0, ComSignalType=UINT16, ComSystemTemplateSystemSignalRef=DET_AZIMUTH_077
            DET_AZIMUTH_078_oRDR_DETECTION_077_080_oPCAN_RADAR_a08500ef_Tx: ComBitPosition=200, ComBitSize=13, ComSignalInitValue=0, ComSignalType=UINT16, ComSystemTemplateSystemSignalRef=DET_AZIMUTH_078
            DET_AZIMUTH_079_oRDR_DETECTION_077_080_oPCAN_RADAR_35f5d47a_Tx: ComBitPosition=312, ComBitSize=13, ComSignalInitValue=0, ComSignalType=UINT16, ComSystemTemplateSystemSignalRef=DET_AZIMUTH_079
            DET_AZIMUTH_080_oRDR_DETECTION_077_080_oPCAN_RADAR_38b17560_Tx: ComBitPosition=424, ComBitSize=13, ComSignalInitValue=0, ComSignalType=UINT16, ComSystemTemplateSystemSignalRef=DET_AZIMUTH_080
            DET_AZIMUTH_ERR_077_oRDR_DETECTION_077_080_oPCAN_RADAR_2820075d_Tx: ComBitPosition=105, ComBitSize=7, ComSignalInitValue=0, ComSignalType=UINT8, ComSystemTemplateSystemSignalRef=DET_AZIMUTH_ERR_077
            DET_AZIMUTH_ERR_078_oRDR_DETECTION_077_080_oPCAN_RADAR_0430951a_Tx: ComBitPosition=217, ComBitSize=7, ComSignalInitValue=0, ComSignalType=UINT8, ComSystemTemplateSystemSignalRef=DET_AZIMUTH_ERR_078
            DET_AZIMUTH_ERR_079_oRDR_DETECTION_077_080_oPCAN_RADAR_9140418f_Tx: ComBitPosition=329, ComBitSize=7, ComSignalInitValue=0, ComSignalType=UINT8, ComSystemTemplateSystemSignalRef=DET_AZIMUTH_ERR_079
            DET_AZIMUTH_ERR_080_oRDR_DETECTION_077_080_oPCAN_RADAR_9c04e095_Tx: ComBitPosition=441, ComBitSize=7, ComSignalInitValue=0, ComSignalType=UINT8, ComSystemTemplateSystemSignalRef=DET_AZIMUTH_ERR_080
            DET_BELOW_RAIN_THOLD_077_oRDR_DETECTION_077_080_oPCAN_RADAR_59940168_Tx: ComBitPosition=39, ComBitSize=1, ComSignalInitValue=0, ComSignalType=BOOLEAN, ComSystemTemplateSystemSignalRef=DET_BELOW_RAIN_THOLD_077
            DET_BELOW_RAIN_THOLD_078_oRDR_DETECTION_077_080_oPCAN_RADAR_7584932f_Tx: ComBitPosition=151, ComBitSize=1, ComSignalInitValue=0, ComSignalType=BOOLEAN, ComSystemTemplateSystemSignalRef=DET_BELOW_RAIN_THOLD_078
            DET_BELOW_RAIN_THOLD_079_oRDR_DETECTION_077_080_oPCAN_RADAR_e0f447ba_Tx: ComBitPosition=263, ComBitSize=1, ComSignalInitValue=0, ComSignalType=BOOLEAN, ComSystemTemplateSystemSignalRef=DET_BELOW_RAIN_THOLD_079
            DET_BELOW_RAIN_THOLD_080_oRDR_DETECTION_077_080_oPCAN_RADAR_edb0e6a0_Tx: ComBitPosition=375, ComBitSize=1, ComSignalInitValue=0, ComSignalType=BOOLEAN, ComSystemTemplateSystemSignalRef=DET_BELOW_RAIN_THOLD_080
            DET_BI_STATIC_FLAG_077_oRDR_DETECTION_077_080_oPCAN_RADAR_dab9d22d_Tx: ComBitPosition=104, ComBitSize=1, ComSignalInitValue=0, ComSignalType=BOOLEAN, ComSystemTemplateSystemSignalRef=DET_BI_STATIC_FLAG_077
            DET_BI_STATIC_FLAG_078_oRDR_DETECTION_077_080_oPCAN_RADAR_f6a9406a_Tx: ComBitPosition=216, ComBitSize=1, ComSignalInitValue=0, ComSignalType=BOOLEAN, ComSystemTemplateSystemSignalRef=DET_BI_STATIC_FLAG_078
            DET_BI_STATIC_FLAG_079_oRDR_DETECTION_077_080_oPCAN_RADAR_63d994ff_Tx: ComBitPosition=328, ComBitSize=1, ComSignalInitValue=0, ComSignalType=BOOLEAN, ComSystemTemplateSystemSignalRef=DET_BI_STATIC_FLAG_079
            DET_BI_STATIC_FLAG_080_oRDR_DETECTION_077_080_oPCAN_RADAR_6e9d35e5_Tx: ComBitPosition=440, ComBitSize=1, ComSignalInitValue=0, ComSignalType=BOOLEAN, ComSystemTemplateSystemSignalRef=DET_BI_STATIC_FLAG_080
            DET_CONFD_AZIMUTH_077_oRDR_DETECTION_077_080_oPCAN_RADAR_8e739862_Tx: ComBitPosition=118, ComBitSize=2, ComSignalInitValue=0, ComSignalType=UINT8, ComSystemTemplateSystemSignalRef=DET_CONFD_AZIMUTH_077
            DET_CONFD_AZIMUTH_078_oRDR_DETECTION_077_080_oPCAN_RADAR_a2630a25_Tx: ComBitPosition=230, ComBitSize=2, ComSignalInitValue=0, ComSignalType=UINT8, ComSystemTemplateSystemSignalRef=DET_CONFD_AZIMUTH_078
            DET_CONFD_AZIMUTH_079_oRDR_DETECTION_077_080_oPCAN_RADAR_3713deb0_Tx: ComBitPosition=342, ComBitSize=2, ComSignalInitValue=0, ComSignalType=UINT8, ComSystemTemplateSystemSignalRef=DET_CONFD_AZIMUTH_079
            DET_CONFD_AZIMUTH_080_oRDR_DETECTION_077_080_oPCAN_RADAR_3a577faa_Tx: ComBitPosition=454, ComBitSize=2, ComSignalInitValue=0, ComSignalType=UINT8, ComSystemTemplateSystemSignalRef=DET_CONFD_AZIMUTH_080
            DET_CONFD_ELEVATION_077_oRDR_DETECTION_077_080_oPCAN_RADAR_8ce69998_Tx: ComBitPosition=101, ComBitSize=2, ComSignalInitValue=0, ComSignalType=UINT8, ComSystemTemplateSystemSignalRef=DET_CONFD_ELEVATION_077
            DET_CONFD_ELEVATION_078_oRDR_DETECTION_077_080_oPCAN_RADAR_a0f60bdf_Tx: ComBitPosition=213, ComBitSize=2, ComSignalInitValue=0, ComSignalType=UINT8, ComSystemTemplateSystemSignalRef=DET_CONFD_ELEVATION_078
            DET_CONFD_ELEVATION_079_oRDR_DETECTION_077_080_oPCAN_RADAR_3586df4a_Tx: ComBitPosition=325, ComBitSize=2, ComSignalInitValue=0, ComSignalType=UINT8, ComSystemTemplateSystemSignalRef=DET_CONFD_ELEVATION_079
            DET_CONFD_ELEVATION_080_oRDR_DETECTION_077_080_oPCAN_RADAR_38c27e50_Tx: ComBitPosition=437, ComBitSize=2, ComSignalInitValue=0, ComSignalType=UINT8, ComSystemTemplateSystemSignalRef=DET_CONFD_ELEVATION_080
            DET_ELEVATION_077_oRDR_DETECTION_077_080_oPCAN_RADAR_5d264da4_Tx: ComBitPosition=72, ComBitSize=8, ComSignalInitValue=0, ComSignalType=UINT8, ComSystemTemplateSystemSignalRef=DET_ELEVATION_077
            DET_ELEVATION_078_oRDR_DETECTION_077_080_oPCAN_RADAR_7136dfe3_Tx: ComBitPosition=184, ComBitSize=8, ComSignalInitValue=0, ComSignalType=UINT8, ComSystemTemplateSystemSignalRef=DET_ELEVATION_078
            DET_ELEVATION_079_oRDR_DETECTION_077_080_oPCAN_RADAR_e4460b76_Tx: ComBitPosition=296, ComBitSize=8, ComSignalInitValue=0, ComSignalType=UINT8, ComSystemTemplateSystemSignalRef=DET_ELEVATION_079
            DET_ELEVATION_080_oRDR_DETECTION_077_080_oPCAN_RADAR_e902aa6c_Tx: ComBitPosition=408, ComBitSize=8, ComSignalInitValue=0, ComSignalType=UINT8, ComSystemTemplateSystemSignalRef=DET_ELEVATION_080
            DET_ELEVATION_ERR_077_oRDR_DETECTION_077_080_oPCAN_RADAR_da1fd5d1_Tx: ComBitPosition=80, ComBitSize=6, ComSignalInitValue=0, ComSignalType=UINT8, ComSystemTemplateSystemSignalRef=DET_ELEVATION_ERR_077
            DET_ELEVATION_ERR_078_oRDR_DETECTION_077_080_oPCAN_RADAR_f60f4796_Tx: ComBitPosition=192, ComBitSize=6, ComSignalInitValue=0, ComSignalType=UINT8, ComSystemTemplateSystemSignalRef=DET_ELEVATION_ERR_078
            DET_ELEVATION_ERR_079_oRDR_DETECTION_077_080_oPCAN_RADAR_637f9303_Tx: ComBitPosition=304, ComBitSize=6, ComSignalInitValue=0, ComSignalType=UINT8, ComSystemTemplateSystemSignalRef=DET_ELEVATION_ERR_079
            DET_ELEVATION_ERR_080_oRDR_DETECTION_077_080_oPCAN_RADAR_6e3b3219_Tx: ComBitPosition=416, ComBitSize=6, ComSignalInitValue=0, ComSignalType=UINT8, ComSystemTemplateSystemSignalRef=DET_ELEVATION_ERR_080
            DET_EXISTENCE_PROB_077_oRDR_DETECTION_077_080_oPCAN_RADAR_0880a0b1_Tx: ComBitPosition=112, ComBitSize=6, ComSignalInitValue=0, ComSignalType=UINT8, ComSystemTemplateSystemSignalRef=DET_EXISTENCE_PROB_077
            DET_EXISTENCE_PROB_078_oRDR_DETECTION_077_080_oPCAN_RADAR_249032f6_Tx: ComBitPosition=224, ComBitSize=6, ComSignalInitValue=0, ComSignalType=UINT8, ComSystemTemplateSystemSignalRef=DET_EXISTENCE_PROB_078
            DET_EXISTENCE_PROB_079_oRDR_DETECTION_077_080_oPCAN_RADAR_b1e0e663_Tx: ComBitPosition=336, ComBitSize=6, ComSignalInitValue=0, ComSignalType=UINT8, ComSystemTemplateSystemSignalRef=DET_EXISTENCE_PROB_079
            DET_EXISTENCE_PROB_080_oRDR_DETECTION_077_080_oPCAN_RADAR_bca44779_Tx: ComBitPosition=448, ComBitSize=6, ComSignalInitValue=0, ComSignalType=UINT8, ComSystemTemplateSystemSignalRef=DET_EXISTENCE_PROB_080
            DET_HVC_FLAG_077_oRDR_DETECTION_077_080_oPCAN_RADAR_e9f4e3ce_Tx: ComBitPosition=86, ComBitSize=1, ComSignalInitValue=0, ComSignalType=BOOLEAN, ComSystemTemplateSystemSignalRef=DET_HVC_FLAG_077
            DET_HVC_FLAG_078_oRDR_DETECTION_077_080_oPCAN_RADAR_c5e47189_Tx: ComBitPosition=198, ComBitSize=1, ComSignalInitValue=0, ComSignalType=BOOLEAN, ComSystemTemplateSystemSignalRef=DET_HVC_FLAG_078
            DET_HVC_FLAG_079_oRDR_DETECTION_077_080_oPCAN_RADAR_5094a51c_Tx: ComBitPosition=310, ComBitSize=1, ComSignalInitValue=0, ComSignalType=BOOLEAN, ComSystemTemplateSystemSignalRef=DET_HVC_FLAG_079
            DET_HVC_FLAG_080_oRDR_DETECTION_077_080_oPCAN_RADAR_5dd00406_Tx: ComBitPosition=422, ComBitSize=1, ComSignalInitValue=0, ComSignalType=BOOLEAN, ComSystemTemplateSystemSignalRef=DET_HVC_FLAG_080
            DET_IDM_077_oRDR_DETECTION_077_080_oPCAN_RADAR_62a6d873_Tx: ComBitPosition=63, ComBitSize=1, ComSignalInitValue=0, ComSignalType=BOOLEAN, ComSystemTemplateSystemSignalRef=DET_IDM_077
            DET_IDM_078_oRDR_DETECTION_077_080_oPCAN_RADAR_4eb64a34_Tx: ComBitPosition=175, ComBitSize=1, ComSignalInitValue=0, ComSignalType=BOOLEAN, ComSystemTemplateSystemSignalRef=DET_IDM_078
            DET_IDM_079_oRDR_DETECTION_077_080_oPCAN_RADAR_dbc69ea1_Tx: ComBitPosition=287, ComBitSize=1, ComSignalInitValue=0, ComSignalType=BOOLEAN, ComSystemTemplateSystemSignalRef=DET_IDM_079
            DET_IDM_080_oRDR_DETECTION_077_080_oPCAN_RADAR_d6823fbb_Tx: ComBitPosition=399, ComBitSize=1, ComSignalInitValue=0, ComSignalType=BOOLEAN, ComSystemTemplateSystemSignalRef=DET_IDM_080
            DET_MH_CRC16_077_080_oRDR_DETECTION_077_080_oPCAN_RADAR_aa40e33f_Tx: ComBitPosition=0, ComBitSize=16, ComSignalInitValue=0, ComSignalType=UINT16, ComSystemTemplateSystemSignalRef=DET_MH_CRC16_077_080
            DET_MH_CYCLE_COUNTER_077_080_oRDR_DETECTION_077_080_oPCAN_RADAR_2e354208_Tx: ComBitPosition=16, ComBitSize=8, ComSignalInitValue=0, ComSignalType=UINT8, ComSystemTemplateSystemSignalRef=DET_MH_CYCLE_COUNTER_077_080
            DET_MH_SCAN_INDEX_4LSB_077_080_oRDR_DETECTION_077_080_oPCAN_RADAR_e21f6784_Tx: ComBitPosition=476, ComBitSize=4, ComSignalInitValue=0, ComSignalType=UINT8, ComSystemTemplateSystemSignalRef=DET_MH_SCAN_INDEX_4LSB_077_080
            DET_MTD_077_oRDR_DETECTION_077_080_oPCAN_RADAR_0415eaa8_Tx: ComBitPosition=47, ComBitSize=1, ComSignalInitValue=0, ComSignalType=BOOLEAN, ComSystemTemplateSystemSignalRef=DET_MTD_077
            DET_MTD_078_oRDR_DETECTION_077_080_oPCAN_RADAR_280578ef_Tx: ComBitPosition=159, ComBitSize=1, ComSignalInitValue=0, ComSignalType=BOOLEAN, ComSystemTemplateSystemSignalRef=DET_MTD_078
            DET_MTD_079_oRDR_DETECTION_077_080_oPCAN_RADAR_bd75ac7a_Tx: ComBitPosition=271, ComBitSize=1, ComSignalInitValue=0, ComSignalType=BOOLEAN, ComSystemTemplateSystemSignalRef=DET_MTD_079
            DET_MTD_080_oRDR_DETECTION_077_080_oPCAN_RADAR_b0310d60_Tx: ComBitPosition=383, ComBitSize=1, ComSignalInitValue=0, ComSignalType=BOOLEAN, ComSystemTemplateSystemSignalRef=DET_MTD_080
            DET_PROB_1STAZHYPO_077_oRDR_DETECTION_077_080_oPCAN_RADAR_97a10265_Tx: ComBitPosition=103, ComBitSize=1, ComSignalInitValue=0, ComSignalType=BOOLEAN, ComSystemTemplateSystemSignalRef=DET_PROB_1STAZHYPO_077
            DET_PROB_1STAZHYPO_078_oRDR_DETECTION_077_080_oPCAN_RADAR_bbb19022_Tx: ComBitPosition=215, ComBitSize=1, ComSignalInitValue=0, ComSignalType=BOOLEAN, ComSystemTemplateSystemSignalRef=DET_PROB_1STAZHYPO_078
            DET_PROB_1STAZHYPO_079_oRDR_DETECTION_077_080_oPCAN_RADAR_2ec144b7_Tx: ComBitPosition=327, ComBitSize=1, ComSignalInitValue=0, ComSignalType=BOOLEAN, ComSystemTemplateSystemSignalRef=DET_PROB_1STAZHYPO_079
            DET_PROB_1STAZHYPO_080_oRDR_DETECTION_077_080_oPCAN_RADAR_2385e5ad_Tx: ComBitPosition=439, ComBitSize=1, ComSignalInitValue=0, ComSignalType=BOOLEAN, ComSystemTemplateSystemSignalRef=DET_PROB_1STAZHYPO_080
            DET_RANGE_077_oRDR_DETECTION_077_080_oPCAN_RADAR_9c0ee113_Tx: ComBitPosition=24, ComBitSize=15, ComSignalInitValue=0, ComSignalType=UINT16, ComSystemTemplateSystemSignalRef=DET_RANGE_077
            DET_RANGE_078_oRDR_DETECTION_077_080_oPCAN_RADAR_b01e7354_Tx: ComBitPosition=136, ComBitSize=15, ComSignalInitValue=0, ComSignalType=UINT16, ComSystemTemplateSystemSignalRef=DET_RANGE_078
            DET_RANGE_079_oRDR_DETECTION_077_080_oPCAN_RADAR_256ea7c1_Tx: ComBitPosition=248, ComBitSize=15, ComSignalInitValue=0, ComSignalType=UINT16, ComSystemTemplateSystemSignalRef=DET_RANGE_079
            DET_RANGE_080_oRDR_DETECTION_077_080_oPCAN_RADAR_282a06db_Tx: ComBitPosition=360, ComBitSize=15, ComSignalInitValue=0, ComSignalType=UINT16, ComSystemTemplateSystemSignalRef=DET_RANGE_080
            DET_RANGE_ERR_077_oRDR_DETECTION_077_080_oPCAN_RADAR_3be65b7a_Tx: ComBitPosition=40, ComBitSize=7, ComSignalInitValue=0, ComSignalType=UINT8, ComSystemTemplateSystemSignalRef=DET_RANGE_ERR_077
            DET_RANGE_ERR_078_oRDR_DETECTION_077_080_oPCAN_RADAR_17f6c93d_Tx: ComBitPosition=152, ComBitSize=7, ComSignalInitValue=0, ComSignalType=UINT8, ComSystemTemplateSystemSignalRef=DET_RANGE_ERR_078
            DET_RANGE_ERR_079_oRDR_DETECTION_077_080_oPCAN_RADAR_82861da8_Tx: ComBitPosition=264, ComBitSize=7, ComSignalInitValue=0, ComSignalType=UINT8, ComSystemTemplateSystemSignalRef=DET_RANGE_ERR_079
            DET_RANGE_ERR_080_oRDR_DETECTION_077_080_oPCAN_RADAR_8fc2bcb2_Tx: ComBitPosition=376, ComBitSize=7, ComSignalInitValue=0, ComSignalType=UINT8, ComSystemTemplateSystemSignalRef=DET_RANGE_ERR_080
            DET_RANGE_VELOCITY_077_oRDR_DETECTION_077_080_oPCAN_RADAR_e9a82336_Tx: ComBitPosition=48, ComBitSize=15, ComSignalInitValue=16384, ComSignalType=UINT16, ComSystemTemplateSystemSignalRef=DET_RANGE_VELOCITY_077
            DET_RANGE_VELOCITY_078_oRDR_DETECTION_077_080_oPCAN_RADAR_c5b8b171_Tx: ComBitPosition=160, ComBitSize=15, ComSignalInitValue=16384, ComSignalType=UINT16, ComSystemTemplateSystemSignalRef=DET_RANGE_VELOCITY_078
            DET_RANGE_VELOCITY_079_oRDR_DETECTION_077_080_oPCAN_RADAR_50c865e4_Tx: ComBitPosition=272, ComBitSize=15, ComSignalInitValue=16384, ComSignalType=UINT16, ComSystemTemplateSystemSignalRef=DET_RANGE_VELOCITY_079
            DET_RANGE_VELOCITY_080_oRDR_DETECTION_077_080_oPCAN_RADAR_5d8cc4fe_Tx: ComBitPosition=384, ComBitSize=15, ComSignalInitValue=16384, ComSignalType=UINT16, ComSystemTemplateSystemSignalRef=DET_RANGE_VELOCITY_080
            DET_RANGE_VELOCITY_ERR_077_oRDR_DETECTION_077_080_oPCAN_RADAR_e613d884_Tx: ComBitPosition=64, ComBitSize=8, ComSignalInitValue=0, ComSignalType=UINT8, ComSystemTemplateSystemSignalRef=DET_RANGE_VELOCITY_ERR_077
            DET_RANGE_VELOCITY_ERR_078_oRDR_DETECTION_077_080_oPCAN_RADAR_ca034ac3_Tx: ComBitPosition=176, ComBitSize=8, ComSignalInitValue=0, ComSignalType=UINT8, ComSystemTemplateSystemSignalRef=DET_RANGE_VELOCITY_ERR_078
            DET_RANGE_VELOCITY_ERR_079_oRDR_DETECTION_077_080_oPCAN_RADAR_5f739e56_Tx: ComBitPosition=288, ComBitSize=8, ComSignalInitValue=0, ComSignalType=UINT8, ComSystemTemplateSystemSignalRef=DET_RANGE_VELOCITY_ERR_079
            DET_RANGE_VELOCITY_ERR_080_oRDR_DETECTION_077_080_oPCAN_RADAR_52373f4c_Tx: ComBitPosition=400, ComBitSize=8, ComSignalInitValue=0, ComSignalType=UINT8, ComSystemTemplateSystemSignalRef=DET_RANGE_VELOCITY_ERR_080
            DET_RCS_077_oRDR_DETECTION_077_080_oPCAN_RADAR_6e28146c_Tx: ComBitPosition=128, ComBitSize=8, ComSignalInitValue=128, ComSignalType=UINT8, ComSystemTemplateSystemSignalRef=DET_RCS_077
            DET_RCS_078_oRDR_DETECTION_077_080_oPCAN_RADAR_4238862b_Tx: ComBitPosition=240, ComBitSize=8, ComSignalInitValue=128, ComSignalType=UINT8, ComSystemTemplateSystemSignalRef=DET_RCS_078
            DET_RCS_079_oRDR_DETECTION_077_080_oPCAN_RADAR_d74852be_Tx: ComBitPosition=352, ComBitSize=8, ComSignalInitValue=128, ComSignalType=UINT8, ComSystemTemplateSystemSignalRef=DET_RCS_079
            DET_RCS_080_oRDR_DETECTION_077_080_oPCAN_RADAR_da0cf3a4_Tx: ComBitPosition=464, ComBitSize=8, ComSignalInitValue=128, ComSignalType=UINT8, ComSystemTemplateSystemSignalRef=DET_RCS_080
            DET_SNR_077_oRDR_DETECTION_077_080_oPCAN_RADAR_b386406e_Tx: ComBitPosition=120, ComBitSize=8, ComSignalInitValue=0, ComSignalType=UINT8, ComSystemTemplateSystemSignalRef=DET_SNR_077
            DET_SNR_078_oRDR_DETECTION_077_080_oPCAN_RADAR_9f96d229_Tx: ComBitPosition=232, ComBitSize=8, ComSignalInitValue=0, ComSignalType=UINT8, ComSystemTemplateSystemSignalRef=DET_SNR_078
            DET_SNR_079_oRDR_DETECTION_077_080_oPCAN_RADAR_0ae606bc_Tx: ComBitPosition=344, ComBitSize=8, ComSignalInitValue=0, ComSignalType=UINT8, ComSystemTemplateSystemSignalRef=DET_SNR_079
            DET_SNR_080_oRDR_DETECTION_077_080_oPCAN_RADAR_07a2a7a6_Tx: ComBitPosition=456, ComBitSize=8, ComSignalInitValue=0, ComSignalType=UINT8, ComSystemTemplateSystemSignalRef=DET_SNR_080
            DET_SUPER_RES_TARGET_077_oRDR_DETECTION_077_080_oPCAN_RADAR_821f680b_Tx: ComBitPosition=87, ComBitSize=1, ComSignalInitValue=0, ComSignalType=BOOLEAN, ComSystemTemplateSystemSignalRef=DET_SUPER_RES_TARGET_077
            DET_SUPER_RES_TARGET_078_oRDR_DETECTION_077_080_oPCAN_RADAR_ae0ffa4c_Tx: ComBitPosition=199, ComBitSize=1, ComSignalInitValue=0, ComSignalType=BOOLEAN, ComSystemTemplateSystemSignalRef=DET_SUPER_RES_TARGET_078
            DET_SUPER_RES_TARGET_079_oRDR_DETECTION_077_080_oPCAN_RADAR_3b7f2ed9_Tx: ComBitPosition=311, ComBitSize=1, ComSignalInitValue=0, ComSignalType=BOOLEAN, ComSystemTemplateSystemSignalRef=DET_SUPER_RES_TARGET_079
            DET_SUPER_RES_TARGET_080_oRDR_DETECTION_077_080_oPCAN_RADAR_363b8fc3_Tx: ComBitPosition=423, ComBitSize=1, ComSignalInitValue=0, ComSignalType=BOOLEAN, ComSystemTemplateSystemSignalRef=DET_SUPER_RES_TARGET_080
        SG_Detections_081_084_oRDR_DETECTION_081_084_oPCAN_RADAR_0a9e14ed_Tx: ComSystemTemplateSignalGroupRef=SG_Detections_081_084
          83 x ComGroupSignal, all with ComSignalEndianness=LITTLE_ENDIAN, ComTransferProperty=PENDING:
            DET_AZIMUTH_081_oRDR_DETECTION_081_084_oPCAN_RADAR_3c33d803_Tx: ComBitPosition=88, ComBitSize=13, ComSignalInitValue=0, ComSignalType=UINT16, ComSystemTemplateSystemSignalRef=DET_AZIMUTH_081
            DET_AZIMUTH_082_oRDR_DETECTION_081_084_oPCAN_RADAR_58d3a3fd_Tx: ComBitPosition=200, ComBitSize=13, ComSignalInitValue=0, ComSignalType=UINT16, ComSystemTemplateSystemSignalRef=DET_AZIMUTH_082
            DET_AZIMUTH_083_oRDR_DETECTION_081_084_oPCAN_RADAR_cda37768_Tx: ComBitPosition=312, ComBitSize=13, ComSignalInitValue=0, ComSignalType=UINT16, ComSystemTemplateSystemSignalRef=DET_AZIMUTH_083
            DET_AZIMUTH_084_oRDR_DETECTION_081_084_oPCAN_RADAR_91135401_Tx: ComBitPosition=424, ComBitSize=13, ComSignalInitValue=0, ComSignalType=UINT16, ComSystemTemplateSystemSignalRef=DET_AZIMUTH_084
            DET_AZIMUTH_ERR_081_oRDR_DETECTION_081_084_oPCAN_RADAR_98864df6_Tx: ComBitPosition=105, ComBitSize=7, ComSignalInitValue=0, ComSignalType=UINT8, ComSystemTemplateSystemSignalRef=DET_AZIMUTH_ERR_081
            DET_AZIMUTH_ERR_082_oRDR_DETECTION_081_084_oPCAN_RADAR_fc663608_Tx: ComBitPosition=217, ComBitSize=7, ComSignalInitValue=0, ComSignalType=UINT8, ComSystemTemplateSystemSignalRef=DET_AZIMUTH_ERR_082
            DET_AZIMUTH_ERR_083_oRDR_DETECTION_081_084_oPCAN_RADAR_6916e29d_Tx: ComBitPosition=329, ComBitSize=7, ComSignalInitValue=0, ComSignalType=UINT8, ComSystemTemplateSystemSignalRef=DET_AZIMUTH_ERR_083
            DET_AZIMUTH_ERR_084_oRDR_DETECTION_081_084_oPCAN_RADAR_35a6c1f4_Tx: ComBitPosition=441, ComBitSize=7, ComSignalInitValue=0, ComSignalType=UINT8, ComSystemTemplateSystemSignalRef=DET_AZIMUTH_ERR_084
            DET_BELOW_RAIN_THOLD_081_oRDR_DETECTION_081_084_oPCAN_RADAR_e9324bc3_Tx: ComBitPosition=39, ComBitSize=1, ComSignalInitValue=0, ComSignalType=BOOLEAN, ComSystemTemplateSystemSignalRef=DET_BELOW_RAIN_THOLD_081
            DET_BELOW_RAIN_THOLD_082_oRDR_DETECTION_081_084_oPCAN_RADAR_8dd2303d_Tx: ComBitPosition=151, ComBitSize=1, ComSignalInitValue=0, ComSignalType=BOOLEAN, ComSystemTemplateSystemSignalRef=DET_BELOW_RAIN_THOLD_082
            DET_BELOW_RAIN_THOLD_083_oRDR_DETECTION_081_084_oPCAN_RADAR_18a2e4a8_Tx: ComBitPosition=263, ComBitSize=1, ComSignalInitValue=0, ComSignalType=BOOLEAN, ComSystemTemplateSystemSignalRef=DET_BELOW_RAIN_THOLD_083
            DET_BELOW_RAIN_THOLD_084_oRDR_DETECTION_081_084_oPCAN_RADAR_4412c7c1_Tx: ComBitPosition=375, ComBitSize=1, ComSignalInitValue=0, ComSignalType=BOOLEAN, ComSystemTemplateSystemSignalRef=DET_BELOW_RAIN_THOLD_084
            DET_BI_STATIC_FLAG_081_oRDR_DETECTION_081_084_oPCAN_RADAR_6a1f9886_Tx: ComBitPosition=104, ComBitSize=1, ComSignalInitValue=0, ComSignalType=BOOLEAN, ComSystemTemplateSystemSignalRef=DET_BI_STATIC_FLAG_081
            DET_BI_STATIC_FLAG_082_oRDR_DETECTION_081_084_oPCAN_RADAR_0effe378_Tx: ComBitPosition=216, ComBitSize=1, ComSignalInitValue=0, ComSignalType=BOOLEAN, ComSystemTemplateSystemSignalRef=DET_BI_STATIC_FLAG_082
            DET_BI_STATIC_FLAG_083_oRDR_DETECTION_081_084_oPCAN_RADAR_9b8f37ed_Tx: ComBitPosition=328, ComBitSize=1, ComSignalInitValue=0, ComSignalType=BOOLEAN, ComSystemTemplateSystemSignalRef=DET_BI_STATIC_FLAG_083
            DET_BI_STATIC_FLAG_084_oRDR_DETECTION_081_084_oPCAN_RADAR_c73f1484_Tx: ComBitPosition=440, ComBitSize=1, ComSignalInitValue=0, ComSignalType=BOOLEAN, ComSystemTemplateSystemSignalRef=DET_BI_STATIC_FLAG_084
            DET_CONFD_AZIMUTH_081_oRDR_DETECTION_081_084_oPCAN_RADAR_3ed5d2c9_Tx: ComBitPosition=118, ComBitSize=2, ComSignalInitValue=0, ComSignalType=UINT8, ComSystemTemplateSystemSignalRef=DET_CONFD_AZIMUTH_081
            DET_CONFD_AZIMUTH_082_oRDR_DETECTION_081_084_oPCAN_RADAR_5a35a937_Tx: ComBitPosition=230, ComBitSize=2, ComSignalInitValue=0, ComSignalType=UINT8, ComSystemTemplateSystemSignalRef=DET_CONFD_AZIMUTH_082
            DET_CONFD_AZIMUTH_083_oRDR_DETECTION_081_084_oPCAN_RADAR_cf457da2_Tx: ComBitPosition=342, ComBitSize=2, ComSignalInitValue=0, ComSignalType=UINT8, ComSystemTemplateSystemSignalRef=DET_CONFD_AZIMUTH_083
            DET_CONFD_AZIMUTH_084_oRDR_DETECTION_081_084_oPCAN_RADAR_93f55ecb_Tx: ComBitPosition=454, ComBitSize=2, ComSignalInitValue=0, ComSignalType=UINT8, ComSystemTemplateSystemSignalRef=DET_CONFD_AZIMUTH_084
            DET_CONFD_ELEVATION_081_oRDR_DETECTION_081_084_oPCAN_RADAR_3c40d333_Tx: ComBitPosition=101, ComBitSize=2, ComSignalInitValue=0, ComSignalType=UINT8, ComSystemTemplateSystemSignalRef=DET_CONFD_ELEVATION_081
            DET_CONFD_ELEVATION_082_oRDR_DETECTION_081_084_oPCAN_RADAR_58a0a8cd_Tx: ComBitPosition=213, ComBitSize=2, ComSignalInitValue=0, ComSignalType=UINT8, ComSystemTemplateSystemSignalRef=DET_CONFD_ELEVATION_082
            DET_CONFD_ELEVATION_083_oRDR_DETECTION_081_084_oPCAN_RADAR_cdd07c58_Tx: ComBitPosition=325, ComBitSize=2, ComSignalInitValue=0, ComSignalType=UINT8, ComSystemTemplateSystemSignalRef=DET_CONFD_ELEVATION_083
            DET_CONFD_ELEVATION_084_oRDR_DETECTION_081_084_oPCAN_RADAR_91605f31_Tx: ComBitPosition=437, ComBitSize=2, ComSignalInitValue=0, ComSignalType=UINT8, ComSystemTemplateSystemSignalRef=DET_CONFD_ELEVATION_084
            DET_ELEVATION_081_oRDR_DETECTION_081_084_oPCAN_RADAR_ed80070f_Tx: ComBitPosition=72, ComBitSize=8, ComSignalInitValue=0, ComSignalType=UINT8, ComSystemTemplateSystemSignalRef=DET_ELEVATION_081
            DET_ELEVATION_082_oRDR_DETECTION_081_084_oPCAN_RADAR_89607cf1_Tx: ComBitPosition=184, ComBitSize=8, ComSignalInitValue=0, ComSignalType=UINT8, ComSystemTemplateSystemSignalRef=DET_ELEVATION_082
            DET_ELEVATION_083_oRDR_DETECTION_081_084_oPCAN_RADAR_1c10a864_Tx: ComBitPosition=296, ComBitSize=8, ComSignalInitValue=0, ComSignalType=UINT8, ComSystemTemplateSystemSignalRef=DET_ELEVATION_083
            DET_ELEVATION_084_oRDR_DETECTION_081_084_oPCAN_RADAR_40a08b0d_Tx: ComBitPosition=408, ComBitSize=8, ComSignalInitValue=0, ComSignalType=UINT8, ComSystemTemplateSystemSignalRef=DET_ELEVATION_084
            DET_ELEVATION_ERR_081_oRDR_DETECTION_081_084_oPCAN_RADAR_6ab99f7a_Tx: ComBitPosition=80, ComBitSize=6, ComSignalInitValue=0, ComSignalType=UINT8, ComSystemTemplateSystemSignalRef=DET_ELEVATION_ERR_081
            DET_ELEVATION_ERR_082_oRDR_DETECTION_081_084_oPCAN_RADAR_0e59e484_Tx: ComBitPosition=192, ComBitSize=6, ComSignalInitValue=0, ComSignalType=UINT8, ComSystemTemplateSystemSignalRef=DET_ELEVATION_ERR_082
            DET_ELEVATION_ERR_083_oRDR_DETECTION_081_084_oPCAN_RADAR_9b293011_Tx: ComBitPosition=304, ComBitSize=6, ComSignalInitValue=0, ComSignalType=UINT8, ComSystemTemplateSystemSignalRef=DET_ELEVATION_ERR_083
            DET_ELEVATION_ERR_084_oRDR_DETECTION_081_084_oPCAN_RADAR_c7991378_Tx: ComBitPosition=416, ComBitSize=6, ComSignalInitValue=0, ComSignalType=UINT8, ComSystemTemplateSystemSignalRef=DET_ELEVATION_ERR_084
            DET_EXISTENCE_PROB_081_oRDR_DETECTION_081_084_oPCAN_RADAR_b826ea1a_Tx: ComBitPosition=112, ComBitSize=6, ComSignalInitValue=0, ComSignalType=UINT8, ComSystemTemplateSystemSignalRef=DET_EXISTENCE_PROB_081
            DET_EXISTENCE_PROB_082_oRDR_DETECTION_081_084_oPCAN_RADAR_dcc691e4_Tx: ComBitPosition=224, ComBitSize=6, ComSignalInitValue=0, ComSignalType=UINT8, ComSystemTemplateSystemSignalRef=DET_EXISTENCE_PROB_082
            DET_EXISTENCE_PROB_083_oRDR_DETECTION_081_084_oPCAN_RADAR_49b64571_Tx: ComBitPosition=336, ComBitSize=6, ComSignalInitValue=0, ComSignalType=UINT8, ComSystemTemplateSystemSignalRef=DET_EXISTENCE_PROB_083
            DET_EXISTENCE_PROB_084_oRDR_DETECTION_081_084_oPCAN_RADAR_15066618_Tx: ComBitPosition=448, ComBitSize=6, ComSignalInitValue=0, ComSignalType=UINT8, ComSystemTemplateSystemSignalRef=DET_EXISTENCE_PROB_084
            DET_HVC_FLAG_081_oRDR_DETECTION_081_084_oPCAN_RADAR_5952a965_Tx: ComBitPosition=86, ComBitSize=1, ComSignalInitValue=0, ComSignalType=BOOLEAN, ComSystemTemplateSystemSignalRef=DET_HVC_FLAG_081
            DET_HVC_FLAG_082_oRDR_DETECTION_081_084_oPCAN_RADAR_3db2d29b_Tx: ComBitPosition=198, ComBitSize=1, ComSignalInitValue=0, ComSignalType=BOOLEAN, ComSystemTemplateSystemSignalRef=DET_HVC_FLAG_082
            DET_HVC_FLAG_083_oRDR_DETECTION_081_084_oPCAN_RADAR_a8c2060e_Tx: ComBitPosition=310, ComBitSize=1, ComSignalInitValue=0, ComSignalType=BOOLEAN, ComSystemTemplateSystemSignalRef=DET_HVC_FLAG_083
            DET_HVC_FLAG_084_oRDR_DETECTION_081_084_oPCAN_RADAR_f4722567_Tx: ComBitPosition=422, ComBitSize=1, ComSignalInitValue=0, ComSignalType=BOOLEAN, ComSystemTemplateSystemSignalRef=DET_HVC_FLAG_084
            DET_IDM_081_oRDR_DETECTION_081_084_oPCAN_RADAR_d20092d8_Tx: ComBitPosition=63, ComBitSize=1, ComSignalInitValue=0, ComSignalType=BOOLEAN, ComSystemTemplateSystemSignalRef=DET_IDM_081
            DET_IDM_082_oRDR_DETECTION_081_084_oPCAN_RADAR_b6e0e926_Tx: ComBitPosition=175, ComBitSize=1, ComSignalInitValue=0, ComSignalType=BOOLEAN, ComSystemTemplateSystemSignalRef=DET_IDM_082
            DET_IDM_083_oRDR_DETECTION_081_084_oPCAN_RADAR_23903db3_Tx: ComBitPosition=287, ComBitSize=1, ComSignalInitValue=0, ComSignalType=BOOLEAN, ComSystemTemplateSystemSignalRef=DET_IDM_083
            DET_IDM_084_oRDR_DETECTION_081_084_oPCAN_RADAR_7f201eda_Tx: ComBitPosition=399, ComBitSize=1, ComSignalInitValue=0, ComSignalType=BOOLEAN, ComSystemTemplateSystemSignalRef=DET_IDM_084
            DET_MH_CRC16_081_084_oRDR_DETECTION_081_084_oPCAN_RADAR_8e16c6e6_Tx: ComBitPosition=0, ComBitSize=16, ComSignalInitValue=0, ComSignalType=UINT16, ComSystemTemplateSystemSignalRef=DET_MH_CRC16_081_084
            DET_MH_CYCLE_COUNTER_081_084_oRDR_DETECTION_081_084_oPCAN_RADAR_0a6367d1_Tx: ComBitPosition=16, ComBitSize=8, ComSignalInitValue=0, ComSignalType=UINT8, ComSystemTemplateSystemSignalRef=DET_MH_CYCLE_COUNTER_081_084
            DET_MH_SCAN_INDEX_4LSB_081_084_oRDR_DETECTION_081_084_oPCAN_RADAR_c649425d_Tx: ComBitPosition=476, ComBitSize=4, ComSignalInitValue=0, ComSignalType=UINT8, ComSystemTemplateSystemSignalRef=DET_MH_SCAN_INDEX_4LSB_081_084
            DET_MTD_081_oRDR_DETECTION_081_084_oPCAN_RADAR_b4b3a003_Tx: ComBitPosition=47, ComBitSize=1, ComSignalInitValue=0, ComSignalType=BOOLEAN, ComSystemTemplateSystemSignalRef=DET_MTD_081
            DET_MTD_082_oRDR_DETECTION_081_084_oPCAN_RADAR_d053dbfd_Tx: ComBitPosition=159, ComBitSize=1, ComSignalInitValue=0, ComSignalType=BOOLEAN, ComSystemTemplateSystemSignalRef=DET_MTD_082
            DET_MTD_083_oRDR_DETECTION_081_084_oPCAN_RADAR_45230f68_Tx: ComBitPosition=271, ComBitSize=1, ComSignalInitValue=0, ComSignalType=BOOLEAN, ComSystemTemplateSystemSignalRef=DET_MTD_083
            DET_MTD_084_oRDR_DETECTION_081_084_oPCAN_RADAR_19932c01_Tx: ComBitPosition=383, ComBitSize=1, ComSignalInitValue=0, ComSignalType=BOOLEAN, ComSystemTemplateSystemSignalRef=DET_MTD_084
            DET_PROB_1STAZHYPO_081_oRDR_DETECTION_081_084_oPCAN_RADAR_270748ce_Tx: ComBitPosition=103, ComBitSize=1, ComSignalInitValue=0, ComSignalType=BOOLEAN, ComSystemTemplateSystemSignalRef=DET_PROB_1STAZHYPO_081
            DET_PROB_1STAZHYPO_082_oRDR_DETECTION_081_084_oPCAN_RADAR_43e73330_Tx: ComBitPosition=215, ComBitSize=1, ComSignalInitValue=0, ComSignalType=BOOLEAN, ComSystemTemplateSystemSignalRef=DET_PROB_1STAZHYPO_082
            DET_PROB_1STAZHYPO_083_oRDR_DETECTION_081_084_oPCAN_RADAR_d697e7a5_Tx: ComBitPosition=327, ComBitSize=1, ComSignalInitValue=0, ComSignalType=BOOLEAN, ComSystemTemplateSystemSignalRef=DET_PROB_1STAZHYPO_083
            DET_PROB_1STAZHYPO_084_oRDR_DETECTION_081_084_oPCAN_RADAR_8a27c4cc_Tx: ComBitPosition=439, ComBitSize=1, ComSignalInitValue=0, ComSignalType=BOOLEAN, ComSystemTemplateSystemSignalRef=DET_PROB_1STAZHYPO_084
            DET_RANGE_081_oRDR_DETECTION_081_084_oPCAN_RADAR_2ca8abb8_Tx: ComBitPosition=24, ComBitSize=15, ComSignalInitValue=0, ComSignalType=UINT16, ComSystemTemplateSystemSignalRef=DET_RANGE_081
            DET_RANGE_082_oRDR_DETECTION_081_084_oPCAN_RADAR_4848d046_Tx: ComBitPosition=136, ComBitSize=15, ComSignalInitValue=0, ComSignalType=UINT16, ComSystemTemplateSystemSignalRef=DET_RANGE_082
            DET_RANGE_083_oRDR_DETECTION_081_084_oPCAN_RADAR_dd3804d3_Tx: ComBitPosition=248, ComBitSize=15, ComSignalInitValue=0, ComSignalType=UINT16, ComSystemTemplateSystemSignalRef=DET_RANGE_083
            DET_RANGE_084_oRDR_DETECTION_081_084_oPCAN_RADAR_818827ba_Tx: ComBitPosition=360, ComBitSize=15, ComSignalInitValue=0, ComSignalType=UINT16, ComSystemTemplateSystemSignalRef=DET_RANGE_084
            DET_RANGE_ERR_081_oRDR_DETECTION_081_084_oPCAN_RADAR_8b4011d1_Tx: ComBitPosition=40, ComBitSize=7, ComSignalInitValue=0, ComSignalType=UINT8, ComSystemTemplateSystemSignalRef=DET_RANGE_ERR_081
            DET_RANGE_ERR_082_oRDR_DETECTION_081_084_oPCAN_RADAR_efa06a2f_Tx: ComBitPosition=152, ComBitSize=7, ComSignalInitValue=0, ComSignalType=UINT8, ComSystemTemplateSystemSignalRef=DET_RANGE_ERR_082
            DET_RANGE_ERR_083_oRDR_DETECTION_081_084_oPCAN_RADAR_7ad0beba_Tx: ComBitPosition=264, ComBitSize=7, ComSignalInitValue=0, ComSignalType=UINT8, ComSystemTemplateSystemSignalRef=DET_RANGE_ERR_083
            DET_RANGE_ERR_084_oRDR_DETECTION_081_084_oPCAN_RADAR_26609dd3_Tx: ComBitPosition=376, ComBitSize=7, ComSignalInitValue=0, ComSignalType=UINT8, ComSystemTemplateSystemSignalRef=DET_RANGE_ERR_084
            DET_RANGE_VELOCITY_081_oRDR_DETECTION_081_084_oPCAN_RADAR_590e699d_Tx: ComBitPosition=48, ComBitSize=15, ComSignalInitValue=16384, ComSignalType=UINT16, ComSystemTemplateSystemSignalRef=DET_RANGE_VELOCITY_081
            DET_RANGE_VELOCITY_082_oRDR_DETECTION_081_084_oPCAN_RADAR_3dee1263_Tx: ComBitPosition=160, ComBitSize=15, ComSignalInitValue=16384, ComSignalType=UINT16, ComSystemTemplateSystemSignalRef=DET_RANGE_VELOCITY_082
            DET_RANGE_VELOCITY_083_oRDR_DETECTION_081_084_oPCAN_RADAR_a89ec6f6_Tx: ComBitPosition=272, ComBitSize=15, ComSignalInitValue=16384, ComSignalType=UINT16, ComSystemTemplateSystemSignalRef=DET_RANGE_VELOCITY_083
            DET_RANGE_VELOCITY_084_oRDR_DETECTION_081_084_oPCAN_RADAR_f42ee59f_Tx: ComBitPosition=384, ComBitSize=15, ComSignalInitValue=16384, ComSignalType=UINT16, ComSystemTemplateSystemSignalRef=DET_RANGE_VELOCITY_084
            DET_RANGE_VELOCITY_ERR_081_oRDR_DETECTION_081_084_oPCAN_RADAR_56b5922f_Tx: ComBitPosition=64, ComBitSize=8, ComSignalInitValue=0, ComSignalType=UINT8, ComSystemTemplateSystemSignalRef=DET_RANGE_VELOCITY_ERR_081
            DET_RANGE_VELOCITY_ERR_082_oRDR_DETECTION_081_084_oPCAN_RADAR_3255e9d1_Tx: ComBitPosition=176, ComBitSize=8, ComSignalInitValue=0, ComSignalType=UINT8, ComSystemTemplateSystemSignalRef=DET_RANGE_VELOCITY_ERR_082
            DET_RANGE_VELOCITY_ERR_083_oRDR_DETECTION_081_084_oPCAN_RADAR_a7253d44_Tx: ComBitPosition=288, ComBitSize=8, ComSignalInitValue=0, ComSignalType=UINT8, ComSystemTemplateSystemSignalRef=DET_RANGE_VELOCITY_ERR_083
            DET_RANGE_VELOCITY_ERR_084_oRDR_DETECTION_081_084_oPCAN_RADAR_fb951e2d_Tx: ComBitPosition=400, ComBitSize=8, ComSignalInitValue=0, ComSignalType=UINT8, ComSystemTemplateSystemSignalRef=DET_RANGE_VELOCITY_ERR_084
            DET_RCS_081_oRDR_DETECTION_081_084_oPCAN_RADAR_de8e5ec7_Tx: ComBitPosition=128, ComBitSize=8, ComSignalInitValue=128, ComSignalType=UINT8, ComSystemTemplateSystemSignalRef=DET_RCS_081
            DET_RCS_082_oRDR_DETECTION_081_084_oPCAN_RADAR_ba6e2539_Tx: ComBitPosition=240, ComBitSize=8, ComSignalInitValue=128, ComSignalType=UINT8, ComSystemTemplateSystemSignalRef=DET_RCS_082
            DET_RCS_083_oRDR_DETECTION_081_084_oPCAN_RADAR_2f1ef1ac_Tx: ComBitPosition=352, ComBitSize=8, ComSignalInitValue=128, ComSignalType=UINT8, ComSystemTemplateSystemSignalRef=DET_RCS_083
            DET_RCS_084_oRDR_DETECTION_081_084_oPCAN_RADAR_73aed2c5_Tx: ComBitPosition=464, ComBitSize=8, ComSignalInitValue=128, ComSignalType=UINT8, ComSystemTemplateSystemSignalRef=DET_RCS_084
            DET_SNR_081_oRDR_DETECTION_081_084_oPCAN_RADAR_03200ac5_Tx: ComBitPosition=120, ComBitSize=8, ComSignalInitValue=0, ComSignalType=UINT8, ComSystemTemplateSystemSignalRef=DET_SNR_081
            DET_SNR_082_oRDR_DETECTION_081_084_oPCAN_RADAR_67c0713b_Tx: ComBitPosition=232, ComBitSize=8, ComSignalInitValue=0, ComSignalType=UINT8, ComSystemTemplateSystemSignalRef=DET_SNR_082
            DET_SNR_083_oRDR_DETECTION_081_084_oPCAN_RADAR_f2b0a5ae_Tx: ComBitPosition=344, ComBitSize=8, ComSignalInitValue=0, ComSignalType=UINT8, ComSystemTemplateSystemSignalRef=DET_SNR_083
            DET_SNR_084_oRDR_DETECTION_081_084_oPCAN_RADAR_ae0086c7_Tx: ComBitPosition=456, ComBitSize=8, ComSignalInitValue=0, ComSignalType=UINT8, ComSystemTemplateSystemSignalRef=DET_SNR_084
            DET_SUPER_RES_TARGET_081_oRDR_DETECTION_081_084_oPCAN_RADAR_32b922a0_Tx: ComBitPosition=87, ComBitSize=1, ComSignalInitValue=0, ComSignalType=BOOLEAN, ComSystemTemplateSystemSignalRef=DET_SUPER_RES_TARGET_081
            DET_SUPER_RES_TARGET_082_oRDR_DETECTION_081_084_oPCAN_RADAR_5659595e_Tx: ComBitPosition=199, ComBitSize=1, ComSignalInitValue=0, ComSignalType=BOOLEAN, ComSystemTemplateSystemSignalRef=DET_SUPER_RES_TARGET_082
            DET_SUPER_RES_TARGET_083_oRDR_DETECTION_081_084_oPCAN_RADAR_c3298dcb_Tx: ComBitPosition=311, ComBitSize=1, ComSignalInitValue=0, ComSignalType=BOOLEAN, ComSystemTemplateSystemSignalRef=DET_SUPER_RES_TARGET_083
            DET_SUPER_RES_TARGET_084_oRDR_DETECTION_081_084_oPCAN_RADAR_9f99aea2_Tx: ComBitPosition=423, ComBitSize=1, ComSignalInitValue=0, ComSignalType=BOOLEAN, ComSystemTemplateSystemSignalRef=DET_SUPER_RES_TARGET_084
        SG_Detections_085_088_oRDR_DETECTION_085_088_oPCAN_RADAR_7b5d20bf_Tx: ComSystemTemplateSignalGroupRef=SG_Detections_085_088
          83 x ComGroupSignal, all with ComSignalEndianness=LITTLE_ENDIAN, ComTransferProperty=PENDING:
            DET_AZIMUTH_085_oRDR_DETECTION_085_088_oPCAN_RADAR_edd11ea0_Tx: ComBitPosition=88, ComBitSize=13, ComSignalInitValue=0, ComSignalType=UINT16, ComSystemTemplateSystemSignalRef=DET_AZIMUTH_085
            DET_AZIMUTH_086_oRDR_DETECTION_085_088_oPCAN_RADAR_8931655e_Tx: ComBitPosition=200, ComBitSize=13, ComSignalInitValue=0, ComSignalType=UINT16, ComSystemTemplateSystemSignalRef=DET_AZIMUTH_086
            DET_AZIMUTH_087_oRDR_DETECTION_085_088_oPCAN_RADAR_1c41b1cb_Tx: ComBitPosition=312, ComBitSize=13, ComSignalInitValue=0, ComSignalType=UINT16, ComSystemTemplateSystemSignalRef=DET_AZIMUTH_087
            DET_AZIMUTH_088_oRDR_DETECTION_085_088_oPCAN_RADAR_3051238c_Tx: ComBitPosition=424, ComBitSize=13, ComSignalInitValue=0, ComSignalType=UINT16, ComSystemTemplateSystemSignalRef=DET_AZIMUTH_088
            DET_AZIMUTH_ERR_085_oRDR_DETECTION_085_088_oPCAN_RADAR_49648b55_Tx: ComBitPosition=105, ComBitSize=7, ComSignalInitValue=0, ComSignalType=UINT8, ComSystemTemplateSystemSignalRef=DET_AZIMUTH_ERR_085
            DET_AZIMUTH_ERR_086_oRDR_DETECTION_085_088_oPCAN_RADAR_2d84f0ab_Tx: ComBitPosition=217, ComBitSize=7, ComSignalInitValue=0, ComSignalType=UINT8, ComSystemTemplateSystemSignalRef=DET_AZIMUTH_ERR_086
            DET_AZIMUTH_ERR_087_oRDR_DETECTION_085_088_oPCAN_RADAR_b8f4243e_Tx: ComBitPosition=329, ComBitSize=7, ComSignalInitValue=0, ComSignalType=UINT8, ComSystemTemplateSystemSignalRef=DET_AZIMUTH_ERR_087
            DET_AZIMUTH_ERR_088_oRDR_DETECTION_085_088_oPCAN_RADAR_94e4b679_Tx: ComBitPosition=441, ComBitSize=7, ComSignalInitValue=0, ComSignalType=UINT8, ComSystemTemplateSystemSignalRef=DET_AZIMUTH_ERR_088
            DET_BELOW_RAIN_THOLD_085_oRDR_DETECTION_085_088_oPCAN_RADAR_38d08d60_Tx: ComBitPosition=39, ComBitSize=1, ComSignalInitValue=0, ComSignalType=BOOLEAN, ComSystemTemplateSystemSignalRef=DET_BELOW_RAIN_THOLD_085
            DET_BELOW_RAIN_THOLD_086_oRDR_DETECTION_085_088_oPCAN_RADAR_5c30f69e_Tx: ComBitPosition=151, ComBitSize=1, ComSignalInitValue=0, ComSignalType=BOOLEAN, ComSystemTemplateSystemSignalRef=DET_BELOW_RAIN_THOLD_086
            DET_BELOW_RAIN_THOLD_087_oRDR_DETECTION_085_088_oPCAN_RADAR_c940220b_Tx: ComBitPosition=263, ComBitSize=1, ComSignalInitValue=0, ComSignalType=BOOLEAN, ComSystemTemplateSystemSignalRef=DET_BELOW_RAIN_THOLD_087
            DET_BELOW_RAIN_THOLD_088_oRDR_DETECTION_085_088_oPCAN_RADAR_e550b04c_Tx: ComBitPosition=375, ComBitSize=1, ComSignalInitValue=0, ComSignalType=BOOLEAN, ComSystemTemplateSystemSignalRef=DET_BELOW_RAIN_THOLD_088
            DET_BI_STATIC_FLAG_085_oRDR_DETECTION_085_088_oPCAN_RADAR_bbfd5e25_Tx: ComBitPosition=104, ComBitSize=1, ComSignalInitValue=0, ComSignalType=BOOLEAN, ComSystemTemplateSystemSignalRef=DET_BI_STATIC_FLAG_085
            DET_BI_STATIC_FLAG_086_oRDR_DETECTION_085_088_oPCAN_RADAR_df1d25db_Tx: ComBitPosition=216, ComBitSize=1, ComSignalInitValue=0, ComSignalType=BOOLEAN, ComSystemTemplateSystemSignalRef=DET_BI_STATIC_FLAG_086
            DET_BI_STATIC_FLAG_087_oRDR_DETECTION_085_088_oPCAN_RADAR_4a6df14e_Tx: ComBitPosition=328, ComBitSize=1, ComSignalInitValue=0, ComSignalType=BOOLEAN, ComSystemTemplateSystemSignalRef=DET_BI_STATIC_FLAG_087
            DET_BI_STATIC_FLAG_088_oRDR_DETECTION_085_088_oPCAN_RADAR_667d6309_Tx: ComBitPosition=440, ComBitSize=1, ComSignalInitValue=0, ComSignalType=BOOLEAN, ComSystemTemplateSystemSignalRef=DET_BI_STATIC_FLAG_088
            DET_CONFD_AZIMUTH_085_oRDR_DETECTION_085_088_oPCAN_RADAR_ef37146a_Tx: ComBitPosition=118, ComBitSize=2, ComSignalInitValue=0, ComSignalType=UINT8, ComSystemTemplateSystemSignalRef=DET_CONFD_AZIMUTH_085
            DET_CONFD_AZIMUTH_086_oRDR_DETECTION_085_088_oPCAN_RADAR_8bd76f94_Tx: ComBitPosition=230, ComBitSize=2, ComSignalInitValue=0, ComSignalType=UINT8, ComSystemTemplateSystemSignalRef=DET_CONFD_AZIMUTH_086
            DET_CONFD_AZIMUTH_087_oRDR_DETECTION_085_088_oPCAN_RADAR_1ea7bb01_Tx: ComBitPosition=342, ComBitSize=2, ComSignalInitValue=0, ComSignalType=UINT8, ComSystemTemplateSystemSignalRef=DET_CONFD_AZIMUTH_087
            DET_CONFD_AZIMUTH_088_oRDR_DETECTION_085_088_oPCAN_RADAR_32b72946_Tx: ComBitPosition=454, ComBitSize=2, ComSignalInitValue=0, ComSignalType=UINT8, ComSystemTemplateSystemSignalRef=DET_CONFD_AZIMUTH_088
            DET_CONFD_ELEVATION_085_oRDR_DETECTION_085_088_oPCAN_RADAR_eda21590_Tx: ComBitPosition=101, ComBitSize=2, ComSignalInitValue=0, ComSignalType=UINT8, ComSystemTemplateSystemSignalRef=DET_CONFD_ELEVATION_085
            DET_CONFD_ELEVATION_086_oRDR_DETECTION_085_088_oPCAN_RADAR_89426e6e_Tx: ComBitPosition=213, ComBitSize=2, ComSignalInitValue=0, ComSignalType=UINT8, ComSystemTemplateSystemSignalRef=DET_CONFD_ELEVATION_086
            DET_CONFD_ELEVATION_087_oRDR_DETECTION_085_088_oPCAN_RADAR_1c32bafb_Tx: ComBitPosition=325, ComBitSize=2, ComSignalInitValue=0, ComSignalType=UINT8, ComSystemTemplateSystemSignalRef=DET_CONFD_ELEVATION_087
            DET_CONFD_ELEVATION_088_oRDR_DETECTION_085_088_oPCAN_RADAR_302228bc_Tx: ComBitPosition=437, ComBitSize=2, ComSignalInitValue=0, ComSignalType=UINT8, ComSystemTemplateSystemSignalRef=DET_CONFD_ELEVATION_088
            DET_ELEVATION_085_oRDR_DETECTION_085_088_oPCAN_RADAR_3c62c1ac_Tx: ComBitPosition=72, ComBitSize=8, ComSignalInitValue=0, ComSignalType=UINT8, ComSystemTemplateSystemSignalRef=DET_ELEVATION_085
            DET_ELEVATION_086_oRDR_DETECTION_085_088_oPCAN_RADAR_5882ba52_Tx: ComBitPosition=184, ComBitSize=8, ComSignalInitValue=0, ComSignalType=UINT8, ComSystemTemplateSystemSignalRef=DET_ELEVATION_086
            DET_ELEVATION_087_oRDR_DETECTION_085_088_oPCAN_RADAR_cdf26ec7_Tx: ComBitPosition=296, ComBitSize=8, ComSignalInitValue=0, ComSignalType=UINT8, ComSystemTemplateSystemSignalRef=DET_ELEVATION_087
            DET_ELEVATION_088_oRDR_DETECTION_085_088_oPCAN_RADAR_e1e2fc80_Tx: ComBitPosition=408, ComBitSize=8, ComSignalInitValue=0, ComSignalType=UINT8, ComSystemTemplateSystemSignalRef=DET_ELEVATION_088
            DET_ELEVATION_ERR_085_oRDR_DETECTION_085_088_oPCAN_RADAR_bb5b59d9_Tx: ComBitPosition=80, ComBitSize=6, ComSignalInitValue=0, ComSignalType=UINT8, ComSystemTemplateSystemSignalRef=DET_ELEVATION_ERR_085
            DET_ELEVATION_ERR_086_oRDR_DETECTION_085_088_oPCAN_RADAR_dfbb2227_Tx: ComBitPosition=192, ComBitSize=6, ComSignalInitValue=0, ComSignalType=UINT8, ComSystemTemplateSystemSignalRef=DET_ELEVATION_ERR_086
            DET_ELEVATION_ERR_087_oRDR_DETECTION_085_088_oPCAN_RADAR_4acbf6b2_Tx: ComBitPosition=304, ComBitSize=6, ComSignalInitValue=0, ComSignalType=UINT8, ComSystemTemplateSystemSignalRef=DET_ELEVATION_ERR_087
            DET_ELEVATION_ERR_088_oRDR_DETECTION_085_088_oPCAN_RADAR_66db64f5_Tx: ComBitPosition=416, ComBitSize=6, ComSignalInitValue=0, ComSignalType=UINT8, ComSystemTemplateSystemSignalRef=DET_ELEVATION_ERR_088
            DET_EXISTENCE_PROB_085_oRDR_DETECTION_085_088_oPCAN_RADAR_69c42cb9_Tx: ComBitPosition=112, ComBitSize=6, ComSignalInitValue=0, ComSignalType=UINT8, ComSystemTemplateSystemSignalRef=DET_EXISTENCE_PROB_085
            DET_EXISTENCE_PROB_086_oRDR_DETECTION_085_088_oPCAN_RADAR_0d245747_Tx: ComBitPosition=224, ComBitSize=6, ComSignalInitValue=0, ComSignalType=UINT8, ComSystemTemplateSystemSignalRef=DET_EXISTENCE_PROB_086
            DET_EXISTENCE_PROB_087_oRDR_DETECTION_085_088_oPCAN_RADAR_985483d2_Tx: ComBitPosition=336, ComBitSize=6, ComSignalInitValue=0, ComSignalType=UINT8, ComSystemTemplateSystemSignalRef=DET_EXISTENCE_PROB_087
            DET_EXISTENCE_PROB_088_oRDR_DETECTION_085_088_oPCAN_RADAR_b4441195_Tx: ComBitPosition=448, ComBitSize=6, ComSignalInitValue=0, ComSignalType=UINT8, ComSystemTemplateSystemSignalRef=DET_EXISTENCE_PROB_088
            DET_HVC_FLAG_085_oRDR_DETECTION_085_088_oPCAN_RADAR_88b06fc6_Tx: ComBitPosition=86, ComBitSize=1, ComSignalInitValue=0, ComSignalType=BOOLEAN, ComSystemTemplateSystemSignalRef=DET_HVC_FLAG_085
            DET_HVC_FLAG_086_oRDR_DETECTION_085_088_oPCAN_RADAR_ec501438_Tx: ComBitPosition=198, ComBitSize=1, ComSignalInitValue=0, ComSignalType=BOOLEAN, ComSystemTemplateSystemSignalRef=DET_HVC_FLAG_086
            DET_HVC_FLAG_087_oRDR_DETECTION_085_088_oPCAN_RADAR_7920c0ad_Tx: ComBitPosition=310, ComBitSize=1, ComSignalInitValue=0, ComSignalType=BOOLEAN, ComSystemTemplateSystemSignalRef=DET_HVC_FLAG_087
            DET_HVC_FLAG_088_oRDR_DETECTION_085_088_oPCAN_RADAR_553052ea_Tx: ComBitPosition=422, ComBitSize=1, ComSignalInitValue=0, ComSignalType=BOOLEAN, ComSystemTemplateSystemSignalRef=DET_HVC_FLAG_088
            DET_IDM_085_oRDR_DETECTION_085_088_oPCAN_RADAR_03e2547b_Tx: ComBitPosition=63, ComBitSize=1, ComSignalInitValue=0, ComSignalType=BOOLEAN, ComSystemTemplateSystemSignalRef=DET_IDM_085
            DET_IDM_086_oRDR_DETECTION_085_088_oPCAN_RADAR_67022f85_Tx: ComBitPosition=175, ComBitSize=1, ComSignalInitValue=0, ComSignalType=BOOLEAN, ComSystemTemplateSystemSignalRef=DET_IDM_086
            DET_IDM_087_oRDR_DETECTION_085_088_oPCAN_RADAR_f272fb10_Tx: ComBitPosition=287, ComBitSize=1, ComSignalInitValue=0, ComSignalType=BOOLEAN, ComSystemTemplateSystemSignalRef=DET_IDM_087
            DET_IDM_088_oRDR_DETECTION_085_088_oPCAN_RADAR_de626957_Tx: ComBitPosition=399, ComBitSize=1, ComSignalInitValue=0, ComSignalType=BOOLEAN, ComSystemTemplateSystemSignalRef=DET_IDM_088
            DET_MH_CRC16_085_088_oRDR_DETECTION_085_088_oPCAN_RADAR_ffd5f2b4_Tx: ComBitPosition=0, ComBitSize=16, ComSignalInitValue=0, ComSignalType=UINT16, ComSystemTemplateSystemSignalRef=DET_MH_CRC16_085_088
            DET_MH_CYCLE_COUNTER_085_088_oRDR_DETECTION_085_088_oPCAN_RADAR_7ba05383_Tx: ComBitPosition=16, ComBitSize=8, ComSignalInitValue=0, ComSignalType=UINT8, ComSystemTemplateSystemSignalRef=DET_MH_CYCLE_COUNTER_085_088
            DET_MH_SCAN_INDEX_4LSB_085_088_oRDR_DETECTION_085_088_oPCAN_RADAR_b78a760f_Tx: ComBitPosition=476, ComBitSize=4, ComSignalInitValue=0, ComSignalType=UINT8, ComSystemTemplateSystemSignalRef=DET_MH_SCAN_INDEX_4LSB_085_088
            DET_MTD_085_oRDR_DETECTION_085_088_oPCAN_RADAR_655166a0_Tx: ComBitPosition=47, ComBitSize=1, ComSignalInitValue=0, ComSignalType=BOOLEAN, ComSystemTemplateSystemSignalRef=DET_MTD_085
            DET_MTD_086_oRDR_DETECTION_085_088_oPCAN_RADAR_01b11d5e_Tx: ComBitPosition=159, ComBitSize=1, ComSignalInitValue=0, ComSignalType=BOOLEAN, ComSystemTemplateSystemSignalRef=DET_MTD_086
            DET_MTD_087_oRDR_DETECTION_085_088_oPCAN_RADAR_94c1c9cb_Tx: ComBitPosition=271, ComBitSize=1, ComSignalInitValue=0, ComSignalType=BOOLEAN, ComSystemTemplateSystemSignalRef=DET_MTD_087
            DET_MTD_088_oRDR_DETECTION_085_088_oPCAN_RADAR_b8d15b8c_Tx: ComBitPosition=383, ComBitSize=1, ComSignalInitValue=0, ComSignalType=BOOLEAN, ComSystemTemplateSystemSignalRef=DET_MTD_088
            DET_PROB_1STAZHYPO_085_oRDR_DETECTION_085_088_oPCAN_RADAR_f6e58e6d_Tx: ComBitPosition=103, ComBitSize=1, ComSignalInitValue=0, ComSignalType=BOOLEAN, ComSystemTemplateSystemSignalRef=DET_PROB_1STAZHYPO_085
            DET_PROB_1STAZHYPO_086_oRDR_DETECTION_085_088_oPCAN_RADAR_9205f593_Tx: ComBitPosition=215, ComBitSize=1, ComSignalInitValue=0, ComSignalType=BOOLEAN, ComSystemTemplateSystemSignalRef=DET_PROB_1STAZHYPO_086
            DET_PROB_1STAZHYPO_087_oRDR_DETECTION_085_088_oPCAN_RADAR_07752106_Tx: ComBitPosition=327, ComBitSize=1, ComSignalInitValue=0, ComSignalType=BOOLEAN, ComSystemTemplateSystemSignalRef=DET_PROB_1STAZHYPO_087
            DET_PROB_1STAZHYPO_088_oRDR_DETECTION_085_088_oPCAN_RADAR_2b65b341_Tx: ComBitPosition=439, ComBitSize=1, ComSignalInitValue=0, ComSignalType=BOOLEAN, ComSystemTemplateSystemSignalRef=DET_PROB_1STAZHYPO_088
            DET_RANGE_085_oRDR_DETECTION_085_088_oPCAN_RADAR_fd4a6d1b_Tx: ComBitPosition=24, ComBitSize=15, ComSignalInitValue=0, ComSignalType=UINT16, ComSystemTemplateSystemSignalRef=DET_RANGE_085
            DET_RANGE_086_oRDR_DETECTION_085_088_oPCAN_RADAR_99aa16e5_Tx: ComBitPosition=136, ComBitSize=15, ComSignalInitValue=0, ComSignalType=UINT16, ComSystemTemplateSystemSignalRef=DET_RANGE_086
            DET_RANGE_087_oRDR_DETECTION_085_088_oPCAN_RADAR_0cdac270_Tx: ComBitPosition=248, ComBitSize=15, ComSignalInitValue=0, ComSignalType=UINT16, ComSystemTemplateSystemSignalRef=DET_RANGE_087
            DET_RANGE_088_oRDR_DETECTION_085_088_oPCAN_RADAR_20ca5037_Tx: ComBitPosition=360, ComBitSize=15, ComSignalInitValue=0, ComSignalType=UINT16, ComSystemTemplateSystemSignalRef=DET_RANGE_088
            DET_RANGE_ERR_085_oRDR_DETECTION_085_088_oPCAN_RADAR_5aa2d772_Tx: ComBitPosition=40, ComBitSize=7, ComSignalInitValue=0, ComSignalType=UINT8, ComSystemTemplateSystemSignalRef=DET_RANGE_ERR_085
            DET_RANGE_ERR_086_oRDR_DETECTION_085_088_oPCAN_RADAR_3e42ac8c_Tx: ComBitPosition=152, ComBitSize=7, ComSignalInitValue=0, ComSignalType=UINT8, ComSystemTemplateSystemSignalRef=DET_RANGE_ERR_086
            DET_RANGE_ERR_087_oRDR_DETECTION_085_088_oPCAN_RADAR_ab327819_Tx: ComBitPosition=264, ComBitSize=7, ComSignalInitValue=0, ComSignalType=UINT8, ComSystemTemplateSystemSignalRef=DET_RANGE_ERR_087
            DET_RANGE_ERR_088_oRDR_DETECTION_085_088_oPCAN_RADAR_8722ea5e_Tx: ComBitPosition=376, ComBitSize=7, ComSignalInitValue=0, ComSignalType=UINT8, ComSystemTemplateSystemSignalRef=DET_RANGE_ERR_088
            DET_RANGE_VELOCITY_085_oRDR_DETECTION_085_088_oPCAN_RADAR_88ecaf3e_Tx: ComBitPosition=48, ComBitSize=15, ComSignalInitValue=16384, ComSignalType=UINT16, ComSystemTemplateSystemSignalRef=DET_RANGE_VELOCITY_085
            DET_RANGE_VELOCITY_086_oRDR_DETECTION_085_088_oPCAN_RADAR_ec0cd4c0_Tx: ComBitPosition=160, ComBitSize=15, ComSignalInitValue=16384, ComSignalType=UINT16, ComSystemTemplateSystemSignalRef=DET_RANGE_VELOCITY_086
            DET_RANGE_VELOCITY_087_oRDR_DETECTION_085_088_oPCAN_RADAR_797c0055_Tx: ComBitPosition=272, ComBitSize=15, ComSignalInitValue=16384, ComSignalType=UINT16, ComSystemTemplateSystemSignalRef=DET_RANGE_VELOCITY_087
            DET_RANGE_VELOCITY_088_oRDR_DETECTION_085_088_oPCAN_RADAR_556c9212_Tx: ComBitPosition=384, ComBitSize=15, ComSignalInitValue=16384, ComSignalType=UINT16, ComSystemTemplateSystemSignalRef=DET_RANGE_VELOCITY_088
            DET_RANGE_VELOCITY_ERR_085_oRDR_DETECTION_085_088_oPCAN_RADAR_8757548c_Tx: ComBitPosition=64, ComBitSize=8, ComSignalInitValue=0, ComSignalType=UINT8, ComSystemTemplateSystemSignalRef=DET_RANGE_VELOCITY_ERR_085
            DET_RANGE_VELOCITY_ERR_086_oRDR_DETECTION_085_088_oPCAN_RADAR_e3b72f72_Tx: ComBitPosition=176, ComBitSize=8, ComSignalInitValue=0, ComSignalType=UINT8, ComSystemTemplateSystemSignalRef=DET_RANGE_VELOCITY_ERR_086
            DET_RANGE_VELOCITY_ERR_087_oRDR_DETECTION_085_088_oPCAN_RADAR_76c7fbe7_Tx: ComBitPosition=288, ComBitSize=8, ComSignalInitValue=0, ComSignalType=UINT8, ComSystemTemplateSystemSignalRef=DET_RANGE_VELOCITY_ERR_087
            DET_RANGE_VELOCITY_ERR_088_oRDR_DETECTION_085_088_oPCAN_RADAR_5ad769a0_Tx: ComBitPosition=400, ComBitSize=8, ComSignalInitValue=0, ComSignalType=UINT8, ComSystemTemplateSystemSignalRef=DET_RANGE_VELOCITY_ERR_088
            DET_RCS_085_oRDR_DETECTION_085_088_oPCAN_RADAR_0f6c9864_Tx: ComBitPosition=128, ComBitSize=8, ComSignalInitValue=128, ComSignalType=UINT8, ComSystemTemplateSystemSignalRef=DET_RCS_085
            DET_RCS_086_oRDR_DETECTION_085_088_oPCAN_RADAR_6b8ce39a_Tx: ComBitPosition=240, ComBitSize=8, ComSignalInitValue=128, ComSignalType=UINT8, ComSystemTemplateSystemSignalRef=DET_RCS_086
            DET_RCS_087_oRDR_DETECTION_085_088_oPCAN_RADAR_fefc370f_Tx: ComBitPosition=352, ComBitSize=8, ComSignalInitValue=128, ComSignalType=UINT8, ComSystemTemplateSystemSignalRef=DET_RCS_087
            DET_RCS_088_oRDR_DETECTION_085_088_oPCAN_RADAR_d2eca548_Tx: ComBitPosition=464, ComBitSize=8, ComSignalInitValue=128, ComSignalType=UINT8, ComSystemTemplateSystemSignalRef=DET_RCS_088
            DET_SNR_085_oRDR_DETECTION_085_088_oPCAN_RADAR_d2c2cc66_Tx: ComBitPosition=120, ComBitSize=8, ComSignalInitValue=0, ComSignalType=UINT8, ComSystemTemplateSystemSignalRef=DET_SNR_085
            DET_SNR_086_oRDR_DETECTION_085_088_oPCAN_RADAR_b622b798_Tx: ComBitPosition=232, ComBitSize=8, ComSignalInitValue=0, ComSignalType=UINT8, ComSystemTemplateSystemSignalRef=DET_SNR_086
            DET_SNR_087_oRDR_DETECTION_085_088_oPCAN_RADAR_2352630d_Tx: ComBitPosition=344, ComBitSize=8, ComSignalInitValue=0, ComSignalType=UINT8, ComSystemTemplateSystemSignalRef=DET_SNR_087
            DET_SNR_088_oRDR_DETECTION_085_088_oPCAN_RADAR_0f42f14a_Tx: ComBitPosition=456, ComBitSize=8, ComSignalInitValue=0, ComSignalType=UINT8, ComSystemTemplateSystemSignalRef=DET_SNR_088
            DET_SUPER_RES_TARGET_085_oRDR_DETECTION_085_088_oPCAN_RADAR_e35be403_Tx: ComBitPosition=87, ComBitSize=1, ComSignalInitValue=0, ComSignalType=BOOLEAN, ComSystemTemplateSystemSignalRef=DET_SUPER_RES_TARGET_085
            DET_SUPER_RES_TARGET_086_oRDR_DETECTION_085_088_oPCAN_RADAR_87bb9ffd_Tx: ComBitPosition=199, ComBitSize=1, ComSignalInitValue=0, ComSignalType=BOOLEAN, ComSystemTemplateSystemSignalRef=DET_SUPER_RES_TARGET_086
            DET_SUPER_RES_TARGET_087_oRDR_DETECTION_085_088_oPCAN_RADAR_12cb4b68_Tx: ComBitPosition=311, ComBitSize=1, ComSignalInitValue=0, ComSignalType=BOOLEAN, ComSystemTemplateSystemSignalRef=DET_SUPER_RES_TARGET_087
            DET_SUPER_RES_TARGET_088_oRDR_DETECTION_085_088_oPCAN_RADAR_3edbd92f_Tx: ComBitPosition=423, ComBitSize=1, ComSignalInitValue=0, ComSignalType=BOOLEAN, ComSystemTemplateSystemSignalRef=DET_SUPER_RES_TARGET_088
        SG_Detections_089_092_oRDR_DETECTION_089_092_oPCAN_RADAR_e22704c4_Tx: ComSystemTemplateSignalGroupRef=SG_Detections_089_092
          83 x ComGroupSignal, all with ComSignalEndianness=LITTLE_ENDIAN, ComTransferProperty=PENDING:
            DET_AZIMUTH_089_oRDR_DETECTION_089_092_oPCAN_RADAR_97691818_Tx: ComBitPosition=88, ComBitSize=13, ComSignalInitValue=0, ComSignalType=UINT16, ComSystemTemplateSystemSignalRef=DET_AZIMUTH_089
            DET_AZIMUTH_090_oRDR_DETECTION_089_092_oPCAN_RADAR_f2496abc_Tx: ComBitPosition=200, ComBitSize=13, ComSignalInitValue=0, ComSignalType=UINT16, ComSystemTemplateSystemSignalRef=DET_AZIMUTH_090
            DET_AZIMUTH_091_oRDR_DETECTION_089_092_oPCAN_RADAR_6739be29_Tx: ComBitPosition=312, ComBitSize=13, ComSignalInitValue=0, ComSignalType=UINT16, ComSystemTemplateSystemSignalRef=DET_AZIMUTH_091
            DET_AZIMUTH_092_oRDR_DETECTION_089_092_oPCAN_RADAR_03d9c5d7_Tx: ComBitPosition=424, ComBitSize=13, ComSignalInitValue=0, ComSignalType=UINT16, ComSystemTemplateSystemSignalRef=DET_AZIMUTH_092
            DET_AZIMUTH_ERR_089_oRDR_DETECTION_089_092_oPCAN_RADAR_33dc8ded_Tx: ComBitPosition=105, ComBitSize=7, ComSignalInitValue=0, ComSignalType=UINT8, ComSystemTemplateSystemSignalRef=DET_AZIMUTH_ERR_089
            DET_AZIMUTH_ERR_090_oRDR_DETECTION_089_092_oPCAN_RADAR_56fcff49_Tx: ComBitPosition=217, ComBitSize=7, ComSignalInitValue=0, ComSignalType=UINT8, ComSystemTemplateSystemSignalRef=DET_AZIMUTH_ERR_090
            DET_AZIMUTH_ERR_091_oRDR_DETECTION_089_092_oPCAN_RADAR_c38c2bdc_Tx: ComBitPosition=329, ComBitSize=7, ComSignalInitValue=0, ComSignalType=UINT8, ComSystemTemplateSystemSignalRef=DET_AZIMUTH_ERR_091
            DET_AZIMUTH_ERR_092_oRDR_DETECTION_089_092_oPCAN_RADAR_a76c5022_Tx: ComBitPosition=441, ComBitSize=7, ComSignalInitValue=0, ComSignalType=UINT8, ComSystemTemplateSystemSignalRef=DET_AZIMUTH_ERR_092
            DET_BELOW_RAIN_THOLD_089_oRDR_DETECTION_089_092_oPCAN_RADAR_42688bd8_Tx: ComBitPosition=39, ComBitSize=1, ComSignalInitValue=0, ComSignalType=BOOLEAN, ComSystemTemplateSystemSignalRef=DET_BELOW_RAIN_THOLD_089
            DET_BELOW_RAIN_THOLD_090_oRDR_DETECTION_089_092_oPCAN_RADAR_2748f97c_Tx: ComBitPosition=151, ComBitSize=1, ComSignalInitValue=0, ComSignalType=BOOLEAN, ComSystemTemplateSystemSignalRef=DET_BELOW_RAIN_THOLD_090
            DET_BELOW_RAIN_THOLD_091_oRDR_DETECTION_089_092_oPCAN_RADAR_b2382de9_Tx: ComBitPosition=263, ComBitSize=1, ComSignalInitValue=0, ComSignalType=BOOLEAN, ComSystemTemplateSystemSignalRef=DET_BELOW_RAIN_THOLD_091
            DET_BELOW_RAIN_THOLD_092_oRDR_DETECTION_089_092_oPCAN_RADAR_d6d85617_Tx: ComBitPosition=375, ComBitSize=1, ComSignalInitValue=0, ComSignalType=BOOLEAN, ComSystemTemplateSystemSignalRef=DET_BELOW_RAIN_THOLD_092
            DET_BI_STATIC_FLAG_089_oRDR_DETECTION_089_092_oPCAN_RADAR_c145589d_Tx: ComBitPosition=104, ComBitSize=1, ComSignalInitValue=0, ComSignalType=BOOLEAN, ComSystemTemplateSystemSignalRef=DET_BI_STATIC_FLAG_089
            DET_BI_STATIC_FLAG_090_oRDR_DETECTION_089_092_oPCAN_RADAR_a4652a39_Tx: ComBitPosition=216, ComBitSize=1, ComSignalInitValue=0, ComSignalType=BOOLEAN, ComSystemTemplateSystemSignalRef=DET_BI_STATIC_FLAG_090
            DET_BI_STATIC_FLAG_091_oRDR_DETECTION_089_092_oPCAN_RADAR_3115feac_Tx: ComBitPosition=328, ComBitSize=1, ComSignalInitValue=0, ComSignalType=BOOLEAN, ComSystemTemplateSystemSignalRef=DET_BI_STATIC_FLAG_091
            DET_BI_STATIC_FLAG_092_oRDR_DETECTION_089_092_oPCAN_RADAR_55f58552_Tx: ComBitPosition=440, ComBitSize=1, ComSignalInitValue=0, ComSignalType=BOOLEAN, ComSystemTemplateSystemSignalRef=DET_BI_STATIC_FLAG_092
            DET_CONFD_AZIMUTH_089_oRDR_DETECTION_089_092_oPCAN_RADAR_958f12d2_Tx: ComBitPosition=118, ComBitSize=2, ComSignalInitValue=0, ComSignalType=UINT8, ComSystemTemplateSystemSignalRef=DET_CONFD_AZIMUTH_089
            DET_CONFD_AZIMUTH_090_oRDR_DETECTION_089_092_oPCAN_RADAR_f0af6076_Tx: ComBitPosition=230, ComBitSize=2, ComSignalInitValue=0, ComSignalType=UINT8, ComSystemTemplateSystemSignalRef=DET_CONFD_AZIMUTH_090
            DET_CONFD_AZIMUTH_091_oRDR_DETECTION_089_092_oPCAN_RADAR_65dfb4e3_Tx: ComBitPosition=342, ComBitSize=2, ComSignalInitValue=0, ComSignalType=UINT8, ComSystemTemplateSystemSignalRef=DET_CONFD_AZIMUTH_091
            DET_CONFD_AZIMUTH_092_oRDR_DETECTION_089_092_oPCAN_RADAR_013fcf1d_Tx: ComBitPosition=454, ComBitSize=2, ComSignalInitValue=0, ComSignalType=UINT8, ComSystemTemplateSystemSignalRef=DET_CONFD_AZIMUTH_092
            DET_CONFD_ELEVATION_089_oRDR_DETECTION_089_092_oPCAN_RADAR_971a1328_Tx: ComBitPosition=101, ComBitSize=2, ComSignalInitValue=0, ComSignalType=UINT8, ComSystemTemplateSystemSignalRef=DET_CONFD_ELEVATION_089
            DET_CONFD_ELEVATION_090_oRDR_DETECTION_089_092_oPCAN_RADAR_f23a618c_Tx: ComBitPosition=213, ComBitSize=2, ComSignalInitValue=0, ComSignalType=UINT8, ComSystemTemplateSystemSignalRef=DET_CONFD_ELEVATION_090
            DET_CONFD_ELEVATION_091_oRDR_DETECTION_089_092_oPCAN_RADAR_674ab519_Tx: ComBitPosition=325, ComBitSize=2, ComSignalInitValue=0, ComSignalType=UINT8, ComSystemTemplateSystemSignalRef=DET_CONFD_ELEVATION_091
            DET_CONFD_ELEVATION_092_oRDR_DETECTION_089_092_oPCAN_RADAR_03aacee7_Tx: ComBitPosition=437, ComBitSize=2, ComSignalInitValue=0, ComSignalType=UINT8, ComSystemTemplateSystemSignalRef=DET_CONFD_ELEVATION_092
            DET_ELEVATION_089_oRDR_DETECTION_089_092_oPCAN_RADAR_46dac714_Tx: ComBitPosition=72, ComBitSize=8, ComSignalInitValue=0, ComSignalType=UINT8, ComSystemTemplateSystemSignalRef=DET_ELEVATION_089
            DET_ELEVATION_090_oRDR_DETECTION_089_092_oPCAN_RADAR_23fab5b0_Tx: ComBitPosition=184, ComBitSize=8, ComSignalInitValue=0, ComSignalType=UINT8, ComSystemTemplateSystemSignalRef=DET_ELEVATION_090
            DET_ELEVATION_091_oRDR_DETECTION_089_092_oPCAN_RADAR_b68a6125_Tx: ComBitPosition=296, ComBitSize=8, ComSignalInitValue=0, ComSignalType=UINT8, ComSystemTemplateSystemSignalRef=DET_ELEVATION_091
            DET_ELEVATION_092_oRDR_DETECTION_089_092_oPCAN_RADAR_d26a1adb_Tx: ComBitPosition=408, ComBitSize=8, ComSignalInitValue=0, ComSignalType=UINT8, ComSystemTemplateSystemSignalRef=DET_ELEVATION_092
            DET_ELEVATION_ERR_089_oRDR_DETECTION_089_092_oPCAN_RADAR_c1e35f61_Tx: ComBitPosition=80, ComBitSize=6, ComSignalInitValue=0, ComSignalType=UINT8, ComSystemTemplateSystemSignalRef=DET_ELEVATION_ERR_089
            DET_ELEVATION_ERR_090_oRDR_DETECTION_089_092_oPCAN_RADAR_a4c32dc5_Tx: ComBitPosition=192, ComBitSize=6, ComSignalInitValue=0, ComSignalType=UINT8, ComSystemTemplateSystemSignalRef=DET_ELEVATION_ERR_090
            DET_ELEVATION_ERR_091_oRDR_DETECTION_089_092_oPCAN_RADAR_31b3f950_Tx: ComBitPosition=304, ComBitSize=6, ComSignalInitValue=0, ComSignalType=UINT8, ComSystemTemplateSystemSignalRef=DET_ELEVATION_ERR_091
            DET_ELEVATION_ERR_092_oRDR_DETECTION_089_092_oPCAN_RADAR_555382ae_Tx: ComBitPosition=416, ComBitSize=6, ComSignalInitValue=0, ComSignalType=UINT8, ComSystemTemplateSystemSignalRef=DET_ELEVATION_ERR_092
            DET_EXISTENCE_PROB_089_oRDR_DETECTION_089_092_oPCAN_RADAR_137c2a01_Tx: ComBitPosition=112, ComBitSize=6, ComSignalInitValue=0, ComSignalType=UINT8, ComSystemTemplateSystemSignalRef=DET_EXISTENCE_PROB_089
            DET_EXISTENCE_PROB_090_oRDR_DETECTION_089_092_oPCAN_RADAR_765c58a5_Tx: ComBitPosition=224, ComBitSize=6, ComSignalInitValue=0, ComSignalType=UINT8, ComSystemTemplateSystemSignalRef=DET_EXISTENCE_PROB_090
            DET_EXISTENCE_PROB_091_oRDR_DETECTION_089_092_oPCAN_RADAR_e32c8c30_Tx: ComBitPosition=336, ComBitSize=6, ComSignalInitValue=0, ComSignalType=UINT8, ComSystemTemplateSystemSignalRef=DET_EXISTENCE_PROB_091
            DET_EXISTENCE_PROB_092_oRDR_DETECTION_089_092_oPCAN_RADAR_87ccf7ce_Tx: ComBitPosition=448, ComBitSize=6, ComSignalInitValue=0, ComSignalType=UINT8, ComSystemTemplateSystemSignalRef=DET_EXISTENCE_PROB_092
            DET_HVC_FLAG_089_oRDR_DETECTION_089_092_oPCAN_RADAR_f208697e_Tx: ComBitPosition=86, ComBitSize=1, ComSignalInitValue=0, ComSignalType=BOOLEAN, ComSystemTemplateSystemSignalRef=DET_HVC_FLAG_089
            DET_HVC_FLAG_090_oRDR_DETECTION_089_092_oPCAN_RADAR_97281bda_Tx: ComBitPosition=198, ComBitSize=1, ComSignalInitValue=0, ComSignalType=BOOLEAN, ComSystemTemplateSystemSignalRef=DET_HVC_FLAG_090
            DET_HVC_FLAG_091_oRDR_DETECTION_089_092_oPCAN_RADAR_0258cf4f_Tx: ComBitPosition=310, ComBitSize=1, ComSignalInitValue=0, ComSignalType=BOOLEAN, ComSystemTemplateSystemSignalRef=DET_HVC_FLAG_091
            DET_HVC_FLAG_092_oRDR_DETECTION_089_092_oPCAN_RADAR_66b8b4b1_Tx: ComBitPosition=422, ComBitSize=1, ComSignalInitValue=0, ComSignalType=BOOLEAN, ComSystemTemplateSystemSignalRef=DET_HVC_FLAG_092
            DET_IDM_089_oRDR_DETECTION_089_092_oPCAN_RADAR_795a52c3_Tx: ComBitPosition=63, ComBitSize=1, ComSignalInitValue=0, ComSignalType=BOOLEAN, ComSystemTemplateSystemSignalRef=DET_IDM_089
            DET_IDM_090_oRDR_DETECTION_089_092_oPCAN_RADAR_1c7a2067_Tx: ComBitPosition=175, ComBitSize=1, ComSignalInitValue=0, ComSignalType=BOOLEAN, ComSystemTemplateSystemSignalRef=DET_IDM_090
            DET_IDM_091_oRDR_DETECTION_089_092_oPCAN_RADAR_890af4f2_Tx: ComBitPosition=287, ComBitSize=1, ComSignalInitValue=0, ComSignalType=BOOLEAN, ComSystemTemplateSystemSignalRef=DET_IDM_091
            DET_IDM_092_oRDR_DETECTION_089_092_oPCAN_RADAR_edea8f0c_Tx: ComBitPosition=399, ComBitSize=1, ComSignalInitValue=0, ComSignalType=BOOLEAN, ComSystemTemplateSystemSignalRef=DET_IDM_092
            DET_MH_CRC16_089_092_oRDR_DETECTION_089_092_oPCAN_RADAR_66afd6cf_Tx: ComBitPosition=0, ComBitSize=16, ComSignalInitValue=0, ComSignalType=UINT16, ComSystemTemplateSystemSignalRef=DET_MH_CRC16_089_092
            DET_MH_CYCLE_COUNTER_089_092_oRDR_DETECTION_089_092_oPCAN_RADAR_e2da77f8_Tx: ComBitPosition=16, ComBitSize=8, ComSignalInitValue=0, ComSignalType=UINT8, ComSystemTemplateSystemSignalRef=DET_MH_CYCLE_COUNTER_089_092
            DET_MH_SCAN_INDEX_4LSB_089_092_oRDR_DETECTION_089_092_oPCAN_RADAR_2ef05274_Tx: ComBitPosition=476, ComBitSize=4, ComSignalInitValue=0, ComSignalType=UINT8, ComSystemTemplateSystemSignalRef=DET_MH_SCAN_INDEX_4LSB_089_092
            DET_MTD_089_oRDR_DETECTION_089_092_oPCAN_RADAR_1fe96018_Tx: ComBitPosition=47, ComBitSize=1, ComSignalInitValue=0, ComSignalType=BOOLEAN, ComSystemTemplateSystemSignalRef=DET_MTD_089
            DET_MTD_090_oRDR_DETECTION_089_092_oPCAN_RADAR_7ac912bc_Tx: ComBitPosition=159, ComBitSize=1, ComSignalInitValue=0, ComSignalType=BOOLEAN, ComSystemTemplateSystemSignalRef=DET_MTD_090
            DET_MTD_091_oRDR_DETECTION_089_092_oPCAN_RADAR_efb9c629_Tx: ComBitPosition=271, ComBitSize=1, ComSignalInitValue=0, ComSignalType=BOOLEAN, ComSystemTemplateSystemSignalRef=DET_MTD_091
            DET_MTD_092_oRDR_DETECTION_089_092_oPCAN_RADAR_8b59bdd7_Tx: ComBitPosition=383, ComBitSize=1, ComSignalInitValue=0, ComSignalType=BOOLEAN, ComSystemTemplateSystemSignalRef=DET_MTD_092
            DET_PROB_1STAZHYPO_089_oRDR_DETECTION_089_092_oPCAN_RADAR_8c5d88d5_Tx: ComBitPosition=103, ComBitSize=1, ComSignalInitValue=0, ComSignalType=BOOLEAN, ComSystemTemplateSystemSignalRef=DET_PROB_1STAZHYPO_089
            DET_PROB_1STAZHYPO_090_oRDR_DETECTION_089_092_oPCAN_RADAR_e97dfa71_Tx: ComBitPosition=215, ComBitSize=1, ComSignalInitValue=0, ComSignalType=BOOLEAN, ComSystemTemplateSystemSignalRef=DET_PROB_1STAZHYPO_090
            DET_PROB_1STAZHYPO_091_oRDR_DETECTION_089_092_oPCAN_RADAR_7c0d2ee4_Tx: ComBitPosition=327, ComBitSize=1, ComSignalInitValue=0, ComSignalType=BOOLEAN, ComSystemTemplateSystemSignalRef=DET_PROB_1STAZHYPO_091
            DET_PROB_1STAZHYPO_092_oRDR_DETECTION_089_092_oPCAN_RADAR_18ed551a_Tx: ComBitPosition=439, ComBitSize=1, ComSignalInitValue=0, ComSignalType=BOOLEAN, ComSystemTemplateSystemSignalRef=DET_PROB_1STAZHYPO_092
            DET_RANGE_089_oRDR_DETECTION_089_092_oPCAN_RADAR_87f26ba3_Tx: ComBitPosition=24, ComBitSize=15, ComSignalInitValue=0, ComSignalType=UINT16, ComSystemTemplateSystemSignalRef=DET_RANGE_089
            DET_RANGE_090_oRDR_DETECTION_089_092_oPCAN_RADAR_e2d21907_Tx: ComBitPosition=136, ComBitSize=15, ComSignalInitValue=0, ComSignalType=UINT16, ComSystemTemplateSystemSignalRef=DET_RANGE_090
            DET_RANGE_091_oRDR_DETECTION_089_092_oPCAN_RADAR_77a2cd92_Tx: ComBitPosition=248, ComBitSize=15, ComSignalInitValue=0, ComSignalType=UINT16, ComSystemTemplateSystemSignalRef=DET_RANGE_091
            DET_RANGE_092_oRDR_DETECTION_089_092_oPCAN_RADAR_1342b66c_Tx: ComBitPosition=360, ComBitSize=15, ComSignalInitValue=0, ComSignalType=UINT16, ComSystemTemplateSystemSignalRef=DET_RANGE_092
            DET_RANGE_ERR_089_oRDR_DETECTION_089_092_oPCAN_RADAR_201ad1ca_Tx: ComBitPosition=40, ComBitSize=7, ComSignalInitValue=0, ComSignalType=UINT8, ComSystemTemplateSystemSignalRef=DET_RANGE_ERR_089
            DET_RANGE_ERR_090_oRDR_DETECTION_089_092_oPCAN_RADAR_453aa36e_Tx: ComBitPosition=152, ComBitSize=7, ComSignalInitValue=0, ComSignalType=UINT8, ComSystemTemplateSystemSignalRef=DET_RANGE_ERR_090
            DET_RANGE_ERR_091_oRDR_DETECTION_089_092_oPCAN_RADAR_d04a77fb_Tx: ComBitPosition=264, ComBitSize=7, ComSignalInitValue=0, ComSignalType=UINT8, ComSystemTemplateSystemSignalRef=DET_RANGE_ERR_091
            DET_RANGE_ERR_092_oRDR_DETECTION_089_092_oPCAN_RADAR_b4aa0c05_Tx: ComBitPosition=376, ComBitSize=7, ComSignalInitValue=0, ComSignalType=UINT8, ComSystemTemplateSystemSignalRef=DET_RANGE_ERR_092
            DET_RANGE_VELOCITY_089_oRDR_DETECTION_089_092_oPCAN_RADAR_f254a986_Tx: ComBitPosition=48, ComBitSize=15, ComSignalInitValue=16384, ComSignalType=UINT16, ComSystemTemplateSystemSignalRef=DET_RANGE_VELOCITY_089
            DET_RANGE_VELOCITY_090_oRDR_DETECTION_089_092_oPCAN_RADAR_9774db22_Tx: ComBitPosition=160, ComBitSize=15, ComSignalInitValue=16384, ComSignalType=UINT16, ComSystemTemplateSystemSignalRef=DET_RANGE_VELOCITY_090
            DET_RANGE_VELOCITY_091_oRDR_DETECTION_089_092_oPCAN_RADAR_02040fb7_Tx: ComBitPosition=272, ComBitSize=15, ComSignalInitValue=16384, ComSignalType=UINT16, ComSystemTemplateSystemSignalRef=DET_RANGE_VELOCITY_091
            DET_RANGE_VELOCITY_092_oRDR_DETECTION_089_092_oPCAN_RADAR_66e47449_Tx: ComBitPosition=384, ComBitSize=15, ComSignalInitValue=16384, ComSignalType=UINT16, ComSystemTemplateSystemSignalRef=DET_RANGE_VELOCITY_092
            DET_RANGE_VELOCITY_ERR_089_oRDR_DETECTION_089_092_oPCAN_RADAR_fdef5234_Tx: ComBitPosition=64, ComBitSize=8, ComSignalInitValue=0, ComSignalType=UINT8, ComSystemTemplateSystemSignalRef=DET_RANGE_VELOCITY_ERR_089
            DET_RANGE_VELOCITY_ERR_090_oRDR_DETECTION_089_092_oPCAN_RADAR_98cf2090_Tx: ComBitPosition=176, ComBitSize=8, ComSignalInitValue=0, ComSignalType=UINT8, ComSystemTemplateSystemSignalRef=DET_RANGE_VELOCITY_ERR_090
            DET_RANGE_VELOCITY_ERR_091_oRDR_DETECTION_089_092_oPCAN_RADAR_0dbff405_Tx: ComBitPosition=288, ComBitSize=8, ComSignalInitValue=0, ComSignalType=UINT8, ComSystemTemplateSystemSignalRef=DET_RANGE_VELOCITY_ERR_091
            DET_RANGE_VELOCITY_ERR_092_oRDR_DETECTION_089_092_oPCAN_RADAR_695f8ffb_Tx: ComBitPosition=400, ComBitSize=8, ComSignalInitValue=0, ComSignalType=UINT8, ComSystemTemplateSystemSignalRef=DET_RANGE_VELOCITY_ERR_092
            DET_RCS_089_oRDR_DETECTION_089_092_oPCAN_RADAR_75d49edc_Tx: ComBitPosition=128, ComBitSize=8, ComSignalInitValue=128, ComSignalType=UINT8, ComSystemTemplateSystemSignalRef=DET_RCS_089
            DET_RCS_090_oRDR_DETECTION_089_092_oPCAN_RADAR_10f4ec78_Tx: ComBitPosition=240, ComBitSize=8, ComSignalInitValue=128, ComSignalType=UINT8, ComSystemTemplateSystemSignalRef=DET_RCS_090
            DET_RCS_091_oRDR_DETECTION_089_092_oPCAN_RADAR_858438ed_Tx: ComBitPosition=352, ComBitSize=8, ComSignalInitValue=128, ComSignalType=UINT8, ComSystemTemplateSystemSignalRef=DET_RCS_091
            DET_RCS_092_oRDR_DETECTION_089_092_oPCAN_RADAR_e1644313_Tx: ComBitPosition=464, ComBitSize=8, ComSignalInitValue=128, ComSignalType=UINT8, ComSystemTemplateSystemSignalRef=DET_RCS_092
            DET_SNR_089_oRDR_DETECTION_089_092_oPCAN_RADAR_a87acade_Tx: ComBitPosition=120, ComBitSize=8, ComSignalInitValue=0, ComSignalType=UINT8, ComSystemTemplateSystemSignalRef=DET_SNR_089
            DET_SNR_090_oRDR_DETECTION_089_092_oPCAN_RADAR_cd5ab87a_Tx: ComBitPosition=232, ComBitSize=8, ComSignalInitValue=0, ComSignalType=UINT8, ComSystemTemplateSystemSignalRef=DET_SNR_090
            DET_SNR_091_oRDR_DETECTION_089_092_oPCAN_RADAR_582a6cef_Tx: ComBitPosition=344, ComBitSize=8, ComSignalInitValue=0, ComSignalType=UINT8, ComSystemTemplateSystemSignalRef=DET_SNR_091
            DET_SNR_092_oRDR_DETECTION_089_092_oPCAN_RADAR_3cca1711_Tx: ComBitPosition=456, ComBitSize=8, ComSignalInitValue=0, ComSignalType=UINT8, ComSystemTemplateSystemSignalRef=DET_SNR_092
            DET_SUPER_RES_TARGET_089_oRDR_DETECTION_089_092_oPCAN_RADAR_99e3e2bb_Tx: ComBitPosition=87, ComBitSize=1, ComSignalInitValue=0, ComSignalType=BOOLEAN, ComSystemTemplateSystemSignalRef=DET_SUPER_RES_TARGET_089
            DET_SUPER_RES_TARGET_090_oRDR_DETECTION_089_092_oPCAN_RADAR_fcc3901f_Tx: ComBitPosition=199, ComBitSize=1, ComSignalInitValue=0, ComSignalType=BOOLEAN, ComSystemTemplateSystemSignalRef=DET_SUPER_RES_TARGET_090
            DET_SUPER_RES_TARGET_091_oRDR_DETECTION_089_092_oPCAN_RADAR_69b3448a_Tx: ComBitPosition=311, ComBitSize=1, ComSignalInitValue=0, ComSignalType=BOOLEAN, ComSystemTemplateSystemSignalRef=DET_SUPER_RES_TARGET_091
            DET_SUPER_RES_TARGET_092_oRDR_DETECTION_089_092_oPCAN_RADAR_0d533f74_Tx: ComBitPosition=423, ComBitSize=1, ComSignalInitValue=0, ComSignalType=BOOLEAN, ComSystemTemplateSystemSignalRef=DET_SUPER_RES_TARGET_092
        SG_Detections_093_096_oRDR_DETECTION_093_096_oPCAN_RADAR_d02c6cec_Tx: ComSystemTemplateSignalGroupRef=SG_Detections_093_096
          83 x ComGroupSignal, all with ComSignalEndianness=LITTLE_ENDIAN, ComTransferProperty=PENDING:
            DET_AZIMUTH_093_oRDR_DETECTION_093_096_oPCAN_RADAR_8b6e126c_Tx: ComBitPosition=88, ComBitSize=13, ComSignalInitValue=0, ComSignalType=UINT16, ComSystemTemplateSystemSignalRef=DET_AZIMUTH_093
            DET_AZIMUTH_094_oRDR_DETECTION_093_096_oPCAN_RADAR_d7de3105_Tx: ComBitPosition=200, ComBitSize=13, ComSignalInitValue=0, ComSignalType=UINT16, ComSystemTemplateSystemSignalRef=DET_AZIMUTH_094
            DET_AZIMUTH_095_oRDR_DETECTION_093_096_oPCAN_RADAR_42aee590_Tx: ComBitPosition=312, ComBitSize=13, ComSignalInitValue=0, ComSignalType=UINT16, ComSystemTemplateSystemSignalRef=DET_AZIMUTH_095
            DET_AZIMUTH_096_oRDR_DETECTION_093_096_oPCAN_RADAR_264e9e6e_Tx: ComBitPosition=424, ComBitSize=13, ComSignalInitValue=0, ComSignalType=UINT16, ComSystemTemplateSystemSignalRef=DET_AZIMUTH_096
            DET_AZIMUTH_ERR_093_oRDR_DETECTION_093_096_oPCAN_RADAR_2fdb8799_Tx: ComBitPosition=105, ComBitSize=7, ComSignalInitValue=0, ComSignalType=UINT8, ComSystemTemplateSystemSignalRef=DET_AZIMUTH_ERR_093
            DET_AZIMUTH_ERR_094_oRDR_DETECTION_093_096_oPCAN_RADAR_736ba4f0_Tx: ComBitPosition=217, ComBitSize=7, ComSignalInitValue=0, ComSignalType=UINT8, ComSystemTemplateSystemSignalRef=DET_AZIMUTH_ERR_094
            DET_AZIMUTH_ERR_095_oRDR_DETECTION_093_096_oPCAN_RADAR_e61b7065_Tx: ComBitPosition=329, ComBitSize=7, ComSignalInitValue=0, ComSignalType=UINT8, ComSystemTemplateSystemSignalRef=DET_AZIMUTH_ERR_095
            DET_AZIMUTH_ERR_096_oRDR_DETECTION_093_096_oPCAN_RADAR_82fb0b9b_Tx: ComBitPosition=441, ComBitSize=7, ComSignalInitValue=0, ComSignalType=UINT8, ComSystemTemplateSystemSignalRef=DET_AZIMUTH_ERR_096
            DET_BELOW_RAIN_THOLD_093_oRDR_DETECTION_093_096_oPCAN_RADAR_5e6f81ac_Tx: ComBitPosition=39, ComBitSize=1, ComSignalInitValue=0, ComSignalType=BOOLEAN, ComSystemTemplateSystemSignalRef=DET_BELOW_RAIN_THOLD_093
            DET_BELOW_RAIN_THOLD_094_oRDR_DETECTION_093_096_oPCAN_RADAR_02dfa2c5_Tx: ComBitPosition=151, ComBitSize=1, ComSignalInitValue=0, ComSignalType=BOOLEAN, ComSystemTemplateSystemSignalRef=DET_BELOW_RAIN_THOLD_094
            DET_BELOW_RAIN_THOLD_095_oRDR_DETECTION_093_096_oPCAN_RADAR_97af7650_Tx: ComBitPosition=263, ComBitSize=1, ComSignalInitValue=0, ComSignalType=BOOLEAN, ComSystemTemplateSystemSignalRef=DET_BELOW_RAIN_THOLD_095
            DET_BELOW_RAIN_THOLD_096_oRDR_DETECTION_093_096_oPCAN_RADAR_f34f0dae_Tx: ComBitPosition=375, ComBitSize=1, ComSignalInitValue=0, ComSignalType=BOOLEAN, ComSystemTemplateSystemSignalRef=DET_BELOW_RAIN_THOLD_096
            DET_BI_STATIC_FLAG_093_oRDR_DETECTION_093_096_oPCAN_RADAR_dd4252e9_Tx: ComBitPosition=104, ComBitSize=1, ComSignalInitValue=0, ComSignalType=BOOLEAN, ComSystemTemplateSystemSignalRef=DET_BI_STATIC_FLAG_093
            DET_BI_STATIC_FLAG_094_oRDR_DETECTION_093_096_oPCAN_RADAR_81f27180_Tx: ComBitPosition=216, ComBitSize=1, ComSignalInitValue=0, ComSignalType=BOOLEAN, ComSystemTemplateSystemSignalRef=DET_BI_STATIC_FLAG_094
            DET_BI_STATIC_FLAG_095_oRDR_DETECTION_093_096_oPCAN_RADAR_1482a515_Tx: ComBitPosition=328, ComBitSize=1, ComSignalInitValue=0, ComSignalType=BOOLEAN, ComSystemTemplateSystemSignalRef=DET_BI_STATIC_FLAG_095
            DET_BI_STATIC_FLAG_096_oRDR_DETECTION_093_096_oPCAN_RADAR_7062deeb_Tx: ComBitPosition=440, ComBitSize=1, ComSignalInitValue=0, ComSignalType=BOOLEAN, ComSystemTemplateSystemSignalRef=DET_BI_STATIC_FLAG_096
            DET_CONFD_AZIMUTH_093_oRDR_DETECTION_093_096_oPCAN_RADAR_898818a6_Tx: ComBitPosition=118, ComBitSize=2, ComSignalInitValue=0, ComSignalType=UINT8, ComSystemTemplateSystemSignalRef=DET_CONFD_AZIMUTH_093
            DET_CONFD_AZIMUTH_094_oRDR_DETECTION_093_096_oPCAN_RADAR_d5383bcf_Tx: ComBitPosition=230, ComBitSize=2, ComSignalInitValue=0, ComSignalType=UINT8, ComSystemTemplateSystemSignalRef=DET_CONFD_AZIMUTH_094
            DET_CONFD_AZIMUTH_095_oRDR_DETECTION_093_096_oPCAN_RADAR_4048ef5a_Tx: ComBitPosition=342, ComBitSize=2, ComSignalInitValue=0, ComSignalType=UINT8, ComSystemTemplateSystemSignalRef=DET_CONFD_AZIMUTH_095
            DET_CONFD_AZIMUTH_096_oRDR_DETECTION_093_096_oPCAN_RADAR_24a894a4_Tx: ComBitPosition=454, ComBitSize=2, ComSignalInitValue=0, ComSignalType=UINT8, ComSystemTemplateSystemSignalRef=DET_CONFD_AZIMUTH_096
            DET_CONFD_ELEVATION_093_oRDR_DETECTION_093_096_oPCAN_RADAR_8b1d195c_Tx: ComBitPosition=101, ComBitSize=2, ComSignalInitValue=0, ComSignalType=UINT8, ComSystemTemplateSystemSignalRef=DET_CONFD_ELEVATION_093
            DET_CONFD_ELEVATION_094_oRDR_DETECTION_093_096_oPCAN_RADAR_d7ad3a35_Tx: ComBitPosition=213, ComBitSize=2, ComSignalInitValue=0, ComSignalType=UINT8, ComSystemTemplateSystemSignalRef=DET_CONFD_ELEVATION_094
            DET_CONFD_ELEVATION_095_oRDR_DETECTION_093_096_oPCAN_RADAR_42ddeea0_Tx: ComBitPosition=325, ComBitSize=2, ComSignalInitValue=0, ComSignalType=UINT8, ComSystemTemplateSystemSignalRef=DET_CONFD_ELEVATION_095
            DET_CONFD_ELEVATION_096_oRDR_DETECTION_093_096_oPCAN_RADAR_263d955e_Tx: ComBitPosition=437, ComBitSize=2, ComSignalInitValue=0, ComSignalType=UINT8, ComSystemTemplateSystemSignalRef=DET_CONFD_ELEVATION_096
            DET_ELEVATION_093_oRDR_DETECTION_093_096_oPCAN_RADAR_5addcd60_Tx: ComBitPosition=72, ComBitSize=8, ComSignalInitValue=0, ComSignalType=UINT8, ComSystemTemplateSystemSignalRef=DET_ELEVATION_093
            DET_ELEVATION_094_oRDR_DETECTION_093_096_oPCAN_RADAR_066dee09_Tx: ComBitPosition=184, ComBitSize=8, ComSignalInitValue=0, ComSignalType=UINT8, ComSystemTemplateSystemSignalRef=DET_ELEVATION_094
            DET_ELEVATION_095_oRDR_DETECTION_093_096_oPCAN_RADAR_931d3a9c_Tx: ComBitPosition=296, ComBitSize=8, ComSignalInitValue=0, ComSignalType=UINT8, ComSystemTemplateSystemSignalRef=DET_ELEVATION_095
            DET_ELEVATION_096_oRDR_DETECTION_093_096_oPCAN_RADAR_f7fd4162_Tx: ComBitPosition=408, ComBitSize=8, ComSignalInitValue=0, ComSignalType=UINT8, ComSystemTemplateSystemSignalRef=DET_ELEVATION_096
            DET_ELEVATION_ERR_093_oRDR_DETECTION_093_096_oPCAN_RADAR_dde45515_Tx: ComBitPosition=80, ComBitSize=6, ComSignalInitValue=0, ComSignalType=UINT8, ComSystemTemplateSystemSignalRef=DET_ELEVATION_ERR_093
            DET_ELEVATION_ERR_094_oRDR_DETECTION_093_096_oPCAN_RADAR_8154767c_Tx: ComBitPosition=192, ComBitSize=6, ComSignalInitValue=0, ComSignalType=UINT8, ComSystemTemplateSystemSignalRef=DET_ELEVATION_ERR_094
            DET_ELEVATION_ERR_095_oRDR_DETECTION_093_096_oPCAN_RADAR_1424a2e9_Tx: ComBitPosition=304, ComBitSize=6, ComSignalInitValue=0, ComSignalType=UINT8, ComSystemTemplateSystemSignalRef=DET_ELEVATION_ERR_095
            DET_ELEVATION_ERR_096_oRDR_DETECTION_093_096_oPCAN_RADAR_70c4d917_Tx: ComBitPosition=416, ComBitSize=6, ComSignalInitValue=0, ComSignalType=UINT8, ComSystemTemplateSystemSignalRef=DET_ELEVATION_ERR_096
            DET_EXISTENCE_PROB_093_oRDR_DETECTION_093_096_oPCAN_RADAR_0f7b2075_Tx: ComBitPosition=112, ComBitSize=6, ComSignalInitValue=0, ComSignalType=UINT8, ComSystemTemplateSystemSignalRef=DET_EXISTENCE_PROB_093
            DET_EXISTENCE_PROB_094_oRDR_DETECTION_093_096_oPCAN_RADAR_53cb031c_Tx: ComBitPosition=224, ComBitSize=6, ComSignalInitValue=0, ComSignalType=UINT8, ComSystemTemplateSystemSignalRef=DET_EXISTENCE_PROB_094
            DET_EXISTENCE_PROB_095_oRDR_DETECTION_093_096_oPCAN_RADAR_c6bbd789_Tx: ComBitPosition=336, ComBitSize=6, ComSignalInitValue=0, ComSignalType=UINT8, ComSystemTemplateSystemSignalRef=DET_EXISTENCE_PROB_095
            DET_EXISTENCE_PROB_096_oRDR_DETECTION_093_096_oPCAN_RADAR_a25bac77_Tx: ComBitPosition=448, ComBitSize=6, ComSignalInitValue=0, ComSignalType=UINT8, ComSystemTemplateSystemSignalRef=DET_EXISTENCE_PROB_096
            DET_HVC_FLAG_093_oRDR_DETECTION_093_096_oPCAN_RADAR_ee0f630a_Tx: ComBitPosition=86, ComBitSize=1, ComSignalInitValue=0, ComSignalType=BOOLEAN, ComSystemTemplateSystemSignalRef=DET_HVC_FLAG_093
            DET_HVC_FLAG_094_oRDR_DETECTION_093_096_oPCAN_RADAR_b2bf4063_Tx: ComBitPosition=198, ComBitSize=1, ComSignalInitValue=0, ComSignalType=BOOLEAN, ComSystemTemplateSystemSignalRef=DET_HVC_FLAG_094
            DET_HVC_FLAG_095_oRDR_DETECTION_093_096_oPCAN_RADAR_27cf94f6_Tx: ComBitPosition=310, ComBitSize=1, ComSignalInitValue=0, ComSignalType=BOOLEAN, ComSystemTemplateSystemSignalRef=DET_HVC_FLAG_095
            DET_HVC_FLAG_096_oRDR_DETECTION_093_096_oPCAN_RADAR_432fef08_Tx: ComBitPosition=422, ComBitSize=1, ComSignalInitValue=0, ComSignalType=BOOLEAN, ComSystemTemplateSystemSignalRef=DET_HVC_FLAG_096
            DET_IDM_093_oRDR_DETECTION_093_096_oPCAN_RADAR_655d58b7_Tx: ComBitPosition=63, ComBitSize=1, ComSignalInitValue=0, ComSignalType=BOOLEAN, ComSystemTemplateSystemSignalRef=DET_IDM_093
            DET_IDM_094_oRDR_DETECTION_093_096_oPCAN_RADAR_39ed7bde_Tx: ComBitPosition=175, ComBitSize=1, ComSignalInitValue=0, ComSignalType=BOOLEAN, ComSystemTemplateSystemSignalRef=DET_IDM_094
            DET_IDM_095_oRDR_DETECTION_093_096_oPCAN_RADAR_ac9daf4b_Tx: ComBitPosition=287, ComBitSize=1, ComSignalInitValue=0, ComSignalType=BOOLEAN, ComSystemTemplateSystemSignalRef=DET_IDM_095
            DET_IDM_096_oRDR_DETECTION_093_096_oPCAN_RADAR_c87dd4b5_Tx: ComBitPosition=399, ComBitSize=1, ComSignalInitValue=0, ComSignalType=BOOLEAN, ComSystemTemplateSystemSignalRef=DET_IDM_096
            DET_MH_CRC16_093_096_oRDR_DETECTION_093_096_oPCAN_RADAR_54a4bee7_Tx: ComBitPosition=0, ComBitSize=16, ComSignalInitValue=0, ComSignalType=UINT16, ComSystemTemplateSystemSignalRef=DET_MH_CRC16_093_096
            DET_MH_CYCLE_COUNTER_093_096_oRDR_DETECTION_093_096_oPCAN_RADAR_d0d11fd0_Tx: ComBitPosition=16, ComBitSize=8, ComSignalInitValue=0, ComSignalType=UINT8, ComSystemTemplateSystemSignalRef=DET_MH_CYCLE_COUNTER_093_096
            DET_MH_SCAN_INDEX_4LSB_093_096_oRDR_DETECTION_093_096_oPCAN_RADAR_1cfb3a5c_Tx: ComBitPosition=476, ComBitSize=4, ComSignalInitValue=0, ComSignalType=UINT8, ComSystemTemplateSystemSignalRef=DET_MH_SCAN_INDEX_4LSB_093_096
            DET_MTD_093_oRDR_DETECTION_093_096_oPCAN_RADAR_03ee6a6c_Tx: ComBitPosition=47, ComBitSize=1, ComSignalInitValue=0, ComSignalType=BOOLEAN, ComSystemTemplateSystemSignalRef=DET_MTD_093
            DET_MTD_094_oRDR_DETECTION_093_096_oPCAN_RADAR_5f5e4905_Tx: ComBitPosition=159, ComBitSize=1, ComSignalInitValue=0, ComSignalType=BOOLEAN, ComSystemTemplateSystemSignalRef=DET_MTD_094
            DET_MTD_095_oRDR_DETECTION_093_096_oPCAN_RADAR_ca2e9d90_Tx: ComBitPosition=271, ComBitSize=1, ComSignalInitValue=0, ComSignalType=BOOLEAN, ComSystemTemplateSystemSignalRef=DET_MTD_095
            DET_MTD_096_oRDR_DETECTION_093_096_oPCAN_RADAR_aecee66e_Tx: ComBitPosition=383, ComBitSize=1, ComSignalInitValue=0, ComSignalType=BOOLEAN, ComSystemTemplateSystemSignalRef=DET_MTD_096
            DET_PROB_1STAZHYPO_093_oRDR_DETECTION_093_096_oPCAN_RADAR_905a82a1_Tx: ComBitPosition=103, ComBitSize=1, ComSignalInitValue=0, ComSignalType=BOOLEAN, ComSystemTemplateSystemSignalRef=DET_PROB_1STAZHYPO_093
            DET_PROB_1STAZHYPO_094_oRDR_DETECTION_093_096_oPCAN_RADAR_cceaa1c8_Tx: ComBitPosition=215, ComBitSize=1, ComSignalInitValue=0, ComSignalType=BOOLEAN, ComSystemTemplateSystemSignalRef=DET_PROB_1STAZHYPO_094
            DET_PROB_1STAZHYPO_095_oRDR_DETECTION_093_096_oPCAN_RADAR_599a755d_Tx: ComBitPosition=327, ComBitSize=1, ComSignalInitValue=0, ComSignalType=BOOLEAN, ComSystemTemplateSystemSignalRef=DET_PROB_1STAZHYPO_095
            DET_PROB_1STAZHYPO_096_oRDR_DETECTION_093_096_oPCAN_RADAR_3d7a0ea3_Tx: ComBitPosition=439, ComBitSize=1, ComSignalInitValue=0, ComSignalType=BOOLEAN, ComSystemTemplateSystemSignalRef=DET_PROB_1STAZHYPO_096
            DET_RANGE_093_oRDR_DETECTION_093_096_oPCAN_RADAR_9bf561d7_Tx: ComBitPosition=24, ComBitSize=15, ComSignalInitValue=0, ComSignalType=UINT16, ComSystemTemplateSystemSignalRef=DET_RANGE_093
            DET_RANGE_094_oRDR_DETECTION_093_096_oPCAN_RADAR_c74542be_Tx: ComBitPosition=136, ComBitSize=15, ComSignalInitValue=0, ComSignalType=UINT16, ComSystemTemplateSystemSignalRef=DET_RANGE_094
            DET_RANGE_095_oRDR_DETECTION_093_096_oPCAN_RADAR_5235962b_Tx: ComBitPosition=248, ComBitSize=15, ComSignalInitValue=0, ComSignalType=UINT16, ComSystemTemplateSystemSignalRef=DET_RANGE_095
            DET_RANGE_096_oRDR_DETECTION_093_096_oPCAN_RADAR_36d5edd5_Tx: ComBitPosition=360, ComBitSize=15, ComSignalInitValue=0, ComSignalType=UINT16, ComSystemTemplateSystemSignalRef=DET_RANGE_096
            DET_RANGE_ERR_093_oRDR_DETECTION_093_096_oPCAN_RADAR_3c1ddbbe_Tx: ComBitPosition=40, ComBitSize=7, ComSignalInitValue=0, ComSignalType=UINT8, ComSystemTemplateSystemSignalRef=DET_RANGE_ERR_093
            DET_RANGE_ERR_094_oRDR_DETECTION_093_096_oPCAN_RADAR_60adf8d7_Tx: ComBitPosition=152, ComBitSize=7, ComSignalInitValue=0, ComSignalType=UINT8, ComSystemTemplateSystemSignalRef=DET_RANGE_ERR_094
            DET_RANGE_ERR_095_oRDR_DETECTION_093_096_oPCAN_RADAR_f5dd2c42_Tx: ComBitPosition=264, ComBitSize=7, ComSignalInitValue=0, ComSignalType=UINT8, ComSystemTemplateSystemSignalRef=DET_RANGE_ERR_095
            DET_RANGE_ERR_096_oRDR_DETECTION_093_096_oPCAN_RADAR_913d57bc_Tx: ComBitPosition=376, ComBitSize=7, ComSignalInitValue=0, ComSignalType=UINT8, ComSystemTemplateSystemSignalRef=DET_RANGE_ERR_096
            DET_RANGE_VELOCITY_093_oRDR_DETECTION_093_096_oPCAN_RADAR_ee53a3f2_Tx: ComBitPosition=48, ComBitSize=15, ComSignalInitValue=16384, ComSignalType=UINT16, ComSystemTemplateSystemSignalRef=DET_RANGE_VELOCITY_093
            DET_RANGE_VELOCITY_094_oRDR_DETECTION_093_096_oPCAN_RADAR_b2e3809b_Tx: ComBitPosition=160, ComBitSize=15, ComSignalInitValue=16384, ComSignalType=UINT16, ComSystemTemplateSystemSignalRef=DET_RANGE_VELOCITY_094
            DET_RANGE_VELOCITY_095_oRDR_DETECTION_093_096_oPCAN_RADAR_2793540e_Tx: ComBitPosition=272, ComBitSize=15, ComSignalInitValue=16384, ComSignalType=UINT16, ComSystemTemplateSystemSignalRef=DET_RANGE_VELOCITY_095
            DET_RANGE_VELOCITY_096_oRDR_DETECTION_093_096_oPCAN_RADAR_43732ff0_Tx: ComBitPosition=384, ComBitSize=15, ComSignalInitValue=16384, ComSignalType=UINT16, ComSystemTemplateSystemSignalRef=DET_RANGE_VELOCITY_096
            DET_RANGE_VELOCITY_ERR_093_oRDR_DETECTION_093_096_oPCAN_RADAR_e1e85840_Tx: ComBitPosition=64, ComBitSize=8, ComSignalInitValue=0, ComSignalType=UINT8, ComSystemTemplateSystemSignalRef=DET_RANGE_VELOCITY_ERR_093
            DET_RANGE_VELOCITY_ERR_094_oRDR_DETECTION_093_096_oPCAN_RADAR_bd587b29_Tx: ComBitPosition=176, ComBitSize=8, ComSignalInitValue=0, ComSignalType=UINT8, ComSystemTemplateSystemSignalRef=DET_RANGE_VELOCITY_ERR_094
            DET_RANGE_VELOCITY_ERR_095_oRDR_DETECTION_093_096_oPCAN_RADAR_2828afbc_Tx: ComBitPosition=288, ComBitSize=8, ComSignalInitValue=0, ComSignalType=UINT8, ComSystemTemplateSystemSignalRef=DET_RANGE_VELOCITY_ERR_095
            DET_RANGE_VELOCITY_ERR_096_oRDR_DETECTION_093_096_oPCAN_RADAR_4cc8d442_Tx: ComBitPosition=400, ComBitSize=8, ComSignalInitValue=0, ComSignalType=UINT8, ComSystemTemplateSystemSignalRef=DET_RANGE_VELOCITY_ERR_096
            DET_RCS_093_oRDR_DETECTION_093_096_oPCAN_RADAR_69d394a8_Tx: ComBitPosition=128, ComBitSize=8, ComSignalInitValue=128, ComSignalType=UINT8, ComSystemTemplateSystemSignalRef=DET_RCS_093
            DET_RCS_094_oRDR_DETECTION_093_096_oPCAN_RADAR_3563b7c1_Tx: ComBitPosition=240, ComBitSize=8, ComSignalInitValue=128, ComSignalType=UINT8, ComSystemTemplateSystemSignalRef=DET_RCS_094
            DET_RCS_095_oRDR_DETECTION_093_096_oPCAN_RADAR_a0136354_Tx: ComBitPosition=352, ComBitSize=8, ComSignalInitValue=128, ComSignalType=UINT8, ComSystemTemplateSystemSignalRef=DET_RCS_095
            DET_RCS_096_oRDR_DETECTION_093_096_oPCAN_RADAR_c4f318aa_Tx: ComBitPosition=464, ComBitSize=8, ComSignalInitValue=128, ComSignalType=UINT8, ComSystemTemplateSystemSignalRef=DET_RCS_096
            DET_SNR_093_oRDR_DETECTION_093_096_oPCAN_RADAR_b47dc0aa_Tx: ComBitPosition=120, ComBitSize=8, ComSignalInitValue=0, ComSignalType=UINT8, ComSystemTemplateSystemSignalRef=DET_SNR_093
            DET_SNR_094_oRDR_DETECTION_093_096_oPCAN_RADAR_e8cde3c3_Tx: ComBitPosition=232, ComBitSize=8, ComSignalInitValue=0, ComSignalType=UINT8, ComSystemTemplateSystemSignalRef=DET_SNR_094
            DET_SNR_095_oRDR_DETECTION_093_096_oPCAN_RADAR_7dbd3756_Tx: ComBitPosition=344, ComBitSize=8, ComSignalInitValue=0, ComSignalType=UINT8, ComSystemTemplateSystemSignalRef=DET_SNR_095
            DET_SNR_096_oRDR_DETECTION_093_096_oPCAN_RADAR_195d4ca8_Tx: ComBitPosition=456, ComBitSize=8, ComSignalInitValue=0, ComSignalType=UINT8, ComSystemTemplateSystemSignalRef=DET_SNR_096
            DET_SUPER_RES_TARGET_093_oRDR_DETECTION_093_096_oPCAN_RADAR_85e4e8cf_Tx: ComBitPosition=87, ComBitSize=1, ComSignalInitValue=0, ComSignalType=BOOLEAN, ComSystemTemplateSystemSignalRef=DET_SUPER_RES_TARGET_093
            DET_SUPER_RES_TARGET_094_oRDR_DETECTION_093_096_oPCAN_RADAR_d954cba6_Tx: ComBitPosition=199, ComBitSize=1, ComSignalInitValue=0, ComSignalType=BOOLEAN, ComSystemTemplateSystemSignalRef=DET_SUPER_RES_TARGET_094
            DET_SUPER_RES_TARGET_095_oRDR_DETECTION_093_096_oPCAN_RADAR_4c241f33_Tx: ComBitPosition=311, ComBitSize=1, ComSignalInitValue=0, ComSignalType=BOOLEAN, ComSystemTemplateSystemSignalRef=DET_SUPER_RES_TARGET_095
            DET_SUPER_RES_TARGET_096_oRDR_DETECTION_093_096_oPCAN_RADAR_28c464cd_Tx: ComBitPosition=423, ComBitSize=1, ComSignalInitValue=0, ComSignalType=BOOLEAN, ComSystemTemplateSystemSignalRef=DET_SUPER_RES_TARGET_096
        SG_Detections_097_100_oRDR_DETECTION_097_100_oPCAN_RADAR_dcf343f6_Tx: ComSystemTemplateSignalGroupRef=SG_Detections_097_100
          83 x ComGroupSignal, all with ComSignalEndianness=LITTLE_ENDIAN, ComTransferProperty=PENDING:
            DET_AZIMUTH_097_oRDR_DETECTION_097_100_oPCAN_RADAR_777e9641_Tx: ComBitPosition=88, ComBitSize=13, ComSignalInitValue=0, ComSignalType=UINT16, ComSystemTemplateSystemSignalRef=DET_AZIMUTH_097
            DET_AZIMUTH_098_oRDR_DETECTION_097_100_oPCAN_RADAR_5b6e0406_Tx: ComBitPosition=200, ComBitSize=13, ComSignalInitValue=0, ComSignalType=UINT16, ComSystemTemplateSystemSignalRef=DET_AZIMUTH_098
            DET_AZIMUTH_099_oRDR_DETECTION_097_100_oPCAN_RADAR_ce1ed093_Tx: ComBitPosition=312, ComBitSize=13, ComSignalInitValue=0, ComSignalType=UINT16, ComSystemTemplateSystemSignalRef=DET_AZIMUTH_099
            DET_AZIMUTH_100_oRDR_DETECTION_097_100_oPCAN_RADAR_fa10f2ab_Tx: ComBitPosition=424, ComBitSize=13, ComSignalInitValue=0, ComSignalType=UINT16, ComSystemTemplateSystemSignalRef=DET_AZIMUTH_100
            DET_AZIMUTH_ERR_097_oRDR_DETECTION_097_100_oPCAN_RADAR_d3cb03b4_Tx: ComBitPosition=105, ComBitSize=7, ComSignalInitValue=0, ComSignalType=UINT8, ComSystemTemplateSystemSignalRef=DET_AZIMUTH_ERR_097
            DET_AZIMUTH_ERR_098_oRDR_DETECTION_097_100_oPCAN_RADAR_ffdb91f3_Tx: ComBitPosition=217, ComBitSize=7, ComSignalInitValue=0, ComSignalType=UINT8, ComSystemTemplateSystemSignalRef=DET_AZIMUTH_ERR_098
            DET_AZIMUTH_ERR_099_oRDR_DETECTION_097_100_oPCAN_RADAR_6aab4566_Tx: ComBitPosition=329, ComBitSize=7, ComSignalInitValue=0, ComSignalType=UINT8, ComSystemTemplateSystemSignalRef=DET_AZIMUTH_ERR_099
            DET_AZIMUTH_ERR_100_oRDR_DETECTION_097_100_oPCAN_RADAR_5ea5675e_Tx: ComBitPosition=441, ComBitSize=7, ComSignalInitValue=0, ComSignalType=UINT8, ComSystemTemplateSystemSignalRef=DET_AZIMUTH_ERR_100
            DET_BELOW_RAIN_THOLD_097_oRDR_DETECTION_097_100_oPCAN_RADAR_a27f0581_Tx: ComBitPosition=39, ComBitSize=1, ComSignalInitValue=0, ComSignalType=BOOLEAN, ComSystemTemplateSystemSignalRef=DET_BELOW_RAIN_THOLD_097
            DET_BELOW_RAIN_THOLD_098_oRDR_DETECTION_097_100_oPCAN_RADAR_8e6f97c6_Tx: ComBitPosition=151, ComBitSize=1, ComSignalInitValue=0, ComSignalType=BOOLEAN, ComSystemTemplateSystemSignalRef=DET_BELOW_RAIN_THOLD_098
            DET_BELOW_RAIN_THOLD_099_oRDR_DETECTION_097_100_oPCAN_RADAR_1b1f4353_Tx: ComBitPosition=263, ComBitSize=1, ComSignalInitValue=0, ComSignalType=BOOLEAN, ComSystemTemplateSystemSignalRef=DET_BELOW_RAIN_THOLD_099
            DET_BELOW_RAIN_THOLD_100_oRDR_DETECTION_097_100_oPCAN_RADAR_2f11616b_Tx: ComBitPosition=375, ComBitSize=1, ComSignalInitValue=0, ComSignalType=BOOLEAN, ComSystemTemplateSystemSignalRef=DET_BELOW_RAIN_THOLD_100
            DET_BI_STATIC_FLAG_097_oRDR_DETECTION_097_100_oPCAN_RADAR_2152d6c4_Tx: ComBitPosition=104, ComBitSize=1, ComSignalInitValue=0, ComSignalType=BOOLEAN, ComSystemTemplateSystemSignalRef=DET_BI_STATIC_FLAG_097
            DET_BI_STATIC_FLAG_098_oRDR_DETECTION_097_100_oPCAN_RADAR_0d424483_Tx: ComBitPosition=216, ComBitSize=1, ComSignalInitValue=0, ComSignalType=BOOLEAN, ComSystemTemplateSystemSignalRef=DET_BI_STATIC_FLAG_098
            DET_BI_STATIC_FLAG_099_oRDR_DETECTION_097_100_oPCAN_RADAR_98329016_Tx: ComBitPosition=328, ComBitSize=1, ComSignalInitValue=0, ComSignalType=BOOLEAN, ComSystemTemplateSystemSignalRef=DET_BI_STATIC_FLAG_099
            DET_BI_STATIC_FLAG_100_oRDR_DETECTION_097_100_oPCAN_RADAR_ac3cb22e_Tx: ComBitPosition=440, ComBitSize=1, ComSignalInitValue=0, ComSignalType=BOOLEAN, ComSystemTemplateSystemSignalRef=DET_BI_STATIC_FLAG_100
            DET_CONFD_AZIMUTH_097_oRDR_DETECTION_097_100_oPCAN_RADAR_75989c8b_Tx: ComBitPosition=118, ComBitSize=2, ComSignalInitValue=0, ComSignalType=UINT8, ComSystemTemplateSystemSignalRef=DET_CONFD_AZIMUTH_097
            DET_CONFD_AZIMUTH_098_oRDR_DETECTION_097_100_oPCAN_RADAR_59880ecc_Tx: ComBitPosition=230, ComBitSize=2, ComSignalInitValue=0, ComSignalType=UINT8, ComSystemTemplateSystemSignalRef=DET_CONFD_AZIMUTH_098
            DET_CONFD_AZIMUTH_099_oRDR_DETECTION_097_100_oPCAN_RADAR_ccf8da59_Tx: ComBitPosition=342, ComBitSize=2, ComSignalInitValue=0, ComSignalType=UINT8, ComSystemTemplateSystemSignalRef=DET_CONFD_AZIMUTH_099
            DET_CONFD_AZIMUTH_100_oRDR_DETECTION_097_100_oPCAN_RADAR_f8f6f861_Tx: ComBitPosition=454, ComBitSize=2, ComSignalInitValue=0, ComSignalType=UINT8, ComSystemTemplateSystemSignalRef=DET_CONFD_AZIMUTH_100
            DET_CONFD_ELEVATION_097_oRDR_DETECTION_097_100_oPCAN_RADAR_770d9d71_Tx: ComBitPosition=101, ComBitSize=2, ComSignalInitValue=0, ComSignalType=UINT8, ComSystemTemplateSystemSignalRef=DET_CONFD_ELEVATION_097
            DET_CONFD_ELEVATION_098_oRDR_DETECTION_097_100_oPCAN_RADAR_5b1d0f36_Tx: ComBitPosition=213, ComBitSize=2, ComSignalInitValue=0, ComSignalType=UINT8, ComSystemTemplateSystemSignalRef=DET_CONFD_ELEVATION_098
            DET_CONFD_ELEVATION_099_oRDR_DETECTION_097_100_oPCAN_RADAR_ce6ddba3_Tx: ComBitPosition=325, ComBitSize=2, ComSignalInitValue=0, ComSignalType=UINT8, ComSystemTemplateSystemSignalRef=DET_CONFD_ELEVATION_099
            DET_CONFD_ELEVATION_100_oRDR_DETECTION_097_100_oPCAN_RADAR_fa63f99b_Tx: ComBitPosition=437, ComBitSize=2, ComSignalInitValue=0, ComSignalType=UINT8, ComSystemTemplateSystemSignalRef=DET_CONFD_ELEVATION_100
            DET_ELEVATION_097_oRDR_DETECTION_097_100_oPCAN_RADAR_a6cd494d_Tx: ComBitPosition=72, ComBitSize=8, ComSignalInitValue=0, ComSignalType=UINT8, ComSystemTemplateSystemSignalRef=DET_ELEVATION_097
            DET_ELEVATION_098_oRDR_DETECTION_097_100_oPCAN_RADAR_8adddb0a_Tx: ComBitPosition=184, ComBitSize=8, ComSignalInitValue=0, ComSignalType=UINT8, ComSystemTemplateSystemSignalRef=DET_ELEVATION_098
            DET_ELEVATION_099_oRDR_DETECTION_097_100_oPCAN_RADAR_1fad0f9f_Tx: ComBitPosition=296, ComBitSize=8, ComSignalInitValue=0, ComSignalType=UINT8, ComSystemTemplateSystemSignalRef=DET_ELEVATION_099
            DET_ELEVATION_100_oRDR_DETECTION_097_100_oPCAN_RADAR_2ba32da7_Tx: ComBitPosition=408, ComBitSize=8, ComSignalInitValue=0, ComSignalType=UINT8, ComSystemTemplateSystemSignalRef=DET_ELEVATION_100
            DET_ELEVATION_ERR_097_oRDR_DETECTION_097_100_oPCAN_RADAR_21f4d138_Tx: ComBitPosition=80, ComBitSize=6, ComSignalInitValue=0, ComSignalType=UINT8, ComSystemTemplateSystemSignalRef=DET_ELEVATION_ERR_097
            DET_ELEVATION_ERR_098_oRDR_DETECTION_097_100_oPCAN_RADAR_0de4437f_Tx: ComBitPosition=192, ComBitSize=6, ComSignalInitValue=0, ComSignalType=UINT8, ComSystemTemplateSystemSignalRef=DET_ELEVATION_ERR_098
            DET_ELEVATION_ERR_099_oRDR_DETECTION_097_100_oPCAN_RADAR_989497ea_Tx: ComBitPosition=304, ComBitSize=6, ComSignalInitValue=0, ComSignalType=UINT8, ComSystemTemplateSystemSignalRef=DET_ELEVATION_ERR_099
            DET_ELEVATION_ERR_100_oRDR_DETECTION_097_100_oPCAN_RADAR_ac9ab5d2_Tx: ComBitPosition=416, ComBitSize=6, ComSignalInitValue=0, ComSignalType=UINT8, ComSystemTemplateSystemSignalRef=DET_ELEVATION_ERR_100
            DET_EXISTENCE_PROB_097_oRDR_DETECTION_097_100_oPCAN_RADAR_f36ba458_Tx: ComBitPosition=112, ComBitSize=6, ComSignalInitValue=0, ComSignalType=UINT8, ComSystemTemplateSystemSignalRef=DET_EXISTENCE_PROB_097
            DET_EXISTENCE_PROB_098_oRDR_DETECTION_097_100_oPCAN_RADAR_df7b361f_Tx: ComBitPosition=224, ComBitSize=6, ComSignalInitValue=0, ComSignalType=UINT8, ComSystemTemplateSystemSignalRef=DET_EXISTENCE_PROB_098
            DET_EXISTENCE_PROB_099_oRDR_DETECTION_097_100_oPCAN_RADAR_4a0be28a_Tx: ComBitPosition=336, ComBitSize=6, ComSignalInitValue=0, ComSignalType=UINT8, ComSystemTemplateSystemSignalRef=DET_EXISTENCE_PROB_099
            DET_EXISTENCE_PROB_100_oRDR_DETECTION_097_100_oPCAN_RADAR_7e05c0b2_Tx: ComBitPosition=448, ComBitSize=6, ComSignalInitValue=0, ComSignalType=UINT8, ComSystemTemplateSystemSignalRef=DET_EXISTENCE_PROB_100
            DET_HVC_FLAG_097_oRDR_DETECTION_097_100_oPCAN_RADAR_121fe727_Tx: ComBitPosition=86, ComBitSize=1, ComSignalInitValue=0, ComSignalType=BOOLEAN, ComSystemTemplateSystemSignalRef=DET_HVC_FLAG_097
            DET_HVC_FLAG_098_oRDR_DETECTION_097_100_oPCAN_RADAR_3e0f7560_Tx: ComBitPosition=198, ComBitSize=1, ComSignalInitValue=0, ComSignalType=BOOLEAN, ComSystemTemplateSystemSignalRef=DET_HVC_FLAG_098
            DET_HVC_FLAG_099_oRDR_DETECTION_097_100_oPCAN_RADAR_ab7fa1f5_Tx: ComBitPosition=310, ComBitSize=1, ComSignalInitValue=0, ComSignalType=BOOLEAN, ComSystemTemplateSystemSignalRef=DET_HVC_FLAG_099
            DET_HVC_FLAG_100_oRDR_DETECTION_097_100_oPCAN_RADAR_9f7183cd_Tx: ComBitPosition=422, ComBitSize=1, ComSignalInitValue=0, ComSignalType=BOOLEAN, ComSystemTemplateSystemSignalRef=DET_HVC_FLAG_100
            DET_IDM_097_oRDR_DETECTION_097_100_oPCAN_RADAR_994ddc9a_Tx: ComBitPosition=63, ComBitSize=1, ComSignalInitValue=0, ComSignalType=BOOLEAN, ComSystemTemplateSystemSignalRef=DET_IDM_097
            DET_IDM_098_oRDR_DETECTION_097_100_oPCAN_RADAR_b55d4edd_Tx: ComBitPosition=175, ComBitSize=1, ComSignalInitValue=0, ComSignalType=BOOLEAN, ComSystemTemplateSystemSignalRef=DET_IDM_098
            DET_IDM_099_oRDR_DETECTION_097_100_oPCAN_RADAR_202d9a48_Tx: ComBitPosition=287, ComBitSize=1, ComSignalInitValue=0, ComSignalType=BOOLEAN, ComSystemTemplateSystemSignalRef=DET_IDM_099
            DET_IDM_100_oRDR_DETECTION_097_100_oPCAN_RADAR_1423b870_Tx: ComBitPosition=399, ComBitSize=1, ComSignalInitValue=0, ComSignalType=BOOLEAN, ComSystemTemplateSystemSignalRef=DET_IDM_100
            DET_MH_CRC16_097_100_oRDR_DETECTION_097_100_oPCAN_RADAR_587b91fd_Tx: ComBitPosition=0, ComBitSize=16, ComSignalInitValue=0, ComSignalType=UINT16, ComSystemTemplateSystemSignalRef=DET_MH_CRC16_097_100
            DET_MH_CYCLE_COUNTER_097_100_oRDR_DETECTION_097_100_oPCAN_RADAR_dc0e30ca_Tx: ComBitPosition=16, ComBitSize=8, ComSignalInitValue=0, ComSignalType=UINT8, ComSystemTemplateSystemSignalRef=DET_MH_CYCLE_COUNTER_097_100
            DET_MH_SCAN_INDEX_4LSB_097_100_oRDR_DETECTION_097_100_oPCAN_RADAR_10241546_Tx: ComBitPosition=476, ComBitSize=4, ComSignalInitValue=0, ComSignalType=UINT8, ComSystemTemplateSystemSignalRef=DET_MH_SCAN_INDEX_4LSB_097_100
            DET_MTD_097_oRDR_DETECTION_097_100_oPCAN_RADAR_fffeee41_Tx: ComBitPosition=47, ComBitSize=1, ComSignalInitValue=0, ComSignalType=BOOLEAN, ComSystemTemplateSystemSignalRef=DET_MTD_097
            DET_MTD_098_oRDR_DETECTION_097_100_oPCAN_RADAR_d3ee7c06_Tx: ComBitPosition=159, ComBitSize=1, ComSignalInitValue=0, ComSignalType=BOOLEAN, ComSystemTemplateSystemSignalRef=DET_MTD_098
            DET_MTD_099_oRDR_DETECTION_097_100_oPCAN_RADAR_469ea893_Tx: ComBitPosition=271, ComBitSize=1, ComSignalInitValue=0, ComSignalType=BOOLEAN, ComSystemTemplateSystemSignalRef=DET_MTD_099
            DET_MTD_100_oRDR_DETECTION_097_100_oPCAN_RADAR_72908aab_Tx: ComBitPosition=383, ComBitSize=1, ComSignalInitValue=0, ComSignalType=BOOLEAN, ComSystemTemplateSystemSignalRef=DET_MTD_100
            DET_PROB_1STAZHYPO_097_oRDR_DETECTION_097_100_oPCAN_RADAR_6c4a068c_Tx: ComBitPosition=103, ComBitSize=1, ComSignalInitValue=0, ComSignalType=BOOLEAN, ComSystemTemplateSystemSignalRef=DET_PROB_1STAZHYPO_097
            DET_PROB_1STAZHYPO_098_oRDR_DETECTION_097_100_oPCAN_RADAR_405a94cb_Tx: ComBitPosition=215, ComBitSize=1, ComSignalInitValue=0, ComSignalType=BOOLEAN, ComSystemTemplateSystemSignalRef=DET_PROB_1STAZHYPO_098
            DET_PROB_1STAZHYPO_099_oRDR_DETECTION_097_100_oPCAN_RADAR_d52a405e_Tx: ComBitPosition=327, ComBitSize=1, ComSignalInitValue=0, ComSignalType=BOOLEAN, ComSystemTemplateSystemSignalRef=DET_PROB_1STAZHYPO_099
            DET_PROB_1STAZHYPO_100_oRDR_DETECTION_097_100_oPCAN_RADAR_e1246266_Tx: ComBitPosition=439, ComBitSize=1, ComSignalInitValue=0, ComSignalType=BOOLEAN, ComSystemTemplateSystemSignalRef=DET_PROB_1STAZHYPO_100
            DET_RANGE_097_oRDR_DETECTION_097_100_oPCAN_RADAR_67e5e5fa_Tx: ComBitPosition=24, ComBitSize=15, ComSignalInitValue=0, ComSignalType=UINT16, ComSystemTemplateSystemSignalRef=DET_RANGE_097
            DET_RANGE_098_oRDR_DETECTION_097_100_oPCAN_RADAR_4bf577bd_Tx: ComBitPosition=136, ComBitSize=15, ComSignalInitValue=0, ComSignalType=UINT16, ComSystemTemplateSystemSignalRef=DET_RANGE_098
            DET_RANGE_099_oRDR_DETECTION_097_100_oPCAN_RADAR_de85a328_Tx: ComBitPosition=248, ComBitSize=15, ComSignalInitValue=0, ComSignalType=UINT16, ComSystemTemplateSystemSignalRef=DET_RANGE_099
            DET_RANGE_100_oRDR_DETECTION_097_100_oPCAN_RADAR_ea8b8110_Tx: ComBitPosition=360, ComBitSize=15, ComSignalInitValue=0, ComSignalType=UINT16, ComSystemTemplateSystemSignalRef=DET_RANGE_100
            DET_RANGE_ERR_097_oRDR_DETECTION_097_100_oPCAN_RADAR_c00d5f93_Tx: ComBitPosition=40, ComBitSize=7, ComSignalInitValue=0, ComSignalType=UINT8, ComSystemTemplateSystemSignalRef=DET_RANGE_ERR_097
            DET_RANGE_ERR_098_oRDR_DETECTION_097_100_oPCAN_RADAR_ec1dcdd4_Tx: ComBitPosition=152, ComBitSize=7, ComSignalInitValue=0, ComSignalType=UINT8, ComSystemTemplateSystemSignalRef=DET_RANGE_ERR_098
            DET_RANGE_ERR_099_oRDR_DETECTION_097_100_oPCAN_RADAR_796d1941_Tx: ComBitPosition=264, ComBitSize=7, ComSignalInitValue=0, ComSignalType=UINT8, ComSystemTemplateSystemSignalRef=DET_RANGE_ERR_099
            DET_RANGE_ERR_100_oRDR_DETECTION_097_100_oPCAN_RADAR_4d633b79_Tx: ComBitPosition=376, ComBitSize=7, ComSignalInitValue=0, ComSignalType=UINT8, ComSystemTemplateSystemSignalRef=DET_RANGE_ERR_100
            DET_RANGE_VELOCITY_097_oRDR_DETECTION_097_100_oPCAN_RADAR_124327df_Tx: ComBitPosition=48, ComBitSize=15, ComSignalInitValue=16384, ComSignalType=UINT16, ComSystemTemplateSystemSignalRef=DET_RANGE_VELOCITY_097
            DET_RANGE_VELOCITY_098_oRDR_DETECTION_097_100_oPCAN_RADAR_3e53b598_Tx: ComBitPosition=160, ComBitSize=15, ComSignalInitValue=16384, ComSignalType=UINT16, ComSystemTemplateSystemSignalRef=DET_RANGE_VELOCITY_098
            DET_RANGE_VELOCITY_099_oRDR_DETECTION_097_100_oPCAN_RADAR_ab23610d_Tx: ComBitPosition=272, ComBitSize=15, ComSignalInitValue=16384, ComSignalType=UINT16, ComSystemTemplateSystemSignalRef=DET_RANGE_VELOCITY_099
            DET_RANGE_VELOCITY_100_oRDR_DETECTION_097_100_oPCAN_RADAR_9f2d4335_Tx: ComBitPosition=384, ComBitSize=15, ComSignalInitValue=16384, ComSignalType=UINT16, ComSystemTemplateSystemSignalRef=DET_RANGE_VELOCITY_100
            DET_RANGE_VELOCITY_ERR_097_oRDR_DETECTION_097_100_oPCAN_RADAR_1df8dc6d_Tx: ComBitPosition=64, ComBitSize=8, ComSignalInitValue=0, ComSignalType=UINT8, ComSystemTemplateSystemSignalRef=DET_RANGE_VELOCITY_ERR_097
            DET_RANGE_VELOCITY_ERR_098_oRDR_DETECTION_097_100_oPCAN_RADAR_31e84e2a_Tx: ComBitPosition=176, ComBitSize=8, ComSignalInitValue=0, ComSignalType=UINT8, ComSystemTemplateSystemSignalRef=DET_RANGE_VELOCITY_ERR_098
            DET_RANGE_VELOCITY_ERR_099_oRDR_DETECTION_097_100_oPCAN_RADAR_a4989abf_Tx: ComBitPosition=288, ComBitSize=8, ComSignalInitValue=0, ComSignalType=UINT8, ComSystemTemplateSystemSignalRef=DET_RANGE_VELOCITY_ERR_099
            DET_RANGE_VELOCITY_ERR_100_oRDR_DETECTION_097_100_oPCAN_RADAR_9096b887_Tx: ComBitPosition=400, ComBitSize=8, ComSignalInitValue=0, ComSignalType=UINT8, ComSystemTemplateSystemSignalRef=DET_RANGE_VELOCITY_ERR_100
            DET_RCS_097_oRDR_DETECTION_097_100_oPCAN_RADAR_95c31085_Tx: ComBitPosition=128, ComBitSize=8, ComSignalInitValue=128, ComSignalType=UINT8, ComSystemTemplateSystemSignalRef=DET_RCS_097
            DET_RCS_098_oRDR_DETECTION_097_100_oPCAN_RADAR_b9d382c2_Tx: ComBitPosition=240, ComBitSize=8, ComSignalInitValue=128, ComSignalType=UINT8, ComSystemTemplateSystemSignalRef=DET_RCS_098
            DET_RCS_099_oRDR_DETECTION_097_100_oPCAN_RADAR_2ca35657_Tx: ComBitPosition=352, ComBitSize=8, ComSignalInitValue=128, ComSignalType=UINT8, ComSystemTemplateSystemSignalRef=DET_RCS_099
            DET_RCS_100_oRDR_DETECTION_097_100_oPCAN_RADAR_18ad746f_Tx: ComBitPosition=464, ComBitSize=8, ComSignalInitValue=128, ComSignalType=UINT8, ComSystemTemplateSystemSignalRef=DET_RCS_100
            DET_SNR_097_oRDR_DETECTION_097_100_oPCAN_RADAR_486d4487_Tx: ComBitPosition=120, ComBitSize=8, ComSignalInitValue=0, ComSignalType=UINT8, ComSystemTemplateSystemSignalRef=DET_SNR_097
            DET_SNR_098_oRDR_DETECTION_097_100_oPCAN_RADAR_647dd6c0_Tx: ComBitPosition=232, ComBitSize=8, ComSignalInitValue=0, ComSignalType=UINT8, ComSystemTemplateSystemSignalRef=DET_SNR_098
            DET_SNR_099_oRDR_DETECTION_097_100_oPCAN_RADAR_f10d0255_Tx: ComBitPosition=344, ComBitSize=8, ComSignalInitValue=0, ComSignalType=UINT8, ComSystemTemplateSystemSignalRef=DET_SNR_099
            DET_SNR_100_oRDR_DETECTION_097_100_oPCAN_RADAR_c503206d_Tx: ComBitPosition=456, ComBitSize=8, ComSignalInitValue=0, ComSignalType=UINT8, ComSystemTemplateSystemSignalRef=DET_SNR_100
            DET_SUPER_RES_TARGET_097_oRDR_DETECTION_097_100_oPCAN_RADAR_79f46ce2_Tx: ComBitPosition=87, ComBitSize=1, ComSignalInitValue=0, ComSignalType=BOOLEAN, ComSystemTemplateSystemSignalRef=DET_SUPER_RES_TARGET_097
            DET_SUPER_RES_TARGET_098_oRDR_DETECTION_097_100_oPCAN_RADAR_55e4fea5_Tx: ComBitPosition=199, ComBitSize=1, ComSignalInitValue=0, ComSignalType=BOOLEAN, ComSystemTemplateSystemSignalRef=DET_SUPER_RES_TARGET_098
            DET_SUPER_RES_TARGET_099_oRDR_DETECTION_097_100_oPCAN_RADAR_c0942a30_Tx: ComBitPosition=311, ComBitSize=1, ComSignalInitValue=0, ComSignalType=BOOLEAN, ComSystemTemplateSystemSignalRef=DET_SUPER_RES_TARGET_099
            DET_SUPER_RES_TARGET_100_oRDR_DETECTION_097_100_oPCAN_RADAR_f49a0808_Tx: ComBitPosition=423, ComBitSize=1, ComSignalInitValue=0, ComSignalType=BOOLEAN, ComSystemTemplateSystemSignalRef=DET_SUPER_RES_TARGET_100
        SG_Detections_101_104_oRDR_DETECTION_101_104_oPCAN_RADAR_9de0b719_Tx: ComSystemTemplateSignalGroupRef=SG_Detections_101_104
          83 x ComGroupSignal, all with ComSignalEndianness=LITTLE_ENDIAN, ComTransferProperty=PENDING:
            DET_AZIMUTH_101_oRDR_DETECTION_101_104_oPCAN_RADAR_270c6315_Tx: ComBitPosition=88, ComBitSize=13, ComSignalInitValue=0, ComSignalType=UINT16, ComSystemTemplateSystemSignalRef=DET_AZIMUTH_101
            DET_AZIMUTH_102_oRDR_DETECTION_101_104_oPCAN_RADAR_43ec18eb_Tx: ComBitPosition=200, ComBitSize=13, ComSignalInitValue=0, ComSignalType=UINT16, ComSystemTemplateSystemSignalRef=DET_AZIMUTH_102
            DET_AZIMUTH_103_oRDR_DETECTION_101_104_oPCAN_RADAR_d69ccc7e_Tx: ComBitPosition=312, ComBitSize=13, ComSignalInitValue=0, ComSignalType=UINT16, ComSystemTemplateSystemSignalRef=DET_AZIMUTH_103
            DET_AZIMUTH_104_oRDR_DETECTION_101_104_oPCAN_RADAR_8a2cef17_Tx: ComBitPosition=424, ComBitSize=13, ComSignalInitValue=0, ComSignalType=UINT16, ComSystemTemplateSystemSignalRef=DET_AZIMUTH_104
            DET_AZIMUTH_ERR_101_oRDR_DETECTION_101_104_oPCAN_RADAR_83b9f6e0_Tx: ComBitPosition=105, ComBitSize=7, ComSignalInitValue=0, ComSignalType=UINT8, ComSystemTemplateSystemSignalRef=DET_AZIMUTH_ERR_101
            DET_AZIMUTH_ERR_102_oRDR_DETECTION_101_104_oPCAN_RADAR_e7598d1e_Tx: ComBitPosition=217, ComBitSize=7, ComSignalInitValue=0, ComSignalType=UINT8, ComSystemTemplateSystemSignalRef=DET_AZIMUTH_ERR_102
            DET_AZIMUTH_ERR_103_oRDR_DETECTION_101_104_oPCAN_RADAR_7229598b_Tx: ComBitPosition=329, ComBitSize=7, ComSignalInitValue=0, ComSignalType=UINT8, ComSystemTemplateSystemSignalRef=DET_AZIMUTH_ERR_103
            DET_AZIMUTH_ERR_104_oRDR_DETECTION_101_104_oPCAN_RADAR_2e997ae2_Tx: ComBitPosition=441, ComBitSize=7, ComSignalInitValue=0, ComSignalType=UINT8, ComSystemTemplateSystemSignalRef=DET_AZIMUTH_ERR_104
            DET_BELOW_RAIN_THOLD_101_oRDR_DETECTION_101_104_oPCAN_RADAR_f20df0d5_Tx: ComBitPosition=39, ComBitSize=1, ComSignalInitValue=0, ComSignalType=BOOLEAN, ComSystemTemplateSystemSignalRef=DET_BELOW_RAIN_THOLD_101
            DET_BELOW_RAIN_THOLD_102_oRDR_DETECTION_101_104_oPCAN_RADAR_96ed8b2b_Tx: ComBitPosition=151, ComBitSize=1, ComSignalInitValue=0, ComSignalType=BOOLEAN, ComSystemTemplateSystemSignalRef=DET_BELOW_RAIN_THOLD_102
            DET_BELOW_RAIN_THOLD_103_oRDR_DETECTION_101_104_oPCAN_RADAR_039d5fbe_Tx: ComBitPosition=263, ComBitSize=1, ComSignalInitValue=0, ComSignalType=BOOLEAN, ComSystemTemplateSystemSignalRef=DET_BELOW_RAIN_THOLD_103
            DET_BELOW_RAIN_THOLD_104_oRDR_DETECTION_101_104_oPCAN_RADAR_5f2d7cd7_Tx: ComBitPosition=375, ComBitSize=1, ComSignalInitValue=0, ComSignalType=BOOLEAN, ComSystemTemplateSystemSignalRef=DET_BELOW_RAIN_THOLD_104
            DET_BI_STATIC_FLAG_101_oRDR_DETECTION_101_104_oPCAN_RADAR_71202390_Tx: ComBitPosition=104, ComBitSize=1, ComSignalInitValue=0, ComSignalType=BOOLEAN, ComSystemTemplateSystemSignalRef=DET_BI_STATIC_FLAG_101
            DET_BI_STATIC_FLAG_102_oRDR_DETECTION_101_104_oPCAN_RADAR_15c0586e_Tx: ComBitPosition=216, ComBitSize=1, ComSignalInitValue=0, ComSignalType=BOOLEAN, ComSystemTemplateSystemSignalRef=DET_BI_STATIC_FLAG_102
            DET_BI_STATIC_FLAG_103_oRDR_DETECTION_101_104_oPCAN_RADAR_80b08cfb_Tx: ComBitPosition=328, ComBitSize=1, ComSignalInitValue=0, ComSignalType=BOOLEAN, ComSystemTemplateSystemSignalRef=DET_BI_STATIC_FLAG_103
            DET_BI_STATIC_FLAG_104_oRDR_DETECTION_101_104_oPCAN_RADAR_dc00af92_Tx: ComBitPosition=440, ComBitSize=1, ComSignalInitValue=0, ComSignalType=BOOLEAN, ComSystemTemplateSystemSignalRef=DET_BI_STATIC_FLAG_104
            DET_CONFD_AZIMUTH_101_oRDR_DETECTION_101_104_oPCAN_RADAR_25ea69df_Tx: ComBitPosition=118, ComBitSize=2, ComSignalInitValue=0, ComSignalType=UINT8, ComSystemTemplateSystemSignalRef=DET_CONFD_AZIMUTH_101
            DET_CONFD_AZIMUTH_102_oRDR_DETECTION_101_104_oPCAN_RADAR_410a1221_Tx: ComBitPosition=230, ComBitSize=2, ComSignalInitValue=0, ComSignalType=UINT8, ComSystemTemplateSystemSignalRef=DET_CONFD_AZIMUTH_102
            DET_CONFD_AZIMUTH_103_oRDR_DETECTION_101_104_oPCAN_RADAR_d47ac6b4_Tx: ComBitPosition=342, ComBitSize=2, ComSignalInitValue=0, ComSignalType=UINT8, ComSystemTemplateSystemSignalRef=DET_CONFD_AZIMUTH_103
            DET_CONFD_AZIMUTH_104_oRDR_DETECTION_101_104_oPCAN_RADAR_88cae5dd_Tx: ComBitPosition=454, ComBitSize=2, ComSignalInitValue=0, ComSignalType=UINT8, ComSystemTemplateSystemSignalRef=DET_CONFD_AZIMUTH_104
            DET_CONFD_ELEVATION_101_oRDR_DETECTION_101_104_oPCAN_RADAR_277f6825_Tx: ComBitPosition=101, ComBitSize=2, ComSignalInitValue=0, ComSignalType=UINT8, ComSystemTemplateSystemSignalRef=DET_CONFD_ELEVATION_101
            DET_CONFD_ELEVATION_102_oRDR_DETECTION_101_104_oPCAN_RADAR_439f13db_Tx: ComBitPosition=213, ComBitSize=2, ComSignalInitValue=0, ComSignalType=UINT8, ComSystemTemplateSystemSignalRef=DET_CONFD_ELEVATION_102
            DET_CONFD_ELEVATION_103_oRDR_DETECTION_101_104_oPCAN_RADAR_d6efc74e_Tx: ComBitPosition=325, ComBitSize=2, ComSignalInitValue=0, ComSignalType=UINT8, ComSystemTemplateSystemSignalRef=DET_CONFD_ELEVATION_103
            DET_CONFD_ELEVATION_104_oRDR_DETECTION_101_104_oPCAN_RADAR_8a5fe427_Tx: ComBitPosition=437, ComBitSize=2, ComSignalInitValue=0, ComSignalType=UINT8, ComSystemTemplateSystemSignalRef=DET_CONFD_ELEVATION_104
            DET_ELEVATION_101_oRDR_DETECTION_101_104_oPCAN_RADAR_f6bfbc19_Tx: ComBitPosition=72, ComBitSize=8, ComSignalInitValue=0, ComSignalType=UINT8, ComSystemTemplateSystemSignalRef=DET_ELEVATION_101
            DET_ELEVATION_102_oRDR_DETECTION_101_104_oPCAN_RADAR_925fc7e7_Tx: ComBitPosition=184, ComBitSize=8, ComSignalInitValue=0, ComSignalType=UINT8, ComSystemTemplateSystemSignalRef=DET_ELEVATION_102
            DET_ELEVATION_103_oRDR_DETECTION_101_104_oPCAN_RADAR_072f1372_Tx: ComBitPosition=296, ComBitSize=8, ComSignalInitValue=0, ComSignalType=UINT8, ComSystemTemplateSystemSignalRef=DET_ELEVATION_103
            DET_ELEVATION_104_oRDR_DETECTION_101_104_oPCAN_RADAR_5b9f301b_Tx: ComBitPosition=408, ComBitSize=8, ComSignalInitValue=0, ComSignalType=UINT8, ComSystemTemplateSystemSignalRef=DET_ELEVATION_104
            DET_ELEVATION_ERR_101_oRDR_DETECTION_101_104_oPCAN_RADAR_7186246c_Tx: ComBitPosition=80, ComBitSize=6, ComSignalInitValue=0, ComSignalType=UINT8, ComSystemTemplateSystemSignalRef=DET_ELEVATION_ERR_101
            DET_ELEVATION_ERR_102_oRDR_DETECTION_101_104_oPCAN_RADAR_15665f92_Tx: ComBitPosition=192, ComBitSize=6, ComSignalInitValue=0, ComSignalType=UINT8, ComSystemTemplateSystemSignalRef=DET_ELEVATION_ERR_102
            DET_ELEVATION_ERR_103_oRDR_DETECTION_101_104_oPCAN_RADAR_80168b07_Tx: ComBitPosition=304, ComBitSize=6, ComSignalInitValue=0, ComSignalType=UINT8, ComSystemTemplateSystemSignalRef=DET_ELEVATION_ERR_103
            DET_ELEVATION_ERR_104_oRDR_DETECTION_101_104_oPCAN_RADAR_dca6a86e_Tx: ComBitPosition=416, ComBitSize=6, ComSignalInitValue=0, ComSignalType=UINT8, ComSystemTemplateSystemSignalRef=DET_ELEVATION_ERR_104
            DET_EXISTENCE_PROB_101_oRDR_DETECTION_101_104_oPCAN_RADAR_a319510c_Tx: ComBitPosition=112, ComBitSize=6, ComSignalInitValue=0, ComSignalType=UINT8, ComSystemTemplateSystemSignalRef=DET_EXISTENCE_PROB_101
            DET_EXISTENCE_PROB_102_oRDR_DETECTION_101_104_oPCAN_RADAR_c7f92af2_Tx: ComBitPosition=224, ComBitSize=6, ComSignalInitValue=0, ComSignalType=UINT8, ComSystemTemplateSystemSignalRef=DET_EXISTENCE_PROB_102
            DET_EXISTENCE_PROB_103_oRDR_DETECTION_101_104_oPCAN_RADAR_5289fe67_Tx: ComBitPosition=336, ComBitSize=6, ComSignalInitValue=0, ComSignalType=UINT8, ComSystemTemplateSystemSignalRef=DET_EXISTENCE_PROB_103
            DET_EXISTENCE_PROB_104_oRDR_DETECTION_101_104_oPCAN_RADAR_0e39dd0e_Tx: ComBitPosition=448, ComBitSize=6, ComSignalInitValue=0, ComSignalType=UINT8, ComSystemTemplateSystemSignalRef=DET_EXISTENCE_PROB_104
            DET_HVC_FLAG_101_oRDR_DETECTION_101_104_oPCAN_RADAR_426d1273_Tx: ComBitPosition=86, ComBitSize=1, ComSignalInitValue=0, ComSignalType=BOOLEAN, ComSystemTemplateSystemSignalRef=DET_HVC_FLAG_101
            DET_HVC_FLAG_102_oRDR_DETECTION_101_104_oPCAN_RADAR_268d698d_Tx: ComBitPosition=198, ComBitSize=1, ComSignalInitValue=0, ComSignalType=BOOLEAN, ComSystemTemplateSystemSignalRef=DET_HVC_FLAG_102
            DET_HVC_FLAG_103_oRDR_DETECTION_101_104_oPCAN_RADAR_b3fdbd18_Tx: ComBitPosition=310, ComBitSize=1, ComSignalInitValue=0, ComSignalType=BOOLEAN, ComSystemTemplateSystemSignalRef=DET_HVC_FLAG_103
            DET_HVC_FLAG_104_oRDR_DETECTION_101_104_oPCAN_RADAR_ef4d9e71_Tx: ComBitPosition=422, ComBitSize=1, ComSignalInitValue=0, ComSignalType=BOOLEAN, ComSystemTemplateSystemSignalRef=DET_HVC_FLAG_104
            DET_IDM_101_oRDR_DETECTION_101_104_oPCAN_RADAR_c93f29ce_Tx: ComBitPosition=63, ComBitSize=1, ComSignalInitValue=0, ComSignalType=BOOLEAN, ComSystemTemplateSystemSignalRef=DET_IDM_101
            DET_IDM_102_oRDR_DETECTION_101_104_oPCAN_RADAR_addf5230_Tx: ComBitPosition=175, ComBitSize=1, ComSignalInitValue=0, ComSignalType=BOOLEAN, ComSystemTemplateSystemSignalRef=DET_IDM_102
            DET_IDM_103_oRDR_DETECTION_101_104_oPCAN_RADAR_38af86a5_Tx: ComBitPosition=287, ComBitSize=1, ComSignalInitValue=0, ComSignalType=BOOLEAN, ComSystemTemplateSystemSignalRef=DET_IDM_103
            DET_IDM_104_oRDR_DETECTION_101_104_oPCAN_RADAR_641fa5cc_Tx: ComBitPosition=399, ComBitSize=1, ComSignalInitValue=0, ComSignalType=BOOLEAN, ComSystemTemplateSystemSignalRef=DET_IDM_104
            DET_MH_CRC16_101_104_oRDR_DETECTION_101_104_oPCAN_RADAR_19686512_Tx: ComBitPosition=0, ComBitSize=16, ComSignalInitValue=0, ComSignalType=UINT16, ComSystemTemplateSystemSignalRef=DET_MH_CRC16_101_104
            DET_MH_CYCLE_COUNTER_101_104_oRDR_DETECTION_101_104_oPCAN_RADAR_9d1dc425_Tx: ComBitPosition=16, ComBitSize=8, ComSignalInitValue=0, ComSignalType=UINT8, ComSystemTemplateSystemSignalRef=DET_MH_CYCLE_COUNTER_101_104
            DET_MH_SCAN_INDEX_4LSB_101_104_oRDR_DETECTION_101_104_oPCAN_RADAR_5137e1a9_Tx: ComBitPosition=476, ComBitSize=4, ComSignalInitValue=0, ComSignalType=UINT8, ComSystemTemplateSystemSignalRef=DET_MH_SCAN_INDEX_4LSB_101_104
            DET_MTD_101_oRDR_DETECTION_101_104_oPCAN_RADAR_af8c1b15_Tx: ComBitPosition=47, ComBitSize=1, ComSignalInitValue=0, ComSignalType=BOOLEAN, ComSystemTemplateSystemSignalRef=DET_MTD_101
            DET_MTD_102_oRDR_DETECTION_101_104_oPCAN_RADAR_cb6c60eb_Tx: ComBitPosition=159, ComBitSize=1, ComSignalInitValue=0, ComSignalType=BOOLEAN, ComSystemTemplateSystemSignalRef=DET_MTD_102
            DET_MTD_103_oRDR_DETECTION_101_104_oPCAN_RADAR_5e1cb47e_Tx: ComBitPosition=271, ComBitSize=1, ComSignalInitValue=0, ComSignalType=BOOLEAN, ComSystemTemplateSystemSignalRef=DET_MTD_103
            DET_MTD_104_oRDR_DETECTION_101_104_oPCAN_RADAR_02ac9717_Tx: ComBitPosition=383, ComBitSize=1, ComSignalInitValue=0, ComSignalType=BOOLEAN, ComSystemTemplateSystemSignalRef=DET_MTD_104
            DET_PROB_1STAZHYPO_101_oRDR_DETECTION_101_104_oPCAN_RADAR_3c38f3d8_Tx: ComBitPosition=103, ComBitSize=1, ComSignalInitValue=0, ComSignalType=BOOLEAN, ComSystemTemplateSystemSignalRef=DET_PROB_1STAZHYPO_101
            DET_PROB_1STAZHYPO_102_oRDR_DETECTION_101_104_oPCAN_RADAR_58d88826_Tx: ComBitPosition=215, ComBitSize=1, ComSignalInitValue=0, ComSignalType=BOOLEAN, ComSystemTemplateSystemSignalRef=DET_PROB_1STAZHYPO_102
            DET_PROB_1STAZHYPO_103_oRDR_DETECTION_101_104_oPCAN_RADAR_cda85cb3_Tx: ComBitPosition=327, ComBitSize=1, ComSignalInitValue=0, ComSignalType=BOOLEAN, ComSystemTemplateSystemSignalRef=DET_PROB_1STAZHYPO_103
            DET_PROB_1STAZHYPO_104_oRDR_DETECTION_101_104_oPCAN_RADAR_91187fda_Tx: ComBitPosition=439, ComBitSize=1, ComSignalInitValue=0, ComSignalType=BOOLEAN, ComSystemTemplateSystemSignalRef=DET_PROB_1STAZHYPO_104
            DET_RANGE_101_oRDR_DETECTION_101_104_oPCAN_RADAR_379710ae_Tx: ComBitPosition=24, ComBitSize=15, ComSignalInitValue=0, ComSignalType=UINT16, ComSystemTemplateSystemSignalRef=DET_RANGE_101
            DET_RANGE_102_oRDR_DETECTION_101_104_oPCAN_RADAR_53776b50_Tx: ComBitPosition=136, ComBitSize=15, ComSignalInitValue=0, ComSignalType=UINT16, ComSystemTemplateSystemSignalRef=DET_RANGE_102
            DET_RANGE_103_oRDR_DETECTION_101_104_oPCAN_RADAR_c607bfc5_Tx: ComBitPosition=248, ComBitSize=15, ComSignalInitValue=0, ComSignalType=UINT16, ComSystemTemplateSystemSignalRef=DET_RANGE_103
            DET_RANGE_104_oRDR_DETECTION_101_104_oPCAN_RADAR_9ab79cac_Tx: ComBitPosition=360, ComBitSize=15, ComSignalInitValue=0, ComSignalType=UINT16, ComSystemTemplateSystemSignalRef=DET_RANGE_104
            DET_RANGE_ERR_101_oRDR_DETECTION_101_104_oPCAN_RADAR_907faac7_Tx: ComBitPosition=40, ComBitSize=7, ComSignalInitValue=0, ComSignalType=UINT8, ComSystemTemplateSystemSignalRef=DET_RANGE_ERR_101
            DET_RANGE_ERR_102_oRDR_DETECTION_101_104_oPCAN_RADAR_f49fd139_Tx: ComBitPosition=152, ComBitSize=7, ComSignalInitValue=0, ComSignalType=UINT8, ComSystemTemplateSystemSignalRef=DET_RANGE_ERR_102
            DET_RANGE_ERR_103_oRDR_DETECTION_101_104_oPCAN_RADAR_61ef05ac_Tx: ComBitPosition=264, ComBitSize=7, ComSignalInitValue=0, ComSignalType=UINT8, ComSystemTemplateSystemSignalRef=DET_RANGE_ERR_103
            DET_RANGE_ERR_104_oRDR_DETECTION_101_104_oPCAN_RADAR_3d5f26c5_Tx: ComBitPosition=376, ComBitSize=7, ComSignalInitValue=0, ComSignalType=UINT8, ComSystemTemplateSystemSignalRef=DET_RANGE_ERR_104
            DET_RANGE_VELOCITY_101_oRDR_DETECTION_101_104_oPCAN_RADAR_4231d28b_Tx: ComBitPosition=48, ComBitSize=15, ComSignalInitValue=16384, ComSignalType=UINT16, ComSystemTemplateSystemSignalRef=DET_RANGE_VELOCITY_101
            DET_RANGE_VELOCITY_102_oRDR_DETECTION_101_104_oPCAN_RADAR_26d1a975_Tx: ComBitPosition=160, ComBitSize=15, ComSignalInitValue=16384, ComSignalType=UINT16, ComSystemTemplateSystemSignalRef=DET_RANGE_VELOCITY_102
            DET_RANGE_VELOCITY_103_oRDR_DETECTION_101_104_oPCAN_RADAR_b3a17de0_Tx: ComBitPosition=272, ComBitSize=15, ComSignalInitValue=16384, ComSignalType=UINT16, ComSystemTemplateSystemSignalRef=DET_RANGE_VELOCITY_103
            DET_RANGE_VELOCITY_104_oRDR_DETECTION_101_104_oPCAN_RADAR_ef115e89_Tx: ComBitPosition=384, ComBitSize=15, ComSignalInitValue=16384, ComSignalType=UINT16, ComSystemTemplateSystemSignalRef=DET_RANGE_VELOCITY_104
            DET_RANGE_VELOCITY_ERR_101_oRDR_DETECTION_101_104_oPCAN_RADAR_4d8a2939_Tx: ComBitPosition=64, ComBitSize=8, ComSignalInitValue=0, ComSignalType=UINT8, ComSystemTemplateSystemSignalRef=DET_RANGE_VELOCITY_ERR_101
            DET_RANGE_VELOCITY_ERR_102_oRDR_DETECTION_101_104_oPCAN_RADAR_296a52c7_Tx: ComBitPosition=176, ComBitSize=8, ComSignalInitValue=0, ComSignalType=UINT8, ComSystemTemplateSystemSignalRef=DET_RANGE_VELOCITY_ERR_102
            DET_RANGE_VELOCITY_ERR_103_oRDR_DETECTION_101_104_oPCAN_RADAR_bc1a8652_Tx: ComBitPosition=288, ComBitSize=8, ComSignalInitValue=0, ComSignalType=UINT8, ComSystemTemplateSystemSignalRef=DET_RANGE_VELOCITY_ERR_103
            DET_RANGE_VELOCITY_ERR_104_oRDR_DETECTION_101_104_oPCAN_RADAR_e0aaa53b_Tx: ComBitPosition=400, ComBitSize=8, ComSignalInitValue=0, ComSignalType=UINT8, ComSystemTemplateSystemSignalRef=DET_RANGE_VELOCITY_ERR_104
            DET_RCS_101_oRDR_DETECTION_101_104_oPCAN_RADAR_c5b1e5d1_Tx: ComBitPosition=128, ComBitSize=8, ComSignalInitValue=128, ComSignalType=UINT8, ComSystemTemplateSystemSignalRef=DET_RCS_101
            DET_RCS_102_oRDR_DETECTION_101_104_oPCAN_RADAR_a1519e2f_Tx: ComBitPosition=240, ComBitSize=8, ComSignalInitValue=128, ComSignalType=UINT8, ComSystemTemplateSystemSignalRef=DET_RCS_102
            DET_RCS_103_oRDR_DETECTION_101_104_oPCAN_RADAR_34214aba_Tx: ComBitPosition=352, ComBitSize=8, ComSignalInitValue=128, ComSignalType=UINT8, ComSystemTemplateSystemSignalRef=DET_RCS_103
            DET_RCS_104_oRDR_DETECTION_101_104_oPCAN_RADAR_689169d3_Tx: ComBitPosition=464, ComBitSize=8, ComSignalInitValue=128, ComSignalType=UINT8, ComSystemTemplateSystemSignalRef=DET_RCS_104
            DET_SNR_101_oRDR_DETECTION_101_104_oPCAN_RADAR_181fb1d3_Tx: ComBitPosition=120, ComBitSize=8, ComSignalInitValue=0, ComSignalType=UINT8, ComSystemTemplateSystemSignalRef=DET_SNR_101
            DET_SNR_102_oRDR_DETECTION_101_104_oPCAN_RADAR_7cffca2d_Tx: ComBitPosition=232, ComBitSize=8, ComSignalInitValue=0, ComSignalType=UINT8, ComSystemTemplateSystemSignalRef=DET_SNR_102
            DET_SNR_103_oRDR_DETECTION_101_104_oPCAN_RADAR_e98f1eb8_Tx: ComBitPosition=344, ComBitSize=8, ComSignalInitValue=0, ComSignalType=UINT8, ComSystemTemplateSystemSignalRef=DET_SNR_103
            DET_SNR_104_oRDR_DETECTION_101_104_oPCAN_RADAR_b53f3dd1_Tx: ComBitPosition=456, ComBitSize=8, ComSignalInitValue=0, ComSignalType=UINT8, ComSystemTemplateSystemSignalRef=DET_SNR_104
            DET_SUPER_RES_TARGET_101_oRDR_DETECTION_101_104_oPCAN_RADAR_298699b6_Tx: ComBitPosition=87, ComBitSize=1, ComSignalInitValue=0, ComSignalType=BOOLEAN, ComSystemTemplateSystemSignalRef=DET_SUPER_RES_TARGET_101
            DET_SUPER_RES_TARGET_102_oRDR_DETECTION_101_104_oPCAN_RADAR_4d66e248_Tx: ComBitPosition=199, ComBitSize=1, ComSignalInitValue=0, ComSignalType=BOOLEAN, ComSystemTemplateSystemSignalRef=DET_SUPER_RES_TARGET_102
            DET_SUPER_RES_TARGET_103_oRDR_DETECTION_101_104_oPCAN_RADAR_d81636dd_Tx: ComBitPosition=311, ComBitSize=1, ComSignalInitValue=0, ComSignalType=BOOLEAN, ComSystemTemplateSystemSignalRef=DET_SUPER_RES_TARGET_103
            DET_SUPER_RES_TARGET_104_oRDR_DETECTION_101_104_oPCAN_RADAR_84a615b4_Tx: ComBitPosition=423, ComBitSize=1, ComSignalInitValue=0, ComSignalType=BOOLEAN, ComSystemTemplateSystemSignalRef=DET_SUPER_RES_TARGET_104
        SG_Detections_105_108_oRDR_DETECTION_105_108_oPCAN_RADAR_ec23834b_Tx: ComSystemTemplateSignalGroupRef=SG_Detections_105_108
          83 x ComGroupSignal, all with ComSignalEndianness=LITTLE_ENDIAN, ComTransferProperty=PENDING:
            DET_AZIMUTH_105_oRDR_DETECTION_105_108_oPCAN_RADAR_f6eea5b6_Tx: ComBitPosition=88, ComBitSize=13, ComSignalInitValue=0, ComSignalType=UINT16, ComSystemTemplateSystemSignalRef=DET_AZIMUTH_105
            DET_AZIMUTH_106_oRDR_DETECTION_105_108_oPCAN_RADAR_920ede48_Tx: ComBitPosition=200, ComBitSize=13, ComSignalInitValue=0, ComSignalType=UINT16, ComSystemTemplateSystemSignalRef=DET_AZIMUTH_106
            DET_AZIMUTH_107_oRDR_DETECTION_105_108_oPCAN_RADAR_077e0add_Tx: ComBitPosition=312, ComBitSize=13, ComSignalInitValue=0, ComSignalType=UINT16, ComSystemTemplateSystemSignalRef=DET_AZIMUTH_107
            DET_AZIMUTH_108_oRDR_DETECTION_105_108_oPCAN_RADAR_2b6e989a_Tx: ComBitPosition=424, ComBitSize=13, ComSignalInitValue=0, ComSignalType=UINT16, ComSystemTemplateSystemSignalRef=DET_AZIMUTH_108
            DET_AZIMUTH_ERR_105_oRDR_DETECTION_105_108_oPCAN_RADAR_525b3043_Tx: ComBitPosition=105, ComBitSize=7, ComSignalInitValue=0, ComSignalType=UINT8, ComSystemTemplateSystemSignalRef=DET_AZIMUTH_ERR_105
            DET_AZIMUTH_ERR_106_oRDR_DETECTION_105_108_oPCAN_RADAR_36bb4bbd_Tx: ComBitPosition=217, ComBitSize=7, ComSignalInitValue=0, ComSignalType=UINT8, ComSystemTemplateSystemSignalRef=DET_AZIMUTH_ERR_106
            DET_AZIMUTH_ERR_107_oRDR_DETECTION_105_108_oPCAN_RADAR_a3cb9f28_Tx: ComBitPosition=329, ComBitSize=7, ComSignalInitValue=0, ComSignalType=UINT8, ComSystemTemplateSystemSignalRef=DET_AZIMUTH_ERR_107
            DET_AZIMUTH_ERR_108_oRDR_DETECTION_105_108_oPCAN_RADAR_8fdb0d6f_Tx: ComBitPosition=441, ComBitSize=7, ComSignalInitValue=0, ComSignalType=UINT8, ComSystemTemplateSystemSignalRef=DET_AZIMUTH_ERR_108
            DET_BELOW_RAIN_THOLD_105_oRDR_DETECTION_105_108_oPCAN_RADAR_23ef3676_Tx: ComBitPosition=39, ComBitSize=1, ComSignalInitValue=0, ComSignalType=BOOLEAN, ComSystemTemplateSystemSignalRef=DET_BELOW_RAIN_THOLD_105
            DET_BELOW_RAIN_THOLD_106_oRDR_DETECTION_105_108_oPCAN_RADAR_470f4d88_Tx: ComBitPosition=151, ComBitSize=1, ComSignalInitValue=0, ComSignalType=BOOLEAN, ComSystemTemplateSystemSignalRef=DET_BELOW_RAIN_THOLD_106
            DET_BELOW_RAIN_THOLD_107_oRDR_DETECTION_105_108_oPCAN_RADAR_d27f991d_Tx: ComBitPosition=263, ComBitSize=1, ComSignalInitValue=0, ComSignalType=BOOLEAN, ComSystemTemplateSystemSignalRef=DET_BELOW_RAIN_THOLD_107
            DET_BELOW_RAIN_THOLD_108_oRDR_DETECTION_105_108_oPCAN_RADAR_fe6f0b5a_Tx: ComBitPosition=375, ComBitSize=1, ComSignalInitValue=0, ComSignalType=BOOLEAN, ComSystemTemplateSystemSignalRef=DET_BELOW_RAIN_THOLD_108
            DET_BI_STATIC_FLAG_105_oRDR_DETECTION_105_108_oPCAN_RADAR_a0c2e533_Tx: ComBitPosition=104, ComBitSize=1, ComSignalInitValue=0, ComSignalType=BOOLEAN, ComSystemTemplateSystemSignalRef=DET_BI_STATIC_FLAG_105
            DET_BI_STATIC_FLAG_106_oRDR_DETECTION_105_108_oPCAN_RADAR_c4229ecd_Tx: ComBitPosition=216, ComBitSize=1, ComSignalInitValue=0, ComSignalType=BOOLEAN, ComSystemTemplateSystemSignalRef=DET_BI_STATIC_FLAG_106
            DET_BI_STATIC_FLAG_107_oRDR_DETECTION_105_108_oPCAN_RADAR_51524a58_Tx: ComBitPosition=328, ComBitSize=1, ComSignalInitValue=0, ComSignalType=BOOLEAN, ComSystemTemplateSystemSignalRef=DET_BI_STATIC_FLAG_107
            DET_BI_STATIC_FLAG_108_oRDR_DETECTION_105_108_oPCAN_RADAR_7d42d81f_Tx: ComBitPosition=440, ComBitSize=1, ComSignalInitValue=0, ComSignalType=BOOLEAN, ComSystemTemplateSystemSignalRef=DET_BI_STATIC_FLAG_108
            DET_CONFD_AZIMUTH_105_oRDR_DETECTION_105_108_oPCAN_RADAR_f408af7c_Tx: ComBitPosition=118, ComBitSize=2, ComSignalInitValue=0, ComSignalType=UINT8, ComSystemTemplateSystemSignalRef=DET_CONFD_AZIMUTH_105
            DET_CONFD_AZIMUTH_106_oRDR_DETECTION_105_108_oPCAN_RADAR_90e8d482_Tx: ComBitPosition=230, ComBitSize=2, ComSignalInitValue=0, ComSignalType=UINT8, ComSystemTemplateSystemSignalRef=DET_CONFD_AZIMUTH_106
            DET_CONFD_AZIMUTH_107_oRDR_DETECTION_105_108_oPCAN_RADAR_05980017_Tx: ComBitPosition=342, ComBitSize=2, ComSignalInitValue=0, ComSignalType=UINT8, ComSystemTemplateSystemSignalRef=DET_CONFD_AZIMUTH_107
            DET_CONFD_AZIMUTH_108_oRDR_DETECTION_105_108_oPCAN_RADAR_29889250_Tx: ComBitPosition=454, ComBitSize=2, ComSignalInitValue=0, ComSignalType=UINT8, ComSystemTemplateSystemSignalRef=DET_CONFD_AZIMUTH_108
            DET_CONFD_ELEVATION_105_oRDR_DETECTION_105_108_oPCAN_RADAR_f69dae86_Tx: ComBitPosition=101, ComBitSize=2, ComSignalInitValue=0, ComSignalType=UINT8, ComSystemTemplateSystemSignalRef=DET_CONFD_ELEVATION_105
            DET_CONFD_ELEVATION_106_oRDR_DETECTION_105_108_oPCAN_RADAR_927dd578_Tx: ComBitPosition=213, ComBitSize=2, ComSignalInitValue=0, ComSignalType=UINT8, ComSystemTemplateSystemSignalRef=DET_CONFD_ELEVATION_106
            DET_CONFD_ELEVATION_107_oRDR_DETECTION_105_108_oPCAN_RADAR_070d01ed_Tx: ComBitPosition=325, ComBitSize=2, ComSignalInitValue=0, ComSignalType=UINT8, ComSystemTemplateSystemSignalRef=DET_CONFD_ELEVATION_107
            DET_CONFD_ELEVATION_108_oRDR_DETECTION_105_108_oPCAN_RADAR_2b1d93aa_Tx: ComBitPosition=437, ComBitSize=2, ComSignalInitValue=0, ComSignalType=UINT8, ComSystemTemplateSystemSignalRef=DET_CONFD_ELEVATION_108
            DET_ELEVATION_105_oRDR_DETECTION_105_108_oPCAN_RADAR_275d7aba_Tx: ComBitPosition=72, ComBitSize=8, ComSignalInitValue=0, ComSignalType=UINT8, ComSystemTemplateSystemSignalRef=DET_ELEVATION_105
            DET_ELEVATION_106_oRDR_DETECTION_105_108_oPCAN_RADAR_43bd0144_Tx: ComBitPosition=184, ComBitSize=8, ComSignalInitValue=0, ComSignalType=UINT8, ComSystemTemplateSystemSignalRef=DET_ELEVATION_106
            DET_ELEVATION_107_oRDR_DETECTION_105_108_oPCAN_RADAR_d6cdd5d1_Tx: ComBitPosition=296, ComBitSize=8, ComSignalInitValue=0, ComSignalType=UINT8, ComSystemTemplateSystemSignalRef=DET_ELEVATION_107
            DET_ELEVATION_108_oRDR_DETECTION_105_108_oPCAN_RADAR_fadd4796_Tx: ComBitPosition=408, ComBitSize=8, ComSignalInitValue=0, ComSignalType=UINT8, ComSystemTemplateSystemSignalRef=DET_ELEVATION_108
            DET_ELEVATION_ERR_105_oRDR_DETECTION_105_108_oPCAN_RADAR_a064e2cf_Tx: ComBitPosition=80, ComBitSize=6, ComSignalInitValue=0, ComSignalType=UINT8, ComSystemTemplateSystemSignalRef=DET_ELEVATION_ERR_105
            DET_ELEVATION_ERR_106_oRDR_DETECTION_105_108_oPCAN_RADAR_c4849931_Tx: ComBitPosition=192, ComBitSize=6, ComSignalInitValue=0, ComSignalType=UINT8, ComSystemTemplateSystemSignalRef=DET_ELEVATION_ERR_106
            DET_ELEVATION_ERR_107_oRDR_DETECTION_105_108_oPCAN_RADAR_51f44da4_Tx: ComBitPosition=304, ComBitSize=6, ComSignalInitValue=0, ComSignalType=UINT8, ComSystemTemplateSystemSignalRef=DET_ELEVATION_ERR_107
            DET_ELEVATION_ERR_108_oRDR_DETECTION_105_108_oPCAN_RADAR_7de4dfe3_Tx: ComBitPosition=416, ComBitSize=6, ComSignalInitValue=0, ComSignalType=UINT8, ComSystemTemplateSystemSignalRef=DET_ELEVATION_ERR_108
            DET_EXISTENCE_PROB_105_oRDR_DETECTION_105_108_oPCAN_RADAR_72fb97af_Tx: ComBitPosition=112, ComBitSize=6, ComSignalInitValue=0, ComSignalType=UINT8, ComSystemTemplateSystemSignalRef=DET_EXISTENCE_PROB_105
            DET_EXISTENCE_PROB_106_oRDR_DETECTION_105_108_oPCAN_RADAR_161bec51_Tx: ComBitPosition=224, ComBitSize=6, ComSignalInitValue=0, ComSignalType=UINT8, ComSystemTemplateSystemSignalRef=DET_EXISTENCE_PROB_106
            DET_EXISTENCE_PROB_107_oRDR_DETECTION_105_108_oPCAN_RADAR_836b38c4_Tx: ComBitPosition=336, ComBitSize=6, ComSignalInitValue=0, ComSignalType=UINT8, ComSystemTemplateSystemSignalRef=DET_EXISTENCE_PROB_107
            DET_EXISTENCE_PROB_108_oRDR_DETECTION_105_108_oPCAN_RADAR_af7baa83_Tx: ComBitPosition=448, ComBitSize=6, ComSignalInitValue=0, ComSignalType=UINT8, ComSystemTemplateSystemSignalRef=DET_EXISTENCE_PROB_108
            DET_HVC_FLAG_105_oRDR_DETECTION_105_108_oPCAN_RADAR_938fd4d0_Tx: ComBitPosition=86, ComBitSize=1, ComSignalInitValue=0, ComSignalType=BOOLEAN, ComSystemTemplateSystemSignalRef=DET_HVC_FLAG_105
            DET_HVC_FLAG_106_oRDR_DETECTION_105_108_oPCAN_RADAR_f76faf2e_Tx: ComBitPosition=198, ComBitSize=1, ComSignalInitValue=0, ComSignalType=BOOLEAN, ComSystemTemplateSystemSignalRef=DET_HVC_FLAG_106
            DET_HVC_FLAG_107_oRDR_DETECTION_105_108_oPCAN_RADAR_621f7bbb_Tx: ComBitPosition=310, ComBitSize=1, ComSignalInitValue=0, ComSignalType=BOOLEAN, ComSystemTemplateSystemSignalRef=DET_HVC_FLAG_107
            DET_HVC_FLAG_108_oRDR_DETECTION_105_108_oPCAN_RADAR_4e0fe9fc_Tx: ComBitPosition=422, ComBitSize=1, ComSignalInitValue=0, ComSignalType=BOOLEAN, ComSystemTemplateSystemSignalRef=DET_HVC_FLAG_108
            DET_IDM_105_oRDR_DETECTION_105_108_oPCAN_RADAR_18ddef6d_Tx: ComBitPosition=63, ComBitSize=1, ComSignalInitValue=0, ComSignalType=BOOLEAN, ComSystemTemplateSystemSignalRef=DET_IDM_105
            DET_IDM_106_oRDR_DETECTION_105_108_oPCAN_RADAR_7c3d9493_Tx: ComBitPosition=175, ComBitSize=1, ComSignalInitValue=0, ComSignalType=BOOLEAN, ComSystemTemplateSystemSignalRef=DET_IDM_106
            DET_IDM_107_oRDR_DETECTION_105_108_oPCAN_RADAR_e94d4006_Tx: ComBitPosition=287, ComBitSize=1, ComSignalInitValue=0, ComSignalType=BOOLEAN, ComSystemTemplateSystemSignalRef=DET_IDM_107
            DET_IDM_108_oRDR_DETECTION_105_108_oPCAN_RADAR_c55dd241_Tx: ComBitPosition=399, ComBitSize=1, ComSignalInitValue=0, ComSignalType=BOOLEAN, ComSystemTemplateSystemSignalRef=DET_IDM_108
            DET_MH_CRC16_105_108_oRDR_DETECTION_105_108_oPCAN_RADAR_68ab5140_Tx: ComBitPosition=0, ComBitSize=16, ComSignalInitValue=0, ComSignalType=UINT16, ComSystemTemplateSystemSignalRef=DET_MH_CRC16_105_108
            DET_MH_CYCLE_COUNTER_105_108_oRDR_DETECTION_105_108_oPCAN_RADAR_ecdef077_Tx: ComBitPosition=16, ComBitSize=8, ComSignalInitValue=0, ComSignalType=UINT8, ComSystemTemplateSystemSignalRef=DET_MH_CYCLE_COUNTER_105_108
            DET_MH_SCAN_INDEX_4LSB_105_108_oRDR_DETECTION_105_108_oPCAN_RADAR_20f4d5fb_Tx: ComBitPosition=476, ComBitSize=4, ComSignalInitValue=0, ComSignalType=UINT8, ComSystemTemplateSystemSignalRef=DET_MH_SCAN_INDEX_4LSB_105_108
            DET_MTD_105_oRDR_DETECTION_105_108_oPCAN_RADAR_7e6eddb6_Tx: ComBitPosition=47, ComBitSize=1, ComSignalInitValue=0, ComSignalType=BOOLEAN, ComSystemTemplateSystemSignalRef=DET_MTD_105
            DET_MTD_106_oRDR_DETECTION_105_108_oPCAN_RADAR_1a8ea648_Tx: ComBitPosition=159, ComBitSize=1, ComSignalInitValue=0, ComSignalType=BOOLEAN, ComSystemTemplateSystemSignalRef=DET_MTD_106
            DET_MTD_107_oRDR_DETECTION_105_108_oPCAN_RADAR_8ffe72dd_Tx: ComBitPosition=271, ComBitSize=1, ComSignalInitValue=0, ComSignalType=BOOLEAN, ComSystemTemplateSystemSignalRef=DET_MTD_107
            DET_MTD_108_oRDR_DETECTION_105_108_oPCAN_RADAR_a3eee09a_Tx: ComBitPosition=383, ComBitSize=1, ComSignalInitValue=0, ComSignalType=BOOLEAN, ComSystemTemplateSystemSignalRef=DET_MTD_108
            DET_PROB_1STAZHYPO_105_oRDR_DETECTION_105_108_oPCAN_RADAR_edda357b_Tx: ComBitPosition=103, ComBitSize=1, ComSignalInitValue=0, ComSignalType=BOOLEAN, ComSystemTemplateSystemSignalRef=DET_PROB_1STAZHYPO_105
            DET_PROB_1STAZHYPO_106_oRDR_DETECTION_105_108_oPCAN_RADAR_893a4e85_Tx: ComBitPosition=215, ComBitSize=1, ComSignalInitValue=0, ComSignalType=BOOLEAN, ComSystemTemplateSystemSignalRef=DET_PROB_1STAZHYPO_106
            DET_PROB_1STAZHYPO_107_oRDR_DETECTION_105_108_oPCAN_RADAR_1c4a9a10_Tx: ComBitPosition=327, ComBitSize=1, ComSignalInitValue=0, ComSignalType=BOOLEAN, ComSystemTemplateSystemSignalRef=DET_PROB_1STAZHYPO_107
            DET_PROB_1STAZHYPO_108_oRDR_DETECTION_105_108_oPCAN_RADAR_305a0857_Tx: ComBitPosition=439, ComBitSize=1, ComSignalInitValue=0, ComSignalType=BOOLEAN, ComSystemTemplateSystemSignalRef=DET_PROB_1STAZHYPO_108
            DET_RANGE_105_oRDR_DETECTION_105_108_oPCAN_RADAR_e675d60d_Tx: ComBitPosition=24, ComBitSize=15, ComSignalInitValue=0, ComSignalType=UINT16, ComSystemTemplateSystemSignalRef=DET_RANGE_105
            DET_RANGE_106_oRDR_DETECTION_105_108_oPCAN_RADAR_8295adf3_Tx: ComBitPosition=136, ComBitSize=15, ComSignalInitValue=0, ComSignalType=UINT16, ComSystemTemplateSystemSignalRef=DET_RANGE_106
            DET_RANGE_107_oRDR_DETECTION_105_108_oPCAN_RADAR_17e57966_Tx: ComBitPosition=248, ComBitSize=15, ComSignalInitValue=0, ComSignalType=UINT16, ComSystemTemplateSystemSignalRef=DET_RANGE_107
            DET_RANGE_108_oRDR_DETECTION_105_108_oPCAN_RADAR_3bf5eb21_Tx: ComBitPosition=360, ComBitSize=15, ComSignalInitValue=0, ComSignalType=UINT16, ComSystemTemplateSystemSignalRef=DET_RANGE_108
            DET_RANGE_ERR_105_oRDR_DETECTION_105_108_oPCAN_RADAR_419d6c64_Tx: ComBitPosition=40, ComBitSize=7, ComSignalInitValue=0, ComSignalType=UINT8, ComSystemTemplateSystemSignalRef=DET_RANGE_ERR_105
            DET_RANGE_ERR_106_oRDR_DETECTION_105_108_oPCAN_RADAR_257d179a_Tx: ComBitPosition=152, ComBitSize=7, ComSignalInitValue=0, ComSignalType=UINT8, ComSystemTemplateSystemSignalRef=DET_RANGE_ERR_106
            DET_RANGE_ERR_107_oRDR_DETECTION_105_108_oPCAN_RADAR_b00dc30f_Tx: ComBitPosition=264, ComBitSize=7, ComSignalInitValue=0, ComSignalType=UINT8, ComSystemTemplateSystemSignalRef=DET_RANGE_ERR_107
            DET_RANGE_ERR_108_oRDR_DETECTION_105_108_oPCAN_RADAR_9c1d5148_Tx: ComBitPosition=376, ComBitSize=7, ComSignalInitValue=0, ComSignalType=UINT8, ComSystemTemplateSystemSignalRef=DET_RANGE_ERR_108
            DET_RANGE_VELOCITY_105_oRDR_DETECTION_105_108_oPCAN_RADAR_93d31428_Tx: ComBitPosition=48, ComBitSize=15, ComSignalInitValue=16384, ComSignalType=UINT16, ComSystemTemplateSystemSignalRef=DET_RANGE_VELOCITY_105
            DET_RANGE_VELOCITY_106_oRDR_DETECTION_105_108_oPCAN_RADAR_f7336fd6_Tx: ComBitPosition=160, ComBitSize=15, ComSignalInitValue=16384, ComSignalType=UINT16, ComSystemTemplateSystemSignalRef=DET_RANGE_VELOCITY_106
            DET_RANGE_VELOCITY_107_oRDR_DETECTION_105_108_oPCAN_RADAR_6243bb43_Tx: ComBitPosition=272, ComBitSize=15, ComSignalInitValue=16384, ComSignalType=UINT16, ComSystemTemplateSystemSignalRef=DET_RANGE_VELOCITY_107
            DET_RANGE_VELOCITY_108_oRDR_DETECTION_105_108_oPCAN_RADAR_4e532904_Tx: ComBitPosition=384, ComBitSize=15, ComSignalInitValue=16384, ComSignalType=UINT16, ComSystemTemplateSystemSignalRef=DET_RANGE_VELOCITY_108
            DET_RANGE_VELOCITY_ERR_105_oRDR_DETECTION_105_108_oPCAN_RADAR_9c68ef9a_Tx: ComBitPosition=64, ComBitSize=8, ComSignalInitValue=0, ComSignalType=UINT8, ComSystemTemplateSystemSignalRef=DET_RANGE_VELOCITY_ERR_105
            DET_RANGE_VELOCITY_ERR_106_oRDR_DETECTION_105_108_oPCAN_RADAR_f8889464_Tx: ComBitPosition=176, ComBitSize=8, ComSignalInitValue=0, ComSignalType=UINT8, ComSystemTemplateSystemSignalRef=DET_RANGE_VELOCITY_ERR_106
            DET_RANGE_VELOCITY_ERR_107_oRDR_DETECTION_105_108_oPCAN_RADAR_6df840f1_Tx: ComBitPosition=288, ComBitSize=8, ComSignalInitValue=0, ComSignalType=UINT8, ComSystemTemplateSystemSignalRef=DET_RANGE_VELOCITY_ERR_107
            DET_RANGE_VELOCITY_ERR_108_oRDR_DETECTION_105_108_oPCAN_RADAR_41e8d2b6_Tx: ComBitPosition=400, ComBitSize=8, ComSignalInitValue=0, ComSignalType=UINT8, ComSystemTemplateSystemSignalRef=DET_RANGE_VELOCITY_ERR_108
            DET_RCS_105_oRDR_DETECTION_105_108_oPCAN_RADAR_14532372_Tx: ComBitPosition=128, ComBitSize=8, ComSignalInitValue=128, ComSignalType=UINT8, ComSystemTemplateSystemSignalRef=DET_RCS_105
            DET_RCS_106_oRDR_DETECTION_105_108_oPCAN_RADAR_70b3588c_Tx: ComBitPosition=240, ComBitSize=8, ComSignalInitValue=128, ComSignalType=UINT8, ComSystemTemplateSystemSignalRef=DET_RCS_106
            DET_RCS_107_oRDR_DETECTION_105_108_oPCAN_RADAR_e5c38c19_Tx: ComBitPosition=352, ComBitSize=8, ComSignalInitValue=128, ComSignalType=UINT8, ComSystemTemplateSystemSignalRef=DET_RCS_107
            DET_RCS_108_oRDR_DETECTION_105_108_oPCAN_RADAR_c9d31e5e_Tx: ComBitPosition=464, ComBitSize=8, ComSignalInitValue=128, ComSignalType=UINT8, ComSystemTemplateSystemSignalRef=DET_RCS_108
            DET_SNR_105_oRDR_DETECTION_105_108_oPCAN_RADAR_c9fd7770_Tx: ComBitPosition=120, ComBitSize=8, ComSignalInitValue=0, ComSignalType=UINT8, ComSystemTemplateSystemSignalRef=DET_SNR_105
            DET_SNR_106_oRDR_DETECTION_105_108_oPCAN_RADAR_ad1d0c8e_Tx: ComBitPosition=232, ComBitSize=8, ComSignalInitValue=0, ComSignalType=UINT8, ComSystemTemplateSystemSignalRef=DET_SNR_106
            DET_SNR_107_oRDR_DETECTION_105_108_oPCAN_RADAR_386dd81b_Tx: ComBitPosition=344, ComBitSize=8, ComSignalInitValue=0, ComSignalType=UINT8, ComSystemTemplateSystemSignalRef=DET_SNR_107
            DET_SNR_108_oRDR_DETECTION_105_108_oPCAN_RADAR_147d4a5c_Tx: ComBitPosition=456, ComBitSize=8, ComSignalInitValue=0, ComSignalType=UINT8, ComSystemTemplateSystemSignalRef=DET_SNR_108
            DET_SUPER_RES_TARGET_105_oRDR_DETECTION_105_108_oPCAN_RADAR_f8645f15_Tx: ComBitPosition=87, ComBitSize=1, ComSignalInitValue=0, ComSignalType=BOOLEAN, ComSystemTemplateSystemSignalRef=DET_SUPER_RES_TARGET_105
            DET_SUPER_RES_TARGET_106_oRDR_DETECTION_105_108_oPCAN_RADAR_9c8424eb_Tx: ComBitPosition=199, ComBitSize=1, ComSignalInitValue=0, ComSignalType=BOOLEAN, ComSystemTemplateSystemSignalRef=DET_SUPER_RES_TARGET_106
            DET_SUPER_RES_TARGET_107_oRDR_DETECTION_105_108_oPCAN_RADAR_09f4f07e_Tx: ComBitPosition=311, ComBitSize=1, ComSignalInitValue=0, ComSignalType=BOOLEAN, ComSystemTemplateSystemSignalRef=DET_SUPER_RES_TARGET_107
            DET_SUPER_RES_TARGET_108_oRDR_DETECTION_105_108_oPCAN_RADAR_25e46239_Tx: ComBitPosition=423, ComBitSize=1, ComSignalInitValue=0, ComSignalType=BOOLEAN, ComSystemTemplateSystemSignalRef=DET_SUPER_RES_TARGET_108
