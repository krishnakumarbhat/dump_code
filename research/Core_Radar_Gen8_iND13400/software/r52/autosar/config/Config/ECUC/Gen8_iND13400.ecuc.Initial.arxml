[part 14 of 24: package /InitialEcuC]
AUTOSAR XML (schema 00053)
package /InitialEcuC  (continued)
  module config Com  (continued)
    ComConfig  (continued)
      242 x ComSignalGroup, all with ComTransferProperty=PENDING:  (continued)
        SG_Detections_373_376_oRDR_DETECTION_373_376_oPCAN_RADAR_9d9c6a96_Tx: ComSystemTemplateSignalGroupRef=SG_Detections_373_376
          83 x ComGroupSignal, all with ComSignalEndianness=LITTLE_ENDIAN, ComTransferProperty=PENDING:
            DET_AZIMUTH_373_oRDR_DETECTION_373_376_oPCAN_RADAR_ce7f6a6c_Tx: ComBitPosition=88, ComBitSize=13, ComSignalInitValue=0, ComSignalType=UINT16, ComSystemTemplateSystemSignalRef=DET_AZIMUTH_373
            DET_AZIMUTH_374_oRDR_DETECTION_373_376_oPCAN_RADAR_92cf4905_Tx: ComBitPosition=200, ComBitSize=13, ComSignalInitValue=0, ComSignalType=UINT16, ComSystemTemplateSystemSignalRef=DET_AZIMUTH_374
            DET_AZIMUTH_375_oRDR_DETECTION_373_376_oPCAN_RADAR_07bf9d90_Tx: ComBitPosition=312, ComBitSize=13, ComSignalInitValue=0, ComSignalType=UINT16, ComSystemTemplateSystemSignalRef=DET_AZIMUTH_375
            DET_AZIMUTH_376_oRDR_DETECTION_373_376_oPCAN_RADAR_635fe66e_Tx: ComBitPosition=424, ComBitSize=13, ComSignalInitValue=0, ComSignalType=UINT16, ComSystemTemplateSystemSignalRef=DET_AZIMUTH_376
            DET_AZIMUTH_ERR_373_oRDR_DETECTION_373_376_oPCAN_RADAR_6acaff99_Tx: ComBitPosition=105, ComBitSize=7, ComSignalInitValue=0, ComSignalType=UINT8, ComSystemTemplateSystemSignalRef=DET_AZIMUTH_ERR_373
            DET_AZIMUTH_ERR_374_oRDR_DETECTION_373_376_oPCAN_RADAR_367adcf0_Tx: ComBitPosition=217, ComBitSize=7, ComSignalInitValue=0, ComSignalType=UINT8, ComSystemTemplateSystemSignalRef=DET_AZIMUTH_ERR_374
            DET_AZIMUTH_ERR_375_oRDR_DETECTION_373_376_oPCAN_RADAR_a30a0865_Tx: ComBitPosition=329, ComBitSize=7, ComSignalInitValue=0, ComSignalType=UINT8, ComSystemTemplateSystemSignalRef=DET_AZIMUTH_ERR_375
            DET_AZIMUTH_ERR_376_oRDR_DETECTION_373_376_oPCAN_RADAR_c7ea739b_Tx: ComBitPosition=441, ComBitSize=7, ComSignalInitValue=0, ComSignalType=UINT8, ComSystemTemplateSystemSignalRef=DET_AZIMUTH_ERR_376
            DET_BELOW_RAIN_THOLD_373_oRDR_DETECTION_373_376_oPCAN_RADAR_1b7ef9ac_Tx: ComBitPosition=39, ComBitSize=1, ComSignalInitValue=0, ComSignalType=BOOLEAN, ComSystemTemplateSystemSignalRef=DET_BELOW_RAIN_THOLD_373
            DET_BELOW_RAIN_THOLD_374_oRDR_DETECTION_373_376_oPCAN_RADAR_47cedac5_Tx: ComBitPosition=151, ComBitSize=1, ComSignalInitValue=0, ComSignalType=BOOLEAN, ComSystemTemplateSystemSignalRef=DET_BELOW_RAIN_THOLD_374
            DET_BELOW_RAIN_THOLD_375_oRDR_DETECTION_373_376_oPCAN_RADAR_d2be0e50_Tx: ComBitPosition=263, ComBitSize=1, ComSignalInitValue=0, ComSignalType=BOOLEAN, ComSystemTemplateSystemSignalRef=DET_BELOW_RAIN_THOLD_375
            DET_BELOW_RAIN_THOLD_376_oRDR_DETECTION_373_376_oPCAN_RADAR_b65e75ae_Tx: ComBitPosition=375, ComBitSize=1, ComSignalInitValue=0, ComSignalType=BOOLEAN, ComSystemTemplateSystemSignalRef=DET_BELOW_RAIN_THOLD_376
            DET_BI_STATIC_FLAG_373_oRDR_DETECTION_373_376_oPCAN_RADAR_98532ae9_Tx: ComBitPosition=104, ComBitSize=1, ComSignalInitValue=0, ComSignalType=BOOLEAN, ComSystemTemplateSystemSignalRef=DET_BI_STATIC_FLAG_373
            DET_BI_STATIC_FLAG_374_oRDR_DETECTION_373_376_oPCAN_RADAR_c4e30980_Tx: ComBitPosition=216, ComBitSize=1, ComSignalInitValue=0, ComSignalType=BOOLEAN, ComSystemTemplateSystemSignalRef=DET_BI_STATIC_FLAG_374
            DET_BI_STATIC_FLAG_375_oRDR_DETECTION_373_376_oPCAN_RADAR_5193dd15_Tx: ComBitPosition=328, ComBitSize=1, ComSignalInitValue=0, ComSignalType=BOOLEAN, ComSystemTemplateSystemSignalRef=DET_BI_STATIC_FLAG_375
            DET_BI_STATIC_FLAG_376_oRDR_DETECTION_373_376_oPCAN_RADAR_3573a6eb_Tx: ComBitPosition=440, ComBitSize=1, ComSignalInitValue=0, ComSignalType=BOOLEAN, ComSystemTemplateSystemSignalRef=DET_BI_STATIC_FLAG_376
            DET_CONFD_AZIMUTH_373_oRDR_DETECTION_373_376_oPCAN_RADAR_cc9960a6_Tx: ComBitPosition=118, ComBitSize=2, ComSignalInitValue=0, ComSignalType=UINT8, ComSystemTemplateSystemSignalRef=DET_CONFD_AZIMUTH_373
            DET_CONFD_AZIMUTH_374_oRDR_DETECTION_373_376_oPCAN_RADAR_902943cf_Tx: ComBitPosition=230, ComBitSize=2, ComSignalInitValue=0, ComSignalType=UINT8, ComSystemTemplateSystemSignalRef=DET_CONFD_AZIMUTH_374
            DET_CONFD_AZIMUTH_375_oRDR_DETECTION_373_376_oPCAN_RADAR_0559975a_Tx: ComBitPosition=342, ComBitSize=2, ComSignalInitValue=0, ComSignalType=UINT8, ComSystemTemplateSystemSignalRef=DET_CONFD_AZIMUTH_375
            DET_CONFD_AZIMUTH_376_oRDR_DETECTION_373_376_oPCAN_RADAR_61b9eca4_Tx: ComBitPosition=454, ComBitSize=2, ComSignalInitValue=0, ComSignalType=UINT8, ComSystemTemplateSystemSignalRef=DET_CONFD_AZIMUTH_376
            DET_CONFD_ELEVATION_373_oRDR_DETECTION_373_376_oPCAN_RADAR_ce0c615c_Tx: ComBitPosition=101, ComBitSize=2, ComSignalInitValue=0, ComSignalType=UINT8, ComSystemTemplateSystemSignalRef=DET_CONFD_ELEVATION_373
            DET_CONFD_ELEVATION_374_oRDR_DETECTION_373_376_oPCAN_RADAR_92bc4235_Tx: ComBitPosition=213, ComBitSize=2, ComSignalInitValue=0, ComSignalType=UINT8, ComSystemTemplateSystemSignalRef=DET_CONFD_ELEVATION_374
            DET_CONFD_ELEVATION_375_oRDR_DETECTION_373_376_oPCAN_RADAR_07cc96a0_Tx: ComBitPosition=325, ComBitSize=2, ComSignalInitValue=0, ComSignalType=UINT8, ComSystemTemplateSystemSignalRef=DET_CONFD_ELEVATION_375
            DET_CONFD_ELEVATION_376_oRDR_DETECTION_373_376_oPCAN_RADAR_632ced5e_Tx: ComBitPosition=437, ComBitSize=2, ComSignalInitValue=0, ComSignalType=UINT8, ComSystemTemplateSystemSignalRef=DET_CONFD_ELEVATION_376
            DET_ELEVATION_373_oRDR_DETECTION_373_376_oPCAN_RADAR_1fccb560_Tx: ComBitPosition=72, ComBitSize=8, ComSignalInitValue=0, ComSignalType=UINT8, ComSystemTemplateSystemSignalRef=DET_ELEVATION_373
            DET_ELEVATION_374_oRDR_DETECTION_373_376_oPCAN_RADAR_437c9609_Tx: ComBitPosition=184, ComBitSize=8, ComSignalInitValue=0, ComSignalType=UINT8, ComSystemTemplateSystemSignalRef=DET_ELEVATION_374
            DET_ELEVATION_375_oRDR_DETECTION_373_376_oPCAN_RADAR_d60c429c_Tx: ComBitPosition=296, ComBitSize=8, ComSignalInitValue=0, ComSignalType=UINT8, ComSystemTemplateSystemSignalRef=DET_ELEVATION_375
            DET_ELEVATION_376_oRDR_DETECTION_373_376_oPCAN_RADAR_b2ec3962_Tx: ComBitPosition=408, ComBitSize=8, ComSignalInitValue=0, ComSignalType=UINT8, ComSystemTemplateSystemSignalRef=DET_ELEVATION_376
            DET_ELEVATION_ERR_373_oRDR_DETECTION_373_376_oPCAN_RADAR_98f52d15_Tx: ComBitPosition=80, ComBitSize=6, ComSignalInitValue=0, ComSignalType=UINT8, ComSystemTemplateSystemSignalRef=DET_ELEVATION_ERR_373
            DET_ELEVATION_ERR_374_oRDR_DETECTION_373_376_oPCAN_RADAR_c4450e7c_Tx: ComBitPosition=192, ComBitSize=6, ComSignalInitValue=0, ComSignalType=UINT8, ComSystemTemplateSystemSignalRef=DET_ELEVATION_ERR_374
            DET_ELEVATION_ERR_375_oRDR_DETECTION_373_376_oPCAN_RADAR_5135dae9_Tx: ComBitPosition=304, ComBitSize=6, ComSignalInitValue=0, ComSignalType=UINT8, ComSystemTemplateSystemSignalRef=DET_ELEVATION_ERR_375
            DET_ELEVATION_ERR_376_oRDR_DETECTION_373_376_oPCAN_RADAR_35d5a117_Tx: ComBitPosition=416, ComBitSize=6, ComSignalInitValue=0, ComSignalType=UINT8, ComSystemTemplateSystemSignalRef=DET_ELEVATION_ERR_376
            DET_EXISTENCE_PROB_373_oRDR_DETECTION_373_376_oPCAN_RADAR_4a6a5875_Tx: ComBitPosition=112, ComBitSize=6, ComSignalInitValue=0, ComSignalType=UINT8, ComSystemTemplateSystemSignalRef=DET_EXISTENCE_PROB_373
            DET_EXISTENCE_PROB_374_oRDR_DETECTION_373_376_oPCAN_RADAR_16da7b1c_Tx: ComBitPosition=224, ComBitSize=6, ComSignalInitValue=0, ComSignalType=UINT8, ComSystemTemplateSystemSignalRef=DET_EXISTENCE_PROB_374
            DET_EXISTENCE_PROB_375_oRDR_DETECTION_373_376_oPCAN_RADAR_83aaaf89_Tx: ComBitPosition=336, ComBitSize=6, ComSignalInitValue=0, ComSignalType=UINT8, ComSystemTemplateSystemSignalRef=DET_EXISTENCE_PROB_375
            DET_EXISTENCE_PROB_376_oRDR_DETECTION_373_376_oPCAN_RADAR_e74ad477_Tx: ComBitPosition=448, ComBitSize=6, ComSignalInitValue=0, ComSignalType=UINT8, ComSystemTemplateSystemSignalRef=DET_EXISTENCE_PROB_376
            DET_HVC_FLAG_373_oRDR_DETECTION_373_376_oPCAN_RADAR_ab1e1b0a_Tx: ComBitPosition=86, ComBitSize=1, ComSignalInitValue=0, ComSignalType=BOOLEAN, ComSystemTemplateSystemSignalRef=DET_HVC_FLAG_373
            DET_HVC_FLAG_374_oRDR_DETECTION_373_376_oPCAN_RADAR_f7ae3863_Tx: ComBitPosition=198, ComBitSize=1, ComSignalInitValue=0, ComSignalType=BOOLEAN, ComSystemTemplateSystemSignalRef=DET_HVC_FLAG_374
            DET_HVC_FLAG_375_oRDR_DETECTION_373_376_oPCAN_RADAR_62deecf6_Tx: ComBitPosition=310, ComBitSize=1, ComSignalInitValue=0, ComSignalType=BOOLEAN, ComSystemTemplateSystemSignalRef=DET_HVC_FLAG_375
            DET_HVC_FLAG_376_oRDR_DETECTION_373_376_oPCAN_RADAR_063e9708_Tx: ComBitPosition=422, ComBitSize=1, ComSignalInitValue=0, ComSignalType=BOOLEAN, ComSystemTemplateSystemSignalRef=DET_HVC_FLAG_376
            DET_IDM_373_oRDR_DETECTION_373_376_oPCAN_RADAR_204c20b7_Tx: ComBitPosition=63, ComBitSize=1, ComSignalInitValue=0, ComSignalType=BOOLEAN, ComSystemTemplateSystemSignalRef=DET_IDM_373
            DET_IDM_374_oRDR_DETECTION_373_376_oPCAN_RADAR_7cfc03de_Tx: ComBitPosition=175, ComBitSize=1, ComSignalInitValue=0, ComSignalType=BOOLEAN, ComSystemTemplateSystemSignalRef=DET_IDM_374
            DET_IDM_375_oRDR_DETECTION_373_376_oPCAN_RADAR_e98cd74b_Tx: ComBitPosition=287, ComBitSize=1, ComSignalInitValue=0, ComSignalType=BOOLEAN, ComSystemTemplateSystemSignalRef=DET_IDM_375
            DET_IDM_376_oRDR_DETECTION_373_376_oPCAN_RADAR_8d6cacb5_Tx: ComBitPosition=399, ComBitSize=1, ComSignalInitValue=0, ComSignalType=BOOLEAN, ComSystemTemplateSystemSignalRef=DET_IDM_376
            DET_MH_CRC16_373_376_oRDR_DETECTION_373_376_oPCAN_RADAR_1914b89d_Tx: ComBitPosition=0, ComBitSize=16, ComSignalInitValue=0, ComSignalType=UINT16, ComSystemTemplateSystemSignalRef=DET_MH_CRC16_373_376
            DET_MH_CYCLE_COUNTER_373_376_oRDR_DETECTION_373_376_oPCAN_RADAR_9d6119aa_Tx: ComBitPosition=16, ComBitSize=8, ComSignalInitValue=0, ComSignalType=UINT8, ComSystemTemplateSystemSignalRef=DET_MH_CYCLE_COUNTER_373_376
            DET_MH_SCAN_INDEX_4LSB_373_376_oRDR_DETECTION_373_376_oPCAN_RADAR_514b3c26_Tx: ComBitPosition=476, ComBitSize=4, ComSignalInitValue=0, ComSignalType=UINT8, ComSystemTemplateSystemSignalRef=DET_MH_SCAN_INDEX_4LSB_373_376
            DET_MTD_373_oRDR_DETECTION_373_376_oPCAN_RADAR_46ff126c_Tx: ComBitPosition=47, ComBitSize=1, ComSignalInitValue=0, ComSignalType=BOOLEAN, ComSystemTemplateSystemSignalRef=DET_MTD_373
            DET_MTD_374_oRDR_DETECTION_373_376_oPCAN_RADAR_1a4f3105_Tx: ComBitPosition=159, ComBitSize=1, ComSignalInitValue=0, ComSignalType=BOOLEAN, ComSystemTemplateSystemSignalRef=DET_MTD_374
            DET_MTD_375_oRDR_DETECTION_373_376_oPCAN_RADAR_8f3fe590_Tx: ComBitPosition=271, ComBitSize=1, ComSignalInitValue=0, ComSignalType=BOOLEAN, ComSystemTemplateSystemSignalRef=DET_MTD_375
            DET_MTD_376_oRDR_DETECTION_373_376_oPCAN_RADAR_ebdf9e6e_Tx: ComBitPosition=383, ComBitSize=1, ComSignalInitValue=0, ComSignalType=BOOLEAN, ComSystemTemplateSystemSignalRef=DET_MTD_376
            DET_PROB_1STAZHYPO_373_oRDR_DETECTION_373_376_oPCAN_RADAR_d54bfaa1_Tx: ComBitPosition=103, ComBitSize=1, ComSignalInitValue=0, ComSignalType=BOOLEAN, ComSystemTemplateSystemSignalRef=DET_PROB_1STAZHYPO_373
            DET_PROB_1STAZHYPO_374_oRDR_DETECTION_373_376_oPCAN_RADAR_89fbd9c8_Tx: ComBitPosition=215, ComBitSize=1, ComSignalInitValue=0, ComSignalType=BOOLEAN, ComSystemTemplateSystemSignalRef=DET_PROB_1STAZHYPO_374
            DET_PROB_1STAZHYPO_375_oRDR_DETECTION_373_376_oPCAN_RADAR_1c8b0d5d_Tx: ComBitPosition=327, ComBitSize=1, ComSignalInitValue=0, ComSignalType=BOOLEAN, ComSystemTemplateSystemSignalRef=DET_PROB_1STAZHYPO_375
            DET_PROB_1STAZHYPO_376_oRDR_DETECTION_373_376_oPCAN_RADAR_786b76a3_Tx: ComBitPosition=439, ComBitSize=1, ComSignalInitValue=0, ComSignalType=BOOLEAN, ComSystemTemplateSystemSignalRef=DET_PROB_1STAZHYPO_376
            DET_RANGE_373_oRDR_DETECTION_373_376_oPCAN_RADAR_dee419d7_Tx: ComBitPosition=24, ComBitSize=15, ComSignalInitValue=0, ComSignalType=UINT16, ComSystemTemplateSystemSignalRef=DET_RANGE_373
            DET_RANGE_374_oRDR_DETECTION_373_376_oPCAN_RADAR_82543abe_Tx: ComBitPosition=136, ComBitSize=15, ComSignalInitValue=0, ComSignalType=UINT16, ComSystemTemplateSystemSignalRef=DET_RANGE_374
            DET_RANGE_375_oRDR_DETECTION_373_376_oPCAN_RADAR_1724ee2b_Tx: ComBitPosition=248, ComBitSize=15, ComSignalInitValue=0, ComSignalType=UINT16, ComSystemTemplateSystemSignalRef=DET_RANGE_375
            DET_RANGE_376_oRDR_DETECTION_373_376_oPCAN_RADAR_73c495d5_Tx: ComBitPosition=360, ComBitSize=15, ComSignalInitValue=0, ComSignalType=UINT16, ComSystemTemplateSystemSignalRef=DET_RANGE_376
            DET_RANGE_ERR_373_oRDR_DETECTION_373_376_oPCAN_RADAR_790ca3be_Tx: ComBitPosition=40, ComBitSize=7, ComSignalInitValue=0, ComSignalType=UINT8, ComSystemTemplateSystemSignalRef=DET_RANGE_ERR_373
            DET_RANGE_ERR_374_oRDR_DETECTION_373_376_oPCAN_RADAR_25bc80d7_Tx: ComBitPosition=152, ComBitSize=7, ComSignalInitValue=0, ComSignalType=UINT8, ComSystemTemplateSystemSignalRef=DET_RANGE_ERR_374
            DET_RANGE_ERR_375_oRDR_DETECTION_373_376_oPCAN_RADAR_b0cc5442_Tx: ComBitPosition=264, ComBitSize=7, ComSignalInitValue=0, ComSignalType=UINT8, ComSystemTemplateSystemSignalRef=DET_RANGE_ERR_375
            DET_RANGE_ERR_376_oRDR_DETECTION_373_376_oPCAN_RADAR_d42c2fbc_Tx: ComBitPosition=376, ComBitSize=7, ComSignalInitValue=0, ComSignalType=UINT8, ComSystemTemplateSystemSignalRef=DET_RANGE_ERR_376
            DET_RANGE_VELOCITY_373_oRDR_DETECTION_373_376_oPCAN_RADAR_ab42dbf2_Tx: ComBitPosition=48, ComBitSize=15, ComSignalInitValue=16384, ComSignalType=UINT16, ComSystemTemplateSystemSignalRef=DET_RANGE_VELOCITY_373
            DET_RANGE_VELOCITY_374_oRDR_DETECTION_373_376_oPCAN_RADAR_f7f2f89b_Tx: ComBitPosition=160, ComBitSize=15, ComSignalInitValue=16384, ComSignalType=UINT16, ComSystemTemplateSystemSignalRef=DET_RANGE_VELOCITY_374
            DET_RANGE_VELOCITY_375_oRDR_DETECTION_373_376_oPCAN_RADAR_62822c0e_Tx: ComBitPosition=272, ComBitSize=15, ComSignalInitValue=16384, ComSignalType=UINT16, ComSystemTemplateSystemSignalRef=DET_RANGE_VELOCITY_375
            DET_RANGE_VELOCITY_376_oRDR_DETECTION_373_376_oPCAN_RADAR_066257f0_Tx: ComBitPosition=384, ComBitSize=15, ComSignalInitValue=16384, ComSignalType=UINT16, ComSystemTemplateSystemSignalRef=DET_RANGE_VELOCITY_376
            DET_RANGE_VELOCITY_ERR_373_oRDR_DETECTION_373_376_oPCAN_RADAR_a4f92040_Tx: ComBitPosition=64, ComBitSize=8, ComSignalInitValue=0, ComSignalType=UINT8, ComSystemTemplateSystemSignalRef=DET_RANGE_VELOCITY_ERR_373
            DET_RANGE_VELOCITY_ERR_374_oRDR_DETECTION_373_376_oPCAN_RADAR_f8490329_Tx: ComBitPosition=176, ComBitSize=8, ComSignalInitValue=0, ComSignalType=UINT8, ComSystemTemplateSystemSignalRef=DET_RANGE_VELOCITY_ERR_374
            DET_RANGE_VELOCITY_ERR_375_oRDR_DETECTION_373_376_oPCAN_RADAR_6d39d7bc_Tx: ComBitPosition=288, ComBitSize=8, ComSignalInitValue=0, ComSignalType=UINT8, ComSystemTemplateSystemSignalRef=DET_RANGE_VELOCITY_ERR_375
            DET_RANGE_VELOCITY_ERR_376_oRDR_DETECTION_373_376_oPCAN_RADAR_09d9ac42_Tx: ComBitPosition=400, ComBitSize=8, ComSignalInitValue=0, ComSignalType=UINT8, ComSystemTemplateSystemSignalRef=DET_RANGE_VELOCITY_ERR_376
            DET_RCS_373_oRDR_DETECTION_373_376_oPCAN_RADAR_2cc2eca8_Tx: ComBitPosition=128, ComBitSize=8, ComSignalInitValue=128, ComSignalType=UINT8, ComSystemTemplateSystemSignalRef=DET_RCS_373
            DET_RCS_374_oRDR_DETECTION_373_376_oPCAN_RADAR_7072cfc1_Tx: ComBitPosition=240, ComBitSize=8, ComSignalInitValue=128, ComSignalType=UINT8, ComSystemTemplateSystemSignalRef=DET_RCS_374
            DET_RCS_375_oRDR_DETECTION_373_376_oPCAN_RADAR_e5021b54_Tx: ComBitPosition=352, ComBitSize=8, ComSignalInitValue=128, ComSignalType=UINT8, ComSystemTemplateSystemSignalRef=DET_RCS_375
            DET_RCS_376_oRDR_DETECTION_373_376_oPCAN_RADAR_81e260aa_Tx: ComBitPosition=464, ComBitSize=8, ComSignalInitValue=128, ComSignalType=UINT8, ComSystemTemplateSystemSignalRef=DET_RCS_376
            DET_SNR_373_oRDR_DETECTION_373_376_oPCAN_RADAR_f16cb8aa_Tx: ComBitPosition=120, ComBitSize=8, ComSignalInitValue=0, ComSignalType=UINT8, ComSystemTemplateSystemSignalRef=DET_SNR_373
            DET_SNR_374_oRDR_DETECTION_373_376_oPCAN_RADAR_addc9bc3_Tx: ComBitPosition=232, ComBitSize=8, ComSignalInitValue=0, ComSignalType=UINT8, ComSystemTemplateSystemSignalRef=DET_SNR_374
            DET_SNR_375_oRDR_DETECTION_373_376_oPCAN_RADAR_38ac4f56_Tx: ComBitPosition=344, ComBitSize=8, ComSignalInitValue=0, ComSignalType=UINT8, ComSystemTemplateSystemSignalRef=DET_SNR_375
            DET_SNR_376_oRDR_DETECTION_373_376_oPCAN_RADAR_5c4c34a8_Tx: ComBitPosition=456, ComBitSize=8, ComSignalInitValue=0, ComSignalType=UINT8, ComSystemTemplateSystemSignalRef=DET_SNR_376
            DET_SUPER_RES_TARGET_373_oRDR_DETECTION_373_376_oPCAN_RADAR_c0f590cf_Tx: ComBitPosition=87, ComBitSize=1, ComSignalInitValue=0, ComSignalType=BOOLEAN, ComSystemTemplateSystemSignalRef=DET_SUPER_RES_TARGET_373
            DET_SUPER_RES_TARGET_374_oRDR_DETECTION_373_376_oPCAN_RADAR_9c45b3a6_Tx: ComBitPosition=199, ComBitSize=1, ComSignalInitValue=0, ComSignalType=BOOLEAN, ComSystemTemplateSystemSignalRef=DET_SUPER_RES_TARGET_374
            DET_SUPER_RES_TARGET_375_oRDR_DETECTION_373_376_oPCAN_RADAR_09356733_Tx: ComBitPosition=311, ComBitSize=1, ComSignalInitValue=0, ComSignalType=BOOLEAN, ComSystemTemplateSystemSignalRef=DET_SUPER_RES_TARGET_375
            DET_SUPER_RES_TARGET_376_oRDR_DETECTION_373_376_oPCAN_RADAR_6dd51ccd_Tx: ComBitPosition=423, ComBitSize=1, ComSignalInitValue=0, ComSignalType=BOOLEAN, ComSystemTemplateSystemSignalRef=DET_SUPER_RES_TARGET_376
        SG_Detections_377_380_oRDR_DETECTION_377_380_oPCAN_RADAR_e93056f0_Tx: ComSystemTemplateSignalGroupRef=SG_Detections_377_380
          83 x ComGroupSignal, all with ComSignalEndianness=LITTLE_ENDIAN, ComTransferProperty=PENDING:
            DET_AZIMUTH_377_oRDR_DETECTION_377_380_oPCAN_RADAR_73567e1f_Tx: ComBitPosition=88, ComBitSize=13, ComSignalInitValue=0, ComSignalType=UINT16, ComSystemTemplateSystemSignalRef=DET_AZIMUTH_377
            DET_AZIMUTH_378_oRDR_DETECTION_377_380_oPCAN_RADAR_5f46ec58_Tx: ComBitPosition=200, ComBitSize=13, ComSignalInitValue=0, ComSignalType=UINT16, ComSystemTemplateSystemSignalRef=DET_AZIMUTH_378
            DET_AZIMUTH_379_oRDR_DETECTION_377_380_oPCAN_RADAR_ca3638cd_Tx: ComBitPosition=312, ComBitSize=13, ComSignalInitValue=0, ComSignalType=UINT16, ComSystemTemplateSystemSignalRef=DET_AZIMUTH_379
            DET_AZIMUTH_380_oRDR_DETECTION_377_380_oPCAN_RADAR_c77299d7_Tx: ComBitPosition=424, ComBitSize=13, ComSignalInitValue=0, ComSignalType=UINT16, ComSystemTemplateSystemSignalRef=DET_AZIMUTH_380
            DET_AZIMUTH_ERR_377_oRDR_DETECTION_377_380_oPCAN_RADAR_d7e3ebea_Tx: ComBitPosition=105, ComBitSize=7, ComSignalInitValue=0, ComSignalType=UINT8, ComSystemTemplateSystemSignalRef=DET_AZIMUTH_ERR_377
            DET_AZIMUTH_ERR_378_oRDR_DETECTION_377_380_oPCAN_RADAR_fbf379ad_Tx: ComBitPosition=217, ComBitSize=7, ComSignalInitValue=0, ComSignalType=UINT8, ComSystemTemplateSystemSignalRef=DET_AZIMUTH_ERR_378
            DET_AZIMUTH_ERR_379_oRDR_DETECTION_377_380_oPCAN_RADAR_6e83ad38_Tx: ComBitPosition=329, ComBitSize=7, ComSignalInitValue=0, ComSignalType=UINT8, ComSystemTemplateSystemSignalRef=DET_AZIMUTH_ERR_379
            DET_AZIMUTH_ERR_380_oRDR_DETECTION_377_380_oPCAN_RADAR_63c70c22_Tx: ComBitPosition=441, ComBitSize=7, ComSignalInitValue=0, ComSignalType=UINT8, ComSystemTemplateSystemSignalRef=DET_AZIMUTH_ERR_380
            DET_BELOW_RAIN_THOLD_377_oRDR_DETECTION_377_380_oPCAN_RADAR_a657eddf_Tx: ComBitPosition=39, ComBitSize=1, ComSignalInitValue=0, ComSignalType=BOOLEAN, ComSystemTemplateSystemSignalRef=DET_BELOW_RAIN_THOLD_377
            DET_BELOW_RAIN_THOLD_378_oRDR_DETECTION_377_380_oPCAN_RADAR_8a477f98_Tx: ComBitPosition=151, ComBitSize=1, ComSignalInitValue=0, ComSignalType=BOOLEAN, ComSystemTemplateSystemSignalRef=DET_BELOW_RAIN_THOLD_378
            DET_BELOW_RAIN_THOLD_379_oRDR_DETECTION_377_380_oPCAN_RADAR_1f37ab0d_Tx: ComBitPosition=263, ComBitSize=1, ComSignalInitValue=0, ComSignalType=BOOLEAN, ComSystemTemplateSystemSignalRef=DET_BELOW_RAIN_THOLD_379
            DET_BELOW_RAIN_THOLD_380_oRDR_DETECTION_377_380_oPCAN_RADAR_12730a17_Tx: ComBitPosition=375, ComBitSize=1, ComSignalInitValue=0, ComSignalType=BOOLEAN, ComSystemTemplateSystemSignalRef=DET_BELOW_RAIN_THOLD_380
            DET_BI_STATIC_FLAG_377_oRDR_DETECTION_377_380_oPCAN_RADAR_257a3e9a_Tx: ComBitPosition=104, ComBitSize=1, ComSignalInitValue=0, ComSignalType=BOOLEAN, ComSystemTemplateSystemSignalRef=DET_BI_STATIC_FLAG_377
            DET_BI_STATIC_FLAG_378_oRDR_DETECTION_377_380_oPCAN_RADAR_096aacdd_Tx: ComBitPosition=216, ComBitSize=1, ComSignalInitValue=0, ComSignalType=BOOLEAN, ComSystemTemplateSystemSignalRef=DET_BI_STATIC_FLAG_378
            DET_BI_STATIC_FLAG_379_oRDR_DETECTION_377_380_oPCAN_RADAR_9c1a7848_Tx: ComBitPosition=328, ComBitSize=1, ComSignalInitValue=0, ComSignalType=BOOLEAN, ComSystemTemplateSystemSignalRef=DET_BI_STATIC_FLAG_379
            DET_BI_STATIC_FLAG_380_oRDR_DETECTION_377_380_oPCAN_RADAR_915ed952_Tx: ComBitPosition=440, ComBitSize=1, ComSignalInitValue=0, ComSignalType=BOOLEAN, ComSystemTemplateSystemSignalRef=DET_BI_STATIC_FLAG_380
            DET_CONFD_AZIMUTH_377_oRDR_DETECTION_377_380_oPCAN_RADAR_71b074d5_Tx: ComBitPosition=118, ComBitSize=2, ComSignalInitValue=0, ComSignalType=UINT8, ComSystemTemplateSystemSignalRef=DET_CONFD_AZIMUTH_377
            DET_CONFD_AZIMUTH_378_oRDR_DETECTION_377_380_oPCAN_RADAR_5da0e692_Tx: ComBitPosition=230, ComBitSize=2, ComSignalInitValue=0, ComSignalType=UINT8, ComSystemTemplateSystemSignalRef=DET_CONFD_AZIMUTH_378
            DET_CONFD_AZIMUTH_379_oRDR_DETECTION_377_380_oPCAN_RADAR_c8d03207_Tx: ComBitPosition=342, ComBitSize=2, ComSignalInitValue=0, ComSignalType=UINT8, ComSystemTemplateSystemSignalRef=DET_CONFD_AZIMUTH_379
            DET_CONFD_AZIMUTH_380_oRDR_DETECTION_377_380_oPCAN_RADAR_c594931d_Tx: ComBitPosition=454, ComBitSize=2, ComSignalInitValue=0, ComSignalType=UINT8, ComSystemTemplateSystemSignalRef=DET_CONFD_AZIMUTH_380
            DET_CONFD_ELEVATION_377_oRDR_DETECTION_377_380_oPCAN_RADAR_7325752f_Tx: ComBitPosition=101, ComBitSize=2, ComSignalInitValue=0, ComSignalType=UINT8, ComSystemTemplateSystemSignalRef=DET_CONFD_ELEVATION_377
            DET_CONFD_ELEVATION_378_oRDR_DETECTION_377_380_oPCAN_RADAR_5f35e768_Tx: ComBitPosition=213, ComBitSize=2, ComSignalInitValue=0, ComSignalType=UINT8, ComSystemTemplateSystemSignalRef=DET_CONFD_ELEVATION_378
            DET_CONFD_ELEVATION_379_oRDR_DETECTION_377_380_oPCAN_RADAR_ca4533fd_Tx: ComBitPosition=325, ComBitSize=2, ComSignalInitValue=0, ComSignalType=UINT8, ComSystemTemplateSystemSignalRef=DET_CONFD_ELEVATION_379
            DET_CONFD_ELEVATION_380_oRDR_DETECTION_377_380_oPCAN_RADAR_c70192e7_Tx: ComBitPosition=437, ComBitSize=2, ComSignalInitValue=0, ComSignalType=UINT8, ComSystemTemplateSystemSignalRef=DET_CONFD_ELEVATION_380
            DET_ELEVATION_377_oRDR_DETECTION_377_380_oPCAN_RADAR_a2e5a113_Tx: ComBitPosition=72, ComBitSize=8, ComSignalInitValue=0, ComSignalType=UINT8, ComSystemTemplateSystemSignalRef=DET_ELEVATION_377
            DET_ELEVATION_378_oRDR_DETECTION_377_380_oPCAN_RADAR_8ef53354_Tx: ComBitPosition=184, ComBitSize=8, ComSignalInitValue=0, ComSignalType=UINT8, ComSystemTemplateSystemSignalRef=DET_ELEVATION_378
            DET_ELEVATION_379_oRDR_DETECTION_377_380_oPCAN_RADAR_1b85e7c1_Tx: ComBitPosition=296, ComBitSize=8, ComSignalInitValue=0, ComSignalType=UINT8, ComSystemTemplateSystemSignalRef=DET_ELEVATION_379
            DET_ELEVATION_380_oRDR_DETECTION_377_380_oPCAN_RADAR_16c146db_Tx: ComBitPosition=408, ComBitSize=8, ComSignalInitValue=0, ComSignalType=UINT8, ComSystemTemplateSystemSignalRef=DET_ELEVATION_380
            DET_ELEVATION_ERR_377_oRDR_DETECTION_377_380_oPCAN_RADAR_25dc3966_Tx: ComBitPosition=80, ComBitSize=6, ComSignalInitValue=0, ComSignalType=UINT8, ComSystemTemplateSystemSignalRef=DET_ELEVATION_ERR_377
            DET_ELEVATION_ERR_378_oRDR_DETECTION_377_380_oPCAN_RADAR_09ccab21_Tx: ComBitPosition=192, ComBitSize=6, ComSignalInitValue=0, ComSignalType=UINT8, ComSystemTemplateSystemSignalRef=DET_ELEVATION_ERR_378
            DET_ELEVATION_ERR_379_oRDR_DETECTION_377_380_oPCAN_RADAR_9cbc7fb4_Tx: ComBitPosition=304, ComBitSize=6, ComSignalInitValue=0, ComSignalType=UINT8, ComSystemTemplateSystemSignalRef=DET_ELEVATION_ERR_379
            DET_ELEVATION_ERR_380_oRDR_DETECTION_377_380_oPCAN_RADAR_91f8deae_Tx: ComBitPosition=416, ComBitSize=6, ComSignalInitValue=0, ComSignalType=UINT8, ComSystemTemplateSystemSignalRef=DET_ELEVATION_ERR_380
            DET_EXISTENCE_PROB_377_oRDR_DETECTION_377_380_oPCAN_RADAR_f7434c06_Tx: ComBitPosition=112, ComBitSize=6, ComSignalInitValue=0, ComSignalType=UINT8, ComSystemTemplateSystemSignalRef=DET_EXISTENCE_PROB_377
            DET_EXISTENCE_PROB_378_oRDR_DETECTION_377_380_oPCAN_RADAR_db53de41_Tx: ComBitPosition=224, ComBitSize=6, ComSignalInitValue=0, ComSignalType=UINT8, ComSystemTemplateSystemSignalRef=DET_EXISTENCE_PROB_378
            DET_EXISTENCE_PROB_379_oRDR_DETECTION_377_380_oPCAN_RADAR_4e230ad4_Tx: ComBitPosition=336, ComBitSize=6, ComSignalInitValue=0, ComSignalType=UINT8, ComSystemTemplateSystemSignalRef=DET_EXISTENCE_PROB_379
            DET_EXISTENCE_PROB_380_oRDR_DETECTION_377_380_oPCAN_RADAR_4367abce_Tx: ComBitPosition=448, ComBitSize=6, ComSignalInitValue=0, ComSignalType=UINT8, ComSystemTemplateSystemSignalRef=DET_EXISTENCE_PROB_380
            DET_HVC_FLAG_377_oRDR_DETECTION_377_380_oPCAN_RADAR_16370f79_Tx: ComBitPosition=86, ComBitSize=1, ComSignalInitValue=0, ComSignalType=BOOLEAN, ComSystemTemplateSystemSignalRef=DET_HVC_FLAG_377
            DET_HVC_FLAG_378_oRDR_DETECTION_377_380_oPCAN_RADAR_3a279d3e_Tx: ComBitPosition=198, ComBitSize=1, ComSignalInitValue=0, ComSignalType=BOOLEAN, ComSystemTemplateSystemSignalRef=DET_HVC_FLAG_378
            DET_HVC_FLAG_379_oRDR_DETECTION_377_380_oPCAN_RADAR_af5749ab_Tx: ComBitPosition=310, ComBitSize=1, ComSignalInitValue=0, ComSignalType=BOOLEAN, ComSystemTemplateSystemSignalRef=DET_HVC_FLAG_379
            DET_HVC_FLAG_380_oRDR_DETECTION_377_380_oPCAN_RADAR_a213e8b1_Tx: ComBitPosition=422, ComBitSize=1, ComSignalInitValue=0, ComSignalType=BOOLEAN, ComSystemTemplateSystemSignalRef=DET_HVC_FLAG_380
            DET_IDM_377_oRDR_DETECTION_377_380_oPCAN_RADAR_9d6534c4_Tx: ComBitPosition=63, ComBitSize=1, ComSignalInitValue=0, ComSignalType=BOOLEAN, ComSystemTemplateSystemSignalRef=DET_IDM_377
            DET_IDM_378_oRDR_DETECTION_377_380_oPCAN_RADAR_b175a683_Tx: ComBitPosition=175, ComBitSize=1, ComSignalInitValue=0, ComSignalType=BOOLEAN, ComSystemTemplateSystemSignalRef=DET_IDM_378
            DET_IDM_379_oRDR_DETECTION_377_380_oPCAN_RADAR_24057216_Tx: ComBitPosition=287, ComBitSize=1, ComSignalInitValue=0, ComSignalType=BOOLEAN, ComSystemTemplateSystemSignalRef=DET_IDM_379
            DET_IDM_380_oRDR_DETECTION_377_380_oPCAN_RADAR_2941d30c_Tx: ComBitPosition=399, ComBitSize=1, ComSignalInitValue=0, ComSignalType=BOOLEAN, ComSystemTemplateSystemSignalRef=DET_IDM_380
            DET_MH_CRC16_377_380_oRDR_DETECTION_377_380_oPCAN_RADAR_6db884fb_Tx: ComBitPosition=0, ComBitSize=16, ComSignalInitValue=0, ComSignalType=UINT16, ComSystemTemplateSystemSignalRef=DET_MH_CRC16_377_380
            DET_MH_CYCLE_COUNTER_377_380_oRDR_DETECTION_377_380_oPCAN_RADAR_e9cd25cc_Tx: ComBitPosition=16, ComBitSize=8, ComSignalInitValue=0, ComSignalType=UINT8, ComSystemTemplateSystemSignalRef=DET_MH_CYCLE_COUNTER_377_380
            DET_MH_SCAN_INDEX_4LSB_377_380_oRDR_DETECTION_377_380_oPCAN_RADAR_25e70040_Tx: ComBitPosition=476, ComBitSize=4, ComSignalInitValue=0, ComSignalType=UINT8, ComSystemTemplateSystemSignalRef=DET_MH_SCAN_INDEX_4LSB_377_380
            DET_MTD_377_oRDR_DETECTION_377_380_oPCAN_RADAR_fbd6061f_Tx: ComBitPosition=47, ComBitSize=1, ComSignalInitValue=0, ComSignalType=BOOLEAN, ComSystemTemplateSystemSignalRef=DET_MTD_377
            DET_MTD_378_oRDR_DETECTION_377_380_oPCAN_RADAR_d7c69458_Tx: ComBitPosition=159, ComBitSize=1, ComSignalInitValue=0, ComSignalType=BOOLEAN, ComSystemTemplateSystemSignalRef=DET_MTD_378
            DET_MTD_379_oRDR_DETECTION_377_380_oPCAN_RADAR_42b640cd_Tx: ComBitPosition=271, ComBitSize=1, ComSignalInitValue=0, ComSignalType=BOOLEAN, ComSystemTemplateSystemSignalRef=DET_MTD_379
            DET_MTD_380_oRDR_DETECTION_377_380_oPCAN_RADAR_4ff2e1d7_Tx: ComBitPosition=383, ComBitSize=1, ComSignalInitValue=0, ComSignalType=BOOLEAN, ComSystemTemplateSystemSignalRef=DET_MTD_380
            DET_PROB_1STAZHYPO_377_oRDR_DETECTION_377_380_oPCAN_RADAR_6862eed2_Tx: ComBitPosition=103, ComBitSize=1, ComSignalInitValue=0, ComSignalType=BOOLEAN, ComSystemTemplateSystemSignalRef=DET_PROB_1STAZHYPO_377
            DET_PROB_1STAZHYPO_378_oRDR_DETECTION_377_380_oPCAN_RADAR_44727c95_Tx: ComBitPosition=215, ComBitSize=1, ComSignalInitValue=0, ComSignalType=BOOLEAN, ComSystemTemplateSystemSignalRef=DET_PROB_1STAZHYPO_378
            DET_PROB_1STAZHYPO_379_oRDR_DETECTION_377_380_oPCAN_RADAR_d102a800_Tx: ComBitPosition=327, ComBitSize=1, ComSignalInitValue=0, ComSignalType=BOOLEAN, ComSystemTemplateSystemSignalRef=DET_PROB_1STAZHYPO_379
            DET_PROB_1STAZHYPO_380_oRDR_DETECTION_377_380_oPCAN_RADAR_dc46091a_Tx: ComBitPosition=439, ComBitSize=1, ComSignalInitValue=0, ComSignalType=BOOLEAN, ComSystemTemplateSystemSignalRef=DET_PROB_1STAZHYPO_380
            DET_RANGE_377_oRDR_DETECTION_377_380_oPCAN_RADAR_63cd0da4_Tx: ComBitPosition=24, ComBitSize=15, ComSignalInitValue=0, ComSignalType=UINT16, ComSystemTemplateSystemSignalRef=DET_RANGE_377
            DET_RANGE_378_oRDR_DETECTION_377_380_oPCAN_RADAR_4fdd9fe3_Tx: ComBitPosition=136, ComBitSize=15, ComSignalInitValue=0, ComSignalType=UINT16, ComSystemTemplateSystemSignalRef=DET_RANGE_378
            DET_RANGE_379_oRDR_DETECTION_377_380_oPCAN_RADAR_daad4b76_Tx: ComBitPosition=248, ComBitSize=15, ComSignalInitValue=0, ComSignalType=UINT16, ComSystemTemplateSystemSignalRef=DET_RANGE_379
            DET_RANGE_380_oRDR_DETECTION_377_380_oPCAN_RADAR_d7e9ea6c_Tx: ComBitPosition=360, ComBitSize=15, ComSignalInitValue=0, ComSignalType=UINT16, ComSystemTemplateSystemSignalRef=DET_RANGE_380
            DET_RANGE_ERR_377_oRDR_DETECTION_377_380_oPCAN_RADAR_c425b7cd_Tx: ComBitPosition=40, ComBitSize=7, ComSignalInitValue=0, ComSignalType=UINT8, ComSystemTemplateSystemSignalRef=DET_RANGE_ERR_377
            DET_RANGE_ERR_378_oRDR_DETECTION_377_380_oPCAN_RADAR_e835258a_Tx: ComBitPosition=152, ComBitSize=7, ComSignalInitValue=0, ComSignalType=UINT8, ComSystemTemplateSystemSignalRef=DET_RANGE_ERR_378
            DET_RANGE_ERR_379_oRDR_DETECTION_377_380_oPCAN_RADAR_7d45f11f_Tx: ComBitPosition=264, ComBitSize=7, ComSignalInitValue=0, ComSignalType=UINT8, ComSystemTemplateSystemSignalRef=DET_RANGE_ERR_379
            DET_RANGE_ERR_380_oRDR_DETECTION_377_380_oPCAN_RADAR_70015005_Tx: ComBitPosition=376, ComBitSize=7, ComSignalInitValue=0, ComSignalType=UINT8, ComSystemTemplateSystemSignalRef=DET_RANGE_ERR_380
            DET_RANGE_VELOCITY_377_oRDR_DETECTION_377_380_oPCAN_RADAR_166bcf81_Tx: ComBitPosition=48, ComBitSize=15, ComSignalInitValue=16384, ComSignalType=UINT16, ComSystemTemplateSystemSignalRef=DET_RANGE_VELOCITY_377
            DET_RANGE_VELOCITY_378_oRDR_DETECTION_377_380_oPCAN_RADAR_3a7b5dc6_Tx: ComBitPosition=160, ComBitSize=15, ComSignalInitValue=16384, ComSignalType=UINT16, ComSystemTemplateSystemSignalRef=DET_RANGE_VELOCITY_378
            DET_RANGE_VELOCITY_379_oRDR_DETECTION_377_380_oPCAN_RADAR_af0b8953_Tx: ComBitPosition=272, ComBitSize=15, ComSignalInitValue=16384, ComSignalType=UINT16, ComSystemTemplateSystemSignalRef=DET_RANGE_VELOCITY_379
            DET_RANGE_VELOCITY_380_oRDR_DETECTION_377_380_oPCAN_RADAR_a24f2849_Tx: ComBitPosition=384, ComBitSize=15, ComSignalInitValue=16384, ComSignalType=UINT16, ComSystemTemplateSystemSignalRef=DET_RANGE_VELOCITY_380
            DET_RANGE_VELOCITY_ERR_377_oRDR_DETECTION_377_380_oPCAN_RADAR_19d03433_Tx: ComBitPosition=64, ComBitSize=8, ComSignalInitValue=0, ComSignalType=UINT8, ComSystemTemplateSystemSignalRef=DET_RANGE_VELOCITY_ERR_377
            DET_RANGE_VELOCITY_ERR_378_oRDR_DETECTION_377_380_oPCAN_RADAR_35c0a674_Tx: ComBitPosition=176, ComBitSize=8, ComSignalInitValue=0, ComSignalType=UINT8, ComSystemTemplateSystemSignalRef=DET_RANGE_VELOCITY_ERR_378
            DET_RANGE_VELOCITY_ERR_379_oRDR_DETECTION_377_380_oPCAN_RADAR_a0b072e1_Tx: ComBitPosition=288, ComBitSize=8, ComSignalInitValue=0, ComSignalType=UINT8, ComSystemTemplateSystemSignalRef=DET_RANGE_VELOCITY_ERR_379
            DET_RANGE_VELOCITY_ERR_380_oRDR_DETECTION_377_380_oPCAN_RADAR_adf4d3fb_Tx: ComBitPosition=400, ComBitSize=8, ComSignalInitValue=0, ComSignalType=UINT8, ComSystemTemplateSystemSignalRef=DET_RANGE_VELOCITY_ERR_380
            DET_RCS_377_oRDR_DETECTION_377_380_oPCAN_RADAR_91ebf8db_Tx: ComBitPosition=128, ComBitSize=8, ComSignalInitValue=128, ComSignalType=UINT8, ComSystemTemplateSystemSignalRef=DET_RCS_377
            DET_RCS_378_oRDR_DETECTION_377_380_oPCAN_RADAR_bdfb6a9c_Tx: ComBitPosition=240, ComBitSize=8, ComSignalInitValue=128, ComSignalType=UINT8, ComSystemTemplateSystemSignalRef=DET_RCS_378
            DET_RCS_379_oRDR_DETECTION_377_380_oPCAN_RADAR_288bbe09_Tx: ComBitPosition=352, ComBitSize=8, ComSignalInitValue=128, ComSignalType=UINT8, ComSystemTemplateSystemSignalRef=DET_RCS_379
            DET_RCS_380_oRDR_DETECTION_377_380_oPCAN_RADAR_25cf1f13_Tx: ComBitPosition=464, ComBitSize=8, ComSignalInitValue=128, ComSignalType=UINT8, ComSystemTemplateSystemSignalRef=DET_RCS_380
            DET_SNR_377_oRDR_DETECTION_377_380_oPCAN_RADAR_4c45acd9_Tx: ComBitPosition=120, ComBitSize=8, ComSignalInitValue=0, ComSignalType=UINT8, ComSystemTemplateSystemSignalRef=DET_SNR_377
            DET_SNR_378_oRDR_DETECTION_377_380_oPCAN_RADAR_60553e9e_Tx: ComBitPosition=232, ComBitSize=8, ComSignalInitValue=0, ComSignalType=UINT8, ComSystemTemplateSystemSignalRef=DET_SNR_378
            DET_SNR_379_oRDR_DETECTION_377_380_oPCAN_RADAR_f525ea0b_Tx: ComBitPosition=344, ComBitSize=8, ComSignalInitValue=0, ComSignalType=UINT8, ComSystemTemplateSystemSignalRef=DET_SNR_379
            DET_SNR_380_oRDR_DETECTION_377_380_oPCAN_RADAR_f8614b11_Tx: ComBitPosition=456, ComBitSize=8, ComSignalInitValue=0, ComSignalType=UINT8, ComSystemTemplateSystemSignalRef=DET_SNR_380
            DET_SUPER_RES_TARGET_377_oRDR_DETECTION_377_380_oPCAN_RADAR_7ddc84bc_Tx: ComBitPosition=87, ComBitSize=1, ComSignalInitValue=0, ComSignalType=BOOLEAN, ComSystemTemplateSystemSignalRef=DET_SUPER_RES_TARGET_377
            DET_SUPER_RES_TARGET_378_oRDR_DETECTION_377_380_oPCAN_RADAR_51cc16fb_Tx: ComBitPosition=199, ComBitSize=1, ComSignalInitValue=0, ComSignalType=BOOLEAN, ComSystemTemplateSystemSignalRef=DET_SUPER_RES_TARGET_378
            DET_SUPER_RES_TARGET_379_oRDR_DETECTION_377_380_oPCAN_RADAR_c4bcc26e_Tx: ComBitPosition=311, ComBitSize=1, ComSignalInitValue=0, ComSignalType=BOOLEAN, ComSystemTemplateSystemSignalRef=DET_SUPER_RES_TARGET_379
            DET_SUPER_RES_TARGET_380_oRDR_DETECTION_377_380_oPCAN_RADAR_c9f86374_Tx: ComBitPosition=423, ComBitSize=1, ComSignalInitValue=0, ComSignalType=BOOLEAN, ComSystemTemplateSystemSignalRef=DET_SUPER_RES_TARGET_380
        SG_Detections_381_384_oRDR_DETECTION_381_384_oPCAN_RADAR_cd667329_Tx: ComSystemTemplateSignalGroupRef=SG_Detections_381_384
          83 x ComGroupSignal, all with ComSignalEndianness=LITTLE_ENDIAN, ComTransferProperty=PENDING:
            DET_AZIMUTH_381_oRDR_DETECTION_381_384_oPCAN_RADAR_c3f034b4_Tx: ComBitPosition=88, ComBitSize=13, ComSignalInitValue=0, ComSignalType=UINT16, ComSystemTemplateSystemSignalRef=DET_AZIMUTH_381
            DET_AZIMUTH_382_oRDR_DETECTION_381_384_oPCAN_RADAR_a7104f4a_Tx: ComBitPosition=200, ComBitSize=13, ComSignalInitValue=0, ComSignalType=UINT16, ComSystemTemplateSystemSignalRef=DET_AZIMUTH_382
            DET_AZIMUTH_383_oRDR_DETECTION_381_384_oPCAN_RADAR_32609bdf_Tx: ComBitPosition=312, ComBitSize=13, ComSignalInitValue=0, ComSignalType=UINT16, ComSystemTemplateSystemSignalRef=DET_AZIMUTH_383
            DET_AZIMUTH_384_oRDR_DETECTION_381_384_oPCAN_RADAR_6ed0b8b6_Tx: ComBitPosition=424, ComBitSize=13, ComSignalInitValue=0, ComSignalType=UINT16, ComSystemTemplateSystemSignalRef=DET_AZIMUTH_384
            DET_AZIMUTH_ERR_381_oRDR_DETECTION_381_384_oPCAN_RADAR_6745a141_Tx: ComBitPosition=105, ComBitSize=7, ComSignalInitValue=0, ComSignalType=UINT8, ComSystemTemplateSystemSignalRef=DET_AZIMUTH_ERR_381
            DET_AZIMUTH_ERR_382_oRDR_DETECTION_381_384_oPCAN_RADAR_03a5dabf_Tx: ComBitPosition=217, ComBitSize=7, ComSignalInitValue=0, ComSignalType=UINT8, ComSystemTemplateSystemSignalRef=DET_AZIMUTH_ERR_382
            DET_AZIMUTH_ERR_383_oRDR_DETECTION_381_384_oPCAN_RADAR_96d50e2a_Tx: ComBitPosition=329, ComBitSize=7, ComSignalInitValue=0, ComSignalType=UINT8, ComSystemTemplateSystemSignalRef=DET_AZIMUTH_ERR_383
            DET_AZIMUTH_ERR_384_oRDR_DETECTION_381_384_oPCAN_RADAR_ca652d43_Tx: ComBitPosition=441, ComBitSize=7, ComSignalInitValue=0, ComSignalType=UINT8, ComSystemTemplateSystemSignalRef=DET_AZIMUTH_ERR_384
            DET_BELOW_RAIN_THOLD_381_oRDR_DETECTION_381_384_oPCAN_RADAR_16f1a774_Tx: ComBitPosition=39, ComBitSize=1, ComSignalInitValue=0, ComSignalType=BOOLEAN, ComSystemTemplateSystemSignalRef=DET_BELOW_RAIN_THOLD_381
            DET_BELOW_RAIN_THOLD_382_oRDR_DETECTION_381_384_oPCAN_RADAR_7211dc8a_Tx: ComBitPosition=151, ComBitSize=1, ComSignalInitValue=0, ComSignalType=BOOLEAN, ComSystemTemplateSystemSignalRef=DET_BELOW_RAIN_THOLD_382
            DET_BELOW_RAIN_THOLD_383_oRDR_DETECTION_381_384_oPCAN_RADAR_e761081f_Tx: ComBitPosition=263, ComBitSize=1, ComSignalInitValue=0, ComSignalType=BOOLEAN, ComSystemTemplateSystemSignalRef=DET_BELOW_RAIN_THOLD_383
            DET_BELOW_RAIN_THOLD_384_oRDR_DETECTION_381_384_oPCAN_RADAR_bbd12b76_Tx: ComBitPosition=375, ComBitSize=1, ComSignalInitValue=0, ComSignalType=BOOLEAN, ComSystemTemplateSystemSignalRef=DET_BELOW_RAIN_THOLD_384
            DET_BI_STATIC_FLAG_381_oRDR_DETECTION_381_384_oPCAN_RADAR_95dc7431_Tx: ComBitPosition=104, ComBitSize=1, ComSignalInitValue=0, ComSignalType=BOOLEAN, ComSystemTemplateSystemSignalRef=DET_BI_STATIC_FLAG_381
            DET_BI_STATIC_FLAG_382_oRDR_DETECTION_381_384_oPCAN_RADAR_f13c0fcf_Tx: ComBitPosition=216, ComBitSize=1, ComSignalInitValue=0, ComSignalType=BOOLEAN, ComSystemTemplateSystemSignalRef=DET_BI_STATIC_FLAG_382
            DET_BI_STATIC_FLAG_383_oRDR_DETECTION_381_384_oPCAN_RADAR_644cdb5a_Tx: ComBitPosition=328, ComBitSize=1, ComSignalInitValue=0, ComSignalType=BOOLEAN, ComSystemTemplateSystemSignalRef=DET_BI_STATIC_FLAG_383
            DET_BI_STATIC_FLAG_384_oRDR_DETECTION_381_384_oPCAN_RADAR_38fcf833_Tx: ComBitPosition=440, ComBitSize=1, ComSignalInitValue=0, ComSignalType=BOOLEAN, ComSystemTemplateSystemSignalRef=DET_BI_STATIC_FLAG_384
            DET_CONFD_AZIMUTH_381_oRDR_DETECTION_381_384_oPCAN_RADAR_c1163e7e_Tx: ComBitPosition=118, ComBitSize=2, ComSignalInitValue=0, ComSignalType=UINT8, ComSystemTemplateSystemSignalRef=DET_CONFD_AZIMUTH_381
            DET_CONFD_AZIMUTH_382_oRDR_DETECTION_381_384_oPCAN_RADAR_a5f64580_Tx: ComBitPosition=230, ComBitSize=2, ComSignalInitValue=0, ComSignalType=UINT8, ComSystemTemplateSystemSignalRef=DET_CONFD_AZIMUTH_382
            DET_CONFD_AZIMUTH_383_oRDR_DETECTION_381_384_oPCAN_RADAR_30869115_Tx: ComBitPosition=342, ComBitSize=2, ComSignalInitValue=0, ComSignalType=UINT8, ComSystemTemplateSystemSignalRef=DET_CONFD_AZIMUTH_383
            DET_CONFD_AZIMUTH_384_oRDR_DETECTION_381_384_oPCAN_RADAR_6c36b27c_Tx: ComBitPosition=454, ComBitSize=2, ComSignalInitValue=0, ComSignalType=UINT8, ComSystemTemplateSystemSignalRef=DET_CONFD_AZIMUTH_384
            DET_CONFD_ELEVATION_381_oRDR_DETECTION_381_384_oPCAN_RADAR_c3833f84_Tx: ComBitPosition=101, ComBitSize=2, ComSignalInitValue=0, ComSignalType=UINT8, ComSystemTemplateSystemSignalRef=DET_CONFD_ELEVATION_381
            DET_CONFD_ELEVATION_382_oRDR_DETECTION_381_384_oPCAN_RADAR_a763447a_Tx: ComBitPosition=213, ComBitSize=2, ComSignalInitValue=0, ComSignalType=UINT8, ComSystemTemplateSystemSignalRef=DET_CONFD_ELEVATION_382
            DET_CONFD_ELEVATION_383_oRDR_DETECTION_381_384_oPCAN_RADAR_321390ef_Tx: ComBitPosition=325, ComBitSize=2, ComSignalInitValue=0, ComSignalType=UINT8, ComSystemTemplateSystemSignalRef=DET_CONFD_ELEVATION_383
            DET_CONFD_ELEVATION_384_oRDR_DETECTION_381_384_oPCAN_RADAR_6ea3b386_Tx: ComBitPosition=437, ComBitSize=2, ComSignalInitValue=0, ComSignalType=UINT8, ComSystemTemplateSystemSignalRef=DET_CONFD_ELEVATION_384
            DET_ELEVATION_381_oRDR_DETECTION_381_384_oPCAN_RADAR_1243ebb8_Tx: ComBitPosition=72, ComBitSize=8, ComSignalInitValue=0, ComSignalType=UINT8, ComSystemTemplateSystemSignalRef=DET_ELEVATION_381
            DET_ELEVATION_382_oRDR_DETECTION_381_384_oPCAN_RADAR_76a39046_Tx: ComBitPosition=184, ComBitSize=8, ComSignalInitValue=0, ComSignalType=UINT8, ComSystemTemplateSystemSignalRef=DET_ELEVATION_382
            DET_ELEVATION_383_oRDR_DETECTION_381_384_oPCAN_RADAR_e3d344d3_Tx: ComBitPosition=296, ComBitSize=8, ComSignalInitValue=0, ComSignalType=UINT8, ComSystemTemplateSystemSignalRef=DET_ELEVATION_383
            DET_ELEVATION_384_oRDR_DETECTION_381_384_oPCAN_RADAR_bf6367ba_Tx: ComBitPosition=408, ComBitSize=8, ComSignalInitValue=0, ComSignalType=UINT8, ComSystemTemplateSystemSignalRef=DET_ELEVATION_384
            DET_ELEVATION_ERR_381_oRDR_DETECTION_381_384_oPCAN_RADAR_957a73cd_Tx: ComBitPosition=80, ComBitSize=6, ComSignalInitValue=0, ComSignalType=UINT8, ComSystemTemplateSystemSignalRef=DET_ELEVATION_ERR_381
            DET_ELEVATION_ERR_382_oRDR_DETECTION_381_384_oPCAN_RADAR_f19a0833_Tx: ComBitPosition=192, ComBitSize=6, ComSignalInitValue=0, ComSignalType=UINT8, ComSystemTemplateSystemSignalRef=DET_ELEVATION_ERR_382
            DET_ELEVATION_ERR_383_oRDR_DETECTION_381_384_oPCAN_RADAR_64eadca6_Tx: ComBitPosition=304, ComBitSize=6, ComSignalInitValue=0, ComSignalType=UINT8, ComSystemTemplateSystemSignalRef=DET_ELEVATION_ERR_383
            DET_ELEVATION_ERR_384_oRDR_DETECTION_381_384_oPCAN_RADAR_385affcf_Tx: ComBitPosition=416, ComBitSize=6, ComSignalInitValue=0, ComSignalType=UINT8, ComSystemTemplateSystemSignalRef=DET_ELEVATION_ERR_384
            DET_EXISTENCE_PROB_381_oRDR_DETECTION_381_384_oPCAN_RADAR_47e506ad_Tx: ComBitPosition=112, ComBitSize=6, ComSignalInitValue=0, ComSignalType=UINT8, ComSystemTemplateSystemSignalRef=DET_EXISTENCE_PROB_381
            DET_EXISTENCE_PROB_382_oRDR_DETECTION_381_384_oPCAN_RADAR_23057d53_Tx: ComBitPosition=224, ComBitSize=6, ComSignalInitValue=0, ComSignalType=UINT8, ComSystemTemplateSystemSignalRef=DET_EXISTENCE_PROB_382
            DET_EXISTENCE_PROB_383_oRDR_DETECTION_381_384_oPCAN_RADAR_b675a9c6_Tx: ComBitPosition=336, ComBitSize=6, ComSignalInitValue=0, ComSignalType=UINT8, ComSystemTemplateSystemSignalRef=DET_EXISTENCE_PROB_383
            DET_EXISTENCE_PROB_384_oRDR_DETECTION_381_384_oPCAN_RADAR_eac58aaf_Tx: ComBitPosition=448, ComBitSize=6, ComSignalInitValue=0, ComSignalType=UINT8, ComSystemTemplateSystemSignalRef=DET_EXISTENCE_PROB_384
            DET_HVC_FLAG_381_oRDR_DETECTION_381_384_oPCAN_RADAR_a69145d2_Tx: ComBitPosition=86, ComBitSize=1, ComSignalInitValue=0, ComSignalType=BOOLEAN, ComSystemTemplateSystemSignalRef=DET_HVC_FLAG_381
            DET_HVC_FLAG_382_oRDR_DETECTION_381_384_oPCAN_RADAR_c2713e2c_Tx: ComBitPosition=198, ComBitSize=1, ComSignalInitValue=0, ComSignalType=BOOLEAN, ComSystemTemplateSystemSignalRef=DET_HVC_FLAG_382
            DET_HVC_FLAG_383_oRDR_DETECTION_381_384_oPCAN_RADAR_5701eab9_Tx: ComBitPosition=310, ComBitSize=1, ComSignalInitValue=0, ComSignalType=BOOLEAN, ComSystemTemplateSystemSignalRef=DET_HVC_FLAG_383
            DET_HVC_FLAG_384_oRDR_DETECTION_381_384_oPCAN_RADAR_0bb1c9d0_Tx: ComBitPosition=422, ComBitSize=1, ComSignalInitValue=0, ComSignalType=BOOLEAN, ComSystemTemplateSystemSignalRef=DET_HVC_FLAG_384
            DET_IDM_381_oRDR_DETECTION_381_384_oPCAN_RADAR_2dc37e6f_Tx: ComBitPosition=63, ComBitSize=1, ComSignalInitValue=0, ComSignalType=BOOLEAN, ComSystemTemplateSystemSignalRef=DET_IDM_381
            DET_IDM_382_oRDR_DETECTION_381_384_oPCAN_RADAR_49230591_Tx: ComBitPosition=175, ComBitSize=1, ComSignalInitValue=0, ComSignalType=BOOLEAN, ComSystemTemplateSystemSignalRef=DET_IDM_382
            DET_IDM_383_oRDR_DETECTION_381_384_oPCAN_RADAR_dc53d104_Tx: ComBitPosition=287, ComBitSize=1, ComSignalInitValue=0, ComSignalType=BOOLEAN, ComSystemTemplateSystemSignalRef=DET_IDM_383
            DET_IDM_384_oRDR_DETECTION_381_384_oPCAN_RADAR_80e3f26d_Tx: ComBitPosition=399, ComBitSize=1, ComSignalInitValue=0, ComSignalType=BOOLEAN, ComSystemTemplateSystemSignalRef=DET_IDM_384
            DET_MH_CRC16_381_384_oRDR_DETECTION_381_384_oPCAN_RADAR_49eea122_Tx: ComBitPosition=0, ComBitSize=16, ComSignalInitValue=0, ComSignalType=UINT16, ComSystemTemplateSystemSignalRef=DET_MH_CRC16_381_384
            DET_MH_CYCLE_COUNTER_381_384_oRDR_DETECTION_381_384_oPCAN_RADAR_cd9b0015_Tx: ComBitPosition=16, ComBitSize=8, ComSignalInitValue=0, ComSignalType=UINT8, ComSystemTemplateSystemSignalRef=DET_MH_CYCLE_COUNTER_381_384
            DET_MH_SCAN_INDEX_4LSB_381_384_oRDR_DETECTION_381_384_oPCAN_RADAR_01b12599_Tx: ComBitPosition=476, ComBitSize=4, ComSignalInitValue=0, ComSignalType=UINT8, ComSystemTemplateSystemSignalRef=DET_MH_SCAN_INDEX_4LSB_381_384
            DET_MTD_381_oRDR_DETECTION_381_384_oPCAN_RADAR_4b704cb4_Tx: ComBitPosition=47, ComBitSize=1, ComSignalInitValue=0, ComSignalType=BOOLEAN, ComSystemTemplateSystemSignalRef=DET_MTD_381
            DET_MTD_382_oRDR_DETECTION_381_384_oPCAN_RADAR_2f90374a_Tx: ComBitPosition=159, ComBitSize=1, ComSignalInitValue=0, ComSignalType=BOOLEAN, ComSystemTemplateSystemSignalRef=DET_MTD_382
            DET_MTD_383_oRDR_DETECTION_381_384_oPCAN_RADAR_bae0e3df_Tx: ComBitPosition=271, ComBitSize=1, ComSignalInitValue=0, ComSignalType=BOOLEAN, ComSystemTemplateSystemSignalRef=DET_MTD_383
            DET_MTD_384_oRDR_DETECTION_381_384_oPCAN_RADAR_e650c0b6_Tx: ComBitPosition=383, ComBitSize=1, ComSignalInitValue=0, ComSignalType=BOOLEAN, ComSystemTemplateSystemSignalRef=DET_MTD_384
            DET_PROB_1STAZHYPO_381_oRDR_DETECTION_381_384_oPCAN_RADAR_d8c4a479_Tx: ComBitPosition=103, ComBitSize=1, ComSignalInitValue=0, ComSignalType=BOOLEAN, ComSystemTemplateSystemSignalRef=DET_PROB_1STAZHYPO_381
            DET_PROB_1STAZHYPO_382_oRDR_DETECTION_381_384_oPCAN_RADAR_bc24df87_Tx: ComBitPosition=215, ComBitSize=1, ComSignalInitValue=0, ComSignalType=BOOLEAN, ComSystemTemplateSystemSignalRef=DET_PROB_1STAZHYPO_382
            DET_PROB_1STAZHYPO_383_oRDR_DETECTION_381_384_oPCAN_RADAR_29540b12_Tx: ComBitPosition=327, ComBitSize=1, ComSignalInitValue=0, ComSignalType=BOOLEAN, ComSystemTemplateSystemSignalRef=DET_PROB_1STAZHYPO_383
            DET_PROB_1STAZHYPO_384_oRDR_DETECTION_381_384_oPCAN_RADAR_75e4287b_Tx: ComBitPosition=439, ComBitSize=1, ComSignalInitValue=0, ComSignalType=BOOLEAN, ComSystemTemplateSystemSignalRef=DET_PROB_1STAZHYPO_384
            DET_RANGE_381_oRDR_DETECTION_381_384_oPCAN_RADAR_d36b470f_Tx: ComBitPosition=24, ComBitSize=15, ComSignalInitValue=0, ComSignalType=UINT16, ComSystemTemplateSystemSignalRef=DET_RANGE_381
            DET_RANGE_382_oRDR_DETECTION_381_384_oPCAN_RADAR_b78b3cf1_Tx: ComBitPosition=136, ComBitSize=15, ComSignalInitValue=0, ComSignalType=UINT16, ComSystemTemplateSystemSignalRef=DET_RANGE_382
            DET_RANGE_383_oRDR_DETECTION_381_384_oPCAN_RADAR_22fbe864_Tx: ComBitPosition=248, ComBitSize=15, ComSignalInitValue=0, ComSignalType=UINT16, ComSystemTemplateSystemSignalRef=DET_RANGE_383
            DET_RANGE_384_oRDR_DETECTION_381_384_oPCAN_RADAR_7e4bcb0d_Tx: ComBitPosition=360, ComBitSize=15, ComSignalInitValue=0, ComSignalType=UINT16, ComSystemTemplateSystemSignalRef=DET_RANGE_384
            DET_RANGE_ERR_381_oRDR_DETECTION_381_384_oPCAN_RADAR_7483fd66_Tx: ComBitPosition=40, ComBitSize=7, ComSignalInitValue=0, ComSignalType=UINT8, ComSystemTemplateSystemSignalRef=DET_RANGE_ERR_381
            DET_RANGE_ERR_382_oRDR_DETECTION_381_384_oPCAN_RADAR_10638698_Tx: ComBitPosition=152, ComBitSize=7, ComSignalInitValue=0, ComSignalType=UINT8, ComSystemTemplateSystemSignalRef=DET_RANGE_ERR_382
            DET_RANGE_ERR_383_oRDR_DETECTION_381_384_oPCAN_RADAR_8513520d_Tx: ComBitPosition=264, ComBitSize=7, ComSignalInitValue=0, ComSignalType=UINT8, ComSystemTemplateSystemSignalRef=DET_RANGE_ERR_383
            DET_RANGE_ERR_384_oRDR_DETECTION_381_384_oPCAN_RADAR_d9a37164_Tx: ComBitPosition=376, ComBitSize=7, ComSignalInitValue=0, ComSignalType=UINT8, ComSystemTemplateSystemSignalRef=DET_RANGE_ERR_384
            DET_RANGE_VELOCITY_381_oRDR_DETECTION_381_384_oPCAN_RADAR_a6cd852a_Tx: ComBitPosition=48, ComBitSize=15, ComSignalInitValue=16384, ComSignalType=UINT16, ComSystemTemplateSystemSignalRef=DET_RANGE_VELOCITY_381
            DET_RANGE_VELOCITY_382_oRDR_DETECTION_381_384_oPCAN_RADAR_c22dfed4_Tx: ComBitPosition=160, ComBitSize=15, ComSignalInitValue=16384, ComSignalType=UINT16, ComSystemTemplateSystemSignalRef=DET_RANGE_VELOCITY_382
            DET_RANGE_VELOCITY_383_oRDR_DETECTION_381_384_oPCAN_RADAR_575d2a41_Tx: ComBitPosition=272, ComBitSize=15, ComSignalInitValue=16384, ComSignalType=UINT16, ComSystemTemplateSystemSignalRef=DET_RANGE_VELOCITY_383
            DET_RANGE_VELOCITY_384_oRDR_DETECTION_381_384_oPCAN_RADAR_0bed0928_Tx: ComBitPosition=384, ComBitSize=15, ComSignalInitValue=16384, ComSignalType=UINT16, ComSystemTemplateSystemSignalRef=DET_RANGE_VELOCITY_384
            DET_RANGE_VELOCITY_ERR_381_oRDR_DETECTION_381_384_oPCAN_RADAR_a9767e98_Tx: ComBitPosition=64, ComBitSize=8, ComSignalInitValue=0, ComSignalType=UINT8, ComSystemTemplateSystemSignalRef=DET_RANGE_VELOCITY_ERR_381
            DET_RANGE_VELOCITY_ERR_382_oRDR_DETECTION_381_384_oPCAN_RADAR_cd960566_Tx: ComBitPosition=176, ComBitSize=8, ComSignalInitValue=0, ComSignalType=UINT8, ComSystemTemplateSystemSignalRef=DET_RANGE_VELOCITY_ERR_382
            DET_RANGE_VELOCITY_ERR_383_oRDR_DETECTION_381_384_oPCAN_RADAR_58e6d1f3_Tx: ComBitPosition=288, ComBitSize=8, ComSignalInitValue=0, ComSignalType=UINT8, ComSystemTemplateSystemSignalRef=DET_RANGE_VELOCITY_ERR_383
            DET_RANGE_VELOCITY_ERR_384_oRDR_DETECTION_381_384_oPCAN_RADAR_0456f29a_Tx: ComBitPosition=400, ComBitSize=8, ComSignalInitValue=0, ComSignalType=UINT8, ComSystemTemplateSystemSignalRef=DET_RANGE_VELOCITY_ERR_384
            DET_RCS_381_oRDR_DETECTION_381_384_oPCAN_RADAR_214db270_Tx: ComBitPosition=128, ComBitSize=8, ComSignalInitValue=128, ComSignalType=UINT8, ComSystemTemplateSystemSignalRef=DET_RCS_381
            DET_RCS_382_oRDR_DETECTION_381_384_oPCAN_RADAR_45adc98e_Tx: ComBitPosition=240, ComBitSize=8, ComSignalInitValue=128, ComSignalType=UINT8, ComSystemTemplateSystemSignalRef=DET_RCS_382
            DET_RCS_383_oRDR_DETECTION_381_384_oPCAN_RADAR_d0dd1d1b_Tx: ComBitPosition=352, ComBitSize=8, ComSignalInitValue=128, ComSignalType=UINT8, ComSystemTemplateSystemSignalRef=DET_RCS_383
            DET_RCS_384_oRDR_DETECTION_381_384_oPCAN_RADAR_8c6d3e72_Tx: ComBitPosition=464, ComBitSize=8, ComSignalInitValue=128, ComSignalType=UINT8, ComSystemTemplateSystemSignalRef=DET_RCS_384
            DET_SNR_381_oRDR_DETECTION_381_384_oPCAN_RADAR_fce3e672_Tx: ComBitPosition=120, ComBitSize=8, ComSignalInitValue=0, ComSignalType=UINT8, ComSystemTemplateSystemSignalRef=DET_SNR_381
            DET_SNR_382_oRDR_DETECTION_381_384_oPCAN_RADAR_98039d8c_Tx: ComBitPosition=232, ComBitSize=8, ComSignalInitValue=0, ComSignalType=UINT8, ComSystemTemplateSystemSignalRef=DET_SNR_382
            DET_SNR_383_oRDR_DETECTION_381_384_oPCAN_RADAR_0d734919_Tx: ComBitPosition=344, ComBitSize=8, ComSignalInitValue=0, ComSignalType=UINT8, ComSystemTemplateSystemSignalRef=DET_SNR_383
            DET_SNR_384_oRDR_DETECTION_381_384_oPCAN_RADAR_51c36a70_Tx: ComBitPosition=456, ComBitSize=8, ComSignalInitValue=0, ComSignalType=UINT8, ComSystemTemplateSystemSignalRef=DET_SNR_384
            DET_SUPER_RES_TARGET_381_oRDR_DETECTION_381_384_oPCAN_RADAR_cd7ace17_Tx: ComBitPosition=87, ComBitSize=1, ComSignalInitValue=0, ComSignalType=BOOLEAN, ComSystemTemplateSystemSignalRef=DET_SUPER_RES_TARGET_381
            DET_SUPER_RES_TARGET_382_oRDR_DETECTION_381_384_oPCAN_RADAR_a99ab5e9_Tx: ComBitPosition=199, ComBitSize=1, ComSignalInitValue=0, ComSignalType=BOOLEAN, ComSystemTemplateSystemSignalRef=DET_SUPER_RES_TARGET_382
            DET_SUPER_RES_TARGET_383_oRDR_DETECTION_381_384_oPCAN_RADAR_3cea617c_Tx: ComBitPosition=311, ComBitSize=1, ComSignalInitValue=0, ComSignalType=BOOLEAN, ComSystemTemplateSystemSignalRef=DET_SUPER_RES_TARGET_383
            DET_SUPER_RES_TARGET_384_oRDR_DETECTION_381_384_oPCAN_RADAR_605a4215_Tx: ComBitPosition=423, ComBitSize=1, ComSignalInitValue=0, ComSignalType=BOOLEAN, ComSystemTemplateSystemSignalRef=DET_SUPER_RES_TARGET_384
        SG_Detections_385_388_oRDR_DETECTION_385_388_oPCAN_RADAR_bca5477b_Tx: ComSystemTemplateSignalGroupRef=SG_Detections_385_388
          83 x ComGroupSignal, all with ComSignalEndianness=LITTLE_ENDIAN, ComTransferProperty=PENDING:
            DET_AZIMUTH_385_oRDR_DETECTION_385_388_oPCAN_RADAR_1212f217_Tx: ComBitPosition=88, ComBitSize=13, ComSignalInitValue=0, ComSignalType=UINT16, ComSystemTemplateSystemSignalRef=DET_AZIMUTH_385
            DET_AZIMUTH_386_oRDR_DETECTION_385_388_oPCAN_RADAR_76f289e9_Tx: ComBitPosition=200, ComBitSize=13, ComSignalInitValue=0, ComSignalType=UINT16, ComSystemTemplateSystemSignalRef=DET_AZIMUTH_386
            DET_AZIMUTH_387_oRDR_DETECTION_385_388_oPCAN_RADAR_e3825d7c_Tx: ComBitPosition=312, ComBitSize=13, ComSignalInitValue=0, ComSignalType=UINT16, ComSystemTemplateSystemSignalRef=DET_AZIMUTH_387
            DET_AZIMUTH_388_oRDR_DETECTION_385_388_oPCAN_RADAR_cf92cf3b_Tx: ComBitPosition=424, ComBitSize=13, ComSignalInitValue=0, ComSignalType=UINT16, ComSystemTemplateSystemSignalRef=DET_AZIMUTH_388
            DET_AZIMUTH_ERR_385_oRDR_DETECTION_385_388_oPCAN_RADAR_b6a767e2_Tx: ComBitPosition=105, ComBitSize=7, ComSignalInitValue=0, ComSignalType=UINT8, ComSystemTemplateSystemSignalRef=DET_AZIMUTH_ERR_385
            DET_AZIMUTH_ERR_386_oRDR_DETECTION_385_388_oPCAN_RADAR_d2471c1c_Tx: ComBitPosition=217, ComBitSize=7, ComSignalInitValue=0, ComSignalType=UINT8, ComSystemTemplateSystemSignalRef=DET_AZIMUTH_ERR_386
            DET_AZIMUTH_ERR_387_oRDR_DETECTION_385_388_oPCAN_RADAR_4737c889_Tx: ComBitPosition=329, ComBitSize=7, ComSignalInitValue=0, ComSignalType=UINT8, ComSystemTemplateSystemSignalRef=DET_AZIMUTH_ERR_387
            DET_AZIMUTH_ERR_388_oRDR_DETECTION_385_388_oPCAN_RADAR_6b275ace_Tx: ComBitPosition=441, ComBitSize=7, ComSignalInitValue=0, ComSignalType=UINT8, ComSystemTemplateSystemSignalRef=DET_AZIMUTH_ERR_388
            DET_BELOW_RAIN_THOLD_385_oRDR_DETECTION_385_388_oPCAN_RADAR_c71361d7_Tx: ComBitPosition=39, ComBitSize=1, ComSignalInitValue=0, ComSignalType=BOOLEAN, ComSystemTemplateSystemSignalRef=DET_BELOW_RAIN_THOLD_385
            DET_BELOW_RAIN_THOLD_386_oRDR_DETECTION_385_388_oPCAN_RADAR_a3f31a29_Tx: ComBitPosition=151, ComBitSize=1, ComSignalInitValue=0, ComSignalType=BOOLEAN, ComSystemTemplateSystemSignalRef=DET_BELOW_RAIN_THOLD_386
            DET_BELOW_RAIN_THOLD_387_oRDR_DETECTION_385_388_oPCAN_RADAR_3683cebc_Tx: ComBitPosition=263, ComBitSize=1, ComSignalInitValue=0, ComSignalType=BOOLEAN, ComSystemTemplateSystemSignalRef=DET_BELOW_RAIN_THOLD_387
            DET_BELOW_RAIN_THOLD_388_oRDR_DETECTION_385_388_oPCAN_RADAR_1a935cfb_Tx: ComBitPosition=375, ComBitSize=1, ComSignalInitValue=0, ComSignalType=BOOLEAN, ComSystemTemplateSystemSignalRef=DET_BELOW_RAIN_THOLD_388
            DET_BI_STATIC_FLAG_385_oRDR_DETECTION_385_388_oPCAN_RADAR_443eb292_Tx: ComBitPosition=104, ComBitSize=1, ComSignalInitValue=0, ComSignalType=BOOLEAN, ComSystemTemplateSystemSignalRef=DET_BI_STATIC_FLAG_385
            DET_BI_STATIC_FLAG_386_oRDR_DETECTION_385_388_oPCAN_RADAR_20dec96c_Tx: ComBitPosition=216, ComBitSize=1, ComSignalInitValue=0, ComSignalType=BOOLEAN, ComSystemTemplateSystemSignalRef=DET_BI_STATIC_FLAG_386
            DET_BI_STATIC_FLAG_387_oRDR_DETECTION_385_388_oPCAN_RADAR_b5ae1df9_Tx: ComBitPosition=328, ComBitSize=1, ComSignalInitValue=0, ComSignalType=BOOLEAN, ComSystemTemplateSystemSignalRef=DET_BI_STATIC_FLAG_387
            DET_BI_STATIC_FLAG_388_oRDR_DETECTION_385_388_oPCAN_RADAR_99be8fbe_Tx: ComBitPosition=440, ComBitSize=1, ComSignalInitValue=0, ComSignalType=BOOLEAN, ComSystemTemplateSystemSignalRef=DET_BI_STATIC_FLAG_388
            DET_CONFD_AZIMUTH_385_oRDR_DETECTION_385_388_oPCAN_RADAR_10f4f8dd_Tx: ComBitPosition=118, ComBitSize=2, ComSignalInitValue=0, ComSignalType=UINT8, ComSystemTemplateSystemSignalRef=DET_CONFD_AZIMUTH_385
            DET_CONFD_AZIMUTH_386_oRDR_DETECTION_385_388_oPCAN_RADAR_74148323_Tx: ComBitPosition=230, ComBitSize=2, ComSignalInitValue=0, ComSignalType=UINT8, ComSystemTemplateSystemSignalRef=DET_CONFD_AZIMUTH_386
            DET_CONFD_AZIMUTH_387_oRDR_DETECTION_385_388_oPCAN_RADAR_e16457b6_Tx: ComBitPosition=342, ComBitSize=2, ComSignalInitValue=0, ComSignalType=UINT8, ComSystemTemplateSystemSignalRef=DET_CONFD_AZIMUTH_387
            DET_CONFD_AZIMUTH_388_oRDR_DETECTION_385_388_oPCAN_RADAR_cd74c5f1_Tx: ComBitPosition=454, ComBitSize=2, ComSignalInitValue=0, ComSignalType=UINT8, ComSystemTemplateSystemSignalRef=DET_CONFD_AZIMUTH_388
            DET_CONFD_ELEVATION_385_oRDR_DETECTION_385_388_oPCAN_RADAR_1261f927_Tx: ComBitPosition=101, ComBitSize=2, ComSignalInitValue=0, ComSignalType=UINT8, ComSystemTemplateSystemSignalRef=DET_CONFD_ELEVATION_385
            DET_CONFD_ELEVATION_386_oRDR_DETECTION_385_388_oPCAN_RADAR_768182d9_Tx: ComBitPosition=213, ComBitSize=2, ComSignalInitValue=0, ComSignalType=UINT8, ComSystemTemplateSystemSignalRef=DET_CONFD_ELEVATION_386
            DET_CONFD_ELEVATION_387_oRDR_DETECTION_385_388_oPCAN_RADAR_e3f1564c_Tx: ComBitPosition=325, ComBitSize=2, ComSignalInitValue=0, ComSignalType=UINT8, ComSystemTemplateSystemSignalRef=DET_CONFD_ELEVATION_387
            DET_CONFD_ELEVATION_388_oRDR_DETECTION_385_388_oPCAN_RADAR_cfe1c40b_Tx: ComBitPosition=437, ComBitSize=2, ComSignalInitValue=0, ComSignalType=UINT8, ComSystemTemplateSystemSignalRef=DET_CONFD_ELEVATION_388
            DET_ELEVATION_385_oRDR_DETECTION_385_388_oPCAN_RADAR_c3a12d1b_Tx: ComBitPosition=72, ComBitSize=8, ComSignalInitValue=0, ComSignalType=UINT8, ComSystemTemplateSystemSignalRef=DET_ELEVATION_385
            DET_ELEVATION_386_oRDR_DETECTION_385_388_oPCAN_RADAR_a74156e5_Tx: ComBitPosition=184, ComBitSize=8, ComSignalInitValue=0, ComSignalType=UINT8, ComSystemTemplateSystemSignalRef=DET_ELEVATION_386
            DET_ELEVATION_387_oRDR_DETECTION_385_388_oPCAN_RADAR_32318270_Tx: ComBitPosition=296, ComBitSize=8, ComSignalInitValue=0, ComSignalType=UINT8, ComSystemTemplateSystemSignalRef=DET_ELEVATION_387
            DET_ELEVATION_388_oRDR_DETECTION_385_388_oPCAN_RADAR_1e211037_Tx: ComBitPosition=408, ComBitSize=8, ComSignalInitValue=0, ComSignalType=UINT8, ComSystemTemplateSystemSignalRef=DET_ELEVATION_388
            DET_ELEVATION_ERR_385_oRDR_DETECTION_385_388_oPCAN_RADAR_4498b56e_Tx: ComBitPosition=80, ComBitSize=6, ComSignalInitValue=0, ComSignalType=UINT8, ComSystemTemplateSystemSignalRef=DET_ELEVATION_ERR_385
            DET_ELEVATION_ERR_386_oRDR_DETECTION_385_388_oPCAN_RADAR_2078ce90_Tx: ComBitPosition=192, ComBitSize=6, ComSignalInitValue=0, ComSignalType=UINT8, ComSystemTemplateSystemSignalRef=DET_ELEVATION_ERR_386
            DET_ELEVATION_ERR_387_oRDR_DETECTION_385_388_oPCAN_RADAR_b5081a05_Tx: ComBitPosition=304, ComBitSize=6, ComSignalInitValue=0, ComSignalType=UINT8, ComSystemTemplateSystemSignalRef=DET_ELEVATION_ERR_387
            DET_ELEVATION_ERR_388_oRDR_DETECTION_385_388_oPCAN_RADAR_99188842_Tx: ComBitPosition=416, ComBitSize=6, ComSignalInitValue=0, ComSignalType=UINT8, ComSystemTemplateSystemSignalRef=DET_ELEVATION_ERR_388
            DET_EXISTENCE_PROB_385_oRDR_DETECTION_385_388_oPCAN_RADAR_9607c00e_Tx: ComBitPosition=112, ComBitSize=6, ComSignalInitValue=0, ComSignalType=UINT8, ComSystemTemplateSystemSignalRef=DET_EXISTENCE_PROB_385
            DET_EXISTENCE_PROB_386_oRDR_DETECTION_385_388_oPCAN_RADAR_f2e7bbf0_Tx: ComBitPosition=224, ComBitSize=6, ComSignalInitValue=0, ComSignalType=UINT8, ComSystemTemplateSystemSignalRef=DET_EXISTENCE_PROB_386
            DET_EXISTENCE_PROB_387_oRDR_DETECTION_385_388_oPCAN_RADAR_67976f65_Tx: ComBitPosition=336, ComBitSize=6, ComSignalInitValue=0, ComSignalType=UINT8, ComSystemTemplateSystemSignalRef=DET_EXISTENCE_PROB_387
            DET_EXISTENCE_PROB_388_oRDR_DETECTION_385_388_oPCAN_RADAR_4b87fd22_Tx: ComBitPosition=448, ComBitSize=6, ComSignalInitValue=0, ComSignalType=UINT8, ComSystemTemplateSystemSignalRef=DET_EXISTENCE_PROB_388
            DET_HVC_FLAG_385_oRDR_DETECTION_385_388_oPCAN_RADAR_77738371_Tx: ComBitPosition=86, ComBitSize=1, ComSignalInitValue=0, ComSignalType=BOOLEAN, ComSystemTemplateSystemSignalRef=DET_HVC_FLAG_385
            DET_HVC_FLAG_386_oRDR_DETECTION_385_388_oPCAN_RADAR_1393f88f_Tx: ComBitPosition=198, ComBitSize=1, ComSignalInitValue=0, ComSignalType=BOOLEAN, ComSystemTemplateSystemSignalRef=DET_HVC_FLAG_386
            DET_HVC_FLAG_387_oRDR_DETECTION_385_388_oPCAN_RADAR_86e32c1a_Tx: ComBitPosition=310, ComBitSize=1, ComSignalInitValue=0, ComSignalType=BOOLEAN, ComSystemTemplateSystemSignalRef=DET_HVC_FLAG_387
            DET_HVC_FLAG_388_oRDR_DETECTION_385_388_oPCAN_RADAR_aaf3be5d_Tx: ComBitPosition=422, ComBitSize=1, ComSignalInitValue=0, ComSignalType=BOOLEAN, ComSystemTemplateSystemSignalRef=DET_HVC_FLAG_388
            DET_IDM_385_oRDR_DETECTION_385_388_oPCAN_RADAR_fc21b8cc_Tx: ComBitPosition=63, ComBitSize=1, ComSignalInitValue=0, ComSignalType=BOOLEAN, ComSystemTemplateSystemSignalRef=DET_IDM_385
            DET_IDM_386_oRDR_DETECTION_385_388_oPCAN_RADAR_98c1c332_Tx: ComBitPosition=175, ComBitSize=1, ComSignalInitValue=0, ComSignalType=BOOLEAN, ComSystemTemplateSystemSignalRef=DET_IDM_386
            DET_IDM_387_oRDR_DETECTION_385_388_oPCAN_RADAR_0db117a7_Tx: ComBitPosition=287, ComBitSize=1, ComSignalInitValue=0, ComSignalType=BOOLEAN, ComSystemTemplateSystemSignalRef=DET_IDM_387
            DET_IDM_388_oRDR_DETECTION_385_388_oPCAN_RADAR_21a185e0_Tx: ComBitPosition=399, ComBitSize=1, ComSignalInitValue=0, ComSignalType=BOOLEAN, ComSystemTemplateSystemSignalRef=DET_IDM_388
            DET_MH_CRC16_385_388_oRDR_DETECTION_385_388_oPCAN_RADAR_382d9570_Tx: ComBitPosition=0, ComBitSize=16, ComSignalInitValue=0, ComSignalType=UINT16, ComSystemTemplateSystemSignalRef=DET_MH_CRC16_385_388
            DET_MH_CYCLE_COUNTER_385_388_oRDR_DETECTION_385_388_oPCAN_RADAR_bc583447_Tx: ComBitPosition=16, ComBitSize=8, ComSignalInitValue=0, ComSignalType=UINT8, ComSystemTemplateSystemSignalRef=DET_MH_CYCLE_COUNTER_385_388
            DET_MH_SCAN_INDEX_4LSB_385_388_oRDR_DETECTION_385_388_oPCAN_RADAR_707211cb_Tx: ComBitPosition=476, ComBitSize=4, ComSignalInitValue=0, ComSignalType=UINT8, ComSystemTemplateSystemSignalRef=DET_MH_SCAN_INDEX_4LSB_385_388
            DET_MTD_385_oRDR_DETECTION_385_388_oPCAN_RADAR_9a928a17_Tx: ComBitPosition=47, ComBitSize=1, ComSignalInitValue=0, ComSignalType=BOOLEAN, ComSystemTemplateSystemSignalRef=DET_MTD_385
            DET_MTD_386_oRDR_DETECTION_385_388_oPCAN_RADAR_fe72f1e9_Tx: ComBitPosition=159, ComBitSize=1, ComSignalInitValue=0, ComSignalType=BOOLEAN, ComSystemTemplateSystemSignalRef=DET_MTD_386
            DET_MTD_387_oRDR_DETECTION_385_388_oPCAN_RADAR_6b02257c_Tx: ComBitPosition=271, ComBitSize=1, ComSignalInitValue=0, ComSignalType=BOOLEAN, ComSystemTemplateSystemSignalRef=DET_MTD_387
            DET_MTD_388_oRDR_DETECTION_385_388_oPCAN_RADAR_4712b73b_Tx: ComBitPosition=383, ComBitSize=1, ComSignalInitValue=0, ComSignalType=BOOLEAN, ComSystemTemplateSystemSignalRef=DET_MTD_388
            DET_PROB_1STAZHYPO_385_oRDR_DETECTION_385_388_oPCAN_RADAR_092662da_Tx: ComBitPosition=103, ComBitSize=1, ComSignalInitValue=0, ComSignalType=BOOLEAN, ComSystemTemplateSystemSignalRef=DET_PROB_1STAZHYPO_385
            DET_PROB_1STAZHYPO_386_oRDR_DETECTION_385_388_oPCAN_RADAR_6dc61924_Tx: ComBitPosition=215, ComBitSize=1, ComSignalInitValue=0, ComSignalType=BOOLEAN, ComSystemTemplateSystemSignalRef=DET_PROB_1STAZHYPO_386
            DET_PROB_1STAZHYPO_387_oRDR_DETECTION_385_388_oPCAN_RADAR_f8b6cdb1_Tx: ComBitPosition=327, ComBitSize=1, ComSignalInitValue=0, ComSignalType=BOOLEAN, ComSystemTemplateSystemSignalRef=DET_PROB_1STAZHYPO_387
            DET_PROB_1STAZHYPO_388_oRDR_DETECTION_385_388_oPCAN_RADAR_d4a65ff6_Tx: ComBitPosition=439, ComBitSize=1, ComSignalInitValue=0, ComSignalType=BOOLEAN, ComSystemTemplateSystemSignalRef=DET_PROB_1STAZHYPO_388
            DET_RANGE_385_oRDR_DETECTION_385_388_oPCAN_RADAR_028981ac_Tx: ComBitPosition=24, ComBitSize=15, ComSignalInitValue=0, ComSignalType=UINT16, ComSystemTemplateSystemSignalRef=DET_RANGE_385
            DET_RANGE_386_oRDR_DETECTION_385_388_oPCAN_RADAR_6669fa52_Tx: ComBitPosition=136, ComBitSize=15, ComSignalInitValue=0, ComSignalType=UINT16, ComSystemTemplateSystemSignalRef=DET_RANGE_386
            DET_RANGE_387_oRDR_DETECTION_385_388_oPCAN_RADAR_f3192ec7_Tx: ComBitPosition=248, ComBitSize=15, ComSignalInitValue=0, ComSignalType=UINT16, ComSystemTemplateSystemSignalRef=DET_RANGE_387
            DET_RANGE_388_oRDR_DETECTION_385_388_oPCAN_RADAR_df09bc80_Tx: ComBitPosition=360, ComBitSize=15, ComSignalInitValue=0, ComSignalType=UINT16, ComSystemTemplateSystemSignalRef=DET_RANGE_388
            DET_RANGE_ERR_385_oRDR_DETECTION_385_388_oPCAN_RADAR_a5613bc5_Tx: ComBitPosition=40, ComBitSize=7, ComSignalInitValue=0, ComSignalType=UINT8, ComSystemTemplateSystemSignalRef=DET_RANGE_ERR_385
            DET_RANGE_ERR_386_oRDR_DETECTION_385_388_oPCAN_RADAR_c181403b_Tx: ComBitPosition=152, ComBitSize=7, ComSignalInitValue=0, ComSignalType=UINT8, ComSystemTemplateSystemSignalRef=DET_RANGE_ERR_386
            DET_RANGE_ERR_387_oRDR_DETECTION_385_388_oPCAN_RADAR_54f194ae_Tx: ComBitPosition=264, ComBitSize=7, ComSignalInitValue=0, ComSignalType=UINT8, ComSystemTemplateSystemSignalRef=DET_RANGE_ERR_387
            DET_RANGE_ERR_388_oRDR_DETECTION_385_388_oPCAN_RADAR_78e106e9_Tx: ComBitPosition=376, ComBitSize=7, ComSignalInitValue=0, ComSignalType=UINT8, ComSystemTemplateSystemSignalRef=DET_RANGE_ERR_388
            DET_RANGE_VELOCITY_385_oRDR_DETECTION_385_388_oPCAN_RADAR_772f4389_Tx: ComBitPosition=48, ComBitSize=15, ComSignalInitValue=16384, ComSignalType=UINT16, ComSystemTemplateSystemSignalRef=DET_RANGE_VELOCITY_385
            DET_RANGE_VELOCITY_386_oRDR_DETECTION_385_388_oPCAN_RADAR_13cf3877_Tx: ComBitPosition=160, ComBitSize=15, ComSignalInitValue=16384, ComSignalType=UINT16, ComSystemTemplateSystemSignalRef=DET_RANGE_VELOCITY_386
            DET_RANGE_VELOCITY_387_oRDR_DETECTION_385_388_oPCAN_RADAR_86bfece2_Tx: ComBitPosition=272, ComBitSize=15, ComSignalInitValue=16384, ComSignalType=UINT16, ComSystemTemplateSystemSignalRef=DET_RANGE_VELOCITY_387
            DET_RANGE_VELOCITY_388_oRDR_DETECTION_385_388_oPCAN_RADAR_aaaf7ea5_Tx: ComBitPosition=384, ComBitSize=15, ComSignalInitValue=16384, ComSignalType=UINT16, ComSystemTemplateSystemSignalRef=DET_RANGE_VELOCITY_388
            DET_RANGE_VELOCITY_ERR_385_oRDR_DETECTION_385_388_oPCAN_RADAR_7894b83b_Tx: ComBitPosition=64, ComBitSize=8, ComSignalInitValue=0, ComSignalType=UINT8, ComSystemTemplateSystemSignalRef=DET_RANGE_VELOCITY_ERR_385
            DET_RANGE_VELOCITY_ERR_386_oRDR_DETECTION_385_388_oPCAN_RADAR_1c74c3c5_Tx: ComBitPosition=176, ComBitSize=8, ComSignalInitValue=0, ComSignalType=UINT8, ComSystemTemplateSystemSignalRef=DET_RANGE_VELOCITY_ERR_386
            DET_RANGE_VELOCITY_ERR_387_oRDR_DETECTION_385_388_oPCAN_RADAR_89041750_Tx: ComBitPosition=288, ComBitSize=8, ComSignalInitValue=0, ComSignalType=UINT8, ComSystemTemplateSystemSignalRef=DET_RANGE_VELOCITY_ERR_387
            DET_RANGE_VELOCITY_ERR_388_oRDR_DETECTION_385_388_oPCAN_RADAR_a5148517_Tx: ComBitPosition=400, ComBitSize=8, ComSignalInitValue=0, ComSignalType=UINT8, ComSystemTemplateSystemSignalRef=DET_RANGE_VELOCITY_ERR_388
            DET_RCS_385_oRDR_DETECTION_385_388_oPCAN_RADAR_f0af74d3_Tx: ComBitPosition=128, ComBitSize=8, ComSignalInitValue=128, ComSignalType=UINT8, ComSystemTemplateSystemSignalRef=DET_RCS_385
            DET_RCS_386_oRDR_DETECTION_385_388_oPCAN_RADAR_944f0f2d_Tx: ComBitPosition=240, ComBitSize=8, ComSignalInitValue=128, ComSignalType=UINT8, ComSystemTemplateSystemSignalRef=DET_RCS_386
            DET_RCS_387_oRDR_DETECTION_385_388_oPCAN_RADAR_013fdbb8_Tx: ComBitPosition=352, ComBitSize=8, ComSignalInitValue=128, ComSignalType=UINT8, ComSystemTemplateSystemSignalRef=DET_RCS_387
            DET_RCS_388_oRDR_DETECTION_385_388_oPCAN_RADAR_2d2f49ff_Tx: ComBitPosition=464, ComBitSize=8, ComSignalInitValue=128, ComSignalType=UINT8, ComSystemTemplateSystemSignalRef=DET_RCS_388
            DET_SNR_385_oRDR_DETECTION_385_388_oPCAN_RADAR_2d0120d1_Tx: ComBitPosition=120, ComBitSize=8, ComSignalInitValue=0, ComSignalType=UINT8, ComSystemTemplateSystemSignalRef=DET_SNR_385
            DET_SNR_386_oRDR_DETECTION_385_388_oPCAN_RADAR_49e15b2f_Tx: ComBitPosition=232, ComBitSize=8, ComSignalInitValue=0, ComSignalType=UINT8, ComSystemTemplateSystemSignalRef=DET_SNR_386
            DET_SNR_387_oRDR_DETECTION_385_388_oPCAN_RADAR_dc918fba_Tx: ComBitPosition=344, ComBitSize=8, ComSignalInitValue=0, ComSignalType=UINT8, ComSystemTemplateSystemSignalRef=DET_SNR_387
            DET_SNR_388_oRDR_DETECTION_385_388_oPCAN_RADAR_f0811dfd_Tx: ComBitPosition=456, ComBitSize=8, ComSignalInitValue=0, ComSignalType=UINT8, ComSystemTemplateSystemSignalRef=DET_SNR_388
            DET_SUPER_RES_TARGET_385_oRDR_DETECTION_385_388_oPCAN_RADAR_1c9808b4_Tx: ComBitPosition=87, ComBitSize=1, ComSignalInitValue=0, ComSignalType=BOOLEAN, ComSystemTemplateSystemSignalRef=DET_SUPER_RES_TARGET_385
            DET_SUPER_RES_TARGET_386_oRDR_DETECTION_385_388_oPCAN_RADAR_7878734a_Tx: ComBitPosition=199, ComBitSize=1, ComSignalInitValue=0, ComSignalType=BOOLEAN, ComSystemTemplateSystemSignalRef=DET_SUPER_RES_TARGET_386
            DET_SUPER_RES_TARGET_387_oRDR_DETECTION_385_388_oPCAN_RADAR_ed08a7df_Tx: ComBitPosition=311, ComBitSize=1, ComSignalInitValue=0, ComSignalType=BOOLEAN, ComSystemTemplateSystemSignalRef=DET_SUPER_RES_TARGET_387
            DET_SUPER_RES_TARGET_388_oRDR_DETECTION_385_388_oPCAN_RADAR_c1183598_Tx: ComBitPosition=423, ComBitSize=1, ComSignalInitValue=0, ComSignalType=BOOLEAN, ComSystemTemplateSystemSignalRef=DET_SUPER_RES_TARGET_388
        SG_Detections_389_392_oRDR_DETECTION_389_392_oPCAN_RADAR_25df6300_Tx: ComSystemTemplateSignalGroupRef=SG_Detections_389_392
          83 x ComGroupSignal, all with ComSignalEndianness=LITTLE_ENDIAN, ComTransferProperty=PENDING:
            DET_AZIMUTH_389_oRDR_DETECTION_389_392_oPCAN_RADAR_68aaf4af_Tx: ComBitPosition=88, ComBitSize=13, ComSignalInitValue=0, ComSignalType=UINT16, ComSystemTemplateSystemSignalRef=DET_AZIMUTH_389
            DET_AZIMUTH_390_oRDR_DETECTION_389_392_oPCAN_RADAR_0d8a860b_Tx: ComBitPosition=200, ComBitSize=13, ComSignalInitValue=0, ComSignalType=UINT16, ComSystemTemplateSystemSignalRef=DET_AZIMUTH_390
            DET_AZIMUTH_391_oRDR_DETECTION_389_392_oPCAN_RADAR_98fa529e_Tx: ComBitPosition=312, ComBitSize=13, ComSignalInitValue=0, ComSignalType=UINT16, ComSystemTemplateSystemSignalRef=DET_AZIMUTH_391
            DET_AZIMUTH_392_oRDR_DETECTION_389_392_oPCAN_RADAR_fc1a2960_Tx: ComBitPosition=424, ComBitSize=13, ComSignalInitValue=0, ComSignalType=UINT16, ComSystemTemplateSystemSignalRef=DET_AZIMUTH_392
            DET_AZIMUTH_ERR_389_oRDR_DETECTION_389_392_oPCAN_RADAR_cc1f615a_Tx: ComBitPosition=105, ComBitSize=7, ComSignalInitValue=0, ComSignalType=UINT8, ComSystemTemplateSystemSignalRef=DET_AZIMUTH_ERR_389
            DET_AZIMUTH_ERR_390_oRDR_DETECTION_389_392_oPCAN_RADAR_a93f13fe_Tx: ComBitPosition=217, ComBitSize=7, ComSignalInitValue=0, ComSignalType=UINT8, ComSystemTemplateSystemSignalRef=DET_AZIMUTH_ERR_390
            DET_AZIMUTH_ERR_391_oRDR_DETECTION_389_392_oPCAN_RADAR_3c4fc76b_Tx: ComBitPosition=329, ComBitSize=7, ComSignalInitValue=0, ComSignalType=UINT8, ComSystemTemplateSystemSignalRef=DET_AZIMUTH_ERR_391
            DET_AZIMUTH_ERR_392_oRDR_DETECTION_389_392_oPCAN_RADAR_58afbc95_Tx: ComBitPosition=441, ComBitSize=7, ComSignalInitValue=0, ComSignalType=UINT8, ComSystemTemplateSystemSignalRef=DET_AZIMUTH_ERR_392
            DET_BELOW_RAIN_THOLD_389_oRDR_DETECTION_389_392_oPCAN_RADAR_bdab676f_Tx: ComBitPosition=39, ComBitSize=1, ComSignalInitValue=0, ComSignalType=BOOLEAN, ComSystemTemplateSystemSignalRef=DET_BELOW_RAIN_THOLD_389
            DET_BELOW_RAIN_THOLD_390_oRDR_DETECTION_389_392_oPCAN_RADAR_d88b15cb_Tx: ComBitPosition=151, ComBitSize=1, ComSignalInitValue=0, ComSignalType=BOOLEAN, ComSystemTemplateSystemSignalRef=DET_BELOW_RAIN_THOLD_390
            DET_BELOW_RAIN_THOLD_391_oRDR_DETECTION_389_392_oPCAN_RADAR_4dfbc15e_Tx: ComBitPosition=263, ComBitSize=1, ComSignalInitValue=0, ComSignalType=BOOLEAN, ComSystemTemplateSystemSignalRef=DET_BELOW_RAIN_THOLD_391
            DET_BELOW_RAIN_THOLD_392_oRDR_DETECTION_389_392_oPCAN_RADAR_291bbaa0_Tx: ComBitPosition=375, ComBitSize=1, ComSignalInitValue=0, ComSignalType=BOOLEAN, ComSystemTemplateSystemSignalRef=DET_BELOW_RAIN_THOLD_392
            DET_BI_STATIC_FLAG_389_oRDR_DETECTION_389_392_oPCAN_RADAR_3e86b42a_Tx: ComBitPosition=104, ComBitSize=1, ComSignalInitValue=0, ComSignalType=BOOLEAN, ComSystemTemplateSystemSignalRef=DET_BI_STATIC_FLAG_389
            DET_BI_STATIC_FLAG_390_oRDR_DETECTION_389_392_oPCAN_RADAR_5ba6c68e_Tx: ComBitPosition=216, ComBitSize=1, ComSignalInitValue=0, ComSignalType=BOOLEAN, ComSystemTemplateSystemSignalRef=DET_BI_STATIC_FLAG_390
            DET_BI_STATIC_FLAG_391_oRDR_DETECTION_389_392_oPCAN_RADAR_ced6121b_Tx: ComBitPosition=328, ComBitSize=1, ComSignalInitValue=0, ComSignalType=BOOLEAN, ComSystemTemplateSystemSignalRef=DET_BI_STATIC_FLAG_391
            DET_BI_STATIC_FLAG_392_oRDR_DETECTION_389_392_oPCAN_RADAR_aa3669e5_Tx: ComBitPosition=440, ComBitSize=1, ComSignalInitValue=0, ComSignalType=BOOLEAN, ComSystemTemplateSystemSignalRef=DET_BI_STATIC_FLAG_392
            DET_CONFD_AZIMUTH_389_oRDR_DETECTION_389_392_oPCAN_RADAR_6a4cfe65_Tx: ComBitPosition=118, ComBitSize=2, ComSignalInitValue=0, ComSignalType=UINT8, ComSystemTemplateSystemSignalRef=DET_CONFD_AZIMUTH_389
            DET_CONFD_AZIMUTH_390_oRDR_DETECTION_389_392_oPCAN_RADAR_0f6c8cc1_Tx: ComBitPosition=230, ComBitSize=2, ComSignalInitValue=0, ComSignalType=UINT8, ComSystemTemplateSystemSignalRef=DET_CONFD_AZIMUTH_390
            DET_CONFD_AZIMUTH_391_oRDR_DETECTION_389_392_oPCAN_RADAR_9a1c5854_Tx: ComBitPosition=342, ComBitSize=2, ComSignalInitValue=0, ComSignalType=UINT8, ComSystemTemplateSystemSignalRef=DET_CONFD_AZIMUTH_391
            DET_CONFD_AZIMUTH_392_oRDR_DETECTION_389_392_oPCAN_RADAR_fefc23aa_Tx: ComBitPosition=454, ComBitSize=2, ComSignalInitValue=0, ComSignalType=UINT8, ComSystemTemplateSystemSignalRef=DET_CONFD_AZIMUTH_392
            DET_CONFD_ELEVATION_389_oRDR_DETECTION_389_392_oPCAN_RADAR_68d9ff9f_Tx: ComBitPosition=101, ComBitSize=2, ComSignalInitValue=0, ComSignalType=UINT8, ComSystemTemplateSystemSignalRef=DET_CONFD_ELEVATION_389
            DET_CONFD_ELEVATION_390_oRDR_DETECTION_389_392_oPCAN_RADAR_0df98d3b_Tx: ComBitPosition=213, ComBitSize=2, ComSignalInitValue=0, ComSignalType=UINT8, ComSystemTemplateSystemSignalRef=DET_CONFD_ELEVATION_390
            DET_CONFD_ELEVATION_391_oRDR_DETECTION_389_392_oPCAN_RADAR_988959ae_Tx: ComBitPosition=325, ComBitSize=2, ComSignalInitValue=0, ComSignalType=UINT8, ComSystemTemplateSystemSignalRef=DET_CONFD_ELEVATION_391
            DET_CONFD_ELEVATION_392_oRDR_DETECTION_389_392_oPCAN_RADAR_fc692250_Tx: ComBitPosition=437, ComBitSize=2, ComSignalInitValue=0, ComSignalType=UINT8, ComSystemTemplateSystemSignalRef=DET_CONFD_ELEVATION_392
            DET_ELEVATION_389_oRDR_DETECTION_389_392_oPCAN_RADAR_b9192ba3_Tx: ComBitPosition=72, ComBitSize=8, ComSignalInitValue=0, ComSignalType=UINT8, ComSystemTemplateSystemSignalRef=DET_ELEVATION_389
            DET_ELEVATION_390_oRDR_DETECTION_389_392_oPCAN_RADAR_dc395907_Tx: ComBitPosition=184, ComBitSize=8, ComSignalInitValue=0, ComSignalType=UINT8, ComSystemTemplateSystemSignalRef=DET_ELEVATION_390
            DET_ELEVATION_391_oRDR_DETECTION_389_392_oPCAN_RADAR_49498d92_Tx: ComBitPosition=296, ComBitSize=8, ComSignalInitValue=0, ComSignalType=UINT8, ComSystemTemplateSystemSignalRef=DET_ELEVATION_391
            DET_ELEVATION_392_oRDR_DETECTION_389_392_oPCAN_RADAR_2da9f66c_Tx: ComBitPosition=408, ComBitSize=8, ComSignalInitValue=0, ComSignalType=UINT8, ComSystemTemplateSystemSignalRef=DET_ELEVATION_392
            DET_ELEVATION_ERR_389_oRDR_DETECTION_389_392_oPCAN_RADAR_3e20b3d6_Tx: ComBitPosition=80, ComBitSize=6, ComSignalInitValue=0, ComSignalType=UINT8, ComSystemTemplateSystemSignalRef=DET_ELEVATION_ERR_389
            DET_ELEVATION_ERR_390_oRDR_DETECTION_389_392_oPCAN_RADAR_5b00c172_Tx: ComBitPosition=192, ComBitSize=6, ComSignalInitValue=0, ComSignalType=UINT8, ComSystemTemplateSystemSignalRef=DET_ELEVATION_ERR_390
            DET_ELEVATION_ERR_391_oRDR_DETECTION_389_392_oPCAN_RADAR_ce7015e7_Tx: ComBitPosition=304, ComBitSize=6, ComSignalInitValue=0, ComSignalType=UINT8, ComSystemTemplateSystemSignalRef=DET_ELEVATION_ERR_391
            DET_ELEVATION_ERR_392_oRDR_DETECTION_389_392_oPCAN_RADAR_aa906e19_Tx: ComBitPosition=416, ComBitSize=6, ComSignalInitValue=0, ComSignalType=UINT8, ComSystemTemplateSystemSignalRef=DET_ELEVATION_ERR_392
            DET_EXISTENCE_PROB_389_oRDR_DETECTION_389_392_oPCAN_RADAR_ecbfc6b6_Tx: ComBitPosition=112, ComBitSize=6, ComSignalInitValue=0, ComSignalType=UINT8, ComSystemTemplateSystemSignalRef=DET_EXISTENCE_PROB_389
            DET_EXISTENCE_PROB_390_oRDR_DETECTION_389_392_oPCAN_RADAR_899fb412_Tx: ComBitPosition=224, ComBitSize=6, ComSignalInitValue=0, ComSignalType=UINT8, ComSystemTemplateSystemSignalRef=DET_EXISTENCE_PROB_390
            DET_EXISTENCE_PROB_391_oRDR_DETECTION_389_392_oPCAN_RADAR_1cef6087_Tx: ComBitPosition=336, ComBitSize=6, ComSignalInitValue=0, ComSignalType=UINT8, ComSystemTemplateSystemSignalRef=DET_EXISTENCE_PROB_391
            DET_EXISTENCE_PROB_392_oRDR_DETECTION_389_392_oPCAN_RADAR_780f1b79_Tx: ComBitPosition=448, ComBitSize=6, ComSignalInitValue=0, ComSignalType=UINT8, ComSystemTemplateSystemSignalRef=DET_EXISTENCE_PROB_392
            DET_HVC_FLAG_389_oRDR_DETECTION_389_392_oPCAN_RADAR_0dcb85c9_Tx: ComBitPosition=86, ComBitSize=1, ComSignalInitValue=0, ComSignalType=BOOLEAN, ComSystemTemplateSystemSignalRef=DET_HVC_FLAG_389
            DET_HVC_FLAG_390_oRDR_DETECTION_389_392_oPCAN_RADAR_68ebf76d_Tx: ComBitPosition=198, ComBitSize=1, ComSignalInitValue=0, ComSignalType=BOOLEAN, ComSystemTemplateSystemSignalRef=DET_HVC_FLAG_390
            DET_HVC_FLAG_391_oRDR_DETECTION_389_392_oPCAN_RADAR_fd9b23f8_Tx: ComBitPosition=310, ComBitSize=1, ComSignalInitValue=0, ComSignalType=BOOLEAN, ComSystemTemplateSystemSignalRef=DET_HVC_FLAG_391
            DET_HVC_FLAG_392_oRDR_DETECTION_389_392_oPCAN_RADAR_997b5806_Tx: ComBitPosition=422, ComBitSize=1, ComSignalInitValue=0, ComSignalType=BOOLEAN, ComSystemTemplateSystemSignalRef=DET_HVC_FLAG_392
            DET_IDM_389_oRDR_DETECTION_389_392_oPCAN_RADAR_8699be74_Tx: ComBitPosition=63, ComBitSize=1, ComSignalInitValue=0, ComSignalType=BOOLEAN, ComSystemTemplateSystemSignalRef=DET_IDM_389
            DET_IDM_390_oRDR_DETECTION_389_392_oPCAN_RADAR_e3b9ccd0_Tx: ComBitPosition=175, ComBitSize=1, ComSignalInitValue=0, ComSignalType=BOOLEAN, ComSystemTemplateSystemSignalRef=DET_IDM_390
            DET_IDM_391_oRDR_DETECTION_389_392_oPCAN_RADAR_76c91845_Tx: ComBitPosition=287, ComBitSize=1, ComSignalInitValue=0, ComSignalType=BOOLEAN, ComSystemTemplateSystemSignalRef=DET_IDM_391
            DET_IDM_392_oRDR_DETECTION_389_392_oPCAN_RADAR_122963bb_Tx: ComBitPosition=399, ComBitSize=1, ComSignalInitValue=0, ComSignalType=BOOLEAN, ComSystemTemplateSystemSignalRef=DET_IDM_392
            DET_MH_CRC16_389_392_oRDR_DETECTION_389_392_oPCAN_RADAR_a157b10b_Tx: ComBitPosition=0, ComBitSize=16, ComSignalInitValue=0, ComSignalType=UINT16, ComSystemTemplateSystemSignalRef=DET_MH_CRC16_389_392
            DET_MH_CYCLE_COUNTER_389_392_oRDR_DETECTION_389_392_oPCAN_RADAR_2522103c_Tx: ComBitPosition=16, ComBitSize=8, ComSignalInitValue=0, ComSignalType=UINT8, ComSystemTemplateSystemSignalRef=DET_MH_CYCLE_COUNTER_389_392
            DET_MH_SCAN_INDEX_4LSB_389_392_oRDR_DETECTION_389_392_oPCAN_RADAR_e90835b0_Tx: ComBitPosition=476, ComBitSize=4, ComSignalInitValue=0, ComSignalType=UINT8, ComSystemTemplateSystemSignalRef=DET_MH_SCAN_INDEX_4LSB_389_392
            DET_MTD_389_oRDR_DETECTION_389_392_oPCAN_RADAR_e02a8caf_Tx: ComBitPosition=47, ComBitSize=1, ComSignalInitValue=0, ComSignalType=BOOLEAN, ComSystemTemplateSystemSignalRef=DET_MTD_389
            DET_MTD_390_oRDR_DETECTION_389_392_oPCAN_RADAR_850afe0b_Tx: ComBitPosition=159, ComBitSize=1, ComSignalInitValue=0, ComSignalType=BOOLEAN, ComSystemTemplateSystemSignalRef=DET_MTD_390
            DET_MTD_391_oRDR_DETECTION_389_392_oPCAN_RADAR_107a2a9e_Tx: ComBitPosition=271, ComBitSize=1, ComSignalInitValue=0, ComSignalType=BOOLEAN, ComSystemTemplateSystemSignalRef=DET_MTD_391
            DET_MTD_392_oRDR_DETECTION_389_392_oPCAN_RADAR_749a5160_Tx: ComBitPosition=383, ComBitSize=1, ComSignalInitValue=0, ComSignalType=BOOLEAN, ComSystemTemplateSystemSignalRef=DET_MTD_392
            DET_PROB_1STAZHYPO_389_oRDR_DETECTION_389_392_oPCAN_RADAR_739e6462_Tx: ComBitPosition=103, ComBitSize=1, ComSignalInitValue=0, ComSignalType=BOOLEAN, ComSystemTemplateSystemSignalRef=DET_PROB_1STAZHYPO_389
            DET_PROB_1STAZHYPO_390_oRDR_DETECTION_389_392_oPCAN_RADAR_16be16c6_Tx: ComBitPosition=215, ComBitSize=1, ComSignalInitValue=0, ComSignalType=BOOLEAN, ComSystemTemplateSystemSignalRef=DET_PROB_1STAZHYPO_390
            DET_PROB_1STAZHYPO_391_oRDR_DETECTION_389_392_oPCAN_RADAR_83cec253_Tx: ComBitPosition=327, ComBitSize=1, ComSignalInitValue=0, ComSignalType=BOOLEAN, ComSystemTemplateSystemSignalRef=DET_PROB_1STAZHYPO_391
            DET_PROB_1STAZHYPO_392_oRDR_DETECTION_389_392_oPCAN_RADAR_e72eb9ad_Tx: ComBitPosition=439, ComBitSize=1, ComSignalInitValue=0, ComSignalType=BOOLEAN, ComSystemTemplateSystemSignalRef=DET_PROB_1STAZHYPO_392
            DET_RANGE_389_oRDR_DETECTION_389_392_oPCAN_RADAR_78318714_Tx: ComBitPosition=24, ComBitSize=15, ComSignalInitValue=0, ComSignalType=UINT16, ComSystemTemplateSystemSignalRef=DET_RANGE_389
            DET_RANGE_390_oRDR_DETECTION_389_392_oPCAN_RADAR_1d11f5b0_Tx: ComBitPosition=136, ComBitSize=15, ComSignalInitValue=0, ComSignalType=UINT16, ComSystemTemplateSystemSignalRef=DET_RANGE_390
            DET_RANGE_391_oRDR_DETECTION_389_392_oPCAN_RADAR_88612125_Tx: ComBitPosition=248, ComBitSize=15, ComSignalInitValue=0, ComSignalType=UINT16, ComSystemTemplateSystemSignalRef=DET_RANGE_391
            DET_RANGE_392_oRDR_DETECTION_389_392_oPCAN_RADAR_ec815adb_Tx: ComBitPosition=360, ComBitSize=15, ComSignalInitValue=0, ComSignalType=UINT16, ComSystemTemplateSystemSignalRef=DET_RANGE_392
            DET_RANGE_ERR_389_oRDR_DETECTION_389_392_oPCAN_RADAR_dfd93d7d_Tx: ComBitPosition=40, ComBitSize=7, ComSignalInitValue=0, ComSignalType=UINT8, ComSystemTemplateSystemSignalRef=DET_RANGE_ERR_389
            DET_RANGE_ERR_390_oRDR_DETECTION_389_392_oPCAN_RADAR_baf94fd9_Tx: ComBitPosition=152, ComBitSize=7, ComSignalInitValue=0, ComSignalType=UINT8, ComSystemTemplateSystemSignalRef=DET_RANGE_ERR_390
            DET_RANGE_ERR_391_oRDR_DETECTION_389_392_oPCAN_RADAR_2f899b4c_Tx: ComBitPosition=264, ComBitSize=7, ComSignalInitValue=0, ComSignalType=UINT8, ComSystemTemplateSystemSignalRef=DET_RANGE_ERR_391
            DET_RANGE_ERR_392_oRDR_DETECTION_389_392_oPCAN_RADAR_4b69e0b2_Tx: ComBitPosition=376, ComBitSize=7, ComSignalInitValue=0, ComSignalType=UINT8, ComSystemTemplateSystemSignalRef=DET_RANGE_ERR_392
            DET_RANGE_VELOCITY_389_oRDR_DETECTION_389_392_oPCAN_RADAR_0d974531_Tx: ComBitPosition=48, ComBitSize=15, ComSignalInitValue=16384, ComSignalType=UINT16, ComSystemTemplateSystemSignalRef=DET_RANGE_VELOCITY_389
            DET_RANGE_VELOCITY_390_oRDR_DETECTION_389_392_oPCAN_RADAR_68b73795_Tx: ComBitPosition=160, ComBitSize=15, ComSignalInitValue=16384, ComSignalType=UINT16, ComSystemTemplateSystemSignalRef=DET_RANGE_VELOCITY_390
            DET_RANGE_VELOCITY_391_oRDR_DETECTION_389_392_oPCAN_RADAR_fdc7e300_Tx: ComBitPosition=272, ComBitSize=15, ComSignalInitValue=16384, ComSignalType=UINT16, ComSystemTemplateSystemSignalRef=DET_RANGE_VELOCITY_391
            DET_RANGE_VELOCITY_392_oRDR_DETECTION_389_392_oPCAN_RADAR_992798fe_Tx: ComBitPosition=384, ComBitSize=15, ComSignalInitValue=16384, ComSignalType=UINT16, ComSystemTemplateSystemSignalRef=DET_RANGE_VELOCITY_392
            DET_RANGE_VELOCITY_ERR_389_oRDR_DETECTION_389_392_oPCAN_RADAR_022cbe83_Tx: ComBitPosition=64, ComBitSize=8, ComSignalInitValue=0, ComSignalType=UINT8, ComSystemTemplateSystemSignalRef=DET_RANGE_VELOCITY_ERR_389
            DET_RANGE_VELOCITY_ERR_390_oRDR_DETECTION_389_392_oPCAN_RADAR_670ccc27_Tx: ComBitPosition=176, ComBitSize=8, ComSignalInitValue=0, ComSignalType=UINT8, ComSystemTemplateSystemSignalRef=DET_RANGE_VELOCITY_ERR_390
            DET_RANGE_VELOCITY_ERR_391_oRDR_DETECTION_389_392_oPCAN_RADAR_f27c18b2_Tx: ComBitPosition=288, ComBitSize=8, ComSignalInitValue=0, ComSignalType=UINT8, ComSystemTemplateSystemSignalRef=DET_RANGE_VELOCITY_ERR_391
            DET_RANGE_VELOCITY_ERR_392_oRDR_DETECTION_389_392_oPCAN_RADAR_969c634c_Tx: ComBitPosition=400, ComBitSize=8, ComSignalInitValue=0, ComSignalType=UINT8, ComSystemTemplateSystemSignalRef=DET_RANGE_VELOCITY_ERR_392
            DET_RCS_389_oRDR_DETECTION_389_392_oPCAN_RADAR_8a17726b_Tx: ComBitPosition=128, ComBitSize=8, ComSignalInitValue=128, ComSignalType=UINT8, ComSystemTemplateSystemSignalRef=DET_RCS_389
            DET_RCS_390_oRDR_DETECTION_389_392_oPCAN_RADAR_ef3700cf_Tx: ComBitPosition=240, ComBitSize=8, ComSignalInitValue=128, ComSignalType=UINT8, ComSystemTemplateSystemSignalRef=DET_RCS_390
            DET_RCS_391_oRDR_DETECTION_389_392_oPCAN_RADAR_7a47d45a_Tx: ComBitPosition=352, ComBitSize=8, ComSignalInitValue=128, ComSignalType=UINT8, ComSystemTemplateSystemSignalRef=DET_RCS_391
            DET_RCS_392_oRDR_DETECTION_389_392_oPCAN_RADAR_1ea7afa4_Tx: ComBitPosition=464, ComBitSize=8, ComSignalInitValue=128, ComSignalType=UINT8, ComSystemTemplateSystemSignalRef=DET_RCS_392
            DET_SNR_389_oRDR_DETECTION_389_392_oPCAN_RADAR_57b92669_Tx: ComBitPosition=120, ComBitSize=8, ComSignalInitValue=0, ComSignalType=UINT8, ComSystemTemplateSystemSignalRef=DET_SNR_389
            DET_SNR_390_oRDR_DETECTION_389_392_oPCAN_RADAR_329954cd_Tx: ComBitPosition=232, ComBitSize=8, ComSignalInitValue=0, ComSignalType=UINT8, ComSystemTemplateSystemSignalRef=DET_SNR_390
            DET_SNR_391_oRDR_DETECTION_389_392_oPCAN_RADAR_a7e98058_Tx: ComBitPosition=344, ComBitSize=8, ComSignalInitValue=0, ComSignalType=UINT8, ComSystemTemplateSystemSignalRef=DET_SNR_391
            DET_SNR_392_oRDR_DETECTION_389_392_oPCAN_RADAR_c309fba6_Tx: ComBitPosition=456, ComBitSize=8, ComSignalInitValue=0, ComSignalType=UINT8, ComSystemTemplateSystemSignalRef=DET_SNR_392
            DET_SUPER_RES_TARGET_389_oRDR_DETECTION_389_392_oPCAN_RADAR_66200e0c_Tx: ComBitPosition=87, ComBitSize=1, ComSignalInitValue=0, ComSignalType=BOOLEAN, ComSystemTemplateSystemSignalRef=DET_SUPER_RES_TARGET_389
            DET_SUPER_RES_TARGET_390_oRDR_DETECTION_389_392_oPCAN_RADAR_03007ca8_Tx: ComBitPosition=199, ComBitSize=1, ComSignalInitValue=0, ComSignalType=BOOLEAN, ComSystemTemplateSystemSignalRef=DET_SUPER_RES_TARGET_390
            DET_SUPER_RES_TARGET_391_oRDR_DETECTION_389_392_oPCAN_RADAR_9670a83d_Tx: ComBitPosition=311, ComBitSize=1, ComSignalInitValue=0, ComSignalType=BOOLEAN, ComSystemTemplateSystemSignalRef=DET_SUPER_RES_TARGET_391
            DET_SUPER_RES_TARGET_392_oRDR_DETECTION_389_392_oPCAN_RADAR_f290d3c3_Tx: ComBitPosition=423, ComBitSize=1, ComSignalInitValue=0, ComSignalType=BOOLEAN, ComSystemTemplateSystemSignalRef=DET_SUPER_RES_TARGET_392
        SG_Detections_393_396_oRDR_DETECTION_393_396_oPCAN_RADAR_17d40b28_Tx: ComSystemTemplateSignalGroupRef=SG_Detections_393_396
          83 x ComGroupSignal, all with ComSignalEndianness=LITTLE_ENDIAN, ComTransferProperty=PENDING:
            DET_AZIMUTH_393_oRDR_DETECTION_393_396_oPCAN_RADAR_74adfedb_Tx: ComBitPosition=88, ComBitSize=13, ComSignalInitValue=0, ComSignalType=UINT16, ComSystemTemplateSystemSignalRef=DET_AZIMUTH_393
            DET_AZIMUTH_394_oRDR_DETECTION_393_396_oPCAN_RADAR_281dddb2_Tx: ComBitPosition=200, ComBitSize=13, ComSignalInitValue=0, ComSignalType=UINT16, ComSystemTemplateSystemSignalRef=DET_AZIMUTH_394
            DET_AZIMUTH_395_oRDR_DETECTION_393_396_oPCAN_RADAR_bd6d0927_Tx: ComBitPosition=312, ComBitSize=13, ComSignalInitValue=0, ComSignalType=UINT16, ComSystemTemplateSystemSignalRef=DET_AZIMUTH_395
            DET_AZIMUTH_396_oRDR_DETECTION_393_396_oPCAN_RADAR_d98d72d9_Tx: ComBitPosition=424, ComBitSize=13, ComSignalInitValue=0, ComSignalType=UINT16, ComSystemTemplateSystemSignalRef=DET_AZIMUTH_396
            DET_AZIMUTH_ERR_393_oRDR_DETECTION_393_396_oPCAN_RADAR_d0186b2e_Tx: ComBitPosition=105, ComBitSize=7, ComSignalInitValue=0, ComSignalType=UINT8, ComSystemTemplateSystemSignalRef=DET_AZIMUTH_ERR_393
            DET_AZIMUTH_ERR_394_oRDR_DETECTION_393_396_oPCAN_RADAR_8ca84847_Tx: ComBitPosition=217, ComBitSize=7, ComSignalInitValue=0, ComSignalType=UINT8, ComSystemTemplateSystemSignalRef=DET_AZIMUTH_ERR_394
            DET_AZIMUTH_ERR_395_oRDR_DETECTION_393_396_oPCAN_RADAR_19d89cd2_Tx: ComBitPosition=329, ComBitSize=7, ComSignalInitValue=0, ComSignalType=UINT8, ComSystemTemplateSystemSignalRef=DET_AZIMUTH_ERR_395
            DET_AZIMUTH_ERR_396_oRDR_DETECTION_393_396_oPCAN_RADAR_7d38e72c_Tx: ComBitPosition=441, ComBitSize=7, ComSignalInitValue=0, ComSignalType=UINT8, ComSystemTemplateSystemSignalRef=DET_AZIMUTH_ERR_396
            DET_BELOW_RAIN_THOLD_393_oRDR_DETECTION_393_396_oPCAN_RADAR_a1ac6d1b_Tx: ComBitPosition=39, ComBitSize=1, ComSignalInitValue=0, ComSignalType=BOOLEAN, ComSystemTemplateSystemSignalRef=DET_BELOW_RAIN_THOLD_393
            DET_BELOW_RAIN_THOLD_394_oRDR_DETECTION_393_396_oPCAN_RADAR_fd1c4e72_Tx: ComBitPosition=151, ComBitSize=1, ComSignalInitValue=0, ComSignalType=BOOLEAN, ComSystemTemplateSystemSignalRef=DET_BELOW_RAIN_THOLD_394
            DET_BELOW_RAIN_THOLD_395_oRDR_DETECTION_393_396_oPCAN_RADAR_686c9ae7_Tx: ComBitPosition=263, ComBitSize=1, ComSignalInitValue=0, ComSignalType=BOOLEAN, ComSystemTemplateSystemSignalRef=DET_BELOW_RAIN_THOLD_395
            DET_BELOW_RAIN_THOLD_396_oRDR_DETECTION_393_396_oPCAN_RADAR_0c8ce119_Tx: ComBitPosition=375, ComBitSize=1, ComSignalInitValue=0, ComSignalType=BOOLEAN, ComSystemTemplateSystemSignalRef=DET_BELOW_RAIN_THOLD_396
            DET_BI_STATIC_FLAG_393_oRDR_DETECTION_393_396_oPCAN_RADAR_2281be5e_Tx: ComBitPosition=104, ComBitSize=1, ComSignalInitValue=0, ComSignalType=BOOLEAN, ComSystemTemplateSystemSignalRef=DET_BI_STATIC_FLAG_393
            DET_BI_STATIC_FLAG_394_oRDR_DETECTION_393_396_oPCAN_RADAR_7e319d37_Tx: ComBitPosition=216, ComBitSize=1, ComSignalInitValue=0, ComSignalType=BOOLEAN, ComSystemTemplateSystemSignalRef=DET_BI_STATIC_FLAG_394
            DET_BI_STATIC_FLAG_395_oRDR_DETECTION_393_396_oPCAN_RADAR_eb4149a2_Tx: ComBitPosition=328, ComBitSize=1, ComSignalInitValue=0, ComSignalType=BOOLEAN, ComSystemTemplateSystemSignalRef=DET_BI_STATIC_FLAG_395
            DET_BI_STATIC_FLAG_396_oRDR_DETECTION_393_396_oPCAN_RADAR_8fa1325c_Tx: ComBitPosition=440, ComBitSize=1, ComSignalInitValue=0, ComSignalType=BOOLEAN, ComSystemTemplateSystemSignalRef=DET_BI_STATIC_FLAG_396
            DET_CONFD_AZIMUTH_393_oRDR_DETECTION_393_396_oPCAN_RADAR_764bf411_Tx: ComBitPosition=118, ComBitSize=2, ComSignalInitValue=0, ComSignalType=UINT8, ComSystemTemplateSystemSignalRef=DET_CONFD_AZIMUTH_393
            DET_CONFD_AZIMUTH_394_oRDR_DETECTION_393_396_oPCAN_RADAR_2afbd778_Tx: ComBitPosition=230, ComBitSize=2, ComSignalInitValue=0, ComSignalType=UINT8, ComSystemTemplateSystemSignalRef=DET_CONFD_AZIMUTH_394
            DET_CONFD_AZIMUTH_395_oRDR_DETECTION_393_396_oPCAN_RADAR_bf8b03ed_Tx: ComBitPosition=342, ComBitSize=2, ComSignalInitValue=0, ComSignalType=UINT8, ComSystemTemplateSystemSignalRef=DET_CONFD_AZIMUTH_395
            DET_CONFD_AZIMUTH_396_oRDR_DETECTION_393_396_oPCAN_RADAR_db6b7813_Tx: ComBitPosition=454, ComBitSize=2, ComSignalInitValue=0, ComSignalType=UINT8, ComSystemTemplateSystemSignalRef=DET_CONFD_AZIMUTH_396
            DET_CONFD_ELEVATION_393_oRDR_DETECTION_393_396_oPCAN_RADAR_74def5eb_Tx: ComBitPosition=101, ComBitSize=2, ComSignalInitValue=0, ComSignalType=UINT8, ComSystemTemplateSystemSignalRef=DET_CONFD_ELEVATION_393
            DET_CONFD_ELEVATION_394_oRDR_DETECTION_393_396_oPCAN_RADAR_286ed682_Tx: ComBitPosition=213, ComBitSize=2, ComSignalInitValue=0, ComSignalType=UINT8, ComSystemTemplateSystemSignalRef=DET_CONFD_ELEVATION_394
            DET_CONFD_ELEVATION_395_oRDR_DETECTION_393_396_oPCAN_RADAR_bd1e0217_Tx: ComBitPosition=325, ComBitSize=2, ComSignalInitValue=0, ComSignalType=UINT8, ComSystemTemplateSystemSignalRef=DET_CONFD_ELEVATION_395
            DET_CONFD_ELEVATION_396_oRDR_DETECTION_393_396_oPCAN_RADAR_d9fe79e9_Tx: ComBitPosition=437, ComBitSize=2, ComSignalInitValue=0, ComSignalType=UINT8, ComSystemTemplateSystemSignalRef=DET_CONFD_ELEVATION_396
            DET_ELEVATION_393_oRDR_DETECTION_393_396_oPCAN_RADAR_a51e21d7_Tx: ComBitPosition=72, ComBitSize=8, ComSignalInitValue=0, ComSignalType=UINT8, ComSystemTemplateSystemSignalRef=DET_ELEVATION_393
            DET_ELEVATION_394_oRDR_DETECTION_393_396_oPCAN_RADAR_f9ae02be_Tx: ComBitPosition=184, ComBitSize=8, ComSignalInitValue=0, ComSignalType=UINT8, ComSystemTemplateSystemSignalRef=DET_ELEVATION_394
            DET_ELEVATION_395_oRDR_DETECTION_393_396_oPCAN_RADAR_6cded62b_Tx: ComBitPosition=296, ComBitSize=8, ComSignalInitValue=0, ComSignalType=UINT8, ComSystemTemplateSystemSignalRef=DET_ELEVATION_395
            DET_ELEVATION_396_oRDR_DETECTION_393_396_oPCAN_RADAR_083eadd5_Tx: ComBitPosition=408, ComBitSize=8, ComSignalInitValue=0, ComSignalType=UINT8, ComSystemTemplateSystemSignalRef=DET_ELEVATION_396
            DET_ELEVATION_ERR_393_oRDR_DETECTION_393_396_oPCAN_RADAR_2227b9a2_Tx: ComBitPosition=80, ComBitSize=6, ComSignalInitValue=0, ComSignalType=UINT8, ComSystemTemplateSystemSignalRef=DET_ELEVATION_ERR_393
            DET_ELEVATION_ERR_394_oRDR_DETECTION_393_396_oPCAN_RADAR_7e979acb_Tx: ComBitPosition=192, ComBitSize=6, ComSignalInitValue=0, ComSignalType=UINT8, ComSystemTemplateSystemSignalRef=DET_ELEVATION_ERR_394
            DET_ELEVATION_ERR_395_oRDR_DETECTION_393_396_oPCAN_RADAR_ebe74e5e_Tx: ComBitPosition=304, ComBitSize=6, ComSignalInitValue=0, ComSignalType=UINT8, ComSystemTemplateSystemSignalRef=DET_ELEVATION_ERR_395
            DET_ELEVATION_ERR_396_oRDR_DETECTION_393_396_oPCAN_RADAR_8f0735a0_Tx: ComBitPosition=416, ComBitSize=6, ComSignalInitValue=0, ComSignalType=UINT8, ComSystemTemplateSystemSignalRef=DET_ELEVATION_ERR_396
            DET_EXISTENCE_PROB_393_oRDR_DETECTION_393_396_oPCAN_RADAR_f0b8ccc2_Tx: ComBitPosition=112, ComBitSize=6, ComSignalInitValue=0, ComSignalType=UINT8, ComSystemTemplateSystemSignalRef=DET_EXISTENCE_PROB_393
            DET_EXISTENCE_PROB_394_oRDR_DETECTION_393_396_oPCAN_RADAR_ac08efab_Tx: ComBitPosition=224, ComBitSize=6, ComSignalInitValue=0, ComSignalType=UINT8, ComSystemTemplateSystemSignalRef=DET_EXISTENCE_PROB_394
            DET_EXISTENCE_PROB_395_oRDR_DETECTION_393_396_oPCAN_RADAR_39783b3e_Tx: ComBitPosition=336, ComBitSize=6, ComSignalInitValue=0, ComSignalType=UINT8, ComSystemTemplateSystemSignalRef=DET_EXISTENCE_PROB_395
            DET_EXISTENCE_PROB_396_oRDR_DETECTION_393_396_oPCAN_RADAR_5d9840c0_Tx: ComBitPosition=448, ComBitSize=6, ComSignalInitValue=0, ComSignalType=UINT8, ComSystemTemplateSystemSignalRef=DET_EXISTENCE_PROB_396
            DET_HVC_FLAG_393_oRDR_DETECTION_393_396_oPCAN_RADAR_11cc8fbd_Tx: ComBitPosition=86, ComBitSize=1, ComSignalInitValue=0, ComSignalType=BOOLEAN, ComSystemTemplateSystemSignalRef=DET_HVC_FLAG_393
            DET_HVC_FLAG_394_oRDR_DETECTION_393_396_oPCAN_RADAR_4d7cacd4_Tx: ComBitPosition=198, ComBitSize=1, ComSignalInitValue=0, ComSignalType=BOOLEAN, ComSystemTemplateSystemSignalRef=DET_HVC_FLAG_394
            DET_HVC_FLAG_395_oRDR_DETECTION_393_396_oPCAN_RADAR_d80c7841_Tx: ComBitPosition=310, ComBitSize=1, ComSignalInitValue=0, ComSignalType=BOOLEAN, ComSystemTemplateSystemSignalRef=DET_HVC_FLAG_395
            DET_HVC_FLAG_396_oRDR_DETECTION_393_396_oPCAN_RADAR_bcec03bf_Tx: ComBitPosition=422, ComBitSize=1, ComSignalInitValue=0, ComSignalType=BOOLEAN, ComSystemTemplateSystemSignalRef=DET_HVC_FLAG_396
            DET_IDM_393_oRDR_DETECTION_393_396_oPCAN_RADAR_9a9eb400_Tx: ComBitPosition=63, ComBitSize=1, ComSignalInitValue=0, ComSignalType=BOOLEAN, ComSystemTemplateSystemSignalRef=DET_IDM_393
            DET_IDM_394_oRDR_DETECTION_393_396_oPCAN_RADAR_c62e9769_Tx: ComBitPosition=175, ComBitSize=1, ComSignalInitValue=0, ComSignalType=BOOLEAN, ComSystemTemplateSystemSignalRef=DET_IDM_394
            DET_IDM_395_oRDR_DETECTION_393_396_oPCAN_RADAR_535e43fc_Tx: ComBitPosition=287, ComBitSize=1, ComSignalInitValue=0, ComSignalType=BOOLEAN, ComSystemTemplateSystemSignalRef=DET_IDM_395
            DET_IDM_396_oRDR_DETECTION_393_396_oPCAN_RADAR_37be3802_Tx: ComBitPosition=399, ComBitSize=1, ComSignalInitValue=0, ComSignalType=BOOLEAN, ComSystemTemplateSystemSignalRef=DET_IDM_396
            DET_MH_CRC16_393_396_oRDR_DETECTION_393_396_oPCAN_RADAR_935cd923_Tx: ComBitPosition=0, ComBitSize=16, ComSignalInitValue=0, ComSignalType=UINT16, ComSystemTemplateSystemSignalRef=DET_MH_CRC16_393_396
            DET_MH_CYCLE_COUNTER_393_396_oRDR_DETECTION_393_396_oPCAN_RADAR_17297814_Tx: ComBitPosition=16, ComBitSize=8, ComSignalInitValue=0, ComSignalType=UINT8, ComSystemTemplateSystemSignalRef=DET_MH_CYCLE_COUNTER_393_396
            DET_MH_SCAN_INDEX_4LSB_393_396_oRDR_DETECTION_393_396_oPCAN_RADAR_db035d98_Tx: ComBitPosition=476, ComBitSize=4, ComSignalInitValue=0, ComSignalType=UINT8, ComSystemTemplateSystemSignalRef=DET_MH_SCAN_INDEX_4LSB_393_396
            DET_MTD_393_oRDR_DETECTION_393_396_oPCAN_RADAR_fc2d86db_Tx: ComBitPosition=47, ComBitSize=1, ComSignalInitValue=0, ComSignalType=BOOLEAN, ComSystemTemplateSystemSignalRef=DET_MTD_393
            DET_MTD_394_oRDR_DETECTION_393_396_oPCAN_RADAR_a09da5b2_Tx: ComBitPosition=159, ComBitSize=1, ComSignalInitValue=0, ComSignalType=BOOLEAN, ComSystemTemplateSystemSignalRef=DET_MTD_394
            DET_MTD_395_oRDR_DETECTION_393_396_oPCAN_RADAR_35ed7127_Tx: ComBitPosition=271, ComBitSize=1, ComSignalInitValue=0, ComSignalType=BOOLEAN, ComSystemTemplateSystemSignalRef=DET_MTD_395
            DET_MTD_396_oRDR_DETECTION_393_396_oPCAN_RADAR_510d0ad9_Tx: ComBitPosition=383, ComBitSize=1, ComSignalInitValue=0, ComSignalType=BOOLEAN, ComSystemTemplateSystemSignalRef=DET_MTD_396
            DET_PROB_1STAZHYPO_393_oRDR_DETECTION_393_396_oPCAN_RADAR_6f996e16_Tx: ComBitPosition=103, ComBitSize=1, ComSignalInitValue=0, ComSignalType=BOOLEAN, ComSystemTemplateSystemSignalRef=DET_PROB_1STAZHYPO_393
            DET_PROB_1STAZHYPO_394_oRDR_DETECTION_393_396_oPCAN_RADAR_33294d7f_Tx: ComBitPosition=215, ComBitSize=1, ComSignalInitValue=0, ComSignalType=BOOLEAN, ComSystemTemplateSystemSignalRef=DET_PROB_1STAZHYPO_394
            DET_PROB_1STAZHYPO_395_oRDR_DETECTION_393_396_oPCAN_RADAR_a65999ea_Tx: ComBitPosition=327, ComBitSize=1, ComSignalInitValue=0, ComSignalType=BOOLEAN, ComSystemTemplateSystemSignalRef=DET_PROB_1STAZHYPO_395
            DET_PROB_1STAZHYPO_396_oRDR_DETECTION_393_396_oPCAN_RADAR_c2b9e214_Tx: ComBitPosition=439, ComBitSize=1, ComSignalInitValue=0, ComSignalType=BOOLEAN, ComSystemTemplateSystemSignalRef=DET_PROB_1STAZHYPO_396
            DET_RANGE_393_oRDR_DETECTION_393_396_oPCAN_RADAR_64368d60_Tx: ComBitPosition=24, ComBitSize=15, ComSignalInitValue=0, ComSignalType=UINT16, ComSystemTemplateSystemSignalRef=DET_RANGE_393
            DET_RANGE_394_oRDR_DETECTION_393_396_oPCAN_RADAR_3886ae09_Tx: ComBitPosition=136, ComBitSize=15, ComSignalInitValue=0, ComSignalType=UINT16, ComSystemTemplateSystemSignalRef=DET_RANGE_394
            DET_RANGE_395_oRDR_DETECTION_393_396_oPCAN_RADAR_adf67a9c_Tx: ComBitPosition=248, ComBitSize=15, ComSignalInitValue=0, ComSignalType=UINT16, ComSystemTemplateSystemSignalRef=DET_RANGE_395
            DET_RANGE_396_oRDR_DETECTION_393_396_oPCAN_RADAR_c9160162_Tx: ComBitPosition=360, ComBitSize=15, ComSignalInitValue=0, ComSignalType=UINT16, ComSystemTemplateSystemSignalRef=DET_RANGE_396
            DET_RANGE_ERR_393_oRDR_DETECTION_393_396_oPCAN_RADAR_c3de3709_Tx: ComBitPosition=40, ComBitSize=7, ComSignalInitValue=0, ComSignalType=UINT8, ComSystemTemplateSystemSignalRef=DET_RANGE_ERR_393
            DET_RANGE_ERR_394_oRDR_DETECTION_393_396_oPCAN_RADAR_9f6e1460_Tx: ComBitPosition=152, ComBitSize=7, ComSignalInitValue=0, ComSignalType=UINT8, ComSystemTemplateSystemSignalRef=DET_RANGE_ERR_394
            DET_RANGE_ERR_395_oRDR_DETECTION_393_396_oPCAN_RADAR_0a1ec0f5_Tx: ComBitPosition=264, ComBitSize=7, ComSignalInitValue=0, ComSignalType=UINT8, ComSystemTemplateSystemSignalRef=DET_RANGE_ERR_395
            DET_RANGE_ERR_396_oRDR_DETECTION_393_396_oPCAN_RADAR_6efebb0b_Tx: ComBitPosition=376, ComBitSize=7, ComSignalInitValue=0, ComSignalType=UINT8, ComSystemTemplateSystemSignalRef=DET_RANGE_ERR_396
            DET_RANGE_VELOCITY_393_oRDR_DETECTION_393_396_oPCAN_RADAR_11904f45_Tx: ComBitPosition=48, ComBitSize=15, ComSignalInitValue=16384, ComSignalType=UINT16, ComSystemTemplateSystemSignalRef=DET_RANGE_VELOCITY_393
            DET_RANGE_VELOCITY_394_oRDR_DETECTION_393_396_oPCAN_RADAR_4d206c2c_Tx: ComBitPosition=160, ComBitSize=15, ComSignalInitValue=16384, ComSignalType=UINT16, ComSystemTemplateSystemSignalRef=DET_RANGE_VELOCITY_394
            DET_RANGE_VELOCITY_395_oRDR_DETECTION_393_396_oPCAN_RADAR_d850b8b9_Tx: ComBitPosition=272, ComBitSize=15, ComSignalInitValue=16384, ComSignalType=UINT16, ComSystemTemplateSystemSignalRef=DET_RANGE_VELOCITY_395
            DET_RANGE_VELOCITY_396_oRDR_DETECTION_393_396_oPCAN_RADAR_bcb0c347_Tx: ComBitPosition=384, ComBitSize=15, ComSignalInitValue=16384, ComSignalType=UINT16, ComSystemTemplateSystemSignalRef=DET_RANGE_VELOCITY_396
            DET_RANGE_VELOCITY_ERR_393_oRDR_DETECTION_393_396_oPCAN_RADAR_1e2bb4f7_Tx: ComBitPosition=64, ComBitSize=8, ComSignalInitValue=0, ComSignalType=UINT8, ComSystemTemplateSystemSignalRef=DET_RANGE_VELOCITY_ERR_393
            DET_RANGE_VELOCITY_ERR_394_oRDR_DETECTION_393_396_oPCAN_RADAR_429b979e_Tx: ComBitPosition=176, ComBitSize=8, ComSignalInitValue=0, ComSignalType=UINT8, ComSystemTemplateSystemSignalRef=DET_RANGE_VELOCITY_ERR_394
            DET_RANGE_VELOCITY_ERR_395_oRDR_DETECTION_393_396_oPCAN_RADAR_d7eb430b_Tx: ComBitPosition=288, ComBitSize=8, ComSignalInitValue=0, ComSignalType=UINT8, ComSystemTemplateSystemSignalRef=DET_RANGE_VELOCITY_ERR_395
            DET_RANGE_VELOCITY_ERR_396_oRDR_DETECTION_393_396_oPCAN_RADAR_b30b38f5_Tx: ComBitPosition=400, ComBitSize=8, ComSignalInitValue=0, ComSignalType=UINT8, ComSystemTemplateSystemSignalRef=DET_RANGE_VELOCITY_ERR_396
            DET_RCS_393_oRDR_DETECTION_393_396_oPCAN_RADAR_9610781f_Tx: ComBitPosition=128, ComBitSize=8, ComSignalInitValue=128, ComSignalType=UINT8, ComSystemTemplateSystemSignalRef=DET_RCS_393
            DET_RCS_394_oRDR_DETECTION_393_396_oPCAN_RADAR_caa05b76_Tx: ComBitPosition=240, ComBitSize=8, ComSignalInitValue=128, ComSignalType=UINT8, ComSystemTemplateSystemSignalRef=DET_RCS_394
            DET_RCS_395_oRDR_DETECTION_393_396_oPCAN_RADAR_5fd08fe3_Tx: ComBitPosition=352, ComBitSize=8, ComSignalInitValue=128, ComSignalType=UINT8, ComSystemTemplateSystemSignalRef=DET_RCS_395
            DET_RCS_396_oRDR_DETECTION_393_396_oPCAN_RADAR_3b30f41d_Tx: ComBitPosition=464, ComBitSize=8, ComSignalInitValue=128, ComSignalType=UINT8, ComSystemTemplateSystemSignalRef=DET_RCS_396
            DET_SNR_393_oRDR_DETECTION_393_396_oPCAN_RADAR_4bbe2c1d_Tx: ComBitPosition=120, ComBitSize=8, ComSignalInitValue=0, ComSignalType=UINT8, ComSystemTemplateSystemSignalRef=DET_SNR_393
            DET_SNR_394_oRDR_DETECTION_393_396_oPCAN_RADAR_170e0f74_Tx: ComBitPosition=232, ComBitSize=8, ComSignalInitValue=0, ComSignalType=UINT8, ComSystemTemplateSystemSignalRef=DET_SNR_394
            DET_SNR_395_oRDR_DETECTION_393_396_oPCAN_RADAR_827edbe1_Tx: ComBitPosition=344, ComBitSize=8, ComSignalInitValue=0, ComSignalType=UINT8, ComSystemTemplateSystemSignalRef=DET_SNR_395
            DET_SNR_396_oRDR_DETECTION_393_396_oPCAN_RADAR_e69ea01f_Tx: ComBitPosition=456, ComBitSize=8, ComSignalInitValue=0, ComSignalType=UINT8, ComSystemTemplateSystemSignalRef=DET_SNR_396
            DET_SUPER_RES_TARGET_393_oRDR_DETECTION_393_396_oPCAN_RADAR_7a270478_Tx: ComBitPosition=87, ComBitSize=1, ComSignalInitValue=0, ComSignalType=BOOLEAN, ComSystemTemplateSystemSignalRef=DET_SUPER_RES_TARGET_393
            DET_SUPER_RES_TARGET_394_oRDR_DETECTION_393_396_oPCAN_RADAR_26972711_Tx: ComBitPosition=199, ComBitSize=1, ComSignalInitValue=0, ComSignalType=BOOLEAN, ComSystemTemplateSystemSignalRef=DET_SUPER_RES_TARGET_394
            DET_SUPER_RES_TARGET_395_oRDR_DETECTION_393_396_oPCAN_RADAR_b3e7f384_Tx: ComBitPosition=311, ComBitSize=1, ComSignalInitValue=0, ComSignalType=BOOLEAN, ComSystemTemplateSystemSignalRef=DET_SUPER_RES_TARGET_395
            DET_SUPER_RES_TARGET_396_oRDR_DETECTION_393_396_oPCAN_RADAR_d707887a_Tx: ComBitPosition=423, ComBitSize=1, ComSignalInitValue=0, ComSignalType=BOOLEAN, ComSystemTemplateSystemSignalRef=DET_SUPER_RES_TARGET_396
        SG_Detections_397_400_oRDR_DETECTION_397_400_oPCAN_RADAR_a221f00e_Tx: ComSystemTemplateSignalGroupRef=SG_Detections_397_400
          83 x ComGroupSignal, all with ComSignalEndianness=LITTLE_ENDIAN, ComTransferProperty=PENDING:
            DET_AZIMUTH_397_oRDR_DETECTION_397_400_oPCAN_RADAR_aa47ae04_Tx: ComBitPosition=88, ComBitSize=13, ComSignalInitValue=0, ComSignalType=UINT16, ComSystemTemplateSystemSignalRef=DET_AZIMUTH_397
            DET_AZIMUTH_398_oRDR_DETECTION_397_400_oPCAN_RADAR_86573c43_Tx: ComBitPosition=200, ComBitSize=13, ComSignalInitValue=0, ComSignalType=UINT16, ComSystemTemplateSystemSignalRef=DET_AZIMUTH_398
            DET_AZIMUTH_399_oRDR_DETECTION_397_400_oPCAN_RADAR_1327e8d6_Tx: ComBitPosition=312, ComBitSize=13, ComSignalInitValue=0, ComSignalType=UINT16, ComSystemTemplateSystemSignalRef=DET_AZIMUTH_399
            DET_AZIMUTH_400_oRDR_DETECTION_397_400_oPCAN_RADAR_bcf9ca20_Tx: ComBitPosition=424, ComBitSize=13, ComSignalInitValue=0, ComSignalType=UINT16, ComSystemTemplateSystemSignalRef=DET_AZIMUTH_400
            DET_AZIMUTH_ERR_397_oRDR_DETECTION_397_400_oPCAN_RADAR_0ef23bf1_Tx: ComBitPosition=105, ComBitSize=7, ComSignalInitValue=0, ComSignalType=UINT8, ComSystemTemplateSystemSignalRef=DET_AZIMUTH_ERR_397
            DET_AZIMUTH_ERR_398_oRDR_DETECTION_397_400_oPCAN_RADAR_22e2a9b6_Tx: ComBitPosition=217, ComBitSize=7, ComSignalInitValue=0, ComSignalType=UINT8, ComSystemTemplateSystemSignalRef=DET_AZIMUTH_ERR_398
            DET_AZIMUTH_ERR_399_oRDR_DETECTION_397_400_oPCAN_RADAR_b7927d23_Tx: ComBitPosition=329, ComBitSize=7, ComSignalInitValue=0, ComSignalType=UINT8, ComSystemTemplateSystemSignalRef=DET_AZIMUTH_ERR_399
            DET_AZIMUTH_ERR_400_oRDR_DETECTION_397_400_oPCAN_RADAR_184c5fd5_Tx: ComBitPosition=441, ComBitSize=7, ComSignalInitValue=0, ComSignalType=UINT8, ComSystemTemplateSystemSignalRef=DET_AZIMUTH_ERR_400
            DET_BELOW_RAIN_THOLD_397_oRDR_DETECTION_397_400_oPCAN_RADAR_7f463dc4_Tx: ComBitPosition=39, ComBitSize=1, ComSignalInitValue=0, ComSignalType=BOOLEAN, ComSystemTemplateSystemSignalRef=DET_BELOW_RAIN_THOLD_397
            DET_BELOW_RAIN_THOLD_398_oRDR_DETECTION_397_400_oPCAN_RADAR_5356af83_Tx: ComBitPosition=151, ComBitSize=1, ComSignalInitValue=0, ComSignalType=BOOLEAN, ComSystemTemplateSystemSignalRef=DET_BELOW_RAIN_THOLD_398
            DET_BELOW_RAIN_THOLD_399_oRDR_DETECTION_397_400_oPCAN_RADAR_c6267b16_Tx: ComBitPosition=263, ComBitSize=1, ComSignalInitValue=0, ComSignalType=BOOLEAN, ComSystemTemplateSystemSignalRef=DET_BELOW_RAIN_THOLD_399
            DET_BELOW_RAIN_THOLD_400_oRDR_DETECTION_397_400_oPCAN_RADAR_69f859e0_Tx: ComBitPosition=375, ComBitSize=1, ComSignalInitValue=0, ComSignalType=BOOLEAN, ComSystemTemplateSystemSignalRef=DET_BELOW_RAIN_THOLD_400
            DET_BI_STATIC_FLAG_397_oRDR_DETECTION_397_400_oPCAN_RADAR_fc6bee81_Tx: ComBitPosition=104, ComBitSize=1, ComSignalInitValue=0, ComSignalType=BOOLEAN, ComSystemTemplateSystemSignalRef=DET_BI_STATIC_FLAG_397
            DET_BI_STATIC_FLAG_398_oRDR_DETECTION_397_400_oPCAN_RADAR_d07b7cc6_Tx: ComBitPosition=216, ComBitSize=1, ComSignalInitValue=0, ComSignalType=BOOLEAN, ComSystemTemplateSystemSignalRef=DET_BI_STATIC_FLAG_398
            DET_BI_STATIC_FLAG_399_oRDR_DETECTION_397_400_oPCAN_RADAR_450ba853_Tx: ComBitPosition=328, ComBitSize=1, ComSignalInitValue=0, ComSignalType=BOOLEAN, ComSystemTemplateSystemSignalRef=DET_BI_STATIC_FLAG_399
            DET_BI_STATIC_FLAG_400_oRDR_DETECTION_397_400_oPCAN_RADAR_ead58aa5_Tx: ComBitPosition=440, ComBitSize=1, ComSignalInitValue=0, ComSignalType=BOOLEAN, ComSystemTemplateSystemSignalRef=DET_BI_STATIC_FLAG_400
            DET_CONFD_AZIMUTH_397_oRDR_DETECTION_397_400_oPCAN_RADAR_a8a1a4ce_Tx: ComBitPosition=118, ComBitSize=2, ComSignalInitValue=0, ComSignalType=UINT8, ComSystemTemplateSystemSignalRef=DET_CONFD_AZIMUTH_397
            DET_CONFD_AZIMUTH_398_oRDR_DETECTION_397_400_oPCAN_RADAR_84b13689_Tx: ComBitPosition=230, ComBitSize=2, ComSignalInitValue=0, ComSignalType=UINT8, ComSystemTemplateSystemSignalRef=DET_CONFD_AZIMUTH_398
            DET_CONFD_AZIMUTH_399_oRDR_DETECTION_397_400_oPCAN_RADAR_11c1e21c_Tx: ComBitPosition=342, ComBitSize=2, ComSignalInitValue=0, ComSignalType=UINT8, ComSystemTemplateSystemSignalRef=DET_CONFD_AZIMUTH_399
            DET_CONFD_AZIMUTH_400_oRDR_DETECTION_397_400_oPCAN_RADAR_be1fc0ea_Tx: ComBitPosition=454, ComBitSize=2, ComSignalInitValue=0, ComSignalType=UINT8, ComSystemTemplateSystemSignalRef=DET_CONFD_AZIMUTH_400
            DET_CONFD_ELEVATION_397_oRDR_DETECTION_397_400_oPCAN_RADAR_aa34a534_Tx: ComBitPosition=101, ComBitSize=2, ComSignalInitValue=0, ComSignalType=UINT8, ComSystemTemplateSystemSignalRef=DET_CONFD_ELEVATION_397
            DET_CONFD_ELEVATION_398_oRDR_DETECTION_397_400_oPCAN_RADAR_86243773_Tx: ComBitPosition=213, ComBitSize=2, ComSignalInitValue=0, ComSignalType=UINT8, ComSystemTemplateSystemSignalRef=DET_CONFD_ELEVATION_398
            DET_CONFD_ELEVATION_399_oRDR_DETECTION_397_400_oPCAN_RADAR_1354e3e6_Tx: ComBitPosition=325, ComBitSize=2, ComSignalInitValue=0, ComSignalType=UINT8, ComSystemTemplateSystemSignalRef=DET_CONFD_ELEVATION_399
            DET_CONFD_ELEVATION_400_oRDR_DETECTION_397_400_oPCAN_RADAR_bc8ac110_Tx: ComBitPosition=437, ComBitSize=2, ComSignalInitValue=0, ComSignalType=UINT8, ComSystemTemplateSystemSignalRef=DET_CONFD_ELEVATION_400
            DET_ELEVATION_397_oRDR_DETECTION_397_400_oPCAN_RADAR_7bf47108_Tx: ComBitPosition=72, ComBitSize=8, ComSignalInitValue=0, ComSignalType=UINT8, ComSystemTemplateSystemSignalRef=DET_ELEVATION_397
            DET_ELEVATION_398_oRDR_DETECTION_397_400_oPCAN_RADAR_57e4e34f_Tx: ComBitPosition=184, ComBitSize=8, ComSignalInitValue=0, ComSignalType=UINT8, ComSystemTemplateSystemSignalRef=DET_ELEVATION_398
            DET_ELEVATION_399_oRDR_DETECTION_397_400_oPCAN_RADAR_c29437da_Tx: ComBitPosition=296, ComBitSize=8, ComSignalInitValue=0, ComSignalType=UINT8, ComSystemTemplateSystemSignalRef=DET_ELEVATION_399
            DET_ELEVATION_400_oRDR_DETECTION_397_400_oPCAN_RADAR_6d4a152c_Tx: ComBitPosition=408, ComBitSize=8, ComSignalInitValue=0, ComSignalType=UINT8, ComSystemTemplateSystemSignalRef=DET_ELEVATION_400
            DET_ELEVATION_ERR_397_oRDR_DETECTION_397_400_oPCAN_RADAR_fccde97d_Tx: ComBitPosition=80, ComBitSize=6, ComSignalInitValue=0, ComSignalType=UINT8, ComSystemTemplateSystemSignalRef=DET_ELEVATION_ERR_397
            DET_ELEVATION_ERR_398_oRDR_DETECTION_397_400_oPCAN_RADAR_d0dd7b3a_Tx: ComBitPosition=192, ComBitSize=6, ComSignalInitValue=0, ComSignalType=UINT8, ComSystemTemplateSystemSignalRef=DET_ELEVATION_ERR_398
            DET_ELEVATION_ERR_399_oRDR_DETECTION_397_400_oPCAN_RADAR_45adafaf_Tx: ComBitPosition=304, ComBitSize=6, ComSignalInitValue=0, ComSignalType=UINT8, ComSystemTemplateSystemSignalRef=DET_ELEVATION_ERR_399
            DET_ELEVATION_ERR_400_oRDR_DETECTION_397_400_oPCAN_RADAR_ea738d59_Tx: ComBitPosition=416, ComBitSize=6, ComSignalInitValue=0, ComSignalType=UINT8, ComSystemTemplateSystemSignalRef=DET_ELEVATION_ERR_400
            DET_EXISTENCE_PROB_397_oRDR_DETECTION_397_400_oPCAN_RADAR_2e529c1d_Tx: ComBitPosition=112, ComBitSize=6, ComSignalInitValue=0, ComSignalType=UINT8, ComSystemTemplateSystemSignalRef=DET_EXISTENCE_PROB_397
            DET_EXISTENCE_PROB_398_oRDR_DETECTION_397_400_oPCAN_RADAR_02420e5a_Tx: ComBitPosition=224, ComBitSize=6, ComSignalInitValue=0, ComSignalType=UINT8, ComSystemTemplateSystemSignalRef=DET_EXISTENCE_PROB_398
            DET_EXISTENCE_PROB_399_oRDR_DETECTION_397_400_oPCAN_RADAR_9732dacf_Tx: ComBitPosition=336, ComBitSize=6, ComSignalInitValue=0, ComSignalType=UINT8, ComSystemTemplateSystemSignalRef=DET_EXISTENCE_PROB_399
            DET_EXISTENCE_PROB_400_oRDR_DETECTION_397_400_oPCAN_RADAR_38ecf839_Tx: ComBitPosition=448, ComBitSize=6, ComSignalInitValue=0, ComSignalType=UINT8, ComSystemTemplateSystemSignalRef=DET_EXISTENCE_PROB_400
            DET_HVC_FLAG_397_oRDR_DETECTION_397_400_oPCAN_RADAR_cf26df62_Tx: ComBitPosition=86, ComBitSize=1, ComSignalInitValue=0, ComSignalType=BOOLEAN, ComSystemTemplateSystemSignalRef=DET_HVC_FLAG_397
            DET_HVC_FLAG_398_oRDR_DETECTION_397_400_oPCAN_RADAR_e3364d25_Tx: ComBitPosition=198, ComBitSize=1, ComSignalInitValue=0, ComSignalType=BOOLEAN, ComSystemTemplateSystemSignalRef=DET_HVC_FLAG_398
            DET_HVC_FLAG_399_oRDR_DETECTION_397_400_oPCAN_RADAR_764699b0_Tx: ComBitPosition=310, ComBitSize=1, ComSignalInitValue=0, ComSignalType=BOOLEAN, ComSystemTemplateSystemSignalRef=DET_HVC_FLAG_399
            DET_HVC_FLAG_400_oRDR_DETECTION_397_400_oPCAN_RADAR_d998bb46_Tx: ComBitPosition=422, ComBitSize=1, ComSignalInitValue=0, ComSignalType=BOOLEAN, ComSystemTemplateSystemSignalRef=DET_HVC_FLAG_400
            DET_IDM_397_oRDR_DETECTION_397_400_oPCAN_RADAR_4474e4df_Tx: ComBitPosition=63, ComBitSize=1, ComSignalInitValue=0, ComSignalType=BOOLEAN, ComSystemTemplateSystemSignalRef=DET_IDM_397
            DET_IDM_398_oRDR_DETECTION_397_400_oPCAN_RADAR_68647698_Tx: ComBitPosition=175, ComBitSize=1, ComSignalInitValue=0, ComSignalType=BOOLEAN, ComSystemTemplateSystemSignalRef=DET_IDM_398
            DET_IDM_399_oRDR_DETECTION_397_400_oPCAN_RADAR_fd14a20d_Tx: ComBitPosition=287, ComBitSize=1, ComSignalInitValue=0, ComSignalType=BOOLEAN, ComSystemTemplateSystemSignalRef=DET_IDM_399
            DET_IDM_400_oRDR_DETECTION_397_400_oPCAN_RADAR_52ca80fb_Tx: ComBitPosition=399, ComBitSize=1, ComSignalInitValue=0, ComSignalType=BOOLEAN, ComSystemTemplateSystemSignalRef=DET_IDM_400
            DET_MH_CRC16_397_400_oRDR_DETECTION_397_400_oPCAN_RADAR_26a92205_Tx: ComBitPosition=0, ComBitSize=16, ComSignalInitValue=0, ComSignalType=UINT16, ComSystemTemplateSystemSignalRef=DET_MH_CRC16_397_400
            DET_MH_CYCLE_COUNTER_397_400_oRDR_DETECTION_397_400_oPCAN_RADAR_a2dc8332_Tx: ComBitPosition=16, ComBitSize=8, ComSignalInitValue=0, ComSignalType=UINT8, ComSystemTemplateSystemSignalRef=DET_MH_CYCLE_COUNTER_397_400
            DET_MH_SCAN_INDEX_4LSB_397_400_oRDR_DETECTION_397_400_oPCAN_RADAR_6ef6a6be_Tx: ComBitPosition=476, ComBitSize=4, ComSignalInitValue=0, ComSignalType=UINT8, ComSystemTemplateSystemSignalRef=DET_MH_SCAN_INDEX_4LSB_397_400
            DET_MTD_397_oRDR_DETECTION_397_400_oPCAN_RADAR_22c7d604_Tx: ComBitPosition=47, ComBitSize=1, ComSignalInitValue=0, ComSignalType=BOOLEAN, ComSystemTemplateSystemSignalRef=DET_MTD_397
            DET_MTD_398_oRDR_DETECTION_397_400_oPCAN_RADAR_0ed74443_Tx: ComBitPosition=159, ComBitSize=1, ComSignalInitValue=0, ComSignalType=BOOLEAN, ComSystemTemplateSystemSignalRef=DET_MTD_398
            DET_MTD_399_oRDR_DETECTION_397_400_oPCAN_RADAR_9ba790d6_Tx: ComBitPosition=271, ComBitSize=1, ComSignalInitValue=0, ComSignalType=BOOLEAN, ComSystemTemplateSystemSignalRef=DET_MTD_399
            DET_MTD_400_oRDR_DETECTION_397_400_oPCAN_RADAR_3479b220_Tx: ComBitPosition=383, ComBitSize=1, ComSignalInitValue=0, ComSignalType=BOOLEAN, ComSystemTemplateSystemSignalRef=DET_MTD_400
            DET_PROB_1STAZHYPO_397_oRDR_DETECTION_397_400_oPCAN_RADAR_b1733ec9_Tx: ComBitPosition=103, ComBitSize=1, ComSignalInitValue=0, ComSignalType=BOOLEAN, ComSystemTemplateSystemSignalRef=DET_PROB_1STAZHYPO_397
            DET_PROB_1STAZHYPO_398_oRDR_DETECTION_397_400_oPCAN_RADAR_9d63ac8e_Tx: ComBitPosition=215, ComBitSize=1, ComSignalInitValue=0, ComSignalType=BOOLEAN, ComSystemTemplateSystemSignalRef=DET_PROB_1STAZHYPO_398
            DET_PROB_1STAZHYPO_399_oRDR_DETECTION_397_400_oPCAN_RADAR_0813781b_Tx: ComBitPosition=327, ComBitSize=1, ComSignalInitValue=0, ComSignalType=BOOLEAN, ComSystemTemplateSystemSignalRef=DET_PROB_1STAZHYPO_399
            DET_PROB_1STAZHYPO_400_oRDR_DETECTION_397_400_oPCAN_RADAR_a7cd5aed_Tx: ComBitPosition=439, ComBitSize=1, ComSignalInitValue=0, ComSignalType=BOOLEAN, ComSystemTemplateSystemSignalRef=DET_PROB_1STAZHYPO_400
            DET_RANGE_397_oRDR_DETECTION_397_400_oPCAN_RADAR_badcddbf_Tx: ComBitPosition=24, ComBitSize=15, ComSignalInitValue=0, ComSignalType=UINT16, ComSystemTemplateSystemSignalRef=DET_RANGE_397
            DET_RANGE_398_oRDR_DETECTION_397_400_oPCAN_RADAR_96cc4ff8_Tx: ComBitPosition=136, ComBitSize=15, ComSignalInitValue=0, ComSignalType=UINT16, ComSystemTemplateSystemSignalRef=DET_RANGE_398
            DET_RANGE_399_oRDR_DETECTION_397_400_oPCAN_RADAR_03bc9b6d_Tx: ComBitPosition=248, ComBitSize=15, ComSignalInitValue=0, ComSignalType=UINT16, ComSystemTemplateSystemSignalRef=DET_RANGE_399
            DET_RANGE_400_oRDR_DETECTION_397_400_oPCAN_RADAR_ac62b99b_Tx: ComBitPosition=360, ComBitSize=15, ComSignalInitValue=0, ComSignalType=UINT16, ComSystemTemplateSystemSignalRef=DET_RANGE_400
            DET_RANGE_ERR_397_oRDR_DETECTION_397_400_oPCAN_RADAR_1d3467d6_Tx: ComBitPosition=40, ComBitSize=7, ComSignalInitValue=0, ComSignalType=UINT8, ComSystemTemplateSystemSignalRef=DET_RANGE_ERR_397
            DET_RANGE_ERR_398_oRDR_DETECTION_397_400_oPCAN_RADAR_3124f591_Tx: ComBitPosition=152, ComBitSize=7, ComSignalInitValue=0, ComSignalType=UINT8, ComSystemTemplateSystemSignalRef=DET_RANGE_ERR_398
            DET_RANGE_ERR_399_oRDR_DETECTION_397_400_oPCAN_RADAR_a4542104_Tx: ComBitPosition=264, ComBitSize=7, ComSignalInitValue=0, ComSignalType=UINT8, ComSystemTemplateSystemSignalRef=DET_RANGE_ERR_399
            DET_RANGE_ERR_400_oRDR_DETECTION_397_400_oPCAN_RADAR_0b8a03f2_Tx: ComBitPosition=376, ComBitSize=7, ComSignalInitValue=0, ComSignalType=UINT8, ComSystemTemplateSystemSignalRef=DET_RANGE_ERR_400
            DET_RANGE_VELOCITY_397_oRDR_DETECTION_397_400_oPCAN_RADAR_cf7a1f9a_Tx: ComBitPosition=48, ComBitSize=15, ComSignalInitValue=16384, ComSignalType=UINT16, ComSystemTemplateSystemSignalRef=DET_RANGE_VELOCITY_397
            DET_RANGE_VELOCITY_398_oRDR_DETECTION_397_400_oPCAN_RADAR_e36a8ddd_Tx: ComBitPosition=160, ComBitSize=15, ComSignalInitValue=16384, ComSignalType=UINT16, ComSystemTemplateSystemSignalRef=DET_RANGE_VELOCITY_398
            DET_RANGE_VELOCITY_399_oRDR_DETECTION_397_400_oPCAN_RADAR_761a5948_Tx: ComBitPosition=272, ComBitSize=15, ComSignalInitValue=16384, ComSignalType=UINT16, ComSystemTemplateSystemSignalRef=DET_RANGE_VELOCITY_399
            DET_RANGE_VELOCITY_400_oRDR_DETECTION_397_400_oPCAN_RADAR_d9c47bbe_Tx: ComBitPosition=384, ComBitSize=15, ComSignalInitValue=16384, ComSignalType=UINT16, ComSystemTemplateSystemSignalRef=DET_RANGE_VELOCITY_400
            DET_RANGE_VELOCITY_ERR_397_oRDR_DETECTION_397_400_oPCAN_RADAR_c0c1e428_Tx: ComBitPosition=64, ComBitSize=8, ComSignalInitValue=0, ComSignalType=UINT8, ComSystemTemplateSystemSignalRef=DET_RANGE_VELOCITY_ERR_397
            DET_RANGE_VELOCITY_ERR_398_oRDR_DETECTION_397_400_oPCAN_RADAR_ecd1766f_Tx: ComBitPosition=176, ComBitSize=8, ComSignalInitValue=0, ComSignalType=UINT8, ComSystemTemplateSystemSignalRef=DET_RANGE_VELOCITY_ERR_398
            DET_RANGE_VELOCITY_ERR_399_oRDR_DETECTION_397_400_oPCAN_RADAR_79a1a2fa_Tx: ComBitPosition=288, ComBitSize=8, ComSignalInitValue=0, ComSignalType=UINT8, ComSystemTemplateSystemSignalRef=DET_RANGE_VELOCITY_ERR_399
            DET_RANGE_VELOCITY_ERR_400_oRDR_DETECTION_397_400_oPCAN_RADAR_d67f800c_Tx: ComBitPosition=400, ComBitSize=8, ComSignalInitValue=0, ComSignalType=UINT8, ComSystemTemplateSystemSignalRef=DET_RANGE_VELOCITY_ERR_400
            DET_RCS_397_oRDR_DETECTION_397_400_oPCAN_RADAR_48fa28c0_Tx: ComBitPosition=128, ComBitSize=8, ComSignalInitValue=128, ComSignalType=UINT8, ComSystemTemplateSystemSignalRef=DET_RCS_397
            DET_RCS_398_oRDR_DETECTION_397_400_oPCAN_RADAR_64eaba87_Tx: ComBitPosition=240, ComBitSize=8, ComSignalInitValue=128, ComSignalType=UINT8, ComSystemTemplateSystemSignalRef=DET_RCS_398
            DET_RCS_399_oRDR_DETECTION_397_400_oPCAN_RADAR_f19a6e12_Tx: ComBitPosition=352, ComBitSize=8, ComSignalInitValue=128, ComSignalType=UINT8, ComSystemTemplateSystemSignalRef=DET_RCS_399
            DET_RCS_400_oRDR_DETECTION_397_400_oPCAN_RADAR_5e444ce4_Tx: ComBitPosition=464, ComBitSize=8, ComSignalInitValue=128, ComSignalType=UINT8, ComSystemTemplateSystemSignalRef=DET_RCS_400
            DET_SNR_397_oRDR_DETECTION_397_400_oPCAN_RADAR_95547cc2_Tx: ComBitPosition=120, ComBitSize=8, ComSignalInitValue=0, ComSignalType=UINT8, ComSystemTemplateSystemSignalRef=DET_SNR_397
            DET_SNR_398_oRDR_DETECTION_397_400_oPCAN_RADAR_b944ee85_Tx: ComBitPosition=232, ComBitSize=8, ComSignalInitValue=0, ComSignalType=UINT8, ComSystemTemplateSystemSignalRef=DET_SNR_398
            DET_SNR_399_oRDR_DETECTION_397_400_oPCAN_RADAR_2c343a10_Tx: ComBitPosition=344, ComBitSize=8, ComSignalInitValue=0, ComSignalType=UINT8, ComSystemTemplateSystemSignalRef=DET_SNR_399
            DET_SNR_400_oRDR_DETECTION_397_400_oPCAN_RADAR_83ea18e6_Tx: ComBitPosition=456, ComBitSize=8, ComSignalInitValue=0, ComSignalType=UINT8, ComSystemTemplateSystemSignalRef=DET_SNR_400
            DET_SUPER_RES_TARGET_397_oRDR_DETECTION_397_400_oPCAN_RADAR_a4cd54a7_Tx: ComBitPosition=87, ComBitSize=1, ComSignalInitValue=0, ComSignalType=BOOLEAN, ComSystemTemplateSystemSignalRef=DET_SUPER_RES_TARGET_397
            DET_SUPER_RES_TARGET_398_oRDR_DETECTION_397_400_oPCAN_RADAR_88ddc6e0_Tx: ComBitPosition=199, ComBitSize=1, ComSignalInitValue=0, ComSignalType=BOOLEAN, ComSystemTemplateSystemSignalRef=DET_SUPER_RES_TARGET_398
            DET_SUPER_RES_TARGET_399_oRDR_DETECTION_397_400_oPCAN_RADAR_1dad1275_Tx: ComBitPosition=311, ComBitSize=1, ComSignalInitValue=0, ComSignalType=BOOLEAN, ComSystemTemplateSystemSignalRef=DET_SUPER_RES_TARGET_399
            DET_SUPER_RES_TARGET_400_oRDR_DETECTION_397_400_oPCAN_RADAR_b2733083_Tx: ComBitPosition=423, ComBitSize=1, ComSignalInitValue=0, ComSignalType=BOOLEAN, ComSystemTemplateSystemSignalRef=DET_SUPER_RES_TARGET_400
        SG_ETC2_00_oETC2_00_oVCAN_RADAR_efbda90a_Rx: ComSystemTemplateSignalGroupRef=SG_ETC2_00
          TransCurrentGear_00_oETC2_00_oVCAN_RADAR_3087ec57_Rx (ComGroupSignal):
            ComBitPosition = 24
            ComBitSize = 8
            ComSignalEndianness = LITTLE_ENDIAN
            ComSignalInitValue = 125
            ComSignalType = UINT8
            ComSystemTemplateSystemSignalRef = TransCurrentGear_00
        SG_ETC2_03_oETC2_03_oVCAN_RADAR_6b0f6884_Rx: ComSystemTemplateSignalGroupRef=SG_ETC2_03
          TransCurrentGear_03_oETC2_03_oVCAN_RADAR_b4352dd9_Rx (ComGroupSignal):
            ComBitPosition = 24
            ComBitSize = 8
            ComSignalEndianness = LITTLE_ENDIAN
            ComSignalInitValue = 0
            ComSignalType = UINT8
            ComSystemTemplateSystemSignalRef = TransCurrentGear_03
        SG_Fusion_AlignmentStatus1_oRDR_FUSION_ALIGNMENT_STATUS_001_oPCAN_RADAR_2e5fc362_Rx: ComSignalGroupArrayAccess=true, ComTimeout=0, ComSystemTemplateSignalGroupRef=SG_Fusion_AlignmentStatus1
          42 x ComGroupSignal, all with ComSignalEndianness=LITTLE_ENDIAN, ComSignalInitValue=0:
            AL_STS_001_CYCLE_COUNTER_Rx_oRDR_FUSION_ALIGNMENT_STATUS_001_oPCAN_RADAR_c4e7857e_Rx: ComBitPosition=16, ComBitSize=8, ComSignalType=UINT8, ComSystemTemplateSystemSignalRef=AL_STS_001_CYCLE_COUNTER_Rx
            AL_STS_001_MH_CRC16_Rx_oRDR_FUSION_ALIGNMENT_STATUS_001_oPCAN_RADAR_c23d08ad_Rx: ComBitPosition=0, ComBitSize=16, ComSignalType=UINT16, ComSystemTemplateSystemSignalRef=AL_STS_001_MH_CRC16_Rx
            STS_AAAzimuthStd_Rx_oRDR_FUSION_ALIGNMENT_STATUS_001_oPCAN_RADAR_e0014852_Rx: ComBitPosition=243, ComBitSize=14, ComSignalType=UINT16, ComSystemTemplateSystemSignalRef=STS_AAAzimuthStd_Rx
            STS_AACurrentAzimuth_Rx_oRDR_FUSION_ALIGNMENT_STATUS_001_oPCAN_RADAR_3a00fa82_Rx: ComBitPosition=177, ComBitSize=15, ComSignalType=UINT16, ComSystemTemplateSystemSignalRef=STS_AACurrentAzimuth_Rx
            STS_AACurrentElevation_Rx_oRDR_FUSION_ALIGNMENT_STATUS_001_oPCAN_RADAR_7298a7ea_Rx: ComBitPosition=207, ComBitSize=11, ComSignalType=UINT16, ComSystemTemplateSystemSignalRef=STS_AACurrentElevation_Rx
            STS_AACurrentRoll_Rx_oRDR_FUSION_ALIGNMENT_STATUS_001_oPCAN_RADAR_590d7e8e_Rx: ComBitPosition=481, ComBitSize=15, ComSignalType=SINT16, ComSystemTemplateSystemSignalRef=STS_AACurrentRoll_Rx
            STS_AAElevationStd_Rx_oRDR_FUSION_ALIGNMENT_STATUS_001_oPCAN_RADAR_2f821d5a_Rx: ComBitPosition=257, ComBitSize=14, ComSignalType=UINT16, ComSystemTemplateSystemSignalRef=STS_AAElevationStd_Rx
            STS_AARoll_Std_Rx_oRDR_FUSION_ALIGNMENT_STATUS_001_oPCAN_RADAR_c2a8bede_Rx: ComBitPosition=464, ComBitSize=14, ComSignalType=UINT16, ComSystemTemplateSystemSignalRef=STS_AARoll_Std_Rx
            STS_AlignmentAutoStatus_Rx_oRDR_FUSION_ALIGNMENT_STATUS_001_oPCAN_RADAR_83b4b0f6_Rx: ComBitPosition=133, ComBitSize=3, ComSignalType=UINT8, ComSystemTemplateSystemSignalRef=STS_AlignmentAutoStatus_Rx
            STS_AlignmentAzimuth_Rx_oRDR_FUSION_ALIGNMENT_STATUS_001_oPCAN_RADAR_92f72180_Rx: ComBitPosition=384, ComBitSize=15, ComSignalType=UINT16, ComSystemTemplateSystemSignalRef=STS_AlignmentAzimuth_Rx
            STS_AlignmentElevation_Rx_oRDR_FUSION_ALIGNMENT_STATUS_001_oPCAN_RADAR_51af66c3_Rx: ComBitPosition=400, ComBitSize=15, ComSignalType=UINT16, ComSystemTemplateSystemSignalRef=STS_AlignmentElevation_Rx
            STS_AlignmentError_Rx_oRDR_FUSION_ALIGNMENT_STATUS_001_oPCAN_RADAR_c93c23de_Rx: ComBitPosition=128, ComBitSize=5, ComSignalType=UINT8, ComSystemTemplateSystemSignalRef=STS_AlignmentError_Rx
            STS_AlignmentModeIn_Rx_oRDR_FUSION_ALIGNMENT_STATUS_001_oPCAN_RADAR_817bfc0d_Rx: ComBitPosition=92, ComBitSize=3, ComSignalType=UINT8, ComSystemTemplateSystemSignalRef=STS_AlignmentModeIn_Rx
            STS_AlignmentModeOut_Rx_oRDR_FUSION_ALIGNMENT_STATUS_001_oPCAN_RADAR_515d8cc1_Rx: ComBitPosition=218, ComBitSize=3, ComSignalType=UINT8, ComSystemTemplateSystemSignalRef=STS_AlignmentModeOut_Rx
            STS_AutoAlignmentFailRootCause_Rx_oRDR_FUSION_ALIGNMENT_STATUS_001_oPCAN_RADAR_9bc9d16b_Rx: ComBitPosition=144, ComBitSize=5, ComSignalType=UINT8, ComSystemTemplateSystemSignalRef=STS_AutoAlignmentFailRootCause_Rx
            STS_AzimuthErrorNegative_Rx_oRDR_FUSION_ALIGNMENT_STATUS_001_oPCAN_RADAR_03e79242_Rx: ComBitPosition=96, ComBitSize=15, ComSignalType=SINT16, ComSystemTemplateSystemSignalRef=STS_AzimuthErrorNegative_Rx
            STS_AzimuthErrorPositive_Rx_oRDR_FUSION_ALIGNMENT_STATUS_001_oPCAN_RADAR_739114ea_Rx: ComBitPosition=192, ComBitSize=15, ComSignalType=SINT16, ComSystemTemplateSystemSignalRef=STS_AzimuthErrorPositive_Rx
            STS_AzimuthStd_Rx_oRDR_FUSION_ALIGNMENT_STATUS_001_oPCAN_RADAR_3a37c4c6_Rx: ComBitPosition=164, ComBitSize=13, ComSignalType=UINT16, ComSystemTemplateSystemSignalRef=STS_AzimuthStd_Rx
            STS_AzimuthUpdates_Rx_oRDR_FUSION_ALIGNMENT_STATUS_001_oPCAN_RADAR_26fb55fe_Rx: ComBitPosition=320, ComBitSize=32, ComSignalType=UINT32, ComSystemTemplateSystemSignalRef=STS_AzimuthUpdates_Rx
            STS_CalDisplay_Rx_oRDR_FUSION_ALIGNMENT_STATUS_001_oPCAN_RADAR_989af3fe_Rx: ComBitPosition=95, ComBitSize=1, ComSignalType=BOOLEAN, ComSystemTemplateSystemSignalRef=STS_CalDisplay_Rx
            STS_CalTime_Rx_oRDR_FUSION_ALIGNMENT_STATUS_001_oPCAN_RADAR_7a04fce5_Rx: ComBitPosition=80, ComBitSize=12, ComSignalType=UINT16, ComSystemTemplateSystemSignalRef=STS_CalTime_Rx
            STS_CoordinateSystemInput_Rx_oRDR_FUSION_ALIGNMENT_STATUS_001_oPCAN_RADAR_148acc89_Rx: ComBitPosition=59, ComBitSize=2, ComSignalType=UINT8, ComSystemTemplateSystemSignalRef=STS_CoordinateSystemInput_Rx
            STS_ElevationErrorNegative_Rx_oRDR_FUSION_ALIGNMENT_STATUS_001_oPCAN_RADAR_3dc2410e_Rx: ComBitPosition=287, ComBitSize=11, ComSignalType=SINT16, ComSystemTemplateSystemSignalRef=STS_ElevationErrorNegative_Rx
            STS_ElevationErrorPositive_Rx_oRDR_FUSION_ALIGNMENT_STATUS_001_oPCAN_RADAR_4db4c7a6_Rx: ComBitPosition=232, ComBitSize=11, ComSignalType=SINT16, ComSystemTemplateSystemSignalRef=STS_ElevationErrorPositive_Rx
            STS_ElevationStd_Rx_oRDR_FUSION_ALIGNMENT_STATUS_001_oPCAN_RADAR_dea14779_Rx: ComBitPosition=111, ComBitSize=13, ComSignalType=UINT16, ComSystemTemplateSystemSignalRef=STS_ElevationStd_Rx
            STS_ElevationUpdates_Rx_oRDR_FUSION_ALIGNMENT_STATUS_001_oPCAN_RADAR_00e5a516_Rx: ComBitPosition=352, ComBitSize=32, ComSignalType=UINT32, ComSystemTemplateSystemSignalRef=STS_ElevationUpdates_Rx
            STS_HostSpdCompensationFactorQF_Rx_oRDR_FUSION_ALIGNMENT_STATUS_001_oPCAN_RADAR_fe70a223_Rx: ComBitPosition=61, ComBitSize=2, ComSignalType=UINT8, ComSystemTemplateSystemSignalRef=STS_HostSpdCompensationFactorQF_Rx
            STS_HostSpeedCompensationFactor_Rx_oRDR_FUSION_ALIGNMENT_STATUS_001_oPCAN_RADAR_6d203191_Rx: ComBitPosition=313, ComBitSize=7, ComSignalType=UINT8, ComSystemTemplateSystemSignalRef=STS_HostSpeedCompensationFactor_Rx
            STS_InitAlignResultAzimuthUpdate_Rx_oRDR_FUSION_ALIGNMENT_STATUS_001_oPCAN_RADAR_cb93d2df_Rx: ComBitPosition=64, ComBitSize=16, ComSignalType=UINT16, ComSystemTemplateSystemSignalRef=STS_InitAlignResultAzimuthUpdate_Rx
            STS_InitAlignRsltElevationUpdate_Rx_oRDR_FUSION_ALIGNMENT_STATUS_001_oPCAN_RADAR_a120152f_Rx: ComBitPosition=24, ComBitSize=16, ComSignalType=UINT16, ComSystemTemplateSystemSignalRef=STS_InitAlignRsltElevationUpdate_Rx
            STS_InitAlignRsltHostSpdCompFac_Rx_oRDR_FUSION_ALIGNMENT_STATUS_001_oPCAN_RADAR_9cd6c2f3_Rx: ComBitPosition=40, ComBitSize=7, ComSignalType=UINT8, ComSystemTemplateSystemSignalRef=STS_InitAlignRsltHostSpdCompFac_Rx
            STS_InitAlignmentResultAzimuth_Rx_oRDR_FUSION_ALIGNMENT_STATUS_001_oPCAN_RADAR_d3cdcc54_Rx: ComBitPosition=272, ComBitSize=15, ComSignalType=SINT16, ComSystemTemplateSystemSignalRef=STS_InitAlignmentResultAzimuth_Rx
            STS_InitAlignmentResultElevation_Rx_oRDR_FUSION_ALIGNMENT_STATUS_001_oPCAN_RADAR_6a40b927_Rx: ComBitPosition=298, ComBitSize=14, ComSignalType=SINT16, ComSystemTemplateSystemSignalRef=STS_InitAlignmentResultElevation_Rx
            STS_InitLastSuccessfulAlignMode_Rx_oRDR_FUSION_ALIGNMENT_STATUS_001_oPCAN_RADAR_527c92a9_Rx: ComBitPosition=478, ComBitSize=3, ComSignalType=UINT8, ComSystemTemplateSystemSignalRef=STS_InitLastSuccessfulAlignMode_Rx
            STS_ProgressPercent_Rx_oRDR_FUSION_ALIGNMENT_STATUS_001_oPCAN_RADAR_e195d140_Rx: ComBitPosition=136, ComBitSize=7, ComSignalType=UINT8, ComSystemTemplateSystemSignalRef=STS_ProgressPercent_Rx
            STS_RadarTypeInput_Rx_oRDR_FUSION_ALIGNMENT_STATUS_001_oPCAN_RADAR_294e7a2f_Rx: ComBitPosition=124, ComBitSize=3, ComSignalType=UINT8, ComSystemTemplateSystemSignalRef=STS_RadarTypeInput_Rx
            STS_RollErrorNegative_Rx_oRDR_FUSION_ALIGNMENT_STATUS_001_oPCAN_RADAR_fe114bd3_Rx: ComBitPosition=448, ComBitSize=15, ComSignalType=SINT16, ComSystemTemplateSystemSignalRef=STS_RollErrorNegative_Rx
            STS_RollErrorPositive_Rx_oRDR_FUSION_ALIGNMENT_STATUS_001_oPCAN_RADAR_8e67cd7b_Rx: ComBitPosition=221, ComBitSize=10, ComSignalType=SINT16, ComSystemTemplateSystemSignalRef=STS_RollErrorPositive_Rx
            STS_Roll_Updates_Rx_oRDR_FUSION_ALIGNMENT_STATUS_001_oPCAN_RADAR_5eac71d0_Rx: ComBitPosition=416, ComBitSize=32, ComSignalType=UINT32, ComSystemTemplateSystemSignalRef=STS_Roll_Updates_Rx
            STS_StartAzimuth_Rx_oRDR_FUSION_ALIGNMENT_STATUS_001_oPCAN_RADAR_3b77c56a_Rx: ComBitPosition=149, ComBitSize=15, ComSignalType=SINT16, ComSystemTemplateSystemSignalRef=STS_StartAzimuth_Rx
            STS_StartElevation_Rx_oRDR_FUSION_ALIGNMENT_STATUS_001_oPCAN_RADAR_5259f244_Rx: ComBitPosition=48, ComBitSize=11, ComSignalType=SINT16, ComSystemTemplateSystemSignalRef=STS_StartElevation_Rx
            STS_StartRoll_Rx_oRDR_FUSION_ALIGNMENT_STATUS_001_oPCAN_RADAR_2c0c1bdd_Rx: ComBitPosition=496, ComBitSize=15, ComSignalType=SINT16, ComSystemTemplateSystemSignalRef=STS_StartRoll_Rx
        SG_Fusion_AlignmentStatus2_oRDR_FUSION_ALIGNMENT_STATUS_002_oPCAN_RADAR_13cf0319_Rx: ComSignalGroupArrayAccess=true, ComTimeout=0, ComSystemTemplateSignalGroupRef=SG_Fusion_AlignmentStatus2
          19 x ComGroupSignal, all with ComSignalEndianness=LITTLE_ENDIAN, ComSignalInitValue=0:
            AL_STS_002_CYCLE_COUNTER_Rx_oRDR_FUSION_ALIGNMENT_STATUS_002_oPCAN_RADAR_88f856d4_Rx: ComBitPosition=16, ComBitSize=8, ComSignalType=UINT8, ComSystemTemplateSystemSignalRef=AL_STS_002_CYCLE_COUNTER_Rx
            AL_STS_002_MH_CRC16_Rx_oRDR_FUSION_ALIGNMENT_STATUS_002_oPCAN_RADAR_a0be74d6_Rx: ComBitPosition=0, ComBitSize=16, ComSignalType=UINT16, ComSystemTemplateSystemSignalRef=AL_STS_002_MH_CRC16_Rx
            STS_AlignmentServiceStatus_Rx_oRDR_FUSION_ALIGNMENT_STATUS_002_oPCAN_RADAR_96feaa0c_Rx: ComBitPosition=308, ComBitSize=3, ComSignalType=UINT8, ComSystemTemplateSystemSignalRef=STS_AlignmentServiceStatus_Rx
            STS_AlignmentShortTrackStatus_Rx_oRDR_FUSION_ALIGNMENT_STATUS_002_oPCAN_RADAR_4b78fe49_Rx: ComBitPosition=107, ComBitSize=3, ComSignalType=UINT8, ComSystemTemplateSystemSignalRef=STS_AlignmentShortTrackStatus_Rx
            STS_AlignmentStaticStatus_Rx_oRDR_FUSION_ALIGNMENT_STATUS_002_oPCAN_RADAR_bcc15f29_Rx: ComBitPosition=304, ComBitSize=3, ComSignalType=UINT8, ComSystemTemplateSystemSignalRef=STS_AlignmentStaticStatus_Rx
            STS_AverageNumberOfDetections_Rx_oRDR_FUSION_ALIGNMENT_STATUS_002_oPCAN_RADAR_87939da8_Rx: ComBitPosition=144, ComBitSize=32, ComSignalType=UINT32, ComSystemTemplateSystemSignalRef=STS_AverageNumberOfDetections_Rx
            STS_AverageSpeed_Rx_oRDR_FUSION_ALIGNMENT_STATUS_002_oPCAN_RADAR_b3b0e615_Rx: ComBitPosition=240, ComBitSize=32, ComSignalType=UINT32, ComSystemTemplateSystemSignalRef=STS_AverageSpeed_Rx
            STS_DistanceAbsolute_Rx_oRDR_FUSION_ALIGNMENT_STATUS_002_oPCAN_RADAR_2fe90afa_Rx: ComBitPosition=112, ComBitSize=32, ComSignalType=UINT32, ComSystemTemplateSystemSignalRef=STS_DistanceAbsolute_Rx
            STS_DistanceEffective_Rx_oRDR_FUSION_ALIGNMENT_STATUS_002_oPCAN_RADAR_5ee1b0ad_Rx: ComBitPosition=176, ComBitSize=32, ComSignalType=UINT32, ComSystemTemplateSystemSignalRef=STS_DistanceEffective_Rx
            STS_DurationAbsolute_Rx_oRDR_FUSION_ALIGNMENT_STATUS_002_oPCAN_RADAR_ad18ccaf_Rx: ComBitPosition=208, ComBitSize=32, ComSignalType=UINT32, ComSystemTemplateSystemSignalRef=STS_DurationAbsolute_Rx
            STS_DurationEffective_Rx_oRDR_FUSION_ALIGNMENT_STATUS_002_oPCAN_RADAR_4562e410_Rx: ComBitPosition=272, ComBitSize=32, ComSignalType=UINT32, ComSystemTemplateSystemSignalRef=STS_DurationEffective_Rx
            STS_ImpactByInterference_Rx_oRDR_FUSION_ALIGNMENT_STATUS_002_oPCAN_RADAR_dbc02f0e_Rx: ComBitPosition=307, ComBitSize=1, ComSignalType=BOOLEAN, ComSystemTemplateSystemSignalRef=STS_ImpactByInterference_Rx
            STS_MeasuredAmpSTD_Rx_oRDR_FUSION_ALIGNMENT_STATUS_002_oPCAN_RADAR_93fa8c9f_Rx: ComBitPosition=88, ComBitSize=15, ComSignalType=UINT16, ComSystemTemplateSystemSignalRef=STS_MeasuredAmpSTD_Rx
            STS_MeasuredRangeRateStd_Rx_oRDR_FUSION_ALIGNMENT_STATUS_002_oPCAN_RADAR_7ea372f0_Rx: ComBitPosition=40, ComBitSize=16, ComSignalType=SINT16, ComSystemTemplateSystemSignalRef=STS_MeasuredRangeRateStd_Rx
            STS_MeasuredRangeRate_Rx_oRDR_FUSION_ALIGNMENT_STATUS_002_oPCAN_RADAR_62640a65_Rx: ComBitPosition=69, ComBitSize=18, ComSignalType=SINT32, ComSystemTemplateSystemSignalRef=STS_MeasuredRangeRate_Rx
            STS_MeasuredRangeStd_Rx_oRDR_FUSION_ALIGNMENT_STATUS_002_oPCAN_RADAR_79b75936_Rx: ComBitPosition=24, ComBitSize=16, ComSignalType=UINT16, ComSystemTemplateSystemSignalRef=STS_MeasuredRangeStd_Rx
            STS_MeasuredRawAmplitude_Rx_oRDR_FUSION_ALIGNMENT_STATUS_002_oPCAN_RADAR_37a2fd07_Rx: ComBitPosition=56, ComBitSize=13, ComSignalType=SINT16, ComSystemTemplateSystemSignalRef=STS_MeasuredRawAmplitude_Rx
            STS_Measured_Range_Rx_oRDR_FUSION_ALIGNMENT_STATUS_002_oPCAN_RADAR_b763ef82_Rx: ComBitPosition=312, ComBitSize=14, ComSignalType=UINT16, ComSystemTemplateSystemSignalRef=STS_Measured_Range_Rx
            STS_VehicleCondition_Rx_oRDR_FUSION_ALIGNMENT_STATUS_002_oPCAN_RADAR_4c9d97f7_Rx: ComBitPosition=104, ComBitSize=3, ComSignalType=UINT8, ComSystemTemplateSystemSignalRef=STS_VehicleCondition_Rx
        SG_Fusion_Detections_001_004_oRDR_FUSION_DET_001_004_oPCAN_RADAR_4a788d9f_Rx: ComTimeout=0, ComSystemTemplateSignalGroupRef=SG_Fusion_Detections_001_004
          83 x ComGroupSignal, all with ComSignalEndianness=LITTLE_ENDIAN, ComSignalInitValue=0:
            DET_AZIMUTH_001_Rx_oRDR_FUSION_DET_001_004_oPCAN_RADAR_5993bb11_Rx: ComBitPosition=88, ComBitSize=13, ComSignalType=UINT16, ComSystemTemplateSystemSignalRef=DET_AZIMUTH_001_Rx
            DET_AZIMUTH_002_Rx_oRDR_FUSION_DET_001_004_oPCAN_RADAR_732f0b99_Rx: ComBitPosition=200, ComBitSize=13, ComSignalType=UINT16, ComSystemTemplateSystemSignalRef=DET_AZIMUTH_002_Rx
            DET_AZIMUTH_003_Rx_oRDR_FUSION_DET_001_004_oPCAN_RADAR_dc6b99de_Rx: ComBitPosition=312, ComBitSize=13, ComSignalType=UINT16, ComSystemTemplateSystemSignalRef=DET_AZIMUTH_003_Rx
            DET_AZIMUTH_004_Rx_oRDR_FUSION_DET_001_004_oPCAN_RADAR_26566a89_Rx: ComBitPosition=424, ComBitSize=13, ComSignalType=UINT16, ComSystemTemplateSystemSignalRef=DET_AZIMUTH_004_Rx
            DET_AZIMUTH_ERR_001_Rx_oRDR_FUSION_DET_001_004_oPCAN_RADAR_5bfa1a93_Rx: ComBitPosition=105, ComBitSize=7, ComSignalType=UINT8, ComSystemTemplateSystemSignalRef=DET_AZIMUTH_ERR_001_Rx
            DET_AZIMUTH_ERR_002_Rx_oRDR_FUSION_DET_001_004_oPCAN_RADAR_7146aa1b_Rx: ComBitPosition=217, ComBitSize=7, ComSignalType=UINT8, ComSystemTemplateSystemSignalRef=DET_AZIMUTH_ERR_002_Rx
            DET_AZIMUTH_ERR_003_Rx_oRDR_FUSION_DET_001_004_oPCAN_RADAR_de02385c_Rx: ComBitPosition=329, ComBitSize=7, ComSignalType=UINT8, ComSystemTemplateSystemSignalRef=DET_AZIMUTH_ERR_003_Rx
            DET_AZIMUTH_ERR_004_Rx_oRDR_FUSION_DET_001_004_oPCAN_RADAR_243fcb0b_Rx: ComBitPosition=441, ComBitSize=7, ComSignalType=UINT8, ComSystemTemplateSystemSignalRef=DET_AZIMUTH_ERR_004_Rx
            DET_BELOW_RAIN_THOLD_001_Rx_oRDR_FUSION_DET_001_004_oPCAN_RADAR_3f2944a4_Rx: ComBitPosition=39, ComBitSize=1, ComSignalType=BOOLEAN, ComSystemTemplateSystemSignalRef=DET_BELOW_RAIN_THOLD_001_Rx
            DET_BELOW_RAIN_THOLD_002_Rx_oRDR_FUSION_DET_001_004_oPCAN_RADAR_1595f42c_Rx: ComBitPosition=151, ComBitSize=1, ComSignalType=BOOLEAN, ComSystemTemplateSystemSignalRef=DET_BELOW_RAIN_THOLD_002_Rx
            DET_BELOW_RAIN_THOLD_003_Rx_oRDR_FUSION_DET_001_004_oPCAN_RADAR_bad1666b_Rx: ComBitPosition=263, ComBitSize=1, ComSignalType=BOOLEAN, ComSystemTemplateSystemSignalRef=DET_BELOW_RAIN_THOLD_003_Rx
            DET_BELOW_RAIN_THOLD_004_Rx_oRDR_FUSION_DET_001_004_oPCAN_RADAR_40ec953c_Rx: ComBitPosition=375, ComBitSize=1, ComSignalType=BOOLEAN, ComSystemTemplateSystemSignalRef=DET_BELOW_RAIN_THOLD_004_Rx
            DET_BI_STATIC_FLAG_001_Rx_oRDR_FUSION_DET_001_004_oPCAN_RADAR_48b7efb7_Rx: ComBitPosition=104, ComBitSize=1, ComSignalType=BOOLEAN, ComSystemTemplateSystemSignalRef=DET_BI_STATIC_FLAG_001_Rx
            DET_BI_STATIC_FLAG_002_Rx_oRDR_FUSION_DET_001_004_oPCAN_RADAR_620b5f3f_Rx: ComBitPosition=216, ComBitSize=1, ComSignalType=BOOLEAN, ComSystemTemplateSystemSignalRef=DET_BI_STATIC_FLAG_002_Rx
            DET_BI_STATIC_FLAG_003_Rx_oRDR_FUSION_DET_001_004_oPCAN_RADAR_cd4fcd78_Rx: ComBitPosition=328, ComBitSize=1, ComSignalType=BOOLEAN, ComSystemTemplateSystemSignalRef=DET_BI_STATIC_FLAG_003_Rx
            DET_BI_STATIC_FLAG_004_Rx_oRDR_FUSION_DET_001_004_oPCAN_RADAR_37723e2f_Rx: ComBitPosition=440, ComBitSize=1, ComSignalType=BOOLEAN, ComSystemTemplateSystemSignalRef=DET_BI_STATIC_FLAG_004_Rx
            DET_CONFD_AZIMUTH_001_Rx_oRDR_FUSION_DET_001_004_oPCAN_RADAR_abde05e3_Rx: ComBitPosition=118, ComBitSize=2, ComSignalType=UINT8, ComSystemTemplateSystemSignalRef=DET_CONFD_AZIMUTH_001_Rx
            DET_CONFD_AZIMUTH_002_Rx_oRDR_FUSION_DET_001_004_oPCAN_RADAR_8162b56b_Rx: ComBitPosition=230, ComBitSize=2, ComSignalType=UINT8, ComSystemTemplateSystemSignalRef=DET_CONFD_AZIMUTH_002_Rx
            DET_CONFD_AZIMUTH_003_Rx_oRDR_FUSION_DET_001_004_oPCAN_RADAR_2e26272c_Rx: ComBitPosition=342, ComBitSize=2, ComSignalType=UINT8, ComSystemTemplateSystemSignalRef=DET_CONFD_AZIMUTH_003_Rx
            DET_CONFD_AZIMUTH_004_Rx_oRDR_FUSION_DET_001_004_oPCAN_RADAR_d41bd47b_Rx: ComBitPosition=454, ComBitSize=2, ComSignalType=UINT8, ComSystemTemplateSystemSignalRef=DET_CONFD_AZIMUTH_004_Rx
            DET_CONFD_ELEVATION_001_Rx_oRDR_FUSION_DET_001_004_oPCAN_RADAR_a1ff8664_Rx: ComBitPosition=101, ComBitSize=2, ComSignalType=UINT8, ComSystemTemplateSystemSignalRef=DET_CONFD_ELEVATION_001_Rx
            DET_CONFD_ELEVATION_002_Rx_oRDR_FUSION_DET_001_004_oPCAN_RADAR_8b4336ec_Rx: ComBitPosition=213, ComBitSize=2, ComSignalType=UINT8, ComSystemTemplateSystemSignalRef=DET_CONFD_ELEVATION_002_Rx
            DET_CONFD_ELEVATION_003_Rx_oRDR_FUSION_DET_001_004_oPCAN_RADAR_2407a4ab_Rx: ComBitPosition=325, ComBitSize=2, ComSignalType=UINT8, ComSystemTemplateSystemSignalRef=DET_CONFD_ELEVATION_003_Rx
            DET_CONFD_ELEVATION_004_Rx_oRDR_FUSION_DET_001_004_oPCAN_RADAR_de3a57fc_Rx: ComBitPosition=437, ComBitSize=2, ComSignalType=UINT8, ComSystemTemplateSystemSignalRef=DET_CONFD_ELEVATION_004_Rx
            DET_ELEVATION_001_Rx_oRDR_FUSION_DET_001_004_oPCAN_RADAR_abac699d_Rx: ComBitPosition=72, ComBitSize=8, ComSignalType=UINT8, ComSystemTemplateSystemSignalRef=DET_ELEVATION_001_Rx
            DET_ELEVATION_002_Rx_oRDR_FUSION_DET_001_004_oPCAN_RADAR_8110d915_Rx: ComBitPosition=184, ComBitSize=8, ComSignalType=UINT8, ComSystemTemplateSystemSignalRef=DET_ELEVATION_002_Rx
            DET_ELEVATION_003_Rx_oRDR_FUSION_DET_001_004_oPCAN_RADAR_2e544b52_Rx: ComBitPosition=296, ComBitSize=8, ComSignalType=UINT8, ComSystemTemplateSystemSignalRef=DET_ELEVATION_003_Rx
            DET_ELEVATION_004_Rx_oRDR_FUSION_DET_001_004_oPCAN_RADAR_d469b805_Rx: ComBitPosition=408, ComBitSize=8, ComSignalType=UINT8, ComSystemTemplateSystemSignalRef=DET_ELEVATION_004_Rx
            DET_ELEVATION_ERR_001_Rx_oRDR_FUSION_DET_001_004_oPCAN_RADAR_79154b42_Rx: ComBitPosition=80, ComBitSize=6, ComSignalType=UINT8, ComSystemTemplateSystemSignalRef=DET_ELEVATION_ERR_001_Rx
            DET_ELEVATION_ERR_002_Rx_oRDR_FUSION_DET_001_004_oPCAN_RADAR_53a9fbca_Rx: ComBitPosition=192, ComBitSize=6, ComSignalType=UINT8, ComSystemTemplateSystemSignalRef=DET_ELEVATION_ERR_002_Rx
            DET_ELEVATION_ERR_003_Rx_oRDR_FUSION_DET_001_004_oPCAN_RADAR_fced698d_Rx: ComBitPosition=304, ComBitSize=6, ComSignalType=UINT8, ComSystemTemplateSystemSignalRef=DET_ELEVATION_ERR_003_Rx
            DET_ELEVATION_ERR_004_Rx_oRDR_FUSION_DET_001_004_oPCAN_RADAR_06d09ada_Rx: ComBitPosition=416, ComBitSize=6, ComSignalType=UINT8, ComSystemTemplateSystemSignalRef=DET_ELEVATION_ERR_004_Rx
            DET_EXISTENCE_PROB_001_Rx_oRDR_FUSION_DET_001_004_oPCAN_RADAR_8e0d33d7_Rx: ComBitPosition=112, ComBitSize=6, ComSignalType=UINT8, ComSystemTemplateSystemSignalRef=DET_EXISTENCE_PROB_001_Rx
            DET_EXISTENCE_PROB_002_Rx_oRDR_FUSION_DET_001_004_oPCAN_RADAR_a4b1835f_Rx: ComBitPosition=224, ComBitSize=6, ComSignalType=UINT8, ComSystemTemplateSystemSignalRef=DET_EXISTENCE_PROB_002_Rx
            DET_EXISTENCE_PROB_003_Rx_oRDR_FUSION_DET_001_004_oPCAN_RADAR_0bf51118_Rx: ComBitPosition=336, ComBitSize=6, ComSignalType=UINT8, ComSystemTemplateSystemSignalRef=DET_EXISTENCE_PROB_003_Rx
            DET_EXISTENCE_PROB_004_Rx_oRDR_FUSION_DET_001_004_oPCAN_RADAR_f1c8e24f_Rx: ComBitPosition=448, ComBitSize=6, ComSignalType=UINT8, ComSystemTemplateSystemSignalRef=DET_EXISTENCE_PROB_004_Rx
            DET_HVC_FLAG_001_Rx_oRDR_FUSION_DET_001_004_oPCAN_RADAR_53d3de98_Rx: ComBitPosition=86, ComBitSize=1, ComSignalType=BOOLEAN, ComSystemTemplateSystemSignalRef=DET_HVC_FLAG_001_Rx
            DET_HVC_FLAG_002_Rx_oRDR_FUSION_DET_001_004_oPCAN_RADAR_796f6e10_Rx: ComBitPosition=198, ComBitSize=1, ComSignalType=BOOLEAN, ComSystemTemplateSystemSignalRef=DET_HVC_FLAG_002_Rx
            DET_HVC_FLAG_003_Rx_oRDR_FUSION_DET_001_004_oPCAN_RADAR_d62bfc57_Rx: ComBitPosition=310, ComBitSize=1, ComSignalType=BOOLEAN, ComSystemTemplateSystemSignalRef=DET_HVC_FLAG_003_Rx
            DET_HVC_FLAG_004_Rx_oRDR_FUSION_DET_001_004_oPCAN_RADAR_2c160f00_Rx: ComBitPosition=422, ComBitSize=1, ComSignalType=BOOLEAN, ComSystemTemplateSystemSignalRef=DET_HVC_FLAG_004_Rx
            DET_IDM_001_Rx_oRDR_FUSION_DET_001_004_oPCAN_RADAR_661227d0_Rx: ComBitPosition=63, ComBitSize=1, ComSignalType=BOOLEAN, ComSystemTemplateSystemSignalRef=DET_IDM_001_Rx
            DET_IDM_002_Rx_oRDR_FUSION_DET_001_004_oPCAN_RADAR_4cae9758_Rx: ComBitPosition=175, ComBitSize=1, ComSignalType=BOOLEAN, ComSystemTemplateSystemSignalRef=DET_IDM_002_Rx
            DET_IDM_003_Rx_oRDR_FUSION_DET_001_004_oPCAN_RADAR_e3ea051f_Rx: ComBitPosition=287, ComBitSize=1, ComSignalType=BOOLEAN, ComSystemTemplateSystemSignalRef=DET_IDM_003_Rx
            DET_IDM_004_Rx_oRDR_FUSION_DET_001_004_oPCAN_RADAR_19d7f648_Rx: ComBitPosition=399, ComBitSize=1, ComSignalType=BOOLEAN, ComSystemTemplateSystemSignalRef=DET_IDM_004_Rx
            DET_MH_CRC16_001_004_Rx_oRDR_FUSION_DET_001_004_oPCAN_RADAR_7ff0d781_Rx: ComBitPosition=0, ComBitSize=16, ComSignalType=UINT16, ComSystemTemplateSystemSignalRef=DET_MH_CRC16_001_004_Rx
            DET_MH_CYCLE_COUNTER_001_004_Rx_oRDR_FUSION_DET_001_004_oPCAN_RADAR_722bea44_Rx: ComBitPosition=16, ComBitSize=8, ComSignalType=UINT8, ComSystemTemplateSystemSignalRef=DET_MH_CYCLE_COUNTER_001_004_Rx
            DET_MH_SCAN_INDEX_4LSB_001_004_Rx_oRDR_FUSION_DET_001_004_oPCAN_RADAR_169b257f_Rx: ComBitPosition=476, ComBitSize=4, ComSignalType=UINT8, ComSystemTemplateSystemSignalRef=DET_MH_SCAN_INDEX_4LSB_001_004_Rx
            DET_MTD_001_Rx_oRDR_FUSION_DET_001_004_oPCAN_RADAR_db9111a0_Rx: ComBitPosition=47, ComBitSize=1, ComSignalType=BOOLEAN, ComSystemTemplateSystemSignalRef=DET_MTD_001_Rx
            DET_MTD_002_Rx_oRDR_FUSION_DET_001_004_oPCAN_RADAR_f12da128_Rx: ComBitPosition=159, ComBitSize=1, ComSignalType=BOOLEAN, ComSystemTemplateSystemSignalRef=DET_MTD_002_Rx
            DET_MTD_003_Rx_oRDR_FUSION_DET_001_004_oPCAN_RADAR_5e69336f_Rx: ComBitPosition=271, ComBitSize=1, ComSignalType=BOOLEAN, ComSystemTemplateSystemSignalRef=DET_MTD_003_Rx
            DET_MTD_004_Rx_oRDR_FUSION_DET_001_004_oPCAN_RADAR_a454c038_Rx: ComBitPosition=383, ComBitSize=1, ComSignalType=BOOLEAN, ComSystemTemplateSystemSignalRef=DET_MTD_004_Rx
            DET_PROB_1STAZHYPO_001_Rx_oRDR_FUSION_DET_001_004_oPCAN_RADAR_11e80f21_Rx: ComBitPosition=103, ComBitSize=1, ComSignalType=BOOLEAN, ComSystemTemplateSystemSignalRef=DET_PROB_1STAZHYPO_001_Rx
            DET_PROB_1STAZHYPO_002_Rx_oRDR_FUSION_DET_001_004_oPCAN_RADAR_3b54bfa9_Rx: ComBitPosition=215, ComBitSize=1, ComSignalType=BOOLEAN, ComSystemTemplateSystemSignalRef=DET_PROB_1STAZHYPO_002_Rx
            DET_PROB_1STAZHYPO_003_Rx_oRDR_FUSION_DET_001_004_oPCAN_RADAR_94102dee_Rx: ComBitPosition=327, ComBitSize=1, ComSignalType=BOOLEAN, ComSystemTemplateSystemSignalRef=DET_PROB_1STAZHYPO_003_Rx
            DET_PROB_1STAZHYPO_004_Rx_oRDR_FUSION_DET_001_004_oPCAN_RADAR_6e2ddeb9_Rx: ComBitPosition=439, ComBitSize=1, ComSignalType=BOOLEAN, ComSystemTemplateSystemSignalRef=DET_PROB_1STAZHYPO_004_Rx
            DET_RANGE_001_Rx_oRDR_FUSION_DET_001_004_oPCAN_RADAR_4a55e736_Rx: ComBitPosition=24, ComBitSize=15, ComSignalType=UINT16, ComSystemTemplateSystemSignalRef=DET_RANGE_001_Rx
            DET_RANGE_002_Rx_oRDR_FUSION_DET_001_004_oPCAN_RADAR_60e957be_Rx: ComBitPosition=136, ComBitSize=15, ComSignalType=UINT16, ComSystemTemplateSystemSignalRef=DET_RANGE_002_Rx
            DET_RANGE_003_Rx_oRDR_FUSION_DET_001_004_oPCAN_RADAR_cfadc5f9_Rx: ComBitPosition=248, ComBitSize=15, ComSignalType=UINT16, ComSystemTemplateSystemSignalRef=DET_RANGE_003_Rx
            DET_RANGE_004_Rx_oRDR_FUSION_DET_001_004_oPCAN_RADAR_359036ae_Rx: ComBitPosition=360, ComBitSize=15, ComSignalType=UINT16, ComSystemTemplateSystemSignalRef=DET_RANGE_004_Rx
            DET_RANGE_ERR_001_Rx_oRDR_FUSION_DET_001_004_oPCAN_RADAR_1aa76bd6_Rx: ComBitPosition=40, ComBitSize=7, ComSignalType=UINT8, ComSystemTemplateSystemSignalRef=DET_RANGE_ERR_001_Rx
            DET_RANGE_ERR_002_Rx_oRDR_FUSION_DET_001_004_oPCAN_RADAR_301bdb5e_Rx: ComBitPosition=152, ComBitSize=7, ComSignalType=UINT8, ComSystemTemplateSystemSignalRef=DET_RANGE_ERR_002_Rx
            DET_RANGE_ERR_003_Rx_oRDR_FUSION_DET_001_004_oPCAN_RADAR_9f5f4919_Rx: ComBitPosition=264, ComBitSize=7, ComSignalType=UINT8, ComSystemTemplateSystemSignalRef=DET_RANGE_ERR_003_Rx
            DET_RANGE_ERR_004_Rx_oRDR_FUSION_DET_001_004_oPCAN_RADAR_6562ba4e_Rx: ComBitPosition=376, ComBitSize=7, ComSignalType=UINT8, ComSystemTemplateSystemSignalRef=DET_RANGE_ERR_004_Rx
            DET_RANGE_VELOCITY_001_Rx_oRDR_FUSION_DET_001_004_oPCAN_RADAR_97a064c8_Rx: ComBitPosition=48, ComBitSize=15, ComSignalType=UINT16, ComSystemTemplateSystemSignalRef=DET_RANGE_VELOCITY_001_Rx
            DET_RANGE_VELOCITY_002_Rx_oRDR_FUSION_DET_001_004_oPCAN_RADAR_bd1cd440_Rx: ComBitPosition=160, ComBitSize=15, ComSignalType=UINT16, ComSystemTemplateSystemSignalRef=DET_RANGE_VELOCITY_002_Rx
            DET_RANGE_VELOCITY_003_Rx_oRDR_FUSION_DET_001_004_oPCAN_RADAR_12584607_Rx: ComBitPosition=272, ComBitSize=15, ComSignalType=UINT16, ComSystemTemplateSystemSignalRef=DET_RANGE_VELOCITY_003_Rx
            DET_RANGE_VELOCITY_004_Rx_oRDR_FUSION_DET_001_004_oPCAN_RADAR_e865b550_Rx: ComBitPosition=384, ComBitSize=15, ComSignalType=UINT16, ComSystemTemplateSystemSignalRef=DET_RANGE_VELOCITY_004_Rx
            DET_RANGE_VELOCITY_ERR_001_Rx_oRDR_FUSION_DET_001_004_oPCAN_RADAR_0ec4140a_Rx: ComBitPosition=64, ComBitSize=8, ComSignalType=UINT8, ComSystemTemplateSystemSignalRef=DET_RANGE_VELOCITY_ERR_001_Rx
            DET_RANGE_VELOCITY_ERR_002_Rx_oRDR_FUSION_DET_001_004_oPCAN_RADAR_2478a482_Rx: ComBitPosition=176, ComBitSize=8, ComSignalType=UINT8, ComSystemTemplateSystemSignalRef=DET_RANGE_VELOCITY_ERR_002_Rx
            DET_RANGE_VELOCITY_ERR_003_Rx_oRDR_FUSION_DET_001_004_oPCAN_RADAR_8b3c36c5_Rx: ComBitPosition=288, ComBitSize=8, ComSignalType=UINT8, ComSystemTemplateSystemSignalRef=DET_RANGE_VELOCITY_ERR_003_Rx
            DET_RANGE_VELOCITY_ERR_004_Rx_oRDR_FUSION_DET_001_004_oPCAN_RADAR_7101c592_Rx: ComBitPosition=400, ComBitSize=8, ComSignalType=UINT8, ComSystemTemplateSystemSignalRef=DET_RANGE_VELOCITY_ERR_004_Rx
            DET_RCS_001_Rx_oRDR_FUSION_DET_001_004_oPCAN_RADAR_5a6bf6d3_Rx: ComBitPosition=128, ComBitSize=8, ComSignalType=UINT8, ComSystemTemplateSystemSignalRef=DET_RCS_001_Rx
            DET_RCS_002_Rx_oRDR_FUSION_DET_001_004_oPCAN_RADAR_70d7465b_Rx: ComBitPosition=240, ComBitSize=8, ComSignalType=UINT8, ComSystemTemplateSystemSignalRef=DET_RCS_002_Rx
            DET_RCS_003_Rx_oRDR_FUSION_DET_001_004_oPCAN_RADAR_df93d41c_Rx: ComBitPosition=352, ComBitSize=8, ComSignalType=UINT8, ComSystemTemplateSystemSignalRef=DET_RCS_003_Rx
            DET_RCS_004_Rx_oRDR_FUSION_DET_001_004_oPCAN_RADAR_25ae274b_Rx: ComBitPosition=464, ComBitSize=8, ComSignalType=UINT8, ComSystemTemplateSystemSignalRef=DET_RCS_004_Rx
            DET_SNR_001_Rx_oRDR_FUSION_DET_001_004_oPCAN_RADAR_5331873a_Rx: ComBitPosition=120, ComBitSize=8, ComSignalType=UINT8, ComSystemTemplateSystemSignalRef=DET_SNR_001_Rx
            DET_SNR_002_Rx_oRDR_FUSION_DET_001_004_oPCAN_RADAR_798d37b2_Rx: ComBitPosition=232, ComBitSize=8, ComSignalType=UINT8, ComSystemTemplateSystemSignalRef=DET_SNR_002_Rx
            DET_SNR_003_Rx_oRDR_FUSION_DET_001_004_oPCAN_RADAR_d6c9a5f5_Rx: ComBitPosition=344, ComBitSize=8, ComSignalType=UINT8, ComSystemTemplateSystemSignalRef=DET_SNR_003_Rx
            DET_SNR_004_Rx_oRDR_FUSION_DET_001_004_oPCAN_RADAR_2cf456a2_Rx: ComBitPosition=456, ComBitSize=8, ComSignalType=UINT8, ComSystemTemplateSystemSignalRef=DET_SNR_004_Rx
            DET_SUPER_RES_TARGET_001_Rx_oRDR_FUSION_DET_001_004_oPCAN_RADAR_98caa63a_Rx: ComBitPosition=87, ComBitSize=1, ComSignalType=BOOLEAN, ComSystemTemplateSystemSignalRef=DET_SUPER_RES_TARGET_001_Rx
            DET_SUPER_RES_TARGET_002_Rx_oRDR_FUSION_DET_001_004_oPCAN_RADAR_b27616b2_Rx: ComBitPosition=199, ComBitSize=1, ComSignalType=BOOLEAN, ComSystemTemplateSystemSignalRef=DET_SUPER_RES_TARGET_002_Rx
            DET_SUPER_RES_TARGET_003_Rx_oRDR_FUSION_DET_001_004_oPCAN_RADAR_1d3284f5_Rx: ComBitPosition=311, ComBitSize=1, ComSignalType=BOOLEAN, ComSystemTemplateSystemSignalRef=DET_SUPER_RES_TARGET_003_Rx
            DET_SUPER_RES_TARGET_004_Rx_oRDR_FUSION_DET_001_004_oPCAN_RADAR_e70f77a2_Rx: ComBitPosition=423, ComBitSize=1, ComSignalType=BOOLEAN, ComSystemTemplateSystemSignalRef=DET_SUPER_RES_TARGET_004_Rx
        SG_Fusion_Detections_005_008_oRDR_FUSION_DET_005_008_oPCAN_RADAR_0783a66c_Rx: ComTimeout=0, ComSystemTemplateSignalGroupRef=SG_Fusion_Detections_005_008
          83 x ComGroupSignal, all with ComSignalEndianness=LITTLE_ENDIAN, ComSignalInitValue=0:
            DET_AZIMUTH_005_Rx_oRDR_FUSION_DET_005_008_oPCAN_RADAR_60a066fa_Rx: ComBitPosition=88, ComBitSize=13, ComSignalType=UINT16, ComSystemTemplateSystemSignalRef=DET_AZIMUTH_005_Rx
            DET_AZIMUTH_006_Rx_oRDR_FUSION_DET_005_008_oPCAN_RADAR_4a1cd672_Rx: ComBitPosition=200, ComBitSize=13, ComSignalType=UINT16, ComSystemTemplateSystemSignalRef=DET_AZIMUTH_006_Rx
            DET_AZIMUTH_007_Rx_oRDR_FUSION_DET_005_008_oPCAN_RADAR_e5584435_Rx: ComBitPosition=312, ComBitSize=13, ComSignalType=UINT16, ComSystemTemplateSystemSignalRef=DET_AZIMUTH_007_Rx
            DET_AZIMUTH_008_Rx_oRDR_FUSION_DET_005_008_oPCAN_RADAR_6516369d_Rx: ComBitPosition=424, ComBitSize=13, ComSignalType=UINT16, ComSystemTemplateSystemSignalRef=DET_AZIMUTH_008_Rx
            DET_AZIMUTH_ERR_005_Rx_oRDR_FUSION_DET_005_008_oPCAN_RADAR_62c9c778_Rx: ComBitPosition=105, ComBitSize=7, ComSignalType=UINT8, ComSystemTemplateSystemSignalRef=DET_AZIMUTH_ERR_005_Rx
            DET_AZIMUTH_ERR_006_Rx_oRDR_FUSION_DET_005_008_oPCAN_RADAR_487577f0_Rx: ComBitPosition=217, ComBitSize=7, ComSignalType=UINT8, ComSystemTemplateSystemSignalRef=DET_AZIMUTH_ERR_006_Rx
            DET_AZIMUTH_ERR_007_Rx_oRDR_FUSION_DET_005_008_oPCAN_RADAR_e731e5b7_Rx: ComBitPosition=329, ComBitSize=7, ComSignalType=UINT8, ComSystemTemplateSystemSignalRef=DET_AZIMUTH_ERR_007_Rx
            DET_AZIMUTH_ERR_008_Rx_oRDR_FUSION_DET_005_008_oPCAN_RADAR_677f971f_Rx: ComBitPosition=441, ComBitSize=7, ComSignalType=UINT8, ComSystemTemplateSystemSignalRef=DET_AZIMUTH_ERR_008_Rx
            DET_BELOW_RAIN_THOLD_005_Rx_oRDR_FUSION_DET_005_008_oPCAN_RADAR_061a994f_Rx: ComBitPosition=39, ComBitSize=1, ComSignalType=BOOLEAN, ComSystemTemplateSystemSignalRef=DET_BELOW_RAIN_THOLD_005_Rx
            DET_BELOW_RAIN_THOLD_006_Rx_oRDR_FUSION_DET_005_008_oPCAN_RADAR_2ca629c7_Rx: ComBitPosition=151, ComBitSize=1, ComSignalType=BOOLEAN, ComSystemTemplateSystemSignalRef=DET_BELOW_RAIN_THOLD_006_Rx
            DET_BELOW_RAIN_THOLD_007_Rx_oRDR_FUSION_DET_005_008_oPCAN_RADAR_83e2bb80_Rx: ComBitPosition=263, ComBitSize=1, ComSignalType=BOOLEAN, ComSystemTemplateSystemSignalRef=DET_BELOW_RAIN_THOLD_007_Rx
            DET_BELOW_RAIN_THOLD_008_Rx_oRDR_FUSION_DET_005_008_oPCAN_RADAR_03acc928_Rx: ComBitPosition=375, ComBitSize=1, ComSignalType=BOOLEAN, ComSystemTemplateSystemSignalRef=DET_BELOW_RAIN_THOLD_008_Rx
            DET_BI_STATIC_FLAG_005_Rx_oRDR_FUSION_DET_005_008_oPCAN_RADAR_7184325c_Rx: ComBitPosition=104, ComBitSize=1, ComSignalType=BOOLEAN, ComSystemTemplateSystemSignalRef=DET_BI_STATIC_FLAG_005_Rx
            DET_BI_STATIC_FLAG_006_Rx_oRDR_FUSION_DET_005_008_oPCAN_RADAR_5b3882d4_Rx: ComBitPosition=216, ComBitSize=1, ComSignalType=BOOLEAN, ComSystemTemplateSystemSignalRef=DET_BI_STATIC_FLAG_006_Rx
            DET_BI_STATIC_FLAG_007_Rx_oRDR_FUSION_DET_005_008_oPCAN_RADAR_f47c1093_Rx: ComBitPosition=328, ComBitSize=1, ComSignalType=BOOLEAN, ComSystemTemplateSystemSignalRef=DET_BI_STATIC_FLAG_007_Rx
            DET_BI_STATIC_FLAG_008_Rx_oRDR_FUSION_DET_005_008_oPCAN_RADAR_7432623b_Rx: ComBitPosition=440, ComBitSize=1, ComSignalType=BOOLEAN, ComSystemTemplateSystemSignalRef=DET_BI_STATIC_FLAG_008_Rx
            DET_CONFD_AZIMUTH_005_Rx_oRDR_FUSION_DET_005_008_oPCAN_RADAR_92edd808_Rx: ComBitPosition=118, ComBitSize=2, ComSignalType=UINT8, ComSystemTemplateSystemSignalRef=DET_CONFD_AZIMUTH_005_Rx
            DET_CONFD_AZIMUTH_006_Rx_oRDR_FUSION_DET_005_008_oPCAN_RADAR_b8516880_Rx: ComBitPosition=230, ComBitSize=2, ComSignalType=UINT8, ComSystemTemplateSystemSignalRef=DET_CONFD_AZIMUTH_006_Rx
            DET_CONFD_AZIMUTH_007_Rx_oRDR_FUSION_DET_005_008_oPCAN_RADAR_1715fac7_Rx: ComBitPosition=342, ComBitSize=2, ComSignalType=UINT8, ComSystemTemplateSystemSignalRef=DET_CONFD_AZIMUTH_007_Rx
            DET_CONFD_AZIMUTH_008_Rx_oRDR_FUSION_DET_005_008_oPCAN_RADAR_975b886f_Rx: ComBitPosition=454, ComBitSize=2, ComSignalType=UINT8, ComSystemTemplateSystemSignalRef=DET_CONFD_AZIMUTH_008_Rx
            DET_CONFD_ELEVATION_005_Rx_oRDR_FUSION_DET_005_008_oPCAN_RADAR_98cc5b8f_Rx: ComBitPosition=101, ComBitSize=2, ComSignalType=UINT8, ComSystemTemplateSystemSignalRef=DET_CONFD_ELEVATION_005_Rx
            DET_CONFD_ELEVATION_006_Rx_oRDR_FUSION_DET_005_008_oPCAN_RADAR_b270eb07_Rx: ComBitPosition=213, ComBitSize=2, ComSignalType=UINT8, ComSystemTemplateSystemSignalRef=DET_CONFD_ELEVATION_006_Rx
            DET_CONFD_ELEVATION_007_Rx_oRDR_FUSION_DET_005_008_oPCAN_RADAR_1d347940_Rx: ComBitPosition=325, ComBitSize=2, ComSignalType=UINT8, ComSystemTemplateSystemSignalRef=DET_CONFD_ELEVATION_007_Rx
            DET_CONFD_ELEVATION_008_Rx_oRDR_FUSION_DET_005_008_oPCAN_RADAR_9d7a0be8_Rx: ComBitPosition=437, ComBitSize=2, ComSignalType=UINT8, ComSystemTemplateSystemSignalRef=DET_CONFD_ELEVATION_008_Rx
            DET_ELEVATION_005_Rx_oRDR_FUSION_DET_005_008_oPCAN_RADAR_929fb476_Rx: ComBitPosition=72, ComBitSize=8, ComSignalType=UINT8, ComSystemTemplateSystemSignalRef=DET_ELEVATION_005_Rx
            DET_ELEVATION_006_Rx_oRDR_FUSION_DET_005_008_oPCAN_RADAR_b82304fe_Rx: ComBitPosition=184, ComBitSize=8, ComSignalType=UINT8, ComSystemTemplateSystemSignalRef=DET_ELEVATION_006_Rx
            DET_ELEVATION_007_Rx_oRDR_FUSION_DET_005_008_oPCAN_RADAR_176796b9_Rx: ComBitPosition=296, ComBitSize=8, ComSignalType=UINT8, ComSystemTemplateSystemSignalRef=DET_ELEVATION_007_Rx
            DET_ELEVATION_008_Rx_oRDR_FUSION_DET_005_008_oPCAN_RADAR_9729e411_Rx: ComBitPosition=408, ComBitSize=8, ComSignalType=UINT8, ComSystemTemplateSystemSignalRef=DET_ELEVATION_008_Rx
            DET_ELEVATION_ERR_005_Rx_oRDR_FUSION_DET_005_008_oPCAN_RADAR_402696a9_Rx: ComBitPosition=80, ComBitSize=6, ComSignalType=UINT8, ComSystemTemplateSystemSignalRef=DET_ELEVATION_ERR_005_Rx
            DET_ELEVATION_ERR_006_Rx_oRDR_FUSION_DET_005_008_oPCAN_RADAR_6a9a2621_Rx: ComBitPosition=192, ComBitSize=6, ComSignalType=UINT8, ComSystemTemplateSystemSignalRef=DET_ELEVATION_ERR_006_Rx
            DET_ELEVATION_ERR_007_Rx_oRDR_FUSION_DET_005_008_oPCAN_RADAR_c5deb466_Rx: ComBitPosition=304, ComBitSize=6, ComSignalType=UINT8, ComSystemTemplateSystemSignalRef=DET_ELEVATION_ERR_007_Rx
            DET_ELEVATION_ERR_008_Rx_oRDR_FUSION_DET_005_008_oPCAN_RADAR_4590c6ce_Rx: ComBitPosition=416, ComBitSize=6, ComSignalType=UINT8, ComSystemTemplateSystemSignalRef=DET_ELEVATION_ERR_008_Rx
            DET_EXISTENCE_PROB_005_Rx_oRDR_FUSION_DET_005_008_oPCAN_RADAR_b73eee3c_Rx: ComBitPosition=112, ComBitSize=6, ComSignalType=UINT8, ComSystemTemplateSystemSignalRef=DET_EXISTENCE_PROB_005_Rx
            DET_EXISTENCE_PROB_006_Rx_oRDR_FUSION_DET_005_008_oPCAN_RADAR_9d825eb4_Rx: ComBitPosition=224, ComBitSize=6, ComSignalType=UINT8, ComSystemTemplateSystemSignalRef=DET_EXISTENCE_PROB_006_Rx
            DET_EXISTENCE_PROB_007_Rx_oRDR_FUSION_DET_005_008_oPCAN_RADAR_32c6ccf3_Rx: ComBitPosition=336, ComBitSize=6, ComSignalType=UINT8, ComSystemTemplateSystemSignalRef=DET_EXISTENCE_PROB_007_Rx
            DET_EXISTENCE_PROB_008_Rx_oRDR_FUSION_DET_005_008_oPCAN_RADAR_b288be5b_Rx: ComBitPosition=448, ComBitSize=6, ComSignalType=UINT8, ComSystemTemplateSystemSignalRef=DET_EXISTENCE_PROB_008_Rx
            DET_HVC_FLAG_005_Rx_oRDR_FUSION_DET_005_008_oPCAN_RADAR_6ae00373_Rx: ComBitPosition=86, ComBitSize=1, ComSignalType=BOOLEAN, ComSystemTemplateSystemSignalRef=DET_HVC_FLAG_005_Rx
            DET_HVC_FLAG_006_Rx_oRDR_FUSION_DET_005_008_oPCAN_RADAR_405cb3fb_Rx: ComBitPosition=198, ComBitSize=1, ComSignalType=BOOLEAN, ComSystemTemplateSystemSignalRef=DET_HVC_FLAG_006_Rx
            DET_HVC_FLAG_007_Rx_oRDR_FUSION_DET_005_008_oPCAN_RADAR_ef1821bc_Rx: ComBitPosition=310, ComBitSize=1, ComSignalType=BOOLEAN, ComSystemTemplateSystemSignalRef=DET_HVC_FLAG_007_Rx
            DET_HVC_FLAG_008_Rx_oRDR_FUSION_DET_005_008_oPCAN_RADAR_6f565314_Rx: ComBitPosition=422, ComBitSize=1, ComSignalType=BOOLEAN, ComSystemTemplateSystemSignalRef=DET_HVC_FLAG_008_Rx
            DET_IDM_005_Rx_oRDR_FUSION_DET_005_008_oPCAN_RADAR_5f21fa3b_Rx: ComBitPosition=63, ComBitSize=1, ComSignalType=BOOLEAN, ComSystemTemplateSystemSignalRef=DET_IDM_005_Rx
            DET_IDM_006_Rx_oRDR_FUSION_DET_005_008_oPCAN_RADAR_759d4ab3_Rx: ComBitPosition=175, ComBitSize=1, ComSignalType=BOOLEAN, ComSystemTemplateSystemSignalRef=DET_IDM_006_Rx
            DET_IDM_007_Rx_oRDR_FUSION_DET_005_008_oPCAN_RADAR_dad9d8f4_Rx: ComBitPosition=287, ComBitSize=1, ComSignalType=BOOLEAN, ComSystemTemplateSystemSignalRef=DET_IDM_007_Rx
            DET_IDM_008_Rx_oRDR_FUSION_DET_005_008_oPCAN_RADAR_5a97aa5c_Rx: ComBitPosition=399, ComBitSize=1, ComSignalType=BOOLEAN, ComSystemTemplateSystemSignalRef=DET_IDM_008_Rx
            DET_MH_CRC16_005_008_Rx_oRDR_FUSION_DET_005_008_oPCAN_RADAR_94106a1d_Rx: ComBitPosition=0, ComBitSize=16, ComSignalType=UINT16, ComSystemTemplateSystemSignalRef=DET_MH_CRC16_005_008_Rx
            DET_MH_CYCLE_COUNTER_005_008_Rx_oRDR_FUSION_DET_005_008_oPCAN_RADAR_99cb57d8_Rx: ComBitPosition=16, ComBitSize=8, ComSignalType=UINT8, ComSystemTemplateSystemSignalRef=DET_MH_CYCLE_COUNTER_005_008_Rx
            DET_MH_SCAN_INDEX_4LSB_005_008_Rx_oRDR_FUSION_DET_005_008_oPCAN_RADAR_fd7b98e3_Rx: ComBitPosition=476, ComBitSize=4, ComSignalType=UINT8, ComSystemTemplateSystemSignalRef=DET_MH_SCAN_INDEX_4LSB_005_008_Rx
            DET_MTD_005_Rx_oRDR_FUSION_DET_005_008_oPCAN_RADAR_e2a2cc4b_Rx: ComBitPosition=47, ComBitSize=1, ComSignalType=BOOLEAN, ComSystemTemplateSystemSignalRef=DET_MTD_005_Rx
            DET_MTD_006_Rx_oRDR_FUSION_DET_005_008_oPCAN_RADAR_c81e7cc3_Rx: ComBitPosition=159, ComBitSize=1, ComSignalType=BOOLEAN, ComSystemTemplateSystemSignalRef=DET_MTD_006_Rx
            DET_MTD_007_Rx_oRDR_FUSION_DET_005_008_oPCAN_RADAR_675aee84_Rx: ComBitPosition=271, ComBitSize=1, ComSignalType=BOOLEAN, ComSystemTemplateSystemSignalRef=DET_MTD_007_Rx
            DET_MTD_008_Rx_oRDR_FUSION_DET_005_008_oPCAN_RADAR_e7149c2c_Rx: ComBitPosition=383, ComBitSize=1, ComSignalType=BOOLEAN, ComSystemTemplateSystemSignalRef=DET_MTD_008_Rx
            DET_PROB_1STAZHYPO_005_Rx_oRDR_FUSION_DET_005_008_oPCAN_RADAR_28dbd2ca_Rx: ComBitPosition=103, ComBitSize=1, ComSignalType=BOOLEAN, ComSystemTemplateSystemSignalRef=DET_PROB_1STAZHYPO_005_Rx
            DET_PROB_1STAZHYPO_006_Rx_oRDR_FUSION_DET_005_008_oPCAN_RADAR_02676242_Rx: ComBitPosition=215, ComBitSize=1, ComSignalType=BOOLEAN, ComSystemTemplateSystemSignalRef=DET_PROB_1STAZHYPO_006_Rx
            DET_PROB_1STAZHYPO_007_Rx_oRDR_FUSION_DET_005_008_oPCAN_RADAR_ad23f005_Rx: ComBitPosition=327, ComBitSize=1, ComSignalType=BOOLEAN, ComSystemTemplateSystemSignalRef=DET_PROB_1STAZHYPO_007_Rx
            DET_PROB_1STAZHYPO_008_Rx_oRDR_FUSION_DET_005_008_oPCAN_RADAR_2d6d82ad_Rx: ComBitPosition=439, ComBitSize=1, ComSignalType=BOOLEAN, ComSystemTemplateSystemSignalRef=DET_PROB_1STAZHYPO_008_Rx
            DET_RANGE_005_Rx_oRDR_FUSION_DET_005_008_oPCAN_RADAR_73663add_Rx: ComBitPosition=24, ComBitSize=15, ComSignalType=UINT16, ComSystemTemplateSystemSignalRef=DET_RANGE_005_Rx
            DET_RANGE_006_Rx_oRDR_FUSION_DET_005_008_oPCAN_RADAR_59da8a55_Rx: ComBitPosition=136, ComBitSize=15, ComSignalType=UINT16, ComSystemTemplateSystemSignalRef=DET_RANGE_006_Rx
            DET_RANGE_007_Rx_oRDR_FUSION_DET_005_008_oPCAN_RADAR_f69e1812_Rx: ComBitPosition=248, ComBitSize=15, ComSignalType=UINT16, ComSystemTemplateSystemSignalRef=DET_RANGE_007_Rx
            DET_RANGE_008_Rx_oRDR_FUSION_DET_005_008_oPCAN_RADAR_76d06aba_Rx: ComBitPosition=360, ComBitSize=15, ComSignalType=UINT16, ComSystemTemplateSystemSignalRef=DET_RANGE_008_Rx
            DET_RANGE_ERR_005_Rx_oRDR_FUSION_DET_005_008_oPCAN_RADAR_2394b63d_Rx: ComBitPosition=40, ComBitSize=7, ComSignalType=UINT8, ComSystemTemplateSystemSignalRef=DET_RANGE_ERR_005_Rx
            DET_RANGE_ERR_006_Rx_oRDR_FUSION_DET_005_008_oPCAN_RADAR_092806b5_Rx: ComBitPosition=152, ComBitSize=7, ComSignalType=UINT8, ComSystemTemplateSystemSignalRef=DET_RANGE_ERR_006_Rx
            DET_RANGE_ERR_007_Rx_oRDR_FUSION_DET_005_008_oPCAN_RADAR_a66c94f2_Rx: ComBitPosition=264, ComBitSize=7, ComSignalType=UINT8, ComSystemTemplateSystemSignalRef=DET_RANGE_ERR_007_Rx
            DET_RANGE_ERR_008_Rx_oRDR_FUSION_DET_005_008_oPCAN_RADAR_2622e65a_Rx: ComBitPosition=376, ComBitSize=7, ComSignalType=UINT8, ComSystemTemplateSystemSignalRef=DET_RANGE_ERR_008_Rx
            DET_RANGE_VELOCITY_005_Rx_oRDR_FUSION_DET_005_008_oPCAN_RADAR_ae93b923_Rx: ComBitPosition=48, ComBitSize=15, ComSignalType=UINT16, ComSystemTemplateSystemSignalRef=DET_RANGE_VELOCITY_005_Rx
            DET_RANGE_VELOCITY_006_Rx_oRDR_FUSION_DET_005_008_oPCAN_RADAR_842f09ab_Rx: ComBitPosition=160, ComBitSize=15, ComSignalType=UINT16, ComSystemTemplateSystemSignalRef=DET_RANGE_VELOCITY_006_Rx
            DET_RANGE_VELOCITY_007_Rx_oRDR_FUSION_DET_005_008_oPCAN_RADAR_2b6b9bec_Rx: ComBitPosition=272, ComBitSize=15, ComSignalType=UINT16, ComSystemTemplateSystemSignalRef=DET_RANGE_VELOCITY_007_Rx
            DET_RANGE_VELOCITY_008_Rx_oRDR_FUSION_DET_005_008_oPCAN_RADAR_ab25e944_Rx: ComBitPosition=384, ComBitSize=15, ComSignalType=UINT16, ComSystemTemplateSystemSignalRef=DET_RANGE_VELOCITY_008_Rx
            DET_RANGE_VELOCITY_ERR_005_Rx_oRDR_FUSION_DET_005_008_oPCAN_RADAR_37f7c9e1_Rx: ComBitPosition=64, ComBitSize=8, ComSignalType=UINT8, ComSystemTemplateSystemSignalRef=DET_RANGE_VELOCITY_ERR_005_Rx
            DET_RANGE_VELOCITY_ERR_006_Rx_oRDR_FUSION_DET_005_008_oPCAN_RADAR_1d4b7969_Rx: ComBitPosition=176, ComBitSize=8, ComSignalType=UINT8, ComSystemTemplateSystemSignalRef=DET_RANGE_VELOCITY_ERR_006_Rx
            DET_RANGE_VELOCITY_ERR_007_Rx_oRDR_FUSION_DET_005_008_oPCAN_RADAR_b20feb2e_Rx: ComBitPosition=288, ComBitSize=8, ComSignalType=UINT8, ComSystemTemplateSystemSignalRef=DET_RANGE_VELOCITY_ERR_007_Rx
            DET_RANGE_VELOCITY_ERR_008_Rx_oRDR_FUSION_DET_005_008_oPCAN_RADAR_32419986_Rx: ComBitPosition=400, ComBitSize=8, ComSignalType=UINT8, ComSystemTemplateSystemSignalRef=DET_RANGE_VELOCITY_ERR_008_Rx
            DET_RCS_005_Rx_oRDR_FUSION_DET_005_008_oPCAN_RADAR_63582b38_Rx: ComBitPosition=128, ComBitSize=8, ComSignalType=UINT8, ComSystemTemplateSystemSignalRef=DET_RCS_005_Rx
            DET_RCS_006_Rx_oRDR_FUSION_DET_005_008_oPCAN_RADAR_49e49bb0_Rx: ComBitPosition=240, ComBitSize=8, ComSignalType=UINT8, ComSystemTemplateSystemSignalRef=DET_RCS_006_Rx
            DET_RCS_007_Rx_oRDR_FUSION_DET_005_008_oPCAN_RADAR_e6a009f7_Rx: ComBitPosition=352, ComBitSize=8, ComSignalType=UINT8, ComSystemTemplateSystemSignalRef=DET_RCS_007_Rx
            DET_RCS_008_Rx_oRDR_FUSION_DET_005_008_oPCAN_RADAR_66ee7b5f_Rx: ComBitPosition=464, ComBitSize=8, ComSignalType=UINT8, ComSystemTemplateSystemSignalRef=DET_RCS_008_Rx
            DET_SNR_005_Rx_oRDR_FUSION_DET_005_008_oPCAN_RADAR_6a025ad1_Rx: ComBitPosition=120, ComBitSize=8, ComSignalType=UINT8, ComSystemTemplateSystemSignalRef=DET_SNR_005_Rx
            DET_SNR_006_Rx_oRDR_FUSION_DET_005_008_oPCAN_RADAR_40beea59_Rx: ComBitPosition=232, ComBitSize=8, ComSignalType=UINT8, ComSystemTemplateSystemSignalRef=DET_SNR_006_Rx
            DET_SNR_007_Rx_oRDR_FUSION_DET_005_008_oPCAN_RADAR_effa781e_Rx: ComBitPosition=344, ComBitSize=8, ComSignalType=UINT8, ComSystemTemplateSystemSignalRef=DET_SNR_007_Rx
            DET_SNR_008_Rx_oRDR_FUSION_DET_005_008_oPCAN_RADAR_6fb40ab6_Rx: ComBitPosition=456, ComBitSize=8, ComSignalType=UINT8, ComSystemTemplateSystemSignalRef=DET_SNR_008_Rx
            DET_SUPER_RES_TARGET_005_Rx_oRDR_FUSION_DET_005_008_oPCAN_RADAR_a1f97bd1_Rx: ComBitPosition=87, ComBitSize=1, ComSignalType=BOOLEAN, ComSystemTemplateSystemSignalRef=DET_SUPER_RES_TARGET_005_Rx
            DET_SUPER_RES_TARGET_006_Rx_oRDR_FUSION_DET_005_008_oPCAN_RADAR_8b45cb59_Rx: ComBitPosition=199, ComBitSize=1, ComSignalType=BOOLEAN, ComSystemTemplateSystemSignalRef=DET_SUPER_RES_TARGET_006_Rx
            DET_SUPER_RES_TARGET_007_Rx_oRDR_FUSION_DET_005_008_oPCAN_RADAR_2401591e_Rx: ComBitPosition=311, ComBitSize=1, ComSignalType=BOOLEAN, ComSystemTemplateSystemSignalRef=DET_SUPER_RES_TARGET_007_Rx
            DET_SUPER_RES_TARGET_008_Rx_oRDR_FUSION_DET_005_008_oPCAN_RADAR_a44f2bb6_Rx: ComBitPosition=423, ComBitSize=1, ComSignalType=BOOLEAN, ComSystemTemplateSystemSignalRef=DET_SUPER_RES_TARGET_008_Rx
        SG_Fusion_Detections_009_012_oRDR_FUSION_DET_009_012_oPCAN_RADAR_85b0e384_Rx: ComTimeout=0, ComSystemTemplateSignalGroupRef=SG_Fusion_Detections_009_012
          83 x ComGroupSignal, all with ComSignalEndianness=LITTLE_ENDIAN, ComSignalInitValue=0:
            DET_AZIMUTH_009_Rx_oRDR_FUSION_DET_009_012_oPCAN_RADAR_f81a4bdb_Rx: ComBitPosition=88, ComBitSize=13, ComSignalType=UINT16, ComSystemTemplateSystemSignalRef=DET_AZIMUTH_009_Rx
            DET_AZIMUTH_010_Rx_oRDR_FUSION_DET_009_012_oPCAN_RADAR_c53ac8c2_Rx: ComBitPosition=200, ComBitSize=13, ComSignalType=UINT16, ComSystemTemplateSystemSignalRef=DET_AZIMUTH_010_Rx
            DET_AZIMUTH_011_Rx_oRDR_FUSION_DET_009_012_oPCAN_RADAR_6a7e5a85_Rx: ComBitPosition=312, ComBitSize=13, ComSignalType=UINT16, ComSystemTemplateSystemSignalRef=DET_AZIMUTH_011_Rx
            DET_AZIMUTH_012_Rx_oRDR_FUSION_DET_009_012_oPCAN_RADAR_40c2ea0d_Rx: ComBitPosition=424, ComBitSize=13, ComSignalType=UINT16, ComSystemTemplateSystemSignalRef=DET_AZIMUTH_012_Rx
            DET_AZIMUTH_ERR_009_Rx_oRDR_FUSION_DET_009_012_oPCAN_RADAR_fa73ea59_Rx: ComBitPosition=105, ComBitSize=7, ComSignalType=UINT8, ComSystemTemplateSystemSignalRef=DET_AZIMUTH_ERR_009_Rx
            DET_AZIMUTH_ERR_010_Rx_oRDR_FUSION_DET_009_012_oPCAN_RADAR_c7536940_Rx: ComBitPosition=217, ComBitSize=7, ComSignalType=UINT8, ComSystemTemplateSystemSignalRef=DET_AZIMUTH_ERR_010_Rx
            DET_AZIMUTH_ERR_011_Rx_oRDR_FUSION_DET_009_012_oPCAN_RADAR_6817fb07_Rx: ComBitPosition=329, ComBitSize=7, ComSignalType=UINT8, ComSystemTemplateSystemSignalRef=DET_AZIMUTH_ERR_011_Rx
            DET_AZIMUTH_ERR_012_Rx_oRDR_FUSION_DET_009_012_oPCAN_RADAR_42ab4b8f_Rx: ComBitPosition=441, ComBitSize=7, ComSignalType=UINT8, ComSystemTemplateSystemSignalRef=DET_AZIMUTH_ERR_012_Rx
            DET_BELOW_RAIN_THOLD_009_Rx_oRDR_FUSION_DET_009_012_oPCAN_RADAR_9ea0b46e_Rx: ComBitPosition=39, ComBitSize=1, ComSignalType=BOOLEAN, ComSystemTemplateSystemSignalRef=DET_BELOW_RAIN_THOLD_009_Rx
            DET_BELOW_RAIN_THOLD_010_Rx_oRDR_FUSION_DET_009_012_oPCAN_RADAR_a3803777_Rx: ComBitPosition=151, ComBitSize=1, ComSignalType=BOOLEAN, ComSystemTemplateSystemSignalRef=DET_BELOW_RAIN_THOLD_010_Rx
            DET_BELOW_RAIN_THOLD_011_Rx_oRDR_FUSION_DET_009_012_oPCAN_RADAR_0cc4a530_Rx: ComBitPosition=263, ComBitSize=1, ComSignalType=BOOLEAN, ComSystemTemplateSystemSignalRef=DET_BELOW_RAIN_THOLD_011_Rx
            DET_BELOW_RAIN_THOLD_012_Rx_oRDR_FUSION_DET_009_012_oPCAN_RADAR_267815b8_Rx: ComBitPosition=375, ComBitSize=1, ComSignalType=BOOLEAN, ComSystemTemplateSystemSignalRef=DET_BELOW_RAIN_THOLD_012_Rx
            DET_BI_STATIC_FLAG_009_Rx_oRDR_FUSION_DET_009_012_oPCAN_RADAR_e93e1f7d_Rx: ComBitPosition=104, ComBitSize=1, ComSignalType=BOOLEAN, ComSystemTemplateSystemSignalRef=DET_BI_STATIC_FLAG_009_Rx
            DET_BI_STATIC_FLAG_010_Rx_oRDR_FUSION_DET_009_012_oPCAN_RADAR_d41e9c64_Rx: ComBitPosition=216, ComBitSize=1, ComSignalType=BOOLEAN, ComSystemTemplateSystemSignalRef=DET_BI_STATIC_FLAG_010_Rx
            DET_BI_STATIC_FLAG_011_Rx_oRDR_FUSION_DET_009_012_oPCAN_RADAR_7b5a0e23_Rx: ComBitPosition=328, ComBitSize=1, ComSignalType=BOOLEAN, ComSystemTemplateSystemSignalRef=DET_BI_STATIC_FLAG_011_Rx
            DET_BI_STATIC_FLAG_012_Rx_oRDR_FUSION_DET_009_012_oPCAN_RADAR_51e6beab_Rx: ComBitPosition=440, ComBitSize=1, ComSignalType=BOOLEAN, ComSystemTemplateSystemSignalRef=DET_BI_STATIC_FLAG_012_Rx
            DET_CONFD_AZIMUTH_009_Rx_oRDR_FUSION_DET_009_012_oPCAN_RADAR_0a57f529_Rx: ComBitPosition=118, ComBitSize=2, ComSignalType=UINT8, ComSystemTemplateSystemSignalRef=DET_CONFD_AZIMUTH_009_Rx
            DET_CONFD_AZIMUTH_010_Rx_oRDR_FUSION_DET_009_012_oPCAN_RADAR_37777630_Rx: ComBitPosition=230, ComBitSize=2, ComSignalType=UINT8, ComSystemTemplateSystemSignalRef=DET_CONFD_AZIMUTH_010_Rx
            DET_CONFD_AZIMUTH_011_Rx_oRDR_FUSION_DET_009_012_oPCAN_RADAR_9833e477_Rx: ComBitPosition=342, ComBitSize=2, ComSignalType=UINT8, ComSystemTemplateSystemSignalRef=DET_CONFD_AZIMUTH_011_Rx
            DET_CONFD_AZIMUTH_012_Rx_oRDR_FUSION_DET_009_012_oPCAN_RADAR_b28f54ff_Rx: ComBitPosition=454, ComBitSize=2, ComSignalType=UINT8, ComSystemTemplateSystemSignalRef=DET_CONFD_AZIMUTH_012_Rx
            DET_CONFD_ELEVATION_009_Rx_oRDR_FUSION_DET_009_012_oPCAN_RADAR_007676ae_Rx: ComBitPosition=101, ComBitSize=2, ComSignalType=UINT8, ComSystemTemplateSystemSignalRef=DET_CONFD_ELEVATION_009_Rx
            DET_CONFD_ELEVATION_010_Rx_oRDR_FUSION_DET_009_012_oPCAN_RADAR_3d56f5b7_Rx: ComBitPosition=213, ComBitSize=2, ComSignalType=UINT8, ComSystemTemplateSystemSignalRef=DET_CONFD_ELEVATION_010_Rx
            DET_CONFD_ELEVATION_011_Rx_oRDR_FUSION_DET_009_012_oPCAN_RADAR_921267f0_Rx: ComBitPosition=325, ComBitSize=2, ComSignalType=UINT8, ComSystemTemplateSystemSignalRef=DET_CONFD_ELEVATION_011_Rx
            DET_CONFD_ELEVATION_012_Rx_oRDR_FUSION_DET_009_012_oPCAN_RADAR_b8aed778_Rx: ComBitPosition=437, ComBitSize=2, ComSignalType=UINT8, ComSystemTemplateSystemSignalRef=DET_CONFD_ELEVATION_012_Rx
            DET_ELEVATION_009_Rx_oRDR_FUSION_DET_009_012_oPCAN_RADAR_0a259957_Rx: ComBitPosition=72, ComBitSize=8, ComSignalType=UINT8, ComSystemTemplateSystemSignalRef=DET_ELEVATION_009_Rx
            DET_ELEVATION_010_Rx_oRDR_FUSION_DET_009_012_oPCAN_RADAR_37051a4e_Rx: ComBitPosition=184, ComBitSize=8, ComSignalType=UINT8, ComSystemTemplateSystemSignalRef=DET_ELEVATION_010_Rx
            DET_ELEVATION_011_Rx_oRDR_FUSION_DET_009_012_oPCAN_RADAR_98418809_Rx: ComBitPosition=296, ComBitSize=8, ComSignalType=UINT8, ComSystemTemplateSystemSignalRef=DET_ELEVATION_011_Rx
            DET_ELEVATION_012_Rx_oRDR_FUSION_DET_009_012_oPCAN_RADAR_b2fd3881_Rx: ComBitPosition=408, ComBitSize=8, ComSignalType=UINT8, ComSystemTemplateSystemSignalRef=DET_ELEVATION_012_Rx
            DET_ELEVATION_ERR_009_Rx_oRDR_FUSION_DET_009_012_oPCAN_RADAR_d89cbb88_Rx: ComBitPosition=80, ComBitSize=6, ComSignalType=UINT8, ComSystemTemplateSystemSignalRef=DET_ELEVATION_ERR_009_Rx
            DET_ELEVATION_ERR_010_Rx_oRDR_FUSION_DET_009_012_oPCAN_RADAR_e5bc3891_Rx: ComBitPosition=192, ComBitSize=6, ComSignalType=UINT8, ComSystemTemplateSystemSignalRef=DET_ELEVATION_ERR_010_Rx
            DET_ELEVATION_ERR_011_Rx_oRDR_FUSION_DET_009_012_oPCAN_RADAR_4af8aad6_Rx: ComBitPosition=304, ComBitSize=6, ComSignalType=UINT8, ComSystemTemplateSystemSignalRef=DET_ELEVATION_ERR_011_Rx
            DET_ELEVATION_ERR_012_Rx_oRDR_FUSION_DET_009_012_oPCAN_RADAR_60441a5e_Rx: ComBitPosition=416, ComBitSize=6, ComSignalType=UINT8, ComSystemTemplateSystemSignalRef=DET_ELEVATION_ERR_012_Rx
            DET_EXISTENCE_PROB_009_Rx_oRDR_FUSION_DET_009_012_oPCAN_RADAR_2f84c31d_Rx: ComBitPosition=112, ComBitSize=6, ComSignalType=UINT8, ComSystemTemplateSystemSignalRef=DET_EXISTENCE_PROB_009_Rx
            DET_EXISTENCE_PROB_010_Rx_oRDR_FUSION_DET_009_012_oPCAN_RADAR_12a44004_Rx: ComBitPosition=224, ComBitSize=6, ComSignalType=UINT8, ComSystemTemplateSystemSignalRef=DET_EXISTENCE_PROB_010_Rx
            DET_EXISTENCE_PROB_011_Rx_oRDR_FUSION_DET_009_012_oPCAN_RADAR_bde0d243_Rx: ComBitPosition=336, ComBitSize=6, ComSignalType=UINT8, ComSystemTemplateSystemSignalRef=DET_EXISTENCE_PROB_011_Rx
            DET_EXISTENCE_PROB_012_Rx_oRDR_FUSION_DET_009_012_oPCAN_RADAR_975c62cb_Rx: ComBitPosition=448, ComBitSize=6, ComSignalType=UINT8, ComSystemTemplateSystemSignalRef=DET_EXISTENCE_PROB_012_Rx
            DET_HVC_FLAG_009_Rx_oRDR_FUSION_DET_009_012_oPCAN_RADAR_f25a2e52_Rx: ComBitPosition=86, ComBitSize=1, ComSignalType=BOOLEAN, ComSystemTemplateSystemSignalRef=DET_HVC_FLAG_009_Rx
            DET_HVC_FLAG_010_Rx_oRDR_FUSION_DET_009_012_oPCAN_RADAR_cf7aad4b_Rx: ComBitPosition=198, ComBitSize=1, ComSignalType=BOOLEAN, ComSystemTemplateSystemSignalRef=DET_HVC_FLAG_010_Rx
            DET_HVC_FLAG_011_Rx_oRDR_FUSION_DET_009_012_oPCAN_RADAR_603e3f0c_Rx: ComBitPosition=310, ComBitSize=1, ComSignalType=BOOLEAN, ComSystemTemplateSystemSignalRef=DET_HVC_FLAG_011_Rx
            DET_HVC_FLAG_012_Rx_oRDR_FUSION_DET_009_012_oPCAN_RADAR_4a828f84_Rx: ComBitPosition=422, ComBitSize=1, ComSignalType=BOOLEAN, ComSystemTemplateSystemSignalRef=DET_HVC_FLAG_012_Rx
            DET_IDM_009_Rx_oRDR_FUSION_DET_009_012_oPCAN_RADAR_c79bd71a_Rx: ComBitPosition=63, ComBitSize=1, ComSignalType=BOOLEAN, ComSystemTemplateSystemSignalRef=DET_IDM_009_Rx
            DET_IDM_010_Rx_oRDR_FUSION_DET_009_012_oPCAN_RADAR_fabb5403_Rx: ComBitPosition=175, ComBitSize=1, ComSignalType=BOOLEAN, ComSystemTemplateSystemSignalRef=DET_IDM_010_Rx
            DET_IDM_011_Rx_oRDR_FUSION_DET_009_012_oPCAN_RADAR_55ffc644_Rx: ComBitPosition=287, ComBitSize=1, ComSignalType=BOOLEAN, ComSystemTemplateSystemSignalRef=DET_IDM_011_Rx
            DET_IDM_012_Rx_oRDR_FUSION_DET_009_012_oPCAN_RADAR_7f4376cc_Rx: ComBitPosition=399, ComBitSize=1, ComSignalType=BOOLEAN, ComSystemTemplateSystemSignalRef=DET_IDM_012_Rx
            DET_MH_CRC16_009_012_Rx_oRDR_FUSION_DET_009_012_oPCAN_RADAR_93549254_Rx: ComBitPosition=0, ComBitSize=16, ComSignalType=UINT16, ComSystemTemplateSystemSignalRef=DET_MH_CRC16_009_012_Rx
            DET_MH_CYCLE_COUNTER_009_012_Rx_oRDR_FUSION_DET_009_012_oPCAN_RADAR_9e8faf91_Rx: ComBitPosition=16, ComBitSize=8, ComSignalType=UINT8, ComSystemTemplateSystemSignalRef=DET_MH_CYCLE_COUNTER_009_012_Rx
            DET_MH_SCAN_INDEX_4LSB_009_012_Rx_oRDR_FUSION_DET_009_012_oPCAN_RADAR_fa3f60aa_Rx: ComBitPosition=476, ComBitSize=4, ComSignalType=UINT8, ComSystemTemplateSystemSignalRef=DET_MH_SCAN_INDEX_4LSB_009_012_Rx
            DET_MTD_009_Rx_oRDR_FUSION_DET_009_012_oPCAN_RADAR_7a18e16a_Rx: ComBitPosition=47, ComBitSize=1, ComSignalType=BOOLEAN, ComSystemTemplateSystemSignalRef=DET_MTD_009_Rx
            DET_MTD_010_Rx_oRDR_FUSION_DET_009_012_oPCAN_RADAR_47386273_Rx: ComBitPosition=159, ComBitSize=1, ComSignalType=BOOLEAN, ComSystemTemplateSystemSignalRef=DET_MTD_010_Rx
            DET_MTD_011_Rx_oRDR_FUSION_DET_009_012_oPCAN_RADAR_e87cf034_Rx: ComBitPosition=271, ComBitSize=1, ComSignalType=BOOLEAN, ComSystemTemplateSystemSignalRef=DET_MTD_011_Rx
            DET_MTD_012_Rx_oRDR_FUSION_DET_009_012_oPCAN_RADAR_c2c040bc_Rx: ComBitPosition=383, ComBitSize=1, ComSignalType=BOOLEAN, ComSystemTemplateSystemSignalRef=DET_MTD_012_Rx
            DET_PROB_1STAZHYPO_009_Rx_oRDR_FUSION_DET_009_012_oPCAN_RADAR_b061ffeb_Rx: ComBitPosition=103, ComBitSize=1, ComSignalType=BOOLEAN, ComSystemTemplateSystemSignalRef=DET_PROB_1STAZHYPO_009_Rx
            DET_PROB_1STAZHYPO_010_Rx_oRDR_FUSION_DET_009_012_oPCAN_RADAR_8d417cf2_Rx: ComBitPosition=215, ComBitSize=1, ComSignalType=BOOLEAN, ComSystemTemplateSystemSignalRef=DET_PROB_1STAZHYPO_010_Rx
            DET_PROB_1STAZHYPO_011_Rx_oRDR_FUSION_DET_009_012_oPCAN_RADAR_2205eeb5_Rx: ComBitPosition=327, ComBitSize=1, ComSignalType=BOOLEAN, ComSystemTemplateSystemSignalRef=DET_PROB_1STAZHYPO_011_Rx
            DET_PROB_1STAZHYPO_012_Rx_oRDR_FUSION_DET_009_012_oPCAN_RADAR_08b95e3d_Rx: ComBitPosition=439, ComBitSize=1, ComSignalType=BOOLEAN, ComSystemTemplateSystemSignalRef=DET_PROB_1STAZHYPO_012_Rx
            DET_RANGE_009_Rx_oRDR_FUSION_DET_009_012_oPCAN_RADAR_ebdc17fc_Rx: ComBitPosition=24, ComBitSize=15, ComSignalType=UINT16, ComSystemTemplateSystemSignalRef=DET_RANGE_009_Rx
            DET_RANGE_010_Rx_oRDR_FUSION_DET_009_012_oPCAN_RADAR_d6fc94e5_Rx: ComBitPosition=136, ComBitSize=15, ComSignalType=UINT16, ComSystemTemplateSystemSignalRef=DET_RANGE_010_Rx
            DET_RANGE_011_Rx_oRDR_FUSION_DET_009_012_oPCAN_RADAR_79b806a2_Rx: ComBitPosition=248, ComBitSize=15, ComSignalType=UINT16, ComSystemTemplateSystemSignalRef=DET_RANGE_011_Rx
            DET_RANGE_012_Rx_oRDR_FUSION_DET_009_012_oPCAN_RADAR_5304b62a_Rx: ComBitPosition=360, ComBitSize=15, ComSignalType=UINT16, ComSystemTemplateSystemSignalRef=DET_RANGE_012_Rx
            DET_RANGE_ERR_009_Rx_oRDR_FUSION_DET_009_012_oPCAN_RADAR_bb2e9b1c_Rx: ComBitPosition=40, ComBitSize=7, ComSignalType=UINT8, ComSystemTemplateSystemSignalRef=DET_RANGE_ERR_009_Rx
            DET_RANGE_ERR_010_Rx_oRDR_FUSION_DET_009_012_oPCAN_RADAR_860e1805_Rx: ComBitPosition=152, ComBitSize=7, ComSignalType=UINT8, ComSystemTemplateSystemSignalRef=DET_RANGE_ERR_010_Rx
            DET_RANGE_ERR_011_Rx_oRDR_FUSION_DET_009_012_oPCAN_RADAR_294a8a42_Rx: ComBitPosition=264, ComBitSize=7, ComSignalType=UINT8, ComSystemTemplateSystemSignalRef=DET_RANGE_ERR_011_Rx
            DET_RANGE_ERR_012_Rx_oRDR_FUSION_DET_009_012_oPCAN_RADAR_03f63aca_Rx: ComBitPosition=376, ComBitSize=7, ComSignalType=UINT8, ComSystemTemplateSystemSignalRef=DET_RANGE_ERR_012_Rx
            DET_RANGE_VELOCITY_009_Rx_oRDR_FUSION_DET_009_012_oPCAN_RADAR_36299402_Rx: ComBitPosition=48, ComBitSize=15, ComSignalType=UINT16, ComSystemTemplateSystemSignalRef=DET_RANGE_VELOCITY_009_Rx
            DET_RANGE_VELOCITY_010_Rx_oRDR_FUSION_DET_009_012_oPCAN_RADAR_0b09171b_Rx: ComBitPosition=160, ComBitSize=15, ComSignalType=UINT16, ComSystemTemplateSystemSignalRef=DET_RANGE_VELOCITY_010_Rx
            DET_RANGE_VELOCITY_011_Rx_oRDR_FUSION_DET_009_012_oPCAN_RADAR_a44d855c_Rx: ComBitPosition=272, ComBitSize=15, ComSignalType=UINT16, ComSystemTemplateSystemSignalRef=DET_RANGE_VELOCITY_011_Rx
            DET_RANGE_VELOCITY_012_Rx_oRDR_FUSION_DET_009_012_oPCAN_RADAR_8ef135d4_Rx: ComBitPosition=384, ComBitSize=15, ComSignalType=UINT16, ComSystemTemplateSystemSignalRef=DET_RANGE_VELOCITY_012_Rx
            DET_RANGE_VELOCITY_ERR_009_Rx_oRDR_FUSION_DET_009_012_oPCAN_RADAR_af4de4c0_Rx: ComBitPosition=64, ComBitSize=8, ComSignalType=UINT8, ComSystemTemplateSystemSignalRef=DET_RANGE_VELOCITY_ERR_009_Rx
            DET_RANGE_VELOCITY_ERR_010_Rx_oRDR_FUSION_DET_009_012_oPCAN_RADAR_926d67d9_Rx: ComBitPosition=176, ComBitSize=8, ComSignalType=UINT8, ComSystemTemplateSystemSignalRef=DET_RANGE_VELOCITY_ERR_010_Rx
            DET_RANGE_VELOCITY_ERR_011_Rx_oRDR_FUSION_DET_009_012_oPCAN_RADAR_3d29f59e_Rx: ComBitPosition=288, ComBitSize=8, ComSignalType=UINT8, ComSystemTemplateSystemSignalRef=DET_RANGE_VELOCITY_ERR_011_Rx
            DET_RANGE_VELOCITY_ERR_012_Rx_oRDR_FUSION_DET_009_012_oPCAN_RADAR_17954516_Rx: ComBitPosition=400, ComBitSize=8, ComSignalType=UINT8, ComSystemTemplateSystemSignalRef=DET_RANGE_VELOCITY_ERR_012_Rx
            DET_RCS_009_Rx_oRDR_FUSION_DET_009_012_oPCAN_RADAR_fbe20619_Rx: ComBitPosition=128, ComBitSize=8, ComSignalType=UINT8, ComSystemTemplateSystemSignalRef=DET_RCS_009_Rx
            DET_RCS_010_Rx_oRDR_FUSION_DET_009_012_oPCAN_RADAR_c6c28500_Rx: ComBitPosition=240, ComBitSize=8, ComSignalType=UINT8, ComSystemTemplateSystemSignalRef=DET_RCS_010_Rx
            DET_RCS_011_Rx_oRDR_FUSION_DET_009_012_oPCAN_RADAR_69861747_Rx: ComBitPosition=352, ComBitSize=8, ComSignalType=UINT8, ComSystemTemplateSystemSignalRef=DET_RCS_011_Rx
            DET_RCS_012_Rx_oRDR_FUSION_DET_009_012_oPCAN_RADAR_433aa7cf_Rx: ComBitPosition=464, ComBitSize=8, ComSignalType=UINT8, ComSystemTemplateSystemSignalRef=DET_RCS_012_Rx
            DET_SNR_009_Rx_oRDR_FUSION_DET_009_012_oPCAN_RADAR_f2b877f0_Rx: ComBitPosition=120, ComBitSize=8, ComSignalType=UINT8, ComSystemTemplateSystemSignalRef=DET_SNR_009_Rx
            DET_SNR_010_Rx_oRDR_FUSION_DET_009_012_oPCAN_RADAR_cf98f4e9_Rx: ComBitPosition=232, ComBitSize=8, ComSignalType=UINT8, ComSystemTemplateSystemSignalRef=DET_SNR_010_Rx
            DET_SNR_011_Rx_oRDR_FUSION_DET_009_012_oPCAN_RADAR_60dc66ae_Rx: ComBitPosition=344, ComBitSize=8, ComSignalType=UINT8, ComSystemTemplateSystemSignalRef=DET_SNR_011_Rx
            DET_SNR_012_Rx_oRDR_FUSION_DET_009_012_oPCAN_RADAR_4a60d626_Rx: ComBitPosition=456, ComBitSize=8, ComSignalType=UINT8, ComSystemTemplateSystemSignalRef=DET_SNR_012_Rx
            DET_SUPER_RES_TARGET_009_Rx_oRDR_FUSION_DET_009_012_oPCAN_RADAR_394356f0_Rx: ComBitPosition=87, ComBitSize=1, ComSignalType=BOOLEAN, ComSystemTemplateSystemSignalRef=DET_SUPER_RES_TARGET_009_Rx
            DET_SUPER_RES_TARGET_010_Rx_oRDR_FUSION_DET_009_012_oPCAN_RADAR_0463d5e9_Rx: ComBitPosition=199, ComBitSize=1, ComSignalType=BOOLEAN, ComSystemTemplateSystemSignalRef=DET_SUPER_RES_TARGET_010_Rx
            DET_SUPER_RES_TARGET_011_Rx_oRDR_FUSION_DET_009_012_oPCAN_RADAR_ab2747ae_Rx: ComBitPosition=311, ComBitSize=1, ComSignalType=BOOLEAN, ComSystemTemplateSystemSignalRef=DET_SUPER_RES_TARGET_011_Rx
            DET_SUPER_RES_TARGET_012_Rx_oRDR_FUSION_DET_009_012_oPCAN_RADAR_819bf726_Rx: ComBitPosition=423, ComBitSize=1, ComSignalType=BOOLEAN, ComSystemTemplateSystemSignalRef=DET_SUPER_RES_TARGET_012_Rx
