[part 22 of 24: package /InitialEcuC]
AUTOSAR XML (schema 00053)
package /InitialEcuC  (continued)
  module config Dcm
    DcmConfigSet  # Diagnostics Data Import
      DcmDsl
        DcmDslProtocol
          DcmDslProtocolRow_29812fbf (DcmDslProtocolRow)
            96 x DcmDslConnection:
              DC_0xF0BB_oRDR01_oPCAN_RADAR_FD_a6693fcc: variation-point=post-build-variant-condition{matching-criterion=RDR_POS, value=0}
                DC_0xF0BB_oRDR01_oPCAN_RADAR_FD_a6693fcc (DcmDslMainConnection): DcmDslProtocolRxTesterSourceAddr=240
                  PCAN_DIAG_REQ_FUNC_OBD1_oPCAN_RADAR_5664bded_Rx_f8c6c8a4 (DcmDslProtocolRx):
                    DcmDslProtocolRxAddrType = DCM_FUNCTIONAL_TYPE
                    DcmDslProtocolRxPduId = 1
                    DcmDslProtocolRxComMChannelRef = ComMConfigSet/CN_PCAN_RADAR_458ff0f1
                    DcmDslProtocolRxPduRef = PCAN_DIAG_REQ_FUNC_OBD1_oPCAN_RADAR_5664bded_Rx
                  PCAN_DIAG_REQ_PHYS_OBD1_oPCAN_RADAR_caf5eb16_Rx_95487f2b (DcmDslProtocolRx):
                    DcmDslProtocolRxAddrType = DCM_PHYSICAL_TYPE
                    DcmDslProtocolRxPduId = 2
                    DcmDslProtocolRxComMChannelRef = ComMConfigSet/CN_PCAN_RADAR_458ff0f1
                    DcmDslProtocolRxPduRef = PCAN_DIAG_REQ_PHYS_OBD1_oPCAN_RADAR_caf5eb16_Rx
                  PCAN_DIAG_RESP_PHYS_OBD1_oPCAN_RADAR_62c2ee1d_Tx_71c025ae (DcmDslProtocolTx): DcmDslTxConfirmationPduId=0, DcmDslProtocolTxPduRef=EcucPduCollection/PCAN_DIAG_RESP_PHYS_OBD1_oPCAN_RADAR_62c2ee1d_Tx
              DC_0xF0BB_oRDR01_oPCAN_RADAR_dbe9906c: variation-point=post-build-variant-condition{matching-criterion=RDR_POS, value=0}
                DC_0xF0BB_oRDR01_oPCAN_RADAR_dbe9906c (DcmDslMainConnection): DcmDslProtocolRxTesterSourceAddr=240
                  PCAN_DIAG_REQ_FUNC_OBD1_oPCAN_RADAR_20_e986e253_Rx_5365c009 (DcmDslProtocolRx):
                    DcmDslProtocolRxAddrType = DCM_FUNCTIONAL_TYPE
                    DcmDslProtocolRxPduId = 4
                    DcmDslProtocolRxComMChannelRef = ComMConfigSet/CN_PCAN_RADAR_458ff0f1
                    DcmDslProtocolRxPduRef = PCAN_DIAG_REQ_FUNC_OBD1_oPCAN_RADAR_20_e986e253_Rx
                  PCAN_DIAG_REQ_PHYS_OBD1_oPCAN_RADAR_20_3bfe27fe_Rx_2d01fee8 (DcmDslProtocolRx):
                    DcmDslProtocolRxAddrType = DCM_PHYSICAL_TYPE
                    DcmDslProtocolRxPduId = 5
                    DcmDslProtocolRxComMChannelRef = ComMConfigSet/CN_PCAN_RADAR_458ff0f1
                    DcmDslProtocolRxPduRef = PCAN_DIAG_REQ_PHYS_OBD1_oPCAN_RADAR_20_3bfe27fe_Rx
                  PCAN_DIAG_RESP_PHYS_OBD1_oPCAN_RADAR_20_f26199fd_Tx_55fbdb8d (DcmDslProtocolTx): DcmDslTxConfirmationPduId=3, DcmDslProtocolTxPduRef=EcucPduCollection/PCAN_DIAG_RESP_PHYS_OBD1_oPCAN_RADAR_20_f26199fd_Tx
              DC_0xF0D0_oRDR01_oVCAN_RADAR_25c6c859: variation-point=post-build-variant-condition{matching-criterion=RDR_POS, value=0}
                DC_0xF0D0_oRDR01_oVCAN_RADAR_25c6c859 (DcmDslMainConnection): DcmDslProtocolRxTesterSourceAddr=240
                  DIAG_REQ_FNC_OBD1_oVCAN_RADAR_ea4d23fb_Rx_4734fad9 (DcmDslProtocolRx):
                    DcmDslProtocolRxAddrType = DCM_FUNCTIONAL_TYPE
                    DcmDslProtocolRxPduId = 7
                    DcmDslProtocolRxComMChannelRef = ComMConfigSet/CN_VCAN_RADAR_489180b6
                    DcmDslProtocolRxPduRef = DIAG_REQ_FNC_OBD1_oVCAN_RADAR_ea4d23fb_Rx
                  FR_DIAG_REQ_PHY_OBD1_oVCAN_RADAR_83827d3f_Rx_a310dd11 (DcmDslProtocolRx):
                    DcmDslProtocolRxAddrType = DCM_PHYSICAL_TYPE
                    DcmDslProtocolRxPduId = 8
                    DcmDslProtocolRxComMChannelRef = ComMConfigSet/CN_VCAN_RADAR_489180b6
                    DcmDslProtocolRxPduRef = FR_DIAG_REQ_PHY_OBD1_oVCAN_RADAR_83827d3f_Rx
                  FR_DIAG_RES_PHY_OBD1_oVCAN_RADAR_add2b4bf_Tx_08033c95 (DcmDslProtocolTx): DcmDslTxConfirmationPduId=6, DcmDslProtocolTxPduRef=EcucPduCollection/FR_DIAG_RES_PHY_OBD1_oVCAN_RADAR_add2b4bf_Tx
              DC_0xF1BB_oRDR01_oPCAN_RADAR_FD_03e2afc2: variation-point=post-build-variant-condition{matching-criterion=RDR_POS, value=0}
                DC_0xF1BB_oRDR01_oPCAN_RADAR_FD_03e2afc2 (DcmDslMainConnection): DcmDslProtocolRxTesterSourceAddr=241
                  PCAN_DIAG_REQ_FUNC_OBD2_oPCAN_RADAR_ebaed123_Rx_69afd2b8 (DcmDslProtocolRx):
                    DcmDslProtocolRxAddrType = DCM_FUNCTIONAL_TYPE
                    DcmDslProtocolRxPduId = 10
                    DcmDslProtocolRxComMChannelRef = ComMConfigSet/CN_PCAN_RADAR_458ff0f1
                    DcmDslProtocolRxPduRef = PCAN_DIAG_REQ_FUNC_OBD2_oPCAN_RADAR_ebaed123_Rx
                  PCAN_DIAG_REQ_PHYS_OBD2_oPCAN_RADAR_773f87d8_Rx_31c94776 (DcmDslProtocolRx):
                    DcmDslProtocolRxAddrType = DCM_PHYSICAL_TYPE
                    DcmDslProtocolRxPduId = 11
                    DcmDslProtocolRxComMChannelRef = ComMConfigSet/CN_PCAN_RADAR_458ff0f1
                    DcmDslProtocolRxPduRef = PCAN_DIAG_REQ_PHYS_OBD2_oPCAN_RADAR_773f87d8_Rx
                  PCAN_DIAG_RESP_PHYS_OBD2_oPCAN_RADAR_df0882d3_Tx_fbbf77c9 (DcmDslProtocolTx): DcmDslTxConfirmationPduId=9, DcmDslProtocolTxPduRef=EcucPduCollection/PCAN_DIAG_RESP_PHYS_OBD2_oPCAN_RADAR_df0882d3_Tx
              DC_0xF1BB_oRDR01_oPCAN_RADAR_ccc1f4ac: variation-point=post-build-variant-condition{matching-criterion=RDR_POS, value=0}
                DC_0xF1BB_oRDR01_oPCAN_RADAR_ccc1f4ac (DcmDslMainConnection): DcmDslProtocolRxTesterSourceAddr=241
                  PCAN_DIAG_REQ_FUNC_OBD2_oPCAN_RADAR_20_c04e56a1_Rx_a7582bb7 (DcmDslProtocolRx):
                    DcmDslProtocolRxAddrType = DCM_FUNCTIONAL_TYPE
                    DcmDslProtocolRxPduId = 13
                    DcmDslProtocolRxComMChannelRef = ComMConfigSet/CN_PCAN_RADAR_458ff0f1
                    DcmDslProtocolRxPduRef = PCAN_DIAG_REQ_FUNC_OBD2_oPCAN_RADAR_20_c04e56a1_Rx
                  PCAN_DIAG_REQ_PHYS_OBD2_oPCAN_RADAR_20_1236930c_Rx_26654501 (DcmDslProtocolRx):
                    DcmDslProtocolRxAddrType = DCM_PHYSICAL_TYPE
                    DcmDslProtocolRxPduId = 14
                    DcmDslProtocolRxComMChannelRef = ComMConfigSet/CN_PCAN_RADAR_458ff0f1
                    DcmDslProtocolRxPduRef = PCAN_DIAG_REQ_PHYS_OBD2_oPCAN_RADAR_20_1236930c_Rx
                  PCAN_DIAG_RESP_PHYS_OBD2_oPCAN_RADAR_20_dba92d0f_Tx_dcc6691a (DcmDslProtocolTx): DcmDslTxConfirmationPduId=12, DcmDslProtocolTxPduRef=EcucPduCollection/PCAN_DIAG_RESP_PHYS_OBD2_oPCAN_RADAR_20_dba92d0f_Tx
              DC_0xF1D0_oRDR01_oVCAN_RADAR_32eeac99: variation-point=post-build-variant-condition{matching-criterion=RDR_POS, value=0}
                DC_0xF1D0_oRDR01_oVCAN_RADAR_32eeac99 (DcmDslMainConnection): DcmDslProtocolRxTesterSourceAddr=241
                  DIAG_REQ_FNC_OBD2_oVCAN_RADAR_57874f35_Rx_1a4abb4e (DcmDslProtocolRx):
                    DcmDslProtocolRxAddrType = DCM_FUNCTIONAL_TYPE
                    DcmDslProtocolRxPduId = 16
                    DcmDslProtocolRxComMChannelRef = ComMConfigSet/CN_VCAN_RADAR_489180b6
                    DcmDslProtocolRxPduRef = DIAG_REQ_FNC_OBD2_oVCAN_RADAR_57874f35_Rx
                  FR_DIAG_REQ_PHY_OBD2_oVCAN_RADAR_3e4811f1_Rx_ef982e0b (DcmDslProtocolRx):
                    DcmDslProtocolRxAddrType = DCM_PHYSICAL_TYPE
                    DcmDslProtocolRxPduId = 17
                    DcmDslProtocolRxComMChannelRef = ComMConfigSet/CN_VCAN_RADAR_489180b6
                    DcmDslProtocolRxPduRef = FR_DIAG_REQ_PHY_OBD2_oVCAN_RADAR_3e4811f1_Rx
                  FR_DIAG_RES_PHY_OBD2_oVCAN_RADAR_1018d871_Tx_ee91ebc0 (DcmDslProtocolTx): DcmDslTxConfirmationPduId=15, DcmDslProtocolTxPduRef=EcucPduCollection/FR_DIAG_RES_PHY_OBD2_oVCAN_RADAR_1018d871_Tx
              DC_0xF4BB_oRDR01_oPCAN_RADAR_8748036c: variation-point=post-build-variant-condition{matching-criterion=RDR_POS, value=0}
                DC_0xF4BB_oRDR01_oPCAN_RADAR_8748036c (DcmDslMainConnection): DcmDslProtocolRxTesterSourceAddr=244
                  PCAN_DIAG_REQ_FUNC_OTA_oPCAN_RADAR_20_4ceedd9c_Rx_8d5a8781 (DcmDslProtocolRx):
                    DcmDslProtocolRxAddrType = DCM_FUNCTIONAL_TYPE
                    DcmDslProtocolRxPduId = 19
                    DcmDslProtocolRxComMChannelRef = ComMConfigSet/CN_PCAN_RADAR_458ff0f1
                    DcmDslProtocolRxPduRef = PCAN_DIAG_REQ_FUNC_OTA_oPCAN_RADAR_20_4ceedd9c_Rx
                  PCAN_DIAG_REQ_PHYS_OTA_oPCAN_RADAR_20_39ae8dba_Rx_fd38421b (DcmDslProtocolRx):
                    DcmDslProtocolRxAddrType = DCM_PHYSICAL_TYPE
                    DcmDslProtocolRxPduId = 20
                    DcmDslProtocolRxComMChannelRef = ComMConfigSet/CN_PCAN_RADAR_458ff0f1
                    DcmDslProtocolRxPduRef = PCAN_DIAG_REQ_PHYS_OTA_oPCAN_RADAR_20_39ae8dba_Rx
                  PCAN_DIAG_RESP_PHYS_OTA_oPCAN_RADAR_20_aa3008c9_Tx_74022f70 (DcmDslProtocolTx): DcmDslTxConfirmationPduId=18, DcmDslProtocolTxPduRef=EcucPduCollection/PCAN_DIAG_RESP_PHYS_OTA_oPCAN_RADAR_20_aa3008c9_Tx
              DC_0xF4BB_oRDR01_oPCAN_RADAR_FD_5dd47537: variation-point=post-build-variant-condition{matching-criterion=RDR_POS, value=0}
                DC_0xF4BB_oRDR01_oPCAN_RADAR_FD_5dd47537 (DcmDslMainConnection): DcmDslProtocolRxTesterSourceAddr=244
                  PCAN_DIAG_REQ_FUNC_OTA_oPCAN_RADAR_8729c499_Rx_63a44321 (DcmDslProtocolRx):
                    DcmDslProtocolRxAddrType = DCM_FUNCTIONAL_TYPE
                    DcmDslProtocolRxPduId = 22
                    DcmDslProtocolRxComMChannelRef = ComMConfigSet/CN_PCAN_RADAR_458ff0f1
                    DcmDslProtocolRxPduRef = PCAN_DIAG_REQ_FUNC_OTA_oPCAN_RADAR_8729c499_Rx
                  PCAN_DIAG_REQ_PHYS_OTA_oPCAN_RADAR_1f79965d_Rx_897b19f5 (DcmDslProtocolRx):
                    DcmDslProtocolRxAddrType = DCM_PHYSICAL_TYPE
                    DcmDslProtocolRxPduId = 23
                    DcmDslProtocolRxComMChannelRef = ComMConfigSet/CN_PCAN_RADAR_458ff0f1
                    DcmDslProtocolRxPduRef = PCAN_DIAG_REQ_PHYS_OTA_oPCAN_RADAR_1f79965d_Rx
                  PCAN_DIAG_RESP_PHYS_OTA_oPCAN_RADAR_4fa3c8f0_Tx_93c6c140 (DcmDslProtocolTx): DcmDslTxConfirmationPduId=21, DcmDslProtocolTxPduRef=EcucPduCollection/PCAN_DIAG_RESP_PHYS_OTA_oPCAN_RADAR_4fa3c8f0_Tx
              DC_0xF4D0_oRDR01_oVCAN_RADAR_79675b59: variation-point=post-build-variant-condition{matching-criterion=RDR_POS, value=0}
                DC_0xF4D0_oRDR01_oVCAN_RADAR_79675b59 (DcmDslMainConnection): DcmDslProtocolRxTesterSourceAddr=244
                  DIAG_REQ_FNC_OTA_oVCAN_RADAR_b630c1e5_Rx_0176162e (DcmDslProtocolRx):
                    DcmDslProtocolRxAddrType = DCM_FUNCTIONAL_TYPE
                    DcmDslProtocolRxPduId = 25
                    DcmDslProtocolRxComMChannelRef = ComMConfigSet/CN_VCAN_RADAR_489180b6
                    DcmDslProtocolRxPduRef = DIAG_REQ_FNC_OTA_oVCAN_RADAR_b630c1e5_Rx
                  FR_DIAG_REQ_PHY_OTA_oVCAN_RADAR_7facfb76_Rx_b2eaa10c (DcmDslProtocolRx):
                    DcmDslProtocolRxAddrType = DCM_PHYSICAL_TYPE
                    DcmDslProtocolRxPduId = 26
                    DcmDslProtocolRxComMChannelRef = ComMConfigSet/CN_VCAN_RADAR_489180b6
                    DcmDslProtocolRxPduRef = FR_DIAG_REQ_PHY_OTA_oVCAN_RADAR_7facfb76_Rx
                  FR_DIAG_RES_PHY_OTA_oVCAN_RADAR_9b68fa0b_Tx_bc6c5974 (DcmDslProtocolTx): DcmDslTxConfirmationPduId=24, DcmDslProtocolTxPduRef=EcucPduCollection/FR_DIAG_RES_PHY_OTA_oVCAN_RADAR_9b68fa0b_Tx
              DC_0xF5BB_oRDR01_oPCAN_RADAR_906067ac: variation-point=post-build-variant-condition{matching-criterion=RDR_POS, value=0}
                DC_0xF5BB_oRDR01_oPCAN_RADAR_906067ac (DcmDslMainConnection): DcmDslProtocolRxTesterSourceAddr=245
                  PCAN_DIAG_REQ_FUNC_PLANT_oPCAN_RADAR_20_3b79581e_Rx_36801f1b (DcmDslProtocolRx):
                    DcmDslProtocolRxAddrType = DCM_FUNCTIONAL_TYPE
                    DcmDslProtocolRxPduId = 28
                    DcmDslProtocolRxComMChannelRef = ComMConfigSet/CN_PCAN_RADAR_458ff0f1
                    DcmDslProtocolRxPduRef = PCAN_DIAG_REQ_FUNC_PLANT_oPCAN_RADAR_20_3b79581e_Rx
                  PCAN_DIAG_REQ_PHYS_PLANT_oPCAN_RADAR_20_93ccff8e_Rx_c332e01f (DcmDslProtocolRx):
                    DcmDslProtocolRxAddrType = DCM_PHYSICAL_TYPE
                    DcmDslProtocolRxPduId = 29
                    DcmDslProtocolRxComMChannelRef = ComMConfigSet/CN_PCAN_RADAR_458ff0f1
                    DcmDslProtocolRxPduRef = PCAN_DIAG_REQ_PHYS_PLANT_oPCAN_RADAR_20_93ccff8e_Rx
                  PCAN_DIAG_RESP_PHYS_PLANT_oPCAN_RADAR_20_0a0c318a_Tx_b4cb0023 (DcmDslProtocolTx): DcmDslTxConfirmationPduId=27, DcmDslProtocolTxPduRef=EcucPduCollection/PCAN_DIAG_RESP_PHYS_PLANT_oPCAN_RADAR_20_0a0c318a_Tx
              DC_0xF5BB_oRDR01_oPCAN_RADAR_FD_f85fe539: variation-point=post-build-variant-condition{matching-criterion=RDR_POS, value=0}
                DC_0xF5BB_oRDR01_oPCAN_RADAR_FD_f85fe539 (DcmDslMainConnection): DcmDslProtocolRxTesterSourceAddr=245
                  PCAN_DIAG_REQ_FUNC_PLANT_oPCAN_RADAR_8e17ec17_Rx_e2e07788 (DcmDslProtocolRx):
                    DcmDslProtocolRxAddrType = DCM_FUNCTIONAL_TYPE
                    DcmDslProtocolRxPduId = 31
                    DcmDslProtocolRxComMChannelRef = ComMConfigSet/CN_PCAN_RADAR_458ff0f1
                    DcmDslProtocolRxPduRef = PCAN_DIAG_REQ_FUNC_PLANT_oPCAN_RADAR_8e17ec17_Rx
                  PCAN_DIAG_REQ_PHYS_PLANT_oPCAN_RADAR_a4e456d5_Rx_de87c92a (DcmDslProtocolRx):
                    DcmDslProtocolRxAddrType = DCM_PHYSICAL_TYPE
                    DcmDslProtocolRxPduId = 32
                    DcmDslProtocolRxComMChannelRef = ComMConfigSet/CN_PCAN_RADAR_458ff0f1
                    DcmDslProtocolRxPduRef = PCAN_DIAG_REQ_PHYS_PLANT_oPCAN_RADAR_a4e456d5_Rx
                  PCAN_DIAG_RESP_PHYS_PLANT_oPCAN_RADAR_339eb858_Tx_b55bc933 (DcmDslProtocolTx): DcmDslTxConfirmationPduId=30, DcmDslProtocolTxPduRef=EcucPduCollection/PCAN_DIAG_RESP_PHYS_PLANT_oPCAN_RADAR_339eb858_Tx
              DC_0xF5D0_oRDR01_oVCAN_RADAR_6e4f3f99: variation-point=post-build-variant-condition{matching-criterion=RDR_POS, value=0}
                DC_0xF5D0_oRDR01_oVCAN_RADAR_6e4f3f99 (DcmDslMainConnection): DcmDslProtocolRxTesterSourceAddr=245
                  DIAG_REQ_FNC_PLANT_oVCAN_RADAR_9fd4cadc_Rx_f47e2bb6 (DcmDslProtocolRx):
                    DcmDslProtocolRxAddrType = DCM_FUNCTIONAL_TYPE
                    DcmDslProtocolRxPduId = 34
                    DcmDslProtocolRxComMChannelRef = ComMConfigSet/CN_VCAN_RADAR_489180b6
                    DcmDslProtocolRxPduRef = DIAG_REQ_FNC_PLANT_oVCAN_RADAR_9fd4cadc_Rx
                  FR_DIAG_REQ_PHY_PLANT_oVCAN_RADAR_03b4032b_Rx_f4f84964 (DcmDslProtocolRx):
                    DcmDslProtocolRxAddrType = DCM_PHYSICAL_TYPE
                    DcmDslProtocolRxPduId = 35
                    DcmDslProtocolRxComMChannelRef = ComMConfigSet/CN_VCAN_RADAR_489180b6
                    DcmDslProtocolRxPduRef = FR_DIAG_REQ_PHY_PLANT_oVCAN_RADAR_03b4032b_Rx
                  FR_DIAG_RES_PHY_PLANT_oVCAN_RADAR_ee22d0c2_Tx_70415e78 (DcmDslProtocolTx): DcmDslTxConfirmationPduId=33, DcmDslProtocolTxPduRef=EcucPduCollection/FR_DIAG_RES_PHY_PLANT_oVCAN_RADAR_ee22d0c2_Tx
              DC_0xF0BB_oRDR02_oPCAN_RADAR_6623fca2: variation-point=post-build-variant-condition{matching-criterion=RDR_POS, value=1}
                DC_0xF0BB_oRDR02_oPCAN_RADAR_6623fca2 (DcmDslMainConnection): DcmDslProtocolRxTesterSourceAddr=240
                  PCAN_DIAG_REQ_FUNC_OBD1_oPCAN_RADAR_20_e986e253_Rx_5365c009 (DcmDslProtocolRx):
                    DcmDslProtocolRxAddrType = DCM_FUNCTIONAL_TYPE
                    DcmDslProtocolRxPduId = 1
                    DcmDslProtocolRxComMChannelRef = ComMConfigSet/CN_PCAN_RADAR_458ff0f1
                    DcmDslProtocolRxPduRef = PCAN_DIAG_REQ_FUNC_OBD1_oPCAN_RADAR_20_e986e253_Rx
                  PCAN_DIAG_REQ_PHYS_OBD1_oPCAN_RADAR_20_3bfe27fe_Rx_2d01fee8 (DcmDslProtocolRx):
                    DcmDslProtocolRxAddrType = DCM_PHYSICAL_TYPE
                    DcmDslProtocolRxPduId = 2
                    DcmDslProtocolRxComMChannelRef = ComMConfigSet/CN_PCAN_RADAR_458ff0f1
                    DcmDslProtocolRxPduRef = PCAN_DIAG_REQ_PHYS_OBD1_oPCAN_RADAR_20_3bfe27fe_Rx
                  PCAN_DIAG_RESP_PHYS_OBD1_oPCAN_RADAR_20_f26199fd_Tx_55fbdb8d (DcmDslProtocolTx): DcmDslTxConfirmationPduId=0, DcmDslProtocolTxPduRef=EcucPduCollection/PCAN_DIAG_RESP_PHYS_OBD1_oPCAN_RADAR_20_f26199fd_Tx
              DC_0xF0BB_oRDR02_oPCAN_RADAR_FD_8fa18b3e: variation-point=post-build-variant-condition{matching-criterion=RDR_POS, value=1}
                DC_0xF0BB_oRDR02_oPCAN_RADAR_FD_8fa18b3e (DcmDslMainConnection): DcmDslProtocolRxTesterSourceAddr=240
                  PCAN_DIAG_REQ_FUNC_OBD1_oPCAN_RADAR_5664bded_Rx_f8c6c8a4 (DcmDslProtocolRx):
                    DcmDslProtocolRxAddrType = DCM_FUNCTIONAL_TYPE
                    DcmDslProtocolRxPduId = 4
                    DcmDslProtocolRxComMChannelRef = ComMConfigSet/CN_PCAN_RADAR_458ff0f1
                    DcmDslProtocolRxPduRef = PCAN_DIAG_REQ_FUNC_OBD1_oPCAN_RADAR_5664bded_Rx
                  PCAN_DIAG_REQ_PHYS_OBD1_oPCAN_RADAR_caf5eb16_Rx_95487f2b (DcmDslProtocolRx):
                    DcmDslProtocolRxAddrType = DCM_PHYSICAL_TYPE
                    DcmDslProtocolRxPduId = 5
                    DcmDslProtocolRxComMChannelRef = ComMConfigSet/CN_PCAN_RADAR_458ff0f1
                    DcmDslProtocolRxPduRef = PCAN_DIAG_REQ_PHYS_OBD1_oPCAN_RADAR_caf5eb16_Rx
                  PCAN_DIAG_RESP_PHYS_OBD1_oPCAN_RADAR_62c2ee1d_Tx_71c025ae (DcmDslProtocolTx): DcmDslTxConfirmationPduId=3, DcmDslProtocolTxPduRef=EcucPduCollection/PCAN_DIAG_RESP_PHYS_OBD1_oPCAN_RADAR_62c2ee1d_Tx
              DC_0xF0D0_oRDR02_oVCAN_RADAR_980ca497: variation-point=post-build-variant-condition{matching-criterion=RDR_POS, value=1}
                DC_0xF0D0_oRDR02_oVCAN_RADAR_980ca497 (DcmDslMainConnection): DcmDslProtocolRxTesterSourceAddr=240
                  DIAG_REQ_FNC_OBD1_oVCAN_RADAR_ea4d23fb_Rx_4734fad9 (DcmDslProtocolRx):
                    DcmDslProtocolRxAddrType = DCM_FUNCTIONAL_TYPE
                    DcmDslProtocolRxPduId = 7
                    DcmDslProtocolRxComMChannelRef = ComMConfigSet/CN_VCAN_RADAR_489180b6
                    DcmDslProtocolRxPduRef = DIAG_REQ_FNC_OBD1_oVCAN_RADAR_ea4d23fb_Rx
                  FR_DIAG_REQ_PHY_OBD1_oVCAN_RADAR_83827d3f_Rx_a310dd11 (DcmDslProtocolRx):
                    DcmDslProtocolRxAddrType = DCM_PHYSICAL_TYPE
                    DcmDslProtocolRxPduId = 8
                    DcmDslProtocolRxComMChannelRef = ComMConfigSet/CN_VCAN_RADAR_489180b6
                    DcmDslProtocolRxPduRef = FR_DIAG_REQ_PHY_OBD1_oVCAN_RADAR_83827d3f_Rx
                  FR_DIAG_RES_PHY_OBD1_oVCAN_RADAR_add2b4bf_Tx_08033c95 (DcmDslProtocolTx): DcmDslTxConfirmationPduId=6, DcmDslProtocolTxPduRef=EcucPduCollection/FR_DIAG_RES_PHY_OBD1_oVCAN_RADAR_add2b4bf_Tx
              DC_0xF1BB_oRDR02_oPCAN_RADAR_710b9862: variation-point=post-build-variant-condition{matching-criterion=RDR_POS, value=1}
                DC_0xF1BB_oRDR02_oPCAN_RADAR_710b9862 (DcmDslMainConnection): DcmDslProtocolRxTesterSourceAddr=241
                  PCAN_DIAG_REQ_FUNC_OBD2_oPCAN_RADAR_20_c04e56a1_Rx_a7582bb7 (DcmDslProtocolRx):
                    DcmDslProtocolRxAddrType = DCM_FUNCTIONAL_TYPE
                    DcmDslProtocolRxPduId = 10
                    DcmDslProtocolRxComMChannelRef = ComMConfigSet/CN_PCAN_RADAR_458ff0f1
                    DcmDslProtocolRxPduRef = PCAN_DIAG_REQ_FUNC_OBD2_oPCAN_RADAR_20_c04e56a1_Rx
                  PCAN_DIAG_REQ_PHYS_OBD2_oPCAN_RADAR_20_1236930c_Rx_26654501 (DcmDslProtocolRx):
                    DcmDslProtocolRxAddrType = DCM_PHYSICAL_TYPE
                    DcmDslProtocolRxPduId = 11
                    DcmDslProtocolRxComMChannelRef = ComMConfigSet/CN_PCAN_RADAR_458ff0f1
                    DcmDslProtocolRxPduRef = PCAN_DIAG_REQ_PHYS_OBD2_oPCAN_RADAR_20_1236930c_Rx
                  PCAN_DIAG_RESP_PHYS_OBD2_oPCAN_RADAR_20_dba92d0f_Tx_dcc6691a (DcmDslProtocolTx): DcmDslTxConfirmationPduId=9, DcmDslProtocolTxPduRef=EcucPduCollection/PCAN_DIAG_RESP_PHYS_OBD2_oPCAN_RADAR_20_dba92d0f_Tx
              DC_0xF1BB_oRDR02_oPCAN_RADAR_FD_2a2a1b30: variation-point=post-build-variant-condition{matching-criterion=RDR_POS, value=1}
                DC_0xF1BB_oRDR02_oPCAN_RADAR_FD_2a2a1b30 (DcmDslMainConnection): DcmDslProtocolRxTesterSourceAddr=241
                  PCAN_DIAG_REQ_FUNC_OBD2_oPCAN_RADAR_ebaed123_Rx_69afd2b8 (DcmDslProtocolRx):
                    DcmDslProtocolRxAddrType = DCM_FUNCTIONAL_TYPE
                    DcmDslProtocolRxPduId = 13
                    DcmDslProtocolRxComMChannelRef = ComMConfigSet/CN_PCAN_RADAR_458ff0f1
                    DcmDslProtocolRxPduRef = PCAN_DIAG_REQ_FUNC_OBD2_oPCAN_RADAR_ebaed123_Rx
                  PCAN_DIAG_REQ_PHYS_OBD2_oPCAN_RADAR_773f87d8_Rx_31c94776 (DcmDslProtocolRx):
                    DcmDslProtocolRxAddrType = DCM_PHYSICAL_TYPE
                    DcmDslProtocolRxPduId = 14
                    DcmDslProtocolRxComMChannelRef = ComMConfigSet/CN_PCAN_RADAR_458ff0f1
                    DcmDslProtocolRxPduRef = PCAN_DIAG_REQ_PHYS_OBD2_oPCAN_RADAR_773f87d8_Rx
                  PCAN_DIAG_RESP_PHYS_OBD2_oPCAN_RADAR_df0882d3_Tx_fbbf77c9 (DcmDslProtocolTx): DcmDslTxConfirmationPduId=12, DcmDslProtocolTxPduRef=EcucPduCollection/PCAN_DIAG_RESP_PHYS_OBD2_oPCAN_RADAR_df0882d3_Tx
              DC_0xF1D0_oRDR02_oVCAN_RADAR_8f24c057: variation-point=post-build-variant-condition{matching-criterion=RDR_POS, value=1}
                DC_0xF1D0_oRDR02_oVCAN_RADAR_8f24c057 (DcmDslMainConnection): DcmDslProtocolRxTesterSourceAddr=241
                  DIAG_REQ_FNC_OBD2_oVCAN_RADAR_57874f35_Rx_1a4abb4e (DcmDslProtocolRx):
                    DcmDslProtocolRxAddrType = DCM_FUNCTIONAL_TYPE
                    DcmDslProtocolRxPduId = 16
                    DcmDslProtocolRxComMChannelRef = ComMConfigSet/CN_VCAN_RADAR_489180b6
                    DcmDslProtocolRxPduRef = DIAG_REQ_FNC_OBD2_oVCAN_RADAR_57874f35_Rx
                  FR_DIAG_REQ_PHY_OBD2_oVCAN_RADAR_3e4811f1_Rx_ef982e0b (DcmDslProtocolRx):
                    DcmDslProtocolRxAddrType = DCM_PHYSICAL_TYPE
                    DcmDslProtocolRxPduId = 17
                    DcmDslProtocolRxComMChannelRef = ComMConfigSet/CN_VCAN_RADAR_489180b6
                    DcmDslProtocolRxPduRef = FR_DIAG_REQ_PHY_OBD2_oVCAN_RADAR_3e4811f1_Rx
                  FR_DIAG_RES_PHY_OBD2_oVCAN_RADAR_1018d871_Tx_ee91ebc0 (DcmDslProtocolTx): DcmDslTxConfirmationPduId=15, DcmDslProtocolTxPduRef=EcucPduCollection/FR_DIAG_RES_PHY_OBD2_oVCAN_RADAR_1018d871_Tx
              DC_0xF4BB_oRDR02_oPCAN_RADAR_3a826fa2: variation-point=post-build-variant-condition{matching-criterion=RDR_POS, value=1}
                DC_0xF4BB_oRDR02_oPCAN_RADAR_3a826fa2 (DcmDslMainConnection): DcmDslProtocolRxTesterSourceAddr=244
                  PCAN_DIAG_REQ_FUNC_OTA_oPCAN_RADAR_20_4ceedd9c_Rx_8d5a8781 (DcmDslProtocolRx):
                    DcmDslProtocolRxAddrType = DCM_FUNCTIONAL_TYPE
                    DcmDslProtocolRxPduId = 19
                    DcmDslProtocolRxComMChannelRef = ComMConfigSet/CN_PCAN_RADAR_458ff0f1
                    DcmDslProtocolRxPduRef = PCAN_DIAG_REQ_FUNC_OTA_oPCAN_RADAR_20_4ceedd9c_Rx
                  PCAN_DIAG_REQ_PHYS_OTA_oPCAN_RADAR_20_39ae8dba_Rx_fd38421b (DcmDslProtocolRx):
                    DcmDslProtocolRxAddrType = DCM_PHYSICAL_TYPE
                    DcmDslProtocolRxPduId = 20
                    DcmDslProtocolRxComMChannelRef = ComMConfigSet/CN_PCAN_RADAR_458ff0f1
                    DcmDslProtocolRxPduRef = PCAN_DIAG_REQ_PHYS_OTA_oPCAN_RADAR_20_39ae8dba_Rx
                  PCAN_DIAG_RESP_PHYS_OTA_oPCAN_RADAR_20_aa3008c9_Tx_74022f70 (DcmDslProtocolTx): DcmDslTxConfirmationPduId=18, DcmDslProtocolTxPduRef=EcucPduCollection/PCAN_DIAG_RESP_PHYS_OTA_oPCAN_RADAR_20_aa3008c9_Tx
              DC_0xF4BB_oRDR02_oPCAN_RADAR_FD_741cc1c5: variation-point=post-build-variant-condition{matching-criterion=RDR_POS, value=1}
                DC_0xF4BB_oRDR02_oPCAN_RADAR_FD_741cc1c5 (DcmDslMainConnection): DcmDslProtocolRxTesterSourceAddr=244
                  PCAN_DIAG_REQ_FUNC_OTA_oPCAN_RADAR_8729c499_Rx_63a44321 (DcmDslProtocolRx):
                    DcmDslProtocolRxAddrType = DCM_FUNCTIONAL_TYPE
                    DcmDslProtocolRxPduId = 22
                    DcmDslProtocolRxComMChannelRef = ComMConfigSet/CN_PCAN_RADAR_458ff0f1
                    DcmDslProtocolRxPduRef = PCAN_DIAG_REQ_FUNC_OTA_oPCAN_RADAR_8729c499_Rx
                  PCAN_DIAG_REQ_PHYS_OTA_oPCAN_RADAR_1f79965d_Rx_897b19f5 (DcmDslProtocolRx):
                    DcmDslProtocolRxAddrType = DCM_PHYSICAL_TYPE
                    DcmDslProtocolRxPduId = 23
                    DcmDslProtocolRxComMChannelRef = ComMConfigSet/CN_PCAN_RADAR_458ff0f1
                    DcmDslProtocolRxPduRef = PCAN_DIAG_REQ_PHYS_OTA_oPCAN_RADAR_1f79965d_Rx
                  PCAN_DIAG_RESP_PHYS_OTA_oPCAN_RADAR_4fa3c8f0_Tx_93c6c140 (DcmDslProtocolTx): DcmDslTxConfirmationPduId=21, DcmDslProtocolTxPduRef=EcucPduCollection/PCAN_DIAG_RESP_PHYS_OTA_oPCAN_RADAR_4fa3c8f0_Tx
              DC_0xF4D0_oRDR02_oVCAN_RADAR_c4ad3797: variation-point=post-build-variant-condition{matching-criterion=RDR_POS, value=1}
                DC_0xF4D0_oRDR02_oVCAN_RADAR_c4ad3797 (DcmDslMainConnection): DcmDslProtocolRxTesterSourceAddr=244
                  DIAG_REQ_FNC_OTA_oVCAN_RADAR_b630c1e5_Rx_0176162e (DcmDslProtocolRx):
                    DcmDslProtocolRxAddrType = DCM_FUNCTIONAL_TYPE
                    DcmDslProtocolRxPduId = 25
                    DcmDslProtocolRxComMChannelRef = ComMConfigSet/CN_VCAN_RADAR_489180b6
                    DcmDslProtocolRxPduRef = DIAG_REQ_FNC_OTA_oVCAN_RADAR_b630c1e5_Rx
                  FR_DIAG_REQ_PHY_OTA_oVCAN_RADAR_7facfb76_Rx_b2eaa10c (DcmDslProtocolRx):
                    DcmDslProtocolRxAddrType = DCM_PHYSICAL_TYPE
                    DcmDslProtocolRxPduId = 26
                    DcmDslProtocolRxComMChannelRef = ComMConfigSet/CN_VCAN_RADAR_489180b6
                    DcmDslProtocolRxPduRef = FR_DIAG_REQ_PHY_OTA_oVCAN_RADAR_7facfb76_Rx
                  FR_DIAG_RES_PHY_OTA_oVCAN_RADAR_9b68fa0b_Tx_bc6c5974 (DcmDslProtocolTx): DcmDslTxConfirmationPduId=24, DcmDslProtocolTxPduRef=EcucPduCollection/FR_DIAG_RES_PHY_OTA_oVCAN_RADAR_9b68fa0b_Tx
              DC_0xF5BB_oRDR02_oPCAN_RADAR_2daa0b62: variation-point=post-build-variant-condition{matching-criterion=RDR_POS, value=1}
                DC_0xF5BB_oRDR02_oPCAN_RADAR_2daa0b62 (DcmDslMainConnection): DcmDslProtocolRxTesterSourceAddr=245
                  PCAN_DIAG_REQ_FUNC_PLANT_oPCAN_RADAR_20_3b79581e_Rx_36801f1b (DcmDslProtocolRx):
                    DcmDslProtocolRxAddrType = DCM_FUNCTIONAL_TYPE
                    DcmDslProtocolRxPduId = 28
                    DcmDslProtocolRxComMChannelRef = ComMConfigSet/CN_PCAN_RADAR_458ff0f1
                    DcmDslProtocolRxPduRef = PCAN_DIAG_REQ_FUNC_PLANT_oPCAN_RADAR_20_3b79581e_Rx
                  PCAN_DIAG_REQ_PHYS_PLANT_oPCAN_RADAR_20_93ccff8e_Rx_c332e01f (DcmDslProtocolRx):
                    DcmDslProtocolRxAddrType = DCM_PHYSICAL_TYPE
                    DcmDslProtocolRxPduId = 29
                    DcmDslProtocolRxComMChannelRef = ComMConfigSet/CN_PCAN_RADAR_458ff0f1
                    DcmDslProtocolRxPduRef = PCAN_DIAG_REQ_PHYS_PLANT_oPCAN_RADAR_20_93ccff8e_Rx
                  PCAN_DIAG_RESP_PHYS_PLANT_oPCAN_RADAR_20_0a0c318a_Tx_b4cb0023 (DcmDslProtocolTx): DcmDslTxConfirmationPduId=27, DcmDslProtocolTxPduRef=EcucPduCollection/PCAN_DIAG_RESP_PHYS_PLANT_oPCAN_RADAR_20_0a0c318a_Tx
              DC_0xF5BB_oRDR02_oPCAN_RADAR_FD_d19751cb: variation-point=post-build-variant-condition{matching-criterion=RDR_POS, value=1}
                DC_0xF5BB_oRDR02_oPCAN_RADAR_FD_d19751cb (DcmDslMainConnection): DcmDslProtocolRxTesterSourceAddr=245
                  PCAN_DIAG_REQ_FUNC_PLANT_oPCAN_RADAR_8e17ec17_Rx_e2e07788 (DcmDslProtocolRx):
                    DcmDslProtocolRxAddrType = DCM_FUNCTIONAL_TYPE
                    DcmDslProtocolRxPduId = 31
                    DcmDslProtocolRxComMChannelRef = ComMConfigSet/CN_PCAN_RADAR_458ff0f1
                    DcmDslProtocolRxPduRef = PCAN_DIAG_REQ_FUNC_PLANT_oPCAN_RADAR_8e17ec17_Rx
                  PCAN_DIAG_REQ_PHYS_PLANT_oPCAN_RADAR_a4e456d5_Rx_de87c92a (DcmDslProtocolRx):
                    DcmDslProtocolRxAddrType = DCM_PHYSICAL_TYPE
                    DcmDslProtocolRxPduId = 32
                    DcmDslProtocolRxComMChannelRef = ComMConfigSet/CN_PCAN_RADAR_458ff0f1
                    DcmDslProtocolRxPduRef = PCAN_DIAG_REQ_PHYS_PLANT_oPCAN_RADAR_a4e456d5_Rx
                  PCAN_DIAG_RESP_PHYS_PLANT_oPCAN_RADAR_339eb858_Tx_b55bc933 (DcmDslProtocolTx): DcmDslTxConfirmationPduId=30, DcmDslProtocolTxPduRef=EcucPduCollection/PCAN_DIAG_RESP_PHYS_PLANT_oPCAN_RADAR_339eb858_Tx
              DC_0xF5D0_oRDR02_oVCAN_RADAR_d3855357: variation-point=post-build-variant-condition{matching-criterion=RDR_POS, value=1}
                DC_0xF5D0_oRDR02_oVCAN_RADAR_d3855357 (DcmDslMainConnection): DcmDslProtocolRxTesterSourceAddr=245
                  DIAG_REQ_FNC_PLANT_oVCAN_RADAR_9fd4cadc_Rx_f47e2bb6 (DcmDslProtocolRx):
                    DcmDslProtocolRxAddrType = DCM_FUNCTIONAL_TYPE
                    DcmDslProtocolRxPduId = 34
                    DcmDslProtocolRxComMChannelRef = ComMConfigSet/CN_VCAN_RADAR_489180b6
                    DcmDslProtocolRxPduRef = DIAG_REQ_FNC_PLANT_oVCAN_RADAR_9fd4cadc_Rx
                  FR_DIAG_REQ_PHY_PLANT_oVCAN_RADAR_03b4032b_Rx_f4f84964 (DcmDslProtocolRx):
                    DcmDslProtocolRxAddrType = DCM_PHYSICAL_TYPE
                    DcmDslProtocolRxPduId = 35
                    DcmDslProtocolRxComMChannelRef = ComMConfigSet/CN_VCAN_RADAR_489180b6
                    DcmDslProtocolRxPduRef = FR_DIAG_REQ_PHY_PLANT_oVCAN_RADAR_03b4032b_Rx
                  FR_DIAG_RES_PHY_PLANT_oVCAN_RADAR_ee22d0c2_Tx_70415e78 (DcmDslProtocolTx): DcmDslTxConfirmationPduId=33, DcmDslProtocolTxPduRef=EcucPduCollection/FR_DIAG_RES_PHY_PLANT_oVCAN_RADAR_ee22d0c2_Tx
              DC_0xF0BB_oRDR03_oPCAN_RADAR_FD_21c91aaf: variation-point=post-build-variant-condition{matching-criterion=RDR_POS, value=2}
                DC_0xF0BB_oRDR03_oPCAN_RADAR_FD_21c91aaf (DcmDslMainConnection): DcmDslProtocolRxTesterSourceAddr=240
                  PCAN_DIAG_REQ_FUNC_OBD1_oPCAN_RADAR_5664bded_Rx_f8c6c8a4 (DcmDslProtocolRx):
                    DcmDslProtocolRxAddrType = DCM_FUNCTIONAL_TYPE
                    DcmDslProtocolRxPduId = 1
                    DcmDslProtocolRxComMChannelRef = ComMConfigSet/CN_PCAN_RADAR_458ff0f1
                    DcmDslProtocolRxPduRef = PCAN_DIAG_REQ_FUNC_OBD1_oPCAN_RADAR_5664bded_Rx
                  PCAN_DIAG_REQ_PHYS_OBD1_oPCAN_RADAR_caf5eb16_Rx_95487f2b (DcmDslProtocolRx):
                    DcmDslProtocolRxAddrType = DCM_PHYSICAL_TYPE
                    DcmDslProtocolRxPduId = 2
                    DcmDslProtocolRxComMChannelRef = ComMConfigSet/CN_PCAN_RADAR_458ff0f1
                    DcmDslProtocolRxPduRef = PCAN_DIAG_REQ_PHYS_OBD1_oPCAN_RADAR_caf5eb16_Rx
                  PCAN_DIAG_RESP_PHYS_OBD1_oPCAN_RADAR_62c2ee1d_Tx_71c025ae (DcmDslProtocolTx): DcmDslTxConfirmationPduId=0, DcmDslProtocolTxPduRef=EcucPduCollection/PCAN_DIAG_RESP_PHYS_OBD1_oPCAN_RADAR_62c2ee1d_Tx
              DC_0xF0BB_oRDR03_oPCAN_RADAR_bbb52527: variation-point=post-build-variant-condition{matching-criterion=RDR_POS, value=2}
                DC_0xF0BB_oRDR03_oPCAN_RADAR_bbb52527 (DcmDslMainConnection): DcmDslProtocolRxTesterSourceAddr=240
                  PCAN_DIAG_REQ_FUNC_OBD1_oPCAN_RADAR_20_e986e253_Rx_5365c009 (DcmDslProtocolRx):
                    DcmDslProtocolRxAddrType = DCM_FUNCTIONAL_TYPE
                    DcmDslProtocolRxPduId = 4
                    DcmDslProtocolRxComMChannelRef = ComMConfigSet/CN_PCAN_RADAR_458ff0f1
                    DcmDslProtocolRxPduRef = PCAN_DIAG_REQ_FUNC_OBD1_oPCAN_RADAR_20_e986e253_Rx
                  PCAN_DIAG_REQ_PHYS_OBD1_oPCAN_RADAR_20_3bfe27fe_Rx_2d01fee8 (DcmDslProtocolRx):
                    DcmDslProtocolRxAddrType = DCM_PHYSICAL_TYPE
                    DcmDslProtocolRxPduId = 5
                    DcmDslProtocolRxComMChannelRef = ComMConfigSet/CN_PCAN_RADAR_458ff0f1
                    DcmDslProtocolRxPduRef = PCAN_DIAG_REQ_PHYS_OBD1_oPCAN_RADAR_20_3bfe27fe_Rx
                  PCAN_DIAG_RESP_PHYS_OBD1_oPCAN_RADAR_20_f26199fd_Tx_55fbdb8d (DcmDslProtocolTx): DcmDslTxConfirmationPduId=3, DcmDslProtocolTxPduRef=EcucPduCollection/PCAN_DIAG_RESP_PHYS_OBD1_oPCAN_RADAR_20_f26199fd_Tx
              DC_0xF0D0_oRDR03_oVCAN_RADAR_459a7d12: variation-point=post-build-variant-condition{matching-criterion=RDR_POS, value=2}
                DC_0xF0D0_oRDR03_oVCAN_RADAR_459a7d12 (DcmDslMainConnection): DcmDslProtocolRxTesterSourceAddr=240
                  DIAG_REQ_FNC_OBD1_oVCAN_RADAR_ea4d23fb_Rx_4734fad9 (DcmDslProtocolRx):
                    DcmDslProtocolRxAddrType = DCM_FUNCTIONAL_TYPE
                    DcmDslProtocolRxPduId = 7
                    DcmDslProtocolRxComMChannelRef = ComMConfigSet/CN_VCAN_RADAR_489180b6
                    DcmDslProtocolRxPduRef = DIAG_REQ_FNC_OBD1_oVCAN_RADAR_ea4d23fb_Rx
                  FR_DIAG_REQ_PHY_OBD1_oVCAN_RADAR_83827d3f_Rx_a310dd11 (DcmDslProtocolRx):
                    DcmDslProtocolRxAddrType = DCM_PHYSICAL_TYPE
                    DcmDslProtocolRxPduId = 8
                    DcmDslProtocolRxComMChannelRef = ComMConfigSet/CN_VCAN_RADAR_489180b6
                    DcmDslProtocolRxPduRef = FR_DIAG_REQ_PHY_OBD1_oVCAN_RADAR_83827d3f_Rx
                  FR_DIAG_RES_PHY_OBD1_oVCAN_RADAR_add2b4bf_Tx_08033c95 (DcmDslProtocolTx): DcmDslTxConfirmationPduId=6, DcmDslProtocolTxPduRef=EcucPduCollection/FR_DIAG_RES_PHY_OBD1_oVCAN_RADAR_add2b4bf_Tx
              DC_0xF1BB_oRDR03_oPCAN_RADAR_FD_84428aa1: variation-point=post-build-variant-condition{matching-criterion=RDR_POS, value=2}
                DC_0xF1BB_oRDR03_oPCAN_RADAR_FD_84428aa1 (DcmDslMainConnection): DcmDslProtocolRxTesterSourceAddr=241
                  PCAN_DIAG_REQ_FUNC_OBD2_oPCAN_RADAR_ebaed123_Rx_69afd2b8 (DcmDslProtocolRx):
                    DcmDslProtocolRxAddrType = DCM_FUNCTIONAL_TYPE
                    DcmDslProtocolRxPduId = 10
                    DcmDslProtocolRxComMChannelRef = ComMConfigSet/CN_PCAN_RADAR_458ff0f1
                    DcmDslProtocolRxPduRef = PCAN_DIAG_REQ_FUNC_OBD2_oPCAN_RADAR_ebaed123_Rx
                  PCAN_DIAG_REQ_PHYS_OBD2_oPCAN_RADAR_773f87d8_Rx_31c94776 (DcmDslProtocolRx):
                    DcmDslProtocolRxAddrType = DCM_PHYSICAL_TYPE
                    DcmDslProtocolRxPduId = 11
                    DcmDslProtocolRxComMChannelRef = ComMConfigSet/CN_PCAN_RADAR_458ff0f1
                    DcmDslProtocolRxPduRef = PCAN_DIAG_REQ_PHYS_OBD2_oPCAN_RADAR_773f87d8_Rx
                  PCAN_DIAG_RESP_PHYS_OBD2_oPCAN_RADAR_df0882d3_Tx_fbbf77c9 (DcmDslProtocolTx): DcmDslTxConfirmationPduId=9, DcmDslProtocolTxPduRef=EcucPduCollection/PCAN_DIAG_RESP_PHYS_OBD2_oPCAN_RADAR_df0882d3_Tx
              DC_0xF1BB_oRDR03_oPCAN_RADAR_ac9d41e7: variation-point=post-build-variant-condition{matching-criterion=RDR_POS, value=2}
                DC_0xF1BB_oRDR03_oPCAN_RADAR_ac9d41e7 (DcmDslMainConnection): DcmDslProtocolRxTesterSourceAddr=241
                  PCAN_DIAG_REQ_FUNC_OBD2_oPCAN_RADAR_20_c04e56a1_Rx_a7582bb7 (DcmDslProtocolRx):
                    DcmDslProtocolRxAddrType = DCM_FUNCTIONAL_TYPE
                    DcmDslProtocolRxPduId = 13
                    DcmDslProtocolRxComMChannelRef = ComMConfigSet/CN_PCAN_RADAR_458ff0f1
                    DcmDslProtocolRxPduRef = PCAN_DIAG_REQ_FUNC_OBD2_oPCAN_RADAR_20_c04e56a1_Rx
                  PCAN_DIAG_REQ_PHYS_OBD2_oPCAN_RADAR_20_1236930c_Rx_26654501 (DcmDslProtocolRx):
                    DcmDslProtocolRxAddrType = DCM_PHYSICAL_TYPE
                    DcmDslProtocolRxPduId = 14
                    DcmDslProtocolRxComMChannelRef = ComMConfigSet/CN_PCAN_RADAR_458ff0f1
                    DcmDslProtocolRxPduRef = PCAN_DIAG_REQ_PHYS_OBD2_oPCAN_RADAR_20_1236930c_Rx
                  PCAN_DIAG_RESP_PHYS_OBD2_oPCAN_RADAR_20_dba92d0f_Tx_dcc6691a (DcmDslProtocolTx): DcmDslTxConfirmationPduId=12, DcmDslProtocolTxPduRef=EcucPduCollection/PCAN_DIAG_RESP_PHYS_OBD2_oPCAN_RADAR_20_dba92d0f_Tx
              DC_0xF1D0_oRDR03_oVCAN_RADAR_52b219d2: variation-point=post-build-variant-condition{matching-criterion=RDR_POS, value=2}
                DC_0xF1D0_oRDR03_oVCAN_RADAR_52b219d2 (DcmDslMainConnection): DcmDslProtocolRxTesterSourceAddr=241
                  DIAG_REQ_FNC_OBD2_oVCAN_RADAR_57874f35_Rx_1a4abb4e (DcmDslProtocolRx):
                    DcmDslProtocolRxAddrType = DCM_FUNCTIONAL_TYPE
                    DcmDslProtocolRxPduId = 16
                    DcmDslProtocolRxComMChannelRef = ComMConfigSet/CN_VCAN_RADAR_489180b6
                    DcmDslProtocolRxPduRef = DIAG_REQ_FNC_OBD2_oVCAN_RADAR_57874f35_Rx
                  FR_DIAG_REQ_PHY_OBD2_oVCAN_RADAR_3e4811f1_Rx_ef982e0b (DcmDslProtocolRx):
                    DcmDslProtocolRxAddrType = DCM_PHYSICAL_TYPE
                    DcmDslProtocolRxPduId = 17
                    DcmDslProtocolRxComMChannelRef = ComMConfigSet/CN_VCAN_RADAR_489180b6
                    DcmDslProtocolRxPduRef = FR_DIAG_REQ_PHY_OBD2_oVCAN_RADAR_3e4811f1_Rx
                  FR_DIAG_RES_PHY_OBD2_oVCAN_RADAR_1018d871_Tx_ee91ebc0 (DcmDslProtocolTx): DcmDslTxConfirmationPduId=15, DcmDslProtocolTxPduRef=EcucPduCollection/FR_DIAG_RES_PHY_OBD2_oVCAN_RADAR_1018d871_Tx
              DC_0xF4BB_oRDR03_oPCAN_RADAR_FD_da745054: variation-point=post-build-variant-condition{matching-criterion=RDR_POS, value=2}
                DC_0xF4BB_oRDR03_oPCAN_RADAR_FD_da745054 (DcmDslMainConnection): DcmDslProtocolRxTesterSourceAddr=244
                  PCAN_DIAG_REQ_FUNC_OTA_oPCAN_RADAR_8729c499_Rx_63a44321 (DcmDslProtocolRx):
                    DcmDslProtocolRxAddrType = DCM_FUNCTIONAL_TYPE
                    DcmDslProtocolRxPduId = 19
                    DcmDslProtocolRxComMChannelRef = ComMConfigSet/CN_PCAN_RADAR_458ff0f1
                    DcmDslProtocolRxPduRef = PCAN_DIAG_REQ_FUNC_OTA_oPCAN_RADAR_8729c499_Rx
                  PCAN_DIAG_REQ_PHYS_OTA_oPCAN_RADAR_1f79965d_Rx_897b19f5 (DcmDslProtocolRx):
                    DcmDslProtocolRxAddrType = DCM_PHYSICAL_TYPE
                    DcmDslProtocolRxPduId = 20
                    DcmDslProtocolRxComMChannelRef = ComMConfigSet/CN_PCAN_RADAR_458ff0f1
                    DcmDslProtocolRxPduRef = PCAN_DIAG_REQ_PHYS_OTA_oPCAN_RADAR_1f79965d_Rx
                  PCAN_DIAG_RESP_PHYS_OTA_oPCAN_RADAR_4fa3c8f0_Tx_93c6c140 (DcmDslProtocolTx): DcmDslTxConfirmationPduId=18, DcmDslProtocolTxPduRef=EcucPduCollection/PCAN_DIAG_RESP_PHYS_OTA_oPCAN_RADAR_4fa3c8f0_Tx
              DC_0xF4BB_oRDR03_oPCAN_RADAR_e714b627: variation-point=post-build-variant-condition{matching-criterion=RDR_POS, value=2}
                DC_0xF4BB_oRDR03_oPCAN_RADAR_e714b627 (DcmDslMainConnection): DcmDslProtocolRxTesterSourceAddr=244
                  PCAN_DIAG_REQ_FUNC_OTA_oPCAN_RADAR_20_4ceedd9c_Rx_8d5a8781 (DcmDslProtocolRx):
                    DcmDslProtocolRxAddrType = DCM_FUNCTIONAL_TYPE
                    DcmDslProtocolRxPduId = 22
                    DcmDslProtocolRxComMChannelRef = ComMConfigSet/CN_PCAN_RADAR_458ff0f1
                    DcmDslProtocolRxPduRef = PCAN_DIAG_REQ_FUNC_OTA_oPCAN_RADAR_20_4ceedd9c_Rx
                  PCAN_DIAG_REQ_PHYS_OTA_oPCAN_RADAR_20_39ae8dba_Rx_fd38421b (DcmDslProtocolRx):
                    DcmDslProtocolRxAddrType = DCM_PHYSICAL_TYPE
                    DcmDslProtocolRxPduId = 23
                    DcmDslProtocolRxComMChannelRef = ComMConfigSet/CN_PCAN_RADAR_458ff0f1
                    DcmDslProtocolRxPduRef = PCAN_DIAG_REQ_PHYS_OTA_oPCAN_RADAR_20_39ae8dba_Rx
                  PCAN_DIAG_RESP_PHYS_OTA_oPCAN_RADAR_20_aa3008c9_Tx_74022f70 (DcmDslProtocolTx): DcmDslTxConfirmationPduId=21, DcmDslProtocolTxPduRef=EcucPduCollection/PCAN_DIAG_RESP_PHYS_OTA_oPCAN_RADAR_20_aa3008c9_Tx
              DC_0xF4D0_oRDR03_oVCAN_RADAR_193bee12: variation-point=post-build-variant-condition{matching-criterion=RDR_POS, value=2}
                DC_0xF4D0_oRDR03_oVCAN_RADAR_193bee12 (DcmDslMainConnection): DcmDslProtocolRxTesterSourceAddr=244
                  DIAG_REQ_FNC_OTA_oVCAN_RADAR_b630c1e5_Rx_0176162e (DcmDslProtocolRx):
                    DcmDslProtocolRxAddrType = DCM_FUNCTIONAL_TYPE
                    DcmDslProtocolRxPduId = 25
                    DcmDslProtocolRxComMChannelRef = ComMConfigSet/CN_VCAN_RADAR_489180b6
                    DcmDslProtocolRxPduRef = DIAG_REQ_FNC_OTA_oVCAN_RADAR_b630c1e5_Rx
                  FR_DIAG_REQ_PHY_OTA_oVCAN_RADAR_7facfb76_Rx_b2eaa10c (DcmDslProtocolRx):
                    DcmDslProtocolRxAddrType = DCM_PHYSICAL_TYPE
                    DcmDslProtocolRxPduId = 26
                    DcmDslProtocolRxComMChannelRef = ComMConfigSet/CN_VCAN_RADAR_489180b6
                    DcmDslProtocolRxPduRef = FR_DIAG_REQ_PHY_OTA_oVCAN_RADAR_7facfb76_Rx
                  FR_DIAG_RES_PHY_OTA_oVCAN_RADAR_9b68fa0b_Tx_bc6c5974 (DcmDslProtocolTx): DcmDslTxConfirmationPduId=24, DcmDslProtocolTxPduRef=EcucPduCollection/FR_DIAG_RES_PHY_OTA_oVCAN_RADAR_9b68fa0b_Tx
              DC_0xF5BB_oRDR03_oPCAN_RADAR_FD_7fffc05a: variation-point=post-build-variant-condition{matching-criterion=RDR_POS, value=2}
                DC_0xF5BB_oRDR03_oPCAN_RADAR_FD_7fffc05a (DcmDslMainConnection): DcmDslProtocolRxTesterSourceAddr=245
                  PCAN_DIAG_REQ_FUNC_PLANT_oPCAN_RADAR_8e17ec17_Rx_e2e07788 (DcmDslProtocolRx):
                    DcmDslProtocolRxAddrType = DCM_FUNCTIONAL_TYPE
                    DcmDslProtocolRxPduId = 28
                    DcmDslProtocolRxComMChannelRef = ComMConfigSet/CN_PCAN_RADAR_458ff0f1
                    DcmDslProtocolRxPduRef = PCAN_DIAG_REQ_FUNC_PLANT_oPCAN_RADAR_8e17ec17_Rx
                  PCAN_DIAG_REQ_PHYS_PLANT_oPCAN_RADAR_a4e456d5_Rx_de87c92a (DcmDslProtocolRx):
                    DcmDslProtocolRxAddrType = DCM_PHYSICAL_TYPE
                    DcmDslProtocolRxPduId = 29
                    DcmDslProtocolRxComMChannelRef = ComMConfigSet/CN_PCAN_RADAR_458ff0f1
                    DcmDslProtocolRxPduRef = PCAN_DIAG_REQ_PHYS_PLANT_oPCAN_RADAR_a4e456d5_Rx
                  PCAN_DIAG_RESP_PHYS_PLANT_oPCAN_RADAR_339eb858_Tx_b55bc933 (DcmDslProtocolTx): DcmDslTxConfirmationPduId=27, DcmDslProtocolTxPduRef=EcucPduCollection/PCAN_DIAG_RESP_PHYS_PLANT_oPCAN_RADAR_339eb858_Tx
              DC_0xF5BB_oRDR03_oPCAN_RADAR_f03cd2e7: variation-point=post-build-variant-condition{matching-criterion=RDR_POS, value=2}
                DC_0xF5BB_oRDR03_oPCAN_RADAR_f03cd2e7 (DcmDslMainConnection): DcmDslProtocolRxTesterSourceAddr=245
                  PCAN_DIAG_REQ_FUNC_PLANT_oPCAN_RADAR_20_3b79581e_Rx_36801f1b (DcmDslProtocolRx):
                    DcmDslProtocolRxAddrType = DCM_FUNCTIONAL_TYPE
                    DcmDslProtocolRxPduId = 31
                    DcmDslProtocolRxComMChannelRef = ComMConfigSet/CN_PCAN_RADAR_458ff0f1
                    DcmDslProtocolRxPduRef = PCAN_DIAG_REQ_FUNC_PLANT_oPCAN_RADAR_20_3b79581e_Rx
                  PCAN_DIAG_REQ_PHYS_PLANT_oPCAN_RADAR_20_93ccff8e_Rx_c332e01f (DcmDslProtocolRx):
                    DcmDslProtocolRxAddrType = DCM_PHYSICAL_TYPE
                    DcmDslProtocolRxPduId = 32
                    DcmDslProtocolRxComMChannelRef = ComMConfigSet/CN_PCAN_RADAR_458ff0f1
                    DcmDslProtocolRxPduRef = PCAN_DIAG_REQ_PHYS_PLANT_oPCAN_RADAR_20_93ccff8e_Rx
                  PCAN_DIAG_RESP_PHYS_PLANT_oPCAN_RADAR_20_0a0c318a_Tx_b4cb0023 (DcmDslProtocolTx): DcmDslTxConfirmationPduId=30, DcmDslProtocolTxPduRef=EcucPduCollection/PCAN_DIAG_RESP_PHYS_PLANT_oPCAN_RADAR_20_0a0c318a_Tx
              DC_0xF5D0_oRDR03_oVCAN_RADAR_0e138ad2: variation-point=post-build-variant-condition{matching-criterion=RDR_POS, value=2}
                DC_0xF5D0_oRDR03_oVCAN_RADAR_0e138ad2 (DcmDslMainConnection): DcmDslProtocolRxTesterSourceAddr=245
                  DIAG_REQ_FNC_PLANT_oVCAN_RADAR_9fd4cadc_Rx_f47e2bb6 (DcmDslProtocolRx):
                    DcmDslProtocolRxAddrType = DCM_FUNCTIONAL_TYPE
                    DcmDslProtocolRxPduId = 34
                    DcmDslProtocolRxComMChannelRef = ComMConfigSet/CN_VCAN_RADAR_489180b6
                    DcmDslProtocolRxPduRef = DIAG_REQ_FNC_PLANT_oVCAN_RADAR_9fd4cadc_Rx
                  FR_DIAG_REQ_PHY_PLANT_oVCAN_RADAR_03b4032b_Rx_f4f84964 (DcmDslProtocolRx):
                    DcmDslProtocolRxAddrType = DCM_PHYSICAL_TYPE
                    DcmDslProtocolRxPduId = 35
                    DcmDslProtocolRxComMChannelRef = ComMConfigSet/CN_VCAN_RADAR_489180b6
                    DcmDslProtocolRxPduRef = FR_DIAG_REQ_PHY_PLANT_oVCAN_RADAR_03b4032b_Rx
                  FR_DIAG_RES_PHY_PLANT_oVCAN_RADAR_ee22d0c2_Tx_70415e78 (DcmDslProtocolTx): DcmDslTxConfirmationPduId=33, DcmDslProtocolTxPduRef=EcucPduCollection/FR_DIAG_RES_PHY_PLANT_oVCAN_RADAR_ee22d0c2_Tx
              DC_0xF0BB_oRDR04_oPCAN_RADAR_FD_dc30e2da: variation-point=post-build-variant-condition{matching-criterion=RDR_POS, value=3}
                DC_0xF0BB_oRDR04_oPCAN_RADAR_FD_dc30e2da (DcmDslMainConnection): DcmDslProtocolRxTesterSourceAddr=240
                  PCAN_DIAG_REQ_FUNC_OBD1_oPCAN_RADAR_5664bded_Rx_f8c6c8a4 (DcmDslProtocolRx):
                    DcmDslProtocolRxAddrType = DCM_FUNCTIONAL_TYPE
                    DcmDslProtocolRxPduId = 1
                    DcmDslProtocolRxComMChannelRef = ComMConfigSet/CN_PCAN_RADAR_458ff0f1
                    DcmDslProtocolRxPduRef = PCAN_DIAG_REQ_FUNC_OBD1_oPCAN_RADAR_5664bded_Rx
                  PCAN_DIAG_REQ_PHYS_OBD1_oPCAN_RADAR_caf5eb16_Rx_95487f2b (DcmDslProtocolRx):
                    DcmDslProtocolRxAddrType = DCM_PHYSICAL_TYPE
                    DcmDslProtocolRxPduId = 2
                    DcmDslProtocolRxComMChannelRef = ComMConfigSet/CN_PCAN_RADAR_458ff0f1
                    DcmDslProtocolRxPduRef = PCAN_DIAG_REQ_PHYS_OBD1_oPCAN_RADAR_caf5eb16_Rx
                  PCAN_DIAG_RESP_PHYS_OBD1_oPCAN_RADAR_62c2ee1d_Tx_71c025ae (DcmDslProtocolTx): DcmDslTxConfirmationPduId=0, DcmDslProtocolTxPduRef=EcucPduCollection/PCAN_DIAG_RESP_PHYS_OBD1_oPCAN_RADAR_62c2ee1d_Tx
              DC_0xF0BB_oRDR04_oPCAN_RADAR_c6c6237f: variation-point=post-build-variant-condition{matching-criterion=RDR_POS, value=3}
                DC_0xF0BB_oRDR04_oPCAN_RADAR_c6c6237f (DcmDslMainConnection): DcmDslProtocolRxTesterSourceAddr=240
                  PCAN_DIAG_REQ_FUNC_OBD1_oPCAN_RADAR_20_e986e253_Rx_5365c009 (DcmDslProtocolRx):
                    DcmDslProtocolRxAddrType = DCM_FUNCTIONAL_TYPE
                    DcmDslProtocolRxPduId = 4
                    DcmDslProtocolRxComMChannelRef = ComMConfigSet/CN_PCAN_RADAR_458ff0f1
                    DcmDslProtocolRxPduRef = PCAN_DIAG_REQ_FUNC_OBD1_oPCAN_RADAR_20_e986e253_Rx
                  PCAN_DIAG_REQ_PHYS_OBD1_oPCAN_RADAR_20_3bfe27fe_Rx_2d01fee8 (DcmDslProtocolRx):
                    DcmDslProtocolRxAddrType = DCM_PHYSICAL_TYPE
                    DcmDslProtocolRxPduId = 5
                    DcmDslProtocolRxComMChannelRef = ComMConfigSet/CN_PCAN_RADAR_458ff0f1
                    DcmDslProtocolRxPduRef = PCAN_DIAG_REQ_PHYS_OBD1_oPCAN_RADAR_20_3bfe27fe_Rx
                  PCAN_DIAG_RESP_PHYS_OBD1_oPCAN_RADAR_20_f26199fd_Tx_55fbdb8d (DcmDslProtocolTx): DcmDslTxConfirmationPduId=3, DcmDslProtocolTxPduRef=EcucPduCollection/PCAN_DIAG_RESP_PHYS_OBD1_oPCAN_RADAR_20_f26199fd_Tx
              DC_0xF0D0_oRDR04_oVCAN_RADAR_38e97b4a: variation-point=post-build-variant-condition{matching-criterion=RDR_POS, value=3}
                DC_0xF0D0_oRDR04_oVCAN_RADAR_38e97b4a (DcmDslMainConnection): DcmDslProtocolRxTesterSourceAddr=240
                  DIAG_REQ_FNC_OBD1_oVCAN_RADAR_ea4d23fb_Rx_4734fad9 (DcmDslProtocolRx):
                    DcmDslProtocolRxAddrType = DCM_FUNCTIONAL_TYPE
                    DcmDslProtocolRxPduId = 7
                    DcmDslProtocolRxComMChannelRef = ComMConfigSet/CN_VCAN_RADAR_489180b6
                    DcmDslProtocolRxPduRef = DIAG_REQ_FNC_OBD1_oVCAN_RADAR_ea4d23fb_Rx
                  FR_DIAG_REQ_PHY_OBD1_oVCAN_RADAR_83827d3f_Rx_a310dd11 (DcmDslProtocolRx):
                    DcmDslProtocolRxAddrType = DCM_PHYSICAL_TYPE
                    DcmDslProtocolRxPduId = 8
                    DcmDslProtocolRxComMChannelRef = ComMConfigSet/CN_VCAN_RADAR_489180b6
                    DcmDslProtocolRxPduRef = FR_DIAG_REQ_PHY_OBD1_oVCAN_RADAR_83827d3f_Rx
                  FR_DIAG_RES_PHY_OBD1_oVCAN_RADAR_add2b4bf_Tx_08033c95 (DcmDslProtocolTx): DcmDslTxConfirmationPduId=6, DcmDslProtocolTxPduRef=EcucPduCollection/FR_DIAG_RES_PHY_OBD1_oVCAN_RADAR_add2b4bf_Tx
              DC_0xF1BB_oRDR04_oPCAN_RADAR_FD_79bb72d4: variation-point=post-build-variant-condition{matching-criterion=RDR_POS, value=3}
                DC_0xF1BB_oRDR04_oPCAN_RADAR_FD_79bb72d4 (DcmDslMainConnection): DcmDslProtocolRxTesterSourceAddr=241
                  PCAN_DIAG_REQ_FUNC_OBD2_oPCAN_RADAR_ebaed123_Rx_69afd2b8 (DcmDslProtocolRx):
                    DcmDslProtocolRxAddrType = DCM_FUNCTIONAL_TYPE
                    DcmDslProtocolRxPduId = 10
                    DcmDslProtocolRxComMChannelRef = ComMConfigSet/CN_PCAN_RADAR_458ff0f1
                    DcmDslProtocolRxPduRef = PCAN_DIAG_REQ_FUNC_OBD2_oPCAN_RADAR_ebaed123_Rx
                  PCAN_DIAG_REQ_PHYS_OBD2_oPCAN_RADAR_773f87d8_Rx_31c94776 (DcmDslProtocolRx):
                    DcmDslProtocolRxAddrType = DCM_PHYSICAL_TYPE
                    DcmDslProtocolRxPduId = 11
                    DcmDslProtocolRxComMChannelRef = ComMConfigSet/CN_PCAN_RADAR_458ff0f1
                    DcmDslProtocolRxPduRef = PCAN_DIAG_REQ_PHYS_OBD2_oPCAN_RADAR_773f87d8_Rx
                  PCAN_DIAG_RESP_PHYS_OBD2_oPCAN_RADAR_df0882d3_Tx_fbbf77c9 (DcmDslProtocolTx): DcmDslTxConfirmationPduId=9, DcmDslProtocolTxPduRef=EcucPduCollection/PCAN_DIAG_RESP_PHYS_OBD2_oPCAN_RADAR_df0882d3_Tx
              DC_0xF1BB_oRDR04_oPCAN_RADAR_d1ee47bf: variation-point=post-build-variant-condition{matching-criterion=RDR_POS, value=3}
                DC_0xF1BB_oRDR04_oPCAN_RADAR_d1ee47bf (DcmDslMainConnection): DcmDslProtocolRxTesterSourceAddr=241
                  PCAN_DIAG_REQ_FUNC_OBD2_oPCAN_RADAR_20_c04e56a1_Rx_a7582bb7 (DcmDslProtocolRx):
                    DcmDslProtocolRxAddrType = DCM_FUNCTIONAL_TYPE
                    DcmDslProtocolRxPduId = 13
                    DcmDslProtocolRxComMChannelRef = ComMConfigSet/CN_PCAN_RADAR_458ff0f1
                    DcmDslProtocolRxPduRef = PCAN_DIAG_REQ_FUNC_OBD2_oPCAN_RADAR_20_c04e56a1_Rx
                  PCAN_DIAG_REQ_PHYS_OBD2_oPCAN_RADAR_20_1236930c_Rx_26654501 (DcmDslProtocolRx):
                    DcmDslProtocolRxAddrType = DCM_PHYSICAL_TYPE
                    DcmDslProtocolRxPduId = 14
                    DcmDslProtocolRxComMChannelRef = ComMConfigSet/CN_PCAN_RADAR_458ff0f1
                    DcmDslProtocolRxPduRef = PCAN_DIAG_REQ_PHYS_OBD2_oPCAN_RADAR_20_1236930c_Rx
                  PCAN_DIAG_RESP_PHYS_OBD2_oPCAN_RADAR_20_dba92d0f_Tx_dcc6691a (DcmDslProtocolTx): DcmDslTxConfirmationPduId=12, DcmDslProtocolTxPduRef=EcucPduCollection/PCAN_DIAG_RESP_PHYS_OBD2_oPCAN_RADAR_20_dba92d0f_Tx
              DC_0xF1D0_oRDR04_oVCAN_RADAR_2fc11f8a: variation-point=post-build-variant-condition{matching-criterion=RDR_POS, value=3}
                DC_0xF1D0_oRDR04_oVCAN_RADAR_2fc11f8a (DcmDslMainConnection): DcmDslProtocolRxTesterSourceAddr=241
                  DIAG_REQ_FNC_OBD2_oVCAN_RADAR_57874f35_Rx_1a4abb4e (DcmDslProtocolRx):
                    DcmDslProtocolRxAddrType = DCM_FUNCTIONAL_TYPE
                    DcmDslProtocolRxPduId = 16
                    DcmDslProtocolRxComMChannelRef = ComMConfigSet/CN_VCAN_RADAR_489180b6
                    DcmDslProtocolRxPduRef = DIAG_REQ_FNC_OBD2_oVCAN_RADAR_57874f35_Rx
                  FR_DIAG_REQ_PHY_OBD2_oVCAN_RADAR_3e4811f1_Rx_ef982e0b (DcmDslProtocolRx):
                    DcmDslProtocolRxAddrType = DCM_PHYSICAL_TYPE
                    DcmDslProtocolRxPduId = 17
                    DcmDslProtocolRxComMChannelRef = ComMConfigSet/CN_VCAN_RADAR_489180b6
                    DcmDslProtocolRxPduRef = FR_DIAG_REQ_PHY_OBD2_oVCAN_RADAR_3e4811f1_Rx
                  FR_DIAG_RES_PHY_OBD2_oVCAN_RADAR_1018d871_Tx_ee91ebc0 (DcmDslProtocolTx): DcmDslTxConfirmationPduId=15, DcmDslProtocolTxPduRef=EcucPduCollection/FR_DIAG_RES_PHY_OBD2_oVCAN_RADAR_1018d871_Tx
              DC_0xF4BB_oRDR04_oPCAN_RADAR_9a67b07f: variation-point=post-build-variant-condition{matching-criterion=RDR_POS, value=3}
                DC_0xF4BB_oRDR04_oPCAN_RADAR_9a67b07f (DcmDslMainConnection): DcmDslProtocolRxTesterSourceAddr=244
                  PCAN_DIAG_REQ_FUNC_OTA_oPCAN_RADAR_20_4ceedd9c_Rx_8d5a8781 (DcmDslProtocolRx):
                    DcmDslProtocolRxAddrType = DCM_FUNCTIONAL_TYPE
                    DcmDslProtocolRxPduId = 19
                    DcmDslProtocolRxComMChannelRef = ComMConfigSet/CN_PCAN_RADAR_458ff0f1
                    DcmDslProtocolRxPduRef = PCAN_DIAG_REQ_FUNC_OTA_oPCAN_RADAR_20_4ceedd9c_Rx
                  PCAN_DIAG_REQ_PHYS_OTA_oPCAN_RADAR_20_39ae8dba_Rx_fd38421b (DcmDslProtocolRx):
                    DcmDslProtocolRxAddrType = DCM_PHYSICAL_TYPE
                    DcmDslProtocolRxPduId = 20
                    DcmDslProtocolRxComMChannelRef = ComMConfigSet/CN_PCAN_RADAR_458ff0f1
                    DcmDslProtocolRxPduRef = PCAN_DIAG_REQ_PHYS_OTA_oPCAN_RADAR_20_39ae8dba_Rx
                  PCAN_DIAG_RESP_PHYS_OTA_oPCAN_RADAR_20_aa3008c9_Tx_74022f70 (DcmDslProtocolTx): DcmDslTxConfirmationPduId=18, DcmDslProtocolTxPduRef=EcucPduCollection/PCAN_DIAG_RESP_PHYS_OTA_oPCAN_RADAR_20_aa3008c9_Tx
              DC_0xF4BB_oRDR04_oPCAN_RADAR_FD_278da821: variation-point=post-build-variant-condition{matching-criterion=RDR_POS, value=3}
                DC_0xF4BB_oRDR04_oPCAN_RADAR_FD_278da821 (DcmDslMainConnection): DcmDslProtocolRxTesterSourceAddr=244
                  PCAN_DIAG_REQ_FUNC_OTA_oPCAN_RADAR_8729c499_Rx_63a44321 (DcmDslProtocolRx):
                    DcmDslProtocolRxAddrType = DCM_FUNCTIONAL_TYPE
                    DcmDslProtocolRxPduId = 22
                    DcmDslProtocolRxComMChannelRef = ComMConfigSet/CN_PCAN_RADAR_458ff0f1
                    DcmDslProtocolRxPduRef = PCAN_DIAG_REQ_FUNC_OTA_oPCAN_RADAR_8729c499_Rx
                  PCAN_DIAG_REQ_PHYS_OTA_oPCAN_RADAR_1f79965d_Rx_897b19f5 (DcmDslProtocolRx):
                    DcmDslProtocolRxAddrType = DCM_PHYSICAL_TYPE
                    DcmDslProtocolRxPduId = 23
                    DcmDslProtocolRxComMChannelRef = ComMConfigSet/CN_PCAN_RADAR_458ff0f1
                    DcmDslProtocolRxPduRef = PCAN_DIAG_REQ_PHYS_OTA_oPCAN_RADAR_1f79965d_Rx
                  PCAN_DIAG_RESP_PHYS_OTA_oPCAN_RADAR_4fa3c8f0_Tx_93c6c140 (DcmDslProtocolTx): DcmDslTxConfirmationPduId=21, DcmDslProtocolTxPduRef=EcucPduCollection/PCAN_DIAG_RESP_PHYS_OTA_oPCAN_RADAR_4fa3c8f0_Tx
              DC_0xF4D0_oRDR04_oVCAN_RADAR_6448e84a: variation-point=post-build-variant-condition{matching-criterion=RDR_POS, value=3}
                DC_0xF4D0_oRDR04_oVCAN_RADAR_6448e84a (DcmDslMainConnection): DcmDslProtocolRxTesterSourceAddr=244
                  DIAG_REQ_FNC_OTA_oVCAN_RADAR_b630c1e5_Rx_0176162e (DcmDslProtocolRx):
                    DcmDslProtocolRxAddrType = DCM_FUNCTIONAL_TYPE
                    DcmDslProtocolRxPduId = 25
                    DcmDslProtocolRxComMChannelRef = ComMConfigSet/CN_VCAN_RADAR_489180b6
                    DcmDslProtocolRxPduRef = DIAG_REQ_FNC_OTA_oVCAN_RADAR_b630c1e5_Rx
                  FR_DIAG_REQ_PHY_OTA_oVCAN_RADAR_7facfb76_Rx_b2eaa10c (DcmDslProtocolRx):
                    DcmDslProtocolRxAddrType = DCM_PHYSICAL_TYPE
                    DcmDslProtocolRxPduId = 26
                    DcmDslProtocolRxComMChannelRef = ComMConfigSet/CN_VCAN_RADAR_489180b6
                    DcmDslProtocolRxPduRef = FR_DIAG_REQ_PHY_OTA_oVCAN_RADAR_7facfb76_Rx
                  FR_DIAG_RES_PHY_OTA_oVCAN_RADAR_9b68fa0b_Tx_bc6c5974 (DcmDslProtocolTx): DcmDslTxConfirmationPduId=24, DcmDslProtocolTxPduRef=EcucPduCollection/FR_DIAG_RES_PHY_OTA_oVCAN_RADAR_9b68fa0b_Tx
              DC_0xF5BB_oRDR04_oPCAN_RADAR_8d4fd4bf: variation-point=post-build-variant-condition{matching-criterion=RDR_POS, value=3}
                DC_0xF5BB_oRDR04_oPCAN_RADAR_8d4fd4bf (DcmDslMainConnection): DcmDslProtocolRxTesterSourceAddr=245
                  PCAN_DIAG_REQ_FUNC_PLANT_oPCAN_RADAR_20_3b79581e_Rx_36801f1b (DcmDslProtocolRx):
                    DcmDslProtocolRxAddrType = DCM_FUNCTIONAL_TYPE
                    DcmDslProtocolRxPduId = 28
                    DcmDslProtocolRxComMChannelRef = ComMConfigSet/CN_PCAN_RADAR_458ff0f1
                    DcmDslProtocolRxPduRef = PCAN_DIAG_REQ_FUNC_PLANT_oPCAN_RADAR_20_3b79581e_Rx
                  PCAN_DIAG_REQ_PHYS_PLANT_oPCAN_RADAR_20_93ccff8e_Rx_c332e01f (DcmDslProtocolRx):
                    DcmDslProtocolRxAddrType = DCM_PHYSICAL_TYPE
                    DcmDslProtocolRxPduId = 29
                    DcmDslProtocolRxComMChannelRef = ComMConfigSet/CN_PCAN_RADAR_458ff0f1
                    DcmDslProtocolRxPduRef = PCAN_DIAG_REQ_PHYS_PLANT_oPCAN_RADAR_20_93ccff8e_Rx
                  PCAN_DIAG_RESP_PHYS_PLANT_oPCAN_RADAR_20_0a0c318a_Tx_b4cb0023 (DcmDslProtocolTx): DcmDslTxConfirmationPduId=27, DcmDslProtocolTxPduRef=EcucPduCollection/PCAN_DIAG_RESP_PHYS_PLANT_oPCAN_RADAR_20_0a0c318a_Tx
              DC_0xF5BB_oRDR04_oPCAN_RADAR_FD_8206382f: variation-point=post-build-variant-condition{matching-criterion=RDR_POS, value=3}
                DC_0xF5BB_oRDR04_oPCAN_RADAR_FD_8206382f (DcmDslMainConnection): DcmDslProtocolRxTesterSourceAddr=245
                  PCAN_DIAG_REQ_FUNC_PLANT_oPCAN_RADAR_8e17ec17_Rx_e2e07788 (DcmDslProtocolRx):
                    DcmDslProtocolRxAddrType = DCM_FUNCTIONAL_TYPE
                    DcmDslProtocolRxPduId = 31
                    DcmDslProtocolRxComMChannelRef = ComMConfigSet/CN_PCAN_RADAR_458ff0f1
                    DcmDslProtocolRxPduRef = PCAN_DIAG_REQ_FUNC_PLANT_oPCAN_RADAR_8e17ec17_Rx
                  PCAN_DIAG_REQ_PHYS_PLANT_oPCAN_RADAR_a4e456d5_Rx_de87c92a (DcmDslProtocolRx):
                    DcmDslProtocolRxAddrType = DCM_PHYSICAL_TYPE
                    DcmDslProtocolRxPduId = 32
                    DcmDslProtocolRxComMChannelRef = ComMConfigSet/CN_PCAN_RADAR_458ff0f1
                    DcmDslProtocolRxPduRef = PCAN_DIAG_REQ_PHYS_PLANT_oPCAN_RADAR_a4e456d5_Rx
                  PCAN_DIAG_RESP_PHYS_PLANT_oPCAN_RADAR_339eb858_Tx_b55bc933 (DcmDslProtocolTx): DcmDslTxConfirmationPduId=30, DcmDslProtocolTxPduRef=EcucPduCollection/PCAN_DIAG_RESP_PHYS_PLANT_oPCAN_RADAR_339eb858_Tx
              DC_0xF5D0_oRDR04_oVCAN_RADAR_73608c8a: variation-point=post-build-variant-condition{matching-criterion=RDR_POS, value=3}
                DC_0xF5D0_oRDR04_oVCAN_RADAR_73608c8a (DcmDslMainConnection): DcmDslProtocolRxTesterSourceAddr=245
                  DIAG_REQ_FNC_PLANT_oVCAN_RADAR_9fd4cadc_Rx_f47e2bb6 (DcmDslProtocolRx):
                    DcmDslProtocolRxAddrType = DCM_FUNCTIONAL_TYPE
                    DcmDslProtocolRxPduId = 34
                    DcmDslProtocolRxComMChannelRef = ComMConfigSet/CN_VCAN_RADAR_489180b6
                    DcmDslProtocolRxPduRef = DIAG_REQ_FNC_PLANT_oVCAN_RADAR_9fd4cadc_Rx
                  FR_DIAG_REQ_PHY_PLANT_oVCAN_RADAR_03b4032b_Rx_f4f84964 (DcmDslProtocolRx):
                    DcmDslProtocolRxAddrType = DCM_PHYSICAL_TYPE
                    DcmDslProtocolRxPduId = 35
                    DcmDslProtocolRxComMChannelRef = ComMConfigSet/CN_VCAN_RADAR_489180b6
                    DcmDslProtocolRxPduRef = FR_DIAG_REQ_PHY_PLANT_oVCAN_RADAR_03b4032b_Rx
                  FR_DIAG_RES_PHY_PLANT_oVCAN_RADAR_ee22d0c2_Tx_70415e78 (DcmDslProtocolTx): DcmDslTxConfirmationPduId=33, DcmDslProtocolTxPduRef=EcucPduCollection/FR_DIAG_RES_PHY_PLANT_oVCAN_RADAR_ee22d0c2_Tx
              DC_0xF0BB_oRDR05_oPCAN_RADAR_1b50fafa: variation-point=post-build-variant-condition{matching-criterion=RDR_POS, value=4}
                DC_0xF0BB_oRDR05_oPCAN_RADAR_1b50fafa (DcmDslMainConnection): DcmDslProtocolRxTesterSourceAddr=240
                  PCAN_DIAG_REQ_FUNC_OBD1_oPCAN_RADAR_20_e986e253_Rx_5365c009 (DcmDslProtocolRx):
                    DcmDslProtocolRxAddrType = DCM_FUNCTIONAL_TYPE
                    DcmDslProtocolRxPduId = 1
                    DcmDslProtocolRxComMChannelRef = ComMConfigSet/CN_PCAN_RADAR_458ff0f1
                    DcmDslProtocolRxPduRef = PCAN_DIAG_REQ_FUNC_OBD1_oPCAN_RADAR_20_e986e253_Rx
                  PCAN_DIAG_REQ_PHYS_OBD1_oPCAN_RADAR_20_3bfe27fe_Rx_2d01fee8 (DcmDslProtocolRx):
                    DcmDslProtocolRxAddrType = DCM_PHYSICAL_TYPE
                    DcmDslProtocolRxPduId = 2
                    DcmDslProtocolRxComMChannelRef = ComMConfigSet/CN_PCAN_RADAR_458ff0f1
                    DcmDslProtocolRxPduRef = PCAN_DIAG_REQ_PHYS_OBD1_oPCAN_RADAR_20_3bfe27fe_Rx
                  PCAN_DIAG_RESP_PHYS_OBD1_oPCAN_RADAR_20_f26199fd_Tx_55fbdb8d (DcmDslProtocolTx): DcmDslTxConfirmationPduId=0, DcmDslProtocolTxPduRef=EcucPduCollection/PCAN_DIAG_RESP_PHYS_OBD1_oPCAN_RADAR_20_f26199fd_Tx
              DC_0xF0BB_oRDR05_oPCAN_RADAR_FD_7258734b: variation-point=post-build-variant-condition{matching-criterion=RDR_POS, value=4}
                DC_0xF0BB_oRDR05_oPCAN_RADAR_FD_7258734b (DcmDslMainConnection): DcmDslProtocolRxTesterSourceAddr=240
                  PCAN_DIAG_REQ_FUNC_OBD1_oPCAN_RADAR_5664bded_Rx_f8c6c8a4 (DcmDslProtocolRx):
                    DcmDslProtocolRxAddrType = DCM_FUNCTIONAL_TYPE
                    DcmDslProtocolRxPduId = 4
                    DcmDslProtocolRxComMChannelRef = ComMConfigSet/CN_PCAN_RADAR_458ff0f1
                    DcmDslProtocolRxPduRef = PCAN_DIAG_REQ_FUNC_OBD1_oPCAN_RADAR_5664bded_Rx
                  PCAN_DIAG_REQ_PHYS_OBD1_oPCAN_RADAR_caf5eb16_Rx_95487f2b (DcmDslProtocolRx):
                    DcmDslProtocolRxAddrType = DCM_PHYSICAL_TYPE
                    DcmDslProtocolRxPduId = 5
                    DcmDslProtocolRxComMChannelRef = ComMConfigSet/CN_PCAN_RADAR_458ff0f1
                    DcmDslProtocolRxPduRef = PCAN_DIAG_REQ_PHYS_OBD1_oPCAN_RADAR_caf5eb16_Rx
                  PCAN_DIAG_RESP_PHYS_OBD1_oPCAN_RADAR_62c2ee1d_Tx_71c025ae (DcmDslProtocolTx): DcmDslTxConfirmationPduId=3, DcmDslProtocolTxPduRef=EcucPduCollection/PCAN_DIAG_RESP_PHYS_OBD1_oPCAN_RADAR_62c2ee1d_Tx
              DC_0xF0D0_oRDR05_oVCAN_RADAR_e57fa2cf: variation-point=post-build-variant-condition{matching-criterion=RDR_POS, value=4}
                DC_0xF0D0_oRDR05_oVCAN_RADAR_e57fa2cf (DcmDslMainConnection): DcmDslProtocolRxTesterSourceAddr=240
                  DIAG_REQ_FNC_OBD1_oVCAN_RADAR_ea4d23fb_Rx_4734fad9 (DcmDslProtocolRx):
                    DcmDslProtocolRxAddrType = DCM_FUNCTIONAL_TYPE
                    DcmDslProtocolRxPduId = 7
                    DcmDslProtocolRxComMChannelRef = ComMConfigSet/CN_VCAN_RADAR_489180b6
                    DcmDslProtocolRxPduRef = DIAG_REQ_FNC_OBD1_oVCAN_RADAR_ea4d23fb_Rx
                  FR_DIAG_REQ_PHY_OBD1_oVCAN_RADAR_83827d3f_Rx_a310dd11 (DcmDslProtocolRx):
                    DcmDslProtocolRxAddrType = DCM_PHYSICAL_TYPE
                    DcmDslProtocolRxPduId = 8
                    DcmDslProtocolRxComMChannelRef = ComMConfigSet/CN_VCAN_RADAR_489180b6
                    DcmDslProtocolRxPduRef = FR_DIAG_REQ_PHY_OBD1_oVCAN_RADAR_83827d3f_Rx
                  FR_DIAG_RES_PHY_OBD1_oVCAN_RADAR_add2b4bf_Tx_08033c95 (DcmDslProtocolTx): DcmDslTxConfirmationPduId=6, DcmDslProtocolTxPduRef=EcucPduCollection/FR_DIAG_RES_PHY_OBD1_oVCAN_RADAR_add2b4bf_Tx
              DC_0xF1BB_oRDR05_oPCAN_RADAR_0c789e3a: variation-point=post-build-variant-condition{matching-criterion=RDR_POS, value=4}
                DC_0xF1BB_oRDR05_oPCAN_RADAR_0c789e3a (DcmDslMainConnection): DcmDslProtocolRxTesterSourceAddr=241
                  PCAN_DIAG_REQ_FUNC_OBD2_oPCAN_RADAR_20_c04e56a1_Rx_a7582bb7 (DcmDslProtocolRx):
                    DcmDslProtocolRxAddrType = DCM_FUNCTIONAL_TYPE
                    DcmDslProtocolRxPduId = 10
                    DcmDslProtocolRxComMChannelRef = ComMConfigSet/CN_PCAN_RADAR_458ff0f1
                    DcmDslProtocolRxPduRef = PCAN_DIAG_REQ_FUNC_OBD2_oPCAN_RADAR_20_c04e56a1_Rx
                  PCAN_DIAG_REQ_PHYS_OBD2_oPCAN_RADAR_20_1236930c_Rx_26654501 (DcmDslProtocolRx):
                    DcmDslProtocolRxAddrType = DCM_PHYSICAL_TYPE
                    DcmDslProtocolRxPduId = 11
                    DcmDslProtocolRxComMChannelRef = ComMConfigSet/CN_PCAN_RADAR_458ff0f1
                    DcmDslProtocolRxPduRef = PCAN_DIAG_REQ_PHYS_OBD2_oPCAN_RADAR_20_1236930c_Rx
                  PCAN_DIAG_RESP_PHYS_OBD2_oPCAN_RADAR_20_dba92d0f_Tx_dcc6691a (DcmDslProtocolTx): DcmDslTxConfirmationPduId=9, DcmDslProtocolTxPduRef=EcucPduCollection/PCAN_DIAG_RESP_PHYS_OBD2_oPCAN_RADAR_20_dba92d0f_Tx
              DC_0xF1BB_oRDR05_oPCAN_RADAR_FD_d7d3e345: variation-point=post-build-variant-condition{matching-criterion=RDR_POS, value=4}
                DC_0xF1BB_oRDR05_oPCAN_RADAR_FD_d7d3e345 (DcmDslMainConnection): DcmDslProtocolRxTesterSourceAddr=241
                  PCAN_DIAG_REQ_FUNC_OBD2_oPCAN_RADAR_ebaed123_Rx_69afd2b8 (DcmDslProtocolRx):
                    DcmDslProtocolRxAddrType = DCM_FUNCTIONAL_TYPE
                    DcmDslProtocolRxPduId = 13
                    DcmDslProtocolRxComMChannelRef = ComMConfigSet/CN_PCAN_RADAR_458ff0f1
                    DcmDslProtocolRxPduRef = PCAN_DIAG_REQ_FUNC_OBD2_oPCAN_RADAR_ebaed123_Rx
                  PCAN_DIAG_REQ_PHYS_OBD2_oPCAN_RADAR_773f87d8_Rx_31c94776 (DcmDslProtocolRx):
                    DcmDslProtocolRxAddrType = DCM_PHYSICAL_TYPE
                    DcmDslProtocolRxPduId = 14
                    DcmDslProtocolRxComMChannelRef = ComMConfigSet/CN_PCAN_RADAR_458ff0f1
                    DcmDslProtocolRxPduRef = PCAN_DIAG_REQ_PHYS_OBD2_oPCAN_RADAR_773f87d8_Rx
                  PCAN_DIAG_RESP_PHYS_OBD2_oPCAN_RADAR_df0882d3_Tx_fbbf77c9 (DcmDslProtocolTx): DcmDslTxConfirmationPduId=12, DcmDslProtocolTxPduRef=EcucPduCollection/PCAN_DIAG_RESP_PHYS_OBD2_oPCAN_RADAR_df0882d3_Tx
              DC_0xF1D0_oRDR05_oVCAN_RADAR_f257c60f: variation-point=post-build-variant-condition{matching-criterion=RDR_POS, value=4}
                DC_0xF1D0_oRDR05_oVCAN_RADAR_f257c60f (DcmDslMainConnection): DcmDslProtocolRxTesterSourceAddr=241
                  DIAG_REQ_FNC_OBD2_oVCAN_RADAR_57874f35_Rx_1a4abb4e (DcmDslProtocolRx):
                    DcmDslProtocolRxAddrType = DCM_FUNCTIONAL_TYPE
                    DcmDslProtocolRxPduId = 16
                    DcmDslProtocolRxComMChannelRef = ComMConfigSet/CN_VCAN_RADAR_489180b6
                    DcmDslProtocolRxPduRef = DIAG_REQ_FNC_OBD2_oVCAN_RADAR_57874f35_Rx
                  FR_DIAG_REQ_PHY_OBD2_oVCAN_RADAR_3e4811f1_Rx_ef982e0b (DcmDslProtocolRx):
                    DcmDslProtocolRxAddrType = DCM_PHYSICAL_TYPE
                    DcmDslProtocolRxPduId = 17
                    DcmDslProtocolRxComMChannelRef = ComMConfigSet/CN_VCAN_RADAR_489180b6
                    DcmDslProtocolRxPduRef = FR_DIAG_REQ_PHY_OBD2_oVCAN_RADAR_3e4811f1_Rx
                  FR_DIAG_RES_PHY_OBD2_oVCAN_RADAR_1018d871_Tx_ee91ebc0 (DcmDslProtocolTx): DcmDslTxConfirmationPduId=15, DcmDslProtocolTxPduRef=EcucPduCollection/FR_DIAG_RES_PHY_OBD2_oVCAN_RADAR_1018d871_Tx
              DC_0xF4BB_oRDR05_oPCAN_RADAR_47f169fa: variation-point=post-build-variant-condition{matching-criterion=RDR_POS, value=4}
                DC_0xF4BB_oRDR05_oPCAN_RADAR_47f169fa (DcmDslMainConnection): DcmDslProtocolRxTesterSourceAddr=244
                  PCAN_DIAG_REQ_FUNC_OTA_oPCAN_RADAR_20_4ceedd9c_Rx_8d5a8781 (DcmDslProtocolRx):
                    DcmDslProtocolRxAddrType = DCM_FUNCTIONAL_TYPE
                    DcmDslProtocolRxPduId = 19
                    DcmDslProtocolRxComMChannelRef = ComMConfigSet/CN_PCAN_RADAR_458ff0f1
                    DcmDslProtocolRxPduRef = PCAN_DIAG_REQ_FUNC_OTA_oPCAN_RADAR_20_4ceedd9c_Rx
                  PCAN_DIAG_REQ_PHYS_OTA_oPCAN_RADAR_20_39ae8dba_Rx_fd38421b (DcmDslProtocolRx):
                    DcmDslProtocolRxAddrType = DCM_PHYSICAL_TYPE
                    DcmDslProtocolRxPduId = 20
                    DcmDslProtocolRxComMChannelRef = ComMConfigSet/CN_PCAN_RADAR_458ff0f1
                    DcmDslProtocolRxPduRef = PCAN_DIAG_REQ_PHYS_OTA_oPCAN_RADAR_20_39ae8dba_Rx
                  PCAN_DIAG_RESP_PHYS_OTA_oPCAN_RADAR_20_aa3008c9_Tx_74022f70 (DcmDslProtocolTx): DcmDslTxConfirmationPduId=18, DcmDslProtocolTxPduRef=EcucPduCollection/PCAN_DIAG_RESP_PHYS_OTA_oPCAN_RADAR_20_aa3008c9_Tx
              DC_0xF4BB_oRDR05_oPCAN_RADAR_FD_89e539b0: variation-point=post-build-variant-condition{matching-criterion=RDR_POS, value=4}
                DC_0xF4BB_oRDR05_oPCAN_RADAR_FD_89e539b0 (DcmDslMainConnection): DcmDslProtocolRxTesterSourceAddr=244
                  PCAN_DIAG_REQ_FUNC_OTA_oPCAN_RADAR_8729c499_Rx_63a44321 (DcmDslProtocolRx):
                    DcmDslProtocolRxAddrType = DCM_FUNCTIONAL_TYPE
                    DcmDslProtocolRxPduId = 22
                    DcmDslProtocolRxComMChannelRef = ComMConfigSet/CN_PCAN_RADAR_458ff0f1
                    DcmDslProtocolRxPduRef = PCAN_DIAG_REQ_FUNC_OTA_oPCAN_RADAR_8729c499_Rx
                  PCAN_DIAG_REQ_PHYS_OTA_oPCAN_RADAR_1f79965d_Rx_897b19f5 (DcmDslProtocolRx):
                    DcmDslProtocolRxAddrType = DCM_PHYSICAL_TYPE
                    DcmDslProtocolRxPduId = 23
                    DcmDslProtocolRxComMChannelRef = ComMConfigSet/CN_PCAN_RADAR_458ff0f1
                    DcmDslProtocolRxPduRef = PCAN_DIAG_REQ_PHYS_OTA_oPCAN_RADAR_1f79965d_Rx
                  PCAN_DIAG_RESP_PHYS_OTA_oPCAN_RADAR_4fa3c8f0_Tx_93c6c140 (DcmDslProtocolTx): DcmDslTxConfirmationPduId=21, DcmDslProtocolTxPduRef=EcucPduCollection/PCAN_DIAG_RESP_PHYS_OTA_oPCAN_RADAR_4fa3c8f0_Tx
              DC_0xF4D0_oRDR05_oVCAN_RADAR_b9de31cf: variation-point=post-build-variant-condition{matching-criterion=RDR_POS, value=4}
                DC_0xF4D0_oRDR05_oVCAN_RADAR_b9de31cf (DcmDslMainConnection): DcmDslProtocolRxTesterSourceAddr=244
                  DIAG_REQ_FNC_OTA_oVCAN_RADAR_b630c1e5_Rx_0176162e (DcmDslProtocolRx):
                    DcmDslProtocolRxAddrType = DCM_FUNCTIONAL_TYPE
                    DcmDslProtocolRxPduId = 25
                    DcmDslProtocolRxComMChannelRef = ComMConfigSet/CN_VCAN_RADAR_489180b6
                    DcmDslProtocolRxPduRef = DIAG_REQ_FNC_OTA_oVCAN_RADAR_b630c1e5_Rx
                  FR_DIAG_REQ_PHY_OTA_oVCAN_RADAR_7facfb76_Rx_b2eaa10c (DcmDslProtocolRx):
                    DcmDslProtocolRxAddrType = DCM_PHYSICAL_TYPE
                    DcmDslProtocolRxPduId = 26
                    DcmDslProtocolRxComMChannelRef = ComMConfigSet/CN_VCAN_RADAR_489180b6
                    DcmDslProtocolRxPduRef = FR_DIAG_REQ_PHY_OTA_oVCAN_RADAR_7facfb76_Rx
                  FR_DIAG_RES_PHY_OTA_oVCAN_RADAR_9b68fa0b_Tx_bc6c5974 (DcmDslProtocolTx): DcmDslTxConfirmationPduId=24, DcmDslProtocolTxPduRef=EcucPduCollection/FR_DIAG_RES_PHY_OTA_oVCAN_RADAR_9b68fa0b_Tx
              DC_0xF5BB_oRDR05_oPCAN_RADAR_50d90d3a: variation-point=post-build-variant-condition{matching-criterion=RDR_POS, value=4}
                DC_0xF5BB_oRDR05_oPCAN_RADAR_50d90d3a (DcmDslMainConnection): DcmDslProtocolRxTesterSourceAddr=245
                  PCAN_DIAG_REQ_FUNC_PLANT_oPCAN_RADAR_20_3b79581e_Rx_36801f1b (DcmDslProtocolRx):
                    DcmDslProtocolRxAddrType = DCM_FUNCTIONAL_TYPE
                    DcmDslProtocolRxPduId = 28
                    DcmDslProtocolRxComMChannelRef = ComMConfigSet/CN_PCAN_RADAR_458ff0f1
                    DcmDslProtocolRxPduRef = PCAN_DIAG_REQ_FUNC_PLANT_oPCAN_RADAR_20_3b79581e_Rx
                  PCAN_DIAG_REQ_PHYS_PLANT_oPCAN_RADAR_20_93ccff8e_Rx_c332e01f (DcmDslProtocolRx):
                    DcmDslProtocolRxAddrType = DCM_PHYSICAL_TYPE
                    DcmDslProtocolRxPduId = 29
                    DcmDslProtocolRxComMChannelRef = ComMConfigSet/CN_PCAN_RADAR_458ff0f1
                    DcmDslProtocolRxPduRef = PCAN_DIAG_REQ_PHYS_PLANT_oPCAN_RADAR_20_93ccff8e_Rx
                  PCAN_DIAG_RESP_PHYS_PLANT_oPCAN_RADAR_20_0a0c318a_Tx_b4cb0023 (DcmDslProtocolTx): DcmDslTxConfirmationPduId=27, DcmDslProtocolTxPduRef=EcucPduCollection/PCAN_DIAG_RESP_PHYS_PLANT_oPCAN_RADAR_20_0a0c318a_Tx
              DC_0xF5BB_oRDR05_oPCAN_RADAR_FD_2c6ea9be: variation-point=post-build-variant-condition{matching-criterion=RDR_POS, value=4}
                DC_0xF5BB_oRDR05_oPCAN_RADAR_FD_2c6ea9be (DcmDslMainConnection): DcmDslProtocolRxTesterSourceAddr=245
                  PCAN_DIAG_REQ_FUNC_PLANT_oPCAN_RADAR_8e17ec17_Rx_e2e07788 (DcmDslProtocolRx):
                    DcmDslProtocolRxAddrType = DCM_FUNCTIONAL_TYPE
                    DcmDslProtocolRxPduId = 31
                    DcmDslProtocolRxComMChannelRef = ComMConfigSet/CN_PCAN_RADAR_458ff0f1
                    DcmDslProtocolRxPduRef = PCAN_DIAG_REQ_FUNC_PLANT_oPCAN_RADAR_8e17ec17_Rx
                  PCAN_DIAG_REQ_PHYS_PLANT_oPCAN_RADAR_a4e456d5_Rx_de87c92a (DcmDslProtocolRx):
                    DcmDslProtocolRxAddrType = DCM_PHYSICAL_TYPE
                    DcmDslProtocolRxPduId = 32
                    DcmDslProtocolRxComMChannelRef = ComMConfigSet/CN_PCAN_RADAR_458ff0f1
                    DcmDslProtocolRxPduRef = PCAN_DIAG_REQ_PHYS_PLANT_oPCAN_RADAR_a4e456d5_Rx
                  PCAN_DIAG_RESP_PHYS_PLANT_oPCAN_RADAR_339eb858_Tx_b55bc933 (DcmDslProtocolTx): DcmDslTxConfirmationPduId=30, DcmDslProtocolTxPduRef=EcucPduCollection/PCAN_DIAG_RESP_PHYS_PLANT_oPCAN_RADAR_339eb858_Tx
              DC_0xF5D0_oRDR05_oVCAN_RADAR_aef6550f: variation-point=post-build-variant-condition{matching-criterion=RDR_POS, value=4}
                DC_0xF5D0_oRDR05_oVCAN_RADAR_aef6550f (DcmDslMainConnection): DcmDslProtocolRxTesterSourceAddr=245
                  DIAG_REQ_FNC_PLANT_oVCAN_RADAR_9fd4cadc_Rx_f47e2bb6 (DcmDslProtocolRx):
                    DcmDslProtocolRxAddrType = DCM_FUNCTIONAL_TYPE
                    DcmDslProtocolRxPduId = 34
                    DcmDslProtocolRxComMChannelRef = ComMConfigSet/CN_VCAN_RADAR_489180b6
                    DcmDslProtocolRxPduRef = DIAG_REQ_FNC_PLANT_oVCAN_RADAR_9fd4cadc_Rx
                  FR_DIAG_REQ_PHY_PLANT_oVCAN_RADAR_03b4032b_Rx_f4f84964 (DcmDslProtocolRx):
                    DcmDslProtocolRxAddrType = DCM_PHYSICAL_TYPE
                    DcmDslProtocolRxPduId = 35
                    DcmDslProtocolRxComMChannelRef = ComMConfigSet/CN_VCAN_RADAR_489180b6
                    DcmDslProtocolRxPduRef = FR_DIAG_REQ_PHY_PLANT_oVCAN_RADAR_03b4032b_Rx
                  FR_DIAG_RES_PHY_PLANT_oVCAN_RADAR_ee22d0c2_Tx_70415e78 (DcmDslProtocolTx): DcmDslTxConfirmationPduId=33, DcmDslProtocolTxPduRef=EcucPduCollection/FR_DIAG_RES_PHY_PLANT_oVCAN_RADAR_ee22d0c2_Tx
              DC_0xF0BB_oRDR06_oPCAN_RADAR_FD_5b90c7b9: variation-point=post-build-variant-condition{matching-criterion=RDR_POS, value=5}
                DC_0xF0BB_oRDR06_oPCAN_RADAR_FD_5b90c7b9 (DcmDslMainConnection): DcmDslProtocolRxTesterSourceAddr=240
                  PCAN_DIAG_REQ_FUNC_OBD1_oPCAN_RADAR_5664bded_Rx_f8c6c8a4 (DcmDslProtocolRx):
                    DcmDslProtocolRxAddrType = DCM_FUNCTIONAL_TYPE
                    DcmDslProtocolRxPduId = 1
                    DcmDslProtocolRxComMChannelRef = ComMConfigSet/CN_PCAN_RADAR_458ff0f1
                    DcmDslProtocolRxPduRef = PCAN_DIAG_REQ_FUNC_OBD1_oPCAN_RADAR_5664bded_Rx
                  PCAN_DIAG_REQ_PHYS_OBD1_oPCAN_RADAR_caf5eb16_Rx_95487f2b (DcmDslProtocolRx):
                    DcmDslProtocolRxAddrType = DCM_PHYSICAL_TYPE
                    DcmDslProtocolRxPduId = 2
                    DcmDslProtocolRxComMChannelRef = ComMConfigSet/CN_PCAN_RADAR_458ff0f1
                    DcmDslProtocolRxPduRef = PCAN_DIAG_REQ_PHYS_OBD1_oPCAN_RADAR_caf5eb16_Rx
                  PCAN_DIAG_RESP_PHYS_OBD1_oPCAN_RADAR_62c2ee1d_Tx_71c025ae (DcmDslProtocolTx): DcmDslTxConfirmationPduId=0, DcmDslProtocolTxPduRef=EcucPduCollection/PCAN_DIAG_RESP_PHYS_OBD1_oPCAN_RADAR_62c2ee1d_Tx
              DC_0xF0BB_oRDR06_oPCAN_RADAR_a69a9634: variation-point=post-build-variant-condition{matching-criterion=RDR_POS, value=5}
                DC_0xF0BB_oRDR06_oPCAN_RADAR_a69a9634 (DcmDslMainConnection): DcmDslProtocolRxTesterSourceAddr=240
                  PCAN_DIAG_REQ_FUNC_OBD1_oPCAN_RADAR_20_e986e253_Rx_5365c009 (DcmDslProtocolRx):
                    DcmDslProtocolRxAddrType = DCM_FUNCTIONAL_TYPE
                    DcmDslProtocolRxPduId = 4
                    DcmDslProtocolRxComMChannelRef = ComMConfigSet/CN_PCAN_RADAR_458ff0f1
                    DcmDslProtocolRxPduRef = PCAN_DIAG_REQ_FUNC_OBD1_oPCAN_RADAR_20_e986e253_Rx
                  PCAN_DIAG_REQ_PHYS_OBD1_oPCAN_RADAR_20_3bfe27fe_Rx_2d01fee8 (DcmDslProtocolRx):
                    DcmDslProtocolRxAddrType = DCM_PHYSICAL_TYPE
                    DcmDslProtocolRxPduId = 5
                    DcmDslProtocolRxComMChannelRef = ComMConfigSet/CN_PCAN_RADAR_458ff0f1
                    DcmDslProtocolRxPduRef = PCAN_DIAG_REQ_PHYS_OBD1_oPCAN_RADAR_20_3bfe27fe_Rx
                  PCAN_DIAG_RESP_PHYS_OBD1_oPCAN_RADAR_20_f26199fd_Tx_55fbdb8d (DcmDslProtocolTx): DcmDslTxConfirmationPduId=3, DcmDslProtocolTxPduRef=EcucPduCollection/PCAN_DIAG_RESP_PHYS_OBD1_oPCAN_RADAR_20_f26199fd_Tx
              DC_0xF0D0_oRDR06_oVCAN_RADAR_58b5ce01: variation-point=post-build-variant-condition{matching-criterion=RDR_POS, value=5}
                DC_0xF0D0_oRDR06_oVCAN_RADAR_58b5ce01 (DcmDslMainConnection): DcmDslProtocolRxTesterSourceAddr=240
                  DIAG_REQ_FNC_OBD1_oVCAN_RADAR_ea4d23fb_Rx_4734fad9 (DcmDslProtocolRx):
                    DcmDslProtocolRxAddrType = DCM_FUNCTIONAL_TYPE
                    DcmDslProtocolRxPduId = 7
                    DcmDslProtocolRxComMChannelRef = ComMConfigSet/CN_VCAN_RADAR_489180b6
                    DcmDslProtocolRxPduRef = DIAG_REQ_FNC_OBD1_oVCAN_RADAR_ea4d23fb_Rx
                  FR_DIAG_REQ_PHY_OBD1_oVCAN_RADAR_83827d3f_Rx_a310dd11 (DcmDslProtocolRx):
                    DcmDslProtocolRxAddrType = DCM_PHYSICAL_TYPE
                    DcmDslProtocolRxPduId = 8
                    DcmDslProtocolRxComMChannelRef = ComMConfigSet/CN_VCAN_RADAR_489180b6
                    DcmDslProtocolRxPduRef = FR_DIAG_REQ_PHY_OBD1_oVCAN_RADAR_83827d3f_Rx
                  FR_DIAG_RES_PHY_OBD1_oVCAN_RADAR_add2b4bf_Tx_08033c95 (DcmDslProtocolTx): DcmDslTxConfirmationPduId=6, DcmDslProtocolTxPduRef=EcucPduCollection/FR_DIAG_RES_PHY_OBD1_oVCAN_RADAR_add2b4bf_Tx
              DC_0xF1BB_oRDR06_oPCAN_RADAR_FD_fe1b57b7: variation-point=post-build-variant-condition{matching-criterion=RDR_POS, value=5}
                DC_0xF1BB_oRDR06_oPCAN_RADAR_FD_fe1b57b7 (DcmDslMainConnection): DcmDslProtocolRxTesterSourceAddr=241
                  PCAN_DIAG_REQ_FUNC_OBD2_oPCAN_RADAR_ebaed123_Rx_69afd2b8 (DcmDslProtocolRx):
                    DcmDslProtocolRxAddrType = DCM_FUNCTIONAL_TYPE
                    DcmDslProtocolRxPduId = 10
                    DcmDslProtocolRxComMChannelRef = ComMConfigSet/CN_PCAN_RADAR_458ff0f1
                    DcmDslProtocolRxPduRef = PCAN_DIAG_REQ_FUNC_OBD2_oPCAN_RADAR_ebaed123_Rx
                  PCAN_DIAG_REQ_PHYS_OBD2_oPCAN_RADAR_773f87d8_Rx_31c94776 (DcmDslProtocolRx):
                    DcmDslProtocolRxAddrType = DCM_PHYSICAL_TYPE
                    DcmDslProtocolRxPduId = 11
                    DcmDslProtocolRxComMChannelRef = ComMConfigSet/CN_PCAN_RADAR_458ff0f1
                    DcmDslProtocolRxPduRef = PCAN_DIAG_REQ_PHYS_OBD2_oPCAN_RADAR_773f87d8_Rx
                  PCAN_DIAG_RESP_PHYS_OBD2_oPCAN_RADAR_df0882d3_Tx_fbbf77c9 (DcmDslProtocolTx): DcmDslTxConfirmationPduId=9, DcmDslProtocolTxPduRef=EcucPduCollection/PCAN_DIAG_RESP_PHYS_OBD2_oPCAN_RADAR_df0882d3_Tx
              DC_0xF1BB_oRDR06_oPCAN_RADAR_b1b2f2f4: variation-point=post-build-variant-condition{matching-criterion=RDR_POS, value=5}
                DC_0xF1BB_oRDR06_oPCAN_RADAR_b1b2f2f4 (DcmDslMainConnection): DcmDslProtocolRxTesterSourceAddr=241
                  PCAN_DIAG_REQ_FUNC_OBD2_oPCAN_RADAR_20_c04e56a1_Rx_a7582bb7 (DcmDslProtocolRx):
                    DcmDslProtocolRxAddrType = DCM_FUNCTIONAL_TYPE
                    DcmDslProtocolRxPduId = 13
                    DcmDslProtocolRxComMChannelRef = ComMConfigSet/CN_PCAN_RADAR_458ff0f1
                    DcmDslProtocolRxPduRef = PCAN_DIAG_REQ_FUNC_OBD2_oPCAN_RADAR_20_c04e56a1_Rx
                  PCAN_DIAG_REQ_PHYS_OBD2_oPCAN_RADAR_20_1236930c_Rx_26654501 (DcmDslProtocolRx):
                    DcmDslProtocolRxAddrType = DCM_PHYSICAL_TYPE
                    DcmDslProtocolRxPduId = 14
                    DcmDslProtocolRxComMChannelRef = ComMConfigSet/CN_PCAN_RADAR_458ff0f1
                    DcmDslProtocolRxPduRef = PCAN_DIAG_REQ_PHYS_OBD2_oPCAN_RADAR_20_1236930c_Rx
                  PCAN_DIAG_RESP_PHYS_OBD2_oPCAN_RADAR_20_dba92d0f_Tx_dcc6691a (DcmDslProtocolTx): DcmDslTxConfirmationPduId=12, DcmDslProtocolTxPduRef=EcucPduCollection/PCAN_DIAG_RESP_PHYS_OBD2_oPCAN_RADAR_20_dba92d0f_Tx
              DC_0xF1D0_oRDR06_oVCAN_RADAR_4f9daac1: variation-point=post-build-variant-condition{matching-criterion=RDR_POS, value=5}
                DC_0xF1D0_oRDR06_oVCAN_RADAR_4f9daac1 (DcmDslMainConnection): DcmDslProtocolRxTesterSourceAddr=241
                  DIAG_REQ_FNC_OBD2_oVCAN_RADAR_57874f35_Rx_1a4abb4e (DcmDslProtocolRx):
                    DcmDslProtocolRxAddrType = DCM_FUNCTIONAL_TYPE
                    DcmDslProtocolRxPduId = 16
                    DcmDslProtocolRxComMChannelRef = ComMConfigSet/CN_VCAN_RADAR_489180b6
                    DcmDslProtocolRxPduRef = DIAG_REQ_FNC_OBD2_oVCAN_RADAR_57874f35_Rx
                  FR_DIAG_REQ_PHY_OBD2_oVCAN_RADAR_3e4811f1_Rx_ef982e0b (DcmDslProtocolRx):
                    DcmDslProtocolRxAddrType = DCM_PHYSICAL_TYPE
                    DcmDslProtocolRxPduId = 17
                    DcmDslProtocolRxComMChannelRef = ComMConfigSet/CN_VCAN_RADAR_489180b6
                    DcmDslProtocolRxPduRef = FR_DIAG_REQ_PHY_OBD2_oVCAN_RADAR_3e4811f1_Rx
                  FR_DIAG_RES_PHY_OBD2_oVCAN_RADAR_1018d871_Tx_ee91ebc0 (DcmDslProtocolTx): DcmDslTxConfirmationPduId=15, DcmDslProtocolTxPduRef=EcucPduCollection/FR_DIAG_RES_PHY_OBD2_oVCAN_RADAR_1018d871_Tx
              DC_0xF4BB_oRDR06_oPCAN_RADAR_FD_a02d8d42: variation-point=post-build-variant-condition{matching-criterion=RDR_POS, value=5}
                DC_0xF4BB_oRDR06_oPCAN_RADAR_FD_a02d8d42 (DcmDslMainConnection): DcmDslProtocolRxTesterSourceAddr=244
                  PCAN_DIAG_REQ_FUNC_OTA_oPCAN_RADAR_8729c499_Rx_63a44321 (DcmDslProtocolRx):
                    DcmDslProtocolRxAddrType = DCM_FUNCTIONAL_TYPE
                    DcmDslProtocolRxPduId = 19
                    DcmDslProtocolRxComMChannelRef = ComMConfigSet/CN_PCAN_RADAR_458ff0f1
                    DcmDslProtocolRxPduRef = PCAN_DIAG_REQ_FUNC_OTA_oPCAN_RADAR_8729c499_Rx
                  PCAN_DIAG_REQ_PHYS_OTA_oPCAN_RADAR_1f79965d_Rx_897b19f5 (DcmDslProtocolRx):
                    DcmDslProtocolRxAddrType = DCM_PHYSICAL_TYPE
                    DcmDslProtocolRxPduId = 20
                    DcmDslProtocolRxComMChannelRef = ComMConfigSet/CN_PCAN_RADAR_458ff0f1
                    DcmDslProtocolRxPduRef = PCAN_DIAG_REQ_PHYS_OTA_oPCAN_RADAR_1f79965d_Rx
                  PCAN_DIAG_RESP_PHYS_OTA_oPCAN_RADAR_4fa3c8f0_Tx_93c6c140 (DcmDslProtocolTx): DcmDslTxConfirmationPduId=18, DcmDslProtocolTxPduRef=EcucPduCollection/PCAN_DIAG_RESP_PHYS_OTA_oPCAN_RADAR_4fa3c8f0_Tx
              DC_0xF4BB_oRDR06_oPCAN_RADAR_fa3b0534: variation-point=post-build-variant-condition{matching-criterion=RDR_POS, value=5}
                DC_0xF4BB_oRDR06_oPCAN_RADAR_fa3b0534 (DcmDslMainConnection): DcmDslProtocolRxTesterSourceAddr=244
                  PCAN_DIAG_REQ_FUNC_OTA_oPCAN_RADAR_20_4ceedd9c_Rx_8d5a8781 (DcmDslProtocolRx):
                    DcmDslProtocolRxAddrType = DCM_FUNCTIONAL_TYPE
                    DcmDslProtocolRxPduId = 22
                    DcmDslProtocolRxComMChannelRef = ComMConfigSet/CN_PCAN_RADAR_458ff0f1
                    DcmDslProtocolRxPduRef = PCAN_DIAG_REQ_FUNC_OTA_oPCAN_RADAR_20_4ceedd9c_Rx
                  PCAN_DIAG_REQ_PHYS_OTA_oPCAN_RADAR_20_39ae8dba_Rx_fd38421b (DcmDslProtocolRx):
                    DcmDslProtocolRxAddrType = DCM_PHYSICAL_TYPE
                    DcmDslProtocolRxPduId = 23
                    DcmDslProtocolRxComMChannelRef = ComMConfigSet/CN_PCAN_RADAR_458ff0f1
                    DcmDslProtocolRxPduRef = PCAN_DIAG_REQ_PHYS_OTA_oPCAN_RADAR_20_39ae8dba_Rx
                  PCAN_DIAG_RESP_PHYS_OTA_oPCAN_RADAR_20_aa3008c9_Tx_74022f70 (DcmDslProtocolTx): DcmDslTxConfirmationPduId=21, DcmDslProtocolTxPduRef=EcucPduCollection/PCAN_DIAG_RESP_PHYS_OTA_oPCAN_RADAR_20_aa3008c9_Tx
              DC_0xF4D0_oRDR06_oVCAN_RADAR_04145d01: variation-point=post-build-variant-condition{matching-criterion=RDR_POS, value=5}
                DC_0xF4D0_oRDR06_oVCAN_RADAR_04145d01 (DcmDslMainConnection): DcmDslProtocolRxTesterSourceAddr=244
                  DIAG_REQ_FNC_OTA_oVCAN_RADAR_b630c1e5_Rx_0176162e (DcmDslProtocolRx):
                    DcmDslProtocolRxAddrType = DCM_FUNCTIONAL_TYPE
                    DcmDslProtocolRxPduId = 25
                    DcmDslProtocolRxComMChannelRef = ComMConfigSet/CN_VCAN_RADAR_489180b6
                    DcmDslProtocolRxPduRef = DIAG_REQ_FNC_OTA_oVCAN_RADAR_b630c1e5_Rx
                  FR_DIAG_REQ_PHY_OTA_oVCAN_RADAR_7facfb76_Rx_b2eaa10c (DcmDslProtocolRx):
                    DcmDslProtocolRxAddrType = DCM_PHYSICAL_TYPE
                    DcmDslProtocolRxPduId = 26
                    DcmDslProtocolRxComMChannelRef = ComMConfigSet/CN_VCAN_RADAR_489180b6
                    DcmDslProtocolRxPduRef = FR_DIAG_REQ_PHY_OTA_oVCAN_RADAR_7facfb76_Rx
                  FR_DIAG_RES_PHY_OTA_oVCAN_RADAR_9b68fa0b_Tx_bc6c5974 (DcmDslProtocolTx): DcmDslTxConfirmationPduId=24, DcmDslProtocolTxPduRef=EcucPduCollection/FR_DIAG_RES_PHY_OTA_oVCAN_RADAR_9b68fa0b_Tx
              DC_0xF5BB_oRDR06_oPCAN_RADAR_FD_05a61d4c: variation-point=post-build-variant-condition{matching-criterion=RDR_POS, value=5}
                DC_0xF5BB_oRDR06_oPCAN_RADAR_FD_05a61d4c (DcmDslMainConnection): DcmDslProtocolRxTesterSourceAddr=245
                  PCAN_DIAG_REQ_FUNC_PLANT_oPCAN_RADAR_8e17ec17_Rx_e2e07788 (DcmDslProtocolRx):
                    DcmDslProtocolRxAddrType = DCM_FUNCTIONAL_TYPE
                    DcmDslProtocolRxPduId = 28
                    DcmDslProtocolRxComMChannelRef = ComMConfigSet/CN_PCAN_RADAR_458ff0f1
                    DcmDslProtocolRxPduRef = PCAN_DIAG_REQ_FUNC_PLANT_oPCAN_RADAR_8e17ec17_Rx
                  PCAN_DIAG_REQ_PHYS_PLANT_oPCAN_RADAR_a4e456d5_Rx_de87c92a (DcmDslProtocolRx):
                    DcmDslProtocolRxAddrType = DCM_PHYSICAL_TYPE
                    DcmDslProtocolRxPduId = 29
                    DcmDslProtocolRxComMChannelRef = ComMConfigSet/CN_PCAN_RADAR_458ff0f1
                    DcmDslProtocolRxPduRef = PCAN_DIAG_REQ_PHYS_PLANT_oPCAN_RADAR_a4e456d5_Rx
                  PCAN_DIAG_RESP_PHYS_PLANT_oPCAN_RADAR_339eb858_Tx_b55bc933 (DcmDslProtocolTx): DcmDslTxConfirmationPduId=27, DcmDslProtocolTxPduRef=EcucPduCollection/PCAN_DIAG_RESP_PHYS_PLANT_oPCAN_RADAR_339eb858_Tx
              DC_0xF5BB_oRDR06_oPCAN_RADAR_ed1361f4: variation-point=post-build-variant-condition{matching-criterion=RDR_POS, value=5}
                DC_0xF5BB_oRDR06_oPCAN_RADAR_ed1361f4 (DcmDslMainConnection): DcmDslProtocolRxTesterSourceAddr=245
                  PCAN_DIAG_REQ_FUNC_PLANT_oPCAN_RADAR_20_3b79581e_Rx_36801f1b (DcmDslProtocolRx):
                    DcmDslProtocolRxAddrType = DCM_FUNCTIONAL_TYPE
                    DcmDslProtocolRxPduId = 31
                    DcmDslProtocolRxComMChannelRef = ComMConfigSet/CN_PCAN_RADAR_458ff0f1
                    DcmDslProtocolRxPduRef = PCAN_DIAG_REQ_FUNC_PLANT_oPCAN_RADAR_20_3b79581e_Rx
                  PCAN_DIAG_REQ_PHYS_PLANT_oPCAN_RADAR_20_93ccff8e_Rx_c332e01f (DcmDslProtocolRx):
                    DcmDslProtocolRxAddrType = DCM_PHYSICAL_TYPE
                    DcmDslProtocolRxPduId = 32
                    DcmDslProtocolRxComMChannelRef = ComMConfigSet/CN_PCAN_RADAR_458ff0f1
                    DcmDslProtocolRxPduRef = PCAN_DIAG_REQ_PHYS_PLANT_oPCAN_RADAR_20_93ccff8e_Rx
                  PCAN_DIAG_RESP_PHYS_PLANT_oPCAN_RADAR_20_0a0c318a_Tx_b4cb0023 (DcmDslProtocolTx): DcmDslTxConfirmationPduId=30, DcmDslProtocolTxPduRef=EcucPduCollection/PCAN_DIAG_RESP_PHYS_PLANT_oPCAN_RADAR_20_0a0c318a_Tx
              DC_0xF5D0_oRDR06_oVCAN_RADAR_133c39c1: variation-point=post-build-variant-condition{matching-criterion=RDR_POS, value=5}
                DC_0xF5D0_oRDR06_oVCAN_RADAR_133c39c1 (DcmDslMainConnection): DcmDslProtocolRxTesterSourceAddr=245
                  DIAG_REQ_FNC_PLANT_oVCAN_RADAR_9fd4cadc_Rx_f47e2bb6 (DcmDslProtocolRx):
                    DcmDslProtocolRxAddrType = DCM_FUNCTIONAL_TYPE
                    DcmDslProtocolRxPduId = 34
                    DcmDslProtocolRxComMChannelRef = ComMConfigSet/CN_VCAN_RADAR_489180b6
                    DcmDslProtocolRxPduRef = DIAG_REQ_FNC_PLANT_oVCAN_RADAR_9fd4cadc_Rx
                  FR_DIAG_REQ_PHY_PLANT_oVCAN_RADAR_03b4032b_Rx_f4f84964 (DcmDslProtocolRx):
                    DcmDslProtocolRxAddrType = DCM_PHYSICAL_TYPE
                    DcmDslProtocolRxPduId = 35
                    DcmDslProtocolRxComMChannelRef = ComMConfigSet/CN_VCAN_RADAR_489180b6
                    DcmDslProtocolRxPduRef = FR_DIAG_REQ_PHY_PLANT_oVCAN_RADAR_03b4032b_Rx
                  FR_DIAG_RES_PHY_PLANT_oVCAN_RADAR_ee22d0c2_Tx_70415e78 (DcmDslProtocolTx): DcmDslTxConfirmationPduId=33, DcmDslProtocolTxPduRef=EcucPduCollection/FR_DIAG_RES_PHY_PLANT_oVCAN_RADAR_ee22d0c2_Tx
              DC_0xF0BB_oRDR07_oPCAN_RADAR_7b0c4fb1: variation-point=post-build-variant-condition{matching-criterion=RDR_POS, value=6}
                DC_0xF0BB_oRDR07_oPCAN_RADAR_7b0c4fb1 (DcmDslMainConnection): DcmDslProtocolRxTesterSourceAddr=240
                  PCAN_DIAG_REQ_FUNC_OBD1_oPCAN_RADAR_20_e986e253_Rx_5365c009 (DcmDslProtocolRx):
                    DcmDslProtocolRxAddrType = DCM_FUNCTIONAL_TYPE
                    DcmDslProtocolRxPduId = 1
                    DcmDslProtocolRxComMChannelRef = ComMConfigSet/CN_PCAN_RADAR_458ff0f1
                    DcmDslProtocolRxPduRef = PCAN_DIAG_REQ_FUNC_OBD1_oPCAN_RADAR_20_e986e253_Rx
                  PCAN_DIAG_REQ_PHYS_OBD1_oPCAN_RADAR_20_3bfe27fe_Rx_2d01fee8 (DcmDslProtocolRx):
                    DcmDslProtocolRxAddrType = DCM_PHYSICAL_TYPE
                    DcmDslProtocolRxPduId = 2
                    DcmDslProtocolRxComMChannelRef = ComMConfigSet/CN_PCAN_RADAR_458ff0f1
                    DcmDslProtocolRxPduRef = PCAN_DIAG_REQ_PHYS_OBD1_oPCAN_RADAR_20_3bfe27fe_Rx
                  PCAN_DIAG_RESP_PHYS_OBD1_oPCAN_RADAR_20_f26199fd_Tx_55fbdb8d (DcmDslProtocolTx): DcmDslTxConfirmationPduId=0, DcmDslProtocolTxPduRef=EcucPduCollection/PCAN_DIAG_RESP_PHYS_OBD1_oPCAN_RADAR_20_f26199fd_Tx
              DC_0xF0BB_oRDR07_oPCAN_RADAR_FD_f5f85628: variation-point=post-build-variant-condition{matching-criterion=RDR_POS, value=6}
                DC_0xF0BB_oRDR07_oPCAN_RADAR_FD_f5f85628 (DcmDslMainConnection): DcmDslProtocolRxTesterSourceAddr=240
                  PCAN_DIAG_REQ_FUNC_OBD1_oPCAN_RADAR_5664bded_Rx_f8c6c8a4 (DcmDslProtocolRx):
                    DcmDslProtocolRxAddrType = DCM_FUNCTIONAL_TYPE
                    DcmDslProtocolRxPduId = 4
                    DcmDslProtocolRxComMChannelRef = ComMConfigSet/CN_PCAN_RADAR_458ff0f1
                    DcmDslProtocolRxPduRef = PCAN_DIAG_REQ_FUNC_OBD1_oPCAN_RADAR_5664bded_Rx
                  PCAN_DIAG_REQ_PHYS_OBD1_oPCAN_RADAR_caf5eb16_Rx_95487f2b (DcmDslProtocolRx):
                    DcmDslProtocolRxAddrType = DCM_PHYSICAL_TYPE
                    DcmDslProtocolRxPduId = 5
                    DcmDslProtocolRxComMChannelRef = ComMConfigSet/CN_PCAN_RADAR_458ff0f1
                    DcmDslProtocolRxPduRef = PCAN_DIAG_REQ_PHYS_OBD1_oPCAN_RADAR_caf5eb16_Rx
                  PCAN_DIAG_RESP_PHYS_OBD1_oPCAN_RADAR_62c2ee1d_Tx_71c025ae (DcmDslProtocolTx): DcmDslTxConfirmationPduId=3, DcmDslProtocolTxPduRef=EcucPduCollection/PCAN_DIAG_RESP_PHYS_OBD1_oPCAN_RADAR_62c2ee1d_Tx
              DC_0xF0D0_oRDR07_oVCAN_RADAR_85231784: variation-point=post-build-variant-condition{matching-criterion=RDR_POS, value=6}
                DC_0xF0D0_oRDR07_oVCAN_RADAR_85231784 (DcmDslMainConnection): DcmDslProtocolRxTesterSourceAddr=240
                  DIAG_REQ_FNC_OBD1_oVCAN_RADAR_ea4d23fb_Rx_4734fad9 (DcmDslProtocolRx):
                    DcmDslProtocolRxAddrType = DCM_FUNCTIONAL_TYPE
                    DcmDslProtocolRxPduId = 7
                    DcmDslProtocolRxComMChannelRef = ComMConfigSet/CN_VCAN_RADAR_489180b6
                    DcmDslProtocolRxPduRef = DIAG_REQ_FNC_OBD1_oVCAN_RADAR_ea4d23fb_Rx
                  FR_DIAG_REQ_PHY_OBD1_oVCAN_RADAR_83827d3f_Rx_a310dd11 (DcmDslProtocolRx):
                    DcmDslProtocolRxAddrType = DCM_PHYSICAL_TYPE
                    DcmDslProtocolRxPduId = 8
                    DcmDslProtocolRxComMChannelRef = ComMConfigSet/CN_VCAN_RADAR_489180b6
                    DcmDslProtocolRxPduRef = FR_DIAG_REQ_PHY_OBD1_oVCAN_RADAR_83827d3f_Rx
                  FR_DIAG_RES_PHY_OBD1_oVCAN_RADAR_add2b4bf_Tx_08033c95 (DcmDslProtocolTx): DcmDslTxConfirmationPduId=6, DcmDslProtocolTxPduRef=EcucPduCollection/FR_DIAG_RES_PHY_OBD1_oVCAN_RADAR_add2b4bf_Tx
              DC_0xF1BB_oRDR07_oPCAN_RADAR_6c242b71: variation-point=post-build-variant-condition{matching-criterion=RDR_POS, value=6}
                DC_0xF1BB_oRDR07_oPCAN_RADAR_6c242b71 (DcmDslMainConnection): DcmDslProtocolRxTesterSourceAddr=241
                  PCAN_DIAG_REQ_FUNC_OBD2_oPCAN_RADAR_20_c04e56a1_Rx_a7582bb7 (DcmDslProtocolRx):
                    DcmDslProtocolRxAddrType = DCM_FUNCTIONAL_TYPE
                    DcmDslProtocolRxPduId = 10
                    DcmDslProtocolRxComMChannelRef = ComMConfigSet/CN_PCAN_RADAR_458ff0f1
                    DcmDslProtocolRxPduRef = PCAN_DIAG_REQ_FUNC_OBD2_oPCAN_RADAR_20_c04e56a1_Rx
                  PCAN_DIAG_REQ_PHYS_OBD2_oPCAN_RADAR_20_1236930c_Rx_26654501 (DcmDslProtocolRx):
                    DcmDslProtocolRxAddrType = DCM_PHYSICAL_TYPE
                    DcmDslProtocolRxPduId = 11
                    DcmDslProtocolRxComMChannelRef = ComMConfigSet/CN_PCAN_RADAR_458ff0f1
                    DcmDslProtocolRxPduRef = PCAN_DIAG_REQ_PHYS_OBD2_oPCAN_RADAR_20_1236930c_Rx
                  PCAN_DIAG_RESP_PHYS_OBD2_oPCAN_RADAR_20_dba92d0f_Tx_dcc6691a (DcmDslProtocolTx): DcmDslTxConfirmationPduId=9, DcmDslProtocolTxPduRef=EcucPduCollection/PCAN_DIAG_RESP_PHYS_OBD2_oPCAN_RADAR_20_dba92d0f_Tx
              DC_0xF1BB_oRDR07_oPCAN_RADAR_FD_5073c626: variation-point=post-build-variant-condition{matching-criterion=RDR_POS, value=6}
                DC_0xF1BB_oRDR07_oPCAN_RADAR_FD_5073c626 (DcmDslMainConnection): DcmDslProtocolRxTesterSourceAddr=241
                  PCAN_DIAG_REQ_FUNC_OBD2_oPCAN_RADAR_ebaed123_Rx_69afd2b8 (DcmDslProtocolRx):
                    DcmDslProtocolRxAddrType = DCM_FUNCTIONAL_TYPE
                    DcmDslProtocolRxPduId = 13
                    DcmDslProtocolRxComMChannelRef = ComMConfigSet/CN_PCAN_RADAR_458ff0f1
                    DcmDslProtocolRxPduRef = PCAN_DIAG_REQ_FUNC_OBD2_oPCAN_RADAR_ebaed123_Rx
                  PCAN_DIAG_REQ_PHYS_OBD2_oPCAN_RADAR_773f87d8_Rx_31c94776 (DcmDslProtocolRx):
                    DcmDslProtocolRxAddrType = DCM_PHYSICAL_TYPE
                    DcmDslProtocolRxPduId = 14
                    DcmDslProtocolRxComMChannelRef = ComMConfigSet/CN_PCAN_RADAR_458ff0f1
                    DcmDslProtocolRxPduRef = PCAN_DIAG_REQ_PHYS_OBD2_oPCAN_RADAR_773f87d8_Rx
                  PCAN_DIAG_RESP_PHYS_OBD2_oPCAN_RADAR_df0882d3_Tx_fbbf77c9 (DcmDslProtocolTx): DcmDslTxConfirmationPduId=12, DcmDslProtocolTxPduRef=EcucPduCollection/PCAN_DIAG_RESP_PHYS_OBD2_oPCAN_RADAR_df0882d3_Tx
              DC_0xF1D0_oRDR07_oVCAN_RADAR_920b7344: variation-point=post-build-variant-condition{matching-criterion=RDR_POS, value=6}
                DC_0xF1D0_oRDR07_oVCAN_RADAR_920b7344 (DcmDslMainConnection): DcmDslProtocolRxTesterSourceAddr=241
                  DIAG_REQ_FNC_OBD2_oVCAN_RADAR_57874f35_Rx_1a4abb4e (DcmDslProtocolRx):
                    DcmDslProtocolRxAddrType = DCM_FUNCTIONAL_TYPE
                    DcmDslProtocolRxPduId = 16
                    DcmDslProtocolRxComMChannelRef = ComMConfigSet/CN_VCAN_RADAR_489180b6
                    DcmDslProtocolRxPduRef = DIAG_REQ_FNC_OBD2_oVCAN_RADAR_57874f35_Rx
                  FR_DIAG_REQ_PHY_OBD2_oVCAN_RADAR_3e4811f1_Rx_ef982e0b (DcmDslProtocolRx):
                    DcmDslProtocolRxAddrType = DCM_PHYSICAL_TYPE
                    DcmDslProtocolRxPduId = 17
                    DcmDslProtocolRxComMChannelRef = ComMConfigSet/CN_VCAN_RADAR_489180b6
                    DcmDslProtocolRxPduRef = FR_DIAG_REQ_PHY_OBD2_oVCAN_RADAR_3e4811f1_Rx
                  FR_DIAG_RES_PHY_OBD2_oVCAN_RADAR_1018d871_Tx_ee91ebc0 (DcmDslProtocolTx): DcmDslTxConfirmationPduId=15, DcmDslProtocolTxPduRef=EcucPduCollection/FR_DIAG_RES_PHY_OBD2_oVCAN_RADAR_1018d871_Tx
              DC_0xF4BB_oRDR07_oPCAN_RADAR_27addcb1: variation-point=post-build-variant-condition{matching-criterion=RDR_POS, value=6}
                DC_0xF4BB_oRDR07_oPCAN_RADAR_27addcb1 (DcmDslMainConnection): DcmDslProtocolRxTesterSourceAddr=244
                  PCAN_DIAG_REQ_FUNC_OTA_oPCAN_RADAR_20_4ceedd9c_Rx_8d5a8781 (DcmDslProtocolRx):
                    DcmDslProtocolRxAddrType = DCM_FUNCTIONAL_TYPE
                    DcmDslProtocolRxPduId = 19
                    DcmDslProtocolRxComMChannelRef = ComMConfigSet/CN_PCAN_RADAR_458ff0f1
                    DcmDslProtocolRxPduRef = PCAN_DIAG_REQ_FUNC_OTA_oPCAN_RADAR_20_4ceedd9c_Rx
                  PCAN_DIAG_REQ_PHYS_OTA_oPCAN_RADAR_20_39ae8dba_Rx_fd38421b (DcmDslProtocolRx):
                    DcmDslProtocolRxAddrType = DCM_PHYSICAL_TYPE
                    DcmDslProtocolRxPduId = 20
                    DcmDslProtocolRxComMChannelRef = ComMConfigSet/CN_PCAN_RADAR_458ff0f1
                    DcmDslProtocolRxPduRef = PCAN_DIAG_REQ_PHYS_OTA_oPCAN_RADAR_20_39ae8dba_Rx
                  PCAN_DIAG_RESP_PHYS_OTA_oPCAN_RADAR_20_aa3008c9_Tx_74022f70 (DcmDslProtocolTx): DcmDslTxConfirmationPduId=18, DcmDslProtocolTxPduRef=EcucPduCollection/PCAN_DIAG_RESP_PHYS_OTA_oPCAN_RADAR_20_aa3008c9_Tx
              DC_0xF4BB_oRDR07_oPCAN_RADAR_FD_0e451cd3: variation-point=post-build-variant-condition{matching-criterion=RDR_POS, value=6}
                DC_0xF4BB_oRDR07_oPCAN_RADAR_FD_0e451cd3 (DcmDslMainConnection): DcmDslProtocolRxTesterSourceAddr=244
                  PCAN_DIAG_REQ_FUNC_OTA_oPCAN_RADAR_8729c499_Rx_63a44321 (DcmDslProtocolRx):
                    DcmDslProtocolRxAddrType = DCM_FUNCTIONAL_TYPE
                    DcmDslProtocolRxPduId = 22
                    DcmDslProtocolRxComMChannelRef = ComMConfigSet/CN_PCAN_RADAR_458ff0f1
                    DcmDslProtocolRxPduRef = PCAN_DIAG_REQ_FUNC_OTA_oPCAN_RADAR_8729c499_Rx
                  PCAN_DIAG_REQ_PHYS_OTA_oPCAN_RADAR_1f79965d_Rx_897b19f5 (DcmDslProtocolRx):
                    DcmDslProtocolRxAddrType = DCM_PHYSICAL_TYPE
                    DcmDslProtocolRxPduId = 23
                    DcmDslProtocolRxComMChannelRef = ComMConfigSet/CN_PCAN_RADAR_458ff0f1
                    DcmDslProtocolRxPduRef = PCAN_DIAG_REQ_PHYS_OTA_oPCAN_RADAR_1f79965d_Rx
                  PCAN_DIAG_RESP_PHYS_OTA_oPCAN_RADAR_4fa3c8f0_Tx_93c6c140 (DcmDslProtocolTx): DcmDslTxConfirmationPduId=21, DcmDslProtocolTxPduRef=EcucPduCollection/PCAN_DIAG_RESP_PHYS_OTA_oPCAN_RADAR_4fa3c8f0_Tx
              DC_0xF4D0_oRDR07_oVCAN_RADAR_d9828484: variation-point=post-build-variant-condition{matching-criterion=RDR_POS, value=6}
                DC_0xF4D0_oRDR07_oVCAN_RADAR_d9828484 (DcmDslMainConnection): DcmDslProtocolRxTesterSourceAddr=244
                  DIAG_REQ_FNC_OTA_oVCAN_RADAR_b630c1e5_Rx_0176162e (DcmDslProtocolRx):
                    DcmDslProtocolRxAddrType = DCM_FUNCTIONAL_TYPE
                    DcmDslProtocolRxPduId = 25
                    DcmDslProtocolRxComMChannelRef = ComMConfigSet/CN_VCAN_RADAR_489180b6
                    DcmDslProtocolRxPduRef = DIAG_REQ_FNC_OTA_oVCAN_RADAR_b630c1e5_Rx
                  FR_DIAG_REQ_PHY_OTA_oVCAN_RADAR_7facfb76_Rx_b2eaa10c (DcmDslProtocolRx):
                    DcmDslProtocolRxAddrType = DCM_PHYSICAL_TYPE
                    DcmDslProtocolRxPduId = 26
                    DcmDslProtocolRxComMChannelRef = ComMConfigSet/CN_VCAN_RADAR_489180b6
                    DcmDslProtocolRxPduRef = FR_DIAG_REQ_PHY_OTA_oVCAN_RADAR_7facfb76_Rx
                  FR_DIAG_RES_PHY_OTA_oVCAN_RADAR_9b68fa0b_Tx_bc6c5974 (DcmDslProtocolTx): DcmDslTxConfirmationPduId=24, DcmDslProtocolTxPduRef=EcucPduCollection/FR_DIAG_RES_PHY_OTA_oVCAN_RADAR_9b68fa0b_Tx
              DC_0xF5BB_oRDR07_oPCAN_RADAR_3085b871: variation-point=post-build-variant-condition{matching-criterion=RDR_POS, value=6}
                DC_0xF5BB_oRDR07_oPCAN_RADAR_3085b871 (DcmDslMainConnection): DcmDslProtocolRxTesterSourceAddr=245
                  PCAN_DIAG_REQ_FUNC_PLANT_oPCAN_RADAR_20_3b79581e_Rx_36801f1b (DcmDslProtocolRx):
                    DcmDslProtocolRxAddrType = DCM_FUNCTIONAL_TYPE
                    DcmDslProtocolRxPduId = 28
                    DcmDslProtocolRxComMChannelRef = ComMConfigSet/CN_PCAN_RADAR_458ff0f1
                    DcmDslProtocolRxPduRef = PCAN_DIAG_REQ_FUNC_PLANT_oPCAN_RADAR_20_3b79581e_Rx
                  PCAN_DIAG_REQ_PHYS_PLANT_oPCAN_RADAR_20_93ccff8e_Rx_c332e01f (DcmDslProtocolRx):
                    DcmDslProtocolRxAddrType = DCM_PHYSICAL_TYPE
                    DcmDslProtocolRxPduId = 29
                    DcmDslProtocolRxComMChannelRef = ComMConfigSet/CN_PCAN_RADAR_458ff0f1
                    DcmDslProtocolRxPduRef = PCAN_DIAG_REQ_PHYS_PLANT_oPCAN_RADAR_20_93ccff8e_Rx
                  PCAN_DIAG_RESP_PHYS_PLANT_oPCAN_RADAR_20_0a0c318a_Tx_b4cb0023 (DcmDslProtocolTx): DcmDslTxConfirmationPduId=27, DcmDslProtocolTxPduRef=EcucPduCollection/PCAN_DIAG_RESP_PHYS_PLANT_oPCAN_RADAR_20_0a0c318a_Tx
              DC_0xF5BB_oRDR07_oPCAN_RADAR_FD_abce8cdd: variation-point=post-build-variant-condition{matching-criterion=RDR_POS, value=6}
                DC_0xF5BB_oRDR07_oPCAN_RADAR_FD_abce8cdd (DcmDslMainConnection): DcmDslProtocolRxTesterSourceAddr=245
                  PCAN_DIAG_REQ_FUNC_PLANT_oPCAN_RADAR_8e17ec17_Rx_e2e07788 (DcmDslProtocolRx):
                    DcmDslProtocolRxAddrType = DCM_FUNCTIONAL_TYPE
                    DcmDslProtocolRxPduId = 31
                    DcmDslProtocolRxComMChannelRef = ComMConfigSet/CN_PCAN_RADAR_458ff0f1
                    DcmDslProtocolRxPduRef = PCAN_DIAG_REQ_FUNC_PLANT_oPCAN_RADAR_8e17ec17_Rx
                  PCAN_DIAG_REQ_PHYS_PLANT_oPCAN_RADAR_a4e456d5_Rx_de87c92a (DcmDslProtocolRx):
                    DcmDslProtocolRxAddrType = DCM_PHYSICAL_TYPE
                    DcmDslProtocolRxPduId = 32
                    DcmDslProtocolRxComMChannelRef = ComMConfigSet/CN_PCAN_RADAR_458ff0f1
                    DcmDslProtocolRxPduRef = PCAN_DIAG_REQ_PHYS_PLANT_oPCAN_RADAR_a4e456d5_Rx
                  PCAN_DIAG_RESP_PHYS_PLANT_oPCAN_RADAR_339eb858_Tx_b55bc933 (DcmDslProtocolTx): DcmDslTxConfirmationPduId=30, DcmDslProtocolTxPduRef=EcucPduCollection/PCAN_DIAG_RESP_PHYS_PLANT_oPCAN_RADAR_339eb858_Tx
              DC_0xF5D0_oRDR07_oVCAN_RADAR_ceaae044: variation-point=post-build-variant-condition{matching-criterion=RDR_POS, value=6}
                DC_0xF5D0_oRDR07_oVCAN_RADAR_ceaae044 (DcmDslMainConnection): DcmDslProtocolRxTesterSourceAddr=245
                  DIAG_REQ_FNC_PLANT_oVCAN_RADAR_9fd4cadc_Rx_f47e2bb6 (DcmDslProtocolRx):
                    DcmDslProtocolRxAddrType = DCM_FUNCTIONAL_TYPE
                    DcmDslProtocolRxPduId = 34
                    DcmDslProtocolRxComMChannelRef = ComMConfigSet/CN_VCAN_RADAR_489180b6
                    DcmDslProtocolRxPduRef = DIAG_REQ_FNC_PLANT_oVCAN_RADAR_9fd4cadc_Rx
                  FR_DIAG_REQ_PHY_PLANT_oVCAN_RADAR_03b4032b_Rx_f4f84964 (DcmDslProtocolRx):
                    DcmDslProtocolRxAddrType = DCM_PHYSICAL_TYPE
                    DcmDslProtocolRxPduId = 35
                    DcmDslProtocolRxComMChannelRef = ComMConfigSet/CN_VCAN_RADAR_489180b6
                    DcmDslProtocolRxPduRef = FR_DIAG_REQ_PHY_PLANT_oVCAN_RADAR_03b4032b_Rx
                  FR_DIAG_RES_PHY_PLANT_oVCAN_RADAR_ee22d0c2_Tx_70415e78 (DcmDslProtocolTx): DcmDslTxConfirmationPduId=33, DcmDslProtocolTxPduRef=EcucPduCollection/FR_DIAG_RES_PHY_PLANT_oVCAN_RADAR_ee22d0c2_Tx
              DC_0xF0BB_oRDR08_oPCAN_RADAR_5c7c9a84: variation-point=post-build-variant-condition{matching-criterion=RDR_POS, value=7}
                DC_0xF0BB_oRDR08_oPCAN_RADAR_5c7c9a84 (DcmDslMainConnection): DcmDslProtocolRxTesterSourceAddr=240
                  PCAN_DIAG_REQ_FUNC_OBD1_oPCAN_RADAR_20_e986e253_Rx_5365c009 (DcmDslProtocolRx):
                    DcmDslProtocolRxAddrType = DCM_FUNCTIONAL_TYPE
                    DcmDslProtocolRxPduId = 1
                    DcmDslProtocolRxComMChannelRef = ComMConfigSet/CN_PCAN_RADAR_458ff0f1
                    DcmDslProtocolRxPduRef = PCAN_DIAG_REQ_FUNC_OBD1_oPCAN_RADAR_20_e986e253_Rx
                  PCAN_DIAG_REQ_PHYS_OBD1_oPCAN_RADAR_20_3bfe27fe_Rx_2d01fee8 (DcmDslProtocolRx):
                    DcmDslProtocolRxAddrType = DCM_PHYSICAL_TYPE
                    DcmDslProtocolRxPduId = 2
                    DcmDslProtocolRxComMChannelRef = ComMConfigSet/CN_PCAN_RADAR_458ff0f1
                    DcmDslProtocolRxPduRef = PCAN_DIAG_REQ_PHYS_OBD1_oPCAN_RADAR_20_3bfe27fe_Rx
                  PCAN_DIAG_RESP_PHYS_OBD1_oPCAN_RADAR_20_f26199fd_Tx_55fbdb8d (DcmDslProtocolTx): DcmDslTxConfirmationPduId=0, DcmDslProtocolTxPduRef=EcucPduCollection/PCAN_DIAG_RESP_PHYS_OBD1_oPCAN_RADAR_20_f26199fd_Tx
              DC_0xF0BB_oRDR08_oPCAN_RADAR_FD_7b123112: variation-point=post-build-variant-condition{matching-criterion=RDR_POS, value=7}
                DC_0xF0BB_oRDR08_oPCAN_RADAR_FD_7b123112 (DcmDslMainConnection): DcmDslProtocolRxTesterSourceAddr=240
                  PCAN_DIAG_REQ_FUNC_OBD1_oPCAN_RADAR_5664bded_Rx_f8c6c8a4 (DcmDslProtocolRx):
                    DcmDslProtocolRxAddrType = DCM_FUNCTIONAL_TYPE
                    DcmDslProtocolRxPduId = 4
                    DcmDslProtocolRxComMChannelRef = ComMConfigSet/CN_PCAN_RADAR_458ff0f1
                    DcmDslProtocolRxPduRef = PCAN_DIAG_REQ_FUNC_OBD1_oPCAN_RADAR_5664bded_Rx
                  PCAN_DIAG_REQ_PHYS_OBD1_oPCAN_RADAR_caf5eb16_Rx_95487f2b (DcmDslProtocolRx):
                    DcmDslProtocolRxAddrType = DCM_PHYSICAL_TYPE
                    DcmDslProtocolRxPduId = 5
                    DcmDslProtocolRxComMChannelRef = ComMConfigSet/CN_PCAN_RADAR_458ff0f1
                    DcmDslProtocolRxPduRef = PCAN_DIAG_REQ_PHYS_OBD1_oPCAN_RADAR_caf5eb16_Rx
                  PCAN_DIAG_RESP_PHYS_OBD1_oPCAN_RADAR_62c2ee1d_Tx_71c025ae (DcmDslProtocolTx): DcmDslTxConfirmationPduId=3, DcmDslProtocolTxPduRef=EcucPduCollection/PCAN_DIAG_RESP_PHYS_OBD1_oPCAN_RADAR_62c2ee1d_Tx
              DC_0xF0D0_oRDR08_oVCAN_RADAR_a253c2b1: variation-point=post-build-variant-condition{matching-criterion=RDR_POS, value=7}
                DC_0xF0D0_oRDR08_oVCAN_RADAR_a253c2b1 (DcmDslMainConnection): DcmDslProtocolRxTesterSourceAddr=240
                  DIAG_REQ_FNC_OBD1_oVCAN_RADAR_ea4d23fb_Rx_4734fad9 (DcmDslProtocolRx):
                    DcmDslProtocolRxAddrType = DCM_FUNCTIONAL_TYPE
                    DcmDslProtocolRxPduId = 7
                    DcmDslProtocolRxComMChannelRef = ComMConfigSet/CN_VCAN_RADAR_489180b6
                    DcmDslProtocolRxPduRef = DIAG_REQ_FNC_OBD1_oVCAN_RADAR_ea4d23fb_Rx
                  FR_DIAG_REQ_PHY_OBD1_oVCAN_RADAR_83827d3f_Rx_a310dd11 (DcmDslProtocolRx):
                    DcmDslProtocolRxAddrType = DCM_PHYSICAL_TYPE
                    DcmDslProtocolRxPduId = 8
                    DcmDslProtocolRxComMChannelRef = ComMConfigSet/CN_VCAN_RADAR_489180b6
                    DcmDslProtocolRxPduRef = FR_DIAG_REQ_PHY_OBD1_oVCAN_RADAR_83827d3f_Rx
                  FR_DIAG_RES_PHY_OBD1_oVCAN_RADAR_add2b4bf_Tx_08033c95 (DcmDslProtocolTx): DcmDslTxConfirmationPduId=6, DcmDslProtocolTxPduRef=EcucPduCollection/FR_DIAG_RES_PHY_OBD1_oVCAN_RADAR_add2b4bf_Tx
              DC_0xF1BB_oRDR08_oPCAN_RADAR_4b54fe44: variation-point=post-build-variant-condition{matching-criterion=RDR_POS, value=7}
                DC_0xF1BB_oRDR08_oPCAN_RADAR_4b54fe44 (DcmDslMainConnection): DcmDslProtocolRxTesterSourceAddr=241
                  PCAN_DIAG_REQ_FUNC_OBD2_oPCAN_RADAR_20_c04e56a1_Rx_a7582bb7 (DcmDslProtocolRx):
                    DcmDslProtocolRxAddrType = DCM_FUNCTIONAL_TYPE
                    DcmDslProtocolRxPduId = 10
                    DcmDslProtocolRxComMChannelRef = ComMConfigSet/CN_PCAN_RADAR_458ff0f1
                    DcmDslProtocolRxPduRef = PCAN_DIAG_REQ_FUNC_OBD2_oPCAN_RADAR_20_c04e56a1_Rx
                  PCAN_DIAG_REQ_PHYS_OBD2_oPCAN_RADAR_20_1236930c_Rx_26654501 (DcmDslProtocolRx):
                    DcmDslProtocolRxAddrType = DCM_PHYSICAL_TYPE
                    DcmDslProtocolRxPduId = 11
                    DcmDslProtocolRxComMChannelRef = ComMConfigSet/CN_PCAN_RADAR_458ff0f1
                    DcmDslProtocolRxPduRef = PCAN_DIAG_REQ_PHYS_OBD2_oPCAN_RADAR_20_1236930c_Rx
                  PCAN_DIAG_RESP_PHYS_OBD2_oPCAN_RADAR_20_dba92d0f_Tx_dcc6691a (DcmDslProtocolTx): DcmDslTxConfirmationPduId=9, DcmDslProtocolTxPduRef=EcucPduCollection/PCAN_DIAG_RESP_PHYS_OBD2_oPCAN_RADAR_20_dba92d0f_Tx
              DC_0xF1BB_oRDR08_oPCAN_RADAR_FD_de99a11c: variation-point=post-build-variant-condition{matching-criterion=RDR_POS, value=7}
                DC_0xF1BB_oRDR08_oPCAN_RADAR_FD_de99a11c (DcmDslMainConnection): DcmDslProtocolRxTesterSourceAddr=241
                  PCAN_DIAG_REQ_FUNC_OBD2_oPCAN_RADAR_ebaed123_Rx_69afd2b8 (DcmDslProtocolRx):
                    DcmDslProtocolRxAddrType = DCM_FUNCTIONAL_TYPE
                    DcmDslProtocolRxPduId = 13
                    DcmDslProtocolRxComMChannelRef = ComMConfigSet/CN_PCAN_RADAR_458ff0f1
                    DcmDslProtocolRxPduRef = PCAN_DIAG_REQ_FUNC_OBD2_oPCAN_RADAR_ebaed123_Rx
                  PCAN_DIAG_REQ_PHYS_OBD2_oPCAN_RADAR_773f87d8_Rx_31c94776 (DcmDslProtocolRx):
                    DcmDslProtocolRxAddrType = DCM_PHYSICAL_TYPE
                    DcmDslProtocolRxPduId = 14
                    DcmDslProtocolRxComMChannelRef = ComMConfigSet/CN_PCAN_RADAR_458ff0f1
                    DcmDslProtocolRxPduRef = PCAN_DIAG_REQ_PHYS_OBD2_oPCAN_RADAR_773f87d8_Rx
                  PCAN_DIAG_RESP_PHYS_OBD2_oPCAN_RADAR_df0882d3_Tx_fbbf77c9 (DcmDslProtocolTx): DcmDslTxConfirmationPduId=12, DcmDslProtocolTxPduRef=EcucPduCollection/PCAN_DIAG_RESP_PHYS_OBD2_oPCAN_RADAR_df0882d3_Tx
              DC_0xF1D0_oRDR08_oVCAN_RADAR_b57ba671: variation-point=post-build-variant-condition{matching-criterion=RDR_POS, value=7}
                DC_0xF1D0_oRDR08_oVCAN_RADAR_b57ba671 (DcmDslMainConnection): DcmDslProtocolRxTesterSourceAddr=241
                  DIAG_REQ_FNC_OBD2_oVCAN_RADAR_57874f35_Rx_1a4abb4e (DcmDslProtocolRx):
                    DcmDslProtocolRxAddrType = DCM_FUNCTIONAL_TYPE
                    DcmDslProtocolRxPduId = 16
                    DcmDslProtocolRxComMChannelRef = ComMConfigSet/CN_VCAN_RADAR_489180b6
                    DcmDslProtocolRxPduRef = DIAG_REQ_FNC_OBD2_oVCAN_RADAR_57874f35_Rx
                  FR_DIAG_REQ_PHY_OBD2_oVCAN_RADAR_3e4811f1_Rx_ef982e0b (DcmDslProtocolRx):
                    DcmDslProtocolRxAddrType = DCM_PHYSICAL_TYPE
                    DcmDslProtocolRxPduId = 17
                    DcmDslProtocolRxComMChannelRef = ComMConfigSet/CN_VCAN_RADAR_489180b6
                    DcmDslProtocolRxPduRef = FR_DIAG_REQ_PHY_OBD2_oVCAN_RADAR_3e4811f1_Rx
                  FR_DIAG_RES_PHY_OBD2_oVCAN_RADAR_1018d871_Tx_ee91ebc0 (DcmDslProtocolTx): DcmDslTxConfirmationPduId=15, DcmDslProtocolTxPduRef=EcucPduCollection/FR_DIAG_RES_PHY_OBD2_oVCAN_RADAR_1018d871_Tx
              DC_0xF4BB_oRDR08_oPCAN_RADAR_00dd0984: variation-point=post-build-variant-condition{matching-criterion=RDR_POS, value=7}
                DC_0xF4BB_oRDR08_oPCAN_RADAR_00dd0984 (DcmDslMainConnection): DcmDslProtocolRxTesterSourceAddr=244
                  PCAN_DIAG_REQ_FUNC_OTA_oPCAN_RADAR_20_4ceedd9c_Rx_8d5a8781 (DcmDslProtocolRx):
                    DcmDslProtocolRxAddrType = DCM_FUNCTIONAL_TYPE
                    DcmDslProtocolRxPduId = 19
                    DcmDslProtocolRxComMChannelRef = ComMConfigSet/CN_PCAN_RADAR_458ff0f1
                    DcmDslProtocolRxPduRef = PCAN_DIAG_REQ_FUNC_OTA_oPCAN_RADAR_20_4ceedd9c_Rx
                  PCAN_DIAG_REQ_PHYS_OTA_oPCAN_RADAR_20_39ae8dba_Rx_fd38421b (DcmDslProtocolRx):
                    DcmDslProtocolRxAddrType = DCM_PHYSICAL_TYPE
                    DcmDslProtocolRxPduId = 20
                    DcmDslProtocolRxComMChannelRef = ComMConfigSet/CN_PCAN_RADAR_458ff0f1
                    DcmDslProtocolRxPduRef = PCAN_DIAG_REQ_PHYS_OTA_oPCAN_RADAR_20_39ae8dba_Rx
                  PCAN_DIAG_RESP_PHYS_OTA_oPCAN_RADAR_20_aa3008c9_Tx_74022f70 (DcmDslProtocolTx): DcmDslTxConfirmationPduId=18, DcmDslProtocolTxPduRef=EcucPduCollection/PCAN_DIAG_RESP_PHYS_OTA_oPCAN_RADAR_20_aa3008c9_Tx
              DC_0xF4BB_oRDR08_oPCAN_RADAR_FD_80af7be9: variation-point=post-build-variant-condition{matching-criterion=RDR_POS, value=7}
                DC_0xF4BB_oRDR08_oPCAN_RADAR_FD_80af7be9 (DcmDslMainConnection): DcmDslProtocolRxTesterSourceAddr=244
                  PCAN_DIAG_REQ_FUNC_OTA_oPCAN_RADAR_8729c499_Rx_63a44321 (DcmDslProtocolRx):
                    DcmDslProtocolRxAddrType = DCM_FUNCTIONAL_TYPE
                    DcmDslProtocolRxPduId = 22
                    DcmDslProtocolRxComMChannelRef = ComMConfigSet/CN_PCAN_RADAR_458ff0f1
                    DcmDslProtocolRxPduRef = PCAN_DIAG_REQ_FUNC_OTA_oPCAN_RADAR_8729c499_Rx
                  PCAN_DIAG_REQ_PHYS_OTA_oPCAN_RADAR_1f79965d_Rx_897b19f5 (DcmDslProtocolRx):
                    DcmDslProtocolRxAddrType = DCM_PHYSICAL_TYPE
                    DcmDslProtocolRxPduId = 23
                    DcmDslProtocolRxComMChannelRef = ComMConfigSet/CN_PCAN_RADAR_458ff0f1
                    DcmDslProtocolRxPduRef = PCAN_DIAG_REQ_PHYS_OTA_oPCAN_RADAR_1f79965d_Rx
                  PCAN_DIAG_RESP_PHYS_OTA_oPCAN_RADAR_4fa3c8f0_Tx_93c6c140 (DcmDslProtocolTx): DcmDslTxConfirmationPduId=21, DcmDslProtocolTxPduRef=EcucPduCollection/PCAN_DIAG_RESP_PHYS_OTA_oPCAN_RADAR_4fa3c8f0_Tx
              DC_0xF4D0_oRDR08_oVCAN_RADAR_fef251b1: variation-point=post-build-variant-condition{matching-criterion=RDR_POS, value=7}
                DC_0xF4D0_oRDR08_oVCAN_RADAR_fef251b1 (DcmDslMainConnection): DcmDslProtocolRxTesterSourceAddr=244
                  DIAG_REQ_FNC_OTA_oVCAN_RADAR_b630c1e5_Rx_0176162e (DcmDslProtocolRx):
                    DcmDslProtocolRxAddrType = DCM_FUNCTIONAL_TYPE
                    DcmDslProtocolRxPduId = 25
                    DcmDslProtocolRxComMChannelRef = ComMConfigSet/CN_VCAN_RADAR_489180b6
                    DcmDslProtocolRxPduRef = DIAG_REQ_FNC_OTA_oVCAN_RADAR_b630c1e5_Rx
                  FR_DIAG_REQ_PHY_OTA_oVCAN_RADAR_7facfb76_Rx_b2eaa10c (DcmDslProtocolRx):
                    DcmDslProtocolRxAddrType = DCM_PHYSICAL_TYPE
                    DcmDslProtocolRxPduId = 26
                    DcmDslProtocolRxComMChannelRef = ComMConfigSet/CN_VCAN_RADAR_489180b6
                    DcmDslProtocolRxPduRef = FR_DIAG_REQ_PHY_OTA_oVCAN_RADAR_7facfb76_Rx
                  FR_DIAG_RES_PHY_OTA_oVCAN_RADAR_9b68fa0b_Tx_bc6c5974 (DcmDslProtocolTx): DcmDslTxConfirmationPduId=24, DcmDslProtocolTxPduRef=EcucPduCollection/FR_DIAG_RES_PHY_OTA_oVCAN_RADAR_9b68fa0b_Tx
              DC_0xF5BB_oRDR08_oPCAN_RADAR_17f56d44: variation-point=post-build-variant-condition{matching-criterion=RDR_POS, value=7}
                DC_0xF5BB_oRDR08_oPCAN_RADAR_17f56d44 (DcmDslMainConnection): DcmDslProtocolRxTesterSourceAddr=245
                  PCAN_DIAG_REQ_FUNC_PLANT_oPCAN_RADAR_20_3b79581e_Rx_36801f1b (DcmDslProtocolRx):
                    DcmDslProtocolRxAddrType = DCM_FUNCTIONAL_TYPE
                    DcmDslProtocolRxPduId = 28
                    DcmDslProtocolRxComMChannelRef = ComMConfigSet/CN_PCAN_RADAR_458ff0f1
                    DcmDslProtocolRxPduRef = PCAN_DIAG_REQ_FUNC_PLANT_oPCAN_RADAR_20_3b79581e_Rx
                  PCAN_DIAG_REQ_PHYS_PLANT_oPCAN_RADAR_20_93ccff8e_Rx_c332e01f (DcmDslProtocolRx):
                    DcmDslProtocolRxAddrType = DCM_PHYSICAL_TYPE
                    DcmDslProtocolRxPduId = 29
                    DcmDslProtocolRxComMChannelRef = ComMConfigSet/CN_PCAN_RADAR_458ff0f1
                    DcmDslProtocolRxPduRef = PCAN_DIAG_REQ_PHYS_PLANT_oPCAN_RADAR_20_93ccff8e_Rx
                  PCAN_DIAG_RESP_PHYS_PLANT_oPCAN_RADAR_20_0a0c318a_Tx_b4cb0023 (DcmDslProtocolTx): DcmDslTxConfirmationPduId=27, DcmDslProtocolTxPduRef=EcucPduCollection/PCAN_DIAG_RESP_PHYS_PLANT_oPCAN_RADAR_20_0a0c318a_Tx
              DC_0xF5BB_oRDR08_oPCAN_RADAR_FD_2524ebe7: variation-point=post-build-variant-condition{matching-criterion=RDR_POS, value=7}
                DC_0xF5BB_oRDR08_oPCAN_RADAR_FD_2524ebe7 (DcmDslMainConnection): DcmDslProtocolRxTesterSourceAddr=245
                  PCAN_DIAG_REQ_FUNC_PLANT_oPCAN_RADAR_8e17ec17_Rx_e2e07788 (DcmDslProtocolRx):
                    DcmDslProtocolRxAddrType = DCM_FUNCTIONAL_TYPE
                    DcmDslProtocolRxPduId = 31
                    DcmDslProtocolRxComMChannelRef = ComMConfigSet/CN_PCAN_RADAR_458ff0f1
                    DcmDslProtocolRxPduRef = PCAN_DIAG_REQ_FUNC_PLANT_oPCAN_RADAR_8e17ec17_Rx
                  PCAN_DIAG_REQ_PHYS_PLANT_oPCAN_RADAR_a4e456d5_Rx_de87c92a (DcmDslProtocolRx):
                    DcmDslProtocolRxAddrType = DCM_PHYSICAL_TYPE
                    DcmDslProtocolRxPduId = 32
                    DcmDslProtocolRxComMChannelRef = ComMConfigSet/CN_PCAN_RADAR_458ff0f1
                    DcmDslProtocolRxPduRef = PCAN_DIAG_REQ_PHYS_PLANT_oPCAN_RADAR_a4e456d5_Rx
                  PCAN_DIAG_RESP_PHYS_PLANT_oPCAN_RADAR_339eb858_Tx_b55bc933 (DcmDslProtocolTx): DcmDslTxConfirmationPduId=30, DcmDslProtocolTxPduRef=EcucPduCollection/PCAN_DIAG_RESP_PHYS_PLANT_oPCAN_RADAR_339eb858_Tx
              DC_0xF5D0_oRDR08_oVCAN_RADAR_e9da3571: variation-point=post-build-variant-condition{matching-criterion=RDR_POS, value=7}
                DC_0xF5D0_oRDR08_oVCAN_RADAR_e9da3571 (DcmDslMainConnection): DcmDslProtocolRxTesterSourceAddr=245
                  DIAG_REQ_FNC_PLANT_oVCAN_RADAR_9fd4cadc_Rx_f47e2bb6 (DcmDslProtocolRx):
                    DcmDslProtocolRxAddrType = DCM_FUNCTIONAL_TYPE
                    DcmDslProtocolRxPduId = 34
                    DcmDslProtocolRxComMChannelRef = ComMConfigSet/CN_VCAN_RADAR_489180b6
                    DcmDslProtocolRxPduRef = DIAG_REQ_FNC_PLANT_oVCAN_RADAR_9fd4cadc_Rx
                  FR_DIAG_REQ_PHY_PLANT_oVCAN_RADAR_03b4032b_Rx_f4f84964 (DcmDslProtocolRx):
                    DcmDslProtocolRxAddrType = DCM_PHYSICAL_TYPE
                    DcmDslProtocolRxPduId = 35
                    DcmDslProtocolRxComMChannelRef = ComMConfigSet/CN_VCAN_RADAR_489180b6
                    DcmDslProtocolRxPduRef = FR_DIAG_REQ_PHY_PLANT_oVCAN_RADAR_03b4032b_Rx
                  FR_DIAG_RES_PHY_PLANT_oVCAN_RADAR_ee22d0c2_Tx_70415e78 (DcmDslProtocolTx): DcmDslTxConfirmationPduId=33, DcmDslProtocolTxPduRef=EcucPduCollection/FR_DIAG_RES_PHY_PLANT_oVCAN_RADAR_ee22d0c2_Tx
      DcmDsp: DcmDspMaxDidToRead=5  # Diagnostics Data Import
        ComControl (DcmDspComControl)  # Diagnostics Data Import
          DspComContolAllChannel (DcmDspComControlAllChannel)  # Diagnostics Data Import
        DcmDspSession  # Diagnostics Data Import
          3 x DcmDspSessionRow, all with DcmDspSessionP2ServerMax=0.05, DcmDspSessionP2StarServerMax=1.95, DcmDspSessionForBoot=DCM_NO_BOOT:
            Extended: DcmDspSessionLevel=3  # Diagnostics Data Import
            Programming: DcmDspSessionLevel=2  # Diagnostics Data Import
            Default: DcmDspSessionLevel=1  # Diagnostics Data Import
        DcmDspSecurity  # Diagnostics Data Import
          UnlockedL1 (DcmDspSecurityRow):  # Diagnostics Data Import
            DcmDspSecurityDelayTime = 100
            DcmDspSecurityDelayTimeOnBoot = 0
            DcmDspSecurityKeySize = 16
            DcmDspSecurityLevel = 6
            DcmDspSecurityNumAttDelay = 3
            DcmDspSecuritySeedSize = 16
        8 x DcmDspRoutineInfo:
          RoutineInfo_RoutineInfo_CheckProgDep_Start  # Diagnostics Data Import
            DcmDspStartRoutineOut  # Diagnostics Data Import
              Out_ResData (DcmDspStartRoutineOutSignal): DcmDspRoutineSignalLength=8, DcmDspRoutineSignalType=UINT8_N, DcmDspRoutineSignalEndianness=opaque, DcmDspRoutineSignalPos=0  # Diagnostics Data Import
            DcmDspRoutineAuthorization: DcmDspRoutineSessionRef=DcmDspSession/Programming, DcmDspRoutineSecurityLevelRef=UnlockedL1  # Diagnostics Data Import
          RoutineInfo_RoutineInfo_EraseMem_Start  # Diagnostics Data Import
            DcmDspStartRoutineOut  # Diagnostics Data Import
              Out_ResData (DcmDspStartRoutineOutSignal): DcmDspRoutineSignalLength=8, DcmDspRoutineSignalType=UINT8_N, DcmDspRoutineSignalEndianness=opaque, DcmDspRoutineSignalPos=0  # Diagnostics Data Import
            DcmDspStartRoutineIn  # Diagnostics Data Import
              In_ReqData (DcmDspStartRoutineInSignal): DcmDspRoutineSignalLength=72, DcmDspRoutineSignalType=UINT8_N, DcmDspRoutineSignalEndianness=opaque, DcmDspRoutineSignalPos=0  # Diagnostics Data Import
            DcmDspRoutineAuthorization: DcmDspRoutineSessionRef=DcmDspSession/Programming, DcmDspRoutineSecurityLevelRef=UnlockedL1  # Diagnostics Data Import
          RoutineInfo_RoutineInfo_Pin_Position_Unlock_Start  # Diagnostics Data Import
            DcmDspRoutineRequestResOut  # Diagnostics Data Import
              Out_ResData (DcmDspRoutineRequestResOutSignal): DcmDspRoutineSignalLength=8, DcmDspRoutineSignalType=UINT8_N, DcmDspRoutineSignalEndianness=opaque, DcmDspRoutineSignalPos=0  # Diagnostics Data Import
            DcmDspStartRoutineOut  # Diagnostics Data Import
              Out_ResData (DcmDspStartRoutineOutSignal): DcmDspRoutineSignalLength=8, DcmDspRoutineSignalType=UINT8_N, DcmDspRoutineSignalEndianness=opaque, DcmDspRoutineSignalPos=0  # Diagnostics Data Import
            DcmDspStartRoutineIn  # Diagnostics Data Import
              In_ReqData (DcmDspStartRoutineInSignal): DcmDspRoutineSignalLength=8, DcmDspRoutineSignalType=UINT8_N, DcmDspRoutineSignalEndianness=opaque, DcmDspRoutineSignalPos=0  # Diagnostics Data Import
            DcmDspRoutineAuthorization: DcmDspRoutineSessionRef=DcmDspSession/Extended, DcmDspRoutineSecurityLevelRef=UnlockedL1  # Diagnostics Data Import
          RoutineInfo_RoutineInfo_Pin_Position_Lock_Start  # Diagnostics Data Import
            DcmDspRoutineRequestResOut  # Diagnostics Data Import
              Out_ResData (DcmDspRoutineRequestResOutSignal): DcmDspRoutineSignalLength=8, DcmDspRoutineSignalType=UINT8_N, DcmDspRoutineSignalEndianness=opaque, DcmDspRoutineSignalPos=0  # Diagnostics Data Import
            DcmDspStartRoutineOut  # Diagnostics Data Import
              Out_ResData (DcmDspStartRoutineOutSignal): DcmDspRoutineSignalLength=8, DcmDspRoutineSignalType=UINT8_N, DcmDspRoutineSignalEndianness=opaque, DcmDspRoutineSignalPos=0  # Diagnostics Data Import
            DcmDspStartRoutineIn  # Diagnostics Data Import
              In_ReqData (DcmDspStartRoutineInSignal): DcmDspRoutineSignalLength=8, DcmDspRoutineSignalType=UINT8_N, DcmDspRoutineSignalEndianness=opaque, DcmDspRoutineSignalPos=0  # Diagnostics Data Import
            DcmDspRoutineAuthorization: DcmDspRoutineSessionRef=DcmDspSession/Extended, DcmDspRoutineSecurityLevelRef=UnlockedL1  # Diagnostics Data Import
          RoutineInfo_RoutineInfo_Service_Alignment_Execution_Start  # Diagnostics Data Import
            DcmDspRoutineRequestResOut  # Diagnostics Data Import
              Out_ResData (DcmDspRoutineRequestResOutSignal): DcmDspRoutineSignalLength=224, DcmDspRoutineSignalType=UINT8_N, DcmDspRoutineSignalEndianness=opaque, DcmDspRoutineSignalPos=0  # Diagnostics Data Import
            DcmDspRoutineAuthorization: DcmDspRoutineSessionRef=DcmDspSession/Extended, DcmDspRoutineSecurityLevelRef=UnlockedL1  # Diagnostics Data Import
          RoutineInfo_RoutineInfo_Static_Alignment_Execution_Start  # Diagnostics Data Import
            DcmDspRoutineRequestResOut  # Diagnostics Data Import
              Out_ResData (DcmDspRoutineRequestResOutSignal): DcmDspRoutineSignalLength=24, DcmDspRoutineSignalType=UINT8_N, DcmDspRoutineSignalEndianness=opaque, DcmDspRoutineSignalPos=0  # Diagnostics Data Import
            DcmDspRoutineAuthorization: DcmDspRoutineSessionRef=DcmDspSession/Extended, DcmDspRoutineSecurityLevelRef=UnlockedL1  # Diagnostics Data Import
          RoutineInfo_RoutineInfo_CheckSig_Start  # Diagnostics Data Import
            DcmDspStartRoutineOut  # Diagnostics Data Import
              Out_ResData (DcmDspStartRoutineOutSignal): DcmDspRoutineSignalLength=8, DcmDspRoutineSignalType=UINT8_N, DcmDspRoutineSignalEndianness=opaque, DcmDspRoutineSignalPos=0  # Diagnostics Data Import
            DcmDspRoutineAuthorization: DcmDspRoutineSessionRef=DcmDspSession/Programming, DcmDspRoutineSecurityLevelRef=UnlockedL1  # Diagnostics Data Import
          RoutineInfo_RoutineInfo_CheckProgPreCond_Start  # Diagnostics Data Import
            DcmDspStartRoutineOut  # Diagnostics Data Import
              Out_ResData (DcmDspStartRoutineOutSignal): DcmDspRoutineSignalLength=16, DcmDspRoutineSignalType=UINT8_N, DcmDspRoutineSignalEndianness=opaque, DcmDspRoutineSignalPos=0  # Diagnostics Data Import
            DcmDspRoutineAuthorization: DcmDspRoutineSessionRef=DcmDspSession/Extended  # Diagnostics Data Import
        8 x DcmDspRoutine:
          Routine_CheckProgDep_Start: DcmDspRequestResultsRoutineSupported=false, DcmDspStopRoutineSupported=false, DcmDspRoutineIdentifier=65281, DcmDspRoutineInfoRef=RoutineInfo_RoutineInfo_CheckProgDep_Start  # Diagnostics Data Import
          Routine_EraseMem_Start: DcmDspRequestResultsRoutineSupported=false, DcmDspStopRoutineSupported=false, DcmDspRoutineIdentifier=65280, DcmDspRoutineInfoRef=RoutineInfo_RoutineInfo_EraseMem_Start  # Diagnostics Data Import
          Routine_Pin_Position_Unlock_Start: DcmDspRequestResultsRoutineSupported=true, DcmDspStopRoutineSupported=false, DcmDspRoutineIdentifier=28677, DcmDspRoutineInfoRef=RoutineInfo_RoutineInfo_Pin_Position_Unlock_Start  # Diagnostics Data Import
          Routine_Pin_Position_Lock_Start: DcmDspRequestResultsRoutineSupported=true, DcmDspStopRoutineSupported=false, DcmDspRoutineIdentifier=28676, DcmDspRoutineInfoRef=RoutineInfo_RoutineInfo_Pin_Position_Lock_Start  # Diagnostics Data Import
          Routine_Service_Alignment_Execution_Start: DcmDspRequestResultsRoutineSupported=true, DcmDspStopRoutineSupported=true, DcmDspRoutineIdentifier=28675, DcmDspRoutineInfoRef=RoutineInfo_RoutineInfo_Service_Alignment_Execution_Start  # Diagnostics Data Import
          Routine_Static_Alignment_Execution_Start: DcmDspRequestResultsRoutineSupported=true, DcmDspStopRoutineSupported=true, DcmDspRoutineIdentifier=28672, DcmDspRoutineInfoRef=RoutineInfo_RoutineInfo_Static_Alignment_Execution_Start  # Diagnostics Data Import
          Routine_CheckSig_Start: DcmDspRequestResultsRoutineSupported=false, DcmDspStopRoutineSupported=false, DcmDspRoutineIdentifier=526, DcmDspRoutineInfoRef=RoutineInfo_RoutineInfo_CheckSig_Start  # Diagnostics Data Import
          Routine_CheckProgPreCond_Start: DcmDspRequestResultsRoutineSupported=false, DcmDspStopRoutineSupported=false, DcmDspRoutineIdentifier=512, DcmDspRoutineInfoRef=RoutineInfo_RoutineInfo_CheckProgPreCond_Start  # Diagnostics Data Import
        31 x DcmDspDidInfo:
          DidInfo_DidInfo_Read_Active_Fault_Table_Read  # Diagnostics Data Import
            DcmDspDidAccess  # Diagnostics Data Import
              DcmDspDidRead: DcmDspDidReadSessionRef=DcmDspSession/Default, DcmDspDidReadSessionRef=DcmDspSession/Extended  # Diagnostics Data Import
          DidInfo_DidInfo_PCAN_DBC_Version_Read  # Diagnostics Data Import
            DcmDspDidAccess  # Diagnostics Data Import
              DcmDspDidRead: DcmDspDidReadSessionRef=DcmDspSession/Default, DcmDspDidReadSessionRef=DcmDspSession/Extended  # Diagnostics Data Import
          DidInfo_DidInfo_CANDBMatrixVer_Read  # Diagnostics Data Import
            DcmDspDidAccess  # Diagnostics Data Import
              DcmDspDidRead: DcmDspDidReadSessionRef=DcmDspSession/Default, DcmDspDidReadSessionRef=DcmDspSession/Extended  # Diagnostics Data Import
          DidInfo_DidInfo_HardwareNumber_Read  # Diagnostics Data Import
            DcmDspDidAccess  # Diagnostics Data Import
              DcmDspDidRead  # Diagnostics Data Import
          DidInfo_DidInfo_VIN_Read  # Diagnostics Data Import
            DcmDspDidAccess  # Diagnostics Data Import
              DcmDspDidWrite: DcmDspDidWriteSessionRef=DcmDspSession/Extended, DcmDspDidWriteSecurityLevelRef=UnlockedL1  # Diagnostics Data Import
              DcmDspDidRead: DcmDspDidReadSessionRef=DcmDspSession/Default, DcmDspDidReadSessionRef=DcmDspSession/Extended  # Diagnostics Data Import
          DidInfo_DidInfo_ECUBuildDate_Read  # Diagnostics Data Import
            DcmDspDidAccess  # Diagnostics Data Import
              DcmDspDidRead: DcmDspDidReadSessionRef=DcmDspSession/Default, DcmDspDidReadSessionRef=DcmDspSession/Extended  # Diagnostics Data Import
          DidInfo_DidInfo_Base_Software_Version_number_Read  # Diagnostics Data Import
            DcmDspDidAccess  # Diagnostics Data Import
              DcmDspDidRead  # Diagnostics Data Import
          DidInfo_DidInfo_ActiveDiagnosticSessionDataIdentifier_Read  # Diagnostics Data Import
            DcmDspDidAccess  # Diagnostics Data Import
              DcmDspDidRead  # Diagnostics Data Import
          DidInfo_DidInfo_BootloaderNumber_Read  # Diagnostics Data Import
            DcmDspDidAccess  # Diagnostics Data Import
              DcmDspDidRead  # Diagnostics Data Import
          DidInfo_DidInfo_Boot_App_Identification_DID_Read  # Diagnostics Data Import
            DcmDspDidAccess  # Diagnostics Data Import
              DcmDspDidRead  # Diagnostics Data Import
          DidInfo_DidInfo_Software_Fingerprint_Read  # Diagnostics Data Import
            DcmDspDidAccess  # Diagnostics Data Import
              DcmDspDidWrite: DcmDspDidWriteSessionRef=DcmDspSession/Programming, DcmDspDidWriteSecurityLevelRef=UnlockedL1  # Diagnostics Data Import
              DcmDspDidRead  # Diagnostics Data Import
          DidInfo_DidInfo_Hardware_Version_number_Read  # Diagnostics Data Import
            DcmDspDidAccess  # Diagnostics Data Import
              DcmDspDidRead  # Diagnostics Data Import
          DidInfo_DidInfo_Static_Alignment_Result_Parameters_Read  # Diagnostics Data Import
            DcmDspDidAccess  # Diagnostics Data Import
              DcmDspDidRead: DcmDspDidReadSessionRef=DcmDspSession/Default, DcmDspDidReadSessionRef=DcmDspSession/Extended  # Diagnostics Data Import
          DidInfo_DidInfo_Manual_Alignment_Execution_Read  # Diagnostics Data Import
            DcmDspDidAccess  # Diagnostics Data Import
              DcmDspDidWrite: DcmDspDidWriteSessionRef=DcmDspSession/Extended, DcmDspDidWriteSecurityLevelRef=UnlockedL1  # Diagnostics Data Import
              DcmDspDidRead: DcmDspDidReadSessionRef=DcmDspSession/Default, DcmDspDidReadSessionRef=DcmDspSession/Extended  # Diagnostics Data Import
          DidInfo_DidInfo_Pin_Position_Status_Read  # Diagnostics Data Import
            DcmDspDidAccess  # Diagnostics Data Import
              DcmDspDidRead: DcmDspDidReadSessionRef=DcmDspSession/Default, DcmDspDidReadSessionRef=DcmDspSession/Extended  # Diagnostics Data Import
          DidInfo_DidInfo_Auto_Alignment_Status_Information_Read  # Diagnostics Data Import
            DcmDspDidAccess  # Diagnostics Data Import
              DcmDspDidRead: DcmDspDidReadSessionRef=DcmDspSession/Default, DcmDspDidReadSessionRef=DcmDspSession/Extended  # Diagnostics Data Import
          DidInfo_DidInfo_Service_Alignment_Result_Parameters_Read  # Diagnostics Data Import
            DcmDspDidAccess  # Diagnostics Data Import
              DcmDspDidRead: DcmDspDidReadSessionRef=DcmDspSession/Default, DcmDspDidReadSessionRef=DcmDspSession/Extended  # Diagnostics Data Import
          DidInfo_DidInfo_Service_Alignment_Engineering_Non_Configuration_Parameters_Read  # Diagnostics Data Import
            DcmDspDidAccess  # Diagnostics Data Import
              DcmDspDidRead: DcmDspDidReadSessionRef=DcmDspSession/Default, DcmDspDidReadSessionRef=DcmDspSession/Extended  # Diagnostics Data Import
          DidInfo_DidInfo_Static_Alignment_Engineering_Write_Configuration_Parameter_Write  # Diagnostics Data Import
            DcmDspDidAccess  # Diagnostics Data Import
              DcmDspDidWrite: DcmDspDidWriteSessionRef=DcmDspSession/Extended, DcmDspDidWriteSecurityLevelRef=UnlockedL1  # Diagnostics Data Import
          DidInfo_DidInfo_Static_Alignment_Engineering_Read_Parameters_Read  # Diagnostics Data Import
            DcmDspDidAccess  # Diagnostics Data Import
              DcmDspDidRead: DcmDspDidReadSessionRef=DcmDspSession/Default, DcmDspDidReadSessionRef=DcmDspSession/Extended  # Diagnostics Data Import
          DidInfo_DidInfo_Static_Alignment_Engineering_Non_Configuration_Parameters_Read  # Diagnostics Data Import
            DcmDspDidAccess  # Diagnostics Data Import
              DcmDspDidRead: DcmDspDidReadSessionRef=DcmDspSession/Default, DcmDspDidReadSessionRef=DcmDspSession/Extended  # Diagnostics Data Import
          DidInfo_DidInfo_Vehicle_Variant_Read  # Diagnostics Data Import
            DcmDspDidAccess  # Diagnostics Data Import
              DcmDspDidRead: DcmDspDidReadSessionRef=DcmDspSession/Default, DcmDspDidReadSessionRef=DcmDspSession/Extended  # Diagnostics Data Import
          DidInfo_DidInfo_Ego_Acceleration_Read  # Diagnostics Data Import
            DcmDspDidAccess  # Diagnostics Data Import
              DcmDspDidRead: DcmDspDidReadSessionRef=DcmDspSession/Default, DcmDspDidReadSessionRef=DcmDspSession/Extended  # Diagnostics Data Import
          DidInfo_DidInfo_SMC_Part_No_and_Revision_Read  # Diagnostics Data Import
            DcmDspDidAccess  # Diagnostics Data Import
              DcmDspDidRead  # Diagnostics Data Import
          DidInfo_DidInfo_Dataset_Part_No_and_Revision_Read  # Diagnostics Data Import
            DcmDspDidAccess  # Diagnostics Data Import
              DcmDspDidRead  # Diagnostics Data Import
          DidInfo_DidInfo_SoftwareNumber_Read  # Diagnostics Data Import
            DcmDspDidAccess  # Diagnostics Data Import
              DcmDspDidRead: DcmDspDidReadSessionRef=DcmDspSession/Default, DcmDspDidReadSessionRef=DcmDspSession/Extended  # Diagnostics Data Import
          DidInfo_DidInfo_SerialNumber_Read  # Diagnostics Data Import
            DcmDspDidAccess  # Diagnostics Data Import
              DcmDspDidRead  # Diagnostics Data Import
          DidInfo_DidInfo_Sensor_Availability_Flag_Read  # Diagnostics Data Import
            DcmDspDidAccess  # Diagnostics Data Import
              DcmDspDidRead: DcmDspDidReadSessionRef=DcmDspSession/Default, DcmDspDidReadSessionRef=DcmDspSession/Extended  # Diagnostics Data Import
          DidInfo_DidInfo_DateandTime_Read  # Diagnostics Data Import
            DcmDspDidAccess  # Diagnostics Data Import
              DcmDspDidRead: DcmDspDidReadSessionRef=DcmDspSession/Default, DcmDspDidReadSessionRef=DcmDspSession/Extended  # Diagnostics Data Import
          DidInfo_DidInfo_VehicleSpeed_Read  # Diagnostics Data Import
            DcmDspDidAccess  # Diagnostics Data Import
              DcmDspDidRead: DcmDspDidReadSessionRef=DcmDspSession/Default, DcmDspDidReadSessionRef=DcmDspSession/Extended  # Diagnostics Data Import
          DidInfo_DidInfo_ECUVoltage_Read  # Diagnostics Data Import
            DcmDspDidAccess  # Diagnostics Data Import
              DcmDspDidRead: DcmDspDidReadSessionRef=DcmDspSession/Default, DcmDspDidReadSessionRef=DcmDspSession/Extended  # Diagnostics Data Import
        31 x DcmDspDid:
          DID_Read_Active_Fault_Table_Read: DcmDspDidIdentifier=64899, DcmDspDidInfoRef=DidInfo_DidInfo_Read_Active_Fault_Table_Read  # Diagnostics Data Import
            DcmDspDidSignal: DcmDspDidDataPos=0, DcmDspDidDataRef=Data_Read_Active_Fault_Table_Read  # Diagnostics Data Import
          DID_PCAN_DBC_Version_Read: DcmDspDidIdentifier=61854, DcmDspDidInfoRef=DidInfo_DidInfo_PCAN_DBC_Version_Read  # Diagnostics Data Import
            DcmDspDidSignal: DcmDspDidDataPos=0, DcmDspDidDataRef=Data_PCAN_DBC_Version_Read  # Diagnostics Data Import
          DID_CANDBMatrixVer_Read: DcmDspDidIdentifier=61853, DcmDspDidInfoRef=DidInfo_DidInfo_CANDBMatrixVer_Read  # Diagnostics Data Import
            DcmDspDidSignal: DcmDspDidDataPos=0, DcmDspDidDataRef=Data_CANDBMatrixVer_Read  # Diagnostics Data Import
          DID_HardwareNumber_Read: DcmDspDidIdentifier=61841, DcmDspDidInfoRef=DidInfo_DidInfo_HardwareNumber_Read  # Diagnostics Data Import
            DcmDspDidSignal: DcmDspDidDataPos=0, DcmDspDidDataRef=Data_HardwareNumber_Read  # Diagnostics Data Import
          DID_VIN_Read: DcmDspDidIdentifier=61840, DcmDspDidInfoRef=DidInfo_DidInfo_VIN_Read  # Diagnostics Data Import
            DcmDspDidSignal: DcmDspDidDataPos=0, DcmDspDidDataRef=Data_VIN_Read  # Diagnostics Data Import
          DID_ECUBuildDate_Read: DcmDspDidIdentifier=61835, DcmDspDidInfoRef=DidInfo_DidInfo_ECUBuildDate_Read  # Diagnostics Data Import
            DcmDspDidSignal: DcmDspDidDataPos=0, DcmDspDidDataRef=Data_ECUBuildDate_Read  # Diagnostics Data Import
          DID_Base_Software_Version_number_Read: DcmDspDidIdentifier=61833, DcmDspDidInfoRef=DidInfo_DidInfo_Base_Software_Version_number_Read  # Diagnostics Data Import
            DcmDspDidSignal: DcmDspDidDataPos=0, DcmDspDidDataRef=Data_Base_Software_Version_number_Read  # Diagnostics Data Import
          DID_ActiveDiagnosticSessionDataIdentifier_Read: DcmDspDidIdentifier=61830, DcmDspDidInfoRef=DidInfo_DidInfo_ActiveDiagnosticSessionDataIdentifier_Read  # Diagnostics Data Import
            DcmDspDidSignal: DcmDspDidDataPos=0, DcmDspDidDataRef=Data_ActiveDiagnosticSessionDataIdentifier_Read  # Diagnostics Data Import
          DID_BootloaderNumber_Read: DcmDspDidIdentifier=61824, DcmDspDidInfoRef=DidInfo_DidInfo_BootloaderNumber_Read  # Diagnostics Data Import
            DcmDspDidSignal: DcmDspDidDataPos=0, DcmDspDidDataRef=Data_BootloaderNumber_Read  # Diagnostics Data Import
          DID_Boot_App_Identification_DID_Read: DcmDspDidIdentifier=61802, DcmDspDidInfoRef=DidInfo_DidInfo_Boot_App_Identification_DID_Read  # Diagnostics Data Import
            DcmDspDidSignal: DcmDspDidDataPos=0, DcmDspDidDataRef=Data_Boot_App_Identification_DID_Read  # Diagnostics Data Import
          DID_Software_Fingerprint_Read: DcmDspDidIdentifier=61786, DcmDspDidInfoRef=DidInfo_DidInfo_Software_Fingerprint_Read  # Diagnostics Data Import
            DcmDspDidSignal: DcmDspDidDataPos=0, DcmDspDidDataRef=Data_Software_Fingerprint_Read  # Diagnostics Data Import
          DID_Hardware_Version_number_Read: DcmDspDidIdentifier=61776, DcmDspDidInfoRef=DidInfo_DidInfo_Hardware_Version_number_Read  # Diagnostics Data Import
            DcmDspDidSignal: DcmDspDidDataPos=0, DcmDspDidDataRef=Data_Hardware_Version_number_Read  # Diagnostics Data Import
          DID_Static_Alignment_Result_Parameters_Read: DcmDspDidIdentifier=61468, DcmDspDidInfoRef=DidInfo_DidInfo_Static_Alignment_Result_Parameters_Read  # Diagnostics Data Import
            DcmDspDidSignal: DcmDspDidDataPos=0, DcmDspDidDataRef=Data_Static_Alignment_Result_Parameters_Read  # Diagnostics Data Import
          DID_Manual_Alignment_Execution_Read: DcmDspDidIdentifier=61467, DcmDspDidInfoRef=DidInfo_DidInfo_Manual_Alignment_Execution_Read  # Diagnostics Data Import
            DcmDspDidSignal: DcmDspDidDataPos=0, DcmDspDidDataRef=Data_Manual_Alignment_Execution_Read  # Diagnostics Data Import
          DID_Pin_Position_Status_Read: DcmDspDidIdentifier=61463, DcmDspDidInfoRef=DidInfo_DidInfo_Pin_Position_Status_Read  # Diagnostics Data Import
            DcmDspDidSignal: DcmDspDidDataPos=0, DcmDspDidDataRef=Data_Pin_Position_Status_Read  # Diagnostics Data Import
          DID_Auto_Alignment_Status_Information_Read: DcmDspDidIdentifier=61462, DcmDspDidInfoRef=DidInfo_DidInfo_Auto_Alignment_Status_Information_Read  # Diagnostics Data Import
            DcmDspDidSignal: DcmDspDidDataPos=0, DcmDspDidDataRef=Data_Auto_Alignment_Status_Information_Read  # Diagnostics Data Import
          DID_Service_Alignment_Result_Parameters_Read: DcmDspDidIdentifier=61461, DcmDspDidInfoRef=DidInfo_DidInfo_Service_Alignment_Result_Parameters_Read  # Diagnostics Data Import
            DcmDspDidSignal: DcmDspDidDataPos=0, DcmDspDidDataRef=Data_Service_Alignment_Result_Parameters_Read  # Diagnostics Data Import
          DID_Service_Alignment_Engineering_Non_Configuration_Parameters_Read: DcmDspDidIdentifier=61460, DcmDspDidInfoRef=DidInfo_DidInfo_Service_Alignment_Engineering_Non_Configuration_Parameters_Read  # Diagnostics Data Import
            DcmDspDidSignal: DcmDspDidDataPos=0, DcmDspDidDataRef=Data_Service_Alignment_Engineering_Non_Configuration_Parameters_Read  # Diagnostics Data Import
          DID_Static_Alignment_Engineering_Write_Configuration_Parameter_Write: DcmDspDidIdentifier=61459, DcmDspDidInfoRef=DidInfo_DidInfo_Static_Alignment_Engineering_Write_Configuration_Parameter_Write  # Diagnostics Data Import
            DcmDspDidSignal: DcmDspDidDataPos=0, DcmDspDidDataRef=Data_Static_Alignment_Engineering_Write_Configuration_Parameter_Write  # Diagnostics Data Import
          DID_Static_Alignment_Engineering_Read_Parameters_Read: DcmDspDidIdentifier=61458, DcmDspDidInfoRef=DidInfo_DidInfo_Static_Alignment_Engineering_Read_Parameters_Read  # Diagnostics Data Import
            DcmDspDidSignal: DcmDspDidDataPos=0, DcmDspDidDataRef=Data_Static_Alignment_Engineering_Read_Parameters_Read  # Diagnostics Data Import
          DID_Static_Alignment_Engineering_Non_Configuration_Parameters_Read: DcmDspDidIdentifier=61457, DcmDspDidInfoRef=DidInfo_DidInfo_Static_Alignment_Engineering_Non_Configuration_Parameters_Read  # Diagnostics Data Import
            DcmDspDidSignal: DcmDspDidDataPos=0, DcmDspDidDataRef=Data_Static_Alignment_Engineering_Non_Configuration_Parameters_Read  # Diagnostics Data Import
          DID_Vehicle_Variant_Read: DcmDspDidIdentifier=61456, DcmDspDidInfoRef=DidInfo_DidInfo_Vehicle_Variant_Read  # Diagnostics Data Import
            DcmDspDidSignal: DcmDspDidDataPos=0, DcmDspDidDataRef=Data_Vehicle_Variant_Read  # Diagnostics Data Import
          DID_Ego_Acceleration_Read: DcmDspDidIdentifier=40964, DcmDspDidInfoRef=DidInfo_DidInfo_Ego_Acceleration_Read  # Diagnostics Data Import
            DcmDspDidSignal: DcmDspDidDataPos=0, DcmDspDidDataRef=Data_Ego_Acceleration_Read  # Diagnostics Data Import
          DID_SMC_Part_No_and_Revision_Read: DcmDspDidIdentifier=40963, DcmDspDidInfoRef=DidInfo_DidInfo_SMC_Part_No_and_Revision_Read  # Diagnostics Data Import
            DcmDspDidSignal: DcmDspDidDataPos=0, DcmDspDidDataRef=Data_SMC_Part_No_and_Revision_Read  # Diagnostics Data Import
          DID_Dataset_Part_No_and_Revision_Read: DcmDspDidIdentifier=40962, DcmDspDidInfoRef=DidInfo_DidInfo_Dataset_Part_No_and_Revision_Read  # Diagnostics Data Import
            DcmDspDidSignal: DcmDspDidDataPos=0, DcmDspDidDataRef=Data_Dataset_Part_No_and_Revision_Read  # Diagnostics Data Import
          DID_SoftwareNumber_Read: DcmDspDidIdentifier=40961, DcmDspDidInfoRef=DidInfo_DidInfo_SoftwareNumber_Read  # Diagnostics Data Import
            DcmDspDidSignal: DcmDspDidDataPos=0, DcmDspDidDataRef=Data_SoftwareNumber_Read  # Diagnostics Data Import
          DID_SerialNumber_Read: DcmDspDidIdentifier=40960, DcmDspDidInfoRef=DidInfo_DidInfo_SerialNumber_Read  # Diagnostics Data Import
            DcmDspDidSignal: DcmDspDidDataPos=0, DcmDspDidDataRef=Data_SerialNumber_Read  # Diagnostics Data Import
          DID_Sensor_Availability_Flag_Read: DcmDspDidIdentifier=4375, DcmDspDidInfoRef=DidInfo_DidInfo_Sensor_Availability_Flag_Read  # Diagnostics Data Import
            DcmDspDidSignal: DcmDspDidDataPos=0, DcmDspDidDataRef=Data_Sensor_Availability_Flag_Read  # Diagnostics Data Import
          DID_DateandTime_Read: DcmDspDidIdentifier=4374, DcmDspDidInfoRef=DidInfo_DidInfo_DateandTime_Read  # Diagnostics Data Import
            DcmDspDidSignal: DcmDspDidDataPos=0, DcmDspDidDataRef=Data_DateandTime_Read  # Diagnostics Data Import
          DID_VehicleSpeed_Read: DcmDspDidIdentifier=4370, DcmDspDidInfoRef=DidInfo_DidInfo_VehicleSpeed_Read  # Diagnostics Data Import
            DcmDspDidSignal: DcmDspDidDataPos=0, DcmDspDidDataRef=Data_VehicleSpeed_Read  # Diagnostics Data Import
          DID_ECUVoltage_Read: DcmDspDidIdentifier=4369, DcmDspDidInfoRef=DidInfo_DidInfo_ECUVoltage_Read  # Diagnostics Data Import
            DcmDspDidSignal: DcmDspDidDataPos=0, DcmDspDidDataRef=Data_ECUVoltage_Read  # Diagnostics Data Import
        DataInfo_DataInfo_Read_Active_Fault_Table_Read (DcmDspDataInfo): DcmDspDataFixedLength=true  # Diagnostics Data Import
        Data_Read_Active_Fault_Table_Read (DcmDspData): DcmDspDataSize=176, DcmDspDataType=UINT8_N, DcmDspDataInfoRef=DataInfo_DataInfo_Read_Active_Fault_Table_Read  # Diagnostics Data Import
        DataInfo_DataInfo_PCAN_DBC_Version_Read (DcmDspDataInfo): DcmDspDataFixedLength=true  # Diagnostics Data Import
        Data_PCAN_DBC_Version_Read (DcmDspData): DcmDspDataSize=16, DcmDspDataType=UINT8_N, DcmDspDataInfoRef=DataInfo_DataInfo_PCAN_DBC_Version_Read  # Diagnostics Data Import
        DataInfo_DataInfo_CANDBMatrixVer_Read (DcmDspDataInfo): DcmDspDataFixedLength=true  # Diagnostics Data Import
        Data_CANDBMatrixVer_Read (DcmDspData): DcmDspDataSize=16, DcmDspDataType=UINT8_N, DcmDspDataInfoRef=DataInfo_DataInfo_CANDBMatrixVer_Read  # Diagnostics Data Import
        DataInfo_DataInfo_HardwareNumber_Read (DcmDspDataInfo): DcmDspDataFixedLength=true  # Diagnostics Data Import
        Data_HardwareNumber_Read (DcmDspData): DcmDspDataSize=104, DcmDspDataType=UINT8_N, DcmDspDataInfoRef=DataInfo_DataInfo_HardwareNumber_Read  # Diagnostics Data Import
        DataInfo_DataInfo_VIN_Read (DcmDspDataInfo): DcmDspDataFixedLength=true  # Diagnostics Data Import
        Data_VIN_Read (DcmDspData): DcmDspDataSize=136, DcmDspDataType=UINT8_N, DcmDspDataInfoRef=DataInfo_DataInfo_VIN_Read  # Diagnostics Data Import
        DataInfo_DataInfo_ECUBuildDate_Read (DcmDspDataInfo): DcmDspDataFixedLength=true  # Diagnostics Data Import
        Data_ECUBuildDate_Read (DcmDspData): DcmDspDataSize=32, DcmDspDataType=UINT8_N, DcmDspDataInfoRef=DataInfo_DataInfo_ECUBuildDate_Read  # Diagnostics Data Import
        DataInfo_DataInfo_Base_Software_Version_number_Read (DcmDspDataInfo): DcmDspDataFixedLength=true  # Diagnostics Data Import
        Data_Base_Software_Version_number_Read (DcmDspData): DcmDspDataSize=56, DcmDspDataType=UINT8_N, DcmDspDataInfoRef=DataInfo_DataInfo_Base_Software_Version_number_Read  # Diagnostics Data Import
        DataInfo_DataInfo_ActiveDiagnosticSessionDataIdentifier_Read (DcmDspDataInfo): DcmDspDataFixedLength=true  # Diagnostics Data Import
        Data_ActiveDiagnosticSessionDataIdentifier_Read (DcmDspData): DcmDspDataSize=8, DcmDspDataType=UINT8_N, DcmDspDataInfoRef=DataInfo_DataInfo_ActiveDiagnosticSessionDataIdentifier_Read  # Diagnostics Data Import
        DataInfo_DataInfo_BootloaderNumber_Read (DcmDspDataInfo): DcmDspDataFixedLength=true  # Diagnostics Data Import
        Data_BootloaderNumber_Read (DcmDspData): DcmDspDataSize=96, DcmDspDataType=UINT8_N, DcmDspDataInfoRef=DataInfo_DataInfo_BootloaderNumber_Read  # Diagnostics Data Import
        DataInfo_DataInfo_Boot_App_Identification_DID_Read (DcmDspDataInfo): DcmDspDataFixedLength=true  # Diagnostics Data Import
        Data_Boot_App_Identification_DID_Read (DcmDspData): DcmDspDataSize=8, DcmDspDataType=UINT8_N, DcmDspDataInfoRef=DataInfo_DataInfo_Boot_App_Identification_DID_Read  # Diagnostics Data Import
        DataInfo_DataInfo_Software_Fingerprint_Read (DcmDspDataInfo): DcmDspDataFixedLength=true  # Diagnostics Data Import
        Data_Software_Fingerprint_Read (DcmDspData): DcmDspDataSize=32, DcmDspDataType=UINT8_N, DcmDspDataInfoRef=DataInfo_DataInfo_Software_Fingerprint_Read  # Diagnostics Data Import
        DataInfo_DataInfo_Hardware_Version_number_Read (DcmDspDataInfo): DcmDspDataFixedLength=true  # Diagnostics Data Import
        Data_Hardware_Version_number_Read (DcmDspData): DcmDspDataSize=40, DcmDspDataType=UINT8_N, DcmDspDataInfoRef=DataInfo_DataInfo_Hardware_Version_number_Read  # Diagnostics Data Import
        DataInfo_DataInfo_Static_Alignment_Result_Parameters_Read (DcmDspDataInfo): DcmDspDataFixedLength=true  # Diagnostics Data Import
        Data_Static_Alignment_Result_Parameters_Read (DcmDspData): DcmDspDataSize=440, DcmDspDataType=UINT8_N, DcmDspDataInfoRef=DataInfo_DataInfo_Static_Alignment_Result_Parameters_Read  # Diagnostics Data Import
        DataInfo_DataInfo_Manual_Alignment_Execution_Read (DcmDspDataInfo): DcmDspDataFixedLength=true  # Diagnostics Data Import
        Data_Manual_Alignment_Execution_Read (DcmDspData): DcmDspDataSize=80, DcmDspDataType=UINT8_N, DcmDspDataInfoRef=DataInfo_DataInfo_Manual_Alignment_Execution_Read  # Diagnostics Data Import
        DataInfo_DataInfo_Pin_Position_Status_Read (DcmDspDataInfo): DcmDspDataFixedLength=true  # Diagnostics Data Import
        Data_Pin_Position_Status_Read (DcmDspData): DcmDspDataSize=16, DcmDspDataType=UINT8_N, DcmDspDataInfoRef=DataInfo_DataInfo_Pin_Position_Status_Read  # Diagnostics Data Import
        DataInfo_DataInfo_Auto_Alignment_Status_Information_Read (DcmDspDataInfo): DcmDspDataFixedLength=true  # Diagnostics Data Import
        Data_Auto_Alignment_Status_Information_Read (DcmDspData): DcmDspDataSize=744, DcmDspDataType=UINT8_N, DcmDspDataInfoRef=DataInfo_DataInfo_Auto_Alignment_Status_Information_Read  # Diagnostics Data Import
        DataInfo_DataInfo_Service_Alignment_Result_Parameters_Read (DcmDspDataInfo): DcmDspDataFixedLength=true  # Diagnostics Data Import
        Data_Service_Alignment_Result_Parameters_Read (DcmDspData): DcmDspDataSize=696, DcmDspDataType=UINT8_N, DcmDspDataInfoRef=DataInfo_DataInfo_Service_Alignment_Result_Parameters_Read  # Diagnostics Data Import
        DataInfo_DataInfo_Service_Alignment_Engineering_Non_Configuration_Parameters_Read (DcmDspDataInfo): DcmDspDataFixedLength=true  # Diagnostics Data Import
        Data_Service_Alignment_Engineering_Non_Configuration_Parameters_Read (DcmDspData): DcmDspDataSize=112, DcmDspDataType=UINT8_N, DcmDspDataInfoRef=DataInfo_DataInfo_Service_Alignment_Engineering_Non_Configuration_Parameters_Read  # Diagnostics Data Import
        DataInfo_DataInfo_Static_Alignment_Engineering_Write_Configuration_Parameter_Write (DcmDspDataInfo): DcmDspDataFixedLength=true  # Diagnostics Data Import
        Data_Static_Alignment_Engineering_Write_Configuration_Parameter_Write (DcmDspData): DcmDspDataSize=48, DcmDspDataType=UINT8_N, DcmDspDataInfoRef=DataInfo_DataInfo_Static_Alignment_Engineering_Write_Configuration_Parameter_Write  # Diagnostics Data Import
        DataInfo_DataInfo_Static_Alignment_Engineering_Read_Parameters_Read (DcmDspDataInfo): DcmDspDataFixedLength=true  # Diagnostics Data Import
        Data_Static_Alignment_Engineering_Read_Parameters_Read (DcmDspData): DcmDspDataSize=176, DcmDspDataType=UINT8_N, DcmDspDataInfoRef=DataInfo_DataInfo_Static_Alignment_Engineering_Read_Parameters_Read  # Diagnostics Data Import
        DataInfo_DataInfo_Static_Alignment_Engineering_Non_Configuration_Parameters_Read (DcmDspDataInfo): DcmDspDataFixedLength=true  # Diagnostics Data Import
        Data_Static_Alignment_Engineering_Non_Configuration_Parameters_Read (DcmDspData): DcmDspDataSize=336, DcmDspDataType=UINT8_N, DcmDspDataInfoRef=DataInfo_DataInfo_Static_Alignment_Engineering_Non_Configuration_Parameters_Read  # Diagnostics Data Import
        DataInfo_DataInfo_Vehicle_Variant_Read (DcmDspDataInfo): DcmDspDataFixedLength=true  # Diagnostics Data Import
        Data_Vehicle_Variant_Read (DcmDspData): DcmDspDataSize=8, DcmDspDataType=UINT8_N, DcmDspDataInfoRef=DataInfo_DataInfo_Vehicle_Variant_Read  # Diagnostics Data Import
        DataInfo_DataInfo_Ego_Acceleration_Read (DcmDspDataInfo): DcmDspDataFixedLength=true  # Diagnostics Data Import
        Data_Ego_Acceleration_Read (DcmDspData): DcmDspDataSize=8, DcmDspDataType=UINT8_N, DcmDspDataInfoRef=DataInfo_DataInfo_Ego_Acceleration_Read  # Diagnostics Data Import
        DataInfo_DataInfo_SMC_Part_No_and_Revision_Read (DcmDspDataInfo): DcmDspDataFixedLength=true  # Diagnostics Data Import
        Data_SMC_Part_No_and_Revision_Read (DcmDspData): DcmDspDataSize=96, DcmDspDataType=UINT8_N, DcmDspDataInfoRef=DataInfo_DataInfo_SMC_Part_No_and_Revision_Read  # Diagnostics Data Import
        DataInfo_DataInfo_Dataset_Part_No_and_Revision_Read (DcmDspDataInfo): DcmDspDataFixedLength=true  # Diagnostics Data Import
        Data_Dataset_Part_No_and_Revision_Read (DcmDspData): DcmDspDataSize=96, DcmDspDataType=UINT8_N, DcmDspDataInfoRef=DataInfo_DataInfo_Dataset_Part_No_and_Revision_Read  # Diagnostics Data Import
        DataInfo_DataInfo_SoftwareNumber_Read (DcmDspDataInfo): DcmDspDataFixedLength=true  # Diagnostics Data Import
        Data_SoftwareNumber_Read (DcmDspData): DcmDspDataSize=112, DcmDspDataType=UINT8_N, DcmDspDataInfoRef=DataInfo_DataInfo_SoftwareNumber_Read  # Diagnostics Data Import
        DataInfo_DataInfo_SerialNumber_Read (DcmDspDataInfo): DcmDspDataFixedLength=true  # Diagnostics Data Import
        Data_SerialNumber_Read (DcmDspData): DcmDspDataSize=128, DcmDspDataType=UINT8_N, DcmDspDataInfoRef=DataInfo_DataInfo_SerialNumber_Read  # Diagnostics Data Import
        DataInfo_DataInfo_Sensor_Availability_Flag_Read (DcmDspDataInfo): DcmDspDataFixedLength=true  # Diagnostics Data Import
        Data_Sensor_Availability_Flag_Read (DcmDspData): DcmDspDataSize=8, DcmDspDataType=UINT8_N, DcmDspDataInfoRef=DataInfo_DataInfo_Sensor_Availability_Flag_Read  # Diagnostics Data Import
        DataInfo_DataInfo_DateandTime_Read (DcmDspDataInfo): DcmDspDataFixedLength=true  # Diagnostics Data Import
        Data_DateandTime_Read (DcmDspData): DcmDspDataSize=56, DcmDspDataType=UINT8_N, DcmDspDataInfoRef=DataInfo_DataInfo_DateandTime_Read  # Diagnostics Data Import
        DataInfo_DataInfo_VehicleSpeed_Read (DcmDspDataInfo): DcmDspDataFixedLength=true  # Diagnostics Data Import
        Data_VehicleSpeed_Read (DcmDspData): DcmDspDataSize=16, DcmDspDataType=UINT8_N, DcmDspDataInfoRef=DataInfo_DataInfo_VehicleSpeed_Read  # Diagnostics Data Import
        DataInfo_DataInfo_ECUVoltage_Read (DcmDspDataInfo): DcmDspDataFixedLength=true  # Diagnostics Data Import
        Data_ECUVoltage_Read (DcmDspData): DcmDspDataSize=16, DcmDspDataType=UINT8_N, DcmDspDataInfoRef=DataInfo_DataInfo_ECUVoltage_Read  # Diagnostics Data Import
      DcmDsd  # Diagnostics Data Import
        DcmDsdServiceTable  # Diagnostics Data Import
          14 x DcmDsdService:
            ControlDtcSetting: DcmDsdSidTabServiceId=133, DcmDsdSidTabSubfuncAvail=true, DcmDsdSidTabSessionLevelRef=DcmDspSession/Extended, DcmDsdSidTabSecurityLevelRef=UnlockedL1  # Diagnostics Data Import
              Disable (DcmDsdSubService): DcmDsdSubServiceId=2, DcmDsdSubServiceSessionLevelRef=DcmDspSession/Extended, DcmDsdSubServiceSecurityLevelRef=UnlockedL1  # Diagnostics Data Import
              Enable (DcmDsdSubService): DcmDsdSubServiceId=1, DcmDsdSubServiceSessionLevelRef=DcmDspSession/Extended, DcmDsdSubServiceSecurityLevelRef=UnlockedL1  # Diagnostics Data Import
            TesterPresent: DcmDsdSidTabServiceId=62, DcmDsdSidTabSubfuncAvail=true  # Diagnostics Data Import
              TesterPresent (DcmDsdSubService): DcmDsdSubServiceId=0  # Diagnostics Data Import
            RequestTransferExit: DcmDsdSidTabServiceId=55, DcmDsdSidTabSubfuncAvail=false, DcmDsdSidTabSessionLevelRef=DcmDspSession/Programming  # Diagnostics Data Import
            TransferData: DcmDsdSidTabServiceId=54, DcmDsdSidTabSubfuncAvail=false, DcmDsdSidTabSessionLevelRef=DcmDspSession/Programming  # Diagnostics Data Import
            RequestDownload: DcmDsdSidTabServiceId=52, DcmDsdSidTabSubfuncAvail=false, DcmDsdSidTabSessionLevelRef=DcmDspSession/Programming  # Diagnostics Data Import
            RoutineControl: DcmDsdSidTabServiceId=49, DcmDsdSidTabSubfuncAvail=true, DcmDsdSidTabSessionLevelRef=DcmDspSession/Programming, DcmDsdSidTabSessionLevelRef=DcmDspSession/Extended  # Diagnostics Data Import
            WriteDataById: DcmDsdSidTabServiceId=46, DcmDsdSidTabSubfuncAvail=false, DcmDsdSidTabSessionLevelRef=DcmDspSession/Programming, DcmDsdSidTabSessionLevelRef=DcmDspSession/Extended, DcmDsdSidTabSecurityLevelRef=UnlockedL1  # Diagnostics Data Import
            CommunicationControl: DcmDsdSidTabServiceId=40, DcmDsdSidTabSubfuncAvail=true, DcmDsdSidTabSessionLevelRef=DcmDspSession/Extended, DcmDsdSidTabSecurityLevelRef=UnlockedL1  # Diagnostics Data Import
              4 x DcmDsdSubService, all with DcmDsdSubServiceSessionLevelRef=DcmDspSession/Extended, DcmDsdSubServiceSecurityLevelRef=UnlockedL1:
                DisableRxAndTx: DcmDsdSubServiceId=3  # Diagnostics Data Import
                DisableRxAndEnableTx: DcmDsdSubServiceId=2  # Diagnostics Data Import
                EnableRxAndDisableTx: DcmDsdSubServiceId=1  # Diagnostics Data Import
                EnableRxAndTx: DcmDsdSubServiceId=0  # Diagnostics Data Import
            SecurityAccess: DcmDsdSidTabServiceId=39, DcmDsdSidTabSubfuncAvail=true, DcmDsdSidTabSessionLevelRef=DcmDspSession/Programming, DcmDsdSidTabSessionLevelRef=DcmDspSession/Extended  # Diagnostics Data Import
              KeyL6_Send (DcmDsdSubService): DcmDsdSubServiceId=12, DcmDsdSubServiceSessionLevelRef=DcmDspSession/Programming, DcmDsdSubServiceSessionLevelRef=DcmDspSession/Extended  # Diagnostics Data Import
              SeedL6_Request (DcmDsdSubService): DcmDsdSubServiceId=11, DcmDsdSubServiceSessionLevelRef=DcmDspSession/Programming, DcmDsdSubServiceSessionLevelRef=DcmDspSession/Extended  # Diagnostics Data Import
            ReadDataById: DcmDsdSidTabServiceId=34, DcmDsdSidTabSubfuncAvail=false  # Diagnostics Data Import
            ReadDtcInfo: DcmDsdSidTabServiceId=25, DcmDsdSidTabSubfuncAvail=true, DcmDsdSidTabSessionLevelRef=DcmDspSession/Default, DcmDsdSidTabSessionLevelRef=DcmDspSession/Extended  # Diagnostics Data Import
              3 x DcmDsdSubService, all with DcmDsdSubServiceSessionLevelRef=DcmDspSession/Default, DcmDsdSubServiceSessionLevelRef=DcmDspSession/Extended:
                RDTCEDRBDN: DcmDsdSubServiceId=6  # Diagnostics Data Import
                RDTCSSBDTC: DcmDsdSubServiceId=4  # Diagnostics Data Import
                RDTCBSM: DcmDsdSubServiceId=2  # Diagnostics Data Import
            ClearDiagInfo: DcmDsdSidTabServiceId=20, DcmDsdSidTabSubfuncAvail=false, DcmDsdSidTabSessionLevelRef=DcmDspSession/Default, DcmDsdSidTabSessionLevelRef=DcmDspSession/Extended  # Diagnostics Data Import
            EcuReset: DcmDsdSidTabServiceId=17, DcmDsdSidTabSubfuncAvail=true  # Diagnostics Data Import
              Soft (DcmDsdSubService): DcmDsdSubServiceId=3  # Diagnostics Data Import
              Hard (DcmDsdSubService): DcmDsdSubServiceId=1  # Diagnostics Data Import
            DiagSessionControl: DcmDsdSidTabServiceId=16, DcmDsdSidTabSubfuncAvail=true  # Diagnostics Data Import
              3 x DcmDsdSubService:
                Extended: DcmDsdSubServiceId=3, DcmDsdSubServiceSessionLevelRef=DcmDspSession/Default, DcmDsdSubServiceSessionLevelRef=DcmDspSession/Extended  # Diagnostics Data Import
                Programming: DcmDsdSubServiceId=2, DcmDsdSubServiceSessionLevelRef=DcmDspSession/Programming, DcmDsdSubServiceSessionLevelRef=DcmDspSession/Extended, DcmDsdSubServiceSecurityLevelRef=UnlockedL1  # Diagnostics Data Import
                Default: DcmDsdSubServiceId=1  # Diagnostics Data Import
      DcmGeneral: DcmResetToFblAfterSessionFinalResponseEnabled=false  # Diagnostics Data Import
