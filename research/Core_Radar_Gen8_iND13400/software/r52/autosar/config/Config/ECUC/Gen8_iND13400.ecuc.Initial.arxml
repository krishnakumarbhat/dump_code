[part 6 of 24: package /InitialEcuC]
AUTOSAR XML (schema 00053)
package /InitialEcuC  (continued)
  module config Com  (continued)
    ComConfig  (continued)
      242 x ComSignalGroup, all with ComTransferProperty=PENDING:  (continued)
        SG_Detections_021_024_oRDR_DETECTION_021_024_oPCAN_RADAR_ea3d35f7_Tx: ComSystemTemplateSignalGroupRef=SG_Detections_021_024
          83 x ComGroupSignal, all with ComSignalEndianness=LITTLE_ENDIAN, ComTransferProperty=PENDING:
            DET_AZIMUTH_021_oRDR_DETECTION_021_024_oPCAN_RADAR_fab64216_Tx: ComBitPosition=88, ComBitSize=13, ComSignalInitValue=0, ComSignalType=UINT16, ComSystemTemplateSystemSignalRef=DET_AZIMUTH_021
            DET_AZIMUTH_022_oRDR_DETECTION_021_024_oPCAN_RADAR_9e5639e8_Tx: ComBitPosition=200, ComBitSize=13, ComSignalInitValue=0, ComSignalType=UINT16, ComSystemTemplateSystemSignalRef=DET_AZIMUTH_022
            DET_AZIMUTH_023_oRDR_DETECTION_021_024_oPCAN_RADAR_0b26ed7d_Tx: ComBitPosition=312, ComBitSize=13, ComSignalInitValue=0, ComSignalType=UINT16, ComSystemTemplateSystemSignalRef=DET_AZIMUTH_023
            DET_AZIMUTH_024_oRDR_DETECTION_021_024_oPCAN_RADAR_5796ce14_Tx: ComBitPosition=424, ComBitSize=13, ComSignalInitValue=0, ComSignalType=UINT16, ComSystemTemplateSystemSignalRef=DET_AZIMUTH_024
            DET_AZIMUTH_ERR_021_oRDR_DETECTION_021_024_oPCAN_RADAR_5e03d7e3_Tx: ComBitPosition=105, ComBitSize=7, ComSignalInitValue=0, ComSignalType=UINT8, ComSystemTemplateSystemSignalRef=DET_AZIMUTH_ERR_021
            DET_AZIMUTH_ERR_022_oRDR_DETECTION_021_024_oPCAN_RADAR_3ae3ac1d_Tx: ComBitPosition=217, ComBitSize=7, ComSignalInitValue=0, ComSignalType=UINT8, ComSystemTemplateSystemSignalRef=DET_AZIMUTH_ERR_022
            DET_AZIMUTH_ERR_023_oRDR_DETECTION_021_024_oPCAN_RADAR_af937888_Tx: ComBitPosition=329, ComBitSize=7, ComSignalInitValue=0, ComSignalType=UINT8, ComSystemTemplateSystemSignalRef=DET_AZIMUTH_ERR_023
            DET_AZIMUTH_ERR_024_oRDR_DETECTION_021_024_oPCAN_RADAR_f3235be1_Tx: ComBitPosition=441, ComBitSize=7, ComSignalInitValue=0, ComSignalType=UINT8, ComSystemTemplateSystemSignalRef=DET_AZIMUTH_ERR_024
            DET_BELOW_RAIN_THOLD_021_oRDR_DETECTION_021_024_oPCAN_RADAR_2fb7d1d6_Tx: ComBitPosition=39, ComBitSize=1, ComSignalInitValue=0, ComSignalType=BOOLEAN, ComSystemTemplateSystemSignalRef=DET_BELOW_RAIN_THOLD_021
            DET_BELOW_RAIN_THOLD_022_oRDR_DETECTION_021_024_oPCAN_RADAR_4b57aa28_Tx: ComBitPosition=151, ComBitSize=1, ComSignalInitValue=0, ComSignalType=BOOLEAN, ComSystemTemplateSystemSignalRef=DET_BELOW_RAIN_THOLD_022
            DET_BELOW_RAIN_THOLD_023_oRDR_DETECTION_021_024_oPCAN_RADAR_de277ebd_Tx: ComBitPosition=263, ComBitSize=1, ComSignalInitValue=0, ComSignalType=BOOLEAN, ComSystemTemplateSystemSignalRef=DET_BELOW_RAIN_THOLD_023
            DET_BELOW_RAIN_THOLD_024_oRDR_DETECTION_021_024_oPCAN_RADAR_82975dd4_Tx: ComBitPosition=375, ComBitSize=1, ComSignalInitValue=0, ComSignalType=BOOLEAN, ComSystemTemplateSystemSignalRef=DET_BELOW_RAIN_THOLD_024
            DET_BI_STATIC_FLAG_021_oRDR_DETECTION_021_024_oPCAN_RADAR_ac9a0293_Tx: ComBitPosition=104, ComBitSize=1, ComSignalInitValue=0, ComSignalType=BOOLEAN, ComSystemTemplateSystemSignalRef=DET_BI_STATIC_FLAG_021
            DET_BI_STATIC_FLAG_022_oRDR_DETECTION_021_024_oPCAN_RADAR_c87a796d_Tx: ComBitPosition=216, ComBitSize=1, ComSignalInitValue=0, ComSignalType=BOOLEAN, ComSystemTemplateSystemSignalRef=DET_BI_STATIC_FLAG_022
            DET_BI_STATIC_FLAG_023_oRDR_DETECTION_021_024_oPCAN_RADAR_5d0aadf8_Tx: ComBitPosition=328, ComBitSize=1, ComSignalInitValue=0, ComSignalType=BOOLEAN, ComSystemTemplateSystemSignalRef=DET_BI_STATIC_FLAG_023
            DET_BI_STATIC_FLAG_024_oRDR_DETECTION_021_024_oPCAN_RADAR_01ba8e91_Tx: ComBitPosition=440, ComBitSize=1, ComSignalInitValue=0, ComSignalType=BOOLEAN, ComSystemTemplateSystemSignalRef=DET_BI_STATIC_FLAG_024
            DET_CONFD_AZIMUTH_021_oRDR_DETECTION_021_024_oPCAN_RADAR_f85048dc_Tx: ComBitPosition=118, ComBitSize=2, ComSignalInitValue=0, ComSignalType=UINT8, ComSystemTemplateSystemSignalRef=DET_CONFD_AZIMUTH_021
            DET_CONFD_AZIMUTH_022_oRDR_DETECTION_021_024_oPCAN_RADAR_9cb03322_Tx: ComBitPosition=230, ComBitSize=2, ComSignalInitValue=0, ComSignalType=UINT8, ComSystemTemplateSystemSignalRef=DET_CONFD_AZIMUTH_022
            DET_CONFD_AZIMUTH_023_oRDR_DETECTION_021_024_oPCAN_RADAR_09c0e7b7_Tx: ComBitPosition=342, ComBitSize=2, ComSignalInitValue=0, ComSignalType=UINT8, ComSystemTemplateSystemSignalRef=DET_CONFD_AZIMUTH_023
            DET_CONFD_AZIMUTH_024_oRDR_DETECTION_021_024_oPCAN_RADAR_5570c4de_Tx: ComBitPosition=454, ComBitSize=2, ComSignalInitValue=0, ComSignalType=UINT8, ComSystemTemplateSystemSignalRef=DET_CONFD_AZIMUTH_024
            DET_CONFD_ELEVATION_021_oRDR_DETECTION_021_024_oPCAN_RADAR_fac54926_Tx: ComBitPosition=101, ComBitSize=2, ComSignalInitValue=0, ComSignalType=UINT8, ComSystemTemplateSystemSignalRef=DET_CONFD_ELEVATION_021
            DET_CONFD_ELEVATION_022_oRDR_DETECTION_021_024_oPCAN_RADAR_9e2532d8_Tx: ComBitPosition=213, ComBitSize=2, ComSignalInitValue=0, ComSignalType=UINT8, ComSystemTemplateSystemSignalRef=DET_CONFD_ELEVATION_022
            DET_CONFD_ELEVATION_023_oRDR_DETECTION_021_024_oPCAN_RADAR_0b55e64d_Tx: ComBitPosition=325, ComBitSize=2, ComSignalInitValue=0, ComSignalType=UINT8, ComSystemTemplateSystemSignalRef=DET_CONFD_ELEVATION_023
            DET_CONFD_ELEVATION_024_oRDR_DETECTION_021_024_oPCAN_RADAR_57e5c524_Tx: ComBitPosition=437, ComBitSize=2, ComSignalInitValue=0, ComSignalType=UINT8, ComSystemTemplateSystemSignalRef=DET_CONFD_ELEVATION_024
            DET_ELEVATION_021_oRDR_DETECTION_021_024_oPCAN_RADAR_2b059d1a_Tx: ComBitPosition=72, ComBitSize=8, ComSignalInitValue=0, ComSignalType=UINT8, ComSystemTemplateSystemSignalRef=DET_ELEVATION_021
            DET_ELEVATION_022_oRDR_DETECTION_021_024_oPCAN_RADAR_4fe5e6e4_Tx: ComBitPosition=184, ComBitSize=8, ComSignalInitValue=0, ComSignalType=UINT8, ComSystemTemplateSystemSignalRef=DET_ELEVATION_022
            DET_ELEVATION_023_oRDR_DETECTION_021_024_oPCAN_RADAR_da953271_Tx: ComBitPosition=296, ComBitSize=8, ComSignalInitValue=0, ComSignalType=UINT8, ComSystemTemplateSystemSignalRef=DET_ELEVATION_023
            DET_ELEVATION_024_oRDR_DETECTION_021_024_oPCAN_RADAR_86251118_Tx: ComBitPosition=408, ComBitSize=8, ComSignalInitValue=0, ComSignalType=UINT8, ComSystemTemplateSystemSignalRef=DET_ELEVATION_024
            DET_ELEVATION_ERR_021_oRDR_DETECTION_021_024_oPCAN_RADAR_ac3c056f_Tx: ComBitPosition=80, ComBitSize=6, ComSignalInitValue=0, ComSignalType=UINT8, ComSystemTemplateSystemSignalRef=DET_ELEVATION_ERR_021
            DET_ELEVATION_ERR_022_oRDR_DETECTION_021_024_oPCAN_RADAR_c8dc7e91_Tx: ComBitPosition=192, ComBitSize=6, ComSignalInitValue=0, ComSignalType=UINT8, ComSystemTemplateSystemSignalRef=DET_ELEVATION_ERR_022
            DET_ELEVATION_ERR_023_oRDR_DETECTION_021_024_oPCAN_RADAR_5dacaa04_Tx: ComBitPosition=304, ComBitSize=6, ComSignalInitValue=0, ComSignalType=UINT8, ComSystemTemplateSystemSignalRef=DET_ELEVATION_ERR_023
            DET_ELEVATION_ERR_024_oRDR_DETECTION_021_024_oPCAN_RADAR_011c896d_Tx: ComBitPosition=416, ComBitSize=6, ComSignalInitValue=0, ComSignalType=UINT8, ComSystemTemplateSystemSignalRef=DET_ELEVATION_ERR_024
            DET_EXISTENCE_PROB_021_oRDR_DETECTION_021_024_oPCAN_RADAR_7ea3700f_Tx: ComBitPosition=112, ComBitSize=6, ComSignalInitValue=0, ComSignalType=UINT8, ComSystemTemplateSystemSignalRef=DET_EXISTENCE_PROB_021
            DET_EXISTENCE_PROB_022_oRDR_DETECTION_021_024_oPCAN_RADAR_1a430bf1_Tx: ComBitPosition=224, ComBitSize=6, ComSignalInitValue=0, ComSignalType=UINT8, ComSystemTemplateSystemSignalRef=DET_EXISTENCE_PROB_022
            DET_EXISTENCE_PROB_023_oRDR_DETECTION_021_024_oPCAN_RADAR_8f33df64_Tx: ComBitPosition=336, ComBitSize=6, ComSignalInitValue=0, ComSignalType=UINT8, ComSystemTemplateSystemSignalRef=DET_EXISTENCE_PROB_023
            DET_EXISTENCE_PROB_024_oRDR_DETECTION_021_024_oPCAN_RADAR_d383fc0d_Tx: ComBitPosition=448, ComBitSize=6, ComSignalInitValue=0, ComSignalType=UINT8, ComSystemTemplateSystemSignalRef=DET_EXISTENCE_PROB_024
            DET_HVC_FLAG_021_oRDR_DETECTION_021_024_oPCAN_RADAR_9fd73370_Tx: ComBitPosition=86, ComBitSize=1, ComSignalInitValue=0, ComSignalType=BOOLEAN, ComSystemTemplateSystemSignalRef=DET_HVC_FLAG_021
            DET_HVC_FLAG_022_oRDR_DETECTION_021_024_oPCAN_RADAR_fb37488e_Tx: ComBitPosition=198, ComBitSize=1, ComSignalInitValue=0, ComSignalType=BOOLEAN, ComSystemTemplateSystemSignalRef=DET_HVC_FLAG_022
            DET_HVC_FLAG_023_oRDR_DETECTION_021_024_oPCAN_RADAR_6e479c1b_Tx: ComBitPosition=310, ComBitSize=1, ComSignalInitValue=0, ComSignalType=BOOLEAN, ComSystemTemplateSystemSignalRef=DET_HVC_FLAG_023
            DET_HVC_FLAG_024_oRDR_DETECTION_021_024_oPCAN_RADAR_32f7bf72_Tx: ComBitPosition=422, ComBitSize=1, ComSignalInitValue=0, ComSignalType=BOOLEAN, ComSystemTemplateSystemSignalRef=DET_HVC_FLAG_024
            DET_IDM_021_oRDR_DETECTION_021_024_oPCAN_RADAR_148508cd_Tx: ComBitPosition=63, ComBitSize=1, ComSignalInitValue=0, ComSignalType=BOOLEAN, ComSystemTemplateSystemSignalRef=DET_IDM_021
            DET_IDM_022_oRDR_DETECTION_021_024_oPCAN_RADAR_70657333_Tx: ComBitPosition=175, ComBitSize=1, ComSignalInitValue=0, ComSignalType=BOOLEAN, ComSystemTemplateSystemSignalRef=DET_IDM_022
            DET_IDM_023_oRDR_DETECTION_021_024_oPCAN_RADAR_e515a7a6_Tx: ComBitPosition=287, ComBitSize=1, ComSignalInitValue=0, ComSignalType=BOOLEAN, ComSystemTemplateSystemSignalRef=DET_IDM_023
            DET_IDM_024_oRDR_DETECTION_021_024_oPCAN_RADAR_b9a584cf_Tx: ComBitPosition=399, ComBitSize=1, ComSignalInitValue=0, ComSignalType=BOOLEAN, ComSystemTemplateSystemSignalRef=DET_IDM_024
            DET_MH_CRC16_021_024_oRDR_DETECTION_021_024_oPCAN_RADAR_6eb5e7fc_Tx: ComBitPosition=0, ComBitSize=16, ComSignalInitValue=0, ComSignalType=UINT16, ComSystemTemplateSystemSignalRef=DET_MH_CRC16_021_024
            DET_MH_CYCLE_COUNTER_021_024_oRDR_DETECTION_021_024_oPCAN_RADAR_eac046cb_Tx: ComBitPosition=16, ComBitSize=8, ComSignalInitValue=0, ComSignalType=UINT8, ComSystemTemplateSystemSignalRef=DET_MH_CYCLE_COUNTER_021_024
            DET_MH_SCAN_INDEX_4LSB_021_024_oRDR_DETECTION_021_024_oPCAN_RADAR_26ea6347_Tx: ComBitPosition=476, ComBitSize=4, ComSignalInitValue=0, ComSignalType=UINT8, ComSystemTemplateSystemSignalRef=DET_MH_SCAN_INDEX_4LSB_021_024
            DET_MTD_021_oRDR_DETECTION_021_024_oPCAN_RADAR_72363a16_Tx: ComBitPosition=47, ComBitSize=1, ComSignalInitValue=0, ComSignalType=BOOLEAN, ComSystemTemplateSystemSignalRef=DET_MTD_021
            DET_MTD_022_oRDR_DETECTION_021_024_oPCAN_RADAR_16d641e8_Tx: ComBitPosition=159, ComBitSize=1, ComSignalInitValue=0, ComSignalType=BOOLEAN, ComSystemTemplateSystemSignalRef=DET_MTD_022
            DET_MTD_023_oRDR_DETECTION_021_024_oPCAN_RADAR_83a6957d_Tx: ComBitPosition=271, ComBitSize=1, ComSignalInitValue=0, ComSignalType=BOOLEAN, ComSystemTemplateSystemSignalRef=DET_MTD_023
            DET_MTD_024_oRDR_DETECTION_021_024_oPCAN_RADAR_df16b614_Tx: ComBitPosition=383, ComBitSize=1, ComSignalInitValue=0, ComSignalType=BOOLEAN, ComSystemTemplateSystemSignalRef=DET_MTD_024
            DET_PROB_1STAZHYPO_021_oRDR_DETECTION_021_024_oPCAN_RADAR_e182d2db_Tx: ComBitPosition=103, ComBitSize=1, ComSignalInitValue=0, ComSignalType=BOOLEAN, ComSystemTemplateSystemSignalRef=DET_PROB_1STAZHYPO_021
            DET_PROB_1STAZHYPO_022_oRDR_DETECTION_021_024_oPCAN_RADAR_8562a925_Tx: ComBitPosition=215, ComBitSize=1, ComSignalInitValue=0, ComSignalType=BOOLEAN, ComSystemTemplateSystemSignalRef=DET_PROB_1STAZHYPO_022
            DET_PROB_1STAZHYPO_023_oRDR_DETECTION_021_024_oPCAN_RADAR_10127db0_Tx: ComBitPosition=327, ComBitSize=1, ComSignalInitValue=0, ComSignalType=BOOLEAN, ComSystemTemplateSystemSignalRef=DET_PROB_1STAZHYPO_023
            DET_PROB_1STAZHYPO_024_oRDR_DETECTION_021_024_oPCAN_RADAR_4ca25ed9_Tx: ComBitPosition=439, ComBitSize=1, ComSignalInitValue=0, ComSignalType=BOOLEAN, ComSystemTemplateSystemSignalRef=DET_PROB_1STAZHYPO_024
            DET_RANGE_021_oRDR_DETECTION_021_024_oPCAN_RADAR_ea2d31ad_Tx: ComBitPosition=24, ComBitSize=15, ComSignalInitValue=0, ComSignalType=UINT16, ComSystemTemplateSystemSignalRef=DET_RANGE_021
            DET_RANGE_022_oRDR_DETECTION_021_024_oPCAN_RADAR_8ecd4a53_Tx: ComBitPosition=136, ComBitSize=15, ComSignalInitValue=0, ComSignalType=UINT16, ComSystemTemplateSystemSignalRef=DET_RANGE_022
            DET_RANGE_023_oRDR_DETECTION_021_024_oPCAN_RADAR_1bbd9ec6_Tx: ComBitPosition=248, ComBitSize=15, ComSignalInitValue=0, ComSignalType=UINT16, ComSystemTemplateSystemSignalRef=DET_RANGE_023
            DET_RANGE_024_oRDR_DETECTION_021_024_oPCAN_RADAR_470dbdaf_Tx: ComBitPosition=360, ComBitSize=15, ComSignalInitValue=0, ComSignalType=UINT16, ComSystemTemplateSystemSignalRef=DET_RANGE_024
            DET_RANGE_ERR_021_oRDR_DETECTION_021_024_oPCAN_RADAR_4dc58bc4_Tx: ComBitPosition=40, ComBitSize=7, ComSignalInitValue=0, ComSignalType=UINT8, ComSystemTemplateSystemSignalRef=DET_RANGE_ERR_021
            DET_RANGE_ERR_022_oRDR_DETECTION_021_024_oPCAN_RADAR_2925f03a_Tx: ComBitPosition=152, ComBitSize=7, ComSignalInitValue=0, ComSignalType=UINT8, ComSystemTemplateSystemSignalRef=DET_RANGE_ERR_022
            DET_RANGE_ERR_023_oRDR_DETECTION_021_024_oPCAN_RADAR_bc5524af_Tx: ComBitPosition=264, ComBitSize=7, ComSignalInitValue=0, ComSignalType=UINT8, ComSystemTemplateSystemSignalRef=DET_RANGE_ERR_023
            DET_RANGE_ERR_024_oRDR_DETECTION_021_024_oPCAN_RADAR_e0e507c6_Tx: ComBitPosition=376, ComBitSize=7, ComSignalInitValue=0, ComSignalType=UINT8, ComSystemTemplateSystemSignalRef=DET_RANGE_ERR_024
            DET_RANGE_VELOCITY_021_oRDR_DETECTION_021_024_oPCAN_RADAR_9f8bf388_Tx: ComBitPosition=48, ComBitSize=15, ComSignalInitValue=16384, ComSignalType=UINT16, ComSystemTemplateSystemSignalRef=DET_RANGE_VELOCITY_021
            DET_RANGE_VELOCITY_022_oRDR_DETECTION_021_024_oPCAN_RADAR_fb6b8876_Tx: ComBitPosition=160, ComBitSize=15, ComSignalInitValue=16384, ComSignalType=UINT16, ComSystemTemplateSystemSignalRef=DET_RANGE_VELOCITY_022
            DET_RANGE_VELOCITY_023_oRDR_DETECTION_021_024_oPCAN_RADAR_6e1b5ce3_Tx: ComBitPosition=272, ComBitSize=15, ComSignalInitValue=16384, ComSignalType=UINT16, ComSystemTemplateSystemSignalRef=DET_RANGE_VELOCITY_023
            DET_RANGE_VELOCITY_024_oRDR_DETECTION_021_024_oPCAN_RADAR_32ab7f8a_Tx: ComBitPosition=384, ComBitSize=15, ComSignalInitValue=16384, ComSignalType=UINT16, ComSystemTemplateSystemSignalRef=DET_RANGE_VELOCITY_024
            DET_RANGE_VELOCITY_ERR_021_oRDR_DETECTION_021_024_oPCAN_RADAR_9030083a_Tx: ComBitPosition=64, ComBitSize=8, ComSignalInitValue=0, ComSignalType=UINT8, ComSystemTemplateSystemSignalRef=DET_RANGE_VELOCITY_ERR_021
            DET_RANGE_VELOCITY_ERR_022_oRDR_DETECTION_021_024_oPCAN_RADAR_f4d073c4_Tx: ComBitPosition=176, ComBitSize=8, ComSignalInitValue=0, ComSignalType=UINT8, ComSystemTemplateSystemSignalRef=DET_RANGE_VELOCITY_ERR_022
            DET_RANGE_VELOCITY_ERR_023_oRDR_DETECTION_021_024_oPCAN_RADAR_61a0a751_Tx: ComBitPosition=288, ComBitSize=8, ComSignalInitValue=0, ComSignalType=UINT8, ComSystemTemplateSystemSignalRef=DET_RANGE_VELOCITY_ERR_023
            DET_RANGE_VELOCITY_ERR_024_oRDR_DETECTION_021_024_oPCAN_RADAR_3d108438_Tx: ComBitPosition=400, ComBitSize=8, ComSignalInitValue=0, ComSignalType=UINT8, ComSystemTemplateSystemSignalRef=DET_RANGE_VELOCITY_ERR_024
            DET_RCS_021_oRDR_DETECTION_021_024_oPCAN_RADAR_180bc4d2_Tx: ComBitPosition=128, ComBitSize=8, ComSignalInitValue=128, ComSignalType=UINT8, ComSystemTemplateSystemSignalRef=DET_RCS_021
            DET_RCS_022_oRDR_DETECTION_021_024_oPCAN_RADAR_7cebbf2c_Tx: ComBitPosition=240, ComBitSize=8, ComSignalInitValue=128, ComSignalType=UINT8, ComSystemTemplateSystemSignalRef=DET_RCS_022
            DET_RCS_023_oRDR_DETECTION_021_024_oPCAN_RADAR_e99b6bb9_Tx: ComBitPosition=352, ComBitSize=8, ComSignalInitValue=128, ComSignalType=UINT8, ComSystemTemplateSystemSignalRef=DET_RCS_023
            DET_RCS_024_oRDR_DETECTION_021_024_oPCAN_RADAR_b52b48d0_Tx: ComBitPosition=464, ComBitSize=8, ComSignalInitValue=128, ComSignalType=UINT8, ComSystemTemplateSystemSignalRef=DET_RCS_024
            DET_SNR_021_oRDR_DETECTION_021_024_oPCAN_RADAR_c5a590d0_Tx: ComBitPosition=120, ComBitSize=8, ComSignalInitValue=0, ComSignalType=UINT8, ComSystemTemplateSystemSignalRef=DET_SNR_021
            DET_SNR_022_oRDR_DETECTION_021_024_oPCAN_RADAR_a145eb2e_Tx: ComBitPosition=232, ComBitSize=8, ComSignalInitValue=0, ComSignalType=UINT8, ComSystemTemplateSystemSignalRef=DET_SNR_022
            DET_SNR_023_oRDR_DETECTION_021_024_oPCAN_RADAR_34353fbb_Tx: ComBitPosition=344, ComBitSize=8, ComSignalInitValue=0, ComSignalType=UINT8, ComSystemTemplateSystemSignalRef=DET_SNR_023
            DET_SNR_024_oRDR_DETECTION_021_024_oPCAN_RADAR_68851cd2_Tx: ComBitPosition=456, ComBitSize=8, ComSignalInitValue=0, ComSignalType=UINT8, ComSystemTemplateSystemSignalRef=DET_SNR_024
            DET_SUPER_RES_TARGET_021_oRDR_DETECTION_021_024_oPCAN_RADAR_f43cb8b5_Tx: ComBitPosition=87, ComBitSize=1, ComSignalInitValue=0, ComSignalType=BOOLEAN, ComSystemTemplateSystemSignalRef=DET_SUPER_RES_TARGET_021
            DET_SUPER_RES_TARGET_022_oRDR_DETECTION_021_024_oPCAN_RADAR_90dcc34b_Tx: ComBitPosition=199, ComBitSize=1, ComSignalInitValue=0, ComSignalType=BOOLEAN, ComSystemTemplateSystemSignalRef=DET_SUPER_RES_TARGET_022
            DET_SUPER_RES_TARGET_023_oRDR_DETECTION_021_024_oPCAN_RADAR_05ac17de_Tx: ComBitPosition=311, ComBitSize=1, ComSignalInitValue=0, ComSignalType=BOOLEAN, ComSystemTemplateSystemSignalRef=DET_SUPER_RES_TARGET_023
            DET_SUPER_RES_TARGET_024_oRDR_DETECTION_021_024_oPCAN_RADAR_591c34b7_Tx: ComBitPosition=423, ComBitSize=1, ComSignalInitValue=0, ComSignalType=BOOLEAN, ComSystemTemplateSystemSignalRef=DET_SUPER_RES_TARGET_024
        SG_Detections_025_028_oRDR_DETECTION_025_028_oPCAN_RADAR_9bfe01a5_Tx: ComSystemTemplateSignalGroupRef=SG_Detections_025_028
          83 x ComGroupSignal, all with ComSignalEndianness=LITTLE_ENDIAN, ComTransferProperty=PENDING:
            DET_AZIMUTH_025_oRDR_DETECTION_025_028_oPCAN_RADAR_2b5484b5_Tx: ComBitPosition=88, ComBitSize=13, ComSignalInitValue=0, ComSignalType=UINT16, ComSystemTemplateSystemSignalRef=DET_AZIMUTH_025
            DET_AZIMUTH_026_oRDR_DETECTION_025_028_oPCAN_RADAR_4fb4ff4b_Tx: ComBitPosition=200, ComBitSize=13, ComSignalInitValue=0, ComSignalType=UINT16, ComSystemTemplateSystemSignalRef=DET_AZIMUTH_026
            DET_AZIMUTH_027_oRDR_DETECTION_025_028_oPCAN_RADAR_dac42bde_Tx: ComBitPosition=312, ComBitSize=13, ComSignalInitValue=0, ComSignalType=UINT16, ComSystemTemplateSystemSignalRef=DET_AZIMUTH_027
            DET_AZIMUTH_028_oRDR_DETECTION_025_028_oPCAN_RADAR_f6d4b999_Tx: ComBitPosition=424, ComBitSize=13, ComSignalInitValue=0, ComSignalType=UINT16, ComSystemTemplateSystemSignalRef=DET_AZIMUTH_028
            DET_AZIMUTH_ERR_025_oRDR_DETECTION_025_028_oPCAN_RADAR_8fe11140_Tx: ComBitPosition=105, ComBitSize=7, ComSignalInitValue=0, ComSignalType=UINT8, ComSystemTemplateSystemSignalRef=DET_AZIMUTH_ERR_025
            DET_AZIMUTH_ERR_026_oRDR_DETECTION_025_028_oPCAN_RADAR_eb016abe_Tx: ComBitPosition=217, ComBitSize=7, ComSignalInitValue=0, ComSignalType=UINT8, ComSystemTemplateSystemSignalRef=DET_AZIMUTH_ERR_026
            DET_AZIMUTH_ERR_027_oRDR_DETECTION_025_028_oPCAN_RADAR_7e71be2b_Tx: ComBitPosition=329, ComBitSize=7, ComSignalInitValue=0, ComSignalType=UINT8, ComSystemTemplateSystemSignalRef=DET_AZIMUTH_ERR_027
            DET_AZIMUTH_ERR_028_oRDR_DETECTION_025_028_oPCAN_RADAR_52612c6c_Tx: ComBitPosition=441, ComBitSize=7, ComSignalInitValue=0, ComSignalType=UINT8, ComSystemTemplateSystemSignalRef=DET_AZIMUTH_ERR_028
            DET_BELOW_RAIN_THOLD_025_oRDR_DETECTION_025_028_oPCAN_RADAR_fe551775_Tx: ComBitPosition=39, ComBitSize=1, ComSignalInitValue=0, ComSignalType=BOOLEAN, ComSystemTemplateSystemSignalRef=DET_BELOW_RAIN_THOLD_025
            DET_BELOW_RAIN_THOLD_026_oRDR_DETECTION_025_028_oPCAN_RADAR_9ab56c8b_Tx: ComBitPosition=151, ComBitSize=1, ComSignalInitValue=0, ComSignalType=BOOLEAN, ComSystemTemplateSystemSignalRef=DET_BELOW_RAIN_THOLD_026
            DET_BELOW_RAIN_THOLD_027_oRDR_DETECTION_025_028_oPCAN_RADAR_0fc5b81e_Tx: ComBitPosition=263, ComBitSize=1, ComSignalInitValue=0, ComSignalType=BOOLEAN, ComSystemTemplateSystemSignalRef=DET_BELOW_RAIN_THOLD_027
            DET_BELOW_RAIN_THOLD_028_oRDR_DETECTION_025_028_oPCAN_RADAR_23d52a59_Tx: ComBitPosition=375, ComBitSize=1, ComSignalInitValue=0, ComSignalType=BOOLEAN, ComSystemTemplateSystemSignalRef=DET_BELOW_RAIN_THOLD_028
            DET_BI_STATIC_FLAG_025_oRDR_DETECTION_025_028_oPCAN_RADAR_7d78c430_Tx: ComBitPosition=104, ComBitSize=1, ComSignalInitValue=0, ComSignalType=BOOLEAN, ComSystemTemplateSystemSignalRef=DET_BI_STATIC_FLAG_025
            DET_BI_STATIC_FLAG_026_oRDR_DETECTION_025_028_oPCAN_RADAR_1998bfce_Tx: ComBitPosition=216, ComBitSize=1, ComSignalInitValue=0, ComSignalType=BOOLEAN, ComSystemTemplateSystemSignalRef=DET_BI_STATIC_FLAG_026
            DET_BI_STATIC_FLAG_027_oRDR_DETECTION_025_028_oPCAN_RADAR_8ce86b5b_Tx: ComBitPosition=328, ComBitSize=1, ComSignalInitValue=0, ComSignalType=BOOLEAN, ComSystemTemplateSystemSignalRef=DET_BI_STATIC_FLAG_027
            DET_BI_STATIC_FLAG_028_oRDR_DETECTION_025_028_oPCAN_RADAR_a0f8f91c_Tx: ComBitPosition=440, ComBitSize=1, ComSignalInitValue=0, ComSignalType=BOOLEAN, ComSystemTemplateSystemSignalRef=DET_BI_STATIC_FLAG_028
            DET_CONFD_AZIMUTH_025_oRDR_DETECTION_025_028_oPCAN_RADAR_29b28e7f_Tx: ComBitPosition=118, ComBitSize=2, ComSignalInitValue=0, ComSignalType=UINT8, ComSystemTemplateSystemSignalRef=DET_CONFD_AZIMUTH_025
            DET_CONFD_AZIMUTH_026_oRDR_DETECTION_025_028_oPCAN_RADAR_4d52f581_Tx: ComBitPosition=230, ComBitSize=2, ComSignalInitValue=0, ComSignalType=UINT8, ComSystemTemplateSystemSignalRef=DET_CONFD_AZIMUTH_026
            DET_CONFD_AZIMUTH_027_oRDR_DETECTION_025_028_oPCAN_RADAR_d8222114_Tx: ComBitPosition=342, ComBitSize=2, ComSignalInitValue=0, ComSignalType=UINT8, ComSystemTemplateSystemSignalRef=DET_CONFD_AZIMUTH_027
            DET_CONFD_AZIMUTH_028_oRDR_DETECTION_025_028_oPCAN_RADAR_f432b353_Tx: ComBitPosition=454, ComBitSize=2, ComSignalInitValue=0, ComSignalType=UINT8, ComSystemTemplateSystemSignalRef=DET_CONFD_AZIMUTH_028
            DET_CONFD_ELEVATION_025_oRDR_DETECTION_025_028_oPCAN_RADAR_2b278f85_Tx: ComBitPosition=101, ComBitSize=2, ComSignalInitValue=0, ComSignalType=UINT8, ComSystemTemplateSystemSignalRef=DET_CONFD_ELEVATION_025
            DET_CONFD_ELEVATION_026_oRDR_DETECTION_025_028_oPCAN_RADAR_4fc7f47b_Tx: ComBitPosition=213, ComBitSize=2, ComSignalInitValue=0, ComSignalType=UINT8, ComSystemTemplateSystemSignalRef=DET_CONFD_ELEVATION_026
            DET_CONFD_ELEVATION_027_oRDR_DETECTION_025_028_oPCAN_RADAR_dab720ee_Tx: ComBitPosition=325, ComBitSize=2, ComSignalInitValue=0, ComSignalType=UINT8, ComSystemTemplateSystemSignalRef=DET_CONFD_ELEVATION_027
            DET_CONFD_ELEVATION_028_oRDR_DETECTION_025_028_oPCAN_RADAR_f6a7b2a9_Tx: ComBitPosition=437, ComBitSize=2, ComSignalInitValue=0, ComSignalType=UINT8, ComSystemTemplateSystemSignalRef=DET_CONFD_ELEVATION_028
            DET_ELEVATION_025_oRDR_DETECTION_025_028_oPCAN_RADAR_fae75bb9_Tx: ComBitPosition=72, ComBitSize=8, ComSignalInitValue=0, ComSignalType=UINT8, ComSystemTemplateSystemSignalRef=DET_ELEVATION_025
            DET_ELEVATION_026_oRDR_DETECTION_025_028_oPCAN_RADAR_9e072047_Tx: ComBitPosition=184, ComBitSize=8, ComSignalInitValue=0, ComSignalType=UINT8, ComSystemTemplateSystemSignalRef=DET_ELEVATION_026
            DET_ELEVATION_027_oRDR_DETECTION_025_028_oPCAN_RADAR_0b77f4d2_Tx: ComBitPosition=296, ComBitSize=8, ComSignalInitValue=0, ComSignalType=UINT8, ComSystemTemplateSystemSignalRef=DET_ELEVATION_027
            DET_ELEVATION_028_oRDR_DETECTION_025_028_oPCAN_RADAR_27676695_Tx: ComBitPosition=408, ComBitSize=8, ComSignalInitValue=0, ComSignalType=UINT8, ComSystemTemplateSystemSignalRef=DET_ELEVATION_028
            DET_ELEVATION_ERR_025_oRDR_DETECTION_025_028_oPCAN_RADAR_7ddec3cc_Tx: ComBitPosition=80, ComBitSize=6, ComSignalInitValue=0, ComSignalType=UINT8, ComSystemTemplateSystemSignalRef=DET_ELEVATION_ERR_025
            DET_ELEVATION_ERR_026_oRDR_DETECTION_025_028_oPCAN_RADAR_193eb832_Tx: ComBitPosition=192, ComBitSize=6, ComSignalInitValue=0, ComSignalType=UINT8, ComSystemTemplateSystemSignalRef=DET_ELEVATION_ERR_026
            DET_ELEVATION_ERR_027_oRDR_DETECTION_025_028_oPCAN_RADAR_8c4e6ca7_Tx: ComBitPosition=304, ComBitSize=6, ComSignalInitValue=0, ComSignalType=UINT8, ComSystemTemplateSystemSignalRef=DET_ELEVATION_ERR_027
            DET_ELEVATION_ERR_028_oRDR_DETECTION_025_028_oPCAN_RADAR_a05efee0_Tx: ComBitPosition=416, ComBitSize=6, ComSignalInitValue=0, ComSignalType=UINT8, ComSystemTemplateSystemSignalRef=DET_ELEVATION_ERR_028
            DET_EXISTENCE_PROB_025_oRDR_DETECTION_025_028_oPCAN_RADAR_af41b6ac_Tx: ComBitPosition=112, ComBitSize=6, ComSignalInitValue=0, ComSignalType=UINT8, ComSystemTemplateSystemSignalRef=DET_EXISTENCE_PROB_025
            DET_EXISTENCE_PROB_026_oRDR_DETECTION_025_028_oPCAN_RADAR_cba1cd52_Tx: ComBitPosition=224, ComBitSize=6, ComSignalInitValue=0, ComSignalType=UINT8, ComSystemTemplateSystemSignalRef=DET_EXISTENCE_PROB_026
            DET_EXISTENCE_PROB_027_oRDR_DETECTION_025_028_oPCAN_RADAR_5ed119c7_Tx: ComBitPosition=336, ComBitSize=6, ComSignalInitValue=0, ComSignalType=UINT8, ComSystemTemplateSystemSignalRef=DET_EXISTENCE_PROB_027
            DET_EXISTENCE_PROB_028_oRDR_DETECTION_025_028_oPCAN_RADAR_72c18b80_Tx: ComBitPosition=448, ComBitSize=6, ComSignalInitValue=0, ComSignalType=UINT8, ComSystemTemplateSystemSignalRef=DET_EXISTENCE_PROB_028
            DET_HVC_FLAG_025_oRDR_DETECTION_025_028_oPCAN_RADAR_4e35f5d3_Tx: ComBitPosition=86, ComBitSize=1, ComSignalInitValue=0, ComSignalType=BOOLEAN, ComSystemTemplateSystemSignalRef=DET_HVC_FLAG_025
            DET_HVC_FLAG_026_oRDR_DETECTION_025_028_oPCAN_RADAR_2ad58e2d_Tx: ComBitPosition=198, ComBitSize=1, ComSignalInitValue=0, ComSignalType=BOOLEAN, ComSystemTemplateSystemSignalRef=DET_HVC_FLAG_026
            DET_HVC_FLAG_027_oRDR_DETECTION_025_028_oPCAN_RADAR_bfa55ab8_Tx: ComBitPosition=310, ComBitSize=1, ComSignalInitValue=0, ComSignalType=BOOLEAN, ComSystemTemplateSystemSignalRef=DET_HVC_FLAG_027
            DET_HVC_FLAG_028_oRDR_DETECTION_025_028_oPCAN_RADAR_93b5c8ff_Tx: ComBitPosition=422, ComBitSize=1, ComSignalInitValue=0, ComSignalType=BOOLEAN, ComSystemTemplateSystemSignalRef=DET_HVC_FLAG_028
            DET_IDM_025_oRDR_DETECTION_025_028_oPCAN_RADAR_c567ce6e_Tx: ComBitPosition=63, ComBitSize=1, ComSignalInitValue=0, ComSignalType=BOOLEAN, ComSystemTemplateSystemSignalRef=DET_IDM_025
            DET_IDM_026_oRDR_DETECTION_025_028_oPCAN_RADAR_a187b590_Tx: ComBitPosition=175, ComBitSize=1, ComSignalInitValue=0, ComSignalType=BOOLEAN, ComSystemTemplateSystemSignalRef=DET_IDM_026
            DET_IDM_027_oRDR_DETECTION_025_028_oPCAN_RADAR_34f76105_Tx: ComBitPosition=287, ComBitSize=1, ComSignalInitValue=0, ComSignalType=BOOLEAN, ComSystemTemplateSystemSignalRef=DET_IDM_027
            DET_IDM_028_oRDR_DETECTION_025_028_oPCAN_RADAR_18e7f342_Tx: ComBitPosition=399, ComBitSize=1, ComSignalInitValue=0, ComSignalType=BOOLEAN, ComSystemTemplateSystemSignalRef=DET_IDM_028
            DET_MH_CRC16_025_028_oRDR_DETECTION_025_028_oPCAN_RADAR_1f76d3ae_Tx: ComBitPosition=0, ComBitSize=16, ComSignalInitValue=0, ComSignalType=UINT16, ComSystemTemplateSystemSignalRef=DET_MH_CRC16_025_028
            DET_MH_CYCLE_COUNTER_025_028_oRDR_DETECTION_025_028_oPCAN_RADAR_9b037299_Tx: ComBitPosition=16, ComBitSize=8, ComSignalInitValue=0, ComSignalType=UINT8, ComSystemTemplateSystemSignalRef=DET_MH_CYCLE_COUNTER_025_028
            DET_MH_SCAN_INDEX_4LSB_025_028_oRDR_DETECTION_025_028_oPCAN_RADAR_57295715_Tx: ComBitPosition=476, ComBitSize=4, ComSignalInitValue=0, ComSignalType=UINT8, ComSystemTemplateSystemSignalRef=DET_MH_SCAN_INDEX_4LSB_025_028
            DET_MTD_025_oRDR_DETECTION_025_028_oPCAN_RADAR_a3d4fcb5_Tx: ComBitPosition=47, ComBitSize=1, ComSignalInitValue=0, ComSignalType=BOOLEAN, ComSystemTemplateSystemSignalRef=DET_MTD_025
            DET_MTD_026_oRDR_DETECTION_025_028_oPCAN_RADAR_c734874b_Tx: ComBitPosition=159, ComBitSize=1, ComSignalInitValue=0, ComSignalType=BOOLEAN, ComSystemTemplateSystemSignalRef=DET_MTD_026
            DET_MTD_027_oRDR_DETECTION_025_028_oPCAN_RADAR_524453de_Tx: ComBitPosition=271, ComBitSize=1, ComSignalInitValue=0, ComSignalType=BOOLEAN, ComSystemTemplateSystemSignalRef=DET_MTD_027
            DET_MTD_028_oRDR_DETECTION_025_028_oPCAN_RADAR_7e54c199_Tx: ComBitPosition=383, ComBitSize=1, ComSignalInitValue=0, ComSignalType=BOOLEAN, ComSystemTemplateSystemSignalRef=DET_MTD_028
            DET_PROB_1STAZHYPO_025_oRDR_DETECTION_025_028_oPCAN_RADAR_30601478_Tx: ComBitPosition=103, ComBitSize=1, ComSignalInitValue=0, ComSignalType=BOOLEAN, ComSystemTemplateSystemSignalRef=DET_PROB_1STAZHYPO_025
            DET_PROB_1STAZHYPO_026_oRDR_DETECTION_025_028_oPCAN_RADAR_54806f86_Tx: ComBitPosition=215, ComBitSize=1, ComSignalInitValue=0, ComSignalType=BOOLEAN, ComSystemTemplateSystemSignalRef=DET_PROB_1STAZHYPO_026
            DET_PROB_1STAZHYPO_027_oRDR_DETECTION_025_028_oPCAN_RADAR_c1f0bb13_Tx: ComBitPosition=327, ComBitSize=1, ComSignalInitValue=0, ComSignalType=BOOLEAN, ComSystemTemplateSystemSignalRef=DET_PROB_1STAZHYPO_027
            DET_PROB_1STAZHYPO_028_oRDR_DETECTION_025_028_oPCAN_RADAR_ede02954_Tx: ComBitPosition=439, ComBitSize=1, ComSignalInitValue=0, ComSignalType=BOOLEAN, ComSystemTemplateSystemSignalRef=DET_PROB_1STAZHYPO_028
            DET_RANGE_025_oRDR_DETECTION_025_028_oPCAN_RADAR_3bcff70e_Tx: ComBitPosition=24, ComBitSize=15, ComSignalInitValue=0, ComSignalType=UINT16, ComSystemTemplateSystemSignalRef=DET_RANGE_025
            DET_RANGE_026_oRDR_DETECTION_025_028_oPCAN_RADAR_5f2f8cf0_Tx: ComBitPosition=136, ComBitSize=15, ComSignalInitValue=0, ComSignalType=UINT16, ComSystemTemplateSystemSignalRef=DET_RANGE_026
            DET_RANGE_027_oRDR_DETECTION_025_028_oPCAN_RADAR_ca5f5865_Tx: ComBitPosition=248, ComBitSize=15, ComSignalInitValue=0, ComSignalType=UINT16, ComSystemTemplateSystemSignalRef=DET_RANGE_027
            DET_RANGE_028_oRDR_DETECTION_025_028_oPCAN_RADAR_e64fca22_Tx: ComBitPosition=360, ComBitSize=15, ComSignalInitValue=0, ComSignalType=UINT16, ComSystemTemplateSystemSignalRef=DET_RANGE_028
            DET_RANGE_ERR_025_oRDR_DETECTION_025_028_oPCAN_RADAR_9c274d67_Tx: ComBitPosition=40, ComBitSize=7, ComSignalInitValue=0, ComSignalType=UINT8, ComSystemTemplateSystemSignalRef=DET_RANGE_ERR_025
            DET_RANGE_ERR_026_oRDR_DETECTION_025_028_oPCAN_RADAR_f8c73699_Tx: ComBitPosition=152, ComBitSize=7, ComSignalInitValue=0, ComSignalType=UINT8, ComSystemTemplateSystemSignalRef=DET_RANGE_ERR_026
            DET_RANGE_ERR_027_oRDR_DETECTION_025_028_oPCAN_RADAR_6db7e20c_Tx: ComBitPosition=264, ComBitSize=7, ComSignalInitValue=0, ComSignalType=UINT8, ComSystemTemplateSystemSignalRef=DET_RANGE_ERR_027
            DET_RANGE_ERR_028_oRDR_DETECTION_025_028_oPCAN_RADAR_41a7704b_Tx: ComBitPosition=376, ComBitSize=7, ComSignalInitValue=0, ComSignalType=UINT8, ComSystemTemplateSystemSignalRef=DET_RANGE_ERR_028
            DET_RANGE_VELOCITY_025_oRDR_DETECTION_025_028_oPCAN_RADAR_4e69352b_Tx: ComBitPosition=48, ComBitSize=15, ComSignalInitValue=16384, ComSignalType=UINT16, ComSystemTemplateSystemSignalRef=DET_RANGE_VELOCITY_025
            DET_RANGE_VELOCITY_026_oRDR_DETECTION_025_028_oPCAN_RADAR_2a894ed5_Tx: ComBitPosition=160, ComBitSize=15, ComSignalInitValue=16384, ComSignalType=UINT16, ComSystemTemplateSystemSignalRef=DET_RANGE_VELOCITY_026
            DET_RANGE_VELOCITY_027_oRDR_DETECTION_025_028_oPCAN_RADAR_bff99a40_Tx: ComBitPosition=272, ComBitSize=15, ComSignalInitValue=16384, ComSignalType=UINT16, ComSystemTemplateSystemSignalRef=DET_RANGE_VELOCITY_027
            DET_RANGE_VELOCITY_028_oRDR_DETECTION_025_028_oPCAN_RADAR_93e90807_Tx: ComBitPosition=384, ComBitSize=15, ComSignalInitValue=16384, ComSignalType=UINT16, ComSystemTemplateSystemSignalRef=DET_RANGE_VELOCITY_028
            DET_RANGE_VELOCITY_ERR_025_oRDR_DETECTION_025_028_oPCAN_RADAR_41d2ce99_Tx: ComBitPosition=64, ComBitSize=8, ComSignalInitValue=0, ComSignalType=UINT8, ComSystemTemplateSystemSignalRef=DET_RANGE_VELOCITY_ERR_025
            DET_RANGE_VELOCITY_ERR_026_oRDR_DETECTION_025_028_oPCAN_RADAR_2532b567_Tx: ComBitPosition=176, ComBitSize=8, ComSignalInitValue=0, ComSignalType=UINT8, ComSystemTemplateSystemSignalRef=DET_RANGE_VELOCITY_ERR_026
            DET_RANGE_VELOCITY_ERR_027_oRDR_DETECTION_025_028_oPCAN_RADAR_b04261f2_Tx: ComBitPosition=288, ComBitSize=8, ComSignalInitValue=0, ComSignalType=UINT8, ComSystemTemplateSystemSignalRef=DET_RANGE_VELOCITY_ERR_027
            DET_RANGE_VELOCITY_ERR_028_oRDR_DETECTION_025_028_oPCAN_RADAR_9c52f3b5_Tx: ComBitPosition=400, ComBitSize=8, ComSignalInitValue=0, ComSignalType=UINT8, ComSystemTemplateSystemSignalRef=DET_RANGE_VELOCITY_ERR_028
            DET_RCS_025_oRDR_DETECTION_025_028_oPCAN_RADAR_c9e90271_Tx: ComBitPosition=128, ComBitSize=8, ComSignalInitValue=128, ComSignalType=UINT8, ComSystemTemplateSystemSignalRef=DET_RCS_025
            DET_RCS_026_oRDR_DETECTION_025_028_oPCAN_RADAR_ad09798f_Tx: ComBitPosition=240, ComBitSize=8, ComSignalInitValue=128, ComSignalType=UINT8, ComSystemTemplateSystemSignalRef=DET_RCS_026
            DET_RCS_027_oRDR_DETECTION_025_028_oPCAN_RADAR_3879ad1a_Tx: ComBitPosition=352, ComBitSize=8, ComSignalInitValue=128, ComSignalType=UINT8, ComSystemTemplateSystemSignalRef=DET_RCS_027
            DET_RCS_028_oRDR_DETECTION_025_028_oPCAN_RADAR_14693f5d_Tx: ComBitPosition=464, ComBitSize=8, ComSignalInitValue=128, ComSignalType=UINT8, ComSystemTemplateSystemSignalRef=DET_RCS_028
            DET_SNR_025_oRDR_DETECTION_025_028_oPCAN_RADAR_14475673_Tx: ComBitPosition=120, ComBitSize=8, ComSignalInitValue=0, ComSignalType=UINT8, ComSystemTemplateSystemSignalRef=DET_SNR_025
            DET_SNR_026_oRDR_DETECTION_025_028_oPCAN_RADAR_70a72d8d_Tx: ComBitPosition=232, ComBitSize=8, ComSignalInitValue=0, ComSignalType=UINT8, ComSystemTemplateSystemSignalRef=DET_SNR_026
            DET_SNR_027_oRDR_DETECTION_025_028_oPCAN_RADAR_e5d7f918_Tx: ComBitPosition=344, ComBitSize=8, ComSignalInitValue=0, ComSignalType=UINT8, ComSystemTemplateSystemSignalRef=DET_SNR_027
            DET_SNR_028_oRDR_DETECTION_025_028_oPCAN_RADAR_c9c76b5f_Tx: ComBitPosition=456, ComBitSize=8, ComSignalInitValue=0, ComSignalType=UINT8, ComSystemTemplateSystemSignalRef=DET_SNR_028
            DET_SUPER_RES_TARGET_025_oRDR_DETECTION_025_028_oPCAN_RADAR_25de7e16_Tx: ComBitPosition=87, ComBitSize=1, ComSignalInitValue=0, ComSignalType=BOOLEAN, ComSystemTemplateSystemSignalRef=DET_SUPER_RES_TARGET_025
            DET_SUPER_RES_TARGET_026_oRDR_DETECTION_025_028_oPCAN_RADAR_413e05e8_Tx: ComBitPosition=199, ComBitSize=1, ComSignalInitValue=0, ComSignalType=BOOLEAN, ComSystemTemplateSystemSignalRef=DET_SUPER_RES_TARGET_026
            DET_SUPER_RES_TARGET_027_oRDR_DETECTION_025_028_oPCAN_RADAR_d44ed17d_Tx: ComBitPosition=311, ComBitSize=1, ComSignalInitValue=0, ComSignalType=BOOLEAN, ComSystemTemplateSystemSignalRef=DET_SUPER_RES_TARGET_027
            DET_SUPER_RES_TARGET_028_oRDR_DETECTION_025_028_oPCAN_RADAR_f85e433a_Tx: ComBitPosition=423, ComBitSize=1, ComSignalInitValue=0, ComSignalType=BOOLEAN, ComSystemTemplateSystemSignalRef=DET_SUPER_RES_TARGET_028
        SG_Detections_029_032_oRDR_DETECTION_029_032_oPCAN_RADAR_028425de_Tx: ComSystemTemplateSignalGroupRef=SG_Detections_029_032
          83 x ComGroupSignal, all with ComSignalEndianness=LITTLE_ENDIAN, ComTransferProperty=PENDING:
            DET_AZIMUTH_029_oRDR_DETECTION_029_032_oPCAN_RADAR_51ec820d_Tx: ComBitPosition=88, ComBitSize=13, ComSignalInitValue=0, ComSignalType=UINT16, ComSystemTemplateSystemSignalRef=DET_AZIMUTH_029
            DET_AZIMUTH_030_oRDR_DETECTION_029_032_oPCAN_RADAR_34ccf0a9_Tx: ComBitPosition=200, ComBitSize=13, ComSignalInitValue=0, ComSignalType=UINT16, ComSystemTemplateSystemSignalRef=DET_AZIMUTH_030
            DET_AZIMUTH_031_oRDR_DETECTION_029_032_oPCAN_RADAR_a1bc243c_Tx: ComBitPosition=312, ComBitSize=13, ComSignalInitValue=0, ComSignalType=UINT16, ComSystemTemplateSystemSignalRef=DET_AZIMUTH_031
            DET_AZIMUTH_032_oRDR_DETECTION_029_032_oPCAN_RADAR_c55c5fc2_Tx: ComBitPosition=424, ComBitSize=13, ComSignalInitValue=0, ComSignalType=UINT16, ComSystemTemplateSystemSignalRef=DET_AZIMUTH_032
            DET_AZIMUTH_ERR_029_oRDR_DETECTION_029_032_oPCAN_RADAR_f55917f8_Tx: ComBitPosition=105, ComBitSize=7, ComSignalInitValue=0, ComSignalType=UINT8, ComSystemTemplateSystemSignalRef=DET_AZIMUTH_ERR_029
            DET_AZIMUTH_ERR_030_oRDR_DETECTION_029_032_oPCAN_RADAR_9079655c_Tx: ComBitPosition=217, ComBitSize=7, ComSignalInitValue=0, ComSignalType=UINT8, ComSystemTemplateSystemSignalRef=DET_AZIMUTH_ERR_030
            DET_AZIMUTH_ERR_031_oRDR_DETECTION_029_032_oPCAN_RADAR_0509b1c9_Tx: ComBitPosition=329, ComBitSize=7, ComSignalInitValue=0, ComSignalType=UINT8, ComSystemTemplateSystemSignalRef=DET_AZIMUTH_ERR_031
            DET_AZIMUTH_ERR_032_oRDR_DETECTION_029_032_oPCAN_RADAR_61e9ca37_Tx: ComBitPosition=441, ComBitSize=7, ComSignalInitValue=0, ComSignalType=UINT8, ComSystemTemplateSystemSignalRef=DET_AZIMUTH_ERR_032
            DET_BELOW_RAIN_THOLD_029_oRDR_DETECTION_029_032_oPCAN_RADAR_84ed11cd_Tx: ComBitPosition=39, ComBitSize=1, ComSignalInitValue=0, ComSignalType=BOOLEAN, ComSystemTemplateSystemSignalRef=DET_BELOW_RAIN_THOLD_029
            DET_BELOW_RAIN_THOLD_030_oRDR_DETECTION_029_032_oPCAN_RADAR_e1cd6369_Tx: ComBitPosition=151, ComBitSize=1, ComSignalInitValue=0, ComSignalType=BOOLEAN, ComSystemTemplateSystemSignalRef=DET_BELOW_RAIN_THOLD_030
            DET_BELOW_RAIN_THOLD_031_oRDR_DETECTION_029_032_oPCAN_RADAR_74bdb7fc_Tx: ComBitPosition=263, ComBitSize=1, ComSignalInitValue=0, ComSignalType=BOOLEAN, ComSystemTemplateSystemSignalRef=DET_BELOW_RAIN_THOLD_031
            DET_BELOW_RAIN_THOLD_032_oRDR_DETECTION_029_032_oPCAN_RADAR_105dcc02_Tx: ComBitPosition=375, ComBitSize=1, ComSignalInitValue=0, ComSignalType=BOOLEAN, ComSystemTemplateSystemSignalRef=DET_BELOW_RAIN_THOLD_032
            DET_BI_STATIC_FLAG_029_oRDR_DETECTION_029_032_oPCAN_RADAR_07c0c288_Tx: ComBitPosition=104, ComBitSize=1, ComSignalInitValue=0, ComSignalType=BOOLEAN, ComSystemTemplateSystemSignalRef=DET_BI_STATIC_FLAG_029
            DET_BI_STATIC_FLAG_030_oRDR_DETECTION_029_032_oPCAN_RADAR_62e0b02c_Tx: ComBitPosition=216, ComBitSize=1, ComSignalInitValue=0, ComSignalType=BOOLEAN, ComSystemTemplateSystemSignalRef=DET_BI_STATIC_FLAG_030
            DET_BI_STATIC_FLAG_031_oRDR_DETECTION_029_032_oPCAN_RADAR_f79064b9_Tx: ComBitPosition=328, ComBitSize=1, ComSignalInitValue=0, ComSignalType=BOOLEAN, ComSystemTemplateSystemSignalRef=DET_BI_STATIC_FLAG_031
            DET_BI_STATIC_FLAG_032_oRDR_DETECTION_029_032_oPCAN_RADAR_93701f47_Tx: ComBitPosition=440, ComBitSize=1, ComSignalInitValue=0, ComSignalType=BOOLEAN, ComSystemTemplateSystemSignalRef=DET_BI_STATIC_FLAG_032
            DET_CONFD_AZIMUTH_029_oRDR_DETECTION_029_032_oPCAN_RADAR_530a88c7_Tx: ComBitPosition=118, ComBitSize=2, ComSignalInitValue=0, ComSignalType=UINT8, ComSystemTemplateSystemSignalRef=DET_CONFD_AZIMUTH_029
            DET_CONFD_AZIMUTH_030_oRDR_DETECTION_029_032_oPCAN_RADAR_362afa63_Tx: ComBitPosition=230, ComBitSize=2, ComSignalInitValue=0, ComSignalType=UINT8, ComSystemTemplateSystemSignalRef=DET_CONFD_AZIMUTH_030
            DET_CONFD_AZIMUTH_031_oRDR_DETECTION_029_032_oPCAN_RADAR_a35a2ef6_Tx: ComBitPosition=342, ComBitSize=2, ComSignalInitValue=0, ComSignalType=UINT8, ComSystemTemplateSystemSignalRef=DET_CONFD_AZIMUTH_031
            DET_CONFD_AZIMUTH_032_oRDR_DETECTION_029_032_oPCAN_RADAR_c7ba5508_Tx: ComBitPosition=454, ComBitSize=2, ComSignalInitValue=0, ComSignalType=UINT8, ComSystemTemplateSystemSignalRef=DET_CONFD_AZIMUTH_032
            DET_CONFD_ELEVATION_029_oRDR_DETECTION_029_032_oPCAN_RADAR_519f893d_Tx: ComBitPosition=101, ComBitSize=2, ComSignalInitValue=0, ComSignalType=UINT8, ComSystemTemplateSystemSignalRef=DET_CONFD_ELEVATION_029
            DET_CONFD_ELEVATION_030_oRDR_DETECTION_029_032_oPCAN_RADAR_34bffb99_Tx: ComBitPosition=213, ComBitSize=2, ComSignalInitValue=0, ComSignalType=UINT8, ComSystemTemplateSystemSignalRef=DET_CONFD_ELEVATION_030
            DET_CONFD_ELEVATION_031_oRDR_DETECTION_029_032_oPCAN_RADAR_a1cf2f0c_Tx: ComBitPosition=325, ComBitSize=2, ComSignalInitValue=0, ComSignalType=UINT8, ComSystemTemplateSystemSignalRef=DET_CONFD_ELEVATION_031
            DET_CONFD_ELEVATION_032_oRDR_DETECTION_029_032_oPCAN_RADAR_c52f54f2_Tx: ComBitPosition=437, ComBitSize=2, ComSignalInitValue=0, ComSignalType=UINT8, ComSystemTemplateSystemSignalRef=DET_CONFD_ELEVATION_032
            DET_ELEVATION_029_oRDR_DETECTION_029_032_oPCAN_RADAR_805f5d01_Tx: ComBitPosition=72, ComBitSize=8, ComSignalInitValue=0, ComSignalType=UINT8, ComSystemTemplateSystemSignalRef=DET_ELEVATION_029
            DET_ELEVATION_030_oRDR_DETECTION_029_032_oPCAN_RADAR_e57f2fa5_Tx: ComBitPosition=184, ComBitSize=8, ComSignalInitValue=0, ComSignalType=UINT8, ComSystemTemplateSystemSignalRef=DET_ELEVATION_030
            DET_ELEVATION_031_oRDR_DETECTION_029_032_oPCAN_RADAR_700ffb30_Tx: ComBitPosition=296, ComBitSize=8, ComSignalInitValue=0, ComSignalType=UINT8, ComSystemTemplateSystemSignalRef=DET_ELEVATION_031
            DET_ELEVATION_032_oRDR_DETECTION_029_032_oPCAN_RADAR_14ef80ce_Tx: ComBitPosition=408, ComBitSize=8, ComSignalInitValue=0, ComSignalType=UINT8, ComSystemTemplateSystemSignalRef=DET_ELEVATION_032
            DET_ELEVATION_ERR_029_oRDR_DETECTION_029_032_oPCAN_RADAR_0766c574_Tx: ComBitPosition=80, ComBitSize=6, ComSignalInitValue=0, ComSignalType=UINT8, ComSystemTemplateSystemSignalRef=DET_ELEVATION_ERR_029
            DET_ELEVATION_ERR_030_oRDR_DETECTION_029_032_oPCAN_RADAR_6246b7d0_Tx: ComBitPosition=192, ComBitSize=6, ComSignalInitValue=0, ComSignalType=UINT8, ComSystemTemplateSystemSignalRef=DET_ELEVATION_ERR_030
            DET_ELEVATION_ERR_031_oRDR_DETECTION_029_032_oPCAN_RADAR_f7366345_Tx: ComBitPosition=304, ComBitSize=6, ComSignalInitValue=0, ComSignalType=UINT8, ComSystemTemplateSystemSignalRef=DET_ELEVATION_ERR_031
            DET_ELEVATION_ERR_032_oRDR_DETECTION_029_032_oPCAN_RADAR_93d618bb_Tx: ComBitPosition=416, ComBitSize=6, ComSignalInitValue=0, ComSignalType=UINT8, ComSystemTemplateSystemSignalRef=DET_ELEVATION_ERR_032
            DET_EXISTENCE_PROB_029_oRDR_DETECTION_029_032_oPCAN_RADAR_d5f9b014_Tx: ComBitPosition=112, ComBitSize=6, ComSignalInitValue=0, ComSignalType=UINT8, ComSystemTemplateSystemSignalRef=DET_EXISTENCE_PROB_029
            DET_EXISTENCE_PROB_030_oRDR_DETECTION_029_032_oPCAN_RADAR_b0d9c2b0_Tx: ComBitPosition=224, ComBitSize=6, ComSignalInitValue=0, ComSignalType=UINT8, ComSystemTemplateSystemSignalRef=DET_EXISTENCE_PROB_030
            DET_EXISTENCE_PROB_031_oRDR_DETECTION_029_032_oPCAN_RADAR_25a91625_Tx: ComBitPosition=336, ComBitSize=6, ComSignalInitValue=0, ComSignalType=UINT8, ComSystemTemplateSystemSignalRef=DET_EXISTENCE_PROB_031
            DET_EXISTENCE_PROB_032_oRDR_DETECTION_029_032_oPCAN_RADAR_41496ddb_Tx: ComBitPosition=448, ComBitSize=6, ComSignalInitValue=0, ComSignalType=UINT8, ComSystemTemplateSystemSignalRef=DET_EXISTENCE_PROB_032
            DET_HVC_FLAG_029_oRDR_DETECTION_029_032_oPCAN_RADAR_348df36b_Tx: ComBitPosition=86, ComBitSize=1, ComSignalInitValue=0, ComSignalType=BOOLEAN, ComSystemTemplateSystemSignalRef=DET_HVC_FLAG_029
            DET_HVC_FLAG_030_oRDR_DETECTION_029_032_oPCAN_RADAR_51ad81cf_Tx: ComBitPosition=198, ComBitSize=1, ComSignalInitValue=0, ComSignalType=BOOLEAN, ComSystemTemplateSystemSignalRef=DET_HVC_FLAG_030
            DET_HVC_FLAG_031_oRDR_DETECTION_029_032_oPCAN_RADAR_c4dd555a_Tx: ComBitPosition=310, ComBitSize=1, ComSignalInitValue=0, ComSignalType=BOOLEAN, ComSystemTemplateSystemSignalRef=DET_HVC_FLAG_031
            DET_HVC_FLAG_032_oRDR_DETECTION_029_032_oPCAN_RADAR_a03d2ea4_Tx: ComBitPosition=422, ComBitSize=1, ComSignalInitValue=0, ComSignalType=BOOLEAN, ComSystemTemplateSystemSignalRef=DET_HVC_FLAG_032
            DET_IDM_029_oRDR_DETECTION_029_032_oPCAN_RADAR_bfdfc8d6_Tx: ComBitPosition=63, ComBitSize=1, ComSignalInitValue=0, ComSignalType=BOOLEAN, ComSystemTemplateSystemSignalRef=DET_IDM_029
            DET_IDM_030_oRDR_DETECTION_029_032_oPCAN_RADAR_daffba72_Tx: ComBitPosition=175, ComBitSize=1, ComSignalInitValue=0, ComSignalType=BOOLEAN, ComSystemTemplateSystemSignalRef=DET_IDM_030
            DET_IDM_031_oRDR_DETECTION_029_032_oPCAN_RADAR_4f8f6ee7_Tx: ComBitPosition=287, ComBitSize=1, ComSignalInitValue=0, ComSignalType=BOOLEAN, ComSystemTemplateSystemSignalRef=DET_IDM_031
            DET_IDM_032_oRDR_DETECTION_029_032_oPCAN_RADAR_2b6f1519_Tx: ComBitPosition=399, ComBitSize=1, ComSignalInitValue=0, ComSignalType=BOOLEAN, ComSystemTemplateSystemSignalRef=DET_IDM_032
            DET_MH_CRC16_029_032_oRDR_DETECTION_029_032_oPCAN_RADAR_860cf7d5_Tx: ComBitPosition=0, ComBitSize=16, ComSignalInitValue=0, ComSignalType=UINT16, ComSystemTemplateSystemSignalRef=DET_MH_CRC16_029_032
            DET_MH_CYCLE_COUNTER_029_032_oRDR_DETECTION_029_032_oPCAN_RADAR_027956e2_Tx: ComBitPosition=16, ComBitSize=8, ComSignalInitValue=0, ComSignalType=UINT8, ComSystemTemplateSystemSignalRef=DET_MH_CYCLE_COUNTER_029_032
            DET_MH_SCAN_INDEX_4LSB_029_032_oRDR_DETECTION_029_032_oPCAN_RADAR_ce53736e_Tx: ComBitPosition=476, ComBitSize=4, ComSignalInitValue=0, ComSignalType=UINT8, ComSystemTemplateSystemSignalRef=DET_MH_SCAN_INDEX_4LSB_029_032
            DET_MTD_029_oRDR_DETECTION_029_032_oPCAN_RADAR_d96cfa0d_Tx: ComBitPosition=47, ComBitSize=1, ComSignalInitValue=0, ComSignalType=BOOLEAN, ComSystemTemplateSystemSignalRef=DET_MTD_029
            DET_MTD_030_oRDR_DETECTION_029_032_oPCAN_RADAR_bc4c88a9_Tx: ComBitPosition=159, ComBitSize=1, ComSignalInitValue=0, ComSignalType=BOOLEAN, ComSystemTemplateSystemSignalRef=DET_MTD_030
            DET_MTD_031_oRDR_DETECTION_029_032_oPCAN_RADAR_293c5c3c_Tx: ComBitPosition=271, ComBitSize=1, ComSignalInitValue=0, ComSignalType=BOOLEAN, ComSystemTemplateSystemSignalRef=DET_MTD_031
            DET_MTD_032_oRDR_DETECTION_029_032_oPCAN_RADAR_4ddc27c2_Tx: ComBitPosition=383, ComBitSize=1, ComSignalInitValue=0, ComSignalType=BOOLEAN, ComSystemTemplateSystemSignalRef=DET_MTD_032
            DET_PROB_1STAZHYPO_029_oRDR_DETECTION_029_032_oPCAN_RADAR_4ad812c0_Tx: ComBitPosition=103, ComBitSize=1, ComSignalInitValue=0, ComSignalType=BOOLEAN, ComSystemTemplateSystemSignalRef=DET_PROB_1STAZHYPO_029
            DET_PROB_1STAZHYPO_030_oRDR_DETECTION_029_032_oPCAN_RADAR_2ff86064_Tx: ComBitPosition=215, ComBitSize=1, ComSignalInitValue=0, ComSignalType=BOOLEAN, ComSystemTemplateSystemSignalRef=DET_PROB_1STAZHYPO_030
            DET_PROB_1STAZHYPO_031_oRDR_DETECTION_029_032_oPCAN_RADAR_ba88b4f1_Tx: ComBitPosition=327, ComBitSize=1, ComSignalInitValue=0, ComSignalType=BOOLEAN, ComSystemTemplateSystemSignalRef=DET_PROB_1STAZHYPO_031
            DET_PROB_1STAZHYPO_032_oRDR_DETECTION_029_032_oPCAN_RADAR_de68cf0f_Tx: ComBitPosition=439, ComBitSize=1, ComSignalInitValue=0, ComSignalType=BOOLEAN, ComSystemTemplateSystemSignalRef=DET_PROB_1STAZHYPO_032
            DET_RANGE_029_oRDR_DETECTION_029_032_oPCAN_RADAR_4177f1b6_Tx: ComBitPosition=24, ComBitSize=15, ComSignalInitValue=0, ComSignalType=UINT16, ComSystemTemplateSystemSignalRef=DET_RANGE_029
            DET_RANGE_030_oRDR_DETECTION_029_032_oPCAN_RADAR_24578312_Tx: ComBitPosition=136, ComBitSize=15, ComSignalInitValue=0, ComSignalType=UINT16, ComSystemTemplateSystemSignalRef=DET_RANGE_030
            DET_RANGE_031_oRDR_DETECTION_029_032_oPCAN_RADAR_b1275787_Tx: ComBitPosition=248, ComBitSize=15, ComSignalInitValue=0, ComSignalType=UINT16, ComSystemTemplateSystemSignalRef=DET_RANGE_031
            DET_RANGE_032_oRDR_DETECTION_029_032_oPCAN_RADAR_d5c72c79_Tx: ComBitPosition=360, ComBitSize=15, ComSignalInitValue=0, ComSignalType=UINT16, ComSystemTemplateSystemSignalRef=DET_RANGE_032
            DET_RANGE_ERR_029_oRDR_DETECTION_029_032_oPCAN_RADAR_e69f4bdf_Tx: ComBitPosition=40, ComBitSize=7, ComSignalInitValue=0, ComSignalType=UINT8, ComSystemTemplateSystemSignalRef=DET_RANGE_ERR_029
            DET_RANGE_ERR_030_oRDR_DETECTION_029_032_oPCAN_RADAR_83bf397b_Tx: ComBitPosition=152, ComBitSize=7, ComSignalInitValue=0, ComSignalType=UINT8, ComSystemTemplateSystemSignalRef=DET_RANGE_ERR_030
            DET_RANGE_ERR_031_oRDR_DETECTION_029_032_oPCAN_RADAR_16cfedee_Tx: ComBitPosition=264, ComBitSize=7, ComSignalInitValue=0, ComSignalType=UINT8, ComSystemTemplateSystemSignalRef=DET_RANGE_ERR_031
            DET_RANGE_ERR_032_oRDR_DETECTION_029_032_oPCAN_RADAR_722f9610_Tx: ComBitPosition=376, ComBitSize=7, ComSignalInitValue=0, ComSignalType=UINT8, ComSystemTemplateSystemSignalRef=DET_RANGE_ERR_032
            DET_RANGE_VELOCITY_029_oRDR_DETECTION_029_032_oPCAN_RADAR_34d13393_Tx: ComBitPosition=48, ComBitSize=15, ComSignalInitValue=16384, ComSignalType=UINT16, ComSystemTemplateSystemSignalRef=DET_RANGE_VELOCITY_029
            DET_RANGE_VELOCITY_030_oRDR_DETECTION_029_032_oPCAN_RADAR_51f14137_Tx: ComBitPosition=160, ComBitSize=15, ComSignalInitValue=16384, ComSignalType=UINT16, ComSystemTemplateSystemSignalRef=DET_RANGE_VELOCITY_030
            DET_RANGE_VELOCITY_031_oRDR_DETECTION_029_032_oPCAN_RADAR_c48195a2_Tx: ComBitPosition=272, ComBitSize=15, ComSignalInitValue=16384, ComSignalType=UINT16, ComSystemTemplateSystemSignalRef=DET_RANGE_VELOCITY_031
            DET_RANGE_VELOCITY_032_oRDR_DETECTION_029_032_oPCAN_RADAR_a061ee5c_Tx: ComBitPosition=384, ComBitSize=15, ComSignalInitValue=16384, ComSignalType=UINT16, ComSystemTemplateSystemSignalRef=DET_RANGE_VELOCITY_032
            DET_RANGE_VELOCITY_ERR_029_oRDR_DETECTION_029_032_oPCAN_RADAR_3b6ac821_Tx: ComBitPosition=64, ComBitSize=8, ComSignalInitValue=0, ComSignalType=UINT8, ComSystemTemplateSystemSignalRef=DET_RANGE_VELOCITY_ERR_029
            DET_RANGE_VELOCITY_ERR_030_oRDR_DETECTION_029_032_oPCAN_RADAR_5e4aba85_Tx: ComBitPosition=176, ComBitSize=8, ComSignalInitValue=0, ComSignalType=UINT8, ComSystemTemplateSystemSignalRef=DET_RANGE_VELOCITY_ERR_030
            DET_RANGE_VELOCITY_ERR_031_oRDR_DETECTION_029_032_oPCAN_RADAR_cb3a6e10_Tx: ComBitPosition=288, ComBitSize=8, ComSignalInitValue=0, ComSignalType=UINT8, ComSystemTemplateSystemSignalRef=DET_RANGE_VELOCITY_ERR_031
            DET_RANGE_VELOCITY_ERR_032_oRDR_DETECTION_029_032_oPCAN_RADAR_afda15ee_Tx: ComBitPosition=400, ComBitSize=8, ComSignalInitValue=0, ComSignalType=UINT8, ComSystemTemplateSystemSignalRef=DET_RANGE_VELOCITY_ERR_032
            DET_RCS_029_oRDR_DETECTION_029_032_oPCAN_RADAR_b35104c9_Tx: ComBitPosition=128, ComBitSize=8, ComSignalInitValue=128, ComSignalType=UINT8, ComSystemTemplateSystemSignalRef=DET_RCS_029
            DET_RCS_030_oRDR_DETECTION_029_032_oPCAN_RADAR_d671766d_Tx: ComBitPosition=240, ComBitSize=8, ComSignalInitValue=128, ComSignalType=UINT8, ComSystemTemplateSystemSignalRef=DET_RCS_030
            DET_RCS_031_oRDR_DETECTION_029_032_oPCAN_RADAR_4301a2f8_Tx: ComBitPosition=352, ComBitSize=8, ComSignalInitValue=128, ComSignalType=UINT8, ComSystemTemplateSystemSignalRef=DET_RCS_031
            DET_RCS_032_oRDR_DETECTION_029_032_oPCAN_RADAR_27e1d906_Tx: ComBitPosition=464, ComBitSize=8, ComSignalInitValue=128, ComSignalType=UINT8, ComSystemTemplateSystemSignalRef=DET_RCS_032
            DET_SNR_029_oRDR_DETECTION_029_032_oPCAN_RADAR_6eff50cb_Tx: ComBitPosition=120, ComBitSize=8, ComSignalInitValue=0, ComSignalType=UINT8, ComSystemTemplateSystemSignalRef=DET_SNR_029
            DET_SNR_030_oRDR_DETECTION_029_032_oPCAN_RADAR_0bdf226f_Tx: ComBitPosition=232, ComBitSize=8, ComSignalInitValue=0, ComSignalType=UINT8, ComSystemTemplateSystemSignalRef=DET_SNR_030
            DET_SNR_031_oRDR_DETECTION_029_032_oPCAN_RADAR_9eaff6fa_Tx: ComBitPosition=344, ComBitSize=8, ComSignalInitValue=0, ComSignalType=UINT8, ComSystemTemplateSystemSignalRef=DET_SNR_031
            DET_SNR_032_oRDR_DETECTION_029_032_oPCAN_RADAR_fa4f8d04_Tx: ComBitPosition=456, ComBitSize=8, ComSignalInitValue=0, ComSignalType=UINT8, ComSystemTemplateSystemSignalRef=DET_SNR_032
            DET_SUPER_RES_TARGET_029_oRDR_DETECTION_029_032_oPCAN_RADAR_5f6678ae_Tx: ComBitPosition=87, ComBitSize=1, ComSignalInitValue=0, ComSignalType=BOOLEAN, ComSystemTemplateSystemSignalRef=DET_SUPER_RES_TARGET_029
            DET_SUPER_RES_TARGET_030_oRDR_DETECTION_029_032_oPCAN_RADAR_3a460a0a_Tx: ComBitPosition=199, ComBitSize=1, ComSignalInitValue=0, ComSignalType=BOOLEAN, ComSystemTemplateSystemSignalRef=DET_SUPER_RES_TARGET_030
            DET_SUPER_RES_TARGET_031_oRDR_DETECTION_029_032_oPCAN_RADAR_af36de9f_Tx: ComBitPosition=311, ComBitSize=1, ComSignalInitValue=0, ComSignalType=BOOLEAN, ComSystemTemplateSystemSignalRef=DET_SUPER_RES_TARGET_031
            DET_SUPER_RES_TARGET_032_oRDR_DETECTION_029_032_oPCAN_RADAR_cbd6a561_Tx: ComBitPosition=423, ComBitSize=1, ComSignalInitValue=0, ComSignalType=BOOLEAN, ComSystemTemplateSystemSignalRef=DET_SUPER_RES_TARGET_032
        SG_Detections_033_036_oRDR_DETECTION_033_036_oPCAN_RADAR_308f4df6_Tx: ComSystemTemplateSignalGroupRef=SG_Detections_033_036
          83 x ComGroupSignal, all with ComSignalEndianness=LITTLE_ENDIAN, ComTransferProperty=PENDING:
            DET_AZIMUTH_033_oRDR_DETECTION_033_036_oPCAN_RADAR_4deb8879_Tx: ComBitPosition=88, ComBitSize=13, ComSignalInitValue=0, ComSignalType=UINT16, ComSystemTemplateSystemSignalRef=DET_AZIMUTH_033
            DET_AZIMUTH_034_oRDR_DETECTION_033_036_oPCAN_RADAR_115bab10_Tx: ComBitPosition=200, ComBitSize=13, ComSignalInitValue=0, ComSignalType=UINT16, ComSystemTemplateSystemSignalRef=DET_AZIMUTH_034
            DET_AZIMUTH_035_oRDR_DETECTION_033_036_oPCAN_RADAR_842b7f85_Tx: ComBitPosition=312, ComBitSize=13, ComSignalInitValue=0, ComSignalType=UINT16, ComSystemTemplateSystemSignalRef=DET_AZIMUTH_035
            DET_AZIMUTH_036_oRDR_DETECTION_033_036_oPCAN_RADAR_e0cb047b_Tx: ComBitPosition=424, ComBitSize=13, ComSignalInitValue=0, ComSignalType=UINT16, ComSystemTemplateSystemSignalRef=DET_AZIMUTH_036
            DET_AZIMUTH_ERR_033_oRDR_DETECTION_033_036_oPCAN_RADAR_e95e1d8c_Tx: ComBitPosition=105, ComBitSize=7, ComSignalInitValue=0, ComSignalType=UINT8, ComSystemTemplateSystemSignalRef=DET_AZIMUTH_ERR_033
            DET_AZIMUTH_ERR_034_oRDR_DETECTION_033_036_oPCAN_RADAR_b5ee3ee5_Tx: ComBitPosition=217, ComBitSize=7, ComSignalInitValue=0, ComSignalType=UINT8, ComSystemTemplateSystemSignalRef=DET_AZIMUTH_ERR_034
            DET_AZIMUTH_ERR_035_oRDR_DETECTION_033_036_oPCAN_RADAR_209eea70_Tx: ComBitPosition=329, ComBitSize=7, ComSignalInitValue=0, ComSignalType=UINT8, ComSystemTemplateSystemSignalRef=DET_AZIMUTH_ERR_035
            DET_AZIMUTH_ERR_036_oRDR_DETECTION_033_036_oPCAN_RADAR_447e918e_Tx: ComBitPosition=441, ComBitSize=7, ComSignalInitValue=0, ComSignalType=UINT8, ComSystemTemplateSystemSignalRef=DET_AZIMUTH_ERR_036
            DET_BELOW_RAIN_THOLD_033_oRDR_DETECTION_033_036_oPCAN_RADAR_98ea1bb9_Tx: ComBitPosition=39, ComBitSize=1, ComSignalInitValue=0, ComSignalType=BOOLEAN, ComSystemTemplateSystemSignalRef=DET_BELOW_RAIN_THOLD_033
            DET_BELOW_RAIN_THOLD_034_oRDR_DETECTION_033_036_oPCAN_RADAR_c45a38d0_Tx: ComBitPosition=151, ComBitSize=1, ComSignalInitValue=0, ComSignalType=BOOLEAN, ComSystemTemplateSystemSignalRef=DET_BELOW_RAIN_THOLD_034
            DET_BELOW_RAIN_THOLD_035_oRDR_DETECTION_033_036_oPCAN_RADAR_512aec45_Tx: ComBitPosition=263, ComBitSize=1, ComSignalInitValue=0, ComSignalType=BOOLEAN, ComSystemTemplateSystemSignalRef=DET_BELOW_RAIN_THOLD_035
            DET_BELOW_RAIN_THOLD_036_oRDR_DETECTION_033_036_oPCAN_RADAR_35ca97bb_Tx: ComBitPosition=375, ComBitSize=1, ComSignalInitValue=0, ComSignalType=BOOLEAN, ComSystemTemplateSystemSignalRef=DET_BELOW_RAIN_THOLD_036
            DET_BI_STATIC_FLAG_033_oRDR_DETECTION_033_036_oPCAN_RADAR_1bc7c8fc_Tx: ComBitPosition=104, ComBitSize=1, ComSignalInitValue=0, ComSignalType=BOOLEAN, ComSystemTemplateSystemSignalRef=DET_BI_STATIC_FLAG_033
            DET_BI_STATIC_FLAG_034_oRDR_DETECTION_033_036_oPCAN_RADAR_4777eb95_Tx: ComBitPosition=216, ComBitSize=1, ComSignalInitValue=0, ComSignalType=BOOLEAN, ComSystemTemplateSystemSignalRef=DET_BI_STATIC_FLAG_034
            DET_BI_STATIC_FLAG_035_oRDR_DETECTION_033_036_oPCAN_RADAR_d2073f00_Tx: ComBitPosition=328, ComBitSize=1, ComSignalInitValue=0, ComSignalType=BOOLEAN, ComSystemTemplateSystemSignalRef=DET_BI_STATIC_FLAG_035
            DET_BI_STATIC_FLAG_036_oRDR_DETECTION_033_036_oPCAN_RADAR_b6e744fe_Tx: ComBitPosition=440, ComBitSize=1, ComSignalInitValue=0, ComSignalType=BOOLEAN, ComSystemTemplateSystemSignalRef=DET_BI_STATIC_FLAG_036
            DET_CONFD_AZIMUTH_033_oRDR_DETECTION_033_036_oPCAN_RADAR_4f0d82b3_Tx: ComBitPosition=118, ComBitSize=2, ComSignalInitValue=0, ComSignalType=UINT8, ComSystemTemplateSystemSignalRef=DET_CONFD_AZIMUTH_033
            DET_CONFD_AZIMUTH_034_oRDR_DETECTION_033_036_oPCAN_RADAR_13bda1da_Tx: ComBitPosition=230, ComBitSize=2, ComSignalInitValue=0, ComSignalType=UINT8, ComSystemTemplateSystemSignalRef=DET_CONFD_AZIMUTH_034
            DET_CONFD_AZIMUTH_035_oRDR_DETECTION_033_036_oPCAN_RADAR_86cd754f_Tx: ComBitPosition=342, ComBitSize=2, ComSignalInitValue=0, ComSignalType=UINT8, ComSystemTemplateSystemSignalRef=DET_CONFD_AZIMUTH_035
            DET_CONFD_AZIMUTH_036_oRDR_DETECTION_033_036_oPCAN_RADAR_e22d0eb1_Tx: ComBitPosition=454, ComBitSize=2, ComSignalInitValue=0, ComSignalType=UINT8, ComSystemTemplateSystemSignalRef=DET_CONFD_AZIMUTH_036
            DET_CONFD_ELEVATION_033_oRDR_DETECTION_033_036_oPCAN_RADAR_4d988349_Tx: ComBitPosition=101, ComBitSize=2, ComSignalInitValue=0, ComSignalType=UINT8, ComSystemTemplateSystemSignalRef=DET_CONFD_ELEVATION_033
            DET_CONFD_ELEVATION_034_oRDR_DETECTION_033_036_oPCAN_RADAR_1128a020_Tx: ComBitPosition=213, ComBitSize=2, ComSignalInitValue=0, ComSignalType=UINT8, ComSystemTemplateSystemSignalRef=DET_CONFD_ELEVATION_034
            DET_CONFD_ELEVATION_035_oRDR_DETECTION_033_036_oPCAN_RADAR_845874b5_Tx: ComBitPosition=325, ComBitSize=2, ComSignalInitValue=0, ComSignalType=UINT8, ComSystemTemplateSystemSignalRef=DET_CONFD_ELEVATION_035
            DET_CONFD_ELEVATION_036_oRDR_DETECTION_033_036_oPCAN_RADAR_e0b80f4b_Tx: ComBitPosition=437, ComBitSize=2, ComSignalInitValue=0, ComSignalType=UINT8, ComSystemTemplateSystemSignalRef=DET_CONFD_ELEVATION_036
            DET_ELEVATION_033_oRDR_DETECTION_033_036_oPCAN_RADAR_9c585775_Tx: ComBitPosition=72, ComBitSize=8, ComSignalInitValue=0, ComSignalType=UINT8, ComSystemTemplateSystemSignalRef=DET_ELEVATION_033
            DET_ELEVATION_034_oRDR_DETECTION_033_036_oPCAN_RADAR_c0e8741c_Tx: ComBitPosition=184, ComBitSize=8, ComSignalInitValue=0, ComSignalType=UINT8, ComSystemTemplateSystemSignalRef=DET_ELEVATION_034
            DET_ELEVATION_035_oRDR_DETECTION_033_036_oPCAN_RADAR_5598a089_Tx: ComBitPosition=296, ComBitSize=8, ComSignalInitValue=0, ComSignalType=UINT8, ComSystemTemplateSystemSignalRef=DET_ELEVATION_035
            DET_ELEVATION_036_oRDR_DETECTION_033_036_oPCAN_RADAR_3178db77_Tx: ComBitPosition=408, ComBitSize=8, ComSignalInitValue=0, ComSignalType=UINT8, ComSystemTemplateSystemSignalRef=DET_ELEVATION_036
            DET_ELEVATION_ERR_033_oRDR_DETECTION_033_036_oPCAN_RADAR_1b61cf00_Tx: ComBitPosition=80, ComBitSize=6, ComSignalInitValue=0, ComSignalType=UINT8, ComSystemTemplateSystemSignalRef=DET_ELEVATION_ERR_033
            DET_ELEVATION_ERR_034_oRDR_DETECTION_033_036_oPCAN_RADAR_47d1ec69_Tx: ComBitPosition=192, ComBitSize=6, ComSignalInitValue=0, ComSignalType=UINT8, ComSystemTemplateSystemSignalRef=DET_ELEVATION_ERR_034
            DET_ELEVATION_ERR_035_oRDR_DETECTION_033_036_oPCAN_RADAR_d2a138fc_Tx: ComBitPosition=304, ComBitSize=6, ComSignalInitValue=0, ComSignalType=UINT8, ComSystemTemplateSystemSignalRef=DET_ELEVATION_ERR_035
            DET_ELEVATION_ERR_036_oRDR_DETECTION_033_036_oPCAN_RADAR_b6414302_Tx: ComBitPosition=416, ComBitSize=6, ComSignalInitValue=0, ComSignalType=UINT8, ComSystemTemplateSystemSignalRef=DET_ELEVATION_ERR_036
            DET_EXISTENCE_PROB_033_oRDR_DETECTION_033_036_oPCAN_RADAR_c9feba60_Tx: ComBitPosition=112, ComBitSize=6, ComSignalInitValue=0, ComSignalType=UINT8, ComSystemTemplateSystemSignalRef=DET_EXISTENCE_PROB_033
            DET_EXISTENCE_PROB_034_oRDR_DETECTION_033_036_oPCAN_RADAR_954e9909_Tx: ComBitPosition=224, ComBitSize=6, ComSignalInitValue=0, ComSignalType=UINT8, ComSystemTemplateSystemSignalRef=DET_EXISTENCE_PROB_034
            DET_EXISTENCE_PROB_035_oRDR_DETECTION_033_036_oPCAN_RADAR_003e4d9c_Tx: ComBitPosition=336, ComBitSize=6, ComSignalInitValue=0, ComSignalType=UINT8, ComSystemTemplateSystemSignalRef=DET_EXISTENCE_PROB_035
            DET_EXISTENCE_PROB_036_oRDR_DETECTION_033_036_oPCAN_RADAR_64de3662_Tx: ComBitPosition=448, ComBitSize=6, ComSignalInitValue=0, ComSignalType=UINT8, ComSystemTemplateSystemSignalRef=DET_EXISTENCE_PROB_036
            DET_HVC_FLAG_033_oRDR_DETECTION_033_036_oPCAN_RADAR_288af91f_Tx: ComBitPosition=86, ComBitSize=1, ComSignalInitValue=0, ComSignalType=BOOLEAN, ComSystemTemplateSystemSignalRef=DET_HVC_FLAG_033
            DET_HVC_FLAG_034_oRDR_DETECTION_033_036_oPCAN_RADAR_743ada76_Tx: ComBitPosition=198, ComBitSize=1, ComSignalInitValue=0, ComSignalType=BOOLEAN, ComSystemTemplateSystemSignalRef=DET_HVC_FLAG_034
            DET_HVC_FLAG_035_oRDR_DETECTION_033_036_oPCAN_RADAR_e14a0ee3_Tx: ComBitPosition=310, ComBitSize=1, ComSignalInitValue=0, ComSignalType=BOOLEAN, ComSystemTemplateSystemSignalRef=DET_HVC_FLAG_035
            DET_HVC_FLAG_036_oRDR_DETECTION_033_036_oPCAN_RADAR_85aa751d_Tx: ComBitPosition=422, ComBitSize=1, ComSignalInitValue=0, ComSignalType=BOOLEAN, ComSystemTemplateSystemSignalRef=DET_HVC_FLAG_036
            DET_IDM_033_oRDR_DETECTION_033_036_oPCAN_RADAR_a3d8c2a2_Tx: ComBitPosition=63, ComBitSize=1, ComSignalInitValue=0, ComSignalType=BOOLEAN, ComSystemTemplateSystemSignalRef=DET_IDM_033
            DET_IDM_034_oRDR_DETECTION_033_036_oPCAN_RADAR_ff68e1cb_Tx: ComBitPosition=175, ComBitSize=1, ComSignalInitValue=0, ComSignalType=BOOLEAN, ComSystemTemplateSystemSignalRef=DET_IDM_034
            DET_IDM_035_oRDR_DETECTION_033_036_oPCAN_RADAR_6a18355e_Tx: ComBitPosition=287, ComBitSize=1, ComSignalInitValue=0, ComSignalType=BOOLEAN, ComSystemTemplateSystemSignalRef=DET_IDM_035
            DET_IDM_036_oRDR_DETECTION_033_036_oPCAN_RADAR_0ef84ea0_Tx: ComBitPosition=399, ComBitSize=1, ComSignalInitValue=0, ComSignalType=BOOLEAN, ComSystemTemplateSystemSignalRef=DET_IDM_036
            DET_MH_CRC16_033_036_oRDR_DETECTION_033_036_oPCAN_RADAR_b4079ffd_Tx: ComBitPosition=0, ComBitSize=16, ComSignalInitValue=0, ComSignalType=UINT16, ComSystemTemplateSystemSignalRef=DET_MH_CRC16_033_036
            DET_MH_CYCLE_COUNTER_033_036_oRDR_DETECTION_033_036_oPCAN_RADAR_30723eca_Tx: ComBitPosition=16, ComBitSize=8, ComSignalInitValue=0, ComSignalType=UINT8, ComSystemTemplateSystemSignalRef=DET_MH_CYCLE_COUNTER_033_036
            DET_MH_SCAN_INDEX_4LSB_033_036_oRDR_DETECTION_033_036_oPCAN_RADAR_fc581b46_Tx: ComBitPosition=476, ComBitSize=4, ComSignalInitValue=0, ComSignalType=UINT8, ComSystemTemplateSystemSignalRef=DET_MH_SCAN_INDEX_4LSB_033_036
            DET_MTD_033_oRDR_DETECTION_033_036_oPCAN_RADAR_c56bf079_Tx: ComBitPosition=47, ComBitSize=1, ComSignalInitValue=0, ComSignalType=BOOLEAN, ComSystemTemplateSystemSignalRef=DET_MTD_033
            DET_MTD_034_oRDR_DETECTION_033_036_oPCAN_RADAR_99dbd310_Tx: ComBitPosition=159, ComBitSize=1, ComSignalInitValue=0, ComSignalType=BOOLEAN, ComSystemTemplateSystemSignalRef=DET_MTD_034
            DET_MTD_035_oRDR_DETECTION_033_036_oPCAN_RADAR_0cab0785_Tx: ComBitPosition=271, ComBitSize=1, ComSignalInitValue=0, ComSignalType=BOOLEAN, ComSystemTemplateSystemSignalRef=DET_MTD_035
            DET_MTD_036_oRDR_DETECTION_033_036_oPCAN_RADAR_684b7c7b_Tx: ComBitPosition=383, ComBitSize=1, ComSignalInitValue=0, ComSignalType=BOOLEAN, ComSystemTemplateSystemSignalRef=DET_MTD_036
            DET_PROB_1STAZHYPO_033_oRDR_DETECTION_033_036_oPCAN_RADAR_56df18b4_Tx: ComBitPosition=103, ComBitSize=1, ComSignalInitValue=0, ComSignalType=BOOLEAN, ComSystemTemplateSystemSignalRef=DET_PROB_1STAZHYPO_033
            DET_PROB_1STAZHYPO_034_oRDR_DETECTION_033_036_oPCAN_RADAR_0a6f3bdd_Tx: ComBitPosition=215, ComBitSize=1, ComSignalInitValue=0, ComSignalType=BOOLEAN, ComSystemTemplateSystemSignalRef=DET_PROB_1STAZHYPO_034
            DET_PROB_1STAZHYPO_035_oRDR_DETECTION_033_036_oPCAN_RADAR_9f1fef48_Tx: ComBitPosition=327, ComBitSize=1, ComSignalInitValue=0, ComSignalType=BOOLEAN, ComSystemTemplateSystemSignalRef=DET_PROB_1STAZHYPO_035
            DET_PROB_1STAZHYPO_036_oRDR_DETECTION_033_036_oPCAN_RADAR_fbff94b6_Tx: ComBitPosition=439, ComBitSize=1, ComSignalInitValue=0, ComSignalType=BOOLEAN, ComSystemTemplateSystemSignalRef=DET_PROB_1STAZHYPO_036
            DET_RANGE_033_oRDR_DETECTION_033_036_oPCAN_RADAR_5d70fbc2_Tx: ComBitPosition=24, ComBitSize=15, ComSignalInitValue=0, ComSignalType=UINT16, ComSystemTemplateSystemSignalRef=DET_RANGE_033
            DET_RANGE_034_oRDR_DETECTION_033_036_oPCAN_RADAR_01c0d8ab_Tx: ComBitPosition=136, ComBitSize=15, ComSignalInitValue=0, ComSignalType=UINT16, ComSystemTemplateSystemSignalRef=DET_RANGE_034
            DET_RANGE_035_oRDR_DETECTION_033_036_oPCAN_RADAR_94b00c3e_Tx: ComBitPosition=248, ComBitSize=15, ComSignalInitValue=0, ComSignalType=UINT16, ComSystemTemplateSystemSignalRef=DET_RANGE_035
            DET_RANGE_036_oRDR_DETECTION_033_036_oPCAN_RADAR_f05077c0_Tx: ComBitPosition=360, ComBitSize=15, ComSignalInitValue=0, ComSignalType=UINT16, ComSystemTemplateSystemSignalRef=DET_RANGE_036
            DET_RANGE_ERR_033_oRDR_DETECTION_033_036_oPCAN_RADAR_fa9841ab_Tx: ComBitPosition=40, ComBitSize=7, ComSignalInitValue=0, ComSignalType=UINT8, ComSystemTemplateSystemSignalRef=DET_RANGE_ERR_033
            DET_RANGE_ERR_034_oRDR_DETECTION_033_036_oPCAN_RADAR_a62862c2_Tx: ComBitPosition=152, ComBitSize=7, ComSignalInitValue=0, ComSignalType=UINT8, ComSystemTemplateSystemSignalRef=DET_RANGE_ERR_034
            DET_RANGE_ERR_035_oRDR_DETECTION_033_036_oPCAN_RADAR_3358b657_Tx: ComBitPosition=264, ComBitSize=7, ComSignalInitValue=0, ComSignalType=UINT8, ComSystemTemplateSystemSignalRef=DET_RANGE_ERR_035
            DET_RANGE_ERR_036_oRDR_DETECTION_033_036_oPCAN_RADAR_57b8cda9_Tx: ComBitPosition=376, ComBitSize=7, ComSignalInitValue=0, ComSignalType=UINT8, ComSystemTemplateSystemSignalRef=DET_RANGE_ERR_036
            DET_RANGE_VELOCITY_033_oRDR_DETECTION_033_036_oPCAN_RADAR_28d639e7_Tx: ComBitPosition=48, ComBitSize=15, ComSignalInitValue=16384, ComSignalType=UINT16, ComSystemTemplateSystemSignalRef=DET_RANGE_VELOCITY_033
            DET_RANGE_VELOCITY_034_oRDR_DETECTION_033_036_oPCAN_RADAR_74661a8e_Tx: ComBitPosition=160, ComBitSize=15, ComSignalInitValue=16384, ComSignalType=UINT16, ComSystemTemplateSystemSignalRef=DET_RANGE_VELOCITY_034
            DET_RANGE_VELOCITY_035_oRDR_DETECTION_033_036_oPCAN_RADAR_e116ce1b_Tx: ComBitPosition=272, ComBitSize=15, ComSignalInitValue=16384, ComSignalType=UINT16, ComSystemTemplateSystemSignalRef=DET_RANGE_VELOCITY_035
            DET_RANGE_VELOCITY_036_oRDR_DETECTION_033_036_oPCAN_RADAR_85f6b5e5_Tx: ComBitPosition=384, ComBitSize=15, ComSignalInitValue=16384, ComSignalType=UINT16, ComSystemTemplateSystemSignalRef=DET_RANGE_VELOCITY_036
            DET_RANGE_VELOCITY_ERR_033_oRDR_DETECTION_033_036_oPCAN_RADAR_276dc255_Tx: ComBitPosition=64, ComBitSize=8, ComSignalInitValue=0, ComSignalType=UINT8, ComSystemTemplateSystemSignalRef=DET_RANGE_VELOCITY_ERR_033
            DET_RANGE_VELOCITY_ERR_034_oRDR_DETECTION_033_036_oPCAN_RADAR_7bdde13c_Tx: ComBitPosition=176, ComBitSize=8, ComSignalInitValue=0, ComSignalType=UINT8, ComSystemTemplateSystemSignalRef=DET_RANGE_VELOCITY_ERR_034
            DET_RANGE_VELOCITY_ERR_035_oRDR_DETECTION_033_036_oPCAN_RADAR_eead35a9_Tx: ComBitPosition=288, ComBitSize=8, ComSignalInitValue=0, ComSignalType=UINT8, ComSystemTemplateSystemSignalRef=DET_RANGE_VELOCITY_ERR_035
            DET_RANGE_VELOCITY_ERR_036_oRDR_DETECTION_033_036_oPCAN_RADAR_8a4d4e57_Tx: ComBitPosition=400, ComBitSize=8, ComSignalInitValue=0, ComSignalType=UINT8, ComSystemTemplateSystemSignalRef=DET_RANGE_VELOCITY_ERR_036
            DET_RCS_033_oRDR_DETECTION_033_036_oPCAN_RADAR_af560ebd_Tx: ComBitPosition=128, ComBitSize=8, ComSignalInitValue=128, ComSignalType=UINT8, ComSystemTemplateSystemSignalRef=DET_RCS_033
            DET_RCS_034_oRDR_DETECTION_033_036_oPCAN_RADAR_f3e62dd4_Tx: ComBitPosition=240, ComBitSize=8, ComSignalInitValue=128, ComSignalType=UINT8, ComSystemTemplateSystemSignalRef=DET_RCS_034
            DET_RCS_035_oRDR_DETECTION_033_036_oPCAN_RADAR_6696f941_Tx: ComBitPosition=352, ComBitSize=8, ComSignalInitValue=128, ComSignalType=UINT8, ComSystemTemplateSystemSignalRef=DET_RCS_035
            DET_RCS_036_oRDR_DETECTION_033_036_oPCAN_RADAR_027682bf_Tx: ComBitPosition=464, ComBitSize=8, ComSignalInitValue=128, ComSignalType=UINT8, ComSystemTemplateSystemSignalRef=DET_RCS_036
            DET_SNR_033_oRDR_DETECTION_033_036_oPCAN_RADAR_72f85abf_Tx: ComBitPosition=120, ComBitSize=8, ComSignalInitValue=0, ComSignalType=UINT8, ComSystemTemplateSystemSignalRef=DET_SNR_033
            DET_SNR_034_oRDR_DETECTION_033_036_oPCAN_RADAR_2e4879d6_Tx: ComBitPosition=232, ComBitSize=8, ComSignalInitValue=0, ComSignalType=UINT8, ComSystemTemplateSystemSignalRef=DET_SNR_034
            DET_SNR_035_oRDR_DETECTION_033_036_oPCAN_RADAR_bb38ad43_Tx: ComBitPosition=344, ComBitSize=8, ComSignalInitValue=0, ComSignalType=UINT8, ComSystemTemplateSystemSignalRef=DET_SNR_035
            DET_SNR_036_oRDR_DETECTION_033_036_oPCAN_RADAR_dfd8d6bd_Tx: ComBitPosition=456, ComBitSize=8, ComSignalInitValue=0, ComSignalType=UINT8, ComSystemTemplateSystemSignalRef=DET_SNR_036
            DET_SUPER_RES_TARGET_033_oRDR_DETECTION_033_036_oPCAN_RADAR_436172da_Tx: ComBitPosition=87, ComBitSize=1, ComSignalInitValue=0, ComSignalType=BOOLEAN, ComSystemTemplateSystemSignalRef=DET_SUPER_RES_TARGET_033
            DET_SUPER_RES_TARGET_034_oRDR_DETECTION_033_036_oPCAN_RADAR_1fd151b3_Tx: ComBitPosition=199, ComBitSize=1, ComSignalInitValue=0, ComSignalType=BOOLEAN, ComSystemTemplateSystemSignalRef=DET_SUPER_RES_TARGET_034
            DET_SUPER_RES_TARGET_035_oRDR_DETECTION_033_036_oPCAN_RADAR_8aa18526_Tx: ComBitPosition=311, ComBitSize=1, ComSignalInitValue=0, ComSignalType=BOOLEAN, ComSystemTemplateSystemSignalRef=DET_SUPER_RES_TARGET_035
            DET_SUPER_RES_TARGET_036_oRDR_DETECTION_033_036_oPCAN_RADAR_ee41fed8_Tx: ComBitPosition=423, ComBitSize=1, ComSignalInitValue=0, ComSignalType=BOOLEAN, ComSystemTemplateSystemSignalRef=DET_SUPER_RES_TARGET_036
        SG_Detections_037_040_oRDR_DETECTION_037_040_oPCAN_RADAR_abdcc2d8_Tx: ComSystemTemplateSignalGroupRef=SG_Detections_037_040
          83 x ComGroupSignal, all with ComSignalEndianness=LITTLE_ENDIAN, ComTransferProperty=PENDING:
            DET_AZIMUTH_037_oRDR_DETECTION_037_040_oPCAN_RADAR_c39b823c_Tx: ComBitPosition=88, ComBitSize=13, ComSignalInitValue=0, ComSignalType=UINT16, ComSystemTemplateSystemSignalRef=DET_AZIMUTH_037
            DET_AZIMUTH_038_oRDR_DETECTION_037_040_oPCAN_RADAR_ef8b107b_Tx: ComBitPosition=200, ComBitSize=13, ComSignalInitValue=0, ComSignalType=UINT16, ComSystemTemplateSystemSignalRef=DET_AZIMUTH_038
            DET_AZIMUTH_039_oRDR_DETECTION_037_040_oPCAN_RADAR_7afbc4ee_Tx: ComBitPosition=312, ComBitSize=13, ComSignalInitValue=0, ComSignalType=UINT16, ComSystemTemplateSystemSignalRef=DET_AZIMUTH_039
            DET_AZIMUTH_040_oRDR_DETECTION_037_040_oPCAN_RADAR_ab19c88a_Tx: ComBitPosition=424, ComBitSize=13, ComSignalInitValue=0, ComSignalType=UINT16, ComSystemTemplateSystemSignalRef=DET_AZIMUTH_040
            DET_AZIMUTH_ERR_037_oRDR_DETECTION_037_040_oPCAN_RADAR_672e17c9_Tx: ComBitPosition=105, ComBitSize=7, ComSignalInitValue=0, ComSignalType=UINT8, ComSystemTemplateSystemSignalRef=DET_AZIMUTH_ERR_037
            DET_AZIMUTH_ERR_038_oRDR_DETECTION_037_040_oPCAN_RADAR_4b3e858e_Tx: ComBitPosition=217, ComBitSize=7, ComSignalInitValue=0, ComSignalType=UINT8, ComSystemTemplateSystemSignalRef=DET_AZIMUTH_ERR_038
            DET_AZIMUTH_ERR_039_oRDR_DETECTION_037_040_oPCAN_RADAR_de4e511b_Tx: ComBitPosition=329, ComBitSize=7, ComSignalInitValue=0, ComSignalType=UINT8, ComSystemTemplateSystemSignalRef=DET_AZIMUTH_ERR_039
            DET_AZIMUTH_ERR_040_oRDR_DETECTION_037_040_oPCAN_RADAR_0fac5d7f_Tx: ComBitPosition=441, ComBitSize=7, ComSignalInitValue=0, ComSignalType=UINT8, ComSystemTemplateSystemSignalRef=DET_AZIMUTH_ERR_040
            DET_BELOW_RAIN_THOLD_037_oRDR_DETECTION_037_040_oPCAN_RADAR_169a11fc_Tx: ComBitPosition=39, ComBitSize=1, ComSignalInitValue=0, ComSignalType=BOOLEAN, ComSystemTemplateSystemSignalRef=DET_BELOW_RAIN_THOLD_037
            DET_BELOW_RAIN_THOLD_038_oRDR_DETECTION_037_040_oPCAN_RADAR_3a8a83bb_Tx: ComBitPosition=151, ComBitSize=1, ComSignalInitValue=0, ComSignalType=BOOLEAN, ComSystemTemplateSystemSignalRef=DET_BELOW_RAIN_THOLD_038
            DET_BELOW_RAIN_THOLD_039_oRDR_DETECTION_037_040_oPCAN_RADAR_affa572e_Tx: ComBitPosition=263, ComBitSize=1, ComSignalInitValue=0, ComSignalType=BOOLEAN, ComSystemTemplateSystemSignalRef=DET_BELOW_RAIN_THOLD_039
            DET_BELOW_RAIN_THOLD_040_oRDR_DETECTION_037_040_oPCAN_RADAR_7e185b4a_Tx: ComBitPosition=375, ComBitSize=1, ComSignalInitValue=0, ComSignalType=BOOLEAN, ComSystemTemplateSystemSignalRef=DET_BELOW_RAIN_THOLD_040
            DET_BI_STATIC_FLAG_037_oRDR_DETECTION_037_040_oPCAN_RADAR_95b7c2b9_Tx: ComBitPosition=104, ComBitSize=1, ComSignalInitValue=0, ComSignalType=BOOLEAN, ComSystemTemplateSystemSignalRef=DET_BI_STATIC_FLAG_037
            DET_BI_STATIC_FLAG_038_oRDR_DETECTION_037_040_oPCAN_RADAR_b9a750fe_Tx: ComBitPosition=216, ComBitSize=1, ComSignalInitValue=0, ComSignalType=BOOLEAN, ComSystemTemplateSystemSignalRef=DET_BI_STATIC_FLAG_038
            DET_BI_STATIC_FLAG_039_oRDR_DETECTION_037_040_oPCAN_RADAR_2cd7846b_Tx: ComBitPosition=328, ComBitSize=1, ComSignalInitValue=0, ComSignalType=BOOLEAN, ComSystemTemplateSystemSignalRef=DET_BI_STATIC_FLAG_039
            DET_BI_STATIC_FLAG_040_oRDR_DETECTION_037_040_oPCAN_RADAR_fd35880f_Tx: ComBitPosition=440, ComBitSize=1, ComSignalInitValue=0, ComSignalType=BOOLEAN, ComSystemTemplateSystemSignalRef=DET_BI_STATIC_FLAG_040
            DET_CONFD_AZIMUTH_037_oRDR_DETECTION_037_040_oPCAN_RADAR_c17d88f6_Tx: ComBitPosition=118, ComBitSize=2, ComSignalInitValue=0, ComSignalType=UINT8, ComSystemTemplateSystemSignalRef=DET_CONFD_AZIMUTH_037
            DET_CONFD_AZIMUTH_038_oRDR_DETECTION_037_040_oPCAN_RADAR_ed6d1ab1_Tx: ComBitPosition=230, ComBitSize=2, ComSignalInitValue=0, ComSignalType=UINT8, ComSystemTemplateSystemSignalRef=DET_CONFD_AZIMUTH_038
            DET_CONFD_AZIMUTH_039_oRDR_DETECTION_037_040_oPCAN_RADAR_781dce24_Tx: ComBitPosition=342, ComBitSize=2, ComSignalInitValue=0, ComSignalType=UINT8, ComSystemTemplateSystemSignalRef=DET_CONFD_AZIMUTH_039
            DET_CONFD_AZIMUTH_040_oRDR_DETECTION_037_040_oPCAN_RADAR_a9ffc240_Tx: ComBitPosition=454, ComBitSize=2, ComSignalInitValue=0, ComSignalType=UINT8, ComSystemTemplateSystemSignalRef=DET_CONFD_AZIMUTH_040
            DET_CONFD_ELEVATION_037_oRDR_DETECTION_037_040_oPCAN_RADAR_c3e8890c_Tx: ComBitPosition=101, ComBitSize=2, ComSignalInitValue=0, ComSignalType=UINT8, ComSystemTemplateSystemSignalRef=DET_CONFD_ELEVATION_037
            DET_CONFD_ELEVATION_038_oRDR_DETECTION_037_040_oPCAN_RADAR_eff81b4b_Tx: ComBitPosition=213, ComBitSize=2, ComSignalInitValue=0, ComSignalType=UINT8, ComSystemTemplateSystemSignalRef=DET_CONFD_ELEVATION_038
            DET_CONFD_ELEVATION_039_oRDR_DETECTION_037_040_oPCAN_RADAR_7a88cfde_Tx: ComBitPosition=325, ComBitSize=2, ComSignalInitValue=0, ComSignalType=UINT8, ComSystemTemplateSystemSignalRef=DET_CONFD_ELEVATION_039
            DET_CONFD_ELEVATION_040_oRDR_DETECTION_037_040_oPCAN_RADAR_ab6ac3ba_Tx: ComBitPosition=437, ComBitSize=2, ComSignalInitValue=0, ComSignalType=UINT8, ComSystemTemplateSystemSignalRef=DET_CONFD_ELEVATION_040
            DET_ELEVATION_037_oRDR_DETECTION_037_040_oPCAN_RADAR_12285d30_Tx: ComBitPosition=72, ComBitSize=8, ComSignalInitValue=0, ComSignalType=UINT8, ComSystemTemplateSystemSignalRef=DET_ELEVATION_037
            DET_ELEVATION_038_oRDR_DETECTION_037_040_oPCAN_RADAR_3e38cf77_Tx: ComBitPosition=184, ComBitSize=8, ComSignalInitValue=0, ComSignalType=UINT8, ComSystemTemplateSystemSignalRef=DET_ELEVATION_038
            DET_ELEVATION_039_oRDR_DETECTION_037_040_oPCAN_RADAR_ab481be2_Tx: ComBitPosition=296, ComBitSize=8, ComSignalInitValue=0, ComSignalType=UINT8, ComSystemTemplateSystemSignalRef=DET_ELEVATION_039
            DET_ELEVATION_040_oRDR_DETECTION_037_040_oPCAN_RADAR_7aaa1786_Tx: ComBitPosition=408, ComBitSize=8, ComSignalInitValue=0, ComSignalType=UINT8, ComSystemTemplateSystemSignalRef=DET_ELEVATION_040
            DET_ELEVATION_ERR_037_oRDR_DETECTION_037_040_oPCAN_RADAR_9511c545_Tx: ComBitPosition=80, ComBitSize=6, ComSignalInitValue=0, ComSignalType=UINT8, ComSystemTemplateSystemSignalRef=DET_ELEVATION_ERR_037
            DET_ELEVATION_ERR_038_oRDR_DETECTION_037_040_oPCAN_RADAR_b9015702_Tx: ComBitPosition=192, ComBitSize=6, ComSignalInitValue=0, ComSignalType=UINT8, ComSystemTemplateSystemSignalRef=DET_ELEVATION_ERR_038
            DET_ELEVATION_ERR_039_oRDR_DETECTION_037_040_oPCAN_RADAR_2c718397_Tx: ComBitPosition=304, ComBitSize=6, ComSignalInitValue=0, ComSignalType=UINT8, ComSystemTemplateSystemSignalRef=DET_ELEVATION_ERR_039
            DET_ELEVATION_ERR_040_oRDR_DETECTION_037_040_oPCAN_RADAR_fd938ff3_Tx: ComBitPosition=416, ComBitSize=6, ComSignalInitValue=0, ComSignalType=UINT8, ComSystemTemplateSystemSignalRef=DET_ELEVATION_ERR_040
            DET_EXISTENCE_PROB_037_oRDR_DETECTION_037_040_oPCAN_RADAR_478eb025_Tx: ComBitPosition=112, ComBitSize=6, ComSignalInitValue=0, ComSignalType=UINT8, ComSystemTemplateSystemSignalRef=DET_EXISTENCE_PROB_037
            DET_EXISTENCE_PROB_038_oRDR_DETECTION_037_040_oPCAN_RADAR_6b9e2262_Tx: ComBitPosition=224, ComBitSize=6, ComSignalInitValue=0, ComSignalType=UINT8, ComSystemTemplateSystemSignalRef=DET_EXISTENCE_PROB_038
            DET_EXISTENCE_PROB_039_oRDR_DETECTION_037_040_oPCAN_RADAR_feeef6f7_Tx: ComBitPosition=336, ComBitSize=6, ComSignalInitValue=0, ComSignalType=UINT8, ComSystemTemplateSystemSignalRef=DET_EXISTENCE_PROB_039
            DET_EXISTENCE_PROB_040_oRDR_DETECTION_037_040_oPCAN_RADAR_2f0cfa93_Tx: ComBitPosition=448, ComBitSize=6, ComSignalInitValue=0, ComSignalType=UINT8, ComSystemTemplateSystemSignalRef=DET_EXISTENCE_PROB_040
            DET_HVC_FLAG_037_oRDR_DETECTION_037_040_oPCAN_RADAR_a6faf35a_Tx: ComBitPosition=86, ComBitSize=1, ComSignalInitValue=0, ComSignalType=BOOLEAN, ComSystemTemplateSystemSignalRef=DET_HVC_FLAG_037
            DET_HVC_FLAG_038_oRDR_DETECTION_037_040_oPCAN_RADAR_8aea611d_Tx: ComBitPosition=198, ComBitSize=1, ComSignalInitValue=0, ComSignalType=BOOLEAN, ComSystemTemplateSystemSignalRef=DET_HVC_FLAG_038
            DET_HVC_FLAG_039_oRDR_DETECTION_037_040_oPCAN_RADAR_1f9ab588_Tx: ComBitPosition=310, ComBitSize=1, ComSignalInitValue=0, ComSignalType=BOOLEAN, ComSystemTemplateSystemSignalRef=DET_HVC_FLAG_039
            DET_HVC_FLAG_040_oRDR_DETECTION_037_040_oPCAN_RADAR_ce78b9ec_Tx: ComBitPosition=422, ComBitSize=1, ComSignalInitValue=0, ComSignalType=BOOLEAN, ComSystemTemplateSystemSignalRef=DET_HVC_FLAG_040
            DET_IDM_037_oRDR_DETECTION_037_040_oPCAN_RADAR_2da8c8e7_Tx: ComBitPosition=63, ComBitSize=1, ComSignalInitValue=0, ComSignalType=BOOLEAN, ComSystemTemplateSystemSignalRef=DET_IDM_037
            DET_IDM_038_oRDR_DETECTION_037_040_oPCAN_RADAR_01b85aa0_Tx: ComBitPosition=175, ComBitSize=1, ComSignalInitValue=0, ComSignalType=BOOLEAN, ComSystemTemplateSystemSignalRef=DET_IDM_038
            DET_IDM_039_oRDR_DETECTION_037_040_oPCAN_RADAR_94c88e35_Tx: ComBitPosition=287, ComBitSize=1, ComSignalInitValue=0, ComSignalType=BOOLEAN, ComSystemTemplateSystemSignalRef=DET_IDM_039
            DET_IDM_040_oRDR_DETECTION_037_040_oPCAN_RADAR_452a8251_Tx: ComBitPosition=399, ComBitSize=1, ComSignalInitValue=0, ComSignalType=BOOLEAN, ComSystemTemplateSystemSignalRef=DET_IDM_040
            DET_MH_CRC16_037_040_oRDR_DETECTION_037_040_oPCAN_RADAR_2f5410d3_Tx: ComBitPosition=0, ComBitSize=16, ComSignalInitValue=0, ComSignalType=UINT16, ComSystemTemplateSystemSignalRef=DET_MH_CRC16_037_040
            DET_MH_CYCLE_COUNTER_037_040_oRDR_DETECTION_037_040_oPCAN_RADAR_ab21b1e4_Tx: ComBitPosition=16, ComBitSize=8, ComSignalInitValue=0, ComSignalType=UINT8, ComSystemTemplateSystemSignalRef=DET_MH_CYCLE_COUNTER_037_040
            DET_MH_SCAN_INDEX_4LSB_037_040_oRDR_DETECTION_037_040_oPCAN_RADAR_670b9468_Tx: ComBitPosition=476, ComBitSize=4, ComSignalInitValue=0, ComSignalType=UINT8, ComSystemTemplateSystemSignalRef=DET_MH_SCAN_INDEX_4LSB_037_040
            DET_MTD_037_oRDR_DETECTION_037_040_oPCAN_RADAR_4b1bfa3c_Tx: ComBitPosition=47, ComBitSize=1, ComSignalInitValue=0, ComSignalType=BOOLEAN, ComSystemTemplateSystemSignalRef=DET_MTD_037
            DET_MTD_038_oRDR_DETECTION_037_040_oPCAN_RADAR_670b687b_Tx: ComBitPosition=159, ComBitSize=1, ComSignalInitValue=0, ComSignalType=BOOLEAN, ComSystemTemplateSystemSignalRef=DET_MTD_038
            DET_MTD_039_oRDR_DETECTION_037_040_oPCAN_RADAR_f27bbcee_Tx: ComBitPosition=271, ComBitSize=1, ComSignalInitValue=0, ComSignalType=BOOLEAN, ComSystemTemplateSystemSignalRef=DET_MTD_039
            DET_MTD_040_oRDR_DETECTION_037_040_oPCAN_RADAR_2399b08a_Tx: ComBitPosition=383, ComBitSize=1, ComSignalInitValue=0, ComSignalType=BOOLEAN, ComSystemTemplateSystemSignalRef=DET_MTD_040
            DET_PROB_1STAZHYPO_037_oRDR_DETECTION_037_040_oPCAN_RADAR_d8af12f1_Tx: ComBitPosition=103, ComBitSize=1, ComSignalInitValue=0, ComSignalType=BOOLEAN, ComSystemTemplateSystemSignalRef=DET_PROB_1STAZHYPO_037
            DET_PROB_1STAZHYPO_038_oRDR_DETECTION_037_040_oPCAN_RADAR_f4bf80b6_Tx: ComBitPosition=215, ComBitSize=1, ComSignalInitValue=0, ComSignalType=BOOLEAN, ComSystemTemplateSystemSignalRef=DET_PROB_1STAZHYPO_038
            DET_PROB_1STAZHYPO_039_oRDR_DETECTION_037_040_oPCAN_RADAR_61cf5423_Tx: ComBitPosition=327, ComBitSize=1, ComSignalInitValue=0, ComSignalType=BOOLEAN, ComSystemTemplateSystemSignalRef=DET_PROB_1STAZHYPO_039
            DET_PROB_1STAZHYPO_040_oRDR_DETECTION_037_040_oPCAN_RADAR_b02d5847_Tx: ComBitPosition=439, ComBitSize=1, ComSignalInitValue=0, ComSignalType=BOOLEAN, ComSystemTemplateSystemSignalRef=DET_PROB_1STAZHYPO_040
            DET_RANGE_037_oRDR_DETECTION_037_040_oPCAN_RADAR_d300f187_Tx: ComBitPosition=24, ComBitSize=15, ComSignalInitValue=0, ComSignalType=UINT16, ComSystemTemplateSystemSignalRef=DET_RANGE_037
            DET_RANGE_038_oRDR_DETECTION_037_040_oPCAN_RADAR_ff1063c0_Tx: ComBitPosition=136, ComBitSize=15, ComSignalInitValue=0, ComSignalType=UINT16, ComSystemTemplateSystemSignalRef=DET_RANGE_038
            DET_RANGE_039_oRDR_DETECTION_037_040_oPCAN_RADAR_6a60b755_Tx: ComBitPosition=248, ComBitSize=15, ComSignalInitValue=0, ComSignalType=UINT16, ComSystemTemplateSystemSignalRef=DET_RANGE_039
            DET_RANGE_040_oRDR_DETECTION_037_040_oPCAN_RADAR_bb82bb31_Tx: ComBitPosition=360, ComBitSize=15, ComSignalInitValue=0, ComSignalType=UINT16, ComSystemTemplateSystemSignalRef=DET_RANGE_040
            DET_RANGE_ERR_037_oRDR_DETECTION_037_040_oPCAN_RADAR_74e84bee_Tx: ComBitPosition=40, ComBitSize=7, ComSignalInitValue=0, ComSignalType=UINT8, ComSystemTemplateSystemSignalRef=DET_RANGE_ERR_037
            DET_RANGE_ERR_038_oRDR_DETECTION_037_040_oPCAN_RADAR_58f8d9a9_Tx: ComBitPosition=152, ComBitSize=7, ComSignalInitValue=0, ComSignalType=UINT8, ComSystemTemplateSystemSignalRef=DET_RANGE_ERR_038
            DET_RANGE_ERR_039_oRDR_DETECTION_037_040_oPCAN_RADAR_cd880d3c_Tx: ComBitPosition=264, ComBitSize=7, ComSignalInitValue=0, ComSignalType=UINT8, ComSystemTemplateSystemSignalRef=DET_RANGE_ERR_039
            DET_RANGE_ERR_040_oRDR_DETECTION_037_040_oPCAN_RADAR_1c6a0158_Tx: ComBitPosition=376, ComBitSize=7, ComSignalInitValue=0, ComSignalType=UINT8, ComSystemTemplateSystemSignalRef=DET_RANGE_ERR_040
            DET_RANGE_VELOCITY_037_oRDR_DETECTION_037_040_oPCAN_RADAR_a6a633a2_Tx: ComBitPosition=48, ComBitSize=15, ComSignalInitValue=16384, ComSignalType=UINT16, ComSystemTemplateSystemSignalRef=DET_RANGE_VELOCITY_037
            DET_RANGE_VELOCITY_038_oRDR_DETECTION_037_040_oPCAN_RADAR_8ab6a1e5_Tx: ComBitPosition=160, ComBitSize=15, ComSignalInitValue=16384, ComSignalType=UINT16, ComSystemTemplateSystemSignalRef=DET_RANGE_VELOCITY_038
            DET_RANGE_VELOCITY_039_oRDR_DETECTION_037_040_oPCAN_RADAR_1fc67570_Tx: ComBitPosition=272, ComBitSize=15, ComSignalInitValue=16384, ComSignalType=UINT16, ComSystemTemplateSystemSignalRef=DET_RANGE_VELOCITY_039
            DET_RANGE_VELOCITY_040_oRDR_DETECTION_037_040_oPCAN_RADAR_ce247914_Tx: ComBitPosition=384, ComBitSize=15, ComSignalInitValue=16384, ComSignalType=UINT16, ComSystemTemplateSystemSignalRef=DET_RANGE_VELOCITY_040
            DET_RANGE_VELOCITY_ERR_037_oRDR_DETECTION_037_040_oPCAN_RADAR_a91dc810_Tx: ComBitPosition=64, ComBitSize=8, ComSignalInitValue=0, ComSignalType=UINT8, ComSystemTemplateSystemSignalRef=DET_RANGE_VELOCITY_ERR_037
            DET_RANGE_VELOCITY_ERR_038_oRDR_DETECTION_037_040_oPCAN_RADAR_850d5a57_Tx: ComBitPosition=176, ComBitSize=8, ComSignalInitValue=0, ComSignalType=UINT8, ComSystemTemplateSystemSignalRef=DET_RANGE_VELOCITY_ERR_038
            DET_RANGE_VELOCITY_ERR_039_oRDR_DETECTION_037_040_oPCAN_RADAR_107d8ec2_Tx: ComBitPosition=288, ComBitSize=8, ComSignalInitValue=0, ComSignalType=UINT8, ComSystemTemplateSystemSignalRef=DET_RANGE_VELOCITY_ERR_039
            DET_RANGE_VELOCITY_ERR_040_oRDR_DETECTION_037_040_oPCAN_RADAR_c19f82a6_Tx: ComBitPosition=400, ComBitSize=8, ComSignalInitValue=0, ComSignalType=UINT8, ComSystemTemplateSystemSignalRef=DET_RANGE_VELOCITY_ERR_040
            DET_RCS_037_oRDR_DETECTION_037_040_oPCAN_RADAR_212604f8_Tx: ComBitPosition=128, ComBitSize=8, ComSignalInitValue=128, ComSignalType=UINT8, ComSystemTemplateSystemSignalRef=DET_RCS_037
            DET_RCS_038_oRDR_DETECTION_037_040_oPCAN_RADAR_0d3696bf_Tx: ComBitPosition=240, ComBitSize=8, ComSignalInitValue=128, ComSignalType=UINT8, ComSystemTemplateSystemSignalRef=DET_RCS_038
            DET_RCS_039_oRDR_DETECTION_037_040_oPCAN_RADAR_9846422a_Tx: ComBitPosition=352, ComBitSize=8, ComSignalInitValue=128, ComSignalType=UINT8, ComSystemTemplateSystemSignalRef=DET_RCS_039
            DET_RCS_040_oRDR_DETECTION_037_040_oPCAN_RADAR_49a44e4e_Tx: ComBitPosition=464, ComBitSize=8, ComSignalInitValue=128, ComSignalType=UINT8, ComSystemTemplateSystemSignalRef=DET_RCS_040
            DET_SNR_037_oRDR_DETECTION_037_040_oPCAN_RADAR_fc8850fa_Tx: ComBitPosition=120, ComBitSize=8, ComSignalInitValue=0, ComSignalType=UINT8, ComSystemTemplateSystemSignalRef=DET_SNR_037
            DET_SNR_038_oRDR_DETECTION_037_040_oPCAN_RADAR_d098c2bd_Tx: ComBitPosition=232, ComBitSize=8, ComSignalInitValue=0, ComSignalType=UINT8, ComSystemTemplateSystemSignalRef=DET_SNR_038
            DET_SNR_039_oRDR_DETECTION_037_040_oPCAN_RADAR_45e81628_Tx: ComBitPosition=344, ComBitSize=8, ComSignalInitValue=0, ComSignalType=UINT8, ComSystemTemplateSystemSignalRef=DET_SNR_039
            DET_SNR_040_oRDR_DETECTION_037_040_oPCAN_RADAR_940a1a4c_Tx: ComBitPosition=456, ComBitSize=8, ComSignalInitValue=0, ComSignalType=UINT8, ComSystemTemplateSystemSignalRef=DET_SNR_040
            DET_SUPER_RES_TARGET_037_oRDR_DETECTION_037_040_oPCAN_RADAR_cd11789f_Tx: ComBitPosition=87, ComBitSize=1, ComSignalInitValue=0, ComSignalType=BOOLEAN, ComSystemTemplateSystemSignalRef=DET_SUPER_RES_TARGET_037
            DET_SUPER_RES_TARGET_038_oRDR_DETECTION_037_040_oPCAN_RADAR_e101ead8_Tx: ComBitPosition=199, ComBitSize=1, ComSignalInitValue=0, ComSignalType=BOOLEAN, ComSystemTemplateSystemSignalRef=DET_SUPER_RES_TARGET_038
            DET_SUPER_RES_TARGET_039_oRDR_DETECTION_037_040_oPCAN_RADAR_74713e4d_Tx: ComBitPosition=311, ComBitSize=1, ComSignalInitValue=0, ComSignalType=BOOLEAN, ComSystemTemplateSystemSignalRef=DET_SUPER_RES_TARGET_039
            DET_SUPER_RES_TARGET_040_oRDR_DETECTION_037_040_oPCAN_RADAR_a5933229_Tx: ComBitPosition=423, ComBitSize=1, ComSignalInitValue=0, ComSignalType=BOOLEAN, ComSystemTemplateSystemSignalRef=DET_SUPER_RES_TARGET_040
        SG_Detections_041_044_oRDR_DETECTION_041_044_oPCAN_RADAR_b5a3d501_Tx: ComSystemTemplateSignalGroupRef=SG_Detections_041_044
          83 x ComGroupSignal, all with ComSignalEndianness=LITTLE_ENDIAN, ComTransferProperty=PENDING:
            DET_AZIMUTH_041_oRDR_DETECTION_041_044_oPCAN_RADAR_b8cacbe5_Tx: ComBitPosition=88, ComBitSize=13, ComSignalInitValue=0, ComSignalType=UINT16, ComSystemTemplateSystemSignalRef=DET_AZIMUTH_041
            DET_AZIMUTH_042_oRDR_DETECTION_041_044_oPCAN_RADAR_dc2ab01b_Tx: ComBitPosition=200, ComBitSize=13, ComSignalInitValue=0, ComSignalType=UINT16, ComSystemTemplateSystemSignalRef=DET_AZIMUTH_042
            DET_AZIMUTH_043_oRDR_DETECTION_041_044_oPCAN_RADAR_495a648e_Tx: ComBitPosition=312, ComBitSize=13, ComSignalInitValue=0, ComSignalType=UINT16, ComSystemTemplateSystemSignalRef=DET_AZIMUTH_043
            DET_AZIMUTH_044_oRDR_DETECTION_041_044_oPCAN_RADAR_15ea47e7_Tx: ComBitPosition=424, ComBitSize=13, ComSignalInitValue=0, ComSignalType=UINT16, ComSystemTemplateSystemSignalRef=DET_AZIMUTH_044
            DET_AZIMUTH_ERR_041_oRDR_DETECTION_041_044_oPCAN_RADAR_1c7f5e10_Tx: ComBitPosition=105, ComBitSize=7, ComSignalInitValue=0, ComSignalType=UINT8, ComSystemTemplateSystemSignalRef=DET_AZIMUTH_ERR_041
            DET_AZIMUTH_ERR_042_oRDR_DETECTION_041_044_oPCAN_RADAR_789f25ee_Tx: ComBitPosition=217, ComBitSize=7, ComSignalInitValue=0, ComSignalType=UINT8, ComSystemTemplateSystemSignalRef=DET_AZIMUTH_ERR_042
            DET_AZIMUTH_ERR_043_oRDR_DETECTION_041_044_oPCAN_RADAR_edeff17b_Tx: ComBitPosition=329, ComBitSize=7, ComSignalInitValue=0, ComSignalType=UINT8, ComSystemTemplateSystemSignalRef=DET_AZIMUTH_ERR_043
            DET_AZIMUTH_ERR_044_oRDR_DETECTION_041_044_oPCAN_RADAR_b15fd212_Tx: ComBitPosition=441, ComBitSize=7, ComSignalInitValue=0, ComSignalType=UINT8, ComSystemTemplateSystemSignalRef=DET_AZIMUTH_ERR_044
            DET_BELOW_RAIN_THOLD_041_oRDR_DETECTION_041_044_oPCAN_RADAR_6dcb5825_Tx: ComBitPosition=39, ComBitSize=1, ComSignalInitValue=0, ComSignalType=BOOLEAN, ComSystemTemplateSystemSignalRef=DET_BELOW_RAIN_THOLD_041
            DET_BELOW_RAIN_THOLD_042_oRDR_DETECTION_041_044_oPCAN_RADAR_092b23db_Tx: ComBitPosition=151, ComBitSize=1, ComSignalInitValue=0, ComSignalType=BOOLEAN, ComSystemTemplateSystemSignalRef=DET_BELOW_RAIN_THOLD_042
            DET_BELOW_RAIN_THOLD_043_oRDR_DETECTION_041_044_oPCAN_RADAR_9c5bf74e_Tx: ComBitPosition=263, ComBitSize=1, ComSignalInitValue=0, ComSignalType=BOOLEAN, ComSystemTemplateSystemSignalRef=DET_BELOW_RAIN_THOLD_043
            DET_BELOW_RAIN_THOLD_044_oRDR_DETECTION_041_044_oPCAN_RADAR_c0ebd427_Tx: ComBitPosition=375, ComBitSize=1, ComSignalInitValue=0, ComSignalType=BOOLEAN, ComSystemTemplateSystemSignalRef=DET_BELOW_RAIN_THOLD_044
            DET_BI_STATIC_FLAG_041_oRDR_DETECTION_041_044_oPCAN_RADAR_eee68b60_Tx: ComBitPosition=104, ComBitSize=1, ComSignalInitValue=0, ComSignalType=BOOLEAN, ComSystemTemplateSystemSignalRef=DET_BI_STATIC_FLAG_041
            DET_BI_STATIC_FLAG_042_oRDR_DETECTION_041_044_oPCAN_RADAR_8a06f09e_Tx: ComBitPosition=216, ComBitSize=1, ComSignalInitValue=0, ComSignalType=BOOLEAN, ComSystemTemplateSystemSignalRef=DET_BI_STATIC_FLAG_042
            DET_BI_STATIC_FLAG_043_oRDR_DETECTION_041_044_oPCAN_RADAR_1f76240b_Tx: ComBitPosition=328, ComBitSize=1, ComSignalInitValue=0, ComSignalType=BOOLEAN, ComSystemTemplateSystemSignalRef=DET_BI_STATIC_FLAG_043
            DET_BI_STATIC_FLAG_044_oRDR_DETECTION_041_044_oPCAN_RADAR_43c60762_Tx: ComBitPosition=440, ComBitSize=1, ComSignalInitValue=0, ComSignalType=BOOLEAN, ComSystemTemplateSystemSignalRef=DET_BI_STATIC_FLAG_044
            DET_CONFD_AZIMUTH_041_oRDR_DETECTION_041_044_oPCAN_RADAR_ba2cc12f_Tx: ComBitPosition=118, ComBitSize=2, ComSignalInitValue=0, ComSignalType=UINT8, ComSystemTemplateSystemSignalRef=DET_CONFD_AZIMUTH_041
            DET_CONFD_AZIMUTH_042_oRDR_DETECTION_041_044_oPCAN_RADAR_deccbad1_Tx: ComBitPosition=230, ComBitSize=2, ComSignalInitValue=0, ComSignalType=UINT8, ComSystemTemplateSystemSignalRef=DET_CONFD_AZIMUTH_042
            DET_CONFD_AZIMUTH_043_oRDR_DETECTION_041_044_oPCAN_RADAR_4bbc6e44_Tx: ComBitPosition=342, ComBitSize=2, ComSignalInitValue=0, ComSignalType=UINT8, ComSystemTemplateSystemSignalRef=DET_CONFD_AZIMUTH_043
            DET_CONFD_AZIMUTH_044_oRDR_DETECTION_041_044_oPCAN_RADAR_170c4d2d_Tx: ComBitPosition=454, ComBitSize=2, ComSignalInitValue=0, ComSignalType=UINT8, ComSystemTemplateSystemSignalRef=DET_CONFD_AZIMUTH_044
            DET_CONFD_ELEVATION_041_oRDR_DETECTION_041_044_oPCAN_RADAR_b8b9c0d5_Tx: ComBitPosition=101, ComBitSize=2, ComSignalInitValue=0, ComSignalType=UINT8, ComSystemTemplateSystemSignalRef=DET_CONFD_ELEVATION_041
            DET_CONFD_ELEVATION_042_oRDR_DETECTION_041_044_oPCAN_RADAR_dc59bb2b_Tx: ComBitPosition=213, ComBitSize=2, ComSignalInitValue=0, ComSignalType=UINT8, ComSystemTemplateSystemSignalRef=DET_CONFD_ELEVATION_042
            DET_CONFD_ELEVATION_043_oRDR_DETECTION_041_044_oPCAN_RADAR_49296fbe_Tx: ComBitPosition=325, ComBitSize=2, ComSignalInitValue=0, ComSignalType=UINT8, ComSystemTemplateSystemSignalRef=DET_CONFD_ELEVATION_043
            DET_CONFD_ELEVATION_044_oRDR_DETECTION_041_044_oPCAN_RADAR_15994cd7_Tx: ComBitPosition=437, ComBitSize=2, ComSignalInitValue=0, ComSignalType=UINT8, ComSystemTemplateSystemSignalRef=DET_CONFD_ELEVATION_044
            DET_ELEVATION_041_oRDR_DETECTION_041_044_oPCAN_RADAR_697914e9_Tx: ComBitPosition=72, ComBitSize=8, ComSignalInitValue=0, ComSignalType=UINT8, ComSystemTemplateSystemSignalRef=DET_ELEVATION_041
            DET_ELEVATION_042_oRDR_DETECTION_041_044_oPCAN_RADAR_0d996f17_Tx: ComBitPosition=184, ComBitSize=8, ComSignalInitValue=0, ComSignalType=UINT8, ComSystemTemplateSystemSignalRef=DET_ELEVATION_042
            DET_ELEVATION_043_oRDR_DETECTION_041_044_oPCAN_RADAR_98e9bb82_Tx: ComBitPosition=296, ComBitSize=8, ComSignalInitValue=0, ComSignalType=UINT8, ComSystemTemplateSystemSignalRef=DET_ELEVATION_043
            DET_ELEVATION_044_oRDR_DETECTION_041_044_oPCAN_RADAR_c45998eb_Tx: ComBitPosition=408, ComBitSize=8, ComSignalInitValue=0, ComSignalType=UINT8, ComSystemTemplateSystemSignalRef=DET_ELEVATION_044
            DET_ELEVATION_ERR_041_oRDR_DETECTION_041_044_oPCAN_RADAR_ee408c9c_Tx: ComBitPosition=80, ComBitSize=6, ComSignalInitValue=0, ComSignalType=UINT8, ComSystemTemplateSystemSignalRef=DET_ELEVATION_ERR_041
            DET_ELEVATION_ERR_042_oRDR_DETECTION_041_044_oPCAN_RADAR_8aa0f762_Tx: ComBitPosition=192, ComBitSize=6, ComSignalInitValue=0, ComSignalType=UINT8, ComSystemTemplateSystemSignalRef=DET_ELEVATION_ERR_042
            DET_ELEVATION_ERR_043_oRDR_DETECTION_041_044_oPCAN_RADAR_1fd023f7_Tx: ComBitPosition=304, ComBitSize=6, ComSignalInitValue=0, ComSignalType=UINT8, ComSystemTemplateSystemSignalRef=DET_ELEVATION_ERR_043
            DET_ELEVATION_ERR_044_oRDR_DETECTION_041_044_oPCAN_RADAR_4360009e_Tx: ComBitPosition=416, ComBitSize=6, ComSignalInitValue=0, ComSignalType=UINT8, ComSystemTemplateSystemSignalRef=DET_ELEVATION_ERR_044
            DET_EXISTENCE_PROB_041_oRDR_DETECTION_041_044_oPCAN_RADAR_3cdff9fc_Tx: ComBitPosition=112, ComBitSize=6, ComSignalInitValue=0, ComSignalType=UINT8, ComSystemTemplateSystemSignalRef=DET_EXISTENCE_PROB_041
            DET_EXISTENCE_PROB_042_oRDR_DETECTION_041_044_oPCAN_RADAR_583f8202_Tx: ComBitPosition=224, ComBitSize=6, ComSignalInitValue=0, ComSignalType=UINT8, ComSystemTemplateSystemSignalRef=DET_EXISTENCE_PROB_042
            DET_EXISTENCE_PROB_043_oRDR_DETECTION_041_044_oPCAN_RADAR_cd4f5697_Tx: ComBitPosition=336, ComBitSize=6, ComSignalInitValue=0, ComSignalType=UINT8, ComSystemTemplateSystemSignalRef=DET_EXISTENCE_PROB_043
            DET_EXISTENCE_PROB_044_oRDR_DETECTION_041_044_oPCAN_RADAR_91ff75fe_Tx: ComBitPosition=448, ComBitSize=6, ComSignalInitValue=0, ComSignalType=UINT8, ComSystemTemplateSystemSignalRef=DET_EXISTENCE_PROB_044
            DET_HVC_FLAG_041_oRDR_DETECTION_041_044_oPCAN_RADAR_ddabba83_Tx: ComBitPosition=86, ComBitSize=1, ComSignalInitValue=0, ComSignalType=BOOLEAN, ComSystemTemplateSystemSignalRef=DET_HVC_FLAG_041
            DET_HVC_FLAG_042_oRDR_DETECTION_041_044_oPCAN_RADAR_b94bc17d_Tx: ComBitPosition=198, ComBitSize=1, ComSignalInitValue=0, ComSignalType=BOOLEAN, ComSystemTemplateSystemSignalRef=DET_HVC_FLAG_042
            DET_HVC_FLAG_043_oRDR_DETECTION_041_044_oPCAN_RADAR_2c3b15e8_Tx: ComBitPosition=310, ComBitSize=1, ComSignalInitValue=0, ComSignalType=BOOLEAN, ComSystemTemplateSystemSignalRef=DET_HVC_FLAG_043
            DET_HVC_FLAG_044_oRDR_DETECTION_041_044_oPCAN_RADAR_708b3681_Tx: ComBitPosition=422, ComBitSize=1, ComSignalInitValue=0, ComSignalType=BOOLEAN, ComSystemTemplateSystemSignalRef=DET_HVC_FLAG_044
            DET_IDM_041_oRDR_DETECTION_041_044_oPCAN_RADAR_56f9813e_Tx: ComBitPosition=63, ComBitSize=1, ComSignalInitValue=0, ComSignalType=BOOLEAN, ComSystemTemplateSystemSignalRef=DET_IDM_041
            DET_IDM_042_oRDR_DETECTION_041_044_oPCAN_RADAR_3219fac0_Tx: ComBitPosition=175, ComBitSize=1, ComSignalInitValue=0, ComSignalType=BOOLEAN, ComSystemTemplateSystemSignalRef=DET_IDM_042
            DET_IDM_043_oRDR_DETECTION_041_044_oPCAN_RADAR_a7692e55_Tx: ComBitPosition=287, ComBitSize=1, ComSignalInitValue=0, ComSignalType=BOOLEAN, ComSystemTemplateSystemSignalRef=DET_IDM_043
            DET_IDM_044_oRDR_DETECTION_041_044_oPCAN_RADAR_fbd90d3c_Tx: ComBitPosition=399, ComBitSize=1, ComSignalInitValue=0, ComSignalType=BOOLEAN, ComSystemTemplateSystemSignalRef=DET_IDM_044
            DET_MH_CRC16_041_044_oRDR_DETECTION_041_044_oPCAN_RADAR_312b070a_Tx: ComBitPosition=0, ComBitSize=16, ComSignalInitValue=0, ComSignalType=UINT16, ComSystemTemplateSystemSignalRef=DET_MH_CRC16_041_044
            DET_MH_CYCLE_COUNTER_041_044_oRDR_DETECTION_041_044_oPCAN_RADAR_b55ea63d_Tx: ComBitPosition=16, ComBitSize=8, ComSignalInitValue=0, ComSignalType=UINT8, ComSystemTemplateSystemSignalRef=DET_MH_CYCLE_COUNTER_041_044
            DET_MH_SCAN_INDEX_4LSB_041_044_oRDR_DETECTION_041_044_oPCAN_RADAR_797483b1_Tx: ComBitPosition=476, ComBitSize=4, ComSignalInitValue=0, ComSignalType=UINT8, ComSystemTemplateSystemSignalRef=DET_MH_SCAN_INDEX_4LSB_041_044
            DET_MTD_041_oRDR_DETECTION_041_044_oPCAN_RADAR_304ab3e5_Tx: ComBitPosition=47, ComBitSize=1, ComSignalInitValue=0, ComSignalType=BOOLEAN, ComSystemTemplateSystemSignalRef=DET_MTD_041
            DET_MTD_042_oRDR_DETECTION_041_044_oPCAN_RADAR_54aac81b_Tx: ComBitPosition=159, ComBitSize=1, ComSignalInitValue=0, ComSignalType=BOOLEAN, ComSystemTemplateSystemSignalRef=DET_MTD_042
            DET_MTD_043_oRDR_DETECTION_041_044_oPCAN_RADAR_c1da1c8e_Tx: ComBitPosition=271, ComBitSize=1, ComSignalInitValue=0, ComSignalType=BOOLEAN, ComSystemTemplateSystemSignalRef=DET_MTD_043
            DET_MTD_044_oRDR_DETECTION_041_044_oPCAN_RADAR_9d6a3fe7_Tx: ComBitPosition=383, ComBitSize=1, ComSignalInitValue=0, ComSignalType=BOOLEAN, ComSystemTemplateSystemSignalRef=DET_MTD_044
            DET_PROB_1STAZHYPO_041_oRDR_DETECTION_041_044_oPCAN_RADAR_a3fe5b28_Tx: ComBitPosition=103, ComBitSize=1, ComSignalInitValue=0, ComSignalType=BOOLEAN, ComSystemTemplateSystemSignalRef=DET_PROB_1STAZHYPO_041
            DET_PROB_1STAZHYPO_042_oRDR_DETECTION_041_044_oPCAN_RADAR_c71e20d6_Tx: ComBitPosition=215, ComBitSize=1, ComSignalInitValue=0, ComSignalType=BOOLEAN, ComSystemTemplateSystemSignalRef=DET_PROB_1STAZHYPO_042
            DET_PROB_1STAZHYPO_043_oRDR_DETECTION_041_044_oPCAN_RADAR_526ef443_Tx: ComBitPosition=327, ComBitSize=1, ComSignalInitValue=0, ComSignalType=BOOLEAN, ComSystemTemplateSystemSignalRef=DET_PROB_1STAZHYPO_043
            DET_PROB_1STAZHYPO_044_oRDR_DETECTION_041_044_oPCAN_RADAR_0eded72a_Tx: ComBitPosition=439, ComBitSize=1, ComSignalInitValue=0, ComSignalType=BOOLEAN, ComSystemTemplateSystemSignalRef=DET_PROB_1STAZHYPO_044
            DET_RANGE_041_oRDR_DETECTION_041_044_oPCAN_RADAR_a851b85e_Tx: ComBitPosition=24, ComBitSize=15, ComSignalInitValue=0, ComSignalType=UINT16, ComSystemTemplateSystemSignalRef=DET_RANGE_041
            DET_RANGE_042_oRDR_DETECTION_041_044_oPCAN_RADAR_ccb1c3a0_Tx: ComBitPosition=136, ComBitSize=15, ComSignalInitValue=0, ComSignalType=UINT16, ComSystemTemplateSystemSignalRef=DET_RANGE_042
            DET_RANGE_043_oRDR_DETECTION_041_044_oPCAN_RADAR_59c11735_Tx: ComBitPosition=248, ComBitSize=15, ComSignalInitValue=0, ComSignalType=UINT16, ComSystemTemplateSystemSignalRef=DET_RANGE_043
            DET_RANGE_044_oRDR_DETECTION_041_044_oPCAN_RADAR_0571345c_Tx: ComBitPosition=360, ComBitSize=15, ComSignalInitValue=0, ComSignalType=UINT16, ComSystemTemplateSystemSignalRef=DET_RANGE_044
            DET_RANGE_ERR_041_oRDR_DETECTION_041_044_oPCAN_RADAR_0fb90237_Tx: ComBitPosition=40, ComBitSize=7, ComSignalInitValue=0, ComSignalType=UINT8, ComSystemTemplateSystemSignalRef=DET_RANGE_ERR_041
            DET_RANGE_ERR_042_oRDR_DETECTION_041_044_oPCAN_RADAR_6b5979c9_Tx: ComBitPosition=152, ComBitSize=7, ComSignalInitValue=0, ComSignalType=UINT8, ComSystemTemplateSystemSignalRef=DET_RANGE_ERR_042
            DET_RANGE_ERR_043_oRDR_DETECTION_041_044_oPCAN_RADAR_fe29ad5c_Tx: ComBitPosition=264, ComBitSize=7, ComSignalInitValue=0, ComSignalType=UINT8, ComSystemTemplateSystemSignalRef=DET_RANGE_ERR_043
            DET_RANGE_ERR_044_oRDR_DETECTION_041_044_oPCAN_RADAR_a2998e35_Tx: ComBitPosition=376, ComBitSize=7, ComSignalInitValue=0, ComSignalType=UINT8, ComSystemTemplateSystemSignalRef=DET_RANGE_ERR_044
            DET_RANGE_VELOCITY_041_oRDR_DETECTION_041_044_oPCAN_RADAR_ddf77a7b_Tx: ComBitPosition=48, ComBitSize=15, ComSignalInitValue=16384, ComSignalType=UINT16, ComSystemTemplateSystemSignalRef=DET_RANGE_VELOCITY_041
            DET_RANGE_VELOCITY_042_oRDR_DETECTION_041_044_oPCAN_RADAR_b9170185_Tx: ComBitPosition=160, ComBitSize=15, ComSignalInitValue=16384, ComSignalType=UINT16, ComSystemTemplateSystemSignalRef=DET_RANGE_VELOCITY_042
            DET_RANGE_VELOCITY_043_oRDR_DETECTION_041_044_oPCAN_RADAR_2c67d510_Tx: ComBitPosition=272, ComBitSize=15, ComSignalInitValue=16384, ComSignalType=UINT16, ComSystemTemplateSystemSignalRef=DET_RANGE_VELOCITY_043
            DET_RANGE_VELOCITY_044_oRDR_DETECTION_041_044_oPCAN_RADAR_70d7f679_Tx: ComBitPosition=384, ComBitSize=15, ComSignalInitValue=16384, ComSignalType=UINT16, ComSystemTemplateSystemSignalRef=DET_RANGE_VELOCITY_044
            DET_RANGE_VELOCITY_ERR_041_oRDR_DETECTION_041_044_oPCAN_RADAR_d24c81c9_Tx: ComBitPosition=64, ComBitSize=8, ComSignalInitValue=0, ComSignalType=UINT8, ComSystemTemplateSystemSignalRef=DET_RANGE_VELOCITY_ERR_041
            DET_RANGE_VELOCITY_ERR_042_oRDR_DETECTION_041_044_oPCAN_RADAR_b6acfa37_Tx: ComBitPosition=176, ComBitSize=8, ComSignalInitValue=0, ComSignalType=UINT8, ComSystemTemplateSystemSignalRef=DET_RANGE_VELOCITY_ERR_042
            DET_RANGE_VELOCITY_ERR_043_oRDR_DETECTION_041_044_oPCAN_RADAR_23dc2ea2_Tx: ComBitPosition=288, ComBitSize=8, ComSignalInitValue=0, ComSignalType=UINT8, ComSystemTemplateSystemSignalRef=DET_RANGE_VELOCITY_ERR_043
            DET_RANGE_VELOCITY_ERR_044_oRDR_DETECTION_041_044_oPCAN_RADAR_7f6c0dcb_Tx: ComBitPosition=400, ComBitSize=8, ComSignalInitValue=0, ComSignalType=UINT8, ComSystemTemplateSystemSignalRef=DET_RANGE_VELOCITY_ERR_044
            DET_RCS_041_oRDR_DETECTION_041_044_oPCAN_RADAR_5a774d21_Tx: ComBitPosition=128, ComBitSize=8, ComSignalInitValue=128, ComSignalType=UINT8, ComSystemTemplateSystemSignalRef=DET_RCS_041
            DET_RCS_042_oRDR_DETECTION_041_044_oPCAN_RADAR_3e9736df_Tx: ComBitPosition=240, ComBitSize=8, ComSignalInitValue=128, ComSignalType=UINT8, ComSystemTemplateSystemSignalRef=DET_RCS_042
            DET_RCS_043_oRDR_DETECTION_041_044_oPCAN_RADAR_abe7e24a_Tx: ComBitPosition=352, ComBitSize=8, ComSignalInitValue=128, ComSignalType=UINT8, ComSystemTemplateSystemSignalRef=DET_RCS_043
            DET_RCS_044_oRDR_DETECTION_041_044_oPCAN_RADAR_f757c123_Tx: ComBitPosition=464, ComBitSize=8, ComSignalInitValue=128, ComSignalType=UINT8, ComSystemTemplateSystemSignalRef=DET_RCS_044
            DET_SNR_041_oRDR_DETECTION_041_044_oPCAN_RADAR_87d91923_Tx: ComBitPosition=120, ComBitSize=8, ComSignalInitValue=0, ComSignalType=UINT8, ComSystemTemplateSystemSignalRef=DET_SNR_041
            DET_SNR_042_oRDR_DETECTION_041_044_oPCAN_RADAR_e33962dd_Tx: ComBitPosition=232, ComBitSize=8, ComSignalInitValue=0, ComSignalType=UINT8, ComSystemTemplateSystemSignalRef=DET_SNR_042
            DET_SNR_043_oRDR_DETECTION_041_044_oPCAN_RADAR_7649b648_Tx: ComBitPosition=344, ComBitSize=8, ComSignalInitValue=0, ComSignalType=UINT8, ComSystemTemplateSystemSignalRef=DET_SNR_043
            DET_SNR_044_oRDR_DETECTION_041_044_oPCAN_RADAR_2af99521_Tx: ComBitPosition=456, ComBitSize=8, ComSignalInitValue=0, ComSignalType=UINT8, ComSystemTemplateSystemSignalRef=DET_SNR_044
            DET_SUPER_RES_TARGET_041_oRDR_DETECTION_041_044_oPCAN_RADAR_b6403146_Tx: ComBitPosition=87, ComBitSize=1, ComSignalInitValue=0, ComSignalType=BOOLEAN, ComSystemTemplateSystemSignalRef=DET_SUPER_RES_TARGET_041
            DET_SUPER_RES_TARGET_042_oRDR_DETECTION_041_044_oPCAN_RADAR_d2a04ab8_Tx: ComBitPosition=199, ComBitSize=1, ComSignalInitValue=0, ComSignalType=BOOLEAN, ComSystemTemplateSystemSignalRef=DET_SUPER_RES_TARGET_042
            DET_SUPER_RES_TARGET_043_oRDR_DETECTION_041_044_oPCAN_RADAR_47d09e2d_Tx: ComBitPosition=311, ComBitSize=1, ComSignalInitValue=0, ComSignalType=BOOLEAN, ComSystemTemplateSystemSignalRef=DET_SUPER_RES_TARGET_043
            DET_SUPER_RES_TARGET_044_oRDR_DETECTION_041_044_oPCAN_RADAR_1b60bd44_Tx: ComBitPosition=423, ComBitSize=1, ComSignalInitValue=0, ComSignalType=BOOLEAN, ComSystemTemplateSystemSignalRef=DET_SUPER_RES_TARGET_044
        SG_Detections_045_048_oRDR_DETECTION_045_048_oPCAN_RADAR_c460e153_Tx: ComSystemTemplateSignalGroupRef=SG_Detections_045_048
          83 x ComGroupSignal, all with ComSignalEndianness=LITTLE_ENDIAN, ComTransferProperty=PENDING:
            DET_AZIMUTH_045_oRDR_DETECTION_045_048_oPCAN_RADAR_69280d46_Tx: ComBitPosition=88, ComBitSize=13, ComSignalInitValue=0, ComSignalType=UINT16, ComSystemTemplateSystemSignalRef=DET_AZIMUTH_045
            DET_AZIMUTH_046_oRDR_DETECTION_045_048_oPCAN_RADAR_0dc876b8_Tx: ComBitPosition=200, ComBitSize=13, ComSignalInitValue=0, ComSignalType=UINT16, ComSystemTemplateSystemSignalRef=DET_AZIMUTH_046
            DET_AZIMUTH_047_oRDR_DETECTION_045_048_oPCAN_RADAR_98b8a22d_Tx: ComBitPosition=312, ComBitSize=13, ComSignalInitValue=0, ComSignalType=UINT16, ComSystemTemplateSystemSignalRef=DET_AZIMUTH_047
            DET_AZIMUTH_048_oRDR_DETECTION_045_048_oPCAN_RADAR_b4a8306a_Tx: ComBitPosition=424, ComBitSize=13, ComSignalInitValue=0, ComSignalType=UINT16, ComSystemTemplateSystemSignalRef=DET_AZIMUTH_048
            DET_AZIMUTH_ERR_045_oRDR_DETECTION_045_048_oPCAN_RADAR_cd9d98b3_Tx: ComBitPosition=105, ComBitSize=7, ComSignalInitValue=0, ComSignalType=UINT8, ComSystemTemplateSystemSignalRef=DET_AZIMUTH_ERR_045
            DET_AZIMUTH_ERR_046_oRDR_DETECTION_045_048_oPCAN_RADAR_a97de34d_Tx: ComBitPosition=217, ComBitSize=7, ComSignalInitValue=0, ComSignalType=UINT8, ComSystemTemplateSystemSignalRef=DET_AZIMUTH_ERR_046
            DET_AZIMUTH_ERR_047_oRDR_DETECTION_045_048_oPCAN_RADAR_3c0d37d8_Tx: ComBitPosition=329, ComBitSize=7, ComSignalInitValue=0, ComSignalType=UINT8, ComSystemTemplateSystemSignalRef=DET_AZIMUTH_ERR_047
            DET_AZIMUTH_ERR_048_oRDR_DETECTION_045_048_oPCAN_RADAR_101da59f_Tx: ComBitPosition=441, ComBitSize=7, ComSignalInitValue=0, ComSignalType=UINT8, ComSystemTemplateSystemSignalRef=DET_AZIMUTH_ERR_048
            DET_BELOW_RAIN_THOLD_045_oRDR_DETECTION_045_048_oPCAN_RADAR_bc299e86_Tx: ComBitPosition=39, ComBitSize=1, ComSignalInitValue=0, ComSignalType=BOOLEAN, ComSystemTemplateSystemSignalRef=DET_BELOW_RAIN_THOLD_045
            DET_BELOW_RAIN_THOLD_046_oRDR_DETECTION_045_048_oPCAN_RADAR_d8c9e578_Tx: ComBitPosition=151, ComBitSize=1, ComSignalInitValue=0, ComSignalType=BOOLEAN, ComSystemTemplateSystemSignalRef=DET_BELOW_RAIN_THOLD_046
            DET_BELOW_RAIN_THOLD_047_oRDR_DETECTION_045_048_oPCAN_RADAR_4db931ed_Tx: ComBitPosition=263, ComBitSize=1, ComSignalInitValue=0, ComSignalType=BOOLEAN, ComSystemTemplateSystemSignalRef=DET_BELOW_RAIN_THOLD_047
            DET_BELOW_RAIN_THOLD_048_oRDR_DETECTION_045_048_oPCAN_RADAR_61a9a3aa_Tx: ComBitPosition=375, ComBitSize=1, ComSignalInitValue=0, ComSignalType=BOOLEAN, ComSystemTemplateSystemSignalRef=DET_BELOW_RAIN_THOLD_048
            DET_BI_STATIC_FLAG_045_oRDR_DETECTION_045_048_oPCAN_RADAR_3f044dc3_Tx: ComBitPosition=104, ComBitSize=1, ComSignalInitValue=0, ComSignalType=BOOLEAN, ComSystemTemplateSystemSignalRef=DET_BI_STATIC_FLAG_045
            DET_BI_STATIC_FLAG_046_oRDR_DETECTION_045_048_oPCAN_RADAR_5be4363d_Tx: ComBitPosition=216, ComBitSize=1, ComSignalInitValue=0, ComSignalType=BOOLEAN, ComSystemTemplateSystemSignalRef=DET_BI_STATIC_FLAG_046
            DET_BI_STATIC_FLAG_047_oRDR_DETECTION_045_048_oPCAN_RADAR_ce94e2a8_Tx: ComBitPosition=328, ComBitSize=1, ComSignalInitValue=0, ComSignalType=BOOLEAN, ComSystemTemplateSystemSignalRef=DET_BI_STATIC_FLAG_047
            DET_BI_STATIC_FLAG_048_oRDR_DETECTION_045_048_oPCAN_RADAR_e28470ef_Tx: ComBitPosition=440, ComBitSize=1, ComSignalInitValue=0, ComSignalType=BOOLEAN, ComSystemTemplateSystemSignalRef=DET_BI_STATIC_FLAG_048
            DET_CONFD_AZIMUTH_045_oRDR_DETECTION_045_048_oPCAN_RADAR_6bce078c_Tx: ComBitPosition=118, ComBitSize=2, ComSignalInitValue=0, ComSignalType=UINT8, ComSystemTemplateSystemSignalRef=DET_CONFD_AZIMUTH_045
            DET_CONFD_AZIMUTH_046_oRDR_DETECTION_045_048_oPCAN_RADAR_0f2e7c72_Tx: ComBitPosition=230, ComBitSize=2, ComSignalInitValue=0, ComSignalType=UINT8, ComSystemTemplateSystemSignalRef=DET_CONFD_AZIMUTH_046
            DET_CONFD_AZIMUTH_047_oRDR_DETECTION_045_048_oPCAN_RADAR_9a5ea8e7_Tx: ComBitPosition=342, ComBitSize=2, ComSignalInitValue=0, ComSignalType=UINT8, ComSystemTemplateSystemSignalRef=DET_CONFD_AZIMUTH_047
            DET_CONFD_AZIMUTH_048_oRDR_DETECTION_045_048_oPCAN_RADAR_b64e3aa0_Tx: ComBitPosition=454, ComBitSize=2, ComSignalInitValue=0, ComSignalType=UINT8, ComSystemTemplateSystemSignalRef=DET_CONFD_AZIMUTH_048
            DET_CONFD_ELEVATION_045_oRDR_DETECTION_045_048_oPCAN_RADAR_695b0676_Tx: ComBitPosition=101, ComBitSize=2, ComSignalInitValue=0, ComSignalType=UINT8, ComSystemTemplateSystemSignalRef=DET_CONFD_ELEVATION_045
            DET_CONFD_ELEVATION_046_oRDR_DETECTION_045_048_oPCAN_RADAR_0dbb7d88_Tx: ComBitPosition=213, ComBitSize=2, ComSignalInitValue=0, ComSignalType=UINT8, ComSystemTemplateSystemSignalRef=DET_CONFD_ELEVATION_046
            DET_CONFD_ELEVATION_047_oRDR_DETECTION_045_048_oPCAN_RADAR_98cba91d_Tx: ComBitPosition=325, ComBitSize=2, ComSignalInitValue=0, ComSignalType=UINT8, ComSystemTemplateSystemSignalRef=DET_CONFD_ELEVATION_047
            DET_CONFD_ELEVATION_048_oRDR_DETECTION_045_048_oPCAN_RADAR_b4db3b5a_Tx: ComBitPosition=437, ComBitSize=2, ComSignalInitValue=0, ComSignalType=UINT8, ComSystemTemplateSystemSignalRef=DET_CONFD_ELEVATION_048
            DET_ELEVATION_045_oRDR_DETECTION_045_048_oPCAN_RADAR_b89bd24a_Tx: ComBitPosition=72, ComBitSize=8, ComSignalInitValue=0, ComSignalType=UINT8, ComSystemTemplateSystemSignalRef=DET_ELEVATION_045
            DET_ELEVATION_046_oRDR_DETECTION_045_048_oPCAN_RADAR_dc7ba9b4_Tx: ComBitPosition=184, ComBitSize=8, ComSignalInitValue=0, ComSignalType=UINT8, ComSystemTemplateSystemSignalRef=DET_ELEVATION_046
            DET_ELEVATION_047_oRDR_DETECTION_045_048_oPCAN_RADAR_490b7d21_Tx: ComBitPosition=296, ComBitSize=8, ComSignalInitValue=0, ComSignalType=UINT8, ComSystemTemplateSystemSignalRef=DET_ELEVATION_047
            DET_ELEVATION_048_oRDR_DETECTION_045_048_oPCAN_RADAR_651bef66_Tx: ComBitPosition=408, ComBitSize=8, ComSignalInitValue=0, ComSignalType=UINT8, ComSystemTemplateSystemSignalRef=DET_ELEVATION_048
            DET_ELEVATION_ERR_045_oRDR_DETECTION_045_048_oPCAN_RADAR_3fa24a3f_Tx: ComBitPosition=80, ComBitSize=6, ComSignalInitValue=0, ComSignalType=UINT8, ComSystemTemplateSystemSignalRef=DET_ELEVATION_ERR_045
            DET_ELEVATION_ERR_046_oRDR_DETECTION_045_048_oPCAN_RADAR_5b4231c1_Tx: ComBitPosition=192, ComBitSize=6, ComSignalInitValue=0, ComSignalType=UINT8, ComSystemTemplateSystemSignalRef=DET_ELEVATION_ERR_046
            DET_ELEVATION_ERR_047_oRDR_DETECTION_045_048_oPCAN_RADAR_ce32e554_Tx: ComBitPosition=304, ComBitSize=6, ComSignalInitValue=0, ComSignalType=UINT8, ComSystemTemplateSystemSignalRef=DET_ELEVATION_ERR_047
            DET_ELEVATION_ERR_048_oRDR_DETECTION_045_048_oPCAN_RADAR_e2227713_Tx: ComBitPosition=416, ComBitSize=6, ComSignalInitValue=0, ComSignalType=UINT8, ComSystemTemplateSystemSignalRef=DET_ELEVATION_ERR_048
            DET_EXISTENCE_PROB_045_oRDR_DETECTION_045_048_oPCAN_RADAR_ed3d3f5f_Tx: ComBitPosition=112, ComBitSize=6, ComSignalInitValue=0, ComSignalType=UINT8, ComSystemTemplateSystemSignalRef=DET_EXISTENCE_PROB_045
            DET_EXISTENCE_PROB_046_oRDR_DETECTION_045_048_oPCAN_RADAR_89dd44a1_Tx: ComBitPosition=224, ComBitSize=6, ComSignalInitValue=0, ComSignalType=UINT8, ComSystemTemplateSystemSignalRef=DET_EXISTENCE_PROB_046
            DET_EXISTENCE_PROB_047_oRDR_DETECTION_045_048_oPCAN_RADAR_1cad9034_Tx: ComBitPosition=336, ComBitSize=6, ComSignalInitValue=0, ComSignalType=UINT8, ComSystemTemplateSystemSignalRef=DET_EXISTENCE_PROB_047
            DET_EXISTENCE_PROB_048_oRDR_DETECTION_045_048_oPCAN_RADAR_30bd0273_Tx: ComBitPosition=448, ComBitSize=6, ComSignalInitValue=0, ComSignalType=UINT8, ComSystemTemplateSystemSignalRef=DET_EXISTENCE_PROB_048
            DET_HVC_FLAG_045_oRDR_DETECTION_045_048_oPCAN_RADAR_0c497c20_Tx: ComBitPosition=86, ComBitSize=1, ComSignalInitValue=0, ComSignalType=BOOLEAN, ComSystemTemplateSystemSignalRef=DET_HVC_FLAG_045
            DET_HVC_FLAG_046_oRDR_DETECTION_045_048_oPCAN_RADAR_68a907de_Tx: ComBitPosition=198, ComBitSize=1, ComSignalInitValue=0, ComSignalType=BOOLEAN, ComSystemTemplateSystemSignalRef=DET_HVC_FLAG_046
            DET_HVC_FLAG_047_oRDR_DETECTION_045_048_oPCAN_RADAR_fdd9d34b_Tx: ComBitPosition=310, ComBitSize=1, ComSignalInitValue=0, ComSignalType=BOOLEAN, ComSystemTemplateSystemSignalRef=DET_HVC_FLAG_047
            DET_HVC_FLAG_048_oRDR_DETECTION_045_048_oPCAN_RADAR_d1c9410c_Tx: ComBitPosition=422, ComBitSize=1, ComSignalInitValue=0, ComSignalType=BOOLEAN, ComSystemTemplateSystemSignalRef=DET_HVC_FLAG_048
            DET_IDM_045_oRDR_DETECTION_045_048_oPCAN_RADAR_871b479d_Tx: ComBitPosition=63, ComBitSize=1, ComSignalInitValue=0, ComSignalType=BOOLEAN, ComSystemTemplateSystemSignalRef=DET_IDM_045
            DET_IDM_046_oRDR_DETECTION_045_048_oPCAN_RADAR_e3fb3c63_Tx: ComBitPosition=175, ComBitSize=1, ComSignalInitValue=0, ComSignalType=BOOLEAN, ComSystemTemplateSystemSignalRef=DET_IDM_046
            DET_IDM_047_oRDR_DETECTION_045_048_oPCAN_RADAR_768be8f6_Tx: ComBitPosition=287, ComBitSize=1, ComSignalInitValue=0, ComSignalType=BOOLEAN, ComSystemTemplateSystemSignalRef=DET_IDM_047
            DET_IDM_048_oRDR_DETECTION_045_048_oPCAN_RADAR_5a9b7ab1_Tx: ComBitPosition=399, ComBitSize=1, ComSignalInitValue=0, ComSignalType=BOOLEAN, ComSystemTemplateSystemSignalRef=DET_IDM_048
            DET_MH_CRC16_045_048_oRDR_DETECTION_045_048_oPCAN_RADAR_40e83358_Tx: ComBitPosition=0, ComBitSize=16, ComSignalInitValue=0, ComSignalType=UINT16, ComSystemTemplateSystemSignalRef=DET_MH_CRC16_045_048
            DET_MH_CYCLE_COUNTER_045_048_oRDR_DETECTION_045_048_oPCAN_RADAR_c49d926f_Tx: ComBitPosition=16, ComBitSize=8, ComSignalInitValue=0, ComSignalType=UINT8, ComSystemTemplateSystemSignalRef=DET_MH_CYCLE_COUNTER_045_048
            DET_MH_SCAN_INDEX_4LSB_045_048_oRDR_DETECTION_045_048_oPCAN_RADAR_08b7b7e3_Tx: ComBitPosition=476, ComBitSize=4, ComSignalInitValue=0, ComSignalType=UINT8, ComSystemTemplateSystemSignalRef=DET_MH_SCAN_INDEX_4LSB_045_048
            DET_MTD_045_oRDR_DETECTION_045_048_oPCAN_RADAR_e1a87546_Tx: ComBitPosition=47, ComBitSize=1, ComSignalInitValue=0, ComSignalType=BOOLEAN, ComSystemTemplateSystemSignalRef=DET_MTD_045
            DET_MTD_046_oRDR_DETECTION_045_048_oPCAN_RADAR_85480eb8_Tx: ComBitPosition=159, ComBitSize=1, ComSignalInitValue=0, ComSignalType=BOOLEAN, ComSystemTemplateSystemSignalRef=DET_MTD_046
            DET_MTD_047_oRDR_DETECTION_045_048_oPCAN_RADAR_1038da2d_Tx: ComBitPosition=271, ComBitSize=1, ComSignalInitValue=0, ComSignalType=BOOLEAN, ComSystemTemplateSystemSignalRef=DET_MTD_047
            DET_MTD_048_oRDR_DETECTION_045_048_oPCAN_RADAR_3c28486a_Tx: ComBitPosition=383, ComBitSize=1, ComSignalInitValue=0, ComSignalType=BOOLEAN, ComSystemTemplateSystemSignalRef=DET_MTD_048
            DET_PROB_1STAZHYPO_045_oRDR_DETECTION_045_048_oPCAN_RADAR_721c9d8b_Tx: ComBitPosition=103, ComBitSize=1, ComSignalInitValue=0, ComSignalType=BOOLEAN, ComSystemTemplateSystemSignalRef=DET_PROB_1STAZHYPO_045
            DET_PROB_1STAZHYPO_046_oRDR_DETECTION_045_048_oPCAN_RADAR_16fce675_Tx: ComBitPosition=215, ComBitSize=1, ComSignalInitValue=0, ComSignalType=BOOLEAN, ComSystemTemplateSystemSignalRef=DET_PROB_1STAZHYPO_046
            DET_PROB_1STAZHYPO_047_oRDR_DETECTION_045_048_oPCAN_RADAR_838c32e0_Tx: ComBitPosition=327, ComBitSize=1, ComSignalInitValue=0, ComSignalType=BOOLEAN, ComSystemTemplateSystemSignalRef=DET_PROB_1STAZHYPO_047
            DET_PROB_1STAZHYPO_048_oRDR_DETECTION_045_048_oPCAN_RADAR_af9ca0a7_Tx: ComBitPosition=439, ComBitSize=1, ComSignalInitValue=0, ComSignalType=BOOLEAN, ComSystemTemplateSystemSignalRef=DET_PROB_1STAZHYPO_048
            DET_RANGE_045_oRDR_DETECTION_045_048_oPCAN_RADAR_79b37efd_Tx: ComBitPosition=24, ComBitSize=15, ComSignalInitValue=0, ComSignalType=UINT16, ComSystemTemplateSystemSignalRef=DET_RANGE_045
            DET_RANGE_046_oRDR_DETECTION_045_048_oPCAN_RADAR_1d530503_Tx: ComBitPosition=136, ComBitSize=15, ComSignalInitValue=0, ComSignalType=UINT16, ComSystemTemplateSystemSignalRef=DET_RANGE_046
            DET_RANGE_047_oRDR_DETECTION_045_048_oPCAN_RADAR_8823d196_Tx: ComBitPosition=248, ComBitSize=15, ComSignalInitValue=0, ComSignalType=UINT16, ComSystemTemplateSystemSignalRef=DET_RANGE_047
            DET_RANGE_048_oRDR_DETECTION_045_048_oPCAN_RADAR_a43343d1_Tx: ComBitPosition=360, ComBitSize=15, ComSignalInitValue=0, ComSignalType=UINT16, ComSystemTemplateSystemSignalRef=DET_RANGE_048
            DET_RANGE_ERR_045_oRDR_DETECTION_045_048_oPCAN_RADAR_de5bc494_Tx: ComBitPosition=40, ComBitSize=7, ComSignalInitValue=0, ComSignalType=UINT8, ComSystemTemplateSystemSignalRef=DET_RANGE_ERR_045
            DET_RANGE_ERR_046_oRDR_DETECTION_045_048_oPCAN_RADAR_babbbf6a_Tx: ComBitPosition=152, ComBitSize=7, ComSignalInitValue=0, ComSignalType=UINT8, ComSystemTemplateSystemSignalRef=DET_RANGE_ERR_046
            DET_RANGE_ERR_047_oRDR_DETECTION_045_048_oPCAN_RADAR_2fcb6bff_Tx: ComBitPosition=264, ComBitSize=7, ComSignalInitValue=0, ComSignalType=UINT8, ComSystemTemplateSystemSignalRef=DET_RANGE_ERR_047
            DET_RANGE_ERR_048_oRDR_DETECTION_045_048_oPCAN_RADAR_03dbf9b8_Tx: ComBitPosition=376, ComBitSize=7, ComSignalInitValue=0, ComSignalType=UINT8, ComSystemTemplateSystemSignalRef=DET_RANGE_ERR_048
            DET_RANGE_VELOCITY_045_oRDR_DETECTION_045_048_oPCAN_RADAR_0c15bcd8_Tx: ComBitPosition=48, ComBitSize=15, ComSignalInitValue=16384, ComSignalType=UINT16, ComSystemTemplateSystemSignalRef=DET_RANGE_VELOCITY_045
            DET_RANGE_VELOCITY_046_oRDR_DETECTION_045_048_oPCAN_RADAR_68f5c726_Tx: ComBitPosition=160, ComBitSize=15, ComSignalInitValue=16384, ComSignalType=UINT16, ComSystemTemplateSystemSignalRef=DET_RANGE_VELOCITY_046
            DET_RANGE_VELOCITY_047_oRDR_DETECTION_045_048_oPCAN_RADAR_fd8513b3_Tx: ComBitPosition=272, ComBitSize=15, ComSignalInitValue=16384, ComSignalType=UINT16, ComSystemTemplateSystemSignalRef=DET_RANGE_VELOCITY_047
            DET_RANGE_VELOCITY_048_oRDR_DETECTION_045_048_oPCAN_RADAR_d19581f4_Tx: ComBitPosition=384, ComBitSize=15, ComSignalInitValue=16384, ComSignalType=UINT16, ComSystemTemplateSystemSignalRef=DET_RANGE_VELOCITY_048
            DET_RANGE_VELOCITY_ERR_045_oRDR_DETECTION_045_048_oPCAN_RADAR_03ae476a_Tx: ComBitPosition=64, ComBitSize=8, ComSignalInitValue=0, ComSignalType=UINT8, ComSystemTemplateSystemSignalRef=DET_RANGE_VELOCITY_ERR_045
            DET_RANGE_VELOCITY_ERR_046_oRDR_DETECTION_045_048_oPCAN_RADAR_674e3c94_Tx: ComBitPosition=176, ComBitSize=8, ComSignalInitValue=0, ComSignalType=UINT8, ComSystemTemplateSystemSignalRef=DET_RANGE_VELOCITY_ERR_046
            DET_RANGE_VELOCITY_ERR_047_oRDR_DETECTION_045_048_oPCAN_RADAR_f23ee801_Tx: ComBitPosition=288, ComBitSize=8, ComSignalInitValue=0, ComSignalType=UINT8, ComSystemTemplateSystemSignalRef=DET_RANGE_VELOCITY_ERR_047
            DET_RANGE_VELOCITY_ERR_048_oRDR_DETECTION_045_048_oPCAN_RADAR_de2e7a46_Tx: ComBitPosition=400, ComBitSize=8, ComSignalInitValue=0, ComSignalType=UINT8, ComSystemTemplateSystemSignalRef=DET_RANGE_VELOCITY_ERR_048
            DET_RCS_045_oRDR_DETECTION_045_048_oPCAN_RADAR_8b958b82_Tx: ComBitPosition=128, ComBitSize=8, ComSignalInitValue=128, ComSignalType=UINT8, ComSystemTemplateSystemSignalRef=DET_RCS_045
            DET_RCS_046_oRDR_DETECTION_045_048_oPCAN_RADAR_ef75f07c_Tx: ComBitPosition=240, ComBitSize=8, ComSignalInitValue=128, ComSignalType=UINT8, ComSystemTemplateSystemSignalRef=DET_RCS_046
            DET_RCS_047_oRDR_DETECTION_045_048_oPCAN_RADAR_7a0524e9_Tx: ComBitPosition=352, ComBitSize=8, ComSignalInitValue=128, ComSignalType=UINT8, ComSystemTemplateSystemSignalRef=DET_RCS_047
            DET_RCS_048_oRDR_DETECTION_045_048_oPCAN_RADAR_5615b6ae_Tx: ComBitPosition=464, ComBitSize=8, ComSignalInitValue=128, ComSignalType=UINT8, ComSystemTemplateSystemSignalRef=DET_RCS_048
            DET_SNR_045_oRDR_DETECTION_045_048_oPCAN_RADAR_563bdf80_Tx: ComBitPosition=120, ComBitSize=8, ComSignalInitValue=0, ComSignalType=UINT8, ComSystemTemplateSystemSignalRef=DET_SNR_045
            DET_SNR_046_oRDR_DETECTION_045_048_oPCAN_RADAR_32dba47e_Tx: ComBitPosition=232, ComBitSize=8, ComSignalInitValue=0, ComSignalType=UINT8, ComSystemTemplateSystemSignalRef=DET_SNR_046
            DET_SNR_047_oRDR_DETECTION_045_048_oPCAN_RADAR_a7ab70eb_Tx: ComBitPosition=344, ComBitSize=8, ComSignalInitValue=0, ComSignalType=UINT8, ComSystemTemplateSystemSignalRef=DET_SNR_047
            DET_SNR_048_oRDR_DETECTION_045_048_oPCAN_RADAR_8bbbe2ac_Tx: ComBitPosition=456, ComBitSize=8, ComSignalInitValue=0, ComSignalType=UINT8, ComSystemTemplateSystemSignalRef=DET_SNR_048
            DET_SUPER_RES_TARGET_045_oRDR_DETECTION_045_048_oPCAN_RADAR_67a2f7e5_Tx: ComBitPosition=87, ComBitSize=1, ComSignalInitValue=0, ComSignalType=BOOLEAN, ComSystemTemplateSystemSignalRef=DET_SUPER_RES_TARGET_045
            DET_SUPER_RES_TARGET_046_oRDR_DETECTION_045_048_oPCAN_RADAR_03428c1b_Tx: ComBitPosition=199, ComBitSize=1, ComSignalInitValue=0, ComSignalType=BOOLEAN, ComSystemTemplateSystemSignalRef=DET_SUPER_RES_TARGET_046
            DET_SUPER_RES_TARGET_047_oRDR_DETECTION_045_048_oPCAN_RADAR_9632588e_Tx: ComBitPosition=311, ComBitSize=1, ComSignalInitValue=0, ComSignalType=BOOLEAN, ComSystemTemplateSystemSignalRef=DET_SUPER_RES_TARGET_047
            DET_SUPER_RES_TARGET_048_oRDR_DETECTION_045_048_oPCAN_RADAR_ba22cac9_Tx: ComBitPosition=423, ComBitSize=1, ComSignalInitValue=0, ComSignalType=BOOLEAN, ComSystemTemplateSystemSignalRef=DET_SUPER_RES_TARGET_048
        SG_Detections_049_052_oRDR_DETECTION_049_052_oPCAN_RADAR_5d1ac528_Tx: ComSystemTemplateSignalGroupRef=SG_Detections_049_052
          83 x ComGroupSignal, all with ComSignalEndianness=LITTLE_ENDIAN, ComTransferProperty=PENDING:
            DET_AZIMUTH_049_oRDR_DETECTION_049_052_oPCAN_RADAR_13900bfe_Tx: ComBitPosition=88, ComBitSize=13, ComSignalInitValue=0, ComSignalType=UINT16, ComSystemTemplateSystemSignalRef=DET_AZIMUTH_049
            DET_AZIMUTH_050_oRDR_DETECTION_049_052_oPCAN_RADAR_76b0795a_Tx: ComBitPosition=200, ComBitSize=13, ComSignalInitValue=0, ComSignalType=UINT16, ComSystemTemplateSystemSignalRef=DET_AZIMUTH_050
            DET_AZIMUTH_051_oRDR_DETECTION_049_052_oPCAN_RADAR_e3c0adcf_Tx: ComBitPosition=312, ComBitSize=13, ComSignalInitValue=0, ComSignalType=UINT16, ComSystemTemplateSystemSignalRef=DET_AZIMUTH_051
            DET_AZIMUTH_052_oRDR_DETECTION_049_052_oPCAN_RADAR_8720d631_Tx: ComBitPosition=424, ComBitSize=13, ComSignalInitValue=0, ComSignalType=UINT16, ComSystemTemplateSystemSignalRef=DET_AZIMUTH_052
            DET_AZIMUTH_ERR_049_oRDR_DETECTION_049_052_oPCAN_RADAR_b7259e0b_Tx: ComBitPosition=105, ComBitSize=7, ComSignalInitValue=0, ComSignalType=UINT8, ComSystemTemplateSystemSignalRef=DET_AZIMUTH_ERR_049
            DET_AZIMUTH_ERR_050_oRDR_DETECTION_049_052_oPCAN_RADAR_d205ecaf_Tx: ComBitPosition=217, ComBitSize=7, ComSignalInitValue=0, ComSignalType=UINT8, ComSystemTemplateSystemSignalRef=DET_AZIMUTH_ERR_050
            DET_AZIMUTH_ERR_051_oRDR_DETECTION_049_052_oPCAN_RADAR_4775383a_Tx: ComBitPosition=329, ComBitSize=7, ComSignalInitValue=0, ComSignalType=UINT8, ComSystemTemplateSystemSignalRef=DET_AZIMUTH_ERR_051
            DET_AZIMUTH_ERR_052_oRDR_DETECTION_049_052_oPCAN_RADAR_239543c4_Tx: ComBitPosition=441, ComBitSize=7, ComSignalInitValue=0, ComSignalType=UINT8, ComSystemTemplateSystemSignalRef=DET_AZIMUTH_ERR_052
            DET_BELOW_RAIN_THOLD_049_oRDR_DETECTION_049_052_oPCAN_RADAR_c691983e_Tx: ComBitPosition=39, ComBitSize=1, ComSignalInitValue=0, ComSignalType=BOOLEAN, ComSystemTemplateSystemSignalRef=DET_BELOW_RAIN_THOLD_049
            DET_BELOW_RAIN_THOLD_050_oRDR_DETECTION_049_052_oPCAN_RADAR_a3b1ea9a_Tx: ComBitPosition=151, ComBitSize=1, ComSignalInitValue=0, ComSignalType=BOOLEAN, ComSystemTemplateSystemSignalRef=DET_BELOW_RAIN_THOLD_050
            DET_BELOW_RAIN_THOLD_051_oRDR_DETECTION_049_052_oPCAN_RADAR_36c13e0f_Tx: ComBitPosition=263, ComBitSize=1, ComSignalInitValue=0, ComSignalType=BOOLEAN, ComSystemTemplateSystemSignalRef=DET_BELOW_RAIN_THOLD_051
            DET_BELOW_RAIN_THOLD_052_oRDR_DETECTION_049_052_oPCAN_RADAR_522145f1_Tx: ComBitPosition=375, ComBitSize=1, ComSignalInitValue=0, ComSignalType=BOOLEAN, ComSystemTemplateSystemSignalRef=DET_BELOW_RAIN_THOLD_052
            DET_BI_STATIC_FLAG_049_oRDR_DETECTION_049_052_oPCAN_RADAR_45bc4b7b_Tx: ComBitPosition=104, ComBitSize=1, ComSignalInitValue=0, ComSignalType=BOOLEAN, ComSystemTemplateSystemSignalRef=DET_BI_STATIC_FLAG_049
            DET_BI_STATIC_FLAG_050_oRDR_DETECTION_049_052_oPCAN_RADAR_209c39df_Tx: ComBitPosition=216, ComBitSize=1, ComSignalInitValue=0, ComSignalType=BOOLEAN, ComSystemTemplateSystemSignalRef=DET_BI_STATIC_FLAG_050
            DET_BI_STATIC_FLAG_051_oRDR_DETECTION_049_052_oPCAN_RADAR_b5eced4a_Tx: ComBitPosition=328, ComBitSize=1, ComSignalInitValue=0, ComSignalType=BOOLEAN, ComSystemTemplateSystemSignalRef=DET_BI_STATIC_FLAG_051
            DET_BI_STATIC_FLAG_052_oRDR_DETECTION_049_052_oPCAN_RADAR_d10c96b4_Tx: ComBitPosition=440, ComBitSize=1, ComSignalInitValue=0, ComSignalType=BOOLEAN, ComSystemTemplateSystemSignalRef=DET_BI_STATIC_FLAG_052
            DET_CONFD_AZIMUTH_049_oRDR_DETECTION_049_052_oPCAN_RADAR_11760134_Tx: ComBitPosition=118, ComBitSize=2, ComSignalInitValue=0, ComSignalType=UINT8, ComSystemTemplateSystemSignalRef=DET_CONFD_AZIMUTH_049
            DET_CONFD_AZIMUTH_050_oRDR_DETECTION_049_052_oPCAN_RADAR_74567390_Tx: ComBitPosition=230, ComBitSize=2, ComSignalInitValue=0, ComSignalType=UINT8, ComSystemTemplateSystemSignalRef=DET_CONFD_AZIMUTH_050
            DET_CONFD_AZIMUTH_051_oRDR_DETECTION_049_052_oPCAN_RADAR_e126a705_Tx: ComBitPosition=342, ComBitSize=2, ComSignalInitValue=0, ComSignalType=UINT8, ComSystemTemplateSystemSignalRef=DET_CONFD_AZIMUTH_051
            DET_CONFD_AZIMUTH_052_oRDR_DETECTION_049_052_oPCAN_RADAR_85c6dcfb_Tx: ComBitPosition=454, ComBitSize=2, ComSignalInitValue=0, ComSignalType=UINT8, ComSystemTemplateSystemSignalRef=DET_CONFD_AZIMUTH_052
            DET_CONFD_ELEVATION_049_oRDR_DETECTION_049_052_oPCAN_RADAR_13e300ce_Tx: ComBitPosition=101, ComBitSize=2, ComSignalInitValue=0, ComSignalType=UINT8, ComSystemTemplateSystemSignalRef=DET_CONFD_ELEVATION_049
            DET_CONFD_ELEVATION_050_oRDR_DETECTION_049_052_oPCAN_RADAR_76c3726a_Tx: ComBitPosition=213, ComBitSize=2, ComSignalInitValue=0, ComSignalType=UINT8, ComSystemTemplateSystemSignalRef=DET_CONFD_ELEVATION_050
            DET_CONFD_ELEVATION_051_oRDR_DETECTION_049_052_oPCAN_RADAR_e3b3a6ff_Tx: ComBitPosition=325, ComBitSize=2, ComSignalInitValue=0, ComSignalType=UINT8, ComSystemTemplateSystemSignalRef=DET_CONFD_ELEVATION_051
            DET_CONFD_ELEVATION_052_oRDR_DETECTION_049_052_oPCAN_RADAR_8753dd01_Tx: ComBitPosition=437, ComBitSize=2, ComSignalInitValue=0, ComSignalType=UINT8, ComSystemTemplateSystemSignalRef=DET_CONFD_ELEVATION_052
            DET_ELEVATION_049_oRDR_DETECTION_049_052_oPCAN_RADAR_c223d4f2_Tx: ComBitPosition=72, ComBitSize=8, ComSignalInitValue=0, ComSignalType=UINT8, ComSystemTemplateSystemSignalRef=DET_ELEVATION_049
            DET_ELEVATION_050_oRDR_DETECTION_049_052_oPCAN_RADAR_a703a656_Tx: ComBitPosition=184, ComBitSize=8, ComSignalInitValue=0, ComSignalType=UINT8, ComSystemTemplateSystemSignalRef=DET_ELEVATION_050
            DET_ELEVATION_051_oRDR_DETECTION_049_052_oPCAN_RADAR_327372c3_Tx: ComBitPosition=296, ComBitSize=8, ComSignalInitValue=0, ComSignalType=UINT8, ComSystemTemplateSystemSignalRef=DET_ELEVATION_051
            DET_ELEVATION_052_oRDR_DETECTION_049_052_oPCAN_RADAR_5693093d_Tx: ComBitPosition=408, ComBitSize=8, ComSignalInitValue=0, ComSignalType=UINT8, ComSystemTemplateSystemSignalRef=DET_ELEVATION_052
            DET_ELEVATION_ERR_049_oRDR_DETECTION_049_052_oPCAN_RADAR_451a4c87_Tx: ComBitPosition=80, ComBitSize=6, ComSignalInitValue=0, ComSignalType=UINT8, ComSystemTemplateSystemSignalRef=DET_ELEVATION_ERR_049
            DET_ELEVATION_ERR_050_oRDR_DETECTION_049_052_oPCAN_RADAR_203a3e23_Tx: ComBitPosition=192, ComBitSize=6, ComSignalInitValue=0, ComSignalType=UINT8, ComSystemTemplateSystemSignalRef=DET_ELEVATION_ERR_050
            DET_ELEVATION_ERR_051_oRDR_DETECTION_049_052_oPCAN_RADAR_b54aeab6_Tx: ComBitPosition=304, ComBitSize=6, ComSignalInitValue=0, ComSignalType=UINT8, ComSystemTemplateSystemSignalRef=DET_ELEVATION_ERR_051
            DET_ELEVATION_ERR_052_oRDR_DETECTION_049_052_oPCAN_RADAR_d1aa9148_Tx: ComBitPosition=416, ComBitSize=6, ComSignalInitValue=0, ComSignalType=UINT8, ComSystemTemplateSystemSignalRef=DET_ELEVATION_ERR_052
            DET_EXISTENCE_PROB_049_oRDR_DETECTION_049_052_oPCAN_RADAR_978539e7_Tx: ComBitPosition=112, ComBitSize=6, ComSignalInitValue=0, ComSignalType=UINT8, ComSystemTemplateSystemSignalRef=DET_EXISTENCE_PROB_049
            DET_EXISTENCE_PROB_050_oRDR_DETECTION_049_052_oPCAN_RADAR_f2a54b43_Tx: ComBitPosition=224, ComBitSize=6, ComSignalInitValue=0, ComSignalType=UINT8, ComSystemTemplateSystemSignalRef=DET_EXISTENCE_PROB_050
            DET_EXISTENCE_PROB_051_oRDR_DETECTION_049_052_oPCAN_RADAR_67d59fd6_Tx: ComBitPosition=336, ComBitSize=6, ComSignalInitValue=0, ComSignalType=UINT8, ComSystemTemplateSystemSignalRef=DET_EXISTENCE_PROB_051
            DET_EXISTENCE_PROB_052_oRDR_DETECTION_049_052_oPCAN_RADAR_0335e428_Tx: ComBitPosition=448, ComBitSize=6, ComSignalInitValue=0, ComSignalType=UINT8, ComSystemTemplateSystemSignalRef=DET_EXISTENCE_PROB_052
            DET_HVC_FLAG_049_oRDR_DETECTION_049_052_oPCAN_RADAR_76f17a98_Tx: ComBitPosition=86, ComBitSize=1, ComSignalInitValue=0, ComSignalType=BOOLEAN, ComSystemTemplateSystemSignalRef=DET_HVC_FLAG_049
            DET_HVC_FLAG_050_oRDR_DETECTION_049_052_oPCAN_RADAR_13d1083c_Tx: ComBitPosition=198, ComBitSize=1, ComSignalInitValue=0, ComSignalType=BOOLEAN, ComSystemTemplateSystemSignalRef=DET_HVC_FLAG_050
            DET_HVC_FLAG_051_oRDR_DETECTION_049_052_oPCAN_RADAR_86a1dca9_Tx: ComBitPosition=310, ComBitSize=1, ComSignalInitValue=0, ComSignalType=BOOLEAN, ComSystemTemplateSystemSignalRef=DET_HVC_FLAG_051
            DET_HVC_FLAG_052_oRDR_DETECTION_049_052_oPCAN_RADAR_e241a757_Tx: ComBitPosition=422, ComBitSize=1, ComSignalInitValue=0, ComSignalType=BOOLEAN, ComSystemTemplateSystemSignalRef=DET_HVC_FLAG_052
            DET_IDM_049_oRDR_DETECTION_049_052_oPCAN_RADAR_fda34125_Tx: ComBitPosition=63, ComBitSize=1, ComSignalInitValue=0, ComSignalType=BOOLEAN, ComSystemTemplateSystemSignalRef=DET_IDM_049
            DET_IDM_050_oRDR_DETECTION_049_052_oPCAN_RADAR_98833381_Tx: ComBitPosition=175, ComBitSize=1, ComSignalInitValue=0, ComSignalType=BOOLEAN, ComSystemTemplateSystemSignalRef=DET_IDM_050
            DET_IDM_051_oRDR_DETECTION_049_052_oPCAN_RADAR_0df3e714_Tx: ComBitPosition=287, ComBitSize=1, ComSignalInitValue=0, ComSignalType=BOOLEAN, ComSystemTemplateSystemSignalRef=DET_IDM_051
            DET_IDM_052_oRDR_DETECTION_049_052_oPCAN_RADAR_69139cea_Tx: ComBitPosition=399, ComBitSize=1, ComSignalInitValue=0, ComSignalType=BOOLEAN, ComSystemTemplateSystemSignalRef=DET_IDM_052
            DET_MH_CRC16_049_052_oRDR_DETECTION_049_052_oPCAN_RADAR_d9921723_Tx: ComBitPosition=0, ComBitSize=16, ComSignalInitValue=0, ComSignalType=UINT16, ComSystemTemplateSystemSignalRef=DET_MH_CRC16_049_052
            DET_MH_CYCLE_COUNTER_049_052_oRDR_DETECTION_049_052_oPCAN_RADAR_5de7b614_Tx: ComBitPosition=16, ComBitSize=8, ComSignalInitValue=0, ComSignalType=UINT8, ComSystemTemplateSystemSignalRef=DET_MH_CYCLE_COUNTER_049_052
            DET_MH_SCAN_INDEX_4LSB_049_052_oRDR_DETECTION_049_052_oPCAN_RADAR_91cd9398_Tx: ComBitPosition=476, ComBitSize=4, ComSignalInitValue=0, ComSignalType=UINT8, ComSystemTemplateSystemSignalRef=DET_MH_SCAN_INDEX_4LSB_049_052
            DET_MTD_049_oRDR_DETECTION_049_052_oPCAN_RADAR_9b1073fe_Tx: ComBitPosition=47, ComBitSize=1, ComSignalInitValue=0, ComSignalType=BOOLEAN, ComSystemTemplateSystemSignalRef=DET_MTD_049
            DET_MTD_050_oRDR_DETECTION_049_052_oPCAN_RADAR_fe30015a_Tx: ComBitPosition=159, ComBitSize=1, ComSignalInitValue=0, ComSignalType=BOOLEAN, ComSystemTemplateSystemSignalRef=DET_MTD_050
            DET_MTD_051_oRDR_DETECTION_049_052_oPCAN_RADAR_6b40d5cf_Tx: ComBitPosition=271, ComBitSize=1, ComSignalInitValue=0, ComSignalType=BOOLEAN, ComSystemTemplateSystemSignalRef=DET_MTD_051
            DET_MTD_052_oRDR_DETECTION_049_052_oPCAN_RADAR_0fa0ae31_Tx: ComBitPosition=383, ComBitSize=1, ComSignalInitValue=0, ComSignalType=BOOLEAN, ComSystemTemplateSystemSignalRef=DET_MTD_052
            DET_PROB_1STAZHYPO_049_oRDR_DETECTION_049_052_oPCAN_RADAR_08a49b33_Tx: ComBitPosition=103, ComBitSize=1, ComSignalInitValue=0, ComSignalType=BOOLEAN, ComSystemTemplateSystemSignalRef=DET_PROB_1STAZHYPO_049
            DET_PROB_1STAZHYPO_050_oRDR_DETECTION_049_052_oPCAN_RADAR_6d84e997_Tx: ComBitPosition=215, ComBitSize=1, ComSignalInitValue=0, ComSignalType=BOOLEAN, ComSystemTemplateSystemSignalRef=DET_PROB_1STAZHYPO_050
            DET_PROB_1STAZHYPO_051_oRDR_DETECTION_049_052_oPCAN_RADAR_f8f43d02_Tx: ComBitPosition=327, ComBitSize=1, ComSignalInitValue=0, ComSignalType=BOOLEAN, ComSystemTemplateSystemSignalRef=DET_PROB_1STAZHYPO_051
            DET_PROB_1STAZHYPO_052_oRDR_DETECTION_049_052_oPCAN_RADAR_9c1446fc_Tx: ComBitPosition=439, ComBitSize=1, ComSignalInitValue=0, ComSignalType=BOOLEAN, ComSystemTemplateSystemSignalRef=DET_PROB_1STAZHYPO_052
            DET_RANGE_049_oRDR_DETECTION_049_052_oPCAN_RADAR_030b7845_Tx: ComBitPosition=24, ComBitSize=15, ComSignalInitValue=0, ComSignalType=UINT16, ComSystemTemplateSystemSignalRef=DET_RANGE_049
            DET_RANGE_050_oRDR_DETECTION_049_052_oPCAN_RADAR_662b0ae1_Tx: ComBitPosition=136, ComBitSize=15, ComSignalInitValue=0, ComSignalType=UINT16, ComSystemTemplateSystemSignalRef=DET_RANGE_050
            DET_RANGE_051_oRDR_DETECTION_049_052_oPCAN_RADAR_f35bde74_Tx: ComBitPosition=248, ComBitSize=15, ComSignalInitValue=0, ComSignalType=UINT16, ComSystemTemplateSystemSignalRef=DET_RANGE_051
            DET_RANGE_052_oRDR_DETECTION_049_052_oPCAN_RADAR_97bba58a_Tx: ComBitPosition=360, ComBitSize=15, ComSignalInitValue=0, ComSignalType=UINT16, ComSystemTemplateSystemSignalRef=DET_RANGE_052
            DET_RANGE_ERR_049_oRDR_DETECTION_049_052_oPCAN_RADAR_a4e3c22c_Tx: ComBitPosition=40, ComBitSize=7, ComSignalInitValue=0, ComSignalType=UINT8, ComSystemTemplateSystemSignalRef=DET_RANGE_ERR_049
            DET_RANGE_ERR_050_oRDR_DETECTION_049_052_oPCAN_RADAR_c1c3b088_Tx: ComBitPosition=152, ComBitSize=7, ComSignalInitValue=0, ComSignalType=UINT8, ComSystemTemplateSystemSignalRef=DET_RANGE_ERR_050
            DET_RANGE_ERR_051_oRDR_DETECTION_049_052_oPCAN_RADAR_54b3641d_Tx: ComBitPosition=264, ComBitSize=7, ComSignalInitValue=0, ComSignalType=UINT8, ComSystemTemplateSystemSignalRef=DET_RANGE_ERR_051
            DET_RANGE_ERR_052_oRDR_DETECTION_049_052_oPCAN_RADAR_30531fe3_Tx: ComBitPosition=376, ComBitSize=7, ComSignalInitValue=0, ComSignalType=UINT8, ComSystemTemplateSystemSignalRef=DET_RANGE_ERR_052
            DET_RANGE_VELOCITY_049_oRDR_DETECTION_049_052_oPCAN_RADAR_76adba60_Tx: ComBitPosition=48, ComBitSize=15, ComSignalInitValue=16384, ComSignalType=UINT16, ComSystemTemplateSystemSignalRef=DET_RANGE_VELOCITY_049
            DET_RANGE_VELOCITY_050_oRDR_DETECTION_049_052_oPCAN_RADAR_138dc8c4_Tx: ComBitPosition=160, ComBitSize=15, ComSignalInitValue=16384, ComSignalType=UINT16, ComSystemTemplateSystemSignalRef=DET_RANGE_VELOCITY_050
            DET_RANGE_VELOCITY_051_oRDR_DETECTION_049_052_oPCAN_RADAR_86fd1c51_Tx: ComBitPosition=272, ComBitSize=15, ComSignalInitValue=16384, ComSignalType=UINT16, ComSystemTemplateSystemSignalRef=DET_RANGE_VELOCITY_051
            DET_RANGE_VELOCITY_052_oRDR_DETECTION_049_052_oPCAN_RADAR_e21d67af_Tx: ComBitPosition=384, ComBitSize=15, ComSignalInitValue=16384, ComSignalType=UINT16, ComSystemTemplateSystemSignalRef=DET_RANGE_VELOCITY_052
            DET_RANGE_VELOCITY_ERR_049_oRDR_DETECTION_049_052_oPCAN_RADAR_791641d2_Tx: ComBitPosition=64, ComBitSize=8, ComSignalInitValue=0, ComSignalType=UINT8, ComSystemTemplateSystemSignalRef=DET_RANGE_VELOCITY_ERR_049
            DET_RANGE_VELOCITY_ERR_050_oRDR_DETECTION_049_052_oPCAN_RADAR_1c363376_Tx: ComBitPosition=176, ComBitSize=8, ComSignalInitValue=0, ComSignalType=UINT8, ComSystemTemplateSystemSignalRef=DET_RANGE_VELOCITY_ERR_050
            DET_RANGE_VELOCITY_ERR_051_oRDR_DETECTION_049_052_oPCAN_RADAR_8946e7e3_Tx: ComBitPosition=288, ComBitSize=8, ComSignalInitValue=0, ComSignalType=UINT8, ComSystemTemplateSystemSignalRef=DET_RANGE_VELOCITY_ERR_051
            DET_RANGE_VELOCITY_ERR_052_oRDR_DETECTION_049_052_oPCAN_RADAR_eda69c1d_Tx: ComBitPosition=400, ComBitSize=8, ComSignalInitValue=0, ComSignalType=UINT8, ComSystemTemplateSystemSignalRef=DET_RANGE_VELOCITY_ERR_052
            DET_RCS_049_oRDR_DETECTION_049_052_oPCAN_RADAR_f12d8d3a_Tx: ComBitPosition=128, ComBitSize=8, ComSignalInitValue=128, ComSignalType=UINT8, ComSystemTemplateSystemSignalRef=DET_RCS_049
            DET_RCS_050_oRDR_DETECTION_049_052_oPCAN_RADAR_940dff9e_Tx: ComBitPosition=240, ComBitSize=8, ComSignalInitValue=128, ComSignalType=UINT8, ComSystemTemplateSystemSignalRef=DET_RCS_050
            DET_RCS_051_oRDR_DETECTION_049_052_oPCAN_RADAR_017d2b0b_Tx: ComBitPosition=352, ComBitSize=8, ComSignalInitValue=128, ComSignalType=UINT8, ComSystemTemplateSystemSignalRef=DET_RCS_051
            DET_RCS_052_oRDR_DETECTION_049_052_oPCAN_RADAR_659d50f5_Tx: ComBitPosition=464, ComBitSize=8, ComSignalInitValue=128, ComSignalType=UINT8, ComSystemTemplateSystemSignalRef=DET_RCS_052
            DET_SNR_049_oRDR_DETECTION_049_052_oPCAN_RADAR_2c83d938_Tx: ComBitPosition=120, ComBitSize=8, ComSignalInitValue=0, ComSignalType=UINT8, ComSystemTemplateSystemSignalRef=DET_SNR_049
            DET_SNR_050_oRDR_DETECTION_049_052_oPCAN_RADAR_49a3ab9c_Tx: ComBitPosition=232, ComBitSize=8, ComSignalInitValue=0, ComSignalType=UINT8, ComSystemTemplateSystemSignalRef=DET_SNR_050
            DET_SNR_051_oRDR_DETECTION_049_052_oPCAN_RADAR_dcd37f09_Tx: ComBitPosition=344, ComBitSize=8, ComSignalInitValue=0, ComSignalType=UINT8, ComSystemTemplateSystemSignalRef=DET_SNR_051
            DET_SNR_052_oRDR_DETECTION_049_052_oPCAN_RADAR_b83304f7_Tx: ComBitPosition=456, ComBitSize=8, ComSignalInitValue=0, ComSignalType=UINT8, ComSystemTemplateSystemSignalRef=DET_SNR_052
            DET_SUPER_RES_TARGET_049_oRDR_DETECTION_049_052_oPCAN_RADAR_1d1af15d_Tx: ComBitPosition=87, ComBitSize=1, ComSignalInitValue=0, ComSignalType=BOOLEAN, ComSystemTemplateSystemSignalRef=DET_SUPER_RES_TARGET_049
            DET_SUPER_RES_TARGET_050_oRDR_DETECTION_049_052_oPCAN_RADAR_783a83f9_Tx: ComBitPosition=199, ComBitSize=1, ComSignalInitValue=0, ComSignalType=BOOLEAN, ComSystemTemplateSystemSignalRef=DET_SUPER_RES_TARGET_050
            DET_SUPER_RES_TARGET_051_oRDR_DETECTION_049_052_oPCAN_RADAR_ed4a576c_Tx: ComBitPosition=311, ComBitSize=1, ComSignalInitValue=0, ComSignalType=BOOLEAN, ComSystemTemplateSystemSignalRef=DET_SUPER_RES_TARGET_051
            DET_SUPER_RES_TARGET_052_oRDR_DETECTION_049_052_oPCAN_RADAR_89aa2c92_Tx: ComBitPosition=423, ComBitSize=1, ComSignalInitValue=0, ComSignalType=BOOLEAN, ComSystemTemplateSystemSignalRef=DET_SUPER_RES_TARGET_052
        SG_Detections_053_056_oRDR_DETECTION_053_056_oPCAN_RADAR_6f11ad00_Tx: ComSystemTemplateSignalGroupRef=SG_Detections_053_056
          83 x ComGroupSignal, all with ComSignalEndianness=LITTLE_ENDIAN, ComTransferProperty=PENDING:
            DET_AZIMUTH_053_oRDR_DETECTION_053_056_oPCAN_RADAR_0f97018a_Tx: ComBitPosition=88, ComBitSize=13, ComSignalInitValue=0, ComSignalType=UINT16, ComSystemTemplateSystemSignalRef=DET_AZIMUTH_053
            DET_AZIMUTH_054_oRDR_DETECTION_053_056_oPCAN_RADAR_532722e3_Tx: ComBitPosition=200, ComBitSize=13, ComSignalInitValue=0, ComSignalType=UINT16, ComSystemTemplateSystemSignalRef=DET_AZIMUTH_054
            DET_AZIMUTH_055_oRDR_DETECTION_053_056_oPCAN_RADAR_c657f676_Tx: ComBitPosition=312, ComBitSize=13, ComSignalInitValue=0, ComSignalType=UINT16, ComSystemTemplateSystemSignalRef=DET_AZIMUTH_055
            DET_AZIMUTH_056_oRDR_DETECTION_053_056_oPCAN_RADAR_a2b78d88_Tx: ComBitPosition=424, ComBitSize=13, ComSignalInitValue=0, ComSignalType=UINT16, ComSystemTemplateSystemSignalRef=DET_AZIMUTH_056
            DET_AZIMUTH_ERR_053_oRDR_DETECTION_053_056_oPCAN_RADAR_ab22947f_Tx: ComBitPosition=105, ComBitSize=7, ComSignalInitValue=0, ComSignalType=UINT8, ComSystemTemplateSystemSignalRef=DET_AZIMUTH_ERR_053
            DET_AZIMUTH_ERR_054_oRDR_DETECTION_053_056_oPCAN_RADAR_f792b716_Tx: ComBitPosition=217, ComBitSize=7, ComSignalInitValue=0, ComSignalType=UINT8, ComSystemTemplateSystemSignalRef=DET_AZIMUTH_ERR_054
            DET_AZIMUTH_ERR_055_oRDR_DETECTION_053_056_oPCAN_RADAR_62e26383_Tx: ComBitPosition=329, ComBitSize=7, ComSignalInitValue=0, ComSignalType=UINT8, ComSystemTemplateSystemSignalRef=DET_AZIMUTH_ERR_055
            DET_AZIMUTH_ERR_056_oRDR_DETECTION_053_056_oPCAN_RADAR_0602187d_Tx: ComBitPosition=441, ComBitSize=7, ComSignalInitValue=0, ComSignalType=UINT8, ComSystemTemplateSystemSignalRef=DET_AZIMUTH_ERR_056
            DET_BELOW_RAIN_THOLD_053_oRDR_DETECTION_053_056_oPCAN_RADAR_da96924a_Tx: ComBitPosition=39, ComBitSize=1, ComSignalInitValue=0, ComSignalType=BOOLEAN, ComSystemTemplateSystemSignalRef=DET_BELOW_RAIN_THOLD_053
            DET_BELOW_RAIN_THOLD_054_oRDR_DETECTION_053_056_oPCAN_RADAR_8626b123_Tx: ComBitPosition=151, ComBitSize=1, ComSignalInitValue=0, ComSignalType=BOOLEAN, ComSystemTemplateSystemSignalRef=DET_BELOW_RAIN_THOLD_054
            DET_BELOW_RAIN_THOLD_055_oRDR_DETECTION_053_056_oPCAN_RADAR_135665b6_Tx: ComBitPosition=263, ComBitSize=1, ComSignalInitValue=0, ComSignalType=BOOLEAN, ComSystemTemplateSystemSignalRef=DET_BELOW_RAIN_THOLD_055
            DET_BELOW_RAIN_THOLD_056_oRDR_DETECTION_053_056_oPCAN_RADAR_77b61e48_Tx: ComBitPosition=375, ComBitSize=1, ComSignalInitValue=0, ComSignalType=BOOLEAN, ComSystemTemplateSystemSignalRef=DET_BELOW_RAIN_THOLD_056
            DET_BI_STATIC_FLAG_053_oRDR_DETECTION_053_056_oPCAN_RADAR_59bb410f_Tx: ComBitPosition=104, ComBitSize=1, ComSignalInitValue=0, ComSignalType=BOOLEAN, ComSystemTemplateSystemSignalRef=DET_BI_STATIC_FLAG_053
            DET_BI_STATIC_FLAG_054_oRDR_DETECTION_053_056_oPCAN_RADAR_050b6266_Tx: ComBitPosition=216, ComBitSize=1, ComSignalInitValue=0, ComSignalType=BOOLEAN, ComSystemTemplateSystemSignalRef=DET_BI_STATIC_FLAG_054
            DET_BI_STATIC_FLAG_055_oRDR_DETECTION_053_056_oPCAN_RADAR_907bb6f3_Tx: ComBitPosition=328, ComBitSize=1, ComSignalInitValue=0, ComSignalType=BOOLEAN, ComSystemTemplateSystemSignalRef=DET_BI_STATIC_FLAG_055
            DET_BI_STATIC_FLAG_056_oRDR_DETECTION_053_056_oPCAN_RADAR_f49bcd0d_Tx: ComBitPosition=440, ComBitSize=1, ComSignalInitValue=0, ComSignalType=BOOLEAN, ComSystemTemplateSystemSignalRef=DET_BI_STATIC_FLAG_056
            DET_CONFD_AZIMUTH_053_oRDR_DETECTION_053_056_oPCAN_RADAR_0d710b40_Tx: ComBitPosition=118, ComBitSize=2, ComSignalInitValue=0, ComSignalType=UINT8, ComSystemTemplateSystemSignalRef=DET_CONFD_AZIMUTH_053
            DET_CONFD_AZIMUTH_054_oRDR_DETECTION_053_056_oPCAN_RADAR_51c12829_Tx: ComBitPosition=230, ComBitSize=2, ComSignalInitValue=0, ComSignalType=UINT8, ComSystemTemplateSystemSignalRef=DET_CONFD_AZIMUTH_054
            DET_CONFD_AZIMUTH_055_oRDR_DETECTION_053_056_oPCAN_RADAR_c4b1fcbc_Tx: ComBitPosition=342, ComBitSize=2, ComSignalInitValue=0, ComSignalType=UINT8, ComSystemTemplateSystemSignalRef=DET_CONFD_AZIMUTH_055
            DET_CONFD_AZIMUTH_056_oRDR_DETECTION_053_056_oPCAN_RADAR_a0518742_Tx: ComBitPosition=454, ComBitSize=2, ComSignalInitValue=0, ComSignalType=UINT8, ComSystemTemplateSystemSignalRef=DET_CONFD_AZIMUTH_056
            DET_CONFD_ELEVATION_053_oRDR_DETECTION_053_056_oPCAN_RADAR_0fe40aba_Tx: ComBitPosition=101, ComBitSize=2, ComSignalInitValue=0, ComSignalType=UINT8, ComSystemTemplateSystemSignalRef=DET_CONFD_ELEVATION_053
            DET_CONFD_ELEVATION_054_oRDR_DETECTION_053_056_oPCAN_RADAR_535429d3_Tx: ComBitPosition=213, ComBitSize=2, ComSignalInitValue=0, ComSignalType=UINT8, ComSystemTemplateSystemSignalRef=DET_CONFD_ELEVATION_054
            DET_CONFD_ELEVATION_055_oRDR_DETECTION_053_056_oPCAN_RADAR_c624fd46_Tx: ComBitPosition=325, ComBitSize=2, ComSignalInitValue=0, ComSignalType=UINT8, ComSystemTemplateSystemSignalRef=DET_CONFD_ELEVATION_055
            DET_CONFD_ELEVATION_056_oRDR_DETECTION_053_056_oPCAN_RADAR_a2c486b8_Tx: ComBitPosition=437, ComBitSize=2, ComSignalInitValue=0, ComSignalType=UINT8, ComSystemTemplateSystemSignalRef=DET_CONFD_ELEVATION_056
            DET_ELEVATION_053_oRDR_DETECTION_053_056_oPCAN_RADAR_de24de86_Tx: ComBitPosition=72, ComBitSize=8, ComSignalInitValue=0, ComSignalType=UINT8, ComSystemTemplateSystemSignalRef=DET_ELEVATION_053
            DET_ELEVATION_054_oRDR_DETECTION_053_056_oPCAN_RADAR_8294fdef_Tx: ComBitPosition=184, ComBitSize=8, ComSignalInitValue=0, ComSignalType=UINT8, ComSystemTemplateSystemSignalRef=DET_ELEVATION_054
            DET_ELEVATION_055_oRDR_DETECTION_053_056_oPCAN_RADAR_17e4297a_Tx: ComBitPosition=296, ComBitSize=8, ComSignalInitValue=0, ComSignalType=UINT8, ComSystemTemplateSystemSignalRef=DET_ELEVATION_055
            DET_ELEVATION_056_oRDR_DETECTION_053_056_oPCAN_RADAR_73045284_Tx: ComBitPosition=408, ComBitSize=8, ComSignalInitValue=0, ComSignalType=UINT8, ComSystemTemplateSystemSignalRef=DET_ELEVATION_056
            DET_ELEVATION_ERR_053_oRDR_DETECTION_053_056_oPCAN_RADAR_591d46f3_Tx: ComBitPosition=80, ComBitSize=6, ComSignalInitValue=0, ComSignalType=UINT8, ComSystemTemplateSystemSignalRef=DET_ELEVATION_ERR_053
            DET_ELEVATION_ERR_054_oRDR_DETECTION_053_056_oPCAN_RADAR_05ad659a_Tx: ComBitPosition=192, ComBitSize=6, ComSignalInitValue=0, ComSignalType=UINT8, ComSystemTemplateSystemSignalRef=DET_ELEVATION_ERR_054
            DET_ELEVATION_ERR_055_oRDR_DETECTION_053_056_oPCAN_RADAR_90ddb10f_Tx: ComBitPosition=304, ComBitSize=6, ComSignalInitValue=0, ComSignalType=UINT8, ComSystemTemplateSystemSignalRef=DET_ELEVATION_ERR_055
            DET_ELEVATION_ERR_056_oRDR_DETECTION_053_056_oPCAN_RADAR_f43dcaf1_Tx: ComBitPosition=416, ComBitSize=6, ComSignalInitValue=0, ComSignalType=UINT8, ComSystemTemplateSystemSignalRef=DET_ELEVATION_ERR_056
            DET_EXISTENCE_PROB_053_oRDR_DETECTION_053_056_oPCAN_RADAR_8b823393_Tx: ComBitPosition=112, ComBitSize=6, ComSignalInitValue=0, ComSignalType=UINT8, ComSystemTemplateSystemSignalRef=DET_EXISTENCE_PROB_053
            DET_EXISTENCE_PROB_054_oRDR_DETECTION_053_056_oPCAN_RADAR_d73210fa_Tx: ComBitPosition=224, ComBitSize=6, ComSignalInitValue=0, ComSignalType=UINT8, ComSystemTemplateSystemSignalRef=DET_EXISTENCE_PROB_054
            DET_EXISTENCE_PROB_055_oRDR_DETECTION_053_056_oPCAN_RADAR_4242c46f_Tx: ComBitPosition=336, ComBitSize=6, ComSignalInitValue=0, ComSignalType=UINT8, ComSystemTemplateSystemSignalRef=DET_EXISTENCE_PROB_055
            DET_EXISTENCE_PROB_056_oRDR_DETECTION_053_056_oPCAN_RADAR_26a2bf91_Tx: ComBitPosition=448, ComBitSize=6, ComSignalInitValue=0, ComSignalType=UINT8, ComSystemTemplateSystemSignalRef=DET_EXISTENCE_PROB_056
            DET_HVC_FLAG_053_oRDR_DETECTION_053_056_oPCAN_RADAR_6af670ec_Tx: ComBitPosition=86, ComBitSize=1, ComSignalInitValue=0, ComSignalType=BOOLEAN, ComSystemTemplateSystemSignalRef=DET_HVC_FLAG_053
            DET_HVC_FLAG_054_oRDR_DETECTION_053_056_oPCAN_RADAR_36465385_Tx: ComBitPosition=198, ComBitSize=1, ComSignalInitValue=0, ComSignalType=BOOLEAN, ComSystemTemplateSystemSignalRef=DET_HVC_FLAG_054
            DET_HVC_FLAG_055_oRDR_DETECTION_053_056_oPCAN_RADAR_a3368710_Tx: ComBitPosition=310, ComBitSize=1, ComSignalInitValue=0, ComSignalType=BOOLEAN, ComSystemTemplateSystemSignalRef=DET_HVC_FLAG_055
            DET_HVC_FLAG_056_oRDR_DETECTION_053_056_oPCAN_RADAR_c7d6fcee_Tx: ComBitPosition=422, ComBitSize=1, ComSignalInitValue=0, ComSignalType=BOOLEAN, ComSystemTemplateSystemSignalRef=DET_HVC_FLAG_056
            DET_IDM_053_oRDR_DETECTION_053_056_oPCAN_RADAR_e1a44b51_Tx: ComBitPosition=63, ComBitSize=1, ComSignalInitValue=0, ComSignalType=BOOLEAN, ComSystemTemplateSystemSignalRef=DET_IDM_053
            DET_IDM_054_oRDR_DETECTION_053_056_oPCAN_RADAR_bd146838_Tx: ComBitPosition=175, ComBitSize=1, ComSignalInitValue=0, ComSignalType=BOOLEAN, ComSystemTemplateSystemSignalRef=DET_IDM_054
            DET_IDM_055_oRDR_DETECTION_053_056_oPCAN_RADAR_2864bcad_Tx: ComBitPosition=287, ComBitSize=1, ComSignalInitValue=0, ComSignalType=BOOLEAN, ComSystemTemplateSystemSignalRef=DET_IDM_055
            DET_IDM_056_oRDR_DETECTION_053_056_oPCAN_RADAR_4c84c753_Tx: ComBitPosition=399, ComBitSize=1, ComSignalInitValue=0, ComSignalType=BOOLEAN, ComSystemTemplateSystemSignalRef=DET_IDM_056
            DET_MH_CRC16_053_056_oRDR_DETECTION_053_056_oPCAN_RADAR_eb997f0b_Tx: ComBitPosition=0, ComBitSize=16, ComSignalInitValue=0, ComSignalType=UINT16, ComSystemTemplateSystemSignalRef=DET_MH_CRC16_053_056
            DET_MH_CYCLE_COUNTER_053_056_oRDR_DETECTION_053_056_oPCAN_RADAR_6fecde3c_Tx: ComBitPosition=16, ComBitSize=8, ComSignalInitValue=0, ComSignalType=UINT8, ComSystemTemplateSystemSignalRef=DET_MH_CYCLE_COUNTER_053_056
            DET_MH_SCAN_INDEX_4LSB_053_056_oRDR_DETECTION_053_056_oPCAN_RADAR_a3c6fbb0_Tx: ComBitPosition=476, ComBitSize=4, ComSignalInitValue=0, ComSignalType=UINT8, ComSystemTemplateSystemSignalRef=DET_MH_SCAN_INDEX_4LSB_053_056
            DET_MTD_053_oRDR_DETECTION_053_056_oPCAN_RADAR_8717798a_Tx: ComBitPosition=47, ComBitSize=1, ComSignalInitValue=0, ComSignalType=BOOLEAN, ComSystemTemplateSystemSignalRef=DET_MTD_053
            DET_MTD_054_oRDR_DETECTION_053_056_oPCAN_RADAR_dba75ae3_Tx: ComBitPosition=159, ComBitSize=1, ComSignalInitValue=0, ComSignalType=BOOLEAN, ComSystemTemplateSystemSignalRef=DET_MTD_054
            DET_MTD_055_oRDR_DETECTION_053_056_oPCAN_RADAR_4ed78e76_Tx: ComBitPosition=271, ComBitSize=1, ComSignalInitValue=0, ComSignalType=BOOLEAN, ComSystemTemplateSystemSignalRef=DET_MTD_055
            DET_MTD_056_oRDR_DETECTION_053_056_oPCAN_RADAR_2a37f588_Tx: ComBitPosition=383, ComBitSize=1, ComSignalInitValue=0, ComSignalType=BOOLEAN, ComSystemTemplateSystemSignalRef=DET_MTD_056
            DET_PROB_1STAZHYPO_053_oRDR_DETECTION_053_056_oPCAN_RADAR_14a39147_Tx: ComBitPosition=103, ComBitSize=1, ComSignalInitValue=0, ComSignalType=BOOLEAN, ComSystemTemplateSystemSignalRef=DET_PROB_1STAZHYPO_053
            DET_PROB_1STAZHYPO_054_oRDR_DETECTION_053_056_oPCAN_RADAR_4813b22e_Tx: ComBitPosition=215, ComBitSize=1, ComSignalInitValue=0, ComSignalType=BOOLEAN, ComSystemTemplateSystemSignalRef=DET_PROB_1STAZHYPO_054
            DET_PROB_1STAZHYPO_055_oRDR_DETECTION_053_056_oPCAN_RADAR_dd6366bb_Tx: ComBitPosition=327, ComBitSize=1, ComSignalInitValue=0, ComSignalType=BOOLEAN, ComSystemTemplateSystemSignalRef=DET_PROB_1STAZHYPO_055
            DET_PROB_1STAZHYPO_056_oRDR_DETECTION_053_056_oPCAN_RADAR_b9831d45_Tx: ComBitPosition=439, ComBitSize=1, ComSignalInitValue=0, ComSignalType=BOOLEAN, ComSystemTemplateSystemSignalRef=DET_PROB_1STAZHYPO_056
            DET_RANGE_053_oRDR_DETECTION_053_056_oPCAN_RADAR_1f0c7231_Tx: ComBitPosition=24, ComBitSize=15, ComSignalInitValue=0, ComSignalType=UINT16, ComSystemTemplateSystemSignalRef=DET_RANGE_053
            DET_RANGE_054_oRDR_DETECTION_053_056_oPCAN_RADAR_43bc5158_Tx: ComBitPosition=136, ComBitSize=15, ComSignalInitValue=0, ComSignalType=UINT16, ComSystemTemplateSystemSignalRef=DET_RANGE_054
            DET_RANGE_055_oRDR_DETECTION_053_056_oPCAN_RADAR_d6cc85cd_Tx: ComBitPosition=248, ComBitSize=15, ComSignalInitValue=0, ComSignalType=UINT16, ComSystemTemplateSystemSignalRef=DET_RANGE_055
            DET_RANGE_056_oRDR_DETECTION_053_056_oPCAN_RADAR_b22cfe33_Tx: ComBitPosition=360, ComBitSize=15, ComSignalInitValue=0, ComSignalType=UINT16, ComSystemTemplateSystemSignalRef=DET_RANGE_056
            DET_RANGE_ERR_053_oRDR_DETECTION_053_056_oPCAN_RADAR_b8e4c858_Tx: ComBitPosition=40, ComBitSize=7, ComSignalInitValue=0, ComSignalType=UINT8, ComSystemTemplateSystemSignalRef=DET_RANGE_ERR_053
            DET_RANGE_ERR_054_oRDR_DETECTION_053_056_oPCAN_RADAR_e454eb31_Tx: ComBitPosition=152, ComBitSize=7, ComSignalInitValue=0, ComSignalType=UINT8, ComSystemTemplateSystemSignalRef=DET_RANGE_ERR_054
            DET_RANGE_ERR_055_oRDR_DETECTION_053_056_oPCAN_RADAR_71243fa4_Tx: ComBitPosition=264, ComBitSize=7, ComSignalInitValue=0, ComSignalType=UINT8, ComSystemTemplateSystemSignalRef=DET_RANGE_ERR_055
            DET_RANGE_ERR_056_oRDR_DETECTION_053_056_oPCAN_RADAR_15c4445a_Tx: ComBitPosition=376, ComBitSize=7, ComSignalInitValue=0, ComSignalType=UINT8, ComSystemTemplateSystemSignalRef=DET_RANGE_ERR_056
            DET_RANGE_VELOCITY_053_oRDR_DETECTION_053_056_oPCAN_RADAR_6aaab014_Tx: ComBitPosition=48, ComBitSize=15, ComSignalInitValue=16384, ComSignalType=UINT16, ComSystemTemplateSystemSignalRef=DET_RANGE_VELOCITY_053
            DET_RANGE_VELOCITY_054_oRDR_DETECTION_053_056_oPCAN_RADAR_361a937d_Tx: ComBitPosition=160, ComBitSize=15, ComSignalInitValue=16384, ComSignalType=UINT16, ComSystemTemplateSystemSignalRef=DET_RANGE_VELOCITY_054
            DET_RANGE_VELOCITY_055_oRDR_DETECTION_053_056_oPCAN_RADAR_a36a47e8_Tx: ComBitPosition=272, ComBitSize=15, ComSignalInitValue=16384, ComSignalType=UINT16, ComSystemTemplateSystemSignalRef=DET_RANGE_VELOCITY_055
            DET_RANGE_VELOCITY_056_oRDR_DETECTION_053_056_oPCAN_RADAR_c78a3c16_Tx: ComBitPosition=384, ComBitSize=15, ComSignalInitValue=16384, ComSignalType=UINT16, ComSystemTemplateSystemSignalRef=DET_RANGE_VELOCITY_056
            DET_RANGE_VELOCITY_ERR_053_oRDR_DETECTION_053_056_oPCAN_RADAR_65114ba6_Tx: ComBitPosition=64, ComBitSize=8, ComSignalInitValue=0, ComSignalType=UINT8, ComSystemTemplateSystemSignalRef=DET_RANGE_VELOCITY_ERR_053
            DET_RANGE_VELOCITY_ERR_054_oRDR_DETECTION_053_056_oPCAN_RADAR_39a168cf_Tx: ComBitPosition=176, ComBitSize=8, ComSignalInitValue=0, ComSignalType=UINT8, ComSystemTemplateSystemSignalRef=DET_RANGE_VELOCITY_ERR_054
            DET_RANGE_VELOCITY_ERR_055_oRDR_DETECTION_053_056_oPCAN_RADAR_acd1bc5a_Tx: ComBitPosition=288, ComBitSize=8, ComSignalInitValue=0, ComSignalType=UINT8, ComSystemTemplateSystemSignalRef=DET_RANGE_VELOCITY_ERR_055
            DET_RANGE_VELOCITY_ERR_056_oRDR_DETECTION_053_056_oPCAN_RADAR_c831c7a4_Tx: ComBitPosition=400, ComBitSize=8, ComSignalInitValue=0, ComSignalType=UINT8, ComSystemTemplateSystemSignalRef=DET_RANGE_VELOCITY_ERR_056
            DET_RCS_053_oRDR_DETECTION_053_056_oPCAN_RADAR_ed2a874e_Tx: ComBitPosition=128, ComBitSize=8, ComSignalInitValue=128, ComSignalType=UINT8, ComSystemTemplateSystemSignalRef=DET_RCS_053
            DET_RCS_054_oRDR_DETECTION_053_056_oPCAN_RADAR_b19aa427_Tx: ComBitPosition=240, ComBitSize=8, ComSignalInitValue=128, ComSignalType=UINT8, ComSystemTemplateSystemSignalRef=DET_RCS_054
            DET_RCS_055_oRDR_DETECTION_053_056_oPCAN_RADAR_24ea70b2_Tx: ComBitPosition=352, ComBitSize=8, ComSignalInitValue=128, ComSignalType=UINT8, ComSystemTemplateSystemSignalRef=DET_RCS_055
            DET_RCS_056_oRDR_DETECTION_053_056_oPCAN_RADAR_400a0b4c_Tx: ComBitPosition=464, ComBitSize=8, ComSignalInitValue=128, ComSignalType=UINT8, ComSystemTemplateSystemSignalRef=DET_RCS_056
            DET_SNR_053_oRDR_DETECTION_053_056_oPCAN_RADAR_3084d34c_Tx: ComBitPosition=120, ComBitSize=8, ComSignalInitValue=0, ComSignalType=UINT8, ComSystemTemplateSystemSignalRef=DET_SNR_053
            DET_SNR_054_oRDR_DETECTION_053_056_oPCAN_RADAR_6c34f025_Tx: ComBitPosition=232, ComBitSize=8, ComSignalInitValue=0, ComSignalType=UINT8, ComSystemTemplateSystemSignalRef=DET_SNR_054
            DET_SNR_055_oRDR_DETECTION_053_056_oPCAN_RADAR_f94424b0_Tx: ComBitPosition=344, ComBitSize=8, ComSignalInitValue=0, ComSignalType=UINT8, ComSystemTemplateSystemSignalRef=DET_SNR_055
            DET_SNR_056_oRDR_DETECTION_053_056_oPCAN_RADAR_9da45f4e_Tx: ComBitPosition=456, ComBitSize=8, ComSignalInitValue=0, ComSignalType=UINT8, ComSystemTemplateSystemSignalRef=DET_SNR_056
            DET_SUPER_RES_TARGET_053_oRDR_DETECTION_053_056_oPCAN_RADAR_011dfb29_Tx: ComBitPosition=87, ComBitSize=1, ComSignalInitValue=0, ComSignalType=BOOLEAN, ComSystemTemplateSystemSignalRef=DET_SUPER_RES_TARGET_053
            DET_SUPER_RES_TARGET_054_oRDR_DETECTION_053_056_oPCAN_RADAR_5dadd840_Tx: ComBitPosition=199, ComBitSize=1, ComSignalInitValue=0, ComSignalType=BOOLEAN, ComSystemTemplateSystemSignalRef=DET_SUPER_RES_TARGET_054
            DET_SUPER_RES_TARGET_055_oRDR_DETECTION_053_056_oPCAN_RADAR_c8dd0cd5_Tx: ComBitPosition=311, ComBitSize=1, ComSignalInitValue=0, ComSignalType=BOOLEAN, ComSystemTemplateSystemSignalRef=DET_SUPER_RES_TARGET_055
            DET_SUPER_RES_TARGET_056_oRDR_DETECTION_053_056_oPCAN_RADAR_ac3d772b_Tx: ComBitPosition=423, ComBitSize=1, ComSignalInitValue=0, ComSignalType=BOOLEAN, ComSystemTemplateSystemSignalRef=DET_SUPER_RES_TARGET_056
        SG_Detections_057_060_oRDR_DETECTION_057_060_oPCAN_RADAR_83bdfb8a_Tx: ComSystemTemplateSignalGroupRef=SG_Detections_057_060
          83 x ComGroupSignal, all with ComSignalEndianness=LITTLE_ENDIAN, ComTransferProperty=PENDING:
            DET_AZIMUTH_057_oRDR_DETECTION_057_060_oPCAN_RADAR_984b84d4_Tx: ComBitPosition=88, ComBitSize=13, ComSignalInitValue=0, ComSignalType=UINT16, ComSystemTemplateSystemSignalRef=DET_AZIMUTH_057
            DET_AZIMUTH_058_oRDR_DETECTION_057_060_oPCAN_RADAR_b45b1693_Tx: ComBitPosition=200, ComBitSize=13, ComSignalInitValue=0, ComSignalType=UINT16, ComSystemTemplateSystemSignalRef=DET_AZIMUTH_058
            DET_AZIMUTH_059_oRDR_DETECTION_057_060_oPCAN_RADAR_212bc206_Tx: ComBitPosition=312, ComBitSize=13, ComSignalInitValue=0, ComSignalType=UINT16, ComSystemTemplateSystemSignalRef=DET_AZIMUTH_059
            DET_AZIMUTH_060_oRDR_DETECTION_057_060_oPCAN_RADAR_9e9a98dd_Tx: ComBitPosition=424, ComBitSize=13, ComSignalInitValue=0, ComSignalType=UINT16, ComSystemTemplateSystemSignalRef=DET_AZIMUTH_060
            DET_AZIMUTH_ERR_057_oRDR_DETECTION_057_060_oPCAN_RADAR_3cfe1121_Tx: ComBitPosition=105, ComBitSize=7, ComSignalInitValue=0, ComSignalType=UINT8, ComSystemTemplateSystemSignalRef=DET_AZIMUTH_ERR_057
            DET_AZIMUTH_ERR_058_oRDR_DETECTION_057_060_oPCAN_RADAR_10ee8366_Tx: ComBitPosition=217, ComBitSize=7, ComSignalInitValue=0, ComSignalType=UINT8, ComSystemTemplateSystemSignalRef=DET_AZIMUTH_ERR_058
            DET_AZIMUTH_ERR_059_oRDR_DETECTION_057_060_oPCAN_RADAR_859e57f3_Tx: ComBitPosition=329, ComBitSize=7, ComSignalInitValue=0, ComSignalType=UINT8, ComSystemTemplateSystemSignalRef=DET_AZIMUTH_ERR_059
            DET_AZIMUTH_ERR_060_oRDR_DETECTION_057_060_oPCAN_RADAR_3a2f0d28_Tx: ComBitPosition=441, ComBitSize=7, ComSignalInitValue=0, ComSignalType=UINT8, ComSystemTemplateSystemSignalRef=DET_AZIMUTH_ERR_060
            DET_BELOW_RAIN_THOLD_057_oRDR_DETECTION_057_060_oPCAN_RADAR_4d4a1714_Tx: ComBitPosition=39, ComBitSize=1, ComSignalInitValue=0, ComSignalType=BOOLEAN, ComSystemTemplateSystemSignalRef=DET_BELOW_RAIN_THOLD_057
            DET_BELOW_RAIN_THOLD_058_oRDR_DETECTION_057_060_oPCAN_RADAR_615a8553_Tx: ComBitPosition=151, ComBitSize=1, ComSignalInitValue=0, ComSignalType=BOOLEAN, ComSystemTemplateSystemSignalRef=DET_BELOW_RAIN_THOLD_058
            DET_BELOW_RAIN_THOLD_059_oRDR_DETECTION_057_060_oPCAN_RADAR_f42a51c6_Tx: ComBitPosition=263, ComBitSize=1, ComSignalInitValue=0, ComSignalType=BOOLEAN, ComSystemTemplateSystemSignalRef=DET_BELOW_RAIN_THOLD_059
            DET_BELOW_RAIN_THOLD_060_oRDR_DETECTION_057_060_oPCAN_RADAR_4b9b0b1d_Tx: ComBitPosition=375, ComBitSize=1, ComSignalInitValue=0, ComSignalType=BOOLEAN, ComSystemTemplateSystemSignalRef=DET_BELOW_RAIN_THOLD_060
            DET_BI_STATIC_FLAG_057_oRDR_DETECTION_057_060_oPCAN_RADAR_ce67c451_Tx: ComBitPosition=104, ComBitSize=1, ComSignalInitValue=0, ComSignalType=BOOLEAN, ComSystemTemplateSystemSignalRef=DET_BI_STATIC_FLAG_057
            DET_BI_STATIC_FLAG_058_oRDR_DETECTION_057_060_oPCAN_RADAR_e2775616_Tx: ComBitPosition=216, ComBitSize=1, ComSignalInitValue=0, ComSignalType=BOOLEAN, ComSystemTemplateSystemSignalRef=DET_BI_STATIC_FLAG_058
            DET_BI_STATIC_FLAG_059_oRDR_DETECTION_057_060_oPCAN_RADAR_77078283_Tx: ComBitPosition=328, ComBitSize=1, ComSignalInitValue=0, ComSignalType=BOOLEAN, ComSystemTemplateSystemSignalRef=DET_BI_STATIC_FLAG_059
            DET_BI_STATIC_FLAG_060_oRDR_DETECTION_057_060_oPCAN_RADAR_c8b6d858_Tx: ComBitPosition=440, ComBitSize=1, ComSignalInitValue=0, ComSignalType=BOOLEAN, ComSystemTemplateSystemSignalRef=DET_BI_STATIC_FLAG_060
            DET_CONFD_AZIMUTH_057_oRDR_DETECTION_057_060_oPCAN_RADAR_9aad8e1e_Tx: ComBitPosition=118, ComBitSize=2, ComSignalInitValue=0, ComSignalType=UINT8, ComSystemTemplateSystemSignalRef=DET_CONFD_AZIMUTH_057
            DET_CONFD_AZIMUTH_058_oRDR_DETECTION_057_060_oPCAN_RADAR_b6bd1c59_Tx: ComBitPosition=230, ComBitSize=2, ComSignalInitValue=0, ComSignalType=UINT8, ComSystemTemplateSystemSignalRef=DET_CONFD_AZIMUTH_058
            DET_CONFD_AZIMUTH_059_oRDR_DETECTION_057_060_oPCAN_RADAR_23cdc8cc_Tx: ComBitPosition=342, ComBitSize=2, ComSignalInitValue=0, ComSignalType=UINT8, ComSystemTemplateSystemSignalRef=DET_CONFD_AZIMUTH_059
            DET_CONFD_AZIMUTH_060_oRDR_DETECTION_057_060_oPCAN_RADAR_9c7c9217_Tx: ComBitPosition=454, ComBitSize=2, ComSignalInitValue=0, ComSignalType=UINT8, ComSystemTemplateSystemSignalRef=DET_CONFD_AZIMUTH_060
            DET_CONFD_ELEVATION_057_oRDR_DETECTION_057_060_oPCAN_RADAR_98388fe4_Tx: ComBitPosition=101, ComBitSize=2, ComSignalInitValue=0, ComSignalType=UINT8, ComSystemTemplateSystemSignalRef=DET_CONFD_ELEVATION_057
            DET_CONFD_ELEVATION_058_oRDR_DETECTION_057_060_oPCAN_RADAR_b4281da3_Tx: ComBitPosition=213, ComBitSize=2, ComSignalInitValue=0, ComSignalType=UINT8, ComSystemTemplateSystemSignalRef=DET_CONFD_ELEVATION_058
            DET_CONFD_ELEVATION_059_oRDR_DETECTION_057_060_oPCAN_RADAR_2158c936_Tx: ComBitPosition=325, ComBitSize=2, ComSignalInitValue=0, ComSignalType=UINT8, ComSystemTemplateSystemSignalRef=DET_CONFD_ELEVATION_059
            DET_CONFD_ELEVATION_060_oRDR_DETECTION_057_060_oPCAN_RADAR_9ee993ed_Tx: ComBitPosition=437, ComBitSize=2, ComSignalInitValue=0, ComSignalType=UINT8, ComSystemTemplateSystemSignalRef=DET_CONFD_ELEVATION_060
            DET_ELEVATION_057_oRDR_DETECTION_057_060_oPCAN_RADAR_49f85bd8_Tx: ComBitPosition=72, ComBitSize=8, ComSignalInitValue=0, ComSignalType=UINT8, ComSystemTemplateSystemSignalRef=DET_ELEVATION_057
            DET_ELEVATION_058_oRDR_DETECTION_057_060_oPCAN_RADAR_65e8c99f_Tx: ComBitPosition=184, ComBitSize=8, ComSignalInitValue=0, ComSignalType=UINT8, ComSystemTemplateSystemSignalRef=DET_ELEVATION_058
            DET_ELEVATION_059_oRDR_DETECTION_057_060_oPCAN_RADAR_f0981d0a_Tx: ComBitPosition=296, ComBitSize=8, ComSignalInitValue=0, ComSignalType=UINT8, ComSystemTemplateSystemSignalRef=DET_ELEVATION_059
            DET_ELEVATION_060_oRDR_DETECTION_057_060_oPCAN_RADAR_4f2947d1_Tx: ComBitPosition=408, ComBitSize=8, ComSignalInitValue=0, ComSignalType=UINT8, ComSystemTemplateSystemSignalRef=DET_ELEVATION_060
            DET_ELEVATION_ERR_057_oRDR_DETECTION_057_060_oPCAN_RADAR_cec1c3ad_Tx: ComBitPosition=80, ComBitSize=6, ComSignalInitValue=0, ComSignalType=UINT8, ComSystemTemplateSystemSignalRef=DET_ELEVATION_ERR_057
            DET_ELEVATION_ERR_058_oRDR_DETECTION_057_060_oPCAN_RADAR_e2d151ea_Tx: ComBitPosition=192, ComBitSize=6, ComSignalInitValue=0, ComSignalType=UINT8, ComSystemTemplateSystemSignalRef=DET_ELEVATION_ERR_058
            DET_ELEVATION_ERR_059_oRDR_DETECTION_057_060_oPCAN_RADAR_77a1857f_Tx: ComBitPosition=304, ComBitSize=6, ComSignalInitValue=0, ComSignalType=UINT8, ComSystemTemplateSystemSignalRef=DET_ELEVATION_ERR_059
            DET_ELEVATION_ERR_060_oRDR_DETECTION_057_060_oPCAN_RADAR_c810dfa4_Tx: ComBitPosition=416, ComBitSize=6, ComSignalInitValue=0, ComSignalType=UINT8, ComSystemTemplateSystemSignalRef=DET_ELEVATION_ERR_060
            DET_EXISTENCE_PROB_057_oRDR_DETECTION_057_060_oPCAN_RADAR_1c5eb6cd_Tx: ComBitPosition=112, ComBitSize=6, ComSignalInitValue=0, ComSignalType=UINT8, ComSystemTemplateSystemSignalRef=DET_EXISTENCE_PROB_057
            DET_EXISTENCE_PROB_058_oRDR_DETECTION_057_060_oPCAN_RADAR_304e248a_Tx: ComBitPosition=224, ComBitSize=6, ComSignalInitValue=0, ComSignalType=UINT8, ComSystemTemplateSystemSignalRef=DET_EXISTENCE_PROB_058
            DET_EXISTENCE_PROB_059_oRDR_DETECTION_057_060_oPCAN_RADAR_a53ef01f_Tx: ComBitPosition=336, ComBitSize=6, ComSignalInitValue=0, ComSignalType=UINT8, ComSystemTemplateSystemSignalRef=DET_EXISTENCE_PROB_059
            DET_EXISTENCE_PROB_060_oRDR_DETECTION_057_060_oPCAN_RADAR_1a8faac4_Tx: ComBitPosition=448, ComBitSize=6, ComSignalInitValue=0, ComSignalType=UINT8, ComSystemTemplateSystemSignalRef=DET_EXISTENCE_PROB_060
            DET_HVC_FLAG_057_oRDR_DETECTION_057_060_oPCAN_RADAR_fd2af5b2_Tx: ComBitPosition=86, ComBitSize=1, ComSignalInitValue=0, ComSignalType=BOOLEAN, ComSystemTemplateSystemSignalRef=DET_HVC_FLAG_057
            DET_HVC_FLAG_058_oRDR_DETECTION_057_060_oPCAN_RADAR_d13a67f5_Tx: ComBitPosition=198, ComBitSize=1, ComSignalInitValue=0, ComSignalType=BOOLEAN, ComSystemTemplateSystemSignalRef=DET_HVC_FLAG_058
            DET_HVC_FLAG_059_oRDR_DETECTION_057_060_oPCAN_RADAR_444ab360_Tx: ComBitPosition=310, ComBitSize=1, ComSignalInitValue=0, ComSignalType=BOOLEAN, ComSystemTemplateSystemSignalRef=DET_HVC_FLAG_059
            DET_HVC_FLAG_060_oRDR_DETECTION_057_060_oPCAN_RADAR_fbfbe9bb_Tx: ComBitPosition=422, ComBitSize=1, ComSignalInitValue=0, ComSignalType=BOOLEAN, ComSystemTemplateSystemSignalRef=DET_HVC_FLAG_060
            DET_IDM_057_oRDR_DETECTION_057_060_oPCAN_RADAR_7678ce0f_Tx: ComBitPosition=63, ComBitSize=1, ComSignalInitValue=0, ComSignalType=BOOLEAN, ComSystemTemplateSystemSignalRef=DET_IDM_057
            DET_IDM_058_oRDR_DETECTION_057_060_oPCAN_RADAR_5a685c48_Tx: ComBitPosition=175, ComBitSize=1, ComSignalInitValue=0, ComSignalType=BOOLEAN, ComSystemTemplateSystemSignalRef=DET_IDM_058
            DET_IDM_059_oRDR_DETECTION_057_060_oPCAN_RADAR_cf1888dd_Tx: ComBitPosition=287, ComBitSize=1, ComSignalInitValue=0, ComSignalType=BOOLEAN, ComSystemTemplateSystemSignalRef=DET_IDM_059
            DET_IDM_060_oRDR_DETECTION_057_060_oPCAN_RADAR_70a9d206_Tx: ComBitPosition=399, ComBitSize=1, ComSignalInitValue=0, ComSignalType=BOOLEAN, ComSystemTemplateSystemSignalRef=DET_IDM_060
            DET_MH_CRC16_057_060_oRDR_DETECTION_057_060_oPCAN_RADAR_07352981_Tx: ComBitPosition=0, ComBitSize=16, ComSignalInitValue=0, ComSignalType=UINT16, ComSystemTemplateSystemSignalRef=DET_MH_CRC16_057_060
            DET_MH_CYCLE_COUNTER_057_060_oRDR_DETECTION_057_060_oPCAN_RADAR_834088b6_Tx: ComBitPosition=16, ComBitSize=8, ComSignalInitValue=0, ComSignalType=UINT8, ComSystemTemplateSystemSignalRef=DET_MH_CYCLE_COUNTER_057_060
            DET_MH_SCAN_INDEX_4LSB_057_060_oRDR_DETECTION_057_060_oPCAN_RADAR_4f6aad3a_Tx: ComBitPosition=476, ComBitSize=4, ComSignalInitValue=0, ComSignalType=UINT8, ComSystemTemplateSystemSignalRef=DET_MH_SCAN_INDEX_4LSB_057_060
            DET_MTD_057_oRDR_DETECTION_057_060_oPCAN_RADAR_10cbfcd4_Tx: ComBitPosition=47, ComBitSize=1, ComSignalInitValue=0, ComSignalType=BOOLEAN, ComSystemTemplateSystemSignalRef=DET_MTD_057
            DET_MTD_058_oRDR_DETECTION_057_060_oPCAN_RADAR_3cdb6e93_Tx: ComBitPosition=159, ComBitSize=1, ComSignalInitValue=0, ComSignalType=BOOLEAN, ComSystemTemplateSystemSignalRef=DET_MTD_058
            DET_MTD_059_oRDR_DETECTION_057_060_oPCAN_RADAR_a9abba06_Tx: ComBitPosition=271, ComBitSize=1, ComSignalInitValue=0, ComSignalType=BOOLEAN, ComSystemTemplateSystemSignalRef=DET_MTD_059
            DET_MTD_060_oRDR_DETECTION_057_060_oPCAN_RADAR_161ae0dd_Tx: ComBitPosition=383, ComBitSize=1, ComSignalInitValue=0, ComSignalType=BOOLEAN, ComSystemTemplateSystemSignalRef=DET_MTD_060
            DET_PROB_1STAZHYPO_057_oRDR_DETECTION_057_060_oPCAN_RADAR_837f1419_Tx: ComBitPosition=103, ComBitSize=1, ComSignalInitValue=0, ComSignalType=BOOLEAN, ComSystemTemplateSystemSignalRef=DET_PROB_1STAZHYPO_057
            DET_PROB_1STAZHYPO_058_oRDR_DETECTION_057_060_oPCAN_RADAR_af6f865e_Tx: ComBitPosition=215, ComBitSize=1, ComSignalInitValue=0, ComSignalType=BOOLEAN, ComSystemTemplateSystemSignalRef=DET_PROB_1STAZHYPO_058
            DET_PROB_1STAZHYPO_059_oRDR_DETECTION_057_060_oPCAN_RADAR_3a1f52cb_Tx: ComBitPosition=327, ComBitSize=1, ComSignalInitValue=0, ComSignalType=BOOLEAN, ComSystemTemplateSystemSignalRef=DET_PROB_1STAZHYPO_059
            DET_PROB_1STAZHYPO_060_oRDR_DETECTION_057_060_oPCAN_RADAR_85ae0810_Tx: ComBitPosition=439, ComBitSize=1, ComSignalInitValue=0, ComSignalType=BOOLEAN, ComSystemTemplateSystemSignalRef=DET_PROB_1STAZHYPO_060
            DET_RANGE_057_oRDR_DETECTION_057_060_oPCAN_RADAR_88d0f76f_Tx: ComBitPosition=24, ComBitSize=15, ComSignalInitValue=0, ComSignalType=UINT16, ComSystemTemplateSystemSignalRef=DET_RANGE_057
            DET_RANGE_058_oRDR_DETECTION_057_060_oPCAN_RADAR_a4c06528_Tx: ComBitPosition=136, ComBitSize=15, ComSignalInitValue=0, ComSignalType=UINT16, ComSystemTemplateSystemSignalRef=DET_RANGE_058
            DET_RANGE_059_oRDR_DETECTION_057_060_oPCAN_RADAR_31b0b1bd_Tx: ComBitPosition=248, ComBitSize=15, ComSignalInitValue=0, ComSignalType=UINT16, ComSystemTemplateSystemSignalRef=DET_RANGE_059
            DET_RANGE_060_oRDR_DETECTION_057_060_oPCAN_RADAR_8e01eb66_Tx: ComBitPosition=360, ComBitSize=15, ComSignalInitValue=0, ComSignalType=UINT16, ComSystemTemplateSystemSignalRef=DET_RANGE_060
            DET_RANGE_ERR_057_oRDR_DETECTION_057_060_oPCAN_RADAR_2f384d06_Tx: ComBitPosition=40, ComBitSize=7, ComSignalInitValue=0, ComSignalType=UINT8, ComSystemTemplateSystemSignalRef=DET_RANGE_ERR_057
            DET_RANGE_ERR_058_oRDR_DETECTION_057_060_oPCAN_RADAR_0328df41_Tx: ComBitPosition=152, ComBitSize=7, ComSignalInitValue=0, ComSignalType=UINT8, ComSystemTemplateSystemSignalRef=DET_RANGE_ERR_058
            DET_RANGE_ERR_059_oRDR_DETECTION_057_060_oPCAN_RADAR_96580bd4_Tx: ComBitPosition=264, ComBitSize=7, ComSignalInitValue=0, ComSignalType=UINT8, ComSystemTemplateSystemSignalRef=DET_RANGE_ERR_059
            DET_RANGE_ERR_060_oRDR_DETECTION_057_060_oPCAN_RADAR_29e9510f_Tx: ComBitPosition=376, ComBitSize=7, ComSignalInitValue=0, ComSignalType=UINT8, ComSystemTemplateSystemSignalRef=DET_RANGE_ERR_060
            DET_RANGE_VELOCITY_057_oRDR_DETECTION_057_060_oPCAN_RADAR_fd76354a_Tx: ComBitPosition=48, ComBitSize=15, ComSignalInitValue=16384, ComSignalType=UINT16, ComSystemTemplateSystemSignalRef=DET_RANGE_VELOCITY_057
            DET_RANGE_VELOCITY_058_oRDR_DETECTION_057_060_oPCAN_RADAR_d166a70d_Tx: ComBitPosition=160, ComBitSize=15, ComSignalInitValue=16384, ComSignalType=UINT16, ComSystemTemplateSystemSignalRef=DET_RANGE_VELOCITY_058
            DET_RANGE_VELOCITY_059_oRDR_DETECTION_057_060_oPCAN_RADAR_44167398_Tx: ComBitPosition=272, ComBitSize=15, ComSignalInitValue=16384, ComSignalType=UINT16, ComSystemTemplateSystemSignalRef=DET_RANGE_VELOCITY_059
            DET_RANGE_VELOCITY_060_oRDR_DETECTION_057_060_oPCAN_RADAR_fba72943_Tx: ComBitPosition=384, ComBitSize=15, ComSignalInitValue=16384, ComSignalType=UINT16, ComSystemTemplateSystemSignalRef=DET_RANGE_VELOCITY_060
            DET_RANGE_VELOCITY_ERR_057_oRDR_DETECTION_057_060_oPCAN_RADAR_f2cdcef8_Tx: ComBitPosition=64, ComBitSize=8, ComSignalInitValue=0, ComSignalType=UINT8, ComSystemTemplateSystemSignalRef=DET_RANGE_VELOCITY_ERR_057
            DET_RANGE_VELOCITY_ERR_058_oRDR_DETECTION_057_060_oPCAN_RADAR_dedd5cbf_Tx: ComBitPosition=176, ComBitSize=8, ComSignalInitValue=0, ComSignalType=UINT8, ComSystemTemplateSystemSignalRef=DET_RANGE_VELOCITY_ERR_058
            DET_RANGE_VELOCITY_ERR_059_oRDR_DETECTION_057_060_oPCAN_RADAR_4bad882a_Tx: ComBitPosition=288, ComBitSize=8, ComSignalInitValue=0, ComSignalType=UINT8, ComSystemTemplateSystemSignalRef=DET_RANGE_VELOCITY_ERR_059
            DET_RANGE_VELOCITY_ERR_060_oRDR_DETECTION_057_060_oPCAN_RADAR_f41cd2f1_Tx: ComBitPosition=400, ComBitSize=8, ComSignalInitValue=0, ComSignalType=UINT8, ComSystemTemplateSystemSignalRef=DET_RANGE_VELOCITY_ERR_060
            DET_RCS_057_oRDR_DETECTION_057_060_oPCAN_RADAR_7af60210_Tx: ComBitPosition=128, ComBitSize=8, ComSignalInitValue=128, ComSignalType=UINT8, ComSystemTemplateSystemSignalRef=DET_RCS_057
            DET_RCS_058_oRDR_DETECTION_057_060_oPCAN_RADAR_56e69057_Tx: ComBitPosition=240, ComBitSize=8, ComSignalInitValue=128, ComSignalType=UINT8, ComSystemTemplateSystemSignalRef=DET_RCS_058
            DET_RCS_059_oRDR_DETECTION_057_060_oPCAN_RADAR_c39644c2_Tx: ComBitPosition=352, ComBitSize=8, ComSignalInitValue=128, ComSignalType=UINT8, ComSystemTemplateSystemSignalRef=DET_RCS_059
            DET_RCS_060_oRDR_DETECTION_057_060_oPCAN_RADAR_7c271e19_Tx: ComBitPosition=464, ComBitSize=8, ComSignalInitValue=128, ComSignalType=UINT8, ComSystemTemplateSystemSignalRef=DET_RCS_060
            DET_SNR_057_oRDR_DETECTION_057_060_oPCAN_RADAR_a7585612_Tx: ComBitPosition=120, ComBitSize=8, ComSignalInitValue=0, ComSignalType=UINT8, ComSystemTemplateSystemSignalRef=DET_SNR_057
            DET_SNR_058_oRDR_DETECTION_057_060_oPCAN_RADAR_8b48c455_Tx: ComBitPosition=232, ComBitSize=8, ComSignalInitValue=0, ComSignalType=UINT8, ComSystemTemplateSystemSignalRef=DET_SNR_058
            DET_SNR_059_oRDR_DETECTION_057_060_oPCAN_RADAR_1e3810c0_Tx: ComBitPosition=344, ComBitSize=8, ComSignalInitValue=0, ComSignalType=UINT8, ComSystemTemplateSystemSignalRef=DET_SNR_059
            DET_SNR_060_oRDR_DETECTION_057_060_oPCAN_RADAR_a1894a1b_Tx: ComBitPosition=456, ComBitSize=8, ComSignalInitValue=0, ComSignalType=UINT8, ComSystemTemplateSystemSignalRef=DET_SNR_060
            DET_SUPER_RES_TARGET_057_oRDR_DETECTION_057_060_oPCAN_RADAR_96c17e77_Tx: ComBitPosition=87, ComBitSize=1, ComSignalInitValue=0, ComSignalType=BOOLEAN, ComSystemTemplateSystemSignalRef=DET_SUPER_RES_TARGET_057
            DET_SUPER_RES_TARGET_058_oRDR_DETECTION_057_060_oPCAN_RADAR_bad1ec30_Tx: ComBitPosition=199, ComBitSize=1, ComSignalInitValue=0, ComSignalType=BOOLEAN, ComSystemTemplateSystemSignalRef=DET_SUPER_RES_TARGET_058
            DET_SUPER_RES_TARGET_059_oRDR_DETECTION_057_060_oPCAN_RADAR_2fa138a5_Tx: ComBitPosition=311, ComBitSize=1, ComSignalInitValue=0, ComSignalType=BOOLEAN, ComSystemTemplateSystemSignalRef=DET_SUPER_RES_TARGET_059
            DET_SUPER_RES_TARGET_060_oRDR_DETECTION_057_060_oPCAN_RADAR_9010627e_Tx: ComBitPosition=423, ComBitSize=1, ComSignalInitValue=0, ComSignalType=BOOLEAN, ComSystemTemplateSystemSignalRef=DET_SUPER_RES_TARGET_060
        SG_Detections_061_064_oRDR_DETECTION_061_064_oPCAN_RADAR_80d67553_Tx: ComSystemTemplateSignalGroupRef=SG_Detections_061_064
          83 x ComGroupSignal, all with ComSignalEndianness=LITTLE_ENDIAN, ComTransferProperty=PENDING:
            DET_AZIMUTH_061_oRDR_DETECTION_061_064_oPCAN_RADAR_86e14cb4_Tx: ComBitPosition=88, ComBitSize=13, ComSignalInitValue=0, ComSignalType=UINT16, ComSystemTemplateSystemSignalRef=DET_AZIMUTH_061
            DET_AZIMUTH_062_oRDR_DETECTION_061_064_oPCAN_RADAR_e201374a_Tx: ComBitPosition=200, ComBitSize=13, ComSignalInitValue=0, ComSignalType=UINT16, ComSystemTemplateSystemSignalRef=DET_AZIMUTH_062
            DET_AZIMUTH_063_oRDR_DETECTION_061_064_oPCAN_RADAR_7771e3df_Tx: ComBitPosition=312, ComBitSize=13, ComSignalInitValue=0, ComSignalType=UINT16, ComSystemTemplateSystemSignalRef=DET_AZIMUTH_063
            DET_AZIMUTH_064_oRDR_DETECTION_061_064_oPCAN_RADAR_2bc1c0b6_Tx: ComBitPosition=424, ComBitSize=13, ComSignalInitValue=0, ComSignalType=UINT16, ComSystemTemplateSystemSignalRef=DET_AZIMUTH_064
            DET_AZIMUTH_ERR_061_oRDR_DETECTION_061_064_oPCAN_RADAR_2254d941_Tx: ComBitPosition=105, ComBitSize=7, ComSignalInitValue=0, ComSignalType=UINT8, ComSystemTemplateSystemSignalRef=DET_AZIMUTH_ERR_061
            DET_AZIMUTH_ERR_062_oRDR_DETECTION_061_064_oPCAN_RADAR_46b4a2bf_Tx: ComBitPosition=217, ComBitSize=7, ComSignalInitValue=0, ComSignalType=UINT8, ComSystemTemplateSystemSignalRef=DET_AZIMUTH_ERR_062
            DET_AZIMUTH_ERR_063_oRDR_DETECTION_061_064_oPCAN_RADAR_d3c4762a_Tx: ComBitPosition=329, ComBitSize=7, ComSignalInitValue=0, ComSignalType=UINT8, ComSystemTemplateSystemSignalRef=DET_AZIMUTH_ERR_063
            DET_AZIMUTH_ERR_064_oRDR_DETECTION_061_064_oPCAN_RADAR_8f745543_Tx: ComBitPosition=441, ComBitSize=7, ComSignalInitValue=0, ComSignalType=UINT8, ComSystemTemplateSystemSignalRef=DET_AZIMUTH_ERR_064
            DET_BELOW_RAIN_THOLD_061_oRDR_DETECTION_061_064_oPCAN_RADAR_53e0df74_Tx: ComBitPosition=39, ComBitSize=1, ComSignalInitValue=0, ComSignalType=BOOLEAN, ComSystemTemplateSystemSignalRef=DET_BELOW_RAIN_THOLD_061
            DET_BELOW_RAIN_THOLD_062_oRDR_DETECTION_061_064_oPCAN_RADAR_3700a48a_Tx: ComBitPosition=151, ComBitSize=1, ComSignalInitValue=0, ComSignalType=BOOLEAN, ComSystemTemplateSystemSignalRef=DET_BELOW_RAIN_THOLD_062
            DET_BELOW_RAIN_THOLD_063_oRDR_DETECTION_061_064_oPCAN_RADAR_a270701f_Tx: ComBitPosition=263, ComBitSize=1, ComSignalInitValue=0, ComSignalType=BOOLEAN, ComSystemTemplateSystemSignalRef=DET_BELOW_RAIN_THOLD_063
            DET_BELOW_RAIN_THOLD_064_oRDR_DETECTION_061_064_oPCAN_RADAR_fec05376_Tx: ComBitPosition=375, ComBitSize=1, ComSignalInitValue=0, ComSignalType=BOOLEAN, ComSystemTemplateSystemSignalRef=DET_BELOW_RAIN_THOLD_064
            DET_BI_STATIC_FLAG_061_oRDR_DETECTION_061_064_oPCAN_RADAR_d0cd0c31_Tx: ComBitPosition=104, ComBitSize=1, ComSignalInitValue=0, ComSignalType=BOOLEAN, ComSystemTemplateSystemSignalRef=DET_BI_STATIC_FLAG_061
            DET_BI_STATIC_FLAG_062_oRDR_DETECTION_061_064_oPCAN_RADAR_b42d77cf_Tx: ComBitPosition=216, ComBitSize=1, ComSignalInitValue=0, ComSignalType=BOOLEAN, ComSystemTemplateSystemSignalRef=DET_BI_STATIC_FLAG_062
            DET_BI_STATIC_FLAG_063_oRDR_DETECTION_061_064_oPCAN_RADAR_215da35a_Tx: ComBitPosition=328, ComBitSize=1, ComSignalInitValue=0, ComSignalType=BOOLEAN, ComSystemTemplateSystemSignalRef=DET_BI_STATIC_FLAG_063
            DET_BI_STATIC_FLAG_064_oRDR_DETECTION_061_064_oPCAN_RADAR_7ded8033_Tx: ComBitPosition=440, ComBitSize=1, ComSignalInitValue=0, ComSignalType=BOOLEAN, ComSystemTemplateSystemSignalRef=DET_BI_STATIC_FLAG_064
            DET_CONFD_AZIMUTH_061_oRDR_DETECTION_061_064_oPCAN_RADAR_8407467e_Tx: ComBitPosition=118, ComBitSize=2, ComSignalInitValue=0, ComSignalType=UINT8, ComSystemTemplateSystemSignalRef=DET_CONFD_AZIMUTH_061
            DET_CONFD_AZIMUTH_062_oRDR_DETECTION_061_064_oPCAN_RADAR_e0e73d80_Tx: ComBitPosition=230, ComBitSize=2, ComSignalInitValue=0, ComSignalType=UINT8, ComSystemTemplateSystemSignalRef=DET_CONFD_AZIMUTH_062
            DET_CONFD_AZIMUTH_063_oRDR_DETECTION_061_064_oPCAN_RADAR_7597e915_Tx: ComBitPosition=342, ComBitSize=2, ComSignalInitValue=0, ComSignalType=UINT8, ComSystemTemplateSystemSignalRef=DET_CONFD_AZIMUTH_063
            DET_CONFD_AZIMUTH_064_oRDR_DETECTION_061_064_oPCAN_RADAR_2927ca7c_Tx: ComBitPosition=454, ComBitSize=2, ComSignalInitValue=0, ComSignalType=UINT8, ComSystemTemplateSystemSignalRef=DET_CONFD_AZIMUTH_064
            DET_CONFD_ELEVATION_061_oRDR_DETECTION_061_064_oPCAN_RADAR_86924784_Tx: ComBitPosition=101, ComBitSize=2, ComSignalInitValue=0, ComSignalType=UINT8, ComSystemTemplateSystemSignalRef=DET_CONFD_ELEVATION_061
            DET_CONFD_ELEVATION_062_oRDR_DETECTION_061_064_oPCAN_RADAR_e2723c7a_Tx: ComBitPosition=213, ComBitSize=2, ComSignalInitValue=0, ComSignalType=UINT8, ComSystemTemplateSystemSignalRef=DET_CONFD_ELEVATION_062
            DET_CONFD_ELEVATION_063_oRDR_DETECTION_061_064_oPCAN_RADAR_7702e8ef_Tx: ComBitPosition=325, ComBitSize=2, ComSignalInitValue=0, ComSignalType=UINT8, ComSystemTemplateSystemSignalRef=DET_CONFD_ELEVATION_063
            DET_CONFD_ELEVATION_064_oRDR_DETECTION_061_064_oPCAN_RADAR_2bb2cb86_Tx: ComBitPosition=437, ComBitSize=2, ComSignalInitValue=0, ComSignalType=UINT8, ComSystemTemplateSystemSignalRef=DET_CONFD_ELEVATION_064
            DET_ELEVATION_061_oRDR_DETECTION_061_064_oPCAN_RADAR_575293b8_Tx: ComBitPosition=72, ComBitSize=8, ComSignalInitValue=0, ComSignalType=UINT8, ComSystemTemplateSystemSignalRef=DET_ELEVATION_061
            DET_ELEVATION_062_oRDR_DETECTION_061_064_oPCAN_RADAR_33b2e846_Tx: ComBitPosition=184, ComBitSize=8, ComSignalInitValue=0, ComSignalType=UINT8, ComSystemTemplateSystemSignalRef=DET_ELEVATION_062
            DET_ELEVATION_063_oRDR_DETECTION_061_064_oPCAN_RADAR_a6c23cd3_Tx: ComBitPosition=296, ComBitSize=8, ComSignalInitValue=0, ComSignalType=UINT8, ComSystemTemplateSystemSignalRef=DET_ELEVATION_063
            DET_ELEVATION_064_oRDR_DETECTION_061_064_oPCAN_RADAR_fa721fba_Tx: ComBitPosition=408, ComBitSize=8, ComSignalInitValue=0, ComSignalType=UINT8, ComSystemTemplateSystemSignalRef=DET_ELEVATION_064
            DET_ELEVATION_ERR_061_oRDR_DETECTION_061_064_oPCAN_RADAR_d06b0bcd_Tx: ComBitPosition=80, ComBitSize=6, ComSignalInitValue=0, ComSignalType=UINT8, ComSystemTemplateSystemSignalRef=DET_ELEVATION_ERR_061
            DET_ELEVATION_ERR_062_oRDR_DETECTION_061_064_oPCAN_RADAR_b48b7033_Tx: ComBitPosition=192, ComBitSize=6, ComSignalInitValue=0, ComSignalType=UINT8, ComSystemTemplateSystemSignalRef=DET_ELEVATION_ERR_062
            DET_ELEVATION_ERR_063_oRDR_DETECTION_061_064_oPCAN_RADAR_21fba4a6_Tx: ComBitPosition=304, ComBitSize=6, ComSignalInitValue=0, ComSignalType=UINT8, ComSystemTemplateSystemSignalRef=DET_ELEVATION_ERR_063
            DET_ELEVATION_ERR_064_oRDR_DETECTION_061_064_oPCAN_RADAR_7d4b87cf_Tx: ComBitPosition=416, ComBitSize=6, ComSignalInitValue=0, ComSignalType=UINT8, ComSystemTemplateSystemSignalRef=DET_ELEVATION_ERR_064
            DET_EXISTENCE_PROB_061_oRDR_DETECTION_061_064_oPCAN_RADAR_02f47ead_Tx: ComBitPosition=112, ComBitSize=6, ComSignalInitValue=0, ComSignalType=UINT8, ComSystemTemplateSystemSignalRef=DET_EXISTENCE_PROB_061
            DET_EXISTENCE_PROB_062_oRDR_DETECTION_061_064_oPCAN_RADAR_66140553_Tx: ComBitPosition=224, ComBitSize=6, ComSignalInitValue=0, ComSignalType=UINT8, ComSystemTemplateSystemSignalRef=DET_EXISTENCE_PROB_062
            DET_EXISTENCE_PROB_063_oRDR_DETECTION_061_064_oPCAN_RADAR_f364d1c6_Tx: ComBitPosition=336, ComBitSize=6, ComSignalInitValue=0, ComSignalType=UINT8, ComSystemTemplateSystemSignalRef=DET_EXISTENCE_PROB_063
            DET_EXISTENCE_PROB_064_oRDR_DETECTION_061_064_oPCAN_RADAR_afd4f2af_Tx: ComBitPosition=448, ComBitSize=6, ComSignalInitValue=0, ComSignalType=UINT8, ComSystemTemplateSystemSignalRef=DET_EXISTENCE_PROB_064
            DET_HVC_FLAG_061_oRDR_DETECTION_061_064_oPCAN_RADAR_e3803dd2_Tx: ComBitPosition=86, ComBitSize=1, ComSignalInitValue=0, ComSignalType=BOOLEAN, ComSystemTemplateSystemSignalRef=DET_HVC_FLAG_061
            DET_HVC_FLAG_062_oRDR_DETECTION_061_064_oPCAN_RADAR_8760462c_Tx: ComBitPosition=198, ComBitSize=1, ComSignalInitValue=0, ComSignalType=BOOLEAN, ComSystemTemplateSystemSignalRef=DET_HVC_FLAG_062
            DET_HVC_FLAG_063_oRDR_DETECTION_061_064_oPCAN_RADAR_121092b9_Tx: ComBitPosition=310, ComBitSize=1, ComSignalInitValue=0, ComSignalType=BOOLEAN, ComSystemTemplateSystemSignalRef=DET_HVC_FLAG_063
            DET_HVC_FLAG_064_oRDR_DETECTION_061_064_oPCAN_RADAR_4ea0b1d0_Tx: ComBitPosition=422, ComBitSize=1, ComSignalInitValue=0, ComSignalType=BOOLEAN, ComSystemTemplateSystemSignalRef=DET_HVC_FLAG_064
            DET_IDM_061_oRDR_DETECTION_061_064_oPCAN_RADAR_68d2066f_Tx: ComBitPosition=63, ComBitSize=1, ComSignalInitValue=0, ComSignalType=BOOLEAN, ComSystemTemplateSystemSignalRef=DET_IDM_061
            DET_IDM_062_oRDR_DETECTION_061_064_oPCAN_RADAR_0c327d91_Tx: ComBitPosition=175, ComBitSize=1, ComSignalInitValue=0, ComSignalType=BOOLEAN, ComSystemTemplateSystemSignalRef=DET_IDM_062
            DET_IDM_063_oRDR_DETECTION_061_064_oPCAN_RADAR_9942a904_Tx: ComBitPosition=287, ComBitSize=1, ComSignalInitValue=0, ComSignalType=BOOLEAN, ComSystemTemplateSystemSignalRef=DET_IDM_063
            DET_IDM_064_oRDR_DETECTION_061_064_oPCAN_RADAR_c5f28a6d_Tx: ComBitPosition=399, ComBitSize=1, ComSignalInitValue=0, ComSignalType=BOOLEAN, ComSystemTemplateSystemSignalRef=DET_IDM_064
            DET_MH_CRC16_061_064_oRDR_DETECTION_061_064_oPCAN_RADAR_045ea758_Tx: ComBitPosition=0, ComBitSize=16, ComSignalInitValue=0, ComSignalType=UINT16, ComSystemTemplateSystemSignalRef=DET_MH_CRC16_061_064
            DET_MH_CYCLE_COUNTER_061_064_oRDR_DETECTION_061_064_oPCAN_RADAR_802b066f_Tx: ComBitPosition=16, ComBitSize=8, ComSignalInitValue=0, ComSignalType=UINT8, ComSystemTemplateSystemSignalRef=DET_MH_CYCLE_COUNTER_061_064
            DET_MH_SCAN_INDEX_4LSB_061_064_oRDR_DETECTION_061_064_oPCAN_RADAR_4c0123e3_Tx: ComBitPosition=476, ComBitSize=4, ComSignalInitValue=0, ComSignalType=UINT8, ComSystemTemplateSystemSignalRef=DET_MH_SCAN_INDEX_4LSB_061_064
            DET_MTD_061_oRDR_DETECTION_061_064_oPCAN_RADAR_0e6134b4_Tx: ComBitPosition=47, ComBitSize=1, ComSignalInitValue=0, ComSignalType=BOOLEAN, ComSystemTemplateSystemSignalRef=DET_MTD_061
            DET_MTD_062_oRDR_DETECTION_061_064_oPCAN_RADAR_6a814f4a_Tx: ComBitPosition=159, ComBitSize=1, ComSignalInitValue=0, ComSignalType=BOOLEAN, ComSystemTemplateSystemSignalRef=DET_MTD_062
            DET_MTD_063_oRDR_DETECTION_061_064_oPCAN_RADAR_fff19bdf_Tx: ComBitPosition=271, ComBitSize=1, ComSignalInitValue=0, ComSignalType=BOOLEAN, ComSystemTemplateSystemSignalRef=DET_MTD_063
            DET_MTD_064_oRDR_DETECTION_061_064_oPCAN_RADAR_a341b8b6_Tx: ComBitPosition=383, ComBitSize=1, ComSignalInitValue=0, ComSignalType=BOOLEAN, ComSystemTemplateSystemSignalRef=DET_MTD_064
            DET_PROB_1STAZHYPO_061_oRDR_DETECTION_061_064_oPCAN_RADAR_9dd5dc79_Tx: ComBitPosition=103, ComBitSize=1, ComSignalInitValue=0, ComSignalType=BOOLEAN, ComSystemTemplateSystemSignalRef=DET_PROB_1STAZHYPO_061
            DET_PROB_1STAZHYPO_062_oRDR_DETECTION_061_064_oPCAN_RADAR_f935a787_Tx: ComBitPosition=215, ComBitSize=1, ComSignalInitValue=0, ComSignalType=BOOLEAN, ComSystemTemplateSystemSignalRef=DET_PROB_1STAZHYPO_062
            DET_PROB_1STAZHYPO_063_oRDR_DETECTION_061_064_oPCAN_RADAR_6c457312_Tx: ComBitPosition=327, ComBitSize=1, ComSignalInitValue=0, ComSignalType=BOOLEAN, ComSystemTemplateSystemSignalRef=DET_PROB_1STAZHYPO_063
            DET_PROB_1STAZHYPO_064_oRDR_DETECTION_061_064_oPCAN_RADAR_30f5507b_Tx: ComBitPosition=439, ComBitSize=1, ComSignalInitValue=0, ComSignalType=BOOLEAN, ComSystemTemplateSystemSignalRef=DET_PROB_1STAZHYPO_064
            DET_RANGE_061_oRDR_DETECTION_061_064_oPCAN_RADAR_967a3f0f_Tx: ComBitPosition=24, ComBitSize=15, ComSignalInitValue=0, ComSignalType=UINT16, ComSystemTemplateSystemSignalRef=DET_RANGE_061
            DET_RANGE_062_oRDR_DETECTION_061_064_oPCAN_RADAR_f29a44f1_Tx: ComBitPosition=136, ComBitSize=15, ComSignalInitValue=0, ComSignalType=UINT16, ComSystemTemplateSystemSignalRef=DET_RANGE_062
            DET_RANGE_063_oRDR_DETECTION_061_064_oPCAN_RADAR_67ea9064_Tx: ComBitPosition=248, ComBitSize=15, ComSignalInitValue=0, ComSignalType=UINT16, ComSystemTemplateSystemSignalRef=DET_RANGE_063
            DET_RANGE_064_oRDR_DETECTION_061_064_oPCAN_RADAR_3b5ab30d_Tx: ComBitPosition=360, ComBitSize=15, ComSignalInitValue=0, ComSignalType=UINT16, ComSystemTemplateSystemSignalRef=DET_RANGE_064
            DET_RANGE_ERR_061_oRDR_DETECTION_061_064_oPCAN_RADAR_31928566_Tx: ComBitPosition=40, ComBitSize=7, ComSignalInitValue=0, ComSignalType=UINT8, ComSystemTemplateSystemSignalRef=DET_RANGE_ERR_061
            DET_RANGE_ERR_062_oRDR_DETECTION_061_064_oPCAN_RADAR_5572fe98_Tx: ComBitPosition=152, ComBitSize=7, ComSignalInitValue=0, ComSignalType=UINT8, ComSystemTemplateSystemSignalRef=DET_RANGE_ERR_062
            DET_RANGE_ERR_063_oRDR_DETECTION_061_064_oPCAN_RADAR_c0022a0d_Tx: ComBitPosition=264, ComBitSize=7, ComSignalInitValue=0, ComSignalType=UINT8, ComSystemTemplateSystemSignalRef=DET_RANGE_ERR_063
            DET_RANGE_ERR_064_oRDR_DETECTION_061_064_oPCAN_RADAR_9cb20964_Tx: ComBitPosition=376, ComBitSize=7, ComSignalInitValue=0, ComSignalType=UINT8, ComSystemTemplateSystemSignalRef=DET_RANGE_ERR_064
            DET_RANGE_VELOCITY_061_oRDR_DETECTION_061_064_oPCAN_RADAR_e3dcfd2a_Tx: ComBitPosition=48, ComBitSize=15, ComSignalInitValue=16384, ComSignalType=UINT16, ComSystemTemplateSystemSignalRef=DET_RANGE_VELOCITY_061
            DET_RANGE_VELOCITY_062_oRDR_DETECTION_061_064_oPCAN_RADAR_873c86d4_Tx: ComBitPosition=160, ComBitSize=15, ComSignalInitValue=16384, ComSignalType=UINT16, ComSystemTemplateSystemSignalRef=DET_RANGE_VELOCITY_062
            DET_RANGE_VELOCITY_063_oRDR_DETECTION_061_064_oPCAN_RADAR_124c5241_Tx: ComBitPosition=272, ComBitSize=15, ComSignalInitValue=16384, ComSignalType=UINT16, ComSystemTemplateSystemSignalRef=DET_RANGE_VELOCITY_063
            DET_RANGE_VELOCITY_064_oRDR_DETECTION_061_064_oPCAN_RADAR_4efc7128_Tx: ComBitPosition=384, ComBitSize=15, ComSignalInitValue=16384, ComSignalType=UINT16, ComSystemTemplateSystemSignalRef=DET_RANGE_VELOCITY_064
            DET_RANGE_VELOCITY_ERR_061_oRDR_DETECTION_061_064_oPCAN_RADAR_ec670698_Tx: ComBitPosition=64, ComBitSize=8, ComSignalInitValue=0, ComSignalType=UINT8, ComSystemTemplateSystemSignalRef=DET_RANGE_VELOCITY_ERR_061
            DET_RANGE_VELOCITY_ERR_062_oRDR_DETECTION_061_064_oPCAN_RADAR_88877d66_Tx: ComBitPosition=176, ComBitSize=8, ComSignalInitValue=0, ComSignalType=UINT8, ComSystemTemplateSystemSignalRef=DET_RANGE_VELOCITY_ERR_062
            DET_RANGE_VELOCITY_ERR_063_oRDR_DETECTION_061_064_oPCAN_RADAR_1df7a9f3_Tx: ComBitPosition=288, ComBitSize=8, ComSignalInitValue=0, ComSignalType=UINT8, ComSystemTemplateSystemSignalRef=DET_RANGE_VELOCITY_ERR_063
            DET_RANGE_VELOCITY_ERR_064_oRDR_DETECTION_061_064_oPCAN_RADAR_41478a9a_Tx: ComBitPosition=400, ComBitSize=8, ComSignalInitValue=0, ComSignalType=UINT8, ComSystemTemplateSystemSignalRef=DET_RANGE_VELOCITY_ERR_064
            DET_RCS_061_oRDR_DETECTION_061_064_oPCAN_RADAR_645cca70_Tx: ComBitPosition=128, ComBitSize=8, ComSignalInitValue=128, ComSignalType=UINT8, ComSystemTemplateSystemSignalRef=DET_RCS_061
            DET_RCS_062_oRDR_DETECTION_061_064_oPCAN_RADAR_00bcb18e_Tx: ComBitPosition=240, ComBitSize=8, ComSignalInitValue=128, ComSignalType=UINT8, ComSystemTemplateSystemSignalRef=DET_RCS_062
            DET_RCS_063_oRDR_DETECTION_061_064_oPCAN_RADAR_95cc651b_Tx: ComBitPosition=352, ComBitSize=8, ComSignalInitValue=128, ComSignalType=UINT8, ComSystemTemplateSystemSignalRef=DET_RCS_063
            DET_RCS_064_oRDR_DETECTION_061_064_oPCAN_RADAR_c97c4672_Tx: ComBitPosition=464, ComBitSize=8, ComSignalInitValue=128, ComSignalType=UINT8, ComSystemTemplateSystemSignalRef=DET_RCS_064
            DET_SNR_061_oRDR_DETECTION_061_064_oPCAN_RADAR_b9f29e72_Tx: ComBitPosition=120, ComBitSize=8, ComSignalInitValue=0, ComSignalType=UINT8, ComSystemTemplateSystemSignalRef=DET_SNR_061
            DET_SNR_062_oRDR_DETECTION_061_064_oPCAN_RADAR_dd12e58c_Tx: ComBitPosition=232, ComBitSize=8, ComSignalInitValue=0, ComSignalType=UINT8, ComSystemTemplateSystemSignalRef=DET_SNR_062
            DET_SNR_063_oRDR_DETECTION_061_064_oPCAN_RADAR_48623119_Tx: ComBitPosition=344, ComBitSize=8, ComSignalInitValue=0, ComSignalType=UINT8, ComSystemTemplateSystemSignalRef=DET_SNR_063
            DET_SNR_064_oRDR_DETECTION_061_064_oPCAN_RADAR_14d21270_Tx: ComBitPosition=456, ComBitSize=8, ComSignalInitValue=0, ComSignalType=UINT8, ComSystemTemplateSystemSignalRef=DET_SNR_064
            DET_SUPER_RES_TARGET_061_oRDR_DETECTION_061_064_oPCAN_RADAR_886bb617_Tx: ComBitPosition=87, ComBitSize=1, ComSignalInitValue=0, ComSignalType=BOOLEAN, ComSystemTemplateSystemSignalRef=DET_SUPER_RES_TARGET_061
            DET_SUPER_RES_TARGET_062_oRDR_DETECTION_061_064_oPCAN_RADAR_ec8bcde9_Tx: ComBitPosition=199, ComBitSize=1, ComSignalInitValue=0, ComSignalType=BOOLEAN, ComSystemTemplateSystemSignalRef=DET_SUPER_RES_TARGET_062
            DET_SUPER_RES_TARGET_063_oRDR_DETECTION_061_064_oPCAN_RADAR_79fb197c_Tx: ComBitPosition=311, ComBitSize=1, ComSignalInitValue=0, ComSignalType=BOOLEAN, ComSystemTemplateSystemSignalRef=DET_SUPER_RES_TARGET_063
            DET_SUPER_RES_TARGET_064_oRDR_DETECTION_061_064_oPCAN_RADAR_254b3a15_Tx: ComBitPosition=423, ComBitSize=1, ComSignalInitValue=0, ComSignalType=BOOLEAN, ComSystemTemplateSystemSignalRef=DET_SUPER_RES_TARGET_064
