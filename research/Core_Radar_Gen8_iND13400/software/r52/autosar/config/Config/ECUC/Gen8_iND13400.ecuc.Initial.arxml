[part 13 of 24: package /InitialEcuC]
AUTOSAR XML (schema 00053)
package /InitialEcuC  (continued)
  module config Com  (continued)
    ComConfig  (continued)
      242 x ComSignalGroup, all with ComTransferProperty=PENDING:  (continued)
        SG_Detections_329_332_oRDR_DETECTION_329_332_oPCAN_RADAR_c57c421a_Tx: ComSystemTemplateSignalGroupRef=SG_Detections_329_332
          83 x ComGroupSignal, all with ComSignalEndianness=LITTLE_ENDIAN, ComTransferProperty=PENDING:
            DET_AZIMUTH_329_oRDR_DETECTION_329_332_oPCAN_RADAR_ae2f6eba_Tx: ComBitPosition=88, ComBitSize=13, ComSignalInitValue=0, ComSignalType=UINT16, ComSystemTemplateSystemSignalRef=DET_AZIMUTH_329
            DET_AZIMUTH_330_oRDR_DETECTION_329_332_oPCAN_RADAR_cb0f1c1e_Tx: ComBitPosition=200, ComBitSize=13, ComSignalInitValue=0, ComSignalType=UINT16, ComSystemTemplateSystemSignalRef=DET_AZIMUTH_330
            DET_AZIMUTH_331_oRDR_DETECTION_329_332_oPCAN_RADAR_5e7fc88b_Tx: ComBitPosition=312, ComBitSize=13, ComSignalInitValue=0, ComSignalType=UINT16, ComSystemTemplateSystemSignalRef=DET_AZIMUTH_331
            DET_AZIMUTH_332_oRDR_DETECTION_329_332_oPCAN_RADAR_3a9fb375_Tx: ComBitPosition=424, ComBitSize=13, ComSignalInitValue=0, ComSignalType=UINT16, ComSystemTemplateSystemSignalRef=DET_AZIMUTH_332
            DET_AZIMUTH_ERR_329_oRDR_DETECTION_329_332_oPCAN_RADAR_0a9afb4f_Tx: ComBitPosition=105, ComBitSize=7, ComSignalInitValue=0, ComSignalType=UINT8, ComSystemTemplateSystemSignalRef=DET_AZIMUTH_ERR_329
            DET_AZIMUTH_ERR_330_oRDR_DETECTION_329_332_oPCAN_RADAR_6fba89eb_Tx: ComBitPosition=217, ComBitSize=7, ComSignalInitValue=0, ComSignalType=UINT8, ComSystemTemplateSystemSignalRef=DET_AZIMUTH_ERR_330
            DET_AZIMUTH_ERR_331_oRDR_DETECTION_329_332_oPCAN_RADAR_faca5d7e_Tx: ComBitPosition=329, ComBitSize=7, ComSignalInitValue=0, ComSignalType=UINT8, ComSystemTemplateSystemSignalRef=DET_AZIMUTH_ERR_331
            DET_AZIMUTH_ERR_332_oRDR_DETECTION_329_332_oPCAN_RADAR_9e2a2680_Tx: ComBitPosition=441, ComBitSize=7, ComSignalInitValue=0, ComSignalType=UINT8, ComSystemTemplateSystemSignalRef=DET_AZIMUTH_ERR_332
            DET_BELOW_RAIN_THOLD_329_oRDR_DETECTION_329_332_oPCAN_RADAR_7b2efd7a_Tx: ComBitPosition=39, ComBitSize=1, ComSignalInitValue=0, ComSignalType=BOOLEAN, ComSystemTemplateSystemSignalRef=DET_BELOW_RAIN_THOLD_329
            DET_BELOW_RAIN_THOLD_330_oRDR_DETECTION_329_332_oPCAN_RADAR_1e0e8fde_Tx: ComBitPosition=151, ComBitSize=1, ComSignalInitValue=0, ComSignalType=BOOLEAN, ComSystemTemplateSystemSignalRef=DET_BELOW_RAIN_THOLD_330
            DET_BELOW_RAIN_THOLD_331_oRDR_DETECTION_329_332_oPCAN_RADAR_8b7e5b4b_Tx: ComBitPosition=263, ComBitSize=1, ComSignalInitValue=0, ComSignalType=BOOLEAN, ComSystemTemplateSystemSignalRef=DET_BELOW_RAIN_THOLD_331
            DET_BELOW_RAIN_THOLD_332_oRDR_DETECTION_329_332_oPCAN_RADAR_ef9e20b5_Tx: ComBitPosition=375, ComBitSize=1, ComSignalInitValue=0, ComSignalType=BOOLEAN, ComSystemTemplateSystemSignalRef=DET_BELOW_RAIN_THOLD_332
            DET_BI_STATIC_FLAG_329_oRDR_DETECTION_329_332_oPCAN_RADAR_f8032e3f_Tx: ComBitPosition=104, ComBitSize=1, ComSignalInitValue=0, ComSignalType=BOOLEAN, ComSystemTemplateSystemSignalRef=DET_BI_STATIC_FLAG_329
            DET_BI_STATIC_FLAG_330_oRDR_DETECTION_329_332_oPCAN_RADAR_9d235c9b_Tx: ComBitPosition=216, ComBitSize=1, ComSignalInitValue=0, ComSignalType=BOOLEAN, ComSystemTemplateSystemSignalRef=DET_BI_STATIC_FLAG_330
            DET_BI_STATIC_FLAG_331_oRDR_DETECTION_329_332_oPCAN_RADAR_0853880e_Tx: ComBitPosition=328, ComBitSize=1, ComSignalInitValue=0, ComSignalType=BOOLEAN, ComSystemTemplateSystemSignalRef=DET_BI_STATIC_FLAG_331
            DET_BI_STATIC_FLAG_332_oRDR_DETECTION_329_332_oPCAN_RADAR_6cb3f3f0_Tx: ComBitPosition=440, ComBitSize=1, ComSignalInitValue=0, ComSignalType=BOOLEAN, ComSystemTemplateSystemSignalRef=DET_BI_STATIC_FLAG_332
            DET_CONFD_AZIMUTH_329_oRDR_DETECTION_329_332_oPCAN_RADAR_acc96470_Tx: ComBitPosition=118, ComBitSize=2, ComSignalInitValue=0, ComSignalType=UINT8, ComSystemTemplateSystemSignalRef=DET_CONFD_AZIMUTH_329
            DET_CONFD_AZIMUTH_330_oRDR_DETECTION_329_332_oPCAN_RADAR_c9e916d4_Tx: ComBitPosition=230, ComBitSize=2, ComSignalInitValue=0, ComSignalType=UINT8, ComSystemTemplateSystemSignalRef=DET_CONFD_AZIMUTH_330
            DET_CONFD_AZIMUTH_331_oRDR_DETECTION_329_332_oPCAN_RADAR_5c99c241_Tx: ComBitPosition=342, ComBitSize=2, ComSignalInitValue=0, ComSignalType=UINT8, ComSystemTemplateSystemSignalRef=DET_CONFD_AZIMUTH_331
            DET_CONFD_AZIMUTH_332_oRDR_DETECTION_329_332_oPCAN_RADAR_3879b9bf_Tx: ComBitPosition=454, ComBitSize=2, ComSignalInitValue=0, ComSignalType=UINT8, ComSystemTemplateSystemSignalRef=DET_CONFD_AZIMUTH_332
            DET_CONFD_ELEVATION_329_oRDR_DETECTION_329_332_oPCAN_RADAR_ae5c658a_Tx: ComBitPosition=101, ComBitSize=2, ComSignalInitValue=0, ComSignalType=UINT8, ComSystemTemplateSystemSignalRef=DET_CONFD_ELEVATION_329
            DET_CONFD_ELEVATION_330_oRDR_DETECTION_329_332_oPCAN_RADAR_cb7c172e_Tx: ComBitPosition=213, ComBitSize=2, ComSignalInitValue=0, ComSignalType=UINT8, ComSystemTemplateSystemSignalRef=DET_CONFD_ELEVATION_330
            DET_CONFD_ELEVATION_331_oRDR_DETECTION_329_332_oPCAN_RADAR_5e0cc3bb_Tx: ComBitPosition=325, ComBitSize=2, ComSignalInitValue=0, ComSignalType=UINT8, ComSystemTemplateSystemSignalRef=DET_CONFD_ELEVATION_331
            DET_CONFD_ELEVATION_332_oRDR_DETECTION_329_332_oPCAN_RADAR_3aecb845_Tx: ComBitPosition=437, ComBitSize=2, ComSignalInitValue=0, ComSignalType=UINT8, ComSystemTemplateSystemSignalRef=DET_CONFD_ELEVATION_332
            DET_ELEVATION_329_oRDR_DETECTION_329_332_oPCAN_RADAR_7f9cb1b6_Tx: ComBitPosition=72, ComBitSize=8, ComSignalInitValue=0, ComSignalType=UINT8, ComSystemTemplateSystemSignalRef=DET_ELEVATION_329
            DET_ELEVATION_330_oRDR_DETECTION_329_332_oPCAN_RADAR_1abcc312_Tx: ComBitPosition=184, ComBitSize=8, ComSignalInitValue=0, ComSignalType=UINT8, ComSystemTemplateSystemSignalRef=DET_ELEVATION_330
            DET_ELEVATION_331_oRDR_DETECTION_329_332_oPCAN_RADAR_8fcc1787_Tx: ComBitPosition=296, ComBitSize=8, ComSignalInitValue=0, ComSignalType=UINT8, ComSystemTemplateSystemSignalRef=DET_ELEVATION_331
            DET_ELEVATION_332_oRDR_DETECTION_329_332_oPCAN_RADAR_eb2c6c79_Tx: ComBitPosition=408, ComBitSize=8, ComSignalInitValue=0, ComSignalType=UINT8, ComSystemTemplateSystemSignalRef=DET_ELEVATION_332
            DET_ELEVATION_ERR_329_oRDR_DETECTION_329_332_oPCAN_RADAR_f8a529c3_Tx: ComBitPosition=80, ComBitSize=6, ComSignalInitValue=0, ComSignalType=UINT8, ComSystemTemplateSystemSignalRef=DET_ELEVATION_ERR_329
            DET_ELEVATION_ERR_330_oRDR_DETECTION_329_332_oPCAN_RADAR_9d855b67_Tx: ComBitPosition=192, ComBitSize=6, ComSignalInitValue=0, ComSignalType=UINT8, ComSystemTemplateSystemSignalRef=DET_ELEVATION_ERR_330
            DET_ELEVATION_ERR_331_oRDR_DETECTION_329_332_oPCAN_RADAR_08f58ff2_Tx: ComBitPosition=304, ComBitSize=6, ComSignalInitValue=0, ComSignalType=UINT8, ComSystemTemplateSystemSignalRef=DET_ELEVATION_ERR_331
            DET_ELEVATION_ERR_332_oRDR_DETECTION_329_332_oPCAN_RADAR_6c15f40c_Tx: ComBitPosition=416, ComBitSize=6, ComSignalInitValue=0, ComSignalType=UINT8, ComSystemTemplateSystemSignalRef=DET_ELEVATION_ERR_332
            DET_EXISTENCE_PROB_329_oRDR_DETECTION_329_332_oPCAN_RADAR_2a3a5ca3_Tx: ComBitPosition=112, ComBitSize=6, ComSignalInitValue=0, ComSignalType=UINT8, ComSystemTemplateSystemSignalRef=DET_EXISTENCE_PROB_329
            DET_EXISTENCE_PROB_330_oRDR_DETECTION_329_332_oPCAN_RADAR_4f1a2e07_Tx: ComBitPosition=224, ComBitSize=6, ComSignalInitValue=0, ComSignalType=UINT8, ComSystemTemplateSystemSignalRef=DET_EXISTENCE_PROB_330
            DET_EXISTENCE_PROB_331_oRDR_DETECTION_329_332_oPCAN_RADAR_da6afa92_Tx: ComBitPosition=336, ComBitSize=6, ComSignalInitValue=0, ComSignalType=UINT8, ComSystemTemplateSystemSignalRef=DET_EXISTENCE_PROB_331
            DET_EXISTENCE_PROB_332_oRDR_DETECTION_329_332_oPCAN_RADAR_be8a816c_Tx: ComBitPosition=448, ComBitSize=6, ComSignalInitValue=0, ComSignalType=UINT8, ComSystemTemplateSystemSignalRef=DET_EXISTENCE_PROB_332
            DET_HVC_FLAG_329_oRDR_DETECTION_329_332_oPCAN_RADAR_cb4e1fdc_Tx: ComBitPosition=86, ComBitSize=1, ComSignalInitValue=0, ComSignalType=BOOLEAN, ComSystemTemplateSystemSignalRef=DET_HVC_FLAG_329
            DET_HVC_FLAG_330_oRDR_DETECTION_329_332_oPCAN_RADAR_ae6e6d78_Tx: ComBitPosition=198, ComBitSize=1, ComSignalInitValue=0, ComSignalType=BOOLEAN, ComSystemTemplateSystemSignalRef=DET_HVC_FLAG_330
            DET_HVC_FLAG_331_oRDR_DETECTION_329_332_oPCAN_RADAR_3b1eb9ed_Tx: ComBitPosition=310, ComBitSize=1, ComSignalInitValue=0, ComSignalType=BOOLEAN, ComSystemTemplateSystemSignalRef=DET_HVC_FLAG_331
            DET_HVC_FLAG_332_oRDR_DETECTION_329_332_oPCAN_RADAR_5ffec213_Tx: ComBitPosition=422, ComBitSize=1, ComSignalInitValue=0, ComSignalType=BOOLEAN, ComSystemTemplateSystemSignalRef=DET_HVC_FLAG_332
            DET_IDM_329_oRDR_DETECTION_329_332_oPCAN_RADAR_401c2461_Tx: ComBitPosition=63, ComBitSize=1, ComSignalInitValue=0, ComSignalType=BOOLEAN, ComSystemTemplateSystemSignalRef=DET_IDM_329
            DET_IDM_330_oRDR_DETECTION_329_332_oPCAN_RADAR_253c56c5_Tx: ComBitPosition=175, ComBitSize=1, ComSignalInitValue=0, ComSignalType=BOOLEAN, ComSystemTemplateSystemSignalRef=DET_IDM_330
            DET_IDM_331_oRDR_DETECTION_329_332_oPCAN_RADAR_b04c8250_Tx: ComBitPosition=287, ComBitSize=1, ComSignalInitValue=0, ComSignalType=BOOLEAN, ComSystemTemplateSystemSignalRef=DET_IDM_331
            DET_IDM_332_oRDR_DETECTION_329_332_oPCAN_RADAR_d4acf9ae_Tx: ComBitPosition=399, ComBitSize=1, ComSignalInitValue=0, ComSignalType=BOOLEAN, ComSystemTemplateSystemSignalRef=DET_IDM_332
            DET_MH_CRC16_329_332_oRDR_DETECTION_329_332_oPCAN_RADAR_41f49011_Tx: ComBitPosition=0, ComBitSize=16, ComSignalInitValue=0, ComSignalType=UINT16, ComSystemTemplateSystemSignalRef=DET_MH_CRC16_329_332
            DET_MH_CYCLE_COUNTER_329_332_oRDR_DETECTION_329_332_oPCAN_RADAR_c5813126_Tx: ComBitPosition=16, ComBitSize=8, ComSignalInitValue=0, ComSignalType=UINT8, ComSystemTemplateSystemSignalRef=DET_MH_CYCLE_COUNTER_329_332
            DET_MH_SCAN_INDEX_4LSB_329_332_oRDR_DETECTION_329_332_oPCAN_RADAR_09ab14aa_Tx: ComBitPosition=476, ComBitSize=4, ComSignalInitValue=0, ComSignalType=UINT8, ComSystemTemplateSystemSignalRef=DET_MH_SCAN_INDEX_4LSB_329_332
            DET_MTD_329_oRDR_DETECTION_329_332_oPCAN_RADAR_26af16ba_Tx: ComBitPosition=47, ComBitSize=1, ComSignalInitValue=0, ComSignalType=BOOLEAN, ComSystemTemplateSystemSignalRef=DET_MTD_329
            DET_MTD_330_oRDR_DETECTION_329_332_oPCAN_RADAR_438f641e_Tx: ComBitPosition=159, ComBitSize=1, ComSignalInitValue=0, ComSignalType=BOOLEAN, ComSystemTemplateSystemSignalRef=DET_MTD_330
            DET_MTD_331_oRDR_DETECTION_329_332_oPCAN_RADAR_d6ffb08b_Tx: ComBitPosition=271, ComBitSize=1, ComSignalInitValue=0, ComSignalType=BOOLEAN, ComSystemTemplateSystemSignalRef=DET_MTD_331
            DET_MTD_332_oRDR_DETECTION_329_332_oPCAN_RADAR_b21fcb75_Tx: ComBitPosition=383, ComBitSize=1, ComSignalInitValue=0, ComSignalType=BOOLEAN, ComSystemTemplateSystemSignalRef=DET_MTD_332
            DET_PROB_1STAZHYPO_329_oRDR_DETECTION_329_332_oPCAN_RADAR_b51bfe77_Tx: ComBitPosition=103, ComBitSize=1, ComSignalInitValue=0, ComSignalType=BOOLEAN, ComSystemTemplateSystemSignalRef=DET_PROB_1STAZHYPO_329
            DET_PROB_1STAZHYPO_330_oRDR_DETECTION_329_332_oPCAN_RADAR_d03b8cd3_Tx: ComBitPosition=215, ComBitSize=1, ComSignalInitValue=0, ComSignalType=BOOLEAN, ComSystemTemplateSystemSignalRef=DET_PROB_1STAZHYPO_330
            DET_PROB_1STAZHYPO_331_oRDR_DETECTION_329_332_oPCAN_RADAR_454b5846_Tx: ComBitPosition=327, ComBitSize=1, ComSignalInitValue=0, ComSignalType=BOOLEAN, ComSystemTemplateSystemSignalRef=DET_PROB_1STAZHYPO_331
            DET_PROB_1STAZHYPO_332_oRDR_DETECTION_329_332_oPCAN_RADAR_21ab23b8_Tx: ComBitPosition=439, ComBitSize=1, ComSignalInitValue=0, ComSignalType=BOOLEAN, ComSystemTemplateSystemSignalRef=DET_PROB_1STAZHYPO_332
            DET_RANGE_329_oRDR_DETECTION_329_332_oPCAN_RADAR_beb41d01_Tx: ComBitPosition=24, ComBitSize=15, ComSignalInitValue=0, ComSignalType=UINT16, ComSystemTemplateSystemSignalRef=DET_RANGE_329
            DET_RANGE_330_oRDR_DETECTION_329_332_oPCAN_RADAR_db946fa5_Tx: ComBitPosition=136, ComBitSize=15, ComSignalInitValue=0, ComSignalType=UINT16, ComSystemTemplateSystemSignalRef=DET_RANGE_330
            DET_RANGE_331_oRDR_DETECTION_329_332_oPCAN_RADAR_4ee4bb30_Tx: ComBitPosition=248, ComBitSize=15, ComSignalInitValue=0, ComSignalType=UINT16, ComSystemTemplateSystemSignalRef=DET_RANGE_331
            DET_RANGE_332_oRDR_DETECTION_329_332_oPCAN_RADAR_2a04c0ce_Tx: ComBitPosition=360, ComBitSize=15, ComSignalInitValue=0, ComSignalType=UINT16, ComSystemTemplateSystemSignalRef=DET_RANGE_332
            DET_RANGE_ERR_329_oRDR_DETECTION_329_332_oPCAN_RADAR_195ca768_Tx: ComBitPosition=40, ComBitSize=7, ComSignalInitValue=0, ComSignalType=UINT8, ComSystemTemplateSystemSignalRef=DET_RANGE_ERR_329
            DET_RANGE_ERR_330_oRDR_DETECTION_329_332_oPCAN_RADAR_7c7cd5cc_Tx: ComBitPosition=152, ComBitSize=7, ComSignalInitValue=0, ComSignalType=UINT8, ComSystemTemplateSystemSignalRef=DET_RANGE_ERR_330
            DET_RANGE_ERR_331_oRDR_DETECTION_329_332_oPCAN_RADAR_e90c0159_Tx: ComBitPosition=264, ComBitSize=7, ComSignalInitValue=0, ComSignalType=UINT8, ComSystemTemplateSystemSignalRef=DET_RANGE_ERR_331
            DET_RANGE_ERR_332_oRDR_DETECTION_329_332_oPCAN_RADAR_8dec7aa7_Tx: ComBitPosition=376, ComBitSize=7, ComSignalInitValue=0, ComSignalType=UINT8, ComSystemTemplateSystemSignalRef=DET_RANGE_ERR_332
            DET_RANGE_VELOCITY_329_oRDR_DETECTION_329_332_oPCAN_RADAR_cb12df24_Tx: ComBitPosition=48, ComBitSize=15, ComSignalInitValue=16384, ComSignalType=UINT16, ComSystemTemplateSystemSignalRef=DET_RANGE_VELOCITY_329
            DET_RANGE_VELOCITY_330_oRDR_DETECTION_329_332_oPCAN_RADAR_ae32ad80_Tx: ComBitPosition=160, ComBitSize=15, ComSignalInitValue=16384, ComSignalType=UINT16, ComSystemTemplateSystemSignalRef=DET_RANGE_VELOCITY_330
            DET_RANGE_VELOCITY_331_oRDR_DETECTION_329_332_oPCAN_RADAR_3b427915_Tx: ComBitPosition=272, ComBitSize=15, ComSignalInitValue=16384, ComSignalType=UINT16, ComSystemTemplateSystemSignalRef=DET_RANGE_VELOCITY_331
            DET_RANGE_VELOCITY_332_oRDR_DETECTION_329_332_oPCAN_RADAR_5fa202eb_Tx: ComBitPosition=384, ComBitSize=15, ComSignalInitValue=16384, ComSignalType=UINT16, ComSystemTemplateSystemSignalRef=DET_RANGE_VELOCITY_332
            DET_RANGE_VELOCITY_ERR_329_oRDR_DETECTION_329_332_oPCAN_RADAR_c4a92496_Tx: ComBitPosition=64, ComBitSize=8, ComSignalInitValue=0, ComSignalType=UINT8, ComSystemTemplateSystemSignalRef=DET_RANGE_VELOCITY_ERR_329
            DET_RANGE_VELOCITY_ERR_330_oRDR_DETECTION_329_332_oPCAN_RADAR_a1895632_Tx: ComBitPosition=176, ComBitSize=8, ComSignalInitValue=0, ComSignalType=UINT8, ComSystemTemplateSystemSignalRef=DET_RANGE_VELOCITY_ERR_330
            DET_RANGE_VELOCITY_ERR_331_oRDR_DETECTION_329_332_oPCAN_RADAR_34f982a7_Tx: ComBitPosition=288, ComBitSize=8, ComSignalInitValue=0, ComSignalType=UINT8, ComSystemTemplateSystemSignalRef=DET_RANGE_VELOCITY_ERR_331
            DET_RANGE_VELOCITY_ERR_332_oRDR_DETECTION_329_332_oPCAN_RADAR_5019f959_Tx: ComBitPosition=400, ComBitSize=8, ComSignalInitValue=0, ComSignalType=UINT8, ComSystemTemplateSystemSignalRef=DET_RANGE_VELOCITY_ERR_332
            DET_RCS_329_oRDR_DETECTION_329_332_oPCAN_RADAR_4c92e87e_Tx: ComBitPosition=128, ComBitSize=8, ComSignalInitValue=128, ComSignalType=UINT8, ComSystemTemplateSystemSignalRef=DET_RCS_329
            DET_RCS_330_oRDR_DETECTION_329_332_oPCAN_RADAR_29b29ada_Tx: ComBitPosition=240, ComBitSize=8, ComSignalInitValue=128, ComSignalType=UINT8, ComSystemTemplateSystemSignalRef=DET_RCS_330
            DET_RCS_331_oRDR_DETECTION_329_332_oPCAN_RADAR_bcc24e4f_Tx: ComBitPosition=352, ComBitSize=8, ComSignalInitValue=128, ComSignalType=UINT8, ComSystemTemplateSystemSignalRef=DET_RCS_331
            DET_RCS_332_oRDR_DETECTION_329_332_oPCAN_RADAR_d82235b1_Tx: ComBitPosition=464, ComBitSize=8, ComSignalInitValue=128, ComSignalType=UINT8, ComSystemTemplateSystemSignalRef=DET_RCS_332
            DET_SNR_329_oRDR_DETECTION_329_332_oPCAN_RADAR_913cbc7c_Tx: ComBitPosition=120, ComBitSize=8, ComSignalInitValue=0, ComSignalType=UINT8, ComSystemTemplateSystemSignalRef=DET_SNR_329
            DET_SNR_330_oRDR_DETECTION_329_332_oPCAN_RADAR_f41cced8_Tx: ComBitPosition=232, ComBitSize=8, ComSignalInitValue=0, ComSignalType=UINT8, ComSystemTemplateSystemSignalRef=DET_SNR_330
            DET_SNR_331_oRDR_DETECTION_329_332_oPCAN_RADAR_616c1a4d_Tx: ComBitPosition=344, ComBitSize=8, ComSignalInitValue=0, ComSignalType=UINT8, ComSystemTemplateSystemSignalRef=DET_SNR_331
            DET_SNR_332_oRDR_DETECTION_329_332_oPCAN_RADAR_058c61b3_Tx: ComBitPosition=456, ComBitSize=8, ComSignalInitValue=0, ComSignalType=UINT8, ComSystemTemplateSystemSignalRef=DET_SNR_332
            DET_SUPER_RES_TARGET_329_oRDR_DETECTION_329_332_oPCAN_RADAR_a0a59419_Tx: ComBitPosition=87, ComBitSize=1, ComSignalInitValue=0, ComSignalType=BOOLEAN, ComSystemTemplateSystemSignalRef=DET_SUPER_RES_TARGET_329
            DET_SUPER_RES_TARGET_330_oRDR_DETECTION_329_332_oPCAN_RADAR_c585e6bd_Tx: ComBitPosition=199, ComBitSize=1, ComSignalInitValue=0, ComSignalType=BOOLEAN, ComSystemTemplateSystemSignalRef=DET_SUPER_RES_TARGET_330
            DET_SUPER_RES_TARGET_331_oRDR_DETECTION_329_332_oPCAN_RADAR_50f53228_Tx: ComBitPosition=311, ComBitSize=1, ComSignalInitValue=0, ComSignalType=BOOLEAN, ComSystemTemplateSystemSignalRef=DET_SUPER_RES_TARGET_331
            DET_SUPER_RES_TARGET_332_oRDR_DETECTION_329_332_oPCAN_RADAR_341549d6_Tx: ComBitPosition=423, ComBitSize=1, ComSignalInitValue=0, ComSignalType=BOOLEAN, ComSystemTemplateSystemSignalRef=DET_SUPER_RES_TARGET_332
        SG_Detections_333_336_oRDR_DETECTION_333_336_oPCAN_RADAR_f7772a32_Tx: ComSystemTemplateSignalGroupRef=SG_Detections_333_336
          83 x ComGroupSignal, all with ComSignalEndianness=LITTLE_ENDIAN, ComTransferProperty=PENDING:
            DET_AZIMUTH_333_oRDR_DETECTION_333_336_oPCAN_RADAR_b22864ce_Tx: ComBitPosition=88, ComBitSize=13, ComSignalInitValue=0, ComSignalType=UINT16, ComSystemTemplateSystemSignalRef=DET_AZIMUTH_333
            DET_AZIMUTH_334_oRDR_DETECTION_333_336_oPCAN_RADAR_ee9847a7_Tx: ComBitPosition=200, ComBitSize=13, ComSignalInitValue=0, ComSignalType=UINT16, ComSystemTemplateSystemSignalRef=DET_AZIMUTH_334
            DET_AZIMUTH_335_oRDR_DETECTION_333_336_oPCAN_RADAR_7be89332_Tx: ComBitPosition=312, ComBitSize=13, ComSignalInitValue=0, ComSignalType=UINT16, ComSystemTemplateSystemSignalRef=DET_AZIMUTH_335
            DET_AZIMUTH_336_oRDR_DETECTION_333_336_oPCAN_RADAR_1f08e8cc_Tx: ComBitPosition=424, ComBitSize=13, ComSignalInitValue=0, ComSignalType=UINT16, ComSystemTemplateSystemSignalRef=DET_AZIMUTH_336
            DET_AZIMUTH_ERR_333_oRDR_DETECTION_333_336_oPCAN_RADAR_169df13b_Tx: ComBitPosition=105, ComBitSize=7, ComSignalInitValue=0, ComSignalType=UINT8, ComSystemTemplateSystemSignalRef=DET_AZIMUTH_ERR_333
            DET_AZIMUTH_ERR_334_oRDR_DETECTION_333_336_oPCAN_RADAR_4a2dd252_Tx: ComBitPosition=217, ComBitSize=7, ComSignalInitValue=0, ComSignalType=UINT8, ComSystemTemplateSystemSignalRef=DET_AZIMUTH_ERR_334
            DET_AZIMUTH_ERR_335_oRDR_DETECTION_333_336_oPCAN_RADAR_df5d06c7_Tx: ComBitPosition=329, ComBitSize=7, ComSignalInitValue=0, ComSignalType=UINT8, ComSystemTemplateSystemSignalRef=DET_AZIMUTH_ERR_335
            DET_AZIMUTH_ERR_336_oRDR_DETECTION_333_336_oPCAN_RADAR_bbbd7d39_Tx: ComBitPosition=441, ComBitSize=7, ComSignalInitValue=0, ComSignalType=UINT8, ComSystemTemplateSystemSignalRef=DET_AZIMUTH_ERR_336
            DET_BELOW_RAIN_THOLD_333_oRDR_DETECTION_333_336_oPCAN_RADAR_6729f70e_Tx: ComBitPosition=39, ComBitSize=1, ComSignalInitValue=0, ComSignalType=BOOLEAN, ComSystemTemplateSystemSignalRef=DET_BELOW_RAIN_THOLD_333
            DET_BELOW_RAIN_THOLD_334_oRDR_DETECTION_333_336_oPCAN_RADAR_3b99d467_Tx: ComBitPosition=151, ComBitSize=1, ComSignalInitValue=0, ComSignalType=BOOLEAN, ComSystemTemplateSystemSignalRef=DET_BELOW_RAIN_THOLD_334
            DET_BELOW_RAIN_THOLD_335_oRDR_DETECTION_333_336_oPCAN_RADAR_aee900f2_Tx: ComBitPosition=263, ComBitSize=1, ComSignalInitValue=0, ComSignalType=BOOLEAN, ComSystemTemplateSystemSignalRef=DET_BELOW_RAIN_THOLD_335
            DET_BELOW_RAIN_THOLD_336_oRDR_DETECTION_333_336_oPCAN_RADAR_ca097b0c_Tx: ComBitPosition=375, ComBitSize=1, ComSignalInitValue=0, ComSignalType=BOOLEAN, ComSystemTemplateSystemSignalRef=DET_BELOW_RAIN_THOLD_336
            DET_BI_STATIC_FLAG_333_oRDR_DETECTION_333_336_oPCAN_RADAR_e404244b_Tx: ComBitPosition=104, ComBitSize=1, ComSignalInitValue=0, ComSignalType=BOOLEAN, ComSystemTemplateSystemSignalRef=DET_BI_STATIC_FLAG_333
            DET_BI_STATIC_FLAG_334_oRDR_DETECTION_333_336_oPCAN_RADAR_b8b40722_Tx: ComBitPosition=216, ComBitSize=1, ComSignalInitValue=0, ComSignalType=BOOLEAN, ComSystemTemplateSystemSignalRef=DET_BI_STATIC_FLAG_334
            DET_BI_STATIC_FLAG_335_oRDR_DETECTION_333_336_oPCAN_RADAR_2dc4d3b7_Tx: ComBitPosition=328, ComBitSize=1, ComSignalInitValue=0, ComSignalType=BOOLEAN, ComSystemTemplateSystemSignalRef=DET_BI_STATIC_FLAG_335
            DET_BI_STATIC_FLAG_336_oRDR_DETECTION_333_336_oPCAN_RADAR_4924a849_Tx: ComBitPosition=440, ComBitSize=1, ComSignalInitValue=0, ComSignalType=BOOLEAN, ComSystemTemplateSystemSignalRef=DET_BI_STATIC_FLAG_336
            DET_CONFD_AZIMUTH_333_oRDR_DETECTION_333_336_oPCAN_RADAR_b0ce6e04_Tx: ComBitPosition=118, ComBitSize=2, ComSignalInitValue=0, ComSignalType=UINT8, ComSystemTemplateSystemSignalRef=DET_CONFD_AZIMUTH_333
            DET_CONFD_AZIMUTH_334_oRDR_DETECTION_333_336_oPCAN_RADAR_ec7e4d6d_Tx: ComBitPosition=230, ComBitSize=2, ComSignalInitValue=0, ComSignalType=UINT8, ComSystemTemplateSystemSignalRef=DET_CONFD_AZIMUTH_334
            DET_CONFD_AZIMUTH_335_oRDR_DETECTION_333_336_oPCAN_RADAR_790e99f8_Tx: ComBitPosition=342, ComBitSize=2, ComSignalInitValue=0, ComSignalType=UINT8, ComSystemTemplateSystemSignalRef=DET_CONFD_AZIMUTH_335
            DET_CONFD_AZIMUTH_336_oRDR_DETECTION_333_336_oPCAN_RADAR_1deee206_Tx: ComBitPosition=454, ComBitSize=2, ComSignalInitValue=0, ComSignalType=UINT8, ComSystemTemplateSystemSignalRef=DET_CONFD_AZIMUTH_336
            DET_CONFD_ELEVATION_333_oRDR_DETECTION_333_336_oPCAN_RADAR_b25b6ffe_Tx: ComBitPosition=101, ComBitSize=2, ComSignalInitValue=0, ComSignalType=UINT8, ComSystemTemplateSystemSignalRef=DET_CONFD_ELEVATION_333
            DET_CONFD_ELEVATION_334_oRDR_DETECTION_333_336_oPCAN_RADAR_eeeb4c97_Tx: ComBitPosition=213, ComBitSize=2, ComSignalInitValue=0, ComSignalType=UINT8, ComSystemTemplateSystemSignalRef=DET_CONFD_ELEVATION_334
            DET_CONFD_ELEVATION_335_oRDR_DETECTION_333_336_oPCAN_RADAR_7b9b9802_Tx: ComBitPosition=325, ComBitSize=2, ComSignalInitValue=0, ComSignalType=UINT8, ComSystemTemplateSystemSignalRef=DET_CONFD_ELEVATION_335
            DET_CONFD_ELEVATION_336_oRDR_DETECTION_333_336_oPCAN_RADAR_1f7be3fc_Tx: ComBitPosition=437, ComBitSize=2, ComSignalInitValue=0, ComSignalType=UINT8, ComSystemTemplateSystemSignalRef=DET_CONFD_ELEVATION_336
            DET_ELEVATION_333_oRDR_DETECTION_333_336_oPCAN_RADAR_639bbbc2_Tx: ComBitPosition=72, ComBitSize=8, ComSignalInitValue=0, ComSignalType=UINT8, ComSystemTemplateSystemSignalRef=DET_ELEVATION_333
            DET_ELEVATION_334_oRDR_DETECTION_333_336_oPCAN_RADAR_3f2b98ab_Tx: ComBitPosition=184, ComBitSize=8, ComSignalInitValue=0, ComSignalType=UINT8, ComSystemTemplateSystemSignalRef=DET_ELEVATION_334
            DET_ELEVATION_335_oRDR_DETECTION_333_336_oPCAN_RADAR_aa5b4c3e_Tx: ComBitPosition=296, ComBitSize=8, ComSignalInitValue=0, ComSignalType=UINT8, ComSystemTemplateSystemSignalRef=DET_ELEVATION_335
            DET_ELEVATION_336_oRDR_DETECTION_333_336_oPCAN_RADAR_cebb37c0_Tx: ComBitPosition=408, ComBitSize=8, ComSignalInitValue=0, ComSignalType=UINT8, ComSystemTemplateSystemSignalRef=DET_ELEVATION_336
            DET_ELEVATION_ERR_333_oRDR_DETECTION_333_336_oPCAN_RADAR_e4a223b7_Tx: ComBitPosition=80, ComBitSize=6, ComSignalInitValue=0, ComSignalType=UINT8, ComSystemTemplateSystemSignalRef=DET_ELEVATION_ERR_333
            DET_ELEVATION_ERR_334_oRDR_DETECTION_333_336_oPCAN_RADAR_b81200de_Tx: ComBitPosition=192, ComBitSize=6, ComSignalInitValue=0, ComSignalType=UINT8, ComSystemTemplateSystemSignalRef=DET_ELEVATION_ERR_334
            DET_ELEVATION_ERR_335_oRDR_DETECTION_333_336_oPCAN_RADAR_2d62d44b_Tx: ComBitPosition=304, ComBitSize=6, ComSignalInitValue=0, ComSignalType=UINT8, ComSystemTemplateSystemSignalRef=DET_ELEVATION_ERR_335
            DET_ELEVATION_ERR_336_oRDR_DETECTION_333_336_oPCAN_RADAR_4982afb5_Tx: ComBitPosition=416, ComBitSize=6, ComSignalInitValue=0, ComSignalType=UINT8, ComSystemTemplateSystemSignalRef=DET_ELEVATION_ERR_336
            DET_EXISTENCE_PROB_333_oRDR_DETECTION_333_336_oPCAN_RADAR_363d56d7_Tx: ComBitPosition=112, ComBitSize=6, ComSignalInitValue=0, ComSignalType=UINT8, ComSystemTemplateSystemSignalRef=DET_EXISTENCE_PROB_333
            DET_EXISTENCE_PROB_334_oRDR_DETECTION_333_336_oPCAN_RADAR_6a8d75be_Tx: ComBitPosition=224, ComBitSize=6, ComSignalInitValue=0, ComSignalType=UINT8, ComSystemTemplateSystemSignalRef=DET_EXISTENCE_PROB_334
            DET_EXISTENCE_PROB_335_oRDR_DETECTION_333_336_oPCAN_RADAR_fffda12b_Tx: ComBitPosition=336, ComBitSize=6, ComSignalInitValue=0, ComSignalType=UINT8, ComSystemTemplateSystemSignalRef=DET_EXISTENCE_PROB_335
            DET_EXISTENCE_PROB_336_oRDR_DETECTION_333_336_oPCAN_RADAR_9b1ddad5_Tx: ComBitPosition=448, ComBitSize=6, ComSignalInitValue=0, ComSignalType=UINT8, ComSystemTemplateSystemSignalRef=DET_EXISTENCE_PROB_336
            DET_HVC_FLAG_333_oRDR_DETECTION_333_336_oPCAN_RADAR_d74915a8_Tx: ComBitPosition=86, ComBitSize=1, ComSignalInitValue=0, ComSignalType=BOOLEAN, ComSystemTemplateSystemSignalRef=DET_HVC_FLAG_333
            DET_HVC_FLAG_334_oRDR_DETECTION_333_336_oPCAN_RADAR_8bf936c1_Tx: ComBitPosition=198, ComBitSize=1, ComSignalInitValue=0, ComSignalType=BOOLEAN, ComSystemTemplateSystemSignalRef=DET_HVC_FLAG_334
            DET_HVC_FLAG_335_oRDR_DETECTION_333_336_oPCAN_RADAR_1e89e254_Tx: ComBitPosition=310, ComBitSize=1, ComSignalInitValue=0, ComSignalType=BOOLEAN, ComSystemTemplateSystemSignalRef=DET_HVC_FLAG_335
            DET_HVC_FLAG_336_oRDR_DETECTION_333_336_oPCAN_RADAR_7a6999aa_Tx: ComBitPosition=422, ComBitSize=1, ComSignalInitValue=0, ComSignalType=BOOLEAN, ComSystemTemplateSystemSignalRef=DET_HVC_FLAG_336
            DET_IDM_333_oRDR_DETECTION_333_336_oPCAN_RADAR_5c1b2e15_Tx: ComBitPosition=63, ComBitSize=1, ComSignalInitValue=0, ComSignalType=BOOLEAN, ComSystemTemplateSystemSignalRef=DET_IDM_333
            DET_IDM_334_oRDR_DETECTION_333_336_oPCAN_RADAR_00ab0d7c_Tx: ComBitPosition=175, ComBitSize=1, ComSignalInitValue=0, ComSignalType=BOOLEAN, ComSystemTemplateSystemSignalRef=DET_IDM_334
            DET_IDM_335_oRDR_DETECTION_333_336_oPCAN_RADAR_95dbd9e9_Tx: ComBitPosition=287, ComBitSize=1, ComSignalInitValue=0, ComSignalType=BOOLEAN, ComSystemTemplateSystemSignalRef=DET_IDM_335
            DET_IDM_336_oRDR_DETECTION_333_336_oPCAN_RADAR_f13ba217_Tx: ComBitPosition=399, ComBitSize=1, ComSignalInitValue=0, ComSignalType=BOOLEAN, ComSystemTemplateSystemSignalRef=DET_IDM_336
            DET_MH_CRC16_333_336_oRDR_DETECTION_333_336_oPCAN_RADAR_73fff839_Tx: ComBitPosition=0, ComBitSize=16, ComSignalInitValue=0, ComSignalType=UINT16, ComSystemTemplateSystemSignalRef=DET_MH_CRC16_333_336
            DET_MH_CYCLE_COUNTER_333_336_oRDR_DETECTION_333_336_oPCAN_RADAR_f78a590e_Tx: ComBitPosition=16, ComBitSize=8, ComSignalInitValue=0, ComSignalType=UINT8, ComSystemTemplateSystemSignalRef=DET_MH_CYCLE_COUNTER_333_336
            DET_MH_SCAN_INDEX_4LSB_333_336_oRDR_DETECTION_333_336_oPCAN_RADAR_3ba07c82_Tx: ComBitPosition=476, ComBitSize=4, ComSignalInitValue=0, ComSignalType=UINT8, ComSystemTemplateSystemSignalRef=DET_MH_SCAN_INDEX_4LSB_333_336
            DET_MTD_333_oRDR_DETECTION_333_336_oPCAN_RADAR_3aa81cce_Tx: ComBitPosition=47, ComBitSize=1, ComSignalInitValue=0, ComSignalType=BOOLEAN, ComSystemTemplateSystemSignalRef=DET_MTD_333
            DET_MTD_334_oRDR_DETECTION_333_336_oPCAN_RADAR_66183fa7_Tx: ComBitPosition=159, ComBitSize=1, ComSignalInitValue=0, ComSignalType=BOOLEAN, ComSystemTemplateSystemSignalRef=DET_MTD_334
            DET_MTD_335_oRDR_DETECTION_333_336_oPCAN_RADAR_f368eb32_Tx: ComBitPosition=271, ComBitSize=1, ComSignalInitValue=0, ComSignalType=BOOLEAN, ComSystemTemplateSystemSignalRef=DET_MTD_335
            DET_MTD_336_oRDR_DETECTION_333_336_oPCAN_RADAR_978890cc_Tx: ComBitPosition=383, ComBitSize=1, ComSignalInitValue=0, ComSignalType=BOOLEAN, ComSystemTemplateSystemSignalRef=DET_MTD_336
            DET_PROB_1STAZHYPO_333_oRDR_DETECTION_333_336_oPCAN_RADAR_a91cf403_Tx: ComBitPosition=103, ComBitSize=1, ComSignalInitValue=0, ComSignalType=BOOLEAN, ComSystemTemplateSystemSignalRef=DET_PROB_1STAZHYPO_333
            DET_PROB_1STAZHYPO_334_oRDR_DETECTION_333_336_oPCAN_RADAR_f5acd76a_Tx: ComBitPosition=215, ComBitSize=1, ComSignalInitValue=0, ComSignalType=BOOLEAN, ComSystemTemplateSystemSignalRef=DET_PROB_1STAZHYPO_334
            DET_PROB_1STAZHYPO_335_oRDR_DETECTION_333_336_oPCAN_RADAR_60dc03ff_Tx: ComBitPosition=327, ComBitSize=1, ComSignalInitValue=0, ComSignalType=BOOLEAN, ComSystemTemplateSystemSignalRef=DET_PROB_1STAZHYPO_335
            DET_PROB_1STAZHYPO_336_oRDR_DETECTION_333_336_oPCAN_RADAR_043c7801_Tx: ComBitPosition=439, ComBitSize=1, ComSignalInitValue=0, ComSignalType=BOOLEAN, ComSystemTemplateSystemSignalRef=DET_PROB_1STAZHYPO_336
            DET_RANGE_333_oRDR_DETECTION_333_336_oPCAN_RADAR_a2b31775_Tx: ComBitPosition=24, ComBitSize=15, ComSignalInitValue=0, ComSignalType=UINT16, ComSystemTemplateSystemSignalRef=DET_RANGE_333
            DET_RANGE_334_oRDR_DETECTION_333_336_oPCAN_RADAR_fe03341c_Tx: ComBitPosition=136, ComBitSize=15, ComSignalInitValue=0, ComSignalType=UINT16, ComSystemTemplateSystemSignalRef=DET_RANGE_334
            DET_RANGE_335_oRDR_DETECTION_333_336_oPCAN_RADAR_6b73e089_Tx: ComBitPosition=248, ComBitSize=15, ComSignalInitValue=0, ComSignalType=UINT16, ComSystemTemplateSystemSignalRef=DET_RANGE_335
            DET_RANGE_336_oRDR_DETECTION_333_336_oPCAN_RADAR_0f939b77_Tx: ComBitPosition=360, ComBitSize=15, ComSignalInitValue=0, ComSignalType=UINT16, ComSystemTemplateSystemSignalRef=DET_RANGE_336
            DET_RANGE_ERR_333_oRDR_DETECTION_333_336_oPCAN_RADAR_055bad1c_Tx: ComBitPosition=40, ComBitSize=7, ComSignalInitValue=0, ComSignalType=UINT8, ComSystemTemplateSystemSignalRef=DET_RANGE_ERR_333
            DET_RANGE_ERR_334_oRDR_DETECTION_333_336_oPCAN_RADAR_59eb8e75_Tx: ComBitPosition=152, ComBitSize=7, ComSignalInitValue=0, ComSignalType=UINT8, ComSystemTemplateSystemSignalRef=DET_RANGE_ERR_334
            DET_RANGE_ERR_335_oRDR_DETECTION_333_336_oPCAN_RADAR_cc9b5ae0_Tx: ComBitPosition=264, ComBitSize=7, ComSignalInitValue=0, ComSignalType=UINT8, ComSystemTemplateSystemSignalRef=DET_RANGE_ERR_335
            DET_RANGE_ERR_336_oRDR_DETECTION_333_336_oPCAN_RADAR_a87b211e_Tx: ComBitPosition=376, ComBitSize=7, ComSignalInitValue=0, ComSignalType=UINT8, ComSystemTemplateSystemSignalRef=DET_RANGE_ERR_336
            DET_RANGE_VELOCITY_333_oRDR_DETECTION_333_336_oPCAN_RADAR_d715d550_Tx: ComBitPosition=48, ComBitSize=15, ComSignalInitValue=16384, ComSignalType=UINT16, ComSystemTemplateSystemSignalRef=DET_RANGE_VELOCITY_333
            DET_RANGE_VELOCITY_334_oRDR_DETECTION_333_336_oPCAN_RADAR_8ba5f639_Tx: ComBitPosition=160, ComBitSize=15, ComSignalInitValue=16384, ComSignalType=UINT16, ComSystemTemplateSystemSignalRef=DET_RANGE_VELOCITY_334
            DET_RANGE_VELOCITY_335_oRDR_DETECTION_333_336_oPCAN_RADAR_1ed522ac_Tx: ComBitPosition=272, ComBitSize=15, ComSignalInitValue=16384, ComSignalType=UINT16, ComSystemTemplateSystemSignalRef=DET_RANGE_VELOCITY_335
            DET_RANGE_VELOCITY_336_oRDR_DETECTION_333_336_oPCAN_RADAR_7a355952_Tx: ComBitPosition=384, ComBitSize=15, ComSignalInitValue=16384, ComSignalType=UINT16, ComSystemTemplateSystemSignalRef=DET_RANGE_VELOCITY_336
            DET_RANGE_VELOCITY_ERR_333_oRDR_DETECTION_333_336_oPCAN_RADAR_d8ae2ee2_Tx: ComBitPosition=64, ComBitSize=8, ComSignalInitValue=0, ComSignalType=UINT8, ComSystemTemplateSystemSignalRef=DET_RANGE_VELOCITY_ERR_333
            DET_RANGE_VELOCITY_ERR_334_oRDR_DETECTION_333_336_oPCAN_RADAR_841e0d8b_Tx: ComBitPosition=176, ComBitSize=8, ComSignalInitValue=0, ComSignalType=UINT8, ComSystemTemplateSystemSignalRef=DET_RANGE_VELOCITY_ERR_334
            DET_RANGE_VELOCITY_ERR_335_oRDR_DETECTION_333_336_oPCAN_RADAR_116ed91e_Tx: ComBitPosition=288, ComBitSize=8, ComSignalInitValue=0, ComSignalType=UINT8, ComSystemTemplateSystemSignalRef=DET_RANGE_VELOCITY_ERR_335
            DET_RANGE_VELOCITY_ERR_336_oRDR_DETECTION_333_336_oPCAN_RADAR_758ea2e0_Tx: ComBitPosition=400, ComBitSize=8, ComSignalInitValue=0, ComSignalType=UINT8, ComSystemTemplateSystemSignalRef=DET_RANGE_VELOCITY_ERR_336
            DET_RCS_333_oRDR_DETECTION_333_336_oPCAN_RADAR_5095e20a_Tx: ComBitPosition=128, ComBitSize=8, ComSignalInitValue=128, ComSignalType=UINT8, ComSystemTemplateSystemSignalRef=DET_RCS_333
            DET_RCS_334_oRDR_DETECTION_333_336_oPCAN_RADAR_0c25c163_Tx: ComBitPosition=240, ComBitSize=8, ComSignalInitValue=128, ComSignalType=UINT8, ComSystemTemplateSystemSignalRef=DET_RCS_334
            DET_RCS_335_oRDR_DETECTION_333_336_oPCAN_RADAR_995515f6_Tx: ComBitPosition=352, ComBitSize=8, ComSignalInitValue=128, ComSignalType=UINT8, ComSystemTemplateSystemSignalRef=DET_RCS_335
            DET_RCS_336_oRDR_DETECTION_333_336_oPCAN_RADAR_fdb56e08_Tx: ComBitPosition=464, ComBitSize=8, ComSignalInitValue=128, ComSignalType=UINT8, ComSystemTemplateSystemSignalRef=DET_RCS_336
            DET_SNR_333_oRDR_DETECTION_333_336_oPCAN_RADAR_8d3bb608_Tx: ComBitPosition=120, ComBitSize=8, ComSignalInitValue=0, ComSignalType=UINT8, ComSystemTemplateSystemSignalRef=DET_SNR_333
            DET_SNR_334_oRDR_DETECTION_333_336_oPCAN_RADAR_d18b9561_Tx: ComBitPosition=232, ComBitSize=8, ComSignalInitValue=0, ComSignalType=UINT8, ComSystemTemplateSystemSignalRef=DET_SNR_334
            DET_SNR_335_oRDR_DETECTION_333_336_oPCAN_RADAR_44fb41f4_Tx: ComBitPosition=344, ComBitSize=8, ComSignalInitValue=0, ComSignalType=UINT8, ComSystemTemplateSystemSignalRef=DET_SNR_335
            DET_SNR_336_oRDR_DETECTION_333_336_oPCAN_RADAR_201b3a0a_Tx: ComBitPosition=456, ComBitSize=8, ComSignalInitValue=0, ComSignalType=UINT8, ComSystemTemplateSystemSignalRef=DET_SNR_336
            DET_SUPER_RES_TARGET_333_oRDR_DETECTION_333_336_oPCAN_RADAR_bca29e6d_Tx: ComBitPosition=87, ComBitSize=1, ComSignalInitValue=0, ComSignalType=BOOLEAN, ComSystemTemplateSystemSignalRef=DET_SUPER_RES_TARGET_333
            DET_SUPER_RES_TARGET_334_oRDR_DETECTION_333_336_oPCAN_RADAR_e012bd04_Tx: ComBitPosition=199, ComBitSize=1, ComSignalInitValue=0, ComSignalType=BOOLEAN, ComSystemTemplateSystemSignalRef=DET_SUPER_RES_TARGET_334
            DET_SUPER_RES_TARGET_335_oRDR_DETECTION_333_336_oPCAN_RADAR_75626991_Tx: ComBitPosition=311, ComBitSize=1, ComSignalInitValue=0, ComSignalType=BOOLEAN, ComSystemTemplateSystemSignalRef=DET_SUPER_RES_TARGET_335
            DET_SUPER_RES_TARGET_336_oRDR_DETECTION_333_336_oPCAN_RADAR_1182126f_Tx: ComBitPosition=423, ComBitSize=1, ComSignalInitValue=0, ComSignalType=BOOLEAN, ComSystemTemplateSystemSignalRef=DET_SUPER_RES_TARGET_336
        SG_Detections_337_340_oRDR_DETECTION_337_340_oPCAN_RADAR_6c24a51c_Tx: ComSystemTemplateSignalGroupRef=SG_Detections_337_340
          83 x ComGroupSignal, all with ComSignalEndianness=LITTLE_ENDIAN, ComTransferProperty=PENDING:
            DET_AZIMUTH_337_oRDR_DETECTION_337_340_oPCAN_RADAR_3c586e8b_Tx: ComBitPosition=88, ComBitSize=13, ComSignalInitValue=0, ComSignalType=UINT16, ComSystemTemplateSystemSignalRef=DET_AZIMUTH_337
            DET_AZIMUTH_338_oRDR_DETECTION_337_340_oPCAN_RADAR_1048fccc_Tx: ComBitPosition=200, ComBitSize=13, ComSignalInitValue=0, ComSignalType=UINT16, ComSystemTemplateSystemSignalRef=DET_AZIMUTH_338
            DET_AZIMUTH_339_oRDR_DETECTION_337_340_oPCAN_RADAR_85382859_Tx: ComBitPosition=312, ComBitSize=13, ComSignalInitValue=0, ComSignalType=UINT16, ComSystemTemplateSystemSignalRef=DET_AZIMUTH_339
            DET_AZIMUTH_340_oRDR_DETECTION_337_340_oPCAN_RADAR_54da243d_Tx: ComBitPosition=424, ComBitSize=13, ComSignalInitValue=0, ComSignalType=UINT16, ComSystemTemplateSystemSignalRef=DET_AZIMUTH_340
            DET_AZIMUTH_ERR_337_oRDR_DETECTION_337_340_oPCAN_RADAR_98edfb7e_Tx: ComBitPosition=105, ComBitSize=7, ComSignalInitValue=0, ComSignalType=UINT8, ComSystemTemplateSystemSignalRef=DET_AZIMUTH_ERR_337
            DET_AZIMUTH_ERR_338_oRDR_DETECTION_337_340_oPCAN_RADAR_b4fd6939_Tx: ComBitPosition=217, ComBitSize=7, ComSignalInitValue=0, ComSignalType=UINT8, ComSystemTemplateSystemSignalRef=DET_AZIMUTH_ERR_338
            DET_AZIMUTH_ERR_339_oRDR_DETECTION_337_340_oPCAN_RADAR_218dbdac_Tx: ComBitPosition=329, ComBitSize=7, ComSignalInitValue=0, ComSignalType=UINT8, ComSystemTemplateSystemSignalRef=DET_AZIMUTH_ERR_339
            DET_AZIMUTH_ERR_340_oRDR_DETECTION_337_340_oPCAN_RADAR_f06fb1c8_Tx: ComBitPosition=441, ComBitSize=7, ComSignalInitValue=0, ComSignalType=UINT8, ComSystemTemplateSystemSignalRef=DET_AZIMUTH_ERR_340
            DET_BELOW_RAIN_THOLD_337_oRDR_DETECTION_337_340_oPCAN_RADAR_e959fd4b_Tx: ComBitPosition=39, ComBitSize=1, ComSignalInitValue=0, ComSignalType=BOOLEAN, ComSystemTemplateSystemSignalRef=DET_BELOW_RAIN_THOLD_337
            DET_BELOW_RAIN_THOLD_338_oRDR_DETECTION_337_340_oPCAN_RADAR_c5496f0c_Tx: ComBitPosition=151, ComBitSize=1, ComSignalInitValue=0, ComSignalType=BOOLEAN, ComSystemTemplateSystemSignalRef=DET_BELOW_RAIN_THOLD_338
            DET_BELOW_RAIN_THOLD_339_oRDR_DETECTION_337_340_oPCAN_RADAR_5039bb99_Tx: ComBitPosition=263, ComBitSize=1, ComSignalInitValue=0, ComSignalType=BOOLEAN, ComSystemTemplateSystemSignalRef=DET_BELOW_RAIN_THOLD_339
            DET_BELOW_RAIN_THOLD_340_oRDR_DETECTION_337_340_oPCAN_RADAR_81dbb7fd_Tx: ComBitPosition=375, ComBitSize=1, ComSignalInitValue=0, ComSignalType=BOOLEAN, ComSystemTemplateSystemSignalRef=DET_BELOW_RAIN_THOLD_340
            DET_BI_STATIC_FLAG_337_oRDR_DETECTION_337_340_oPCAN_RADAR_6a742e0e_Tx: ComBitPosition=104, ComBitSize=1, ComSignalInitValue=0, ComSignalType=BOOLEAN, ComSystemTemplateSystemSignalRef=DET_BI_STATIC_FLAG_337
            DET_BI_STATIC_FLAG_338_oRDR_DETECTION_337_340_oPCAN_RADAR_4664bc49_Tx: ComBitPosition=216, ComBitSize=1, ComSignalInitValue=0, ComSignalType=BOOLEAN, ComSystemTemplateSystemSignalRef=DET_BI_STATIC_FLAG_338
            DET_BI_STATIC_FLAG_339_oRDR_DETECTION_337_340_oPCAN_RADAR_d31468dc_Tx: ComBitPosition=328, ComBitSize=1, ComSignalInitValue=0, ComSignalType=BOOLEAN, ComSystemTemplateSystemSignalRef=DET_BI_STATIC_FLAG_339
            DET_BI_STATIC_FLAG_340_oRDR_DETECTION_337_340_oPCAN_RADAR_02f664b8_Tx: ComBitPosition=440, ComBitSize=1, ComSignalInitValue=0, ComSignalType=BOOLEAN, ComSystemTemplateSystemSignalRef=DET_BI_STATIC_FLAG_340
            DET_CONFD_AZIMUTH_337_oRDR_DETECTION_337_340_oPCAN_RADAR_3ebe6441_Tx: ComBitPosition=118, ComBitSize=2, ComSignalInitValue=0, ComSignalType=UINT8, ComSystemTemplateSystemSignalRef=DET_CONFD_AZIMUTH_337
            DET_CONFD_AZIMUTH_338_oRDR_DETECTION_337_340_oPCAN_RADAR_12aef606_Tx: ComBitPosition=230, ComBitSize=2, ComSignalInitValue=0, ComSignalType=UINT8, ComSystemTemplateSystemSignalRef=DET_CONFD_AZIMUTH_338
            DET_CONFD_AZIMUTH_339_oRDR_DETECTION_337_340_oPCAN_RADAR_87de2293_Tx: ComBitPosition=342, ComBitSize=2, ComSignalInitValue=0, ComSignalType=UINT8, ComSystemTemplateSystemSignalRef=DET_CONFD_AZIMUTH_339
            DET_CONFD_AZIMUTH_340_oRDR_DETECTION_337_340_oPCAN_RADAR_563c2ef7_Tx: ComBitPosition=454, ComBitSize=2, ComSignalInitValue=0, ComSignalType=UINT8, ComSystemTemplateSystemSignalRef=DET_CONFD_AZIMUTH_340
            DET_CONFD_ELEVATION_337_oRDR_DETECTION_337_340_oPCAN_RADAR_3c2b65bb_Tx: ComBitPosition=101, ComBitSize=2, ComSignalInitValue=0, ComSignalType=UINT8, ComSystemTemplateSystemSignalRef=DET_CONFD_ELEVATION_337
            DET_CONFD_ELEVATION_338_oRDR_DETECTION_337_340_oPCAN_RADAR_103bf7fc_Tx: ComBitPosition=213, ComBitSize=2, ComSignalInitValue=0, ComSignalType=UINT8, ComSystemTemplateSystemSignalRef=DET_CONFD_ELEVATION_338
            DET_CONFD_ELEVATION_339_oRDR_DETECTION_337_340_oPCAN_RADAR_854b2369_Tx: ComBitPosition=325, ComBitSize=2, ComSignalInitValue=0, ComSignalType=UINT8, ComSystemTemplateSystemSignalRef=DET_CONFD_ELEVATION_339
            DET_CONFD_ELEVATION_340_oRDR_DETECTION_337_340_oPCAN_RADAR_54a92f0d_Tx: ComBitPosition=437, ComBitSize=2, ComSignalInitValue=0, ComSignalType=UINT8, ComSystemTemplateSystemSignalRef=DET_CONFD_ELEVATION_340
            DET_ELEVATION_337_oRDR_DETECTION_337_340_oPCAN_RADAR_edebb187_Tx: ComBitPosition=72, ComBitSize=8, ComSignalInitValue=0, ComSignalType=UINT8, ComSystemTemplateSystemSignalRef=DET_ELEVATION_337
            DET_ELEVATION_338_oRDR_DETECTION_337_340_oPCAN_RADAR_c1fb23c0_Tx: ComBitPosition=184, ComBitSize=8, ComSignalInitValue=0, ComSignalType=UINT8, ComSystemTemplateSystemSignalRef=DET_ELEVATION_338
            DET_ELEVATION_339_oRDR_DETECTION_337_340_oPCAN_RADAR_548bf755_Tx: ComBitPosition=296, ComBitSize=8, ComSignalInitValue=0, ComSignalType=UINT8, ComSystemTemplateSystemSignalRef=DET_ELEVATION_339
            DET_ELEVATION_340_oRDR_DETECTION_337_340_oPCAN_RADAR_8569fb31_Tx: ComBitPosition=408, ComBitSize=8, ComSignalInitValue=0, ComSignalType=UINT8, ComSystemTemplateSystemSignalRef=DET_ELEVATION_340
            DET_ELEVATION_ERR_337_oRDR_DETECTION_337_340_oPCAN_RADAR_6ad229f2_Tx: ComBitPosition=80, ComBitSize=6, ComSignalInitValue=0, ComSignalType=UINT8, ComSystemTemplateSystemSignalRef=DET_ELEVATION_ERR_337
            DET_ELEVATION_ERR_338_oRDR_DETECTION_337_340_oPCAN_RADAR_46c2bbb5_Tx: ComBitPosition=192, ComBitSize=6, ComSignalInitValue=0, ComSignalType=UINT8, ComSystemTemplateSystemSignalRef=DET_ELEVATION_ERR_338
            DET_ELEVATION_ERR_339_oRDR_DETECTION_337_340_oPCAN_RADAR_d3b26f20_Tx: ComBitPosition=304, ComBitSize=6, ComSignalInitValue=0, ComSignalType=UINT8, ComSystemTemplateSystemSignalRef=DET_ELEVATION_ERR_339
            DET_ELEVATION_ERR_340_oRDR_DETECTION_337_340_oPCAN_RADAR_02506344_Tx: ComBitPosition=416, ComBitSize=6, ComSignalInitValue=0, ComSignalType=UINT8, ComSystemTemplateSystemSignalRef=DET_ELEVATION_ERR_340
            DET_EXISTENCE_PROB_337_oRDR_DETECTION_337_340_oPCAN_RADAR_b84d5c92_Tx: ComBitPosition=112, ComBitSize=6, ComSignalInitValue=0, ComSignalType=UINT8, ComSystemTemplateSystemSignalRef=DET_EXISTENCE_PROB_337
            DET_EXISTENCE_PROB_338_oRDR_DETECTION_337_340_oPCAN_RADAR_945dced5_Tx: ComBitPosition=224, ComBitSize=6, ComSignalInitValue=0, ComSignalType=UINT8, ComSystemTemplateSystemSignalRef=DET_EXISTENCE_PROB_338
            DET_EXISTENCE_PROB_339_oRDR_DETECTION_337_340_oPCAN_RADAR_012d1a40_Tx: ComBitPosition=336, ComBitSize=6, ComSignalInitValue=0, ComSignalType=UINT8, ComSystemTemplateSystemSignalRef=DET_EXISTENCE_PROB_339
            DET_EXISTENCE_PROB_340_oRDR_DETECTION_337_340_oPCAN_RADAR_d0cf1624_Tx: ComBitPosition=448, ComBitSize=6, ComSignalInitValue=0, ComSignalType=UINT8, ComSystemTemplateSystemSignalRef=DET_EXISTENCE_PROB_340
            DET_HVC_FLAG_337_oRDR_DETECTION_337_340_oPCAN_RADAR_59391fed_Tx: ComBitPosition=86, ComBitSize=1, ComSignalInitValue=0, ComSignalType=BOOLEAN, ComSystemTemplateSystemSignalRef=DET_HVC_FLAG_337
            DET_HVC_FLAG_338_oRDR_DETECTION_337_340_oPCAN_RADAR_75298daa_Tx: ComBitPosition=198, ComBitSize=1, ComSignalInitValue=0, ComSignalType=BOOLEAN, ComSystemTemplateSystemSignalRef=DET_HVC_FLAG_338
            DET_HVC_FLAG_339_oRDR_DETECTION_337_340_oPCAN_RADAR_e059593f_Tx: ComBitPosition=310, ComBitSize=1, ComSignalInitValue=0, ComSignalType=BOOLEAN, ComSystemTemplateSystemSignalRef=DET_HVC_FLAG_339
            DET_HVC_FLAG_340_oRDR_DETECTION_337_340_oPCAN_RADAR_31bb555b_Tx: ComBitPosition=422, ComBitSize=1, ComSignalInitValue=0, ComSignalType=BOOLEAN, ComSystemTemplateSystemSignalRef=DET_HVC_FLAG_340
            DET_IDM_337_oRDR_DETECTION_337_340_oPCAN_RADAR_d26b2450_Tx: ComBitPosition=63, ComBitSize=1, ComSignalInitValue=0, ComSignalType=BOOLEAN, ComSystemTemplateSystemSignalRef=DET_IDM_337
            DET_IDM_338_oRDR_DETECTION_337_340_oPCAN_RADAR_fe7bb617_Tx: ComBitPosition=175, ComBitSize=1, ComSignalInitValue=0, ComSignalType=BOOLEAN, ComSystemTemplateSystemSignalRef=DET_IDM_338
            DET_IDM_339_oRDR_DETECTION_337_340_oPCAN_RADAR_6b0b6282_Tx: ComBitPosition=287, ComBitSize=1, ComSignalInitValue=0, ComSignalType=BOOLEAN, ComSystemTemplateSystemSignalRef=DET_IDM_339
            DET_IDM_340_oRDR_DETECTION_337_340_oPCAN_RADAR_bae96ee6_Tx: ComBitPosition=399, ComBitSize=1, ComSignalInitValue=0, ComSignalType=BOOLEAN, ComSystemTemplateSystemSignalRef=DET_IDM_340
            DET_MH_CRC16_337_340_oRDR_DETECTION_337_340_oPCAN_RADAR_e8ac7717_Tx: ComBitPosition=0, ComBitSize=16, ComSignalInitValue=0, ComSignalType=UINT16, ComSystemTemplateSystemSignalRef=DET_MH_CRC16_337_340
            DET_MH_CYCLE_COUNTER_337_340_oRDR_DETECTION_337_340_oPCAN_RADAR_6cd9d620_Tx: ComBitPosition=16, ComBitSize=8, ComSignalInitValue=0, ComSignalType=UINT8, ComSystemTemplateSystemSignalRef=DET_MH_CYCLE_COUNTER_337_340
            DET_MH_SCAN_INDEX_4LSB_337_340_oRDR_DETECTION_337_340_oPCAN_RADAR_a0f3f3ac_Tx: ComBitPosition=476, ComBitSize=4, ComSignalInitValue=0, ComSignalType=UINT8, ComSystemTemplateSystemSignalRef=DET_MH_SCAN_INDEX_4LSB_337_340
            DET_MTD_337_oRDR_DETECTION_337_340_oPCAN_RADAR_b4d8168b_Tx: ComBitPosition=47, ComBitSize=1, ComSignalInitValue=0, ComSignalType=BOOLEAN, ComSystemTemplateSystemSignalRef=DET_MTD_337
            DET_MTD_338_oRDR_DETECTION_337_340_oPCAN_RADAR_98c884cc_Tx: ComBitPosition=159, ComBitSize=1, ComSignalInitValue=0, ComSignalType=BOOLEAN, ComSystemTemplateSystemSignalRef=DET_MTD_338
            DET_MTD_339_oRDR_DETECTION_337_340_oPCAN_RADAR_0db85059_Tx: ComBitPosition=271, ComBitSize=1, ComSignalInitValue=0, ComSignalType=BOOLEAN, ComSystemTemplateSystemSignalRef=DET_MTD_339
            DET_MTD_340_oRDR_DETECTION_337_340_oPCAN_RADAR_dc5a5c3d_Tx: ComBitPosition=383, ComBitSize=1, ComSignalInitValue=0, ComSignalType=BOOLEAN, ComSystemTemplateSystemSignalRef=DET_MTD_340
            DET_PROB_1STAZHYPO_337_oRDR_DETECTION_337_340_oPCAN_RADAR_276cfe46_Tx: ComBitPosition=103, ComBitSize=1, ComSignalInitValue=0, ComSignalType=BOOLEAN, ComSystemTemplateSystemSignalRef=DET_PROB_1STAZHYPO_337
            DET_PROB_1STAZHYPO_338_oRDR_DETECTION_337_340_oPCAN_RADAR_0b7c6c01_Tx: ComBitPosition=215, ComBitSize=1, ComSignalInitValue=0, ComSignalType=BOOLEAN, ComSystemTemplateSystemSignalRef=DET_PROB_1STAZHYPO_338
            DET_PROB_1STAZHYPO_339_oRDR_DETECTION_337_340_oPCAN_RADAR_9e0cb894_Tx: ComBitPosition=327, ComBitSize=1, ComSignalInitValue=0, ComSignalType=BOOLEAN, ComSystemTemplateSystemSignalRef=DET_PROB_1STAZHYPO_339
            DET_PROB_1STAZHYPO_340_oRDR_DETECTION_337_340_oPCAN_RADAR_4feeb4f0_Tx: ComBitPosition=439, ComBitSize=1, ComSignalInitValue=0, ComSignalType=BOOLEAN, ComSystemTemplateSystemSignalRef=DET_PROB_1STAZHYPO_340
            DET_RANGE_337_oRDR_DETECTION_337_340_oPCAN_RADAR_2cc31d30_Tx: ComBitPosition=24, ComBitSize=15, ComSignalInitValue=0, ComSignalType=UINT16, ComSystemTemplateSystemSignalRef=DET_RANGE_337
            DET_RANGE_338_oRDR_DETECTION_337_340_oPCAN_RADAR_00d38f77_Tx: ComBitPosition=136, ComBitSize=15, ComSignalInitValue=0, ComSignalType=UINT16, ComSystemTemplateSystemSignalRef=DET_RANGE_338
            DET_RANGE_339_oRDR_DETECTION_337_340_oPCAN_RADAR_95a35be2_Tx: ComBitPosition=248, ComBitSize=15, ComSignalInitValue=0, ComSignalType=UINT16, ComSystemTemplateSystemSignalRef=DET_RANGE_339
            DET_RANGE_340_oRDR_DETECTION_337_340_oPCAN_RADAR_44415786_Tx: ComBitPosition=360, ComBitSize=15, ComSignalInitValue=0, ComSignalType=UINT16, ComSystemTemplateSystemSignalRef=DET_RANGE_340
            DET_RANGE_ERR_337_oRDR_DETECTION_337_340_oPCAN_RADAR_8b2ba759_Tx: ComBitPosition=40, ComBitSize=7, ComSignalInitValue=0, ComSignalType=UINT8, ComSystemTemplateSystemSignalRef=DET_RANGE_ERR_337
            DET_RANGE_ERR_338_oRDR_DETECTION_337_340_oPCAN_RADAR_a73b351e_Tx: ComBitPosition=152, ComBitSize=7, ComSignalInitValue=0, ComSignalType=UINT8, ComSystemTemplateSystemSignalRef=DET_RANGE_ERR_338
            DET_RANGE_ERR_339_oRDR_DETECTION_337_340_oPCAN_RADAR_324be18b_Tx: ComBitPosition=264, ComBitSize=7, ComSignalInitValue=0, ComSignalType=UINT8, ComSystemTemplateSystemSignalRef=DET_RANGE_ERR_339
            DET_RANGE_ERR_340_oRDR_DETECTION_337_340_oPCAN_RADAR_e3a9edef_Tx: ComBitPosition=376, ComBitSize=7, ComSignalInitValue=0, ComSignalType=UINT8, ComSystemTemplateSystemSignalRef=DET_RANGE_ERR_340
            DET_RANGE_VELOCITY_337_oRDR_DETECTION_337_340_oPCAN_RADAR_5965df15_Tx: ComBitPosition=48, ComBitSize=15, ComSignalInitValue=16384, ComSignalType=UINT16, ComSystemTemplateSystemSignalRef=DET_RANGE_VELOCITY_337
            DET_RANGE_VELOCITY_338_oRDR_DETECTION_337_340_oPCAN_RADAR_75754d52_Tx: ComBitPosition=160, ComBitSize=15, ComSignalInitValue=16384, ComSignalType=UINT16, ComSystemTemplateSystemSignalRef=DET_RANGE_VELOCITY_338
            DET_RANGE_VELOCITY_339_oRDR_DETECTION_337_340_oPCAN_RADAR_e00599c7_Tx: ComBitPosition=272, ComBitSize=15, ComSignalInitValue=16384, ComSignalType=UINT16, ComSystemTemplateSystemSignalRef=DET_RANGE_VELOCITY_339
            DET_RANGE_VELOCITY_340_oRDR_DETECTION_337_340_oPCAN_RADAR_31e795a3_Tx: ComBitPosition=384, ComBitSize=15, ComSignalInitValue=16384, ComSignalType=UINT16, ComSystemTemplateSystemSignalRef=DET_RANGE_VELOCITY_340
            DET_RANGE_VELOCITY_ERR_337_oRDR_DETECTION_337_340_oPCAN_RADAR_56de24a7_Tx: ComBitPosition=64, ComBitSize=8, ComSignalInitValue=0, ComSignalType=UINT8, ComSystemTemplateSystemSignalRef=DET_RANGE_VELOCITY_ERR_337
            DET_RANGE_VELOCITY_ERR_338_oRDR_DETECTION_337_340_oPCAN_RADAR_7aceb6e0_Tx: ComBitPosition=176, ComBitSize=8, ComSignalInitValue=0, ComSignalType=UINT8, ComSystemTemplateSystemSignalRef=DET_RANGE_VELOCITY_ERR_338
            DET_RANGE_VELOCITY_ERR_339_oRDR_DETECTION_337_340_oPCAN_RADAR_efbe6275_Tx: ComBitPosition=288, ComBitSize=8, ComSignalInitValue=0, ComSignalType=UINT8, ComSystemTemplateSystemSignalRef=DET_RANGE_VELOCITY_ERR_339
            DET_RANGE_VELOCITY_ERR_340_oRDR_DETECTION_337_340_oPCAN_RADAR_3e5c6e11_Tx: ComBitPosition=400, ComBitSize=8, ComSignalInitValue=0, ComSignalType=UINT8, ComSystemTemplateSystemSignalRef=DET_RANGE_VELOCITY_ERR_340
            DET_RCS_337_oRDR_DETECTION_337_340_oPCAN_RADAR_dee5e84f_Tx: ComBitPosition=128, ComBitSize=8, ComSignalInitValue=128, ComSignalType=UINT8, ComSystemTemplateSystemSignalRef=DET_RCS_337
            DET_RCS_338_oRDR_DETECTION_337_340_oPCAN_RADAR_f2f57a08_Tx: ComBitPosition=240, ComBitSize=8, ComSignalInitValue=128, ComSignalType=UINT8, ComSystemTemplateSystemSignalRef=DET_RCS_338
            DET_RCS_339_oRDR_DETECTION_337_340_oPCAN_RADAR_6785ae9d_Tx: ComBitPosition=352, ComBitSize=8, ComSignalInitValue=128, ComSignalType=UINT8, ComSystemTemplateSystemSignalRef=DET_RCS_339
            DET_RCS_340_oRDR_DETECTION_337_340_oPCAN_RADAR_b667a2f9_Tx: ComBitPosition=464, ComBitSize=8, ComSignalInitValue=128, ComSignalType=UINT8, ComSystemTemplateSystemSignalRef=DET_RCS_340
            DET_SNR_337_oRDR_DETECTION_337_340_oPCAN_RADAR_034bbc4d_Tx: ComBitPosition=120, ComBitSize=8, ComSignalInitValue=0, ComSignalType=UINT8, ComSystemTemplateSystemSignalRef=DET_SNR_337
            DET_SNR_338_oRDR_DETECTION_337_340_oPCAN_RADAR_2f5b2e0a_Tx: ComBitPosition=232, ComBitSize=8, ComSignalInitValue=0, ComSignalType=UINT8, ComSystemTemplateSystemSignalRef=DET_SNR_338
            DET_SNR_339_oRDR_DETECTION_337_340_oPCAN_RADAR_ba2bfa9f_Tx: ComBitPosition=344, ComBitSize=8, ComSignalInitValue=0, ComSignalType=UINT8, ComSystemTemplateSystemSignalRef=DET_SNR_339
            DET_SNR_340_oRDR_DETECTION_337_340_oPCAN_RADAR_6bc9f6fb_Tx: ComBitPosition=456, ComBitSize=8, ComSignalInitValue=0, ComSignalType=UINT8, ComSystemTemplateSystemSignalRef=DET_SNR_340
            DET_SUPER_RES_TARGET_337_oRDR_DETECTION_337_340_oPCAN_RADAR_32d29428_Tx: ComBitPosition=87, ComBitSize=1, ComSignalInitValue=0, ComSignalType=BOOLEAN, ComSystemTemplateSystemSignalRef=DET_SUPER_RES_TARGET_337
            DET_SUPER_RES_TARGET_338_oRDR_DETECTION_337_340_oPCAN_RADAR_1ec2066f_Tx: ComBitPosition=199, ComBitSize=1, ComSignalInitValue=0, ComSignalType=BOOLEAN, ComSystemTemplateSystemSignalRef=DET_SUPER_RES_TARGET_338
            DET_SUPER_RES_TARGET_339_oRDR_DETECTION_337_340_oPCAN_RADAR_8bb2d2fa_Tx: ComBitPosition=311, ComBitSize=1, ComSignalInitValue=0, ComSignalType=BOOLEAN, ComSystemTemplateSystemSignalRef=DET_SUPER_RES_TARGET_339
            DET_SUPER_RES_TARGET_340_oRDR_DETECTION_337_340_oPCAN_RADAR_5a50de9e_Tx: ComBitPosition=423, ComBitSize=1, ComSignalInitValue=0, ComSignalType=BOOLEAN, ComSystemTemplateSystemSignalRef=DET_SUPER_RES_TARGET_340
        SG_Detections_341_344_oRDR_DETECTION_341_344_oPCAN_RADAR_725bb2c5_Tx: ComSystemTemplateSignalGroupRef=SG_Detections_341_344
          83 x ComGroupSignal, all with ComSignalEndianness=LITTLE_ENDIAN, ComTransferProperty=PENDING:
            DET_AZIMUTH_341_oRDR_DETECTION_341_344_oPCAN_RADAR_47092752_Tx: ComBitPosition=88, ComBitSize=13, ComSignalInitValue=0, ComSignalType=UINT16, ComSystemTemplateSystemSignalRef=DET_AZIMUTH_341
            DET_AZIMUTH_342_oRDR_DETECTION_341_344_oPCAN_RADAR_23e95cac_Tx: ComBitPosition=200, ComBitSize=13, ComSignalInitValue=0, ComSignalType=UINT16, ComSystemTemplateSystemSignalRef=DET_AZIMUTH_342
            DET_AZIMUTH_343_oRDR_DETECTION_341_344_oPCAN_RADAR_b6998839_Tx: ComBitPosition=312, ComBitSize=13, ComSignalInitValue=0, ComSignalType=UINT16, ComSystemTemplateSystemSignalRef=DET_AZIMUTH_343
            DET_AZIMUTH_344_oRDR_DETECTION_341_344_oPCAN_RADAR_ea29ab50_Tx: ComBitPosition=424, ComBitSize=13, ComSignalInitValue=0, ComSignalType=UINT16, ComSystemTemplateSystemSignalRef=DET_AZIMUTH_344
            DET_AZIMUTH_ERR_341_oRDR_DETECTION_341_344_oPCAN_RADAR_e3bcb2a7_Tx: ComBitPosition=105, ComBitSize=7, ComSignalInitValue=0, ComSignalType=UINT8, ComSystemTemplateSystemSignalRef=DET_AZIMUTH_ERR_341
            DET_AZIMUTH_ERR_342_oRDR_DETECTION_341_344_oPCAN_RADAR_875cc959_Tx: ComBitPosition=217, ComBitSize=7, ComSignalInitValue=0, ComSignalType=UINT8, ComSystemTemplateSystemSignalRef=DET_AZIMUTH_ERR_342
            DET_AZIMUTH_ERR_343_oRDR_DETECTION_341_344_oPCAN_RADAR_122c1dcc_Tx: ComBitPosition=329, ComBitSize=7, ComSignalInitValue=0, ComSignalType=UINT8, ComSystemTemplateSystemSignalRef=DET_AZIMUTH_ERR_343
            DET_AZIMUTH_ERR_344_oRDR_DETECTION_341_344_oPCAN_RADAR_4e9c3ea5_Tx: ComBitPosition=441, ComBitSize=7, ComSignalInitValue=0, ComSignalType=UINT8, ComSystemTemplateSystemSignalRef=DET_AZIMUTH_ERR_344
            DET_BELOW_RAIN_THOLD_341_oRDR_DETECTION_341_344_oPCAN_RADAR_9208b492_Tx: ComBitPosition=39, ComBitSize=1, ComSignalInitValue=0, ComSignalType=BOOLEAN, ComSystemTemplateSystemSignalRef=DET_BELOW_RAIN_THOLD_341
            DET_BELOW_RAIN_THOLD_342_oRDR_DETECTION_341_344_oPCAN_RADAR_f6e8cf6c_Tx: ComBitPosition=151, ComBitSize=1, ComSignalInitValue=0, ComSignalType=BOOLEAN, ComSystemTemplateSystemSignalRef=DET_BELOW_RAIN_THOLD_342
            DET_BELOW_RAIN_THOLD_343_oRDR_DETECTION_341_344_oPCAN_RADAR_63981bf9_Tx: ComBitPosition=263, ComBitSize=1, ComSignalInitValue=0, ComSignalType=BOOLEAN, ComSystemTemplateSystemSignalRef=DET_BELOW_RAIN_THOLD_343
            DET_BELOW_RAIN_THOLD_344_oRDR_DETECTION_341_344_oPCAN_RADAR_3f283890_Tx: ComBitPosition=375, ComBitSize=1, ComSignalInitValue=0, ComSignalType=BOOLEAN, ComSystemTemplateSystemSignalRef=DET_BELOW_RAIN_THOLD_344
            DET_BI_STATIC_FLAG_341_oRDR_DETECTION_341_344_oPCAN_RADAR_112567d7_Tx: ComBitPosition=104, ComBitSize=1, ComSignalInitValue=0, ComSignalType=BOOLEAN, ComSystemTemplateSystemSignalRef=DET_BI_STATIC_FLAG_341
            DET_BI_STATIC_FLAG_342_oRDR_DETECTION_341_344_oPCAN_RADAR_75c51c29_Tx: ComBitPosition=216, ComBitSize=1, ComSignalInitValue=0, ComSignalType=BOOLEAN, ComSystemTemplateSystemSignalRef=DET_BI_STATIC_FLAG_342
            DET_BI_STATIC_FLAG_343_oRDR_DETECTION_341_344_oPCAN_RADAR_e0b5c8bc_Tx: ComBitPosition=328, ComBitSize=1, ComSignalInitValue=0, ComSignalType=BOOLEAN, ComSystemTemplateSystemSignalRef=DET_BI_STATIC_FLAG_343
            DET_BI_STATIC_FLAG_344_oRDR_DETECTION_341_344_oPCAN_RADAR_bc05ebd5_Tx: ComBitPosition=440, ComBitSize=1, ComSignalInitValue=0, ComSignalType=BOOLEAN, ComSystemTemplateSystemSignalRef=DET_BI_STATIC_FLAG_344
            DET_CONFD_AZIMUTH_341_oRDR_DETECTION_341_344_oPCAN_RADAR_45ef2d98_Tx: ComBitPosition=118, ComBitSize=2, ComSignalInitValue=0, ComSignalType=UINT8, ComSystemTemplateSystemSignalRef=DET_CONFD_AZIMUTH_341
            DET_CONFD_AZIMUTH_342_oRDR_DETECTION_341_344_oPCAN_RADAR_210f5666_Tx: ComBitPosition=230, ComBitSize=2, ComSignalInitValue=0, ComSignalType=UINT8, ComSystemTemplateSystemSignalRef=DET_CONFD_AZIMUTH_342
            DET_CONFD_AZIMUTH_343_oRDR_DETECTION_341_344_oPCAN_RADAR_b47f82f3_Tx: ComBitPosition=342, ComBitSize=2, ComSignalInitValue=0, ComSignalType=UINT8, ComSystemTemplateSystemSignalRef=DET_CONFD_AZIMUTH_343
            DET_CONFD_AZIMUTH_344_oRDR_DETECTION_341_344_oPCAN_RADAR_e8cfa19a_Tx: ComBitPosition=454, ComBitSize=2, ComSignalInitValue=0, ComSignalType=UINT8, ComSystemTemplateSystemSignalRef=DET_CONFD_AZIMUTH_344
            DET_CONFD_ELEVATION_341_oRDR_DETECTION_341_344_oPCAN_RADAR_477a2c62_Tx: ComBitPosition=101, ComBitSize=2, ComSignalInitValue=0, ComSignalType=UINT8, ComSystemTemplateSystemSignalRef=DET_CONFD_ELEVATION_341
            DET_CONFD_ELEVATION_342_oRDR_DETECTION_341_344_oPCAN_RADAR_239a579c_Tx: ComBitPosition=213, ComBitSize=2, ComSignalInitValue=0, ComSignalType=UINT8, ComSystemTemplateSystemSignalRef=DET_CONFD_ELEVATION_342
            DET_CONFD_ELEVATION_343_oRDR_DETECTION_341_344_oPCAN_RADAR_b6ea8309_Tx: ComBitPosition=325, ComBitSize=2, ComSignalInitValue=0, ComSignalType=UINT8, ComSystemTemplateSystemSignalRef=DET_CONFD_ELEVATION_343
            DET_CONFD_ELEVATION_344_oRDR_DETECTION_341_344_oPCAN_RADAR_ea5aa060_Tx: ComBitPosition=437, ComBitSize=2, ComSignalInitValue=0, ComSignalType=UINT8, ComSystemTemplateSystemSignalRef=DET_CONFD_ELEVATION_344
            DET_ELEVATION_341_oRDR_DETECTION_341_344_oPCAN_RADAR_96baf85e_Tx: ComBitPosition=72, ComBitSize=8, ComSignalInitValue=0, ComSignalType=UINT8, ComSystemTemplateSystemSignalRef=DET_ELEVATION_341
            DET_ELEVATION_342_oRDR_DETECTION_341_344_oPCAN_RADAR_f25a83a0_Tx: ComBitPosition=184, ComBitSize=8, ComSignalInitValue=0, ComSignalType=UINT8, ComSystemTemplateSystemSignalRef=DET_ELEVATION_342
            DET_ELEVATION_343_oRDR_DETECTION_341_344_oPCAN_RADAR_672a5735_Tx: ComBitPosition=296, ComBitSize=8, ComSignalInitValue=0, ComSignalType=UINT8, ComSystemTemplateSystemSignalRef=DET_ELEVATION_343
            DET_ELEVATION_344_oRDR_DETECTION_341_344_oPCAN_RADAR_3b9a745c_Tx: ComBitPosition=408, ComBitSize=8, ComSignalInitValue=0, ComSignalType=UINT8, ComSystemTemplateSystemSignalRef=DET_ELEVATION_344
            DET_ELEVATION_ERR_341_oRDR_DETECTION_341_344_oPCAN_RADAR_1183602b_Tx: ComBitPosition=80, ComBitSize=6, ComSignalInitValue=0, ComSignalType=UINT8, ComSystemTemplateSystemSignalRef=DET_ELEVATION_ERR_341
            DET_ELEVATION_ERR_342_oRDR_DETECTION_341_344_oPCAN_RADAR_75631bd5_Tx: ComBitPosition=192, ComBitSize=6, ComSignalInitValue=0, ComSignalType=UINT8, ComSystemTemplateSystemSignalRef=DET_ELEVATION_ERR_342
            DET_ELEVATION_ERR_343_oRDR_DETECTION_341_344_oPCAN_RADAR_e013cf40_Tx: ComBitPosition=304, ComBitSize=6, ComSignalInitValue=0, ComSignalType=UINT8, ComSystemTemplateSystemSignalRef=DET_ELEVATION_ERR_343
            DET_ELEVATION_ERR_344_oRDR_DETECTION_341_344_oPCAN_RADAR_bca3ec29_Tx: ComBitPosition=416, ComBitSize=6, ComSignalInitValue=0, ComSignalType=UINT8, ComSystemTemplateSystemSignalRef=DET_ELEVATION_ERR_344
            DET_EXISTENCE_PROB_341_oRDR_DETECTION_341_344_oPCAN_RADAR_c31c154b_Tx: ComBitPosition=112, ComBitSize=6, ComSignalInitValue=0, ComSignalType=UINT8, ComSystemTemplateSystemSignalRef=DET_EXISTENCE_PROB_341
            DET_EXISTENCE_PROB_342_oRDR_DETECTION_341_344_oPCAN_RADAR_a7fc6eb5_Tx: ComBitPosition=224, ComBitSize=6, ComSignalInitValue=0, ComSignalType=UINT8, ComSystemTemplateSystemSignalRef=DET_EXISTENCE_PROB_342
            DET_EXISTENCE_PROB_343_oRDR_DETECTION_341_344_oPCAN_RADAR_328cba20_Tx: ComBitPosition=336, ComBitSize=6, ComSignalInitValue=0, ComSignalType=UINT8, ComSystemTemplateSystemSignalRef=DET_EXISTENCE_PROB_343
            DET_EXISTENCE_PROB_344_oRDR_DETECTION_341_344_oPCAN_RADAR_6e3c9949_Tx: ComBitPosition=448, ComBitSize=6, ComSignalInitValue=0, ComSignalType=UINT8, ComSystemTemplateSystemSignalRef=DET_EXISTENCE_PROB_344
            DET_HVC_FLAG_341_oRDR_DETECTION_341_344_oPCAN_RADAR_22685634_Tx: ComBitPosition=86, ComBitSize=1, ComSignalInitValue=0, ComSignalType=BOOLEAN, ComSystemTemplateSystemSignalRef=DET_HVC_FLAG_341
            DET_HVC_FLAG_342_oRDR_DETECTION_341_344_oPCAN_RADAR_46882dca_Tx: ComBitPosition=198, ComBitSize=1, ComSignalInitValue=0, ComSignalType=BOOLEAN, ComSystemTemplateSystemSignalRef=DET_HVC_FLAG_342
            DET_HVC_FLAG_343_oRDR_DETECTION_341_344_oPCAN_RADAR_d3f8f95f_Tx: ComBitPosition=310, ComBitSize=1, ComSignalInitValue=0, ComSignalType=BOOLEAN, ComSystemTemplateSystemSignalRef=DET_HVC_FLAG_343
            DET_HVC_FLAG_344_oRDR_DETECTION_341_344_oPCAN_RADAR_8f48da36_Tx: ComBitPosition=422, ComBitSize=1, ComSignalInitValue=0, ComSignalType=BOOLEAN, ComSystemTemplateSystemSignalRef=DET_HVC_FLAG_344
            DET_IDM_341_oRDR_DETECTION_341_344_oPCAN_RADAR_a93a6d89_Tx: ComBitPosition=63, ComBitSize=1, ComSignalInitValue=0, ComSignalType=BOOLEAN, ComSystemTemplateSystemSignalRef=DET_IDM_341
            DET_IDM_342_oRDR_DETECTION_341_344_oPCAN_RADAR_cdda1677_Tx: ComBitPosition=175, ComBitSize=1, ComSignalInitValue=0, ComSignalType=BOOLEAN, ComSystemTemplateSystemSignalRef=DET_IDM_342
            DET_IDM_343_oRDR_DETECTION_341_344_oPCAN_RADAR_58aac2e2_Tx: ComBitPosition=287, ComBitSize=1, ComSignalInitValue=0, ComSignalType=BOOLEAN, ComSystemTemplateSystemSignalRef=DET_IDM_343
            DET_IDM_344_oRDR_DETECTION_341_344_oPCAN_RADAR_041ae18b_Tx: ComBitPosition=399, ComBitSize=1, ComSignalInitValue=0, ComSignalType=BOOLEAN, ComSystemTemplateSystemSignalRef=DET_IDM_344
            DET_MH_CRC16_341_344_oRDR_DETECTION_341_344_oPCAN_RADAR_f6d360ce_Tx: ComBitPosition=0, ComBitSize=16, ComSignalInitValue=0, ComSignalType=UINT16, ComSystemTemplateSystemSignalRef=DET_MH_CRC16_341_344
            DET_MH_CYCLE_COUNTER_341_344_oRDR_DETECTION_341_344_oPCAN_RADAR_72a6c1f9_Tx: ComBitPosition=16, ComBitSize=8, ComSignalInitValue=0, ComSignalType=UINT8, ComSystemTemplateSystemSignalRef=DET_MH_CYCLE_COUNTER_341_344
            DET_MH_SCAN_INDEX_4LSB_341_344_oRDR_DETECTION_341_344_oPCAN_RADAR_be8ce475_Tx: ComBitPosition=476, ComBitSize=4, ComSignalInitValue=0, ComSignalType=UINT8, ComSystemTemplateSystemSignalRef=DET_MH_SCAN_INDEX_4LSB_341_344
            DET_MTD_341_oRDR_DETECTION_341_344_oPCAN_RADAR_cf895f52_Tx: ComBitPosition=47, ComBitSize=1, ComSignalInitValue=0, ComSignalType=BOOLEAN, ComSystemTemplateSystemSignalRef=DET_MTD_341
            DET_MTD_342_oRDR_DETECTION_341_344_oPCAN_RADAR_ab6924ac_Tx: ComBitPosition=159, ComBitSize=1, ComSignalInitValue=0, ComSignalType=BOOLEAN, ComSystemTemplateSystemSignalRef=DET_MTD_342
            DET_MTD_343_oRDR_DETECTION_341_344_oPCAN_RADAR_3e19f039_Tx: ComBitPosition=271, ComBitSize=1, ComSignalInitValue=0, ComSignalType=BOOLEAN, ComSystemTemplateSystemSignalRef=DET_MTD_343
            DET_MTD_344_oRDR_DETECTION_341_344_oPCAN_RADAR_62a9d350_Tx: ComBitPosition=383, ComBitSize=1, ComSignalInitValue=0, ComSignalType=BOOLEAN, ComSystemTemplateSystemSignalRef=DET_MTD_344
            DET_PROB_1STAZHYPO_341_oRDR_DETECTION_341_344_oPCAN_RADAR_5c3db79f_Tx: ComBitPosition=103, ComBitSize=1, ComSignalInitValue=0, ComSignalType=BOOLEAN, ComSystemTemplateSystemSignalRef=DET_PROB_1STAZHYPO_341
            DET_PROB_1STAZHYPO_342_oRDR_DETECTION_341_344_oPCAN_RADAR_38ddcc61_Tx: ComBitPosition=215, ComBitSize=1, ComSignalInitValue=0, ComSignalType=BOOLEAN, ComSystemTemplateSystemSignalRef=DET_PROB_1STAZHYPO_342
            DET_PROB_1STAZHYPO_343_oRDR_DETECTION_341_344_oPCAN_RADAR_adad18f4_Tx: ComBitPosition=327, ComBitSize=1, ComSignalInitValue=0, ComSignalType=BOOLEAN, ComSystemTemplateSystemSignalRef=DET_PROB_1STAZHYPO_343
            DET_PROB_1STAZHYPO_344_oRDR_DETECTION_341_344_oPCAN_RADAR_f11d3b9d_Tx: ComBitPosition=439, ComBitSize=1, ComSignalInitValue=0, ComSignalType=BOOLEAN, ComSystemTemplateSystemSignalRef=DET_PROB_1STAZHYPO_344
            DET_RANGE_341_oRDR_DETECTION_341_344_oPCAN_RADAR_579254e9_Tx: ComBitPosition=24, ComBitSize=15, ComSignalInitValue=0, ComSignalType=UINT16, ComSystemTemplateSystemSignalRef=DET_RANGE_341
            DET_RANGE_342_oRDR_DETECTION_341_344_oPCAN_RADAR_33722f17_Tx: ComBitPosition=136, ComBitSize=15, ComSignalInitValue=0, ComSignalType=UINT16, ComSystemTemplateSystemSignalRef=DET_RANGE_342
            DET_RANGE_343_oRDR_DETECTION_341_344_oPCAN_RADAR_a602fb82_Tx: ComBitPosition=248, ComBitSize=15, ComSignalInitValue=0, ComSignalType=UINT16, ComSystemTemplateSystemSignalRef=DET_RANGE_343
            DET_RANGE_344_oRDR_DETECTION_341_344_oPCAN_RADAR_fab2d8eb_Tx: ComBitPosition=360, ComBitSize=15, ComSignalInitValue=0, ComSignalType=UINT16, ComSystemTemplateSystemSignalRef=DET_RANGE_344
            DET_RANGE_ERR_341_oRDR_DETECTION_341_344_oPCAN_RADAR_f07aee80_Tx: ComBitPosition=40, ComBitSize=7, ComSignalInitValue=0, ComSignalType=UINT8, ComSystemTemplateSystemSignalRef=DET_RANGE_ERR_341
            DET_RANGE_ERR_342_oRDR_DETECTION_341_344_oPCAN_RADAR_949a957e_Tx: ComBitPosition=152, ComBitSize=7, ComSignalInitValue=0, ComSignalType=UINT8, ComSystemTemplateSystemSignalRef=DET_RANGE_ERR_342
            DET_RANGE_ERR_343_oRDR_DETECTION_341_344_oPCAN_RADAR_01ea41eb_Tx: ComBitPosition=264, ComBitSize=7, ComSignalInitValue=0, ComSignalType=UINT8, ComSystemTemplateSystemSignalRef=DET_RANGE_ERR_343
            DET_RANGE_ERR_344_oRDR_DETECTION_341_344_oPCAN_RADAR_5d5a6282_Tx: ComBitPosition=376, ComBitSize=7, ComSignalInitValue=0, ComSignalType=UINT8, ComSystemTemplateSystemSignalRef=DET_RANGE_ERR_344
            DET_RANGE_VELOCITY_341_oRDR_DETECTION_341_344_oPCAN_RADAR_223496cc_Tx: ComBitPosition=48, ComBitSize=15, ComSignalInitValue=16384, ComSignalType=UINT16, ComSystemTemplateSystemSignalRef=DET_RANGE_VELOCITY_341
            DET_RANGE_VELOCITY_342_oRDR_DETECTION_341_344_oPCAN_RADAR_46d4ed32_Tx: ComBitPosition=160, ComBitSize=15, ComSignalInitValue=16384, ComSignalType=UINT16, ComSystemTemplateSystemSignalRef=DET_RANGE_VELOCITY_342
            DET_RANGE_VELOCITY_343_oRDR_DETECTION_341_344_oPCAN_RADAR_d3a439a7_Tx: ComBitPosition=272, ComBitSize=15, ComSignalInitValue=16384, ComSignalType=UINT16, ComSystemTemplateSystemSignalRef=DET_RANGE_VELOCITY_343
            DET_RANGE_VELOCITY_344_oRDR_DETECTION_341_344_oPCAN_RADAR_8f141ace_Tx: ComBitPosition=384, ComBitSize=15, ComSignalInitValue=16384, ComSignalType=UINT16, ComSystemTemplateSystemSignalRef=DET_RANGE_VELOCITY_344
            DET_RANGE_VELOCITY_ERR_341_oRDR_DETECTION_341_344_oPCAN_RADAR_2d8f6d7e_Tx: ComBitPosition=64, ComBitSize=8, ComSignalInitValue=0, ComSignalType=UINT8, ComSystemTemplateSystemSignalRef=DET_RANGE_VELOCITY_ERR_341
            DET_RANGE_VELOCITY_ERR_342_oRDR_DETECTION_341_344_oPCAN_RADAR_496f1680_Tx: ComBitPosition=176, ComBitSize=8, ComSignalInitValue=0, ComSignalType=UINT8, ComSystemTemplateSystemSignalRef=DET_RANGE_VELOCITY_ERR_342
            DET_RANGE_VELOCITY_ERR_343_oRDR_DETECTION_341_344_oPCAN_RADAR_dc1fc215_Tx: ComBitPosition=288, ComBitSize=8, ComSignalInitValue=0, ComSignalType=UINT8, ComSystemTemplateSystemSignalRef=DET_RANGE_VELOCITY_ERR_343
            DET_RANGE_VELOCITY_ERR_344_oRDR_DETECTION_341_344_oPCAN_RADAR_80afe17c_Tx: ComBitPosition=400, ComBitSize=8, ComSignalInitValue=0, ComSignalType=UINT8, ComSystemTemplateSystemSignalRef=DET_RANGE_VELOCITY_ERR_344
            DET_RCS_341_oRDR_DETECTION_341_344_oPCAN_RADAR_a5b4a196_Tx: ComBitPosition=128, ComBitSize=8, ComSignalInitValue=128, ComSignalType=UINT8, ComSystemTemplateSystemSignalRef=DET_RCS_341
            DET_RCS_342_oRDR_DETECTION_341_344_oPCAN_RADAR_c154da68_Tx: ComBitPosition=240, ComBitSize=8, ComSignalInitValue=128, ComSignalType=UINT8, ComSystemTemplateSystemSignalRef=DET_RCS_342
            DET_RCS_343_oRDR_DETECTION_341_344_oPCAN_RADAR_54240efd_Tx: ComBitPosition=352, ComBitSize=8, ComSignalInitValue=128, ComSignalType=UINT8, ComSystemTemplateSystemSignalRef=DET_RCS_343
            DET_RCS_344_oRDR_DETECTION_341_344_oPCAN_RADAR_08942d94_Tx: ComBitPosition=464, ComBitSize=8, ComSignalInitValue=128, ComSignalType=UINT8, ComSystemTemplateSystemSignalRef=DET_RCS_344
            DET_SNR_341_oRDR_DETECTION_341_344_oPCAN_RADAR_781af594_Tx: ComBitPosition=120, ComBitSize=8, ComSignalInitValue=0, ComSignalType=UINT8, ComSystemTemplateSystemSignalRef=DET_SNR_341
            DET_SNR_342_oRDR_DETECTION_341_344_oPCAN_RADAR_1cfa8e6a_Tx: ComBitPosition=232, ComBitSize=8, ComSignalInitValue=0, ComSignalType=UINT8, ComSystemTemplateSystemSignalRef=DET_SNR_342
            DET_SNR_343_oRDR_DETECTION_341_344_oPCAN_RADAR_898a5aff_Tx: ComBitPosition=344, ComBitSize=8, ComSignalInitValue=0, ComSignalType=UINT8, ComSystemTemplateSystemSignalRef=DET_SNR_343
            DET_SNR_344_oRDR_DETECTION_341_344_oPCAN_RADAR_d53a7996_Tx: ComBitPosition=456, ComBitSize=8, ComSignalInitValue=0, ComSignalType=UINT8, ComSystemTemplateSystemSignalRef=DET_SNR_344
            DET_SUPER_RES_TARGET_341_oRDR_DETECTION_341_344_oPCAN_RADAR_4983ddf1_Tx: ComBitPosition=87, ComBitSize=1, ComSignalInitValue=0, ComSignalType=BOOLEAN, ComSystemTemplateSystemSignalRef=DET_SUPER_RES_TARGET_341
            DET_SUPER_RES_TARGET_342_oRDR_DETECTION_341_344_oPCAN_RADAR_2d63a60f_Tx: ComBitPosition=199, ComBitSize=1, ComSignalInitValue=0, ComSignalType=BOOLEAN, ComSystemTemplateSystemSignalRef=DET_SUPER_RES_TARGET_342
            DET_SUPER_RES_TARGET_343_oRDR_DETECTION_341_344_oPCAN_RADAR_b813729a_Tx: ComBitPosition=311, ComBitSize=1, ComSignalInitValue=0, ComSignalType=BOOLEAN, ComSystemTemplateSystemSignalRef=DET_SUPER_RES_TARGET_343
            DET_SUPER_RES_TARGET_344_oRDR_DETECTION_341_344_oPCAN_RADAR_e4a351f3_Tx: ComBitPosition=423, ComBitSize=1, ComSignalInitValue=0, ComSignalType=BOOLEAN, ComSystemTemplateSystemSignalRef=DET_SUPER_RES_TARGET_344
        SG_Detections_345_348_oRDR_DETECTION_345_348_oPCAN_RADAR_03988697_Tx: ComSystemTemplateSignalGroupRef=SG_Detections_345_348
          83 x ComGroupSignal, all with ComSignalEndianness=LITTLE_ENDIAN, ComTransferProperty=PENDING:
            DET_AZIMUTH_345_oRDR_DETECTION_345_348_oPCAN_RADAR_96ebe1f1_Tx: ComBitPosition=88, ComBitSize=13, ComSignalInitValue=0, ComSignalType=UINT16, ComSystemTemplateSystemSignalRef=DET_AZIMUTH_345
            DET_AZIMUTH_346_oRDR_DETECTION_345_348_oPCAN_RADAR_f20b9a0f_Tx: ComBitPosition=200, ComBitSize=13, ComSignalInitValue=0, ComSignalType=UINT16, ComSystemTemplateSystemSignalRef=DET_AZIMUTH_346
            DET_AZIMUTH_347_oRDR_DETECTION_345_348_oPCAN_RADAR_677b4e9a_Tx: ComBitPosition=312, ComBitSize=13, ComSignalInitValue=0, ComSignalType=UINT16, ComSystemTemplateSystemSignalRef=DET_AZIMUTH_347
            DET_AZIMUTH_348_oRDR_DETECTION_345_348_oPCAN_RADAR_4b6bdcdd_Tx: ComBitPosition=424, ComBitSize=13, ComSignalInitValue=0, ComSignalType=UINT16, ComSystemTemplateSystemSignalRef=DET_AZIMUTH_348
            DET_AZIMUTH_ERR_345_oRDR_DETECTION_345_348_oPCAN_RADAR_325e7404_Tx: ComBitPosition=105, ComBitSize=7, ComSignalInitValue=0, ComSignalType=UINT8, ComSystemTemplateSystemSignalRef=DET_AZIMUTH_ERR_345
            DET_AZIMUTH_ERR_346_oRDR_DETECTION_345_348_oPCAN_RADAR_56be0ffa_Tx: ComBitPosition=217, ComBitSize=7, ComSignalInitValue=0, ComSignalType=UINT8, ComSystemTemplateSystemSignalRef=DET_AZIMUTH_ERR_346
            DET_AZIMUTH_ERR_347_oRDR_DETECTION_345_348_oPCAN_RADAR_c3cedb6f_Tx: ComBitPosition=329, ComBitSize=7, ComSignalInitValue=0, ComSignalType=UINT8, ComSystemTemplateSystemSignalRef=DET_AZIMUTH_ERR_347
            DET_AZIMUTH_ERR_348_oRDR_DETECTION_345_348_oPCAN_RADAR_efde4928_Tx: ComBitPosition=441, ComBitSize=7, ComSignalInitValue=0, ComSignalType=UINT8, ComSystemTemplateSystemSignalRef=DET_AZIMUTH_ERR_348
            DET_BELOW_RAIN_THOLD_345_oRDR_DETECTION_345_348_oPCAN_RADAR_43ea7231_Tx: ComBitPosition=39, ComBitSize=1, ComSignalInitValue=0, ComSignalType=BOOLEAN, ComSystemTemplateSystemSignalRef=DET_BELOW_RAIN_THOLD_345
            DET_BELOW_RAIN_THOLD_346_oRDR_DETECTION_345_348_oPCAN_RADAR_270a09cf_Tx: ComBitPosition=151, ComBitSize=1, ComSignalInitValue=0, ComSignalType=BOOLEAN, ComSystemTemplateSystemSignalRef=DET_BELOW_RAIN_THOLD_346
            DET_BELOW_RAIN_THOLD_347_oRDR_DETECTION_345_348_oPCAN_RADAR_b27add5a_Tx: ComBitPosition=263, ComBitSize=1, ComSignalInitValue=0, ComSignalType=BOOLEAN, ComSystemTemplateSystemSignalRef=DET_BELOW_RAIN_THOLD_347
            DET_BELOW_RAIN_THOLD_348_oRDR_DETECTION_345_348_oPCAN_RADAR_9e6a4f1d_Tx: ComBitPosition=375, ComBitSize=1, ComSignalInitValue=0, ComSignalType=BOOLEAN, ComSystemTemplateSystemSignalRef=DET_BELOW_RAIN_THOLD_348
            DET_BI_STATIC_FLAG_345_oRDR_DETECTION_345_348_oPCAN_RADAR_c0c7a174_Tx: ComBitPosition=104, ComBitSize=1, ComSignalInitValue=0, ComSignalType=BOOLEAN, ComSystemTemplateSystemSignalRef=DET_BI_STATIC_FLAG_345
            DET_BI_STATIC_FLAG_346_oRDR_DETECTION_345_348_oPCAN_RADAR_a427da8a_Tx: ComBitPosition=216, ComBitSize=1, ComSignalInitValue=0, ComSignalType=BOOLEAN, ComSystemTemplateSystemSignalRef=DET_BI_STATIC_FLAG_346
            DET_BI_STATIC_FLAG_347_oRDR_DETECTION_345_348_oPCAN_RADAR_31570e1f_Tx: ComBitPosition=328, ComBitSize=1, ComSignalInitValue=0, ComSignalType=BOOLEAN, ComSystemTemplateSystemSignalRef=DET_BI_STATIC_FLAG_347
            DET_BI_STATIC_FLAG_348_oRDR_DETECTION_345_348_oPCAN_RADAR_1d479c58_Tx: ComBitPosition=440, ComBitSize=1, ComSignalInitValue=0, ComSignalType=BOOLEAN, ComSystemTemplateSystemSignalRef=DET_BI_STATIC_FLAG_348
            DET_CONFD_AZIMUTH_345_oRDR_DETECTION_345_348_oPCAN_RADAR_940deb3b_Tx: ComBitPosition=118, ComBitSize=2, ComSignalInitValue=0, ComSignalType=UINT8, ComSystemTemplateSystemSignalRef=DET_CONFD_AZIMUTH_345
            DET_CONFD_AZIMUTH_346_oRDR_DETECTION_345_348_oPCAN_RADAR_f0ed90c5_Tx: ComBitPosition=230, ComBitSize=2, ComSignalInitValue=0, ComSignalType=UINT8, ComSystemTemplateSystemSignalRef=DET_CONFD_AZIMUTH_346
            DET_CONFD_AZIMUTH_347_oRDR_DETECTION_345_348_oPCAN_RADAR_659d4450_Tx: ComBitPosition=342, ComBitSize=2, ComSignalInitValue=0, ComSignalType=UINT8, ComSystemTemplateSystemSignalRef=DET_CONFD_AZIMUTH_347
            DET_CONFD_AZIMUTH_348_oRDR_DETECTION_345_348_oPCAN_RADAR_498dd617_Tx: ComBitPosition=454, ComBitSize=2, ComSignalInitValue=0, ComSignalType=UINT8, ComSystemTemplateSystemSignalRef=DET_CONFD_AZIMUTH_348
            DET_CONFD_ELEVATION_345_oRDR_DETECTION_345_348_oPCAN_RADAR_9698eac1_Tx: ComBitPosition=101, ComBitSize=2, ComSignalInitValue=0, ComSignalType=UINT8, ComSystemTemplateSystemSignalRef=DET_CONFD_ELEVATION_345
            DET_CONFD_ELEVATION_346_oRDR_DETECTION_345_348_oPCAN_RADAR_f278913f_Tx: ComBitPosition=213, ComBitSize=2, ComSignalInitValue=0, ComSignalType=UINT8, ComSystemTemplateSystemSignalRef=DET_CONFD_ELEVATION_346
            DET_CONFD_ELEVATION_347_oRDR_DETECTION_345_348_oPCAN_RADAR_670845aa_Tx: ComBitPosition=325, ComBitSize=2, ComSignalInitValue=0, ComSignalType=UINT8, ComSystemTemplateSystemSignalRef=DET_CONFD_ELEVATION_347
            DET_CONFD_ELEVATION_348_oRDR_DETECTION_345_348_oPCAN_RADAR_4b18d7ed_Tx: ComBitPosition=437, ComBitSize=2, ComSignalInitValue=0, ComSignalType=UINT8, ComSystemTemplateSystemSignalRef=DET_CONFD_ELEVATION_348
            DET_ELEVATION_345_oRDR_DETECTION_345_348_oPCAN_RADAR_47583efd_Tx: ComBitPosition=72, ComBitSize=8, ComSignalInitValue=0, ComSignalType=UINT8, ComSystemTemplateSystemSignalRef=DET_ELEVATION_345
            DET_ELEVATION_346_oRDR_DETECTION_345_348_oPCAN_RADAR_23b84503_Tx: ComBitPosition=184, ComBitSize=8, ComSignalInitValue=0, ComSignalType=UINT8, ComSystemTemplateSystemSignalRef=DET_ELEVATION_346
            DET_ELEVATION_347_oRDR_DETECTION_345_348_oPCAN_RADAR_b6c89196_Tx: ComBitPosition=296, ComBitSize=8, ComSignalInitValue=0, ComSignalType=UINT8, ComSystemTemplateSystemSignalRef=DET_ELEVATION_347
            DET_ELEVATION_348_oRDR_DETECTION_345_348_oPCAN_RADAR_9ad803d1_Tx: ComBitPosition=408, ComBitSize=8, ComSignalInitValue=0, ComSignalType=UINT8, ComSystemTemplateSystemSignalRef=DET_ELEVATION_348
            DET_ELEVATION_ERR_345_oRDR_DETECTION_345_348_oPCAN_RADAR_c061a688_Tx: ComBitPosition=80, ComBitSize=6, ComSignalInitValue=0, ComSignalType=UINT8, ComSystemTemplateSystemSignalRef=DET_ELEVATION_ERR_345
            DET_ELEVATION_ERR_346_oRDR_DETECTION_345_348_oPCAN_RADAR_a481dd76_Tx: ComBitPosition=192, ComBitSize=6, ComSignalInitValue=0, ComSignalType=UINT8, ComSystemTemplateSystemSignalRef=DET_ELEVATION_ERR_346
            DET_ELEVATION_ERR_347_oRDR_DETECTION_345_348_oPCAN_RADAR_31f109e3_Tx: ComBitPosition=304, ComBitSize=6, ComSignalInitValue=0, ComSignalType=UINT8, ComSystemTemplateSystemSignalRef=DET_ELEVATION_ERR_347
            DET_ELEVATION_ERR_348_oRDR_DETECTION_345_348_oPCAN_RADAR_1de19ba4_Tx: ComBitPosition=416, ComBitSize=6, ComSignalInitValue=0, ComSignalType=UINT8, ComSystemTemplateSystemSignalRef=DET_ELEVATION_ERR_348
            DET_EXISTENCE_PROB_345_oRDR_DETECTION_345_348_oPCAN_RADAR_12fed3e8_Tx: ComBitPosition=112, ComBitSize=6, ComSignalInitValue=0, ComSignalType=UINT8, ComSystemTemplateSystemSignalRef=DET_EXISTENCE_PROB_345
            DET_EXISTENCE_PROB_346_oRDR_DETECTION_345_348_oPCAN_RADAR_761ea816_Tx: ComBitPosition=224, ComBitSize=6, ComSignalInitValue=0, ComSignalType=UINT8, ComSystemTemplateSystemSignalRef=DET_EXISTENCE_PROB_346
            DET_EXISTENCE_PROB_347_oRDR_DETECTION_345_348_oPCAN_RADAR_e36e7c83_Tx: ComBitPosition=336, ComBitSize=6, ComSignalInitValue=0, ComSignalType=UINT8, ComSystemTemplateSystemSignalRef=DET_EXISTENCE_PROB_347
            DET_EXISTENCE_PROB_348_oRDR_DETECTION_345_348_oPCAN_RADAR_cf7eeec4_Tx: ComBitPosition=448, ComBitSize=6, ComSignalInitValue=0, ComSignalType=UINT8, ComSystemTemplateSystemSignalRef=DET_EXISTENCE_PROB_348
            DET_HVC_FLAG_345_oRDR_DETECTION_345_348_oPCAN_RADAR_f38a9097_Tx: ComBitPosition=86, ComBitSize=1, ComSignalInitValue=0, ComSignalType=BOOLEAN, ComSystemTemplateSystemSignalRef=DET_HVC_FLAG_345
            DET_HVC_FLAG_346_oRDR_DETECTION_345_348_oPCAN_RADAR_976aeb69_Tx: ComBitPosition=198, ComBitSize=1, ComSignalInitValue=0, ComSignalType=BOOLEAN, ComSystemTemplateSystemSignalRef=DET_HVC_FLAG_346
            DET_HVC_FLAG_347_oRDR_DETECTION_345_348_oPCAN_RADAR_021a3ffc_Tx: ComBitPosition=310, ComBitSize=1, ComSignalInitValue=0, ComSignalType=BOOLEAN, ComSystemTemplateSystemSignalRef=DET_HVC_FLAG_347
            DET_HVC_FLAG_348_oRDR_DETECTION_345_348_oPCAN_RADAR_2e0aadbb_Tx: ComBitPosition=422, ComBitSize=1, ComSignalInitValue=0, ComSignalType=BOOLEAN, ComSystemTemplateSystemSignalRef=DET_HVC_FLAG_348
            DET_IDM_345_oRDR_DETECTION_345_348_oPCAN_RADAR_78d8ab2a_Tx: ComBitPosition=63, ComBitSize=1, ComSignalInitValue=0, ComSignalType=BOOLEAN, ComSystemTemplateSystemSignalRef=DET_IDM_345
            DET_IDM_346_oRDR_DETECTION_345_348_oPCAN_RADAR_1c38d0d4_Tx: ComBitPosition=175, ComBitSize=1, ComSignalInitValue=0, ComSignalType=BOOLEAN, ComSystemTemplateSystemSignalRef=DET_IDM_346
            DET_IDM_347_oRDR_DETECTION_345_348_oPCAN_RADAR_89480441_Tx: ComBitPosition=287, ComBitSize=1, ComSignalInitValue=0, ComSignalType=BOOLEAN, ComSystemTemplateSystemSignalRef=DET_IDM_347
            DET_IDM_348_oRDR_DETECTION_345_348_oPCAN_RADAR_a5589606_Tx: ComBitPosition=399, ComBitSize=1, ComSignalInitValue=0, ComSignalType=BOOLEAN, ComSystemTemplateSystemSignalRef=DET_IDM_348
            DET_MH_CRC16_345_348_oRDR_DETECTION_345_348_oPCAN_RADAR_8710549c_Tx: ComBitPosition=0, ComBitSize=16, ComSignalInitValue=0, ComSignalType=UINT16, ComSystemTemplateSystemSignalRef=DET_MH_CRC16_345_348
            DET_MH_CYCLE_COUNTER_345_348_oRDR_DETECTION_345_348_oPCAN_RADAR_0365f5ab_Tx: ComBitPosition=16, ComBitSize=8, ComSignalInitValue=0, ComSignalType=UINT8, ComSystemTemplateSystemSignalRef=DET_MH_CYCLE_COUNTER_345_348
            DET_MH_SCAN_INDEX_4LSB_345_348_oRDR_DETECTION_345_348_oPCAN_RADAR_cf4fd027_Tx: ComBitPosition=476, ComBitSize=4, ComSignalInitValue=0, ComSignalType=UINT8, ComSystemTemplateSystemSignalRef=DET_MH_SCAN_INDEX_4LSB_345_348
            DET_MTD_345_oRDR_DETECTION_345_348_oPCAN_RADAR_1e6b99f1_Tx: ComBitPosition=47, ComBitSize=1, ComSignalInitValue=0, ComSignalType=BOOLEAN, ComSystemTemplateSystemSignalRef=DET_MTD_345
            DET_MTD_346_oRDR_DETECTION_345_348_oPCAN_RADAR_7a8be20f_Tx: ComBitPosition=159, ComBitSize=1, ComSignalInitValue=0, ComSignalType=BOOLEAN, ComSystemTemplateSystemSignalRef=DET_MTD_346
            DET_MTD_347_oRDR_DETECTION_345_348_oPCAN_RADAR_effb369a_Tx: ComBitPosition=271, ComBitSize=1, ComSignalInitValue=0, ComSignalType=BOOLEAN, ComSystemTemplateSystemSignalRef=DET_MTD_347
            DET_MTD_348_oRDR_DETECTION_345_348_oPCAN_RADAR_c3eba4dd_Tx: ComBitPosition=383, ComBitSize=1, ComSignalInitValue=0, ComSignalType=BOOLEAN, ComSystemTemplateSystemSignalRef=DET_MTD_348
            DET_PROB_1STAZHYPO_345_oRDR_DETECTION_345_348_oPCAN_RADAR_8ddf713c_Tx: ComBitPosition=103, ComBitSize=1, ComSignalInitValue=0, ComSignalType=BOOLEAN, ComSystemTemplateSystemSignalRef=DET_PROB_1STAZHYPO_345
            DET_PROB_1STAZHYPO_346_oRDR_DETECTION_345_348_oPCAN_RADAR_e93f0ac2_Tx: ComBitPosition=215, ComBitSize=1, ComSignalInitValue=0, ComSignalType=BOOLEAN, ComSystemTemplateSystemSignalRef=DET_PROB_1STAZHYPO_346
            DET_PROB_1STAZHYPO_347_oRDR_DETECTION_345_348_oPCAN_RADAR_7c4fde57_Tx: ComBitPosition=327, ComBitSize=1, ComSignalInitValue=0, ComSignalType=BOOLEAN, ComSystemTemplateSystemSignalRef=DET_PROB_1STAZHYPO_347
            DET_PROB_1STAZHYPO_348_oRDR_DETECTION_345_348_oPCAN_RADAR_505f4c10_Tx: ComBitPosition=439, ComBitSize=1, ComSignalInitValue=0, ComSignalType=BOOLEAN, ComSystemTemplateSystemSignalRef=DET_PROB_1STAZHYPO_348
            DET_RANGE_345_oRDR_DETECTION_345_348_oPCAN_RADAR_8670924a_Tx: ComBitPosition=24, ComBitSize=15, ComSignalInitValue=0, ComSignalType=UINT16, ComSystemTemplateSystemSignalRef=DET_RANGE_345
            DET_RANGE_346_oRDR_DETECTION_345_348_oPCAN_RADAR_e290e9b4_Tx: ComBitPosition=136, ComBitSize=15, ComSignalInitValue=0, ComSignalType=UINT16, ComSystemTemplateSystemSignalRef=DET_RANGE_346
            DET_RANGE_347_oRDR_DETECTION_345_348_oPCAN_RADAR_77e03d21_Tx: ComBitPosition=248, ComBitSize=15, ComSignalInitValue=0, ComSignalType=UINT16, ComSystemTemplateSystemSignalRef=DET_RANGE_347
            DET_RANGE_348_oRDR_DETECTION_345_348_oPCAN_RADAR_5bf0af66_Tx: ComBitPosition=360, ComBitSize=15, ComSignalInitValue=0, ComSignalType=UINT16, ComSystemTemplateSystemSignalRef=DET_RANGE_348
            DET_RANGE_ERR_345_oRDR_DETECTION_345_348_oPCAN_RADAR_21982823_Tx: ComBitPosition=40, ComBitSize=7, ComSignalInitValue=0, ComSignalType=UINT8, ComSystemTemplateSystemSignalRef=DET_RANGE_ERR_345
            DET_RANGE_ERR_346_oRDR_DETECTION_345_348_oPCAN_RADAR_457853dd_Tx: ComBitPosition=152, ComBitSize=7, ComSignalInitValue=0, ComSignalType=UINT8, ComSystemTemplateSystemSignalRef=DET_RANGE_ERR_346
            DET_RANGE_ERR_347_oRDR_DETECTION_345_348_oPCAN_RADAR_d0088748_Tx: ComBitPosition=264, ComBitSize=7, ComSignalInitValue=0, ComSignalType=UINT8, ComSystemTemplateSystemSignalRef=DET_RANGE_ERR_347
            DET_RANGE_ERR_348_oRDR_DETECTION_345_348_oPCAN_RADAR_fc18150f_Tx: ComBitPosition=376, ComBitSize=7, ComSignalInitValue=0, ComSignalType=UINT8, ComSystemTemplateSystemSignalRef=DET_RANGE_ERR_348
            DET_RANGE_VELOCITY_345_oRDR_DETECTION_345_348_oPCAN_RADAR_f3d6506f_Tx: ComBitPosition=48, ComBitSize=15, ComSignalInitValue=16384, ComSignalType=UINT16, ComSystemTemplateSystemSignalRef=DET_RANGE_VELOCITY_345
            DET_RANGE_VELOCITY_346_oRDR_DETECTION_345_348_oPCAN_RADAR_97362b91_Tx: ComBitPosition=160, ComBitSize=15, ComSignalInitValue=16384, ComSignalType=UINT16, ComSystemTemplateSystemSignalRef=DET_RANGE_VELOCITY_346
            DET_RANGE_VELOCITY_347_oRDR_DETECTION_345_348_oPCAN_RADAR_0246ff04_Tx: ComBitPosition=272, ComBitSize=15, ComSignalInitValue=16384, ComSignalType=UINT16, ComSystemTemplateSystemSignalRef=DET_RANGE_VELOCITY_347
            DET_RANGE_VELOCITY_348_oRDR_DETECTION_345_348_oPCAN_RADAR_2e566d43_Tx: ComBitPosition=384, ComBitSize=15, ComSignalInitValue=16384, ComSignalType=UINT16, ComSystemTemplateSystemSignalRef=DET_RANGE_VELOCITY_348
            DET_RANGE_VELOCITY_ERR_345_oRDR_DETECTION_345_348_oPCAN_RADAR_fc6dabdd_Tx: ComBitPosition=64, ComBitSize=8, ComSignalInitValue=0, ComSignalType=UINT8, ComSystemTemplateSystemSignalRef=DET_RANGE_VELOCITY_ERR_345
            DET_RANGE_VELOCITY_ERR_346_oRDR_DETECTION_345_348_oPCAN_RADAR_988dd023_Tx: ComBitPosition=176, ComBitSize=8, ComSignalInitValue=0, ComSignalType=UINT8, ComSystemTemplateSystemSignalRef=DET_RANGE_VELOCITY_ERR_346
            DET_RANGE_VELOCITY_ERR_347_oRDR_DETECTION_345_348_oPCAN_RADAR_0dfd04b6_Tx: ComBitPosition=288, ComBitSize=8, ComSignalInitValue=0, ComSignalType=UINT8, ComSystemTemplateSystemSignalRef=DET_RANGE_VELOCITY_ERR_347
            DET_RANGE_VELOCITY_ERR_348_oRDR_DETECTION_345_348_oPCAN_RADAR_21ed96f1_Tx: ComBitPosition=400, ComBitSize=8, ComSignalInitValue=0, ComSignalType=UINT8, ComSystemTemplateSystemSignalRef=DET_RANGE_VELOCITY_ERR_348
            DET_RCS_345_oRDR_DETECTION_345_348_oPCAN_RADAR_74566735_Tx: ComBitPosition=128, ComBitSize=8, ComSignalInitValue=128, ComSignalType=UINT8, ComSystemTemplateSystemSignalRef=DET_RCS_345
            DET_RCS_346_oRDR_DETECTION_345_348_oPCAN_RADAR_10b61ccb_Tx: ComBitPosition=240, ComBitSize=8, ComSignalInitValue=128, ComSignalType=UINT8, ComSystemTemplateSystemSignalRef=DET_RCS_346
            DET_RCS_347_oRDR_DETECTION_345_348_oPCAN_RADAR_85c6c85e_Tx: ComBitPosition=352, ComBitSize=8, ComSignalInitValue=128, ComSignalType=UINT8, ComSystemTemplateSystemSignalRef=DET_RCS_347
            DET_RCS_348_oRDR_DETECTION_345_348_oPCAN_RADAR_a9d65a19_Tx: ComBitPosition=464, ComBitSize=8, ComSignalInitValue=128, ComSignalType=UINT8, ComSystemTemplateSystemSignalRef=DET_RCS_348
            DET_SNR_345_oRDR_DETECTION_345_348_oPCAN_RADAR_a9f83337_Tx: ComBitPosition=120, ComBitSize=8, ComSignalInitValue=0, ComSignalType=UINT8, ComSystemTemplateSystemSignalRef=DET_SNR_345
            DET_SNR_346_oRDR_DETECTION_345_348_oPCAN_RADAR_cd1848c9_Tx: ComBitPosition=232, ComBitSize=8, ComSignalInitValue=0, ComSignalType=UINT8, ComSystemTemplateSystemSignalRef=DET_SNR_346
            DET_SNR_347_oRDR_DETECTION_345_348_oPCAN_RADAR_58689c5c_Tx: ComBitPosition=344, ComBitSize=8, ComSignalInitValue=0, ComSignalType=UINT8, ComSystemTemplateSystemSignalRef=DET_SNR_347
            DET_SNR_348_oRDR_DETECTION_345_348_oPCAN_RADAR_74780e1b_Tx: ComBitPosition=456, ComBitSize=8, ComSignalInitValue=0, ComSignalType=UINT8, ComSystemTemplateSystemSignalRef=DET_SNR_348
            DET_SUPER_RES_TARGET_345_oRDR_DETECTION_345_348_oPCAN_RADAR_98611b52_Tx: ComBitPosition=87, ComBitSize=1, ComSignalInitValue=0, ComSignalType=BOOLEAN, ComSystemTemplateSystemSignalRef=DET_SUPER_RES_TARGET_345
            DET_SUPER_RES_TARGET_346_oRDR_DETECTION_345_348_oPCAN_RADAR_fc8160ac_Tx: ComBitPosition=199, ComBitSize=1, ComSignalInitValue=0, ComSignalType=BOOLEAN, ComSystemTemplateSystemSignalRef=DET_SUPER_RES_TARGET_346
            DET_SUPER_RES_TARGET_347_oRDR_DETECTION_345_348_oPCAN_RADAR_69f1b439_Tx: ComBitPosition=311, ComBitSize=1, ComSignalInitValue=0, ComSignalType=BOOLEAN, ComSystemTemplateSystemSignalRef=DET_SUPER_RES_TARGET_347
            DET_SUPER_RES_TARGET_348_oRDR_DETECTION_345_348_oPCAN_RADAR_45e1267e_Tx: ComBitPosition=423, ComBitSize=1, ComSignalInitValue=0, ComSignalType=BOOLEAN, ComSystemTemplateSystemSignalRef=DET_SUPER_RES_TARGET_348
        SG_Detections_349_352_oRDR_DETECTION_349_352_oPCAN_RADAR_9ae2a2ec_Tx: ComSystemTemplateSignalGroupRef=SG_Detections_349_352
          83 x ComGroupSignal, all with ComSignalEndianness=LITTLE_ENDIAN, ComTransferProperty=PENDING:
            DET_AZIMUTH_349_oRDR_DETECTION_349_352_oPCAN_RADAR_ec53e749_Tx: ComBitPosition=88, ComBitSize=13, ComSignalInitValue=0, ComSignalType=UINT16, ComSystemTemplateSystemSignalRef=DET_AZIMUTH_349
            DET_AZIMUTH_350_oRDR_DETECTION_349_352_oPCAN_RADAR_897395ed_Tx: ComBitPosition=200, ComBitSize=13, ComSignalInitValue=0, ComSignalType=UINT16, ComSystemTemplateSystemSignalRef=DET_AZIMUTH_350
            DET_AZIMUTH_351_oRDR_DETECTION_349_352_oPCAN_RADAR_1c034178_Tx: ComBitPosition=312, ComBitSize=13, ComSignalInitValue=0, ComSignalType=UINT16, ComSystemTemplateSystemSignalRef=DET_AZIMUTH_351
            DET_AZIMUTH_352_oRDR_DETECTION_349_352_oPCAN_RADAR_78e33a86_Tx: ComBitPosition=424, ComBitSize=13, ComSignalInitValue=0, ComSignalType=UINT16, ComSystemTemplateSystemSignalRef=DET_AZIMUTH_352
            DET_AZIMUTH_ERR_349_oRDR_DETECTION_349_352_oPCAN_RADAR_48e672bc_Tx: ComBitPosition=105, ComBitSize=7, ComSignalInitValue=0, ComSignalType=UINT8, ComSystemTemplateSystemSignalRef=DET_AZIMUTH_ERR_349
            DET_AZIMUTH_ERR_350_oRDR_DETECTION_349_352_oPCAN_RADAR_2dc60018_Tx: ComBitPosition=217, ComBitSize=7, ComSignalInitValue=0, ComSignalType=UINT8, ComSystemTemplateSystemSignalRef=DET_AZIMUTH_ERR_350
            DET_AZIMUTH_ERR_351_oRDR_DETECTION_349_352_oPCAN_RADAR_b8b6d48d_Tx: ComBitPosition=329, ComBitSize=7, ComSignalInitValue=0, ComSignalType=UINT8, ComSystemTemplateSystemSignalRef=DET_AZIMUTH_ERR_351
            DET_AZIMUTH_ERR_352_oRDR_DETECTION_349_352_oPCAN_RADAR_dc56af73_Tx: ComBitPosition=441, ComBitSize=7, ComSignalInitValue=0, ComSignalType=UINT8, ComSystemTemplateSystemSignalRef=DET_AZIMUTH_ERR_352
            DET_BELOW_RAIN_THOLD_349_oRDR_DETECTION_349_352_oPCAN_RADAR_39527489_Tx: ComBitPosition=39, ComBitSize=1, ComSignalInitValue=0, ComSignalType=BOOLEAN, ComSystemTemplateSystemSignalRef=DET_BELOW_RAIN_THOLD_349
            DET_BELOW_RAIN_THOLD_350_oRDR_DETECTION_349_352_oPCAN_RADAR_5c72062d_Tx: ComBitPosition=151, ComBitSize=1, ComSignalInitValue=0, ComSignalType=BOOLEAN, ComSystemTemplateSystemSignalRef=DET_BELOW_RAIN_THOLD_350
            DET_BELOW_RAIN_THOLD_351_oRDR_DETECTION_349_352_oPCAN_RADAR_c902d2b8_Tx: ComBitPosition=263, ComBitSize=1, ComSignalInitValue=0, ComSignalType=BOOLEAN, ComSystemTemplateSystemSignalRef=DET_BELOW_RAIN_THOLD_351
            DET_BELOW_RAIN_THOLD_352_oRDR_DETECTION_349_352_oPCAN_RADAR_ade2a946_Tx: ComBitPosition=375, ComBitSize=1, ComSignalInitValue=0, ComSignalType=BOOLEAN, ComSystemTemplateSystemSignalRef=DET_BELOW_RAIN_THOLD_352
            DET_BI_STATIC_FLAG_349_oRDR_DETECTION_349_352_oPCAN_RADAR_ba7fa7cc_Tx: ComBitPosition=104, ComBitSize=1, ComSignalInitValue=0, ComSignalType=BOOLEAN, ComSystemTemplateSystemSignalRef=DET_BI_STATIC_FLAG_349
            DET_BI_STATIC_FLAG_350_oRDR_DETECTION_349_352_oPCAN_RADAR_df5fd568_Tx: ComBitPosition=216, ComBitSize=1, ComSignalInitValue=0, ComSignalType=BOOLEAN, ComSystemTemplateSystemSignalRef=DET_BI_STATIC_FLAG_350
            DET_BI_STATIC_FLAG_351_oRDR_DETECTION_349_352_oPCAN_RADAR_4a2f01fd_Tx: ComBitPosition=328, ComBitSize=1, ComSignalInitValue=0, ComSignalType=BOOLEAN, ComSystemTemplateSystemSignalRef=DET_BI_STATIC_FLAG_351
            DET_BI_STATIC_FLAG_352_oRDR_DETECTION_349_352_oPCAN_RADAR_2ecf7a03_Tx: ComBitPosition=440, ComBitSize=1, ComSignalInitValue=0, ComSignalType=BOOLEAN, ComSystemTemplateSystemSignalRef=DET_BI_STATIC_FLAG_352
            DET_CONFD_AZIMUTH_349_oRDR_DETECTION_349_352_oPCAN_RADAR_eeb5ed83_Tx: ComBitPosition=118, ComBitSize=2, ComSignalInitValue=0, ComSignalType=UINT8, ComSystemTemplateSystemSignalRef=DET_CONFD_AZIMUTH_349
            DET_CONFD_AZIMUTH_350_oRDR_DETECTION_349_352_oPCAN_RADAR_8b959f27_Tx: ComBitPosition=230, ComBitSize=2, ComSignalInitValue=0, ComSignalType=UINT8, ComSystemTemplateSystemSignalRef=DET_CONFD_AZIMUTH_350
            DET_CONFD_AZIMUTH_351_oRDR_DETECTION_349_352_oPCAN_RADAR_1ee54bb2_Tx: ComBitPosition=342, ComBitSize=2, ComSignalInitValue=0, ComSignalType=UINT8, ComSystemTemplateSystemSignalRef=DET_CONFD_AZIMUTH_351
            DET_CONFD_AZIMUTH_352_oRDR_DETECTION_349_352_oPCAN_RADAR_7a05304c_Tx: ComBitPosition=454, ComBitSize=2, ComSignalInitValue=0, ComSignalType=UINT8, ComSystemTemplateSystemSignalRef=DET_CONFD_AZIMUTH_352
            DET_CONFD_ELEVATION_349_oRDR_DETECTION_349_352_oPCAN_RADAR_ec20ec79_Tx: ComBitPosition=101, ComBitSize=2, ComSignalInitValue=0, ComSignalType=UINT8, ComSystemTemplateSystemSignalRef=DET_CONFD_ELEVATION_349
            DET_CONFD_ELEVATION_350_oRDR_DETECTION_349_352_oPCAN_RADAR_89009edd_Tx: ComBitPosition=213, ComBitSize=2, ComSignalInitValue=0, ComSignalType=UINT8, ComSystemTemplateSystemSignalRef=DET_CONFD_ELEVATION_350
            DET_CONFD_ELEVATION_351_oRDR_DETECTION_349_352_oPCAN_RADAR_1c704a48_Tx: ComBitPosition=325, ComBitSize=2, ComSignalInitValue=0, ComSignalType=UINT8, ComSystemTemplateSystemSignalRef=DET_CONFD_ELEVATION_351
            DET_CONFD_ELEVATION_352_oRDR_DETECTION_349_352_oPCAN_RADAR_789031b6_Tx: ComBitPosition=437, ComBitSize=2, ComSignalInitValue=0, ComSignalType=UINT8, ComSystemTemplateSystemSignalRef=DET_CONFD_ELEVATION_352
            DET_ELEVATION_349_oRDR_DETECTION_349_352_oPCAN_RADAR_3de03845_Tx: ComBitPosition=72, ComBitSize=8, ComSignalInitValue=0, ComSignalType=UINT8, ComSystemTemplateSystemSignalRef=DET_ELEVATION_349
            DET_ELEVATION_350_oRDR_DETECTION_349_352_oPCAN_RADAR_58c04ae1_Tx: ComBitPosition=184, ComBitSize=8, ComSignalInitValue=0, ComSignalType=UINT8, ComSystemTemplateSystemSignalRef=DET_ELEVATION_350
            DET_ELEVATION_351_oRDR_DETECTION_349_352_oPCAN_RADAR_cdb09e74_Tx: ComBitPosition=296, ComBitSize=8, ComSignalInitValue=0, ComSignalType=UINT8, ComSystemTemplateSystemSignalRef=DET_ELEVATION_351
            DET_ELEVATION_352_oRDR_DETECTION_349_352_oPCAN_RADAR_a950e58a_Tx: ComBitPosition=408, ComBitSize=8, ComSignalInitValue=0, ComSignalType=UINT8, ComSystemTemplateSystemSignalRef=DET_ELEVATION_352
            DET_ELEVATION_ERR_349_oRDR_DETECTION_349_352_oPCAN_RADAR_bad9a030_Tx: ComBitPosition=80, ComBitSize=6, ComSignalInitValue=0, ComSignalType=UINT8, ComSystemTemplateSystemSignalRef=DET_ELEVATION_ERR_349
            DET_ELEVATION_ERR_350_oRDR_DETECTION_349_352_oPCAN_RADAR_dff9d294_Tx: ComBitPosition=192, ComBitSize=6, ComSignalInitValue=0, ComSignalType=UINT8, ComSystemTemplateSystemSignalRef=DET_ELEVATION_ERR_350
            DET_ELEVATION_ERR_351_oRDR_DETECTION_349_352_oPCAN_RADAR_4a890601_Tx: ComBitPosition=304, ComBitSize=6, ComSignalInitValue=0, ComSignalType=UINT8, ComSystemTemplateSystemSignalRef=DET_ELEVATION_ERR_351
            DET_ELEVATION_ERR_352_oRDR_DETECTION_349_352_oPCAN_RADAR_2e697dff_Tx: ComBitPosition=416, ComBitSize=6, ComSignalInitValue=0, ComSignalType=UINT8, ComSystemTemplateSystemSignalRef=DET_ELEVATION_ERR_352
            DET_EXISTENCE_PROB_349_oRDR_DETECTION_349_352_oPCAN_RADAR_6846d550_Tx: ComBitPosition=112, ComBitSize=6, ComSignalInitValue=0, ComSignalType=UINT8, ComSystemTemplateSystemSignalRef=DET_EXISTENCE_PROB_349
            DET_EXISTENCE_PROB_350_oRDR_DETECTION_349_352_oPCAN_RADAR_0d66a7f4_Tx: ComBitPosition=224, ComBitSize=6, ComSignalInitValue=0, ComSignalType=UINT8, ComSystemTemplateSystemSignalRef=DET_EXISTENCE_PROB_350
            DET_EXISTENCE_PROB_351_oRDR_DETECTION_349_352_oPCAN_RADAR_98167361_Tx: ComBitPosition=336, ComBitSize=6, ComSignalInitValue=0, ComSignalType=UINT8, ComSystemTemplateSystemSignalRef=DET_EXISTENCE_PROB_351
            DET_EXISTENCE_PROB_352_oRDR_DETECTION_349_352_oPCAN_RADAR_fcf6089f_Tx: ComBitPosition=448, ComBitSize=6, ComSignalInitValue=0, ComSignalType=UINT8, ComSystemTemplateSystemSignalRef=DET_EXISTENCE_PROB_352
            DET_HVC_FLAG_349_oRDR_DETECTION_349_352_oPCAN_RADAR_8932962f_Tx: ComBitPosition=86, ComBitSize=1, ComSignalInitValue=0, ComSignalType=BOOLEAN, ComSystemTemplateSystemSignalRef=DET_HVC_FLAG_349
            DET_HVC_FLAG_350_oRDR_DETECTION_349_352_oPCAN_RADAR_ec12e48b_Tx: ComBitPosition=198, ComBitSize=1, ComSignalInitValue=0, ComSignalType=BOOLEAN, ComSystemTemplateSystemSignalRef=DET_HVC_FLAG_350
            DET_HVC_FLAG_351_oRDR_DETECTION_349_352_oPCAN_RADAR_7962301e_Tx: ComBitPosition=310, ComBitSize=1, ComSignalInitValue=0, ComSignalType=BOOLEAN, ComSystemTemplateSystemSignalRef=DET_HVC_FLAG_351
            DET_HVC_FLAG_352_oRDR_DETECTION_349_352_oPCAN_RADAR_1d824be0_Tx: ComBitPosition=422, ComBitSize=1, ComSignalInitValue=0, ComSignalType=BOOLEAN, ComSystemTemplateSystemSignalRef=DET_HVC_FLAG_352
            DET_IDM_349_oRDR_DETECTION_349_352_oPCAN_RADAR_0260ad92_Tx: ComBitPosition=63, ComBitSize=1, ComSignalInitValue=0, ComSignalType=BOOLEAN, ComSystemTemplateSystemSignalRef=DET_IDM_349
            DET_IDM_350_oRDR_DETECTION_349_352_oPCAN_RADAR_6740df36_Tx: ComBitPosition=175, ComBitSize=1, ComSignalInitValue=0, ComSignalType=BOOLEAN, ComSystemTemplateSystemSignalRef=DET_IDM_350
            DET_IDM_351_oRDR_DETECTION_349_352_oPCAN_RADAR_f2300ba3_Tx: ComBitPosition=287, ComBitSize=1, ComSignalInitValue=0, ComSignalType=BOOLEAN, ComSystemTemplateSystemSignalRef=DET_IDM_351
            DET_IDM_352_oRDR_DETECTION_349_352_oPCAN_RADAR_96d0705d_Tx: ComBitPosition=399, ComBitSize=1, ComSignalInitValue=0, ComSignalType=BOOLEAN, ComSystemTemplateSystemSignalRef=DET_IDM_352
            DET_MH_CRC16_349_352_oRDR_DETECTION_349_352_oPCAN_RADAR_1e6a70e7_Tx: ComBitPosition=0, ComBitSize=16, ComSignalInitValue=0, ComSignalType=UINT16, ComSystemTemplateSystemSignalRef=DET_MH_CRC16_349_352
            DET_MH_CYCLE_COUNTER_349_352_oRDR_DETECTION_349_352_oPCAN_RADAR_9a1fd1d0_Tx: ComBitPosition=16, ComBitSize=8, ComSignalInitValue=0, ComSignalType=UINT8, ComSystemTemplateSystemSignalRef=DET_MH_CYCLE_COUNTER_349_352
            DET_MH_SCAN_INDEX_4LSB_349_352_oRDR_DETECTION_349_352_oPCAN_RADAR_5635f45c_Tx: ComBitPosition=476, ComBitSize=4, ComSignalInitValue=0, ComSignalType=UINT8, ComSystemTemplateSystemSignalRef=DET_MH_SCAN_INDEX_4LSB_349_352
            DET_MTD_349_oRDR_DETECTION_349_352_oPCAN_RADAR_64d39f49_Tx: ComBitPosition=47, ComBitSize=1, ComSignalInitValue=0, ComSignalType=BOOLEAN, ComSystemTemplateSystemSignalRef=DET_MTD_349
            DET_MTD_350_oRDR_DETECTION_349_352_oPCAN_RADAR_01f3eded_Tx: ComBitPosition=159, ComBitSize=1, ComSignalInitValue=0, ComSignalType=BOOLEAN, ComSystemTemplateSystemSignalRef=DET_MTD_350
            DET_MTD_351_oRDR_DETECTION_349_352_oPCAN_RADAR_94833978_Tx: ComBitPosition=271, ComBitSize=1, ComSignalInitValue=0, ComSignalType=BOOLEAN, ComSystemTemplateSystemSignalRef=DET_MTD_351
            DET_MTD_352_oRDR_DETECTION_349_352_oPCAN_RADAR_f0634286_Tx: ComBitPosition=383, ComBitSize=1, ComSignalInitValue=0, ComSignalType=BOOLEAN, ComSystemTemplateSystemSignalRef=DET_MTD_352
            DET_PROB_1STAZHYPO_349_oRDR_DETECTION_349_352_oPCAN_RADAR_f7677784_Tx: ComBitPosition=103, ComBitSize=1, ComSignalInitValue=0, ComSignalType=BOOLEAN, ComSystemTemplateSystemSignalRef=DET_PROB_1STAZHYPO_349
            DET_PROB_1STAZHYPO_350_oRDR_DETECTION_349_352_oPCAN_RADAR_92470520_Tx: ComBitPosition=215, ComBitSize=1, ComSignalInitValue=0, ComSignalType=BOOLEAN, ComSystemTemplateSystemSignalRef=DET_PROB_1STAZHYPO_350
            DET_PROB_1STAZHYPO_351_oRDR_DETECTION_349_352_oPCAN_RADAR_0737d1b5_Tx: ComBitPosition=327, ComBitSize=1, ComSignalInitValue=0, ComSignalType=BOOLEAN, ComSystemTemplateSystemSignalRef=DET_PROB_1STAZHYPO_351
            DET_PROB_1STAZHYPO_352_oRDR_DETECTION_349_352_oPCAN_RADAR_63d7aa4b_Tx: ComBitPosition=439, ComBitSize=1, ComSignalInitValue=0, ComSignalType=BOOLEAN, ComSystemTemplateSystemSignalRef=DET_PROB_1STAZHYPO_352
            DET_RANGE_349_oRDR_DETECTION_349_352_oPCAN_RADAR_fcc894f2_Tx: ComBitPosition=24, ComBitSize=15, ComSignalInitValue=0, ComSignalType=UINT16, ComSystemTemplateSystemSignalRef=DET_RANGE_349
            DET_RANGE_350_oRDR_DETECTION_349_352_oPCAN_RADAR_99e8e656_Tx: ComBitPosition=136, ComBitSize=15, ComSignalInitValue=0, ComSignalType=UINT16, ComSystemTemplateSystemSignalRef=DET_RANGE_350
            DET_RANGE_351_oRDR_DETECTION_349_352_oPCAN_RADAR_0c9832c3_Tx: ComBitPosition=248, ComBitSize=15, ComSignalInitValue=0, ComSignalType=UINT16, ComSystemTemplateSystemSignalRef=DET_RANGE_351
            DET_RANGE_352_oRDR_DETECTION_349_352_oPCAN_RADAR_6878493d_Tx: ComBitPosition=360, ComBitSize=15, ComSignalInitValue=0, ComSignalType=UINT16, ComSystemTemplateSystemSignalRef=DET_RANGE_352
            DET_RANGE_ERR_349_oRDR_DETECTION_349_352_oPCAN_RADAR_5b202e9b_Tx: ComBitPosition=40, ComBitSize=7, ComSignalInitValue=0, ComSignalType=UINT8, ComSystemTemplateSystemSignalRef=DET_RANGE_ERR_349
            DET_RANGE_ERR_350_oRDR_DETECTION_349_352_oPCAN_RADAR_3e005c3f_Tx: ComBitPosition=152, ComBitSize=7, ComSignalInitValue=0, ComSignalType=UINT8, ComSystemTemplateSystemSignalRef=DET_RANGE_ERR_350
            DET_RANGE_ERR_351_oRDR_DETECTION_349_352_oPCAN_RADAR_ab7088aa_Tx: ComBitPosition=264, ComBitSize=7, ComSignalInitValue=0, ComSignalType=UINT8, ComSystemTemplateSystemSignalRef=DET_RANGE_ERR_351
            DET_RANGE_ERR_352_oRDR_DETECTION_349_352_oPCAN_RADAR_cf90f354_Tx: ComBitPosition=376, ComBitSize=7, ComSignalInitValue=0, ComSignalType=UINT8, ComSystemTemplateSystemSignalRef=DET_RANGE_ERR_352
            DET_RANGE_VELOCITY_349_oRDR_DETECTION_349_352_oPCAN_RADAR_896e56d7_Tx: ComBitPosition=48, ComBitSize=15, ComSignalInitValue=16384, ComSignalType=UINT16, ComSystemTemplateSystemSignalRef=DET_RANGE_VELOCITY_349
            DET_RANGE_VELOCITY_350_oRDR_DETECTION_349_352_oPCAN_RADAR_ec4e2473_Tx: ComBitPosition=160, ComBitSize=15, ComSignalInitValue=16384, ComSignalType=UINT16, ComSystemTemplateSystemSignalRef=DET_RANGE_VELOCITY_350
            DET_RANGE_VELOCITY_351_oRDR_DETECTION_349_352_oPCAN_RADAR_793ef0e6_Tx: ComBitPosition=272, ComBitSize=15, ComSignalInitValue=16384, ComSignalType=UINT16, ComSystemTemplateSystemSignalRef=DET_RANGE_VELOCITY_351
            DET_RANGE_VELOCITY_352_oRDR_DETECTION_349_352_oPCAN_RADAR_1dde8b18_Tx: ComBitPosition=384, ComBitSize=15, ComSignalInitValue=16384, ComSignalType=UINT16, ComSystemTemplateSystemSignalRef=DET_RANGE_VELOCITY_352
            DET_RANGE_VELOCITY_ERR_349_oRDR_DETECTION_349_352_oPCAN_RADAR_86d5ad65_Tx: ComBitPosition=64, ComBitSize=8, ComSignalInitValue=0, ComSignalType=UINT8, ComSystemTemplateSystemSignalRef=DET_RANGE_VELOCITY_ERR_349
            DET_RANGE_VELOCITY_ERR_350_oRDR_DETECTION_349_352_oPCAN_RADAR_e3f5dfc1_Tx: ComBitPosition=176, ComBitSize=8, ComSignalInitValue=0, ComSignalType=UINT8, ComSystemTemplateSystemSignalRef=DET_RANGE_VELOCITY_ERR_350
            DET_RANGE_VELOCITY_ERR_351_oRDR_DETECTION_349_352_oPCAN_RADAR_76850b54_Tx: ComBitPosition=288, ComBitSize=8, ComSignalInitValue=0, ComSignalType=UINT8, ComSystemTemplateSystemSignalRef=DET_RANGE_VELOCITY_ERR_351
            DET_RANGE_VELOCITY_ERR_352_oRDR_DETECTION_349_352_oPCAN_RADAR_126570aa_Tx: ComBitPosition=400, ComBitSize=8, ComSignalInitValue=0, ComSignalType=UINT8, ComSystemTemplateSystemSignalRef=DET_RANGE_VELOCITY_ERR_352
            DET_RCS_349_oRDR_DETECTION_349_352_oPCAN_RADAR_0eee618d_Tx: ComBitPosition=128, ComBitSize=8, ComSignalInitValue=128, ComSignalType=UINT8, ComSystemTemplateSystemSignalRef=DET_RCS_349
            DET_RCS_350_oRDR_DETECTION_349_352_oPCAN_RADAR_6bce1329_Tx: ComBitPosition=240, ComBitSize=8, ComSignalInitValue=128, ComSignalType=UINT8, ComSystemTemplateSystemSignalRef=DET_RCS_350
            DET_RCS_351_oRDR_DETECTION_349_352_oPCAN_RADAR_febec7bc_Tx: ComBitPosition=352, ComBitSize=8, ComSignalInitValue=128, ComSignalType=UINT8, ComSystemTemplateSystemSignalRef=DET_RCS_351
            DET_RCS_352_oRDR_DETECTION_349_352_oPCAN_RADAR_9a5ebc42_Tx: ComBitPosition=464, ComBitSize=8, ComSignalInitValue=128, ComSignalType=UINT8, ComSystemTemplateSystemSignalRef=DET_RCS_352
            DET_SNR_349_oRDR_DETECTION_349_352_oPCAN_RADAR_d340358f_Tx: ComBitPosition=120, ComBitSize=8, ComSignalInitValue=0, ComSignalType=UINT8, ComSystemTemplateSystemSignalRef=DET_SNR_349
            DET_SNR_350_oRDR_DETECTION_349_352_oPCAN_RADAR_b660472b_Tx: ComBitPosition=232, ComBitSize=8, ComSignalInitValue=0, ComSignalType=UINT8, ComSystemTemplateSystemSignalRef=DET_SNR_350
            DET_SNR_351_oRDR_DETECTION_349_352_oPCAN_RADAR_231093be_Tx: ComBitPosition=344, ComBitSize=8, ComSignalInitValue=0, ComSignalType=UINT8, ComSystemTemplateSystemSignalRef=DET_SNR_351
            DET_SNR_352_oRDR_DETECTION_349_352_oPCAN_RADAR_47f0e840_Tx: ComBitPosition=456, ComBitSize=8, ComSignalInitValue=0, ComSignalType=UINT8, ComSystemTemplateSystemSignalRef=DET_SNR_352
            DET_SUPER_RES_TARGET_349_oRDR_DETECTION_349_352_oPCAN_RADAR_e2d91dea_Tx: ComBitPosition=87, ComBitSize=1, ComSignalInitValue=0, ComSignalType=BOOLEAN, ComSystemTemplateSystemSignalRef=DET_SUPER_RES_TARGET_349
            DET_SUPER_RES_TARGET_350_oRDR_DETECTION_349_352_oPCAN_RADAR_87f96f4e_Tx: ComBitPosition=199, ComBitSize=1, ComSignalInitValue=0, ComSignalType=BOOLEAN, ComSystemTemplateSystemSignalRef=DET_SUPER_RES_TARGET_350
            DET_SUPER_RES_TARGET_351_oRDR_DETECTION_349_352_oPCAN_RADAR_1289bbdb_Tx: ComBitPosition=311, ComBitSize=1, ComSignalInitValue=0, ComSignalType=BOOLEAN, ComSystemTemplateSystemSignalRef=DET_SUPER_RES_TARGET_351
            DET_SUPER_RES_TARGET_352_oRDR_DETECTION_349_352_oPCAN_RADAR_7669c025_Tx: ComBitPosition=423, ComBitSize=1, ComSignalInitValue=0, ComSignalType=BOOLEAN, ComSystemTemplateSystemSignalRef=DET_SUPER_RES_TARGET_352
        SG_Detections_353_356_oRDR_DETECTION_353_356_oPCAN_RADAR_a8e9cac4_Tx: ComSystemTemplateSignalGroupRef=SG_Detections_353_356
          83 x ComGroupSignal, all with ComSignalEndianness=LITTLE_ENDIAN, ComTransferProperty=PENDING:
            DET_AZIMUTH_353_oRDR_DETECTION_353_356_oPCAN_RADAR_f054ed3d_Tx: ComBitPosition=88, ComBitSize=13, ComSignalInitValue=0, ComSignalType=UINT16, ComSystemTemplateSystemSignalRef=DET_AZIMUTH_353
            DET_AZIMUTH_354_oRDR_DETECTION_353_356_oPCAN_RADAR_ace4ce54_Tx: ComBitPosition=200, ComBitSize=13, ComSignalInitValue=0, ComSignalType=UINT16, ComSystemTemplateSystemSignalRef=DET_AZIMUTH_354
            DET_AZIMUTH_355_oRDR_DETECTION_353_356_oPCAN_RADAR_39941ac1_Tx: ComBitPosition=312, ComBitSize=13, ComSignalInitValue=0, ComSignalType=UINT16, ComSystemTemplateSystemSignalRef=DET_AZIMUTH_355
            DET_AZIMUTH_356_oRDR_DETECTION_353_356_oPCAN_RADAR_5d74613f_Tx: ComBitPosition=424, ComBitSize=13, ComSignalInitValue=0, ComSignalType=UINT16, ComSystemTemplateSystemSignalRef=DET_AZIMUTH_356
            DET_AZIMUTH_ERR_353_oRDR_DETECTION_353_356_oPCAN_RADAR_54e178c8_Tx: ComBitPosition=105, ComBitSize=7, ComSignalInitValue=0, ComSignalType=UINT8, ComSystemTemplateSystemSignalRef=DET_AZIMUTH_ERR_353
            DET_AZIMUTH_ERR_354_oRDR_DETECTION_353_356_oPCAN_RADAR_08515ba1_Tx: ComBitPosition=217, ComBitSize=7, ComSignalInitValue=0, ComSignalType=UINT8, ComSystemTemplateSystemSignalRef=DET_AZIMUTH_ERR_354
            DET_AZIMUTH_ERR_355_oRDR_DETECTION_353_356_oPCAN_RADAR_9d218f34_Tx: ComBitPosition=329, ComBitSize=7, ComSignalInitValue=0, ComSignalType=UINT8, ComSystemTemplateSystemSignalRef=DET_AZIMUTH_ERR_355
            DET_AZIMUTH_ERR_356_oRDR_DETECTION_353_356_oPCAN_RADAR_f9c1f4ca_Tx: ComBitPosition=441, ComBitSize=7, ComSignalInitValue=0, ComSignalType=UINT8, ComSystemTemplateSystemSignalRef=DET_AZIMUTH_ERR_356
            DET_BELOW_RAIN_THOLD_353_oRDR_DETECTION_353_356_oPCAN_RADAR_25557efd_Tx: ComBitPosition=39, ComBitSize=1, ComSignalInitValue=0, ComSignalType=BOOLEAN, ComSystemTemplateSystemSignalRef=DET_BELOW_RAIN_THOLD_353
            DET_BELOW_RAIN_THOLD_354_oRDR_DETECTION_353_356_oPCAN_RADAR_79e55d94_Tx: ComBitPosition=151, ComBitSize=1, ComSignalInitValue=0, ComSignalType=BOOLEAN, ComSystemTemplateSystemSignalRef=DET_BELOW_RAIN_THOLD_354
            DET_BELOW_RAIN_THOLD_355_oRDR_DETECTION_353_356_oPCAN_RADAR_ec958901_Tx: ComBitPosition=263, ComBitSize=1, ComSignalInitValue=0, ComSignalType=BOOLEAN, ComSystemTemplateSystemSignalRef=DET_BELOW_RAIN_THOLD_355
            DET_BELOW_RAIN_THOLD_356_oRDR_DETECTION_353_356_oPCAN_RADAR_8875f2ff_Tx: ComBitPosition=375, ComBitSize=1, ComSignalInitValue=0, ComSignalType=BOOLEAN, ComSystemTemplateSystemSignalRef=DET_BELOW_RAIN_THOLD_356
            DET_BI_STATIC_FLAG_353_oRDR_DETECTION_353_356_oPCAN_RADAR_a678adb8_Tx: ComBitPosition=104, ComBitSize=1, ComSignalInitValue=0, ComSignalType=BOOLEAN, ComSystemTemplateSystemSignalRef=DET_BI_STATIC_FLAG_353
            DET_BI_STATIC_FLAG_354_oRDR_DETECTION_353_356_oPCAN_RADAR_fac88ed1_Tx: ComBitPosition=216, ComBitSize=1, ComSignalInitValue=0, ComSignalType=BOOLEAN, ComSystemTemplateSystemSignalRef=DET_BI_STATIC_FLAG_354
            DET_BI_STATIC_FLAG_355_oRDR_DETECTION_353_356_oPCAN_RADAR_6fb85a44_Tx: ComBitPosition=328, ComBitSize=1, ComSignalInitValue=0, ComSignalType=BOOLEAN, ComSystemTemplateSystemSignalRef=DET_BI_STATIC_FLAG_355
            DET_BI_STATIC_FLAG_356_oRDR_DETECTION_353_356_oPCAN_RADAR_0b5821ba_Tx: ComBitPosition=440, ComBitSize=1, ComSignalInitValue=0, ComSignalType=BOOLEAN, ComSystemTemplateSystemSignalRef=DET_BI_STATIC_FLAG_356
            DET_CONFD_AZIMUTH_353_oRDR_DETECTION_353_356_oPCAN_RADAR_f2b2e7f7_Tx: ComBitPosition=118, ComBitSize=2, ComSignalInitValue=0, ComSignalType=UINT8, ComSystemTemplateSystemSignalRef=DET_CONFD_AZIMUTH_353
            DET_CONFD_AZIMUTH_354_oRDR_DETECTION_353_356_oPCAN_RADAR_ae02c49e_Tx: ComBitPosition=230, ComBitSize=2, ComSignalInitValue=0, ComSignalType=UINT8, ComSystemTemplateSystemSignalRef=DET_CONFD_AZIMUTH_354
            DET_CONFD_AZIMUTH_355_oRDR_DETECTION_353_356_oPCAN_RADAR_3b72100b_Tx: ComBitPosition=342, ComBitSize=2, ComSignalInitValue=0, ComSignalType=UINT8, ComSystemTemplateSystemSignalRef=DET_CONFD_AZIMUTH_355
            DET_CONFD_AZIMUTH_356_oRDR_DETECTION_353_356_oPCAN_RADAR_5f926bf5_Tx: ComBitPosition=454, ComBitSize=2, ComSignalInitValue=0, ComSignalType=UINT8, ComSystemTemplateSystemSignalRef=DET_CONFD_AZIMUTH_356
            DET_CONFD_ELEVATION_353_oRDR_DETECTION_353_356_oPCAN_RADAR_f027e60d_Tx: ComBitPosition=101, ComBitSize=2, ComSignalInitValue=0, ComSignalType=UINT8, ComSystemTemplateSystemSignalRef=DET_CONFD_ELEVATION_353
            DET_CONFD_ELEVATION_354_oRDR_DETECTION_353_356_oPCAN_RADAR_ac97c564_Tx: ComBitPosition=213, ComBitSize=2, ComSignalInitValue=0, ComSignalType=UINT8, ComSystemTemplateSystemSignalRef=DET_CONFD_ELEVATION_354
            DET_CONFD_ELEVATION_355_oRDR_DETECTION_353_356_oPCAN_RADAR_39e711f1_Tx: ComBitPosition=325, ComBitSize=2, ComSignalInitValue=0, ComSignalType=UINT8, ComSystemTemplateSystemSignalRef=DET_CONFD_ELEVATION_355
            DET_CONFD_ELEVATION_356_oRDR_DETECTION_353_356_oPCAN_RADAR_5d076a0f_Tx: ComBitPosition=437, ComBitSize=2, ComSignalInitValue=0, ComSignalType=UINT8, ComSystemTemplateSystemSignalRef=DET_CONFD_ELEVATION_356
            DET_ELEVATION_353_oRDR_DETECTION_353_356_oPCAN_RADAR_21e73231_Tx: ComBitPosition=72, ComBitSize=8, ComSignalInitValue=0, ComSignalType=UINT8, ComSystemTemplateSystemSignalRef=DET_ELEVATION_353
            DET_ELEVATION_354_oRDR_DETECTION_353_356_oPCAN_RADAR_7d571158_Tx: ComBitPosition=184, ComBitSize=8, ComSignalInitValue=0, ComSignalType=UINT8, ComSystemTemplateSystemSignalRef=DET_ELEVATION_354
            DET_ELEVATION_355_oRDR_DETECTION_353_356_oPCAN_RADAR_e827c5cd_Tx: ComBitPosition=296, ComBitSize=8, ComSignalInitValue=0, ComSignalType=UINT8, ComSystemTemplateSystemSignalRef=DET_ELEVATION_355
            DET_ELEVATION_356_oRDR_DETECTION_353_356_oPCAN_RADAR_8cc7be33_Tx: ComBitPosition=408, ComBitSize=8, ComSignalInitValue=0, ComSignalType=UINT8, ComSystemTemplateSystemSignalRef=DET_ELEVATION_356
            DET_ELEVATION_ERR_353_oRDR_DETECTION_353_356_oPCAN_RADAR_a6deaa44_Tx: ComBitPosition=80, ComBitSize=6, ComSignalInitValue=0, ComSignalType=UINT8, ComSystemTemplateSystemSignalRef=DET_ELEVATION_ERR_353
            DET_ELEVATION_ERR_354_oRDR_DETECTION_353_356_oPCAN_RADAR_fa6e892d_Tx: ComBitPosition=192, ComBitSize=6, ComSignalInitValue=0, ComSignalType=UINT8, ComSystemTemplateSystemSignalRef=DET_ELEVATION_ERR_354
            DET_ELEVATION_ERR_355_oRDR_DETECTION_353_356_oPCAN_RADAR_6f1e5db8_Tx: ComBitPosition=304, ComBitSize=6, ComSignalInitValue=0, ComSignalType=UINT8, ComSystemTemplateSystemSignalRef=DET_ELEVATION_ERR_355
            DET_ELEVATION_ERR_356_oRDR_DETECTION_353_356_oPCAN_RADAR_0bfe2646_Tx: ComBitPosition=416, ComBitSize=6, ComSignalInitValue=0, ComSignalType=UINT8, ComSystemTemplateSystemSignalRef=DET_ELEVATION_ERR_356
            DET_EXISTENCE_PROB_353_oRDR_DETECTION_353_356_oPCAN_RADAR_7441df24_Tx: ComBitPosition=112, ComBitSize=6, ComSignalInitValue=0, ComSignalType=UINT8, ComSystemTemplateSystemSignalRef=DET_EXISTENCE_PROB_353
            DET_EXISTENCE_PROB_354_oRDR_DETECTION_353_356_oPCAN_RADAR_28f1fc4d_Tx: ComBitPosition=224, ComBitSize=6, ComSignalInitValue=0, ComSignalType=UINT8, ComSystemTemplateSystemSignalRef=DET_EXISTENCE_PROB_354
            DET_EXISTENCE_PROB_355_oRDR_DETECTION_353_356_oPCAN_RADAR_bd8128d8_Tx: ComBitPosition=336, ComBitSize=6, ComSignalInitValue=0, ComSignalType=UINT8, ComSystemTemplateSystemSignalRef=DET_EXISTENCE_PROB_355
            DET_EXISTENCE_PROB_356_oRDR_DETECTION_353_356_oPCAN_RADAR_d9615326_Tx: ComBitPosition=448, ComBitSize=6, ComSignalInitValue=0, ComSignalType=UINT8, ComSystemTemplateSystemSignalRef=DET_EXISTENCE_PROB_356
            DET_HVC_FLAG_353_oRDR_DETECTION_353_356_oPCAN_RADAR_95359c5b_Tx: ComBitPosition=86, ComBitSize=1, ComSignalInitValue=0, ComSignalType=BOOLEAN, ComSystemTemplateSystemSignalRef=DET_HVC_FLAG_353
            DET_HVC_FLAG_354_oRDR_DETECTION_353_356_oPCAN_RADAR_c985bf32_Tx: ComBitPosition=198, ComBitSize=1, ComSignalInitValue=0, ComSignalType=BOOLEAN, ComSystemTemplateSystemSignalRef=DET_HVC_FLAG_354
            DET_HVC_FLAG_355_oRDR_DETECTION_353_356_oPCAN_RADAR_5cf56ba7_Tx: ComBitPosition=310, ComBitSize=1, ComSignalInitValue=0, ComSignalType=BOOLEAN, ComSystemTemplateSystemSignalRef=DET_HVC_FLAG_355
            DET_HVC_FLAG_356_oRDR_DETECTION_353_356_oPCAN_RADAR_38151059_Tx: ComBitPosition=422, ComBitSize=1, ComSignalInitValue=0, ComSignalType=BOOLEAN, ComSystemTemplateSystemSignalRef=DET_HVC_FLAG_356
            DET_IDM_353_oRDR_DETECTION_353_356_oPCAN_RADAR_1e67a7e6_Tx: ComBitPosition=63, ComBitSize=1, ComSignalInitValue=0, ComSignalType=BOOLEAN, ComSystemTemplateSystemSignalRef=DET_IDM_353
            DET_IDM_354_oRDR_DETECTION_353_356_oPCAN_RADAR_42d7848f_Tx: ComBitPosition=175, ComBitSize=1, ComSignalInitValue=0, ComSignalType=BOOLEAN, ComSystemTemplateSystemSignalRef=DET_IDM_354
            DET_IDM_355_oRDR_DETECTION_353_356_oPCAN_RADAR_d7a7501a_Tx: ComBitPosition=287, ComBitSize=1, ComSignalInitValue=0, ComSignalType=BOOLEAN, ComSystemTemplateSystemSignalRef=DET_IDM_355
            DET_IDM_356_oRDR_DETECTION_353_356_oPCAN_RADAR_b3472be4_Tx: ComBitPosition=399, ComBitSize=1, ComSignalInitValue=0, ComSignalType=BOOLEAN, ComSystemTemplateSystemSignalRef=DET_IDM_356
            DET_MH_CRC16_353_356_oRDR_DETECTION_353_356_oPCAN_RADAR_2c6118cf_Tx: ComBitPosition=0, ComBitSize=16, ComSignalInitValue=0, ComSignalType=UINT16, ComSystemTemplateSystemSignalRef=DET_MH_CRC16_353_356
            DET_MH_CYCLE_COUNTER_353_356_oRDR_DETECTION_353_356_oPCAN_RADAR_a814b9f8_Tx: ComBitPosition=16, ComBitSize=8, ComSignalInitValue=0, ComSignalType=UINT8, ComSystemTemplateSystemSignalRef=DET_MH_CYCLE_COUNTER_353_356
            DET_MH_SCAN_INDEX_4LSB_353_356_oRDR_DETECTION_353_356_oPCAN_RADAR_643e9c74_Tx: ComBitPosition=476, ComBitSize=4, ComSignalInitValue=0, ComSignalType=UINT8, ComSystemTemplateSystemSignalRef=DET_MH_SCAN_INDEX_4LSB_353_356
            DET_MTD_353_oRDR_DETECTION_353_356_oPCAN_RADAR_78d4953d_Tx: ComBitPosition=47, ComBitSize=1, ComSignalInitValue=0, ComSignalType=BOOLEAN, ComSystemTemplateSystemSignalRef=DET_MTD_353
            DET_MTD_354_oRDR_DETECTION_353_356_oPCAN_RADAR_2464b654_Tx: ComBitPosition=159, ComBitSize=1, ComSignalInitValue=0, ComSignalType=BOOLEAN, ComSystemTemplateSystemSignalRef=DET_MTD_354
            DET_MTD_355_oRDR_DETECTION_353_356_oPCAN_RADAR_b11462c1_Tx: ComBitPosition=271, ComBitSize=1, ComSignalInitValue=0, ComSignalType=BOOLEAN, ComSystemTemplateSystemSignalRef=DET_MTD_355
            DET_MTD_356_oRDR_DETECTION_353_356_oPCAN_RADAR_d5f4193f_Tx: ComBitPosition=383, ComBitSize=1, ComSignalInitValue=0, ComSignalType=BOOLEAN, ComSystemTemplateSystemSignalRef=DET_MTD_356
            DET_PROB_1STAZHYPO_353_oRDR_DETECTION_353_356_oPCAN_RADAR_eb607df0_Tx: ComBitPosition=103, ComBitSize=1, ComSignalInitValue=0, ComSignalType=BOOLEAN, ComSystemTemplateSystemSignalRef=DET_PROB_1STAZHYPO_353
            DET_PROB_1STAZHYPO_354_oRDR_DETECTION_353_356_oPCAN_RADAR_b7d05e99_Tx: ComBitPosition=215, ComBitSize=1, ComSignalInitValue=0, ComSignalType=BOOLEAN, ComSystemTemplateSystemSignalRef=DET_PROB_1STAZHYPO_354
            DET_PROB_1STAZHYPO_355_oRDR_DETECTION_353_356_oPCAN_RADAR_22a08a0c_Tx: ComBitPosition=327, ComBitSize=1, ComSignalInitValue=0, ComSignalType=BOOLEAN, ComSystemTemplateSystemSignalRef=DET_PROB_1STAZHYPO_355
            DET_PROB_1STAZHYPO_356_oRDR_DETECTION_353_356_oPCAN_RADAR_4640f1f2_Tx: ComBitPosition=439, ComBitSize=1, ComSignalInitValue=0, ComSignalType=BOOLEAN, ComSystemTemplateSystemSignalRef=DET_PROB_1STAZHYPO_356
            DET_RANGE_353_oRDR_DETECTION_353_356_oPCAN_RADAR_e0cf9e86_Tx: ComBitPosition=24, ComBitSize=15, ComSignalInitValue=0, ComSignalType=UINT16, ComSystemTemplateSystemSignalRef=DET_RANGE_353
            DET_RANGE_354_oRDR_DETECTION_353_356_oPCAN_RADAR_bc7fbdef_Tx: ComBitPosition=136, ComBitSize=15, ComSignalInitValue=0, ComSignalType=UINT16, ComSystemTemplateSystemSignalRef=DET_RANGE_354
            DET_RANGE_355_oRDR_DETECTION_353_356_oPCAN_RADAR_290f697a_Tx: ComBitPosition=248, ComBitSize=15, ComSignalInitValue=0, ComSignalType=UINT16, ComSystemTemplateSystemSignalRef=DET_RANGE_355
            DET_RANGE_356_oRDR_DETECTION_353_356_oPCAN_RADAR_4def1284_Tx: ComBitPosition=360, ComBitSize=15, ComSignalInitValue=0, ComSignalType=UINT16, ComSystemTemplateSystemSignalRef=DET_RANGE_356
            DET_RANGE_ERR_353_oRDR_DETECTION_353_356_oPCAN_RADAR_472724ef_Tx: ComBitPosition=40, ComBitSize=7, ComSignalInitValue=0, ComSignalType=UINT8, ComSystemTemplateSystemSignalRef=DET_RANGE_ERR_353
            DET_RANGE_ERR_354_oRDR_DETECTION_353_356_oPCAN_RADAR_1b970786_Tx: ComBitPosition=152, ComBitSize=7, ComSignalInitValue=0, ComSignalType=UINT8, ComSystemTemplateSystemSignalRef=DET_RANGE_ERR_354
            DET_RANGE_ERR_355_oRDR_DETECTION_353_356_oPCAN_RADAR_8ee7d313_Tx: ComBitPosition=264, ComBitSize=7, ComSignalInitValue=0, ComSignalType=UINT8, ComSystemTemplateSystemSignalRef=DET_RANGE_ERR_355
            DET_RANGE_ERR_356_oRDR_DETECTION_353_356_oPCAN_RADAR_ea07a8ed_Tx: ComBitPosition=376, ComBitSize=7, ComSignalInitValue=0, ComSignalType=UINT8, ComSystemTemplateSystemSignalRef=DET_RANGE_ERR_356
            DET_RANGE_VELOCITY_353_oRDR_DETECTION_353_356_oPCAN_RADAR_95695ca3_Tx: ComBitPosition=48, ComBitSize=15, ComSignalInitValue=16384, ComSignalType=UINT16, ComSystemTemplateSystemSignalRef=DET_RANGE_VELOCITY_353
            DET_RANGE_VELOCITY_354_oRDR_DETECTION_353_356_oPCAN_RADAR_c9d97fca_Tx: ComBitPosition=160, ComBitSize=15, ComSignalInitValue=16384, ComSignalType=UINT16, ComSystemTemplateSystemSignalRef=DET_RANGE_VELOCITY_354
            DET_RANGE_VELOCITY_355_oRDR_DETECTION_353_356_oPCAN_RADAR_5ca9ab5f_Tx: ComBitPosition=272, ComBitSize=15, ComSignalInitValue=16384, ComSignalType=UINT16, ComSystemTemplateSystemSignalRef=DET_RANGE_VELOCITY_355
            DET_RANGE_VELOCITY_356_oRDR_DETECTION_353_356_oPCAN_RADAR_3849d0a1_Tx: ComBitPosition=384, ComBitSize=15, ComSignalInitValue=16384, ComSignalType=UINT16, ComSystemTemplateSystemSignalRef=DET_RANGE_VELOCITY_356
            DET_RANGE_VELOCITY_ERR_353_oRDR_DETECTION_353_356_oPCAN_RADAR_9ad2a711_Tx: ComBitPosition=64, ComBitSize=8, ComSignalInitValue=0, ComSignalType=UINT8, ComSystemTemplateSystemSignalRef=DET_RANGE_VELOCITY_ERR_353
            DET_RANGE_VELOCITY_ERR_354_oRDR_DETECTION_353_356_oPCAN_RADAR_c6628478_Tx: ComBitPosition=176, ComBitSize=8, ComSignalInitValue=0, ComSignalType=UINT8, ComSystemTemplateSystemSignalRef=DET_RANGE_VELOCITY_ERR_354
            DET_RANGE_VELOCITY_ERR_355_oRDR_DETECTION_353_356_oPCAN_RADAR_531250ed_Tx: ComBitPosition=288, ComBitSize=8, ComSignalInitValue=0, ComSignalType=UINT8, ComSystemTemplateSystemSignalRef=DET_RANGE_VELOCITY_ERR_355
            DET_RANGE_VELOCITY_ERR_356_oRDR_DETECTION_353_356_oPCAN_RADAR_37f22b13_Tx: ComBitPosition=400, ComBitSize=8, ComSignalInitValue=0, ComSignalType=UINT8, ComSystemTemplateSystemSignalRef=DET_RANGE_VELOCITY_ERR_356
            DET_RCS_353_oRDR_DETECTION_353_356_oPCAN_RADAR_12e96bf9_Tx: ComBitPosition=128, ComBitSize=8, ComSignalInitValue=128, ComSignalType=UINT8, ComSystemTemplateSystemSignalRef=DET_RCS_353
            DET_RCS_354_oRDR_DETECTION_353_356_oPCAN_RADAR_4e594890_Tx: ComBitPosition=240, ComBitSize=8, ComSignalInitValue=128, ComSignalType=UINT8, ComSystemTemplateSystemSignalRef=DET_RCS_354
            DET_RCS_355_oRDR_DETECTION_353_356_oPCAN_RADAR_db299c05_Tx: ComBitPosition=352, ComBitSize=8, ComSignalInitValue=128, ComSignalType=UINT8, ComSystemTemplateSystemSignalRef=DET_RCS_355
            DET_RCS_356_oRDR_DETECTION_353_356_oPCAN_RADAR_bfc9e7fb_Tx: ComBitPosition=464, ComBitSize=8, ComSignalInitValue=128, ComSignalType=UINT8, ComSystemTemplateSystemSignalRef=DET_RCS_356
            DET_SNR_353_oRDR_DETECTION_353_356_oPCAN_RADAR_cf473ffb_Tx: ComBitPosition=120, ComBitSize=8, ComSignalInitValue=0, ComSignalType=UINT8, ComSystemTemplateSystemSignalRef=DET_SNR_353
            DET_SNR_354_oRDR_DETECTION_353_356_oPCAN_RADAR_93f71c92_Tx: ComBitPosition=232, ComBitSize=8, ComSignalInitValue=0, ComSignalType=UINT8, ComSystemTemplateSystemSignalRef=DET_SNR_354
            DET_SNR_355_oRDR_DETECTION_353_356_oPCAN_RADAR_0687c807_Tx: ComBitPosition=344, ComBitSize=8, ComSignalInitValue=0, ComSignalType=UINT8, ComSystemTemplateSystemSignalRef=DET_SNR_355
            DET_SNR_356_oRDR_DETECTION_353_356_oPCAN_RADAR_6267b3f9_Tx: ComBitPosition=456, ComBitSize=8, ComSignalInitValue=0, ComSignalType=UINT8, ComSystemTemplateSystemSignalRef=DET_SNR_356
            DET_SUPER_RES_TARGET_353_oRDR_DETECTION_353_356_oPCAN_RADAR_fede179e_Tx: ComBitPosition=87, ComBitSize=1, ComSignalInitValue=0, ComSignalType=BOOLEAN, ComSystemTemplateSystemSignalRef=DET_SUPER_RES_TARGET_353
            DET_SUPER_RES_TARGET_354_oRDR_DETECTION_353_356_oPCAN_RADAR_a26e34f7_Tx: ComBitPosition=199, ComBitSize=1, ComSignalInitValue=0, ComSignalType=BOOLEAN, ComSystemTemplateSystemSignalRef=DET_SUPER_RES_TARGET_354
            DET_SUPER_RES_TARGET_355_oRDR_DETECTION_353_356_oPCAN_RADAR_371ee062_Tx: ComBitPosition=311, ComBitSize=1, ComSignalInitValue=0, ComSignalType=BOOLEAN, ComSystemTemplateSystemSignalRef=DET_SUPER_RES_TARGET_355
            DET_SUPER_RES_TARGET_356_oRDR_DETECTION_353_356_oPCAN_RADAR_53fe9b9c_Tx: ComBitPosition=423, ComBitSize=1, ComSignalInitValue=0, ComSignalType=BOOLEAN, ComSystemTemplateSystemSignalRef=DET_SUPER_RES_TARGET_356
        SG_Detections_357_360_oRDR_DETECTION_357_360_oPCAN_RADAR_44459c4e_Tx: ComSystemTemplateSignalGroupRef=SG_Detections_357_360
          83 x ComGroupSignal, all with ComSignalEndianness=LITTLE_ENDIAN, ComTransferProperty=PENDING:
            DET_AZIMUTH_357_oRDR_DETECTION_357_360_oPCAN_RADAR_67886863_Tx: ComBitPosition=88, ComBitSize=13, ComSignalInitValue=0, ComSignalType=UINT16, ComSystemTemplateSystemSignalRef=DET_AZIMUTH_357
            DET_AZIMUTH_358_oRDR_DETECTION_357_360_oPCAN_RADAR_4b98fa24_Tx: ComBitPosition=200, ComBitSize=13, ComSignalInitValue=0, ComSignalType=UINT16, ComSystemTemplateSystemSignalRef=DET_AZIMUTH_358
            DET_AZIMUTH_359_oRDR_DETECTION_357_360_oPCAN_RADAR_dee82eb1_Tx: ComBitPosition=312, ComBitSize=13, ComSignalInitValue=0, ComSignalType=UINT16, ComSystemTemplateSystemSignalRef=DET_AZIMUTH_359
            DET_AZIMUTH_360_oRDR_DETECTION_357_360_oPCAN_RADAR_6159746a_Tx: ComBitPosition=424, ComBitSize=13, ComSignalInitValue=0, ComSignalType=UINT16, ComSystemTemplateSystemSignalRef=DET_AZIMUTH_360
            DET_AZIMUTH_ERR_357_oRDR_DETECTION_357_360_oPCAN_RADAR_c33dfd96_Tx: ComBitPosition=105, ComBitSize=7, ComSignalInitValue=0, ComSignalType=UINT8, ComSystemTemplateSystemSignalRef=DET_AZIMUTH_ERR_357
            DET_AZIMUTH_ERR_358_oRDR_DETECTION_357_360_oPCAN_RADAR_ef2d6fd1_Tx: ComBitPosition=217, ComBitSize=7, ComSignalInitValue=0, ComSignalType=UINT8, ComSystemTemplateSystemSignalRef=DET_AZIMUTH_ERR_358
            DET_AZIMUTH_ERR_359_oRDR_DETECTION_357_360_oPCAN_RADAR_7a5dbb44_Tx: ComBitPosition=329, ComBitSize=7, ComSignalInitValue=0, ComSignalType=UINT8, ComSystemTemplateSystemSignalRef=DET_AZIMUTH_ERR_359
            DET_AZIMUTH_ERR_360_oRDR_DETECTION_357_360_oPCAN_RADAR_c5ece19f_Tx: ComBitPosition=441, ComBitSize=7, ComSignalInitValue=0, ComSignalType=UINT8, ComSystemTemplateSystemSignalRef=DET_AZIMUTH_ERR_360
            DET_BELOW_RAIN_THOLD_357_oRDR_DETECTION_357_360_oPCAN_RADAR_b289fba3_Tx: ComBitPosition=39, ComBitSize=1, ComSignalInitValue=0, ComSignalType=BOOLEAN, ComSystemTemplateSystemSignalRef=DET_BELOW_RAIN_THOLD_357
            DET_BELOW_RAIN_THOLD_358_oRDR_DETECTION_357_360_oPCAN_RADAR_9e9969e4_Tx: ComBitPosition=151, ComBitSize=1, ComSignalInitValue=0, ComSignalType=BOOLEAN, ComSystemTemplateSystemSignalRef=DET_BELOW_RAIN_THOLD_358
            DET_BELOW_RAIN_THOLD_359_oRDR_DETECTION_357_360_oPCAN_RADAR_0be9bd71_Tx: ComBitPosition=263, ComBitSize=1, ComSignalInitValue=0, ComSignalType=BOOLEAN, ComSystemTemplateSystemSignalRef=DET_BELOW_RAIN_THOLD_359
            DET_BELOW_RAIN_THOLD_360_oRDR_DETECTION_357_360_oPCAN_RADAR_b458e7aa_Tx: ComBitPosition=375, ComBitSize=1, ComSignalInitValue=0, ComSignalType=BOOLEAN, ComSystemTemplateSystemSignalRef=DET_BELOW_RAIN_THOLD_360
            DET_BI_STATIC_FLAG_357_oRDR_DETECTION_357_360_oPCAN_RADAR_31a428e6_Tx: ComBitPosition=104, ComBitSize=1, ComSignalInitValue=0, ComSignalType=BOOLEAN, ComSystemTemplateSystemSignalRef=DET_BI_STATIC_FLAG_357
            DET_BI_STATIC_FLAG_358_oRDR_DETECTION_357_360_oPCAN_RADAR_1db4baa1_Tx: ComBitPosition=216, ComBitSize=1, ComSignalInitValue=0, ComSignalType=BOOLEAN, ComSystemTemplateSystemSignalRef=DET_BI_STATIC_FLAG_358
            DET_BI_STATIC_FLAG_359_oRDR_DETECTION_357_360_oPCAN_RADAR_88c46e34_Tx: ComBitPosition=328, ComBitSize=1, ComSignalInitValue=0, ComSignalType=BOOLEAN, ComSystemTemplateSystemSignalRef=DET_BI_STATIC_FLAG_359
            DET_BI_STATIC_FLAG_360_oRDR_DETECTION_357_360_oPCAN_RADAR_377534ef_Tx: ComBitPosition=440, ComBitSize=1, ComSignalInitValue=0, ComSignalType=BOOLEAN, ComSystemTemplateSystemSignalRef=DET_BI_STATIC_FLAG_360
            DET_CONFD_AZIMUTH_357_oRDR_DETECTION_357_360_oPCAN_RADAR_656e62a9_Tx: ComBitPosition=118, ComBitSize=2, ComSignalInitValue=0, ComSignalType=UINT8, ComSystemTemplateSystemSignalRef=DET_CONFD_AZIMUTH_357
            DET_CONFD_AZIMUTH_358_oRDR_DETECTION_357_360_oPCAN_RADAR_497ef0ee_Tx: ComBitPosition=230, ComBitSize=2, ComSignalInitValue=0, ComSignalType=UINT8, ComSystemTemplateSystemSignalRef=DET_CONFD_AZIMUTH_358
            DET_CONFD_AZIMUTH_359_oRDR_DETECTION_357_360_oPCAN_RADAR_dc0e247b_Tx: ComBitPosition=342, ComBitSize=2, ComSignalInitValue=0, ComSignalType=UINT8, ComSystemTemplateSystemSignalRef=DET_CONFD_AZIMUTH_359
            DET_CONFD_AZIMUTH_360_oRDR_DETECTION_357_360_oPCAN_RADAR_63bf7ea0_Tx: ComBitPosition=454, ComBitSize=2, ComSignalInitValue=0, ComSignalType=UINT8, ComSystemTemplateSystemSignalRef=DET_CONFD_AZIMUTH_360
            DET_CONFD_ELEVATION_357_oRDR_DETECTION_357_360_oPCAN_RADAR_67fb6353_Tx: ComBitPosition=101, ComBitSize=2, ComSignalInitValue=0, ComSignalType=UINT8, ComSystemTemplateSystemSignalRef=DET_CONFD_ELEVATION_357
            DET_CONFD_ELEVATION_358_oRDR_DETECTION_357_360_oPCAN_RADAR_4bebf114_Tx: ComBitPosition=213, ComBitSize=2, ComSignalInitValue=0, ComSignalType=UINT8, ComSystemTemplateSystemSignalRef=DET_CONFD_ELEVATION_358
            DET_CONFD_ELEVATION_359_oRDR_DETECTION_357_360_oPCAN_RADAR_de9b2581_Tx: ComBitPosition=325, ComBitSize=2, ComSignalInitValue=0, ComSignalType=UINT8, ComSystemTemplateSystemSignalRef=DET_CONFD_ELEVATION_359
            DET_CONFD_ELEVATION_360_oRDR_DETECTION_357_360_oPCAN_RADAR_612a7f5a_Tx: ComBitPosition=437, ComBitSize=2, ComSignalInitValue=0, ComSignalType=UINT8, ComSystemTemplateSystemSignalRef=DET_CONFD_ELEVATION_360
            DET_ELEVATION_357_oRDR_DETECTION_357_360_oPCAN_RADAR_b63bb76f_Tx: ComBitPosition=72, ComBitSize=8, ComSignalInitValue=0, ComSignalType=UINT8, ComSystemTemplateSystemSignalRef=DET_ELEVATION_357
            DET_ELEVATION_358_oRDR_DETECTION_357_360_oPCAN_RADAR_9a2b2528_Tx: ComBitPosition=184, ComBitSize=8, ComSignalInitValue=0, ComSignalType=UINT8, ComSystemTemplateSystemSignalRef=DET_ELEVATION_358
            DET_ELEVATION_359_oRDR_DETECTION_357_360_oPCAN_RADAR_0f5bf1bd_Tx: ComBitPosition=296, ComBitSize=8, ComSignalInitValue=0, ComSignalType=UINT8, ComSystemTemplateSystemSignalRef=DET_ELEVATION_359
            DET_ELEVATION_360_oRDR_DETECTION_357_360_oPCAN_RADAR_b0eaab66_Tx: ComBitPosition=408, ComBitSize=8, ComSignalInitValue=0, ComSignalType=UINT8, ComSystemTemplateSystemSignalRef=DET_ELEVATION_360
            DET_ELEVATION_ERR_357_oRDR_DETECTION_357_360_oPCAN_RADAR_31022f1a_Tx: ComBitPosition=80, ComBitSize=6, ComSignalInitValue=0, ComSignalType=UINT8, ComSystemTemplateSystemSignalRef=DET_ELEVATION_ERR_357
            DET_ELEVATION_ERR_358_oRDR_DETECTION_357_360_oPCAN_RADAR_1d12bd5d_Tx: ComBitPosition=192, ComBitSize=6, ComSignalInitValue=0, ComSignalType=UINT8, ComSystemTemplateSystemSignalRef=DET_ELEVATION_ERR_358
            DET_ELEVATION_ERR_359_oRDR_DETECTION_357_360_oPCAN_RADAR_886269c8_Tx: ComBitPosition=304, ComBitSize=6, ComSignalInitValue=0, ComSignalType=UINT8, ComSystemTemplateSystemSignalRef=DET_ELEVATION_ERR_359
            DET_ELEVATION_ERR_360_oRDR_DETECTION_357_360_oPCAN_RADAR_37d33313_Tx: ComBitPosition=416, ComBitSize=6, ComSignalInitValue=0, ComSignalType=UINT8, ComSystemTemplateSystemSignalRef=DET_ELEVATION_ERR_360
            DET_EXISTENCE_PROB_357_oRDR_DETECTION_357_360_oPCAN_RADAR_e39d5a7a_Tx: ComBitPosition=112, ComBitSize=6, ComSignalInitValue=0, ComSignalType=UINT8, ComSystemTemplateSystemSignalRef=DET_EXISTENCE_PROB_357
            DET_EXISTENCE_PROB_358_oRDR_DETECTION_357_360_oPCAN_RADAR_cf8dc83d_Tx: ComBitPosition=224, ComBitSize=6, ComSignalInitValue=0, ComSignalType=UINT8, ComSystemTemplateSystemSignalRef=DET_EXISTENCE_PROB_358
            DET_EXISTENCE_PROB_359_oRDR_DETECTION_357_360_oPCAN_RADAR_5afd1ca8_Tx: ComBitPosition=336, ComBitSize=6, ComSignalInitValue=0, ComSignalType=UINT8, ComSystemTemplateSystemSignalRef=DET_EXISTENCE_PROB_359
            DET_EXISTENCE_PROB_360_oRDR_DETECTION_357_360_oPCAN_RADAR_e54c4673_Tx: ComBitPosition=448, ComBitSize=6, ComSignalInitValue=0, ComSignalType=UINT8, ComSystemTemplateSystemSignalRef=DET_EXISTENCE_PROB_360
            DET_HVC_FLAG_357_oRDR_DETECTION_357_360_oPCAN_RADAR_02e91905_Tx: ComBitPosition=86, ComBitSize=1, ComSignalInitValue=0, ComSignalType=BOOLEAN, ComSystemTemplateSystemSignalRef=DET_HVC_FLAG_357
            DET_HVC_FLAG_358_oRDR_DETECTION_357_360_oPCAN_RADAR_2ef98b42_Tx: ComBitPosition=198, ComBitSize=1, ComSignalInitValue=0, ComSignalType=BOOLEAN, ComSystemTemplateSystemSignalRef=DET_HVC_FLAG_358
            DET_HVC_FLAG_359_oRDR_DETECTION_357_360_oPCAN_RADAR_bb895fd7_Tx: ComBitPosition=310, ComBitSize=1, ComSignalInitValue=0, ComSignalType=BOOLEAN, ComSystemTemplateSystemSignalRef=DET_HVC_FLAG_359
            DET_HVC_FLAG_360_oRDR_DETECTION_357_360_oPCAN_RADAR_0438050c_Tx: ComBitPosition=422, ComBitSize=1, ComSignalInitValue=0, ComSignalType=BOOLEAN, ComSystemTemplateSystemSignalRef=DET_HVC_FLAG_360
            DET_IDM_357_oRDR_DETECTION_357_360_oPCAN_RADAR_89bb22b8_Tx: ComBitPosition=63, ComBitSize=1, ComSignalInitValue=0, ComSignalType=BOOLEAN, ComSystemTemplateSystemSignalRef=DET_IDM_357
            DET_IDM_358_oRDR_DETECTION_357_360_oPCAN_RADAR_a5abb0ff_Tx: ComBitPosition=175, ComBitSize=1, ComSignalInitValue=0, ComSignalType=BOOLEAN, ComSystemTemplateSystemSignalRef=DET_IDM_358
            DET_IDM_359_oRDR_DETECTION_357_360_oPCAN_RADAR_30db646a_Tx: ComBitPosition=287, ComBitSize=1, ComSignalInitValue=0, ComSignalType=BOOLEAN, ComSystemTemplateSystemSignalRef=DET_IDM_359
            DET_IDM_360_oRDR_DETECTION_357_360_oPCAN_RADAR_8f6a3eb1_Tx: ComBitPosition=399, ComBitSize=1, ComSignalInitValue=0, ComSignalType=BOOLEAN, ComSystemTemplateSystemSignalRef=DET_IDM_360
            DET_MH_CRC16_357_360_oRDR_DETECTION_357_360_oPCAN_RADAR_c0cd4e45_Tx: ComBitPosition=0, ComBitSize=16, ComSignalInitValue=0, ComSignalType=UINT16, ComSystemTemplateSystemSignalRef=DET_MH_CRC16_357_360
            DET_MH_CYCLE_COUNTER_357_360_oRDR_DETECTION_357_360_oPCAN_RADAR_44b8ef72_Tx: ComBitPosition=16, ComBitSize=8, ComSignalInitValue=0, ComSignalType=UINT8, ComSystemTemplateSystemSignalRef=DET_MH_CYCLE_COUNTER_357_360
            DET_MH_SCAN_INDEX_4LSB_357_360_oRDR_DETECTION_357_360_oPCAN_RADAR_8892cafe_Tx: ComBitPosition=476, ComBitSize=4, ComSignalInitValue=0, ComSignalType=UINT8, ComSystemTemplateSystemSignalRef=DET_MH_SCAN_INDEX_4LSB_357_360
            DET_MTD_357_oRDR_DETECTION_357_360_oPCAN_RADAR_ef081063_Tx: ComBitPosition=47, ComBitSize=1, ComSignalInitValue=0, ComSignalType=BOOLEAN, ComSystemTemplateSystemSignalRef=DET_MTD_357
            DET_MTD_358_oRDR_DETECTION_357_360_oPCAN_RADAR_c3188224_Tx: ComBitPosition=159, ComBitSize=1, ComSignalInitValue=0, ComSignalType=BOOLEAN, ComSystemTemplateSystemSignalRef=DET_MTD_358
            DET_MTD_359_oRDR_DETECTION_357_360_oPCAN_RADAR_566856b1_Tx: ComBitPosition=271, ComBitSize=1, ComSignalInitValue=0, ComSignalType=BOOLEAN, ComSystemTemplateSystemSignalRef=DET_MTD_359
            DET_MTD_360_oRDR_DETECTION_357_360_oPCAN_RADAR_e9d90c6a_Tx: ComBitPosition=383, ComBitSize=1, ComSignalInitValue=0, ComSignalType=BOOLEAN, ComSystemTemplateSystemSignalRef=DET_MTD_360
            DET_PROB_1STAZHYPO_357_oRDR_DETECTION_357_360_oPCAN_RADAR_7cbcf8ae_Tx: ComBitPosition=103, ComBitSize=1, ComSignalInitValue=0, ComSignalType=BOOLEAN, ComSystemTemplateSystemSignalRef=DET_PROB_1STAZHYPO_357
            DET_PROB_1STAZHYPO_358_oRDR_DETECTION_357_360_oPCAN_RADAR_50ac6ae9_Tx: ComBitPosition=215, ComBitSize=1, ComSignalInitValue=0, ComSignalType=BOOLEAN, ComSystemTemplateSystemSignalRef=DET_PROB_1STAZHYPO_358
            DET_PROB_1STAZHYPO_359_oRDR_DETECTION_357_360_oPCAN_RADAR_c5dcbe7c_Tx: ComBitPosition=327, ComBitSize=1, ComSignalInitValue=0, ComSignalType=BOOLEAN, ComSystemTemplateSystemSignalRef=DET_PROB_1STAZHYPO_359
            DET_PROB_1STAZHYPO_360_oRDR_DETECTION_357_360_oPCAN_RADAR_7a6de4a7_Tx: ComBitPosition=439, ComBitSize=1, ComSignalInitValue=0, ComSignalType=BOOLEAN, ComSystemTemplateSystemSignalRef=DET_PROB_1STAZHYPO_360
            DET_RANGE_357_oRDR_DETECTION_357_360_oPCAN_RADAR_77131bd8_Tx: ComBitPosition=24, ComBitSize=15, ComSignalInitValue=0, ComSignalType=UINT16, ComSystemTemplateSystemSignalRef=DET_RANGE_357
            DET_RANGE_358_oRDR_DETECTION_357_360_oPCAN_RADAR_5b03899f_Tx: ComBitPosition=136, ComBitSize=15, ComSignalInitValue=0, ComSignalType=UINT16, ComSystemTemplateSystemSignalRef=DET_RANGE_358
            DET_RANGE_359_oRDR_DETECTION_357_360_oPCAN_RADAR_ce735d0a_Tx: ComBitPosition=248, ComBitSize=15, ComSignalInitValue=0, ComSignalType=UINT16, ComSystemTemplateSystemSignalRef=DET_RANGE_359
            DET_RANGE_360_oRDR_DETECTION_357_360_oPCAN_RADAR_71c207d1_Tx: ComBitPosition=360, ComBitSize=15, ComSignalInitValue=0, ComSignalType=UINT16, ComSystemTemplateSystemSignalRef=DET_RANGE_360
            DET_RANGE_ERR_357_oRDR_DETECTION_357_360_oPCAN_RADAR_d0fba1b1_Tx: ComBitPosition=40, ComBitSize=7, ComSignalInitValue=0, ComSignalType=UINT8, ComSystemTemplateSystemSignalRef=DET_RANGE_ERR_357
            DET_RANGE_ERR_358_oRDR_DETECTION_357_360_oPCAN_RADAR_fceb33f6_Tx: ComBitPosition=152, ComBitSize=7, ComSignalInitValue=0, ComSignalType=UINT8, ComSystemTemplateSystemSignalRef=DET_RANGE_ERR_358
            DET_RANGE_ERR_359_oRDR_DETECTION_357_360_oPCAN_RADAR_699be763_Tx: ComBitPosition=264, ComBitSize=7, ComSignalInitValue=0, ComSignalType=UINT8, ComSystemTemplateSystemSignalRef=DET_RANGE_ERR_359
            DET_RANGE_ERR_360_oRDR_DETECTION_357_360_oPCAN_RADAR_d62abdb8_Tx: ComBitPosition=376, ComBitSize=7, ComSignalInitValue=0, ComSignalType=UINT8, ComSystemTemplateSystemSignalRef=DET_RANGE_ERR_360
            DET_RANGE_VELOCITY_357_oRDR_DETECTION_357_360_oPCAN_RADAR_02b5d9fd_Tx: ComBitPosition=48, ComBitSize=15, ComSignalInitValue=16384, ComSignalType=UINT16, ComSystemTemplateSystemSignalRef=DET_RANGE_VELOCITY_357
            DET_RANGE_VELOCITY_358_oRDR_DETECTION_357_360_oPCAN_RADAR_2ea54bba_Tx: ComBitPosition=160, ComBitSize=15, ComSignalInitValue=16384, ComSignalType=UINT16, ComSystemTemplateSystemSignalRef=DET_RANGE_VELOCITY_358
            DET_RANGE_VELOCITY_359_oRDR_DETECTION_357_360_oPCAN_RADAR_bbd59f2f_Tx: ComBitPosition=272, ComBitSize=15, ComSignalInitValue=16384, ComSignalType=UINT16, ComSystemTemplateSystemSignalRef=DET_RANGE_VELOCITY_359
            DET_RANGE_VELOCITY_360_oRDR_DETECTION_357_360_oPCAN_RADAR_0464c5f4_Tx: ComBitPosition=384, ComBitSize=15, ComSignalInitValue=16384, ComSignalType=UINT16, ComSystemTemplateSystemSignalRef=DET_RANGE_VELOCITY_360
            DET_RANGE_VELOCITY_ERR_357_oRDR_DETECTION_357_360_oPCAN_RADAR_0d0e224f_Tx: ComBitPosition=64, ComBitSize=8, ComSignalInitValue=0, ComSignalType=UINT8, ComSystemTemplateSystemSignalRef=DET_RANGE_VELOCITY_ERR_357
            DET_RANGE_VELOCITY_ERR_358_oRDR_DETECTION_357_360_oPCAN_RADAR_211eb008_Tx: ComBitPosition=176, ComBitSize=8, ComSignalInitValue=0, ComSignalType=UINT8, ComSystemTemplateSystemSignalRef=DET_RANGE_VELOCITY_ERR_358
            DET_RANGE_VELOCITY_ERR_359_oRDR_DETECTION_357_360_oPCAN_RADAR_b46e649d_Tx: ComBitPosition=288, ComBitSize=8, ComSignalInitValue=0, ComSignalType=UINT8, ComSystemTemplateSystemSignalRef=DET_RANGE_VELOCITY_ERR_359
            DET_RANGE_VELOCITY_ERR_360_oRDR_DETECTION_357_360_oPCAN_RADAR_0bdf3e46_Tx: ComBitPosition=400, ComBitSize=8, ComSignalInitValue=0, ComSignalType=UINT8, ComSystemTemplateSystemSignalRef=DET_RANGE_VELOCITY_ERR_360
            DET_RCS_357_oRDR_DETECTION_357_360_oPCAN_RADAR_8535eea7_Tx: ComBitPosition=128, ComBitSize=8, ComSignalInitValue=128, ComSignalType=UINT8, ComSystemTemplateSystemSignalRef=DET_RCS_357
            DET_RCS_358_oRDR_DETECTION_357_360_oPCAN_RADAR_a9257ce0_Tx: ComBitPosition=240, ComBitSize=8, ComSignalInitValue=128, ComSignalType=UINT8, ComSystemTemplateSystemSignalRef=DET_RCS_358
            DET_RCS_359_oRDR_DETECTION_357_360_oPCAN_RADAR_3c55a875_Tx: ComBitPosition=352, ComBitSize=8, ComSignalInitValue=128, ComSignalType=UINT8, ComSystemTemplateSystemSignalRef=DET_RCS_359
            DET_RCS_360_oRDR_DETECTION_357_360_oPCAN_RADAR_83e4f2ae_Tx: ComBitPosition=464, ComBitSize=8, ComSignalInitValue=128, ComSignalType=UINT8, ComSystemTemplateSystemSignalRef=DET_RCS_360
            DET_SNR_357_oRDR_DETECTION_357_360_oPCAN_RADAR_589bbaa5_Tx: ComBitPosition=120, ComBitSize=8, ComSignalInitValue=0, ComSignalType=UINT8, ComSystemTemplateSystemSignalRef=DET_SNR_357
            DET_SNR_358_oRDR_DETECTION_357_360_oPCAN_RADAR_748b28e2_Tx: ComBitPosition=232, ComBitSize=8, ComSignalInitValue=0, ComSignalType=UINT8, ComSystemTemplateSystemSignalRef=DET_SNR_358
            DET_SNR_359_oRDR_DETECTION_357_360_oPCAN_RADAR_e1fbfc77_Tx: ComBitPosition=344, ComBitSize=8, ComSignalInitValue=0, ComSignalType=UINT8, ComSystemTemplateSystemSignalRef=DET_SNR_359
            DET_SNR_360_oRDR_DETECTION_357_360_oPCAN_RADAR_5e4aa6ac_Tx: ComBitPosition=456, ComBitSize=8, ComSignalInitValue=0, ComSignalType=UINT8, ComSystemTemplateSystemSignalRef=DET_SNR_360
            DET_SUPER_RES_TARGET_357_oRDR_DETECTION_357_360_oPCAN_RADAR_690292c0_Tx: ComBitPosition=87, ComBitSize=1, ComSignalInitValue=0, ComSignalType=BOOLEAN, ComSystemTemplateSystemSignalRef=DET_SUPER_RES_TARGET_357
            DET_SUPER_RES_TARGET_358_oRDR_DETECTION_357_360_oPCAN_RADAR_45120087_Tx: ComBitPosition=199, ComBitSize=1, ComSignalInitValue=0, ComSignalType=BOOLEAN, ComSystemTemplateSystemSignalRef=DET_SUPER_RES_TARGET_358
            DET_SUPER_RES_TARGET_359_oRDR_DETECTION_357_360_oPCAN_RADAR_d062d412_Tx: ComBitPosition=311, ComBitSize=1, ComSignalInitValue=0, ComSignalType=BOOLEAN, ComSystemTemplateSystemSignalRef=DET_SUPER_RES_TARGET_359
            DET_SUPER_RES_TARGET_360_oRDR_DETECTION_357_360_oPCAN_RADAR_6fd38ec9_Tx: ComBitPosition=423, ComBitSize=1, ComSignalInitValue=0, ComSignalType=BOOLEAN, ComSystemTemplateSystemSignalRef=DET_SUPER_RES_TARGET_360
        SG_Detections_361_364_oRDR_DETECTION_361_364_oPCAN_RADAR_472e1297_Tx: ComSystemTemplateSignalGroupRef=SG_Detections_361_364
          83 x ComGroupSignal, all with ComSignalEndianness=LITTLE_ENDIAN, ComTransferProperty=PENDING:
            DET_AZIMUTH_361_oRDR_DETECTION_361_364_oPCAN_RADAR_7922a003_Tx: ComBitPosition=88, ComBitSize=13, ComSignalInitValue=0, ComSignalType=UINT16, ComSystemTemplateSystemSignalRef=DET_AZIMUTH_361
            DET_AZIMUTH_362_oRDR_DETECTION_361_364_oPCAN_RADAR_1dc2dbfd_Tx: ComBitPosition=200, ComBitSize=13, ComSignalInitValue=0, ComSignalType=UINT16, ComSystemTemplateSystemSignalRef=DET_AZIMUTH_362
            DET_AZIMUTH_363_oRDR_DETECTION_361_364_oPCAN_RADAR_88b20f68_Tx: ComBitPosition=312, ComBitSize=13, ComSignalInitValue=0, ComSignalType=UINT16, ComSystemTemplateSystemSignalRef=DET_AZIMUTH_363
            DET_AZIMUTH_364_oRDR_DETECTION_361_364_oPCAN_RADAR_d4022c01_Tx: ComBitPosition=424, ComBitSize=13, ComSignalInitValue=0, ComSignalType=UINT16, ComSystemTemplateSystemSignalRef=DET_AZIMUTH_364
            DET_AZIMUTH_ERR_361_oRDR_DETECTION_361_364_oPCAN_RADAR_dd9735f6_Tx: ComBitPosition=105, ComBitSize=7, ComSignalInitValue=0, ComSignalType=UINT8, ComSystemTemplateSystemSignalRef=DET_AZIMUTH_ERR_361
            DET_AZIMUTH_ERR_362_oRDR_DETECTION_361_364_oPCAN_RADAR_b9774e08_Tx: ComBitPosition=217, ComBitSize=7, ComSignalInitValue=0, ComSignalType=UINT8, ComSystemTemplateSystemSignalRef=DET_AZIMUTH_ERR_362
            DET_AZIMUTH_ERR_363_oRDR_DETECTION_361_364_oPCAN_RADAR_2c079a9d_Tx: ComBitPosition=329, ComBitSize=7, ComSignalInitValue=0, ComSignalType=UINT8, ComSystemTemplateSystemSignalRef=DET_AZIMUTH_ERR_363
            DET_AZIMUTH_ERR_364_oRDR_DETECTION_361_364_oPCAN_RADAR_70b7b9f4_Tx: ComBitPosition=441, ComBitSize=7, ComSignalInitValue=0, ComSignalType=UINT8, ComSystemTemplateSystemSignalRef=DET_AZIMUTH_ERR_364
            DET_BELOW_RAIN_THOLD_361_oRDR_DETECTION_361_364_oPCAN_RADAR_ac2333c3_Tx: ComBitPosition=39, ComBitSize=1, ComSignalInitValue=0, ComSignalType=BOOLEAN, ComSystemTemplateSystemSignalRef=DET_BELOW_RAIN_THOLD_361
            DET_BELOW_RAIN_THOLD_362_oRDR_DETECTION_361_364_oPCAN_RADAR_c8c3483d_Tx: ComBitPosition=151, ComBitSize=1, ComSignalInitValue=0, ComSignalType=BOOLEAN, ComSystemTemplateSystemSignalRef=DET_BELOW_RAIN_THOLD_362
            DET_BELOW_RAIN_THOLD_363_oRDR_DETECTION_361_364_oPCAN_RADAR_5db39ca8_Tx: ComBitPosition=263, ComBitSize=1, ComSignalInitValue=0, ComSignalType=BOOLEAN, ComSystemTemplateSystemSignalRef=DET_BELOW_RAIN_THOLD_363
            DET_BELOW_RAIN_THOLD_364_oRDR_DETECTION_361_364_oPCAN_RADAR_0103bfc1_Tx: ComBitPosition=375, ComBitSize=1, ComSignalInitValue=0, ComSignalType=BOOLEAN, ComSystemTemplateSystemSignalRef=DET_BELOW_RAIN_THOLD_364
            DET_BI_STATIC_FLAG_361_oRDR_DETECTION_361_364_oPCAN_RADAR_2f0ee086_Tx: ComBitPosition=104, ComBitSize=1, ComSignalInitValue=0, ComSignalType=BOOLEAN, ComSystemTemplateSystemSignalRef=DET_BI_STATIC_FLAG_361
            DET_BI_STATIC_FLAG_362_oRDR_DETECTION_361_364_oPCAN_RADAR_4bee9b78_Tx: ComBitPosition=216, ComBitSize=1, ComSignalInitValue=0, ComSignalType=BOOLEAN, ComSystemTemplateSystemSignalRef=DET_BI_STATIC_FLAG_362
            DET_BI_STATIC_FLAG_363_oRDR_DETECTION_361_364_oPCAN_RADAR_de9e4fed_Tx: ComBitPosition=328, ComBitSize=1, ComSignalInitValue=0, ComSignalType=BOOLEAN, ComSystemTemplateSystemSignalRef=DET_BI_STATIC_FLAG_363
            DET_BI_STATIC_FLAG_364_oRDR_DETECTION_361_364_oPCAN_RADAR_822e6c84_Tx: ComBitPosition=440, ComBitSize=1, ComSignalInitValue=0, ComSignalType=BOOLEAN, ComSystemTemplateSystemSignalRef=DET_BI_STATIC_FLAG_364
            DET_CONFD_AZIMUTH_361_oRDR_DETECTION_361_364_oPCAN_RADAR_7bc4aac9_Tx: ComBitPosition=118, ComBitSize=2, ComSignalInitValue=0, ComSignalType=UINT8, ComSystemTemplateSystemSignalRef=DET_CONFD_AZIMUTH_361
            DET_CONFD_AZIMUTH_362_oRDR_DETECTION_361_364_oPCAN_RADAR_1f24d137_Tx: ComBitPosition=230, ComBitSize=2, ComSignalInitValue=0, ComSignalType=UINT8, ComSystemTemplateSystemSignalRef=DET_CONFD_AZIMUTH_362
            DET_CONFD_AZIMUTH_363_oRDR_DETECTION_361_364_oPCAN_RADAR_8a5405a2_Tx: ComBitPosition=342, ComBitSize=2, ComSignalInitValue=0, ComSignalType=UINT8, ComSystemTemplateSystemSignalRef=DET_CONFD_AZIMUTH_363
            DET_CONFD_AZIMUTH_364_oRDR_DETECTION_361_364_oPCAN_RADAR_d6e426cb_Tx: ComBitPosition=454, ComBitSize=2, ComSignalInitValue=0, ComSignalType=UINT8, ComSystemTemplateSystemSignalRef=DET_CONFD_AZIMUTH_364
            DET_CONFD_ELEVATION_361_oRDR_DETECTION_361_364_oPCAN_RADAR_7951ab33_Tx: ComBitPosition=101, ComBitSize=2, ComSignalInitValue=0, ComSignalType=UINT8, ComSystemTemplateSystemSignalRef=DET_CONFD_ELEVATION_361
            DET_CONFD_ELEVATION_362_oRDR_DETECTION_361_364_oPCAN_RADAR_1db1d0cd_Tx: ComBitPosition=213, ComBitSize=2, ComSignalInitValue=0, ComSignalType=UINT8, ComSystemTemplateSystemSignalRef=DET_CONFD_ELEVATION_362
            DET_CONFD_ELEVATION_363_oRDR_DETECTION_361_364_oPCAN_RADAR_88c10458_Tx: ComBitPosition=325, ComBitSize=2, ComSignalInitValue=0, ComSignalType=UINT8, ComSystemTemplateSystemSignalRef=DET_CONFD_ELEVATION_363
            DET_CONFD_ELEVATION_364_oRDR_DETECTION_361_364_oPCAN_RADAR_d4712731_Tx: ComBitPosition=437, ComBitSize=2, ComSignalInitValue=0, ComSignalType=UINT8, ComSystemTemplateSystemSignalRef=DET_CONFD_ELEVATION_364
            DET_ELEVATION_361_oRDR_DETECTION_361_364_oPCAN_RADAR_a8917f0f_Tx: ComBitPosition=72, ComBitSize=8, ComSignalInitValue=0, ComSignalType=UINT8, ComSystemTemplateSystemSignalRef=DET_ELEVATION_361
            DET_ELEVATION_362_oRDR_DETECTION_361_364_oPCAN_RADAR_cc7104f1_Tx: ComBitPosition=184, ComBitSize=8, ComSignalInitValue=0, ComSignalType=UINT8, ComSystemTemplateSystemSignalRef=DET_ELEVATION_362
            DET_ELEVATION_363_oRDR_DETECTION_361_364_oPCAN_RADAR_5901d064_Tx: ComBitPosition=296, ComBitSize=8, ComSignalInitValue=0, ComSignalType=UINT8, ComSystemTemplateSystemSignalRef=DET_ELEVATION_363
            DET_ELEVATION_364_oRDR_DETECTION_361_364_oPCAN_RADAR_05b1f30d_Tx: ComBitPosition=408, ComBitSize=8, ComSignalInitValue=0, ComSignalType=UINT8, ComSystemTemplateSystemSignalRef=DET_ELEVATION_364
            DET_ELEVATION_ERR_361_oRDR_DETECTION_361_364_oPCAN_RADAR_2fa8e77a_Tx: ComBitPosition=80, ComBitSize=6, ComSignalInitValue=0, ComSignalType=UINT8, ComSystemTemplateSystemSignalRef=DET_ELEVATION_ERR_361
            DET_ELEVATION_ERR_362_oRDR_DETECTION_361_364_oPCAN_RADAR_4b489c84_Tx: ComBitPosition=192, ComBitSize=6, ComSignalInitValue=0, ComSignalType=UINT8, ComSystemTemplateSystemSignalRef=DET_ELEVATION_ERR_362
            DET_ELEVATION_ERR_363_oRDR_DETECTION_361_364_oPCAN_RADAR_de384811_Tx: ComBitPosition=304, ComBitSize=6, ComSignalInitValue=0, ComSignalType=UINT8, ComSystemTemplateSystemSignalRef=DET_ELEVATION_ERR_363
            DET_ELEVATION_ERR_364_oRDR_DETECTION_361_364_oPCAN_RADAR_82886b78_Tx: ComBitPosition=416, ComBitSize=6, ComSignalInitValue=0, ComSignalType=UINT8, ComSystemTemplateSystemSignalRef=DET_ELEVATION_ERR_364
            DET_EXISTENCE_PROB_361_oRDR_DETECTION_361_364_oPCAN_RADAR_fd37921a_Tx: ComBitPosition=112, ComBitSize=6, ComSignalInitValue=0, ComSignalType=UINT8, ComSystemTemplateSystemSignalRef=DET_EXISTENCE_PROB_361
            DET_EXISTENCE_PROB_362_oRDR_DETECTION_361_364_oPCAN_RADAR_99d7e9e4_Tx: ComBitPosition=224, ComBitSize=6, ComSignalInitValue=0, ComSignalType=UINT8, ComSystemTemplateSystemSignalRef=DET_EXISTENCE_PROB_362
            DET_EXISTENCE_PROB_363_oRDR_DETECTION_361_364_oPCAN_RADAR_0ca73d71_Tx: ComBitPosition=336, ComBitSize=6, ComSignalInitValue=0, ComSignalType=UINT8, ComSystemTemplateSystemSignalRef=DET_EXISTENCE_PROB_363
            DET_EXISTENCE_PROB_364_oRDR_DETECTION_361_364_oPCAN_RADAR_50171e18_Tx: ComBitPosition=448, ComBitSize=6, ComSignalInitValue=0, ComSignalType=UINT8, ComSystemTemplateSystemSignalRef=DET_EXISTENCE_PROB_364
            DET_HVC_FLAG_361_oRDR_DETECTION_361_364_oPCAN_RADAR_1c43d165_Tx: ComBitPosition=86, ComBitSize=1, ComSignalInitValue=0, ComSignalType=BOOLEAN, ComSystemTemplateSystemSignalRef=DET_HVC_FLAG_361
            DET_HVC_FLAG_362_oRDR_DETECTION_361_364_oPCAN_RADAR_78a3aa9b_Tx: ComBitPosition=198, ComBitSize=1, ComSignalInitValue=0, ComSignalType=BOOLEAN, ComSystemTemplateSystemSignalRef=DET_HVC_FLAG_362
            DET_HVC_FLAG_363_oRDR_DETECTION_361_364_oPCAN_RADAR_edd37e0e_Tx: ComBitPosition=310, ComBitSize=1, ComSignalInitValue=0, ComSignalType=BOOLEAN, ComSystemTemplateSystemSignalRef=DET_HVC_FLAG_363
            DET_HVC_FLAG_364_oRDR_DETECTION_361_364_oPCAN_RADAR_b1635d67_Tx: ComBitPosition=422, ComBitSize=1, ComSignalInitValue=0, ComSignalType=BOOLEAN, ComSystemTemplateSystemSignalRef=DET_HVC_FLAG_364
            DET_IDM_361_oRDR_DETECTION_361_364_oPCAN_RADAR_9711ead8_Tx: ComBitPosition=63, ComBitSize=1, ComSignalInitValue=0, ComSignalType=BOOLEAN, ComSystemTemplateSystemSignalRef=DET_IDM_361
            DET_IDM_362_oRDR_DETECTION_361_364_oPCAN_RADAR_f3f19126_Tx: ComBitPosition=175, ComBitSize=1, ComSignalInitValue=0, ComSignalType=BOOLEAN, ComSystemTemplateSystemSignalRef=DET_IDM_362
            DET_IDM_363_oRDR_DETECTION_361_364_oPCAN_RADAR_668145b3_Tx: ComBitPosition=287, ComBitSize=1, ComSignalInitValue=0, ComSignalType=BOOLEAN, ComSystemTemplateSystemSignalRef=DET_IDM_363
            DET_IDM_364_oRDR_DETECTION_361_364_oPCAN_RADAR_3a3166da_Tx: ComBitPosition=399, ComBitSize=1, ComSignalInitValue=0, ComSignalType=BOOLEAN, ComSystemTemplateSystemSignalRef=DET_IDM_364
            DET_MH_CRC16_361_364_oRDR_DETECTION_361_364_oPCAN_RADAR_c3a6c09c_Tx: ComBitPosition=0, ComBitSize=16, ComSignalInitValue=0, ComSignalType=UINT16, ComSystemTemplateSystemSignalRef=DET_MH_CRC16_361_364
            DET_MH_CYCLE_COUNTER_361_364_oRDR_DETECTION_361_364_oPCAN_RADAR_47d361ab_Tx: ComBitPosition=16, ComBitSize=8, ComSignalInitValue=0, ComSignalType=UINT8, ComSystemTemplateSystemSignalRef=DET_MH_CYCLE_COUNTER_361_364
            DET_MH_SCAN_INDEX_4LSB_361_364_oRDR_DETECTION_361_364_oPCAN_RADAR_8bf94427_Tx: ComBitPosition=476, ComBitSize=4, ComSignalInitValue=0, ComSignalType=UINT8, ComSystemTemplateSystemSignalRef=DET_MH_SCAN_INDEX_4LSB_361_364
            DET_MTD_361_oRDR_DETECTION_361_364_oPCAN_RADAR_f1a2d803_Tx: ComBitPosition=47, ComBitSize=1, ComSignalInitValue=0, ComSignalType=BOOLEAN, ComSystemTemplateSystemSignalRef=DET_MTD_361
            DET_MTD_362_oRDR_DETECTION_361_364_oPCAN_RADAR_9542a3fd_Tx: ComBitPosition=159, ComBitSize=1, ComSignalInitValue=0, ComSignalType=BOOLEAN, ComSystemTemplateSystemSignalRef=DET_MTD_362
            DET_MTD_363_oRDR_DETECTION_361_364_oPCAN_RADAR_00327768_Tx: ComBitPosition=271, ComBitSize=1, ComSignalInitValue=0, ComSignalType=BOOLEAN, ComSystemTemplateSystemSignalRef=DET_MTD_363
            DET_MTD_364_oRDR_DETECTION_361_364_oPCAN_RADAR_5c825401_Tx: ComBitPosition=383, ComBitSize=1, ComSignalInitValue=0, ComSignalType=BOOLEAN, ComSystemTemplateSystemSignalRef=DET_MTD_364
            DET_PROB_1STAZHYPO_361_oRDR_DETECTION_361_364_oPCAN_RADAR_621630ce_Tx: ComBitPosition=103, ComBitSize=1, ComSignalInitValue=0, ComSignalType=BOOLEAN, ComSystemTemplateSystemSignalRef=DET_PROB_1STAZHYPO_361
            DET_PROB_1STAZHYPO_362_oRDR_DETECTION_361_364_oPCAN_RADAR_06f64b30_Tx: ComBitPosition=215, ComBitSize=1, ComSignalInitValue=0, ComSignalType=BOOLEAN, ComSystemTemplateSystemSignalRef=DET_PROB_1STAZHYPO_362
            DET_PROB_1STAZHYPO_363_oRDR_DETECTION_361_364_oPCAN_RADAR_93869fa5_Tx: ComBitPosition=327, ComBitSize=1, ComSignalInitValue=0, ComSignalType=BOOLEAN, ComSystemTemplateSystemSignalRef=DET_PROB_1STAZHYPO_363
            DET_PROB_1STAZHYPO_364_oRDR_DETECTION_361_364_oPCAN_RADAR_cf36bccc_Tx: ComBitPosition=439, ComBitSize=1, ComSignalInitValue=0, ComSignalType=BOOLEAN, ComSystemTemplateSystemSignalRef=DET_PROB_1STAZHYPO_364
            DET_RANGE_361_oRDR_DETECTION_361_364_oPCAN_RADAR_69b9d3b8_Tx: ComBitPosition=24, ComBitSize=15, ComSignalInitValue=0, ComSignalType=UINT16, ComSystemTemplateSystemSignalRef=DET_RANGE_361
            DET_RANGE_362_oRDR_DETECTION_361_364_oPCAN_RADAR_0d59a846_Tx: ComBitPosition=136, ComBitSize=15, ComSignalInitValue=0, ComSignalType=UINT16, ComSystemTemplateSystemSignalRef=DET_RANGE_362
            DET_RANGE_363_oRDR_DETECTION_361_364_oPCAN_RADAR_98297cd3_Tx: ComBitPosition=248, ComBitSize=15, ComSignalInitValue=0, ComSignalType=UINT16, ComSystemTemplateSystemSignalRef=DET_RANGE_363
            DET_RANGE_364_oRDR_DETECTION_361_364_oPCAN_RADAR_c4995fba_Tx: ComBitPosition=360, ComBitSize=15, ComSignalInitValue=0, ComSignalType=UINT16, ComSystemTemplateSystemSignalRef=DET_RANGE_364
            DET_RANGE_ERR_361_oRDR_DETECTION_361_364_oPCAN_RADAR_ce5169d1_Tx: ComBitPosition=40, ComBitSize=7, ComSignalInitValue=0, ComSignalType=UINT8, ComSystemTemplateSystemSignalRef=DET_RANGE_ERR_361
            DET_RANGE_ERR_362_oRDR_DETECTION_361_364_oPCAN_RADAR_aab1122f_Tx: ComBitPosition=152, ComBitSize=7, ComSignalInitValue=0, ComSignalType=UINT8, ComSystemTemplateSystemSignalRef=DET_RANGE_ERR_362
            DET_RANGE_ERR_363_oRDR_DETECTION_361_364_oPCAN_RADAR_3fc1c6ba_Tx: ComBitPosition=264, ComBitSize=7, ComSignalInitValue=0, ComSignalType=UINT8, ComSystemTemplateSystemSignalRef=DET_RANGE_ERR_363
            DET_RANGE_ERR_364_oRDR_DETECTION_361_364_oPCAN_RADAR_6371e5d3_Tx: ComBitPosition=376, ComBitSize=7, ComSignalInitValue=0, ComSignalType=UINT8, ComSystemTemplateSystemSignalRef=DET_RANGE_ERR_364
            DET_RANGE_VELOCITY_361_oRDR_DETECTION_361_364_oPCAN_RADAR_1c1f119d_Tx: ComBitPosition=48, ComBitSize=15, ComSignalInitValue=16384, ComSignalType=UINT16, ComSystemTemplateSystemSignalRef=DET_RANGE_VELOCITY_361
            DET_RANGE_VELOCITY_362_oRDR_DETECTION_361_364_oPCAN_RADAR_78ff6a63_Tx: ComBitPosition=160, ComBitSize=15, ComSignalInitValue=16384, ComSignalType=UINT16, ComSystemTemplateSystemSignalRef=DET_RANGE_VELOCITY_362
            DET_RANGE_VELOCITY_363_oRDR_DETECTION_361_364_oPCAN_RADAR_ed8fbef6_Tx: ComBitPosition=272, ComBitSize=15, ComSignalInitValue=16384, ComSignalType=UINT16, ComSystemTemplateSystemSignalRef=DET_RANGE_VELOCITY_363
            DET_RANGE_VELOCITY_364_oRDR_DETECTION_361_364_oPCAN_RADAR_b13f9d9f_Tx: ComBitPosition=384, ComBitSize=15, ComSignalInitValue=16384, ComSignalType=UINT16, ComSystemTemplateSystemSignalRef=DET_RANGE_VELOCITY_364
            DET_RANGE_VELOCITY_ERR_361_oRDR_DETECTION_361_364_oPCAN_RADAR_13a4ea2f_Tx: ComBitPosition=64, ComBitSize=8, ComSignalInitValue=0, ComSignalType=UINT8, ComSystemTemplateSystemSignalRef=DET_RANGE_VELOCITY_ERR_361
            DET_RANGE_VELOCITY_ERR_362_oRDR_DETECTION_361_364_oPCAN_RADAR_774491d1_Tx: ComBitPosition=176, ComBitSize=8, ComSignalInitValue=0, ComSignalType=UINT8, ComSystemTemplateSystemSignalRef=DET_RANGE_VELOCITY_ERR_362
            DET_RANGE_VELOCITY_ERR_363_oRDR_DETECTION_361_364_oPCAN_RADAR_e2344544_Tx: ComBitPosition=288, ComBitSize=8, ComSignalInitValue=0, ComSignalType=UINT8, ComSystemTemplateSystemSignalRef=DET_RANGE_VELOCITY_ERR_363
            DET_RANGE_VELOCITY_ERR_364_oRDR_DETECTION_361_364_oPCAN_RADAR_be84662d_Tx: ComBitPosition=400, ComBitSize=8, ComSignalInitValue=0, ComSignalType=UINT8, ComSystemTemplateSystemSignalRef=DET_RANGE_VELOCITY_ERR_364
            DET_RCS_361_oRDR_DETECTION_361_364_oPCAN_RADAR_9b9f26c7_Tx: ComBitPosition=128, ComBitSize=8, ComSignalInitValue=128, ComSignalType=UINT8, ComSystemTemplateSystemSignalRef=DET_RCS_361
            DET_RCS_362_oRDR_DETECTION_361_364_oPCAN_RADAR_ff7f5d39_Tx: ComBitPosition=240, ComBitSize=8, ComSignalInitValue=128, ComSignalType=UINT8, ComSystemTemplateSystemSignalRef=DET_RCS_362
            DET_RCS_363_oRDR_DETECTION_361_364_oPCAN_RADAR_6a0f89ac_Tx: ComBitPosition=352, ComBitSize=8, ComSignalInitValue=128, ComSignalType=UINT8, ComSystemTemplateSystemSignalRef=DET_RCS_363
            DET_RCS_364_oRDR_DETECTION_361_364_oPCAN_RADAR_36bfaac5_Tx: ComBitPosition=464, ComBitSize=8, ComSignalInitValue=128, ComSignalType=UINT8, ComSystemTemplateSystemSignalRef=DET_RCS_364
            DET_SNR_361_oRDR_DETECTION_361_364_oPCAN_RADAR_463172c5_Tx: ComBitPosition=120, ComBitSize=8, ComSignalInitValue=0, ComSignalType=UINT8, ComSystemTemplateSystemSignalRef=DET_SNR_361
            DET_SNR_362_oRDR_DETECTION_361_364_oPCAN_RADAR_22d1093b_Tx: ComBitPosition=232, ComBitSize=8, ComSignalInitValue=0, ComSignalType=UINT8, ComSystemTemplateSystemSignalRef=DET_SNR_362
            DET_SNR_363_oRDR_DETECTION_361_364_oPCAN_RADAR_b7a1ddae_Tx: ComBitPosition=344, ComBitSize=8, ComSignalInitValue=0, ComSignalType=UINT8, ComSystemTemplateSystemSignalRef=DET_SNR_363
            DET_SNR_364_oRDR_DETECTION_361_364_oPCAN_RADAR_eb11fec7_Tx: ComBitPosition=456, ComBitSize=8, ComSignalInitValue=0, ComSignalType=UINT8, ComSystemTemplateSystemSignalRef=DET_SNR_364
            DET_SUPER_RES_TARGET_361_oRDR_DETECTION_361_364_oPCAN_RADAR_77a85aa0_Tx: ComBitPosition=87, ComBitSize=1, ComSignalInitValue=0, ComSignalType=BOOLEAN, ComSystemTemplateSystemSignalRef=DET_SUPER_RES_TARGET_361
            DET_SUPER_RES_TARGET_362_oRDR_DETECTION_361_364_oPCAN_RADAR_1348215e_Tx: ComBitPosition=199, ComBitSize=1, ComSignalInitValue=0, ComSignalType=BOOLEAN, ComSystemTemplateSystemSignalRef=DET_SUPER_RES_TARGET_362
            DET_SUPER_RES_TARGET_363_oRDR_DETECTION_361_364_oPCAN_RADAR_8638f5cb_Tx: ComBitPosition=311, ComBitSize=1, ComSignalInitValue=0, ComSignalType=BOOLEAN, ComSystemTemplateSystemSignalRef=DET_SUPER_RES_TARGET_363
            DET_SUPER_RES_TARGET_364_oRDR_DETECTION_361_364_oPCAN_RADAR_da88d6a2_Tx: ComBitPosition=423, ComBitSize=1, ComSignalInitValue=0, ComSignalType=BOOLEAN, ComSystemTemplateSystemSignalRef=DET_SUPER_RES_TARGET_364
        SG_Detections_365_368_oRDR_DETECTION_365_368_oPCAN_RADAR_36ed26c5_Tx: ComSystemTemplateSignalGroupRef=SG_Detections_365_368
          83 x ComGroupSignal, all with ComSignalEndianness=LITTLE_ENDIAN, ComTransferProperty=PENDING:
            DET_AZIMUTH_365_oRDR_DETECTION_365_368_oPCAN_RADAR_a8c066a0_Tx: ComBitPosition=88, ComBitSize=13, ComSignalInitValue=0, ComSignalType=UINT16, ComSystemTemplateSystemSignalRef=DET_AZIMUTH_365
            DET_AZIMUTH_366_oRDR_DETECTION_365_368_oPCAN_RADAR_cc201d5e_Tx: ComBitPosition=200, ComBitSize=13, ComSignalInitValue=0, ComSignalType=UINT16, ComSystemTemplateSystemSignalRef=DET_AZIMUTH_366
            DET_AZIMUTH_367_oRDR_DETECTION_365_368_oPCAN_RADAR_5950c9cb_Tx: ComBitPosition=312, ComBitSize=13, ComSignalInitValue=0, ComSignalType=UINT16, ComSystemTemplateSystemSignalRef=DET_AZIMUTH_367
            DET_AZIMUTH_368_oRDR_DETECTION_365_368_oPCAN_RADAR_75405b8c_Tx: ComBitPosition=424, ComBitSize=13, ComSignalInitValue=0, ComSignalType=UINT16, ComSystemTemplateSystemSignalRef=DET_AZIMUTH_368
            DET_AZIMUTH_ERR_365_oRDR_DETECTION_365_368_oPCAN_RADAR_0c75f355_Tx: ComBitPosition=105, ComBitSize=7, ComSignalInitValue=0, ComSignalType=UINT8, ComSystemTemplateSystemSignalRef=DET_AZIMUTH_ERR_365
            DET_AZIMUTH_ERR_366_oRDR_DETECTION_365_368_oPCAN_RADAR_689588ab_Tx: ComBitPosition=217, ComBitSize=7, ComSignalInitValue=0, ComSignalType=UINT8, ComSystemTemplateSystemSignalRef=DET_AZIMUTH_ERR_366
            DET_AZIMUTH_ERR_367_oRDR_DETECTION_365_368_oPCAN_RADAR_fde55c3e_Tx: ComBitPosition=329, ComBitSize=7, ComSignalInitValue=0, ComSignalType=UINT8, ComSystemTemplateSystemSignalRef=DET_AZIMUTH_ERR_367
            DET_AZIMUTH_ERR_368_oRDR_DETECTION_365_368_oPCAN_RADAR_d1f5ce79_Tx: ComBitPosition=441, ComBitSize=7, ComSignalInitValue=0, ComSignalType=UINT8, ComSystemTemplateSystemSignalRef=DET_AZIMUTH_ERR_368
            DET_BELOW_RAIN_THOLD_365_oRDR_DETECTION_365_368_oPCAN_RADAR_7dc1f560_Tx: ComBitPosition=39, ComBitSize=1, ComSignalInitValue=0, ComSignalType=BOOLEAN, ComSystemTemplateSystemSignalRef=DET_BELOW_RAIN_THOLD_365
            DET_BELOW_RAIN_THOLD_366_oRDR_DETECTION_365_368_oPCAN_RADAR_19218e9e_Tx: ComBitPosition=151, ComBitSize=1, ComSignalInitValue=0, ComSignalType=BOOLEAN, ComSystemTemplateSystemSignalRef=DET_BELOW_RAIN_THOLD_366
            DET_BELOW_RAIN_THOLD_367_oRDR_DETECTION_365_368_oPCAN_RADAR_8c515a0b_Tx: ComBitPosition=263, ComBitSize=1, ComSignalInitValue=0, ComSignalType=BOOLEAN, ComSystemTemplateSystemSignalRef=DET_BELOW_RAIN_THOLD_367
            DET_BELOW_RAIN_THOLD_368_oRDR_DETECTION_365_368_oPCAN_RADAR_a041c84c_Tx: ComBitPosition=375, ComBitSize=1, ComSignalInitValue=0, ComSignalType=BOOLEAN, ComSystemTemplateSystemSignalRef=DET_BELOW_RAIN_THOLD_368
            DET_BI_STATIC_FLAG_365_oRDR_DETECTION_365_368_oPCAN_RADAR_feec2625_Tx: ComBitPosition=104, ComBitSize=1, ComSignalInitValue=0, ComSignalType=BOOLEAN, ComSystemTemplateSystemSignalRef=DET_BI_STATIC_FLAG_365
            DET_BI_STATIC_FLAG_366_oRDR_DETECTION_365_368_oPCAN_RADAR_9a0c5ddb_Tx: ComBitPosition=216, ComBitSize=1, ComSignalInitValue=0, ComSignalType=BOOLEAN, ComSystemTemplateSystemSignalRef=DET_BI_STATIC_FLAG_366
            DET_BI_STATIC_FLAG_367_oRDR_DETECTION_365_368_oPCAN_RADAR_0f7c894e_Tx: ComBitPosition=328, ComBitSize=1, ComSignalInitValue=0, ComSignalType=BOOLEAN, ComSystemTemplateSystemSignalRef=DET_BI_STATIC_FLAG_367
            DET_BI_STATIC_FLAG_368_oRDR_DETECTION_365_368_oPCAN_RADAR_236c1b09_Tx: ComBitPosition=440, ComBitSize=1, ComSignalInitValue=0, ComSignalType=BOOLEAN, ComSystemTemplateSystemSignalRef=DET_BI_STATIC_FLAG_368
            DET_CONFD_AZIMUTH_365_oRDR_DETECTION_365_368_oPCAN_RADAR_aa266c6a_Tx: ComBitPosition=118, ComBitSize=2, ComSignalInitValue=0, ComSignalType=UINT8, ComSystemTemplateSystemSignalRef=DET_CONFD_AZIMUTH_365
            DET_CONFD_AZIMUTH_366_oRDR_DETECTION_365_368_oPCAN_RADAR_cec61794_Tx: ComBitPosition=230, ComBitSize=2, ComSignalInitValue=0, ComSignalType=UINT8, ComSystemTemplateSystemSignalRef=DET_CONFD_AZIMUTH_366
            DET_CONFD_AZIMUTH_367_oRDR_DETECTION_365_368_oPCAN_RADAR_5bb6c301_Tx: ComBitPosition=342, ComBitSize=2, ComSignalInitValue=0, ComSignalType=UINT8, ComSystemTemplateSystemSignalRef=DET_CONFD_AZIMUTH_367
            DET_CONFD_AZIMUTH_368_oRDR_DETECTION_365_368_oPCAN_RADAR_77a65146_Tx: ComBitPosition=454, ComBitSize=2, ComSignalInitValue=0, ComSignalType=UINT8, ComSystemTemplateSystemSignalRef=DET_CONFD_AZIMUTH_368
            DET_CONFD_ELEVATION_365_oRDR_DETECTION_365_368_oPCAN_RADAR_a8b36d90_Tx: ComBitPosition=101, ComBitSize=2, ComSignalInitValue=0, ComSignalType=UINT8, ComSystemTemplateSystemSignalRef=DET_CONFD_ELEVATION_365
            DET_CONFD_ELEVATION_366_oRDR_DETECTION_365_368_oPCAN_RADAR_cc53166e_Tx: ComBitPosition=213, ComBitSize=2, ComSignalInitValue=0, ComSignalType=UINT8, ComSystemTemplateSystemSignalRef=DET_CONFD_ELEVATION_366
            DET_CONFD_ELEVATION_367_oRDR_DETECTION_365_368_oPCAN_RADAR_5923c2fb_Tx: ComBitPosition=325, ComBitSize=2, ComSignalInitValue=0, ComSignalType=UINT8, ComSystemTemplateSystemSignalRef=DET_CONFD_ELEVATION_367
            DET_CONFD_ELEVATION_368_oRDR_DETECTION_365_368_oPCAN_RADAR_753350bc_Tx: ComBitPosition=437, ComBitSize=2, ComSignalInitValue=0, ComSignalType=UINT8, ComSystemTemplateSystemSignalRef=DET_CONFD_ELEVATION_368
            DET_ELEVATION_365_oRDR_DETECTION_365_368_oPCAN_RADAR_7973b9ac_Tx: ComBitPosition=72, ComBitSize=8, ComSignalInitValue=0, ComSignalType=UINT8, ComSystemTemplateSystemSignalRef=DET_ELEVATION_365
            DET_ELEVATION_366_oRDR_DETECTION_365_368_oPCAN_RADAR_1d93c252_Tx: ComBitPosition=184, ComBitSize=8, ComSignalInitValue=0, ComSignalType=UINT8, ComSystemTemplateSystemSignalRef=DET_ELEVATION_366
            DET_ELEVATION_367_oRDR_DETECTION_365_368_oPCAN_RADAR_88e316c7_Tx: ComBitPosition=296, ComBitSize=8, ComSignalInitValue=0, ComSignalType=UINT8, ComSystemTemplateSystemSignalRef=DET_ELEVATION_367
            DET_ELEVATION_368_oRDR_DETECTION_365_368_oPCAN_RADAR_a4f38480_Tx: ComBitPosition=408, ComBitSize=8, ComSignalInitValue=0, ComSignalType=UINT8, ComSystemTemplateSystemSignalRef=DET_ELEVATION_368
            DET_ELEVATION_ERR_365_oRDR_DETECTION_365_368_oPCAN_RADAR_fe4a21d9_Tx: ComBitPosition=80, ComBitSize=6, ComSignalInitValue=0, ComSignalType=UINT8, ComSystemTemplateSystemSignalRef=DET_ELEVATION_ERR_365
            DET_ELEVATION_ERR_366_oRDR_DETECTION_365_368_oPCAN_RADAR_9aaa5a27_Tx: ComBitPosition=192, ComBitSize=6, ComSignalInitValue=0, ComSignalType=UINT8, ComSystemTemplateSystemSignalRef=DET_ELEVATION_ERR_366
            DET_ELEVATION_ERR_367_oRDR_DETECTION_365_368_oPCAN_RADAR_0fda8eb2_Tx: ComBitPosition=304, ComBitSize=6, ComSignalInitValue=0, ComSignalType=UINT8, ComSystemTemplateSystemSignalRef=DET_ELEVATION_ERR_367
            DET_ELEVATION_ERR_368_oRDR_DETECTION_365_368_oPCAN_RADAR_23ca1cf5_Tx: ComBitPosition=416, ComBitSize=6, ComSignalInitValue=0, ComSignalType=UINT8, ComSystemTemplateSystemSignalRef=DET_ELEVATION_ERR_368
            DET_EXISTENCE_PROB_365_oRDR_DETECTION_365_368_oPCAN_RADAR_2cd554b9_Tx: ComBitPosition=112, ComBitSize=6, ComSignalInitValue=0, ComSignalType=UINT8, ComSystemTemplateSystemSignalRef=DET_EXISTENCE_PROB_365
            DET_EXISTENCE_PROB_366_oRDR_DETECTION_365_368_oPCAN_RADAR_48352f47_Tx: ComBitPosition=224, ComBitSize=6, ComSignalInitValue=0, ComSignalType=UINT8, ComSystemTemplateSystemSignalRef=DET_EXISTENCE_PROB_366
            DET_EXISTENCE_PROB_367_oRDR_DETECTION_365_368_oPCAN_RADAR_dd45fbd2_Tx: ComBitPosition=336, ComBitSize=6, ComSignalInitValue=0, ComSignalType=UINT8, ComSystemTemplateSystemSignalRef=DET_EXISTENCE_PROB_367
            DET_EXISTENCE_PROB_368_oRDR_DETECTION_365_368_oPCAN_RADAR_f1556995_Tx: ComBitPosition=448, ComBitSize=6, ComSignalInitValue=0, ComSignalType=UINT8, ComSystemTemplateSystemSignalRef=DET_EXISTENCE_PROB_368
            DET_HVC_FLAG_365_oRDR_DETECTION_365_368_oPCAN_RADAR_cda117c6_Tx: ComBitPosition=86, ComBitSize=1, ComSignalInitValue=0, ComSignalType=BOOLEAN, ComSystemTemplateSystemSignalRef=DET_HVC_FLAG_365
            DET_HVC_FLAG_366_oRDR_DETECTION_365_368_oPCAN_RADAR_a9416c38_Tx: ComBitPosition=198, ComBitSize=1, ComSignalInitValue=0, ComSignalType=BOOLEAN, ComSystemTemplateSystemSignalRef=DET_HVC_FLAG_366
            DET_HVC_FLAG_367_oRDR_DETECTION_365_368_oPCAN_RADAR_3c31b8ad_Tx: ComBitPosition=310, ComBitSize=1, ComSignalInitValue=0, ComSignalType=BOOLEAN, ComSystemTemplateSystemSignalRef=DET_HVC_FLAG_367
            DET_HVC_FLAG_368_oRDR_DETECTION_365_368_oPCAN_RADAR_10212aea_Tx: ComBitPosition=422, ComBitSize=1, ComSignalInitValue=0, ComSignalType=BOOLEAN, ComSystemTemplateSystemSignalRef=DET_HVC_FLAG_368
            DET_IDM_365_oRDR_DETECTION_365_368_oPCAN_RADAR_46f32c7b_Tx: ComBitPosition=63, ComBitSize=1, ComSignalInitValue=0, ComSignalType=BOOLEAN, ComSystemTemplateSystemSignalRef=DET_IDM_365
            DET_IDM_366_oRDR_DETECTION_365_368_oPCAN_RADAR_22135785_Tx: ComBitPosition=175, ComBitSize=1, ComSignalInitValue=0, ComSignalType=BOOLEAN, ComSystemTemplateSystemSignalRef=DET_IDM_366
            DET_IDM_367_oRDR_DETECTION_365_368_oPCAN_RADAR_b7638310_Tx: ComBitPosition=287, ComBitSize=1, ComSignalInitValue=0, ComSignalType=BOOLEAN, ComSystemTemplateSystemSignalRef=DET_IDM_367
            DET_IDM_368_oRDR_DETECTION_365_368_oPCAN_RADAR_9b731157_Tx: ComBitPosition=399, ComBitSize=1, ComSignalInitValue=0, ComSignalType=BOOLEAN, ComSystemTemplateSystemSignalRef=DET_IDM_368
            DET_MH_CRC16_365_368_oRDR_DETECTION_365_368_oPCAN_RADAR_b265f4ce_Tx: ComBitPosition=0, ComBitSize=16, ComSignalInitValue=0, ComSignalType=UINT16, ComSystemTemplateSystemSignalRef=DET_MH_CRC16_365_368
            DET_MH_CYCLE_COUNTER_365_368_oRDR_DETECTION_365_368_oPCAN_RADAR_361055f9_Tx: ComBitPosition=16, ComBitSize=8, ComSignalInitValue=0, ComSignalType=UINT8, ComSystemTemplateSystemSignalRef=DET_MH_CYCLE_COUNTER_365_368
            DET_MH_SCAN_INDEX_4LSB_365_368_oRDR_DETECTION_365_368_oPCAN_RADAR_fa3a7075_Tx: ComBitPosition=476, ComBitSize=4, ComSignalInitValue=0, ComSignalType=UINT8, ComSystemTemplateSystemSignalRef=DET_MH_SCAN_INDEX_4LSB_365_368
            DET_MTD_365_oRDR_DETECTION_365_368_oPCAN_RADAR_20401ea0_Tx: ComBitPosition=47, ComBitSize=1, ComSignalInitValue=0, ComSignalType=BOOLEAN, ComSystemTemplateSystemSignalRef=DET_MTD_365
            DET_MTD_366_oRDR_DETECTION_365_368_oPCAN_RADAR_44a0655e_Tx: ComBitPosition=159, ComBitSize=1, ComSignalInitValue=0, ComSignalType=BOOLEAN, ComSystemTemplateSystemSignalRef=DET_MTD_366
            DET_MTD_367_oRDR_DETECTION_365_368_oPCAN_RADAR_d1d0b1cb_Tx: ComBitPosition=271, ComBitSize=1, ComSignalInitValue=0, ComSignalType=BOOLEAN, ComSystemTemplateSystemSignalRef=DET_MTD_367
            DET_MTD_368_oRDR_DETECTION_365_368_oPCAN_RADAR_fdc0238c_Tx: ComBitPosition=383, ComBitSize=1, ComSignalInitValue=0, ComSignalType=BOOLEAN, ComSystemTemplateSystemSignalRef=DET_MTD_368
            DET_PROB_1STAZHYPO_365_oRDR_DETECTION_365_368_oPCAN_RADAR_b3f4f66d_Tx: ComBitPosition=103, ComBitSize=1, ComSignalInitValue=0, ComSignalType=BOOLEAN, ComSystemTemplateSystemSignalRef=DET_PROB_1STAZHYPO_365
            DET_PROB_1STAZHYPO_366_oRDR_DETECTION_365_368_oPCAN_RADAR_d7148d93_Tx: ComBitPosition=215, ComBitSize=1, ComSignalInitValue=0, ComSignalType=BOOLEAN, ComSystemTemplateSystemSignalRef=DET_PROB_1STAZHYPO_366
            DET_PROB_1STAZHYPO_367_oRDR_DETECTION_365_368_oPCAN_RADAR_42645906_Tx: ComBitPosition=327, ComBitSize=1, ComSignalInitValue=0, ComSignalType=BOOLEAN, ComSystemTemplateSystemSignalRef=DET_PROB_1STAZHYPO_367
            DET_PROB_1STAZHYPO_368_oRDR_DETECTION_365_368_oPCAN_RADAR_6e74cb41_Tx: ComBitPosition=439, ComBitSize=1, ComSignalInitValue=0, ComSignalType=BOOLEAN, ComSystemTemplateSystemSignalRef=DET_PROB_1STAZHYPO_368
            DET_RANGE_365_oRDR_DETECTION_365_368_oPCAN_RADAR_b85b151b_Tx: ComBitPosition=24, ComBitSize=15, ComSignalInitValue=0, ComSignalType=UINT16, ComSystemTemplateSystemSignalRef=DET_RANGE_365
            DET_RANGE_366_oRDR_DETECTION_365_368_oPCAN_RADAR_dcbb6ee5_Tx: ComBitPosition=136, ComBitSize=15, ComSignalInitValue=0, ComSignalType=UINT16, ComSystemTemplateSystemSignalRef=DET_RANGE_366
            DET_RANGE_367_oRDR_DETECTION_365_368_oPCAN_RADAR_49cbba70_Tx: ComBitPosition=248, ComBitSize=15, ComSignalInitValue=0, ComSignalType=UINT16, ComSystemTemplateSystemSignalRef=DET_RANGE_367
            DET_RANGE_368_oRDR_DETECTION_365_368_oPCAN_RADAR_65db2837_Tx: ComBitPosition=360, ComBitSize=15, ComSignalInitValue=0, ComSignalType=UINT16, ComSystemTemplateSystemSignalRef=DET_RANGE_368
            DET_RANGE_ERR_365_oRDR_DETECTION_365_368_oPCAN_RADAR_1fb3af72_Tx: ComBitPosition=40, ComBitSize=7, ComSignalInitValue=0, ComSignalType=UINT8, ComSystemTemplateSystemSignalRef=DET_RANGE_ERR_365
            DET_RANGE_ERR_366_oRDR_DETECTION_365_368_oPCAN_RADAR_7b53d48c_Tx: ComBitPosition=152, ComBitSize=7, ComSignalInitValue=0, ComSignalType=UINT8, ComSystemTemplateSystemSignalRef=DET_RANGE_ERR_366
            DET_RANGE_ERR_367_oRDR_DETECTION_365_368_oPCAN_RADAR_ee230019_Tx: ComBitPosition=264, ComBitSize=7, ComSignalInitValue=0, ComSignalType=UINT8, ComSystemTemplateSystemSignalRef=DET_RANGE_ERR_367
            DET_RANGE_ERR_368_oRDR_DETECTION_365_368_oPCAN_RADAR_c233925e_Tx: ComBitPosition=376, ComBitSize=7, ComSignalInitValue=0, ComSignalType=UINT8, ComSystemTemplateSystemSignalRef=DET_RANGE_ERR_368
            DET_RANGE_VELOCITY_365_oRDR_DETECTION_365_368_oPCAN_RADAR_cdfdd73e_Tx: ComBitPosition=48, ComBitSize=15, ComSignalInitValue=16384, ComSignalType=UINT16, ComSystemTemplateSystemSignalRef=DET_RANGE_VELOCITY_365
            DET_RANGE_VELOCITY_366_oRDR_DETECTION_365_368_oPCAN_RADAR_a91dacc0_Tx: ComBitPosition=160, ComBitSize=15, ComSignalInitValue=16384, ComSignalType=UINT16, ComSystemTemplateSystemSignalRef=DET_RANGE_VELOCITY_366
            DET_RANGE_VELOCITY_367_oRDR_DETECTION_365_368_oPCAN_RADAR_3c6d7855_Tx: ComBitPosition=272, ComBitSize=15, ComSignalInitValue=16384, ComSignalType=UINT16, ComSystemTemplateSystemSignalRef=DET_RANGE_VELOCITY_367
            DET_RANGE_VELOCITY_368_oRDR_DETECTION_365_368_oPCAN_RADAR_107dea12_Tx: ComBitPosition=384, ComBitSize=15, ComSignalInitValue=16384, ComSignalType=UINT16, ComSystemTemplateSystemSignalRef=DET_RANGE_VELOCITY_368
            DET_RANGE_VELOCITY_ERR_365_oRDR_DETECTION_365_368_oPCAN_RADAR_c2462c8c_Tx: ComBitPosition=64, ComBitSize=8, ComSignalInitValue=0, ComSignalType=UINT8, ComSystemTemplateSystemSignalRef=DET_RANGE_VELOCITY_ERR_365
            DET_RANGE_VELOCITY_ERR_366_oRDR_DETECTION_365_368_oPCAN_RADAR_a6a65772_Tx: ComBitPosition=176, ComBitSize=8, ComSignalInitValue=0, ComSignalType=UINT8, ComSystemTemplateSystemSignalRef=DET_RANGE_VELOCITY_ERR_366
            DET_RANGE_VELOCITY_ERR_367_oRDR_DETECTION_365_368_oPCAN_RADAR_33d683e7_Tx: ComBitPosition=288, ComBitSize=8, ComSignalInitValue=0, ComSignalType=UINT8, ComSystemTemplateSystemSignalRef=DET_RANGE_VELOCITY_ERR_367
            DET_RANGE_VELOCITY_ERR_368_oRDR_DETECTION_365_368_oPCAN_RADAR_1fc611a0_Tx: ComBitPosition=400, ComBitSize=8, ComSignalInitValue=0, ComSignalType=UINT8, ComSystemTemplateSystemSignalRef=DET_RANGE_VELOCITY_ERR_368
            DET_RCS_365_oRDR_DETECTION_365_368_oPCAN_RADAR_4a7de064_Tx: ComBitPosition=128, ComBitSize=8, ComSignalInitValue=128, ComSignalType=UINT8, ComSystemTemplateSystemSignalRef=DET_RCS_365
            DET_RCS_366_oRDR_DETECTION_365_368_oPCAN_RADAR_2e9d9b9a_Tx: ComBitPosition=240, ComBitSize=8, ComSignalInitValue=128, ComSignalType=UINT8, ComSystemTemplateSystemSignalRef=DET_RCS_366
            DET_RCS_367_oRDR_DETECTION_365_368_oPCAN_RADAR_bbed4f0f_Tx: ComBitPosition=352, ComBitSize=8, ComSignalInitValue=128, ComSignalType=UINT8, ComSystemTemplateSystemSignalRef=DET_RCS_367
            DET_RCS_368_oRDR_DETECTION_365_368_oPCAN_RADAR_97fddd48_Tx: ComBitPosition=464, ComBitSize=8, ComSignalInitValue=128, ComSignalType=UINT8, ComSystemTemplateSystemSignalRef=DET_RCS_368
            DET_SNR_365_oRDR_DETECTION_365_368_oPCAN_RADAR_97d3b466_Tx: ComBitPosition=120, ComBitSize=8, ComSignalInitValue=0, ComSignalType=UINT8, ComSystemTemplateSystemSignalRef=DET_SNR_365
            DET_SNR_366_oRDR_DETECTION_365_368_oPCAN_RADAR_f333cf98_Tx: ComBitPosition=232, ComBitSize=8, ComSignalInitValue=0, ComSignalType=UINT8, ComSystemTemplateSystemSignalRef=DET_SNR_366
            DET_SNR_367_oRDR_DETECTION_365_368_oPCAN_RADAR_66431b0d_Tx: ComBitPosition=344, ComBitSize=8, ComSignalInitValue=0, ComSignalType=UINT8, ComSystemTemplateSystemSignalRef=DET_SNR_367
            DET_SNR_368_oRDR_DETECTION_365_368_oPCAN_RADAR_4a53894a_Tx: ComBitPosition=456, ComBitSize=8, ComSignalInitValue=0, ComSignalType=UINT8, ComSystemTemplateSystemSignalRef=DET_SNR_368
            DET_SUPER_RES_TARGET_365_oRDR_DETECTION_365_368_oPCAN_RADAR_a64a9c03_Tx: ComBitPosition=87, ComBitSize=1, ComSignalInitValue=0, ComSignalType=BOOLEAN, ComSystemTemplateSystemSignalRef=DET_SUPER_RES_TARGET_365
            DET_SUPER_RES_TARGET_366_oRDR_DETECTION_365_368_oPCAN_RADAR_c2aae7fd_Tx: ComBitPosition=199, ComBitSize=1, ComSignalInitValue=0, ComSignalType=BOOLEAN, ComSystemTemplateSystemSignalRef=DET_SUPER_RES_TARGET_366
            DET_SUPER_RES_TARGET_367_oRDR_DETECTION_365_368_oPCAN_RADAR_57da3368_Tx: ComBitPosition=311, ComBitSize=1, ComSignalInitValue=0, ComSignalType=BOOLEAN, ComSystemTemplateSystemSignalRef=DET_SUPER_RES_TARGET_367
            DET_SUPER_RES_TARGET_368_oRDR_DETECTION_365_368_oPCAN_RADAR_7bcaa12f_Tx: ComBitPosition=423, ComBitSize=1, ComSignalInitValue=0, ComSignalType=BOOLEAN, ComSystemTemplateSystemSignalRef=DET_SUPER_RES_TARGET_368
        SG_Detections_369_372_oRDR_DETECTION_369_372_oPCAN_RADAR_af9702be_Tx: ComSystemTemplateSignalGroupRef=SG_Detections_369_372
          83 x ComGroupSignal, all with ComSignalEndianness=LITTLE_ENDIAN, ComTransferProperty=PENDING:
            DET_AZIMUTH_369_oRDR_DETECTION_369_372_oPCAN_RADAR_d2786018_Tx: ComBitPosition=88, ComBitSize=13, ComSignalInitValue=0, ComSignalType=UINT16, ComSystemTemplateSystemSignalRef=DET_AZIMUTH_369
            DET_AZIMUTH_370_oRDR_DETECTION_369_372_oPCAN_RADAR_b75812bc_Tx: ComBitPosition=200, ComBitSize=13, ComSignalInitValue=0, ComSignalType=UINT16, ComSystemTemplateSystemSignalRef=DET_AZIMUTH_370
            DET_AZIMUTH_371_oRDR_DETECTION_369_372_oPCAN_RADAR_2228c629_Tx: ComBitPosition=312, ComBitSize=13, ComSignalInitValue=0, ComSignalType=UINT16, ComSystemTemplateSystemSignalRef=DET_AZIMUTH_371
            DET_AZIMUTH_372_oRDR_DETECTION_369_372_oPCAN_RADAR_46c8bdd7_Tx: ComBitPosition=424, ComBitSize=13, ComSignalInitValue=0, ComSignalType=UINT16, ComSystemTemplateSystemSignalRef=DET_AZIMUTH_372
            DET_AZIMUTH_ERR_369_oRDR_DETECTION_369_372_oPCAN_RADAR_76cdf5ed_Tx: ComBitPosition=105, ComBitSize=7, ComSignalInitValue=0, ComSignalType=UINT8, ComSystemTemplateSystemSignalRef=DET_AZIMUTH_ERR_369
            DET_AZIMUTH_ERR_370_oRDR_DETECTION_369_372_oPCAN_RADAR_13ed8749_Tx: ComBitPosition=217, ComBitSize=7, ComSignalInitValue=0, ComSignalType=UINT8, ComSystemTemplateSystemSignalRef=DET_AZIMUTH_ERR_370
            DET_AZIMUTH_ERR_371_oRDR_DETECTION_369_372_oPCAN_RADAR_869d53dc_Tx: ComBitPosition=329, ComBitSize=7, ComSignalInitValue=0, ComSignalType=UINT8, ComSystemTemplateSystemSignalRef=DET_AZIMUTH_ERR_371
            DET_AZIMUTH_ERR_372_oRDR_DETECTION_369_372_oPCAN_RADAR_e27d2822_Tx: ComBitPosition=441, ComBitSize=7, ComSignalInitValue=0, ComSignalType=UINT8, ComSystemTemplateSystemSignalRef=DET_AZIMUTH_ERR_372
            DET_BELOW_RAIN_THOLD_369_oRDR_DETECTION_369_372_oPCAN_RADAR_0779f3d8_Tx: ComBitPosition=39, ComBitSize=1, ComSignalInitValue=0, ComSignalType=BOOLEAN, ComSystemTemplateSystemSignalRef=DET_BELOW_RAIN_THOLD_369
            DET_BELOW_RAIN_THOLD_370_oRDR_DETECTION_369_372_oPCAN_RADAR_6259817c_Tx: ComBitPosition=151, ComBitSize=1, ComSignalInitValue=0, ComSignalType=BOOLEAN, ComSystemTemplateSystemSignalRef=DET_BELOW_RAIN_THOLD_370
            DET_BELOW_RAIN_THOLD_371_oRDR_DETECTION_369_372_oPCAN_RADAR_f72955e9_Tx: ComBitPosition=263, ComBitSize=1, ComSignalInitValue=0, ComSignalType=BOOLEAN, ComSystemTemplateSystemSignalRef=DET_BELOW_RAIN_THOLD_371
            DET_BELOW_RAIN_THOLD_372_oRDR_DETECTION_369_372_oPCAN_RADAR_93c92e17_Tx: ComBitPosition=375, ComBitSize=1, ComSignalInitValue=0, ComSignalType=BOOLEAN, ComSystemTemplateSystemSignalRef=DET_BELOW_RAIN_THOLD_372
            DET_BI_STATIC_FLAG_369_oRDR_DETECTION_369_372_oPCAN_RADAR_8454209d_Tx: ComBitPosition=104, ComBitSize=1, ComSignalInitValue=0, ComSignalType=BOOLEAN, ComSystemTemplateSystemSignalRef=DET_BI_STATIC_FLAG_369
            DET_BI_STATIC_FLAG_370_oRDR_DETECTION_369_372_oPCAN_RADAR_e1745239_Tx: ComBitPosition=216, ComBitSize=1, ComSignalInitValue=0, ComSignalType=BOOLEAN, ComSystemTemplateSystemSignalRef=DET_BI_STATIC_FLAG_370
            DET_BI_STATIC_FLAG_371_oRDR_DETECTION_369_372_oPCAN_RADAR_740486ac_Tx: ComBitPosition=328, ComBitSize=1, ComSignalInitValue=0, ComSignalType=BOOLEAN, ComSystemTemplateSystemSignalRef=DET_BI_STATIC_FLAG_371
            DET_BI_STATIC_FLAG_372_oRDR_DETECTION_369_372_oPCAN_RADAR_10e4fd52_Tx: ComBitPosition=440, ComBitSize=1, ComSignalInitValue=0, ComSignalType=BOOLEAN, ComSystemTemplateSystemSignalRef=DET_BI_STATIC_FLAG_372
            DET_CONFD_AZIMUTH_369_oRDR_DETECTION_369_372_oPCAN_RADAR_d09e6ad2_Tx: ComBitPosition=118, ComBitSize=2, ComSignalInitValue=0, ComSignalType=UINT8, ComSystemTemplateSystemSignalRef=DET_CONFD_AZIMUTH_369
            DET_CONFD_AZIMUTH_370_oRDR_DETECTION_369_372_oPCAN_RADAR_b5be1876_Tx: ComBitPosition=230, ComBitSize=2, ComSignalInitValue=0, ComSignalType=UINT8, ComSystemTemplateSystemSignalRef=DET_CONFD_AZIMUTH_370
            DET_CONFD_AZIMUTH_371_oRDR_DETECTION_369_372_oPCAN_RADAR_20cecce3_Tx: ComBitPosition=342, ComBitSize=2, ComSignalInitValue=0, ComSignalType=UINT8, ComSystemTemplateSystemSignalRef=DET_CONFD_AZIMUTH_371
            DET_CONFD_AZIMUTH_372_oRDR_DETECTION_369_372_oPCAN_RADAR_442eb71d_Tx: ComBitPosition=454, ComBitSize=2, ComSignalInitValue=0, ComSignalType=UINT8, ComSystemTemplateSystemSignalRef=DET_CONFD_AZIMUTH_372
            DET_CONFD_ELEVATION_369_oRDR_DETECTION_369_372_oPCAN_RADAR_d20b6b28_Tx: ComBitPosition=101, ComBitSize=2, ComSignalInitValue=0, ComSignalType=UINT8, ComSystemTemplateSystemSignalRef=DET_CONFD_ELEVATION_369
            DET_CONFD_ELEVATION_370_oRDR_DETECTION_369_372_oPCAN_RADAR_b72b198c_Tx: ComBitPosition=213, ComBitSize=2, ComSignalInitValue=0, ComSignalType=UINT8, ComSystemTemplateSystemSignalRef=DET_CONFD_ELEVATION_370
            DET_CONFD_ELEVATION_371_oRDR_DETECTION_369_372_oPCAN_RADAR_225bcd19_Tx: ComBitPosition=325, ComBitSize=2, ComSignalInitValue=0, ComSignalType=UINT8, ComSystemTemplateSystemSignalRef=DET_CONFD_ELEVATION_371
            DET_CONFD_ELEVATION_372_oRDR_DETECTION_369_372_oPCAN_RADAR_46bbb6e7_Tx: ComBitPosition=437, ComBitSize=2, ComSignalInitValue=0, ComSignalType=UINT8, ComSystemTemplateSystemSignalRef=DET_CONFD_ELEVATION_372
            DET_ELEVATION_369_oRDR_DETECTION_369_372_oPCAN_RADAR_03cbbf14_Tx: ComBitPosition=72, ComBitSize=8, ComSignalInitValue=0, ComSignalType=UINT8, ComSystemTemplateSystemSignalRef=DET_ELEVATION_369
            DET_ELEVATION_370_oRDR_DETECTION_369_372_oPCAN_RADAR_66ebcdb0_Tx: ComBitPosition=184, ComBitSize=8, ComSignalInitValue=0, ComSignalType=UINT8, ComSystemTemplateSystemSignalRef=DET_ELEVATION_370
            DET_ELEVATION_371_oRDR_DETECTION_369_372_oPCAN_RADAR_f39b1925_Tx: ComBitPosition=296, ComBitSize=8, ComSignalInitValue=0, ComSignalType=UINT8, ComSystemTemplateSystemSignalRef=DET_ELEVATION_371
            DET_ELEVATION_372_oRDR_DETECTION_369_372_oPCAN_RADAR_977b62db_Tx: ComBitPosition=408, ComBitSize=8, ComSignalInitValue=0, ComSignalType=UINT8, ComSystemTemplateSystemSignalRef=DET_ELEVATION_372
            DET_ELEVATION_ERR_369_oRDR_DETECTION_369_372_oPCAN_RADAR_84f22761_Tx: ComBitPosition=80, ComBitSize=6, ComSignalInitValue=0, ComSignalType=UINT8, ComSystemTemplateSystemSignalRef=DET_ELEVATION_ERR_369
            DET_ELEVATION_ERR_370_oRDR_DETECTION_369_372_oPCAN_RADAR_e1d255c5_Tx: ComBitPosition=192, ComBitSize=6, ComSignalInitValue=0, ComSignalType=UINT8, ComSystemTemplateSystemSignalRef=DET_ELEVATION_ERR_370
            DET_ELEVATION_ERR_371_oRDR_DETECTION_369_372_oPCAN_RADAR_74a28150_Tx: ComBitPosition=304, ComBitSize=6, ComSignalInitValue=0, ComSignalType=UINT8, ComSystemTemplateSystemSignalRef=DET_ELEVATION_ERR_371
            DET_ELEVATION_ERR_372_oRDR_DETECTION_369_372_oPCAN_RADAR_1042faae_Tx: ComBitPosition=416, ComBitSize=6, ComSignalInitValue=0, ComSignalType=UINT8, ComSystemTemplateSystemSignalRef=DET_ELEVATION_ERR_372
            DET_EXISTENCE_PROB_369_oRDR_DETECTION_369_372_oPCAN_RADAR_566d5201_Tx: ComBitPosition=112, ComBitSize=6, ComSignalInitValue=0, ComSignalType=UINT8, ComSystemTemplateSystemSignalRef=DET_EXISTENCE_PROB_369
            DET_EXISTENCE_PROB_370_oRDR_DETECTION_369_372_oPCAN_RADAR_334d20a5_Tx: ComBitPosition=224, ComBitSize=6, ComSignalInitValue=0, ComSignalType=UINT8, ComSystemTemplateSystemSignalRef=DET_EXISTENCE_PROB_370
            DET_EXISTENCE_PROB_371_oRDR_DETECTION_369_372_oPCAN_RADAR_a63df430_Tx: ComBitPosition=336, ComBitSize=6, ComSignalInitValue=0, ComSignalType=UINT8, ComSystemTemplateSystemSignalRef=DET_EXISTENCE_PROB_371
            DET_EXISTENCE_PROB_372_oRDR_DETECTION_369_372_oPCAN_RADAR_c2dd8fce_Tx: ComBitPosition=448, ComBitSize=6, ComSignalInitValue=0, ComSignalType=UINT8, ComSystemTemplateSystemSignalRef=DET_EXISTENCE_PROB_372
            DET_HVC_FLAG_369_oRDR_DETECTION_369_372_oPCAN_RADAR_b719117e_Tx: ComBitPosition=86, ComBitSize=1, ComSignalInitValue=0, ComSignalType=BOOLEAN, ComSystemTemplateSystemSignalRef=DET_HVC_FLAG_369
            DET_HVC_FLAG_370_oRDR_DETECTION_369_372_oPCAN_RADAR_d23963da_Tx: ComBitPosition=198, ComBitSize=1, ComSignalInitValue=0, ComSignalType=BOOLEAN, ComSystemTemplateSystemSignalRef=DET_HVC_FLAG_370
            DET_HVC_FLAG_371_oRDR_DETECTION_369_372_oPCAN_RADAR_4749b74f_Tx: ComBitPosition=310, ComBitSize=1, ComSignalInitValue=0, ComSignalType=BOOLEAN, ComSystemTemplateSystemSignalRef=DET_HVC_FLAG_371
            DET_HVC_FLAG_372_oRDR_DETECTION_369_372_oPCAN_RADAR_23a9ccb1_Tx: ComBitPosition=422, ComBitSize=1, ComSignalInitValue=0, ComSignalType=BOOLEAN, ComSystemTemplateSystemSignalRef=DET_HVC_FLAG_372
            DET_IDM_369_oRDR_DETECTION_369_372_oPCAN_RADAR_3c4b2ac3_Tx: ComBitPosition=63, ComBitSize=1, ComSignalInitValue=0, ComSignalType=BOOLEAN, ComSystemTemplateSystemSignalRef=DET_IDM_369
            DET_IDM_370_oRDR_DETECTION_369_372_oPCAN_RADAR_596b5867_Tx: ComBitPosition=175, ComBitSize=1, ComSignalInitValue=0, ComSignalType=BOOLEAN, ComSystemTemplateSystemSignalRef=DET_IDM_370
            DET_IDM_371_oRDR_DETECTION_369_372_oPCAN_RADAR_cc1b8cf2_Tx: ComBitPosition=287, ComBitSize=1, ComSignalInitValue=0, ComSignalType=BOOLEAN, ComSystemTemplateSystemSignalRef=DET_IDM_371
            DET_IDM_372_oRDR_DETECTION_369_372_oPCAN_RADAR_a8fbf70c_Tx: ComBitPosition=399, ComBitSize=1, ComSignalInitValue=0, ComSignalType=BOOLEAN, ComSystemTemplateSystemSignalRef=DET_IDM_372
            DET_MH_CRC16_369_372_oRDR_DETECTION_369_372_oPCAN_RADAR_2b1fd0b5_Tx: ComBitPosition=0, ComBitSize=16, ComSignalInitValue=0, ComSignalType=UINT16, ComSystemTemplateSystemSignalRef=DET_MH_CRC16_369_372
            DET_MH_CYCLE_COUNTER_369_372_oRDR_DETECTION_369_372_oPCAN_RADAR_af6a7182_Tx: ComBitPosition=16, ComBitSize=8, ComSignalInitValue=0, ComSignalType=UINT8, ComSystemTemplateSystemSignalRef=DET_MH_CYCLE_COUNTER_369_372
            DET_MH_SCAN_INDEX_4LSB_369_372_oRDR_DETECTION_369_372_oPCAN_RADAR_6340540e_Tx: ComBitPosition=476, ComBitSize=4, ComSignalInitValue=0, ComSignalType=UINT8, ComSystemTemplateSystemSignalRef=DET_MH_SCAN_INDEX_4LSB_369_372
            DET_MTD_369_oRDR_DETECTION_369_372_oPCAN_RADAR_5af81818_Tx: ComBitPosition=47, ComBitSize=1, ComSignalInitValue=0, ComSignalType=BOOLEAN, ComSystemTemplateSystemSignalRef=DET_MTD_369
            DET_MTD_370_oRDR_DETECTION_369_372_oPCAN_RADAR_3fd86abc_Tx: ComBitPosition=159, ComBitSize=1, ComSignalInitValue=0, ComSignalType=BOOLEAN, ComSystemTemplateSystemSignalRef=DET_MTD_370
            DET_MTD_371_oRDR_DETECTION_369_372_oPCAN_RADAR_aaa8be29_Tx: ComBitPosition=271, ComBitSize=1, ComSignalInitValue=0, ComSignalType=BOOLEAN, ComSystemTemplateSystemSignalRef=DET_MTD_371
            DET_MTD_372_oRDR_DETECTION_369_372_oPCAN_RADAR_ce48c5d7_Tx: ComBitPosition=383, ComBitSize=1, ComSignalInitValue=0, ComSignalType=BOOLEAN, ComSystemTemplateSystemSignalRef=DET_MTD_372
            DET_PROB_1STAZHYPO_369_oRDR_DETECTION_369_372_oPCAN_RADAR_c94cf0d5_Tx: ComBitPosition=103, ComBitSize=1, ComSignalInitValue=0, ComSignalType=BOOLEAN, ComSystemTemplateSystemSignalRef=DET_PROB_1STAZHYPO_369
            DET_PROB_1STAZHYPO_370_oRDR_DETECTION_369_372_oPCAN_RADAR_ac6c8271_Tx: ComBitPosition=215, ComBitSize=1, ComSignalInitValue=0, ComSignalType=BOOLEAN, ComSystemTemplateSystemSignalRef=DET_PROB_1STAZHYPO_370
            DET_PROB_1STAZHYPO_371_oRDR_DETECTION_369_372_oPCAN_RADAR_391c56e4_Tx: ComBitPosition=327, ComBitSize=1, ComSignalInitValue=0, ComSignalType=BOOLEAN, ComSystemTemplateSystemSignalRef=DET_PROB_1STAZHYPO_371
            DET_PROB_1STAZHYPO_372_oRDR_DETECTION_369_372_oPCAN_RADAR_5dfc2d1a_Tx: ComBitPosition=439, ComBitSize=1, ComSignalInitValue=0, ComSignalType=BOOLEAN, ComSystemTemplateSystemSignalRef=DET_PROB_1STAZHYPO_372
            DET_RANGE_369_oRDR_DETECTION_369_372_oPCAN_RADAR_c2e313a3_Tx: ComBitPosition=24, ComBitSize=15, ComSignalInitValue=0, ComSignalType=UINT16, ComSystemTemplateSystemSignalRef=DET_RANGE_369
            DET_RANGE_370_oRDR_DETECTION_369_372_oPCAN_RADAR_a7c36107_Tx: ComBitPosition=136, ComBitSize=15, ComSignalInitValue=0, ComSignalType=UINT16, ComSystemTemplateSystemSignalRef=DET_RANGE_370
            DET_RANGE_371_oRDR_DETECTION_369_372_oPCAN_RADAR_32b3b592_Tx: ComBitPosition=248, ComBitSize=15, ComSignalInitValue=0, ComSignalType=UINT16, ComSystemTemplateSystemSignalRef=DET_RANGE_371
            DET_RANGE_372_oRDR_DETECTION_369_372_oPCAN_RADAR_5653ce6c_Tx: ComBitPosition=360, ComBitSize=15, ComSignalInitValue=0, ComSignalType=UINT16, ComSystemTemplateSystemSignalRef=DET_RANGE_372
            DET_RANGE_ERR_369_oRDR_DETECTION_369_372_oPCAN_RADAR_650ba9ca_Tx: ComBitPosition=40, ComBitSize=7, ComSignalInitValue=0, ComSignalType=UINT8, ComSystemTemplateSystemSignalRef=DET_RANGE_ERR_369
            DET_RANGE_ERR_370_oRDR_DETECTION_369_372_oPCAN_RADAR_002bdb6e_Tx: ComBitPosition=152, ComBitSize=7, ComSignalInitValue=0, ComSignalType=UINT8, ComSystemTemplateSystemSignalRef=DET_RANGE_ERR_370
            DET_RANGE_ERR_371_oRDR_DETECTION_369_372_oPCAN_RADAR_955b0ffb_Tx: ComBitPosition=264, ComBitSize=7, ComSignalInitValue=0, ComSignalType=UINT8, ComSystemTemplateSystemSignalRef=DET_RANGE_ERR_371
            DET_RANGE_ERR_372_oRDR_DETECTION_369_372_oPCAN_RADAR_f1bb7405_Tx: ComBitPosition=376, ComBitSize=7, ComSignalInitValue=0, ComSignalType=UINT8, ComSystemTemplateSystemSignalRef=DET_RANGE_ERR_372
            DET_RANGE_VELOCITY_369_oRDR_DETECTION_369_372_oPCAN_RADAR_b745d186_Tx: ComBitPosition=48, ComBitSize=15, ComSignalInitValue=16384, ComSignalType=UINT16, ComSystemTemplateSystemSignalRef=DET_RANGE_VELOCITY_369
            DET_RANGE_VELOCITY_370_oRDR_DETECTION_369_372_oPCAN_RADAR_d265a322_Tx: ComBitPosition=160, ComBitSize=15, ComSignalInitValue=16384, ComSignalType=UINT16, ComSystemTemplateSystemSignalRef=DET_RANGE_VELOCITY_370
            DET_RANGE_VELOCITY_371_oRDR_DETECTION_369_372_oPCAN_RADAR_471577b7_Tx: ComBitPosition=272, ComBitSize=15, ComSignalInitValue=16384, ComSignalType=UINT16, ComSystemTemplateSystemSignalRef=DET_RANGE_VELOCITY_371
            DET_RANGE_VELOCITY_372_oRDR_DETECTION_369_372_oPCAN_RADAR_23f50c49_Tx: ComBitPosition=384, ComBitSize=15, ComSignalInitValue=16384, ComSignalType=UINT16, ComSystemTemplateSystemSignalRef=DET_RANGE_VELOCITY_372
            DET_RANGE_VELOCITY_ERR_369_oRDR_DETECTION_369_372_oPCAN_RADAR_b8fe2a34_Tx: ComBitPosition=64, ComBitSize=8, ComSignalInitValue=0, ComSignalType=UINT8, ComSystemTemplateSystemSignalRef=DET_RANGE_VELOCITY_ERR_369
            DET_RANGE_VELOCITY_ERR_370_oRDR_DETECTION_369_372_oPCAN_RADAR_ddde5890_Tx: ComBitPosition=176, ComBitSize=8, ComSignalInitValue=0, ComSignalType=UINT8, ComSystemTemplateSystemSignalRef=DET_RANGE_VELOCITY_ERR_370
            DET_RANGE_VELOCITY_ERR_371_oRDR_DETECTION_369_372_oPCAN_RADAR_48ae8c05_Tx: ComBitPosition=288, ComBitSize=8, ComSignalInitValue=0, ComSignalType=UINT8, ComSystemTemplateSystemSignalRef=DET_RANGE_VELOCITY_ERR_371
            DET_RANGE_VELOCITY_ERR_372_oRDR_DETECTION_369_372_oPCAN_RADAR_2c4ef7fb_Tx: ComBitPosition=400, ComBitSize=8, ComSignalInitValue=0, ComSignalType=UINT8, ComSystemTemplateSystemSignalRef=DET_RANGE_VELOCITY_ERR_372
            DET_RCS_369_oRDR_DETECTION_369_372_oPCAN_RADAR_30c5e6dc_Tx: ComBitPosition=128, ComBitSize=8, ComSignalInitValue=128, ComSignalType=UINT8, ComSystemTemplateSystemSignalRef=DET_RCS_369
            DET_RCS_370_oRDR_DETECTION_369_372_oPCAN_RADAR_55e59478_Tx: ComBitPosition=240, ComBitSize=8, ComSignalInitValue=128, ComSignalType=UINT8, ComSystemTemplateSystemSignalRef=DET_RCS_370
            DET_RCS_371_oRDR_DETECTION_369_372_oPCAN_RADAR_c09540ed_Tx: ComBitPosition=352, ComBitSize=8, ComSignalInitValue=128, ComSignalType=UINT8, ComSystemTemplateSystemSignalRef=DET_RCS_371
            DET_RCS_372_oRDR_DETECTION_369_372_oPCAN_RADAR_a4753b13_Tx: ComBitPosition=464, ComBitSize=8, ComSignalInitValue=128, ComSignalType=UINT8, ComSystemTemplateSystemSignalRef=DET_RCS_372
            DET_SNR_369_oRDR_DETECTION_369_372_oPCAN_RADAR_ed6bb2de_Tx: ComBitPosition=120, ComBitSize=8, ComSignalInitValue=0, ComSignalType=UINT8, ComSystemTemplateSystemSignalRef=DET_SNR_369
            DET_SNR_370_oRDR_DETECTION_369_372_oPCAN_RADAR_884bc07a_Tx: ComBitPosition=232, ComBitSize=8, ComSignalInitValue=0, ComSignalType=UINT8, ComSystemTemplateSystemSignalRef=DET_SNR_370
            DET_SNR_371_oRDR_DETECTION_369_372_oPCAN_RADAR_1d3b14ef_Tx: ComBitPosition=344, ComBitSize=8, ComSignalInitValue=0, ComSignalType=UINT8, ComSystemTemplateSystemSignalRef=DET_SNR_371
            DET_SNR_372_oRDR_DETECTION_369_372_oPCAN_RADAR_79db6f11_Tx: ComBitPosition=456, ComBitSize=8, ComSignalInitValue=0, ComSignalType=UINT8, ComSystemTemplateSystemSignalRef=DET_SNR_372
            DET_SUPER_RES_TARGET_369_oRDR_DETECTION_369_372_oPCAN_RADAR_dcf29abb_Tx: ComBitPosition=87, ComBitSize=1, ComSignalInitValue=0, ComSignalType=BOOLEAN, ComSystemTemplateSystemSignalRef=DET_SUPER_RES_TARGET_369
            DET_SUPER_RES_TARGET_370_oRDR_DETECTION_369_372_oPCAN_RADAR_b9d2e81f_Tx: ComBitPosition=199, ComBitSize=1, ComSignalInitValue=0, ComSignalType=BOOLEAN, ComSystemTemplateSystemSignalRef=DET_SUPER_RES_TARGET_370
            DET_SUPER_RES_TARGET_371_oRDR_DETECTION_369_372_oPCAN_RADAR_2ca23c8a_Tx: ComBitPosition=311, ComBitSize=1, ComSignalInitValue=0, ComSignalType=BOOLEAN, ComSystemTemplateSystemSignalRef=DET_SUPER_RES_TARGET_371
            DET_SUPER_RES_TARGET_372_oRDR_DETECTION_369_372_oPCAN_RADAR_48424774_Tx: ComBitPosition=423, ComBitSize=1, ComSignalInitValue=0, ComSignalType=BOOLEAN, ComSystemTemplateSystemSignalRef=DET_SUPER_RES_TARGET_372
