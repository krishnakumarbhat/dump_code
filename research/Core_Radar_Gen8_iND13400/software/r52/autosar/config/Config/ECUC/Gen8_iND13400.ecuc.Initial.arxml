[part 11 of 24: package /InitialEcuC]
AUTOSAR XML (schema 00053)
package /InitialEcuC  (continued)
  module config Com  (continued)
    ComConfig  (continued)
      242 x ComSignalGroup, all with ComTransferProperty=PENDING:  (continued)
        SG_Detections_241_244_oRDR_DETECTION_241_244_oPCAN_RADAR_30f39079_Tx: ComSystemTemplateSignalGroupRef=SG_Detections_241_244
          83 x ComGroupSignal, all with ComSignalEndianness=LITTLE_ENDIAN, ComTransferProperty=PENDING:
            DET_AZIMUTH_241_oRDR_DETECTION_241_244_oPCAN_RADAR_a4988100_Tx: ComBitPosition=88, ComBitSize=13, ComSignalInitValue=0, ComSignalType=UINT16, ComSystemTemplateSystemSignalRef=DET_AZIMUTH_241
            DET_AZIMUTH_242_oRDR_DETECTION_241_244_oPCAN_RADAR_c078fafe_Tx: ComBitPosition=200, ComBitSize=13, ComSignalInitValue=0, ComSignalType=UINT16, ComSystemTemplateSystemSignalRef=DET_AZIMUTH_242
            DET_AZIMUTH_243_oRDR_DETECTION_241_244_oPCAN_RADAR_55082e6b_Tx: ComBitPosition=312, ComBitSize=13, ComSignalInitValue=0, ComSignalType=UINT16, ComSystemTemplateSystemSignalRef=DET_AZIMUTH_243
            DET_AZIMUTH_244_oRDR_DETECTION_241_244_oPCAN_RADAR_09b80d02_Tx: ComBitPosition=424, ComBitSize=13, ComSignalInitValue=0, ComSignalType=UINT16, ComSystemTemplateSystemSignalRef=DET_AZIMUTH_244
            DET_AZIMUTH_ERR_241_oRDR_DETECTION_241_244_oPCAN_RADAR_002d14f5_Tx: ComBitPosition=105, ComBitSize=7, ComSignalInitValue=0, ComSignalType=UINT8, ComSystemTemplateSystemSignalRef=DET_AZIMUTH_ERR_241
            DET_AZIMUTH_ERR_242_oRDR_DETECTION_241_244_oPCAN_RADAR_64cd6f0b_Tx: ComBitPosition=217, ComBitSize=7, ComSignalInitValue=0, ComSignalType=UINT8, ComSystemTemplateSystemSignalRef=DET_AZIMUTH_ERR_242
            DET_AZIMUTH_ERR_243_oRDR_DETECTION_241_244_oPCAN_RADAR_f1bdbb9e_Tx: ComBitPosition=329, ComBitSize=7, ComSignalInitValue=0, ComSignalType=UINT8, ComSystemTemplateSystemSignalRef=DET_AZIMUTH_ERR_243
            DET_AZIMUTH_ERR_244_oRDR_DETECTION_241_244_oPCAN_RADAR_ad0d98f7_Tx: ComBitPosition=441, ComBitSize=7, ComSignalInitValue=0, ComSignalType=UINT8, ComSystemTemplateSystemSignalRef=DET_AZIMUTH_ERR_244
            DET_BELOW_RAIN_THOLD_241_oRDR_DETECTION_241_244_oPCAN_RADAR_719912c0_Tx: ComBitPosition=39, ComBitSize=1, ComSignalInitValue=0, ComSignalType=BOOLEAN, ComSystemTemplateSystemSignalRef=DET_BELOW_RAIN_THOLD_241
            DET_BELOW_RAIN_THOLD_242_oRDR_DETECTION_241_244_oPCAN_RADAR_1579693e_Tx: ComBitPosition=151, ComBitSize=1, ComSignalInitValue=0, ComSignalType=BOOLEAN, ComSystemTemplateSystemSignalRef=DET_BELOW_RAIN_THOLD_242
            DET_BELOW_RAIN_THOLD_243_oRDR_DETECTION_241_244_oPCAN_RADAR_8009bdab_Tx: ComBitPosition=263, ComBitSize=1, ComSignalInitValue=0, ComSignalType=BOOLEAN, ComSystemTemplateSystemSignalRef=DET_BELOW_RAIN_THOLD_243
            DET_BELOW_RAIN_THOLD_244_oRDR_DETECTION_241_244_oPCAN_RADAR_dcb99ec2_Tx: ComBitPosition=375, ComBitSize=1, ComSignalInitValue=0, ComSignalType=BOOLEAN, ComSystemTemplateSystemSignalRef=DET_BELOW_RAIN_THOLD_244
            DET_BI_STATIC_FLAG_241_oRDR_DETECTION_241_244_oPCAN_RADAR_f2b4c185_Tx: ComBitPosition=104, ComBitSize=1, ComSignalInitValue=0, ComSignalType=BOOLEAN, ComSystemTemplateSystemSignalRef=DET_BI_STATIC_FLAG_241
            DET_BI_STATIC_FLAG_242_oRDR_DETECTION_241_244_oPCAN_RADAR_9654ba7b_Tx: ComBitPosition=216, ComBitSize=1, ComSignalInitValue=0, ComSignalType=BOOLEAN, ComSystemTemplateSystemSignalRef=DET_BI_STATIC_FLAG_242
            DET_BI_STATIC_FLAG_243_oRDR_DETECTION_241_244_oPCAN_RADAR_03246eee_Tx: ComBitPosition=328, ComBitSize=1, ComSignalInitValue=0, ComSignalType=BOOLEAN, ComSystemTemplateSystemSignalRef=DET_BI_STATIC_FLAG_243
            DET_BI_STATIC_FLAG_244_oRDR_DETECTION_241_244_oPCAN_RADAR_5f944d87_Tx: ComBitPosition=440, ComBitSize=1, ComSignalInitValue=0, ComSignalType=BOOLEAN, ComSystemTemplateSystemSignalRef=DET_BI_STATIC_FLAG_244
            DET_CONFD_AZIMUTH_241_oRDR_DETECTION_241_244_oPCAN_RADAR_a67e8bca_Tx: ComBitPosition=118, ComBitSize=2, ComSignalInitValue=0, ComSignalType=UINT8, ComSystemTemplateSystemSignalRef=DET_CONFD_AZIMUTH_241
            DET_CONFD_AZIMUTH_242_oRDR_DETECTION_241_244_oPCAN_RADAR_c29ef034_Tx: ComBitPosition=230, ComBitSize=2, ComSignalInitValue=0, ComSignalType=UINT8, ComSystemTemplateSystemSignalRef=DET_CONFD_AZIMUTH_242
            DET_CONFD_AZIMUTH_243_oRDR_DETECTION_241_244_oPCAN_RADAR_57ee24a1_Tx: ComBitPosition=342, ComBitSize=2, ComSignalInitValue=0, ComSignalType=UINT8, ComSystemTemplateSystemSignalRef=DET_CONFD_AZIMUTH_243
            DET_CONFD_AZIMUTH_244_oRDR_DETECTION_241_244_oPCAN_RADAR_0b5e07c8_Tx: ComBitPosition=454, ComBitSize=2, ComSignalInitValue=0, ComSignalType=UINT8, ComSystemTemplateSystemSignalRef=DET_CONFD_AZIMUTH_244
            DET_CONFD_ELEVATION_241_oRDR_DETECTION_241_244_oPCAN_RADAR_a4eb8a30_Tx: ComBitPosition=101, ComBitSize=2, ComSignalInitValue=0, ComSignalType=UINT8, ComSystemTemplateSystemSignalRef=DET_CONFD_ELEVATION_241
            DET_CONFD_ELEVATION_242_oRDR_DETECTION_241_244_oPCAN_RADAR_c00bf1ce_Tx: ComBitPosition=213, ComBitSize=2, ComSignalInitValue=0, ComSignalType=UINT8, ComSystemTemplateSystemSignalRef=DET_CONFD_ELEVATION_242
            DET_CONFD_ELEVATION_243_oRDR_DETECTION_241_244_oPCAN_RADAR_557b255b_Tx: ComBitPosition=325, ComBitSize=2, ComSignalInitValue=0, ComSignalType=UINT8, ComSystemTemplateSystemSignalRef=DET_CONFD_ELEVATION_243
            DET_CONFD_ELEVATION_244_oRDR_DETECTION_241_244_oPCAN_RADAR_09cb0632_Tx: ComBitPosition=437, ComBitSize=2, ComSignalInitValue=0, ComSignalType=UINT8, ComSystemTemplateSystemSignalRef=DET_CONFD_ELEVATION_244
            DET_ELEVATION_241_oRDR_DETECTION_241_244_oPCAN_RADAR_752b5e0c_Tx: ComBitPosition=72, ComBitSize=8, ComSignalInitValue=0, ComSignalType=UINT8, ComSystemTemplateSystemSignalRef=DET_ELEVATION_241
            DET_ELEVATION_242_oRDR_DETECTION_241_244_oPCAN_RADAR_11cb25f2_Tx: ComBitPosition=184, ComBitSize=8, ComSignalInitValue=0, ComSignalType=UINT8, ComSystemTemplateSystemSignalRef=DET_ELEVATION_242
            DET_ELEVATION_243_oRDR_DETECTION_241_244_oPCAN_RADAR_84bbf167_Tx: ComBitPosition=296, ComBitSize=8, ComSignalInitValue=0, ComSignalType=UINT8, ComSystemTemplateSystemSignalRef=DET_ELEVATION_243
            DET_ELEVATION_244_oRDR_DETECTION_241_244_oPCAN_RADAR_d80bd20e_Tx: ComBitPosition=408, ComBitSize=8, ComSignalInitValue=0, ComSignalType=UINT8, ComSystemTemplateSystemSignalRef=DET_ELEVATION_244
            DET_ELEVATION_ERR_241_oRDR_DETECTION_241_244_oPCAN_RADAR_f212c679_Tx: ComBitPosition=80, ComBitSize=6, ComSignalInitValue=0, ComSignalType=UINT8, ComSystemTemplateSystemSignalRef=DET_ELEVATION_ERR_241
            DET_ELEVATION_ERR_242_oRDR_DETECTION_241_244_oPCAN_RADAR_96f2bd87_Tx: ComBitPosition=192, ComBitSize=6, ComSignalInitValue=0, ComSignalType=UINT8, ComSystemTemplateSystemSignalRef=DET_ELEVATION_ERR_242
            DET_ELEVATION_ERR_243_oRDR_DETECTION_241_244_oPCAN_RADAR_03826912_Tx: ComBitPosition=304, ComBitSize=6, ComSignalInitValue=0, ComSignalType=UINT8, ComSystemTemplateSystemSignalRef=DET_ELEVATION_ERR_243
            DET_ELEVATION_ERR_244_oRDR_DETECTION_241_244_oPCAN_RADAR_5f324a7b_Tx: ComBitPosition=416, ComBitSize=6, ComSignalInitValue=0, ComSignalType=UINT8, ComSystemTemplateSystemSignalRef=DET_ELEVATION_ERR_244
            DET_EXISTENCE_PROB_241_oRDR_DETECTION_241_244_oPCAN_RADAR_208db319_Tx: ComBitPosition=112, ComBitSize=6, ComSignalInitValue=0, ComSignalType=UINT8, ComSystemTemplateSystemSignalRef=DET_EXISTENCE_PROB_241
            DET_EXISTENCE_PROB_242_oRDR_DETECTION_241_244_oPCAN_RADAR_446dc8e7_Tx: ComBitPosition=224, ComBitSize=6, ComSignalInitValue=0, ComSignalType=UINT8, ComSystemTemplateSystemSignalRef=DET_EXISTENCE_PROB_242
            DET_EXISTENCE_PROB_243_oRDR_DETECTION_241_244_oPCAN_RADAR_d11d1c72_Tx: ComBitPosition=336, ComBitSize=6, ComSignalInitValue=0, ComSignalType=UINT8, ComSystemTemplateSystemSignalRef=DET_EXISTENCE_PROB_243
            DET_EXISTENCE_PROB_244_oRDR_DETECTION_241_244_oPCAN_RADAR_8dad3f1b_Tx: ComBitPosition=448, ComBitSize=6, ComSignalInitValue=0, ComSignalType=UINT8, ComSystemTemplateSystemSignalRef=DET_EXISTENCE_PROB_244
            DET_HVC_FLAG_241_oRDR_DETECTION_241_244_oPCAN_RADAR_c1f9f066_Tx: ComBitPosition=86, ComBitSize=1, ComSignalInitValue=0, ComSignalType=BOOLEAN, ComSystemTemplateSystemSignalRef=DET_HVC_FLAG_241
            DET_HVC_FLAG_242_oRDR_DETECTION_241_244_oPCAN_RADAR_a5198b98_Tx: ComBitPosition=198, ComBitSize=1, ComSignalInitValue=0, ComSignalType=BOOLEAN, ComSystemTemplateSystemSignalRef=DET_HVC_FLAG_242
            DET_HVC_FLAG_243_oRDR_DETECTION_241_244_oPCAN_RADAR_30695f0d_Tx: ComBitPosition=310, ComBitSize=1, ComSignalInitValue=0, ComSignalType=BOOLEAN, ComSystemTemplateSystemSignalRef=DET_HVC_FLAG_243
            DET_HVC_FLAG_244_oRDR_DETECTION_241_244_oPCAN_RADAR_6cd97c64_Tx: ComBitPosition=422, ComBitSize=1, ComSignalInitValue=0, ComSignalType=BOOLEAN, ComSystemTemplateSystemSignalRef=DET_HVC_FLAG_244
            DET_IDM_241_oRDR_DETECTION_241_244_oPCAN_RADAR_4aabcbdb_Tx: ComBitPosition=63, ComBitSize=1, ComSignalInitValue=0, ComSignalType=BOOLEAN, ComSystemTemplateSystemSignalRef=DET_IDM_241
            DET_IDM_242_oRDR_DETECTION_241_244_oPCAN_RADAR_2e4bb025_Tx: ComBitPosition=175, ComBitSize=1, ComSignalInitValue=0, ComSignalType=BOOLEAN, ComSystemTemplateSystemSignalRef=DET_IDM_242
            DET_IDM_243_oRDR_DETECTION_241_244_oPCAN_RADAR_bb3b64b0_Tx: ComBitPosition=287, ComBitSize=1, ComSignalInitValue=0, ComSignalType=BOOLEAN, ComSystemTemplateSystemSignalRef=DET_IDM_243
            DET_IDM_244_oRDR_DETECTION_241_244_oPCAN_RADAR_e78b47d9_Tx: ComBitPosition=399, ComBitSize=1, ComSignalInitValue=0, ComSignalType=BOOLEAN, ComSystemTemplateSystemSignalRef=DET_IDM_244
            DET_MH_CRC16_241_244_oRDR_DETECTION_241_244_oPCAN_RADAR_b47b4272_Tx: ComBitPosition=0, ComBitSize=16, ComSignalInitValue=0, ComSignalType=UINT16, ComSystemTemplateSystemSignalRef=DET_MH_CRC16_241_244
            DET_MH_CYCLE_COUNTER_241_244_oRDR_DETECTION_241_244_oPCAN_RADAR_300ee345_Tx: ComBitPosition=16, ComBitSize=8, ComSignalInitValue=0, ComSignalType=UINT8, ComSystemTemplateSystemSignalRef=DET_MH_CYCLE_COUNTER_241_244
            DET_MH_SCAN_INDEX_4LSB_241_244_oRDR_DETECTION_241_244_oPCAN_RADAR_fc24c6c9_Tx: ComBitPosition=476, ComBitSize=4, ComSignalInitValue=0, ComSignalType=UINT8, ComSystemTemplateSystemSignalRef=DET_MH_SCAN_INDEX_4LSB_241_244
            DET_MTD_241_oRDR_DETECTION_241_244_oPCAN_RADAR_2c18f900_Tx: ComBitPosition=47, ComBitSize=1, ComSignalInitValue=0, ComSignalType=BOOLEAN, ComSystemTemplateSystemSignalRef=DET_MTD_241
            DET_MTD_242_oRDR_DETECTION_241_244_oPCAN_RADAR_48f882fe_Tx: ComBitPosition=159, ComBitSize=1, ComSignalInitValue=0, ComSignalType=BOOLEAN, ComSystemTemplateSystemSignalRef=DET_MTD_242
            DET_MTD_243_oRDR_DETECTION_241_244_oPCAN_RADAR_dd88566b_Tx: ComBitPosition=271, ComBitSize=1, ComSignalInitValue=0, ComSignalType=BOOLEAN, ComSystemTemplateSystemSignalRef=DET_MTD_243
            DET_MTD_244_oRDR_DETECTION_241_244_oPCAN_RADAR_81387502_Tx: ComBitPosition=383, ComBitSize=1, ComSignalInitValue=0, ComSignalType=BOOLEAN, ComSystemTemplateSystemSignalRef=DET_MTD_244
            DET_PROB_1STAZHYPO_241_oRDR_DETECTION_241_244_oPCAN_RADAR_bfac11cd_Tx: ComBitPosition=103, ComBitSize=1, ComSignalInitValue=0, ComSignalType=BOOLEAN, ComSystemTemplateSystemSignalRef=DET_PROB_1STAZHYPO_241
            DET_PROB_1STAZHYPO_242_oRDR_DETECTION_241_244_oPCAN_RADAR_db4c6a33_Tx: ComBitPosition=215, ComBitSize=1, ComSignalInitValue=0, ComSignalType=BOOLEAN, ComSystemTemplateSystemSignalRef=DET_PROB_1STAZHYPO_242
            DET_PROB_1STAZHYPO_243_oRDR_DETECTION_241_244_oPCAN_RADAR_4e3cbea6_Tx: ComBitPosition=327, ComBitSize=1, ComSignalInitValue=0, ComSignalType=BOOLEAN, ComSystemTemplateSystemSignalRef=DET_PROB_1STAZHYPO_243
            DET_PROB_1STAZHYPO_244_oRDR_DETECTION_241_244_oPCAN_RADAR_128c9dcf_Tx: ComBitPosition=439, ComBitSize=1, ComSignalInitValue=0, ComSignalType=BOOLEAN, ComSystemTemplateSystemSignalRef=DET_PROB_1STAZHYPO_244
            DET_RANGE_241_oRDR_DETECTION_241_244_oPCAN_RADAR_b403f2bb_Tx: ComBitPosition=24, ComBitSize=15, ComSignalInitValue=0, ComSignalType=UINT16, ComSystemTemplateSystemSignalRef=DET_RANGE_241
            DET_RANGE_242_oRDR_DETECTION_241_244_oPCAN_RADAR_d0e38945_Tx: ComBitPosition=136, ComBitSize=15, ComSignalInitValue=0, ComSignalType=UINT16, ComSystemTemplateSystemSignalRef=DET_RANGE_242
            DET_RANGE_243_oRDR_DETECTION_241_244_oPCAN_RADAR_45935dd0_Tx: ComBitPosition=248, ComBitSize=15, ComSignalInitValue=0, ComSignalType=UINT16, ComSystemTemplateSystemSignalRef=DET_RANGE_243
            DET_RANGE_244_oRDR_DETECTION_241_244_oPCAN_RADAR_19237eb9_Tx: ComBitPosition=360, ComBitSize=15, ComSignalInitValue=0, ComSignalType=UINT16, ComSystemTemplateSystemSignalRef=DET_RANGE_244
            DET_RANGE_ERR_241_oRDR_DETECTION_241_244_oPCAN_RADAR_13eb48d2_Tx: ComBitPosition=40, ComBitSize=7, ComSignalInitValue=0, ComSignalType=UINT8, ComSystemTemplateSystemSignalRef=DET_RANGE_ERR_241
            DET_RANGE_ERR_242_oRDR_DETECTION_241_244_oPCAN_RADAR_770b332c_Tx: ComBitPosition=152, ComBitSize=7, ComSignalInitValue=0, ComSignalType=UINT8, ComSystemTemplateSystemSignalRef=DET_RANGE_ERR_242
            DET_RANGE_ERR_243_oRDR_DETECTION_241_244_oPCAN_RADAR_e27be7b9_Tx: ComBitPosition=264, ComBitSize=7, ComSignalInitValue=0, ComSignalType=UINT8, ComSystemTemplateSystemSignalRef=DET_RANGE_ERR_243
            DET_RANGE_ERR_244_oRDR_DETECTION_241_244_oPCAN_RADAR_becbc4d0_Tx: ComBitPosition=376, ComBitSize=7, ComSignalInitValue=0, ComSignalType=UINT8, ComSystemTemplateSystemSignalRef=DET_RANGE_ERR_244
            DET_RANGE_VELOCITY_241_oRDR_DETECTION_241_244_oPCAN_RADAR_c1a5309e_Tx: ComBitPosition=48, ComBitSize=15, ComSignalInitValue=16384, ComSignalType=UINT16, ComSystemTemplateSystemSignalRef=DET_RANGE_VELOCITY_241
            DET_RANGE_VELOCITY_242_oRDR_DETECTION_241_244_oPCAN_RADAR_a5454b60_Tx: ComBitPosition=160, ComBitSize=15, ComSignalInitValue=16384, ComSignalType=UINT16, ComSystemTemplateSystemSignalRef=DET_RANGE_VELOCITY_242
            DET_RANGE_VELOCITY_243_oRDR_DETECTION_241_244_oPCAN_RADAR_30359ff5_Tx: ComBitPosition=272, ComBitSize=15, ComSignalInitValue=16384, ComSignalType=UINT16, ComSystemTemplateSystemSignalRef=DET_RANGE_VELOCITY_243
            DET_RANGE_VELOCITY_244_oRDR_DETECTION_241_244_oPCAN_RADAR_6c85bc9c_Tx: ComBitPosition=384, ComBitSize=15, ComSignalInitValue=16384, ComSignalType=UINT16, ComSystemTemplateSystemSignalRef=DET_RANGE_VELOCITY_244
            DET_RANGE_VELOCITY_ERR_241_oRDR_DETECTION_241_244_oPCAN_RADAR_ce1ecb2c_Tx: ComBitPosition=64, ComBitSize=8, ComSignalInitValue=0, ComSignalType=UINT8, ComSystemTemplateSystemSignalRef=DET_RANGE_VELOCITY_ERR_241
            DET_RANGE_VELOCITY_ERR_242_oRDR_DETECTION_241_244_oPCAN_RADAR_aafeb0d2_Tx: ComBitPosition=176, ComBitSize=8, ComSignalInitValue=0, ComSignalType=UINT8, ComSystemTemplateSystemSignalRef=DET_RANGE_VELOCITY_ERR_242
            DET_RANGE_VELOCITY_ERR_243_oRDR_DETECTION_241_244_oPCAN_RADAR_3f8e6447_Tx: ComBitPosition=288, ComBitSize=8, ComSignalInitValue=0, ComSignalType=UINT8, ComSystemTemplateSystemSignalRef=DET_RANGE_VELOCITY_ERR_243
            DET_RANGE_VELOCITY_ERR_244_oRDR_DETECTION_241_244_oPCAN_RADAR_633e472e_Tx: ComBitPosition=400, ComBitSize=8, ComSignalInitValue=0, ComSignalType=UINT8, ComSystemTemplateSystemSignalRef=DET_RANGE_VELOCITY_ERR_244
            DET_RCS_241_oRDR_DETECTION_241_244_oPCAN_RADAR_462507c4_Tx: ComBitPosition=128, ComBitSize=8, ComSignalInitValue=128, ComSignalType=UINT8, ComSystemTemplateSystemSignalRef=DET_RCS_241
            DET_RCS_242_oRDR_DETECTION_241_244_oPCAN_RADAR_22c57c3a_Tx: ComBitPosition=240, ComBitSize=8, ComSignalInitValue=128, ComSignalType=UINT8, ComSystemTemplateSystemSignalRef=DET_RCS_242
            DET_RCS_243_oRDR_DETECTION_241_244_oPCAN_RADAR_b7b5a8af_Tx: ComBitPosition=352, ComBitSize=8, ComSignalInitValue=128, ComSignalType=UINT8, ComSystemTemplateSystemSignalRef=DET_RCS_243
            DET_RCS_244_oRDR_DETECTION_241_244_oPCAN_RADAR_eb058bc6_Tx: ComBitPosition=464, ComBitSize=8, ComSignalInitValue=128, ComSignalType=UINT8, ComSystemTemplateSystemSignalRef=DET_RCS_244
            DET_SNR_241_oRDR_DETECTION_241_244_oPCAN_RADAR_9b8b53c6_Tx: ComBitPosition=120, ComBitSize=8, ComSignalInitValue=0, ComSignalType=UINT8, ComSystemTemplateSystemSignalRef=DET_SNR_241
            DET_SNR_242_oRDR_DETECTION_241_244_oPCAN_RADAR_ff6b2838_Tx: ComBitPosition=232, ComBitSize=8, ComSignalInitValue=0, ComSignalType=UINT8, ComSystemTemplateSystemSignalRef=DET_SNR_242
            DET_SNR_243_oRDR_DETECTION_241_244_oPCAN_RADAR_6a1bfcad_Tx: ComBitPosition=344, ComBitSize=8, ComSignalInitValue=0, ComSignalType=UINT8, ComSystemTemplateSystemSignalRef=DET_SNR_243
            DET_SNR_244_oRDR_DETECTION_241_244_oPCAN_RADAR_36abdfc4_Tx: ComBitPosition=456, ComBitSize=8, ComSignalInitValue=0, ComSignalType=UINT8, ComSystemTemplateSystemSignalRef=DET_SNR_244
            DET_SUPER_RES_TARGET_241_oRDR_DETECTION_241_244_oPCAN_RADAR_aa127ba3_Tx: ComBitPosition=87, ComBitSize=1, ComSignalInitValue=0, ComSignalType=BOOLEAN, ComSystemTemplateSystemSignalRef=DET_SUPER_RES_TARGET_241
            DET_SUPER_RES_TARGET_242_oRDR_DETECTION_241_244_oPCAN_RADAR_cef2005d_Tx: ComBitPosition=199, ComBitSize=1, ComSignalInitValue=0, ComSignalType=BOOLEAN, ComSystemTemplateSystemSignalRef=DET_SUPER_RES_TARGET_242
            DET_SUPER_RES_TARGET_243_oRDR_DETECTION_241_244_oPCAN_RADAR_5b82d4c8_Tx: ComBitPosition=311, ComBitSize=1, ComSignalInitValue=0, ComSignalType=BOOLEAN, ComSystemTemplateSystemSignalRef=DET_SUPER_RES_TARGET_243
            DET_SUPER_RES_TARGET_244_oRDR_DETECTION_241_244_oPCAN_RADAR_0732f7a1_Tx: ComBitPosition=423, ComBitSize=1, ComSignalInitValue=0, ComSignalType=BOOLEAN, ComSystemTemplateSystemSignalRef=DET_SUPER_RES_TARGET_244
        SG_Detections_245_248_oRDR_DETECTION_245_248_oPCAN_RADAR_4130a42b_Tx: ComSystemTemplateSignalGroupRef=SG_Detections_245_248
          83 x ComGroupSignal, all with ComSignalEndianness=LITTLE_ENDIAN, ComTransferProperty=PENDING:
            DET_AZIMUTH_245_oRDR_DETECTION_245_248_oPCAN_RADAR_757a47a3_Tx: ComBitPosition=88, ComBitSize=13, ComSignalInitValue=0, ComSignalType=UINT16, ComSystemTemplateSystemSignalRef=DET_AZIMUTH_245
            DET_AZIMUTH_246_oRDR_DETECTION_245_248_oPCAN_RADAR_119a3c5d_Tx: ComBitPosition=200, ComBitSize=13, ComSignalInitValue=0, ComSignalType=UINT16, ComSystemTemplateSystemSignalRef=DET_AZIMUTH_246
            DET_AZIMUTH_247_oRDR_DETECTION_245_248_oPCAN_RADAR_84eae8c8_Tx: ComBitPosition=312, ComBitSize=13, ComSignalInitValue=0, ComSignalType=UINT16, ComSystemTemplateSystemSignalRef=DET_AZIMUTH_247
            DET_AZIMUTH_248_oRDR_DETECTION_245_248_oPCAN_RADAR_a8fa7a8f_Tx: ComBitPosition=424, ComBitSize=13, ComSignalInitValue=0, ComSignalType=UINT16, ComSystemTemplateSystemSignalRef=DET_AZIMUTH_248
            DET_AZIMUTH_ERR_245_oRDR_DETECTION_245_248_oPCAN_RADAR_d1cfd256_Tx: ComBitPosition=105, ComBitSize=7, ComSignalInitValue=0, ComSignalType=UINT8, ComSystemTemplateSystemSignalRef=DET_AZIMUTH_ERR_245
            DET_AZIMUTH_ERR_246_oRDR_DETECTION_245_248_oPCAN_RADAR_b52fa9a8_Tx: ComBitPosition=217, ComBitSize=7, ComSignalInitValue=0, ComSignalType=UINT8, ComSystemTemplateSystemSignalRef=DET_AZIMUTH_ERR_246
            DET_AZIMUTH_ERR_247_oRDR_DETECTION_245_248_oPCAN_RADAR_205f7d3d_Tx: ComBitPosition=329, ComBitSize=7, ComSignalInitValue=0, ComSignalType=UINT8, ComSystemTemplateSystemSignalRef=DET_AZIMUTH_ERR_247
            DET_AZIMUTH_ERR_248_oRDR_DETECTION_245_248_oPCAN_RADAR_0c4fef7a_Tx: ComBitPosition=441, ComBitSize=7, ComSignalInitValue=0, ComSignalType=UINT8, ComSystemTemplateSystemSignalRef=DET_AZIMUTH_ERR_248
            DET_BELOW_RAIN_THOLD_245_oRDR_DETECTION_245_248_oPCAN_RADAR_a07bd463_Tx: ComBitPosition=39, ComBitSize=1, ComSignalInitValue=0, ComSignalType=BOOLEAN, ComSystemTemplateSystemSignalRef=DET_BELOW_RAIN_THOLD_245
            DET_BELOW_RAIN_THOLD_246_oRDR_DETECTION_245_248_oPCAN_RADAR_c49baf9d_Tx: ComBitPosition=151, ComBitSize=1, ComSignalInitValue=0, ComSignalType=BOOLEAN, ComSystemTemplateSystemSignalRef=DET_BELOW_RAIN_THOLD_246
            DET_BELOW_RAIN_THOLD_247_oRDR_DETECTION_245_248_oPCAN_RADAR_51eb7b08_Tx: ComBitPosition=263, ComBitSize=1, ComSignalInitValue=0, ComSignalType=BOOLEAN, ComSystemTemplateSystemSignalRef=DET_BELOW_RAIN_THOLD_247
            DET_BELOW_RAIN_THOLD_248_oRDR_DETECTION_245_248_oPCAN_RADAR_7dfbe94f_Tx: ComBitPosition=375, ComBitSize=1, ComSignalInitValue=0, ComSignalType=BOOLEAN, ComSystemTemplateSystemSignalRef=DET_BELOW_RAIN_THOLD_248
            DET_BI_STATIC_FLAG_245_oRDR_DETECTION_245_248_oPCAN_RADAR_23560726_Tx: ComBitPosition=104, ComBitSize=1, ComSignalInitValue=0, ComSignalType=BOOLEAN, ComSystemTemplateSystemSignalRef=DET_BI_STATIC_FLAG_245
            DET_BI_STATIC_FLAG_246_oRDR_DETECTION_245_248_oPCAN_RADAR_47b67cd8_Tx: ComBitPosition=216, ComBitSize=1, ComSignalInitValue=0, ComSignalType=BOOLEAN, ComSystemTemplateSystemSignalRef=DET_BI_STATIC_FLAG_246
            DET_BI_STATIC_FLAG_247_oRDR_DETECTION_245_248_oPCAN_RADAR_d2c6a84d_Tx: ComBitPosition=328, ComBitSize=1, ComSignalInitValue=0, ComSignalType=BOOLEAN, ComSystemTemplateSystemSignalRef=DET_BI_STATIC_FLAG_247
            DET_BI_STATIC_FLAG_248_oRDR_DETECTION_245_248_oPCAN_RADAR_fed63a0a_Tx: ComBitPosition=440, ComBitSize=1, ComSignalInitValue=0, ComSignalType=BOOLEAN, ComSystemTemplateSystemSignalRef=DET_BI_STATIC_FLAG_248
            DET_CONFD_AZIMUTH_245_oRDR_DETECTION_245_248_oPCAN_RADAR_779c4d69_Tx: ComBitPosition=118, ComBitSize=2, ComSignalInitValue=0, ComSignalType=UINT8, ComSystemTemplateSystemSignalRef=DET_CONFD_AZIMUTH_245
            DET_CONFD_AZIMUTH_246_oRDR_DETECTION_245_248_oPCAN_RADAR_137c3697_Tx: ComBitPosition=230, ComBitSize=2, ComSignalInitValue=0, ComSignalType=UINT8, ComSystemTemplateSystemSignalRef=DET_CONFD_AZIMUTH_246
            DET_CONFD_AZIMUTH_247_oRDR_DETECTION_245_248_oPCAN_RADAR_860ce202_Tx: ComBitPosition=342, ComBitSize=2, ComSignalInitValue=0, ComSignalType=UINT8, ComSystemTemplateSystemSignalRef=DET_CONFD_AZIMUTH_247
            DET_CONFD_AZIMUTH_248_oRDR_DETECTION_245_248_oPCAN_RADAR_aa1c7045_Tx: ComBitPosition=454, ComBitSize=2, ComSignalInitValue=0, ComSignalType=UINT8, ComSystemTemplateSystemSignalRef=DET_CONFD_AZIMUTH_248
            DET_CONFD_ELEVATION_245_oRDR_DETECTION_245_248_oPCAN_RADAR_75094c93_Tx: ComBitPosition=101, ComBitSize=2, ComSignalInitValue=0, ComSignalType=UINT8, ComSystemTemplateSystemSignalRef=DET_CONFD_ELEVATION_245
            DET_CONFD_ELEVATION_246_oRDR_DETECTION_245_248_oPCAN_RADAR_11e9376d_Tx: ComBitPosition=213, ComBitSize=2, ComSignalInitValue=0, ComSignalType=UINT8, ComSystemTemplateSystemSignalRef=DET_CONFD_ELEVATION_246
            DET_CONFD_ELEVATION_247_oRDR_DETECTION_245_248_oPCAN_RADAR_8499e3f8_Tx: ComBitPosition=325, ComBitSize=2, ComSignalInitValue=0, ComSignalType=UINT8, ComSystemTemplateSystemSignalRef=DET_CONFD_ELEVATION_247
            DET_CONFD_ELEVATION_248_oRDR_DETECTION_245_248_oPCAN_RADAR_a88971bf_Tx: ComBitPosition=437, ComBitSize=2, ComSignalInitValue=0, ComSignalType=UINT8, ComSystemTemplateSystemSignalRef=DET_CONFD_ELEVATION_248
            DET_ELEVATION_245_oRDR_DETECTION_245_248_oPCAN_RADAR_a4c998af_Tx: ComBitPosition=72, ComBitSize=8, ComSignalInitValue=0, ComSignalType=UINT8, ComSystemTemplateSystemSignalRef=DET_ELEVATION_245
            DET_ELEVATION_246_oRDR_DETECTION_245_248_oPCAN_RADAR_c029e351_Tx: ComBitPosition=184, ComBitSize=8, ComSignalInitValue=0, ComSignalType=UINT8, ComSystemTemplateSystemSignalRef=DET_ELEVATION_246
            DET_ELEVATION_247_oRDR_DETECTION_245_248_oPCAN_RADAR_555937c4_Tx: ComBitPosition=296, ComBitSize=8, ComSignalInitValue=0, ComSignalType=UINT8, ComSystemTemplateSystemSignalRef=DET_ELEVATION_247
            DET_ELEVATION_248_oRDR_DETECTION_245_248_oPCAN_RADAR_7949a583_Tx: ComBitPosition=408, ComBitSize=8, ComSignalInitValue=0, ComSignalType=UINT8, ComSystemTemplateSystemSignalRef=DET_ELEVATION_248
            DET_ELEVATION_ERR_245_oRDR_DETECTION_245_248_oPCAN_RADAR_23f000da_Tx: ComBitPosition=80, ComBitSize=6, ComSignalInitValue=0, ComSignalType=UINT8, ComSystemTemplateSystemSignalRef=DET_ELEVATION_ERR_245
            DET_ELEVATION_ERR_246_oRDR_DETECTION_245_248_oPCAN_RADAR_47107b24_Tx: ComBitPosition=192, ComBitSize=6, ComSignalInitValue=0, ComSignalType=UINT8, ComSystemTemplateSystemSignalRef=DET_ELEVATION_ERR_246
            DET_ELEVATION_ERR_247_oRDR_DETECTION_245_248_oPCAN_RADAR_d260afb1_Tx: ComBitPosition=304, ComBitSize=6, ComSignalInitValue=0, ComSignalType=UINT8, ComSystemTemplateSystemSignalRef=DET_ELEVATION_ERR_247
            DET_ELEVATION_ERR_248_oRDR_DETECTION_245_248_oPCAN_RADAR_fe703df6_Tx: ComBitPosition=416, ComBitSize=6, ComSignalInitValue=0, ComSignalType=UINT8, ComSystemTemplateSystemSignalRef=DET_ELEVATION_ERR_248
            DET_EXISTENCE_PROB_245_oRDR_DETECTION_245_248_oPCAN_RADAR_f16f75ba_Tx: ComBitPosition=112, ComBitSize=6, ComSignalInitValue=0, ComSignalType=UINT8, ComSystemTemplateSystemSignalRef=DET_EXISTENCE_PROB_245
            DET_EXISTENCE_PROB_246_oRDR_DETECTION_245_248_oPCAN_RADAR_958f0e44_Tx: ComBitPosition=224, ComBitSize=6, ComSignalInitValue=0, ComSignalType=UINT8, ComSystemTemplateSystemSignalRef=DET_EXISTENCE_PROB_246
            DET_EXISTENCE_PROB_247_oRDR_DETECTION_245_248_oPCAN_RADAR_00ffdad1_Tx: ComBitPosition=336, ComBitSize=6, ComSignalInitValue=0, ComSignalType=UINT8, ComSystemTemplateSystemSignalRef=DET_EXISTENCE_PROB_247
            DET_EXISTENCE_PROB_248_oRDR_DETECTION_245_248_oPCAN_RADAR_2cef4896_Tx: ComBitPosition=448, ComBitSize=6, ComSignalInitValue=0, ComSignalType=UINT8, ComSystemTemplateSystemSignalRef=DET_EXISTENCE_PROB_248
            DET_HVC_FLAG_245_oRDR_DETECTION_245_248_oPCAN_RADAR_101b36c5_Tx: ComBitPosition=86, ComBitSize=1, ComSignalInitValue=0, ComSignalType=BOOLEAN, ComSystemTemplateSystemSignalRef=DET_HVC_FLAG_245
            DET_HVC_FLAG_246_oRDR_DETECTION_245_248_oPCAN_RADAR_74fb4d3b_Tx: ComBitPosition=198, ComBitSize=1, ComSignalInitValue=0, ComSignalType=BOOLEAN, ComSystemTemplateSystemSignalRef=DET_HVC_FLAG_246
            DET_HVC_FLAG_247_oRDR_DETECTION_245_248_oPCAN_RADAR_e18b99ae_Tx: ComBitPosition=310, ComBitSize=1, ComSignalInitValue=0, ComSignalType=BOOLEAN, ComSystemTemplateSystemSignalRef=DET_HVC_FLAG_247
            DET_HVC_FLAG_248_oRDR_DETECTION_245_248_oPCAN_RADAR_cd9b0be9_Tx: ComBitPosition=422, ComBitSize=1, ComSignalInitValue=0, ComSignalType=BOOLEAN, ComSystemTemplateSystemSignalRef=DET_HVC_FLAG_248
            DET_IDM_245_oRDR_DETECTION_245_248_oPCAN_RADAR_9b490d78_Tx: ComBitPosition=63, ComBitSize=1, ComSignalInitValue=0, ComSignalType=BOOLEAN, ComSystemTemplateSystemSignalRef=DET_IDM_245
            DET_IDM_246_oRDR_DETECTION_245_248_oPCAN_RADAR_ffa97686_Tx: ComBitPosition=175, ComBitSize=1, ComSignalInitValue=0, ComSignalType=BOOLEAN, ComSystemTemplateSystemSignalRef=DET_IDM_246
            DET_IDM_247_oRDR_DETECTION_245_248_oPCAN_RADAR_6ad9a213_Tx: ComBitPosition=287, ComBitSize=1, ComSignalInitValue=0, ComSignalType=BOOLEAN, ComSystemTemplateSystemSignalRef=DET_IDM_247
            DET_IDM_248_oRDR_DETECTION_245_248_oPCAN_RADAR_46c93054_Tx: ComBitPosition=399, ComBitSize=1, ComSignalInitValue=0, ComSignalType=BOOLEAN, ComSystemTemplateSystemSignalRef=DET_IDM_248
            DET_MH_CRC16_245_248_oRDR_DETECTION_245_248_oPCAN_RADAR_c5b87620_Tx: ComBitPosition=0, ComBitSize=16, ComSignalInitValue=0, ComSignalType=UINT16, ComSystemTemplateSystemSignalRef=DET_MH_CRC16_245_248
            DET_MH_CYCLE_COUNTER_245_248_oRDR_DETECTION_245_248_oPCAN_RADAR_41cdd717_Tx: ComBitPosition=16, ComBitSize=8, ComSignalInitValue=0, ComSignalType=UINT8, ComSystemTemplateSystemSignalRef=DET_MH_CYCLE_COUNTER_245_248
            DET_MH_SCAN_INDEX_4LSB_245_248_oRDR_DETECTION_245_248_oPCAN_RADAR_8de7f29b_Tx: ComBitPosition=476, ComBitSize=4, ComSignalInitValue=0, ComSignalType=UINT8, ComSystemTemplateSystemSignalRef=DET_MH_SCAN_INDEX_4LSB_245_248
            DET_MTD_245_oRDR_DETECTION_245_248_oPCAN_RADAR_fdfa3fa3_Tx: ComBitPosition=47, ComBitSize=1, ComSignalInitValue=0, ComSignalType=BOOLEAN, ComSystemTemplateSystemSignalRef=DET_MTD_245
            DET_MTD_246_oRDR_DETECTION_245_248_oPCAN_RADAR_991a445d_Tx: ComBitPosition=159, ComBitSize=1, ComSignalInitValue=0, ComSignalType=BOOLEAN, ComSystemTemplateSystemSignalRef=DET_MTD_246
            DET_MTD_247_oRDR_DETECTION_245_248_oPCAN_RADAR_0c6a90c8_Tx: ComBitPosition=271, ComBitSize=1, ComSignalInitValue=0, ComSignalType=BOOLEAN, ComSystemTemplateSystemSignalRef=DET_MTD_247
            DET_MTD_248_oRDR_DETECTION_245_248_oPCAN_RADAR_207a028f_Tx: ComBitPosition=383, ComBitSize=1, ComSignalInitValue=0, ComSignalType=BOOLEAN, ComSystemTemplateSystemSignalRef=DET_MTD_248
            DET_PROB_1STAZHYPO_245_oRDR_DETECTION_245_248_oPCAN_RADAR_6e4ed76e_Tx: ComBitPosition=103, ComBitSize=1, ComSignalInitValue=0, ComSignalType=BOOLEAN, ComSystemTemplateSystemSignalRef=DET_PROB_1STAZHYPO_245
            DET_PROB_1STAZHYPO_246_oRDR_DETECTION_245_248_oPCAN_RADAR_0aaeac90_Tx: ComBitPosition=215, ComBitSize=1, ComSignalInitValue=0, ComSignalType=BOOLEAN, ComSystemTemplateSystemSignalRef=DET_PROB_1STAZHYPO_246
            DET_PROB_1STAZHYPO_247_oRDR_DETECTION_245_248_oPCAN_RADAR_9fde7805_Tx: ComBitPosition=327, ComBitSize=1, ComSignalInitValue=0, ComSignalType=BOOLEAN, ComSystemTemplateSystemSignalRef=DET_PROB_1STAZHYPO_247
            DET_PROB_1STAZHYPO_248_oRDR_DETECTION_245_248_oPCAN_RADAR_b3ceea42_Tx: ComBitPosition=439, ComBitSize=1, ComSignalInitValue=0, ComSignalType=BOOLEAN, ComSystemTemplateSystemSignalRef=DET_PROB_1STAZHYPO_248
            DET_RANGE_245_oRDR_DETECTION_245_248_oPCAN_RADAR_65e13418_Tx: ComBitPosition=24, ComBitSize=15, ComSignalInitValue=0, ComSignalType=UINT16, ComSystemTemplateSystemSignalRef=DET_RANGE_245
            DET_RANGE_246_oRDR_DETECTION_245_248_oPCAN_RADAR_01014fe6_Tx: ComBitPosition=136, ComBitSize=15, ComSignalInitValue=0, ComSignalType=UINT16, ComSystemTemplateSystemSignalRef=DET_RANGE_246
            DET_RANGE_247_oRDR_DETECTION_245_248_oPCAN_RADAR_94719b73_Tx: ComBitPosition=248, ComBitSize=15, ComSignalInitValue=0, ComSignalType=UINT16, ComSystemTemplateSystemSignalRef=DET_RANGE_247
            DET_RANGE_248_oRDR_DETECTION_245_248_oPCAN_RADAR_b8610934_Tx: ComBitPosition=360, ComBitSize=15, ComSignalInitValue=0, ComSignalType=UINT16, ComSystemTemplateSystemSignalRef=DET_RANGE_248
            DET_RANGE_ERR_245_oRDR_DETECTION_245_248_oPCAN_RADAR_c2098e71_Tx: ComBitPosition=40, ComBitSize=7, ComSignalInitValue=0, ComSignalType=UINT8, ComSystemTemplateSystemSignalRef=DET_RANGE_ERR_245
            DET_RANGE_ERR_246_oRDR_DETECTION_245_248_oPCAN_RADAR_a6e9f58f_Tx: ComBitPosition=152, ComBitSize=7, ComSignalInitValue=0, ComSignalType=UINT8, ComSystemTemplateSystemSignalRef=DET_RANGE_ERR_246
            DET_RANGE_ERR_247_oRDR_DETECTION_245_248_oPCAN_RADAR_3399211a_Tx: ComBitPosition=264, ComBitSize=7, ComSignalInitValue=0, ComSignalType=UINT8, ComSystemTemplateSystemSignalRef=DET_RANGE_ERR_247
            DET_RANGE_ERR_248_oRDR_DETECTION_245_248_oPCAN_RADAR_1f89b35d_Tx: ComBitPosition=376, ComBitSize=7, ComSignalInitValue=0, ComSignalType=UINT8, ComSystemTemplateSystemSignalRef=DET_RANGE_ERR_248
            DET_RANGE_VELOCITY_245_oRDR_DETECTION_245_248_oPCAN_RADAR_1047f63d_Tx: ComBitPosition=48, ComBitSize=15, ComSignalInitValue=16384, ComSignalType=UINT16, ComSystemTemplateSystemSignalRef=DET_RANGE_VELOCITY_245
            DET_RANGE_VELOCITY_246_oRDR_DETECTION_245_248_oPCAN_RADAR_74a78dc3_Tx: ComBitPosition=160, ComBitSize=15, ComSignalInitValue=16384, ComSignalType=UINT16, ComSystemTemplateSystemSignalRef=DET_RANGE_VELOCITY_246
            DET_RANGE_VELOCITY_247_oRDR_DETECTION_245_248_oPCAN_RADAR_e1d75956_Tx: ComBitPosition=272, ComBitSize=15, ComSignalInitValue=16384, ComSignalType=UINT16, ComSystemTemplateSystemSignalRef=DET_RANGE_VELOCITY_247
            DET_RANGE_VELOCITY_248_oRDR_DETECTION_245_248_oPCAN_RADAR_cdc7cb11_Tx: ComBitPosition=384, ComBitSize=15, ComSignalInitValue=16384, ComSignalType=UINT16, ComSystemTemplateSystemSignalRef=DET_RANGE_VELOCITY_248
            DET_RANGE_VELOCITY_ERR_245_oRDR_DETECTION_245_248_oPCAN_RADAR_1ffc0d8f_Tx: ComBitPosition=64, ComBitSize=8, ComSignalInitValue=0, ComSignalType=UINT8, ComSystemTemplateSystemSignalRef=DET_RANGE_VELOCITY_ERR_245
            DET_RANGE_VELOCITY_ERR_246_oRDR_DETECTION_245_248_oPCAN_RADAR_7b1c7671_Tx: ComBitPosition=176, ComBitSize=8, ComSignalInitValue=0, ComSignalType=UINT8, ComSystemTemplateSystemSignalRef=DET_RANGE_VELOCITY_ERR_246
            DET_RANGE_VELOCITY_ERR_247_oRDR_DETECTION_245_248_oPCAN_RADAR_ee6ca2e4_Tx: ComBitPosition=288, ComBitSize=8, ComSignalInitValue=0, ComSignalType=UINT8, ComSystemTemplateSystemSignalRef=DET_RANGE_VELOCITY_ERR_247
            DET_RANGE_VELOCITY_ERR_248_oRDR_DETECTION_245_248_oPCAN_RADAR_c27c30a3_Tx: ComBitPosition=400, ComBitSize=8, ComSignalInitValue=0, ComSignalType=UINT8, ComSystemTemplateSystemSignalRef=DET_RANGE_VELOCITY_ERR_248
            DET_RCS_245_oRDR_DETECTION_245_248_oPCAN_RADAR_97c7c167_Tx: ComBitPosition=128, ComBitSize=8, ComSignalInitValue=128, ComSignalType=UINT8, ComSystemTemplateSystemSignalRef=DET_RCS_245
            DET_RCS_246_oRDR_DETECTION_245_248_oPCAN_RADAR_f327ba99_Tx: ComBitPosition=240, ComBitSize=8, ComSignalInitValue=128, ComSignalType=UINT8, ComSystemTemplateSystemSignalRef=DET_RCS_246
            DET_RCS_247_oRDR_DETECTION_245_248_oPCAN_RADAR_66576e0c_Tx: ComBitPosition=352, ComBitSize=8, ComSignalInitValue=128, ComSignalType=UINT8, ComSystemTemplateSystemSignalRef=DET_RCS_247
            DET_RCS_248_oRDR_DETECTION_245_248_oPCAN_RADAR_4a47fc4b_Tx: ComBitPosition=464, ComBitSize=8, ComSignalInitValue=128, ComSignalType=UINT8, ComSystemTemplateSystemSignalRef=DET_RCS_248
            DET_SNR_245_oRDR_DETECTION_245_248_oPCAN_RADAR_4a699565_Tx: ComBitPosition=120, ComBitSize=8, ComSignalInitValue=0, ComSignalType=UINT8, ComSystemTemplateSystemSignalRef=DET_SNR_245
            DET_SNR_246_oRDR_DETECTION_245_248_oPCAN_RADAR_2e89ee9b_Tx: ComBitPosition=232, ComBitSize=8, ComSignalInitValue=0, ComSignalType=UINT8, ComSystemTemplateSystemSignalRef=DET_SNR_246
            DET_SNR_247_oRDR_DETECTION_245_248_oPCAN_RADAR_bbf93a0e_Tx: ComBitPosition=344, ComBitSize=8, ComSignalInitValue=0, ComSignalType=UINT8, ComSystemTemplateSystemSignalRef=DET_SNR_247
            DET_SNR_248_oRDR_DETECTION_245_248_oPCAN_RADAR_97e9a849_Tx: ComBitPosition=456, ComBitSize=8, ComSignalInitValue=0, ComSignalType=UINT8, ComSystemTemplateSystemSignalRef=DET_SNR_248
            DET_SUPER_RES_TARGET_245_oRDR_DETECTION_245_248_oPCAN_RADAR_7bf0bd00_Tx: ComBitPosition=87, ComBitSize=1, ComSignalInitValue=0, ComSignalType=BOOLEAN, ComSystemTemplateSystemSignalRef=DET_SUPER_RES_TARGET_245
            DET_SUPER_RES_TARGET_246_oRDR_DETECTION_245_248_oPCAN_RADAR_1f10c6fe_Tx: ComBitPosition=199, ComBitSize=1, ComSignalInitValue=0, ComSignalType=BOOLEAN, ComSystemTemplateSystemSignalRef=DET_SUPER_RES_TARGET_246
            DET_SUPER_RES_TARGET_247_oRDR_DETECTION_245_248_oPCAN_RADAR_8a60126b_Tx: ComBitPosition=311, ComBitSize=1, ComSignalInitValue=0, ComSignalType=BOOLEAN, ComSystemTemplateSystemSignalRef=DET_SUPER_RES_TARGET_247
            DET_SUPER_RES_TARGET_248_oRDR_DETECTION_245_248_oPCAN_RADAR_a670802c_Tx: ComBitPosition=423, ComBitSize=1, ComSignalInitValue=0, ComSignalType=BOOLEAN, ComSystemTemplateSystemSignalRef=DET_SUPER_RES_TARGET_248
        SG_Detections_249_252_oRDR_DETECTION_249_252_oPCAN_RADAR_d84a8050_Tx: ComSystemTemplateSignalGroupRef=SG_Detections_249_252
          83 x ComGroupSignal, all with ComSignalEndianness=LITTLE_ENDIAN, ComTransferProperty=PENDING:
            DET_AZIMUTH_249_oRDR_DETECTION_249_252_oPCAN_RADAR_0fc2411b_Tx: ComBitPosition=88, ComBitSize=13, ComSignalInitValue=0, ComSignalType=UINT16, ComSystemTemplateSystemSignalRef=DET_AZIMUTH_249
            DET_AZIMUTH_250_oRDR_DETECTION_249_252_oPCAN_RADAR_6ae233bf_Tx: ComBitPosition=200, ComBitSize=13, ComSignalInitValue=0, ComSignalType=UINT16, ComSystemTemplateSystemSignalRef=DET_AZIMUTH_250
            DET_AZIMUTH_251_oRDR_DETECTION_249_252_oPCAN_RADAR_ff92e72a_Tx: ComBitPosition=312, ComBitSize=13, ComSignalInitValue=0, ComSignalType=UINT16, ComSystemTemplateSystemSignalRef=DET_AZIMUTH_251
            DET_AZIMUTH_252_oRDR_DETECTION_249_252_oPCAN_RADAR_9b729cd4_Tx: ComBitPosition=424, ComBitSize=13, ComSignalInitValue=0, ComSignalType=UINT16, ComSystemTemplateSystemSignalRef=DET_AZIMUTH_252
            DET_AZIMUTH_ERR_249_oRDR_DETECTION_249_252_oPCAN_RADAR_ab77d4ee_Tx: ComBitPosition=105, ComBitSize=7, ComSignalInitValue=0, ComSignalType=UINT8, ComSystemTemplateSystemSignalRef=DET_AZIMUTH_ERR_249
            DET_AZIMUTH_ERR_250_oRDR_DETECTION_249_252_oPCAN_RADAR_ce57a64a_Tx: ComBitPosition=217, ComBitSize=7, ComSignalInitValue=0, ComSignalType=UINT8, ComSystemTemplateSystemSignalRef=DET_AZIMUTH_ERR_250
            DET_AZIMUTH_ERR_251_oRDR_DETECTION_249_252_oPCAN_RADAR_5b2772df_Tx: ComBitPosition=329, ComBitSize=7, ComSignalInitValue=0, ComSignalType=UINT8, ComSystemTemplateSystemSignalRef=DET_AZIMUTH_ERR_251
            DET_AZIMUTH_ERR_252_oRDR_DETECTION_249_252_oPCAN_RADAR_3fc70921_Tx: ComBitPosition=441, ComBitSize=7, ComSignalInitValue=0, ComSignalType=UINT8, ComSystemTemplateSystemSignalRef=DET_AZIMUTH_ERR_252
            DET_BELOW_RAIN_THOLD_249_oRDR_DETECTION_249_252_oPCAN_RADAR_dac3d2db_Tx: ComBitPosition=39, ComBitSize=1, ComSignalInitValue=0, ComSignalType=BOOLEAN, ComSystemTemplateSystemSignalRef=DET_BELOW_RAIN_THOLD_249
            DET_BELOW_RAIN_THOLD_250_oRDR_DETECTION_249_252_oPCAN_RADAR_bfe3a07f_Tx: ComBitPosition=151, ComBitSize=1, ComSignalInitValue=0, ComSignalType=BOOLEAN, ComSystemTemplateSystemSignalRef=DET_BELOW_RAIN_THOLD_250
            DET_BELOW_RAIN_THOLD_251_oRDR_DETECTION_249_252_oPCAN_RADAR_2a9374ea_Tx: ComBitPosition=263, ComBitSize=1, ComSignalInitValue=0, ComSignalType=BOOLEAN, ComSystemTemplateSystemSignalRef=DET_BELOW_RAIN_THOLD_251
            DET_BELOW_RAIN_THOLD_252_oRDR_DETECTION_249_252_oPCAN_RADAR_4e730f14_Tx: ComBitPosition=375, ComBitSize=1, ComSignalInitValue=0, ComSignalType=BOOLEAN, ComSystemTemplateSystemSignalRef=DET_BELOW_RAIN_THOLD_252
            DET_BI_STATIC_FLAG_249_oRDR_DETECTION_249_252_oPCAN_RADAR_59ee019e_Tx: ComBitPosition=104, ComBitSize=1, ComSignalInitValue=0, ComSignalType=BOOLEAN, ComSystemTemplateSystemSignalRef=DET_BI_STATIC_FLAG_249
            DET_BI_STATIC_FLAG_250_oRDR_DETECTION_249_252_oPCAN_RADAR_3cce733a_Tx: ComBitPosition=216, ComBitSize=1, ComSignalInitValue=0, ComSignalType=BOOLEAN, ComSystemTemplateSystemSignalRef=DET_BI_STATIC_FLAG_250
            DET_BI_STATIC_FLAG_251_oRDR_DETECTION_249_252_oPCAN_RADAR_a9bea7af_Tx: ComBitPosition=328, ComBitSize=1, ComSignalInitValue=0, ComSignalType=BOOLEAN, ComSystemTemplateSystemSignalRef=DET_BI_STATIC_FLAG_251
            DET_BI_STATIC_FLAG_252_oRDR_DETECTION_249_252_oPCAN_RADAR_cd5edc51_Tx: ComBitPosition=440, ComBitSize=1, ComSignalInitValue=0, ComSignalType=BOOLEAN, ComSystemTemplateSystemSignalRef=DET_BI_STATIC_FLAG_252
            DET_CONFD_AZIMUTH_249_oRDR_DETECTION_249_252_oPCAN_RADAR_0d244bd1_Tx: ComBitPosition=118, ComBitSize=2, ComSignalInitValue=0, ComSignalType=UINT8, ComSystemTemplateSystemSignalRef=DET_CONFD_AZIMUTH_249
            DET_CONFD_AZIMUTH_250_oRDR_DETECTION_249_252_oPCAN_RADAR_68043975_Tx: ComBitPosition=230, ComBitSize=2, ComSignalInitValue=0, ComSignalType=UINT8, ComSystemTemplateSystemSignalRef=DET_CONFD_AZIMUTH_250
            DET_CONFD_AZIMUTH_251_oRDR_DETECTION_249_252_oPCAN_RADAR_fd74ede0_Tx: ComBitPosition=342, ComBitSize=2, ComSignalInitValue=0, ComSignalType=UINT8, ComSystemTemplateSystemSignalRef=DET_CONFD_AZIMUTH_251
            DET_CONFD_AZIMUTH_252_oRDR_DETECTION_249_252_oPCAN_RADAR_9994961e_Tx: ComBitPosition=454, ComBitSize=2, ComSignalInitValue=0, ComSignalType=UINT8, ComSystemTemplateSystemSignalRef=DET_CONFD_AZIMUTH_252
            DET_CONFD_ELEVATION_249_oRDR_DETECTION_249_252_oPCAN_RADAR_0fb14a2b_Tx: ComBitPosition=101, ComBitSize=2, ComSignalInitValue=0, ComSignalType=UINT8, ComSystemTemplateSystemSignalRef=DET_CONFD_ELEVATION_249
            DET_CONFD_ELEVATION_250_oRDR_DETECTION_249_252_oPCAN_RADAR_6a91388f_Tx: ComBitPosition=213, ComBitSize=2, ComSignalInitValue=0, ComSignalType=UINT8, ComSystemTemplateSystemSignalRef=DET_CONFD_ELEVATION_250
            DET_CONFD_ELEVATION_251_oRDR_DETECTION_249_252_oPCAN_RADAR_ffe1ec1a_Tx: ComBitPosition=325, ComBitSize=2, ComSignalInitValue=0, ComSignalType=UINT8, ComSystemTemplateSystemSignalRef=DET_CONFD_ELEVATION_251
            DET_CONFD_ELEVATION_252_oRDR_DETECTION_249_252_oPCAN_RADAR_9b0197e4_Tx: ComBitPosition=437, ComBitSize=2, ComSignalInitValue=0, ComSignalType=UINT8, ComSystemTemplateSystemSignalRef=DET_CONFD_ELEVATION_252
            DET_ELEVATION_249_oRDR_DETECTION_249_252_oPCAN_RADAR_de719e17_Tx: ComBitPosition=72, ComBitSize=8, ComSignalInitValue=0, ComSignalType=UINT8, ComSystemTemplateSystemSignalRef=DET_ELEVATION_249
            DET_ELEVATION_250_oRDR_DETECTION_249_252_oPCAN_RADAR_bb51ecb3_Tx: ComBitPosition=184, ComBitSize=8, ComSignalInitValue=0, ComSignalType=UINT8, ComSystemTemplateSystemSignalRef=DET_ELEVATION_250
            DET_ELEVATION_251_oRDR_DETECTION_249_252_oPCAN_RADAR_2e213826_Tx: ComBitPosition=296, ComBitSize=8, ComSignalInitValue=0, ComSignalType=UINT8, ComSystemTemplateSystemSignalRef=DET_ELEVATION_251
            DET_ELEVATION_252_oRDR_DETECTION_249_252_oPCAN_RADAR_4ac143d8_Tx: ComBitPosition=408, ComBitSize=8, ComSignalInitValue=0, ComSignalType=UINT8, ComSystemTemplateSystemSignalRef=DET_ELEVATION_252
            DET_ELEVATION_ERR_249_oRDR_DETECTION_249_252_oPCAN_RADAR_59480662_Tx: ComBitPosition=80, ComBitSize=6, ComSignalInitValue=0, ComSignalType=UINT8, ComSystemTemplateSystemSignalRef=DET_ELEVATION_ERR_249
            DET_ELEVATION_ERR_250_oRDR_DETECTION_249_252_oPCAN_RADAR_3c6874c6_Tx: ComBitPosition=192, ComBitSize=6, ComSignalInitValue=0, ComSignalType=UINT8, ComSystemTemplateSystemSignalRef=DET_ELEVATION_ERR_250
            DET_ELEVATION_ERR_251_oRDR_DETECTION_249_252_oPCAN_RADAR_a918a053_Tx: ComBitPosition=304, ComBitSize=6, ComSignalInitValue=0, ComSignalType=UINT8, ComSystemTemplateSystemSignalRef=DET_ELEVATION_ERR_251
            DET_ELEVATION_ERR_252_oRDR_DETECTION_249_252_oPCAN_RADAR_cdf8dbad_Tx: ComBitPosition=416, ComBitSize=6, ComSignalInitValue=0, ComSignalType=UINT8, ComSystemTemplateSystemSignalRef=DET_ELEVATION_ERR_252
            DET_EXISTENCE_PROB_249_oRDR_DETECTION_249_252_oPCAN_RADAR_8bd77302_Tx: ComBitPosition=112, ComBitSize=6, ComSignalInitValue=0, ComSignalType=UINT8, ComSystemTemplateSystemSignalRef=DET_EXISTENCE_PROB_249
            DET_EXISTENCE_PROB_250_oRDR_DETECTION_249_252_oPCAN_RADAR_eef701a6_Tx: ComBitPosition=224, ComBitSize=6, ComSignalInitValue=0, ComSignalType=UINT8, ComSystemTemplateSystemSignalRef=DET_EXISTENCE_PROB_250
            DET_EXISTENCE_PROB_251_oRDR_DETECTION_249_252_oPCAN_RADAR_7b87d533_Tx: ComBitPosition=336, ComBitSize=6, ComSignalInitValue=0, ComSignalType=UINT8, ComSystemTemplateSystemSignalRef=DET_EXISTENCE_PROB_251
            DET_EXISTENCE_PROB_252_oRDR_DETECTION_249_252_oPCAN_RADAR_1f67aecd_Tx: ComBitPosition=448, ComBitSize=6, ComSignalInitValue=0, ComSignalType=UINT8, ComSystemTemplateSystemSignalRef=DET_EXISTENCE_PROB_252
            DET_HVC_FLAG_249_oRDR_DETECTION_249_252_oPCAN_RADAR_6aa3307d_Tx: ComBitPosition=86, ComBitSize=1, ComSignalInitValue=0, ComSignalType=BOOLEAN, ComSystemTemplateSystemSignalRef=DET_HVC_FLAG_249
            DET_HVC_FLAG_250_oRDR_DETECTION_249_252_oPCAN_RADAR_0f8342d9_Tx: ComBitPosition=198, ComBitSize=1, ComSignalInitValue=0, ComSignalType=BOOLEAN, ComSystemTemplateSystemSignalRef=DET_HVC_FLAG_250
            DET_HVC_FLAG_251_oRDR_DETECTION_249_252_oPCAN_RADAR_9af3964c_Tx: ComBitPosition=310, ComBitSize=1, ComSignalInitValue=0, ComSignalType=BOOLEAN, ComSystemTemplateSystemSignalRef=DET_HVC_FLAG_251
            DET_HVC_FLAG_252_oRDR_DETECTION_249_252_oPCAN_RADAR_fe13edb2_Tx: ComBitPosition=422, ComBitSize=1, ComSignalInitValue=0, ComSignalType=BOOLEAN, ComSystemTemplateSystemSignalRef=DET_HVC_FLAG_252
            DET_IDM_249_oRDR_DETECTION_249_252_oPCAN_RADAR_e1f10bc0_Tx: ComBitPosition=63, ComBitSize=1, ComSignalInitValue=0, ComSignalType=BOOLEAN, ComSystemTemplateSystemSignalRef=DET_IDM_249
            DET_IDM_250_oRDR_DETECTION_249_252_oPCAN_RADAR_84d17964_Tx: ComBitPosition=175, ComBitSize=1, ComSignalInitValue=0, ComSignalType=BOOLEAN, ComSystemTemplateSystemSignalRef=DET_IDM_250
            DET_IDM_251_oRDR_DETECTION_249_252_oPCAN_RADAR_11a1adf1_Tx: ComBitPosition=287, ComBitSize=1, ComSignalInitValue=0, ComSignalType=BOOLEAN, ComSystemTemplateSystemSignalRef=DET_IDM_251
            DET_IDM_252_oRDR_DETECTION_249_252_oPCAN_RADAR_7541d60f_Tx: ComBitPosition=399, ComBitSize=1, ComSignalInitValue=0, ComSignalType=BOOLEAN, ComSystemTemplateSystemSignalRef=DET_IDM_252
            DET_MH_CRC16_249_252_oRDR_DETECTION_249_252_oPCAN_RADAR_5cc2525b_Tx: ComBitPosition=0, ComBitSize=16, ComSignalInitValue=0, ComSignalType=UINT16, ComSystemTemplateSystemSignalRef=DET_MH_CRC16_249_252
            DET_MH_CYCLE_COUNTER_249_252_oRDR_DETECTION_249_252_oPCAN_RADAR_d8b7f36c_Tx: ComBitPosition=16, ComBitSize=8, ComSignalInitValue=0, ComSignalType=UINT8, ComSystemTemplateSystemSignalRef=DET_MH_CYCLE_COUNTER_249_252
            DET_MH_SCAN_INDEX_4LSB_249_252_oRDR_DETECTION_249_252_oPCAN_RADAR_149dd6e0_Tx: ComBitPosition=476, ComBitSize=4, ComSignalInitValue=0, ComSignalType=UINT8, ComSystemTemplateSystemSignalRef=DET_MH_SCAN_INDEX_4LSB_249_252
            DET_MTD_249_oRDR_DETECTION_249_252_oPCAN_RADAR_8742391b_Tx: ComBitPosition=47, ComBitSize=1, ComSignalInitValue=0, ComSignalType=BOOLEAN, ComSystemTemplateSystemSignalRef=DET_MTD_249
            DET_MTD_250_oRDR_DETECTION_249_252_oPCAN_RADAR_e2624bbf_Tx: ComBitPosition=159, ComBitSize=1, ComSignalInitValue=0, ComSignalType=BOOLEAN, ComSystemTemplateSystemSignalRef=DET_MTD_250
            DET_MTD_251_oRDR_DETECTION_249_252_oPCAN_RADAR_77129f2a_Tx: ComBitPosition=271, ComBitSize=1, ComSignalInitValue=0, ComSignalType=BOOLEAN, ComSystemTemplateSystemSignalRef=DET_MTD_251
            DET_MTD_252_oRDR_DETECTION_249_252_oPCAN_RADAR_13f2e4d4_Tx: ComBitPosition=383, ComBitSize=1, ComSignalInitValue=0, ComSignalType=BOOLEAN, ComSystemTemplateSystemSignalRef=DET_MTD_252
            DET_PROB_1STAZHYPO_249_oRDR_DETECTION_249_252_oPCAN_RADAR_14f6d1d6_Tx: ComBitPosition=103, ComBitSize=1, ComSignalInitValue=0, ComSignalType=BOOLEAN, ComSystemTemplateSystemSignalRef=DET_PROB_1STAZHYPO_249
            DET_PROB_1STAZHYPO_250_oRDR_DETECTION_249_252_oPCAN_RADAR_71d6a372_Tx: ComBitPosition=215, ComBitSize=1, ComSignalInitValue=0, ComSignalType=BOOLEAN, ComSystemTemplateSystemSignalRef=DET_PROB_1STAZHYPO_250
            DET_PROB_1STAZHYPO_251_oRDR_DETECTION_249_252_oPCAN_RADAR_e4a677e7_Tx: ComBitPosition=327, ComBitSize=1, ComSignalInitValue=0, ComSignalType=BOOLEAN, ComSystemTemplateSystemSignalRef=DET_PROB_1STAZHYPO_251
            DET_PROB_1STAZHYPO_252_oRDR_DETECTION_249_252_oPCAN_RADAR_80460c19_Tx: ComBitPosition=439, ComBitSize=1, ComSignalInitValue=0, ComSignalType=BOOLEAN, ComSystemTemplateSystemSignalRef=DET_PROB_1STAZHYPO_252
            DET_RANGE_249_oRDR_DETECTION_249_252_oPCAN_RADAR_1f5932a0_Tx: ComBitPosition=24, ComBitSize=15, ComSignalInitValue=0, ComSignalType=UINT16, ComSystemTemplateSystemSignalRef=DET_RANGE_249
            DET_RANGE_250_oRDR_DETECTION_249_252_oPCAN_RADAR_7a794004_Tx: ComBitPosition=136, ComBitSize=15, ComSignalInitValue=0, ComSignalType=UINT16, ComSystemTemplateSystemSignalRef=DET_RANGE_250
            DET_RANGE_251_oRDR_DETECTION_249_252_oPCAN_RADAR_ef099491_Tx: ComBitPosition=248, ComBitSize=15, ComSignalInitValue=0, ComSignalType=UINT16, ComSystemTemplateSystemSignalRef=DET_RANGE_251
            DET_RANGE_252_oRDR_DETECTION_249_252_oPCAN_RADAR_8be9ef6f_Tx: ComBitPosition=360, ComBitSize=15, ComSignalInitValue=0, ComSignalType=UINT16, ComSystemTemplateSystemSignalRef=DET_RANGE_252
            DET_RANGE_ERR_249_oRDR_DETECTION_249_252_oPCAN_RADAR_b8b188c9_Tx: ComBitPosition=40, ComBitSize=7, ComSignalInitValue=0, ComSignalType=UINT8, ComSystemTemplateSystemSignalRef=DET_RANGE_ERR_249
            DET_RANGE_ERR_250_oRDR_DETECTION_249_252_oPCAN_RADAR_dd91fa6d_Tx: ComBitPosition=152, ComBitSize=7, ComSignalInitValue=0, ComSignalType=UINT8, ComSystemTemplateSystemSignalRef=DET_RANGE_ERR_250
            DET_RANGE_ERR_251_oRDR_DETECTION_249_252_oPCAN_RADAR_48e12ef8_Tx: ComBitPosition=264, ComBitSize=7, ComSignalInitValue=0, ComSignalType=UINT8, ComSystemTemplateSystemSignalRef=DET_RANGE_ERR_251
            DET_RANGE_ERR_252_oRDR_DETECTION_249_252_oPCAN_RADAR_2c015506_Tx: ComBitPosition=376, ComBitSize=7, ComSignalInitValue=0, ComSignalType=UINT8, ComSystemTemplateSystemSignalRef=DET_RANGE_ERR_252
            DET_RANGE_VELOCITY_249_oRDR_DETECTION_249_252_oPCAN_RADAR_6afff085_Tx: ComBitPosition=48, ComBitSize=15, ComSignalInitValue=16384, ComSignalType=UINT16, ComSystemTemplateSystemSignalRef=DET_RANGE_VELOCITY_249
            DET_RANGE_VELOCITY_250_oRDR_DETECTION_249_252_oPCAN_RADAR_0fdf8221_Tx: ComBitPosition=160, ComBitSize=15, ComSignalInitValue=16384, ComSignalType=UINT16, ComSystemTemplateSystemSignalRef=DET_RANGE_VELOCITY_250
            DET_RANGE_VELOCITY_251_oRDR_DETECTION_249_252_oPCAN_RADAR_9aaf56b4_Tx: ComBitPosition=272, ComBitSize=15, ComSignalInitValue=16384, ComSignalType=UINT16, ComSystemTemplateSystemSignalRef=DET_RANGE_VELOCITY_251
            DET_RANGE_VELOCITY_252_oRDR_DETECTION_249_252_oPCAN_RADAR_fe4f2d4a_Tx: ComBitPosition=384, ComBitSize=15, ComSignalInitValue=16384, ComSignalType=UINT16, ComSystemTemplateSystemSignalRef=DET_RANGE_VELOCITY_252
            DET_RANGE_VELOCITY_ERR_249_oRDR_DETECTION_249_252_oPCAN_RADAR_65440b37_Tx: ComBitPosition=64, ComBitSize=8, ComSignalInitValue=0, ComSignalType=UINT8, ComSystemTemplateSystemSignalRef=DET_RANGE_VELOCITY_ERR_249
            DET_RANGE_VELOCITY_ERR_250_oRDR_DETECTION_249_252_oPCAN_RADAR_00647993_Tx: ComBitPosition=176, ComBitSize=8, ComSignalInitValue=0, ComSignalType=UINT8, ComSystemTemplateSystemSignalRef=DET_RANGE_VELOCITY_ERR_250
            DET_RANGE_VELOCITY_ERR_251_oRDR_DETECTION_249_252_oPCAN_RADAR_9514ad06_Tx: ComBitPosition=288, ComBitSize=8, ComSignalInitValue=0, ComSignalType=UINT8, ComSystemTemplateSystemSignalRef=DET_RANGE_VELOCITY_ERR_251
            DET_RANGE_VELOCITY_ERR_252_oRDR_DETECTION_249_252_oPCAN_RADAR_f1f4d6f8_Tx: ComBitPosition=400, ComBitSize=8, ComSignalInitValue=0, ComSignalType=UINT8, ComSystemTemplateSystemSignalRef=DET_RANGE_VELOCITY_ERR_252
            DET_RCS_249_oRDR_DETECTION_249_252_oPCAN_RADAR_ed7fc7df_Tx: ComBitPosition=128, ComBitSize=8, ComSignalInitValue=128, ComSignalType=UINT8, ComSystemTemplateSystemSignalRef=DET_RCS_249
            DET_RCS_250_oRDR_DETECTION_249_252_oPCAN_RADAR_885fb57b_Tx: ComBitPosition=240, ComBitSize=8, ComSignalInitValue=128, ComSignalType=UINT8, ComSystemTemplateSystemSignalRef=DET_RCS_250
            DET_RCS_251_oRDR_DETECTION_249_252_oPCAN_RADAR_1d2f61ee_Tx: ComBitPosition=352, ComBitSize=8, ComSignalInitValue=128, ComSignalType=UINT8, ComSystemTemplateSystemSignalRef=DET_RCS_251
            DET_RCS_252_oRDR_DETECTION_249_252_oPCAN_RADAR_79cf1a10_Tx: ComBitPosition=464, ComBitSize=8, ComSignalInitValue=128, ComSignalType=UINT8, ComSystemTemplateSystemSignalRef=DET_RCS_252
            DET_SNR_249_oRDR_DETECTION_249_252_oPCAN_RADAR_30d193dd_Tx: ComBitPosition=120, ComBitSize=8, ComSignalInitValue=0, ComSignalType=UINT8, ComSystemTemplateSystemSignalRef=DET_SNR_249
            DET_SNR_250_oRDR_DETECTION_249_252_oPCAN_RADAR_55f1e179_Tx: ComBitPosition=232, ComBitSize=8, ComSignalInitValue=0, ComSignalType=UINT8, ComSystemTemplateSystemSignalRef=DET_SNR_250
            DET_SNR_251_oRDR_DETECTION_249_252_oPCAN_RADAR_c08135ec_Tx: ComBitPosition=344, ComBitSize=8, ComSignalInitValue=0, ComSignalType=UINT8, ComSystemTemplateSystemSignalRef=DET_SNR_251
            DET_SNR_252_oRDR_DETECTION_249_252_oPCAN_RADAR_a4614e12_Tx: ComBitPosition=456, ComBitSize=8, ComSignalInitValue=0, ComSignalType=UINT8, ComSystemTemplateSystemSignalRef=DET_SNR_252
            DET_SUPER_RES_TARGET_249_oRDR_DETECTION_249_252_oPCAN_RADAR_0148bbb8_Tx: ComBitPosition=87, ComBitSize=1, ComSignalInitValue=0, ComSignalType=BOOLEAN, ComSystemTemplateSystemSignalRef=DET_SUPER_RES_TARGET_249
            DET_SUPER_RES_TARGET_250_oRDR_DETECTION_249_252_oPCAN_RADAR_6468c91c_Tx: ComBitPosition=199, ComBitSize=1, ComSignalInitValue=0, ComSignalType=BOOLEAN, ComSystemTemplateSystemSignalRef=DET_SUPER_RES_TARGET_250
            DET_SUPER_RES_TARGET_251_oRDR_DETECTION_249_252_oPCAN_RADAR_f1181d89_Tx: ComBitPosition=311, ComBitSize=1, ComSignalInitValue=0, ComSignalType=BOOLEAN, ComSystemTemplateSystemSignalRef=DET_SUPER_RES_TARGET_251
            DET_SUPER_RES_TARGET_252_oRDR_DETECTION_249_252_oPCAN_RADAR_95f86677_Tx: ComBitPosition=423, ComBitSize=1, ComSignalInitValue=0, ComSignalType=BOOLEAN, ComSystemTemplateSystemSignalRef=DET_SUPER_RES_TARGET_252
        SG_Detections_253_256_oRDR_DETECTION_253_256_oPCAN_RADAR_ea41e878_Tx: ComSystemTemplateSignalGroupRef=SG_Detections_253_256
          83 x ComGroupSignal, all with ComSignalEndianness=LITTLE_ENDIAN, ComTransferProperty=PENDING:
            DET_AZIMUTH_253_oRDR_DETECTION_253_256_oPCAN_RADAR_13c54b6f_Tx: ComBitPosition=88, ComBitSize=13, ComSignalInitValue=0, ComSignalType=UINT16, ComSystemTemplateSystemSignalRef=DET_AZIMUTH_253
            DET_AZIMUTH_254_oRDR_DETECTION_253_256_oPCAN_RADAR_4f756806_Tx: ComBitPosition=200, ComBitSize=13, ComSignalInitValue=0, ComSignalType=UINT16, ComSystemTemplateSystemSignalRef=DET_AZIMUTH_254
            DET_AZIMUTH_255_oRDR_DETECTION_253_256_oPCAN_RADAR_da05bc93_Tx: ComBitPosition=312, ComBitSize=13, ComSignalInitValue=0, ComSignalType=UINT16, ComSystemTemplateSystemSignalRef=DET_AZIMUTH_255
            DET_AZIMUTH_256_oRDR_DETECTION_253_256_oPCAN_RADAR_bee5c76d_Tx: ComBitPosition=424, ComBitSize=13, ComSignalInitValue=0, ComSignalType=UINT16, ComSystemTemplateSystemSignalRef=DET_AZIMUTH_256
            DET_AZIMUTH_ERR_253_oRDR_DETECTION_253_256_oPCAN_RADAR_b770de9a_Tx: ComBitPosition=105, ComBitSize=7, ComSignalInitValue=0, ComSignalType=UINT8, ComSystemTemplateSystemSignalRef=DET_AZIMUTH_ERR_253
            DET_AZIMUTH_ERR_254_oRDR_DETECTION_253_256_oPCAN_RADAR_ebc0fdf3_Tx: ComBitPosition=217, ComBitSize=7, ComSignalInitValue=0, ComSignalType=UINT8, ComSystemTemplateSystemSignalRef=DET_AZIMUTH_ERR_254
            DET_AZIMUTH_ERR_255_oRDR_DETECTION_253_256_oPCAN_RADAR_7eb02966_Tx: ComBitPosition=329, ComBitSize=7, ComSignalInitValue=0, ComSignalType=UINT8, ComSystemTemplateSystemSignalRef=DET_AZIMUTH_ERR_255
            DET_AZIMUTH_ERR_256_oRDR_DETECTION_253_256_oPCAN_RADAR_1a505298_Tx: ComBitPosition=441, ComBitSize=7, ComSignalInitValue=0, ComSignalType=UINT8, ComSystemTemplateSystemSignalRef=DET_AZIMUTH_ERR_256
            DET_BELOW_RAIN_THOLD_253_oRDR_DETECTION_253_256_oPCAN_RADAR_c6c4d8af_Tx: ComBitPosition=39, ComBitSize=1, ComSignalInitValue=0, ComSignalType=BOOLEAN, ComSystemTemplateSystemSignalRef=DET_BELOW_RAIN_THOLD_253
            DET_BELOW_RAIN_THOLD_254_oRDR_DETECTION_253_256_oPCAN_RADAR_9a74fbc6_Tx: ComBitPosition=151, ComBitSize=1, ComSignalInitValue=0, ComSignalType=BOOLEAN, ComSystemTemplateSystemSignalRef=DET_BELOW_RAIN_THOLD_254
            DET_BELOW_RAIN_THOLD_255_oRDR_DETECTION_253_256_oPCAN_RADAR_0f042f53_Tx: ComBitPosition=263, ComBitSize=1, ComSignalInitValue=0, ComSignalType=BOOLEAN, ComSystemTemplateSystemSignalRef=DET_BELOW_RAIN_THOLD_255
            DET_BELOW_RAIN_THOLD_256_oRDR_DETECTION_253_256_oPCAN_RADAR_6be454ad_Tx: ComBitPosition=375, ComBitSize=1, ComSignalInitValue=0, ComSignalType=BOOLEAN, ComSystemTemplateSystemSignalRef=DET_BELOW_RAIN_THOLD_256
            DET_BI_STATIC_FLAG_253_oRDR_DETECTION_253_256_oPCAN_RADAR_45e90bea_Tx: ComBitPosition=104, ComBitSize=1, ComSignalInitValue=0, ComSignalType=BOOLEAN, ComSystemTemplateSystemSignalRef=DET_BI_STATIC_FLAG_253
            DET_BI_STATIC_FLAG_254_oRDR_DETECTION_253_256_oPCAN_RADAR_19592883_Tx: ComBitPosition=216, ComBitSize=1, ComSignalInitValue=0, ComSignalType=BOOLEAN, ComSystemTemplateSystemSignalRef=DET_BI_STATIC_FLAG_254
            DET_BI_STATIC_FLAG_255_oRDR_DETECTION_253_256_oPCAN_RADAR_8c29fc16_Tx: ComBitPosition=328, ComBitSize=1, ComSignalInitValue=0, ComSignalType=BOOLEAN, ComSystemTemplateSystemSignalRef=DET_BI_STATIC_FLAG_255
            DET_BI_STATIC_FLAG_256_oRDR_DETECTION_253_256_oPCAN_RADAR_e8c987e8_Tx: ComBitPosition=440, ComBitSize=1, ComSignalInitValue=0, ComSignalType=BOOLEAN, ComSystemTemplateSystemSignalRef=DET_BI_STATIC_FLAG_256
            DET_CONFD_AZIMUTH_253_oRDR_DETECTION_253_256_oPCAN_RADAR_112341a5_Tx: ComBitPosition=118, ComBitSize=2, ComSignalInitValue=0, ComSignalType=UINT8, ComSystemTemplateSystemSignalRef=DET_CONFD_AZIMUTH_253
            DET_CONFD_AZIMUTH_254_oRDR_DETECTION_253_256_oPCAN_RADAR_4d9362cc_Tx: ComBitPosition=230, ComBitSize=2, ComSignalInitValue=0, ComSignalType=UINT8, ComSystemTemplateSystemSignalRef=DET_CONFD_AZIMUTH_254
            DET_CONFD_AZIMUTH_255_oRDR_DETECTION_253_256_oPCAN_RADAR_d8e3b659_Tx: ComBitPosition=342, ComBitSize=2, ComSignalInitValue=0, ComSignalType=UINT8, ComSystemTemplateSystemSignalRef=DET_CONFD_AZIMUTH_255
            DET_CONFD_AZIMUTH_256_oRDR_DETECTION_253_256_oPCAN_RADAR_bc03cda7_Tx: ComBitPosition=454, ComBitSize=2, ComSignalInitValue=0, ComSignalType=UINT8, ComSystemTemplateSystemSignalRef=DET_CONFD_AZIMUTH_256
            DET_CONFD_ELEVATION_253_oRDR_DETECTION_253_256_oPCAN_RADAR_13b6405f_Tx: ComBitPosition=101, ComBitSize=2, ComSignalInitValue=0, ComSignalType=UINT8, ComSystemTemplateSystemSignalRef=DET_CONFD_ELEVATION_253
            DET_CONFD_ELEVATION_254_oRDR_DETECTION_253_256_oPCAN_RADAR_4f066336_Tx: ComBitPosition=213, ComBitSize=2, ComSignalInitValue=0, ComSignalType=UINT8, ComSystemTemplateSystemSignalRef=DET_CONFD_ELEVATION_254
            DET_CONFD_ELEVATION_255_oRDR_DETECTION_253_256_oPCAN_RADAR_da76b7a3_Tx: ComBitPosition=325, ComBitSize=2, ComSignalInitValue=0, ComSignalType=UINT8, ComSystemTemplateSystemSignalRef=DET_CONFD_ELEVATION_255
            DET_CONFD_ELEVATION_256_oRDR_DETECTION_253_256_oPCAN_RADAR_be96cc5d_Tx: ComBitPosition=437, ComBitSize=2, ComSignalInitValue=0, ComSignalType=UINT8, ComSystemTemplateSystemSignalRef=DET_CONFD_ELEVATION_256
            DET_ELEVATION_253_oRDR_DETECTION_253_256_oPCAN_RADAR_c2769463_Tx: ComBitPosition=72, ComBitSize=8, ComSignalInitValue=0, ComSignalType=UINT8, ComSystemTemplateSystemSignalRef=DET_ELEVATION_253
            DET_ELEVATION_254_oRDR_DETECTION_253_256_oPCAN_RADAR_9ec6b70a_Tx: ComBitPosition=184, ComBitSize=8, ComSignalInitValue=0, ComSignalType=UINT8, ComSystemTemplateSystemSignalRef=DET_ELEVATION_254
            DET_ELEVATION_255_oRDR_DETECTION_253_256_oPCAN_RADAR_0bb6639f_Tx: ComBitPosition=296, ComBitSize=8, ComSignalInitValue=0, ComSignalType=UINT8, ComSystemTemplateSystemSignalRef=DET_ELEVATION_255
            DET_ELEVATION_256_oRDR_DETECTION_253_256_oPCAN_RADAR_6f561861_Tx: ComBitPosition=408, ComBitSize=8, ComSignalInitValue=0, ComSignalType=UINT8, ComSystemTemplateSystemSignalRef=DET_ELEVATION_256
            DET_ELEVATION_ERR_253_oRDR_DETECTION_253_256_oPCAN_RADAR_454f0c16_Tx: ComBitPosition=80, ComBitSize=6, ComSignalInitValue=0, ComSignalType=UINT8, ComSystemTemplateSystemSignalRef=DET_ELEVATION_ERR_253
            DET_ELEVATION_ERR_254_oRDR_DETECTION_253_256_oPCAN_RADAR_19ff2f7f_Tx: ComBitPosition=192, ComBitSize=6, ComSignalInitValue=0, ComSignalType=UINT8, ComSystemTemplateSystemSignalRef=DET_ELEVATION_ERR_254
            DET_ELEVATION_ERR_255_oRDR_DETECTION_253_256_oPCAN_RADAR_8c8ffbea_Tx: ComBitPosition=304, ComBitSize=6, ComSignalInitValue=0, ComSignalType=UINT8, ComSystemTemplateSystemSignalRef=DET_ELEVATION_ERR_255
            DET_ELEVATION_ERR_256_oRDR_DETECTION_253_256_oPCAN_RADAR_e86f8014_Tx: ComBitPosition=416, ComBitSize=6, ComSignalInitValue=0, ComSignalType=UINT8, ComSystemTemplateSystemSignalRef=DET_ELEVATION_ERR_256
            DET_EXISTENCE_PROB_253_oRDR_DETECTION_253_256_oPCAN_RADAR_97d07976_Tx: ComBitPosition=112, ComBitSize=6, ComSignalInitValue=0, ComSignalType=UINT8, ComSystemTemplateSystemSignalRef=DET_EXISTENCE_PROB_253
            DET_EXISTENCE_PROB_254_oRDR_DETECTION_253_256_oPCAN_RADAR_cb605a1f_Tx: ComBitPosition=224, ComBitSize=6, ComSignalInitValue=0, ComSignalType=UINT8, ComSystemTemplateSystemSignalRef=DET_EXISTENCE_PROB_254
            DET_EXISTENCE_PROB_255_oRDR_DETECTION_253_256_oPCAN_RADAR_5e108e8a_Tx: ComBitPosition=336, ComBitSize=6, ComSignalInitValue=0, ComSignalType=UINT8, ComSystemTemplateSystemSignalRef=DET_EXISTENCE_PROB_255
            DET_EXISTENCE_PROB_256_oRDR_DETECTION_253_256_oPCAN_RADAR_3af0f574_Tx: ComBitPosition=448, ComBitSize=6, ComSignalInitValue=0, ComSignalType=UINT8, ComSystemTemplateSystemSignalRef=DET_EXISTENCE_PROB_256
            DET_HVC_FLAG_253_oRDR_DETECTION_253_256_oPCAN_RADAR_76a43a09_Tx: ComBitPosition=86, ComBitSize=1, ComSignalInitValue=0, ComSignalType=BOOLEAN, ComSystemTemplateSystemSignalRef=DET_HVC_FLAG_253
            DET_HVC_FLAG_254_oRDR_DETECTION_253_256_oPCAN_RADAR_2a141960_Tx: ComBitPosition=198, ComBitSize=1, ComSignalInitValue=0, ComSignalType=BOOLEAN, ComSystemTemplateSystemSignalRef=DET_HVC_FLAG_254
            DET_HVC_FLAG_255_oRDR_DETECTION_253_256_oPCAN_RADAR_bf64cdf5_Tx: ComBitPosition=310, ComBitSize=1, ComSignalInitValue=0, ComSignalType=BOOLEAN, ComSystemTemplateSystemSignalRef=DET_HVC_FLAG_255
            DET_HVC_FLAG_256_oRDR_DETECTION_253_256_oPCAN_RADAR_db84b60b_Tx: ComBitPosition=422, ComBitSize=1, ComSignalInitValue=0, ComSignalType=BOOLEAN, ComSystemTemplateSystemSignalRef=DET_HVC_FLAG_256
            DET_IDM_253_oRDR_DETECTION_253_256_oPCAN_RADAR_fdf601b4_Tx: ComBitPosition=63, ComBitSize=1, ComSignalInitValue=0, ComSignalType=BOOLEAN, ComSystemTemplateSystemSignalRef=DET_IDM_253
            DET_IDM_254_oRDR_DETECTION_253_256_oPCAN_RADAR_a14622dd_Tx: ComBitPosition=175, ComBitSize=1, ComSignalInitValue=0, ComSignalType=BOOLEAN, ComSystemTemplateSystemSignalRef=DET_IDM_254
            DET_IDM_255_oRDR_DETECTION_253_256_oPCAN_RADAR_3436f648_Tx: ComBitPosition=287, ComBitSize=1, ComSignalInitValue=0, ComSignalType=BOOLEAN, ComSystemTemplateSystemSignalRef=DET_IDM_255
            DET_IDM_256_oRDR_DETECTION_253_256_oPCAN_RADAR_50d68db6_Tx: ComBitPosition=399, ComBitSize=1, ComSignalInitValue=0, ComSignalType=BOOLEAN, ComSystemTemplateSystemSignalRef=DET_IDM_256
            DET_MH_CRC16_253_256_oRDR_DETECTION_253_256_oPCAN_RADAR_6ec93a73_Tx: ComBitPosition=0, ComBitSize=16, ComSignalInitValue=0, ComSignalType=UINT16, ComSystemTemplateSystemSignalRef=DET_MH_CRC16_253_256
            DET_MH_CYCLE_COUNTER_253_256_oRDR_DETECTION_253_256_oPCAN_RADAR_eabc9b44_Tx: ComBitPosition=16, ComBitSize=8, ComSignalInitValue=0, ComSignalType=UINT8, ComSystemTemplateSystemSignalRef=DET_MH_CYCLE_COUNTER_253_256
            DET_MH_SCAN_INDEX_4LSB_253_256_oRDR_DETECTION_253_256_oPCAN_RADAR_2696bec8_Tx: ComBitPosition=476, ComBitSize=4, ComSignalInitValue=0, ComSignalType=UINT8, ComSystemTemplateSystemSignalRef=DET_MH_SCAN_INDEX_4LSB_253_256
            DET_MTD_253_oRDR_DETECTION_253_256_oPCAN_RADAR_9b45336f_Tx: ComBitPosition=47, ComBitSize=1, ComSignalInitValue=0, ComSignalType=BOOLEAN, ComSystemTemplateSystemSignalRef=DET_MTD_253
            DET_MTD_254_oRDR_DETECTION_253_256_oPCAN_RADAR_c7f51006_Tx: ComBitPosition=159, ComBitSize=1, ComSignalInitValue=0, ComSignalType=BOOLEAN, ComSystemTemplateSystemSignalRef=DET_MTD_254
            DET_MTD_255_oRDR_DETECTION_253_256_oPCAN_RADAR_5285c493_Tx: ComBitPosition=271, ComBitSize=1, ComSignalInitValue=0, ComSignalType=BOOLEAN, ComSystemTemplateSystemSignalRef=DET_MTD_255
            DET_MTD_256_oRDR_DETECTION_253_256_oPCAN_RADAR_3665bf6d_Tx: ComBitPosition=383, ComBitSize=1, ComSignalInitValue=0, ComSignalType=BOOLEAN, ComSystemTemplateSystemSignalRef=DET_MTD_256
            DET_PROB_1STAZHYPO_253_oRDR_DETECTION_253_256_oPCAN_RADAR_08f1dba2_Tx: ComBitPosition=103, ComBitSize=1, ComSignalInitValue=0, ComSignalType=BOOLEAN, ComSystemTemplateSystemSignalRef=DET_PROB_1STAZHYPO_253
            DET_PROB_1STAZHYPO_254_oRDR_DETECTION_253_256_oPCAN_RADAR_5441f8cb_Tx: ComBitPosition=215, ComBitSize=1, ComSignalInitValue=0, ComSignalType=BOOLEAN, ComSystemTemplateSystemSignalRef=DET_PROB_1STAZHYPO_254
            DET_PROB_1STAZHYPO_255_oRDR_DETECTION_253_256_oPCAN_RADAR_c1312c5e_Tx: ComBitPosition=327, ComBitSize=1, ComSignalInitValue=0, ComSignalType=BOOLEAN, ComSystemTemplateSystemSignalRef=DET_PROB_1STAZHYPO_255
            DET_PROB_1STAZHYPO_256_oRDR_DETECTION_253_256_oPCAN_RADAR_a5d157a0_Tx: ComBitPosition=439, ComBitSize=1, ComSignalInitValue=0, ComSignalType=BOOLEAN, ComSystemTemplateSystemSignalRef=DET_PROB_1STAZHYPO_256
            DET_RANGE_253_oRDR_DETECTION_253_256_oPCAN_RADAR_035e38d4_Tx: ComBitPosition=24, ComBitSize=15, ComSignalInitValue=0, ComSignalType=UINT16, ComSystemTemplateSystemSignalRef=DET_RANGE_253
            DET_RANGE_254_oRDR_DETECTION_253_256_oPCAN_RADAR_5fee1bbd_Tx: ComBitPosition=136, ComBitSize=15, ComSignalInitValue=0, ComSignalType=UINT16, ComSystemTemplateSystemSignalRef=DET_RANGE_254
            DET_RANGE_255_oRDR_DETECTION_253_256_oPCAN_RADAR_ca9ecf28_Tx: ComBitPosition=248, ComBitSize=15, ComSignalInitValue=0, ComSignalType=UINT16, ComSystemTemplateSystemSignalRef=DET_RANGE_255
            DET_RANGE_256_oRDR_DETECTION_253_256_oPCAN_RADAR_ae7eb4d6_Tx: ComBitPosition=360, ComBitSize=15, ComSignalInitValue=0, ComSignalType=UINT16, ComSystemTemplateSystemSignalRef=DET_RANGE_256
            DET_RANGE_ERR_253_oRDR_DETECTION_253_256_oPCAN_RADAR_a4b682bd_Tx: ComBitPosition=40, ComBitSize=7, ComSignalInitValue=0, ComSignalType=UINT8, ComSystemTemplateSystemSignalRef=DET_RANGE_ERR_253
            DET_RANGE_ERR_254_oRDR_DETECTION_253_256_oPCAN_RADAR_f806a1d4_Tx: ComBitPosition=152, ComBitSize=7, ComSignalInitValue=0, ComSignalType=UINT8, ComSystemTemplateSystemSignalRef=DET_RANGE_ERR_254
            DET_RANGE_ERR_255_oRDR_DETECTION_253_256_oPCAN_RADAR_6d767541_Tx: ComBitPosition=264, ComBitSize=7, ComSignalInitValue=0, ComSignalType=UINT8, ComSystemTemplateSystemSignalRef=DET_RANGE_ERR_255
            DET_RANGE_ERR_256_oRDR_DETECTION_253_256_oPCAN_RADAR_09960ebf_Tx: ComBitPosition=376, ComBitSize=7, ComSignalInitValue=0, ComSignalType=UINT8, ComSystemTemplateSystemSignalRef=DET_RANGE_ERR_256
            DET_RANGE_VELOCITY_253_oRDR_DETECTION_253_256_oPCAN_RADAR_76f8faf1_Tx: ComBitPosition=48, ComBitSize=15, ComSignalInitValue=16384, ComSignalType=UINT16, ComSystemTemplateSystemSignalRef=DET_RANGE_VELOCITY_253
            DET_RANGE_VELOCITY_254_oRDR_DETECTION_253_256_oPCAN_RADAR_2a48d998_Tx: ComBitPosition=160, ComBitSize=15, ComSignalInitValue=16384, ComSignalType=UINT16, ComSystemTemplateSystemSignalRef=DET_RANGE_VELOCITY_254
            DET_RANGE_VELOCITY_255_oRDR_DETECTION_253_256_oPCAN_RADAR_bf380d0d_Tx: ComBitPosition=272, ComBitSize=15, ComSignalInitValue=16384, ComSignalType=UINT16, ComSystemTemplateSystemSignalRef=DET_RANGE_VELOCITY_255
            DET_RANGE_VELOCITY_256_oRDR_DETECTION_253_256_oPCAN_RADAR_dbd876f3_Tx: ComBitPosition=384, ComBitSize=15, ComSignalInitValue=16384, ComSignalType=UINT16, ComSystemTemplateSystemSignalRef=DET_RANGE_VELOCITY_256
            DET_RANGE_VELOCITY_ERR_253_oRDR_DETECTION_253_256_oPCAN_RADAR_79430143_Tx: ComBitPosition=64, ComBitSize=8, ComSignalInitValue=0, ComSignalType=UINT8, ComSystemTemplateSystemSignalRef=DET_RANGE_VELOCITY_ERR_253
            DET_RANGE_VELOCITY_ERR_254_oRDR_DETECTION_253_256_oPCAN_RADAR_25f3222a_Tx: ComBitPosition=176, ComBitSize=8, ComSignalInitValue=0, ComSignalType=UINT8, ComSystemTemplateSystemSignalRef=DET_RANGE_VELOCITY_ERR_254
            DET_RANGE_VELOCITY_ERR_255_oRDR_DETECTION_253_256_oPCAN_RADAR_b083f6bf_Tx: ComBitPosition=288, ComBitSize=8, ComSignalInitValue=0, ComSignalType=UINT8, ComSystemTemplateSystemSignalRef=DET_RANGE_VELOCITY_ERR_255
            DET_RANGE_VELOCITY_ERR_256_oRDR_DETECTION_253_256_oPCAN_RADAR_d4638d41_Tx: ComBitPosition=400, ComBitSize=8, ComSignalInitValue=0, ComSignalType=UINT8, ComSystemTemplateSystemSignalRef=DET_RANGE_VELOCITY_ERR_256
            DET_RCS_253_oRDR_DETECTION_253_256_oPCAN_RADAR_f178cdab_Tx: ComBitPosition=128, ComBitSize=8, ComSignalInitValue=128, ComSignalType=UINT8, ComSystemTemplateSystemSignalRef=DET_RCS_253
            DET_RCS_254_oRDR_DETECTION_253_256_oPCAN_RADAR_adc8eec2_Tx: ComBitPosition=240, ComBitSize=8, ComSignalInitValue=128, ComSignalType=UINT8, ComSystemTemplateSystemSignalRef=DET_RCS_254
            DET_RCS_255_oRDR_DETECTION_253_256_oPCAN_RADAR_38b83a57_Tx: ComBitPosition=352, ComBitSize=8, ComSignalInitValue=128, ComSignalType=UINT8, ComSystemTemplateSystemSignalRef=DET_RCS_255
            DET_RCS_256_oRDR_DETECTION_253_256_oPCAN_RADAR_5c5841a9_Tx: ComBitPosition=464, ComBitSize=8, ComSignalInitValue=128, ComSignalType=UINT8, ComSystemTemplateSystemSignalRef=DET_RCS_256
            DET_SNR_253_oRDR_DETECTION_253_256_oPCAN_RADAR_2cd699a9_Tx: ComBitPosition=120, ComBitSize=8, ComSignalInitValue=0, ComSignalType=UINT8, ComSystemTemplateSystemSignalRef=DET_SNR_253
            DET_SNR_254_oRDR_DETECTION_253_256_oPCAN_RADAR_7066bac0_Tx: ComBitPosition=232, ComBitSize=8, ComSignalInitValue=0, ComSignalType=UINT8, ComSystemTemplateSystemSignalRef=DET_SNR_254
            DET_SNR_255_oRDR_DETECTION_253_256_oPCAN_RADAR_e5166e55_Tx: ComBitPosition=344, ComBitSize=8, ComSignalInitValue=0, ComSignalType=UINT8, ComSystemTemplateSystemSignalRef=DET_SNR_255
            DET_SNR_256_oRDR_DETECTION_253_256_oPCAN_RADAR_81f615ab_Tx: ComBitPosition=456, ComBitSize=8, ComSignalInitValue=0, ComSignalType=UINT8, ComSystemTemplateSystemSignalRef=DET_SNR_256
            DET_SUPER_RES_TARGET_253_oRDR_DETECTION_253_256_oPCAN_RADAR_1d4fb1cc_Tx: ComBitPosition=87, ComBitSize=1, ComSignalInitValue=0, ComSignalType=BOOLEAN, ComSystemTemplateSystemSignalRef=DET_SUPER_RES_TARGET_253
            DET_SUPER_RES_TARGET_254_oRDR_DETECTION_253_256_oPCAN_RADAR_41ff92a5_Tx: ComBitPosition=199, ComBitSize=1, ComSignalInitValue=0, ComSignalType=BOOLEAN, ComSystemTemplateSystemSignalRef=DET_SUPER_RES_TARGET_254
            DET_SUPER_RES_TARGET_255_oRDR_DETECTION_253_256_oPCAN_RADAR_d48f4630_Tx: ComBitPosition=311, ComBitSize=1, ComSignalInitValue=0, ComSignalType=BOOLEAN, ComSystemTemplateSystemSignalRef=DET_SUPER_RES_TARGET_255
            DET_SUPER_RES_TARGET_256_oRDR_DETECTION_253_256_oPCAN_RADAR_b06f3dce_Tx: ComBitPosition=423, ComBitSize=1, ComSignalInitValue=0, ComSignalType=BOOLEAN, ComSystemTemplateSystemSignalRef=DET_SUPER_RES_TARGET_256
        SG_Detections_257_260_oRDR_DETECTION_257_260_oPCAN_RADAR_06edbef2_Tx: ComSystemTemplateSignalGroupRef=SG_Detections_257_260
          83 x ComGroupSignal, all with ComSignalEndianness=LITTLE_ENDIAN, ComTransferProperty=PENDING:
            DET_AZIMUTH_257_oRDR_DETECTION_257_260_oPCAN_RADAR_8419ce31_Tx: ComBitPosition=88, ComBitSize=13, ComSignalInitValue=0, ComSignalType=UINT16, ComSystemTemplateSystemSignalRef=DET_AZIMUTH_257
            DET_AZIMUTH_258_oRDR_DETECTION_257_260_oPCAN_RADAR_a8095c76_Tx: ComBitPosition=200, ComBitSize=13, ComSignalInitValue=0, ComSignalType=UINT16, ComSystemTemplateSystemSignalRef=DET_AZIMUTH_258
            DET_AZIMUTH_259_oRDR_DETECTION_257_260_oPCAN_RADAR_3d7988e3_Tx: ComBitPosition=312, ComBitSize=13, ComSignalInitValue=0, ComSignalType=UINT16, ComSystemTemplateSystemSignalRef=DET_AZIMUTH_259
            DET_AZIMUTH_260_oRDR_DETECTION_257_260_oPCAN_RADAR_82c8d238_Tx: ComBitPosition=424, ComBitSize=13, ComSignalInitValue=0, ComSignalType=UINT16, ComSystemTemplateSystemSignalRef=DET_AZIMUTH_260
            DET_AZIMUTH_ERR_257_oRDR_DETECTION_257_260_oPCAN_RADAR_20ac5bc4_Tx: ComBitPosition=105, ComBitSize=7, ComSignalInitValue=0, ComSignalType=UINT8, ComSystemTemplateSystemSignalRef=DET_AZIMUTH_ERR_257
            DET_AZIMUTH_ERR_258_oRDR_DETECTION_257_260_oPCAN_RADAR_0cbcc983_Tx: ComBitPosition=217, ComBitSize=7, ComSignalInitValue=0, ComSignalType=UINT8, ComSystemTemplateSystemSignalRef=DET_AZIMUTH_ERR_258
            DET_AZIMUTH_ERR_259_oRDR_DETECTION_257_260_oPCAN_RADAR_99cc1d16_Tx: ComBitPosition=329, ComBitSize=7, ComSignalInitValue=0, ComSignalType=UINT8, ComSystemTemplateSystemSignalRef=DET_AZIMUTH_ERR_259
            DET_AZIMUTH_ERR_260_oRDR_DETECTION_257_260_oPCAN_RADAR_267d47cd_Tx: ComBitPosition=441, ComBitSize=7, ComSignalInitValue=0, ComSignalType=UINT8, ComSystemTemplateSystemSignalRef=DET_AZIMUTH_ERR_260
            DET_BELOW_RAIN_THOLD_257_oRDR_DETECTION_257_260_oPCAN_RADAR_51185df1_Tx: ComBitPosition=39, ComBitSize=1, ComSignalInitValue=0, ComSignalType=BOOLEAN, ComSystemTemplateSystemSignalRef=DET_BELOW_RAIN_THOLD_257
            DET_BELOW_RAIN_THOLD_258_oRDR_DETECTION_257_260_oPCAN_RADAR_7d08cfb6_Tx: ComBitPosition=151, ComBitSize=1, ComSignalInitValue=0, ComSignalType=BOOLEAN, ComSystemTemplateSystemSignalRef=DET_BELOW_RAIN_THOLD_258
            DET_BELOW_RAIN_THOLD_259_oRDR_DETECTION_257_260_oPCAN_RADAR_e8781b23_Tx: ComBitPosition=263, ComBitSize=1, ComSignalInitValue=0, ComSignalType=BOOLEAN, ComSystemTemplateSystemSignalRef=DET_BELOW_RAIN_THOLD_259
            DET_BELOW_RAIN_THOLD_260_oRDR_DETECTION_257_260_oPCAN_RADAR_57c941f8_Tx: ComBitPosition=375, ComBitSize=1, ComSignalInitValue=0, ComSignalType=BOOLEAN, ComSystemTemplateSystemSignalRef=DET_BELOW_RAIN_THOLD_260
            DET_BI_STATIC_FLAG_257_oRDR_DETECTION_257_260_oPCAN_RADAR_d2358eb4_Tx: ComBitPosition=104, ComBitSize=1, ComSignalInitValue=0, ComSignalType=BOOLEAN, ComSystemTemplateSystemSignalRef=DET_BI_STATIC_FLAG_257
            DET_BI_STATIC_FLAG_258_oRDR_DETECTION_257_260_oPCAN_RADAR_fe251cf3_Tx: ComBitPosition=216, ComBitSize=1, ComSignalInitValue=0, ComSignalType=BOOLEAN, ComSystemTemplateSystemSignalRef=DET_BI_STATIC_FLAG_258
            DET_BI_STATIC_FLAG_259_oRDR_DETECTION_257_260_oPCAN_RADAR_6b55c866_Tx: ComBitPosition=328, ComBitSize=1, ComSignalInitValue=0, ComSignalType=BOOLEAN, ComSystemTemplateSystemSignalRef=DET_BI_STATIC_FLAG_259
            DET_BI_STATIC_FLAG_260_oRDR_DETECTION_257_260_oPCAN_RADAR_d4e492bd_Tx: ComBitPosition=440, ComBitSize=1, ComSignalInitValue=0, ComSignalType=BOOLEAN, ComSystemTemplateSystemSignalRef=DET_BI_STATIC_FLAG_260
            DET_CONFD_AZIMUTH_257_oRDR_DETECTION_257_260_oPCAN_RADAR_86ffc4fb_Tx: ComBitPosition=118, ComBitSize=2, ComSignalInitValue=0, ComSignalType=UINT8, ComSystemTemplateSystemSignalRef=DET_CONFD_AZIMUTH_257
            DET_CONFD_AZIMUTH_258_oRDR_DETECTION_257_260_oPCAN_RADAR_aaef56bc_Tx: ComBitPosition=230, ComBitSize=2, ComSignalInitValue=0, ComSignalType=UINT8, ComSystemTemplateSystemSignalRef=DET_CONFD_AZIMUTH_258
            DET_CONFD_AZIMUTH_259_oRDR_DETECTION_257_260_oPCAN_RADAR_3f9f8229_Tx: ComBitPosition=342, ComBitSize=2, ComSignalInitValue=0, ComSignalType=UINT8, ComSystemTemplateSystemSignalRef=DET_CONFD_AZIMUTH_259
            DET_CONFD_AZIMUTH_260_oRDR_DETECTION_257_260_oPCAN_RADAR_802ed8f2_Tx: ComBitPosition=454, ComBitSize=2, ComSignalInitValue=0, ComSignalType=UINT8, ComSystemTemplateSystemSignalRef=DET_CONFD_AZIMUTH_260
            DET_CONFD_ELEVATION_257_oRDR_DETECTION_257_260_oPCAN_RADAR_846ac501_Tx: ComBitPosition=101, ComBitSize=2, ComSignalInitValue=0, ComSignalType=UINT8, ComSystemTemplateSystemSignalRef=DET_CONFD_ELEVATION_257
            DET_CONFD_ELEVATION_258_oRDR_DETECTION_257_260_oPCAN_RADAR_a87a5746_Tx: ComBitPosition=213, ComBitSize=2, ComSignalInitValue=0, ComSignalType=UINT8, ComSystemTemplateSystemSignalRef=DET_CONFD_ELEVATION_258
            DET_CONFD_ELEVATION_259_oRDR_DETECTION_257_260_oPCAN_RADAR_3d0a83d3_Tx: ComBitPosition=325, ComBitSize=2, ComSignalInitValue=0, ComSignalType=UINT8, ComSystemTemplateSystemSignalRef=DET_CONFD_ELEVATION_259
            DET_CONFD_ELEVATION_260_oRDR_DETECTION_257_260_oPCAN_RADAR_82bbd908_Tx: ComBitPosition=437, ComBitSize=2, ComSignalInitValue=0, ComSignalType=UINT8, ComSystemTemplateSystemSignalRef=DET_CONFD_ELEVATION_260
            DET_ELEVATION_257_oRDR_DETECTION_257_260_oPCAN_RADAR_55aa113d_Tx: ComBitPosition=72, ComBitSize=8, ComSignalInitValue=0, ComSignalType=UINT8, ComSystemTemplateSystemSignalRef=DET_ELEVATION_257
            DET_ELEVATION_258_oRDR_DETECTION_257_260_oPCAN_RADAR_79ba837a_Tx: ComBitPosition=184, ComBitSize=8, ComSignalInitValue=0, ComSignalType=UINT8, ComSystemTemplateSystemSignalRef=DET_ELEVATION_258
            DET_ELEVATION_259_oRDR_DETECTION_257_260_oPCAN_RADAR_ecca57ef_Tx: ComBitPosition=296, ComBitSize=8, ComSignalInitValue=0, ComSignalType=UINT8, ComSystemTemplateSystemSignalRef=DET_ELEVATION_259
            DET_ELEVATION_260_oRDR_DETECTION_257_260_oPCAN_RADAR_537b0d34_Tx: ComBitPosition=408, ComBitSize=8, ComSignalInitValue=0, ComSignalType=UINT8, ComSystemTemplateSystemSignalRef=DET_ELEVATION_260
            DET_ELEVATION_ERR_257_oRDR_DETECTION_257_260_oPCAN_RADAR_d2938948_Tx: ComBitPosition=80, ComBitSize=6, ComSignalInitValue=0, ComSignalType=UINT8, ComSystemTemplateSystemSignalRef=DET_ELEVATION_ERR_257
            DET_ELEVATION_ERR_258_oRDR_DETECTION_257_260_oPCAN_RADAR_fe831b0f_Tx: ComBitPosition=192, ComBitSize=6, ComSignalInitValue=0, ComSignalType=UINT8, ComSystemTemplateSystemSignalRef=DET_ELEVATION_ERR_258
            DET_ELEVATION_ERR_259_oRDR_DETECTION_257_260_oPCAN_RADAR_6bf3cf9a_Tx: ComBitPosition=304, ComBitSize=6, ComSignalInitValue=0, ComSignalType=UINT8, ComSystemTemplateSystemSignalRef=DET_ELEVATION_ERR_259
            DET_ELEVATION_ERR_260_oRDR_DETECTION_257_260_oPCAN_RADAR_d4429541_Tx: ComBitPosition=416, ComBitSize=6, ComSignalInitValue=0, ComSignalType=UINT8, ComSystemTemplateSystemSignalRef=DET_ELEVATION_ERR_260
            DET_EXISTENCE_PROB_257_oRDR_DETECTION_257_260_oPCAN_RADAR_000cfc28_Tx: ComBitPosition=112, ComBitSize=6, ComSignalInitValue=0, ComSignalType=UINT8, ComSystemTemplateSystemSignalRef=DET_EXISTENCE_PROB_257
            DET_EXISTENCE_PROB_258_oRDR_DETECTION_257_260_oPCAN_RADAR_2c1c6e6f_Tx: ComBitPosition=224, ComBitSize=6, ComSignalInitValue=0, ComSignalType=UINT8, ComSystemTemplateSystemSignalRef=DET_EXISTENCE_PROB_258
            DET_EXISTENCE_PROB_259_oRDR_DETECTION_257_260_oPCAN_RADAR_b96cbafa_Tx: ComBitPosition=336, ComBitSize=6, ComSignalInitValue=0, ComSignalType=UINT8, ComSystemTemplateSystemSignalRef=DET_EXISTENCE_PROB_259
            DET_EXISTENCE_PROB_260_oRDR_DETECTION_257_260_oPCAN_RADAR_06dde021_Tx: ComBitPosition=448, ComBitSize=6, ComSignalInitValue=0, ComSignalType=UINT8, ComSystemTemplateSystemSignalRef=DET_EXISTENCE_PROB_260
            DET_HVC_FLAG_257_oRDR_DETECTION_257_260_oPCAN_RADAR_e178bf57_Tx: ComBitPosition=86, ComBitSize=1, ComSignalInitValue=0, ComSignalType=BOOLEAN, ComSystemTemplateSystemSignalRef=DET_HVC_FLAG_257
            DET_HVC_FLAG_258_oRDR_DETECTION_257_260_oPCAN_RADAR_cd682d10_Tx: ComBitPosition=198, ComBitSize=1, ComSignalInitValue=0, ComSignalType=BOOLEAN, ComSystemTemplateSystemSignalRef=DET_HVC_FLAG_258
            DET_HVC_FLAG_259_oRDR_DETECTION_257_260_oPCAN_RADAR_5818f985_Tx: ComBitPosition=310, ComBitSize=1, ComSignalInitValue=0, ComSignalType=BOOLEAN, ComSystemTemplateSystemSignalRef=DET_HVC_FLAG_259
            DET_HVC_FLAG_260_oRDR_DETECTION_257_260_oPCAN_RADAR_e7a9a35e_Tx: ComBitPosition=422, ComBitSize=1, ComSignalInitValue=0, ComSignalType=BOOLEAN, ComSystemTemplateSystemSignalRef=DET_HVC_FLAG_260
            DET_IDM_257_oRDR_DETECTION_257_260_oPCAN_RADAR_6a2a84ea_Tx: ComBitPosition=63, ComBitSize=1, ComSignalInitValue=0, ComSignalType=BOOLEAN, ComSystemTemplateSystemSignalRef=DET_IDM_257
            DET_IDM_258_oRDR_DETECTION_257_260_oPCAN_RADAR_463a16ad_Tx: ComBitPosition=175, ComBitSize=1, ComSignalInitValue=0, ComSignalType=BOOLEAN, ComSystemTemplateSystemSignalRef=DET_IDM_258
            DET_IDM_259_oRDR_DETECTION_257_260_oPCAN_RADAR_d34ac238_Tx: ComBitPosition=287, ComBitSize=1, ComSignalInitValue=0, ComSignalType=BOOLEAN, ComSystemTemplateSystemSignalRef=DET_IDM_259
            DET_IDM_260_oRDR_DETECTION_257_260_oPCAN_RADAR_6cfb98e3_Tx: ComBitPosition=399, ComBitSize=1, ComSignalInitValue=0, ComSignalType=BOOLEAN, ComSystemTemplateSystemSignalRef=DET_IDM_260
            DET_MH_CRC16_257_260_oRDR_DETECTION_257_260_oPCAN_RADAR_82656cf9_Tx: ComBitPosition=0, ComBitSize=16, ComSignalInitValue=0, ComSignalType=UINT16, ComSystemTemplateSystemSignalRef=DET_MH_CRC16_257_260
            DET_MH_CYCLE_COUNTER_257_260_oRDR_DETECTION_257_260_oPCAN_RADAR_0610cdce_Tx: ComBitPosition=16, ComBitSize=8, ComSignalInitValue=0, ComSignalType=UINT8, ComSystemTemplateSystemSignalRef=DET_MH_CYCLE_COUNTER_257_260
            DET_MH_SCAN_INDEX_4LSB_257_260_oRDR_DETECTION_257_260_oPCAN_RADAR_ca3ae842_Tx: ComBitPosition=476, ComBitSize=4, ComSignalInitValue=0, ComSignalType=UINT8, ComSystemTemplateSystemSignalRef=DET_MH_SCAN_INDEX_4LSB_257_260
            DET_MTD_257_oRDR_DETECTION_257_260_oPCAN_RADAR_0c99b631_Tx: ComBitPosition=47, ComBitSize=1, ComSignalInitValue=0, ComSignalType=BOOLEAN, ComSystemTemplateSystemSignalRef=DET_MTD_257
            DET_MTD_258_oRDR_DETECTION_257_260_oPCAN_RADAR_20892476_Tx: ComBitPosition=159, ComBitSize=1, ComSignalInitValue=0, ComSignalType=BOOLEAN, ComSystemTemplateSystemSignalRef=DET_MTD_258
            DET_MTD_259_oRDR_DETECTION_257_260_oPCAN_RADAR_b5f9f0e3_Tx: ComBitPosition=271, ComBitSize=1, ComSignalInitValue=0, ComSignalType=BOOLEAN, ComSystemTemplateSystemSignalRef=DET_MTD_259
            DET_MTD_260_oRDR_DETECTION_257_260_oPCAN_RADAR_0a48aa38_Tx: ComBitPosition=383, ComBitSize=1, ComSignalInitValue=0, ComSignalType=BOOLEAN, ComSystemTemplateSystemSignalRef=DET_MTD_260
            DET_PROB_1STAZHYPO_257_oRDR_DETECTION_257_260_oPCAN_RADAR_9f2d5efc_Tx: ComBitPosition=103, ComBitSize=1, ComSignalInitValue=0, ComSignalType=BOOLEAN, ComSystemTemplateSystemSignalRef=DET_PROB_1STAZHYPO_257
            DET_PROB_1STAZHYPO_258_oRDR_DETECTION_257_260_oPCAN_RADAR_b33dccbb_Tx: ComBitPosition=215, ComBitSize=1, ComSignalInitValue=0, ComSignalType=BOOLEAN, ComSystemTemplateSystemSignalRef=DET_PROB_1STAZHYPO_258
            DET_PROB_1STAZHYPO_259_oRDR_DETECTION_257_260_oPCAN_RADAR_264d182e_Tx: ComBitPosition=327, ComBitSize=1, ComSignalInitValue=0, ComSignalType=BOOLEAN, ComSystemTemplateSystemSignalRef=DET_PROB_1STAZHYPO_259
            DET_PROB_1STAZHYPO_260_oRDR_DETECTION_257_260_oPCAN_RADAR_99fc42f5_Tx: ComBitPosition=439, ComBitSize=1, ComSignalInitValue=0, ComSignalType=BOOLEAN, ComSystemTemplateSystemSignalRef=DET_PROB_1STAZHYPO_260
            DET_RANGE_257_oRDR_DETECTION_257_260_oPCAN_RADAR_9482bd8a_Tx: ComBitPosition=24, ComBitSize=15, ComSignalInitValue=0, ComSignalType=UINT16, ComSystemTemplateSystemSignalRef=DET_RANGE_257
            DET_RANGE_258_oRDR_DETECTION_257_260_oPCAN_RADAR_b8922fcd_Tx: ComBitPosition=136, ComBitSize=15, ComSignalInitValue=0, ComSignalType=UINT16, ComSystemTemplateSystemSignalRef=DET_RANGE_258
            DET_RANGE_259_oRDR_DETECTION_257_260_oPCAN_RADAR_2de2fb58_Tx: ComBitPosition=248, ComBitSize=15, ComSignalInitValue=0, ComSignalType=UINT16, ComSystemTemplateSystemSignalRef=DET_RANGE_259
            DET_RANGE_260_oRDR_DETECTION_257_260_oPCAN_RADAR_9253a183_Tx: ComBitPosition=360, ComBitSize=15, ComSignalInitValue=0, ComSignalType=UINT16, ComSystemTemplateSystemSignalRef=DET_RANGE_260
            DET_RANGE_ERR_257_oRDR_DETECTION_257_260_oPCAN_RADAR_336a07e3_Tx: ComBitPosition=40, ComBitSize=7, ComSignalInitValue=0, ComSignalType=UINT8, ComSystemTemplateSystemSignalRef=DET_RANGE_ERR_257
            DET_RANGE_ERR_258_oRDR_DETECTION_257_260_oPCAN_RADAR_1f7a95a4_Tx: ComBitPosition=152, ComBitSize=7, ComSignalInitValue=0, ComSignalType=UINT8, ComSystemTemplateSystemSignalRef=DET_RANGE_ERR_258
            DET_RANGE_ERR_259_oRDR_DETECTION_257_260_oPCAN_RADAR_8a0a4131_Tx: ComBitPosition=264, ComBitSize=7, ComSignalInitValue=0, ComSignalType=UINT8, ComSystemTemplateSystemSignalRef=DET_RANGE_ERR_259
            DET_RANGE_ERR_260_oRDR_DETECTION_257_260_oPCAN_RADAR_35bb1bea_Tx: ComBitPosition=376, ComBitSize=7, ComSignalInitValue=0, ComSignalType=UINT8, ComSystemTemplateSystemSignalRef=DET_RANGE_ERR_260
            DET_RANGE_VELOCITY_257_oRDR_DETECTION_257_260_oPCAN_RADAR_e1247faf_Tx: ComBitPosition=48, ComBitSize=15, ComSignalInitValue=16384, ComSignalType=UINT16, ComSystemTemplateSystemSignalRef=DET_RANGE_VELOCITY_257
            DET_RANGE_VELOCITY_258_oRDR_DETECTION_257_260_oPCAN_RADAR_cd34ede8_Tx: ComBitPosition=160, ComBitSize=15, ComSignalInitValue=16384, ComSignalType=UINT16, ComSystemTemplateSystemSignalRef=DET_RANGE_VELOCITY_258
            DET_RANGE_VELOCITY_259_oRDR_DETECTION_257_260_oPCAN_RADAR_5844397d_Tx: ComBitPosition=272, ComBitSize=15, ComSignalInitValue=16384, ComSignalType=UINT16, ComSystemTemplateSystemSignalRef=DET_RANGE_VELOCITY_259
            DET_RANGE_VELOCITY_260_oRDR_DETECTION_257_260_oPCAN_RADAR_e7f563a6_Tx: ComBitPosition=384, ComBitSize=15, ComSignalInitValue=16384, ComSignalType=UINT16, ComSystemTemplateSystemSignalRef=DET_RANGE_VELOCITY_260
            DET_RANGE_VELOCITY_ERR_257_oRDR_DETECTION_257_260_oPCAN_RADAR_ee9f841d_Tx: ComBitPosition=64, ComBitSize=8, ComSignalInitValue=0, ComSignalType=UINT8, ComSystemTemplateSystemSignalRef=DET_RANGE_VELOCITY_ERR_257
            DET_RANGE_VELOCITY_ERR_258_oRDR_DETECTION_257_260_oPCAN_RADAR_c28f165a_Tx: ComBitPosition=176, ComBitSize=8, ComSignalInitValue=0, ComSignalType=UINT8, ComSystemTemplateSystemSignalRef=DET_RANGE_VELOCITY_ERR_258
            DET_RANGE_VELOCITY_ERR_259_oRDR_DETECTION_257_260_oPCAN_RADAR_57ffc2cf_Tx: ComBitPosition=288, ComBitSize=8, ComSignalInitValue=0, ComSignalType=UINT8, ComSystemTemplateSystemSignalRef=DET_RANGE_VELOCITY_ERR_259
            DET_RANGE_VELOCITY_ERR_260_oRDR_DETECTION_257_260_oPCAN_RADAR_e84e9814_Tx: ComBitPosition=400, ComBitSize=8, ComSignalInitValue=0, ComSignalType=UINT8, ComSystemTemplateSystemSignalRef=DET_RANGE_VELOCITY_ERR_260
            DET_RCS_257_oRDR_DETECTION_257_260_oPCAN_RADAR_66a448f5_Tx: ComBitPosition=128, ComBitSize=8, ComSignalInitValue=128, ComSignalType=UINT8, ComSystemTemplateSystemSignalRef=DET_RCS_257
            DET_RCS_258_oRDR_DETECTION_257_260_oPCAN_RADAR_4ab4dab2_Tx: ComBitPosition=240, ComBitSize=8, ComSignalInitValue=128, ComSignalType=UINT8, ComSystemTemplateSystemSignalRef=DET_RCS_258
            DET_RCS_259_oRDR_DETECTION_257_260_oPCAN_RADAR_dfc40e27_Tx: ComBitPosition=352, ComBitSize=8, ComSignalInitValue=128, ComSignalType=UINT8, ComSystemTemplateSystemSignalRef=DET_RCS_259
            DET_RCS_260_oRDR_DETECTION_257_260_oPCAN_RADAR_607554fc_Tx: ComBitPosition=464, ComBitSize=8, ComSignalInitValue=128, ComSignalType=UINT8, ComSystemTemplateSystemSignalRef=DET_RCS_260
            DET_SNR_257_oRDR_DETECTION_257_260_oPCAN_RADAR_bb0a1cf7_Tx: ComBitPosition=120, ComBitSize=8, ComSignalInitValue=0, ComSignalType=UINT8, ComSystemTemplateSystemSignalRef=DET_SNR_257
            DET_SNR_258_oRDR_DETECTION_257_260_oPCAN_RADAR_971a8eb0_Tx: ComBitPosition=232, ComBitSize=8, ComSignalInitValue=0, ComSignalType=UINT8, ComSystemTemplateSystemSignalRef=DET_SNR_258
            DET_SNR_259_oRDR_DETECTION_257_260_oPCAN_RADAR_026a5a25_Tx: ComBitPosition=344, ComBitSize=8, ComSignalInitValue=0, ComSignalType=UINT8, ComSystemTemplateSystemSignalRef=DET_SNR_259
            DET_SNR_260_oRDR_DETECTION_257_260_oPCAN_RADAR_bddb00fe_Tx: ComBitPosition=456, ComBitSize=8, ComSignalInitValue=0, ComSignalType=UINT8, ComSystemTemplateSystemSignalRef=DET_SNR_260
            DET_SUPER_RES_TARGET_257_oRDR_DETECTION_257_260_oPCAN_RADAR_8a933492_Tx: ComBitPosition=87, ComBitSize=1, ComSignalInitValue=0, ComSignalType=BOOLEAN, ComSystemTemplateSystemSignalRef=DET_SUPER_RES_TARGET_257
            DET_SUPER_RES_TARGET_258_oRDR_DETECTION_257_260_oPCAN_RADAR_a683a6d5_Tx: ComBitPosition=199, ComBitSize=1, ComSignalInitValue=0, ComSignalType=BOOLEAN, ComSystemTemplateSystemSignalRef=DET_SUPER_RES_TARGET_258
            DET_SUPER_RES_TARGET_259_oRDR_DETECTION_257_260_oPCAN_RADAR_33f37240_Tx: ComBitPosition=311, ComBitSize=1, ComSignalInitValue=0, ComSignalType=BOOLEAN, ComSystemTemplateSystemSignalRef=DET_SUPER_RES_TARGET_259
            DET_SUPER_RES_TARGET_260_oRDR_DETECTION_257_260_oPCAN_RADAR_8c42289b_Tx: ComBitPosition=423, ComBitSize=1, ComSignalInitValue=0, ComSignalType=BOOLEAN, ComSystemTemplateSystemSignalRef=DET_SUPER_RES_TARGET_260
        SG_Detections_261_264_oRDR_DETECTION_261_264_oPCAN_RADAR_0586302b_Tx: ComSystemTemplateSignalGroupRef=SG_Detections_261_264
          83 x ComGroupSignal, all with ComSignalEndianness=LITTLE_ENDIAN, ComTransferProperty=PENDING:
            DET_AZIMUTH_261_oRDR_DETECTION_261_264_oPCAN_RADAR_9ab30651_Tx: ComBitPosition=88, ComBitSize=13, ComSignalInitValue=0, ComSignalType=UINT16, ComSystemTemplateSystemSignalRef=DET_AZIMUTH_261
            DET_AZIMUTH_262_oRDR_DETECTION_261_264_oPCAN_RADAR_fe537daf_Tx: ComBitPosition=200, ComBitSize=13, ComSignalInitValue=0, ComSignalType=UINT16, ComSystemTemplateSystemSignalRef=DET_AZIMUTH_262
            DET_AZIMUTH_263_oRDR_DETECTION_261_264_oPCAN_RADAR_6b23a93a_Tx: ComBitPosition=312, ComBitSize=13, ComSignalInitValue=0, ComSignalType=UINT16, ComSystemTemplateSystemSignalRef=DET_AZIMUTH_263
            DET_AZIMUTH_264_oRDR_DETECTION_261_264_oPCAN_RADAR_37938a53_Tx: ComBitPosition=424, ComBitSize=13, ComSignalInitValue=0, ComSignalType=UINT16, ComSystemTemplateSystemSignalRef=DET_AZIMUTH_264
            DET_AZIMUTH_ERR_261_oRDR_DETECTION_261_264_oPCAN_RADAR_3e0693a4_Tx: ComBitPosition=105, ComBitSize=7, ComSignalInitValue=0, ComSignalType=UINT8, ComSystemTemplateSystemSignalRef=DET_AZIMUTH_ERR_261
            DET_AZIMUTH_ERR_262_oRDR_DETECTION_261_264_oPCAN_RADAR_5ae6e85a_Tx: ComBitPosition=217, ComBitSize=7, ComSignalInitValue=0, ComSignalType=UINT8, ComSystemTemplateSystemSignalRef=DET_AZIMUTH_ERR_262
            DET_AZIMUTH_ERR_263_oRDR_DETECTION_261_264_oPCAN_RADAR_cf963ccf_Tx: ComBitPosition=329, ComBitSize=7, ComSignalInitValue=0, ComSignalType=UINT8, ComSystemTemplateSystemSignalRef=DET_AZIMUTH_ERR_263
            DET_AZIMUTH_ERR_264_oRDR_DETECTION_261_264_oPCAN_RADAR_93261fa6_Tx: ComBitPosition=441, ComBitSize=7, ComSignalInitValue=0, ComSignalType=UINT8, ComSystemTemplateSystemSignalRef=DET_AZIMUTH_ERR_264
            DET_BELOW_RAIN_THOLD_261_oRDR_DETECTION_261_264_oPCAN_RADAR_4fb29591_Tx: ComBitPosition=39, ComBitSize=1, ComSignalInitValue=0, ComSignalType=BOOLEAN, ComSystemTemplateSystemSignalRef=DET_BELOW_RAIN_THOLD_261
            DET_BELOW_RAIN_THOLD_262_oRDR_DETECTION_261_264_oPCAN_RADAR_2b52ee6f_Tx: ComBitPosition=151, ComBitSize=1, ComSignalInitValue=0, ComSignalType=BOOLEAN, ComSystemTemplateSystemSignalRef=DET_BELOW_RAIN_THOLD_262
            DET_BELOW_RAIN_THOLD_263_oRDR_DETECTION_261_264_oPCAN_RADAR_be223afa_Tx: ComBitPosition=263, ComBitSize=1, ComSignalInitValue=0, ComSignalType=BOOLEAN, ComSystemTemplateSystemSignalRef=DET_BELOW_RAIN_THOLD_263
            DET_BELOW_RAIN_THOLD_264_oRDR_DETECTION_261_264_oPCAN_RADAR_e2921993_Tx: ComBitPosition=375, ComBitSize=1, ComSignalInitValue=0, ComSignalType=BOOLEAN, ComSystemTemplateSystemSignalRef=DET_BELOW_RAIN_THOLD_264
            DET_BI_STATIC_FLAG_261_oRDR_DETECTION_261_264_oPCAN_RADAR_cc9f46d4_Tx: ComBitPosition=104, ComBitSize=1, ComSignalInitValue=0, ComSignalType=BOOLEAN, ComSystemTemplateSystemSignalRef=DET_BI_STATIC_FLAG_261
            DET_BI_STATIC_FLAG_262_oRDR_DETECTION_261_264_oPCAN_RADAR_a87f3d2a_Tx: ComBitPosition=216, ComBitSize=1, ComSignalInitValue=0, ComSignalType=BOOLEAN, ComSystemTemplateSystemSignalRef=DET_BI_STATIC_FLAG_262
            DET_BI_STATIC_FLAG_263_oRDR_DETECTION_261_264_oPCAN_RADAR_3d0fe9bf_Tx: ComBitPosition=328, ComBitSize=1, ComSignalInitValue=0, ComSignalType=BOOLEAN, ComSystemTemplateSystemSignalRef=DET_BI_STATIC_FLAG_263
            DET_BI_STATIC_FLAG_264_oRDR_DETECTION_261_264_oPCAN_RADAR_61bfcad6_Tx: ComBitPosition=440, ComBitSize=1, ComSignalInitValue=0, ComSignalType=BOOLEAN, ComSystemTemplateSystemSignalRef=DET_BI_STATIC_FLAG_264
            DET_CONFD_AZIMUTH_261_oRDR_DETECTION_261_264_oPCAN_RADAR_98550c9b_Tx: ComBitPosition=118, ComBitSize=2, ComSignalInitValue=0, ComSignalType=UINT8, ComSystemTemplateSystemSignalRef=DET_CONFD_AZIMUTH_261
            DET_CONFD_AZIMUTH_262_oRDR_DETECTION_261_264_oPCAN_RADAR_fcb57765_Tx: ComBitPosition=230, ComBitSize=2, ComSignalInitValue=0, ComSignalType=UINT8, ComSystemTemplateSystemSignalRef=DET_CONFD_AZIMUTH_262
            DET_CONFD_AZIMUTH_263_oRDR_DETECTION_261_264_oPCAN_RADAR_69c5a3f0_Tx: ComBitPosition=342, ComBitSize=2, ComSignalInitValue=0, ComSignalType=UINT8, ComSystemTemplateSystemSignalRef=DET_CONFD_AZIMUTH_263
            DET_CONFD_AZIMUTH_264_oRDR_DETECTION_261_264_oPCAN_RADAR_35758099_Tx: ComBitPosition=454, ComBitSize=2, ComSignalInitValue=0, ComSignalType=UINT8, ComSystemTemplateSystemSignalRef=DET_CONFD_AZIMUTH_264
            DET_CONFD_ELEVATION_261_oRDR_DETECTION_261_264_oPCAN_RADAR_9ac00d61_Tx: ComBitPosition=101, ComBitSize=2, ComSignalInitValue=0, ComSignalType=UINT8, ComSystemTemplateSystemSignalRef=DET_CONFD_ELEVATION_261
            DET_CONFD_ELEVATION_262_oRDR_DETECTION_261_264_oPCAN_RADAR_fe20769f_Tx: ComBitPosition=213, ComBitSize=2, ComSignalInitValue=0, ComSignalType=UINT8, ComSystemTemplateSystemSignalRef=DET_CONFD_ELEVATION_262
            DET_CONFD_ELEVATION_263_oRDR_DETECTION_261_264_oPCAN_RADAR_6b50a20a_Tx: ComBitPosition=325, ComBitSize=2, ComSignalInitValue=0, ComSignalType=UINT8, ComSystemTemplateSystemSignalRef=DET_CONFD_ELEVATION_263
            DET_CONFD_ELEVATION_264_oRDR_DETECTION_261_264_oPCAN_RADAR_37e08163_Tx: ComBitPosition=437, ComBitSize=2, ComSignalInitValue=0, ComSignalType=UINT8, ComSystemTemplateSystemSignalRef=DET_CONFD_ELEVATION_264
            DET_ELEVATION_261_oRDR_DETECTION_261_264_oPCAN_RADAR_4b00d95d_Tx: ComBitPosition=72, ComBitSize=8, ComSignalInitValue=0, ComSignalType=UINT8, ComSystemTemplateSystemSignalRef=DET_ELEVATION_261
            DET_ELEVATION_262_oRDR_DETECTION_261_264_oPCAN_RADAR_2fe0a2a3_Tx: ComBitPosition=184, ComBitSize=8, ComSignalInitValue=0, ComSignalType=UINT8, ComSystemTemplateSystemSignalRef=DET_ELEVATION_262
            DET_ELEVATION_263_oRDR_DETECTION_261_264_oPCAN_RADAR_ba907636_Tx: ComBitPosition=296, ComBitSize=8, ComSignalInitValue=0, ComSignalType=UINT8, ComSystemTemplateSystemSignalRef=DET_ELEVATION_263
            DET_ELEVATION_264_oRDR_DETECTION_261_264_oPCAN_RADAR_e620555f_Tx: ComBitPosition=408, ComBitSize=8, ComSignalInitValue=0, ComSignalType=UINT8, ComSystemTemplateSystemSignalRef=DET_ELEVATION_264
            DET_ELEVATION_ERR_261_oRDR_DETECTION_261_264_oPCAN_RADAR_cc394128_Tx: ComBitPosition=80, ComBitSize=6, ComSignalInitValue=0, ComSignalType=UINT8, ComSystemTemplateSystemSignalRef=DET_ELEVATION_ERR_261
            DET_ELEVATION_ERR_262_oRDR_DETECTION_261_264_oPCAN_RADAR_a8d93ad6_Tx: ComBitPosition=192, ComBitSize=6, ComSignalInitValue=0, ComSignalType=UINT8, ComSystemTemplateSystemSignalRef=DET_ELEVATION_ERR_262
            DET_ELEVATION_ERR_263_oRDR_DETECTION_261_264_oPCAN_RADAR_3da9ee43_Tx: ComBitPosition=304, ComBitSize=6, ComSignalInitValue=0, ComSignalType=UINT8, ComSystemTemplateSystemSignalRef=DET_ELEVATION_ERR_263
            DET_ELEVATION_ERR_264_oRDR_DETECTION_261_264_oPCAN_RADAR_6119cd2a_Tx: ComBitPosition=416, ComBitSize=6, ComSignalInitValue=0, ComSignalType=UINT8, ComSystemTemplateSystemSignalRef=DET_ELEVATION_ERR_264
            DET_EXISTENCE_PROB_261_oRDR_DETECTION_261_264_oPCAN_RADAR_1ea63448_Tx: ComBitPosition=112, ComBitSize=6, ComSignalInitValue=0, ComSignalType=UINT8, ComSystemTemplateSystemSignalRef=DET_EXISTENCE_PROB_261
            DET_EXISTENCE_PROB_262_oRDR_DETECTION_261_264_oPCAN_RADAR_7a464fb6_Tx: ComBitPosition=224, ComBitSize=6, ComSignalInitValue=0, ComSignalType=UINT8, ComSystemTemplateSystemSignalRef=DET_EXISTENCE_PROB_262
            DET_EXISTENCE_PROB_263_oRDR_DETECTION_261_264_oPCAN_RADAR_ef369b23_Tx: ComBitPosition=336, ComBitSize=6, ComSignalInitValue=0, ComSignalType=UINT8, ComSystemTemplateSystemSignalRef=DET_EXISTENCE_PROB_263
            DET_EXISTENCE_PROB_264_oRDR_DETECTION_261_264_oPCAN_RADAR_b386b84a_Tx: ComBitPosition=448, ComBitSize=6, ComSignalInitValue=0, ComSignalType=UINT8, ComSystemTemplateSystemSignalRef=DET_EXISTENCE_PROB_264
            DET_HVC_FLAG_261_oRDR_DETECTION_261_264_oPCAN_RADAR_ffd27737_Tx: ComBitPosition=86, ComBitSize=1, ComSignalInitValue=0, ComSignalType=BOOLEAN, ComSystemTemplateSystemSignalRef=DET_HVC_FLAG_261
            DET_HVC_FLAG_262_oRDR_DETECTION_261_264_oPCAN_RADAR_9b320cc9_Tx: ComBitPosition=198, ComBitSize=1, ComSignalInitValue=0, ComSignalType=BOOLEAN, ComSystemTemplateSystemSignalRef=DET_HVC_FLAG_262
            DET_HVC_FLAG_263_oRDR_DETECTION_261_264_oPCAN_RADAR_0e42d85c_Tx: ComBitPosition=310, ComBitSize=1, ComSignalInitValue=0, ComSignalType=BOOLEAN, ComSystemTemplateSystemSignalRef=DET_HVC_FLAG_263
            DET_HVC_FLAG_264_oRDR_DETECTION_261_264_oPCAN_RADAR_52f2fb35_Tx: ComBitPosition=422, ComBitSize=1, ComSignalInitValue=0, ComSignalType=BOOLEAN, ComSystemTemplateSystemSignalRef=DET_HVC_FLAG_264
            DET_IDM_261_oRDR_DETECTION_261_264_oPCAN_RADAR_74804c8a_Tx: ComBitPosition=63, ComBitSize=1, ComSignalInitValue=0, ComSignalType=BOOLEAN, ComSystemTemplateSystemSignalRef=DET_IDM_261
            DET_IDM_262_oRDR_DETECTION_261_264_oPCAN_RADAR_10603774_Tx: ComBitPosition=175, ComBitSize=1, ComSignalInitValue=0, ComSignalType=BOOLEAN, ComSystemTemplateSystemSignalRef=DET_IDM_262
            DET_IDM_263_oRDR_DETECTION_261_264_oPCAN_RADAR_8510e3e1_Tx: ComBitPosition=287, ComBitSize=1, ComSignalInitValue=0, ComSignalType=BOOLEAN, ComSystemTemplateSystemSignalRef=DET_IDM_263
            DET_IDM_264_oRDR_DETECTION_261_264_oPCAN_RADAR_d9a0c088_Tx: ComBitPosition=399, ComBitSize=1, ComSignalInitValue=0, ComSignalType=BOOLEAN, ComSystemTemplateSystemSignalRef=DET_IDM_264
            DET_MH_CRC16_261_264_oRDR_DETECTION_261_264_oPCAN_RADAR_810ee220_Tx: ComBitPosition=0, ComBitSize=16, ComSignalInitValue=0, ComSignalType=UINT16, ComSystemTemplateSystemSignalRef=DET_MH_CRC16_261_264
            DET_MH_CYCLE_COUNTER_261_264_oRDR_DETECTION_261_264_oPCAN_RADAR_057b4317_Tx: ComBitPosition=16, ComBitSize=8, ComSignalInitValue=0, ComSignalType=UINT8, ComSystemTemplateSystemSignalRef=DET_MH_CYCLE_COUNTER_261_264
            DET_MH_SCAN_INDEX_4LSB_261_264_oRDR_DETECTION_261_264_oPCAN_RADAR_c951669b_Tx: ComBitPosition=476, ComBitSize=4, ComSignalInitValue=0, ComSignalType=UINT8, ComSystemTemplateSystemSignalRef=DET_MH_SCAN_INDEX_4LSB_261_264
            DET_MTD_261_oRDR_DETECTION_261_264_oPCAN_RADAR_12337e51_Tx: ComBitPosition=47, ComBitSize=1, ComSignalInitValue=0, ComSignalType=BOOLEAN, ComSystemTemplateSystemSignalRef=DET_MTD_261
            DET_MTD_262_oRDR_DETECTION_261_264_oPCAN_RADAR_76d305af_Tx: ComBitPosition=159, ComBitSize=1, ComSignalInitValue=0, ComSignalType=BOOLEAN, ComSystemTemplateSystemSignalRef=DET_MTD_262
            DET_MTD_263_oRDR_DETECTION_261_264_oPCAN_RADAR_e3a3d13a_Tx: ComBitPosition=271, ComBitSize=1, ComSignalInitValue=0, ComSignalType=BOOLEAN, ComSystemTemplateSystemSignalRef=DET_MTD_263
            DET_MTD_264_oRDR_DETECTION_261_264_oPCAN_RADAR_bf13f253_Tx: ComBitPosition=383, ComBitSize=1, ComSignalInitValue=0, ComSignalType=BOOLEAN, ComSystemTemplateSystemSignalRef=DET_MTD_264
            DET_PROB_1STAZHYPO_261_oRDR_DETECTION_261_264_oPCAN_RADAR_8187969c_Tx: ComBitPosition=103, ComBitSize=1, ComSignalInitValue=0, ComSignalType=BOOLEAN, ComSystemTemplateSystemSignalRef=DET_PROB_1STAZHYPO_261
            DET_PROB_1STAZHYPO_262_oRDR_DETECTION_261_264_oPCAN_RADAR_e567ed62_Tx: ComBitPosition=215, ComBitSize=1, ComSignalInitValue=0, ComSignalType=BOOLEAN, ComSystemTemplateSystemSignalRef=DET_PROB_1STAZHYPO_262
            DET_PROB_1STAZHYPO_263_oRDR_DETECTION_261_264_oPCAN_RADAR_701739f7_Tx: ComBitPosition=327, ComBitSize=1, ComSignalInitValue=0, ComSignalType=BOOLEAN, ComSystemTemplateSystemSignalRef=DET_PROB_1STAZHYPO_263
            DET_PROB_1STAZHYPO_264_oRDR_DETECTION_261_264_oPCAN_RADAR_2ca71a9e_Tx: ComBitPosition=439, ComBitSize=1, ComSignalInitValue=0, ComSignalType=BOOLEAN, ComSystemTemplateSystemSignalRef=DET_PROB_1STAZHYPO_264
            DET_RANGE_261_oRDR_DETECTION_261_264_oPCAN_RADAR_8a2875ea_Tx: ComBitPosition=24, ComBitSize=15, ComSignalInitValue=0, ComSignalType=UINT16, ComSystemTemplateSystemSignalRef=DET_RANGE_261
            DET_RANGE_262_oRDR_DETECTION_261_264_oPCAN_RADAR_eec80e14_Tx: ComBitPosition=136, ComBitSize=15, ComSignalInitValue=0, ComSignalType=UINT16, ComSystemTemplateSystemSignalRef=DET_RANGE_262
            DET_RANGE_263_oRDR_DETECTION_261_264_oPCAN_RADAR_7bb8da81_Tx: ComBitPosition=248, ComBitSize=15, ComSignalInitValue=0, ComSignalType=UINT16, ComSystemTemplateSystemSignalRef=DET_RANGE_263
            DET_RANGE_264_oRDR_DETECTION_261_264_oPCAN_RADAR_2708f9e8_Tx: ComBitPosition=360, ComBitSize=15, ComSignalInitValue=0, ComSignalType=UINT16, ComSystemTemplateSystemSignalRef=DET_RANGE_264
            DET_RANGE_ERR_261_oRDR_DETECTION_261_264_oPCAN_RADAR_2dc0cf83_Tx: ComBitPosition=40, ComBitSize=7, ComSignalInitValue=0, ComSignalType=UINT8, ComSystemTemplateSystemSignalRef=DET_RANGE_ERR_261
            DET_RANGE_ERR_262_oRDR_DETECTION_261_264_oPCAN_RADAR_4920b47d_Tx: ComBitPosition=152, ComBitSize=7, ComSignalInitValue=0, ComSignalType=UINT8, ComSystemTemplateSystemSignalRef=DET_RANGE_ERR_262
            DET_RANGE_ERR_263_oRDR_DETECTION_261_264_oPCAN_RADAR_dc5060e8_Tx: ComBitPosition=264, ComBitSize=7, ComSignalInitValue=0, ComSignalType=UINT8, ComSystemTemplateSystemSignalRef=DET_RANGE_ERR_263
            DET_RANGE_ERR_264_oRDR_DETECTION_261_264_oPCAN_RADAR_80e04381_Tx: ComBitPosition=376, ComBitSize=7, ComSignalInitValue=0, ComSignalType=UINT8, ComSystemTemplateSystemSignalRef=DET_RANGE_ERR_264
            DET_RANGE_VELOCITY_261_oRDR_DETECTION_261_264_oPCAN_RADAR_ff8eb7cf_Tx: ComBitPosition=48, ComBitSize=15, ComSignalInitValue=16384, ComSignalType=UINT16, ComSystemTemplateSystemSignalRef=DET_RANGE_VELOCITY_261
            DET_RANGE_VELOCITY_262_oRDR_DETECTION_261_264_oPCAN_RADAR_9b6ecc31_Tx: ComBitPosition=160, ComBitSize=15, ComSignalInitValue=16384, ComSignalType=UINT16, ComSystemTemplateSystemSignalRef=DET_RANGE_VELOCITY_262
            DET_RANGE_VELOCITY_263_oRDR_DETECTION_261_264_oPCAN_RADAR_0e1e18a4_Tx: ComBitPosition=272, ComBitSize=15, ComSignalInitValue=16384, ComSignalType=UINT16, ComSystemTemplateSystemSignalRef=DET_RANGE_VELOCITY_263
            DET_RANGE_VELOCITY_264_oRDR_DETECTION_261_264_oPCAN_RADAR_52ae3bcd_Tx: ComBitPosition=384, ComBitSize=15, ComSignalInitValue=16384, ComSignalType=UINT16, ComSystemTemplateSystemSignalRef=DET_RANGE_VELOCITY_264
            DET_RANGE_VELOCITY_ERR_261_oRDR_DETECTION_261_264_oPCAN_RADAR_f0354c7d_Tx: ComBitPosition=64, ComBitSize=8, ComSignalInitValue=0, ComSignalType=UINT8, ComSystemTemplateSystemSignalRef=DET_RANGE_VELOCITY_ERR_261
            DET_RANGE_VELOCITY_ERR_262_oRDR_DETECTION_261_264_oPCAN_RADAR_94d53783_Tx: ComBitPosition=176, ComBitSize=8, ComSignalInitValue=0, ComSignalType=UINT8, ComSystemTemplateSystemSignalRef=DET_RANGE_VELOCITY_ERR_262
            DET_RANGE_VELOCITY_ERR_263_oRDR_DETECTION_261_264_oPCAN_RADAR_01a5e316_Tx: ComBitPosition=288, ComBitSize=8, ComSignalInitValue=0, ComSignalType=UINT8, ComSystemTemplateSystemSignalRef=DET_RANGE_VELOCITY_ERR_263
            DET_RANGE_VELOCITY_ERR_264_oRDR_DETECTION_261_264_oPCAN_RADAR_5d15c07f_Tx: ComBitPosition=400, ComBitSize=8, ComSignalInitValue=0, ComSignalType=UINT8, ComSystemTemplateSystemSignalRef=DET_RANGE_VELOCITY_ERR_264
            DET_RCS_261_oRDR_DETECTION_261_264_oPCAN_RADAR_780e8095_Tx: ComBitPosition=128, ComBitSize=8, ComSignalInitValue=128, ComSignalType=UINT8, ComSystemTemplateSystemSignalRef=DET_RCS_261
            DET_RCS_262_oRDR_DETECTION_261_264_oPCAN_RADAR_1ceefb6b_Tx: ComBitPosition=240, ComBitSize=8, ComSignalInitValue=128, ComSignalType=UINT8, ComSystemTemplateSystemSignalRef=DET_RCS_262
            DET_RCS_263_oRDR_DETECTION_261_264_oPCAN_RADAR_899e2ffe_Tx: ComBitPosition=352, ComBitSize=8, ComSignalInitValue=128, ComSignalType=UINT8, ComSystemTemplateSystemSignalRef=DET_RCS_263
            DET_RCS_264_oRDR_DETECTION_261_264_oPCAN_RADAR_d52e0c97_Tx: ComBitPosition=464, ComBitSize=8, ComSignalInitValue=128, ComSignalType=UINT8, ComSystemTemplateSystemSignalRef=DET_RCS_264
            DET_SNR_261_oRDR_DETECTION_261_264_oPCAN_RADAR_a5a0d497_Tx: ComBitPosition=120, ComBitSize=8, ComSignalInitValue=0, ComSignalType=UINT8, ComSystemTemplateSystemSignalRef=DET_SNR_261
            DET_SNR_262_oRDR_DETECTION_261_264_oPCAN_RADAR_c140af69_Tx: ComBitPosition=232, ComBitSize=8, ComSignalInitValue=0, ComSignalType=UINT8, ComSystemTemplateSystemSignalRef=DET_SNR_262
            DET_SNR_263_oRDR_DETECTION_261_264_oPCAN_RADAR_54307bfc_Tx: ComBitPosition=344, ComBitSize=8, ComSignalInitValue=0, ComSignalType=UINT8, ComSystemTemplateSystemSignalRef=DET_SNR_263
            DET_SNR_264_oRDR_DETECTION_261_264_oPCAN_RADAR_08805895_Tx: ComBitPosition=456, ComBitSize=8, ComSignalInitValue=0, ComSignalType=UINT8, ComSystemTemplateSystemSignalRef=DET_SNR_264
            DET_SUPER_RES_TARGET_261_oRDR_DETECTION_261_264_oPCAN_RADAR_9439fcf2_Tx: ComBitPosition=87, ComBitSize=1, ComSignalInitValue=0, ComSignalType=BOOLEAN, ComSystemTemplateSystemSignalRef=DET_SUPER_RES_TARGET_261
            DET_SUPER_RES_TARGET_262_oRDR_DETECTION_261_264_oPCAN_RADAR_f0d9870c_Tx: ComBitPosition=199, ComBitSize=1, ComSignalInitValue=0, ComSignalType=BOOLEAN, ComSystemTemplateSystemSignalRef=DET_SUPER_RES_TARGET_262
            DET_SUPER_RES_TARGET_263_oRDR_DETECTION_261_264_oPCAN_RADAR_65a95399_Tx: ComBitPosition=311, ComBitSize=1, ComSignalInitValue=0, ComSignalType=BOOLEAN, ComSystemTemplateSystemSignalRef=DET_SUPER_RES_TARGET_263
            DET_SUPER_RES_TARGET_264_oRDR_DETECTION_261_264_oPCAN_RADAR_391970f0_Tx: ComBitPosition=423, ComBitSize=1, ComSignalInitValue=0, ComSignalType=BOOLEAN, ComSystemTemplateSystemSignalRef=DET_SUPER_RES_TARGET_264
        SG_Detections_265_268_oRDR_DETECTION_265_268_oPCAN_RADAR_74450479_Tx: ComSystemTemplateSignalGroupRef=SG_Detections_265_268
          83 x ComGroupSignal, all with ComSignalEndianness=LITTLE_ENDIAN, ComTransferProperty=PENDING:
            DET_AZIMUTH_265_oRDR_DETECTION_265_268_oPCAN_RADAR_4b51c0f2_Tx: ComBitPosition=88, ComBitSize=13, ComSignalInitValue=0, ComSignalType=UINT16, ComSystemTemplateSystemSignalRef=DET_AZIMUTH_265
            DET_AZIMUTH_266_oRDR_DETECTION_265_268_oPCAN_RADAR_2fb1bb0c_Tx: ComBitPosition=200, ComBitSize=13, ComSignalInitValue=0, ComSignalType=UINT16, ComSystemTemplateSystemSignalRef=DET_AZIMUTH_266
            DET_AZIMUTH_267_oRDR_DETECTION_265_268_oPCAN_RADAR_bac16f99_Tx: ComBitPosition=312, ComBitSize=13, ComSignalInitValue=0, ComSignalType=UINT16, ComSystemTemplateSystemSignalRef=DET_AZIMUTH_267
            DET_AZIMUTH_268_oRDR_DETECTION_265_268_oPCAN_RADAR_96d1fdde_Tx: ComBitPosition=424, ComBitSize=13, ComSignalInitValue=0, ComSignalType=UINT16, ComSystemTemplateSystemSignalRef=DET_AZIMUTH_268
            DET_AZIMUTH_ERR_265_oRDR_DETECTION_265_268_oPCAN_RADAR_efe45507_Tx: ComBitPosition=105, ComBitSize=7, ComSignalInitValue=0, ComSignalType=UINT8, ComSystemTemplateSystemSignalRef=DET_AZIMUTH_ERR_265
            DET_AZIMUTH_ERR_266_oRDR_DETECTION_265_268_oPCAN_RADAR_8b042ef9_Tx: ComBitPosition=217, ComBitSize=7, ComSignalInitValue=0, ComSignalType=UINT8, ComSystemTemplateSystemSignalRef=DET_AZIMUTH_ERR_266
            DET_AZIMUTH_ERR_267_oRDR_DETECTION_265_268_oPCAN_RADAR_1e74fa6c_Tx: ComBitPosition=329, ComBitSize=7, ComSignalInitValue=0, ComSignalType=UINT8, ComSystemTemplateSystemSignalRef=DET_AZIMUTH_ERR_267
            DET_AZIMUTH_ERR_268_oRDR_DETECTION_265_268_oPCAN_RADAR_3264682b_Tx: ComBitPosition=441, ComBitSize=7, ComSignalInitValue=0, ComSignalType=UINT8, ComSystemTemplateSystemSignalRef=DET_AZIMUTH_ERR_268
            DET_BELOW_RAIN_THOLD_265_oRDR_DETECTION_265_268_oPCAN_RADAR_9e505332_Tx: ComBitPosition=39, ComBitSize=1, ComSignalInitValue=0, ComSignalType=BOOLEAN, ComSystemTemplateSystemSignalRef=DET_BELOW_RAIN_THOLD_265
            DET_BELOW_RAIN_THOLD_266_oRDR_DETECTION_265_268_oPCAN_RADAR_fab028cc_Tx: ComBitPosition=151, ComBitSize=1, ComSignalInitValue=0, ComSignalType=BOOLEAN, ComSystemTemplateSystemSignalRef=DET_BELOW_RAIN_THOLD_266
            DET_BELOW_RAIN_THOLD_267_oRDR_DETECTION_265_268_oPCAN_RADAR_6fc0fc59_Tx: ComBitPosition=263, ComBitSize=1, ComSignalInitValue=0, ComSignalType=BOOLEAN, ComSystemTemplateSystemSignalRef=DET_BELOW_RAIN_THOLD_267
            DET_BELOW_RAIN_THOLD_268_oRDR_DETECTION_265_268_oPCAN_RADAR_43d06e1e_Tx: ComBitPosition=375, ComBitSize=1, ComSignalInitValue=0, ComSignalType=BOOLEAN, ComSystemTemplateSystemSignalRef=DET_BELOW_RAIN_THOLD_268
            DET_BI_STATIC_FLAG_265_oRDR_DETECTION_265_268_oPCAN_RADAR_1d7d8077_Tx: ComBitPosition=104, ComBitSize=1, ComSignalInitValue=0, ComSignalType=BOOLEAN, ComSystemTemplateSystemSignalRef=DET_BI_STATIC_FLAG_265
            DET_BI_STATIC_FLAG_266_oRDR_DETECTION_265_268_oPCAN_RADAR_799dfb89_Tx: ComBitPosition=216, ComBitSize=1, ComSignalInitValue=0, ComSignalType=BOOLEAN, ComSystemTemplateSystemSignalRef=DET_BI_STATIC_FLAG_266
            DET_BI_STATIC_FLAG_267_oRDR_DETECTION_265_268_oPCAN_RADAR_eced2f1c_Tx: ComBitPosition=328, ComBitSize=1, ComSignalInitValue=0, ComSignalType=BOOLEAN, ComSystemTemplateSystemSignalRef=DET_BI_STATIC_FLAG_267
            DET_BI_STATIC_FLAG_268_oRDR_DETECTION_265_268_oPCAN_RADAR_c0fdbd5b_Tx: ComBitPosition=440, ComBitSize=1, ComSignalInitValue=0, ComSignalType=BOOLEAN, ComSystemTemplateSystemSignalRef=DET_BI_STATIC_FLAG_268
            DET_CONFD_AZIMUTH_265_oRDR_DETECTION_265_268_oPCAN_RADAR_49b7ca38_Tx: ComBitPosition=118, ComBitSize=2, ComSignalInitValue=0, ComSignalType=UINT8, ComSystemTemplateSystemSignalRef=DET_CONFD_AZIMUTH_265
            DET_CONFD_AZIMUTH_266_oRDR_DETECTION_265_268_oPCAN_RADAR_2d57b1c6_Tx: ComBitPosition=230, ComBitSize=2, ComSignalInitValue=0, ComSignalType=UINT8, ComSystemTemplateSystemSignalRef=DET_CONFD_AZIMUTH_266
            DET_CONFD_AZIMUTH_267_oRDR_DETECTION_265_268_oPCAN_RADAR_b8276553_Tx: ComBitPosition=342, ComBitSize=2, ComSignalInitValue=0, ComSignalType=UINT8, ComSystemTemplateSystemSignalRef=DET_CONFD_AZIMUTH_267
            DET_CONFD_AZIMUTH_268_oRDR_DETECTION_265_268_oPCAN_RADAR_9437f714_Tx: ComBitPosition=454, ComBitSize=2, ComSignalInitValue=0, ComSignalType=UINT8, ComSystemTemplateSystemSignalRef=DET_CONFD_AZIMUTH_268
            DET_CONFD_ELEVATION_265_oRDR_DETECTION_265_268_oPCAN_RADAR_4b22cbc2_Tx: ComBitPosition=101, ComBitSize=2, ComSignalInitValue=0, ComSignalType=UINT8, ComSystemTemplateSystemSignalRef=DET_CONFD_ELEVATION_265
            DET_CONFD_ELEVATION_266_oRDR_DETECTION_265_268_oPCAN_RADAR_2fc2b03c_Tx: ComBitPosition=213, ComBitSize=2, ComSignalInitValue=0, ComSignalType=UINT8, ComSystemTemplateSystemSignalRef=DET_CONFD_ELEVATION_266
            DET_CONFD_ELEVATION_267_oRDR_DETECTION_265_268_oPCAN_RADAR_bab264a9_Tx: ComBitPosition=325, ComBitSize=2, ComSignalInitValue=0, ComSignalType=UINT8, ComSystemTemplateSystemSignalRef=DET_CONFD_ELEVATION_267
            DET_CONFD_ELEVATION_268_oRDR_DETECTION_265_268_oPCAN_RADAR_96a2f6ee_Tx: ComBitPosition=437, ComBitSize=2, ComSignalInitValue=0, ComSignalType=UINT8, ComSystemTemplateSystemSignalRef=DET_CONFD_ELEVATION_268
            DET_ELEVATION_265_oRDR_DETECTION_265_268_oPCAN_RADAR_9ae21ffe_Tx: ComBitPosition=72, ComBitSize=8, ComSignalInitValue=0, ComSignalType=UINT8, ComSystemTemplateSystemSignalRef=DET_ELEVATION_265
            DET_ELEVATION_266_oRDR_DETECTION_265_268_oPCAN_RADAR_fe026400_Tx: ComBitPosition=184, ComBitSize=8, ComSignalInitValue=0, ComSignalType=UINT8, ComSystemTemplateSystemSignalRef=DET_ELEVATION_266
            DET_ELEVATION_267_oRDR_DETECTION_265_268_oPCAN_RADAR_6b72b095_Tx: ComBitPosition=296, ComBitSize=8, ComSignalInitValue=0, ComSignalType=UINT8, ComSystemTemplateSystemSignalRef=DET_ELEVATION_267
            DET_ELEVATION_268_oRDR_DETECTION_265_268_oPCAN_RADAR_476222d2_Tx: ComBitPosition=408, ComBitSize=8, ComSignalInitValue=0, ComSignalType=UINT8, ComSystemTemplateSystemSignalRef=DET_ELEVATION_268
            DET_ELEVATION_ERR_265_oRDR_DETECTION_265_268_oPCAN_RADAR_1ddb878b_Tx: ComBitPosition=80, ComBitSize=6, ComSignalInitValue=0, ComSignalType=UINT8, ComSystemTemplateSystemSignalRef=DET_ELEVATION_ERR_265
            DET_ELEVATION_ERR_266_oRDR_DETECTION_265_268_oPCAN_RADAR_793bfc75_Tx: ComBitPosition=192, ComBitSize=6, ComSignalInitValue=0, ComSignalType=UINT8, ComSystemTemplateSystemSignalRef=DET_ELEVATION_ERR_266
            DET_ELEVATION_ERR_267_oRDR_DETECTION_265_268_oPCAN_RADAR_ec4b28e0_Tx: ComBitPosition=304, ComBitSize=6, ComSignalInitValue=0, ComSignalType=UINT8, ComSystemTemplateSystemSignalRef=DET_ELEVATION_ERR_267
            DET_ELEVATION_ERR_268_oRDR_DETECTION_265_268_oPCAN_RADAR_c05bbaa7_Tx: ComBitPosition=416, ComBitSize=6, ComSignalInitValue=0, ComSignalType=UINT8, ComSystemTemplateSystemSignalRef=DET_ELEVATION_ERR_268
            DET_EXISTENCE_PROB_265_oRDR_DETECTION_265_268_oPCAN_RADAR_cf44f2eb_Tx: ComBitPosition=112, ComBitSize=6, ComSignalInitValue=0, ComSignalType=UINT8, ComSystemTemplateSystemSignalRef=DET_EXISTENCE_PROB_265
            DET_EXISTENCE_PROB_266_oRDR_DETECTION_265_268_oPCAN_RADAR_aba48915_Tx: ComBitPosition=224, ComBitSize=6, ComSignalInitValue=0, ComSignalType=UINT8, ComSystemTemplateSystemSignalRef=DET_EXISTENCE_PROB_266
            DET_EXISTENCE_PROB_267_oRDR_DETECTION_265_268_oPCAN_RADAR_3ed45d80_Tx: ComBitPosition=336, ComBitSize=6, ComSignalInitValue=0, ComSignalType=UINT8, ComSystemTemplateSystemSignalRef=DET_EXISTENCE_PROB_267
            DET_EXISTENCE_PROB_268_oRDR_DETECTION_265_268_oPCAN_RADAR_12c4cfc7_Tx: ComBitPosition=448, ComBitSize=6, ComSignalInitValue=0, ComSignalType=UINT8, ComSystemTemplateSystemSignalRef=DET_EXISTENCE_PROB_268
            DET_HVC_FLAG_265_oRDR_DETECTION_265_268_oPCAN_RADAR_2e30b194_Tx: ComBitPosition=86, ComBitSize=1, ComSignalInitValue=0, ComSignalType=BOOLEAN, ComSystemTemplateSystemSignalRef=DET_HVC_FLAG_265
            DET_HVC_FLAG_266_oRDR_DETECTION_265_268_oPCAN_RADAR_4ad0ca6a_Tx: ComBitPosition=198, ComBitSize=1, ComSignalInitValue=0, ComSignalType=BOOLEAN, ComSystemTemplateSystemSignalRef=DET_HVC_FLAG_266
            DET_HVC_FLAG_267_oRDR_DETECTION_265_268_oPCAN_RADAR_dfa01eff_Tx: ComBitPosition=310, ComBitSize=1, ComSignalInitValue=0, ComSignalType=BOOLEAN, ComSystemTemplateSystemSignalRef=DET_HVC_FLAG_267
            DET_HVC_FLAG_268_oRDR_DETECTION_265_268_oPCAN_RADAR_f3b08cb8_Tx: ComBitPosition=422, ComBitSize=1, ComSignalInitValue=0, ComSignalType=BOOLEAN, ComSystemTemplateSystemSignalRef=DET_HVC_FLAG_268
            DET_IDM_265_oRDR_DETECTION_265_268_oPCAN_RADAR_a5628a29_Tx: ComBitPosition=63, ComBitSize=1, ComSignalInitValue=0, ComSignalType=BOOLEAN, ComSystemTemplateSystemSignalRef=DET_IDM_265
            DET_IDM_266_oRDR_DETECTION_265_268_oPCAN_RADAR_c182f1d7_Tx: ComBitPosition=175, ComBitSize=1, ComSignalInitValue=0, ComSignalType=BOOLEAN, ComSystemTemplateSystemSignalRef=DET_IDM_266
            DET_IDM_267_oRDR_DETECTION_265_268_oPCAN_RADAR_54f22542_Tx: ComBitPosition=287, ComBitSize=1, ComSignalInitValue=0, ComSignalType=BOOLEAN, ComSystemTemplateSystemSignalRef=DET_IDM_267
            DET_IDM_268_oRDR_DETECTION_265_268_oPCAN_RADAR_78e2b705_Tx: ComBitPosition=399, ComBitSize=1, ComSignalInitValue=0, ComSignalType=BOOLEAN, ComSystemTemplateSystemSignalRef=DET_IDM_268
            DET_MH_CRC16_265_268_oRDR_DETECTION_265_268_oPCAN_RADAR_f0cdd672_Tx: ComBitPosition=0, ComBitSize=16, ComSignalInitValue=0, ComSignalType=UINT16, ComSystemTemplateSystemSignalRef=DET_MH_CRC16_265_268
            DET_MH_CYCLE_COUNTER_265_268_oRDR_DETECTION_265_268_oPCAN_RADAR_74b87745_Tx: ComBitPosition=16, ComBitSize=8, ComSignalInitValue=0, ComSignalType=UINT8, ComSystemTemplateSystemSignalRef=DET_MH_CYCLE_COUNTER_265_268
            DET_MH_SCAN_INDEX_4LSB_265_268_oRDR_DETECTION_265_268_oPCAN_RADAR_b89252c9_Tx: ComBitPosition=476, ComBitSize=4, ComSignalInitValue=0, ComSignalType=UINT8, ComSystemTemplateSystemSignalRef=DET_MH_SCAN_INDEX_4LSB_265_268
            DET_MTD_265_oRDR_DETECTION_265_268_oPCAN_RADAR_c3d1b8f2_Tx: ComBitPosition=47, ComBitSize=1, ComSignalInitValue=0, ComSignalType=BOOLEAN, ComSystemTemplateSystemSignalRef=DET_MTD_265
            DET_MTD_266_oRDR_DETECTION_265_268_oPCAN_RADAR_a731c30c_Tx: ComBitPosition=159, ComBitSize=1, ComSignalInitValue=0, ComSignalType=BOOLEAN, ComSystemTemplateSystemSignalRef=DET_MTD_266
            DET_MTD_267_oRDR_DETECTION_265_268_oPCAN_RADAR_32411799_Tx: ComBitPosition=271, ComBitSize=1, ComSignalInitValue=0, ComSignalType=BOOLEAN, ComSystemTemplateSystemSignalRef=DET_MTD_267
            DET_MTD_268_oRDR_DETECTION_265_268_oPCAN_RADAR_1e5185de_Tx: ComBitPosition=383, ComBitSize=1, ComSignalInitValue=0, ComSignalType=BOOLEAN, ComSystemTemplateSystemSignalRef=DET_MTD_268
            DET_PROB_1STAZHYPO_265_oRDR_DETECTION_265_268_oPCAN_RADAR_5065503f_Tx: ComBitPosition=103, ComBitSize=1, ComSignalInitValue=0, ComSignalType=BOOLEAN, ComSystemTemplateSystemSignalRef=DET_PROB_1STAZHYPO_265
            DET_PROB_1STAZHYPO_266_oRDR_DETECTION_265_268_oPCAN_RADAR_34852bc1_Tx: ComBitPosition=215, ComBitSize=1, ComSignalInitValue=0, ComSignalType=BOOLEAN, ComSystemTemplateSystemSignalRef=DET_PROB_1STAZHYPO_266
            DET_PROB_1STAZHYPO_267_oRDR_DETECTION_265_268_oPCAN_RADAR_a1f5ff54_Tx: ComBitPosition=327, ComBitSize=1, ComSignalInitValue=0, ComSignalType=BOOLEAN, ComSystemTemplateSystemSignalRef=DET_PROB_1STAZHYPO_267
            DET_PROB_1STAZHYPO_268_oRDR_DETECTION_265_268_oPCAN_RADAR_8de56d13_Tx: ComBitPosition=439, ComBitSize=1, ComSignalInitValue=0, ComSignalType=BOOLEAN, ComSystemTemplateSystemSignalRef=DET_PROB_1STAZHYPO_268
            DET_RANGE_265_oRDR_DETECTION_265_268_oPCAN_RADAR_5bcab349_Tx: ComBitPosition=24, ComBitSize=15, ComSignalInitValue=0, ComSignalType=UINT16, ComSystemTemplateSystemSignalRef=DET_RANGE_265
            DET_RANGE_266_oRDR_DETECTION_265_268_oPCAN_RADAR_3f2ac8b7_Tx: ComBitPosition=136, ComBitSize=15, ComSignalInitValue=0, ComSignalType=UINT16, ComSystemTemplateSystemSignalRef=DET_RANGE_266
            DET_RANGE_267_oRDR_DETECTION_265_268_oPCAN_RADAR_aa5a1c22_Tx: ComBitPosition=248, ComBitSize=15, ComSignalInitValue=0, ComSignalType=UINT16, ComSystemTemplateSystemSignalRef=DET_RANGE_267
            DET_RANGE_268_oRDR_DETECTION_265_268_oPCAN_RADAR_864a8e65_Tx: ComBitPosition=360, ComBitSize=15, ComSignalInitValue=0, ComSignalType=UINT16, ComSystemTemplateSystemSignalRef=DET_RANGE_268
            DET_RANGE_ERR_265_oRDR_DETECTION_265_268_oPCAN_RADAR_fc220920_Tx: ComBitPosition=40, ComBitSize=7, ComSignalInitValue=0, ComSignalType=UINT8, ComSystemTemplateSystemSignalRef=DET_RANGE_ERR_265
            DET_RANGE_ERR_266_oRDR_DETECTION_265_268_oPCAN_RADAR_98c272de_Tx: ComBitPosition=152, ComBitSize=7, ComSignalInitValue=0, ComSignalType=UINT8, ComSystemTemplateSystemSignalRef=DET_RANGE_ERR_266
            DET_RANGE_ERR_267_oRDR_DETECTION_265_268_oPCAN_RADAR_0db2a64b_Tx: ComBitPosition=264, ComBitSize=7, ComSignalInitValue=0, ComSignalType=UINT8, ComSystemTemplateSystemSignalRef=DET_RANGE_ERR_267
            DET_RANGE_ERR_268_oRDR_DETECTION_265_268_oPCAN_RADAR_21a2340c_Tx: ComBitPosition=376, ComBitSize=7, ComSignalInitValue=0, ComSignalType=UINT8, ComSystemTemplateSystemSignalRef=DET_RANGE_ERR_268
            DET_RANGE_VELOCITY_265_oRDR_DETECTION_265_268_oPCAN_RADAR_2e6c716c_Tx: ComBitPosition=48, ComBitSize=15, ComSignalInitValue=16384, ComSignalType=UINT16, ComSystemTemplateSystemSignalRef=DET_RANGE_VELOCITY_265
            DET_RANGE_VELOCITY_266_oRDR_DETECTION_265_268_oPCAN_RADAR_4a8c0a92_Tx: ComBitPosition=160, ComBitSize=15, ComSignalInitValue=16384, ComSignalType=UINT16, ComSystemTemplateSystemSignalRef=DET_RANGE_VELOCITY_266
            DET_RANGE_VELOCITY_267_oRDR_DETECTION_265_268_oPCAN_RADAR_dffcde07_Tx: ComBitPosition=272, ComBitSize=15, ComSignalInitValue=16384, ComSignalType=UINT16, ComSystemTemplateSystemSignalRef=DET_RANGE_VELOCITY_267
            DET_RANGE_VELOCITY_268_oRDR_DETECTION_265_268_oPCAN_RADAR_f3ec4c40_Tx: ComBitPosition=384, ComBitSize=15, ComSignalInitValue=16384, ComSignalType=UINT16, ComSystemTemplateSystemSignalRef=DET_RANGE_VELOCITY_268
            DET_RANGE_VELOCITY_ERR_265_oRDR_DETECTION_265_268_oPCAN_RADAR_21d78ade_Tx: ComBitPosition=64, ComBitSize=8, ComSignalInitValue=0, ComSignalType=UINT8, ComSystemTemplateSystemSignalRef=DET_RANGE_VELOCITY_ERR_265
            DET_RANGE_VELOCITY_ERR_266_oRDR_DETECTION_265_268_oPCAN_RADAR_4537f120_Tx: ComBitPosition=176, ComBitSize=8, ComSignalInitValue=0, ComSignalType=UINT8, ComSystemTemplateSystemSignalRef=DET_RANGE_VELOCITY_ERR_266
            DET_RANGE_VELOCITY_ERR_267_oRDR_DETECTION_265_268_oPCAN_RADAR_d04725b5_Tx: ComBitPosition=288, ComBitSize=8, ComSignalInitValue=0, ComSignalType=UINT8, ComSystemTemplateSystemSignalRef=DET_RANGE_VELOCITY_ERR_267
            DET_RANGE_VELOCITY_ERR_268_oRDR_DETECTION_265_268_oPCAN_RADAR_fc57b7f2_Tx: ComBitPosition=400, ComBitSize=8, ComSignalInitValue=0, ComSignalType=UINT8, ComSystemTemplateSystemSignalRef=DET_RANGE_VELOCITY_ERR_268
            DET_RCS_265_oRDR_DETECTION_265_268_oPCAN_RADAR_a9ec4636_Tx: ComBitPosition=128, ComBitSize=8, ComSignalInitValue=128, ComSignalType=UINT8, ComSystemTemplateSystemSignalRef=DET_RCS_265
            DET_RCS_266_oRDR_DETECTION_265_268_oPCAN_RADAR_cd0c3dc8_Tx: ComBitPosition=240, ComBitSize=8, ComSignalInitValue=128, ComSignalType=UINT8, ComSystemTemplateSystemSignalRef=DET_RCS_266
            DET_RCS_267_oRDR_DETECTION_265_268_oPCAN_RADAR_587ce95d_Tx: ComBitPosition=352, ComBitSize=8, ComSignalInitValue=128, ComSignalType=UINT8, ComSystemTemplateSystemSignalRef=DET_RCS_267
            DET_RCS_268_oRDR_DETECTION_265_268_oPCAN_RADAR_746c7b1a_Tx: ComBitPosition=464, ComBitSize=8, ComSignalInitValue=128, ComSignalType=UINT8, ComSystemTemplateSystemSignalRef=DET_RCS_268
            DET_SNR_265_oRDR_DETECTION_265_268_oPCAN_RADAR_74421234_Tx: ComBitPosition=120, ComBitSize=8, ComSignalInitValue=0, ComSignalType=UINT8, ComSystemTemplateSystemSignalRef=DET_SNR_265
            DET_SNR_266_oRDR_DETECTION_265_268_oPCAN_RADAR_10a269ca_Tx: ComBitPosition=232, ComBitSize=8, ComSignalInitValue=0, ComSignalType=UINT8, ComSystemTemplateSystemSignalRef=DET_SNR_266
            DET_SNR_267_oRDR_DETECTION_265_268_oPCAN_RADAR_85d2bd5f_Tx: ComBitPosition=344, ComBitSize=8, ComSignalInitValue=0, ComSignalType=UINT8, ComSystemTemplateSystemSignalRef=DET_SNR_267
            DET_SNR_268_oRDR_DETECTION_265_268_oPCAN_RADAR_a9c22f18_Tx: ComBitPosition=456, ComBitSize=8, ComSignalInitValue=0, ComSignalType=UINT8, ComSystemTemplateSystemSignalRef=DET_SNR_268
            DET_SUPER_RES_TARGET_265_oRDR_DETECTION_265_268_oPCAN_RADAR_45db3a51_Tx: ComBitPosition=87, ComBitSize=1, ComSignalInitValue=0, ComSignalType=BOOLEAN, ComSystemTemplateSystemSignalRef=DET_SUPER_RES_TARGET_265
            DET_SUPER_RES_TARGET_266_oRDR_DETECTION_265_268_oPCAN_RADAR_213b41af_Tx: ComBitPosition=199, ComBitSize=1, ComSignalInitValue=0, ComSignalType=BOOLEAN, ComSystemTemplateSystemSignalRef=DET_SUPER_RES_TARGET_266
            DET_SUPER_RES_TARGET_267_oRDR_DETECTION_265_268_oPCAN_RADAR_b44b953a_Tx: ComBitPosition=311, ComBitSize=1, ComSignalInitValue=0, ComSignalType=BOOLEAN, ComSystemTemplateSystemSignalRef=DET_SUPER_RES_TARGET_267
            DET_SUPER_RES_TARGET_268_oRDR_DETECTION_265_268_oPCAN_RADAR_985b077d_Tx: ComBitPosition=423, ComBitSize=1, ComSignalInitValue=0, ComSignalType=BOOLEAN, ComSystemTemplateSystemSignalRef=DET_SUPER_RES_TARGET_268
        SG_Detections_269_272_oRDR_DETECTION_269_272_oPCAN_RADAR_ed3f2002_Tx: ComSystemTemplateSignalGroupRef=SG_Detections_269_272
          83 x ComGroupSignal, all with ComSignalEndianness=LITTLE_ENDIAN, ComTransferProperty=PENDING:
            DET_AZIMUTH_269_oRDR_DETECTION_269_272_oPCAN_RADAR_31e9c64a_Tx: ComBitPosition=88, ComBitSize=13, ComSignalInitValue=0, ComSignalType=UINT16, ComSystemTemplateSystemSignalRef=DET_AZIMUTH_269
            DET_AZIMUTH_270_oRDR_DETECTION_269_272_oPCAN_RADAR_54c9b4ee_Tx: ComBitPosition=200, ComBitSize=13, ComSignalInitValue=0, ComSignalType=UINT16, ComSystemTemplateSystemSignalRef=DET_AZIMUTH_270
            DET_AZIMUTH_271_oRDR_DETECTION_269_272_oPCAN_RADAR_c1b9607b_Tx: ComBitPosition=312, ComBitSize=13, ComSignalInitValue=0, ComSignalType=UINT16, ComSystemTemplateSystemSignalRef=DET_AZIMUTH_271
            DET_AZIMUTH_272_oRDR_DETECTION_269_272_oPCAN_RADAR_a5591b85_Tx: ComBitPosition=424, ComBitSize=13, ComSignalInitValue=0, ComSignalType=UINT16, ComSystemTemplateSystemSignalRef=DET_AZIMUTH_272
            DET_AZIMUTH_ERR_269_oRDR_DETECTION_269_272_oPCAN_RADAR_955c53bf_Tx: ComBitPosition=105, ComBitSize=7, ComSignalInitValue=0, ComSignalType=UINT8, ComSystemTemplateSystemSignalRef=DET_AZIMUTH_ERR_269
            DET_AZIMUTH_ERR_270_oRDR_DETECTION_269_272_oPCAN_RADAR_f07c211b_Tx: ComBitPosition=217, ComBitSize=7, ComSignalInitValue=0, ComSignalType=UINT8, ComSystemTemplateSystemSignalRef=DET_AZIMUTH_ERR_270
            DET_AZIMUTH_ERR_271_oRDR_DETECTION_269_272_oPCAN_RADAR_650cf58e_Tx: ComBitPosition=329, ComBitSize=7, ComSignalInitValue=0, ComSignalType=UINT8, ComSystemTemplateSystemSignalRef=DET_AZIMUTH_ERR_271
            DET_AZIMUTH_ERR_272_oRDR_DETECTION_269_272_oPCAN_RADAR_01ec8e70_Tx: ComBitPosition=441, ComBitSize=7, ComSignalInitValue=0, ComSignalType=UINT8, ComSystemTemplateSystemSignalRef=DET_AZIMUTH_ERR_272
            DET_BELOW_RAIN_THOLD_269_oRDR_DETECTION_269_272_oPCAN_RADAR_e4e8558a_Tx: ComBitPosition=39, ComBitSize=1, ComSignalInitValue=0, ComSignalType=BOOLEAN, ComSystemTemplateSystemSignalRef=DET_BELOW_RAIN_THOLD_269
            DET_BELOW_RAIN_THOLD_270_oRDR_DETECTION_269_272_oPCAN_RADAR_81c8272e_Tx: ComBitPosition=151, ComBitSize=1, ComSignalInitValue=0, ComSignalType=BOOLEAN, ComSystemTemplateSystemSignalRef=DET_BELOW_RAIN_THOLD_270
            DET_BELOW_RAIN_THOLD_271_oRDR_DETECTION_269_272_oPCAN_RADAR_14b8f3bb_Tx: ComBitPosition=263, ComBitSize=1, ComSignalInitValue=0, ComSignalType=BOOLEAN, ComSystemTemplateSystemSignalRef=DET_BELOW_RAIN_THOLD_271
            DET_BELOW_RAIN_THOLD_272_oRDR_DETECTION_269_272_oPCAN_RADAR_70588845_Tx: ComBitPosition=375, ComBitSize=1, ComSignalInitValue=0, ComSignalType=BOOLEAN, ComSystemTemplateSystemSignalRef=DET_BELOW_RAIN_THOLD_272
            DET_BI_STATIC_FLAG_269_oRDR_DETECTION_269_272_oPCAN_RADAR_67c586cf_Tx: ComBitPosition=104, ComBitSize=1, ComSignalInitValue=0, ComSignalType=BOOLEAN, ComSystemTemplateSystemSignalRef=DET_BI_STATIC_FLAG_269
            DET_BI_STATIC_FLAG_270_oRDR_DETECTION_269_272_oPCAN_RADAR_02e5f46b_Tx: ComBitPosition=216, ComBitSize=1, ComSignalInitValue=0, ComSignalType=BOOLEAN, ComSystemTemplateSystemSignalRef=DET_BI_STATIC_FLAG_270
            DET_BI_STATIC_FLAG_271_oRDR_DETECTION_269_272_oPCAN_RADAR_979520fe_Tx: ComBitPosition=328, ComBitSize=1, ComSignalInitValue=0, ComSignalType=BOOLEAN, ComSystemTemplateSystemSignalRef=DET_BI_STATIC_FLAG_271
            DET_BI_STATIC_FLAG_272_oRDR_DETECTION_269_272_oPCAN_RADAR_f3755b00_Tx: ComBitPosition=440, ComBitSize=1, ComSignalInitValue=0, ComSignalType=BOOLEAN, ComSystemTemplateSystemSignalRef=DET_BI_STATIC_FLAG_272
            DET_CONFD_AZIMUTH_269_oRDR_DETECTION_269_272_oPCAN_RADAR_330fcc80_Tx: ComBitPosition=118, ComBitSize=2, ComSignalInitValue=0, ComSignalType=UINT8, ComSystemTemplateSystemSignalRef=DET_CONFD_AZIMUTH_269
            DET_CONFD_AZIMUTH_270_oRDR_DETECTION_269_272_oPCAN_RADAR_562fbe24_Tx: ComBitPosition=230, ComBitSize=2, ComSignalInitValue=0, ComSignalType=UINT8, ComSystemTemplateSystemSignalRef=DET_CONFD_AZIMUTH_270
            DET_CONFD_AZIMUTH_271_oRDR_DETECTION_269_272_oPCAN_RADAR_c35f6ab1_Tx: ComBitPosition=342, ComBitSize=2, ComSignalInitValue=0, ComSignalType=UINT8, ComSystemTemplateSystemSignalRef=DET_CONFD_AZIMUTH_271
            DET_CONFD_AZIMUTH_272_oRDR_DETECTION_269_272_oPCAN_RADAR_a7bf114f_Tx: ComBitPosition=454, ComBitSize=2, ComSignalInitValue=0, ComSignalType=UINT8, ComSystemTemplateSystemSignalRef=DET_CONFD_AZIMUTH_272
            DET_CONFD_ELEVATION_269_oRDR_DETECTION_269_272_oPCAN_RADAR_319acd7a_Tx: ComBitPosition=101, ComBitSize=2, ComSignalInitValue=0, ComSignalType=UINT8, ComSystemTemplateSystemSignalRef=DET_CONFD_ELEVATION_269
            DET_CONFD_ELEVATION_270_oRDR_DETECTION_269_272_oPCAN_RADAR_54babfde_Tx: ComBitPosition=213, ComBitSize=2, ComSignalInitValue=0, ComSignalType=UINT8, ComSystemTemplateSystemSignalRef=DET_CONFD_ELEVATION_270
            DET_CONFD_ELEVATION_271_oRDR_DETECTION_269_272_oPCAN_RADAR_c1ca6b4b_Tx: ComBitPosition=325, ComBitSize=2, ComSignalInitValue=0, ComSignalType=UINT8, ComSystemTemplateSystemSignalRef=DET_CONFD_ELEVATION_271
            DET_CONFD_ELEVATION_272_oRDR_DETECTION_269_272_oPCAN_RADAR_a52a10b5_Tx: ComBitPosition=437, ComBitSize=2, ComSignalInitValue=0, ComSignalType=UINT8, ComSystemTemplateSystemSignalRef=DET_CONFD_ELEVATION_272
            DET_ELEVATION_269_oRDR_DETECTION_269_272_oPCAN_RADAR_e05a1946_Tx: ComBitPosition=72, ComBitSize=8, ComSignalInitValue=0, ComSignalType=UINT8, ComSystemTemplateSystemSignalRef=DET_ELEVATION_269
            DET_ELEVATION_270_oRDR_DETECTION_269_272_oPCAN_RADAR_857a6be2_Tx: ComBitPosition=184, ComBitSize=8, ComSignalInitValue=0, ComSignalType=UINT8, ComSystemTemplateSystemSignalRef=DET_ELEVATION_270
            DET_ELEVATION_271_oRDR_DETECTION_269_272_oPCAN_RADAR_100abf77_Tx: ComBitPosition=296, ComBitSize=8, ComSignalInitValue=0, ComSignalType=UINT8, ComSystemTemplateSystemSignalRef=DET_ELEVATION_271
            DET_ELEVATION_272_oRDR_DETECTION_269_272_oPCAN_RADAR_74eac489_Tx: ComBitPosition=408, ComBitSize=8, ComSignalInitValue=0, ComSignalType=UINT8, ComSystemTemplateSystemSignalRef=DET_ELEVATION_272
            DET_ELEVATION_ERR_269_oRDR_DETECTION_269_272_oPCAN_RADAR_67638133_Tx: ComBitPosition=80, ComBitSize=6, ComSignalInitValue=0, ComSignalType=UINT8, ComSystemTemplateSystemSignalRef=DET_ELEVATION_ERR_269
            DET_ELEVATION_ERR_270_oRDR_DETECTION_269_272_oPCAN_RADAR_0243f397_Tx: ComBitPosition=192, ComBitSize=6, ComSignalInitValue=0, ComSignalType=UINT8, ComSystemTemplateSystemSignalRef=DET_ELEVATION_ERR_270
            DET_ELEVATION_ERR_271_oRDR_DETECTION_269_272_oPCAN_RADAR_97332702_Tx: ComBitPosition=304, ComBitSize=6, ComSignalInitValue=0, ComSignalType=UINT8, ComSystemTemplateSystemSignalRef=DET_ELEVATION_ERR_271
            DET_ELEVATION_ERR_272_oRDR_DETECTION_269_272_oPCAN_RADAR_f3d35cfc_Tx: ComBitPosition=416, ComBitSize=6, ComSignalInitValue=0, ComSignalType=UINT8, ComSystemTemplateSystemSignalRef=DET_ELEVATION_ERR_272
            DET_EXISTENCE_PROB_269_oRDR_DETECTION_269_272_oPCAN_RADAR_b5fcf453_Tx: ComBitPosition=112, ComBitSize=6, ComSignalInitValue=0, ComSignalType=UINT8, ComSystemTemplateSystemSignalRef=DET_EXISTENCE_PROB_269
            DET_EXISTENCE_PROB_270_oRDR_DETECTION_269_272_oPCAN_RADAR_d0dc86f7_Tx: ComBitPosition=224, ComBitSize=6, ComSignalInitValue=0, ComSignalType=UINT8, ComSystemTemplateSystemSignalRef=DET_EXISTENCE_PROB_270
            DET_EXISTENCE_PROB_271_oRDR_DETECTION_269_272_oPCAN_RADAR_45ac5262_Tx: ComBitPosition=336, ComBitSize=6, ComSignalInitValue=0, ComSignalType=UINT8, ComSystemTemplateSystemSignalRef=DET_EXISTENCE_PROB_271
            DET_EXISTENCE_PROB_272_oRDR_DETECTION_269_272_oPCAN_RADAR_214c299c_Tx: ComBitPosition=448, ComBitSize=6, ComSignalInitValue=0, ComSignalType=UINT8, ComSystemTemplateSystemSignalRef=DET_EXISTENCE_PROB_272
            DET_HVC_FLAG_269_oRDR_DETECTION_269_272_oPCAN_RADAR_5488b72c_Tx: ComBitPosition=86, ComBitSize=1, ComSignalInitValue=0, ComSignalType=BOOLEAN, ComSystemTemplateSystemSignalRef=DET_HVC_FLAG_269
            DET_HVC_FLAG_270_oRDR_DETECTION_269_272_oPCAN_RADAR_31a8c588_Tx: ComBitPosition=198, ComBitSize=1, ComSignalInitValue=0, ComSignalType=BOOLEAN, ComSystemTemplateSystemSignalRef=DET_HVC_FLAG_270
            DET_HVC_FLAG_271_oRDR_DETECTION_269_272_oPCAN_RADAR_a4d8111d_Tx: ComBitPosition=310, ComBitSize=1, ComSignalInitValue=0, ComSignalType=BOOLEAN, ComSystemTemplateSystemSignalRef=DET_HVC_FLAG_271
            DET_HVC_FLAG_272_oRDR_DETECTION_269_272_oPCAN_RADAR_c0386ae3_Tx: ComBitPosition=422, ComBitSize=1, ComSignalInitValue=0, ComSignalType=BOOLEAN, ComSystemTemplateSystemSignalRef=DET_HVC_FLAG_272
            DET_IDM_269_oRDR_DETECTION_269_272_oPCAN_RADAR_dfda8c91_Tx: ComBitPosition=63, ComBitSize=1, ComSignalInitValue=0, ComSignalType=BOOLEAN, ComSystemTemplateSystemSignalRef=DET_IDM_269
            DET_IDM_270_oRDR_DETECTION_269_272_oPCAN_RADAR_bafafe35_Tx: ComBitPosition=175, ComBitSize=1, ComSignalInitValue=0, ComSignalType=BOOLEAN, ComSystemTemplateSystemSignalRef=DET_IDM_270
            DET_IDM_271_oRDR_DETECTION_269_272_oPCAN_RADAR_2f8a2aa0_Tx: ComBitPosition=287, ComBitSize=1, ComSignalInitValue=0, ComSignalType=BOOLEAN, ComSystemTemplateSystemSignalRef=DET_IDM_271
            DET_IDM_272_oRDR_DETECTION_269_272_oPCAN_RADAR_4b6a515e_Tx: ComBitPosition=399, ComBitSize=1, ComSignalInitValue=0, ComSignalType=BOOLEAN, ComSystemTemplateSystemSignalRef=DET_IDM_272
            DET_MH_CRC16_269_272_oRDR_DETECTION_269_272_oPCAN_RADAR_69b7f209_Tx: ComBitPosition=0, ComBitSize=16, ComSignalInitValue=0, ComSignalType=UINT16, ComSystemTemplateSystemSignalRef=DET_MH_CRC16_269_272
            DET_MH_CYCLE_COUNTER_269_272_oRDR_DETECTION_269_272_oPCAN_RADAR_edc2533e_Tx: ComBitPosition=16, ComBitSize=8, ComSignalInitValue=0, ComSignalType=UINT8, ComSystemTemplateSystemSignalRef=DET_MH_CYCLE_COUNTER_269_272
            DET_MH_SCAN_INDEX_4LSB_269_272_oRDR_DETECTION_269_272_oPCAN_RADAR_21e876b2_Tx: ComBitPosition=476, ComBitSize=4, ComSignalInitValue=0, ComSignalType=UINT8, ComSystemTemplateSystemSignalRef=DET_MH_SCAN_INDEX_4LSB_269_272
            DET_MTD_269_oRDR_DETECTION_269_272_oPCAN_RADAR_b969be4a_Tx: ComBitPosition=47, ComBitSize=1, ComSignalInitValue=0, ComSignalType=BOOLEAN, ComSystemTemplateSystemSignalRef=DET_MTD_269
            DET_MTD_270_oRDR_DETECTION_269_272_oPCAN_RADAR_dc49ccee_Tx: ComBitPosition=159, ComBitSize=1, ComSignalInitValue=0, ComSignalType=BOOLEAN, ComSystemTemplateSystemSignalRef=DET_MTD_270
            DET_MTD_271_oRDR_DETECTION_269_272_oPCAN_RADAR_4939187b_Tx: ComBitPosition=271, ComBitSize=1, ComSignalInitValue=0, ComSignalType=BOOLEAN, ComSystemTemplateSystemSignalRef=DET_MTD_271
            DET_MTD_272_oRDR_DETECTION_269_272_oPCAN_RADAR_2dd96385_Tx: ComBitPosition=383, ComBitSize=1, ComSignalInitValue=0, ComSignalType=BOOLEAN, ComSystemTemplateSystemSignalRef=DET_MTD_272
            DET_PROB_1STAZHYPO_269_oRDR_DETECTION_269_272_oPCAN_RADAR_2add5687_Tx: ComBitPosition=103, ComBitSize=1, ComSignalInitValue=0, ComSignalType=BOOLEAN, ComSystemTemplateSystemSignalRef=DET_PROB_1STAZHYPO_269
            DET_PROB_1STAZHYPO_270_oRDR_DETECTION_269_272_oPCAN_RADAR_4ffd2423_Tx: ComBitPosition=215, ComBitSize=1, ComSignalInitValue=0, ComSignalType=BOOLEAN, ComSystemTemplateSystemSignalRef=DET_PROB_1STAZHYPO_270
            DET_PROB_1STAZHYPO_271_oRDR_DETECTION_269_272_oPCAN_RADAR_da8df0b6_Tx: ComBitPosition=327, ComBitSize=1, ComSignalInitValue=0, ComSignalType=BOOLEAN, ComSystemTemplateSystemSignalRef=DET_PROB_1STAZHYPO_271
            DET_PROB_1STAZHYPO_272_oRDR_DETECTION_269_272_oPCAN_RADAR_be6d8b48_Tx: ComBitPosition=439, ComBitSize=1, ComSignalInitValue=0, ComSignalType=BOOLEAN, ComSystemTemplateSystemSignalRef=DET_PROB_1STAZHYPO_272
            DET_RANGE_269_oRDR_DETECTION_269_272_oPCAN_RADAR_2172b5f1_Tx: ComBitPosition=24, ComBitSize=15, ComSignalInitValue=0, ComSignalType=UINT16, ComSystemTemplateSystemSignalRef=DET_RANGE_269
            DET_RANGE_270_oRDR_DETECTION_269_272_oPCAN_RADAR_4452c755_Tx: ComBitPosition=136, ComBitSize=15, ComSignalInitValue=0, ComSignalType=UINT16, ComSystemTemplateSystemSignalRef=DET_RANGE_270
            DET_RANGE_271_oRDR_DETECTION_269_272_oPCAN_RADAR_d12213c0_Tx: ComBitPosition=248, ComBitSize=15, ComSignalInitValue=0, ComSignalType=UINT16, ComSystemTemplateSystemSignalRef=DET_RANGE_271
            DET_RANGE_272_oRDR_DETECTION_269_272_oPCAN_RADAR_b5c2683e_Tx: ComBitPosition=360, ComBitSize=15, ComSignalInitValue=0, ComSignalType=UINT16, ComSystemTemplateSystemSignalRef=DET_RANGE_272
            DET_RANGE_ERR_269_oRDR_DETECTION_269_272_oPCAN_RADAR_869a0f98_Tx: ComBitPosition=40, ComBitSize=7, ComSignalInitValue=0, ComSignalType=UINT8, ComSystemTemplateSystemSignalRef=DET_RANGE_ERR_269
            DET_RANGE_ERR_270_oRDR_DETECTION_269_272_oPCAN_RADAR_e3ba7d3c_Tx: ComBitPosition=152, ComBitSize=7, ComSignalInitValue=0, ComSignalType=UINT8, ComSystemTemplateSystemSignalRef=DET_RANGE_ERR_270
            DET_RANGE_ERR_271_oRDR_DETECTION_269_272_oPCAN_RADAR_76caa9a9_Tx: ComBitPosition=264, ComBitSize=7, ComSignalInitValue=0, ComSignalType=UINT8, ComSystemTemplateSystemSignalRef=DET_RANGE_ERR_271
            DET_RANGE_ERR_272_oRDR_DETECTION_269_272_oPCAN_RADAR_122ad257_Tx: ComBitPosition=376, ComBitSize=7, ComSignalInitValue=0, ComSignalType=UINT8, ComSystemTemplateSystemSignalRef=DET_RANGE_ERR_272
            DET_RANGE_VELOCITY_269_oRDR_DETECTION_269_272_oPCAN_RADAR_54d477d4_Tx: ComBitPosition=48, ComBitSize=15, ComSignalInitValue=16384, ComSignalType=UINT16, ComSystemTemplateSystemSignalRef=DET_RANGE_VELOCITY_269
            DET_RANGE_VELOCITY_270_oRDR_DETECTION_269_272_oPCAN_RADAR_31f40570_Tx: ComBitPosition=160, ComBitSize=15, ComSignalInitValue=16384, ComSignalType=UINT16, ComSystemTemplateSystemSignalRef=DET_RANGE_VELOCITY_270
            DET_RANGE_VELOCITY_271_oRDR_DETECTION_269_272_oPCAN_RADAR_a484d1e5_Tx: ComBitPosition=272, ComBitSize=15, ComSignalInitValue=16384, ComSignalType=UINT16, ComSystemTemplateSystemSignalRef=DET_RANGE_VELOCITY_271
            DET_RANGE_VELOCITY_272_oRDR_DETECTION_269_272_oPCAN_RADAR_c064aa1b_Tx: ComBitPosition=384, ComBitSize=15, ComSignalInitValue=16384, ComSignalType=UINT16, ComSystemTemplateSystemSignalRef=DET_RANGE_VELOCITY_272
            DET_RANGE_VELOCITY_ERR_269_oRDR_DETECTION_269_272_oPCAN_RADAR_5b6f8c66_Tx: ComBitPosition=64, ComBitSize=8, ComSignalInitValue=0, ComSignalType=UINT8, ComSystemTemplateSystemSignalRef=DET_RANGE_VELOCITY_ERR_269
            DET_RANGE_VELOCITY_ERR_270_oRDR_DETECTION_269_272_oPCAN_RADAR_3e4ffec2_Tx: ComBitPosition=176, ComBitSize=8, ComSignalInitValue=0, ComSignalType=UINT8, ComSystemTemplateSystemSignalRef=DET_RANGE_VELOCITY_ERR_270
            DET_RANGE_VELOCITY_ERR_271_oRDR_DETECTION_269_272_oPCAN_RADAR_ab3f2a57_Tx: ComBitPosition=288, ComBitSize=8, ComSignalInitValue=0, ComSignalType=UINT8, ComSystemTemplateSystemSignalRef=DET_RANGE_VELOCITY_ERR_271
            DET_RANGE_VELOCITY_ERR_272_oRDR_DETECTION_269_272_oPCAN_RADAR_cfdf51a9_Tx: ComBitPosition=400, ComBitSize=8, ComSignalInitValue=0, ComSignalType=UINT8, ComSystemTemplateSystemSignalRef=DET_RANGE_VELOCITY_ERR_272
            DET_RCS_269_oRDR_DETECTION_269_272_oPCAN_RADAR_d354408e_Tx: ComBitPosition=128, ComBitSize=8, ComSignalInitValue=128, ComSignalType=UINT8, ComSystemTemplateSystemSignalRef=DET_RCS_269
            DET_RCS_270_oRDR_DETECTION_269_272_oPCAN_RADAR_b674322a_Tx: ComBitPosition=240, ComBitSize=8, ComSignalInitValue=128, ComSignalType=UINT8, ComSystemTemplateSystemSignalRef=DET_RCS_270
            DET_RCS_271_oRDR_DETECTION_269_272_oPCAN_RADAR_2304e6bf_Tx: ComBitPosition=352, ComBitSize=8, ComSignalInitValue=128, ComSignalType=UINT8, ComSystemTemplateSystemSignalRef=DET_RCS_271
            DET_RCS_272_oRDR_DETECTION_269_272_oPCAN_RADAR_47e49d41_Tx: ComBitPosition=464, ComBitSize=8, ComSignalInitValue=128, ComSignalType=UINT8, ComSystemTemplateSystemSignalRef=DET_RCS_272
            DET_SNR_269_oRDR_DETECTION_269_272_oPCAN_RADAR_0efa148c_Tx: ComBitPosition=120, ComBitSize=8, ComSignalInitValue=0, ComSignalType=UINT8, ComSystemTemplateSystemSignalRef=DET_SNR_269
            DET_SNR_270_oRDR_DETECTION_269_272_oPCAN_RADAR_6bda6628_Tx: ComBitPosition=232, ComBitSize=8, ComSignalInitValue=0, ComSignalType=UINT8, ComSystemTemplateSystemSignalRef=DET_SNR_270
            DET_SNR_271_oRDR_DETECTION_269_272_oPCAN_RADAR_feaab2bd_Tx: ComBitPosition=344, ComBitSize=8, ComSignalInitValue=0, ComSignalType=UINT8, ComSystemTemplateSystemSignalRef=DET_SNR_271
            DET_SNR_272_oRDR_DETECTION_269_272_oPCAN_RADAR_9a4ac943_Tx: ComBitPosition=456, ComBitSize=8, ComSignalInitValue=0, ComSignalType=UINT8, ComSystemTemplateSystemSignalRef=DET_SNR_272
            DET_SUPER_RES_TARGET_269_oRDR_DETECTION_269_272_oPCAN_RADAR_3f633ce9_Tx: ComBitPosition=87, ComBitSize=1, ComSignalInitValue=0, ComSignalType=BOOLEAN, ComSystemTemplateSystemSignalRef=DET_SUPER_RES_TARGET_269
            DET_SUPER_RES_TARGET_270_oRDR_DETECTION_269_272_oPCAN_RADAR_5a434e4d_Tx: ComBitPosition=199, ComBitSize=1, ComSignalInitValue=0, ComSignalType=BOOLEAN, ComSystemTemplateSystemSignalRef=DET_SUPER_RES_TARGET_270
            DET_SUPER_RES_TARGET_271_oRDR_DETECTION_269_272_oPCAN_RADAR_cf339ad8_Tx: ComBitPosition=311, ComBitSize=1, ComSignalInitValue=0, ComSignalType=BOOLEAN, ComSystemTemplateSystemSignalRef=DET_SUPER_RES_TARGET_271
            DET_SUPER_RES_TARGET_272_oRDR_DETECTION_269_272_oPCAN_RADAR_abd3e126_Tx: ComBitPosition=423, ComBitSize=1, ComSignalInitValue=0, ComSignalType=BOOLEAN, ComSystemTemplateSystemSignalRef=DET_SUPER_RES_TARGET_272
        SG_Detections_273_276_oRDR_DETECTION_273_276_oPCAN_RADAR_df34482a_Tx: ComSystemTemplateSignalGroupRef=SG_Detections_273_276
          83 x ComGroupSignal, all with ComSignalEndianness=LITTLE_ENDIAN, ComTransferProperty=PENDING:
            DET_AZIMUTH_273_oRDR_DETECTION_273_276_oPCAN_RADAR_2deecc3e_Tx: ComBitPosition=88, ComBitSize=13, ComSignalInitValue=0, ComSignalType=UINT16, ComSystemTemplateSystemSignalRef=DET_AZIMUTH_273
            DET_AZIMUTH_274_oRDR_DETECTION_273_276_oPCAN_RADAR_715eef57_Tx: ComBitPosition=200, ComBitSize=13, ComSignalInitValue=0, ComSignalType=UINT16, ComSystemTemplateSystemSignalRef=DET_AZIMUTH_274
            DET_AZIMUTH_275_oRDR_DETECTION_273_276_oPCAN_RADAR_e42e3bc2_Tx: ComBitPosition=312, ComBitSize=13, ComSignalInitValue=0, ComSignalType=UINT16, ComSystemTemplateSystemSignalRef=DET_AZIMUTH_275
            DET_AZIMUTH_276_oRDR_DETECTION_273_276_oPCAN_RADAR_80ce403c_Tx: ComBitPosition=424, ComBitSize=13, ComSignalInitValue=0, ComSignalType=UINT16, ComSystemTemplateSystemSignalRef=DET_AZIMUTH_276
            DET_AZIMUTH_ERR_273_oRDR_DETECTION_273_276_oPCAN_RADAR_895b59cb_Tx: ComBitPosition=105, ComBitSize=7, ComSignalInitValue=0, ComSignalType=UINT8, ComSystemTemplateSystemSignalRef=DET_AZIMUTH_ERR_273
            DET_AZIMUTH_ERR_274_oRDR_DETECTION_273_276_oPCAN_RADAR_d5eb7aa2_Tx: ComBitPosition=217, ComBitSize=7, ComSignalInitValue=0, ComSignalType=UINT8, ComSystemTemplateSystemSignalRef=DET_AZIMUTH_ERR_274
            DET_AZIMUTH_ERR_275_oRDR_DETECTION_273_276_oPCAN_RADAR_409bae37_Tx: ComBitPosition=329, ComBitSize=7, ComSignalInitValue=0, ComSignalType=UINT8, ComSystemTemplateSystemSignalRef=DET_AZIMUTH_ERR_275
            DET_AZIMUTH_ERR_276_oRDR_DETECTION_273_276_oPCAN_RADAR_247bd5c9_Tx: ComBitPosition=441, ComBitSize=7, ComSignalInitValue=0, ComSignalType=UINT8, ComSystemTemplateSystemSignalRef=DET_AZIMUTH_ERR_276
            DET_BELOW_RAIN_THOLD_273_oRDR_DETECTION_273_276_oPCAN_RADAR_f8ef5ffe_Tx: ComBitPosition=39, ComBitSize=1, ComSignalInitValue=0, ComSignalType=BOOLEAN, ComSystemTemplateSystemSignalRef=DET_BELOW_RAIN_THOLD_273
            DET_BELOW_RAIN_THOLD_274_oRDR_DETECTION_273_276_oPCAN_RADAR_a45f7c97_Tx: ComBitPosition=151, ComBitSize=1, ComSignalInitValue=0, ComSignalType=BOOLEAN, ComSystemTemplateSystemSignalRef=DET_BELOW_RAIN_THOLD_274
            DET_BELOW_RAIN_THOLD_275_oRDR_DETECTION_273_276_oPCAN_RADAR_312fa802_Tx: ComBitPosition=263, ComBitSize=1, ComSignalInitValue=0, ComSignalType=BOOLEAN, ComSystemTemplateSystemSignalRef=DET_BELOW_RAIN_THOLD_275
            DET_BELOW_RAIN_THOLD_276_oRDR_DETECTION_273_276_oPCAN_RADAR_55cfd3fc_Tx: ComBitPosition=375, ComBitSize=1, ComSignalInitValue=0, ComSignalType=BOOLEAN, ComSystemTemplateSystemSignalRef=DET_BELOW_RAIN_THOLD_276
            DET_BI_STATIC_FLAG_273_oRDR_DETECTION_273_276_oPCAN_RADAR_7bc28cbb_Tx: ComBitPosition=104, ComBitSize=1, ComSignalInitValue=0, ComSignalType=BOOLEAN, ComSystemTemplateSystemSignalRef=DET_BI_STATIC_FLAG_273
            DET_BI_STATIC_FLAG_274_oRDR_DETECTION_273_276_oPCAN_RADAR_2772afd2_Tx: ComBitPosition=216, ComBitSize=1, ComSignalInitValue=0, ComSignalType=BOOLEAN, ComSystemTemplateSystemSignalRef=DET_BI_STATIC_FLAG_274
            DET_BI_STATIC_FLAG_275_oRDR_DETECTION_273_276_oPCAN_RADAR_b2027b47_Tx: ComBitPosition=328, ComBitSize=1, ComSignalInitValue=0, ComSignalType=BOOLEAN, ComSystemTemplateSystemSignalRef=DET_BI_STATIC_FLAG_275
            DET_BI_STATIC_FLAG_276_oRDR_DETECTION_273_276_oPCAN_RADAR_d6e200b9_Tx: ComBitPosition=440, ComBitSize=1, ComSignalInitValue=0, ComSignalType=BOOLEAN, ComSystemTemplateSystemSignalRef=DET_BI_STATIC_FLAG_276
            DET_CONFD_AZIMUTH_273_oRDR_DETECTION_273_276_oPCAN_RADAR_2f08c6f4_Tx: ComBitPosition=118, ComBitSize=2, ComSignalInitValue=0, ComSignalType=UINT8, ComSystemTemplateSystemSignalRef=DET_CONFD_AZIMUTH_273
            DET_CONFD_AZIMUTH_274_oRDR_DETECTION_273_276_oPCAN_RADAR_73b8e59d_Tx: ComBitPosition=230, ComBitSize=2, ComSignalInitValue=0, ComSignalType=UINT8, ComSystemTemplateSystemSignalRef=DET_CONFD_AZIMUTH_274
            DET_CONFD_AZIMUTH_275_oRDR_DETECTION_273_276_oPCAN_RADAR_e6c83108_Tx: ComBitPosition=342, ComBitSize=2, ComSignalInitValue=0, ComSignalType=UINT8, ComSystemTemplateSystemSignalRef=DET_CONFD_AZIMUTH_275
            DET_CONFD_AZIMUTH_276_oRDR_DETECTION_273_276_oPCAN_RADAR_82284af6_Tx: ComBitPosition=454, ComBitSize=2, ComSignalInitValue=0, ComSignalType=UINT8, ComSystemTemplateSystemSignalRef=DET_CONFD_AZIMUTH_276
            DET_CONFD_ELEVATION_273_oRDR_DETECTION_273_276_oPCAN_RADAR_2d9dc70e_Tx: ComBitPosition=101, ComBitSize=2, ComSignalInitValue=0, ComSignalType=UINT8, ComSystemTemplateSystemSignalRef=DET_CONFD_ELEVATION_273
            DET_CONFD_ELEVATION_274_oRDR_DETECTION_273_276_oPCAN_RADAR_712de467_Tx: ComBitPosition=213, ComBitSize=2, ComSignalInitValue=0, ComSignalType=UINT8, ComSystemTemplateSystemSignalRef=DET_CONFD_ELEVATION_274
            DET_CONFD_ELEVATION_275_oRDR_DETECTION_273_276_oPCAN_RADAR_e45d30f2_Tx: ComBitPosition=325, ComBitSize=2, ComSignalInitValue=0, ComSignalType=UINT8, ComSystemTemplateSystemSignalRef=DET_CONFD_ELEVATION_275
            DET_CONFD_ELEVATION_276_oRDR_DETECTION_273_276_oPCAN_RADAR_80bd4b0c_Tx: ComBitPosition=437, ComBitSize=2, ComSignalInitValue=0, ComSignalType=UINT8, ComSystemTemplateSystemSignalRef=DET_CONFD_ELEVATION_276
            DET_ELEVATION_273_oRDR_DETECTION_273_276_oPCAN_RADAR_fc5d1332_Tx: ComBitPosition=72, ComBitSize=8, ComSignalInitValue=0, ComSignalType=UINT8, ComSystemTemplateSystemSignalRef=DET_ELEVATION_273
            DET_ELEVATION_274_oRDR_DETECTION_273_276_oPCAN_RADAR_a0ed305b_Tx: ComBitPosition=184, ComBitSize=8, ComSignalInitValue=0, ComSignalType=UINT8, ComSystemTemplateSystemSignalRef=DET_ELEVATION_274
            DET_ELEVATION_275_oRDR_DETECTION_273_276_oPCAN_RADAR_359de4ce_Tx: ComBitPosition=296, ComBitSize=8, ComSignalInitValue=0, ComSignalType=UINT8, ComSystemTemplateSystemSignalRef=DET_ELEVATION_275
            DET_ELEVATION_276_oRDR_DETECTION_273_276_oPCAN_RADAR_517d9f30_Tx: ComBitPosition=408, ComBitSize=8, ComSignalInitValue=0, ComSignalType=UINT8, ComSystemTemplateSystemSignalRef=DET_ELEVATION_276
            DET_ELEVATION_ERR_273_oRDR_DETECTION_273_276_oPCAN_RADAR_7b648b47_Tx: ComBitPosition=80, ComBitSize=6, ComSignalInitValue=0, ComSignalType=UINT8, ComSystemTemplateSystemSignalRef=DET_ELEVATION_ERR_273
            DET_ELEVATION_ERR_274_oRDR_DETECTION_273_276_oPCAN_RADAR_27d4a82e_Tx: ComBitPosition=192, ComBitSize=6, ComSignalInitValue=0, ComSignalType=UINT8, ComSystemTemplateSystemSignalRef=DET_ELEVATION_ERR_274
            DET_ELEVATION_ERR_275_oRDR_DETECTION_273_276_oPCAN_RADAR_b2a47cbb_Tx: ComBitPosition=304, ComBitSize=6, ComSignalInitValue=0, ComSignalType=UINT8, ComSystemTemplateSystemSignalRef=DET_ELEVATION_ERR_275
            DET_ELEVATION_ERR_276_oRDR_DETECTION_273_276_oPCAN_RADAR_d6440745_Tx: ComBitPosition=416, ComBitSize=6, ComSignalInitValue=0, ComSignalType=UINT8, ComSystemTemplateSystemSignalRef=DET_ELEVATION_ERR_276
            DET_EXISTENCE_PROB_273_oRDR_DETECTION_273_276_oPCAN_RADAR_a9fbfe27_Tx: ComBitPosition=112, ComBitSize=6, ComSignalInitValue=0, ComSignalType=UINT8, ComSystemTemplateSystemSignalRef=DET_EXISTENCE_PROB_273
            DET_EXISTENCE_PROB_274_oRDR_DETECTION_273_276_oPCAN_RADAR_f54bdd4e_Tx: ComBitPosition=224, ComBitSize=6, ComSignalInitValue=0, ComSignalType=UINT8, ComSystemTemplateSystemSignalRef=DET_EXISTENCE_PROB_274
            DET_EXISTENCE_PROB_275_oRDR_DETECTION_273_276_oPCAN_RADAR_603b09db_Tx: ComBitPosition=336, ComBitSize=6, ComSignalInitValue=0, ComSignalType=UINT8, ComSystemTemplateSystemSignalRef=DET_EXISTENCE_PROB_275
            DET_EXISTENCE_PROB_276_oRDR_DETECTION_273_276_oPCAN_RADAR_04db7225_Tx: ComBitPosition=448, ComBitSize=6, ComSignalInitValue=0, ComSignalType=UINT8, ComSystemTemplateSystemSignalRef=DET_EXISTENCE_PROB_276
            DET_HVC_FLAG_273_oRDR_DETECTION_273_276_oPCAN_RADAR_488fbd58_Tx: ComBitPosition=86, ComBitSize=1, ComSignalInitValue=0, ComSignalType=BOOLEAN, ComSystemTemplateSystemSignalRef=DET_HVC_FLAG_273
            DET_HVC_FLAG_274_oRDR_DETECTION_273_276_oPCAN_RADAR_143f9e31_Tx: ComBitPosition=198, ComBitSize=1, ComSignalInitValue=0, ComSignalType=BOOLEAN, ComSystemTemplateSystemSignalRef=DET_HVC_FLAG_274
            DET_HVC_FLAG_275_oRDR_DETECTION_273_276_oPCAN_RADAR_814f4aa4_Tx: ComBitPosition=310, ComBitSize=1, ComSignalInitValue=0, ComSignalType=BOOLEAN, ComSystemTemplateSystemSignalRef=DET_HVC_FLAG_275
            DET_HVC_FLAG_276_oRDR_DETECTION_273_276_oPCAN_RADAR_e5af315a_Tx: ComBitPosition=422, ComBitSize=1, ComSignalInitValue=0, ComSignalType=BOOLEAN, ComSystemTemplateSystemSignalRef=DET_HVC_FLAG_276
            DET_IDM_273_oRDR_DETECTION_273_276_oPCAN_RADAR_c3dd86e5_Tx: ComBitPosition=63, ComBitSize=1, ComSignalInitValue=0, ComSignalType=BOOLEAN, ComSystemTemplateSystemSignalRef=DET_IDM_273
            DET_IDM_274_oRDR_DETECTION_273_276_oPCAN_RADAR_9f6da58c_Tx: ComBitPosition=175, ComBitSize=1, ComSignalInitValue=0, ComSignalType=BOOLEAN, ComSystemTemplateSystemSignalRef=DET_IDM_274
            DET_IDM_275_oRDR_DETECTION_273_276_oPCAN_RADAR_0a1d7119_Tx: ComBitPosition=287, ComBitSize=1, ComSignalInitValue=0, ComSignalType=BOOLEAN, ComSystemTemplateSystemSignalRef=DET_IDM_275
            DET_IDM_276_oRDR_DETECTION_273_276_oPCAN_RADAR_6efd0ae7_Tx: ComBitPosition=399, ComBitSize=1, ComSignalInitValue=0, ComSignalType=BOOLEAN, ComSystemTemplateSystemSignalRef=DET_IDM_276
            DET_MH_CRC16_273_276_oRDR_DETECTION_273_276_oPCAN_RADAR_5bbc9a21_Tx: ComBitPosition=0, ComBitSize=16, ComSignalInitValue=0, ComSignalType=UINT16, ComSystemTemplateSystemSignalRef=DET_MH_CRC16_273_276
            DET_MH_CYCLE_COUNTER_273_276_oRDR_DETECTION_273_276_oPCAN_RADAR_dfc93b16_Tx: ComBitPosition=16, ComBitSize=8, ComSignalInitValue=0, ComSignalType=UINT8, ComSystemTemplateSystemSignalRef=DET_MH_CYCLE_COUNTER_273_276
            DET_MH_SCAN_INDEX_4LSB_273_276_oRDR_DETECTION_273_276_oPCAN_RADAR_13e31e9a_Tx: ComBitPosition=476, ComBitSize=4, ComSignalInitValue=0, ComSignalType=UINT8, ComSystemTemplateSystemSignalRef=DET_MH_SCAN_INDEX_4LSB_273_276
            DET_MTD_273_oRDR_DETECTION_273_276_oPCAN_RADAR_a56eb43e_Tx: ComBitPosition=47, ComBitSize=1, ComSignalInitValue=0, ComSignalType=BOOLEAN, ComSystemTemplateSystemSignalRef=DET_MTD_273
            DET_MTD_274_oRDR_DETECTION_273_276_oPCAN_RADAR_f9de9757_Tx: ComBitPosition=159, ComBitSize=1, ComSignalInitValue=0, ComSignalType=BOOLEAN, ComSystemTemplateSystemSignalRef=DET_MTD_274
            DET_MTD_275_oRDR_DETECTION_273_276_oPCAN_RADAR_6cae43c2_Tx: ComBitPosition=271, ComBitSize=1, ComSignalInitValue=0, ComSignalType=BOOLEAN, ComSystemTemplateSystemSignalRef=DET_MTD_275
            DET_MTD_276_oRDR_DETECTION_273_276_oPCAN_RADAR_084e383c_Tx: ComBitPosition=383, ComBitSize=1, ComSignalInitValue=0, ComSignalType=BOOLEAN, ComSystemTemplateSystemSignalRef=DET_MTD_276
            DET_PROB_1STAZHYPO_273_oRDR_DETECTION_273_276_oPCAN_RADAR_36da5cf3_Tx: ComBitPosition=103, ComBitSize=1, ComSignalInitValue=0, ComSignalType=BOOLEAN, ComSystemTemplateSystemSignalRef=DET_PROB_1STAZHYPO_273
            DET_PROB_1STAZHYPO_274_oRDR_DETECTION_273_276_oPCAN_RADAR_6a6a7f9a_Tx: ComBitPosition=215, ComBitSize=1, ComSignalInitValue=0, ComSignalType=BOOLEAN, ComSystemTemplateSystemSignalRef=DET_PROB_1STAZHYPO_274
            DET_PROB_1STAZHYPO_275_oRDR_DETECTION_273_276_oPCAN_RADAR_ff1aab0f_Tx: ComBitPosition=327, ComBitSize=1, ComSignalInitValue=0, ComSignalType=BOOLEAN, ComSystemTemplateSystemSignalRef=DET_PROB_1STAZHYPO_275
            DET_PROB_1STAZHYPO_276_oRDR_DETECTION_273_276_oPCAN_RADAR_9bfad0f1_Tx: ComBitPosition=439, ComBitSize=1, ComSignalInitValue=0, ComSignalType=BOOLEAN, ComSystemTemplateSystemSignalRef=DET_PROB_1STAZHYPO_276
            DET_RANGE_273_oRDR_DETECTION_273_276_oPCAN_RADAR_3d75bf85_Tx: ComBitPosition=24, ComBitSize=15, ComSignalInitValue=0, ComSignalType=UINT16, ComSystemTemplateSystemSignalRef=DET_RANGE_273
            DET_RANGE_274_oRDR_DETECTION_273_276_oPCAN_RADAR_61c59cec_Tx: ComBitPosition=136, ComBitSize=15, ComSignalInitValue=0, ComSignalType=UINT16, ComSystemTemplateSystemSignalRef=DET_RANGE_274
            DET_RANGE_275_oRDR_DETECTION_273_276_oPCAN_RADAR_f4b54879_Tx: ComBitPosition=248, ComBitSize=15, ComSignalInitValue=0, ComSignalType=UINT16, ComSystemTemplateSystemSignalRef=DET_RANGE_275
            DET_RANGE_276_oRDR_DETECTION_273_276_oPCAN_RADAR_90553387_Tx: ComBitPosition=360, ComBitSize=15, ComSignalInitValue=0, ComSignalType=UINT16, ComSystemTemplateSystemSignalRef=DET_RANGE_276
            DET_RANGE_ERR_273_oRDR_DETECTION_273_276_oPCAN_RADAR_9a9d05ec_Tx: ComBitPosition=40, ComBitSize=7, ComSignalInitValue=0, ComSignalType=UINT8, ComSystemTemplateSystemSignalRef=DET_RANGE_ERR_273
            DET_RANGE_ERR_274_oRDR_DETECTION_273_276_oPCAN_RADAR_c62d2685_Tx: ComBitPosition=152, ComBitSize=7, ComSignalInitValue=0, ComSignalType=UINT8, ComSystemTemplateSystemSignalRef=DET_RANGE_ERR_274
            DET_RANGE_ERR_275_oRDR_DETECTION_273_276_oPCAN_RADAR_535df210_Tx: ComBitPosition=264, ComBitSize=7, ComSignalInitValue=0, ComSignalType=UINT8, ComSystemTemplateSystemSignalRef=DET_RANGE_ERR_275
            DET_RANGE_ERR_276_oRDR_DETECTION_273_276_oPCAN_RADAR_37bd89ee_Tx: ComBitPosition=376, ComBitSize=7, ComSignalInitValue=0, ComSignalType=UINT8, ComSystemTemplateSystemSignalRef=DET_RANGE_ERR_276
            DET_RANGE_VELOCITY_273_oRDR_DETECTION_273_276_oPCAN_RADAR_48d37da0_Tx: ComBitPosition=48, ComBitSize=15, ComSignalInitValue=16384, ComSignalType=UINT16, ComSystemTemplateSystemSignalRef=DET_RANGE_VELOCITY_273
            DET_RANGE_VELOCITY_274_oRDR_DETECTION_273_276_oPCAN_RADAR_14635ec9_Tx: ComBitPosition=160, ComBitSize=15, ComSignalInitValue=16384, ComSignalType=UINT16, ComSystemTemplateSystemSignalRef=DET_RANGE_VELOCITY_274
            DET_RANGE_VELOCITY_275_oRDR_DETECTION_273_276_oPCAN_RADAR_81138a5c_Tx: ComBitPosition=272, ComBitSize=15, ComSignalInitValue=16384, ComSignalType=UINT16, ComSystemTemplateSystemSignalRef=DET_RANGE_VELOCITY_275
            DET_RANGE_VELOCITY_276_oRDR_DETECTION_273_276_oPCAN_RADAR_e5f3f1a2_Tx: ComBitPosition=384, ComBitSize=15, ComSignalInitValue=16384, ComSignalType=UINT16, ComSystemTemplateSystemSignalRef=DET_RANGE_VELOCITY_276
            DET_RANGE_VELOCITY_ERR_273_oRDR_DETECTION_273_276_oPCAN_RADAR_47688612_Tx: ComBitPosition=64, ComBitSize=8, ComSignalInitValue=0, ComSignalType=UINT8, ComSystemTemplateSystemSignalRef=DET_RANGE_VELOCITY_ERR_273
            DET_RANGE_VELOCITY_ERR_274_oRDR_DETECTION_273_276_oPCAN_RADAR_1bd8a57b_Tx: ComBitPosition=176, ComBitSize=8, ComSignalInitValue=0, ComSignalType=UINT8, ComSystemTemplateSystemSignalRef=DET_RANGE_VELOCITY_ERR_274
            DET_RANGE_VELOCITY_ERR_275_oRDR_DETECTION_273_276_oPCAN_RADAR_8ea871ee_Tx: ComBitPosition=288, ComBitSize=8, ComSignalInitValue=0, ComSignalType=UINT8, ComSystemTemplateSystemSignalRef=DET_RANGE_VELOCITY_ERR_275
            DET_RANGE_VELOCITY_ERR_276_oRDR_DETECTION_273_276_oPCAN_RADAR_ea480a10_Tx: ComBitPosition=400, ComBitSize=8, ComSignalInitValue=0, ComSignalType=UINT8, ComSystemTemplateSystemSignalRef=DET_RANGE_VELOCITY_ERR_276
            DET_RCS_273_oRDR_DETECTION_273_276_oPCAN_RADAR_cf534afa_Tx: ComBitPosition=128, ComBitSize=8, ComSignalInitValue=128, ComSignalType=UINT8, ComSystemTemplateSystemSignalRef=DET_RCS_273
            DET_RCS_274_oRDR_DETECTION_273_276_oPCAN_RADAR_93e36993_Tx: ComBitPosition=240, ComBitSize=8, ComSignalInitValue=128, ComSignalType=UINT8, ComSystemTemplateSystemSignalRef=DET_RCS_274
            DET_RCS_275_oRDR_DETECTION_273_276_oPCAN_RADAR_0693bd06_Tx: ComBitPosition=352, ComBitSize=8, ComSignalInitValue=128, ComSignalType=UINT8, ComSystemTemplateSystemSignalRef=DET_RCS_275
            DET_RCS_276_oRDR_DETECTION_273_276_oPCAN_RADAR_6273c6f8_Tx: ComBitPosition=464, ComBitSize=8, ComSignalInitValue=128, ComSignalType=UINT8, ComSystemTemplateSystemSignalRef=DET_RCS_276
            DET_SNR_273_oRDR_DETECTION_273_276_oPCAN_RADAR_12fd1ef8_Tx: ComBitPosition=120, ComBitSize=8, ComSignalInitValue=0, ComSignalType=UINT8, ComSystemTemplateSystemSignalRef=DET_SNR_273
            DET_SNR_274_oRDR_DETECTION_273_276_oPCAN_RADAR_4e4d3d91_Tx: ComBitPosition=232, ComBitSize=8, ComSignalInitValue=0, ComSignalType=UINT8, ComSystemTemplateSystemSignalRef=DET_SNR_274
            DET_SNR_275_oRDR_DETECTION_273_276_oPCAN_RADAR_db3de904_Tx: ComBitPosition=344, ComBitSize=8, ComSignalInitValue=0, ComSignalType=UINT8, ComSystemTemplateSystemSignalRef=DET_SNR_275
            DET_SNR_276_oRDR_DETECTION_273_276_oPCAN_RADAR_bfdd92fa_Tx: ComBitPosition=456, ComBitSize=8, ComSignalInitValue=0, ComSignalType=UINT8, ComSystemTemplateSystemSignalRef=DET_SNR_276
            DET_SUPER_RES_TARGET_273_oRDR_DETECTION_273_276_oPCAN_RADAR_2364369d_Tx: ComBitPosition=87, ComBitSize=1, ComSignalInitValue=0, ComSignalType=BOOLEAN, ComSystemTemplateSystemSignalRef=DET_SUPER_RES_TARGET_273
            DET_SUPER_RES_TARGET_274_oRDR_DETECTION_273_276_oPCAN_RADAR_7fd415f4_Tx: ComBitPosition=199, ComBitSize=1, ComSignalInitValue=0, ComSignalType=BOOLEAN, ComSystemTemplateSystemSignalRef=DET_SUPER_RES_TARGET_274
            DET_SUPER_RES_TARGET_275_oRDR_DETECTION_273_276_oPCAN_RADAR_eaa4c161_Tx: ComBitPosition=311, ComBitSize=1, ComSignalInitValue=0, ComSignalType=BOOLEAN, ComSystemTemplateSystemSignalRef=DET_SUPER_RES_TARGET_275
            DET_SUPER_RES_TARGET_276_oRDR_DETECTION_273_276_oPCAN_RADAR_8e44ba9f_Tx: ComBitPosition=423, ComBitSize=1, ComSignalInitValue=0, ComSignalType=BOOLEAN, ComSystemTemplateSystemSignalRef=DET_SUPER_RES_TARGET_276
        SG_Detections_277_280_oRDR_DETECTION_277_280_oPCAN_RADAR_ab98744c_Tx: ComSystemTemplateSignalGroupRef=SG_Detections_277_280
          83 x ComGroupSignal, all with ComSignalEndianness=LITTLE_ENDIAN, ComTransferProperty=PENDING:
            DET_AZIMUTH_277_oRDR_DETECTION_277_280_oPCAN_RADAR_90c7d84d_Tx: ComBitPosition=88, ComBitSize=13, ComSignalInitValue=0, ComSignalType=UINT16, ComSystemTemplateSystemSignalRef=DET_AZIMUTH_277
            DET_AZIMUTH_278_oRDR_DETECTION_277_280_oPCAN_RADAR_bcd74a0a_Tx: ComBitPosition=200, ComBitSize=13, ComSignalInitValue=0, ComSignalType=UINT16, ComSystemTemplateSystemSignalRef=DET_AZIMUTH_278
            DET_AZIMUTH_279_oRDR_DETECTION_277_280_oPCAN_RADAR_29a79e9f_Tx: ComBitPosition=312, ComBitSize=13, ComSignalInitValue=0, ComSignalType=UINT16, ComSystemTemplateSystemSignalRef=DET_AZIMUTH_279
            DET_AZIMUTH_280_oRDR_DETECTION_277_280_oPCAN_RADAR_24e33f85_Tx: ComBitPosition=424, ComBitSize=13, ComSignalInitValue=0, ComSignalType=UINT16, ComSystemTemplateSystemSignalRef=DET_AZIMUTH_280
            DET_AZIMUTH_ERR_277_oRDR_DETECTION_277_280_oPCAN_RADAR_34724db8_Tx: ComBitPosition=105, ComBitSize=7, ComSignalInitValue=0, ComSignalType=UINT8, ComSystemTemplateSystemSignalRef=DET_AZIMUTH_ERR_277
            DET_AZIMUTH_ERR_278_oRDR_DETECTION_277_280_oPCAN_RADAR_1862dfff_Tx: ComBitPosition=217, ComBitSize=7, ComSignalInitValue=0, ComSignalType=UINT8, ComSystemTemplateSystemSignalRef=DET_AZIMUTH_ERR_278
            DET_AZIMUTH_ERR_279_oRDR_DETECTION_277_280_oPCAN_RADAR_8d120b6a_Tx: ComBitPosition=329, ComBitSize=7, ComSignalInitValue=0, ComSignalType=UINT8, ComSystemTemplateSystemSignalRef=DET_AZIMUTH_ERR_279
            DET_AZIMUTH_ERR_280_oRDR_DETECTION_277_280_oPCAN_RADAR_8056aa70_Tx: ComBitPosition=441, ComBitSize=7, ComSignalInitValue=0, ComSignalType=UINT8, ComSystemTemplateSystemSignalRef=DET_AZIMUTH_ERR_280
            DET_BELOW_RAIN_THOLD_277_oRDR_DETECTION_277_280_oPCAN_RADAR_45c64b8d_Tx: ComBitPosition=39, ComBitSize=1, ComSignalInitValue=0, ComSignalType=BOOLEAN, ComSystemTemplateSystemSignalRef=DET_BELOW_RAIN_THOLD_277
            DET_BELOW_RAIN_THOLD_278_oRDR_DETECTION_277_280_oPCAN_RADAR_69d6d9ca_Tx: ComBitPosition=151, ComBitSize=1, ComSignalInitValue=0, ComSignalType=BOOLEAN, ComSystemTemplateSystemSignalRef=DET_BELOW_RAIN_THOLD_278
            DET_BELOW_RAIN_THOLD_279_oRDR_DETECTION_277_280_oPCAN_RADAR_fca60d5f_Tx: ComBitPosition=263, ComBitSize=1, ComSignalInitValue=0, ComSignalType=BOOLEAN, ComSystemTemplateSystemSignalRef=DET_BELOW_RAIN_THOLD_279
            DET_BELOW_RAIN_THOLD_280_oRDR_DETECTION_277_280_oPCAN_RADAR_f1e2ac45_Tx: ComBitPosition=375, ComBitSize=1, ComSignalInitValue=0, ComSignalType=BOOLEAN, ComSystemTemplateSystemSignalRef=DET_BELOW_RAIN_THOLD_280
            DET_BI_STATIC_FLAG_277_oRDR_DETECTION_277_280_oPCAN_RADAR_c6eb98c8_Tx: ComBitPosition=104, ComBitSize=1, ComSignalInitValue=0, ComSignalType=BOOLEAN, ComSystemTemplateSystemSignalRef=DET_BI_STATIC_FLAG_277
            DET_BI_STATIC_FLAG_278_oRDR_DETECTION_277_280_oPCAN_RADAR_eafb0a8f_Tx: ComBitPosition=216, ComBitSize=1, ComSignalInitValue=0, ComSignalType=BOOLEAN, ComSystemTemplateSystemSignalRef=DET_BI_STATIC_FLAG_278
            DET_BI_STATIC_FLAG_279_oRDR_DETECTION_277_280_oPCAN_RADAR_7f8bde1a_Tx: ComBitPosition=328, ComBitSize=1, ComSignalInitValue=0, ComSignalType=BOOLEAN, ComSystemTemplateSystemSignalRef=DET_BI_STATIC_FLAG_279
            DET_BI_STATIC_FLAG_280_oRDR_DETECTION_277_280_oPCAN_RADAR_72cf7f00_Tx: ComBitPosition=440, ComBitSize=1, ComSignalInitValue=0, ComSignalType=BOOLEAN, ComSystemTemplateSystemSignalRef=DET_BI_STATIC_FLAG_280
            DET_CONFD_AZIMUTH_277_oRDR_DETECTION_277_280_oPCAN_RADAR_9221d287_Tx: ComBitPosition=118, ComBitSize=2, ComSignalInitValue=0, ComSignalType=UINT8, ComSystemTemplateSystemSignalRef=DET_CONFD_AZIMUTH_277
            DET_CONFD_AZIMUTH_278_oRDR_DETECTION_277_280_oPCAN_RADAR_be3140c0_Tx: ComBitPosition=230, ComBitSize=2, ComSignalInitValue=0, ComSignalType=UINT8, ComSystemTemplateSystemSignalRef=DET_CONFD_AZIMUTH_278
            DET_CONFD_AZIMUTH_279_oRDR_DETECTION_277_280_oPCAN_RADAR_2b419455_Tx: ComBitPosition=342, ComBitSize=2, ComSignalInitValue=0, ComSignalType=UINT8, ComSystemTemplateSystemSignalRef=DET_CONFD_AZIMUTH_279
            DET_CONFD_AZIMUTH_280_oRDR_DETECTION_277_280_oPCAN_RADAR_2605354f_Tx: ComBitPosition=454, ComBitSize=2, ComSignalInitValue=0, ComSignalType=UINT8, ComSystemTemplateSystemSignalRef=DET_CONFD_AZIMUTH_280
            DET_CONFD_ELEVATION_277_oRDR_DETECTION_277_280_oPCAN_RADAR_90b4d37d_Tx: ComBitPosition=101, ComBitSize=2, ComSignalInitValue=0, ComSignalType=UINT8, ComSystemTemplateSystemSignalRef=DET_CONFD_ELEVATION_277
            DET_CONFD_ELEVATION_278_oRDR_DETECTION_277_280_oPCAN_RADAR_bca4413a_Tx: ComBitPosition=213, ComBitSize=2, ComSignalInitValue=0, ComSignalType=UINT8, ComSystemTemplateSystemSignalRef=DET_CONFD_ELEVATION_278
            DET_CONFD_ELEVATION_279_oRDR_DETECTION_277_280_oPCAN_RADAR_29d495af_Tx: ComBitPosition=325, ComBitSize=2, ComSignalInitValue=0, ComSignalType=UINT8, ComSystemTemplateSystemSignalRef=DET_CONFD_ELEVATION_279
            DET_CONFD_ELEVATION_280_oRDR_DETECTION_277_280_oPCAN_RADAR_249034b5_Tx: ComBitPosition=437, ComBitSize=2, ComSignalInitValue=0, ComSignalType=UINT8, ComSystemTemplateSystemSignalRef=DET_CONFD_ELEVATION_280
            DET_ELEVATION_277_oRDR_DETECTION_277_280_oPCAN_RADAR_41740741_Tx: ComBitPosition=72, ComBitSize=8, ComSignalInitValue=0, ComSignalType=UINT8, ComSystemTemplateSystemSignalRef=DET_ELEVATION_277
            DET_ELEVATION_278_oRDR_DETECTION_277_280_oPCAN_RADAR_6d649506_Tx: ComBitPosition=184, ComBitSize=8, ComSignalInitValue=0, ComSignalType=UINT8, ComSystemTemplateSystemSignalRef=DET_ELEVATION_278
            DET_ELEVATION_279_oRDR_DETECTION_277_280_oPCAN_RADAR_f8144193_Tx: ComBitPosition=296, ComBitSize=8, ComSignalInitValue=0, ComSignalType=UINT8, ComSystemTemplateSystemSignalRef=DET_ELEVATION_279
            DET_ELEVATION_280_oRDR_DETECTION_277_280_oPCAN_RADAR_f550e089_Tx: ComBitPosition=408, ComBitSize=8, ComSignalInitValue=0, ComSignalType=UINT8, ComSystemTemplateSystemSignalRef=DET_ELEVATION_280
            DET_ELEVATION_ERR_277_oRDR_DETECTION_277_280_oPCAN_RADAR_c64d9f34_Tx: ComBitPosition=80, ComBitSize=6, ComSignalInitValue=0, ComSignalType=UINT8, ComSystemTemplateSystemSignalRef=DET_ELEVATION_ERR_277
            DET_ELEVATION_ERR_278_oRDR_DETECTION_277_280_oPCAN_RADAR_ea5d0d73_Tx: ComBitPosition=192, ComBitSize=6, ComSignalInitValue=0, ComSignalType=UINT8, ComSystemTemplateSystemSignalRef=DET_ELEVATION_ERR_278
            DET_ELEVATION_ERR_279_oRDR_DETECTION_277_280_oPCAN_RADAR_7f2dd9e6_Tx: ComBitPosition=304, ComBitSize=6, ComSignalInitValue=0, ComSignalType=UINT8, ComSystemTemplateSystemSignalRef=DET_ELEVATION_ERR_279
            DET_ELEVATION_ERR_280_oRDR_DETECTION_277_280_oPCAN_RADAR_726978fc_Tx: ComBitPosition=416, ComBitSize=6, ComSignalInitValue=0, ComSignalType=UINT8, ComSystemTemplateSystemSignalRef=DET_ELEVATION_ERR_280
            DET_EXISTENCE_PROB_277_oRDR_DETECTION_277_280_oPCAN_RADAR_14d2ea54_Tx: ComBitPosition=112, ComBitSize=6, ComSignalInitValue=0, ComSignalType=UINT8, ComSystemTemplateSystemSignalRef=DET_EXISTENCE_PROB_277
            DET_EXISTENCE_PROB_278_oRDR_DETECTION_277_280_oPCAN_RADAR_38c27813_Tx: ComBitPosition=224, ComBitSize=6, ComSignalInitValue=0, ComSignalType=UINT8, ComSystemTemplateSystemSignalRef=DET_EXISTENCE_PROB_278
            DET_EXISTENCE_PROB_279_oRDR_DETECTION_277_280_oPCAN_RADAR_adb2ac86_Tx: ComBitPosition=336, ComBitSize=6, ComSignalInitValue=0, ComSignalType=UINT8, ComSystemTemplateSystemSignalRef=DET_EXISTENCE_PROB_279
            DET_EXISTENCE_PROB_280_oRDR_DETECTION_277_280_oPCAN_RADAR_a0f60d9c_Tx: ComBitPosition=448, ComBitSize=6, ComSignalInitValue=0, ComSignalType=UINT8, ComSystemTemplateSystemSignalRef=DET_EXISTENCE_PROB_280
            DET_HVC_FLAG_277_oRDR_DETECTION_277_280_oPCAN_RADAR_f5a6a92b_Tx: ComBitPosition=86, ComBitSize=1, ComSignalInitValue=0, ComSignalType=BOOLEAN, ComSystemTemplateSystemSignalRef=DET_HVC_FLAG_277
            DET_HVC_FLAG_278_oRDR_DETECTION_277_280_oPCAN_RADAR_d9b63b6c_Tx: ComBitPosition=198, ComBitSize=1, ComSignalInitValue=0, ComSignalType=BOOLEAN, ComSystemTemplateSystemSignalRef=DET_HVC_FLAG_278
            DET_HVC_FLAG_279_oRDR_DETECTION_277_280_oPCAN_RADAR_4cc6eff9_Tx: ComBitPosition=310, ComBitSize=1, ComSignalInitValue=0, ComSignalType=BOOLEAN, ComSystemTemplateSystemSignalRef=DET_HVC_FLAG_279
            DET_HVC_FLAG_280_oRDR_DETECTION_277_280_oPCAN_RADAR_41824ee3_Tx: ComBitPosition=422, ComBitSize=1, ComSignalInitValue=0, ComSignalType=BOOLEAN, ComSystemTemplateSystemSignalRef=DET_HVC_FLAG_280
            DET_IDM_277_oRDR_DETECTION_277_280_oPCAN_RADAR_7ef49296_Tx: ComBitPosition=63, ComBitSize=1, ComSignalInitValue=0, ComSignalType=BOOLEAN, ComSystemTemplateSystemSignalRef=DET_IDM_277
            DET_IDM_278_oRDR_DETECTION_277_280_oPCAN_RADAR_52e400d1_Tx: ComBitPosition=175, ComBitSize=1, ComSignalInitValue=0, ComSignalType=BOOLEAN, ComSystemTemplateSystemSignalRef=DET_IDM_278
            DET_IDM_279_oRDR_DETECTION_277_280_oPCAN_RADAR_c794d444_Tx: ComBitPosition=287, ComBitSize=1, ComSignalInitValue=0, ComSignalType=BOOLEAN, ComSystemTemplateSystemSignalRef=DET_IDM_279
            DET_IDM_280_oRDR_DETECTION_277_280_oPCAN_RADAR_cad0755e_Tx: ComBitPosition=399, ComBitSize=1, ComSignalInitValue=0, ComSignalType=BOOLEAN, ComSystemTemplateSystemSignalRef=DET_IDM_280
            DET_MH_CRC16_277_280_oRDR_DETECTION_277_280_oPCAN_RADAR_2f10a647_Tx: ComBitPosition=0, ComBitSize=16, ComSignalInitValue=0, ComSignalType=UINT16, ComSystemTemplateSystemSignalRef=DET_MH_CRC16_277_280
            DET_MH_CYCLE_COUNTER_277_280_oRDR_DETECTION_277_280_oPCAN_RADAR_ab650770_Tx: ComBitPosition=16, ComBitSize=8, ComSignalInitValue=0, ComSignalType=UINT8, ComSystemTemplateSystemSignalRef=DET_MH_CYCLE_COUNTER_277_280
            DET_MH_SCAN_INDEX_4LSB_277_280_oRDR_DETECTION_277_280_oPCAN_RADAR_674f22fc_Tx: ComBitPosition=476, ComBitSize=4, ComSignalInitValue=0, ComSignalType=UINT8, ComSystemTemplateSystemSignalRef=DET_MH_SCAN_INDEX_4LSB_277_280
            DET_MTD_277_oRDR_DETECTION_277_280_oPCAN_RADAR_1847a04d_Tx: ComBitPosition=47, ComBitSize=1, ComSignalInitValue=0, ComSignalType=BOOLEAN, ComSystemTemplateSystemSignalRef=DET_MTD_277
            DET_MTD_278_oRDR_DETECTION_277_280_oPCAN_RADAR_3457320a_Tx: ComBitPosition=159, ComBitSize=1, ComSignalInitValue=0, ComSignalType=BOOLEAN, ComSystemTemplateSystemSignalRef=DET_MTD_278
            DET_MTD_279_oRDR_DETECTION_277_280_oPCAN_RADAR_a127e69f_Tx: ComBitPosition=271, ComBitSize=1, ComSignalInitValue=0, ComSignalType=BOOLEAN, ComSystemTemplateSystemSignalRef=DET_MTD_279
            DET_MTD_280_oRDR_DETECTION_277_280_oPCAN_RADAR_ac634785_Tx: ComBitPosition=383, ComBitSize=1, ComSignalInitValue=0, ComSignalType=BOOLEAN, ComSystemTemplateSystemSignalRef=DET_MTD_280
            DET_PROB_1STAZHYPO_277_oRDR_DETECTION_277_280_oPCAN_RADAR_8bf34880_Tx: ComBitPosition=103, ComBitSize=1, ComSignalInitValue=0, ComSignalType=BOOLEAN, ComSystemTemplateSystemSignalRef=DET_PROB_1STAZHYPO_277
            DET_PROB_1STAZHYPO_278_oRDR_DETECTION_277_280_oPCAN_RADAR_a7e3dac7_Tx: ComBitPosition=215, ComBitSize=1, ComSignalInitValue=0, ComSignalType=BOOLEAN, ComSystemTemplateSystemSignalRef=DET_PROB_1STAZHYPO_278
            DET_PROB_1STAZHYPO_279_oRDR_DETECTION_277_280_oPCAN_RADAR_32930e52_Tx: ComBitPosition=327, ComBitSize=1, ComSignalInitValue=0, ComSignalType=BOOLEAN, ComSystemTemplateSystemSignalRef=DET_PROB_1STAZHYPO_279
            DET_PROB_1STAZHYPO_280_oRDR_DETECTION_277_280_oPCAN_RADAR_3fd7af48_Tx: ComBitPosition=439, ComBitSize=1, ComSignalInitValue=0, ComSignalType=BOOLEAN, ComSystemTemplateSystemSignalRef=DET_PROB_1STAZHYPO_280
            DET_RANGE_277_oRDR_DETECTION_277_280_oPCAN_RADAR_805cabf6_Tx: ComBitPosition=24, ComBitSize=15, ComSignalInitValue=0, ComSignalType=UINT16, ComSystemTemplateSystemSignalRef=DET_RANGE_277
            DET_RANGE_278_oRDR_DETECTION_277_280_oPCAN_RADAR_ac4c39b1_Tx: ComBitPosition=136, ComBitSize=15, ComSignalInitValue=0, ComSignalType=UINT16, ComSystemTemplateSystemSignalRef=DET_RANGE_278
            DET_RANGE_279_oRDR_DETECTION_277_280_oPCAN_RADAR_393ced24_Tx: ComBitPosition=248, ComBitSize=15, ComSignalInitValue=0, ComSignalType=UINT16, ComSystemTemplateSystemSignalRef=DET_RANGE_279
            DET_RANGE_280_oRDR_DETECTION_277_280_oPCAN_RADAR_34784c3e_Tx: ComBitPosition=360, ComBitSize=15, ComSignalInitValue=0, ComSignalType=UINT16, ComSystemTemplateSystemSignalRef=DET_RANGE_280
            DET_RANGE_ERR_277_oRDR_DETECTION_277_280_oPCAN_RADAR_27b4119f_Tx: ComBitPosition=40, ComBitSize=7, ComSignalInitValue=0, ComSignalType=UINT8, ComSystemTemplateSystemSignalRef=DET_RANGE_ERR_277
            DET_RANGE_ERR_278_oRDR_DETECTION_277_280_oPCAN_RADAR_0ba483d8_Tx: ComBitPosition=152, ComBitSize=7, ComSignalInitValue=0, ComSignalType=UINT8, ComSystemTemplateSystemSignalRef=DET_RANGE_ERR_278
            DET_RANGE_ERR_279_oRDR_DETECTION_277_280_oPCAN_RADAR_9ed4574d_Tx: ComBitPosition=264, ComBitSize=7, ComSignalInitValue=0, ComSignalType=UINT8, ComSystemTemplateSystemSignalRef=DET_RANGE_ERR_279
            DET_RANGE_ERR_280_oRDR_DETECTION_277_280_oPCAN_RADAR_9390f657_Tx: ComBitPosition=376, ComBitSize=7, ComSignalInitValue=0, ComSignalType=UINT8, ComSystemTemplateSystemSignalRef=DET_RANGE_ERR_280
            DET_RANGE_VELOCITY_277_oRDR_DETECTION_277_280_oPCAN_RADAR_f5fa69d3_Tx: ComBitPosition=48, ComBitSize=15, ComSignalInitValue=16384, ComSignalType=UINT16, ComSystemTemplateSystemSignalRef=DET_RANGE_VELOCITY_277
            DET_RANGE_VELOCITY_278_oRDR_DETECTION_277_280_oPCAN_RADAR_d9eafb94_Tx: ComBitPosition=160, ComBitSize=15, ComSignalInitValue=16384, ComSignalType=UINT16, ComSystemTemplateSystemSignalRef=DET_RANGE_VELOCITY_278
            DET_RANGE_VELOCITY_279_oRDR_DETECTION_277_280_oPCAN_RADAR_4c9a2f01_Tx: ComBitPosition=272, ComBitSize=15, ComSignalInitValue=16384, ComSignalType=UINT16, ComSystemTemplateSystemSignalRef=DET_RANGE_VELOCITY_279
            DET_RANGE_VELOCITY_280_oRDR_DETECTION_277_280_oPCAN_RADAR_41de8e1b_Tx: ComBitPosition=384, ComBitSize=15, ComSignalInitValue=16384, ComSignalType=UINT16, ComSystemTemplateSystemSignalRef=DET_RANGE_VELOCITY_280
            DET_RANGE_VELOCITY_ERR_277_oRDR_DETECTION_277_280_oPCAN_RADAR_fa419261_Tx: ComBitPosition=64, ComBitSize=8, ComSignalInitValue=0, ComSignalType=UINT8, ComSystemTemplateSystemSignalRef=DET_RANGE_VELOCITY_ERR_277
            DET_RANGE_VELOCITY_ERR_278_oRDR_DETECTION_277_280_oPCAN_RADAR_d6510026_Tx: ComBitPosition=176, ComBitSize=8, ComSignalInitValue=0, ComSignalType=UINT8, ComSystemTemplateSystemSignalRef=DET_RANGE_VELOCITY_ERR_278
            DET_RANGE_VELOCITY_ERR_279_oRDR_DETECTION_277_280_oPCAN_RADAR_4321d4b3_Tx: ComBitPosition=288, ComBitSize=8, ComSignalInitValue=0, ComSignalType=UINT8, ComSystemTemplateSystemSignalRef=DET_RANGE_VELOCITY_ERR_279
            DET_RANGE_VELOCITY_ERR_280_oRDR_DETECTION_277_280_oPCAN_RADAR_4e6575a9_Tx: ComBitPosition=400, ComBitSize=8, ComSignalInitValue=0, ComSignalType=UINT8, ComSystemTemplateSystemSignalRef=DET_RANGE_VELOCITY_ERR_280
            DET_RCS_277_oRDR_DETECTION_277_280_oPCAN_RADAR_727a5e89_Tx: ComBitPosition=128, ComBitSize=8, ComSignalInitValue=128, ComSignalType=UINT8, ComSystemTemplateSystemSignalRef=DET_RCS_277
            DET_RCS_278_oRDR_DETECTION_277_280_oPCAN_RADAR_5e6accce_Tx: ComBitPosition=240, ComBitSize=8, ComSignalInitValue=128, ComSignalType=UINT8, ComSystemTemplateSystemSignalRef=DET_RCS_278
            DET_RCS_279_oRDR_DETECTION_277_280_oPCAN_RADAR_cb1a185b_Tx: ComBitPosition=352, ComBitSize=8, ComSignalInitValue=128, ComSignalType=UINT8, ComSystemTemplateSystemSignalRef=DET_RCS_279
            DET_RCS_280_oRDR_DETECTION_277_280_oPCAN_RADAR_c65eb941_Tx: ComBitPosition=464, ComBitSize=8, ComSignalInitValue=128, ComSignalType=UINT8, ComSystemTemplateSystemSignalRef=DET_RCS_280
            DET_SNR_277_oRDR_DETECTION_277_280_oPCAN_RADAR_afd40a8b_Tx: ComBitPosition=120, ComBitSize=8, ComSignalInitValue=0, ComSignalType=UINT8, ComSystemTemplateSystemSignalRef=DET_SNR_277
            DET_SNR_278_oRDR_DETECTION_277_280_oPCAN_RADAR_83c498cc_Tx: ComBitPosition=232, ComBitSize=8, ComSignalInitValue=0, ComSignalType=UINT8, ComSystemTemplateSystemSignalRef=DET_SNR_278
            DET_SNR_279_oRDR_DETECTION_277_280_oPCAN_RADAR_16b44c59_Tx: ComBitPosition=344, ComBitSize=8, ComSignalInitValue=0, ComSignalType=UINT8, ComSystemTemplateSystemSignalRef=DET_SNR_279
            DET_SNR_280_oRDR_DETECTION_277_280_oPCAN_RADAR_1bf0ed43_Tx: ComBitPosition=456, ComBitSize=8, ComSignalInitValue=0, ComSignalType=UINT8, ComSystemTemplateSystemSignalRef=DET_SNR_280
            DET_SUPER_RES_TARGET_277_oRDR_DETECTION_277_280_oPCAN_RADAR_9e4d22ee_Tx: ComBitPosition=87, ComBitSize=1, ComSignalInitValue=0, ComSignalType=BOOLEAN, ComSystemTemplateSystemSignalRef=DET_SUPER_RES_TARGET_277
            DET_SUPER_RES_TARGET_278_oRDR_DETECTION_277_280_oPCAN_RADAR_b25db0a9_Tx: ComBitPosition=199, ComBitSize=1, ComSignalInitValue=0, ComSignalType=BOOLEAN, ComSystemTemplateSystemSignalRef=DET_SUPER_RES_TARGET_278
            DET_SUPER_RES_TARGET_279_oRDR_DETECTION_277_280_oPCAN_RADAR_272d643c_Tx: ComBitPosition=311, ComBitSize=1, ComSignalInitValue=0, ComSignalType=BOOLEAN, ComSystemTemplateSystemSignalRef=DET_SUPER_RES_TARGET_279
            DET_SUPER_RES_TARGET_280_oRDR_DETECTION_277_280_oPCAN_RADAR_2a69c526_Tx: ComBitPosition=423, ComBitSize=1, ComSignalInitValue=0, ComSignalType=BOOLEAN, ComSystemTemplateSystemSignalRef=DET_SUPER_RES_TARGET_280
        SG_Detections_281_284_oRDR_DETECTION_281_284_oPCAN_RADAR_8fce5195_Tx: ComSystemTemplateSignalGroupRef=SG_Detections_281_284
          83 x ComGroupSignal, all with ComSignalEndianness=LITTLE_ENDIAN, ComTransferProperty=PENDING:
            DET_AZIMUTH_281_oRDR_DETECTION_281_284_oPCAN_RADAR_206192e6_Tx: ComBitPosition=88, ComBitSize=13, ComSignalInitValue=0, ComSignalType=UINT16, ComSystemTemplateSystemSignalRef=DET_AZIMUTH_281
            DET_AZIMUTH_282_oRDR_DETECTION_281_284_oPCAN_RADAR_4481e918_Tx: ComBitPosition=200, ComBitSize=13, ComSignalInitValue=0, ComSignalType=UINT16, ComSystemTemplateSystemSignalRef=DET_AZIMUTH_282
            DET_AZIMUTH_283_oRDR_DETECTION_281_284_oPCAN_RADAR_d1f13d8d_Tx: ComBitPosition=312, ComBitSize=13, ComSignalInitValue=0, ComSignalType=UINT16, ComSystemTemplateSystemSignalRef=DET_AZIMUTH_283
            DET_AZIMUTH_284_oRDR_DETECTION_281_284_oPCAN_RADAR_8d411ee4_Tx: ComBitPosition=424, ComBitSize=13, ComSignalInitValue=0, ComSignalType=UINT16, ComSystemTemplateSystemSignalRef=DET_AZIMUTH_284
            DET_AZIMUTH_ERR_281_oRDR_DETECTION_281_284_oPCAN_RADAR_84d40713_Tx: ComBitPosition=105, ComBitSize=7, ComSignalInitValue=0, ComSignalType=UINT8, ComSystemTemplateSystemSignalRef=DET_AZIMUTH_ERR_281
            DET_AZIMUTH_ERR_282_oRDR_DETECTION_281_284_oPCAN_RADAR_e0347ced_Tx: ComBitPosition=217, ComBitSize=7, ComSignalInitValue=0, ComSignalType=UINT8, ComSystemTemplateSystemSignalRef=DET_AZIMUTH_ERR_282
            DET_AZIMUTH_ERR_283_oRDR_DETECTION_281_284_oPCAN_RADAR_7544a878_Tx: ComBitPosition=329, ComBitSize=7, ComSignalInitValue=0, ComSignalType=UINT8, ComSystemTemplateSystemSignalRef=DET_AZIMUTH_ERR_283
            DET_AZIMUTH_ERR_284_oRDR_DETECTION_281_284_oPCAN_RADAR_29f48b11_Tx: ComBitPosition=441, ComBitSize=7, ComSignalInitValue=0, ComSignalType=UINT8, ComSystemTemplateSystemSignalRef=DET_AZIMUTH_ERR_284
            DET_BELOW_RAIN_THOLD_281_oRDR_DETECTION_281_284_oPCAN_RADAR_f5600126_Tx: ComBitPosition=39, ComBitSize=1, ComSignalInitValue=0, ComSignalType=BOOLEAN, ComSystemTemplateSystemSignalRef=DET_BELOW_RAIN_THOLD_281
            DET_BELOW_RAIN_THOLD_282_oRDR_DETECTION_281_284_oPCAN_RADAR_91807ad8_Tx: ComBitPosition=151, ComBitSize=1, ComSignalInitValue=0, ComSignalType=BOOLEAN, ComSystemTemplateSystemSignalRef=DET_BELOW_RAIN_THOLD_282
            DET_BELOW_RAIN_THOLD_283_oRDR_DETECTION_281_284_oPCAN_RADAR_04f0ae4d_Tx: ComBitPosition=263, ComBitSize=1, ComSignalInitValue=0, ComSignalType=BOOLEAN, ComSystemTemplateSystemSignalRef=DET_BELOW_RAIN_THOLD_283
            DET_BELOW_RAIN_THOLD_284_oRDR_DETECTION_281_284_oPCAN_RADAR_58408d24_Tx: ComBitPosition=375, ComBitSize=1, ComSignalInitValue=0, ComSignalType=BOOLEAN, ComSystemTemplateSystemSignalRef=DET_BELOW_RAIN_THOLD_284
            DET_BI_STATIC_FLAG_281_oRDR_DETECTION_281_284_oPCAN_RADAR_764dd263_Tx: ComBitPosition=104, ComBitSize=1, ComSignalInitValue=0, ComSignalType=BOOLEAN, ComSystemTemplateSystemSignalRef=DET_BI_STATIC_FLAG_281
            DET_BI_STATIC_FLAG_282_oRDR_DETECTION_281_284_oPCAN_RADAR_12ada99d_Tx: ComBitPosition=216, ComBitSize=1, ComSignalInitValue=0, ComSignalType=BOOLEAN, ComSystemTemplateSystemSignalRef=DET_BI_STATIC_FLAG_282
            DET_BI_STATIC_FLAG_283_oRDR_DETECTION_281_284_oPCAN_RADAR_87dd7d08_Tx: ComBitPosition=328, ComBitSize=1, ComSignalInitValue=0, ComSignalType=BOOLEAN, ComSystemTemplateSystemSignalRef=DET_BI_STATIC_FLAG_283
            DET_BI_STATIC_FLAG_284_oRDR_DETECTION_281_284_oPCAN_RADAR_db6d5e61_Tx: ComBitPosition=440, ComBitSize=1, ComSignalInitValue=0, ComSignalType=BOOLEAN, ComSystemTemplateSystemSignalRef=DET_BI_STATIC_FLAG_284
            DET_CONFD_AZIMUTH_281_oRDR_DETECTION_281_284_oPCAN_RADAR_2287982c_Tx: ComBitPosition=118, ComBitSize=2, ComSignalInitValue=0, ComSignalType=UINT8, ComSystemTemplateSystemSignalRef=DET_CONFD_AZIMUTH_281
            DET_CONFD_AZIMUTH_282_oRDR_DETECTION_281_284_oPCAN_RADAR_4667e3d2_Tx: ComBitPosition=230, ComBitSize=2, ComSignalInitValue=0, ComSignalType=UINT8, ComSystemTemplateSystemSignalRef=DET_CONFD_AZIMUTH_282
            DET_CONFD_AZIMUTH_283_oRDR_DETECTION_281_284_oPCAN_RADAR_d3173747_Tx: ComBitPosition=342, ComBitSize=2, ComSignalInitValue=0, ComSignalType=UINT8, ComSystemTemplateSystemSignalRef=DET_CONFD_AZIMUTH_283
            DET_CONFD_AZIMUTH_284_oRDR_DETECTION_281_284_oPCAN_RADAR_8fa7142e_Tx: ComBitPosition=454, ComBitSize=2, ComSignalInitValue=0, ComSignalType=UINT8, ComSystemTemplateSystemSignalRef=DET_CONFD_AZIMUTH_284
            DET_CONFD_ELEVATION_281_oRDR_DETECTION_281_284_oPCAN_RADAR_201299d6_Tx: ComBitPosition=101, ComBitSize=2, ComSignalInitValue=0, ComSignalType=UINT8, ComSystemTemplateSystemSignalRef=DET_CONFD_ELEVATION_281
            DET_CONFD_ELEVATION_282_oRDR_DETECTION_281_284_oPCAN_RADAR_44f2e228_Tx: ComBitPosition=213, ComBitSize=2, ComSignalInitValue=0, ComSignalType=UINT8, ComSystemTemplateSystemSignalRef=DET_CONFD_ELEVATION_282
            DET_CONFD_ELEVATION_283_oRDR_DETECTION_281_284_oPCAN_RADAR_d18236bd_Tx: ComBitPosition=325, ComBitSize=2, ComSignalInitValue=0, ComSignalType=UINT8, ComSystemTemplateSystemSignalRef=DET_CONFD_ELEVATION_283
            DET_CONFD_ELEVATION_284_oRDR_DETECTION_281_284_oPCAN_RADAR_8d3215d4_Tx: ComBitPosition=437, ComBitSize=2, ComSignalInitValue=0, ComSignalType=UINT8, ComSystemTemplateSystemSignalRef=DET_CONFD_ELEVATION_284
            DET_ELEVATION_281_oRDR_DETECTION_281_284_oPCAN_RADAR_f1d24dea_Tx: ComBitPosition=72, ComBitSize=8, ComSignalInitValue=0, ComSignalType=UINT8, ComSystemTemplateSystemSignalRef=DET_ELEVATION_281
            DET_ELEVATION_282_oRDR_DETECTION_281_284_oPCAN_RADAR_95323614_Tx: ComBitPosition=184, ComBitSize=8, ComSignalInitValue=0, ComSignalType=UINT8, ComSystemTemplateSystemSignalRef=DET_ELEVATION_282
            DET_ELEVATION_283_oRDR_DETECTION_281_284_oPCAN_RADAR_0042e281_Tx: ComBitPosition=296, ComBitSize=8, ComSignalInitValue=0, ComSignalType=UINT8, ComSystemTemplateSystemSignalRef=DET_ELEVATION_283
            DET_ELEVATION_284_oRDR_DETECTION_281_284_oPCAN_RADAR_5cf2c1e8_Tx: ComBitPosition=408, ComBitSize=8, ComSignalInitValue=0, ComSignalType=UINT8, ComSystemTemplateSystemSignalRef=DET_ELEVATION_284
            DET_ELEVATION_ERR_281_oRDR_DETECTION_281_284_oPCAN_RADAR_76ebd59f_Tx: ComBitPosition=80, ComBitSize=6, ComSignalInitValue=0, ComSignalType=UINT8, ComSystemTemplateSystemSignalRef=DET_ELEVATION_ERR_281
            DET_ELEVATION_ERR_282_oRDR_DETECTION_281_284_oPCAN_RADAR_120bae61_Tx: ComBitPosition=192, ComBitSize=6, ComSignalInitValue=0, ComSignalType=UINT8, ComSystemTemplateSystemSignalRef=DET_ELEVATION_ERR_282
            DET_ELEVATION_ERR_283_oRDR_DETECTION_281_284_oPCAN_RADAR_877b7af4_Tx: ComBitPosition=304, ComBitSize=6, ComSignalInitValue=0, ComSignalType=UINT8, ComSystemTemplateSystemSignalRef=DET_ELEVATION_ERR_283
            DET_ELEVATION_ERR_284_oRDR_DETECTION_281_284_oPCAN_RADAR_dbcb599d_Tx: ComBitPosition=416, ComBitSize=6, ComSignalInitValue=0, ComSignalType=UINT8, ComSystemTemplateSystemSignalRef=DET_ELEVATION_ERR_284
            DET_EXISTENCE_PROB_281_oRDR_DETECTION_281_284_oPCAN_RADAR_a474a0ff_Tx: ComBitPosition=112, ComBitSize=6, ComSignalInitValue=0, ComSignalType=UINT8, ComSystemTemplateSystemSignalRef=DET_EXISTENCE_PROB_281
            DET_EXISTENCE_PROB_282_oRDR_DETECTION_281_284_oPCAN_RADAR_c094db01_Tx: ComBitPosition=224, ComBitSize=6, ComSignalInitValue=0, ComSignalType=UINT8, ComSystemTemplateSystemSignalRef=DET_EXISTENCE_PROB_282
            DET_EXISTENCE_PROB_283_oRDR_DETECTION_281_284_oPCAN_RADAR_55e40f94_Tx: ComBitPosition=336, ComBitSize=6, ComSignalInitValue=0, ComSignalType=UINT8, ComSystemTemplateSystemSignalRef=DET_EXISTENCE_PROB_283
            DET_EXISTENCE_PROB_284_oRDR_DETECTION_281_284_oPCAN_RADAR_09542cfd_Tx: ComBitPosition=448, ComBitSize=6, ComSignalInitValue=0, ComSignalType=UINT8, ComSystemTemplateSystemSignalRef=DET_EXISTENCE_PROB_284
            DET_HVC_FLAG_281_oRDR_DETECTION_281_284_oPCAN_RADAR_4500e380_Tx: ComBitPosition=86, ComBitSize=1, ComSignalInitValue=0, ComSignalType=BOOLEAN, ComSystemTemplateSystemSignalRef=DET_HVC_FLAG_281
            DET_HVC_FLAG_282_oRDR_DETECTION_281_284_oPCAN_RADAR_21e0987e_Tx: ComBitPosition=198, ComBitSize=1, ComSignalInitValue=0, ComSignalType=BOOLEAN, ComSystemTemplateSystemSignalRef=DET_HVC_FLAG_282
            DET_HVC_FLAG_283_oRDR_DETECTION_281_284_oPCAN_RADAR_b4904ceb_Tx: ComBitPosition=310, ComBitSize=1, ComSignalInitValue=0, ComSignalType=BOOLEAN, ComSystemTemplateSystemSignalRef=DET_HVC_FLAG_283
            DET_HVC_FLAG_284_oRDR_DETECTION_281_284_oPCAN_RADAR_e8206f82_Tx: ComBitPosition=422, ComBitSize=1, ComSignalInitValue=0, ComSignalType=BOOLEAN, ComSystemTemplateSystemSignalRef=DET_HVC_FLAG_284
            DET_IDM_281_oRDR_DETECTION_281_284_oPCAN_RADAR_ce52d83d_Tx: ComBitPosition=63, ComBitSize=1, ComSignalInitValue=0, ComSignalType=BOOLEAN, ComSystemTemplateSystemSignalRef=DET_IDM_281
            DET_IDM_282_oRDR_DETECTION_281_284_oPCAN_RADAR_aab2a3c3_Tx: ComBitPosition=175, ComBitSize=1, ComSignalInitValue=0, ComSignalType=BOOLEAN, ComSystemTemplateSystemSignalRef=DET_IDM_282
            DET_IDM_283_oRDR_DETECTION_281_284_oPCAN_RADAR_3fc27756_Tx: ComBitPosition=287, ComBitSize=1, ComSignalInitValue=0, ComSignalType=BOOLEAN, ComSystemTemplateSystemSignalRef=DET_IDM_283
            DET_IDM_284_oRDR_DETECTION_281_284_oPCAN_RADAR_6372543f_Tx: ComBitPosition=399, ComBitSize=1, ComSignalInitValue=0, ComSignalType=BOOLEAN, ComSystemTemplateSystemSignalRef=DET_IDM_284
            DET_MH_CRC16_281_284_oRDR_DETECTION_281_284_oPCAN_RADAR_0b46839e_Tx: ComBitPosition=0, ComBitSize=16, ComSignalInitValue=0, ComSignalType=UINT16, ComSystemTemplateSystemSignalRef=DET_MH_CRC16_281_284
            DET_MH_CYCLE_COUNTER_281_284_oRDR_DETECTION_281_284_oPCAN_RADAR_8f3322a9_Tx: ComBitPosition=16, ComBitSize=8, ComSignalInitValue=0, ComSignalType=UINT8, ComSystemTemplateSystemSignalRef=DET_MH_CYCLE_COUNTER_281_284
            DET_MH_SCAN_INDEX_4LSB_281_284_oRDR_DETECTION_281_284_oPCAN_RADAR_43190725_Tx: ComBitPosition=476, ComBitSize=4, ComSignalInitValue=0, ComSignalType=UINT8, ComSystemTemplateSystemSignalRef=DET_MH_SCAN_INDEX_4LSB_281_284
            DET_MTD_281_oRDR_DETECTION_281_284_oPCAN_RADAR_a8e1eae6_Tx: ComBitPosition=47, ComBitSize=1, ComSignalInitValue=0, ComSignalType=BOOLEAN, ComSystemTemplateSystemSignalRef=DET_MTD_281
            DET_MTD_282_oRDR_DETECTION_281_284_oPCAN_RADAR_cc019118_Tx: ComBitPosition=159, ComBitSize=1, ComSignalInitValue=0, ComSignalType=BOOLEAN, ComSystemTemplateSystemSignalRef=DET_MTD_282
            DET_MTD_283_oRDR_DETECTION_281_284_oPCAN_RADAR_5971458d_Tx: ComBitPosition=271, ComBitSize=1, ComSignalInitValue=0, ComSignalType=BOOLEAN, ComSystemTemplateSystemSignalRef=DET_MTD_283
            DET_MTD_284_oRDR_DETECTION_281_284_oPCAN_RADAR_05c166e4_Tx: ComBitPosition=383, ComBitSize=1, ComSignalInitValue=0, ComSignalType=BOOLEAN, ComSystemTemplateSystemSignalRef=DET_MTD_284
            DET_PROB_1STAZHYPO_281_oRDR_DETECTION_281_284_oPCAN_RADAR_3b55022b_Tx: ComBitPosition=103, ComBitSize=1, ComSignalInitValue=0, ComSignalType=BOOLEAN, ComSystemTemplateSystemSignalRef=DET_PROB_1STAZHYPO_281
            DET_PROB_1STAZHYPO_282_oRDR_DETECTION_281_284_oPCAN_RADAR_5fb579d5_Tx: ComBitPosition=215, ComBitSize=1, ComSignalInitValue=0, ComSignalType=BOOLEAN, ComSystemTemplateSystemSignalRef=DET_PROB_1STAZHYPO_282
            DET_PROB_1STAZHYPO_283_oRDR_DETECTION_281_284_oPCAN_RADAR_cac5ad40_Tx: ComBitPosition=327, ComBitSize=1, ComSignalInitValue=0, ComSignalType=BOOLEAN, ComSystemTemplateSystemSignalRef=DET_PROB_1STAZHYPO_283
            DET_PROB_1STAZHYPO_284_oRDR_DETECTION_281_284_oPCAN_RADAR_96758e29_Tx: ComBitPosition=439, ComBitSize=1, ComSignalInitValue=0, ComSignalType=BOOLEAN, ComSystemTemplateSystemSignalRef=DET_PROB_1STAZHYPO_284
            DET_RANGE_281_oRDR_DETECTION_281_284_oPCAN_RADAR_30fae15d_Tx: ComBitPosition=24, ComBitSize=15, ComSignalInitValue=0, ComSignalType=UINT16, ComSystemTemplateSystemSignalRef=DET_RANGE_281
            DET_RANGE_282_oRDR_DETECTION_281_284_oPCAN_RADAR_541a9aa3_Tx: ComBitPosition=136, ComBitSize=15, ComSignalInitValue=0, ComSignalType=UINT16, ComSystemTemplateSystemSignalRef=DET_RANGE_282
            DET_RANGE_283_oRDR_DETECTION_281_284_oPCAN_RADAR_c16a4e36_Tx: ComBitPosition=248, ComBitSize=15, ComSignalInitValue=0, ComSignalType=UINT16, ComSystemTemplateSystemSignalRef=DET_RANGE_283
            DET_RANGE_284_oRDR_DETECTION_281_284_oPCAN_RADAR_9dda6d5f_Tx: ComBitPosition=360, ComBitSize=15, ComSignalInitValue=0, ComSignalType=UINT16, ComSystemTemplateSystemSignalRef=DET_RANGE_284
            DET_RANGE_ERR_281_oRDR_DETECTION_281_284_oPCAN_RADAR_97125b34_Tx: ComBitPosition=40, ComBitSize=7, ComSignalInitValue=0, ComSignalType=UINT8, ComSystemTemplateSystemSignalRef=DET_RANGE_ERR_281
            DET_RANGE_ERR_282_oRDR_DETECTION_281_284_oPCAN_RADAR_f3f220ca_Tx: ComBitPosition=152, ComBitSize=7, ComSignalInitValue=0, ComSignalType=UINT8, ComSystemTemplateSystemSignalRef=DET_RANGE_ERR_282
            DET_RANGE_ERR_283_oRDR_DETECTION_281_284_oPCAN_RADAR_6682f45f_Tx: ComBitPosition=264, ComBitSize=7, ComSignalInitValue=0, ComSignalType=UINT8, ComSystemTemplateSystemSignalRef=DET_RANGE_ERR_283
            DET_RANGE_ERR_284_oRDR_DETECTION_281_284_oPCAN_RADAR_3a32d736_Tx: ComBitPosition=376, ComBitSize=7, ComSignalInitValue=0, ComSignalType=UINT8, ComSystemTemplateSystemSignalRef=DET_RANGE_ERR_284
            DET_RANGE_VELOCITY_281_oRDR_DETECTION_281_284_oPCAN_RADAR_455c2378_Tx: ComBitPosition=48, ComBitSize=15, ComSignalInitValue=16384, ComSignalType=UINT16, ComSystemTemplateSystemSignalRef=DET_RANGE_VELOCITY_281
            DET_RANGE_VELOCITY_282_oRDR_DETECTION_281_284_oPCAN_RADAR_21bc5886_Tx: ComBitPosition=160, ComBitSize=15, ComSignalInitValue=16384, ComSignalType=UINT16, ComSystemTemplateSystemSignalRef=DET_RANGE_VELOCITY_282
            DET_RANGE_VELOCITY_283_oRDR_DETECTION_281_284_oPCAN_RADAR_b4cc8c13_Tx: ComBitPosition=272, ComBitSize=15, ComSignalInitValue=16384, ComSignalType=UINT16, ComSystemTemplateSystemSignalRef=DET_RANGE_VELOCITY_283
            DET_RANGE_VELOCITY_284_oRDR_DETECTION_281_284_oPCAN_RADAR_e87caf7a_Tx: ComBitPosition=384, ComBitSize=15, ComSignalInitValue=16384, ComSignalType=UINT16, ComSystemTemplateSystemSignalRef=DET_RANGE_VELOCITY_284
            DET_RANGE_VELOCITY_ERR_281_oRDR_DETECTION_281_284_oPCAN_RADAR_4ae7d8ca_Tx: ComBitPosition=64, ComBitSize=8, ComSignalInitValue=0, ComSignalType=UINT8, ComSystemTemplateSystemSignalRef=DET_RANGE_VELOCITY_ERR_281
            DET_RANGE_VELOCITY_ERR_282_oRDR_DETECTION_281_284_oPCAN_RADAR_2e07a334_Tx: ComBitPosition=176, ComBitSize=8, ComSignalInitValue=0, ComSignalType=UINT8, ComSystemTemplateSystemSignalRef=DET_RANGE_VELOCITY_ERR_282
            DET_RANGE_VELOCITY_ERR_283_oRDR_DETECTION_281_284_oPCAN_RADAR_bb7777a1_Tx: ComBitPosition=288, ComBitSize=8, ComSignalInitValue=0, ComSignalType=UINT8, ComSystemTemplateSystemSignalRef=DET_RANGE_VELOCITY_ERR_283
            DET_RANGE_VELOCITY_ERR_284_oRDR_DETECTION_281_284_oPCAN_RADAR_e7c754c8_Tx: ComBitPosition=400, ComBitSize=8, ComSignalInitValue=0, ComSignalType=UINT8, ComSystemTemplateSystemSignalRef=DET_RANGE_VELOCITY_ERR_284
            DET_RCS_281_oRDR_DETECTION_281_284_oPCAN_RADAR_c2dc1422_Tx: ComBitPosition=128, ComBitSize=8, ComSignalInitValue=128, ComSignalType=UINT8, ComSystemTemplateSystemSignalRef=DET_RCS_281
            DET_RCS_282_oRDR_DETECTION_281_284_oPCAN_RADAR_a63c6fdc_Tx: ComBitPosition=240, ComBitSize=8, ComSignalInitValue=128, ComSignalType=UINT8, ComSystemTemplateSystemSignalRef=DET_RCS_282
            DET_RCS_283_oRDR_DETECTION_281_284_oPCAN_RADAR_334cbb49_Tx: ComBitPosition=352, ComBitSize=8, ComSignalInitValue=128, ComSignalType=UINT8, ComSystemTemplateSystemSignalRef=DET_RCS_283
            DET_RCS_284_oRDR_DETECTION_281_284_oPCAN_RADAR_6ffc9820_Tx: ComBitPosition=464, ComBitSize=8, ComSignalInitValue=128, ComSignalType=UINT8, ComSystemTemplateSystemSignalRef=DET_RCS_284
            DET_SNR_281_oRDR_DETECTION_281_284_oPCAN_RADAR_1f724020_Tx: ComBitPosition=120, ComBitSize=8, ComSignalInitValue=0, ComSignalType=UINT8, ComSystemTemplateSystemSignalRef=DET_SNR_281
            DET_SNR_282_oRDR_DETECTION_281_284_oPCAN_RADAR_7b923bde_Tx: ComBitPosition=232, ComBitSize=8, ComSignalInitValue=0, ComSignalType=UINT8, ComSystemTemplateSystemSignalRef=DET_SNR_282
            DET_SNR_283_oRDR_DETECTION_281_284_oPCAN_RADAR_eee2ef4b_Tx: ComBitPosition=344, ComBitSize=8, ComSignalInitValue=0, ComSignalType=UINT8, ComSystemTemplateSystemSignalRef=DET_SNR_283
            DET_SNR_284_oRDR_DETECTION_281_284_oPCAN_RADAR_b252cc22_Tx: ComBitPosition=456, ComBitSize=8, ComSignalInitValue=0, ComSignalType=UINT8, ComSystemTemplateSystemSignalRef=DET_SNR_284
            DET_SUPER_RES_TARGET_281_oRDR_DETECTION_281_284_oPCAN_RADAR_2eeb6845_Tx: ComBitPosition=87, ComBitSize=1, ComSignalInitValue=0, ComSignalType=BOOLEAN, ComSystemTemplateSystemSignalRef=DET_SUPER_RES_TARGET_281
            DET_SUPER_RES_TARGET_282_oRDR_DETECTION_281_284_oPCAN_RADAR_4a0b13bb_Tx: ComBitPosition=199, ComBitSize=1, ComSignalInitValue=0, ComSignalType=BOOLEAN, ComSystemTemplateSystemSignalRef=DET_SUPER_RES_TARGET_282
            DET_SUPER_RES_TARGET_283_oRDR_DETECTION_281_284_oPCAN_RADAR_df7bc72e_Tx: ComBitPosition=311, ComBitSize=1, ComSignalInitValue=0, ComSignalType=BOOLEAN, ComSystemTemplateSystemSignalRef=DET_SUPER_RES_TARGET_283
            DET_SUPER_RES_TARGET_284_oRDR_DETECTION_281_284_oPCAN_RADAR_83cbe447_Tx: ComBitPosition=423, ComBitSize=1, ComSignalInitValue=0, ComSignalType=BOOLEAN, ComSystemTemplateSystemSignalRef=DET_SUPER_RES_TARGET_284
