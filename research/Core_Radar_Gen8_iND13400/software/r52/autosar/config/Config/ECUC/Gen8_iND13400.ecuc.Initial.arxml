[part 10 of 24: package /InitialEcuC]
AUTOSAR XML (schema 00053)
package /InitialEcuC  (continued)
  module config Com  (continued)
    ComConfig  (continued)
      242 x ComSignalGroup, all with ComTransferProperty=PENDING:  (continued)
        SG_Detections_197_200_oRDR_DETECTION_197_200_oPCAN_RADAR_f6bd2d5e_Tx: ComSystemTemplateSignalGroupRef=SG_Detections_197_200
          83 x ComGroupSignal, all with ComSignalEndianness=LITTLE_ENDIAN, ComTransferProperty=PENDING:
            DET_AZIMUTH_197_oRDR_DETECTION_197_200_oPCAN_RADAR_3c698182_Tx: ComBitPosition=88, ComBitSize=13, ComSignalInitValue=0, ComSignalType=UINT16, ComSystemTemplateSystemSignalRef=DET_AZIMUTH_197
            DET_AZIMUTH_198_oRDR_DETECTION_197_200_oPCAN_RADAR_107913c5_Tx: ComBitPosition=200, ComBitSize=13, ComSignalInitValue=0, ComSignalType=UINT16, ComSystemTemplateSystemSignalRef=DET_AZIMUTH_198
            DET_AZIMUTH_199_oRDR_DETECTION_197_200_oPCAN_RADAR_8509c750_Tx: ComBitPosition=312, ComBitSize=13, ComSignalInitValue=0, ComSignalType=UINT16, ComSystemTemplateSystemSignalRef=DET_AZIMUTH_199
            DET_AZIMUTH_200_oRDR_DETECTION_197_200_oPCAN_RADAR_716718ed_Tx: ComBitPosition=424, ComBitSize=13, ComSignalInitValue=0, ComSignalType=UINT16, ComSystemTemplateSystemSignalRef=DET_AZIMUTH_200
            DET_AZIMUTH_ERR_197_oRDR_DETECTION_197_200_oPCAN_RADAR_98dc1477_Tx: ComBitPosition=105, ComBitSize=7, ComSignalInitValue=0, ComSignalType=UINT8, ComSystemTemplateSystemSignalRef=DET_AZIMUTH_ERR_197
            DET_AZIMUTH_ERR_198_oRDR_DETECTION_197_200_oPCAN_RADAR_b4cc8630_Tx: ComBitPosition=217, ComBitSize=7, ComSignalInitValue=0, ComSignalType=UINT8, ComSystemTemplateSystemSignalRef=DET_AZIMUTH_ERR_198
            DET_AZIMUTH_ERR_199_oRDR_DETECTION_197_200_oPCAN_RADAR_21bc52a5_Tx: ComBitPosition=329, ComBitSize=7, ComSignalInitValue=0, ComSignalType=UINT8, ComSystemTemplateSystemSignalRef=DET_AZIMUTH_ERR_199
            DET_AZIMUTH_ERR_200_oRDR_DETECTION_197_200_oPCAN_RADAR_d5d28d18_Tx: ComBitPosition=441, ComBitSize=7, ComSignalInitValue=0, ComSignalType=UINT8, ComSystemTemplateSystemSignalRef=DET_AZIMUTH_ERR_200
            DET_BELOW_RAIN_THOLD_197_oRDR_DETECTION_197_200_oPCAN_RADAR_e9681242_Tx: ComBitPosition=39, ComBitSize=1, ComSignalInitValue=0, ComSignalType=BOOLEAN, ComSystemTemplateSystemSignalRef=DET_BELOW_RAIN_THOLD_197
            DET_BELOW_RAIN_THOLD_198_oRDR_DETECTION_197_200_oPCAN_RADAR_c5788005_Tx: ComBitPosition=151, ComBitSize=1, ComSignalInitValue=0, ComSignalType=BOOLEAN, ComSystemTemplateSystemSignalRef=DET_BELOW_RAIN_THOLD_198
            DET_BELOW_RAIN_THOLD_199_oRDR_DETECTION_197_200_oPCAN_RADAR_50085490_Tx: ComBitPosition=263, ComBitSize=1, ComSignalInitValue=0, ComSignalType=BOOLEAN, ComSystemTemplateSystemSignalRef=DET_BELOW_RAIN_THOLD_199
            DET_BELOW_RAIN_THOLD_200_oRDR_DETECTION_197_200_oPCAN_RADAR_a4668b2d_Tx: ComBitPosition=375, ComBitSize=1, ComSignalInitValue=0, ComSignalType=BOOLEAN, ComSystemTemplateSystemSignalRef=DET_BELOW_RAIN_THOLD_200
            DET_BI_STATIC_FLAG_197_oRDR_DETECTION_197_200_oPCAN_RADAR_6a45c107_Tx: ComBitPosition=104, ComBitSize=1, ComSignalInitValue=0, ComSignalType=BOOLEAN, ComSystemTemplateSystemSignalRef=DET_BI_STATIC_FLAG_197
            DET_BI_STATIC_FLAG_198_oRDR_DETECTION_197_200_oPCAN_RADAR_46555340_Tx: ComBitPosition=216, ComBitSize=1, ComSignalInitValue=0, ComSignalType=BOOLEAN, ComSystemTemplateSystemSignalRef=DET_BI_STATIC_FLAG_198
            DET_BI_STATIC_FLAG_199_oRDR_DETECTION_197_200_oPCAN_RADAR_d32587d5_Tx: ComBitPosition=328, ComBitSize=1, ComSignalInitValue=0, ComSignalType=BOOLEAN, ComSystemTemplateSystemSignalRef=DET_BI_STATIC_FLAG_199
            DET_BI_STATIC_FLAG_200_oRDR_DETECTION_197_200_oPCAN_RADAR_274b5868_Tx: ComBitPosition=440, ComBitSize=1, ComSignalInitValue=0, ComSignalType=BOOLEAN, ComSystemTemplateSystemSignalRef=DET_BI_STATIC_FLAG_200
            DET_CONFD_AZIMUTH_197_oRDR_DETECTION_197_200_oPCAN_RADAR_3e8f8b48_Tx: ComBitPosition=118, ComBitSize=2, ComSignalInitValue=0, ComSignalType=UINT8, ComSystemTemplateSystemSignalRef=DET_CONFD_AZIMUTH_197
            DET_CONFD_AZIMUTH_198_oRDR_DETECTION_197_200_oPCAN_RADAR_129f190f_Tx: ComBitPosition=230, ComBitSize=2, ComSignalInitValue=0, ComSignalType=UINT8, ComSystemTemplateSystemSignalRef=DET_CONFD_AZIMUTH_198
            DET_CONFD_AZIMUTH_199_oRDR_DETECTION_197_200_oPCAN_RADAR_87efcd9a_Tx: ComBitPosition=342, ComBitSize=2, ComSignalInitValue=0, ComSignalType=UINT8, ComSystemTemplateSystemSignalRef=DET_CONFD_AZIMUTH_199
            DET_CONFD_AZIMUTH_200_oRDR_DETECTION_197_200_oPCAN_RADAR_73811227_Tx: ComBitPosition=454, ComBitSize=2, ComSignalInitValue=0, ComSignalType=UINT8, ComSystemTemplateSystemSignalRef=DET_CONFD_AZIMUTH_200
            DET_CONFD_ELEVATION_197_oRDR_DETECTION_197_200_oPCAN_RADAR_3c1a8ab2_Tx: ComBitPosition=101, ComBitSize=2, ComSignalInitValue=0, ComSignalType=UINT8, ComSystemTemplateSystemSignalRef=DET_CONFD_ELEVATION_197
            DET_CONFD_ELEVATION_198_oRDR_DETECTION_197_200_oPCAN_RADAR_100a18f5_Tx: ComBitPosition=213, ComBitSize=2, ComSignalInitValue=0, ComSignalType=UINT8, ComSystemTemplateSystemSignalRef=DET_CONFD_ELEVATION_198
            DET_CONFD_ELEVATION_199_oRDR_DETECTION_197_200_oPCAN_RADAR_857acc60_Tx: ComBitPosition=325, ComBitSize=2, ComSignalInitValue=0, ComSignalType=UINT8, ComSystemTemplateSystemSignalRef=DET_CONFD_ELEVATION_199
            DET_CONFD_ELEVATION_200_oRDR_DETECTION_197_200_oPCAN_RADAR_711413dd_Tx: ComBitPosition=437, ComBitSize=2, ComSignalInitValue=0, ComSignalType=UINT8, ComSystemTemplateSystemSignalRef=DET_CONFD_ELEVATION_200
            DET_ELEVATION_197_oRDR_DETECTION_197_200_oPCAN_RADAR_edda5e8e_Tx: ComBitPosition=72, ComBitSize=8, ComSignalInitValue=0, ComSignalType=UINT8, ComSystemTemplateSystemSignalRef=DET_ELEVATION_197
            DET_ELEVATION_198_oRDR_DETECTION_197_200_oPCAN_RADAR_c1caccc9_Tx: ComBitPosition=184, ComBitSize=8, ComSignalInitValue=0, ComSignalType=UINT8, ComSystemTemplateSystemSignalRef=DET_ELEVATION_198
            DET_ELEVATION_199_oRDR_DETECTION_197_200_oPCAN_RADAR_54ba185c_Tx: ComBitPosition=296, ComBitSize=8, ComSignalInitValue=0, ComSignalType=UINT8, ComSystemTemplateSystemSignalRef=DET_ELEVATION_199
            DET_ELEVATION_200_oRDR_DETECTION_197_200_oPCAN_RADAR_a0d4c7e1_Tx: ComBitPosition=408, ComBitSize=8, ComSignalInitValue=0, ComSignalType=UINT8, ComSystemTemplateSystemSignalRef=DET_ELEVATION_200
            DET_ELEVATION_ERR_197_oRDR_DETECTION_197_200_oPCAN_RADAR_6ae3c6fb_Tx: ComBitPosition=80, ComBitSize=6, ComSignalInitValue=0, ComSignalType=UINT8, ComSystemTemplateSystemSignalRef=DET_ELEVATION_ERR_197
            DET_ELEVATION_ERR_198_oRDR_DETECTION_197_200_oPCAN_RADAR_46f354bc_Tx: ComBitPosition=192, ComBitSize=6, ComSignalInitValue=0, ComSignalType=UINT8, ComSystemTemplateSystemSignalRef=DET_ELEVATION_ERR_198
            DET_ELEVATION_ERR_199_oRDR_DETECTION_197_200_oPCAN_RADAR_d3838029_Tx: ComBitPosition=304, ComBitSize=6, ComSignalInitValue=0, ComSignalType=UINT8, ComSystemTemplateSystemSignalRef=DET_ELEVATION_ERR_199
            DET_ELEVATION_ERR_200_oRDR_DETECTION_197_200_oPCAN_RADAR_27ed5f94_Tx: ComBitPosition=416, ComBitSize=6, ComSignalInitValue=0, ComSignalType=UINT8, ComSystemTemplateSystemSignalRef=DET_ELEVATION_ERR_200
            DET_EXISTENCE_PROB_197_oRDR_DETECTION_197_200_oPCAN_RADAR_b87cb39b_Tx: ComBitPosition=112, ComBitSize=6, ComSignalInitValue=0, ComSignalType=UINT8, ComSystemTemplateSystemSignalRef=DET_EXISTENCE_PROB_197
            DET_EXISTENCE_PROB_198_oRDR_DETECTION_197_200_oPCAN_RADAR_946c21dc_Tx: ComBitPosition=224, ComBitSize=6, ComSignalInitValue=0, ComSignalType=UINT8, ComSystemTemplateSystemSignalRef=DET_EXISTENCE_PROB_198
            DET_EXISTENCE_PROB_199_oRDR_DETECTION_197_200_oPCAN_RADAR_011cf549_Tx: ComBitPosition=336, ComBitSize=6, ComSignalInitValue=0, ComSignalType=UINT8, ComSystemTemplateSystemSignalRef=DET_EXISTENCE_PROB_199
            DET_EXISTENCE_PROB_200_oRDR_DETECTION_197_200_oPCAN_RADAR_f5722af4_Tx: ComBitPosition=448, ComBitSize=6, ComSignalInitValue=0, ComSignalType=UINT8, ComSystemTemplateSystemSignalRef=DET_EXISTENCE_PROB_200
            DET_HVC_FLAG_197_oRDR_DETECTION_197_200_oPCAN_RADAR_5908f0e4_Tx: ComBitPosition=86, ComBitSize=1, ComSignalInitValue=0, ComSignalType=BOOLEAN, ComSystemTemplateSystemSignalRef=DET_HVC_FLAG_197
            DET_HVC_FLAG_198_oRDR_DETECTION_197_200_oPCAN_RADAR_751862a3_Tx: ComBitPosition=198, ComBitSize=1, ComSignalInitValue=0, ComSignalType=BOOLEAN, ComSystemTemplateSystemSignalRef=DET_HVC_FLAG_198
            DET_HVC_FLAG_199_oRDR_DETECTION_197_200_oPCAN_RADAR_e068b636_Tx: ComBitPosition=310, ComBitSize=1, ComSignalInitValue=0, ComSignalType=BOOLEAN, ComSystemTemplateSystemSignalRef=DET_HVC_FLAG_199
            DET_HVC_FLAG_200_oRDR_DETECTION_197_200_oPCAN_RADAR_1406698b_Tx: ComBitPosition=422, ComBitSize=1, ComSignalInitValue=0, ComSignalType=BOOLEAN, ComSystemTemplateSystemSignalRef=DET_HVC_FLAG_200
            DET_IDM_197_oRDR_DETECTION_197_200_oPCAN_RADAR_d25acb59_Tx: ComBitPosition=63, ComBitSize=1, ComSignalInitValue=0, ComSignalType=BOOLEAN, ComSystemTemplateSystemSignalRef=DET_IDM_197
            DET_IDM_198_oRDR_DETECTION_197_200_oPCAN_RADAR_fe4a591e_Tx: ComBitPosition=175, ComBitSize=1, ComSignalInitValue=0, ComSignalType=BOOLEAN, ComSystemTemplateSystemSignalRef=DET_IDM_198
            DET_IDM_199_oRDR_DETECTION_197_200_oPCAN_RADAR_6b3a8d8b_Tx: ComBitPosition=287, ComBitSize=1, ComSignalInitValue=0, ComSignalType=BOOLEAN, ComSystemTemplateSystemSignalRef=DET_IDM_199
            DET_IDM_200_oRDR_DETECTION_197_200_oPCAN_RADAR_9f545236_Tx: ComBitPosition=399, ComBitSize=1, ComSignalInitValue=0, ComSignalType=BOOLEAN, ComSystemTemplateSystemSignalRef=DET_IDM_200
            DET_MH_CRC16_197_200_oRDR_DETECTION_197_200_oPCAN_RADAR_7235ff55_Tx: ComBitPosition=0, ComBitSize=16, ComSignalInitValue=0, ComSignalType=UINT16, ComSystemTemplateSystemSignalRef=DET_MH_CRC16_197_200
            DET_MH_CYCLE_COUNTER_197_200_oRDR_DETECTION_197_200_oPCAN_RADAR_f6405e62_Tx: ComBitPosition=16, ComBitSize=8, ComSignalInitValue=0, ComSignalType=UINT8, ComSystemTemplateSystemSignalRef=DET_MH_CYCLE_COUNTER_197_200
            DET_MH_SCAN_INDEX_4LSB_197_200_oRDR_DETECTION_197_200_oPCAN_RADAR_3a6a7bee_Tx: ComBitPosition=476, ComBitSize=4, ComSignalInitValue=0, ComSignalType=UINT8, ComSystemTemplateSystemSignalRef=DET_MH_SCAN_INDEX_4LSB_197_200
            DET_MTD_197_oRDR_DETECTION_197_200_oPCAN_RADAR_b4e9f982_Tx: ComBitPosition=47, ComBitSize=1, ComSignalInitValue=0, ComSignalType=BOOLEAN, ComSystemTemplateSystemSignalRef=DET_MTD_197
            DET_MTD_198_oRDR_DETECTION_197_200_oPCAN_RADAR_98f96bc5_Tx: ComBitPosition=159, ComBitSize=1, ComSignalInitValue=0, ComSignalType=BOOLEAN, ComSystemTemplateSystemSignalRef=DET_MTD_198
            DET_MTD_199_oRDR_DETECTION_197_200_oPCAN_RADAR_0d89bf50_Tx: ComBitPosition=271, ComBitSize=1, ComSignalInitValue=0, ComSignalType=BOOLEAN, ComSystemTemplateSystemSignalRef=DET_MTD_199
            DET_MTD_200_oRDR_DETECTION_197_200_oPCAN_RADAR_f9e760ed_Tx: ComBitPosition=383, ComBitSize=1, ComSignalInitValue=0, ComSignalType=BOOLEAN, ComSystemTemplateSystemSignalRef=DET_MTD_200
            DET_PROB_1STAZHYPO_197_oRDR_DETECTION_197_200_oPCAN_RADAR_275d114f_Tx: ComBitPosition=103, ComBitSize=1, ComSignalInitValue=0, ComSignalType=BOOLEAN, ComSystemTemplateSystemSignalRef=DET_PROB_1STAZHYPO_197
            DET_PROB_1STAZHYPO_198_oRDR_DETECTION_197_200_oPCAN_RADAR_0b4d8308_Tx: ComBitPosition=215, ComBitSize=1, ComSignalInitValue=0, ComSignalType=BOOLEAN, ComSystemTemplateSystemSignalRef=DET_PROB_1STAZHYPO_198
            DET_PROB_1STAZHYPO_199_oRDR_DETECTION_197_200_oPCAN_RADAR_9e3d579d_Tx: ComBitPosition=327, ComBitSize=1, ComSignalInitValue=0, ComSignalType=BOOLEAN, ComSystemTemplateSystemSignalRef=DET_PROB_1STAZHYPO_199
            DET_PROB_1STAZHYPO_200_oRDR_DETECTION_197_200_oPCAN_RADAR_6a538820_Tx: ComBitPosition=439, ComBitSize=1, ComSignalInitValue=0, ComSignalType=BOOLEAN, ComSystemTemplateSystemSignalRef=DET_PROB_1STAZHYPO_200
            DET_RANGE_197_oRDR_DETECTION_197_200_oPCAN_RADAR_2cf2f239_Tx: ComBitPosition=24, ComBitSize=15, ComSignalInitValue=0, ComSignalType=UINT16, ComSystemTemplateSystemSignalRef=DET_RANGE_197
            DET_RANGE_198_oRDR_DETECTION_197_200_oPCAN_RADAR_00e2607e_Tx: ComBitPosition=136, ComBitSize=15, ComSignalInitValue=0, ComSignalType=UINT16, ComSystemTemplateSystemSignalRef=DET_RANGE_198
            DET_RANGE_199_oRDR_DETECTION_197_200_oPCAN_RADAR_9592b4eb_Tx: ComBitPosition=248, ComBitSize=15, ComSignalInitValue=0, ComSignalType=UINT16, ComSystemTemplateSystemSignalRef=DET_RANGE_199
            DET_RANGE_200_oRDR_DETECTION_197_200_oPCAN_RADAR_61fc6b56_Tx: ComBitPosition=360, ComBitSize=15, ComSignalInitValue=0, ComSignalType=UINT16, ComSystemTemplateSystemSignalRef=DET_RANGE_200
            DET_RANGE_ERR_197_oRDR_DETECTION_197_200_oPCAN_RADAR_8b1a4850_Tx: ComBitPosition=40, ComBitSize=7, ComSignalInitValue=0, ComSignalType=UINT8, ComSystemTemplateSystemSignalRef=DET_RANGE_ERR_197
            DET_RANGE_ERR_198_oRDR_DETECTION_197_200_oPCAN_RADAR_a70ada17_Tx: ComBitPosition=152, ComBitSize=7, ComSignalInitValue=0, ComSignalType=UINT8, ComSystemTemplateSystemSignalRef=DET_RANGE_ERR_198
            DET_RANGE_ERR_199_oRDR_DETECTION_197_200_oPCAN_RADAR_327a0e82_Tx: ComBitPosition=264, ComBitSize=7, ComSignalInitValue=0, ComSignalType=UINT8, ComSystemTemplateSystemSignalRef=DET_RANGE_ERR_199
            DET_RANGE_ERR_200_oRDR_DETECTION_197_200_oPCAN_RADAR_c614d13f_Tx: ComBitPosition=376, ComBitSize=7, ComSignalInitValue=0, ComSignalType=UINT8, ComSystemTemplateSystemSignalRef=DET_RANGE_ERR_200
            DET_RANGE_VELOCITY_197_oRDR_DETECTION_197_200_oPCAN_RADAR_5954301c_Tx: ComBitPosition=48, ComBitSize=15, ComSignalInitValue=16384, ComSignalType=UINT16, ComSystemTemplateSystemSignalRef=DET_RANGE_VELOCITY_197
            DET_RANGE_VELOCITY_198_oRDR_DETECTION_197_200_oPCAN_RADAR_7544a25b_Tx: ComBitPosition=160, ComBitSize=15, ComSignalInitValue=16384, ComSignalType=UINT16, ComSystemTemplateSystemSignalRef=DET_RANGE_VELOCITY_198
            DET_RANGE_VELOCITY_199_oRDR_DETECTION_197_200_oPCAN_RADAR_e03476ce_Tx: ComBitPosition=272, ComBitSize=15, ComSignalInitValue=16384, ComSignalType=UINT16, ComSystemTemplateSystemSignalRef=DET_RANGE_VELOCITY_199
            DET_RANGE_VELOCITY_200_oRDR_DETECTION_197_200_oPCAN_RADAR_145aa973_Tx: ComBitPosition=384, ComBitSize=15, ComSignalInitValue=16384, ComSignalType=UINT16, ComSystemTemplateSystemSignalRef=DET_RANGE_VELOCITY_200
            DET_RANGE_VELOCITY_ERR_197_oRDR_DETECTION_197_200_oPCAN_RADAR_56efcbae_Tx: ComBitPosition=64, ComBitSize=8, ComSignalInitValue=0, ComSignalType=UINT8, ComSystemTemplateSystemSignalRef=DET_RANGE_VELOCITY_ERR_197
            DET_RANGE_VELOCITY_ERR_198_oRDR_DETECTION_197_200_oPCAN_RADAR_7aff59e9_Tx: ComBitPosition=176, ComBitSize=8, ComSignalInitValue=0, ComSignalType=UINT8, ComSystemTemplateSystemSignalRef=DET_RANGE_VELOCITY_ERR_198
            DET_RANGE_VELOCITY_ERR_199_oRDR_DETECTION_197_200_oPCAN_RADAR_ef8f8d7c_Tx: ComBitPosition=288, ComBitSize=8, ComSignalInitValue=0, ComSignalType=UINT8, ComSystemTemplateSystemSignalRef=DET_RANGE_VELOCITY_ERR_199
            DET_RANGE_VELOCITY_ERR_200_oRDR_DETECTION_197_200_oPCAN_RADAR_1be152c1_Tx: ComBitPosition=400, ComBitSize=8, ComSignalInitValue=0, ComSignalType=UINT8, ComSystemTemplateSystemSignalRef=DET_RANGE_VELOCITY_ERR_200
            DET_RCS_197_oRDR_DETECTION_197_200_oPCAN_RADAR_ded40746_Tx: ComBitPosition=128, ComBitSize=8, ComSignalInitValue=128, ComSignalType=UINT8, ComSystemTemplateSystemSignalRef=DET_RCS_197
            DET_RCS_198_oRDR_DETECTION_197_200_oPCAN_RADAR_f2c49501_Tx: ComBitPosition=240, ComBitSize=8, ComSignalInitValue=128, ComSignalType=UINT8, ComSystemTemplateSystemSignalRef=DET_RCS_198
            DET_RCS_199_oRDR_DETECTION_197_200_oPCAN_RADAR_67b44194_Tx: ComBitPosition=352, ComBitSize=8, ComSignalInitValue=128, ComSignalType=UINT8, ComSystemTemplateSystemSignalRef=DET_RCS_199
            DET_RCS_200_oRDR_DETECTION_197_200_oPCAN_RADAR_93da9e29_Tx: ComBitPosition=464, ComBitSize=8, ComSignalInitValue=128, ComSignalType=UINT8, ComSystemTemplateSystemSignalRef=DET_RCS_200
            DET_SNR_197_oRDR_DETECTION_197_200_oPCAN_RADAR_037a5344_Tx: ComBitPosition=120, ComBitSize=8, ComSignalInitValue=0, ComSignalType=UINT8, ComSystemTemplateSystemSignalRef=DET_SNR_197
            DET_SNR_198_oRDR_DETECTION_197_200_oPCAN_RADAR_2f6ac103_Tx: ComBitPosition=232, ComBitSize=8, ComSignalInitValue=0, ComSignalType=UINT8, ComSystemTemplateSystemSignalRef=DET_SNR_198
            DET_SNR_199_oRDR_DETECTION_197_200_oPCAN_RADAR_ba1a1596_Tx: ComBitPosition=344, ComBitSize=8, ComSignalInitValue=0, ComSignalType=UINT8, ComSystemTemplateSystemSignalRef=DET_SNR_199
            DET_SNR_200_oRDR_DETECTION_197_200_oPCAN_RADAR_4e74ca2b_Tx: ComBitPosition=456, ComBitSize=8, ComSignalInitValue=0, ComSignalType=UINT8, ComSystemTemplateSystemSignalRef=DET_SNR_200
            DET_SUPER_RES_TARGET_197_oRDR_DETECTION_197_200_oPCAN_RADAR_32e37b21_Tx: ComBitPosition=87, ComBitSize=1, ComSignalInitValue=0, ComSignalType=BOOLEAN, ComSystemTemplateSystemSignalRef=DET_SUPER_RES_TARGET_197
            DET_SUPER_RES_TARGET_198_oRDR_DETECTION_197_200_oPCAN_RADAR_1ef3e966_Tx: ComBitPosition=199, ComBitSize=1, ComSignalInitValue=0, ComSignalType=BOOLEAN, ComSystemTemplateSystemSignalRef=DET_SUPER_RES_TARGET_198
            DET_SUPER_RES_TARGET_199_oRDR_DETECTION_197_200_oPCAN_RADAR_8b833df3_Tx: ComBitPosition=311, ComBitSize=1, ComSignalInitValue=0, ComSignalType=BOOLEAN, ComSystemTemplateSystemSignalRef=DET_SUPER_RES_TARGET_199
            DET_SUPER_RES_TARGET_200_oRDR_DETECTION_197_200_oPCAN_RADAR_7fede24e_Tx: ComBitPosition=423, ComBitSize=1, ComSignalInitValue=0, ComSignalType=BOOLEAN, ComSystemTemplateSystemSignalRef=DET_SUPER_RES_TARGET_200
        SG_Detections_201_204_oRDR_DETECTION_201_204_oPCAN_RADAR_5a18d0dd_Tx: ComSystemTemplateSignalGroupRef=SG_Detections_201_204
          83 x ComGroupSignal, all with ComSignalEndianness=LITTLE_ENDIAN, ComTransferProperty=PENDING:
            DET_AZIMUTH_201_oRDR_DETECTION_201_204_oPCAN_RADAR_d8cf8fa2_Tx: ComBitPosition=88, ComBitSize=13, ComSignalInitValue=0, ComSignalType=UINT16, ComSystemTemplateSystemSignalRef=DET_AZIMUTH_201
            DET_AZIMUTH_202_oRDR_DETECTION_201_204_oPCAN_RADAR_bc2ff45c_Tx: ComBitPosition=200, ComBitSize=13, ComSignalInitValue=0, ComSignalType=UINT16, ComSystemTemplateSystemSignalRef=DET_AZIMUTH_202
            DET_AZIMUTH_203_oRDR_DETECTION_201_204_oPCAN_RADAR_295f20c9_Tx: ComBitPosition=312, ComBitSize=13, ComSignalInitValue=0, ComSignalType=UINT16, ComSystemTemplateSystemSignalRef=DET_AZIMUTH_203
            DET_AZIMUTH_204_oRDR_DETECTION_201_204_oPCAN_RADAR_75ef03a0_Tx: ComBitPosition=424, ComBitSize=13, ComSignalInitValue=0, ComSignalType=UINT16, ComSystemTemplateSystemSignalRef=DET_AZIMUTH_204
            DET_AZIMUTH_ERR_201_oRDR_DETECTION_201_204_oPCAN_RADAR_7c7a1a57_Tx: ComBitPosition=105, ComBitSize=7, ComSignalInitValue=0, ComSignalType=UINT8, ComSystemTemplateSystemSignalRef=DET_AZIMUTH_ERR_201
            DET_AZIMUTH_ERR_202_oRDR_DETECTION_201_204_oPCAN_RADAR_189a61a9_Tx: ComBitPosition=217, ComBitSize=7, ComSignalInitValue=0, ComSignalType=UINT8, ComSystemTemplateSystemSignalRef=DET_AZIMUTH_ERR_202
            DET_AZIMUTH_ERR_203_oRDR_DETECTION_201_204_oPCAN_RADAR_8deab53c_Tx: ComBitPosition=329, ComBitSize=7, ComSignalInitValue=0, ComSignalType=UINT8, ComSystemTemplateSystemSignalRef=DET_AZIMUTH_ERR_203
            DET_AZIMUTH_ERR_204_oRDR_DETECTION_201_204_oPCAN_RADAR_d15a9655_Tx: ComBitPosition=441, ComBitSize=7, ComSignalInitValue=0, ComSignalType=UINT8, ComSystemTemplateSystemSignalRef=DET_AZIMUTH_ERR_204
            DET_BELOW_RAIN_THOLD_201_oRDR_DETECTION_201_204_oPCAN_RADAR_0dce1c62_Tx: ComBitPosition=39, ComBitSize=1, ComSignalInitValue=0, ComSignalType=BOOLEAN, ComSystemTemplateSystemSignalRef=DET_BELOW_RAIN_THOLD_201
            DET_BELOW_RAIN_THOLD_202_oRDR_DETECTION_201_204_oPCAN_RADAR_692e679c_Tx: ComBitPosition=151, ComBitSize=1, ComSignalInitValue=0, ComSignalType=BOOLEAN, ComSystemTemplateSystemSignalRef=DET_BELOW_RAIN_THOLD_202
            DET_BELOW_RAIN_THOLD_203_oRDR_DETECTION_201_204_oPCAN_RADAR_fc5eb309_Tx: ComBitPosition=263, ComBitSize=1, ComSignalInitValue=0, ComSignalType=BOOLEAN, ComSystemTemplateSystemSignalRef=DET_BELOW_RAIN_THOLD_203
            DET_BELOW_RAIN_THOLD_204_oRDR_DETECTION_201_204_oPCAN_RADAR_a0ee9060_Tx: ComBitPosition=375, ComBitSize=1, ComSignalInitValue=0, ComSignalType=BOOLEAN, ComSystemTemplateSystemSignalRef=DET_BELOW_RAIN_THOLD_204
            DET_BI_STATIC_FLAG_201_oRDR_DETECTION_201_204_oPCAN_RADAR_8ee3cf27_Tx: ComBitPosition=104, ComBitSize=1, ComSignalInitValue=0, ComSignalType=BOOLEAN, ComSystemTemplateSystemSignalRef=DET_BI_STATIC_FLAG_201
            DET_BI_STATIC_FLAG_202_oRDR_DETECTION_201_204_oPCAN_RADAR_ea03b4d9_Tx: ComBitPosition=216, ComBitSize=1, ComSignalInitValue=0, ComSignalType=BOOLEAN, ComSystemTemplateSystemSignalRef=DET_BI_STATIC_FLAG_202
            DET_BI_STATIC_FLAG_203_oRDR_DETECTION_201_204_oPCAN_RADAR_7f73604c_Tx: ComBitPosition=328, ComBitSize=1, ComSignalInitValue=0, ComSignalType=BOOLEAN, ComSystemTemplateSystemSignalRef=DET_BI_STATIC_FLAG_203
            DET_BI_STATIC_FLAG_204_oRDR_DETECTION_201_204_oPCAN_RADAR_23c34325_Tx: ComBitPosition=440, ComBitSize=1, ComSignalInitValue=0, ComSignalType=BOOLEAN, ComSystemTemplateSystemSignalRef=DET_BI_STATIC_FLAG_204
            DET_CONFD_AZIMUTH_201_oRDR_DETECTION_201_204_oPCAN_RADAR_da298568_Tx: ComBitPosition=118, ComBitSize=2, ComSignalInitValue=0, ComSignalType=UINT8, ComSystemTemplateSystemSignalRef=DET_CONFD_AZIMUTH_201
            DET_CONFD_AZIMUTH_202_oRDR_DETECTION_201_204_oPCAN_RADAR_bec9fe96_Tx: ComBitPosition=230, ComBitSize=2, ComSignalInitValue=0, ComSignalType=UINT8, ComSystemTemplateSystemSignalRef=DET_CONFD_AZIMUTH_202
            DET_CONFD_AZIMUTH_203_oRDR_DETECTION_201_204_oPCAN_RADAR_2bb92a03_Tx: ComBitPosition=342, ComBitSize=2, ComSignalInitValue=0, ComSignalType=UINT8, ComSystemTemplateSystemSignalRef=DET_CONFD_AZIMUTH_203
            DET_CONFD_AZIMUTH_204_oRDR_DETECTION_201_204_oPCAN_RADAR_7709096a_Tx: ComBitPosition=454, ComBitSize=2, ComSignalInitValue=0, ComSignalType=UINT8, ComSystemTemplateSystemSignalRef=DET_CONFD_AZIMUTH_204
            DET_CONFD_ELEVATION_201_oRDR_DETECTION_201_204_oPCAN_RADAR_d8bc8492_Tx: ComBitPosition=101, ComBitSize=2, ComSignalInitValue=0, ComSignalType=UINT8, ComSystemTemplateSystemSignalRef=DET_CONFD_ELEVATION_201
            DET_CONFD_ELEVATION_202_oRDR_DETECTION_201_204_oPCAN_RADAR_bc5cff6c_Tx: ComBitPosition=213, ComBitSize=2, ComSignalInitValue=0, ComSignalType=UINT8, ComSystemTemplateSystemSignalRef=DET_CONFD_ELEVATION_202
            DET_CONFD_ELEVATION_203_oRDR_DETECTION_201_204_oPCAN_RADAR_292c2bf9_Tx: ComBitPosition=325, ComBitSize=2, ComSignalInitValue=0, ComSignalType=UINT8, ComSystemTemplateSystemSignalRef=DET_CONFD_ELEVATION_203
            DET_CONFD_ELEVATION_204_oRDR_DETECTION_201_204_oPCAN_RADAR_759c0890_Tx: ComBitPosition=437, ComBitSize=2, ComSignalInitValue=0, ComSignalType=UINT8, ComSystemTemplateSystemSignalRef=DET_CONFD_ELEVATION_204
            DET_ELEVATION_201_oRDR_DETECTION_201_204_oPCAN_RADAR_097c50ae_Tx: ComBitPosition=72, ComBitSize=8, ComSignalInitValue=0, ComSignalType=UINT8, ComSystemTemplateSystemSignalRef=DET_ELEVATION_201
            DET_ELEVATION_202_oRDR_DETECTION_201_204_oPCAN_RADAR_6d9c2b50_Tx: ComBitPosition=184, ComBitSize=8, ComSignalInitValue=0, ComSignalType=UINT8, ComSystemTemplateSystemSignalRef=DET_ELEVATION_202
            DET_ELEVATION_203_oRDR_DETECTION_201_204_oPCAN_RADAR_f8ecffc5_Tx: ComBitPosition=296, ComBitSize=8, ComSignalInitValue=0, ComSignalType=UINT8, ComSystemTemplateSystemSignalRef=DET_ELEVATION_203
            DET_ELEVATION_204_oRDR_DETECTION_201_204_oPCAN_RADAR_a45cdcac_Tx: ComBitPosition=408, ComBitSize=8, ComSignalInitValue=0, ComSignalType=UINT8, ComSystemTemplateSystemSignalRef=DET_ELEVATION_204
            DET_ELEVATION_ERR_201_oRDR_DETECTION_201_204_oPCAN_RADAR_8e45c8db_Tx: ComBitPosition=80, ComBitSize=6, ComSignalInitValue=0, ComSignalType=UINT8, ComSystemTemplateSystemSignalRef=DET_ELEVATION_ERR_201
            DET_ELEVATION_ERR_202_oRDR_DETECTION_201_204_oPCAN_RADAR_eaa5b325_Tx: ComBitPosition=192, ComBitSize=6, ComSignalInitValue=0, ComSignalType=UINT8, ComSystemTemplateSystemSignalRef=DET_ELEVATION_ERR_202
            DET_ELEVATION_ERR_203_oRDR_DETECTION_201_204_oPCAN_RADAR_7fd567b0_Tx: ComBitPosition=304, ComBitSize=6, ComSignalInitValue=0, ComSignalType=UINT8, ComSystemTemplateSystemSignalRef=DET_ELEVATION_ERR_203
            DET_ELEVATION_ERR_204_oRDR_DETECTION_201_204_oPCAN_RADAR_236544d9_Tx: ComBitPosition=416, ComBitSize=6, ComSignalInitValue=0, ComSignalType=UINT8, ComSystemTemplateSystemSignalRef=DET_ELEVATION_ERR_204
            DET_EXISTENCE_PROB_201_oRDR_DETECTION_201_204_oPCAN_RADAR_5cdabdbb_Tx: ComBitPosition=112, ComBitSize=6, ComSignalInitValue=0, ComSignalType=UINT8, ComSystemTemplateSystemSignalRef=DET_EXISTENCE_PROB_201
            DET_EXISTENCE_PROB_202_oRDR_DETECTION_201_204_oPCAN_RADAR_383ac645_Tx: ComBitPosition=224, ComBitSize=6, ComSignalInitValue=0, ComSignalType=UINT8, ComSystemTemplateSystemSignalRef=DET_EXISTENCE_PROB_202
            DET_EXISTENCE_PROB_203_oRDR_DETECTION_201_204_oPCAN_RADAR_ad4a12d0_Tx: ComBitPosition=336, ComBitSize=6, ComSignalInitValue=0, ComSignalType=UINT8, ComSystemTemplateSystemSignalRef=DET_EXISTENCE_PROB_203
            DET_EXISTENCE_PROB_204_oRDR_DETECTION_201_204_oPCAN_RADAR_f1fa31b9_Tx: ComBitPosition=448, ComBitSize=6, ComSignalInitValue=0, ComSignalType=UINT8, ComSystemTemplateSystemSignalRef=DET_EXISTENCE_PROB_204
            DET_HVC_FLAG_201_oRDR_DETECTION_201_204_oPCAN_RADAR_bdaefec4_Tx: ComBitPosition=86, ComBitSize=1, ComSignalInitValue=0, ComSignalType=BOOLEAN, ComSystemTemplateSystemSignalRef=DET_HVC_FLAG_201
            DET_HVC_FLAG_202_oRDR_DETECTION_201_204_oPCAN_RADAR_d94e853a_Tx: ComBitPosition=198, ComBitSize=1, ComSignalInitValue=0, ComSignalType=BOOLEAN, ComSystemTemplateSystemSignalRef=DET_HVC_FLAG_202
            DET_HVC_FLAG_203_oRDR_DETECTION_201_204_oPCAN_RADAR_4c3e51af_Tx: ComBitPosition=310, ComBitSize=1, ComSignalInitValue=0, ComSignalType=BOOLEAN, ComSystemTemplateSystemSignalRef=DET_HVC_FLAG_203
            DET_HVC_FLAG_204_oRDR_DETECTION_201_204_oPCAN_RADAR_108e72c6_Tx: ComBitPosition=422, ComBitSize=1, ComSignalInitValue=0, ComSignalType=BOOLEAN, ComSystemTemplateSystemSignalRef=DET_HVC_FLAG_204
            DET_IDM_201_oRDR_DETECTION_201_204_oPCAN_RADAR_36fcc579_Tx: ComBitPosition=63, ComBitSize=1, ComSignalInitValue=0, ComSignalType=BOOLEAN, ComSystemTemplateSystemSignalRef=DET_IDM_201
            DET_IDM_202_oRDR_DETECTION_201_204_oPCAN_RADAR_521cbe87_Tx: ComBitPosition=175, ComBitSize=1, ComSignalInitValue=0, ComSignalType=BOOLEAN, ComSystemTemplateSystemSignalRef=DET_IDM_202
            DET_IDM_203_oRDR_DETECTION_201_204_oPCAN_RADAR_c76c6a12_Tx: ComBitPosition=287, ComBitSize=1, ComSignalInitValue=0, ComSignalType=BOOLEAN, ComSystemTemplateSystemSignalRef=DET_IDM_203
            DET_IDM_204_oRDR_DETECTION_201_204_oPCAN_RADAR_9bdc497b_Tx: ComBitPosition=399, ComBitSize=1, ComSignalInitValue=0, ComSignalType=BOOLEAN, ComSystemTemplateSystemSignalRef=DET_IDM_204
            DET_MH_CRC16_201_204_oRDR_DETECTION_201_204_oPCAN_RADAR_de9002d6_Tx: ComBitPosition=0, ComBitSize=16, ComSignalInitValue=0, ComSignalType=UINT16, ComSystemTemplateSystemSignalRef=DET_MH_CRC16_201_204
            DET_MH_CYCLE_COUNTER_201_204_oRDR_DETECTION_201_204_oPCAN_RADAR_5ae5a3e1_Tx: ComBitPosition=16, ComBitSize=8, ComSignalInitValue=0, ComSignalType=UINT8, ComSystemTemplateSystemSignalRef=DET_MH_CYCLE_COUNTER_201_204
            DET_MH_SCAN_INDEX_4LSB_201_204_oRDR_DETECTION_201_204_oPCAN_RADAR_96cf866d_Tx: ComBitPosition=476, ComBitSize=4, ComSignalInitValue=0, ComSignalType=UINT8, ComSystemTemplateSystemSignalRef=DET_MH_SCAN_INDEX_4LSB_201_204
            DET_MTD_201_oRDR_DETECTION_201_204_oPCAN_RADAR_504ff7a2_Tx: ComBitPosition=47, ComBitSize=1, ComSignalInitValue=0, ComSignalType=BOOLEAN, ComSystemTemplateSystemSignalRef=DET_MTD_201
            DET_MTD_202_oRDR_DETECTION_201_204_oPCAN_RADAR_34af8c5c_Tx: ComBitPosition=159, ComBitSize=1, ComSignalInitValue=0, ComSignalType=BOOLEAN, ComSystemTemplateSystemSignalRef=DET_MTD_202
            DET_MTD_203_oRDR_DETECTION_201_204_oPCAN_RADAR_a1df58c9_Tx: ComBitPosition=271, ComBitSize=1, ComSignalInitValue=0, ComSignalType=BOOLEAN, ComSystemTemplateSystemSignalRef=DET_MTD_203
            DET_MTD_204_oRDR_DETECTION_201_204_oPCAN_RADAR_fd6f7ba0_Tx: ComBitPosition=383, ComBitSize=1, ComSignalInitValue=0, ComSignalType=BOOLEAN, ComSystemTemplateSystemSignalRef=DET_MTD_204
            DET_PROB_1STAZHYPO_201_oRDR_DETECTION_201_204_oPCAN_RADAR_c3fb1f6f_Tx: ComBitPosition=103, ComBitSize=1, ComSignalInitValue=0, ComSignalType=BOOLEAN, ComSystemTemplateSystemSignalRef=DET_PROB_1STAZHYPO_201
            DET_PROB_1STAZHYPO_202_oRDR_DETECTION_201_204_oPCAN_RADAR_a71b6491_Tx: ComBitPosition=215, ComBitSize=1, ComSignalInitValue=0, ComSignalType=BOOLEAN, ComSystemTemplateSystemSignalRef=DET_PROB_1STAZHYPO_202
            DET_PROB_1STAZHYPO_203_oRDR_DETECTION_201_204_oPCAN_RADAR_326bb004_Tx: ComBitPosition=327, ComBitSize=1, ComSignalInitValue=0, ComSignalType=BOOLEAN, ComSystemTemplateSystemSignalRef=DET_PROB_1STAZHYPO_203
            DET_PROB_1STAZHYPO_204_oRDR_DETECTION_201_204_oPCAN_RADAR_6edb936d_Tx: ComBitPosition=439, ComBitSize=1, ComSignalInitValue=0, ComSignalType=BOOLEAN, ComSystemTemplateSystemSignalRef=DET_PROB_1STAZHYPO_204
            DET_RANGE_201_oRDR_DETECTION_201_204_oPCAN_RADAR_c854fc19_Tx: ComBitPosition=24, ComBitSize=15, ComSignalInitValue=0, ComSignalType=UINT16, ComSystemTemplateSystemSignalRef=DET_RANGE_201
            DET_RANGE_202_oRDR_DETECTION_201_204_oPCAN_RADAR_acb487e7_Tx: ComBitPosition=136, ComBitSize=15, ComSignalInitValue=0, ComSignalType=UINT16, ComSystemTemplateSystemSignalRef=DET_RANGE_202
            DET_RANGE_203_oRDR_DETECTION_201_204_oPCAN_RADAR_39c45372_Tx: ComBitPosition=248, ComBitSize=15, ComSignalInitValue=0, ComSignalType=UINT16, ComSystemTemplateSystemSignalRef=DET_RANGE_203
            DET_RANGE_204_oRDR_DETECTION_201_204_oPCAN_RADAR_6574701b_Tx: ComBitPosition=360, ComBitSize=15, ComSignalInitValue=0, ComSignalType=UINT16, ComSystemTemplateSystemSignalRef=DET_RANGE_204
            DET_RANGE_ERR_201_oRDR_DETECTION_201_204_oPCAN_RADAR_6fbc4670_Tx: ComBitPosition=40, ComBitSize=7, ComSignalInitValue=0, ComSignalType=UINT8, ComSystemTemplateSystemSignalRef=DET_RANGE_ERR_201
            DET_RANGE_ERR_202_oRDR_DETECTION_201_204_oPCAN_RADAR_0b5c3d8e_Tx: ComBitPosition=152, ComBitSize=7, ComSignalInitValue=0, ComSignalType=UINT8, ComSystemTemplateSystemSignalRef=DET_RANGE_ERR_202
            DET_RANGE_ERR_203_oRDR_DETECTION_201_204_oPCAN_RADAR_9e2ce91b_Tx: ComBitPosition=264, ComBitSize=7, ComSignalInitValue=0, ComSignalType=UINT8, ComSystemTemplateSystemSignalRef=DET_RANGE_ERR_203
            DET_RANGE_ERR_204_oRDR_DETECTION_201_204_oPCAN_RADAR_c29cca72_Tx: ComBitPosition=376, ComBitSize=7, ComSignalInitValue=0, ComSignalType=UINT8, ComSystemTemplateSystemSignalRef=DET_RANGE_ERR_204
            DET_RANGE_VELOCITY_201_oRDR_DETECTION_201_204_oPCAN_RADAR_bdf23e3c_Tx: ComBitPosition=48, ComBitSize=15, ComSignalInitValue=16384, ComSignalType=UINT16, ComSystemTemplateSystemSignalRef=DET_RANGE_VELOCITY_201
            DET_RANGE_VELOCITY_202_oRDR_DETECTION_201_204_oPCAN_RADAR_d91245c2_Tx: ComBitPosition=160, ComBitSize=15, ComSignalInitValue=16384, ComSignalType=UINT16, ComSystemTemplateSystemSignalRef=DET_RANGE_VELOCITY_202
            DET_RANGE_VELOCITY_203_oRDR_DETECTION_201_204_oPCAN_RADAR_4c629157_Tx: ComBitPosition=272, ComBitSize=15, ComSignalInitValue=16384, ComSignalType=UINT16, ComSystemTemplateSystemSignalRef=DET_RANGE_VELOCITY_203
            DET_RANGE_VELOCITY_204_oRDR_DETECTION_201_204_oPCAN_RADAR_10d2b23e_Tx: ComBitPosition=384, ComBitSize=15, ComSignalInitValue=16384, ComSignalType=UINT16, ComSystemTemplateSystemSignalRef=DET_RANGE_VELOCITY_204
            DET_RANGE_VELOCITY_ERR_201_oRDR_DETECTION_201_204_oPCAN_RADAR_b249c58e_Tx: ComBitPosition=64, ComBitSize=8, ComSignalInitValue=0, ComSignalType=UINT8, ComSystemTemplateSystemSignalRef=DET_RANGE_VELOCITY_ERR_201
            DET_RANGE_VELOCITY_ERR_202_oRDR_DETECTION_201_204_oPCAN_RADAR_d6a9be70_Tx: ComBitPosition=176, ComBitSize=8, ComSignalInitValue=0, ComSignalType=UINT8, ComSystemTemplateSystemSignalRef=DET_RANGE_VELOCITY_ERR_202
            DET_RANGE_VELOCITY_ERR_203_oRDR_DETECTION_201_204_oPCAN_RADAR_43d96ae5_Tx: ComBitPosition=288, ComBitSize=8, ComSignalInitValue=0, ComSignalType=UINT8, ComSystemTemplateSystemSignalRef=DET_RANGE_VELOCITY_ERR_203
            DET_RANGE_VELOCITY_ERR_204_oRDR_DETECTION_201_204_oPCAN_RADAR_1f69498c_Tx: ComBitPosition=400, ComBitSize=8, ComSignalInitValue=0, ComSignalType=UINT8, ComSystemTemplateSystemSignalRef=DET_RANGE_VELOCITY_ERR_204
            DET_RCS_201_oRDR_DETECTION_201_204_oPCAN_RADAR_3a720966_Tx: ComBitPosition=128, ComBitSize=8, ComSignalInitValue=128, ComSignalType=UINT8, ComSystemTemplateSystemSignalRef=DET_RCS_201
            DET_RCS_202_oRDR_DETECTION_201_204_oPCAN_RADAR_5e927298_Tx: ComBitPosition=240, ComBitSize=8, ComSignalInitValue=128, ComSignalType=UINT8, ComSystemTemplateSystemSignalRef=DET_RCS_202
            DET_RCS_203_oRDR_DETECTION_201_204_oPCAN_RADAR_cbe2a60d_Tx: ComBitPosition=352, ComBitSize=8, ComSignalInitValue=128, ComSignalType=UINT8, ComSystemTemplateSystemSignalRef=DET_RCS_203
            DET_RCS_204_oRDR_DETECTION_201_204_oPCAN_RADAR_97528564_Tx: ComBitPosition=464, ComBitSize=8, ComSignalInitValue=128, ComSignalType=UINT8, ComSystemTemplateSystemSignalRef=DET_RCS_204
            DET_SNR_201_oRDR_DETECTION_201_204_oPCAN_RADAR_e7dc5d64_Tx: ComBitPosition=120, ComBitSize=8, ComSignalInitValue=0, ComSignalType=UINT8, ComSystemTemplateSystemSignalRef=DET_SNR_201
            DET_SNR_202_oRDR_DETECTION_201_204_oPCAN_RADAR_833c269a_Tx: ComBitPosition=232, ComBitSize=8, ComSignalInitValue=0, ComSignalType=UINT8, ComSystemTemplateSystemSignalRef=DET_SNR_202
            DET_SNR_203_oRDR_DETECTION_201_204_oPCAN_RADAR_164cf20f_Tx: ComBitPosition=344, ComBitSize=8, ComSignalInitValue=0, ComSignalType=UINT8, ComSystemTemplateSystemSignalRef=DET_SNR_203
            DET_SNR_204_oRDR_DETECTION_201_204_oPCAN_RADAR_4afcd166_Tx: ComBitPosition=456, ComBitSize=8, ComSignalInitValue=0, ComSignalType=UINT8, ComSystemTemplateSystemSignalRef=DET_SNR_204
            DET_SUPER_RES_TARGET_201_oRDR_DETECTION_201_204_oPCAN_RADAR_d6457501_Tx: ComBitPosition=87, ComBitSize=1, ComSignalInitValue=0, ComSignalType=BOOLEAN, ComSystemTemplateSystemSignalRef=DET_SUPER_RES_TARGET_201
            DET_SUPER_RES_TARGET_202_oRDR_DETECTION_201_204_oPCAN_RADAR_b2a50eff_Tx: ComBitPosition=199, ComBitSize=1, ComSignalInitValue=0, ComSignalType=BOOLEAN, ComSystemTemplateSystemSignalRef=DET_SUPER_RES_TARGET_202
            DET_SUPER_RES_TARGET_203_oRDR_DETECTION_201_204_oPCAN_RADAR_27d5da6a_Tx: ComBitPosition=311, ComBitSize=1, ComSignalInitValue=0, ComSignalType=BOOLEAN, ComSystemTemplateSystemSignalRef=DET_SUPER_RES_TARGET_203
            DET_SUPER_RES_TARGET_204_oRDR_DETECTION_201_204_oPCAN_RADAR_7b65f903_Tx: ComBitPosition=423, ComBitSize=1, ComSignalInitValue=0, ComSignalType=BOOLEAN, ComSystemTemplateSystemSignalRef=DET_SUPER_RES_TARGET_204
        SG_Detections_205_208_oRDR_DETECTION_205_208_oPCAN_RADAR_2bdbe48f_Tx: ComSystemTemplateSignalGroupRef=SG_Detections_205_208
          83 x ComGroupSignal, all with ComSignalEndianness=LITTLE_ENDIAN, ComTransferProperty=PENDING:
            DET_AZIMUTH_205_oRDR_DETECTION_205_208_oPCAN_RADAR_092d4901_Tx: ComBitPosition=88, ComBitSize=13, ComSignalInitValue=0, ComSignalType=UINT16, ComSystemTemplateSystemSignalRef=DET_AZIMUTH_205
            DET_AZIMUTH_206_oRDR_DETECTION_205_208_oPCAN_RADAR_6dcd32ff_Tx: ComBitPosition=200, ComBitSize=13, ComSignalInitValue=0, ComSignalType=UINT16, ComSystemTemplateSystemSignalRef=DET_AZIMUTH_206
            DET_AZIMUTH_207_oRDR_DETECTION_205_208_oPCAN_RADAR_f8bde66a_Tx: ComBitPosition=312, ComBitSize=13, ComSignalInitValue=0, ComSignalType=UINT16, ComSystemTemplateSystemSignalRef=DET_AZIMUTH_207
            DET_AZIMUTH_208_oRDR_DETECTION_205_208_oPCAN_RADAR_d4ad742d_Tx: ComBitPosition=424, ComBitSize=13, ComSignalInitValue=0, ComSignalType=UINT16, ComSystemTemplateSystemSignalRef=DET_AZIMUTH_208
            DET_AZIMUTH_ERR_205_oRDR_DETECTION_205_208_oPCAN_RADAR_ad98dcf4_Tx: ComBitPosition=105, ComBitSize=7, ComSignalInitValue=0, ComSignalType=UINT8, ComSystemTemplateSystemSignalRef=DET_AZIMUTH_ERR_205
            DET_AZIMUTH_ERR_206_oRDR_DETECTION_205_208_oPCAN_RADAR_c978a70a_Tx: ComBitPosition=217, ComBitSize=7, ComSignalInitValue=0, ComSignalType=UINT8, ComSystemTemplateSystemSignalRef=DET_AZIMUTH_ERR_206
            DET_AZIMUTH_ERR_207_oRDR_DETECTION_205_208_oPCAN_RADAR_5c08739f_Tx: ComBitPosition=329, ComBitSize=7, ComSignalInitValue=0, ComSignalType=UINT8, ComSystemTemplateSystemSignalRef=DET_AZIMUTH_ERR_207
            DET_AZIMUTH_ERR_208_oRDR_DETECTION_205_208_oPCAN_RADAR_7018e1d8_Tx: ComBitPosition=441, ComBitSize=7, ComSignalInitValue=0, ComSignalType=UINT8, ComSystemTemplateSystemSignalRef=DET_AZIMUTH_ERR_208
            DET_BELOW_RAIN_THOLD_205_oRDR_DETECTION_205_208_oPCAN_RADAR_dc2cdac1_Tx: ComBitPosition=39, ComBitSize=1, ComSignalInitValue=0, ComSignalType=BOOLEAN, ComSystemTemplateSystemSignalRef=DET_BELOW_RAIN_THOLD_205
            DET_BELOW_RAIN_THOLD_206_oRDR_DETECTION_205_208_oPCAN_RADAR_b8cca13f_Tx: ComBitPosition=151, ComBitSize=1, ComSignalInitValue=0, ComSignalType=BOOLEAN, ComSystemTemplateSystemSignalRef=DET_BELOW_RAIN_THOLD_206
            DET_BELOW_RAIN_THOLD_207_oRDR_DETECTION_205_208_oPCAN_RADAR_2dbc75aa_Tx: ComBitPosition=263, ComBitSize=1, ComSignalInitValue=0, ComSignalType=BOOLEAN, ComSystemTemplateSystemSignalRef=DET_BELOW_RAIN_THOLD_207
            DET_BELOW_RAIN_THOLD_208_oRDR_DETECTION_205_208_oPCAN_RADAR_01ace7ed_Tx: ComBitPosition=375, ComBitSize=1, ComSignalInitValue=0, ComSignalType=BOOLEAN, ComSystemTemplateSystemSignalRef=DET_BELOW_RAIN_THOLD_208
            DET_BI_STATIC_FLAG_205_oRDR_DETECTION_205_208_oPCAN_RADAR_5f010984_Tx: ComBitPosition=104, ComBitSize=1, ComSignalInitValue=0, ComSignalType=BOOLEAN, ComSystemTemplateSystemSignalRef=DET_BI_STATIC_FLAG_205
            DET_BI_STATIC_FLAG_206_oRDR_DETECTION_205_208_oPCAN_RADAR_3be1727a_Tx: ComBitPosition=216, ComBitSize=1, ComSignalInitValue=0, ComSignalType=BOOLEAN, ComSystemTemplateSystemSignalRef=DET_BI_STATIC_FLAG_206
            DET_BI_STATIC_FLAG_207_oRDR_DETECTION_205_208_oPCAN_RADAR_ae91a6ef_Tx: ComBitPosition=328, ComBitSize=1, ComSignalInitValue=0, ComSignalType=BOOLEAN, ComSystemTemplateSystemSignalRef=DET_BI_STATIC_FLAG_207
            DET_BI_STATIC_FLAG_208_oRDR_DETECTION_205_208_oPCAN_RADAR_828134a8_Tx: ComBitPosition=440, ComBitSize=1, ComSignalInitValue=0, ComSignalType=BOOLEAN, ComSystemTemplateSystemSignalRef=DET_BI_STATIC_FLAG_208
            DET_CONFD_AZIMUTH_205_oRDR_DETECTION_205_208_oPCAN_RADAR_0bcb43cb_Tx: ComBitPosition=118, ComBitSize=2, ComSignalInitValue=0, ComSignalType=UINT8, ComSystemTemplateSystemSignalRef=DET_CONFD_AZIMUTH_205
            DET_CONFD_AZIMUTH_206_oRDR_DETECTION_205_208_oPCAN_RADAR_6f2b3835_Tx: ComBitPosition=230, ComBitSize=2, ComSignalInitValue=0, ComSignalType=UINT8, ComSystemTemplateSystemSignalRef=DET_CONFD_AZIMUTH_206
            DET_CONFD_AZIMUTH_207_oRDR_DETECTION_205_208_oPCAN_RADAR_fa5beca0_Tx: ComBitPosition=342, ComBitSize=2, ComSignalInitValue=0, ComSignalType=UINT8, ComSystemTemplateSystemSignalRef=DET_CONFD_AZIMUTH_207
            DET_CONFD_AZIMUTH_208_oRDR_DETECTION_205_208_oPCAN_RADAR_d64b7ee7_Tx: ComBitPosition=454, ComBitSize=2, ComSignalInitValue=0, ComSignalType=UINT8, ComSystemTemplateSystemSignalRef=DET_CONFD_AZIMUTH_208
            DET_CONFD_ELEVATION_205_oRDR_DETECTION_205_208_oPCAN_RADAR_095e4231_Tx: ComBitPosition=101, ComBitSize=2, ComSignalInitValue=0, ComSignalType=UINT8, ComSystemTemplateSystemSignalRef=DET_CONFD_ELEVATION_205
            DET_CONFD_ELEVATION_206_oRDR_DETECTION_205_208_oPCAN_RADAR_6dbe39cf_Tx: ComBitPosition=213, ComBitSize=2, ComSignalInitValue=0, ComSignalType=UINT8, ComSystemTemplateSystemSignalRef=DET_CONFD_ELEVATION_206
            DET_CONFD_ELEVATION_207_oRDR_DETECTION_205_208_oPCAN_RADAR_f8ceed5a_Tx: ComBitPosition=325, ComBitSize=2, ComSignalInitValue=0, ComSignalType=UINT8, ComSystemTemplateSystemSignalRef=DET_CONFD_ELEVATION_207
            DET_CONFD_ELEVATION_208_oRDR_DETECTION_205_208_oPCAN_RADAR_d4de7f1d_Tx: ComBitPosition=437, ComBitSize=2, ComSignalInitValue=0, ComSignalType=UINT8, ComSystemTemplateSystemSignalRef=DET_CONFD_ELEVATION_208
            DET_ELEVATION_205_oRDR_DETECTION_205_208_oPCAN_RADAR_d89e960d_Tx: ComBitPosition=72, ComBitSize=8, ComSignalInitValue=0, ComSignalType=UINT8, ComSystemTemplateSystemSignalRef=DET_ELEVATION_205
            DET_ELEVATION_206_oRDR_DETECTION_205_208_oPCAN_RADAR_bc7eedf3_Tx: ComBitPosition=184, ComBitSize=8, ComSignalInitValue=0, ComSignalType=UINT8, ComSystemTemplateSystemSignalRef=DET_ELEVATION_206
            DET_ELEVATION_207_oRDR_DETECTION_205_208_oPCAN_RADAR_290e3966_Tx: ComBitPosition=296, ComBitSize=8, ComSignalInitValue=0, ComSignalType=UINT8, ComSystemTemplateSystemSignalRef=DET_ELEVATION_207
            DET_ELEVATION_208_oRDR_DETECTION_205_208_oPCAN_RADAR_051eab21_Tx: ComBitPosition=408, ComBitSize=8, ComSignalInitValue=0, ComSignalType=UINT8, ComSystemTemplateSystemSignalRef=DET_ELEVATION_208
            DET_ELEVATION_ERR_205_oRDR_DETECTION_205_208_oPCAN_RADAR_5fa70e78_Tx: ComBitPosition=80, ComBitSize=6, ComSignalInitValue=0, ComSignalType=UINT8, ComSystemTemplateSystemSignalRef=DET_ELEVATION_ERR_205
            DET_ELEVATION_ERR_206_oRDR_DETECTION_205_208_oPCAN_RADAR_3b477586_Tx: ComBitPosition=192, ComBitSize=6, ComSignalInitValue=0, ComSignalType=UINT8, ComSystemTemplateSystemSignalRef=DET_ELEVATION_ERR_206
            DET_ELEVATION_ERR_207_oRDR_DETECTION_205_208_oPCAN_RADAR_ae37a113_Tx: ComBitPosition=304, ComBitSize=6, ComSignalInitValue=0, ComSignalType=UINT8, ComSystemTemplateSystemSignalRef=DET_ELEVATION_ERR_207
            DET_ELEVATION_ERR_208_oRDR_DETECTION_205_208_oPCAN_RADAR_82273354_Tx: ComBitPosition=416, ComBitSize=6, ComSignalInitValue=0, ComSignalType=UINT8, ComSystemTemplateSystemSignalRef=DET_ELEVATION_ERR_208
            DET_EXISTENCE_PROB_205_oRDR_DETECTION_205_208_oPCAN_RADAR_8d387b18_Tx: ComBitPosition=112, ComBitSize=6, ComSignalInitValue=0, ComSignalType=UINT8, ComSystemTemplateSystemSignalRef=DET_EXISTENCE_PROB_205
            DET_EXISTENCE_PROB_206_oRDR_DETECTION_205_208_oPCAN_RADAR_e9d800e6_Tx: ComBitPosition=224, ComBitSize=6, ComSignalInitValue=0, ComSignalType=UINT8, ComSystemTemplateSystemSignalRef=DET_EXISTENCE_PROB_206
            DET_EXISTENCE_PROB_207_oRDR_DETECTION_205_208_oPCAN_RADAR_7ca8d473_Tx: ComBitPosition=336, ComBitSize=6, ComSignalInitValue=0, ComSignalType=UINT8, ComSystemTemplateSystemSignalRef=DET_EXISTENCE_PROB_207
            DET_EXISTENCE_PROB_208_oRDR_DETECTION_205_208_oPCAN_RADAR_50b84634_Tx: ComBitPosition=448, ComBitSize=6, ComSignalInitValue=0, ComSignalType=UINT8, ComSystemTemplateSystemSignalRef=DET_EXISTENCE_PROB_208
            DET_HVC_FLAG_205_oRDR_DETECTION_205_208_oPCAN_RADAR_6c4c3867_Tx: ComBitPosition=86, ComBitSize=1, ComSignalInitValue=0, ComSignalType=BOOLEAN, ComSystemTemplateSystemSignalRef=DET_HVC_FLAG_205
            DET_HVC_FLAG_206_oRDR_DETECTION_205_208_oPCAN_RADAR_08ac4399_Tx: ComBitPosition=198, ComBitSize=1, ComSignalInitValue=0, ComSignalType=BOOLEAN, ComSystemTemplateSystemSignalRef=DET_HVC_FLAG_206
            DET_HVC_FLAG_207_oRDR_DETECTION_205_208_oPCAN_RADAR_9ddc970c_Tx: ComBitPosition=310, ComBitSize=1, ComSignalInitValue=0, ComSignalType=BOOLEAN, ComSystemTemplateSystemSignalRef=DET_HVC_FLAG_207
            DET_HVC_FLAG_208_oRDR_DETECTION_205_208_oPCAN_RADAR_b1cc054b_Tx: ComBitPosition=422, ComBitSize=1, ComSignalInitValue=0, ComSignalType=BOOLEAN, ComSystemTemplateSystemSignalRef=DET_HVC_FLAG_208
            DET_IDM_205_oRDR_DETECTION_205_208_oPCAN_RADAR_e71e03da_Tx: ComBitPosition=63, ComBitSize=1, ComSignalInitValue=0, ComSignalType=BOOLEAN, ComSystemTemplateSystemSignalRef=DET_IDM_205
            DET_IDM_206_oRDR_DETECTION_205_208_oPCAN_RADAR_83fe7824_Tx: ComBitPosition=175, ComBitSize=1, ComSignalInitValue=0, ComSignalType=BOOLEAN, ComSystemTemplateSystemSignalRef=DET_IDM_206
            DET_IDM_207_oRDR_DETECTION_205_208_oPCAN_RADAR_168eacb1_Tx: ComBitPosition=287, ComBitSize=1, ComSignalInitValue=0, ComSignalType=BOOLEAN, ComSystemTemplateSystemSignalRef=DET_IDM_207
            DET_IDM_208_oRDR_DETECTION_205_208_oPCAN_RADAR_3a9e3ef6_Tx: ComBitPosition=399, ComBitSize=1, ComSignalInitValue=0, ComSignalType=BOOLEAN, ComSystemTemplateSystemSignalRef=DET_IDM_208
            DET_MH_CRC16_205_208_oRDR_DETECTION_205_208_oPCAN_RADAR_af533684_Tx: ComBitPosition=0, ComBitSize=16, ComSignalInitValue=0, ComSignalType=UINT16, ComSystemTemplateSystemSignalRef=DET_MH_CRC16_205_208
            DET_MH_CYCLE_COUNTER_205_208_oRDR_DETECTION_205_208_oPCAN_RADAR_2b2697b3_Tx: ComBitPosition=16, ComBitSize=8, ComSignalInitValue=0, ComSignalType=UINT8, ComSystemTemplateSystemSignalRef=DET_MH_CYCLE_COUNTER_205_208
            DET_MH_SCAN_INDEX_4LSB_205_208_oRDR_DETECTION_205_208_oPCAN_RADAR_e70cb23f_Tx: ComBitPosition=476, ComBitSize=4, ComSignalInitValue=0, ComSignalType=UINT8, ComSystemTemplateSystemSignalRef=DET_MH_SCAN_INDEX_4LSB_205_208
            DET_MTD_205_oRDR_DETECTION_205_208_oPCAN_RADAR_81ad3101_Tx: ComBitPosition=47, ComBitSize=1, ComSignalInitValue=0, ComSignalType=BOOLEAN, ComSystemTemplateSystemSignalRef=DET_MTD_205
            DET_MTD_206_oRDR_DETECTION_205_208_oPCAN_RADAR_e54d4aff_Tx: ComBitPosition=159, ComBitSize=1, ComSignalInitValue=0, ComSignalType=BOOLEAN, ComSystemTemplateSystemSignalRef=DET_MTD_206
            DET_MTD_207_oRDR_DETECTION_205_208_oPCAN_RADAR_703d9e6a_Tx: ComBitPosition=271, ComBitSize=1, ComSignalInitValue=0, ComSignalType=BOOLEAN, ComSystemTemplateSystemSignalRef=DET_MTD_207
            DET_MTD_208_oRDR_DETECTION_205_208_oPCAN_RADAR_5c2d0c2d_Tx: ComBitPosition=383, ComBitSize=1, ComSignalInitValue=0, ComSignalType=BOOLEAN, ComSystemTemplateSystemSignalRef=DET_MTD_208
            DET_PROB_1STAZHYPO_205_oRDR_DETECTION_205_208_oPCAN_RADAR_1219d9cc_Tx: ComBitPosition=103, ComBitSize=1, ComSignalInitValue=0, ComSignalType=BOOLEAN, ComSystemTemplateSystemSignalRef=DET_PROB_1STAZHYPO_205
            DET_PROB_1STAZHYPO_206_oRDR_DETECTION_205_208_oPCAN_RADAR_76f9a232_Tx: ComBitPosition=215, ComBitSize=1, ComSignalInitValue=0, ComSignalType=BOOLEAN, ComSystemTemplateSystemSignalRef=DET_PROB_1STAZHYPO_206
            DET_PROB_1STAZHYPO_207_oRDR_DETECTION_205_208_oPCAN_RADAR_e38976a7_Tx: ComBitPosition=327, ComBitSize=1, ComSignalInitValue=0, ComSignalType=BOOLEAN, ComSystemTemplateSystemSignalRef=DET_PROB_1STAZHYPO_207
            DET_PROB_1STAZHYPO_208_oRDR_DETECTION_205_208_oPCAN_RADAR_cf99e4e0_Tx: ComBitPosition=439, ComBitSize=1, ComSignalInitValue=0, ComSignalType=BOOLEAN, ComSystemTemplateSystemSignalRef=DET_PROB_1STAZHYPO_208
            DET_RANGE_205_oRDR_DETECTION_205_208_oPCAN_RADAR_19b63aba_Tx: ComBitPosition=24, ComBitSize=15, ComSignalInitValue=0, ComSignalType=UINT16, ComSystemTemplateSystemSignalRef=DET_RANGE_205
            DET_RANGE_206_oRDR_DETECTION_205_208_oPCAN_RADAR_7d564144_Tx: ComBitPosition=136, ComBitSize=15, ComSignalInitValue=0, ComSignalType=UINT16, ComSystemTemplateSystemSignalRef=DET_RANGE_206
            DET_RANGE_207_oRDR_DETECTION_205_208_oPCAN_RADAR_e82695d1_Tx: ComBitPosition=248, ComBitSize=15, ComSignalInitValue=0, ComSignalType=UINT16, ComSystemTemplateSystemSignalRef=DET_RANGE_207
            DET_RANGE_208_oRDR_DETECTION_205_208_oPCAN_RADAR_c4360796_Tx: ComBitPosition=360, ComBitSize=15, ComSignalInitValue=0, ComSignalType=UINT16, ComSystemTemplateSystemSignalRef=DET_RANGE_208
            DET_RANGE_ERR_205_oRDR_DETECTION_205_208_oPCAN_RADAR_be5e80d3_Tx: ComBitPosition=40, ComBitSize=7, ComSignalInitValue=0, ComSignalType=UINT8, ComSystemTemplateSystemSignalRef=DET_RANGE_ERR_205
            DET_RANGE_ERR_206_oRDR_DETECTION_205_208_oPCAN_RADAR_dabefb2d_Tx: ComBitPosition=152, ComBitSize=7, ComSignalInitValue=0, ComSignalType=UINT8, ComSystemTemplateSystemSignalRef=DET_RANGE_ERR_206
            DET_RANGE_ERR_207_oRDR_DETECTION_205_208_oPCAN_RADAR_4fce2fb8_Tx: ComBitPosition=264, ComBitSize=7, ComSignalInitValue=0, ComSignalType=UINT8, ComSystemTemplateSystemSignalRef=DET_RANGE_ERR_207
            DET_RANGE_ERR_208_oRDR_DETECTION_205_208_oPCAN_RADAR_63debdff_Tx: ComBitPosition=376, ComBitSize=7, ComSignalInitValue=0, ComSignalType=UINT8, ComSystemTemplateSystemSignalRef=DET_RANGE_ERR_208
            DET_RANGE_VELOCITY_205_oRDR_DETECTION_205_208_oPCAN_RADAR_6c10f89f_Tx: ComBitPosition=48, ComBitSize=15, ComSignalInitValue=16384, ComSignalType=UINT16, ComSystemTemplateSystemSignalRef=DET_RANGE_VELOCITY_205
            DET_RANGE_VELOCITY_206_oRDR_DETECTION_205_208_oPCAN_RADAR_08f08361_Tx: ComBitPosition=160, ComBitSize=15, ComSignalInitValue=16384, ComSignalType=UINT16, ComSystemTemplateSystemSignalRef=DET_RANGE_VELOCITY_206
            DET_RANGE_VELOCITY_207_oRDR_DETECTION_205_208_oPCAN_RADAR_9d8057f4_Tx: ComBitPosition=272, ComBitSize=15, ComSignalInitValue=16384, ComSignalType=UINT16, ComSystemTemplateSystemSignalRef=DET_RANGE_VELOCITY_207
            DET_RANGE_VELOCITY_208_oRDR_DETECTION_205_208_oPCAN_RADAR_b190c5b3_Tx: ComBitPosition=384, ComBitSize=15, ComSignalInitValue=16384, ComSignalType=UINT16, ComSystemTemplateSystemSignalRef=DET_RANGE_VELOCITY_208
            DET_RANGE_VELOCITY_ERR_205_oRDR_DETECTION_205_208_oPCAN_RADAR_63ab032d_Tx: ComBitPosition=64, ComBitSize=8, ComSignalInitValue=0, ComSignalType=UINT8, ComSystemTemplateSystemSignalRef=DET_RANGE_VELOCITY_ERR_205
            DET_RANGE_VELOCITY_ERR_206_oRDR_DETECTION_205_208_oPCAN_RADAR_074b78d3_Tx: ComBitPosition=176, ComBitSize=8, ComSignalInitValue=0, ComSignalType=UINT8, ComSystemTemplateSystemSignalRef=DET_RANGE_VELOCITY_ERR_206
            DET_RANGE_VELOCITY_ERR_207_oRDR_DETECTION_205_208_oPCAN_RADAR_923bac46_Tx: ComBitPosition=288, ComBitSize=8, ComSignalInitValue=0, ComSignalType=UINT8, ComSystemTemplateSystemSignalRef=DET_RANGE_VELOCITY_ERR_207
            DET_RANGE_VELOCITY_ERR_208_oRDR_DETECTION_205_208_oPCAN_RADAR_be2b3e01_Tx: ComBitPosition=400, ComBitSize=8, ComSignalInitValue=0, ComSignalType=UINT8, ComSystemTemplateSystemSignalRef=DET_RANGE_VELOCITY_ERR_208
            DET_RCS_205_oRDR_DETECTION_205_208_oPCAN_RADAR_eb90cfc5_Tx: ComBitPosition=128, ComBitSize=8, ComSignalInitValue=128, ComSignalType=UINT8, ComSystemTemplateSystemSignalRef=DET_RCS_205
            DET_RCS_206_oRDR_DETECTION_205_208_oPCAN_RADAR_8f70b43b_Tx: ComBitPosition=240, ComBitSize=8, ComSignalInitValue=128, ComSignalType=UINT8, ComSystemTemplateSystemSignalRef=DET_RCS_206
            DET_RCS_207_oRDR_DETECTION_205_208_oPCAN_RADAR_1a0060ae_Tx: ComBitPosition=352, ComBitSize=8, ComSignalInitValue=128, ComSignalType=UINT8, ComSystemTemplateSystemSignalRef=DET_RCS_207
            DET_RCS_208_oRDR_DETECTION_205_208_oPCAN_RADAR_3610f2e9_Tx: ComBitPosition=464, ComBitSize=8, ComSignalInitValue=128, ComSignalType=UINT8, ComSystemTemplateSystemSignalRef=DET_RCS_208
            DET_SNR_205_oRDR_DETECTION_205_208_oPCAN_RADAR_363e9bc7_Tx: ComBitPosition=120, ComBitSize=8, ComSignalInitValue=0, ComSignalType=UINT8, ComSystemTemplateSystemSignalRef=DET_SNR_205
            DET_SNR_206_oRDR_DETECTION_205_208_oPCAN_RADAR_52dee039_Tx: ComBitPosition=232, ComBitSize=8, ComSignalInitValue=0, ComSignalType=UINT8, ComSystemTemplateSystemSignalRef=DET_SNR_206
            DET_SNR_207_oRDR_DETECTION_205_208_oPCAN_RADAR_c7ae34ac_Tx: ComBitPosition=344, ComBitSize=8, ComSignalInitValue=0, ComSignalType=UINT8, ComSystemTemplateSystemSignalRef=DET_SNR_207
            DET_SNR_208_oRDR_DETECTION_205_208_oPCAN_RADAR_ebbea6eb_Tx: ComBitPosition=456, ComBitSize=8, ComSignalInitValue=0, ComSignalType=UINT8, ComSystemTemplateSystemSignalRef=DET_SNR_208
            DET_SUPER_RES_TARGET_205_oRDR_DETECTION_205_208_oPCAN_RADAR_07a7b3a2_Tx: ComBitPosition=87, ComBitSize=1, ComSignalInitValue=0, ComSignalType=BOOLEAN, ComSystemTemplateSystemSignalRef=DET_SUPER_RES_TARGET_205
            DET_SUPER_RES_TARGET_206_oRDR_DETECTION_205_208_oPCAN_RADAR_6347c85c_Tx: ComBitPosition=199, ComBitSize=1, ComSignalInitValue=0, ComSignalType=BOOLEAN, ComSystemTemplateSystemSignalRef=DET_SUPER_RES_TARGET_206
            DET_SUPER_RES_TARGET_207_oRDR_DETECTION_205_208_oPCAN_RADAR_f6371cc9_Tx: ComBitPosition=311, ComBitSize=1, ComSignalInitValue=0, ComSignalType=BOOLEAN, ComSystemTemplateSystemSignalRef=DET_SUPER_RES_TARGET_207
            DET_SUPER_RES_TARGET_208_oRDR_DETECTION_205_208_oPCAN_RADAR_da278e8e_Tx: ComBitPosition=423, ComBitSize=1, ComSignalInitValue=0, ComSignalType=BOOLEAN, ComSystemTemplateSystemSignalRef=DET_SUPER_RES_TARGET_208
        SG_Detections_209_212_oRDR_DETECTION_209_212_oPCAN_RADAR_b2a1c0f4_Tx: ComSystemTemplateSignalGroupRef=SG_Detections_209_212
          83 x ComGroupSignal, all with ComSignalEndianness=LITTLE_ENDIAN, ComTransferProperty=PENDING:
            DET_AZIMUTH_209_oRDR_DETECTION_209_212_oPCAN_RADAR_73954fb9_Tx: ComBitPosition=88, ComBitSize=13, ComSignalInitValue=0, ComSignalType=UINT16, ComSystemTemplateSystemSignalRef=DET_AZIMUTH_209
            DET_AZIMUTH_210_oRDR_DETECTION_209_212_oPCAN_RADAR_16b53d1d_Tx: ComBitPosition=200, ComBitSize=13, ComSignalInitValue=0, ComSignalType=UINT16, ComSystemTemplateSystemSignalRef=DET_AZIMUTH_210
            DET_AZIMUTH_211_oRDR_DETECTION_209_212_oPCAN_RADAR_83c5e988_Tx: ComBitPosition=312, ComBitSize=13, ComSignalInitValue=0, ComSignalType=UINT16, ComSystemTemplateSystemSignalRef=DET_AZIMUTH_211
            DET_AZIMUTH_212_oRDR_DETECTION_209_212_oPCAN_RADAR_e7259276_Tx: ComBitPosition=424, ComBitSize=13, ComSignalInitValue=0, ComSignalType=UINT16, ComSystemTemplateSystemSignalRef=DET_AZIMUTH_212
            DET_AZIMUTH_ERR_209_oRDR_DETECTION_209_212_oPCAN_RADAR_d720da4c_Tx: ComBitPosition=105, ComBitSize=7, ComSignalInitValue=0, ComSignalType=UINT8, ComSystemTemplateSystemSignalRef=DET_AZIMUTH_ERR_209
            DET_AZIMUTH_ERR_210_oRDR_DETECTION_209_212_oPCAN_RADAR_b200a8e8_Tx: ComBitPosition=217, ComBitSize=7, ComSignalInitValue=0, ComSignalType=UINT8, ComSystemTemplateSystemSignalRef=DET_AZIMUTH_ERR_210
            DET_AZIMUTH_ERR_211_oRDR_DETECTION_209_212_oPCAN_RADAR_27707c7d_Tx: ComBitPosition=329, ComBitSize=7, ComSignalInitValue=0, ComSignalType=UINT8, ComSystemTemplateSystemSignalRef=DET_AZIMUTH_ERR_211
            DET_AZIMUTH_ERR_212_oRDR_DETECTION_209_212_oPCAN_RADAR_43900783_Tx: ComBitPosition=441, ComBitSize=7, ComSignalInitValue=0, ComSignalType=UINT8, ComSystemTemplateSystemSignalRef=DET_AZIMUTH_ERR_212
            DET_BELOW_RAIN_THOLD_209_oRDR_DETECTION_209_212_oPCAN_RADAR_a694dc79_Tx: ComBitPosition=39, ComBitSize=1, ComSignalInitValue=0, ComSignalType=BOOLEAN, ComSystemTemplateSystemSignalRef=DET_BELOW_RAIN_THOLD_209
            DET_BELOW_RAIN_THOLD_210_oRDR_DETECTION_209_212_oPCAN_RADAR_c3b4aedd_Tx: ComBitPosition=151, ComBitSize=1, ComSignalInitValue=0, ComSignalType=BOOLEAN, ComSystemTemplateSystemSignalRef=DET_BELOW_RAIN_THOLD_210
            DET_BELOW_RAIN_THOLD_211_oRDR_DETECTION_209_212_oPCAN_RADAR_56c47a48_Tx: ComBitPosition=263, ComBitSize=1, ComSignalInitValue=0, ComSignalType=BOOLEAN, ComSystemTemplateSystemSignalRef=DET_BELOW_RAIN_THOLD_211
            DET_BELOW_RAIN_THOLD_212_oRDR_DETECTION_209_212_oPCAN_RADAR_322401b6_Tx: ComBitPosition=375, ComBitSize=1, ComSignalInitValue=0, ComSignalType=BOOLEAN, ComSystemTemplateSystemSignalRef=DET_BELOW_RAIN_THOLD_212
            DET_BI_STATIC_FLAG_209_oRDR_DETECTION_209_212_oPCAN_RADAR_25b90f3c_Tx: ComBitPosition=104, ComBitSize=1, ComSignalInitValue=0, ComSignalType=BOOLEAN, ComSystemTemplateSystemSignalRef=DET_BI_STATIC_FLAG_209
            DET_BI_STATIC_FLAG_210_oRDR_DETECTION_209_212_oPCAN_RADAR_40997d98_Tx: ComBitPosition=216, ComBitSize=1, ComSignalInitValue=0, ComSignalType=BOOLEAN, ComSystemTemplateSystemSignalRef=DET_BI_STATIC_FLAG_210
            DET_BI_STATIC_FLAG_211_oRDR_DETECTION_209_212_oPCAN_RADAR_d5e9a90d_Tx: ComBitPosition=328, ComBitSize=1, ComSignalInitValue=0, ComSignalType=BOOLEAN, ComSystemTemplateSystemSignalRef=DET_BI_STATIC_FLAG_211
            DET_BI_STATIC_FLAG_212_oRDR_DETECTION_209_212_oPCAN_RADAR_b109d2f3_Tx: ComBitPosition=440, ComBitSize=1, ComSignalInitValue=0, ComSignalType=BOOLEAN, ComSystemTemplateSystemSignalRef=DET_BI_STATIC_FLAG_212
            DET_CONFD_AZIMUTH_209_oRDR_DETECTION_209_212_oPCAN_RADAR_71734573_Tx: ComBitPosition=118, ComBitSize=2, ComSignalInitValue=0, ComSignalType=UINT8, ComSystemTemplateSystemSignalRef=DET_CONFD_AZIMUTH_209
            DET_CONFD_AZIMUTH_210_oRDR_DETECTION_209_212_oPCAN_RADAR_145337d7_Tx: ComBitPosition=230, ComBitSize=2, ComSignalInitValue=0, ComSignalType=UINT8, ComSystemTemplateSystemSignalRef=DET_CONFD_AZIMUTH_210
            DET_CONFD_AZIMUTH_211_oRDR_DETECTION_209_212_oPCAN_RADAR_8123e342_Tx: ComBitPosition=342, ComBitSize=2, ComSignalInitValue=0, ComSignalType=UINT8, ComSystemTemplateSystemSignalRef=DET_CONFD_AZIMUTH_211
            DET_CONFD_AZIMUTH_212_oRDR_DETECTION_209_212_oPCAN_RADAR_e5c398bc_Tx: ComBitPosition=454, ComBitSize=2, ComSignalInitValue=0, ComSignalType=UINT8, ComSystemTemplateSystemSignalRef=DET_CONFD_AZIMUTH_212
            DET_CONFD_ELEVATION_209_oRDR_DETECTION_209_212_oPCAN_RADAR_73e64489_Tx: ComBitPosition=101, ComBitSize=2, ComSignalInitValue=0, ComSignalType=UINT8, ComSystemTemplateSystemSignalRef=DET_CONFD_ELEVATION_209
            DET_CONFD_ELEVATION_210_oRDR_DETECTION_209_212_oPCAN_RADAR_16c6362d_Tx: ComBitPosition=213, ComBitSize=2, ComSignalInitValue=0, ComSignalType=UINT8, ComSystemTemplateSystemSignalRef=DET_CONFD_ELEVATION_210
            DET_CONFD_ELEVATION_211_oRDR_DETECTION_209_212_oPCAN_RADAR_83b6e2b8_Tx: ComBitPosition=325, ComBitSize=2, ComSignalInitValue=0, ComSignalType=UINT8, ComSystemTemplateSystemSignalRef=DET_CONFD_ELEVATION_211
            DET_CONFD_ELEVATION_212_oRDR_DETECTION_209_212_oPCAN_RADAR_e7569946_Tx: ComBitPosition=437, ComBitSize=2, ComSignalInitValue=0, ComSignalType=UINT8, ComSystemTemplateSystemSignalRef=DET_CONFD_ELEVATION_212
            DET_ELEVATION_209_oRDR_DETECTION_209_212_oPCAN_RADAR_a22690b5_Tx: ComBitPosition=72, ComBitSize=8, ComSignalInitValue=0, ComSignalType=UINT8, ComSystemTemplateSystemSignalRef=DET_ELEVATION_209
            DET_ELEVATION_210_oRDR_DETECTION_209_212_oPCAN_RADAR_c706e211_Tx: ComBitPosition=184, ComBitSize=8, ComSignalInitValue=0, ComSignalType=UINT8, ComSystemTemplateSystemSignalRef=DET_ELEVATION_210
            DET_ELEVATION_211_oRDR_DETECTION_209_212_oPCAN_RADAR_52763684_Tx: ComBitPosition=296, ComBitSize=8, ComSignalInitValue=0, ComSignalType=UINT8, ComSystemTemplateSystemSignalRef=DET_ELEVATION_211
            DET_ELEVATION_212_oRDR_DETECTION_209_212_oPCAN_RADAR_36964d7a_Tx: ComBitPosition=408, ComBitSize=8, ComSignalInitValue=0, ComSignalType=UINT8, ComSystemTemplateSystemSignalRef=DET_ELEVATION_212
            DET_ELEVATION_ERR_209_oRDR_DETECTION_209_212_oPCAN_RADAR_251f08c0_Tx: ComBitPosition=80, ComBitSize=6, ComSignalInitValue=0, ComSignalType=UINT8, ComSystemTemplateSystemSignalRef=DET_ELEVATION_ERR_209
            DET_ELEVATION_ERR_210_oRDR_DETECTION_209_212_oPCAN_RADAR_403f7a64_Tx: ComBitPosition=192, ComBitSize=6, ComSignalInitValue=0, ComSignalType=UINT8, ComSystemTemplateSystemSignalRef=DET_ELEVATION_ERR_210
            DET_ELEVATION_ERR_211_oRDR_DETECTION_209_212_oPCAN_RADAR_d54faef1_Tx: ComBitPosition=304, ComBitSize=6, ComSignalInitValue=0, ComSignalType=UINT8, ComSystemTemplateSystemSignalRef=DET_ELEVATION_ERR_211
            DET_ELEVATION_ERR_212_oRDR_DETECTION_209_212_oPCAN_RADAR_b1afd50f_Tx: ComBitPosition=416, ComBitSize=6, ComSignalInitValue=0, ComSignalType=UINT8, ComSystemTemplateSystemSignalRef=DET_ELEVATION_ERR_212
            DET_EXISTENCE_PROB_209_oRDR_DETECTION_209_212_oPCAN_RADAR_f7807da0_Tx: ComBitPosition=112, ComBitSize=6, ComSignalInitValue=0, ComSignalType=UINT8, ComSystemTemplateSystemSignalRef=DET_EXISTENCE_PROB_209
            DET_EXISTENCE_PROB_210_oRDR_DETECTION_209_212_oPCAN_RADAR_92a00f04_Tx: ComBitPosition=224, ComBitSize=6, ComSignalInitValue=0, ComSignalType=UINT8, ComSystemTemplateSystemSignalRef=DET_EXISTENCE_PROB_210
            DET_EXISTENCE_PROB_211_oRDR_DETECTION_209_212_oPCAN_RADAR_07d0db91_Tx: ComBitPosition=336, ComBitSize=6, ComSignalInitValue=0, ComSignalType=UINT8, ComSystemTemplateSystemSignalRef=DET_EXISTENCE_PROB_211
            DET_EXISTENCE_PROB_212_oRDR_DETECTION_209_212_oPCAN_RADAR_6330a06f_Tx: ComBitPosition=448, ComBitSize=6, ComSignalInitValue=0, ComSignalType=UINT8, ComSystemTemplateSystemSignalRef=DET_EXISTENCE_PROB_212
            DET_HVC_FLAG_209_oRDR_DETECTION_209_212_oPCAN_RADAR_16f43edf_Tx: ComBitPosition=86, ComBitSize=1, ComSignalInitValue=0, ComSignalType=BOOLEAN, ComSystemTemplateSystemSignalRef=DET_HVC_FLAG_209
            DET_HVC_FLAG_210_oRDR_DETECTION_209_212_oPCAN_RADAR_73d44c7b_Tx: ComBitPosition=198, ComBitSize=1, ComSignalInitValue=0, ComSignalType=BOOLEAN, ComSystemTemplateSystemSignalRef=DET_HVC_FLAG_210
            DET_HVC_FLAG_211_oRDR_DETECTION_209_212_oPCAN_RADAR_e6a498ee_Tx: ComBitPosition=310, ComBitSize=1, ComSignalInitValue=0, ComSignalType=BOOLEAN, ComSystemTemplateSystemSignalRef=DET_HVC_FLAG_211
            DET_HVC_FLAG_212_oRDR_DETECTION_209_212_oPCAN_RADAR_8244e310_Tx: ComBitPosition=422, ComBitSize=1, ComSignalInitValue=0, ComSignalType=BOOLEAN, ComSystemTemplateSystemSignalRef=DET_HVC_FLAG_212
            DET_IDM_209_oRDR_DETECTION_209_212_oPCAN_RADAR_9da60562_Tx: ComBitPosition=63, ComBitSize=1, ComSignalInitValue=0, ComSignalType=BOOLEAN, ComSystemTemplateSystemSignalRef=DET_IDM_209
            DET_IDM_210_oRDR_DETECTION_209_212_oPCAN_RADAR_f88677c6_Tx: ComBitPosition=175, ComBitSize=1, ComSignalInitValue=0, ComSignalType=BOOLEAN, ComSystemTemplateSystemSignalRef=DET_IDM_210
            DET_IDM_211_oRDR_DETECTION_209_212_oPCAN_RADAR_6df6a353_Tx: ComBitPosition=287, ComBitSize=1, ComSignalInitValue=0, ComSignalType=BOOLEAN, ComSystemTemplateSystemSignalRef=DET_IDM_211
            DET_IDM_212_oRDR_DETECTION_209_212_oPCAN_RADAR_0916d8ad_Tx: ComBitPosition=399, ComBitSize=1, ComSignalInitValue=0, ComSignalType=BOOLEAN, ComSystemTemplateSystemSignalRef=DET_IDM_212
            DET_MH_CRC16_209_212_oRDR_DETECTION_209_212_oPCAN_RADAR_362912ff_Tx: ComBitPosition=0, ComBitSize=16, ComSignalInitValue=0, ComSignalType=UINT16, ComSystemTemplateSystemSignalRef=DET_MH_CRC16_209_212
            DET_MH_CYCLE_COUNTER_209_212_oRDR_DETECTION_209_212_oPCAN_RADAR_b25cb3c8_Tx: ComBitPosition=16, ComBitSize=8, ComSignalInitValue=0, ComSignalType=UINT8, ComSystemTemplateSystemSignalRef=DET_MH_CYCLE_COUNTER_209_212
            DET_MH_SCAN_INDEX_4LSB_209_212_oRDR_DETECTION_209_212_oPCAN_RADAR_7e769644_Tx: ComBitPosition=476, ComBitSize=4, ComSignalInitValue=0, ComSignalType=UINT8, ComSystemTemplateSystemSignalRef=DET_MH_SCAN_INDEX_4LSB_209_212
            DET_MTD_209_oRDR_DETECTION_209_212_oPCAN_RADAR_fb1537b9_Tx: ComBitPosition=47, ComBitSize=1, ComSignalInitValue=0, ComSignalType=BOOLEAN, ComSystemTemplateSystemSignalRef=DET_MTD_209
            DET_MTD_210_oRDR_DETECTION_209_212_oPCAN_RADAR_9e35451d_Tx: ComBitPosition=159, ComBitSize=1, ComSignalInitValue=0, ComSignalType=BOOLEAN, ComSystemTemplateSystemSignalRef=DET_MTD_210
            DET_MTD_211_oRDR_DETECTION_209_212_oPCAN_RADAR_0b459188_Tx: ComBitPosition=271, ComBitSize=1, ComSignalInitValue=0, ComSignalType=BOOLEAN, ComSystemTemplateSystemSignalRef=DET_MTD_211
            DET_MTD_212_oRDR_DETECTION_209_212_oPCAN_RADAR_6fa5ea76_Tx: ComBitPosition=383, ComBitSize=1, ComSignalInitValue=0, ComSignalType=BOOLEAN, ComSystemTemplateSystemSignalRef=DET_MTD_212
            DET_PROB_1STAZHYPO_209_oRDR_DETECTION_209_212_oPCAN_RADAR_68a1df74_Tx: ComBitPosition=103, ComBitSize=1, ComSignalInitValue=0, ComSignalType=BOOLEAN, ComSystemTemplateSystemSignalRef=DET_PROB_1STAZHYPO_209
            DET_PROB_1STAZHYPO_210_oRDR_DETECTION_209_212_oPCAN_RADAR_0d81add0_Tx: ComBitPosition=215, ComBitSize=1, ComSignalInitValue=0, ComSignalType=BOOLEAN, ComSystemTemplateSystemSignalRef=DET_PROB_1STAZHYPO_210
            DET_PROB_1STAZHYPO_211_oRDR_DETECTION_209_212_oPCAN_RADAR_98f17945_Tx: ComBitPosition=327, ComBitSize=1, ComSignalInitValue=0, ComSignalType=BOOLEAN, ComSystemTemplateSystemSignalRef=DET_PROB_1STAZHYPO_211
            DET_PROB_1STAZHYPO_212_oRDR_DETECTION_209_212_oPCAN_RADAR_fc1102bb_Tx: ComBitPosition=439, ComBitSize=1, ComSignalInitValue=0, ComSignalType=BOOLEAN, ComSystemTemplateSystemSignalRef=DET_PROB_1STAZHYPO_212
            DET_RANGE_209_oRDR_DETECTION_209_212_oPCAN_RADAR_630e3c02_Tx: ComBitPosition=24, ComBitSize=15, ComSignalInitValue=0, ComSignalType=UINT16, ComSystemTemplateSystemSignalRef=DET_RANGE_209
            DET_RANGE_210_oRDR_DETECTION_209_212_oPCAN_RADAR_062e4ea6_Tx: ComBitPosition=136, ComBitSize=15, ComSignalInitValue=0, ComSignalType=UINT16, ComSystemTemplateSystemSignalRef=DET_RANGE_210
            DET_RANGE_211_oRDR_DETECTION_209_212_oPCAN_RADAR_935e9a33_Tx: ComBitPosition=248, ComBitSize=15, ComSignalInitValue=0, ComSignalType=UINT16, ComSystemTemplateSystemSignalRef=DET_RANGE_211
            DET_RANGE_212_oRDR_DETECTION_209_212_oPCAN_RADAR_f7bee1cd_Tx: ComBitPosition=360, ComBitSize=15, ComSignalInitValue=0, ComSignalType=UINT16, ComSystemTemplateSystemSignalRef=DET_RANGE_212
            DET_RANGE_ERR_209_oRDR_DETECTION_209_212_oPCAN_RADAR_c4e6866b_Tx: ComBitPosition=40, ComBitSize=7, ComSignalInitValue=0, ComSignalType=UINT8, ComSystemTemplateSystemSignalRef=DET_RANGE_ERR_209
            DET_RANGE_ERR_210_oRDR_DETECTION_209_212_oPCAN_RADAR_a1c6f4cf_Tx: ComBitPosition=152, ComBitSize=7, ComSignalInitValue=0, ComSignalType=UINT8, ComSystemTemplateSystemSignalRef=DET_RANGE_ERR_210
            DET_RANGE_ERR_211_oRDR_DETECTION_209_212_oPCAN_RADAR_34b6205a_Tx: ComBitPosition=264, ComBitSize=7, ComSignalInitValue=0, ComSignalType=UINT8, ComSystemTemplateSystemSignalRef=DET_RANGE_ERR_211
            DET_RANGE_ERR_212_oRDR_DETECTION_209_212_oPCAN_RADAR_50565ba4_Tx: ComBitPosition=376, ComBitSize=7, ComSignalInitValue=0, ComSignalType=UINT8, ComSystemTemplateSystemSignalRef=DET_RANGE_ERR_212
            DET_RANGE_VELOCITY_209_oRDR_DETECTION_209_212_oPCAN_RADAR_16a8fe27_Tx: ComBitPosition=48, ComBitSize=15, ComSignalInitValue=16384, ComSignalType=UINT16, ComSystemTemplateSystemSignalRef=DET_RANGE_VELOCITY_209
            DET_RANGE_VELOCITY_210_oRDR_DETECTION_209_212_oPCAN_RADAR_73888c83_Tx: ComBitPosition=160, ComBitSize=15, ComSignalInitValue=16384, ComSignalType=UINT16, ComSystemTemplateSystemSignalRef=DET_RANGE_VELOCITY_210
            DET_RANGE_VELOCITY_211_oRDR_DETECTION_209_212_oPCAN_RADAR_e6f85816_Tx: ComBitPosition=272, ComBitSize=15, ComSignalInitValue=16384, ComSignalType=UINT16, ComSystemTemplateSystemSignalRef=DET_RANGE_VELOCITY_211
            DET_RANGE_VELOCITY_212_oRDR_DETECTION_209_212_oPCAN_RADAR_821823e8_Tx: ComBitPosition=384, ComBitSize=15, ComSignalInitValue=16384, ComSignalType=UINT16, ComSystemTemplateSystemSignalRef=DET_RANGE_VELOCITY_212
            DET_RANGE_VELOCITY_ERR_209_oRDR_DETECTION_209_212_oPCAN_RADAR_19130595_Tx: ComBitPosition=64, ComBitSize=8, ComSignalInitValue=0, ComSignalType=UINT8, ComSystemTemplateSystemSignalRef=DET_RANGE_VELOCITY_ERR_209
            DET_RANGE_VELOCITY_ERR_210_oRDR_DETECTION_209_212_oPCAN_RADAR_7c337731_Tx: ComBitPosition=176, ComBitSize=8, ComSignalInitValue=0, ComSignalType=UINT8, ComSystemTemplateSystemSignalRef=DET_RANGE_VELOCITY_ERR_210
            DET_RANGE_VELOCITY_ERR_211_oRDR_DETECTION_209_212_oPCAN_RADAR_e943a3a4_Tx: ComBitPosition=288, ComBitSize=8, ComSignalInitValue=0, ComSignalType=UINT8, ComSystemTemplateSystemSignalRef=DET_RANGE_VELOCITY_ERR_211
            DET_RANGE_VELOCITY_ERR_212_oRDR_DETECTION_209_212_oPCAN_RADAR_8da3d85a_Tx: ComBitPosition=400, ComBitSize=8, ComSignalInitValue=0, ComSignalType=UINT8, ComSystemTemplateSystemSignalRef=DET_RANGE_VELOCITY_ERR_212
            DET_RCS_209_oRDR_DETECTION_209_212_oPCAN_RADAR_9128c97d_Tx: ComBitPosition=128, ComBitSize=8, ComSignalInitValue=128, ComSignalType=UINT8, ComSystemTemplateSystemSignalRef=DET_RCS_209
            DET_RCS_210_oRDR_DETECTION_209_212_oPCAN_RADAR_f408bbd9_Tx: ComBitPosition=240, ComBitSize=8, ComSignalInitValue=128, ComSignalType=UINT8, ComSystemTemplateSystemSignalRef=DET_RCS_210
            DET_RCS_211_oRDR_DETECTION_209_212_oPCAN_RADAR_61786f4c_Tx: ComBitPosition=352, ComBitSize=8, ComSignalInitValue=128, ComSignalType=UINT8, ComSystemTemplateSystemSignalRef=DET_RCS_211
            DET_RCS_212_oRDR_DETECTION_209_212_oPCAN_RADAR_059814b2_Tx: ComBitPosition=464, ComBitSize=8, ComSignalInitValue=128, ComSignalType=UINT8, ComSystemTemplateSystemSignalRef=DET_RCS_212
            DET_SNR_209_oRDR_DETECTION_209_212_oPCAN_RADAR_4c869d7f_Tx: ComBitPosition=120, ComBitSize=8, ComSignalInitValue=0, ComSignalType=UINT8, ComSystemTemplateSystemSignalRef=DET_SNR_209
            DET_SNR_210_oRDR_DETECTION_209_212_oPCAN_RADAR_29a6efdb_Tx: ComBitPosition=232, ComBitSize=8, ComSignalInitValue=0, ComSignalType=UINT8, ComSystemTemplateSystemSignalRef=DET_SNR_210
            DET_SNR_211_oRDR_DETECTION_209_212_oPCAN_RADAR_bcd63b4e_Tx: ComBitPosition=344, ComBitSize=8, ComSignalInitValue=0, ComSignalType=UINT8, ComSystemTemplateSystemSignalRef=DET_SNR_211
            DET_SNR_212_oRDR_DETECTION_209_212_oPCAN_RADAR_d83640b0_Tx: ComBitPosition=456, ComBitSize=8, ComSignalInitValue=0, ComSignalType=UINT8, ComSystemTemplateSystemSignalRef=DET_SNR_212
            DET_SUPER_RES_TARGET_209_oRDR_DETECTION_209_212_oPCAN_RADAR_7d1fb51a_Tx: ComBitPosition=87, ComBitSize=1, ComSignalInitValue=0, ComSignalType=BOOLEAN, ComSystemTemplateSystemSignalRef=DET_SUPER_RES_TARGET_209
            DET_SUPER_RES_TARGET_210_oRDR_DETECTION_209_212_oPCAN_RADAR_183fc7be_Tx: ComBitPosition=199, ComBitSize=1, ComSignalInitValue=0, ComSignalType=BOOLEAN, ComSystemTemplateSystemSignalRef=DET_SUPER_RES_TARGET_210
            DET_SUPER_RES_TARGET_211_oRDR_DETECTION_209_212_oPCAN_RADAR_8d4f132b_Tx: ComBitPosition=311, ComBitSize=1, ComSignalInitValue=0, ComSignalType=BOOLEAN, ComSystemTemplateSystemSignalRef=DET_SUPER_RES_TARGET_211
            DET_SUPER_RES_TARGET_212_oRDR_DETECTION_209_212_oPCAN_RADAR_e9af68d5_Tx: ComBitPosition=423, ComBitSize=1, ComSignalInitValue=0, ComSignalType=BOOLEAN, ComSystemTemplateSystemSignalRef=DET_SUPER_RES_TARGET_212
        SG_Detections_213_216_oRDR_DETECTION_213_216_oPCAN_RADAR_80aaa8dc_Tx: ComSystemTemplateSignalGroupRef=SG_Detections_213_216
          83 x ComGroupSignal, all with ComSignalEndianness=LITTLE_ENDIAN, ComTransferProperty=PENDING:
            DET_AZIMUTH_213_oRDR_DETECTION_213_216_oPCAN_RADAR_6f9245cd_Tx: ComBitPosition=88, ComBitSize=13, ComSignalInitValue=0, ComSignalType=UINT16, ComSystemTemplateSystemSignalRef=DET_AZIMUTH_213
            DET_AZIMUTH_214_oRDR_DETECTION_213_216_oPCAN_RADAR_332266a4_Tx: ComBitPosition=200, ComBitSize=13, ComSignalInitValue=0, ComSignalType=UINT16, ComSystemTemplateSystemSignalRef=DET_AZIMUTH_214
            DET_AZIMUTH_215_oRDR_DETECTION_213_216_oPCAN_RADAR_a652b231_Tx: ComBitPosition=312, ComBitSize=13, ComSignalInitValue=0, ComSignalType=UINT16, ComSystemTemplateSystemSignalRef=DET_AZIMUTH_215
            DET_AZIMUTH_216_oRDR_DETECTION_213_216_oPCAN_RADAR_c2b2c9cf_Tx: ComBitPosition=424, ComBitSize=13, ComSignalInitValue=0, ComSignalType=UINT16, ComSystemTemplateSystemSignalRef=DET_AZIMUTH_216
            DET_AZIMUTH_ERR_213_oRDR_DETECTION_213_216_oPCAN_RADAR_cb27d038_Tx: ComBitPosition=105, ComBitSize=7, ComSignalInitValue=0, ComSignalType=UINT8, ComSystemTemplateSystemSignalRef=DET_AZIMUTH_ERR_213
            DET_AZIMUTH_ERR_214_oRDR_DETECTION_213_216_oPCAN_RADAR_9797f351_Tx: ComBitPosition=217, ComBitSize=7, ComSignalInitValue=0, ComSignalType=UINT8, ComSystemTemplateSystemSignalRef=DET_AZIMUTH_ERR_214
            DET_AZIMUTH_ERR_215_oRDR_DETECTION_213_216_oPCAN_RADAR_02e727c4_Tx: ComBitPosition=329, ComBitSize=7, ComSignalInitValue=0, ComSignalType=UINT8, ComSystemTemplateSystemSignalRef=DET_AZIMUTH_ERR_215
            DET_AZIMUTH_ERR_216_oRDR_DETECTION_213_216_oPCAN_RADAR_66075c3a_Tx: ComBitPosition=441, ComBitSize=7, ComSignalInitValue=0, ComSignalType=UINT8, ComSystemTemplateSystemSignalRef=DET_AZIMUTH_ERR_216
            DET_BELOW_RAIN_THOLD_213_oRDR_DETECTION_213_216_oPCAN_RADAR_ba93d60d_Tx: ComBitPosition=39, ComBitSize=1, ComSignalInitValue=0, ComSignalType=BOOLEAN, ComSystemTemplateSystemSignalRef=DET_BELOW_RAIN_THOLD_213
            DET_BELOW_RAIN_THOLD_214_oRDR_DETECTION_213_216_oPCAN_RADAR_e623f564_Tx: ComBitPosition=151, ComBitSize=1, ComSignalInitValue=0, ComSignalType=BOOLEAN, ComSystemTemplateSystemSignalRef=DET_BELOW_RAIN_THOLD_214
            DET_BELOW_RAIN_THOLD_215_oRDR_DETECTION_213_216_oPCAN_RADAR_735321f1_Tx: ComBitPosition=263, ComBitSize=1, ComSignalInitValue=0, ComSignalType=BOOLEAN, ComSystemTemplateSystemSignalRef=DET_BELOW_RAIN_THOLD_215
            DET_BELOW_RAIN_THOLD_216_oRDR_DETECTION_213_216_oPCAN_RADAR_17b35a0f_Tx: ComBitPosition=375, ComBitSize=1, ComSignalInitValue=0, ComSignalType=BOOLEAN, ComSystemTemplateSystemSignalRef=DET_BELOW_RAIN_THOLD_216
            DET_BI_STATIC_FLAG_213_oRDR_DETECTION_213_216_oPCAN_RADAR_39be0548_Tx: ComBitPosition=104, ComBitSize=1, ComSignalInitValue=0, ComSignalType=BOOLEAN, ComSystemTemplateSystemSignalRef=DET_BI_STATIC_FLAG_213
            DET_BI_STATIC_FLAG_214_oRDR_DETECTION_213_216_oPCAN_RADAR_650e2621_Tx: ComBitPosition=216, ComBitSize=1, ComSignalInitValue=0, ComSignalType=BOOLEAN, ComSystemTemplateSystemSignalRef=DET_BI_STATIC_FLAG_214
            DET_BI_STATIC_FLAG_215_oRDR_DETECTION_213_216_oPCAN_RADAR_f07ef2b4_Tx: ComBitPosition=328, ComBitSize=1, ComSignalInitValue=0, ComSignalType=BOOLEAN, ComSystemTemplateSystemSignalRef=DET_BI_STATIC_FLAG_215
            DET_BI_STATIC_FLAG_216_oRDR_DETECTION_213_216_oPCAN_RADAR_949e894a_Tx: ComBitPosition=440, ComBitSize=1, ComSignalInitValue=0, ComSignalType=BOOLEAN, ComSystemTemplateSystemSignalRef=DET_BI_STATIC_FLAG_216
            DET_CONFD_AZIMUTH_213_oRDR_DETECTION_213_216_oPCAN_RADAR_6d744f07_Tx: ComBitPosition=118, ComBitSize=2, ComSignalInitValue=0, ComSignalType=UINT8, ComSystemTemplateSystemSignalRef=DET_CONFD_AZIMUTH_213
            DET_CONFD_AZIMUTH_214_oRDR_DETECTION_213_216_oPCAN_RADAR_31c46c6e_Tx: ComBitPosition=230, ComBitSize=2, ComSignalInitValue=0, ComSignalType=UINT8, ComSystemTemplateSystemSignalRef=DET_CONFD_AZIMUTH_214
            DET_CONFD_AZIMUTH_215_oRDR_DETECTION_213_216_oPCAN_RADAR_a4b4b8fb_Tx: ComBitPosition=342, ComBitSize=2, ComSignalInitValue=0, ComSignalType=UINT8, ComSystemTemplateSystemSignalRef=DET_CONFD_AZIMUTH_215
            DET_CONFD_AZIMUTH_216_oRDR_DETECTION_213_216_oPCAN_RADAR_c054c305_Tx: ComBitPosition=454, ComBitSize=2, ComSignalInitValue=0, ComSignalType=UINT8, ComSystemTemplateSystemSignalRef=DET_CONFD_AZIMUTH_216
            DET_CONFD_ELEVATION_213_oRDR_DETECTION_213_216_oPCAN_RADAR_6fe14efd_Tx: ComBitPosition=101, ComBitSize=2, ComSignalInitValue=0, ComSignalType=UINT8, ComSystemTemplateSystemSignalRef=DET_CONFD_ELEVATION_213
            DET_CONFD_ELEVATION_214_oRDR_DETECTION_213_216_oPCAN_RADAR_33516d94_Tx: ComBitPosition=213, ComBitSize=2, ComSignalInitValue=0, ComSignalType=UINT8, ComSystemTemplateSystemSignalRef=DET_CONFD_ELEVATION_214
            DET_CONFD_ELEVATION_215_oRDR_DETECTION_213_216_oPCAN_RADAR_a621b901_Tx: ComBitPosition=325, ComBitSize=2, ComSignalInitValue=0, ComSignalType=UINT8, ComSystemTemplateSystemSignalRef=DET_CONFD_ELEVATION_215
            DET_CONFD_ELEVATION_216_oRDR_DETECTION_213_216_oPCAN_RADAR_c2c1c2ff_Tx: ComBitPosition=437, ComBitSize=2, ComSignalInitValue=0, ComSignalType=UINT8, ComSystemTemplateSystemSignalRef=DET_CONFD_ELEVATION_216
            DET_ELEVATION_213_oRDR_DETECTION_213_216_oPCAN_RADAR_be219ac1_Tx: ComBitPosition=72, ComBitSize=8, ComSignalInitValue=0, ComSignalType=UINT8, ComSystemTemplateSystemSignalRef=DET_ELEVATION_213
            DET_ELEVATION_214_oRDR_DETECTION_213_216_oPCAN_RADAR_e291b9a8_Tx: ComBitPosition=184, ComBitSize=8, ComSignalInitValue=0, ComSignalType=UINT8, ComSystemTemplateSystemSignalRef=DET_ELEVATION_214
            DET_ELEVATION_215_oRDR_DETECTION_213_216_oPCAN_RADAR_77e16d3d_Tx: ComBitPosition=296, ComBitSize=8, ComSignalInitValue=0, ComSignalType=UINT8, ComSystemTemplateSystemSignalRef=DET_ELEVATION_215
            DET_ELEVATION_216_oRDR_DETECTION_213_216_oPCAN_RADAR_130116c3_Tx: ComBitPosition=408, ComBitSize=8, ComSignalInitValue=0, ComSignalType=UINT8, ComSystemTemplateSystemSignalRef=DET_ELEVATION_216
            DET_ELEVATION_ERR_213_oRDR_DETECTION_213_216_oPCAN_RADAR_391802b4_Tx: ComBitPosition=80, ComBitSize=6, ComSignalInitValue=0, ComSignalType=UINT8, ComSystemTemplateSystemSignalRef=DET_ELEVATION_ERR_213
            DET_ELEVATION_ERR_214_oRDR_DETECTION_213_216_oPCAN_RADAR_65a821dd_Tx: ComBitPosition=192, ComBitSize=6, ComSignalInitValue=0, ComSignalType=UINT8, ComSystemTemplateSystemSignalRef=DET_ELEVATION_ERR_214
            DET_ELEVATION_ERR_215_oRDR_DETECTION_213_216_oPCAN_RADAR_f0d8f548_Tx: ComBitPosition=304, ComBitSize=6, ComSignalInitValue=0, ComSignalType=UINT8, ComSystemTemplateSystemSignalRef=DET_ELEVATION_ERR_215
            DET_ELEVATION_ERR_216_oRDR_DETECTION_213_216_oPCAN_RADAR_94388eb6_Tx: ComBitPosition=416, ComBitSize=6, ComSignalInitValue=0, ComSignalType=UINT8, ComSystemTemplateSystemSignalRef=DET_ELEVATION_ERR_216
            DET_EXISTENCE_PROB_213_oRDR_DETECTION_213_216_oPCAN_RADAR_eb8777d4_Tx: ComBitPosition=112, ComBitSize=6, ComSignalInitValue=0, ComSignalType=UINT8, ComSystemTemplateSystemSignalRef=DET_EXISTENCE_PROB_213
            DET_EXISTENCE_PROB_214_oRDR_DETECTION_213_216_oPCAN_RADAR_b73754bd_Tx: ComBitPosition=224, ComBitSize=6, ComSignalInitValue=0, ComSignalType=UINT8, ComSystemTemplateSystemSignalRef=DET_EXISTENCE_PROB_214
            DET_EXISTENCE_PROB_215_oRDR_DETECTION_213_216_oPCAN_RADAR_22478028_Tx: ComBitPosition=336, ComBitSize=6, ComSignalInitValue=0, ComSignalType=UINT8, ComSystemTemplateSystemSignalRef=DET_EXISTENCE_PROB_215
            DET_EXISTENCE_PROB_216_oRDR_DETECTION_213_216_oPCAN_RADAR_46a7fbd6_Tx: ComBitPosition=448, ComBitSize=6, ComSignalInitValue=0, ComSignalType=UINT8, ComSystemTemplateSystemSignalRef=DET_EXISTENCE_PROB_216
            DET_HVC_FLAG_213_oRDR_DETECTION_213_216_oPCAN_RADAR_0af334ab_Tx: ComBitPosition=86, ComBitSize=1, ComSignalInitValue=0, ComSignalType=BOOLEAN, ComSystemTemplateSystemSignalRef=DET_HVC_FLAG_213
            DET_HVC_FLAG_214_oRDR_DETECTION_213_216_oPCAN_RADAR_564317c2_Tx: ComBitPosition=198, ComBitSize=1, ComSignalInitValue=0, ComSignalType=BOOLEAN, ComSystemTemplateSystemSignalRef=DET_HVC_FLAG_214
            DET_HVC_FLAG_215_oRDR_DETECTION_213_216_oPCAN_RADAR_c333c357_Tx: ComBitPosition=310, ComBitSize=1, ComSignalInitValue=0, ComSignalType=BOOLEAN, ComSystemTemplateSystemSignalRef=DET_HVC_FLAG_215
            DET_HVC_FLAG_216_oRDR_DETECTION_213_216_oPCAN_RADAR_a7d3b8a9_Tx: ComBitPosition=422, ComBitSize=1, ComSignalInitValue=0, ComSignalType=BOOLEAN, ComSystemTemplateSystemSignalRef=DET_HVC_FLAG_216
            DET_IDM_213_oRDR_DETECTION_213_216_oPCAN_RADAR_81a10f16_Tx: ComBitPosition=63, ComBitSize=1, ComSignalInitValue=0, ComSignalType=BOOLEAN, ComSystemTemplateSystemSignalRef=DET_IDM_213
            DET_IDM_214_oRDR_DETECTION_213_216_oPCAN_RADAR_dd112c7f_Tx: ComBitPosition=175, ComBitSize=1, ComSignalInitValue=0, ComSignalType=BOOLEAN, ComSystemTemplateSystemSignalRef=DET_IDM_214
            DET_IDM_215_oRDR_DETECTION_213_216_oPCAN_RADAR_4861f8ea_Tx: ComBitPosition=287, ComBitSize=1, ComSignalInitValue=0, ComSignalType=BOOLEAN, ComSystemTemplateSystemSignalRef=DET_IDM_215
            DET_IDM_216_oRDR_DETECTION_213_216_oPCAN_RADAR_2c818314_Tx: ComBitPosition=399, ComBitSize=1, ComSignalInitValue=0, ComSignalType=BOOLEAN, ComSystemTemplateSystemSignalRef=DET_IDM_216
            DET_MH_CRC16_213_216_oRDR_DETECTION_213_216_oPCAN_RADAR_04227ad7_Tx: ComBitPosition=0, ComBitSize=16, ComSignalInitValue=0, ComSignalType=UINT16, ComSystemTemplateSystemSignalRef=DET_MH_CRC16_213_216
            DET_MH_CYCLE_COUNTER_213_216_oRDR_DETECTION_213_216_oPCAN_RADAR_8057dbe0_Tx: ComBitPosition=16, ComBitSize=8, ComSignalInitValue=0, ComSignalType=UINT8, ComSystemTemplateSystemSignalRef=DET_MH_CYCLE_COUNTER_213_216
            DET_MH_SCAN_INDEX_4LSB_213_216_oRDR_DETECTION_213_216_oPCAN_RADAR_4c7dfe6c_Tx: ComBitPosition=476, ComBitSize=4, ComSignalInitValue=0, ComSignalType=UINT8, ComSystemTemplateSystemSignalRef=DET_MH_SCAN_INDEX_4LSB_213_216
            DET_MTD_213_oRDR_DETECTION_213_216_oPCAN_RADAR_e7123dcd_Tx: ComBitPosition=47, ComBitSize=1, ComSignalInitValue=0, ComSignalType=BOOLEAN, ComSystemTemplateSystemSignalRef=DET_MTD_213
            DET_MTD_214_oRDR_DETECTION_213_216_oPCAN_RADAR_bba21ea4_Tx: ComBitPosition=159, ComBitSize=1, ComSignalInitValue=0, ComSignalType=BOOLEAN, ComSystemTemplateSystemSignalRef=DET_MTD_214
            DET_MTD_215_oRDR_DETECTION_213_216_oPCAN_RADAR_2ed2ca31_Tx: ComBitPosition=271, ComBitSize=1, ComSignalInitValue=0, ComSignalType=BOOLEAN, ComSystemTemplateSystemSignalRef=DET_MTD_215
            DET_MTD_216_oRDR_DETECTION_213_216_oPCAN_RADAR_4a32b1cf_Tx: ComBitPosition=383, ComBitSize=1, ComSignalInitValue=0, ComSignalType=BOOLEAN, ComSystemTemplateSystemSignalRef=DET_MTD_216
            DET_PROB_1STAZHYPO_213_oRDR_DETECTION_213_216_oPCAN_RADAR_74a6d500_Tx: ComBitPosition=103, ComBitSize=1, ComSignalInitValue=0, ComSignalType=BOOLEAN, ComSystemTemplateSystemSignalRef=DET_PROB_1STAZHYPO_213
            DET_PROB_1STAZHYPO_214_oRDR_DETECTION_213_216_oPCAN_RADAR_2816f669_Tx: ComBitPosition=215, ComBitSize=1, ComSignalInitValue=0, ComSignalType=BOOLEAN, ComSystemTemplateSystemSignalRef=DET_PROB_1STAZHYPO_214
            DET_PROB_1STAZHYPO_215_oRDR_DETECTION_213_216_oPCAN_RADAR_bd6622fc_Tx: ComBitPosition=327, ComBitSize=1, ComSignalInitValue=0, ComSignalType=BOOLEAN, ComSystemTemplateSystemSignalRef=DET_PROB_1STAZHYPO_215
            DET_PROB_1STAZHYPO_216_oRDR_DETECTION_213_216_oPCAN_RADAR_d9865902_Tx: ComBitPosition=439, ComBitSize=1, ComSignalInitValue=0, ComSignalType=BOOLEAN, ComSystemTemplateSystemSignalRef=DET_PROB_1STAZHYPO_216
            DET_RANGE_213_oRDR_DETECTION_213_216_oPCAN_RADAR_7f093676_Tx: ComBitPosition=24, ComBitSize=15, ComSignalInitValue=0, ComSignalType=UINT16, ComSystemTemplateSystemSignalRef=DET_RANGE_213
            DET_RANGE_214_oRDR_DETECTION_213_216_oPCAN_RADAR_23b9151f_Tx: ComBitPosition=136, ComBitSize=15, ComSignalInitValue=0, ComSignalType=UINT16, ComSystemTemplateSystemSignalRef=DET_RANGE_214
            DET_RANGE_215_oRDR_DETECTION_213_216_oPCAN_RADAR_b6c9c18a_Tx: ComBitPosition=248, ComBitSize=15, ComSignalInitValue=0, ComSignalType=UINT16, ComSystemTemplateSystemSignalRef=DET_RANGE_215
            DET_RANGE_216_oRDR_DETECTION_213_216_oPCAN_RADAR_d229ba74_Tx: ComBitPosition=360, ComBitSize=15, ComSignalInitValue=0, ComSignalType=UINT16, ComSystemTemplateSystemSignalRef=DET_RANGE_216
            DET_RANGE_ERR_213_oRDR_DETECTION_213_216_oPCAN_RADAR_d8e18c1f_Tx: ComBitPosition=40, ComBitSize=7, ComSignalInitValue=0, ComSignalType=UINT8, ComSystemTemplateSystemSignalRef=DET_RANGE_ERR_213
            DET_RANGE_ERR_214_oRDR_DETECTION_213_216_oPCAN_RADAR_8451af76_Tx: ComBitPosition=152, ComBitSize=7, ComSignalInitValue=0, ComSignalType=UINT8, ComSystemTemplateSystemSignalRef=DET_RANGE_ERR_214
            DET_RANGE_ERR_215_oRDR_DETECTION_213_216_oPCAN_RADAR_11217be3_Tx: ComBitPosition=264, ComBitSize=7, ComSignalInitValue=0, ComSignalType=UINT8, ComSystemTemplateSystemSignalRef=DET_RANGE_ERR_215
            DET_RANGE_ERR_216_oRDR_DETECTION_213_216_oPCAN_RADAR_75c1001d_Tx: ComBitPosition=376, ComBitSize=7, ComSignalInitValue=0, ComSignalType=UINT8, ComSystemTemplateSystemSignalRef=DET_RANGE_ERR_216
            DET_RANGE_VELOCITY_213_oRDR_DETECTION_213_216_oPCAN_RADAR_0aaff453_Tx: ComBitPosition=48, ComBitSize=15, ComSignalInitValue=16384, ComSignalType=UINT16, ComSystemTemplateSystemSignalRef=DET_RANGE_VELOCITY_213
            DET_RANGE_VELOCITY_214_oRDR_DETECTION_213_216_oPCAN_RADAR_561fd73a_Tx: ComBitPosition=160, ComBitSize=15, ComSignalInitValue=16384, ComSignalType=UINT16, ComSystemTemplateSystemSignalRef=DET_RANGE_VELOCITY_214
            DET_RANGE_VELOCITY_215_oRDR_DETECTION_213_216_oPCAN_RADAR_c36f03af_Tx: ComBitPosition=272, ComBitSize=15, ComSignalInitValue=16384, ComSignalType=UINT16, ComSystemTemplateSystemSignalRef=DET_RANGE_VELOCITY_215
            DET_RANGE_VELOCITY_216_oRDR_DETECTION_213_216_oPCAN_RADAR_a78f7851_Tx: ComBitPosition=384, ComBitSize=15, ComSignalInitValue=16384, ComSignalType=UINT16, ComSystemTemplateSystemSignalRef=DET_RANGE_VELOCITY_216
            DET_RANGE_VELOCITY_ERR_213_oRDR_DETECTION_213_216_oPCAN_RADAR_05140fe1_Tx: ComBitPosition=64, ComBitSize=8, ComSignalInitValue=0, ComSignalType=UINT8, ComSystemTemplateSystemSignalRef=DET_RANGE_VELOCITY_ERR_213
            DET_RANGE_VELOCITY_ERR_214_oRDR_DETECTION_213_216_oPCAN_RADAR_59a42c88_Tx: ComBitPosition=176, ComBitSize=8, ComSignalInitValue=0, ComSignalType=UINT8, ComSystemTemplateSystemSignalRef=DET_RANGE_VELOCITY_ERR_214
            DET_RANGE_VELOCITY_ERR_215_oRDR_DETECTION_213_216_oPCAN_RADAR_ccd4f81d_Tx: ComBitPosition=288, ComBitSize=8, ComSignalInitValue=0, ComSignalType=UINT8, ComSystemTemplateSystemSignalRef=DET_RANGE_VELOCITY_ERR_215
            DET_RANGE_VELOCITY_ERR_216_oRDR_DETECTION_213_216_oPCAN_RADAR_a83483e3_Tx: ComBitPosition=400, ComBitSize=8, ComSignalInitValue=0, ComSignalType=UINT8, ComSystemTemplateSystemSignalRef=DET_RANGE_VELOCITY_ERR_216
            DET_RCS_213_oRDR_DETECTION_213_216_oPCAN_RADAR_8d2fc309_Tx: ComBitPosition=128, ComBitSize=8, ComSignalInitValue=128, ComSignalType=UINT8, ComSystemTemplateSystemSignalRef=DET_RCS_213
            DET_RCS_214_oRDR_DETECTION_213_216_oPCAN_RADAR_d19fe060_Tx: ComBitPosition=240, ComBitSize=8, ComSignalInitValue=128, ComSignalType=UINT8, ComSystemTemplateSystemSignalRef=DET_RCS_214
            DET_RCS_215_oRDR_DETECTION_213_216_oPCAN_RADAR_44ef34f5_Tx: ComBitPosition=352, ComBitSize=8, ComSignalInitValue=128, ComSignalType=UINT8, ComSystemTemplateSystemSignalRef=DET_RCS_215
            DET_RCS_216_oRDR_DETECTION_213_216_oPCAN_RADAR_200f4f0b_Tx: ComBitPosition=464, ComBitSize=8, ComSignalInitValue=128, ComSignalType=UINT8, ComSystemTemplateSystemSignalRef=DET_RCS_216
            DET_SNR_213_oRDR_DETECTION_213_216_oPCAN_RADAR_5081970b_Tx: ComBitPosition=120, ComBitSize=8, ComSignalInitValue=0, ComSignalType=UINT8, ComSystemTemplateSystemSignalRef=DET_SNR_213
            DET_SNR_214_oRDR_DETECTION_213_216_oPCAN_RADAR_0c31b462_Tx: ComBitPosition=232, ComBitSize=8, ComSignalInitValue=0, ComSignalType=UINT8, ComSystemTemplateSystemSignalRef=DET_SNR_214
            DET_SNR_215_oRDR_DETECTION_213_216_oPCAN_RADAR_994160f7_Tx: ComBitPosition=344, ComBitSize=8, ComSignalInitValue=0, ComSignalType=UINT8, ComSystemTemplateSystemSignalRef=DET_SNR_215
            DET_SNR_216_oRDR_DETECTION_213_216_oPCAN_RADAR_fda11b09_Tx: ComBitPosition=456, ComBitSize=8, ComSignalInitValue=0, ComSignalType=UINT8, ComSystemTemplateSystemSignalRef=DET_SNR_216
            DET_SUPER_RES_TARGET_213_oRDR_DETECTION_213_216_oPCAN_RADAR_6118bf6e_Tx: ComBitPosition=87, ComBitSize=1, ComSignalInitValue=0, ComSignalType=BOOLEAN, ComSystemTemplateSystemSignalRef=DET_SUPER_RES_TARGET_213
            DET_SUPER_RES_TARGET_214_oRDR_DETECTION_213_216_oPCAN_RADAR_3da89c07_Tx: ComBitPosition=199, ComBitSize=1, ComSignalInitValue=0, ComSignalType=BOOLEAN, ComSystemTemplateSystemSignalRef=DET_SUPER_RES_TARGET_214
            DET_SUPER_RES_TARGET_215_oRDR_DETECTION_213_216_oPCAN_RADAR_a8d84892_Tx: ComBitPosition=311, ComBitSize=1, ComSignalInitValue=0, ComSignalType=BOOLEAN, ComSystemTemplateSystemSignalRef=DET_SUPER_RES_TARGET_215
            DET_SUPER_RES_TARGET_216_oRDR_DETECTION_213_216_oPCAN_RADAR_cc38336c_Tx: ComBitPosition=423, ComBitSize=1, ComSignalInitValue=0, ComSignalType=BOOLEAN, ComSystemTemplateSystemSignalRef=DET_SUPER_RES_TARGET_216
        SG_Detections_217_220_oRDR_DETECTION_217_220_oPCAN_RADAR_6c06fe56_Tx: ComSystemTemplateSignalGroupRef=SG_Detections_217_220
          83 x ComGroupSignal, all with ComSignalEndianness=LITTLE_ENDIAN, ComTransferProperty=PENDING:
            DET_AZIMUTH_217_oRDR_DETECTION_217_220_oPCAN_RADAR_f84ec093_Tx: ComBitPosition=88, ComBitSize=13, ComSignalInitValue=0, ComSignalType=UINT16, ComSystemTemplateSystemSignalRef=DET_AZIMUTH_217
            DET_AZIMUTH_218_oRDR_DETECTION_217_220_oPCAN_RADAR_d45e52d4_Tx: ComBitPosition=200, ComBitSize=13, ComSignalInitValue=0, ComSignalType=UINT16, ComSystemTemplateSystemSignalRef=DET_AZIMUTH_218
            DET_AZIMUTH_219_oRDR_DETECTION_217_220_oPCAN_RADAR_412e8641_Tx: ComBitPosition=312, ComBitSize=13, ComSignalInitValue=0, ComSignalType=UINT16, ComSystemTemplateSystemSignalRef=DET_AZIMUTH_219
            DET_AZIMUTH_220_oRDR_DETECTION_217_220_oPCAN_RADAR_fe9fdc9a_Tx: ComBitPosition=424, ComBitSize=13, ComSignalInitValue=0, ComSignalType=UINT16, ComSystemTemplateSystemSignalRef=DET_AZIMUTH_220
            DET_AZIMUTH_ERR_217_oRDR_DETECTION_217_220_oPCAN_RADAR_5cfb5566_Tx: ComBitPosition=105, ComBitSize=7, ComSignalInitValue=0, ComSignalType=UINT8, ComSystemTemplateSystemSignalRef=DET_AZIMUTH_ERR_217
            DET_AZIMUTH_ERR_218_oRDR_DETECTION_217_220_oPCAN_RADAR_70ebc721_Tx: ComBitPosition=217, ComBitSize=7, ComSignalInitValue=0, ComSignalType=UINT8, ComSystemTemplateSystemSignalRef=DET_AZIMUTH_ERR_218
            DET_AZIMUTH_ERR_219_oRDR_DETECTION_217_220_oPCAN_RADAR_e59b13b4_Tx: ComBitPosition=329, ComBitSize=7, ComSignalInitValue=0, ComSignalType=UINT8, ComSystemTemplateSystemSignalRef=DET_AZIMUTH_ERR_219
            DET_AZIMUTH_ERR_220_oRDR_DETECTION_217_220_oPCAN_RADAR_5a2a496f_Tx: ComBitPosition=441, ComBitSize=7, ComSignalInitValue=0, ComSignalType=UINT8, ComSystemTemplateSystemSignalRef=DET_AZIMUTH_ERR_220
            DET_BELOW_RAIN_THOLD_217_oRDR_DETECTION_217_220_oPCAN_RADAR_2d4f5353_Tx: ComBitPosition=39, ComBitSize=1, ComSignalInitValue=0, ComSignalType=BOOLEAN, ComSystemTemplateSystemSignalRef=DET_BELOW_RAIN_THOLD_217
            DET_BELOW_RAIN_THOLD_218_oRDR_DETECTION_217_220_oPCAN_RADAR_015fc114_Tx: ComBitPosition=151, ComBitSize=1, ComSignalInitValue=0, ComSignalType=BOOLEAN, ComSystemTemplateSystemSignalRef=DET_BELOW_RAIN_THOLD_218
            DET_BELOW_RAIN_THOLD_219_oRDR_DETECTION_217_220_oPCAN_RADAR_942f1581_Tx: ComBitPosition=263, ComBitSize=1, ComSignalInitValue=0, ComSignalType=BOOLEAN, ComSystemTemplateSystemSignalRef=DET_BELOW_RAIN_THOLD_219
            DET_BELOW_RAIN_THOLD_220_oRDR_DETECTION_217_220_oPCAN_RADAR_2b9e4f5a_Tx: ComBitPosition=375, ComBitSize=1, ComSignalInitValue=0, ComSignalType=BOOLEAN, ComSystemTemplateSystemSignalRef=DET_BELOW_RAIN_THOLD_220
            DET_BI_STATIC_FLAG_217_oRDR_DETECTION_217_220_oPCAN_RADAR_ae628016_Tx: ComBitPosition=104, ComBitSize=1, ComSignalInitValue=0, ComSignalType=BOOLEAN, ComSystemTemplateSystemSignalRef=DET_BI_STATIC_FLAG_217
            DET_BI_STATIC_FLAG_218_oRDR_DETECTION_217_220_oPCAN_RADAR_82721251_Tx: ComBitPosition=216, ComBitSize=1, ComSignalInitValue=0, ComSignalType=BOOLEAN, ComSystemTemplateSystemSignalRef=DET_BI_STATIC_FLAG_218
            DET_BI_STATIC_FLAG_219_oRDR_DETECTION_217_220_oPCAN_RADAR_1702c6c4_Tx: ComBitPosition=328, ComBitSize=1, ComSignalInitValue=0, ComSignalType=BOOLEAN, ComSystemTemplateSystemSignalRef=DET_BI_STATIC_FLAG_219
            DET_BI_STATIC_FLAG_220_oRDR_DETECTION_217_220_oPCAN_RADAR_a8b39c1f_Tx: ComBitPosition=440, ComBitSize=1, ComSignalInitValue=0, ComSignalType=BOOLEAN, ComSystemTemplateSystemSignalRef=DET_BI_STATIC_FLAG_220
            DET_CONFD_AZIMUTH_217_oRDR_DETECTION_217_220_oPCAN_RADAR_faa8ca59_Tx: ComBitPosition=118, ComBitSize=2, ComSignalInitValue=0, ComSignalType=UINT8, ComSystemTemplateSystemSignalRef=DET_CONFD_AZIMUTH_217
            DET_CONFD_AZIMUTH_218_oRDR_DETECTION_217_220_oPCAN_RADAR_d6b8581e_Tx: ComBitPosition=230, ComBitSize=2, ComSignalInitValue=0, ComSignalType=UINT8, ComSystemTemplateSystemSignalRef=DET_CONFD_AZIMUTH_218
            DET_CONFD_AZIMUTH_219_oRDR_DETECTION_217_220_oPCAN_RADAR_43c88c8b_Tx: ComBitPosition=342, ComBitSize=2, ComSignalInitValue=0, ComSignalType=UINT8, ComSystemTemplateSystemSignalRef=DET_CONFD_AZIMUTH_219
            DET_CONFD_AZIMUTH_220_oRDR_DETECTION_217_220_oPCAN_RADAR_fc79d650_Tx: ComBitPosition=454, ComBitSize=2, ComSignalInitValue=0, ComSignalType=UINT8, ComSystemTemplateSystemSignalRef=DET_CONFD_AZIMUTH_220
            DET_CONFD_ELEVATION_217_oRDR_DETECTION_217_220_oPCAN_RADAR_f83dcba3_Tx: ComBitPosition=101, ComBitSize=2, ComSignalInitValue=0, ComSignalType=UINT8, ComSystemTemplateSystemSignalRef=DET_CONFD_ELEVATION_217
            DET_CONFD_ELEVATION_218_oRDR_DETECTION_217_220_oPCAN_RADAR_d42d59e4_Tx: ComBitPosition=213, ComBitSize=2, ComSignalInitValue=0, ComSignalType=UINT8, ComSystemTemplateSystemSignalRef=DET_CONFD_ELEVATION_218
            DET_CONFD_ELEVATION_219_oRDR_DETECTION_217_220_oPCAN_RADAR_415d8d71_Tx: ComBitPosition=325, ComBitSize=2, ComSignalInitValue=0, ComSignalType=UINT8, ComSystemTemplateSystemSignalRef=DET_CONFD_ELEVATION_219
            DET_CONFD_ELEVATION_220_oRDR_DETECTION_217_220_oPCAN_RADAR_feecd7aa_Tx: ComBitPosition=437, ComBitSize=2, ComSignalInitValue=0, ComSignalType=UINT8, ComSystemTemplateSystemSignalRef=DET_CONFD_ELEVATION_220
            DET_ELEVATION_217_oRDR_DETECTION_217_220_oPCAN_RADAR_29fd1f9f_Tx: ComBitPosition=72, ComBitSize=8, ComSignalInitValue=0, ComSignalType=UINT8, ComSystemTemplateSystemSignalRef=DET_ELEVATION_217
            DET_ELEVATION_218_oRDR_DETECTION_217_220_oPCAN_RADAR_05ed8dd8_Tx: ComBitPosition=184, ComBitSize=8, ComSignalInitValue=0, ComSignalType=UINT8, ComSystemTemplateSystemSignalRef=DET_ELEVATION_218
            DET_ELEVATION_219_oRDR_DETECTION_217_220_oPCAN_RADAR_909d594d_Tx: ComBitPosition=296, ComBitSize=8, ComSignalInitValue=0, ComSignalType=UINT8, ComSystemTemplateSystemSignalRef=DET_ELEVATION_219
            DET_ELEVATION_220_oRDR_DETECTION_217_220_oPCAN_RADAR_2f2c0396_Tx: ComBitPosition=408, ComBitSize=8, ComSignalInitValue=0, ComSignalType=UINT8, ComSystemTemplateSystemSignalRef=DET_ELEVATION_220
            DET_ELEVATION_ERR_217_oRDR_DETECTION_217_220_oPCAN_RADAR_aec487ea_Tx: ComBitPosition=80, ComBitSize=6, ComSignalInitValue=0, ComSignalType=UINT8, ComSystemTemplateSystemSignalRef=DET_ELEVATION_ERR_217
            DET_ELEVATION_ERR_218_oRDR_DETECTION_217_220_oPCAN_RADAR_82d415ad_Tx: ComBitPosition=192, ComBitSize=6, ComSignalInitValue=0, ComSignalType=UINT8, ComSystemTemplateSystemSignalRef=DET_ELEVATION_ERR_218
            DET_ELEVATION_ERR_219_oRDR_DETECTION_217_220_oPCAN_RADAR_17a4c138_Tx: ComBitPosition=304, ComBitSize=6, ComSignalInitValue=0, ComSignalType=UINT8, ComSystemTemplateSystemSignalRef=DET_ELEVATION_ERR_219
            DET_ELEVATION_ERR_220_oRDR_DETECTION_217_220_oPCAN_RADAR_a8159be3_Tx: ComBitPosition=416, ComBitSize=6, ComSignalInitValue=0, ComSignalType=UINT8, ComSystemTemplateSystemSignalRef=DET_ELEVATION_ERR_220
            DET_EXISTENCE_PROB_217_oRDR_DETECTION_217_220_oPCAN_RADAR_7c5bf28a_Tx: ComBitPosition=112, ComBitSize=6, ComSignalInitValue=0, ComSignalType=UINT8, ComSystemTemplateSystemSignalRef=DET_EXISTENCE_PROB_217
            DET_EXISTENCE_PROB_218_oRDR_DETECTION_217_220_oPCAN_RADAR_504b60cd_Tx: ComBitPosition=224, ComBitSize=6, ComSignalInitValue=0, ComSignalType=UINT8, ComSystemTemplateSystemSignalRef=DET_EXISTENCE_PROB_218
            DET_EXISTENCE_PROB_219_oRDR_DETECTION_217_220_oPCAN_RADAR_c53bb458_Tx: ComBitPosition=336, ComBitSize=6, ComSignalInitValue=0, ComSignalType=UINT8, ComSystemTemplateSystemSignalRef=DET_EXISTENCE_PROB_219
            DET_EXISTENCE_PROB_220_oRDR_DETECTION_217_220_oPCAN_RADAR_7a8aee83_Tx: ComBitPosition=448, ComBitSize=6, ComSignalInitValue=0, ComSignalType=UINT8, ComSystemTemplateSystemSignalRef=DET_EXISTENCE_PROB_220
            DET_HVC_FLAG_217_oRDR_DETECTION_217_220_oPCAN_RADAR_9d2fb1f5_Tx: ComBitPosition=86, ComBitSize=1, ComSignalInitValue=0, ComSignalType=BOOLEAN, ComSystemTemplateSystemSignalRef=DET_HVC_FLAG_217
            DET_HVC_FLAG_218_oRDR_DETECTION_217_220_oPCAN_RADAR_b13f23b2_Tx: ComBitPosition=198, ComBitSize=1, ComSignalInitValue=0, ComSignalType=BOOLEAN, ComSystemTemplateSystemSignalRef=DET_HVC_FLAG_218
            DET_HVC_FLAG_219_oRDR_DETECTION_217_220_oPCAN_RADAR_244ff727_Tx: ComBitPosition=310, ComBitSize=1, ComSignalInitValue=0, ComSignalType=BOOLEAN, ComSystemTemplateSystemSignalRef=DET_HVC_FLAG_219
            DET_HVC_FLAG_220_oRDR_DETECTION_217_220_oPCAN_RADAR_9bfeadfc_Tx: ComBitPosition=422, ComBitSize=1, ComSignalInitValue=0, ComSignalType=BOOLEAN, ComSystemTemplateSystemSignalRef=DET_HVC_FLAG_220
            DET_IDM_217_oRDR_DETECTION_217_220_oPCAN_RADAR_167d8a48_Tx: ComBitPosition=63, ComBitSize=1, ComSignalInitValue=0, ComSignalType=BOOLEAN, ComSystemTemplateSystemSignalRef=DET_IDM_217
            DET_IDM_218_oRDR_DETECTION_217_220_oPCAN_RADAR_3a6d180f_Tx: ComBitPosition=175, ComBitSize=1, ComSignalInitValue=0, ComSignalType=BOOLEAN, ComSystemTemplateSystemSignalRef=DET_IDM_218
            DET_IDM_219_oRDR_DETECTION_217_220_oPCAN_RADAR_af1dcc9a_Tx: ComBitPosition=287, ComBitSize=1, ComSignalInitValue=0, ComSignalType=BOOLEAN, ComSystemTemplateSystemSignalRef=DET_IDM_219
            DET_IDM_220_oRDR_DETECTION_217_220_oPCAN_RADAR_10ac9641_Tx: ComBitPosition=399, ComBitSize=1, ComSignalInitValue=0, ComSignalType=BOOLEAN, ComSystemTemplateSystemSignalRef=DET_IDM_220
            DET_MH_CRC16_217_220_oRDR_DETECTION_217_220_oPCAN_RADAR_e88e2c5d_Tx: ComBitPosition=0, ComBitSize=16, ComSignalInitValue=0, ComSignalType=UINT16, ComSystemTemplateSystemSignalRef=DET_MH_CRC16_217_220
            DET_MH_CYCLE_COUNTER_217_220_oRDR_DETECTION_217_220_oPCAN_RADAR_6cfb8d6a_Tx: ComBitPosition=16, ComBitSize=8, ComSignalInitValue=0, ComSignalType=UINT8, ComSystemTemplateSystemSignalRef=DET_MH_CYCLE_COUNTER_217_220
            DET_MH_SCAN_INDEX_4LSB_217_220_oRDR_DETECTION_217_220_oPCAN_RADAR_a0d1a8e6_Tx: ComBitPosition=476, ComBitSize=4, ComSignalInitValue=0, ComSignalType=UINT8, ComSystemTemplateSystemSignalRef=DET_MH_SCAN_INDEX_4LSB_217_220
            DET_MTD_217_oRDR_DETECTION_217_220_oPCAN_RADAR_70ceb893_Tx: ComBitPosition=47, ComBitSize=1, ComSignalInitValue=0, ComSignalType=BOOLEAN, ComSystemTemplateSystemSignalRef=DET_MTD_217
            DET_MTD_218_oRDR_DETECTION_217_220_oPCAN_RADAR_5cde2ad4_Tx: ComBitPosition=159, ComBitSize=1, ComSignalInitValue=0, ComSignalType=BOOLEAN, ComSystemTemplateSystemSignalRef=DET_MTD_218
            DET_MTD_219_oRDR_DETECTION_217_220_oPCAN_RADAR_c9aefe41_Tx: ComBitPosition=271, ComBitSize=1, ComSignalInitValue=0, ComSignalType=BOOLEAN, ComSystemTemplateSystemSignalRef=DET_MTD_219
            DET_MTD_220_oRDR_DETECTION_217_220_oPCAN_RADAR_761fa49a_Tx: ComBitPosition=383, ComBitSize=1, ComSignalInitValue=0, ComSignalType=BOOLEAN, ComSystemTemplateSystemSignalRef=DET_MTD_220
            DET_PROB_1STAZHYPO_217_oRDR_DETECTION_217_220_oPCAN_RADAR_e37a505e_Tx: ComBitPosition=103, ComBitSize=1, ComSignalInitValue=0, ComSignalType=BOOLEAN, ComSystemTemplateSystemSignalRef=DET_PROB_1STAZHYPO_217
            DET_PROB_1STAZHYPO_218_oRDR_DETECTION_217_220_oPCAN_RADAR_cf6ac219_Tx: ComBitPosition=215, ComBitSize=1, ComSignalInitValue=0, ComSignalType=BOOLEAN, ComSystemTemplateSystemSignalRef=DET_PROB_1STAZHYPO_218
            DET_PROB_1STAZHYPO_219_oRDR_DETECTION_217_220_oPCAN_RADAR_5a1a168c_Tx: ComBitPosition=327, ComBitSize=1, ComSignalInitValue=0, ComSignalType=BOOLEAN, ComSystemTemplateSystemSignalRef=DET_PROB_1STAZHYPO_219
            DET_PROB_1STAZHYPO_220_oRDR_DETECTION_217_220_oPCAN_RADAR_e5ab4c57_Tx: ComBitPosition=439, ComBitSize=1, ComSignalInitValue=0, ComSignalType=BOOLEAN, ComSystemTemplateSystemSignalRef=DET_PROB_1STAZHYPO_220
            DET_RANGE_217_oRDR_DETECTION_217_220_oPCAN_RADAR_e8d5b328_Tx: ComBitPosition=24, ComBitSize=15, ComSignalInitValue=0, ComSignalType=UINT16, ComSystemTemplateSystemSignalRef=DET_RANGE_217
            DET_RANGE_218_oRDR_DETECTION_217_220_oPCAN_RADAR_c4c5216f_Tx: ComBitPosition=136, ComBitSize=15, ComSignalInitValue=0, ComSignalType=UINT16, ComSystemTemplateSystemSignalRef=DET_RANGE_218
            DET_RANGE_219_oRDR_DETECTION_217_220_oPCAN_RADAR_51b5f5fa_Tx: ComBitPosition=248, ComBitSize=15, ComSignalInitValue=0, ComSignalType=UINT16, ComSystemTemplateSystemSignalRef=DET_RANGE_219
            DET_RANGE_220_oRDR_DETECTION_217_220_oPCAN_RADAR_ee04af21_Tx: ComBitPosition=360, ComBitSize=15, ComSignalInitValue=0, ComSignalType=UINT16, ComSystemTemplateSystemSignalRef=DET_RANGE_220
            DET_RANGE_ERR_217_oRDR_DETECTION_217_220_oPCAN_RADAR_4f3d0941_Tx: ComBitPosition=40, ComBitSize=7, ComSignalInitValue=0, ComSignalType=UINT8, ComSystemTemplateSystemSignalRef=DET_RANGE_ERR_217
            DET_RANGE_ERR_218_oRDR_DETECTION_217_220_oPCAN_RADAR_632d9b06_Tx: ComBitPosition=152, ComBitSize=7, ComSignalInitValue=0, ComSignalType=UINT8, ComSystemTemplateSystemSignalRef=DET_RANGE_ERR_218
            DET_RANGE_ERR_219_oRDR_DETECTION_217_220_oPCAN_RADAR_f65d4f93_Tx: ComBitPosition=264, ComBitSize=7, ComSignalInitValue=0, ComSignalType=UINT8, ComSystemTemplateSystemSignalRef=DET_RANGE_ERR_219
            DET_RANGE_ERR_220_oRDR_DETECTION_217_220_oPCAN_RADAR_49ec1548_Tx: ComBitPosition=376, ComBitSize=7, ComSignalInitValue=0, ComSignalType=UINT8, ComSystemTemplateSystemSignalRef=DET_RANGE_ERR_220
            DET_RANGE_VELOCITY_217_oRDR_DETECTION_217_220_oPCAN_RADAR_9d73710d_Tx: ComBitPosition=48, ComBitSize=15, ComSignalInitValue=16384, ComSignalType=UINT16, ComSystemTemplateSystemSignalRef=DET_RANGE_VELOCITY_217
            DET_RANGE_VELOCITY_218_oRDR_DETECTION_217_220_oPCAN_RADAR_b163e34a_Tx: ComBitPosition=160, ComBitSize=15, ComSignalInitValue=16384, ComSignalType=UINT16, ComSystemTemplateSystemSignalRef=DET_RANGE_VELOCITY_218
            DET_RANGE_VELOCITY_219_oRDR_DETECTION_217_220_oPCAN_RADAR_241337df_Tx: ComBitPosition=272, ComBitSize=15, ComSignalInitValue=16384, ComSignalType=UINT16, ComSystemTemplateSystemSignalRef=DET_RANGE_VELOCITY_219
            DET_RANGE_VELOCITY_220_oRDR_DETECTION_217_220_oPCAN_RADAR_9ba26d04_Tx: ComBitPosition=384, ComBitSize=15, ComSignalInitValue=16384, ComSignalType=UINT16, ComSystemTemplateSystemSignalRef=DET_RANGE_VELOCITY_220
            DET_RANGE_VELOCITY_ERR_217_oRDR_DETECTION_217_220_oPCAN_RADAR_92c88abf_Tx: ComBitPosition=64, ComBitSize=8, ComSignalInitValue=0, ComSignalType=UINT8, ComSystemTemplateSystemSignalRef=DET_RANGE_VELOCITY_ERR_217
            DET_RANGE_VELOCITY_ERR_218_oRDR_DETECTION_217_220_oPCAN_RADAR_bed818f8_Tx: ComBitPosition=176, ComBitSize=8, ComSignalInitValue=0, ComSignalType=UINT8, ComSystemTemplateSystemSignalRef=DET_RANGE_VELOCITY_ERR_218
            DET_RANGE_VELOCITY_ERR_219_oRDR_DETECTION_217_220_oPCAN_RADAR_2ba8cc6d_Tx: ComBitPosition=288, ComBitSize=8, ComSignalInitValue=0, ComSignalType=UINT8, ComSystemTemplateSystemSignalRef=DET_RANGE_VELOCITY_ERR_219
            DET_RANGE_VELOCITY_ERR_220_oRDR_DETECTION_217_220_oPCAN_RADAR_941996b6_Tx: ComBitPosition=400, ComBitSize=8, ComSignalInitValue=0, ComSignalType=UINT8, ComSystemTemplateSystemSignalRef=DET_RANGE_VELOCITY_ERR_220
            DET_RCS_217_oRDR_DETECTION_217_220_oPCAN_RADAR_1af34657_Tx: ComBitPosition=128, ComBitSize=8, ComSignalInitValue=128, ComSignalType=UINT8, ComSystemTemplateSystemSignalRef=DET_RCS_217
            DET_RCS_218_oRDR_DETECTION_217_220_oPCAN_RADAR_36e3d410_Tx: ComBitPosition=240, ComBitSize=8, ComSignalInitValue=128, ComSignalType=UINT8, ComSystemTemplateSystemSignalRef=DET_RCS_218
            DET_RCS_219_oRDR_DETECTION_217_220_oPCAN_RADAR_a3930085_Tx: ComBitPosition=352, ComBitSize=8, ComSignalInitValue=128, ComSignalType=UINT8, ComSystemTemplateSystemSignalRef=DET_RCS_219
            DET_RCS_220_oRDR_DETECTION_217_220_oPCAN_RADAR_1c225a5e_Tx: ComBitPosition=464, ComBitSize=8, ComSignalInitValue=128, ComSignalType=UINT8, ComSystemTemplateSystemSignalRef=DET_RCS_220
            DET_SNR_217_oRDR_DETECTION_217_220_oPCAN_RADAR_c75d1255_Tx: ComBitPosition=120, ComBitSize=8, ComSignalInitValue=0, ComSignalType=UINT8, ComSystemTemplateSystemSignalRef=DET_SNR_217
            DET_SNR_218_oRDR_DETECTION_217_220_oPCAN_RADAR_eb4d8012_Tx: ComBitPosition=232, ComBitSize=8, ComSignalInitValue=0, ComSignalType=UINT8, ComSystemTemplateSystemSignalRef=DET_SNR_218
            DET_SNR_219_oRDR_DETECTION_217_220_oPCAN_RADAR_7e3d5487_Tx: ComBitPosition=344, ComBitSize=8, ComSignalInitValue=0, ComSignalType=UINT8, ComSystemTemplateSystemSignalRef=DET_SNR_219
            DET_SNR_220_oRDR_DETECTION_217_220_oPCAN_RADAR_c18c0e5c_Tx: ComBitPosition=456, ComBitSize=8, ComSignalInitValue=0, ComSignalType=UINT8, ComSystemTemplateSystemSignalRef=DET_SNR_220
            DET_SUPER_RES_TARGET_217_oRDR_DETECTION_217_220_oPCAN_RADAR_f6c43a30_Tx: ComBitPosition=87, ComBitSize=1, ComSignalInitValue=0, ComSignalType=BOOLEAN, ComSystemTemplateSystemSignalRef=DET_SUPER_RES_TARGET_217
            DET_SUPER_RES_TARGET_218_oRDR_DETECTION_217_220_oPCAN_RADAR_dad4a877_Tx: ComBitPosition=199, ComBitSize=1, ComSignalInitValue=0, ComSignalType=BOOLEAN, ComSystemTemplateSystemSignalRef=DET_SUPER_RES_TARGET_218
            DET_SUPER_RES_TARGET_219_oRDR_DETECTION_217_220_oPCAN_RADAR_4fa47ce2_Tx: ComBitPosition=311, ComBitSize=1, ComSignalInitValue=0, ComSignalType=BOOLEAN, ComSystemTemplateSystemSignalRef=DET_SUPER_RES_TARGET_219
            DET_SUPER_RES_TARGET_220_oRDR_DETECTION_217_220_oPCAN_RADAR_f0152639_Tx: ComBitPosition=423, ComBitSize=1, ComSignalInitValue=0, ComSignalType=BOOLEAN, ComSystemTemplateSystemSignalRef=DET_SUPER_RES_TARGET_220
        SG_Detections_221_224_oRDR_DETECTION_221_224_oPCAN_RADAR_6f6d708f_Tx: ComSystemTemplateSignalGroupRef=SG_Detections_221_224
          83 x ComGroupSignal, all with ComSignalEndianness=LITTLE_ENDIAN, ComTransferProperty=PENDING:
            DET_AZIMUTH_221_oRDR_DETECTION_221_224_oPCAN_RADAR_e6e408f3_Tx: ComBitPosition=88, ComBitSize=13, ComSignalInitValue=0, ComSignalType=UINT16, ComSystemTemplateSystemSignalRef=DET_AZIMUTH_221
            DET_AZIMUTH_222_oRDR_DETECTION_221_224_oPCAN_RADAR_8204730d_Tx: ComBitPosition=200, ComBitSize=13, ComSignalInitValue=0, ComSignalType=UINT16, ComSystemTemplateSystemSignalRef=DET_AZIMUTH_222
            DET_AZIMUTH_223_oRDR_DETECTION_221_224_oPCAN_RADAR_1774a798_Tx: ComBitPosition=312, ComBitSize=13, ComSignalInitValue=0, ComSignalType=UINT16, ComSystemTemplateSystemSignalRef=DET_AZIMUTH_223
            DET_AZIMUTH_224_oRDR_DETECTION_221_224_oPCAN_RADAR_4bc484f1_Tx: ComBitPosition=424, ComBitSize=13, ComSignalInitValue=0, ComSignalType=UINT16, ComSystemTemplateSystemSignalRef=DET_AZIMUTH_224
            DET_AZIMUTH_ERR_221_oRDR_DETECTION_221_224_oPCAN_RADAR_42519d06_Tx: ComBitPosition=105, ComBitSize=7, ComSignalInitValue=0, ComSignalType=UINT8, ComSystemTemplateSystemSignalRef=DET_AZIMUTH_ERR_221
            DET_AZIMUTH_ERR_222_oRDR_DETECTION_221_224_oPCAN_RADAR_26b1e6f8_Tx: ComBitPosition=217, ComBitSize=7, ComSignalInitValue=0, ComSignalType=UINT8, ComSystemTemplateSystemSignalRef=DET_AZIMUTH_ERR_222
            DET_AZIMUTH_ERR_223_oRDR_DETECTION_221_224_oPCAN_RADAR_b3c1326d_Tx: ComBitPosition=329, ComBitSize=7, ComSignalInitValue=0, ComSignalType=UINT8, ComSystemTemplateSystemSignalRef=DET_AZIMUTH_ERR_223
            DET_AZIMUTH_ERR_224_oRDR_DETECTION_221_224_oPCAN_RADAR_ef711104_Tx: ComBitPosition=441, ComBitSize=7, ComSignalInitValue=0, ComSignalType=UINT8, ComSystemTemplateSystemSignalRef=DET_AZIMUTH_ERR_224
            DET_BELOW_RAIN_THOLD_221_oRDR_DETECTION_221_224_oPCAN_RADAR_33e59b33_Tx: ComBitPosition=39, ComBitSize=1, ComSignalInitValue=0, ComSignalType=BOOLEAN, ComSystemTemplateSystemSignalRef=DET_BELOW_RAIN_THOLD_221
            DET_BELOW_RAIN_THOLD_222_oRDR_DETECTION_221_224_oPCAN_RADAR_5705e0cd_Tx: ComBitPosition=151, ComBitSize=1, ComSignalInitValue=0, ComSignalType=BOOLEAN, ComSystemTemplateSystemSignalRef=DET_BELOW_RAIN_THOLD_222
            DET_BELOW_RAIN_THOLD_223_oRDR_DETECTION_221_224_oPCAN_RADAR_c2753458_Tx: ComBitPosition=263, ComBitSize=1, ComSignalInitValue=0, ComSignalType=BOOLEAN, ComSystemTemplateSystemSignalRef=DET_BELOW_RAIN_THOLD_223
            DET_BELOW_RAIN_THOLD_224_oRDR_DETECTION_221_224_oPCAN_RADAR_9ec51731_Tx: ComBitPosition=375, ComBitSize=1, ComSignalInitValue=0, ComSignalType=BOOLEAN, ComSystemTemplateSystemSignalRef=DET_BELOW_RAIN_THOLD_224
            DET_BI_STATIC_FLAG_221_oRDR_DETECTION_221_224_oPCAN_RADAR_b0c84876_Tx: ComBitPosition=104, ComBitSize=1, ComSignalInitValue=0, ComSignalType=BOOLEAN, ComSystemTemplateSystemSignalRef=DET_BI_STATIC_FLAG_221
            DET_BI_STATIC_FLAG_222_oRDR_DETECTION_221_224_oPCAN_RADAR_d4283388_Tx: ComBitPosition=216, ComBitSize=1, ComSignalInitValue=0, ComSignalType=BOOLEAN, ComSystemTemplateSystemSignalRef=DET_BI_STATIC_FLAG_222
            DET_BI_STATIC_FLAG_223_oRDR_DETECTION_221_224_oPCAN_RADAR_4158e71d_Tx: ComBitPosition=328, ComBitSize=1, ComSignalInitValue=0, ComSignalType=BOOLEAN, ComSystemTemplateSystemSignalRef=DET_BI_STATIC_FLAG_223
            DET_BI_STATIC_FLAG_224_oRDR_DETECTION_221_224_oPCAN_RADAR_1de8c474_Tx: ComBitPosition=440, ComBitSize=1, ComSignalInitValue=0, ComSignalType=BOOLEAN, ComSystemTemplateSystemSignalRef=DET_BI_STATIC_FLAG_224
            DET_CONFD_AZIMUTH_221_oRDR_DETECTION_221_224_oPCAN_RADAR_e4020239_Tx: ComBitPosition=118, ComBitSize=2, ComSignalInitValue=0, ComSignalType=UINT8, ComSystemTemplateSystemSignalRef=DET_CONFD_AZIMUTH_221
            DET_CONFD_AZIMUTH_222_oRDR_DETECTION_221_224_oPCAN_RADAR_80e279c7_Tx: ComBitPosition=230, ComBitSize=2, ComSignalInitValue=0, ComSignalType=UINT8, ComSystemTemplateSystemSignalRef=DET_CONFD_AZIMUTH_222
            DET_CONFD_AZIMUTH_223_oRDR_DETECTION_221_224_oPCAN_RADAR_1592ad52_Tx: ComBitPosition=342, ComBitSize=2, ComSignalInitValue=0, ComSignalType=UINT8, ComSystemTemplateSystemSignalRef=DET_CONFD_AZIMUTH_223
            DET_CONFD_AZIMUTH_224_oRDR_DETECTION_221_224_oPCAN_RADAR_49228e3b_Tx: ComBitPosition=454, ComBitSize=2, ComSignalInitValue=0, ComSignalType=UINT8, ComSystemTemplateSystemSignalRef=DET_CONFD_AZIMUTH_224
            DET_CONFD_ELEVATION_221_oRDR_DETECTION_221_224_oPCAN_RADAR_e69703c3_Tx: ComBitPosition=101, ComBitSize=2, ComSignalInitValue=0, ComSignalType=UINT8, ComSystemTemplateSystemSignalRef=DET_CONFD_ELEVATION_221
            DET_CONFD_ELEVATION_222_oRDR_DETECTION_221_224_oPCAN_RADAR_8277783d_Tx: ComBitPosition=213, ComBitSize=2, ComSignalInitValue=0, ComSignalType=UINT8, ComSystemTemplateSystemSignalRef=DET_CONFD_ELEVATION_222
            DET_CONFD_ELEVATION_223_oRDR_DETECTION_221_224_oPCAN_RADAR_1707aca8_Tx: ComBitPosition=325, ComBitSize=2, ComSignalInitValue=0, ComSignalType=UINT8, ComSystemTemplateSystemSignalRef=DET_CONFD_ELEVATION_223
            DET_CONFD_ELEVATION_224_oRDR_DETECTION_221_224_oPCAN_RADAR_4bb78fc1_Tx: ComBitPosition=437, ComBitSize=2, ComSignalInitValue=0, ComSignalType=UINT8, ComSystemTemplateSystemSignalRef=DET_CONFD_ELEVATION_224
            DET_ELEVATION_221_oRDR_DETECTION_221_224_oPCAN_RADAR_3757d7ff_Tx: ComBitPosition=72, ComBitSize=8, ComSignalInitValue=0, ComSignalType=UINT8, ComSystemTemplateSystemSignalRef=DET_ELEVATION_221
            DET_ELEVATION_222_oRDR_DETECTION_221_224_oPCAN_RADAR_53b7ac01_Tx: ComBitPosition=184, ComBitSize=8, ComSignalInitValue=0, ComSignalType=UINT8, ComSystemTemplateSystemSignalRef=DET_ELEVATION_222
            DET_ELEVATION_223_oRDR_DETECTION_221_224_oPCAN_RADAR_c6c77894_Tx: ComBitPosition=296, ComBitSize=8, ComSignalInitValue=0, ComSignalType=UINT8, ComSystemTemplateSystemSignalRef=DET_ELEVATION_223
            DET_ELEVATION_224_oRDR_DETECTION_221_224_oPCAN_RADAR_9a775bfd_Tx: ComBitPosition=408, ComBitSize=8, ComSignalInitValue=0, ComSignalType=UINT8, ComSystemTemplateSystemSignalRef=DET_ELEVATION_224
            DET_ELEVATION_ERR_221_oRDR_DETECTION_221_224_oPCAN_RADAR_b06e4f8a_Tx: ComBitPosition=80, ComBitSize=6, ComSignalInitValue=0, ComSignalType=UINT8, ComSystemTemplateSystemSignalRef=DET_ELEVATION_ERR_221
            DET_ELEVATION_ERR_222_oRDR_DETECTION_221_224_oPCAN_RADAR_d48e3474_Tx: ComBitPosition=192, ComBitSize=6, ComSignalInitValue=0, ComSignalType=UINT8, ComSystemTemplateSystemSignalRef=DET_ELEVATION_ERR_222
            DET_ELEVATION_ERR_223_oRDR_DETECTION_221_224_oPCAN_RADAR_41fee0e1_Tx: ComBitPosition=304, ComBitSize=6, ComSignalInitValue=0, ComSignalType=UINT8, ComSystemTemplateSystemSignalRef=DET_ELEVATION_ERR_223
            DET_ELEVATION_ERR_224_oRDR_DETECTION_221_224_oPCAN_RADAR_1d4ec388_Tx: ComBitPosition=416, ComBitSize=6, ComSignalInitValue=0, ComSignalType=UINT8, ComSystemTemplateSystemSignalRef=DET_ELEVATION_ERR_224
            DET_EXISTENCE_PROB_221_oRDR_DETECTION_221_224_oPCAN_RADAR_62f13aea_Tx: ComBitPosition=112, ComBitSize=6, ComSignalInitValue=0, ComSignalType=UINT8, ComSystemTemplateSystemSignalRef=DET_EXISTENCE_PROB_221
            DET_EXISTENCE_PROB_222_oRDR_DETECTION_221_224_oPCAN_RADAR_06114114_Tx: ComBitPosition=224, ComBitSize=6, ComSignalInitValue=0, ComSignalType=UINT8, ComSystemTemplateSystemSignalRef=DET_EXISTENCE_PROB_222
            DET_EXISTENCE_PROB_223_oRDR_DETECTION_221_224_oPCAN_RADAR_93619581_Tx: ComBitPosition=336, ComBitSize=6, ComSignalInitValue=0, ComSignalType=UINT8, ComSystemTemplateSystemSignalRef=DET_EXISTENCE_PROB_223
            DET_EXISTENCE_PROB_224_oRDR_DETECTION_221_224_oPCAN_RADAR_cfd1b6e8_Tx: ComBitPosition=448, ComBitSize=6, ComSignalInitValue=0, ComSignalType=UINT8, ComSystemTemplateSystemSignalRef=DET_EXISTENCE_PROB_224
            DET_HVC_FLAG_221_oRDR_DETECTION_221_224_oPCAN_RADAR_83857995_Tx: ComBitPosition=86, ComBitSize=1, ComSignalInitValue=0, ComSignalType=BOOLEAN, ComSystemTemplateSystemSignalRef=DET_HVC_FLAG_221
            DET_HVC_FLAG_222_oRDR_DETECTION_221_224_oPCAN_RADAR_e765026b_Tx: ComBitPosition=198, ComBitSize=1, ComSignalInitValue=0, ComSignalType=BOOLEAN, ComSystemTemplateSystemSignalRef=DET_HVC_FLAG_222
            DET_HVC_FLAG_223_oRDR_DETECTION_221_224_oPCAN_RADAR_7215d6fe_Tx: ComBitPosition=310, ComBitSize=1, ComSignalInitValue=0, ComSignalType=BOOLEAN, ComSystemTemplateSystemSignalRef=DET_HVC_FLAG_223
            DET_HVC_FLAG_224_oRDR_DETECTION_221_224_oPCAN_RADAR_2ea5f597_Tx: ComBitPosition=422, ComBitSize=1, ComSignalInitValue=0, ComSignalType=BOOLEAN, ComSystemTemplateSystemSignalRef=DET_HVC_FLAG_224
            DET_IDM_221_oRDR_DETECTION_221_224_oPCAN_RADAR_08d74228_Tx: ComBitPosition=63, ComBitSize=1, ComSignalInitValue=0, ComSignalType=BOOLEAN, ComSystemTemplateSystemSignalRef=DET_IDM_221
            DET_IDM_222_oRDR_DETECTION_221_224_oPCAN_RADAR_6c3739d6_Tx: ComBitPosition=175, ComBitSize=1, ComSignalInitValue=0, ComSignalType=BOOLEAN, ComSystemTemplateSystemSignalRef=DET_IDM_222
            DET_IDM_223_oRDR_DETECTION_221_224_oPCAN_RADAR_f947ed43_Tx: ComBitPosition=287, ComBitSize=1, ComSignalInitValue=0, ComSignalType=BOOLEAN, ComSystemTemplateSystemSignalRef=DET_IDM_223
            DET_IDM_224_oRDR_DETECTION_221_224_oPCAN_RADAR_a5f7ce2a_Tx: ComBitPosition=399, ComBitSize=1, ComSignalInitValue=0, ComSignalType=BOOLEAN, ComSystemTemplateSystemSignalRef=DET_IDM_224
            DET_MH_CRC16_221_224_oRDR_DETECTION_221_224_oPCAN_RADAR_ebe5a284_Tx: ComBitPosition=0, ComBitSize=16, ComSignalInitValue=0, ComSignalType=UINT16, ComSystemTemplateSystemSignalRef=DET_MH_CRC16_221_224
            DET_MH_CYCLE_COUNTER_221_224_oRDR_DETECTION_221_224_oPCAN_RADAR_6f9003b3_Tx: ComBitPosition=16, ComBitSize=8, ComSignalInitValue=0, ComSignalType=UINT8, ComSystemTemplateSystemSignalRef=DET_MH_CYCLE_COUNTER_221_224
            DET_MH_SCAN_INDEX_4LSB_221_224_oRDR_DETECTION_221_224_oPCAN_RADAR_a3ba263f_Tx: ComBitPosition=476, ComBitSize=4, ComSignalInitValue=0, ComSignalType=UINT8, ComSystemTemplateSystemSignalRef=DET_MH_SCAN_INDEX_4LSB_221_224
            DET_MTD_221_oRDR_DETECTION_221_224_oPCAN_RADAR_6e6470f3_Tx: ComBitPosition=47, ComBitSize=1, ComSignalInitValue=0, ComSignalType=BOOLEAN, ComSystemTemplateSystemSignalRef=DET_MTD_221
            DET_MTD_222_oRDR_DETECTION_221_224_oPCAN_RADAR_0a840b0d_Tx: ComBitPosition=159, ComBitSize=1, ComSignalInitValue=0, ComSignalType=BOOLEAN, ComSystemTemplateSystemSignalRef=DET_MTD_222
            DET_MTD_223_oRDR_DETECTION_221_224_oPCAN_RADAR_9ff4df98_Tx: ComBitPosition=271, ComBitSize=1, ComSignalInitValue=0, ComSignalType=BOOLEAN, ComSystemTemplateSystemSignalRef=DET_MTD_223
            DET_MTD_224_oRDR_DETECTION_221_224_oPCAN_RADAR_c344fcf1_Tx: ComBitPosition=383, ComBitSize=1, ComSignalInitValue=0, ComSignalType=BOOLEAN, ComSystemTemplateSystemSignalRef=DET_MTD_224
            DET_PROB_1STAZHYPO_221_oRDR_DETECTION_221_224_oPCAN_RADAR_fdd0983e_Tx: ComBitPosition=103, ComBitSize=1, ComSignalInitValue=0, ComSignalType=BOOLEAN, ComSystemTemplateSystemSignalRef=DET_PROB_1STAZHYPO_221
            DET_PROB_1STAZHYPO_222_oRDR_DETECTION_221_224_oPCAN_RADAR_9930e3c0_Tx: ComBitPosition=215, ComBitSize=1, ComSignalInitValue=0, ComSignalType=BOOLEAN, ComSystemTemplateSystemSignalRef=DET_PROB_1STAZHYPO_222
            DET_PROB_1STAZHYPO_223_oRDR_DETECTION_221_224_oPCAN_RADAR_0c403755_Tx: ComBitPosition=327, ComBitSize=1, ComSignalInitValue=0, ComSignalType=BOOLEAN, ComSystemTemplateSystemSignalRef=DET_PROB_1STAZHYPO_223
            DET_PROB_1STAZHYPO_224_oRDR_DETECTION_221_224_oPCAN_RADAR_50f0143c_Tx: ComBitPosition=439, ComBitSize=1, ComSignalInitValue=0, ComSignalType=BOOLEAN, ComSystemTemplateSystemSignalRef=DET_PROB_1STAZHYPO_224
            DET_RANGE_221_oRDR_DETECTION_221_224_oPCAN_RADAR_f67f7b48_Tx: ComBitPosition=24, ComBitSize=15, ComSignalInitValue=0, ComSignalType=UINT16, ComSystemTemplateSystemSignalRef=DET_RANGE_221
            DET_RANGE_222_oRDR_DETECTION_221_224_oPCAN_RADAR_929f00b6_Tx: ComBitPosition=136, ComBitSize=15, ComSignalInitValue=0, ComSignalType=UINT16, ComSystemTemplateSystemSignalRef=DET_RANGE_222
            DET_RANGE_223_oRDR_DETECTION_221_224_oPCAN_RADAR_07efd423_Tx: ComBitPosition=248, ComBitSize=15, ComSignalInitValue=0, ComSignalType=UINT16, ComSystemTemplateSystemSignalRef=DET_RANGE_223
            DET_RANGE_224_oRDR_DETECTION_221_224_oPCAN_RADAR_5b5ff74a_Tx: ComBitPosition=360, ComBitSize=15, ComSignalInitValue=0, ComSignalType=UINT16, ComSystemTemplateSystemSignalRef=DET_RANGE_224
            DET_RANGE_ERR_221_oRDR_DETECTION_221_224_oPCAN_RADAR_5197c121_Tx: ComBitPosition=40, ComBitSize=7, ComSignalInitValue=0, ComSignalType=UINT8, ComSystemTemplateSystemSignalRef=DET_RANGE_ERR_221
            DET_RANGE_ERR_222_oRDR_DETECTION_221_224_oPCAN_RADAR_3577badf_Tx: ComBitPosition=152, ComBitSize=7, ComSignalInitValue=0, ComSignalType=UINT8, ComSystemTemplateSystemSignalRef=DET_RANGE_ERR_222
            DET_RANGE_ERR_223_oRDR_DETECTION_221_224_oPCAN_RADAR_a0076e4a_Tx: ComBitPosition=264, ComBitSize=7, ComSignalInitValue=0, ComSignalType=UINT8, ComSystemTemplateSystemSignalRef=DET_RANGE_ERR_223
            DET_RANGE_ERR_224_oRDR_DETECTION_221_224_oPCAN_RADAR_fcb74d23_Tx: ComBitPosition=376, ComBitSize=7, ComSignalInitValue=0, ComSignalType=UINT8, ComSystemTemplateSystemSignalRef=DET_RANGE_ERR_224
            DET_RANGE_VELOCITY_221_oRDR_DETECTION_221_224_oPCAN_RADAR_83d9b96d_Tx: ComBitPosition=48, ComBitSize=15, ComSignalInitValue=16384, ComSignalType=UINT16, ComSystemTemplateSystemSignalRef=DET_RANGE_VELOCITY_221
            DET_RANGE_VELOCITY_222_oRDR_DETECTION_221_224_oPCAN_RADAR_e739c293_Tx: ComBitPosition=160, ComBitSize=15, ComSignalInitValue=16384, ComSignalType=UINT16, ComSystemTemplateSystemSignalRef=DET_RANGE_VELOCITY_222
            DET_RANGE_VELOCITY_223_oRDR_DETECTION_221_224_oPCAN_RADAR_72491606_Tx: ComBitPosition=272, ComBitSize=15, ComSignalInitValue=16384, ComSignalType=UINT16, ComSystemTemplateSystemSignalRef=DET_RANGE_VELOCITY_223
            DET_RANGE_VELOCITY_224_oRDR_DETECTION_221_224_oPCAN_RADAR_2ef9356f_Tx: ComBitPosition=384, ComBitSize=15, ComSignalInitValue=16384, ComSignalType=UINT16, ComSystemTemplateSystemSignalRef=DET_RANGE_VELOCITY_224
            DET_RANGE_VELOCITY_ERR_221_oRDR_DETECTION_221_224_oPCAN_RADAR_8c6242df_Tx: ComBitPosition=64, ComBitSize=8, ComSignalInitValue=0, ComSignalType=UINT8, ComSystemTemplateSystemSignalRef=DET_RANGE_VELOCITY_ERR_221
            DET_RANGE_VELOCITY_ERR_222_oRDR_DETECTION_221_224_oPCAN_RADAR_e8823921_Tx: ComBitPosition=176, ComBitSize=8, ComSignalInitValue=0, ComSignalType=UINT8, ComSystemTemplateSystemSignalRef=DET_RANGE_VELOCITY_ERR_222
            DET_RANGE_VELOCITY_ERR_223_oRDR_DETECTION_221_224_oPCAN_RADAR_7df2edb4_Tx: ComBitPosition=288, ComBitSize=8, ComSignalInitValue=0, ComSignalType=UINT8, ComSystemTemplateSystemSignalRef=DET_RANGE_VELOCITY_ERR_223
            DET_RANGE_VELOCITY_ERR_224_oRDR_DETECTION_221_224_oPCAN_RADAR_2142cedd_Tx: ComBitPosition=400, ComBitSize=8, ComSignalInitValue=0, ComSignalType=UINT8, ComSystemTemplateSystemSignalRef=DET_RANGE_VELOCITY_ERR_224
            DET_RCS_221_oRDR_DETECTION_221_224_oPCAN_RADAR_04598e37_Tx: ComBitPosition=128, ComBitSize=8, ComSignalInitValue=128, ComSignalType=UINT8, ComSystemTemplateSystemSignalRef=DET_RCS_221
            DET_RCS_222_oRDR_DETECTION_221_224_oPCAN_RADAR_60b9f5c9_Tx: ComBitPosition=240, ComBitSize=8, ComSignalInitValue=128, ComSignalType=UINT8, ComSystemTemplateSystemSignalRef=DET_RCS_222
            DET_RCS_223_oRDR_DETECTION_221_224_oPCAN_RADAR_f5c9215c_Tx: ComBitPosition=352, ComBitSize=8, ComSignalInitValue=128, ComSignalType=UINT8, ComSystemTemplateSystemSignalRef=DET_RCS_223
            DET_RCS_224_oRDR_DETECTION_221_224_oPCAN_RADAR_a9790235_Tx: ComBitPosition=464, ComBitSize=8, ComSignalInitValue=128, ComSignalType=UINT8, ComSystemTemplateSystemSignalRef=DET_RCS_224
            DET_SNR_221_oRDR_DETECTION_221_224_oPCAN_RADAR_d9f7da35_Tx: ComBitPosition=120, ComBitSize=8, ComSignalInitValue=0, ComSignalType=UINT8, ComSystemTemplateSystemSignalRef=DET_SNR_221
            DET_SNR_222_oRDR_DETECTION_221_224_oPCAN_RADAR_bd17a1cb_Tx: ComBitPosition=232, ComBitSize=8, ComSignalInitValue=0, ComSignalType=UINT8, ComSystemTemplateSystemSignalRef=DET_SNR_222
            DET_SNR_223_oRDR_DETECTION_221_224_oPCAN_RADAR_2867755e_Tx: ComBitPosition=344, ComBitSize=8, ComSignalInitValue=0, ComSignalType=UINT8, ComSystemTemplateSystemSignalRef=DET_SNR_223
            DET_SNR_224_oRDR_DETECTION_221_224_oPCAN_RADAR_74d75637_Tx: ComBitPosition=456, ComBitSize=8, ComSignalInitValue=0, ComSignalType=UINT8, ComSystemTemplateSystemSignalRef=DET_SNR_224
            DET_SUPER_RES_TARGET_221_oRDR_DETECTION_221_224_oPCAN_RADAR_e86ef250_Tx: ComBitPosition=87, ComBitSize=1, ComSignalInitValue=0, ComSignalType=BOOLEAN, ComSystemTemplateSystemSignalRef=DET_SUPER_RES_TARGET_221
            DET_SUPER_RES_TARGET_222_oRDR_DETECTION_221_224_oPCAN_RADAR_8c8e89ae_Tx: ComBitPosition=199, ComBitSize=1, ComSignalInitValue=0, ComSignalType=BOOLEAN, ComSystemTemplateSystemSignalRef=DET_SUPER_RES_TARGET_222
            DET_SUPER_RES_TARGET_223_oRDR_DETECTION_221_224_oPCAN_RADAR_19fe5d3b_Tx: ComBitPosition=311, ComBitSize=1, ComSignalInitValue=0, ComSignalType=BOOLEAN, ComSystemTemplateSystemSignalRef=DET_SUPER_RES_TARGET_223
            DET_SUPER_RES_TARGET_224_oRDR_DETECTION_221_224_oPCAN_RADAR_454e7e52_Tx: ComBitPosition=423, ComBitSize=1, ComSignalInitValue=0, ComSignalType=BOOLEAN, ComSystemTemplateSystemSignalRef=DET_SUPER_RES_TARGET_224
        SG_Detections_225_228_oRDR_DETECTION_225_228_oPCAN_RADAR_1eae44dd_Tx: ComSystemTemplateSignalGroupRef=SG_Detections_225_228
          83 x ComGroupSignal, all with ComSignalEndianness=LITTLE_ENDIAN, ComTransferProperty=PENDING:
            DET_AZIMUTH_225_oRDR_DETECTION_225_228_oPCAN_RADAR_3706ce50_Tx: ComBitPosition=88, ComBitSize=13, ComSignalInitValue=0, ComSignalType=UINT16, ComSystemTemplateSystemSignalRef=DET_AZIMUTH_225
            DET_AZIMUTH_226_oRDR_DETECTION_225_228_oPCAN_RADAR_53e6b5ae_Tx: ComBitPosition=200, ComBitSize=13, ComSignalInitValue=0, ComSignalType=UINT16, ComSystemTemplateSystemSignalRef=DET_AZIMUTH_226
            DET_AZIMUTH_227_oRDR_DETECTION_225_228_oPCAN_RADAR_c696613b_Tx: ComBitPosition=312, ComBitSize=13, ComSignalInitValue=0, ComSignalType=UINT16, ComSystemTemplateSystemSignalRef=DET_AZIMUTH_227
            DET_AZIMUTH_228_oRDR_DETECTION_225_228_oPCAN_RADAR_ea86f37c_Tx: ComBitPosition=424, ComBitSize=13, ComSignalInitValue=0, ComSignalType=UINT16, ComSystemTemplateSystemSignalRef=DET_AZIMUTH_228
            DET_AZIMUTH_ERR_225_oRDR_DETECTION_225_228_oPCAN_RADAR_93b35ba5_Tx: ComBitPosition=105, ComBitSize=7, ComSignalInitValue=0, ComSignalType=UINT8, ComSystemTemplateSystemSignalRef=DET_AZIMUTH_ERR_225
            DET_AZIMUTH_ERR_226_oRDR_DETECTION_225_228_oPCAN_RADAR_f753205b_Tx: ComBitPosition=217, ComBitSize=7, ComSignalInitValue=0, ComSignalType=UINT8, ComSystemTemplateSystemSignalRef=DET_AZIMUTH_ERR_226
            DET_AZIMUTH_ERR_227_oRDR_DETECTION_225_228_oPCAN_RADAR_6223f4ce_Tx: ComBitPosition=329, ComBitSize=7, ComSignalInitValue=0, ComSignalType=UINT8, ComSystemTemplateSystemSignalRef=DET_AZIMUTH_ERR_227
            DET_AZIMUTH_ERR_228_oRDR_DETECTION_225_228_oPCAN_RADAR_4e336689_Tx: ComBitPosition=441, ComBitSize=7, ComSignalInitValue=0, ComSignalType=UINT8, ComSystemTemplateSystemSignalRef=DET_AZIMUTH_ERR_228
            DET_BELOW_RAIN_THOLD_225_oRDR_DETECTION_225_228_oPCAN_RADAR_e2075d90_Tx: ComBitPosition=39, ComBitSize=1, ComSignalInitValue=0, ComSignalType=BOOLEAN, ComSystemTemplateSystemSignalRef=DET_BELOW_RAIN_THOLD_225
            DET_BELOW_RAIN_THOLD_226_oRDR_DETECTION_225_228_oPCAN_RADAR_86e7266e_Tx: ComBitPosition=151, ComBitSize=1, ComSignalInitValue=0, ComSignalType=BOOLEAN, ComSystemTemplateSystemSignalRef=DET_BELOW_RAIN_THOLD_226
            DET_BELOW_RAIN_THOLD_227_oRDR_DETECTION_225_228_oPCAN_RADAR_1397f2fb_Tx: ComBitPosition=263, ComBitSize=1, ComSignalInitValue=0, ComSignalType=BOOLEAN, ComSystemTemplateSystemSignalRef=DET_BELOW_RAIN_THOLD_227
            DET_BELOW_RAIN_THOLD_228_oRDR_DETECTION_225_228_oPCAN_RADAR_3f8760bc_Tx: ComBitPosition=375, ComBitSize=1, ComSignalInitValue=0, ComSignalType=BOOLEAN, ComSystemTemplateSystemSignalRef=DET_BELOW_RAIN_THOLD_228
            DET_BI_STATIC_FLAG_225_oRDR_DETECTION_225_228_oPCAN_RADAR_612a8ed5_Tx: ComBitPosition=104, ComBitSize=1, ComSignalInitValue=0, ComSignalType=BOOLEAN, ComSystemTemplateSystemSignalRef=DET_BI_STATIC_FLAG_225
            DET_BI_STATIC_FLAG_226_oRDR_DETECTION_225_228_oPCAN_RADAR_05caf52b_Tx: ComBitPosition=216, ComBitSize=1, ComSignalInitValue=0, ComSignalType=BOOLEAN, ComSystemTemplateSystemSignalRef=DET_BI_STATIC_FLAG_226
            DET_BI_STATIC_FLAG_227_oRDR_DETECTION_225_228_oPCAN_RADAR_90ba21be_Tx: ComBitPosition=328, ComBitSize=1, ComSignalInitValue=0, ComSignalType=BOOLEAN, ComSystemTemplateSystemSignalRef=DET_BI_STATIC_FLAG_227
            DET_BI_STATIC_FLAG_228_oRDR_DETECTION_225_228_oPCAN_RADAR_bcaab3f9_Tx: ComBitPosition=440, ComBitSize=1, ComSignalInitValue=0, ComSignalType=BOOLEAN, ComSystemTemplateSystemSignalRef=DET_BI_STATIC_FLAG_228
            DET_CONFD_AZIMUTH_225_oRDR_DETECTION_225_228_oPCAN_RADAR_35e0c49a_Tx: ComBitPosition=118, ComBitSize=2, ComSignalInitValue=0, ComSignalType=UINT8, ComSystemTemplateSystemSignalRef=DET_CONFD_AZIMUTH_225
            DET_CONFD_AZIMUTH_226_oRDR_DETECTION_225_228_oPCAN_RADAR_5100bf64_Tx: ComBitPosition=230, ComBitSize=2, ComSignalInitValue=0, ComSignalType=UINT8, ComSystemTemplateSystemSignalRef=DET_CONFD_AZIMUTH_226
            DET_CONFD_AZIMUTH_227_oRDR_DETECTION_225_228_oPCAN_RADAR_c4706bf1_Tx: ComBitPosition=342, ComBitSize=2, ComSignalInitValue=0, ComSignalType=UINT8, ComSystemTemplateSystemSignalRef=DET_CONFD_AZIMUTH_227
            DET_CONFD_AZIMUTH_228_oRDR_DETECTION_225_228_oPCAN_RADAR_e860f9b6_Tx: ComBitPosition=454, ComBitSize=2, ComSignalInitValue=0, ComSignalType=UINT8, ComSystemTemplateSystemSignalRef=DET_CONFD_AZIMUTH_228
            DET_CONFD_ELEVATION_225_oRDR_DETECTION_225_228_oPCAN_RADAR_3775c560_Tx: ComBitPosition=101, ComBitSize=2, ComSignalInitValue=0, ComSignalType=UINT8, ComSystemTemplateSystemSignalRef=DET_CONFD_ELEVATION_225
            DET_CONFD_ELEVATION_226_oRDR_DETECTION_225_228_oPCAN_RADAR_5395be9e_Tx: ComBitPosition=213, ComBitSize=2, ComSignalInitValue=0, ComSignalType=UINT8, ComSystemTemplateSystemSignalRef=DET_CONFD_ELEVATION_226
            DET_CONFD_ELEVATION_227_oRDR_DETECTION_225_228_oPCAN_RADAR_c6e56a0b_Tx: ComBitPosition=325, ComBitSize=2, ComSignalInitValue=0, ComSignalType=UINT8, ComSystemTemplateSystemSignalRef=DET_CONFD_ELEVATION_227
            DET_CONFD_ELEVATION_228_oRDR_DETECTION_225_228_oPCAN_RADAR_eaf5f84c_Tx: ComBitPosition=437, ComBitSize=2, ComSignalInitValue=0, ComSignalType=UINT8, ComSystemTemplateSystemSignalRef=DET_CONFD_ELEVATION_228
            DET_ELEVATION_225_oRDR_DETECTION_225_228_oPCAN_RADAR_e6b5115c_Tx: ComBitPosition=72, ComBitSize=8, ComSignalInitValue=0, ComSignalType=UINT8, ComSystemTemplateSystemSignalRef=DET_ELEVATION_225
            DET_ELEVATION_226_oRDR_DETECTION_225_228_oPCAN_RADAR_82556aa2_Tx: ComBitPosition=184, ComBitSize=8, ComSignalInitValue=0, ComSignalType=UINT8, ComSystemTemplateSystemSignalRef=DET_ELEVATION_226
            DET_ELEVATION_227_oRDR_DETECTION_225_228_oPCAN_RADAR_1725be37_Tx: ComBitPosition=296, ComBitSize=8, ComSignalInitValue=0, ComSignalType=UINT8, ComSystemTemplateSystemSignalRef=DET_ELEVATION_227
            DET_ELEVATION_228_oRDR_DETECTION_225_228_oPCAN_RADAR_3b352c70_Tx: ComBitPosition=408, ComBitSize=8, ComSignalInitValue=0, ComSignalType=UINT8, ComSystemTemplateSystemSignalRef=DET_ELEVATION_228
            DET_ELEVATION_ERR_225_oRDR_DETECTION_225_228_oPCAN_RADAR_618c8929_Tx: ComBitPosition=80, ComBitSize=6, ComSignalInitValue=0, ComSignalType=UINT8, ComSystemTemplateSystemSignalRef=DET_ELEVATION_ERR_225
            DET_ELEVATION_ERR_226_oRDR_DETECTION_225_228_oPCAN_RADAR_056cf2d7_Tx: ComBitPosition=192, ComBitSize=6, ComSignalInitValue=0, ComSignalType=UINT8, ComSystemTemplateSystemSignalRef=DET_ELEVATION_ERR_226
            DET_ELEVATION_ERR_227_oRDR_DETECTION_225_228_oPCAN_RADAR_901c2642_Tx: ComBitPosition=304, ComBitSize=6, ComSignalInitValue=0, ComSignalType=UINT8, ComSystemTemplateSystemSignalRef=DET_ELEVATION_ERR_227
            DET_ELEVATION_ERR_228_oRDR_DETECTION_225_228_oPCAN_RADAR_bc0cb405_Tx: ComBitPosition=416, ComBitSize=6, ComSignalInitValue=0, ComSignalType=UINT8, ComSystemTemplateSystemSignalRef=DET_ELEVATION_ERR_228
            DET_EXISTENCE_PROB_225_oRDR_DETECTION_225_228_oPCAN_RADAR_b313fc49_Tx: ComBitPosition=112, ComBitSize=6, ComSignalInitValue=0, ComSignalType=UINT8, ComSystemTemplateSystemSignalRef=DET_EXISTENCE_PROB_225
            DET_EXISTENCE_PROB_226_oRDR_DETECTION_225_228_oPCAN_RADAR_d7f387b7_Tx: ComBitPosition=224, ComBitSize=6, ComSignalInitValue=0, ComSignalType=UINT8, ComSystemTemplateSystemSignalRef=DET_EXISTENCE_PROB_226
            DET_EXISTENCE_PROB_227_oRDR_DETECTION_225_228_oPCAN_RADAR_42835322_Tx: ComBitPosition=336, ComBitSize=6, ComSignalInitValue=0, ComSignalType=UINT8, ComSystemTemplateSystemSignalRef=DET_EXISTENCE_PROB_227
            DET_EXISTENCE_PROB_228_oRDR_DETECTION_225_228_oPCAN_RADAR_6e93c165_Tx: ComBitPosition=448, ComBitSize=6, ComSignalInitValue=0, ComSignalType=UINT8, ComSystemTemplateSystemSignalRef=DET_EXISTENCE_PROB_228
            DET_HVC_FLAG_225_oRDR_DETECTION_225_228_oPCAN_RADAR_5267bf36_Tx: ComBitPosition=86, ComBitSize=1, ComSignalInitValue=0, ComSignalType=BOOLEAN, ComSystemTemplateSystemSignalRef=DET_HVC_FLAG_225
            DET_HVC_FLAG_226_oRDR_DETECTION_225_228_oPCAN_RADAR_3687c4c8_Tx: ComBitPosition=198, ComBitSize=1, ComSignalInitValue=0, ComSignalType=BOOLEAN, ComSystemTemplateSystemSignalRef=DET_HVC_FLAG_226
            DET_HVC_FLAG_227_oRDR_DETECTION_225_228_oPCAN_RADAR_a3f7105d_Tx: ComBitPosition=310, ComBitSize=1, ComSignalInitValue=0, ComSignalType=BOOLEAN, ComSystemTemplateSystemSignalRef=DET_HVC_FLAG_227
            DET_HVC_FLAG_228_oRDR_DETECTION_225_228_oPCAN_RADAR_8fe7821a_Tx: ComBitPosition=422, ComBitSize=1, ComSignalInitValue=0, ComSignalType=BOOLEAN, ComSystemTemplateSystemSignalRef=DET_HVC_FLAG_228
            DET_IDM_225_oRDR_DETECTION_225_228_oPCAN_RADAR_d935848b_Tx: ComBitPosition=63, ComBitSize=1, ComSignalInitValue=0, ComSignalType=BOOLEAN, ComSystemTemplateSystemSignalRef=DET_IDM_225
            DET_IDM_226_oRDR_DETECTION_225_228_oPCAN_RADAR_bdd5ff75_Tx: ComBitPosition=175, ComBitSize=1, ComSignalInitValue=0, ComSignalType=BOOLEAN, ComSystemTemplateSystemSignalRef=DET_IDM_226
            DET_IDM_227_oRDR_DETECTION_225_228_oPCAN_RADAR_28a52be0_Tx: ComBitPosition=287, ComBitSize=1, ComSignalInitValue=0, ComSignalType=BOOLEAN, ComSystemTemplateSystemSignalRef=DET_IDM_227
            DET_IDM_228_oRDR_DETECTION_225_228_oPCAN_RADAR_04b5b9a7_Tx: ComBitPosition=399, ComBitSize=1, ComSignalInitValue=0, ComSignalType=BOOLEAN, ComSystemTemplateSystemSignalRef=DET_IDM_228
            DET_MH_CRC16_225_228_oRDR_DETECTION_225_228_oPCAN_RADAR_9a2696d6_Tx: ComBitPosition=0, ComBitSize=16, ComSignalInitValue=0, ComSignalType=UINT16, ComSystemTemplateSystemSignalRef=DET_MH_CRC16_225_228
            DET_MH_CYCLE_COUNTER_225_228_oRDR_DETECTION_225_228_oPCAN_RADAR_1e5337e1_Tx: ComBitPosition=16, ComBitSize=8, ComSignalInitValue=0, ComSignalType=UINT8, ComSystemTemplateSystemSignalRef=DET_MH_CYCLE_COUNTER_225_228
            DET_MH_SCAN_INDEX_4LSB_225_228_oRDR_DETECTION_225_228_oPCAN_RADAR_d279126d_Tx: ComBitPosition=476, ComBitSize=4, ComSignalInitValue=0, ComSignalType=UINT8, ComSystemTemplateSystemSignalRef=DET_MH_SCAN_INDEX_4LSB_225_228
            DET_MTD_225_oRDR_DETECTION_225_228_oPCAN_RADAR_bf86b650_Tx: ComBitPosition=47, ComBitSize=1, ComSignalInitValue=0, ComSignalType=BOOLEAN, ComSystemTemplateSystemSignalRef=DET_MTD_225
            DET_MTD_226_oRDR_DETECTION_225_228_oPCAN_RADAR_db66cdae_Tx: ComBitPosition=159, ComBitSize=1, ComSignalInitValue=0, ComSignalType=BOOLEAN, ComSystemTemplateSystemSignalRef=DET_MTD_226
            DET_MTD_227_oRDR_DETECTION_225_228_oPCAN_RADAR_4e16193b_Tx: ComBitPosition=271, ComBitSize=1, ComSignalInitValue=0, ComSignalType=BOOLEAN, ComSystemTemplateSystemSignalRef=DET_MTD_227
            DET_MTD_228_oRDR_DETECTION_225_228_oPCAN_RADAR_62068b7c_Tx: ComBitPosition=383, ComBitSize=1, ComSignalInitValue=0, ComSignalType=BOOLEAN, ComSystemTemplateSystemSignalRef=DET_MTD_228
            DET_PROB_1STAZHYPO_225_oRDR_DETECTION_225_228_oPCAN_RADAR_2c325e9d_Tx: ComBitPosition=103, ComBitSize=1, ComSignalInitValue=0, ComSignalType=BOOLEAN, ComSystemTemplateSystemSignalRef=DET_PROB_1STAZHYPO_225
            DET_PROB_1STAZHYPO_226_oRDR_DETECTION_225_228_oPCAN_RADAR_48d22563_Tx: ComBitPosition=215, ComBitSize=1, ComSignalInitValue=0, ComSignalType=BOOLEAN, ComSystemTemplateSystemSignalRef=DET_PROB_1STAZHYPO_226
            DET_PROB_1STAZHYPO_227_oRDR_DETECTION_225_228_oPCAN_RADAR_dda2f1f6_Tx: ComBitPosition=327, ComBitSize=1, ComSignalInitValue=0, ComSignalType=BOOLEAN, ComSystemTemplateSystemSignalRef=DET_PROB_1STAZHYPO_227
            DET_PROB_1STAZHYPO_228_oRDR_DETECTION_225_228_oPCAN_RADAR_f1b263b1_Tx: ComBitPosition=439, ComBitSize=1, ComSignalInitValue=0, ComSignalType=BOOLEAN, ComSystemTemplateSystemSignalRef=DET_PROB_1STAZHYPO_228
            DET_RANGE_225_oRDR_DETECTION_225_228_oPCAN_RADAR_279dbdeb_Tx: ComBitPosition=24, ComBitSize=15, ComSignalInitValue=0, ComSignalType=UINT16, ComSystemTemplateSystemSignalRef=DET_RANGE_225
            DET_RANGE_226_oRDR_DETECTION_225_228_oPCAN_RADAR_437dc615_Tx: ComBitPosition=136, ComBitSize=15, ComSignalInitValue=0, ComSignalType=UINT16, ComSystemTemplateSystemSignalRef=DET_RANGE_226
            DET_RANGE_227_oRDR_DETECTION_225_228_oPCAN_RADAR_d60d1280_Tx: ComBitPosition=248, ComBitSize=15, ComSignalInitValue=0, ComSignalType=UINT16, ComSystemTemplateSystemSignalRef=DET_RANGE_227
            DET_RANGE_228_oRDR_DETECTION_225_228_oPCAN_RADAR_fa1d80c7_Tx: ComBitPosition=360, ComBitSize=15, ComSignalInitValue=0, ComSignalType=UINT16, ComSystemTemplateSystemSignalRef=DET_RANGE_228
            DET_RANGE_ERR_225_oRDR_DETECTION_225_228_oPCAN_RADAR_80750782_Tx: ComBitPosition=40, ComBitSize=7, ComSignalInitValue=0, ComSignalType=UINT8, ComSystemTemplateSystemSignalRef=DET_RANGE_ERR_225
            DET_RANGE_ERR_226_oRDR_DETECTION_225_228_oPCAN_RADAR_e4957c7c_Tx: ComBitPosition=152, ComBitSize=7, ComSignalInitValue=0, ComSignalType=UINT8, ComSystemTemplateSystemSignalRef=DET_RANGE_ERR_226
            DET_RANGE_ERR_227_oRDR_DETECTION_225_228_oPCAN_RADAR_71e5a8e9_Tx: ComBitPosition=264, ComBitSize=7, ComSignalInitValue=0, ComSignalType=UINT8, ComSystemTemplateSystemSignalRef=DET_RANGE_ERR_227
            DET_RANGE_ERR_228_oRDR_DETECTION_225_228_oPCAN_RADAR_5df53aae_Tx: ComBitPosition=376, ComBitSize=7, ComSignalInitValue=0, ComSignalType=UINT8, ComSystemTemplateSystemSignalRef=DET_RANGE_ERR_228
            DET_RANGE_VELOCITY_225_oRDR_DETECTION_225_228_oPCAN_RADAR_523b7fce_Tx: ComBitPosition=48, ComBitSize=15, ComSignalInitValue=16384, ComSignalType=UINT16, ComSystemTemplateSystemSignalRef=DET_RANGE_VELOCITY_225
            DET_RANGE_VELOCITY_226_oRDR_DETECTION_225_228_oPCAN_RADAR_36db0430_Tx: ComBitPosition=160, ComBitSize=15, ComSignalInitValue=16384, ComSignalType=UINT16, ComSystemTemplateSystemSignalRef=DET_RANGE_VELOCITY_226
            DET_RANGE_VELOCITY_227_oRDR_DETECTION_225_228_oPCAN_RADAR_a3abd0a5_Tx: ComBitPosition=272, ComBitSize=15, ComSignalInitValue=16384, ComSignalType=UINT16, ComSystemTemplateSystemSignalRef=DET_RANGE_VELOCITY_227
            DET_RANGE_VELOCITY_228_oRDR_DETECTION_225_228_oPCAN_RADAR_8fbb42e2_Tx: ComBitPosition=384, ComBitSize=15, ComSignalInitValue=16384, ComSignalType=UINT16, ComSystemTemplateSystemSignalRef=DET_RANGE_VELOCITY_228
            DET_RANGE_VELOCITY_ERR_225_oRDR_DETECTION_225_228_oPCAN_RADAR_5d80847c_Tx: ComBitPosition=64, ComBitSize=8, ComSignalInitValue=0, ComSignalType=UINT8, ComSystemTemplateSystemSignalRef=DET_RANGE_VELOCITY_ERR_225
            DET_RANGE_VELOCITY_ERR_226_oRDR_DETECTION_225_228_oPCAN_RADAR_3960ff82_Tx: ComBitPosition=176, ComBitSize=8, ComSignalInitValue=0, ComSignalType=UINT8, ComSystemTemplateSystemSignalRef=DET_RANGE_VELOCITY_ERR_226
            DET_RANGE_VELOCITY_ERR_227_oRDR_DETECTION_225_228_oPCAN_RADAR_ac102b17_Tx: ComBitPosition=288, ComBitSize=8, ComSignalInitValue=0, ComSignalType=UINT8, ComSystemTemplateSystemSignalRef=DET_RANGE_VELOCITY_ERR_227
            DET_RANGE_VELOCITY_ERR_228_oRDR_DETECTION_225_228_oPCAN_RADAR_8000b950_Tx: ComBitPosition=400, ComBitSize=8, ComSignalInitValue=0, ComSignalType=UINT8, ComSystemTemplateSystemSignalRef=DET_RANGE_VELOCITY_ERR_228
            DET_RCS_225_oRDR_DETECTION_225_228_oPCAN_RADAR_d5bb4894_Tx: ComBitPosition=128, ComBitSize=8, ComSignalInitValue=128, ComSignalType=UINT8, ComSystemTemplateSystemSignalRef=DET_RCS_225
            DET_RCS_226_oRDR_DETECTION_225_228_oPCAN_RADAR_b15b336a_Tx: ComBitPosition=240, ComBitSize=8, ComSignalInitValue=128, ComSignalType=UINT8, ComSystemTemplateSystemSignalRef=DET_RCS_226
            DET_RCS_227_oRDR_DETECTION_225_228_oPCAN_RADAR_242be7ff_Tx: ComBitPosition=352, ComBitSize=8, ComSignalInitValue=128, ComSignalType=UINT8, ComSystemTemplateSystemSignalRef=DET_RCS_227
            DET_RCS_228_oRDR_DETECTION_225_228_oPCAN_RADAR_083b75b8_Tx: ComBitPosition=464, ComBitSize=8, ComSignalInitValue=128, ComSignalType=UINT8, ComSystemTemplateSystemSignalRef=DET_RCS_228
            DET_SNR_225_oRDR_DETECTION_225_228_oPCAN_RADAR_08151c96_Tx: ComBitPosition=120, ComBitSize=8, ComSignalInitValue=0, ComSignalType=UINT8, ComSystemTemplateSystemSignalRef=DET_SNR_225
            DET_SNR_226_oRDR_DETECTION_225_228_oPCAN_RADAR_6cf56768_Tx: ComBitPosition=232, ComBitSize=8, ComSignalInitValue=0, ComSignalType=UINT8, ComSystemTemplateSystemSignalRef=DET_SNR_226
            DET_SNR_227_oRDR_DETECTION_225_228_oPCAN_RADAR_f985b3fd_Tx: ComBitPosition=344, ComBitSize=8, ComSignalInitValue=0, ComSignalType=UINT8, ComSystemTemplateSystemSignalRef=DET_SNR_227
            DET_SNR_228_oRDR_DETECTION_225_228_oPCAN_RADAR_d59521ba_Tx: ComBitPosition=456, ComBitSize=8, ComSignalInitValue=0, ComSignalType=UINT8, ComSystemTemplateSystemSignalRef=DET_SNR_228
            DET_SUPER_RES_TARGET_225_oRDR_DETECTION_225_228_oPCAN_RADAR_398c34f3_Tx: ComBitPosition=87, ComBitSize=1, ComSignalInitValue=0, ComSignalType=BOOLEAN, ComSystemTemplateSystemSignalRef=DET_SUPER_RES_TARGET_225
            DET_SUPER_RES_TARGET_226_oRDR_DETECTION_225_228_oPCAN_RADAR_5d6c4f0d_Tx: ComBitPosition=199, ComBitSize=1, ComSignalInitValue=0, ComSignalType=BOOLEAN, ComSystemTemplateSystemSignalRef=DET_SUPER_RES_TARGET_226
            DET_SUPER_RES_TARGET_227_oRDR_DETECTION_225_228_oPCAN_RADAR_c81c9b98_Tx: ComBitPosition=311, ComBitSize=1, ComSignalInitValue=0, ComSignalType=BOOLEAN, ComSystemTemplateSystemSignalRef=DET_SUPER_RES_TARGET_227
            DET_SUPER_RES_TARGET_228_oRDR_DETECTION_225_228_oPCAN_RADAR_e40c09df_Tx: ComBitPosition=423, ComBitSize=1, ComSignalInitValue=0, ComSignalType=BOOLEAN, ComSystemTemplateSystemSignalRef=DET_SUPER_RES_TARGET_228
        SG_Detections_229_232_oRDR_DETECTION_229_232_oPCAN_RADAR_87d460a6_Tx: ComSystemTemplateSignalGroupRef=SG_Detections_229_232
          83 x ComGroupSignal, all with ComSignalEndianness=LITTLE_ENDIAN, ComTransferProperty=PENDING:
            DET_AZIMUTH_229_oRDR_DETECTION_229_232_oPCAN_RADAR_4dbec8e8_Tx: ComBitPosition=88, ComBitSize=13, ComSignalInitValue=0, ComSignalType=UINT16, ComSystemTemplateSystemSignalRef=DET_AZIMUTH_229
            DET_AZIMUTH_230_oRDR_DETECTION_229_232_oPCAN_RADAR_289eba4c_Tx: ComBitPosition=200, ComBitSize=13, ComSignalInitValue=0, ComSignalType=UINT16, ComSystemTemplateSystemSignalRef=DET_AZIMUTH_230
            DET_AZIMUTH_231_oRDR_DETECTION_229_232_oPCAN_RADAR_bdee6ed9_Tx: ComBitPosition=312, ComBitSize=13, ComSignalInitValue=0, ComSignalType=UINT16, ComSystemTemplateSystemSignalRef=DET_AZIMUTH_231
            DET_AZIMUTH_232_oRDR_DETECTION_229_232_oPCAN_RADAR_d90e1527_Tx: ComBitPosition=424, ComBitSize=13, ComSignalInitValue=0, ComSignalType=UINT16, ComSystemTemplateSystemSignalRef=DET_AZIMUTH_232
            DET_AZIMUTH_ERR_229_oRDR_DETECTION_229_232_oPCAN_RADAR_e90b5d1d_Tx: ComBitPosition=105, ComBitSize=7, ComSignalInitValue=0, ComSignalType=UINT8, ComSystemTemplateSystemSignalRef=DET_AZIMUTH_ERR_229
            DET_AZIMUTH_ERR_230_oRDR_DETECTION_229_232_oPCAN_RADAR_8c2b2fb9_Tx: ComBitPosition=217, ComBitSize=7, ComSignalInitValue=0, ComSignalType=UINT8, ComSystemTemplateSystemSignalRef=DET_AZIMUTH_ERR_230
            DET_AZIMUTH_ERR_231_oRDR_DETECTION_229_232_oPCAN_RADAR_195bfb2c_Tx: ComBitPosition=329, ComBitSize=7, ComSignalInitValue=0, ComSignalType=UINT8, ComSystemTemplateSystemSignalRef=DET_AZIMUTH_ERR_231
            DET_AZIMUTH_ERR_232_oRDR_DETECTION_229_232_oPCAN_RADAR_7dbb80d2_Tx: ComBitPosition=441, ComBitSize=7, ComSignalInitValue=0, ComSignalType=UINT8, ComSystemTemplateSystemSignalRef=DET_AZIMUTH_ERR_232
            DET_BELOW_RAIN_THOLD_229_oRDR_DETECTION_229_232_oPCAN_RADAR_98bf5b28_Tx: ComBitPosition=39, ComBitSize=1, ComSignalInitValue=0, ComSignalType=BOOLEAN, ComSystemTemplateSystemSignalRef=DET_BELOW_RAIN_THOLD_229
            DET_BELOW_RAIN_THOLD_230_oRDR_DETECTION_229_232_oPCAN_RADAR_fd9f298c_Tx: ComBitPosition=151, ComBitSize=1, ComSignalInitValue=0, ComSignalType=BOOLEAN, ComSystemTemplateSystemSignalRef=DET_BELOW_RAIN_THOLD_230
            DET_BELOW_RAIN_THOLD_231_oRDR_DETECTION_229_232_oPCAN_RADAR_68effd19_Tx: ComBitPosition=263, ComBitSize=1, ComSignalInitValue=0, ComSignalType=BOOLEAN, ComSystemTemplateSystemSignalRef=DET_BELOW_RAIN_THOLD_231
            DET_BELOW_RAIN_THOLD_232_oRDR_DETECTION_229_232_oPCAN_RADAR_0c0f86e7_Tx: ComBitPosition=375, ComBitSize=1, ComSignalInitValue=0, ComSignalType=BOOLEAN, ComSystemTemplateSystemSignalRef=DET_BELOW_RAIN_THOLD_232
            DET_BI_STATIC_FLAG_229_oRDR_DETECTION_229_232_oPCAN_RADAR_1b92886d_Tx: ComBitPosition=104, ComBitSize=1, ComSignalInitValue=0, ComSignalType=BOOLEAN, ComSystemTemplateSystemSignalRef=DET_BI_STATIC_FLAG_229
            DET_BI_STATIC_FLAG_230_oRDR_DETECTION_229_232_oPCAN_RADAR_7eb2fac9_Tx: ComBitPosition=216, ComBitSize=1, ComSignalInitValue=0, ComSignalType=BOOLEAN, ComSystemTemplateSystemSignalRef=DET_BI_STATIC_FLAG_230
            DET_BI_STATIC_FLAG_231_oRDR_DETECTION_229_232_oPCAN_RADAR_ebc22e5c_Tx: ComBitPosition=328, ComBitSize=1, ComSignalInitValue=0, ComSignalType=BOOLEAN, ComSystemTemplateSystemSignalRef=DET_BI_STATIC_FLAG_231
            DET_BI_STATIC_FLAG_232_oRDR_DETECTION_229_232_oPCAN_RADAR_8f2255a2_Tx: ComBitPosition=440, ComBitSize=1, ComSignalInitValue=0, ComSignalType=BOOLEAN, ComSystemTemplateSystemSignalRef=DET_BI_STATIC_FLAG_232
            DET_CONFD_AZIMUTH_229_oRDR_DETECTION_229_232_oPCAN_RADAR_4f58c222_Tx: ComBitPosition=118, ComBitSize=2, ComSignalInitValue=0, ComSignalType=UINT8, ComSystemTemplateSystemSignalRef=DET_CONFD_AZIMUTH_229
            DET_CONFD_AZIMUTH_230_oRDR_DETECTION_229_232_oPCAN_RADAR_2a78b086_Tx: ComBitPosition=230, ComBitSize=2, ComSignalInitValue=0, ComSignalType=UINT8, ComSystemTemplateSystemSignalRef=DET_CONFD_AZIMUTH_230
            DET_CONFD_AZIMUTH_231_oRDR_DETECTION_229_232_oPCAN_RADAR_bf086413_Tx: ComBitPosition=342, ComBitSize=2, ComSignalInitValue=0, ComSignalType=UINT8, ComSystemTemplateSystemSignalRef=DET_CONFD_AZIMUTH_231
            DET_CONFD_AZIMUTH_232_oRDR_DETECTION_229_232_oPCAN_RADAR_dbe81fed_Tx: ComBitPosition=454, ComBitSize=2, ComSignalInitValue=0, ComSignalType=UINT8, ComSystemTemplateSystemSignalRef=DET_CONFD_AZIMUTH_232
            DET_CONFD_ELEVATION_229_oRDR_DETECTION_229_232_oPCAN_RADAR_4dcdc3d8_Tx: ComBitPosition=101, ComBitSize=2, ComSignalInitValue=0, ComSignalType=UINT8, ComSystemTemplateSystemSignalRef=DET_CONFD_ELEVATION_229
            DET_CONFD_ELEVATION_230_oRDR_DETECTION_229_232_oPCAN_RADAR_28edb17c_Tx: ComBitPosition=213, ComBitSize=2, ComSignalInitValue=0, ComSignalType=UINT8, ComSystemTemplateSystemSignalRef=DET_CONFD_ELEVATION_230
            DET_CONFD_ELEVATION_231_oRDR_DETECTION_229_232_oPCAN_RADAR_bd9d65e9_Tx: ComBitPosition=325, ComBitSize=2, ComSignalInitValue=0, ComSignalType=UINT8, ComSystemTemplateSystemSignalRef=DET_CONFD_ELEVATION_231
            DET_CONFD_ELEVATION_232_oRDR_DETECTION_229_232_oPCAN_RADAR_d97d1e17_Tx: ComBitPosition=437, ComBitSize=2, ComSignalInitValue=0, ComSignalType=UINT8, ComSystemTemplateSystemSignalRef=DET_CONFD_ELEVATION_232
            DET_ELEVATION_229_oRDR_DETECTION_229_232_oPCAN_RADAR_9c0d17e4_Tx: ComBitPosition=72, ComBitSize=8, ComSignalInitValue=0, ComSignalType=UINT8, ComSystemTemplateSystemSignalRef=DET_ELEVATION_229
            DET_ELEVATION_230_oRDR_DETECTION_229_232_oPCAN_RADAR_f92d6540_Tx: ComBitPosition=184, ComBitSize=8, ComSignalInitValue=0, ComSignalType=UINT8, ComSystemTemplateSystemSignalRef=DET_ELEVATION_230
            DET_ELEVATION_231_oRDR_DETECTION_229_232_oPCAN_RADAR_6c5db1d5_Tx: ComBitPosition=296, ComBitSize=8, ComSignalInitValue=0, ComSignalType=UINT8, ComSystemTemplateSystemSignalRef=DET_ELEVATION_231
            DET_ELEVATION_232_oRDR_DETECTION_229_232_oPCAN_RADAR_08bdca2b_Tx: ComBitPosition=408, ComBitSize=8, ComSignalInitValue=0, ComSignalType=UINT8, ComSystemTemplateSystemSignalRef=DET_ELEVATION_232
            DET_ELEVATION_ERR_229_oRDR_DETECTION_229_232_oPCAN_RADAR_1b348f91_Tx: ComBitPosition=80, ComBitSize=6, ComSignalInitValue=0, ComSignalType=UINT8, ComSystemTemplateSystemSignalRef=DET_ELEVATION_ERR_229
            DET_ELEVATION_ERR_230_oRDR_DETECTION_229_232_oPCAN_RADAR_7e14fd35_Tx: ComBitPosition=192, ComBitSize=6, ComSignalInitValue=0, ComSignalType=UINT8, ComSystemTemplateSystemSignalRef=DET_ELEVATION_ERR_230
            DET_ELEVATION_ERR_231_oRDR_DETECTION_229_232_oPCAN_RADAR_eb6429a0_Tx: ComBitPosition=304, ComBitSize=6, ComSignalInitValue=0, ComSignalType=UINT8, ComSystemTemplateSystemSignalRef=DET_ELEVATION_ERR_231
            DET_ELEVATION_ERR_232_oRDR_DETECTION_229_232_oPCAN_RADAR_8f84525e_Tx: ComBitPosition=416, ComBitSize=6, ComSignalInitValue=0, ComSignalType=UINT8, ComSystemTemplateSystemSignalRef=DET_ELEVATION_ERR_232
            DET_EXISTENCE_PROB_229_oRDR_DETECTION_229_232_oPCAN_RADAR_c9abfaf1_Tx: ComBitPosition=112, ComBitSize=6, ComSignalInitValue=0, ComSignalType=UINT8, ComSystemTemplateSystemSignalRef=DET_EXISTENCE_PROB_229
            DET_EXISTENCE_PROB_230_oRDR_DETECTION_229_232_oPCAN_RADAR_ac8b8855_Tx: ComBitPosition=224, ComBitSize=6, ComSignalInitValue=0, ComSignalType=UINT8, ComSystemTemplateSystemSignalRef=DET_EXISTENCE_PROB_230
            DET_EXISTENCE_PROB_231_oRDR_DETECTION_229_232_oPCAN_RADAR_39fb5cc0_Tx: ComBitPosition=336, ComBitSize=6, ComSignalInitValue=0, ComSignalType=UINT8, ComSystemTemplateSystemSignalRef=DET_EXISTENCE_PROB_231
            DET_EXISTENCE_PROB_232_oRDR_DETECTION_229_232_oPCAN_RADAR_5d1b273e_Tx: ComBitPosition=448, ComBitSize=6, ComSignalInitValue=0, ComSignalType=UINT8, ComSystemTemplateSystemSignalRef=DET_EXISTENCE_PROB_232
            DET_HVC_FLAG_229_oRDR_DETECTION_229_232_oPCAN_RADAR_28dfb98e_Tx: ComBitPosition=86, ComBitSize=1, ComSignalInitValue=0, ComSignalType=BOOLEAN, ComSystemTemplateSystemSignalRef=DET_HVC_FLAG_229
            DET_HVC_FLAG_230_oRDR_DETECTION_229_232_oPCAN_RADAR_4dffcb2a_Tx: ComBitPosition=198, ComBitSize=1, ComSignalInitValue=0, ComSignalType=BOOLEAN, ComSystemTemplateSystemSignalRef=DET_HVC_FLAG_230
            DET_HVC_FLAG_231_oRDR_DETECTION_229_232_oPCAN_RADAR_d88f1fbf_Tx: ComBitPosition=310, ComBitSize=1, ComSignalInitValue=0, ComSignalType=BOOLEAN, ComSystemTemplateSystemSignalRef=DET_HVC_FLAG_231
            DET_HVC_FLAG_232_oRDR_DETECTION_229_232_oPCAN_RADAR_bc6f6441_Tx: ComBitPosition=422, ComBitSize=1, ComSignalInitValue=0, ComSignalType=BOOLEAN, ComSystemTemplateSystemSignalRef=DET_HVC_FLAG_232
            DET_IDM_229_oRDR_DETECTION_229_232_oPCAN_RADAR_a38d8233_Tx: ComBitPosition=63, ComBitSize=1, ComSignalInitValue=0, ComSignalType=BOOLEAN, ComSystemTemplateSystemSignalRef=DET_IDM_229
            DET_IDM_230_oRDR_DETECTION_229_232_oPCAN_RADAR_c6adf097_Tx: ComBitPosition=175, ComBitSize=1, ComSignalInitValue=0, ComSignalType=BOOLEAN, ComSystemTemplateSystemSignalRef=DET_IDM_230
            DET_IDM_231_oRDR_DETECTION_229_232_oPCAN_RADAR_53dd2402_Tx: ComBitPosition=287, ComBitSize=1, ComSignalInitValue=0, ComSignalType=BOOLEAN, ComSystemTemplateSystemSignalRef=DET_IDM_231
            DET_IDM_232_oRDR_DETECTION_229_232_oPCAN_RADAR_373d5ffc_Tx: ComBitPosition=399, ComBitSize=1, ComSignalInitValue=0, ComSignalType=BOOLEAN, ComSystemTemplateSystemSignalRef=DET_IDM_232
            DET_MH_CRC16_229_232_oRDR_DETECTION_229_232_oPCAN_RADAR_035cb2ad_Tx: ComBitPosition=0, ComBitSize=16, ComSignalInitValue=0, ComSignalType=UINT16, ComSystemTemplateSystemSignalRef=DET_MH_CRC16_229_232
            DET_MH_CYCLE_COUNTER_229_232_oRDR_DETECTION_229_232_oPCAN_RADAR_8729139a_Tx: ComBitPosition=16, ComBitSize=8, ComSignalInitValue=0, ComSignalType=UINT8, ComSystemTemplateSystemSignalRef=DET_MH_CYCLE_COUNTER_229_232
            DET_MH_SCAN_INDEX_4LSB_229_232_oRDR_DETECTION_229_232_oPCAN_RADAR_4b033616_Tx: ComBitPosition=476, ComBitSize=4, ComSignalInitValue=0, ComSignalType=UINT8, ComSystemTemplateSystemSignalRef=DET_MH_SCAN_INDEX_4LSB_229_232
            DET_MTD_229_oRDR_DETECTION_229_232_oPCAN_RADAR_c53eb0e8_Tx: ComBitPosition=47, ComBitSize=1, ComSignalInitValue=0, ComSignalType=BOOLEAN, ComSystemTemplateSystemSignalRef=DET_MTD_229
            DET_MTD_230_oRDR_DETECTION_229_232_oPCAN_RADAR_a01ec24c_Tx: ComBitPosition=159, ComBitSize=1, ComSignalInitValue=0, ComSignalType=BOOLEAN, ComSystemTemplateSystemSignalRef=DET_MTD_230
            DET_MTD_231_oRDR_DETECTION_229_232_oPCAN_RADAR_356e16d9_Tx: ComBitPosition=271, ComBitSize=1, ComSignalInitValue=0, ComSignalType=BOOLEAN, ComSystemTemplateSystemSignalRef=DET_MTD_231
            DET_MTD_232_oRDR_DETECTION_229_232_oPCAN_RADAR_518e6d27_Tx: ComBitPosition=383, ComBitSize=1, ComSignalInitValue=0, ComSignalType=BOOLEAN, ComSystemTemplateSystemSignalRef=DET_MTD_232
            DET_PROB_1STAZHYPO_229_oRDR_DETECTION_229_232_oPCAN_RADAR_568a5825_Tx: ComBitPosition=103, ComBitSize=1, ComSignalInitValue=0, ComSignalType=BOOLEAN, ComSystemTemplateSystemSignalRef=DET_PROB_1STAZHYPO_229
            DET_PROB_1STAZHYPO_230_oRDR_DETECTION_229_232_oPCAN_RADAR_33aa2a81_Tx: ComBitPosition=215, ComBitSize=1, ComSignalInitValue=0, ComSignalType=BOOLEAN, ComSystemTemplateSystemSignalRef=DET_PROB_1STAZHYPO_230
            DET_PROB_1STAZHYPO_231_oRDR_DETECTION_229_232_oPCAN_RADAR_a6dafe14_Tx: ComBitPosition=327, ComBitSize=1, ComSignalInitValue=0, ComSignalType=BOOLEAN, ComSystemTemplateSystemSignalRef=DET_PROB_1STAZHYPO_231
            DET_PROB_1STAZHYPO_232_oRDR_DETECTION_229_232_oPCAN_RADAR_c23a85ea_Tx: ComBitPosition=439, ComBitSize=1, ComSignalInitValue=0, ComSignalType=BOOLEAN, ComSystemTemplateSystemSignalRef=DET_PROB_1STAZHYPO_232
            DET_RANGE_229_oRDR_DETECTION_229_232_oPCAN_RADAR_5d25bb53_Tx: ComBitPosition=24, ComBitSize=15, ComSignalInitValue=0, ComSignalType=UINT16, ComSystemTemplateSystemSignalRef=DET_RANGE_229
            DET_RANGE_230_oRDR_DETECTION_229_232_oPCAN_RADAR_3805c9f7_Tx: ComBitPosition=136, ComBitSize=15, ComSignalInitValue=0, ComSignalType=UINT16, ComSystemTemplateSystemSignalRef=DET_RANGE_230
            DET_RANGE_231_oRDR_DETECTION_229_232_oPCAN_RADAR_ad751d62_Tx: ComBitPosition=248, ComBitSize=15, ComSignalInitValue=0, ComSignalType=UINT16, ComSystemTemplateSystemSignalRef=DET_RANGE_231
            DET_RANGE_232_oRDR_DETECTION_229_232_oPCAN_RADAR_c995669c_Tx: ComBitPosition=360, ComBitSize=15, ComSignalInitValue=0, ComSignalType=UINT16, ComSystemTemplateSystemSignalRef=DET_RANGE_232
            DET_RANGE_ERR_229_oRDR_DETECTION_229_232_oPCAN_RADAR_facd013a_Tx: ComBitPosition=40, ComBitSize=7, ComSignalInitValue=0, ComSignalType=UINT8, ComSystemTemplateSystemSignalRef=DET_RANGE_ERR_229
            DET_RANGE_ERR_230_oRDR_DETECTION_229_232_oPCAN_RADAR_9fed739e_Tx: ComBitPosition=152, ComBitSize=7, ComSignalInitValue=0, ComSignalType=UINT8, ComSystemTemplateSystemSignalRef=DET_RANGE_ERR_230
            DET_RANGE_ERR_231_oRDR_DETECTION_229_232_oPCAN_RADAR_0a9da70b_Tx: ComBitPosition=264, ComBitSize=7, ComSignalInitValue=0, ComSignalType=UINT8, ComSystemTemplateSystemSignalRef=DET_RANGE_ERR_231
            DET_RANGE_ERR_232_oRDR_DETECTION_229_232_oPCAN_RADAR_6e7ddcf5_Tx: ComBitPosition=376, ComBitSize=7, ComSignalInitValue=0, ComSignalType=UINT8, ComSystemTemplateSystemSignalRef=DET_RANGE_ERR_232
            DET_RANGE_VELOCITY_229_oRDR_DETECTION_229_232_oPCAN_RADAR_28837976_Tx: ComBitPosition=48, ComBitSize=15, ComSignalInitValue=16384, ComSignalType=UINT16, ComSystemTemplateSystemSignalRef=DET_RANGE_VELOCITY_229
            DET_RANGE_VELOCITY_230_oRDR_DETECTION_229_232_oPCAN_RADAR_4da30bd2_Tx: ComBitPosition=160, ComBitSize=15, ComSignalInitValue=16384, ComSignalType=UINT16, ComSystemTemplateSystemSignalRef=DET_RANGE_VELOCITY_230
            DET_RANGE_VELOCITY_231_oRDR_DETECTION_229_232_oPCAN_RADAR_d8d3df47_Tx: ComBitPosition=272, ComBitSize=15, ComSignalInitValue=16384, ComSignalType=UINT16, ComSystemTemplateSystemSignalRef=DET_RANGE_VELOCITY_231
            DET_RANGE_VELOCITY_232_oRDR_DETECTION_229_232_oPCAN_RADAR_bc33a4b9_Tx: ComBitPosition=384, ComBitSize=15, ComSignalInitValue=16384, ComSignalType=UINT16, ComSystemTemplateSystemSignalRef=DET_RANGE_VELOCITY_232
            DET_RANGE_VELOCITY_ERR_229_oRDR_DETECTION_229_232_oPCAN_RADAR_273882c4_Tx: ComBitPosition=64, ComBitSize=8, ComSignalInitValue=0, ComSignalType=UINT8, ComSystemTemplateSystemSignalRef=DET_RANGE_VELOCITY_ERR_229
            DET_RANGE_VELOCITY_ERR_230_oRDR_DETECTION_229_232_oPCAN_RADAR_4218f060_Tx: ComBitPosition=176, ComBitSize=8, ComSignalInitValue=0, ComSignalType=UINT8, ComSystemTemplateSystemSignalRef=DET_RANGE_VELOCITY_ERR_230
            DET_RANGE_VELOCITY_ERR_231_oRDR_DETECTION_229_232_oPCAN_RADAR_d76824f5_Tx: ComBitPosition=288, ComBitSize=8, ComSignalInitValue=0, ComSignalType=UINT8, ComSystemTemplateSystemSignalRef=DET_RANGE_VELOCITY_ERR_231
            DET_RANGE_VELOCITY_ERR_232_oRDR_DETECTION_229_232_oPCAN_RADAR_b3885f0b_Tx: ComBitPosition=400, ComBitSize=8, ComSignalInitValue=0, ComSignalType=UINT8, ComSystemTemplateSystemSignalRef=DET_RANGE_VELOCITY_ERR_232
            DET_RCS_229_oRDR_DETECTION_229_232_oPCAN_RADAR_af034e2c_Tx: ComBitPosition=128, ComBitSize=8, ComSignalInitValue=128, ComSignalType=UINT8, ComSystemTemplateSystemSignalRef=DET_RCS_229
            DET_RCS_230_oRDR_DETECTION_229_232_oPCAN_RADAR_ca233c88_Tx: ComBitPosition=240, ComBitSize=8, ComSignalInitValue=128, ComSignalType=UINT8, ComSystemTemplateSystemSignalRef=DET_RCS_230
            DET_RCS_231_oRDR_DETECTION_229_232_oPCAN_RADAR_5f53e81d_Tx: ComBitPosition=352, ComBitSize=8, ComSignalInitValue=128, ComSignalType=UINT8, ComSystemTemplateSystemSignalRef=DET_RCS_231
            DET_RCS_232_oRDR_DETECTION_229_232_oPCAN_RADAR_3bb393e3_Tx: ComBitPosition=464, ComBitSize=8, ComSignalInitValue=128, ComSignalType=UINT8, ComSystemTemplateSystemSignalRef=DET_RCS_232
            DET_SNR_229_oRDR_DETECTION_229_232_oPCAN_RADAR_72ad1a2e_Tx: ComBitPosition=120, ComBitSize=8, ComSignalInitValue=0, ComSignalType=UINT8, ComSystemTemplateSystemSignalRef=DET_SNR_229
            DET_SNR_230_oRDR_DETECTION_229_232_oPCAN_RADAR_178d688a_Tx: ComBitPosition=232, ComBitSize=8, ComSignalInitValue=0, ComSignalType=UINT8, ComSystemTemplateSystemSignalRef=DET_SNR_230
            DET_SNR_231_oRDR_DETECTION_229_232_oPCAN_RADAR_82fdbc1f_Tx: ComBitPosition=344, ComBitSize=8, ComSignalInitValue=0, ComSignalType=UINT8, ComSystemTemplateSystemSignalRef=DET_SNR_231
            DET_SNR_232_oRDR_DETECTION_229_232_oPCAN_RADAR_e61dc7e1_Tx: ComBitPosition=456, ComBitSize=8, ComSignalInitValue=0, ComSignalType=UINT8, ComSystemTemplateSystemSignalRef=DET_SNR_232
            DET_SUPER_RES_TARGET_229_oRDR_DETECTION_229_232_oPCAN_RADAR_4334324b_Tx: ComBitPosition=87, ComBitSize=1, ComSignalInitValue=0, ComSignalType=BOOLEAN, ComSystemTemplateSystemSignalRef=DET_SUPER_RES_TARGET_229
            DET_SUPER_RES_TARGET_230_oRDR_DETECTION_229_232_oPCAN_RADAR_261440ef_Tx: ComBitPosition=199, ComBitSize=1, ComSignalInitValue=0, ComSignalType=BOOLEAN, ComSystemTemplateSystemSignalRef=DET_SUPER_RES_TARGET_230
            DET_SUPER_RES_TARGET_231_oRDR_DETECTION_229_232_oPCAN_RADAR_b364947a_Tx: ComBitPosition=311, ComBitSize=1, ComSignalInitValue=0, ComSignalType=BOOLEAN, ComSystemTemplateSystemSignalRef=DET_SUPER_RES_TARGET_231
            DET_SUPER_RES_TARGET_232_oRDR_DETECTION_229_232_oPCAN_RADAR_d784ef84_Tx: ComBitPosition=423, ComBitSize=1, ComSignalInitValue=0, ComSignalType=BOOLEAN, ComSystemTemplateSystemSignalRef=DET_SUPER_RES_TARGET_232
        SG_Detections_233_236_oRDR_DETECTION_233_236_oPCAN_RADAR_b5df088e_Tx: ComSystemTemplateSignalGroupRef=SG_Detections_233_236
          83 x ComGroupSignal, all with ComSignalEndianness=LITTLE_ENDIAN, ComTransferProperty=PENDING:
            DET_AZIMUTH_233_oRDR_DETECTION_233_236_oPCAN_RADAR_51b9c29c_Tx: ComBitPosition=88, ComBitSize=13, ComSignalInitValue=0, ComSignalType=UINT16, ComSystemTemplateSystemSignalRef=DET_AZIMUTH_233
            DET_AZIMUTH_234_oRDR_DETECTION_233_236_oPCAN_RADAR_0d09e1f5_Tx: ComBitPosition=200, ComBitSize=13, ComSignalInitValue=0, ComSignalType=UINT16, ComSystemTemplateSystemSignalRef=DET_AZIMUTH_234
            DET_AZIMUTH_235_oRDR_DETECTION_233_236_oPCAN_RADAR_98793560_Tx: ComBitPosition=312, ComBitSize=13, ComSignalInitValue=0, ComSignalType=UINT16, ComSystemTemplateSystemSignalRef=DET_AZIMUTH_235
            DET_AZIMUTH_236_oRDR_DETECTION_233_236_oPCAN_RADAR_fc994e9e_Tx: ComBitPosition=424, ComBitSize=13, ComSignalInitValue=0, ComSignalType=UINT16, ComSystemTemplateSystemSignalRef=DET_AZIMUTH_236
            DET_AZIMUTH_ERR_233_oRDR_DETECTION_233_236_oPCAN_RADAR_f50c5769_Tx: ComBitPosition=105, ComBitSize=7, ComSignalInitValue=0, ComSignalType=UINT8, ComSystemTemplateSystemSignalRef=DET_AZIMUTH_ERR_233
            DET_AZIMUTH_ERR_234_oRDR_DETECTION_233_236_oPCAN_RADAR_a9bc7400_Tx: ComBitPosition=217, ComBitSize=7, ComSignalInitValue=0, ComSignalType=UINT8, ComSystemTemplateSystemSignalRef=DET_AZIMUTH_ERR_234
            DET_AZIMUTH_ERR_235_oRDR_DETECTION_233_236_oPCAN_RADAR_3ccca095_Tx: ComBitPosition=329, ComBitSize=7, ComSignalInitValue=0, ComSignalType=UINT8, ComSystemTemplateSystemSignalRef=DET_AZIMUTH_ERR_235
            DET_AZIMUTH_ERR_236_oRDR_DETECTION_233_236_oPCAN_RADAR_582cdb6b_Tx: ComBitPosition=441, ComBitSize=7, ComSignalInitValue=0, ComSignalType=UINT8, ComSystemTemplateSystemSignalRef=DET_AZIMUTH_ERR_236
            DET_BELOW_RAIN_THOLD_233_oRDR_DETECTION_233_236_oPCAN_RADAR_84b8515c_Tx: ComBitPosition=39, ComBitSize=1, ComSignalInitValue=0, ComSignalType=BOOLEAN, ComSystemTemplateSystemSignalRef=DET_BELOW_RAIN_THOLD_233
            DET_BELOW_RAIN_THOLD_234_oRDR_DETECTION_233_236_oPCAN_RADAR_d8087235_Tx: ComBitPosition=151, ComBitSize=1, ComSignalInitValue=0, ComSignalType=BOOLEAN, ComSystemTemplateSystemSignalRef=DET_BELOW_RAIN_THOLD_234
            DET_BELOW_RAIN_THOLD_235_oRDR_DETECTION_233_236_oPCAN_RADAR_4d78a6a0_Tx: ComBitPosition=263, ComBitSize=1, ComSignalInitValue=0, ComSignalType=BOOLEAN, ComSystemTemplateSystemSignalRef=DET_BELOW_RAIN_THOLD_235
            DET_BELOW_RAIN_THOLD_236_oRDR_DETECTION_233_236_oPCAN_RADAR_2998dd5e_Tx: ComBitPosition=375, ComBitSize=1, ComSignalInitValue=0, ComSignalType=BOOLEAN, ComSystemTemplateSystemSignalRef=DET_BELOW_RAIN_THOLD_236
            DET_BI_STATIC_FLAG_233_oRDR_DETECTION_233_236_oPCAN_RADAR_07958219_Tx: ComBitPosition=104, ComBitSize=1, ComSignalInitValue=0, ComSignalType=BOOLEAN, ComSystemTemplateSystemSignalRef=DET_BI_STATIC_FLAG_233
            DET_BI_STATIC_FLAG_234_oRDR_DETECTION_233_236_oPCAN_RADAR_5b25a170_Tx: ComBitPosition=216, ComBitSize=1, ComSignalInitValue=0, ComSignalType=BOOLEAN, ComSystemTemplateSystemSignalRef=DET_BI_STATIC_FLAG_234
            DET_BI_STATIC_FLAG_235_oRDR_DETECTION_233_236_oPCAN_RADAR_ce5575e5_Tx: ComBitPosition=328, ComBitSize=1, ComSignalInitValue=0, ComSignalType=BOOLEAN, ComSystemTemplateSystemSignalRef=DET_BI_STATIC_FLAG_235
            DET_BI_STATIC_FLAG_236_oRDR_DETECTION_233_236_oPCAN_RADAR_aab50e1b_Tx: ComBitPosition=440, ComBitSize=1, ComSignalInitValue=0, ComSignalType=BOOLEAN, ComSystemTemplateSystemSignalRef=DET_BI_STATIC_FLAG_236
            DET_CONFD_AZIMUTH_233_oRDR_DETECTION_233_236_oPCAN_RADAR_535fc856_Tx: ComBitPosition=118, ComBitSize=2, ComSignalInitValue=0, ComSignalType=UINT8, ComSystemTemplateSystemSignalRef=DET_CONFD_AZIMUTH_233
            DET_CONFD_AZIMUTH_234_oRDR_DETECTION_233_236_oPCAN_RADAR_0fefeb3f_Tx: ComBitPosition=230, ComBitSize=2, ComSignalInitValue=0, ComSignalType=UINT8, ComSystemTemplateSystemSignalRef=DET_CONFD_AZIMUTH_234
            DET_CONFD_AZIMUTH_235_oRDR_DETECTION_233_236_oPCAN_RADAR_9a9f3faa_Tx: ComBitPosition=342, ComBitSize=2, ComSignalInitValue=0, ComSignalType=UINT8, ComSystemTemplateSystemSignalRef=DET_CONFD_AZIMUTH_235
            DET_CONFD_AZIMUTH_236_oRDR_DETECTION_233_236_oPCAN_RADAR_fe7f4454_Tx: ComBitPosition=454, ComBitSize=2, ComSignalInitValue=0, ComSignalType=UINT8, ComSystemTemplateSystemSignalRef=DET_CONFD_AZIMUTH_236
            DET_CONFD_ELEVATION_233_oRDR_DETECTION_233_236_oPCAN_RADAR_51cac9ac_Tx: ComBitPosition=101, ComBitSize=2, ComSignalInitValue=0, ComSignalType=UINT8, ComSystemTemplateSystemSignalRef=DET_CONFD_ELEVATION_233
            DET_CONFD_ELEVATION_234_oRDR_DETECTION_233_236_oPCAN_RADAR_0d7aeac5_Tx: ComBitPosition=213, ComBitSize=2, ComSignalInitValue=0, ComSignalType=UINT8, ComSystemTemplateSystemSignalRef=DET_CONFD_ELEVATION_234
            DET_CONFD_ELEVATION_235_oRDR_DETECTION_233_236_oPCAN_RADAR_980a3e50_Tx: ComBitPosition=325, ComBitSize=2, ComSignalInitValue=0, ComSignalType=UINT8, ComSystemTemplateSystemSignalRef=DET_CONFD_ELEVATION_235
            DET_CONFD_ELEVATION_236_oRDR_DETECTION_233_236_oPCAN_RADAR_fcea45ae_Tx: ComBitPosition=437, ComBitSize=2, ComSignalInitValue=0, ComSignalType=UINT8, ComSystemTemplateSystemSignalRef=DET_CONFD_ELEVATION_236
            DET_ELEVATION_233_oRDR_DETECTION_233_236_oPCAN_RADAR_800a1d90_Tx: ComBitPosition=72, ComBitSize=8, ComSignalInitValue=0, ComSignalType=UINT8, ComSystemTemplateSystemSignalRef=DET_ELEVATION_233
            DET_ELEVATION_234_oRDR_DETECTION_233_236_oPCAN_RADAR_dcba3ef9_Tx: ComBitPosition=184, ComBitSize=8, ComSignalInitValue=0, ComSignalType=UINT8, ComSystemTemplateSystemSignalRef=DET_ELEVATION_234
            DET_ELEVATION_235_oRDR_DETECTION_233_236_oPCAN_RADAR_49caea6c_Tx: ComBitPosition=296, ComBitSize=8, ComSignalInitValue=0, ComSignalType=UINT8, ComSystemTemplateSystemSignalRef=DET_ELEVATION_235
            DET_ELEVATION_236_oRDR_DETECTION_233_236_oPCAN_RADAR_2d2a9192_Tx: ComBitPosition=408, ComBitSize=8, ComSignalInitValue=0, ComSignalType=UINT8, ComSystemTemplateSystemSignalRef=DET_ELEVATION_236
            DET_ELEVATION_ERR_233_oRDR_DETECTION_233_236_oPCAN_RADAR_073385e5_Tx: ComBitPosition=80, ComBitSize=6, ComSignalInitValue=0, ComSignalType=UINT8, ComSystemTemplateSystemSignalRef=DET_ELEVATION_ERR_233
            DET_ELEVATION_ERR_234_oRDR_DETECTION_233_236_oPCAN_RADAR_5b83a68c_Tx: ComBitPosition=192, ComBitSize=6, ComSignalInitValue=0, ComSignalType=UINT8, ComSystemTemplateSystemSignalRef=DET_ELEVATION_ERR_234
            DET_ELEVATION_ERR_235_oRDR_DETECTION_233_236_oPCAN_RADAR_cef37219_Tx: ComBitPosition=304, ComBitSize=6, ComSignalInitValue=0, ComSignalType=UINT8, ComSystemTemplateSystemSignalRef=DET_ELEVATION_ERR_235
            DET_ELEVATION_ERR_236_oRDR_DETECTION_233_236_oPCAN_RADAR_aa1309e7_Tx: ComBitPosition=416, ComBitSize=6, ComSignalInitValue=0, ComSignalType=UINT8, ComSystemTemplateSystemSignalRef=DET_ELEVATION_ERR_236
            DET_EXISTENCE_PROB_233_oRDR_DETECTION_233_236_oPCAN_RADAR_d5acf085_Tx: ComBitPosition=112, ComBitSize=6, ComSignalInitValue=0, ComSignalType=UINT8, ComSystemTemplateSystemSignalRef=DET_EXISTENCE_PROB_233
            DET_EXISTENCE_PROB_234_oRDR_DETECTION_233_236_oPCAN_RADAR_891cd3ec_Tx: ComBitPosition=224, ComBitSize=6, ComSignalInitValue=0, ComSignalType=UINT8, ComSystemTemplateSystemSignalRef=DET_EXISTENCE_PROB_234
            DET_EXISTENCE_PROB_235_oRDR_DETECTION_233_236_oPCAN_RADAR_1c6c0779_Tx: ComBitPosition=336, ComBitSize=6, ComSignalInitValue=0, ComSignalType=UINT8, ComSystemTemplateSystemSignalRef=DET_EXISTENCE_PROB_235
            DET_EXISTENCE_PROB_236_oRDR_DETECTION_233_236_oPCAN_RADAR_788c7c87_Tx: ComBitPosition=448, ComBitSize=6, ComSignalInitValue=0, ComSignalType=UINT8, ComSystemTemplateSystemSignalRef=DET_EXISTENCE_PROB_236
            DET_HVC_FLAG_233_oRDR_DETECTION_233_236_oPCAN_RADAR_34d8b3fa_Tx: ComBitPosition=86, ComBitSize=1, ComSignalInitValue=0, ComSignalType=BOOLEAN, ComSystemTemplateSystemSignalRef=DET_HVC_FLAG_233
            DET_HVC_FLAG_234_oRDR_DETECTION_233_236_oPCAN_RADAR_68689093_Tx: ComBitPosition=198, ComBitSize=1, ComSignalInitValue=0, ComSignalType=BOOLEAN, ComSystemTemplateSystemSignalRef=DET_HVC_FLAG_234
            DET_HVC_FLAG_235_oRDR_DETECTION_233_236_oPCAN_RADAR_fd184406_Tx: ComBitPosition=310, ComBitSize=1, ComSignalInitValue=0, ComSignalType=BOOLEAN, ComSystemTemplateSystemSignalRef=DET_HVC_FLAG_235
            DET_HVC_FLAG_236_oRDR_DETECTION_233_236_oPCAN_RADAR_99f83ff8_Tx: ComBitPosition=422, ComBitSize=1, ComSignalInitValue=0, ComSignalType=BOOLEAN, ComSystemTemplateSystemSignalRef=DET_HVC_FLAG_236
            DET_IDM_233_oRDR_DETECTION_233_236_oPCAN_RADAR_bf8a8847_Tx: ComBitPosition=63, ComBitSize=1, ComSignalInitValue=0, ComSignalType=BOOLEAN, ComSystemTemplateSystemSignalRef=DET_IDM_233
            DET_IDM_234_oRDR_DETECTION_233_236_oPCAN_RADAR_e33aab2e_Tx: ComBitPosition=175, ComBitSize=1, ComSignalInitValue=0, ComSignalType=BOOLEAN, ComSystemTemplateSystemSignalRef=DET_IDM_234
            DET_IDM_235_oRDR_DETECTION_233_236_oPCAN_RADAR_764a7fbb_Tx: ComBitPosition=287, ComBitSize=1, ComSignalInitValue=0, ComSignalType=BOOLEAN, ComSystemTemplateSystemSignalRef=DET_IDM_235
            DET_IDM_236_oRDR_DETECTION_233_236_oPCAN_RADAR_12aa0445_Tx: ComBitPosition=399, ComBitSize=1, ComSignalInitValue=0, ComSignalType=BOOLEAN, ComSystemTemplateSystemSignalRef=DET_IDM_236
            DET_MH_CRC16_233_236_oRDR_DETECTION_233_236_oPCAN_RADAR_3157da85_Tx: ComBitPosition=0, ComBitSize=16, ComSignalInitValue=0, ComSignalType=UINT16, ComSystemTemplateSystemSignalRef=DET_MH_CRC16_233_236
            DET_MH_CYCLE_COUNTER_233_236_oRDR_DETECTION_233_236_oPCAN_RADAR_b5227bb2_Tx: ComBitPosition=16, ComBitSize=8, ComSignalInitValue=0, ComSignalType=UINT8, ComSystemTemplateSystemSignalRef=DET_MH_CYCLE_COUNTER_233_236
            DET_MH_SCAN_INDEX_4LSB_233_236_oRDR_DETECTION_233_236_oPCAN_RADAR_79085e3e_Tx: ComBitPosition=476, ComBitSize=4, ComSignalInitValue=0, ComSignalType=UINT8, ComSystemTemplateSystemSignalRef=DET_MH_SCAN_INDEX_4LSB_233_236
            DET_MTD_233_oRDR_DETECTION_233_236_oPCAN_RADAR_d939ba9c_Tx: ComBitPosition=47, ComBitSize=1, ComSignalInitValue=0, ComSignalType=BOOLEAN, ComSystemTemplateSystemSignalRef=DET_MTD_233
            DET_MTD_234_oRDR_DETECTION_233_236_oPCAN_RADAR_858999f5_Tx: ComBitPosition=159, ComBitSize=1, ComSignalInitValue=0, ComSignalType=BOOLEAN, ComSystemTemplateSystemSignalRef=DET_MTD_234
            DET_MTD_235_oRDR_DETECTION_233_236_oPCAN_RADAR_10f94d60_Tx: ComBitPosition=271, ComBitSize=1, ComSignalInitValue=0, ComSignalType=BOOLEAN, ComSystemTemplateSystemSignalRef=DET_MTD_235
            DET_MTD_236_oRDR_DETECTION_233_236_oPCAN_RADAR_7419369e_Tx: ComBitPosition=383, ComBitSize=1, ComSignalInitValue=0, ComSignalType=BOOLEAN, ComSystemTemplateSystemSignalRef=DET_MTD_236
            DET_PROB_1STAZHYPO_233_oRDR_DETECTION_233_236_oPCAN_RADAR_4a8d5251_Tx: ComBitPosition=103, ComBitSize=1, ComSignalInitValue=0, ComSignalType=BOOLEAN, ComSystemTemplateSystemSignalRef=DET_PROB_1STAZHYPO_233
            DET_PROB_1STAZHYPO_234_oRDR_DETECTION_233_236_oPCAN_RADAR_163d7138_Tx: ComBitPosition=215, ComBitSize=1, ComSignalInitValue=0, ComSignalType=BOOLEAN, ComSystemTemplateSystemSignalRef=DET_PROB_1STAZHYPO_234
            DET_PROB_1STAZHYPO_235_oRDR_DETECTION_233_236_oPCAN_RADAR_834da5ad_Tx: ComBitPosition=327, ComBitSize=1, ComSignalInitValue=0, ComSignalType=BOOLEAN, ComSystemTemplateSystemSignalRef=DET_PROB_1STAZHYPO_235
            DET_PROB_1STAZHYPO_236_oRDR_DETECTION_233_236_oPCAN_RADAR_e7adde53_Tx: ComBitPosition=439, ComBitSize=1, ComSignalInitValue=0, ComSignalType=BOOLEAN, ComSystemTemplateSystemSignalRef=DET_PROB_1STAZHYPO_236
            DET_RANGE_233_oRDR_DETECTION_233_236_oPCAN_RADAR_4122b127_Tx: ComBitPosition=24, ComBitSize=15, ComSignalInitValue=0, ComSignalType=UINT16, ComSystemTemplateSystemSignalRef=DET_RANGE_233
            DET_RANGE_234_oRDR_DETECTION_233_236_oPCAN_RADAR_1d92924e_Tx: ComBitPosition=136, ComBitSize=15, ComSignalInitValue=0, ComSignalType=UINT16, ComSystemTemplateSystemSignalRef=DET_RANGE_234
            DET_RANGE_235_oRDR_DETECTION_233_236_oPCAN_RADAR_88e246db_Tx: ComBitPosition=248, ComBitSize=15, ComSignalInitValue=0, ComSignalType=UINT16, ComSystemTemplateSystemSignalRef=DET_RANGE_235
            DET_RANGE_236_oRDR_DETECTION_233_236_oPCAN_RADAR_ec023d25_Tx: ComBitPosition=360, ComBitSize=15, ComSignalInitValue=0, ComSignalType=UINT16, ComSystemTemplateSystemSignalRef=DET_RANGE_236
            DET_RANGE_ERR_233_oRDR_DETECTION_233_236_oPCAN_RADAR_e6ca0b4e_Tx: ComBitPosition=40, ComBitSize=7, ComSignalInitValue=0, ComSignalType=UINT8, ComSystemTemplateSystemSignalRef=DET_RANGE_ERR_233
            DET_RANGE_ERR_234_oRDR_DETECTION_233_236_oPCAN_RADAR_ba7a2827_Tx: ComBitPosition=152, ComBitSize=7, ComSignalInitValue=0, ComSignalType=UINT8, ComSystemTemplateSystemSignalRef=DET_RANGE_ERR_234
            DET_RANGE_ERR_235_oRDR_DETECTION_233_236_oPCAN_RADAR_2f0afcb2_Tx: ComBitPosition=264, ComBitSize=7, ComSignalInitValue=0, ComSignalType=UINT8, ComSystemTemplateSystemSignalRef=DET_RANGE_ERR_235
            DET_RANGE_ERR_236_oRDR_DETECTION_233_236_oPCAN_RADAR_4bea874c_Tx: ComBitPosition=376, ComBitSize=7, ComSignalInitValue=0, ComSignalType=UINT8, ComSystemTemplateSystemSignalRef=DET_RANGE_ERR_236
            DET_RANGE_VELOCITY_233_oRDR_DETECTION_233_236_oPCAN_RADAR_34847302_Tx: ComBitPosition=48, ComBitSize=15, ComSignalInitValue=16384, ComSignalType=UINT16, ComSystemTemplateSystemSignalRef=DET_RANGE_VELOCITY_233
            DET_RANGE_VELOCITY_234_oRDR_DETECTION_233_236_oPCAN_RADAR_6834506b_Tx: ComBitPosition=160, ComBitSize=15, ComSignalInitValue=16384, ComSignalType=UINT16, ComSystemTemplateSystemSignalRef=DET_RANGE_VELOCITY_234
            DET_RANGE_VELOCITY_235_oRDR_DETECTION_233_236_oPCAN_RADAR_fd4484fe_Tx: ComBitPosition=272, ComBitSize=15, ComSignalInitValue=16384, ComSignalType=UINT16, ComSystemTemplateSystemSignalRef=DET_RANGE_VELOCITY_235
            DET_RANGE_VELOCITY_236_oRDR_DETECTION_233_236_oPCAN_RADAR_99a4ff00_Tx: ComBitPosition=384, ComBitSize=15, ComSignalInitValue=16384, ComSignalType=UINT16, ComSystemTemplateSystemSignalRef=DET_RANGE_VELOCITY_236
            DET_RANGE_VELOCITY_ERR_233_oRDR_DETECTION_233_236_oPCAN_RADAR_3b3f88b0_Tx: ComBitPosition=64, ComBitSize=8, ComSignalInitValue=0, ComSignalType=UINT8, ComSystemTemplateSystemSignalRef=DET_RANGE_VELOCITY_ERR_233
            DET_RANGE_VELOCITY_ERR_234_oRDR_DETECTION_233_236_oPCAN_RADAR_678fabd9_Tx: ComBitPosition=176, ComBitSize=8, ComSignalInitValue=0, ComSignalType=UINT8, ComSystemTemplateSystemSignalRef=DET_RANGE_VELOCITY_ERR_234
            DET_RANGE_VELOCITY_ERR_235_oRDR_DETECTION_233_236_oPCAN_RADAR_f2ff7f4c_Tx: ComBitPosition=288, ComBitSize=8, ComSignalInitValue=0, ComSignalType=UINT8, ComSystemTemplateSystemSignalRef=DET_RANGE_VELOCITY_ERR_235
            DET_RANGE_VELOCITY_ERR_236_oRDR_DETECTION_233_236_oPCAN_RADAR_961f04b2_Tx: ComBitPosition=400, ComBitSize=8, ComSignalInitValue=0, ComSignalType=UINT8, ComSystemTemplateSystemSignalRef=DET_RANGE_VELOCITY_ERR_236
            DET_RCS_233_oRDR_DETECTION_233_236_oPCAN_RADAR_b3044458_Tx: ComBitPosition=128, ComBitSize=8, ComSignalInitValue=128, ComSignalType=UINT8, ComSystemTemplateSystemSignalRef=DET_RCS_233
            DET_RCS_234_oRDR_DETECTION_233_236_oPCAN_RADAR_efb46731_Tx: ComBitPosition=240, ComBitSize=8, ComSignalInitValue=128, ComSignalType=UINT8, ComSystemTemplateSystemSignalRef=DET_RCS_234
            DET_RCS_235_oRDR_DETECTION_233_236_oPCAN_RADAR_7ac4b3a4_Tx: ComBitPosition=352, ComBitSize=8, ComSignalInitValue=128, ComSignalType=UINT8, ComSystemTemplateSystemSignalRef=DET_RCS_235
            DET_RCS_236_oRDR_DETECTION_233_236_oPCAN_RADAR_1e24c85a_Tx: ComBitPosition=464, ComBitSize=8, ComSignalInitValue=128, ComSignalType=UINT8, ComSystemTemplateSystemSignalRef=DET_RCS_236
            DET_SNR_233_oRDR_DETECTION_233_236_oPCAN_RADAR_6eaa105a_Tx: ComBitPosition=120, ComBitSize=8, ComSignalInitValue=0, ComSignalType=UINT8, ComSystemTemplateSystemSignalRef=DET_SNR_233
            DET_SNR_234_oRDR_DETECTION_233_236_oPCAN_RADAR_321a3333_Tx: ComBitPosition=232, ComBitSize=8, ComSignalInitValue=0, ComSignalType=UINT8, ComSystemTemplateSystemSignalRef=DET_SNR_234
            DET_SNR_235_oRDR_DETECTION_233_236_oPCAN_RADAR_a76ae7a6_Tx: ComBitPosition=344, ComBitSize=8, ComSignalInitValue=0, ComSignalType=UINT8, ComSystemTemplateSystemSignalRef=DET_SNR_235
            DET_SNR_236_oRDR_DETECTION_233_236_oPCAN_RADAR_c38a9c58_Tx: ComBitPosition=456, ComBitSize=8, ComSignalInitValue=0, ComSignalType=UINT8, ComSystemTemplateSystemSignalRef=DET_SNR_236
            DET_SUPER_RES_TARGET_233_oRDR_DETECTION_233_236_oPCAN_RADAR_5f33383f_Tx: ComBitPosition=87, ComBitSize=1, ComSignalInitValue=0, ComSignalType=BOOLEAN, ComSystemTemplateSystemSignalRef=DET_SUPER_RES_TARGET_233
            DET_SUPER_RES_TARGET_234_oRDR_DETECTION_233_236_oPCAN_RADAR_03831b56_Tx: ComBitPosition=199, ComBitSize=1, ComSignalInitValue=0, ComSignalType=BOOLEAN, ComSystemTemplateSystemSignalRef=DET_SUPER_RES_TARGET_234
            DET_SUPER_RES_TARGET_235_oRDR_DETECTION_233_236_oPCAN_RADAR_96f3cfc3_Tx: ComBitPosition=311, ComBitSize=1, ComSignalInitValue=0, ComSignalType=BOOLEAN, ComSystemTemplateSystemSignalRef=DET_SUPER_RES_TARGET_235
            DET_SUPER_RES_TARGET_236_oRDR_DETECTION_233_236_oPCAN_RADAR_f213b43d_Tx: ComBitPosition=423, ComBitSize=1, ComSignalInitValue=0, ComSignalType=BOOLEAN, ComSystemTemplateSystemSignalRef=DET_SUPER_RES_TARGET_236
        SG_Detections_237_240_oRDR_DETECTION_237_240_oPCAN_RADAR_2e8c87a0_Tx: ComSystemTemplateSignalGroupRef=SG_Detections_237_240
          83 x ComGroupSignal, all with ComSignalEndianness=LITTLE_ENDIAN, ComTransferProperty=PENDING:
            DET_AZIMUTH_237_oRDR_DETECTION_237_240_oPCAN_RADAR_dfc9c8d9_Tx: ComBitPosition=88, ComBitSize=13, ComSignalInitValue=0, ComSignalType=UINT16, ComSystemTemplateSystemSignalRef=DET_AZIMUTH_237
            DET_AZIMUTH_238_oRDR_DETECTION_237_240_oPCAN_RADAR_f3d95a9e_Tx: ComBitPosition=200, ComBitSize=13, ComSignalInitValue=0, ComSignalType=UINT16, ComSystemTemplateSystemSignalRef=DET_AZIMUTH_238
            DET_AZIMUTH_239_oRDR_DETECTION_237_240_oPCAN_RADAR_66a98e0b_Tx: ComBitPosition=312, ComBitSize=13, ComSignalInitValue=0, ComSignalType=UINT16, ComSystemTemplateSystemSignalRef=DET_AZIMUTH_239
            DET_AZIMUTH_240_oRDR_DETECTION_237_240_oPCAN_RADAR_b74b826f_Tx: ComBitPosition=424, ComBitSize=13, ComSignalInitValue=0, ComSignalType=UINT16, ComSystemTemplateSystemSignalRef=DET_AZIMUTH_240
            DET_AZIMUTH_ERR_237_oRDR_DETECTION_237_240_oPCAN_RADAR_7b7c5d2c_Tx: ComBitPosition=105, ComBitSize=7, ComSignalInitValue=0, ComSignalType=UINT8, ComSystemTemplateSystemSignalRef=DET_AZIMUTH_ERR_237
            DET_AZIMUTH_ERR_238_oRDR_DETECTION_237_240_oPCAN_RADAR_576ccf6b_Tx: ComBitPosition=217, ComBitSize=7, ComSignalInitValue=0, ComSignalType=UINT8, ComSystemTemplateSystemSignalRef=DET_AZIMUTH_ERR_238
            DET_AZIMUTH_ERR_239_oRDR_DETECTION_237_240_oPCAN_RADAR_c21c1bfe_Tx: ComBitPosition=329, ComBitSize=7, ComSignalInitValue=0, ComSignalType=UINT8, ComSystemTemplateSystemSignalRef=DET_AZIMUTH_ERR_239
            DET_AZIMUTH_ERR_240_oRDR_DETECTION_237_240_oPCAN_RADAR_13fe179a_Tx: ComBitPosition=441, ComBitSize=7, ComSignalInitValue=0, ComSignalType=UINT8, ComSystemTemplateSystemSignalRef=DET_AZIMUTH_ERR_240
            DET_BELOW_RAIN_THOLD_237_oRDR_DETECTION_237_240_oPCAN_RADAR_0ac85b19_Tx: ComBitPosition=39, ComBitSize=1, ComSignalInitValue=0, ComSignalType=BOOLEAN, ComSystemTemplateSystemSignalRef=DET_BELOW_RAIN_THOLD_237
            DET_BELOW_RAIN_THOLD_238_oRDR_DETECTION_237_240_oPCAN_RADAR_26d8c95e_Tx: ComBitPosition=151, ComBitSize=1, ComSignalInitValue=0, ComSignalType=BOOLEAN, ComSystemTemplateSystemSignalRef=DET_BELOW_RAIN_THOLD_238
            DET_BELOW_RAIN_THOLD_239_oRDR_DETECTION_237_240_oPCAN_RADAR_b3a81dcb_Tx: ComBitPosition=263, ComBitSize=1, ComSignalInitValue=0, ComSignalType=BOOLEAN, ComSystemTemplateSystemSignalRef=DET_BELOW_RAIN_THOLD_239
            DET_BELOW_RAIN_THOLD_240_oRDR_DETECTION_237_240_oPCAN_RADAR_624a11af_Tx: ComBitPosition=375, ComBitSize=1, ComSignalInitValue=0, ComSignalType=BOOLEAN, ComSystemTemplateSystemSignalRef=DET_BELOW_RAIN_THOLD_240
            DET_BI_STATIC_FLAG_237_oRDR_DETECTION_237_240_oPCAN_RADAR_89e5885c_Tx: ComBitPosition=104, ComBitSize=1, ComSignalInitValue=0, ComSignalType=BOOLEAN, ComSystemTemplateSystemSignalRef=DET_BI_STATIC_FLAG_237
            DET_BI_STATIC_FLAG_238_oRDR_DETECTION_237_240_oPCAN_RADAR_a5f51a1b_Tx: ComBitPosition=216, ComBitSize=1, ComSignalInitValue=0, ComSignalType=BOOLEAN, ComSystemTemplateSystemSignalRef=DET_BI_STATIC_FLAG_238
            DET_BI_STATIC_FLAG_239_oRDR_DETECTION_237_240_oPCAN_RADAR_3085ce8e_Tx: ComBitPosition=328, ComBitSize=1, ComSignalInitValue=0, ComSignalType=BOOLEAN, ComSystemTemplateSystemSignalRef=DET_BI_STATIC_FLAG_239
            DET_BI_STATIC_FLAG_240_oRDR_DETECTION_237_240_oPCAN_RADAR_e167c2ea_Tx: ComBitPosition=440, ComBitSize=1, ComSignalInitValue=0, ComSignalType=BOOLEAN, ComSystemTemplateSystemSignalRef=DET_BI_STATIC_FLAG_240
            DET_CONFD_AZIMUTH_237_oRDR_DETECTION_237_240_oPCAN_RADAR_dd2fc213_Tx: ComBitPosition=118, ComBitSize=2, ComSignalInitValue=0, ComSignalType=UINT8, ComSystemTemplateSystemSignalRef=DET_CONFD_AZIMUTH_237
            DET_CONFD_AZIMUTH_238_oRDR_DETECTION_237_240_oPCAN_RADAR_f13f5054_Tx: ComBitPosition=230, ComBitSize=2, ComSignalInitValue=0, ComSignalType=UINT8, ComSystemTemplateSystemSignalRef=DET_CONFD_AZIMUTH_238
            DET_CONFD_AZIMUTH_239_oRDR_DETECTION_237_240_oPCAN_RADAR_644f84c1_Tx: ComBitPosition=342, ComBitSize=2, ComSignalInitValue=0, ComSignalType=UINT8, ComSystemTemplateSystemSignalRef=DET_CONFD_AZIMUTH_239
            DET_CONFD_AZIMUTH_240_oRDR_DETECTION_237_240_oPCAN_RADAR_b5ad88a5_Tx: ComBitPosition=454, ComBitSize=2, ComSignalInitValue=0, ComSignalType=UINT8, ComSystemTemplateSystemSignalRef=DET_CONFD_AZIMUTH_240
            DET_CONFD_ELEVATION_237_oRDR_DETECTION_237_240_oPCAN_RADAR_dfbac3e9_Tx: ComBitPosition=101, ComBitSize=2, ComSignalInitValue=0, ComSignalType=UINT8, ComSystemTemplateSystemSignalRef=DET_CONFD_ELEVATION_237
            DET_CONFD_ELEVATION_238_oRDR_DETECTION_237_240_oPCAN_RADAR_f3aa51ae_Tx: ComBitPosition=213, ComBitSize=2, ComSignalInitValue=0, ComSignalType=UINT8, ComSystemTemplateSystemSignalRef=DET_CONFD_ELEVATION_238
            DET_CONFD_ELEVATION_239_oRDR_DETECTION_237_240_oPCAN_RADAR_66da853b_Tx: ComBitPosition=325, ComBitSize=2, ComSignalInitValue=0, ComSignalType=UINT8, ComSystemTemplateSystemSignalRef=DET_CONFD_ELEVATION_239
            DET_CONFD_ELEVATION_240_oRDR_DETECTION_237_240_oPCAN_RADAR_b738895f_Tx: ComBitPosition=437, ComBitSize=2, ComSignalInitValue=0, ComSignalType=UINT8, ComSystemTemplateSystemSignalRef=DET_CONFD_ELEVATION_240
            DET_ELEVATION_237_oRDR_DETECTION_237_240_oPCAN_RADAR_0e7a17d5_Tx: ComBitPosition=72, ComBitSize=8, ComSignalInitValue=0, ComSignalType=UINT8, ComSystemTemplateSystemSignalRef=DET_ELEVATION_237
            DET_ELEVATION_238_oRDR_DETECTION_237_240_oPCAN_RADAR_226a8592_Tx: ComBitPosition=184, ComBitSize=8, ComSignalInitValue=0, ComSignalType=UINT8, ComSystemTemplateSystemSignalRef=DET_ELEVATION_238
            DET_ELEVATION_239_oRDR_DETECTION_237_240_oPCAN_RADAR_b71a5107_Tx: ComBitPosition=296, ComBitSize=8, ComSignalInitValue=0, ComSignalType=UINT8, ComSystemTemplateSystemSignalRef=DET_ELEVATION_239
            DET_ELEVATION_240_oRDR_DETECTION_237_240_oPCAN_RADAR_66f85d63_Tx: ComBitPosition=408, ComBitSize=8, ComSignalInitValue=0, ComSignalType=UINT8, ComSystemTemplateSystemSignalRef=DET_ELEVATION_240
            DET_ELEVATION_ERR_237_oRDR_DETECTION_237_240_oPCAN_RADAR_89438fa0_Tx: ComBitPosition=80, ComBitSize=6, ComSignalInitValue=0, ComSignalType=UINT8, ComSystemTemplateSystemSignalRef=DET_ELEVATION_ERR_237
            DET_ELEVATION_ERR_238_oRDR_DETECTION_237_240_oPCAN_RADAR_a5531de7_Tx: ComBitPosition=192, ComBitSize=6, ComSignalInitValue=0, ComSignalType=UINT8, ComSystemTemplateSystemSignalRef=DET_ELEVATION_ERR_238
            DET_ELEVATION_ERR_239_oRDR_DETECTION_237_240_oPCAN_RADAR_3023c972_Tx: ComBitPosition=304, ComBitSize=6, ComSignalInitValue=0, ComSignalType=UINT8, ComSystemTemplateSystemSignalRef=DET_ELEVATION_ERR_239
            DET_ELEVATION_ERR_240_oRDR_DETECTION_237_240_oPCAN_RADAR_e1c1c516_Tx: ComBitPosition=416, ComBitSize=6, ComSignalInitValue=0, ComSignalType=UINT8, ComSystemTemplateSystemSignalRef=DET_ELEVATION_ERR_240
            DET_EXISTENCE_PROB_237_oRDR_DETECTION_237_240_oPCAN_RADAR_5bdcfac0_Tx: ComBitPosition=112, ComBitSize=6, ComSignalInitValue=0, ComSignalType=UINT8, ComSystemTemplateSystemSignalRef=DET_EXISTENCE_PROB_237
            DET_EXISTENCE_PROB_238_oRDR_DETECTION_237_240_oPCAN_RADAR_77cc6887_Tx: ComBitPosition=224, ComBitSize=6, ComSignalInitValue=0, ComSignalType=UINT8, ComSystemTemplateSystemSignalRef=DET_EXISTENCE_PROB_238
            DET_EXISTENCE_PROB_239_oRDR_DETECTION_237_240_oPCAN_RADAR_e2bcbc12_Tx: ComBitPosition=336, ComBitSize=6, ComSignalInitValue=0, ComSignalType=UINT8, ComSystemTemplateSystemSignalRef=DET_EXISTENCE_PROB_239
            DET_EXISTENCE_PROB_240_oRDR_DETECTION_237_240_oPCAN_RADAR_335eb076_Tx: ComBitPosition=448, ComBitSize=6, ComSignalInitValue=0, ComSignalType=UINT8, ComSystemTemplateSystemSignalRef=DET_EXISTENCE_PROB_240
            DET_HVC_FLAG_237_oRDR_DETECTION_237_240_oPCAN_RADAR_baa8b9bf_Tx: ComBitPosition=86, ComBitSize=1, ComSignalInitValue=0, ComSignalType=BOOLEAN, ComSystemTemplateSystemSignalRef=DET_HVC_FLAG_237
            DET_HVC_FLAG_238_oRDR_DETECTION_237_240_oPCAN_RADAR_96b82bf8_Tx: ComBitPosition=198, ComBitSize=1, ComSignalInitValue=0, ComSignalType=BOOLEAN, ComSystemTemplateSystemSignalRef=DET_HVC_FLAG_238
            DET_HVC_FLAG_239_oRDR_DETECTION_237_240_oPCAN_RADAR_03c8ff6d_Tx: ComBitPosition=310, ComBitSize=1, ComSignalInitValue=0, ComSignalType=BOOLEAN, ComSystemTemplateSystemSignalRef=DET_HVC_FLAG_239
            DET_HVC_FLAG_240_oRDR_DETECTION_237_240_oPCAN_RADAR_d22af309_Tx: ComBitPosition=422, ComBitSize=1, ComSignalInitValue=0, ComSignalType=BOOLEAN, ComSystemTemplateSystemSignalRef=DET_HVC_FLAG_240
            DET_IDM_237_oRDR_DETECTION_237_240_oPCAN_RADAR_31fa8202_Tx: ComBitPosition=63, ComBitSize=1, ComSignalInitValue=0, ComSignalType=BOOLEAN, ComSystemTemplateSystemSignalRef=DET_IDM_237
            DET_IDM_238_oRDR_DETECTION_237_240_oPCAN_RADAR_1dea1045_Tx: ComBitPosition=175, ComBitSize=1, ComSignalInitValue=0, ComSignalType=BOOLEAN, ComSystemTemplateSystemSignalRef=DET_IDM_238
            DET_IDM_239_oRDR_DETECTION_237_240_oPCAN_RADAR_889ac4d0_Tx: ComBitPosition=287, ComBitSize=1, ComSignalInitValue=0, ComSignalType=BOOLEAN, ComSystemTemplateSystemSignalRef=DET_IDM_239
            DET_IDM_240_oRDR_DETECTION_237_240_oPCAN_RADAR_5978c8b4_Tx: ComBitPosition=399, ComBitSize=1, ComSignalInitValue=0, ComSignalType=BOOLEAN, ComSystemTemplateSystemSignalRef=DET_IDM_240
            DET_MH_CRC16_237_240_oRDR_DETECTION_237_240_oPCAN_RADAR_aa0455ab_Tx: ComBitPosition=0, ComBitSize=16, ComSignalInitValue=0, ComSignalType=UINT16, ComSystemTemplateSystemSignalRef=DET_MH_CRC16_237_240
            DET_MH_CYCLE_COUNTER_237_240_oRDR_DETECTION_237_240_oPCAN_RADAR_2e71f49c_Tx: ComBitPosition=16, ComBitSize=8, ComSignalInitValue=0, ComSignalType=UINT8, ComSystemTemplateSystemSignalRef=DET_MH_CYCLE_COUNTER_237_240
            DET_MH_SCAN_INDEX_4LSB_237_240_oRDR_DETECTION_237_240_oPCAN_RADAR_e25bd110_Tx: ComBitPosition=476, ComBitSize=4, ComSignalInitValue=0, ComSignalType=UINT8, ComSystemTemplateSystemSignalRef=DET_MH_SCAN_INDEX_4LSB_237_240
            DET_MTD_237_oRDR_DETECTION_237_240_oPCAN_RADAR_5749b0d9_Tx: ComBitPosition=47, ComBitSize=1, ComSignalInitValue=0, ComSignalType=BOOLEAN, ComSystemTemplateSystemSignalRef=DET_MTD_237
            DET_MTD_238_oRDR_DETECTION_237_240_oPCAN_RADAR_7b59229e_Tx: ComBitPosition=159, ComBitSize=1, ComSignalInitValue=0, ComSignalType=BOOLEAN, ComSystemTemplateSystemSignalRef=DET_MTD_238
            DET_MTD_239_oRDR_DETECTION_237_240_oPCAN_RADAR_ee29f60b_Tx: ComBitPosition=271, ComBitSize=1, ComSignalInitValue=0, ComSignalType=BOOLEAN, ComSystemTemplateSystemSignalRef=DET_MTD_239
            DET_MTD_240_oRDR_DETECTION_237_240_oPCAN_RADAR_3fcbfa6f_Tx: ComBitPosition=383, ComBitSize=1, ComSignalInitValue=0, ComSignalType=BOOLEAN, ComSystemTemplateSystemSignalRef=DET_MTD_240
            DET_PROB_1STAZHYPO_237_oRDR_DETECTION_237_240_oPCAN_RADAR_c4fd5814_Tx: ComBitPosition=103, ComBitSize=1, ComSignalInitValue=0, ComSignalType=BOOLEAN, ComSystemTemplateSystemSignalRef=DET_PROB_1STAZHYPO_237
            DET_PROB_1STAZHYPO_238_oRDR_DETECTION_237_240_oPCAN_RADAR_e8edca53_Tx: ComBitPosition=215, ComBitSize=1, ComSignalInitValue=0, ComSignalType=BOOLEAN, ComSystemTemplateSystemSignalRef=DET_PROB_1STAZHYPO_238
            DET_PROB_1STAZHYPO_239_oRDR_DETECTION_237_240_oPCAN_RADAR_7d9d1ec6_Tx: ComBitPosition=327, ComBitSize=1, ComSignalInitValue=0, ComSignalType=BOOLEAN, ComSystemTemplateSystemSignalRef=DET_PROB_1STAZHYPO_239
            DET_PROB_1STAZHYPO_240_oRDR_DETECTION_237_240_oPCAN_RADAR_ac7f12a2_Tx: ComBitPosition=439, ComBitSize=1, ComSignalInitValue=0, ComSignalType=BOOLEAN, ComSystemTemplateSystemSignalRef=DET_PROB_1STAZHYPO_240
            DET_RANGE_237_oRDR_DETECTION_237_240_oPCAN_RADAR_cf52bb62_Tx: ComBitPosition=24, ComBitSize=15, ComSignalInitValue=0, ComSignalType=UINT16, ComSystemTemplateSystemSignalRef=DET_RANGE_237
            DET_RANGE_238_oRDR_DETECTION_237_240_oPCAN_RADAR_e3422925_Tx: ComBitPosition=136, ComBitSize=15, ComSignalInitValue=0, ComSignalType=UINT16, ComSystemTemplateSystemSignalRef=DET_RANGE_238
            DET_RANGE_239_oRDR_DETECTION_237_240_oPCAN_RADAR_7632fdb0_Tx: ComBitPosition=248, ComBitSize=15, ComSignalInitValue=0, ComSignalType=UINT16, ComSystemTemplateSystemSignalRef=DET_RANGE_239
            DET_RANGE_240_oRDR_DETECTION_237_240_oPCAN_RADAR_a7d0f1d4_Tx: ComBitPosition=360, ComBitSize=15, ComSignalInitValue=0, ComSignalType=UINT16, ComSystemTemplateSystemSignalRef=DET_RANGE_240
            DET_RANGE_ERR_237_oRDR_DETECTION_237_240_oPCAN_RADAR_68ba010b_Tx: ComBitPosition=40, ComBitSize=7, ComSignalInitValue=0, ComSignalType=UINT8, ComSystemTemplateSystemSignalRef=DET_RANGE_ERR_237
            DET_RANGE_ERR_238_oRDR_DETECTION_237_240_oPCAN_RADAR_44aa934c_Tx: ComBitPosition=152, ComBitSize=7, ComSignalInitValue=0, ComSignalType=UINT8, ComSystemTemplateSystemSignalRef=DET_RANGE_ERR_238
            DET_RANGE_ERR_239_oRDR_DETECTION_237_240_oPCAN_RADAR_d1da47d9_Tx: ComBitPosition=264, ComBitSize=7, ComSignalInitValue=0, ComSignalType=UINT8, ComSystemTemplateSystemSignalRef=DET_RANGE_ERR_239
            DET_RANGE_ERR_240_oRDR_DETECTION_237_240_oPCAN_RADAR_00384bbd_Tx: ComBitPosition=376, ComBitSize=7, ComSignalInitValue=0, ComSignalType=UINT8, ComSystemTemplateSystemSignalRef=DET_RANGE_ERR_240
            DET_RANGE_VELOCITY_237_oRDR_DETECTION_237_240_oPCAN_RADAR_baf47947_Tx: ComBitPosition=48, ComBitSize=15, ComSignalInitValue=16384, ComSignalType=UINT16, ComSystemTemplateSystemSignalRef=DET_RANGE_VELOCITY_237
            DET_RANGE_VELOCITY_238_oRDR_DETECTION_237_240_oPCAN_RADAR_96e4eb00_Tx: ComBitPosition=160, ComBitSize=15, ComSignalInitValue=16384, ComSignalType=UINT16, ComSystemTemplateSystemSignalRef=DET_RANGE_VELOCITY_238
            DET_RANGE_VELOCITY_239_oRDR_DETECTION_237_240_oPCAN_RADAR_03943f95_Tx: ComBitPosition=272, ComBitSize=15, ComSignalInitValue=16384, ComSignalType=UINT16, ComSystemTemplateSystemSignalRef=DET_RANGE_VELOCITY_239
            DET_RANGE_VELOCITY_240_oRDR_DETECTION_237_240_oPCAN_RADAR_d27633f1_Tx: ComBitPosition=384, ComBitSize=15, ComSignalInitValue=16384, ComSignalType=UINT16, ComSystemTemplateSystemSignalRef=DET_RANGE_VELOCITY_240
            DET_RANGE_VELOCITY_ERR_237_oRDR_DETECTION_237_240_oPCAN_RADAR_b54f82f5_Tx: ComBitPosition=64, ComBitSize=8, ComSignalInitValue=0, ComSignalType=UINT8, ComSystemTemplateSystemSignalRef=DET_RANGE_VELOCITY_ERR_237
            DET_RANGE_VELOCITY_ERR_238_oRDR_DETECTION_237_240_oPCAN_RADAR_995f10b2_Tx: ComBitPosition=176, ComBitSize=8, ComSignalInitValue=0, ComSignalType=UINT8, ComSystemTemplateSystemSignalRef=DET_RANGE_VELOCITY_ERR_238
            DET_RANGE_VELOCITY_ERR_239_oRDR_DETECTION_237_240_oPCAN_RADAR_0c2fc427_Tx: ComBitPosition=288, ComBitSize=8, ComSignalInitValue=0, ComSignalType=UINT8, ComSystemTemplateSystemSignalRef=DET_RANGE_VELOCITY_ERR_239
            DET_RANGE_VELOCITY_ERR_240_oRDR_DETECTION_237_240_oPCAN_RADAR_ddcdc843_Tx: ComBitPosition=400, ComBitSize=8, ComSignalInitValue=0, ComSignalType=UINT8, ComSystemTemplateSystemSignalRef=DET_RANGE_VELOCITY_ERR_240
            DET_RCS_237_oRDR_DETECTION_237_240_oPCAN_RADAR_3d744e1d_Tx: ComBitPosition=128, ComBitSize=8, ComSignalInitValue=128, ComSignalType=UINT8, ComSystemTemplateSystemSignalRef=DET_RCS_237
            DET_RCS_238_oRDR_DETECTION_237_240_oPCAN_RADAR_1164dc5a_Tx: ComBitPosition=240, ComBitSize=8, ComSignalInitValue=128, ComSignalType=UINT8, ComSystemTemplateSystemSignalRef=DET_RCS_238
            DET_RCS_239_oRDR_DETECTION_237_240_oPCAN_RADAR_841408cf_Tx: ComBitPosition=352, ComBitSize=8, ComSignalInitValue=128, ComSignalType=UINT8, ComSystemTemplateSystemSignalRef=DET_RCS_239
            DET_RCS_240_oRDR_DETECTION_237_240_oPCAN_RADAR_55f604ab_Tx: ComBitPosition=464, ComBitSize=8, ComSignalInitValue=128, ComSignalType=UINT8, ComSystemTemplateSystemSignalRef=DET_RCS_240
            DET_SNR_237_oRDR_DETECTION_237_240_oPCAN_RADAR_e0da1a1f_Tx: ComBitPosition=120, ComBitSize=8, ComSignalInitValue=0, ComSignalType=UINT8, ComSystemTemplateSystemSignalRef=DET_SNR_237
            DET_SNR_238_oRDR_DETECTION_237_240_oPCAN_RADAR_ccca8858_Tx: ComBitPosition=232, ComBitSize=8, ComSignalInitValue=0, ComSignalType=UINT8, ComSystemTemplateSystemSignalRef=DET_SNR_238
            DET_SNR_239_oRDR_DETECTION_237_240_oPCAN_RADAR_59ba5ccd_Tx: ComBitPosition=344, ComBitSize=8, ComSignalInitValue=0, ComSignalType=UINT8, ComSystemTemplateSystemSignalRef=DET_SNR_239
            DET_SNR_240_oRDR_DETECTION_237_240_oPCAN_RADAR_885850a9_Tx: ComBitPosition=456, ComBitSize=8, ComSignalInitValue=0, ComSignalType=UINT8, ComSystemTemplateSystemSignalRef=DET_SNR_240
            DET_SUPER_RES_TARGET_237_oRDR_DETECTION_237_240_oPCAN_RADAR_d143327a_Tx: ComBitPosition=87, ComBitSize=1, ComSignalInitValue=0, ComSignalType=BOOLEAN, ComSystemTemplateSystemSignalRef=DET_SUPER_RES_TARGET_237
            DET_SUPER_RES_TARGET_238_oRDR_DETECTION_237_240_oPCAN_RADAR_fd53a03d_Tx: ComBitPosition=199, ComBitSize=1, ComSignalInitValue=0, ComSignalType=BOOLEAN, ComSystemTemplateSystemSignalRef=DET_SUPER_RES_TARGET_238
            DET_SUPER_RES_TARGET_239_oRDR_DETECTION_237_240_oPCAN_RADAR_682374a8_Tx: ComBitPosition=311, ComBitSize=1, ComSignalInitValue=0, ComSignalType=BOOLEAN, ComSystemTemplateSystemSignalRef=DET_SUPER_RES_TARGET_239
            DET_SUPER_RES_TARGET_240_oRDR_DETECTION_237_240_oPCAN_RADAR_b9c178cc_Tx: ComBitPosition=423, ComBitSize=1, ComSignalInitValue=0, ComSignalType=BOOLEAN, ComSystemTemplateSystemSignalRef=DET_SUPER_RES_TARGET_240
