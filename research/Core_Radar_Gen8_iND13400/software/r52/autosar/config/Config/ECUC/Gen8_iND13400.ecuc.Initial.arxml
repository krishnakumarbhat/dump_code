[part 17 of 24: package /InitialEcuC]
AUTOSAR XML (schema 00053)
package /InitialEcuC  (continued)
  module config Com  (continued)
    ComConfig  (continued)
      242 x ComSignalGroup, all with ComTransferProperty=PENDING:  (continued)
        SG_Fusion_Detections_101_104_oRDR_FUSION_DET_101_104_oPCAN_RADAR_2dfb2b7d_Rx: ComTimeout=0, ComSystemTemplateSignalGroupRef=SG_Fusion_Detections_101_104
          83 x ComGroupSignal, all with ComSignalEndianness=LITTLE_ENDIAN, ComSignalInitValue=0:
            DET_AZIMUTH_101_Rx_oRDR_FUSION_DET_101_104_oPCAN_RADAR_96b3644f_Rx: ComBitPosition=88, ComBitSize=13, ComSignalType=UINT16, ComSystemTemplateSystemSignalRef=DET_AZIMUTH_101_Rx
            DET_AZIMUTH_102_Rx_oRDR_FUSION_DET_101_104_oPCAN_RADAR_bc0fd4c7_Rx: ComBitPosition=200, ComBitSize=13, ComSignalType=UINT16, ComSystemTemplateSystemSignalRef=DET_AZIMUTH_102_Rx
            DET_AZIMUTH_103_Rx_oRDR_FUSION_DET_101_104_oPCAN_RADAR_134b4680_Rx: ComBitPosition=312, ComBitSize=13, ComSignalType=UINT16, ComSystemTemplateSystemSignalRef=DET_AZIMUTH_103_Rx
            DET_AZIMUTH_104_Rx_oRDR_FUSION_DET_101_104_oPCAN_RADAR_e976b5d7_Rx: ComBitPosition=424, ComBitSize=13, ComSignalType=UINT16, ComSystemTemplateSystemSignalRef=DET_AZIMUTH_104_Rx
            DET_AZIMUTH_ERR_101_Rx_oRDR_FUSION_DET_101_104_oPCAN_RADAR_94dac5cd_Rx: ComBitPosition=105, ComBitSize=7, ComSignalType=UINT8, ComSystemTemplateSystemSignalRef=DET_AZIMUTH_ERR_101_Rx
            DET_AZIMUTH_ERR_102_Rx_oRDR_FUSION_DET_101_104_oPCAN_RADAR_be667545_Rx: ComBitPosition=217, ComBitSize=7, ComSignalType=UINT8, ComSystemTemplateSystemSignalRef=DET_AZIMUTH_ERR_102_Rx
            DET_AZIMUTH_ERR_103_Rx_oRDR_FUSION_DET_101_104_oPCAN_RADAR_1122e702_Rx: ComBitPosition=329, ComBitSize=7, ComSignalType=UINT8, ComSystemTemplateSystemSignalRef=DET_AZIMUTH_ERR_103_Rx
            DET_AZIMUTH_ERR_104_Rx_oRDR_FUSION_DET_101_104_oPCAN_RADAR_eb1f1455_Rx: ComBitPosition=441, ComBitSize=7, ComSignalType=UINT8, ComSystemTemplateSystemSignalRef=DET_AZIMUTH_ERR_104_Rx
            DET_BELOW_RAIN_THOLD_101_Rx_oRDR_FUSION_DET_101_104_oPCAN_RADAR_f0099bfa_Rx: ComBitPosition=39, ComBitSize=1, ComSignalType=BOOLEAN, ComSystemTemplateSystemSignalRef=DET_BELOW_RAIN_THOLD_101_Rx
            DET_BELOW_RAIN_THOLD_102_Rx_oRDR_FUSION_DET_101_104_oPCAN_RADAR_dab52b72_Rx: ComBitPosition=151, ComBitSize=1, ComSignalType=BOOLEAN, ComSystemTemplateSystemSignalRef=DET_BELOW_RAIN_THOLD_102_Rx
            DET_BELOW_RAIN_THOLD_103_Rx_oRDR_FUSION_DET_101_104_oPCAN_RADAR_75f1b935_Rx: ComBitPosition=263, ComBitSize=1, ComSignalType=BOOLEAN, ComSystemTemplateSystemSignalRef=DET_BELOW_RAIN_THOLD_103_Rx
            DET_BELOW_RAIN_THOLD_104_Rx_oRDR_FUSION_DET_101_104_oPCAN_RADAR_8fcc4a62_Rx: ComBitPosition=375, ComBitSize=1, ComSignalType=BOOLEAN, ComSystemTemplateSystemSignalRef=DET_BELOW_RAIN_THOLD_104_Rx
            DET_BI_STATIC_FLAG_101_Rx_oRDR_FUSION_DET_101_104_oPCAN_RADAR_879730e9_Rx: ComBitPosition=104, ComBitSize=1, ComSignalType=BOOLEAN, ComSystemTemplateSystemSignalRef=DET_BI_STATIC_FLAG_101_Rx
            DET_BI_STATIC_FLAG_102_Rx_oRDR_FUSION_DET_101_104_oPCAN_RADAR_ad2b8061_Rx: ComBitPosition=216, ComBitSize=1, ComSignalType=BOOLEAN, ComSystemTemplateSystemSignalRef=DET_BI_STATIC_FLAG_102_Rx
            DET_BI_STATIC_FLAG_103_Rx_oRDR_FUSION_DET_101_104_oPCAN_RADAR_026f1226_Rx: ComBitPosition=328, ComBitSize=1, ComSignalType=BOOLEAN, ComSystemTemplateSystemSignalRef=DET_BI_STATIC_FLAG_103_Rx
            DET_BI_STATIC_FLAG_104_Rx_oRDR_FUSION_DET_101_104_oPCAN_RADAR_f852e171_Rx: ComBitPosition=440, ComBitSize=1, ComSignalType=BOOLEAN, ComSystemTemplateSystemSignalRef=DET_BI_STATIC_FLAG_104_Rx
            DET_CONFD_AZIMUTH_101_Rx_oRDR_FUSION_DET_101_104_oPCAN_RADAR_64fedabd_Rx: ComBitPosition=118, ComBitSize=2, ComSignalType=UINT8, ComSystemTemplateSystemSignalRef=DET_CONFD_AZIMUTH_101_Rx
            DET_CONFD_AZIMUTH_102_Rx_oRDR_FUSION_DET_101_104_oPCAN_RADAR_4e426a35_Rx: ComBitPosition=230, ComBitSize=2, ComSignalType=UINT8, ComSystemTemplateSystemSignalRef=DET_CONFD_AZIMUTH_102_Rx
            DET_CONFD_AZIMUTH_103_Rx_oRDR_FUSION_DET_101_104_oPCAN_RADAR_e106f872_Rx: ComBitPosition=342, ComBitSize=2, ComSignalType=UINT8, ComSystemTemplateSystemSignalRef=DET_CONFD_AZIMUTH_103_Rx
            DET_CONFD_AZIMUTH_104_Rx_oRDR_FUSION_DET_101_104_oPCAN_RADAR_1b3b0b25_Rx: ComBitPosition=454, ComBitSize=2, ComSignalType=UINT8, ComSystemTemplateSystemSignalRef=DET_CONFD_AZIMUTH_104_Rx
            DET_CONFD_ELEVATION_101_Rx_oRDR_FUSION_DET_101_104_oPCAN_RADAR_6edf593a_Rx: ComBitPosition=101, ComBitSize=2, ComSignalType=UINT8, ComSystemTemplateSystemSignalRef=DET_CONFD_ELEVATION_101_Rx
            DET_CONFD_ELEVATION_102_Rx_oRDR_FUSION_DET_101_104_oPCAN_RADAR_4463e9b2_Rx: ComBitPosition=213, ComBitSize=2, ComSignalType=UINT8, ComSystemTemplateSystemSignalRef=DET_CONFD_ELEVATION_102_Rx
            DET_CONFD_ELEVATION_103_Rx_oRDR_FUSION_DET_101_104_oPCAN_RADAR_eb277bf5_Rx: ComBitPosition=325, ComBitSize=2, ComSignalType=UINT8, ComSystemTemplateSystemSignalRef=DET_CONFD_ELEVATION_103_Rx
            DET_CONFD_ELEVATION_104_Rx_oRDR_FUSION_DET_101_104_oPCAN_RADAR_111a88a2_Rx: ComBitPosition=437, ComBitSize=2, ComSignalType=UINT8, ComSystemTemplateSystemSignalRef=DET_CONFD_ELEVATION_104_Rx
            DET_ELEVATION_101_Rx_oRDR_FUSION_DET_101_104_oPCAN_RADAR_648cb6c3_Rx: ComBitPosition=72, ComBitSize=8, ComSignalType=UINT8, ComSystemTemplateSystemSignalRef=DET_ELEVATION_101_Rx
            DET_ELEVATION_102_Rx_oRDR_FUSION_DET_101_104_oPCAN_RADAR_4e30064b_Rx: ComBitPosition=184, ComBitSize=8, ComSignalType=UINT8, ComSystemTemplateSystemSignalRef=DET_ELEVATION_102_Rx
            DET_ELEVATION_103_Rx_oRDR_FUSION_DET_101_104_oPCAN_RADAR_e174940c_Rx: ComBitPosition=296, ComBitSize=8, ComSignalType=UINT8, ComSystemTemplateSystemSignalRef=DET_ELEVATION_103_Rx
            DET_ELEVATION_104_Rx_oRDR_FUSION_DET_101_104_oPCAN_RADAR_1b49675b_Rx: ComBitPosition=408, ComBitSize=8, ComSignalType=UINT8, ComSystemTemplateSystemSignalRef=DET_ELEVATION_104_Rx
            DET_ELEVATION_ERR_101_Rx_oRDR_FUSION_DET_101_104_oPCAN_RADAR_b635941c_Rx: ComBitPosition=80, ComBitSize=6, ComSignalType=UINT8, ComSystemTemplateSystemSignalRef=DET_ELEVATION_ERR_101_Rx
            DET_ELEVATION_ERR_102_Rx_oRDR_FUSION_DET_101_104_oPCAN_RADAR_9c892494_Rx: ComBitPosition=192, ComBitSize=6, ComSignalType=UINT8, ComSystemTemplateSystemSignalRef=DET_ELEVATION_ERR_102_Rx
            DET_ELEVATION_ERR_103_Rx_oRDR_FUSION_DET_101_104_oPCAN_RADAR_33cdb6d3_Rx: ComBitPosition=304, ComBitSize=6, ComSignalType=UINT8, ComSystemTemplateSystemSignalRef=DET_ELEVATION_ERR_103_Rx
            DET_ELEVATION_ERR_104_Rx_oRDR_FUSION_DET_101_104_oPCAN_RADAR_c9f04584_Rx: ComBitPosition=416, ComBitSize=6, ComSignalType=UINT8, ComSystemTemplateSystemSignalRef=DET_ELEVATION_ERR_104_Rx
            DET_EXISTENCE_PROB_101_Rx_oRDR_FUSION_DET_101_104_oPCAN_RADAR_412dec89_Rx: ComBitPosition=112, ComBitSize=6, ComSignalType=UINT8, ComSystemTemplateSystemSignalRef=DET_EXISTENCE_PROB_101_Rx
            DET_EXISTENCE_PROB_102_Rx_oRDR_FUSION_DET_101_104_oPCAN_RADAR_6b915c01_Rx: ComBitPosition=224, ComBitSize=6, ComSignalType=UINT8, ComSystemTemplateSystemSignalRef=DET_EXISTENCE_PROB_102_Rx
            DET_EXISTENCE_PROB_103_Rx_oRDR_FUSION_DET_101_104_oPCAN_RADAR_c4d5ce46_Rx: ComBitPosition=336, ComBitSize=6, ComSignalType=UINT8, ComSystemTemplateSystemSignalRef=DET_EXISTENCE_PROB_103_Rx
            DET_EXISTENCE_PROB_104_Rx_oRDR_FUSION_DET_101_104_oPCAN_RADAR_3ee83d11_Rx: ComBitPosition=448, ComBitSize=6, ComSignalType=UINT8, ComSystemTemplateSystemSignalRef=DET_EXISTENCE_PROB_104_Rx
            DET_HVC_FLAG_101_Rx_oRDR_FUSION_DET_101_104_oPCAN_RADAR_9cf301c6_Rx: ComBitPosition=86, ComBitSize=1, ComSignalType=BOOLEAN, ComSystemTemplateSystemSignalRef=DET_HVC_FLAG_101_Rx
            DET_HVC_FLAG_102_Rx_oRDR_FUSION_DET_101_104_oPCAN_RADAR_b64fb14e_Rx: ComBitPosition=198, ComBitSize=1, ComSignalType=BOOLEAN, ComSystemTemplateSystemSignalRef=DET_HVC_FLAG_102_Rx
            DET_HVC_FLAG_103_Rx_oRDR_FUSION_DET_101_104_oPCAN_RADAR_190b2309_Rx: ComBitPosition=310, ComBitSize=1, ComSignalType=BOOLEAN, ComSystemTemplateSystemSignalRef=DET_HVC_FLAG_103_Rx
            DET_HVC_FLAG_104_Rx_oRDR_FUSION_DET_101_104_oPCAN_RADAR_e336d05e_Rx: ComBitPosition=422, ComBitSize=1, ComSignalType=BOOLEAN, ComSystemTemplateSystemSignalRef=DET_HVC_FLAG_104_Rx
            DET_IDM_101_Rx_oRDR_FUSION_DET_101_104_oPCAN_RADAR_a932f88e_Rx: ComBitPosition=63, ComBitSize=1, ComSignalType=BOOLEAN, ComSystemTemplateSystemSignalRef=DET_IDM_101_Rx
            DET_IDM_102_Rx_oRDR_FUSION_DET_101_104_oPCAN_RADAR_838e4806_Rx: ComBitPosition=175, ComBitSize=1, ComSignalType=BOOLEAN, ComSystemTemplateSystemSignalRef=DET_IDM_102_Rx
            DET_IDM_103_Rx_oRDR_FUSION_DET_101_104_oPCAN_RADAR_2ccada41_Rx: ComBitPosition=287, ComBitSize=1, ComSignalType=BOOLEAN, ComSystemTemplateSystemSignalRef=DET_IDM_103_Rx
            DET_IDM_104_Rx_oRDR_FUSION_DET_101_104_oPCAN_RADAR_d6f72916_Rx: ComBitPosition=399, ComBitSize=1, ComSignalType=BOOLEAN, ComSystemTemplateSystemSignalRef=DET_IDM_104_Rx
            DET_MH_CRC16_101_104_Rx_oRDR_FUSION_DET_101_104_oPCAN_RADAR_cf19934c_Rx: ComBitPosition=0, ComBitSize=16, ComSignalType=UINT16, ComSystemTemplateSystemSignalRef=DET_MH_CRC16_101_104_Rx
            DET_MH_CYCLE_COUNTER_101_104_Rx_oRDR_FUSION_DET_101_104_oPCAN_RADAR_c2c2ae89_Rx: ComBitPosition=16, ComBitSize=8, ComSignalType=UINT8, ComSystemTemplateSystemSignalRef=DET_MH_CYCLE_COUNTER_101_104_Rx
            DET_MH_SCAN_INDEX_4LSB_101_104_Rx_oRDR_FUSION_DET_101_104_oPCAN_RADAR_a67261b2_Rx: ComBitPosition=476, ComBitSize=4, ComSignalType=UINT8, ComSystemTemplateSystemSignalRef=DET_MH_SCAN_INDEX_4LSB_101_104_Rx
            DET_MTD_101_Rx_oRDR_FUSION_DET_101_104_oPCAN_RADAR_14b1cefe_Rx: ComBitPosition=47, ComBitSize=1, ComSignalType=BOOLEAN, ComSystemTemplateSystemSignalRef=DET_MTD_101_Rx
            DET_MTD_102_Rx_oRDR_FUSION_DET_101_104_oPCAN_RADAR_3e0d7e76_Rx: ComBitPosition=159, ComBitSize=1, ComSignalType=BOOLEAN, ComSystemTemplateSystemSignalRef=DET_MTD_102_Rx
            DET_MTD_103_Rx_oRDR_FUSION_DET_101_104_oPCAN_RADAR_9149ec31_Rx: ComBitPosition=271, ComBitSize=1, ComSignalType=BOOLEAN, ComSystemTemplateSystemSignalRef=DET_MTD_103_Rx
            DET_MTD_104_Rx_oRDR_FUSION_DET_101_104_oPCAN_RADAR_6b741f66_Rx: ComBitPosition=383, ComBitSize=1, ComSignalType=BOOLEAN, ComSystemTemplateSystemSignalRef=DET_MTD_104_Rx
            DET_PROB_1STAZHYPO_101_Rx_oRDR_FUSION_DET_101_104_oPCAN_RADAR_dec8d07f_Rx: ComBitPosition=103, ComBitSize=1, ComSignalType=BOOLEAN, ComSystemTemplateSystemSignalRef=DET_PROB_1STAZHYPO_101_Rx
            DET_PROB_1STAZHYPO_102_Rx_oRDR_FUSION_DET_101_104_oPCAN_RADAR_f47460f7_Rx: ComBitPosition=215, ComBitSize=1, ComSignalType=BOOLEAN, ComSystemTemplateSystemSignalRef=DET_PROB_1STAZHYPO_102_Rx
            DET_PROB_1STAZHYPO_103_Rx_oRDR_FUSION_DET_101_104_oPCAN_RADAR_5b30f2b0_Rx: ComBitPosition=327, ComBitSize=1, ComSignalType=BOOLEAN, ComSystemTemplateSystemSignalRef=DET_PROB_1STAZHYPO_103_Rx
            DET_PROB_1STAZHYPO_104_Rx_oRDR_FUSION_DET_101_104_oPCAN_RADAR_a10d01e7_Rx: ComBitPosition=439, ComBitSize=1, ComSignalType=BOOLEAN, ComSystemTemplateSystemSignalRef=DET_PROB_1STAZHYPO_104_Rx
            DET_RANGE_101_Rx_oRDR_FUSION_DET_101_104_oPCAN_RADAR_85753868_Rx: ComBitPosition=24, ComBitSize=15, ComSignalType=UINT16, ComSystemTemplateSystemSignalRef=DET_RANGE_101_Rx
            DET_RANGE_102_Rx_oRDR_FUSION_DET_101_104_oPCAN_RADAR_afc988e0_Rx: ComBitPosition=136, ComBitSize=15, ComSignalType=UINT16, ComSystemTemplateSystemSignalRef=DET_RANGE_102_Rx
            DET_RANGE_103_Rx_oRDR_FUSION_DET_101_104_oPCAN_RADAR_008d1aa7_Rx: ComBitPosition=248, ComBitSize=15, ComSignalType=UINT16, ComSystemTemplateSystemSignalRef=DET_RANGE_103_Rx
            DET_RANGE_104_Rx_oRDR_FUSION_DET_101_104_oPCAN_RADAR_fab0e9f0_Rx: ComBitPosition=360, ComBitSize=15, ComSignalType=UINT16, ComSystemTemplateSystemSignalRef=DET_RANGE_104_Rx
            DET_RANGE_ERR_101_Rx_oRDR_FUSION_DET_101_104_oPCAN_RADAR_d587b488_Rx: ComBitPosition=40, ComBitSize=7, ComSignalType=UINT8, ComSystemTemplateSystemSignalRef=DET_RANGE_ERR_101_Rx
            DET_RANGE_ERR_102_Rx_oRDR_FUSION_DET_101_104_oPCAN_RADAR_ff3b0400_Rx: ComBitPosition=152, ComBitSize=7, ComSignalType=UINT8, ComSystemTemplateSystemSignalRef=DET_RANGE_ERR_102_Rx
            DET_RANGE_ERR_103_Rx_oRDR_FUSION_DET_101_104_oPCAN_RADAR_507f9647_Rx: ComBitPosition=264, ComBitSize=7, ComSignalType=UINT8, ComSystemTemplateSystemSignalRef=DET_RANGE_ERR_103_Rx
            DET_RANGE_ERR_104_Rx_oRDR_FUSION_DET_101_104_oPCAN_RADAR_aa426510_Rx: ComBitPosition=376, ComBitSize=7, ComSignalType=UINT8, ComSystemTemplateSystemSignalRef=DET_RANGE_ERR_104_Rx
            DET_RANGE_VELOCITY_101_Rx_oRDR_FUSION_DET_101_104_oPCAN_RADAR_5880bb96_Rx: ComBitPosition=48, ComBitSize=15, ComSignalType=UINT16, ComSystemTemplateSystemSignalRef=DET_RANGE_VELOCITY_101_Rx
            DET_RANGE_VELOCITY_102_Rx_oRDR_FUSION_DET_101_104_oPCAN_RADAR_723c0b1e_Rx: ComBitPosition=160, ComBitSize=15, ComSignalType=UINT16, ComSystemTemplateSystemSignalRef=DET_RANGE_VELOCITY_102_Rx
            DET_RANGE_VELOCITY_103_Rx_oRDR_FUSION_DET_101_104_oPCAN_RADAR_dd789959_Rx: ComBitPosition=272, ComBitSize=15, ComSignalType=UINT16, ComSystemTemplateSystemSignalRef=DET_RANGE_VELOCITY_103_Rx
            DET_RANGE_VELOCITY_104_Rx_oRDR_FUSION_DET_101_104_oPCAN_RADAR_27456a0e_Rx: ComBitPosition=384, ComBitSize=15, ComSignalType=UINT16, ComSystemTemplateSystemSignalRef=DET_RANGE_VELOCITY_104_Rx
            DET_RANGE_VELOCITY_ERR_101_Rx_oRDR_FUSION_DET_101_104_oPCAN_RADAR_c1e4cb54_Rx: ComBitPosition=64, ComBitSize=8, ComSignalType=UINT8, ComSystemTemplateSystemSignalRef=DET_RANGE_VELOCITY_ERR_101_Rx
            DET_RANGE_VELOCITY_ERR_102_Rx_oRDR_FUSION_DET_101_104_oPCAN_RADAR_eb587bdc_Rx: ComBitPosition=176, ComBitSize=8, ComSignalType=UINT8, ComSystemTemplateSystemSignalRef=DET_RANGE_VELOCITY_ERR_102_Rx
            DET_RANGE_VELOCITY_ERR_103_Rx_oRDR_FUSION_DET_101_104_oPCAN_RADAR_441ce99b_Rx: ComBitPosition=288, ComBitSize=8, ComSignalType=UINT8, ComSystemTemplateSystemSignalRef=DET_RANGE_VELOCITY_ERR_103_Rx
            DET_RANGE_VELOCITY_ERR_104_Rx_oRDR_FUSION_DET_101_104_oPCAN_RADAR_be211acc_Rx: ComBitPosition=400, ComBitSize=8, ComSignalType=UINT8, ComSystemTemplateSystemSignalRef=DET_RANGE_VELOCITY_ERR_104_Rx
            DET_RCS_101_Rx_oRDR_FUSION_DET_101_104_oPCAN_RADAR_954b298d_Rx: ComBitPosition=128, ComBitSize=8, ComSignalType=UINT8, ComSystemTemplateSystemSignalRef=DET_RCS_101_Rx
            DET_RCS_102_Rx_oRDR_FUSION_DET_101_104_oPCAN_RADAR_bff79905_Rx: ComBitPosition=240, ComBitSize=8, ComSignalType=UINT8, ComSystemTemplateSystemSignalRef=DET_RCS_102_Rx
            DET_RCS_103_Rx_oRDR_FUSION_DET_101_104_oPCAN_RADAR_10b30b42_Rx: ComBitPosition=352, ComBitSize=8, ComSignalType=UINT8, ComSystemTemplateSystemSignalRef=DET_RCS_103_Rx
            DET_RCS_104_Rx_oRDR_FUSION_DET_101_104_oPCAN_RADAR_ea8ef815_Rx: ComBitPosition=464, ComBitSize=8, ComSignalType=UINT8, ComSystemTemplateSystemSignalRef=DET_RCS_104_Rx
            DET_SNR_101_Rx_oRDR_FUSION_DET_101_104_oPCAN_RADAR_9c115864_Rx: ComBitPosition=120, ComBitSize=8, ComSignalType=UINT8, ComSystemTemplateSystemSignalRef=DET_SNR_101_Rx
            DET_SNR_102_Rx_oRDR_FUSION_DET_101_104_oPCAN_RADAR_b6ade8ec_Rx: ComBitPosition=232, ComBitSize=8, ComSignalType=UINT8, ComSystemTemplateSystemSignalRef=DET_SNR_102_Rx
            DET_SNR_103_Rx_oRDR_FUSION_DET_101_104_oPCAN_RADAR_19e97aab_Rx: ComBitPosition=344, ComBitSize=8, ComSignalType=UINT8, ComSystemTemplateSystemSignalRef=DET_SNR_103_Rx
            DET_SNR_104_Rx_oRDR_FUSION_DET_101_104_oPCAN_RADAR_e3d489fc_Rx: ComBitPosition=456, ComBitSize=8, ComSignalType=UINT8, ComSystemTemplateSystemSignalRef=DET_SNR_104_Rx
            DET_SUPER_RES_TARGET_101_Rx_oRDR_FUSION_DET_101_104_oPCAN_RADAR_57ea7964_Rx: ComBitPosition=87, ComBitSize=1, ComSignalType=BOOLEAN, ComSystemTemplateSystemSignalRef=DET_SUPER_RES_TARGET_101_Rx
            DET_SUPER_RES_TARGET_102_Rx_oRDR_FUSION_DET_101_104_oPCAN_RADAR_7d56c9ec_Rx: ComBitPosition=199, ComBitSize=1, ComSignalType=BOOLEAN, ComSystemTemplateSystemSignalRef=DET_SUPER_RES_TARGET_102_Rx
            DET_SUPER_RES_TARGET_103_Rx_oRDR_FUSION_DET_101_104_oPCAN_RADAR_d2125bab_Rx: ComBitPosition=311, ComBitSize=1, ComSignalType=BOOLEAN, ComSystemTemplateSystemSignalRef=DET_SUPER_RES_TARGET_103_Rx
            DET_SUPER_RES_TARGET_104_Rx_oRDR_FUSION_DET_101_104_oPCAN_RADAR_282fa8fc_Rx: ComBitPosition=423, ComBitSize=1, ComSignalType=BOOLEAN, ComSystemTemplateSystemSignalRef=DET_SUPER_RES_TARGET_104_Rx
        SG_Fusion_Detections_105_108_oRDR_FUSION_DET_105_108_oPCAN_RADAR_6000008e_Rx: ComTimeout=0, ComSystemTemplateSignalGroupRef=SG_Fusion_Detections_105_108
          83 x ComGroupSignal, all with ComSignalEndianness=LITTLE_ENDIAN, ComSignalInitValue=0:
            DET_AZIMUTH_105_Rx_oRDR_FUSION_DET_105_108_oPCAN_RADAR_af80b9a4_Rx: ComBitPosition=88, ComBitSize=13, ComSignalType=UINT16, ComSystemTemplateSystemSignalRef=DET_AZIMUTH_105_Rx
            DET_AZIMUTH_106_Rx_oRDR_FUSION_DET_105_108_oPCAN_RADAR_853c092c_Rx: ComBitPosition=200, ComBitSize=13, ComSignalType=UINT16, ComSystemTemplateSystemSignalRef=DET_AZIMUTH_106_Rx
            DET_AZIMUTH_107_Rx_oRDR_FUSION_DET_105_108_oPCAN_RADAR_2a789b6b_Rx: ComBitPosition=312, ComBitSize=13, ComSignalType=UINT16, ComSystemTemplateSystemSignalRef=DET_AZIMUTH_107_Rx
            DET_AZIMUTH_108_Rx_oRDR_FUSION_DET_105_108_oPCAN_RADAR_aa36e9c3_Rx: ComBitPosition=424, ComBitSize=13, ComSignalType=UINT16, ComSystemTemplateSystemSignalRef=DET_AZIMUTH_108_Rx
            DET_AZIMUTH_ERR_105_Rx_oRDR_FUSION_DET_105_108_oPCAN_RADAR_ade91826_Rx: ComBitPosition=105, ComBitSize=7, ComSignalType=UINT8, ComSystemTemplateSystemSignalRef=DET_AZIMUTH_ERR_105_Rx
            DET_AZIMUTH_ERR_106_Rx_oRDR_FUSION_DET_105_108_oPCAN_RADAR_8755a8ae_Rx: ComBitPosition=217, ComBitSize=7, ComSignalType=UINT8, ComSystemTemplateSystemSignalRef=DET_AZIMUTH_ERR_106_Rx
            DET_AZIMUTH_ERR_107_Rx_oRDR_FUSION_DET_105_108_oPCAN_RADAR_28113ae9_Rx: ComBitPosition=329, ComBitSize=7, ComSignalType=UINT8, ComSystemTemplateSystemSignalRef=DET_AZIMUTH_ERR_107_Rx
            DET_AZIMUTH_ERR_108_Rx_oRDR_FUSION_DET_105_108_oPCAN_RADAR_a85f4841_Rx: ComBitPosition=441, ComBitSize=7, ComSignalType=UINT8, ComSystemTemplateSystemSignalRef=DET_AZIMUTH_ERR_108_Rx
            DET_BELOW_RAIN_THOLD_105_Rx_oRDR_FUSION_DET_105_108_oPCAN_RADAR_c93a4611_Rx: ComBitPosition=39, ComBitSize=1, ComSignalType=BOOLEAN, ComSystemTemplateSystemSignalRef=DET_BELOW_RAIN_THOLD_105_Rx
            DET_BELOW_RAIN_THOLD_106_Rx_oRDR_FUSION_DET_105_108_oPCAN_RADAR_e386f699_Rx: ComBitPosition=151, ComBitSize=1, ComSignalType=BOOLEAN, ComSystemTemplateSystemSignalRef=DET_BELOW_RAIN_THOLD_106_Rx
            DET_BELOW_RAIN_THOLD_107_Rx_oRDR_FUSION_DET_105_108_oPCAN_RADAR_4cc264de_Rx: ComBitPosition=263, ComBitSize=1, ComSignalType=BOOLEAN, ComSystemTemplateSystemSignalRef=DET_BELOW_RAIN_THOLD_107_Rx
            DET_BELOW_RAIN_THOLD_108_Rx_oRDR_FUSION_DET_105_108_oPCAN_RADAR_cc8c1676_Rx: ComBitPosition=375, ComBitSize=1, ComSignalType=BOOLEAN, ComSystemTemplateSystemSignalRef=DET_BELOW_RAIN_THOLD_108_Rx
            DET_BI_STATIC_FLAG_105_Rx_oRDR_FUSION_DET_105_108_oPCAN_RADAR_bea4ed02_Rx: ComBitPosition=104, ComBitSize=1, ComSignalType=BOOLEAN, ComSystemTemplateSystemSignalRef=DET_BI_STATIC_FLAG_105_Rx
            DET_BI_STATIC_FLAG_106_Rx_oRDR_FUSION_DET_105_108_oPCAN_RADAR_94185d8a_Rx: ComBitPosition=216, ComBitSize=1, ComSignalType=BOOLEAN, ComSystemTemplateSystemSignalRef=DET_BI_STATIC_FLAG_106_Rx
            DET_BI_STATIC_FLAG_107_Rx_oRDR_FUSION_DET_105_108_oPCAN_RADAR_3b5ccfcd_Rx: ComBitPosition=328, ComBitSize=1, ComSignalType=BOOLEAN, ComSystemTemplateSystemSignalRef=DET_BI_STATIC_FLAG_107_Rx
            DET_BI_STATIC_FLAG_108_Rx_oRDR_FUSION_DET_105_108_oPCAN_RADAR_bb12bd65_Rx: ComBitPosition=440, ComBitSize=1, ComSignalType=BOOLEAN, ComSystemTemplateSystemSignalRef=DET_BI_STATIC_FLAG_108_Rx
            DET_CONFD_AZIMUTH_105_Rx_oRDR_FUSION_DET_105_108_oPCAN_RADAR_5dcd0756_Rx: ComBitPosition=118, ComBitSize=2, ComSignalType=UINT8, ComSystemTemplateSystemSignalRef=DET_CONFD_AZIMUTH_105_Rx
            DET_CONFD_AZIMUTH_106_Rx_oRDR_FUSION_DET_105_108_oPCAN_RADAR_7771b7de_Rx: ComBitPosition=230, ComBitSize=2, ComSignalType=UINT8, ComSystemTemplateSystemSignalRef=DET_CONFD_AZIMUTH_106_Rx
            DET_CONFD_AZIMUTH_107_Rx_oRDR_FUSION_DET_105_108_oPCAN_RADAR_d8352599_Rx: ComBitPosition=342, ComBitSize=2, ComSignalType=UINT8, ComSystemTemplateSystemSignalRef=DET_CONFD_AZIMUTH_107_Rx
            DET_CONFD_AZIMUTH_108_Rx_oRDR_FUSION_DET_105_108_oPCAN_RADAR_587b5731_Rx: ComBitPosition=454, ComBitSize=2, ComSignalType=UINT8, ComSystemTemplateSystemSignalRef=DET_CONFD_AZIMUTH_108_Rx
            DET_CONFD_ELEVATION_105_Rx_oRDR_FUSION_DET_105_108_oPCAN_RADAR_57ec84d1_Rx: ComBitPosition=101, ComBitSize=2, ComSignalType=UINT8, ComSystemTemplateSystemSignalRef=DET_CONFD_ELEVATION_105_Rx
            DET_CONFD_ELEVATION_106_Rx_oRDR_FUSION_DET_105_108_oPCAN_RADAR_7d503459_Rx: ComBitPosition=213, ComBitSize=2, ComSignalType=UINT8, ComSystemTemplateSystemSignalRef=DET_CONFD_ELEVATION_106_Rx
            DET_CONFD_ELEVATION_107_Rx_oRDR_FUSION_DET_105_108_oPCAN_RADAR_d214a61e_Rx: ComBitPosition=325, ComBitSize=2, ComSignalType=UINT8, ComSystemTemplateSystemSignalRef=DET_CONFD_ELEVATION_107_Rx
            DET_CONFD_ELEVATION_108_Rx_oRDR_FUSION_DET_105_108_oPCAN_RADAR_525ad4b6_Rx: ComBitPosition=437, ComBitSize=2, ComSignalType=UINT8, ComSystemTemplateSystemSignalRef=DET_CONFD_ELEVATION_108_Rx
            DET_ELEVATION_105_Rx_oRDR_FUSION_DET_105_108_oPCAN_RADAR_5dbf6b28_Rx: ComBitPosition=72, ComBitSize=8, ComSignalType=UINT8, ComSystemTemplateSystemSignalRef=DET_ELEVATION_105_Rx
            DET_ELEVATION_106_Rx_oRDR_FUSION_DET_105_108_oPCAN_RADAR_7703dba0_Rx: ComBitPosition=184, ComBitSize=8, ComSignalType=UINT8, ComSystemTemplateSystemSignalRef=DET_ELEVATION_106_Rx
            DET_ELEVATION_107_Rx_oRDR_FUSION_DET_105_108_oPCAN_RADAR_d84749e7_Rx: ComBitPosition=296, ComBitSize=8, ComSignalType=UINT8, ComSystemTemplateSystemSignalRef=DET_ELEVATION_107_Rx
            DET_ELEVATION_108_Rx_oRDR_FUSION_DET_105_108_oPCAN_RADAR_58093b4f_Rx: ComBitPosition=408, ComBitSize=8, ComSignalType=UINT8, ComSystemTemplateSystemSignalRef=DET_ELEVATION_108_Rx
            DET_ELEVATION_ERR_105_Rx_oRDR_FUSION_DET_105_108_oPCAN_RADAR_8f0649f7_Rx: ComBitPosition=80, ComBitSize=6, ComSignalType=UINT8, ComSystemTemplateSystemSignalRef=DET_ELEVATION_ERR_105_Rx
            DET_ELEVATION_ERR_106_Rx_oRDR_FUSION_DET_105_108_oPCAN_RADAR_a5baf97f_Rx: ComBitPosition=192, ComBitSize=6, ComSignalType=UINT8, ComSystemTemplateSystemSignalRef=DET_ELEVATION_ERR_106_Rx
            DET_ELEVATION_ERR_107_Rx_oRDR_FUSION_DET_105_108_oPCAN_RADAR_0afe6b38_Rx: ComBitPosition=304, ComBitSize=6, ComSignalType=UINT8, ComSystemTemplateSystemSignalRef=DET_ELEVATION_ERR_107_Rx
            DET_ELEVATION_ERR_108_Rx_oRDR_FUSION_DET_105_108_oPCAN_RADAR_8ab01990_Rx: ComBitPosition=416, ComBitSize=6, ComSignalType=UINT8, ComSystemTemplateSystemSignalRef=DET_ELEVATION_ERR_108_Rx
            DET_EXISTENCE_PROB_105_Rx_oRDR_FUSION_DET_105_108_oPCAN_RADAR_781e3162_Rx: ComBitPosition=112, ComBitSize=6, ComSignalType=UINT8, ComSystemTemplateSystemSignalRef=DET_EXISTENCE_PROB_105_Rx
            DET_EXISTENCE_PROB_106_Rx_oRDR_FUSION_DET_105_108_oPCAN_RADAR_52a281ea_Rx: ComBitPosition=224, ComBitSize=6, ComSignalType=UINT8, ComSystemTemplateSystemSignalRef=DET_EXISTENCE_PROB_106_Rx
            DET_EXISTENCE_PROB_107_Rx_oRDR_FUSION_DET_105_108_oPCAN_RADAR_fde613ad_Rx: ComBitPosition=336, ComBitSize=6, ComSignalType=UINT8, ComSystemTemplateSystemSignalRef=DET_EXISTENCE_PROB_107_Rx
            DET_EXISTENCE_PROB_108_Rx_oRDR_FUSION_DET_105_108_oPCAN_RADAR_7da86105_Rx: ComBitPosition=448, ComBitSize=6, ComSignalType=UINT8, ComSystemTemplateSystemSignalRef=DET_EXISTENCE_PROB_108_Rx
            DET_HVC_FLAG_105_Rx_oRDR_FUSION_DET_105_108_oPCAN_RADAR_a5c0dc2d_Rx: ComBitPosition=86, ComBitSize=1, ComSignalType=BOOLEAN, ComSystemTemplateSystemSignalRef=DET_HVC_FLAG_105_Rx
            DET_HVC_FLAG_106_Rx_oRDR_FUSION_DET_105_108_oPCAN_RADAR_8f7c6ca5_Rx: ComBitPosition=198, ComBitSize=1, ComSignalType=BOOLEAN, ComSystemTemplateSystemSignalRef=DET_HVC_FLAG_106_Rx
            DET_HVC_FLAG_107_Rx_oRDR_FUSION_DET_105_108_oPCAN_RADAR_2038fee2_Rx: ComBitPosition=310, ComBitSize=1, ComSignalType=BOOLEAN, ComSystemTemplateSystemSignalRef=DET_HVC_FLAG_107_Rx
            DET_HVC_FLAG_108_Rx_oRDR_FUSION_DET_105_108_oPCAN_RADAR_a0768c4a_Rx: ComBitPosition=422, ComBitSize=1, ComSignalType=BOOLEAN, ComSystemTemplateSystemSignalRef=DET_HVC_FLAG_108_Rx
            DET_IDM_105_Rx_oRDR_FUSION_DET_105_108_oPCAN_RADAR_90012565_Rx: ComBitPosition=63, ComBitSize=1, ComSignalType=BOOLEAN, ComSystemTemplateSystemSignalRef=DET_IDM_105_Rx
            DET_IDM_106_Rx_oRDR_FUSION_DET_105_108_oPCAN_RADAR_babd95ed_Rx: ComBitPosition=175, ComBitSize=1, ComSignalType=BOOLEAN, ComSystemTemplateSystemSignalRef=DET_IDM_106_Rx
            DET_IDM_107_Rx_oRDR_FUSION_DET_105_108_oPCAN_RADAR_15f907aa_Rx: ComBitPosition=287, ComBitSize=1, ComSignalType=BOOLEAN, ComSystemTemplateSystemSignalRef=DET_IDM_107_Rx
            DET_IDM_108_Rx_oRDR_FUSION_DET_105_108_oPCAN_RADAR_95b77502_Rx: ComBitPosition=399, ComBitSize=1, ComSignalType=BOOLEAN, ComSystemTemplateSystemSignalRef=DET_IDM_108_Rx
            DET_MH_CRC16_105_108_Rx_oRDR_FUSION_DET_105_108_oPCAN_RADAR_24f92ed0_Rx: ComBitPosition=0, ComBitSize=16, ComSignalType=UINT16, ComSystemTemplateSystemSignalRef=DET_MH_CRC16_105_108_Rx
            DET_MH_CYCLE_COUNTER_105_108_Rx_oRDR_FUSION_DET_105_108_oPCAN_RADAR_29221315_Rx: ComBitPosition=16, ComBitSize=8, ComSignalType=UINT8, ComSystemTemplateSystemSignalRef=DET_MH_CYCLE_COUNTER_105_108_Rx
            DET_MH_SCAN_INDEX_4LSB_105_108_Rx_oRDR_FUSION_DET_105_108_oPCAN_RADAR_4d92dc2e_Rx: ComBitPosition=476, ComBitSize=4, ComSignalType=UINT8, ComSystemTemplateSystemSignalRef=DET_MH_SCAN_INDEX_4LSB_105_108_Rx
            DET_MTD_105_Rx_oRDR_FUSION_DET_105_108_oPCAN_RADAR_2d821315_Rx: ComBitPosition=47, ComBitSize=1, ComSignalType=BOOLEAN, ComSystemTemplateSystemSignalRef=DET_MTD_105_Rx
            DET_MTD_106_Rx_oRDR_FUSION_DET_105_108_oPCAN_RADAR_073ea39d_Rx: ComBitPosition=159, ComBitSize=1, ComSignalType=BOOLEAN, ComSystemTemplateSystemSignalRef=DET_MTD_106_Rx
            DET_MTD_107_Rx_oRDR_FUSION_DET_105_108_oPCAN_RADAR_a87a31da_Rx: ComBitPosition=271, ComBitSize=1, ComSignalType=BOOLEAN, ComSystemTemplateSystemSignalRef=DET_MTD_107_Rx
            DET_MTD_108_Rx_oRDR_FUSION_DET_105_108_oPCAN_RADAR_28344372_Rx: ComBitPosition=383, ComBitSize=1, ComSignalType=BOOLEAN, ComSystemTemplateSystemSignalRef=DET_MTD_108_Rx
            DET_PROB_1STAZHYPO_105_Rx_oRDR_FUSION_DET_105_108_oPCAN_RADAR_e7fb0d94_Rx: ComBitPosition=103, ComBitSize=1, ComSignalType=BOOLEAN, ComSystemTemplateSystemSignalRef=DET_PROB_1STAZHYPO_105_Rx
            DET_PROB_1STAZHYPO_106_Rx_oRDR_FUSION_DET_105_108_oPCAN_RADAR_cd47bd1c_Rx: ComBitPosition=215, ComBitSize=1, ComSignalType=BOOLEAN, ComSystemTemplateSystemSignalRef=DET_PROB_1STAZHYPO_106_Rx
            DET_PROB_1STAZHYPO_107_Rx_oRDR_FUSION_DET_105_108_oPCAN_RADAR_62032f5b_Rx: ComBitPosition=327, ComBitSize=1, ComSignalType=BOOLEAN, ComSystemTemplateSystemSignalRef=DET_PROB_1STAZHYPO_107_Rx
            DET_PROB_1STAZHYPO_108_Rx_oRDR_FUSION_DET_105_108_oPCAN_RADAR_e24d5df3_Rx: ComBitPosition=439, ComBitSize=1, ComSignalType=BOOLEAN, ComSystemTemplateSystemSignalRef=DET_PROB_1STAZHYPO_108_Rx
            DET_RANGE_105_Rx_oRDR_FUSION_DET_105_108_oPCAN_RADAR_bc46e583_Rx: ComBitPosition=24, ComBitSize=15, ComSignalType=UINT16, ComSystemTemplateSystemSignalRef=DET_RANGE_105_Rx
            DET_RANGE_106_Rx_oRDR_FUSION_DET_105_108_oPCAN_RADAR_96fa550b_Rx: ComBitPosition=136, ComBitSize=15, ComSignalType=UINT16, ComSystemTemplateSystemSignalRef=DET_RANGE_106_Rx
            DET_RANGE_107_Rx_oRDR_FUSION_DET_105_108_oPCAN_RADAR_39bec74c_Rx: ComBitPosition=248, ComBitSize=15, ComSignalType=UINT16, ComSystemTemplateSystemSignalRef=DET_RANGE_107_Rx
            DET_RANGE_108_Rx_oRDR_FUSION_DET_105_108_oPCAN_RADAR_b9f0b5e4_Rx: ComBitPosition=360, ComBitSize=15, ComSignalType=UINT16, ComSystemTemplateSystemSignalRef=DET_RANGE_108_Rx
            DET_RANGE_ERR_105_Rx_oRDR_FUSION_DET_105_108_oPCAN_RADAR_ecb46963_Rx: ComBitPosition=40, ComBitSize=7, ComSignalType=UINT8, ComSystemTemplateSystemSignalRef=DET_RANGE_ERR_105_Rx
            DET_RANGE_ERR_106_Rx_oRDR_FUSION_DET_105_108_oPCAN_RADAR_c608d9eb_Rx: ComBitPosition=152, ComBitSize=7, ComSignalType=UINT8, ComSystemTemplateSystemSignalRef=DET_RANGE_ERR_106_Rx
            DET_RANGE_ERR_107_Rx_oRDR_FUSION_DET_105_108_oPCAN_RADAR_694c4bac_Rx: ComBitPosition=264, ComBitSize=7, ComSignalType=UINT8, ComSystemTemplateSystemSignalRef=DET_RANGE_ERR_107_Rx
            DET_RANGE_ERR_108_Rx_oRDR_FUSION_DET_105_108_oPCAN_RADAR_e9023904_Rx: ComBitPosition=376, ComBitSize=7, ComSignalType=UINT8, ComSystemTemplateSystemSignalRef=DET_RANGE_ERR_108_Rx
            DET_RANGE_VELOCITY_105_Rx_oRDR_FUSION_DET_105_108_oPCAN_RADAR_61b3667d_Rx: ComBitPosition=48, ComBitSize=15, ComSignalType=UINT16, ComSystemTemplateSystemSignalRef=DET_RANGE_VELOCITY_105_Rx
            DET_RANGE_VELOCITY_106_Rx_oRDR_FUSION_DET_105_108_oPCAN_RADAR_4b0fd6f5_Rx: ComBitPosition=160, ComBitSize=15, ComSignalType=UINT16, ComSystemTemplateSystemSignalRef=DET_RANGE_VELOCITY_106_Rx
            DET_RANGE_VELOCITY_107_Rx_oRDR_FUSION_DET_105_108_oPCAN_RADAR_e44b44b2_Rx: ComBitPosition=272, ComBitSize=15, ComSignalType=UINT16, ComSystemTemplateSystemSignalRef=DET_RANGE_VELOCITY_107_Rx
            DET_RANGE_VELOCITY_108_Rx_oRDR_FUSION_DET_105_108_oPCAN_RADAR_6405361a_Rx: ComBitPosition=384, ComBitSize=15, ComSignalType=UINT16, ComSystemTemplateSystemSignalRef=DET_RANGE_VELOCITY_108_Rx
            DET_RANGE_VELOCITY_ERR_105_Rx_oRDR_FUSION_DET_105_108_oPCAN_RADAR_f8d716bf_Rx: ComBitPosition=64, ComBitSize=8, ComSignalType=UINT8, ComSystemTemplateSystemSignalRef=DET_RANGE_VELOCITY_ERR_105_Rx
            DET_RANGE_VELOCITY_ERR_106_Rx_oRDR_FUSION_DET_105_108_oPCAN_RADAR_d26ba637_Rx: ComBitPosition=176, ComBitSize=8, ComSignalType=UINT8, ComSystemTemplateSystemSignalRef=DET_RANGE_VELOCITY_ERR_106_Rx
            DET_RANGE_VELOCITY_ERR_107_Rx_oRDR_FUSION_DET_105_108_oPCAN_RADAR_7d2f3470_Rx: ComBitPosition=288, ComBitSize=8, ComSignalType=UINT8, ComSystemTemplateSystemSignalRef=DET_RANGE_VELOCITY_ERR_107_Rx
            DET_RANGE_VELOCITY_ERR_108_Rx_oRDR_FUSION_DET_105_108_oPCAN_RADAR_fd6146d8_Rx: ComBitPosition=400, ComBitSize=8, ComSignalType=UINT8, ComSystemTemplateSystemSignalRef=DET_RANGE_VELOCITY_ERR_108_Rx
            DET_RCS_105_Rx_oRDR_FUSION_DET_105_108_oPCAN_RADAR_ac78f466_Rx: ComBitPosition=128, ComBitSize=8, ComSignalType=UINT8, ComSystemTemplateSystemSignalRef=DET_RCS_105_Rx
            DET_RCS_106_Rx_oRDR_FUSION_DET_105_108_oPCAN_RADAR_86c444ee_Rx: ComBitPosition=240, ComBitSize=8, ComSignalType=UINT8, ComSystemTemplateSystemSignalRef=DET_RCS_106_Rx
            DET_RCS_107_Rx_oRDR_FUSION_DET_105_108_oPCAN_RADAR_2980d6a9_Rx: ComBitPosition=352, ComBitSize=8, ComSignalType=UINT8, ComSystemTemplateSystemSignalRef=DET_RCS_107_Rx
            DET_RCS_108_Rx_oRDR_FUSION_DET_105_108_oPCAN_RADAR_a9cea401_Rx: ComBitPosition=464, ComBitSize=8, ComSignalType=UINT8, ComSystemTemplateSystemSignalRef=DET_RCS_108_Rx
            DET_SNR_105_Rx_oRDR_FUSION_DET_105_108_oPCAN_RADAR_a522858f_Rx: ComBitPosition=120, ComBitSize=8, ComSignalType=UINT8, ComSystemTemplateSystemSignalRef=DET_SNR_105_Rx
            DET_SNR_106_Rx_oRDR_FUSION_DET_105_108_oPCAN_RADAR_8f9e3507_Rx: ComBitPosition=232, ComBitSize=8, ComSignalType=UINT8, ComSystemTemplateSystemSignalRef=DET_SNR_106_Rx
            DET_SNR_107_Rx_oRDR_FUSION_DET_105_108_oPCAN_RADAR_20daa740_Rx: ComBitPosition=344, ComBitSize=8, ComSignalType=UINT8, ComSystemTemplateSystemSignalRef=DET_SNR_107_Rx
            DET_SNR_108_Rx_oRDR_FUSION_DET_105_108_oPCAN_RADAR_a094d5e8_Rx: ComBitPosition=456, ComBitSize=8, ComSignalType=UINT8, ComSystemTemplateSystemSignalRef=DET_SNR_108_Rx
            DET_SUPER_RES_TARGET_105_Rx_oRDR_FUSION_DET_105_108_oPCAN_RADAR_6ed9a48f_Rx: ComBitPosition=87, ComBitSize=1, ComSignalType=BOOLEAN, ComSystemTemplateSystemSignalRef=DET_SUPER_RES_TARGET_105_Rx
            DET_SUPER_RES_TARGET_106_Rx_oRDR_FUSION_DET_105_108_oPCAN_RADAR_44651407_Rx: ComBitPosition=199, ComBitSize=1, ComSignalType=BOOLEAN, ComSystemTemplateSystemSignalRef=DET_SUPER_RES_TARGET_106_Rx
            DET_SUPER_RES_TARGET_107_Rx_oRDR_FUSION_DET_105_108_oPCAN_RADAR_eb218640_Rx: ComBitPosition=311, ComBitSize=1, ComSignalType=BOOLEAN, ComSystemTemplateSystemSignalRef=DET_SUPER_RES_TARGET_107_Rx
            DET_SUPER_RES_TARGET_108_Rx_oRDR_FUSION_DET_105_108_oPCAN_RADAR_6b6ff4e8_Rx: ComBitPosition=423, ComBitSize=1, ComSignalType=BOOLEAN, ComSystemTemplateSystemSignalRef=DET_SUPER_RES_TARGET_108_Rx
        SG_Fusion_Detections_109_112_oRDR_FUSION_DET_109_112_oPCAN_RADAR_e2334566_Rx: ComTimeout=0, ComSystemTemplateSignalGroupRef=SG_Fusion_Detections_109_112
          83 x ComGroupSignal, all with ComSignalEndianness=LITTLE_ENDIAN, ComSignalInitValue=0:
            DET_AZIMUTH_109_Rx_oRDR_FUSION_DET_109_112_oPCAN_RADAR_373a9485_Rx: ComBitPosition=88, ComBitSize=13, ComSignalType=UINT16, ComSystemTemplateSystemSignalRef=DET_AZIMUTH_109_Rx
            DET_AZIMUTH_110_Rx_oRDR_FUSION_DET_109_112_oPCAN_RADAR_0a1a179c_Rx: ComBitPosition=200, ComBitSize=13, ComSignalType=UINT16, ComSystemTemplateSystemSignalRef=DET_AZIMUTH_110_Rx
            DET_AZIMUTH_111_Rx_oRDR_FUSION_DET_109_112_oPCAN_RADAR_a55e85db_Rx: ComBitPosition=312, ComBitSize=13, ComSignalType=UINT16, ComSystemTemplateSystemSignalRef=DET_AZIMUTH_111_Rx
            DET_AZIMUTH_112_Rx_oRDR_FUSION_DET_109_112_oPCAN_RADAR_8fe23553_Rx: ComBitPosition=424, ComBitSize=13, ComSignalType=UINT16, ComSystemTemplateSystemSignalRef=DET_AZIMUTH_112_Rx
            DET_AZIMUTH_ERR_109_Rx_oRDR_FUSION_DET_109_112_oPCAN_RADAR_35533507_Rx: ComBitPosition=105, ComBitSize=7, ComSignalType=UINT8, ComSystemTemplateSystemSignalRef=DET_AZIMUTH_ERR_109_Rx
            DET_AZIMUTH_ERR_110_Rx_oRDR_FUSION_DET_109_112_oPCAN_RADAR_0873b61e_Rx: ComBitPosition=217, ComBitSize=7, ComSignalType=UINT8, ComSystemTemplateSystemSignalRef=DET_AZIMUTH_ERR_110_Rx
            DET_AZIMUTH_ERR_111_Rx_oRDR_FUSION_DET_109_112_oPCAN_RADAR_a7372459_Rx: ComBitPosition=329, ComBitSize=7, ComSignalType=UINT8, ComSystemTemplateSystemSignalRef=DET_AZIMUTH_ERR_111_Rx
            DET_AZIMUTH_ERR_112_Rx_oRDR_FUSION_DET_109_112_oPCAN_RADAR_8d8b94d1_Rx: ComBitPosition=441, ComBitSize=7, ComSignalType=UINT8, ComSystemTemplateSystemSignalRef=DET_AZIMUTH_ERR_112_Rx
            DET_BELOW_RAIN_THOLD_109_Rx_oRDR_FUSION_DET_109_112_oPCAN_RADAR_51806b30_Rx: ComBitPosition=39, ComBitSize=1, ComSignalType=BOOLEAN, ComSystemTemplateSystemSignalRef=DET_BELOW_RAIN_THOLD_109_Rx
            DET_BELOW_RAIN_THOLD_110_Rx_oRDR_FUSION_DET_109_112_oPCAN_RADAR_6ca0e829_Rx: ComBitPosition=151, ComBitSize=1, ComSignalType=BOOLEAN, ComSystemTemplateSystemSignalRef=DET_BELOW_RAIN_THOLD_110_Rx
            DET_BELOW_RAIN_THOLD_111_Rx_oRDR_FUSION_DET_109_112_oPCAN_RADAR_c3e47a6e_Rx: ComBitPosition=263, ComBitSize=1, ComSignalType=BOOLEAN, ComSystemTemplateSystemSignalRef=DET_BELOW_RAIN_THOLD_111_Rx
            DET_BELOW_RAIN_THOLD_112_Rx_oRDR_FUSION_DET_109_112_oPCAN_RADAR_e958cae6_Rx: ComBitPosition=375, ComBitSize=1, ComSignalType=BOOLEAN, ComSystemTemplateSystemSignalRef=DET_BELOW_RAIN_THOLD_112_Rx
            DET_BI_STATIC_FLAG_109_Rx_oRDR_FUSION_DET_109_112_oPCAN_RADAR_261ec023_Rx: ComBitPosition=104, ComBitSize=1, ComSignalType=BOOLEAN, ComSystemTemplateSystemSignalRef=DET_BI_STATIC_FLAG_109_Rx
            DET_BI_STATIC_FLAG_110_Rx_oRDR_FUSION_DET_109_112_oPCAN_RADAR_1b3e433a_Rx: ComBitPosition=216, ComBitSize=1, ComSignalType=BOOLEAN, ComSystemTemplateSystemSignalRef=DET_BI_STATIC_FLAG_110_Rx
            DET_BI_STATIC_FLAG_111_Rx_oRDR_FUSION_DET_109_112_oPCAN_RADAR_b47ad17d_Rx: ComBitPosition=328, ComBitSize=1, ComSignalType=BOOLEAN, ComSystemTemplateSystemSignalRef=DET_BI_STATIC_FLAG_111_Rx
            DET_BI_STATIC_FLAG_112_Rx_oRDR_FUSION_DET_109_112_oPCAN_RADAR_9ec661f5_Rx: ComBitPosition=440, ComBitSize=1, ComSignalType=BOOLEAN, ComSystemTemplateSystemSignalRef=DET_BI_STATIC_FLAG_112_Rx
            DET_CONFD_AZIMUTH_109_Rx_oRDR_FUSION_DET_109_112_oPCAN_RADAR_c5772a77_Rx: ComBitPosition=118, ComBitSize=2, ComSignalType=UINT8, ComSystemTemplateSystemSignalRef=DET_CONFD_AZIMUTH_109_Rx
            DET_CONFD_AZIMUTH_110_Rx_oRDR_FUSION_DET_109_112_oPCAN_RADAR_f857a96e_Rx: ComBitPosition=230, ComBitSize=2, ComSignalType=UINT8, ComSystemTemplateSystemSignalRef=DET_CONFD_AZIMUTH_110_Rx
            DET_CONFD_AZIMUTH_111_Rx_oRDR_FUSION_DET_109_112_oPCAN_RADAR_57133b29_Rx: ComBitPosition=342, ComBitSize=2, ComSignalType=UINT8, ComSystemTemplateSystemSignalRef=DET_CONFD_AZIMUTH_111_Rx
            DET_CONFD_AZIMUTH_112_Rx_oRDR_FUSION_DET_109_112_oPCAN_RADAR_7daf8ba1_Rx: ComBitPosition=454, ComBitSize=2, ComSignalType=UINT8, ComSystemTemplateSystemSignalRef=DET_CONFD_AZIMUTH_112_Rx
            DET_CONFD_ELEVATION_109_Rx_oRDR_FUSION_DET_109_112_oPCAN_RADAR_cf56a9f0_Rx: ComBitPosition=101, ComBitSize=2, ComSignalType=UINT8, ComSystemTemplateSystemSignalRef=DET_CONFD_ELEVATION_109_Rx
            DET_CONFD_ELEVATION_110_Rx_oRDR_FUSION_DET_109_112_oPCAN_RADAR_f2762ae9_Rx: ComBitPosition=213, ComBitSize=2, ComSignalType=UINT8, ComSystemTemplateSystemSignalRef=DET_CONFD_ELEVATION_110_Rx
            DET_CONFD_ELEVATION_111_Rx_oRDR_FUSION_DET_109_112_oPCAN_RADAR_5d32b8ae_Rx: ComBitPosition=325, ComBitSize=2, ComSignalType=UINT8, ComSystemTemplateSystemSignalRef=DET_CONFD_ELEVATION_111_Rx
            DET_CONFD_ELEVATION_112_Rx_oRDR_FUSION_DET_109_112_oPCAN_RADAR_778e0826_Rx: ComBitPosition=437, ComBitSize=2, ComSignalType=UINT8, ComSystemTemplateSystemSignalRef=DET_CONFD_ELEVATION_112_Rx
            DET_ELEVATION_109_Rx_oRDR_FUSION_DET_109_112_oPCAN_RADAR_c5054609_Rx: ComBitPosition=72, ComBitSize=8, ComSignalType=UINT8, ComSystemTemplateSystemSignalRef=DET_ELEVATION_109_Rx
            DET_ELEVATION_110_Rx_oRDR_FUSION_DET_109_112_oPCAN_RADAR_f825c510_Rx: ComBitPosition=184, ComBitSize=8, ComSignalType=UINT8, ComSystemTemplateSystemSignalRef=DET_ELEVATION_110_Rx
            DET_ELEVATION_111_Rx_oRDR_FUSION_DET_109_112_oPCAN_RADAR_57615757_Rx: ComBitPosition=296, ComBitSize=8, ComSignalType=UINT8, ComSystemTemplateSystemSignalRef=DET_ELEVATION_111_Rx
            DET_ELEVATION_112_Rx_oRDR_FUSION_DET_109_112_oPCAN_RADAR_7ddde7df_Rx: ComBitPosition=408, ComBitSize=8, ComSignalType=UINT8, ComSystemTemplateSystemSignalRef=DET_ELEVATION_112_Rx
            DET_ELEVATION_ERR_109_Rx_oRDR_FUSION_DET_109_112_oPCAN_RADAR_17bc64d6_Rx: ComBitPosition=80, ComBitSize=6, ComSignalType=UINT8, ComSystemTemplateSystemSignalRef=DET_ELEVATION_ERR_109_Rx
            DET_ELEVATION_ERR_110_Rx_oRDR_FUSION_DET_109_112_oPCAN_RADAR_2a9ce7cf_Rx: ComBitPosition=192, ComBitSize=6, ComSignalType=UINT8, ComSystemTemplateSystemSignalRef=DET_ELEVATION_ERR_110_Rx
            DET_ELEVATION_ERR_111_Rx_oRDR_FUSION_DET_109_112_oPCAN_RADAR_85d87588_Rx: ComBitPosition=304, ComBitSize=6, ComSignalType=UINT8, ComSystemTemplateSystemSignalRef=DET_ELEVATION_ERR_111_Rx
            DET_ELEVATION_ERR_112_Rx_oRDR_FUSION_DET_109_112_oPCAN_RADAR_af64c500_Rx: ComBitPosition=416, ComBitSize=6, ComSignalType=UINT8, ComSystemTemplateSystemSignalRef=DET_ELEVATION_ERR_112_Rx
            DET_EXISTENCE_PROB_109_Rx_oRDR_FUSION_DET_109_112_oPCAN_RADAR_e0a41c43_Rx: ComBitPosition=112, ComBitSize=6, ComSignalType=UINT8, ComSystemTemplateSystemSignalRef=DET_EXISTENCE_PROB_109_Rx
            DET_EXISTENCE_PROB_110_Rx_oRDR_FUSION_DET_109_112_oPCAN_RADAR_dd849f5a_Rx: ComBitPosition=224, ComBitSize=6, ComSignalType=UINT8, ComSystemTemplateSystemSignalRef=DET_EXISTENCE_PROB_110_Rx
            DET_EXISTENCE_PROB_111_Rx_oRDR_FUSION_DET_109_112_oPCAN_RADAR_72c00d1d_Rx: ComBitPosition=336, ComBitSize=6, ComSignalType=UINT8, ComSystemTemplateSystemSignalRef=DET_EXISTENCE_PROB_111_Rx
            DET_EXISTENCE_PROB_112_Rx_oRDR_FUSION_DET_109_112_oPCAN_RADAR_587cbd95_Rx: ComBitPosition=448, ComBitSize=6, ComSignalType=UINT8, ComSystemTemplateSystemSignalRef=DET_EXISTENCE_PROB_112_Rx
            DET_HVC_FLAG_109_Rx_oRDR_FUSION_DET_109_112_oPCAN_RADAR_3d7af10c_Rx: ComBitPosition=86, ComBitSize=1, ComSignalType=BOOLEAN, ComSystemTemplateSystemSignalRef=DET_HVC_FLAG_109_Rx
            DET_HVC_FLAG_110_Rx_oRDR_FUSION_DET_109_112_oPCAN_RADAR_005a7215_Rx: ComBitPosition=198, ComBitSize=1, ComSignalType=BOOLEAN, ComSystemTemplateSystemSignalRef=DET_HVC_FLAG_110_Rx
            DET_HVC_FLAG_111_Rx_oRDR_FUSION_DET_109_112_oPCAN_RADAR_af1ee052_Rx: ComBitPosition=310, ComBitSize=1, ComSignalType=BOOLEAN, ComSystemTemplateSystemSignalRef=DET_HVC_FLAG_111_Rx
            DET_HVC_FLAG_112_Rx_oRDR_FUSION_DET_109_112_oPCAN_RADAR_85a250da_Rx: ComBitPosition=422, ComBitSize=1, ComSignalType=BOOLEAN, ComSystemTemplateSystemSignalRef=DET_HVC_FLAG_112_Rx
            DET_IDM_109_Rx_oRDR_FUSION_DET_109_112_oPCAN_RADAR_08bb0844_Rx: ComBitPosition=63, ComBitSize=1, ComSignalType=BOOLEAN, ComSystemTemplateSystemSignalRef=DET_IDM_109_Rx
            DET_IDM_110_Rx_oRDR_FUSION_DET_109_112_oPCAN_RADAR_359b8b5d_Rx: ComBitPosition=175, ComBitSize=1, ComSignalType=BOOLEAN, ComSystemTemplateSystemSignalRef=DET_IDM_110_Rx
            DET_IDM_111_Rx_oRDR_FUSION_DET_109_112_oPCAN_RADAR_9adf191a_Rx: ComBitPosition=287, ComBitSize=1, ComSignalType=BOOLEAN, ComSystemTemplateSystemSignalRef=DET_IDM_111_Rx
            DET_IDM_112_Rx_oRDR_FUSION_DET_109_112_oPCAN_RADAR_b063a992_Rx: ComBitPosition=399, ComBitSize=1, ComSignalType=BOOLEAN, ComSystemTemplateSystemSignalRef=DET_IDM_112_Rx
            DET_MH_CRC16_109_112_Rx_oRDR_FUSION_DET_109_112_oPCAN_RADAR_23bdd699_Rx: ComBitPosition=0, ComBitSize=16, ComSignalType=UINT16, ComSystemTemplateSystemSignalRef=DET_MH_CRC16_109_112_Rx
            DET_MH_CYCLE_COUNTER_109_112_Rx_oRDR_FUSION_DET_109_112_oPCAN_RADAR_2e66eb5c_Rx: ComBitPosition=16, ComBitSize=8, ComSignalType=UINT8, ComSystemTemplateSystemSignalRef=DET_MH_CYCLE_COUNTER_109_112_Rx
            DET_MH_SCAN_INDEX_4LSB_109_112_Rx_oRDR_FUSION_DET_109_112_oPCAN_RADAR_4ad62467_Rx: ComBitPosition=476, ComBitSize=4, ComSignalType=UINT8, ComSystemTemplateSystemSignalRef=DET_MH_SCAN_INDEX_4LSB_109_112_Rx
            DET_MTD_109_Rx_oRDR_FUSION_DET_109_112_oPCAN_RADAR_b5383e34_Rx: ComBitPosition=47, ComBitSize=1, ComSignalType=BOOLEAN, ComSystemTemplateSystemSignalRef=DET_MTD_109_Rx
            DET_MTD_110_Rx_oRDR_FUSION_DET_109_112_oPCAN_RADAR_8818bd2d_Rx: ComBitPosition=159, ComBitSize=1, ComSignalType=BOOLEAN, ComSystemTemplateSystemSignalRef=DET_MTD_110_Rx
            DET_MTD_111_Rx_oRDR_FUSION_DET_109_112_oPCAN_RADAR_275c2f6a_Rx: ComBitPosition=271, ComBitSize=1, ComSignalType=BOOLEAN, ComSystemTemplateSystemSignalRef=DET_MTD_111_Rx
            DET_MTD_112_Rx_oRDR_FUSION_DET_109_112_oPCAN_RADAR_0de09fe2_Rx: ComBitPosition=383, ComBitSize=1, ComSignalType=BOOLEAN, ComSystemTemplateSystemSignalRef=DET_MTD_112_Rx
            DET_PROB_1STAZHYPO_109_Rx_oRDR_FUSION_DET_109_112_oPCAN_RADAR_7f4120b5_Rx: ComBitPosition=103, ComBitSize=1, ComSignalType=BOOLEAN, ComSystemTemplateSystemSignalRef=DET_PROB_1STAZHYPO_109_Rx
            DET_PROB_1STAZHYPO_110_Rx_oRDR_FUSION_DET_109_112_oPCAN_RADAR_4261a3ac_Rx: ComBitPosition=215, ComBitSize=1, ComSignalType=BOOLEAN, ComSystemTemplateSystemSignalRef=DET_PROB_1STAZHYPO_110_Rx
            DET_PROB_1STAZHYPO_111_Rx_oRDR_FUSION_DET_109_112_oPCAN_RADAR_ed2531eb_Rx: ComBitPosition=327, ComBitSize=1, ComSignalType=BOOLEAN, ComSystemTemplateSystemSignalRef=DET_PROB_1STAZHYPO_111_Rx
            DET_PROB_1STAZHYPO_112_Rx_oRDR_FUSION_DET_109_112_oPCAN_RADAR_c7998163_Rx: ComBitPosition=439, ComBitSize=1, ComSignalType=BOOLEAN, ComSystemTemplateSystemSignalRef=DET_PROB_1STAZHYPO_112_Rx
            DET_RANGE_109_Rx_oRDR_FUSION_DET_109_112_oPCAN_RADAR_24fcc8a2_Rx: ComBitPosition=24, ComBitSize=15, ComSignalType=UINT16, ComSystemTemplateSystemSignalRef=DET_RANGE_109_Rx
            DET_RANGE_110_Rx_oRDR_FUSION_DET_109_112_oPCAN_RADAR_19dc4bbb_Rx: ComBitPosition=136, ComBitSize=15, ComSignalType=UINT16, ComSystemTemplateSystemSignalRef=DET_RANGE_110_Rx
            DET_RANGE_111_Rx_oRDR_FUSION_DET_109_112_oPCAN_RADAR_b698d9fc_Rx: ComBitPosition=248, ComBitSize=15, ComSignalType=UINT16, ComSystemTemplateSystemSignalRef=DET_RANGE_111_Rx
            DET_RANGE_112_Rx_oRDR_FUSION_DET_109_112_oPCAN_RADAR_9c246974_Rx: ComBitPosition=360, ComBitSize=15, ComSignalType=UINT16, ComSystemTemplateSystemSignalRef=DET_RANGE_112_Rx
            DET_RANGE_ERR_109_Rx_oRDR_FUSION_DET_109_112_oPCAN_RADAR_740e4442_Rx: ComBitPosition=40, ComBitSize=7, ComSignalType=UINT8, ComSystemTemplateSystemSignalRef=DET_RANGE_ERR_109_Rx
            DET_RANGE_ERR_110_Rx_oRDR_FUSION_DET_109_112_oPCAN_RADAR_492ec75b_Rx: ComBitPosition=152, ComBitSize=7, ComSignalType=UINT8, ComSystemTemplateSystemSignalRef=DET_RANGE_ERR_110_Rx
            DET_RANGE_ERR_111_Rx_oRDR_FUSION_DET_109_112_oPCAN_RADAR_e66a551c_Rx: ComBitPosition=264, ComBitSize=7, ComSignalType=UINT8, ComSystemTemplateSystemSignalRef=DET_RANGE_ERR_111_Rx
            DET_RANGE_ERR_112_Rx_oRDR_FUSION_DET_109_112_oPCAN_RADAR_ccd6e594_Rx: ComBitPosition=376, ComBitSize=7, ComSignalType=UINT8, ComSystemTemplateSystemSignalRef=DET_RANGE_ERR_112_Rx
            DET_RANGE_VELOCITY_109_Rx_oRDR_FUSION_DET_109_112_oPCAN_RADAR_f9094b5c_Rx: ComBitPosition=48, ComBitSize=15, ComSignalType=UINT16, ComSystemTemplateSystemSignalRef=DET_RANGE_VELOCITY_109_Rx
            DET_RANGE_VELOCITY_110_Rx_oRDR_FUSION_DET_109_112_oPCAN_RADAR_c429c845_Rx: ComBitPosition=160, ComBitSize=15, ComSignalType=UINT16, ComSystemTemplateSystemSignalRef=DET_RANGE_VELOCITY_110_Rx
            DET_RANGE_VELOCITY_111_Rx_oRDR_FUSION_DET_109_112_oPCAN_RADAR_6b6d5a02_Rx: ComBitPosition=272, ComBitSize=15, ComSignalType=UINT16, ComSystemTemplateSystemSignalRef=DET_RANGE_VELOCITY_111_Rx
            DET_RANGE_VELOCITY_112_Rx_oRDR_FUSION_DET_109_112_oPCAN_RADAR_41d1ea8a_Rx: ComBitPosition=384, ComBitSize=15, ComSignalType=UINT16, ComSystemTemplateSystemSignalRef=DET_RANGE_VELOCITY_112_Rx
            DET_RANGE_VELOCITY_ERR_109_Rx_oRDR_FUSION_DET_109_112_oPCAN_RADAR_606d3b9e_Rx: ComBitPosition=64, ComBitSize=8, ComSignalType=UINT8, ComSystemTemplateSystemSignalRef=DET_RANGE_VELOCITY_ERR_109_Rx
            DET_RANGE_VELOCITY_ERR_110_Rx_oRDR_FUSION_DET_109_112_oPCAN_RADAR_5d4db887_Rx: ComBitPosition=176, ComBitSize=8, ComSignalType=UINT8, ComSystemTemplateSystemSignalRef=DET_RANGE_VELOCITY_ERR_110_Rx
            DET_RANGE_VELOCITY_ERR_111_Rx_oRDR_FUSION_DET_109_112_oPCAN_RADAR_f2092ac0_Rx: ComBitPosition=288, ComBitSize=8, ComSignalType=UINT8, ComSystemTemplateSystemSignalRef=DET_RANGE_VELOCITY_ERR_111_Rx
            DET_RANGE_VELOCITY_ERR_112_Rx_oRDR_FUSION_DET_109_112_oPCAN_RADAR_d8b59a48_Rx: ComBitPosition=400, ComBitSize=8, ComSignalType=UINT8, ComSystemTemplateSystemSignalRef=DET_RANGE_VELOCITY_ERR_112_Rx
            DET_RCS_109_Rx_oRDR_FUSION_DET_109_112_oPCAN_RADAR_34c2d947_Rx: ComBitPosition=128, ComBitSize=8, ComSignalType=UINT8, ComSystemTemplateSystemSignalRef=DET_RCS_109_Rx
            DET_RCS_110_Rx_oRDR_FUSION_DET_109_112_oPCAN_RADAR_09e25a5e_Rx: ComBitPosition=240, ComBitSize=8, ComSignalType=UINT8, ComSystemTemplateSystemSignalRef=DET_RCS_110_Rx
            DET_RCS_111_Rx_oRDR_FUSION_DET_109_112_oPCAN_RADAR_a6a6c819_Rx: ComBitPosition=352, ComBitSize=8, ComSignalType=UINT8, ComSystemTemplateSystemSignalRef=DET_RCS_111_Rx
            DET_RCS_112_Rx_oRDR_FUSION_DET_109_112_oPCAN_RADAR_8c1a7891_Rx: ComBitPosition=464, ComBitSize=8, ComSignalType=UINT8, ComSystemTemplateSystemSignalRef=DET_RCS_112_Rx
            DET_SNR_109_Rx_oRDR_FUSION_DET_109_112_oPCAN_RADAR_3d98a8ae_Rx: ComBitPosition=120, ComBitSize=8, ComSignalType=UINT8, ComSystemTemplateSystemSignalRef=DET_SNR_109_Rx
            DET_SNR_110_Rx_oRDR_FUSION_DET_109_112_oPCAN_RADAR_00b82bb7_Rx: ComBitPosition=232, ComBitSize=8, ComSignalType=UINT8, ComSystemTemplateSystemSignalRef=DET_SNR_110_Rx
            DET_SNR_111_Rx_oRDR_FUSION_DET_109_112_oPCAN_RADAR_affcb9f0_Rx: ComBitPosition=344, ComBitSize=8, ComSignalType=UINT8, ComSystemTemplateSystemSignalRef=DET_SNR_111_Rx
            DET_SNR_112_Rx_oRDR_FUSION_DET_109_112_oPCAN_RADAR_85400978_Rx: ComBitPosition=456, ComBitSize=8, ComSignalType=UINT8, ComSystemTemplateSystemSignalRef=DET_SNR_112_Rx
            DET_SUPER_RES_TARGET_109_Rx_oRDR_FUSION_DET_109_112_oPCAN_RADAR_f66389ae_Rx: ComBitPosition=87, ComBitSize=1, ComSignalType=BOOLEAN, ComSystemTemplateSystemSignalRef=DET_SUPER_RES_TARGET_109_Rx
            DET_SUPER_RES_TARGET_110_Rx_oRDR_FUSION_DET_109_112_oPCAN_RADAR_cb430ab7_Rx: ComBitPosition=199, ComBitSize=1, ComSignalType=BOOLEAN, ComSystemTemplateSystemSignalRef=DET_SUPER_RES_TARGET_110_Rx
            DET_SUPER_RES_TARGET_111_Rx_oRDR_FUSION_DET_109_112_oPCAN_RADAR_640798f0_Rx: ComBitPosition=311, ComBitSize=1, ComSignalType=BOOLEAN, ComSystemTemplateSystemSignalRef=DET_SUPER_RES_TARGET_111_Rx
            DET_SUPER_RES_TARGET_112_Rx_oRDR_FUSION_DET_109_112_oPCAN_RADAR_4ebb2878_Rx: ComBitPosition=423, ComBitSize=1, ComSignalType=BOOLEAN, ComSystemTemplateSystemSignalRef=DET_SUPER_RES_TARGET_112_Rx
        SG_Fusion_Detections_113_116_oRDR_FUSION_DET_113_116_oPCAN_RADAR_16b82f16_Rx: ComTimeout=0, ComSystemTemplateSignalGroupRef=SG_Fusion_Detections_113_116
          83 x ComGroupSignal, all with ComSignalEndianness=LITTLE_ENDIAN, ComSignalInitValue=0:
            DET_AZIMUTH_113_Rx_oRDR_FUSION_DET_113_116_oPCAN_RADAR_3d61a43a_Rx: ComBitPosition=88, ComBitSize=13, ComSignalType=UINT16, ComSystemTemplateSystemSignalRef=DET_AZIMUTH_113_Rx
            DET_AZIMUTH_114_Rx_oRDR_FUSION_DET_113_116_oPCAN_RADAR_c75c576d_Rx: ComBitPosition=200, ComBitSize=13, ComSignalType=UINT16, ComSystemTemplateSystemSignalRef=DET_AZIMUTH_114_Rx
            DET_AZIMUTH_115_Rx_oRDR_FUSION_DET_113_116_oPCAN_RADAR_6818c52a_Rx: ComBitPosition=312, ComBitSize=13, ComSignalType=UINT16, ComSystemTemplateSystemSignalRef=DET_AZIMUTH_115_Rx
            DET_AZIMUTH_116_Rx_oRDR_FUSION_DET_113_116_oPCAN_RADAR_42a475a2_Rx: ComBitPosition=424, ComBitSize=13, ComSignalType=UINT16, ComSystemTemplateSystemSignalRef=DET_AZIMUTH_116_Rx
            DET_AZIMUTH_ERR_113_Rx_oRDR_FUSION_DET_113_116_oPCAN_RADAR_3f0805b8_Rx: ComBitPosition=105, ComBitSize=7, ComSignalType=UINT8, ComSystemTemplateSystemSignalRef=DET_AZIMUTH_ERR_113_Rx
            DET_AZIMUTH_ERR_114_Rx_oRDR_FUSION_DET_113_116_oPCAN_RADAR_c535f6ef_Rx: ComBitPosition=217, ComBitSize=7, ComSignalType=UINT8, ComSystemTemplateSystemSignalRef=DET_AZIMUTH_ERR_114_Rx
            DET_AZIMUTH_ERR_115_Rx_oRDR_FUSION_DET_113_116_oPCAN_RADAR_6a7164a8_Rx: ComBitPosition=329, ComBitSize=7, ComSignalType=UINT8, ComSystemTemplateSystemSignalRef=DET_AZIMUTH_ERR_115_Rx
            DET_AZIMUTH_ERR_116_Rx_oRDR_FUSION_DET_113_116_oPCAN_RADAR_40cdd420_Rx: ComBitPosition=441, ComBitSize=7, ComSignalType=UINT8, ComSystemTemplateSystemSignalRef=DET_AZIMUTH_ERR_116_Rx
            DET_BELOW_RAIN_THOLD_113_Rx_oRDR_FUSION_DET_113_116_oPCAN_RADAR_5bdb5b8f_Rx: ComBitPosition=39, ComBitSize=1, ComSignalType=BOOLEAN, ComSystemTemplateSystemSignalRef=DET_BELOW_RAIN_THOLD_113_Rx
            DET_BELOW_RAIN_THOLD_114_Rx_oRDR_FUSION_DET_113_116_oPCAN_RADAR_a1e6a8d8_Rx: ComBitPosition=151, ComBitSize=1, ComSignalType=BOOLEAN, ComSystemTemplateSystemSignalRef=DET_BELOW_RAIN_THOLD_114_Rx
            DET_BELOW_RAIN_THOLD_115_Rx_oRDR_FUSION_DET_113_116_oPCAN_RADAR_0ea23a9f_Rx: ComBitPosition=263, ComBitSize=1, ComSignalType=BOOLEAN, ComSystemTemplateSystemSignalRef=DET_BELOW_RAIN_THOLD_115_Rx
            DET_BELOW_RAIN_THOLD_116_Rx_oRDR_FUSION_DET_113_116_oPCAN_RADAR_241e8a17_Rx: ComBitPosition=375, ComBitSize=1, ComSignalType=BOOLEAN, ComSystemTemplateSystemSignalRef=DET_BELOW_RAIN_THOLD_116_Rx
            DET_BI_STATIC_FLAG_113_Rx_oRDR_FUSION_DET_113_116_oPCAN_RADAR_2c45f09c_Rx: ComBitPosition=104, ComBitSize=1, ComSignalType=BOOLEAN, ComSystemTemplateSystemSignalRef=DET_BI_STATIC_FLAG_113_Rx
            DET_BI_STATIC_FLAG_114_Rx_oRDR_FUSION_DET_113_116_oPCAN_RADAR_d67803cb_Rx: ComBitPosition=216, ComBitSize=1, ComSignalType=BOOLEAN, ComSystemTemplateSystemSignalRef=DET_BI_STATIC_FLAG_114_Rx
            DET_BI_STATIC_FLAG_115_Rx_oRDR_FUSION_DET_113_116_oPCAN_RADAR_793c918c_Rx: ComBitPosition=328, ComBitSize=1, ComSignalType=BOOLEAN, ComSystemTemplateSystemSignalRef=DET_BI_STATIC_FLAG_115_Rx
            DET_BI_STATIC_FLAG_116_Rx_oRDR_FUSION_DET_113_116_oPCAN_RADAR_53802104_Rx: ComBitPosition=440, ComBitSize=1, ComSignalType=BOOLEAN, ComSystemTemplateSystemSignalRef=DET_BI_STATIC_FLAG_116_Rx
            DET_CONFD_AZIMUTH_113_Rx_oRDR_FUSION_DET_113_116_oPCAN_RADAR_cf2c1ac8_Rx: ComBitPosition=118, ComBitSize=2, ComSignalType=UINT8, ComSystemTemplateSystemSignalRef=DET_CONFD_AZIMUTH_113_Rx
            DET_CONFD_AZIMUTH_114_Rx_oRDR_FUSION_DET_113_116_oPCAN_RADAR_3511e99f_Rx: ComBitPosition=230, ComBitSize=2, ComSignalType=UINT8, ComSystemTemplateSystemSignalRef=DET_CONFD_AZIMUTH_114_Rx
            DET_CONFD_AZIMUTH_115_Rx_oRDR_FUSION_DET_113_116_oPCAN_RADAR_9a557bd8_Rx: ComBitPosition=342, ComBitSize=2, ComSignalType=UINT8, ComSystemTemplateSystemSignalRef=DET_CONFD_AZIMUTH_115_Rx
            DET_CONFD_AZIMUTH_116_Rx_oRDR_FUSION_DET_113_116_oPCAN_RADAR_b0e9cb50_Rx: ComBitPosition=454, ComBitSize=2, ComSignalType=UINT8, ComSystemTemplateSystemSignalRef=DET_CONFD_AZIMUTH_116_Rx
            DET_CONFD_ELEVATION_113_Rx_oRDR_FUSION_DET_113_116_oPCAN_RADAR_c50d994f_Rx: ComBitPosition=101, ComBitSize=2, ComSignalType=UINT8, ComSystemTemplateSystemSignalRef=DET_CONFD_ELEVATION_113_Rx
            DET_CONFD_ELEVATION_114_Rx_oRDR_FUSION_DET_113_116_oPCAN_RADAR_3f306a18_Rx: ComBitPosition=213, ComBitSize=2, ComSignalType=UINT8, ComSystemTemplateSystemSignalRef=DET_CONFD_ELEVATION_114_Rx
            DET_CONFD_ELEVATION_115_Rx_oRDR_FUSION_DET_113_116_oPCAN_RADAR_9074f85f_Rx: ComBitPosition=325, ComBitSize=2, ComSignalType=UINT8, ComSystemTemplateSystemSignalRef=DET_CONFD_ELEVATION_115_Rx
            DET_CONFD_ELEVATION_116_Rx_oRDR_FUSION_DET_113_116_oPCAN_RADAR_bac848d7_Rx: ComBitPosition=437, ComBitSize=2, ComSignalType=UINT8, ComSystemTemplateSystemSignalRef=DET_CONFD_ELEVATION_116_Rx
            DET_ELEVATION_113_Rx_oRDR_FUSION_DET_113_116_oPCAN_RADAR_cf5e76b6_Rx: ComBitPosition=72, ComBitSize=8, ComSignalType=UINT8, ComSystemTemplateSystemSignalRef=DET_ELEVATION_113_Rx
            DET_ELEVATION_114_Rx_oRDR_FUSION_DET_113_116_oPCAN_RADAR_356385e1_Rx: ComBitPosition=184, ComBitSize=8, ComSignalType=UINT8, ComSystemTemplateSystemSignalRef=DET_ELEVATION_114_Rx
            DET_ELEVATION_115_Rx_oRDR_FUSION_DET_113_116_oPCAN_RADAR_9a2717a6_Rx: ComBitPosition=296, ComBitSize=8, ComSignalType=UINT8, ComSystemTemplateSystemSignalRef=DET_ELEVATION_115_Rx
            DET_ELEVATION_116_Rx_oRDR_FUSION_DET_113_116_oPCAN_RADAR_b09ba72e_Rx: ComBitPosition=408, ComBitSize=8, ComSignalType=UINT8, ComSystemTemplateSystemSignalRef=DET_ELEVATION_116_Rx
            DET_ELEVATION_ERR_113_Rx_oRDR_FUSION_DET_113_116_oPCAN_RADAR_1de75469_Rx: ComBitPosition=80, ComBitSize=6, ComSignalType=UINT8, ComSystemTemplateSystemSignalRef=DET_ELEVATION_ERR_113_Rx
            DET_ELEVATION_ERR_114_Rx_oRDR_FUSION_DET_113_116_oPCAN_RADAR_e7daa73e_Rx: ComBitPosition=192, ComBitSize=6, ComSignalType=UINT8, ComSystemTemplateSystemSignalRef=DET_ELEVATION_ERR_114_Rx
            DET_ELEVATION_ERR_115_Rx_oRDR_FUSION_DET_113_116_oPCAN_RADAR_489e3579_Rx: ComBitPosition=304, ComBitSize=6, ComSignalType=UINT8, ComSystemTemplateSystemSignalRef=DET_ELEVATION_ERR_115_Rx
            DET_ELEVATION_ERR_116_Rx_oRDR_FUSION_DET_113_116_oPCAN_RADAR_622285f1_Rx: ComBitPosition=416, ComBitSize=6, ComSignalType=UINT8, ComSystemTemplateSystemSignalRef=DET_ELEVATION_ERR_116_Rx
            DET_EXISTENCE_PROB_113_Rx_oRDR_FUSION_DET_113_116_oPCAN_RADAR_eaff2cfc_Rx: ComBitPosition=112, ComBitSize=6, ComSignalType=UINT8, ComSystemTemplateSystemSignalRef=DET_EXISTENCE_PROB_113_Rx
            DET_EXISTENCE_PROB_114_Rx_oRDR_FUSION_DET_113_116_oPCAN_RADAR_10c2dfab_Rx: ComBitPosition=224, ComBitSize=6, ComSignalType=UINT8, ComSystemTemplateSystemSignalRef=DET_EXISTENCE_PROB_114_Rx
            DET_EXISTENCE_PROB_115_Rx_oRDR_FUSION_DET_113_116_oPCAN_RADAR_bf864dec_Rx: ComBitPosition=336, ComBitSize=6, ComSignalType=UINT8, ComSystemTemplateSystemSignalRef=DET_EXISTENCE_PROB_115_Rx
            DET_EXISTENCE_PROB_116_Rx_oRDR_FUSION_DET_113_116_oPCAN_RADAR_953afd64_Rx: ComBitPosition=448, ComBitSize=6, ComSignalType=UINT8, ComSystemTemplateSystemSignalRef=DET_EXISTENCE_PROB_116_Rx
            DET_HVC_FLAG_113_Rx_oRDR_FUSION_DET_113_116_oPCAN_RADAR_3721c1b3_Rx: ComBitPosition=86, ComBitSize=1, ComSignalType=BOOLEAN, ComSystemTemplateSystemSignalRef=DET_HVC_FLAG_113_Rx
            DET_HVC_FLAG_114_Rx_oRDR_FUSION_DET_113_116_oPCAN_RADAR_cd1c32e4_Rx: ComBitPosition=198, ComBitSize=1, ComSignalType=BOOLEAN, ComSystemTemplateSystemSignalRef=DET_HVC_FLAG_114_Rx
            DET_HVC_FLAG_115_Rx_oRDR_FUSION_DET_113_116_oPCAN_RADAR_6258a0a3_Rx: ComBitPosition=310, ComBitSize=1, ComSignalType=BOOLEAN, ComSystemTemplateSystemSignalRef=DET_HVC_FLAG_115_Rx
            DET_HVC_FLAG_116_Rx_oRDR_FUSION_DET_113_116_oPCAN_RADAR_48e4102b_Rx: ComBitPosition=422, ComBitSize=1, ComSignalType=BOOLEAN, ComSystemTemplateSystemSignalRef=DET_HVC_FLAG_116_Rx
            DET_IDM_113_Rx_oRDR_FUSION_DET_113_116_oPCAN_RADAR_02e038fb_Rx: ComBitPosition=63, ComBitSize=1, ComSignalType=BOOLEAN, ComSystemTemplateSystemSignalRef=DET_IDM_113_Rx
            DET_IDM_114_Rx_oRDR_FUSION_DET_113_116_oPCAN_RADAR_f8ddcbac_Rx: ComBitPosition=175, ComBitSize=1, ComSignalType=BOOLEAN, ComSystemTemplateSystemSignalRef=DET_IDM_114_Rx
            DET_IDM_115_Rx_oRDR_FUSION_DET_113_116_oPCAN_RADAR_579959eb_Rx: ComBitPosition=287, ComBitSize=1, ComSignalType=BOOLEAN, ComSystemTemplateSystemSignalRef=DET_IDM_115_Rx
            DET_IDM_116_Rx_oRDR_FUSION_DET_113_116_oPCAN_RADAR_7d25e963_Rx: ComBitPosition=399, ComBitSize=1, ComSignalType=BOOLEAN, ComSystemTemplateSystemSignalRef=DET_IDM_116_Rx
            DET_MH_CRC16_113_116_Rx_oRDR_FUSION_DET_113_116_oPCAN_RADAR_930d0bb1_Rx: ComBitPosition=0, ComBitSize=16, ComSignalType=UINT16, ComSystemTemplateSystemSignalRef=DET_MH_CRC16_113_116_Rx
            DET_MH_CYCLE_COUNTER_113_116_Rx_oRDR_FUSION_DET_113_116_oPCAN_RADAR_9ed63674_Rx: ComBitPosition=16, ComBitSize=8, ComSignalType=UINT8, ComSystemTemplateSystemSignalRef=DET_MH_CYCLE_COUNTER_113_116_Rx
            DET_MH_SCAN_INDEX_4LSB_113_116_Rx_oRDR_FUSION_DET_113_116_oPCAN_RADAR_fa66f94f_Rx: ComBitPosition=476, ComBitSize=4, ComSignalType=UINT8, ComSystemTemplateSystemSignalRef=DET_MH_SCAN_INDEX_4LSB_113_116_Rx
            DET_MTD_113_Rx_oRDR_FUSION_DET_113_116_oPCAN_RADAR_bf630e8b_Rx: ComBitPosition=47, ComBitSize=1, ComSignalType=BOOLEAN, ComSystemTemplateSystemSignalRef=DET_MTD_113_Rx
            DET_MTD_114_Rx_oRDR_FUSION_DET_113_116_oPCAN_RADAR_455efddc_Rx: ComBitPosition=159, ComBitSize=1, ComSignalType=BOOLEAN, ComSystemTemplateSystemSignalRef=DET_MTD_114_Rx
            DET_MTD_115_Rx_oRDR_FUSION_DET_113_116_oPCAN_RADAR_ea1a6f9b_Rx: ComBitPosition=271, ComBitSize=1, ComSignalType=BOOLEAN, ComSystemTemplateSystemSignalRef=DET_MTD_115_Rx
            DET_MTD_116_Rx_oRDR_FUSION_DET_113_116_oPCAN_RADAR_c0a6df13_Rx: ComBitPosition=383, ComBitSize=1, ComSignalType=BOOLEAN, ComSystemTemplateSystemSignalRef=DET_MTD_116_Rx
            DET_PROB_1STAZHYPO_113_Rx_oRDR_FUSION_DET_113_116_oPCAN_RADAR_751a100a_Rx: ComBitPosition=103, ComBitSize=1, ComSignalType=BOOLEAN, ComSystemTemplateSystemSignalRef=DET_PROB_1STAZHYPO_113_Rx
            DET_PROB_1STAZHYPO_114_Rx_oRDR_FUSION_DET_113_116_oPCAN_RADAR_8f27e35d_Rx: ComBitPosition=215, ComBitSize=1, ComSignalType=BOOLEAN, ComSystemTemplateSystemSignalRef=DET_PROB_1STAZHYPO_114_Rx
            DET_PROB_1STAZHYPO_115_Rx_oRDR_FUSION_DET_113_116_oPCAN_RADAR_2063711a_Rx: ComBitPosition=327, ComBitSize=1, ComSignalType=BOOLEAN, ComSystemTemplateSystemSignalRef=DET_PROB_1STAZHYPO_115_Rx
            DET_PROB_1STAZHYPO_116_Rx_oRDR_FUSION_DET_113_116_oPCAN_RADAR_0adfc192_Rx: ComBitPosition=439, ComBitSize=1, ComSignalType=BOOLEAN, ComSystemTemplateSystemSignalRef=DET_PROB_1STAZHYPO_116_Rx
            DET_RANGE_113_Rx_oRDR_FUSION_DET_113_116_oPCAN_RADAR_2ea7f81d_Rx: ComBitPosition=24, ComBitSize=15, ComSignalType=UINT16, ComSystemTemplateSystemSignalRef=DET_RANGE_113_Rx
            DET_RANGE_114_Rx_oRDR_FUSION_DET_113_116_oPCAN_RADAR_d49a0b4a_Rx: ComBitPosition=136, ComBitSize=15, ComSignalType=UINT16, ComSystemTemplateSystemSignalRef=DET_RANGE_114_Rx
            DET_RANGE_115_Rx_oRDR_FUSION_DET_113_116_oPCAN_RADAR_7bde990d_Rx: ComBitPosition=248, ComBitSize=15, ComSignalType=UINT16, ComSystemTemplateSystemSignalRef=DET_RANGE_115_Rx
            DET_RANGE_116_Rx_oRDR_FUSION_DET_113_116_oPCAN_RADAR_51622985_Rx: ComBitPosition=360, ComBitSize=15, ComSignalType=UINT16, ComSystemTemplateSystemSignalRef=DET_RANGE_116_Rx
            DET_RANGE_ERR_113_Rx_oRDR_FUSION_DET_113_116_oPCAN_RADAR_7e5574fd_Rx: ComBitPosition=40, ComBitSize=7, ComSignalType=UINT8, ComSystemTemplateSystemSignalRef=DET_RANGE_ERR_113_Rx
            DET_RANGE_ERR_114_Rx_oRDR_FUSION_DET_113_116_oPCAN_RADAR_846887aa_Rx: ComBitPosition=152, ComBitSize=7, ComSignalType=UINT8, ComSystemTemplateSystemSignalRef=DET_RANGE_ERR_114_Rx
            DET_RANGE_ERR_115_Rx_oRDR_FUSION_DET_113_116_oPCAN_RADAR_2b2c15ed_Rx: ComBitPosition=264, ComBitSize=7, ComSignalType=UINT8, ComSystemTemplateSystemSignalRef=DET_RANGE_ERR_115_Rx
            DET_RANGE_ERR_116_Rx_oRDR_FUSION_DET_113_116_oPCAN_RADAR_0190a565_Rx: ComBitPosition=376, ComBitSize=7, ComSignalType=UINT8, ComSystemTemplateSystemSignalRef=DET_RANGE_ERR_116_Rx
            DET_RANGE_VELOCITY_113_Rx_oRDR_FUSION_DET_113_116_oPCAN_RADAR_f3527be3_Rx: ComBitPosition=48, ComBitSize=15, ComSignalType=UINT16, ComSystemTemplateSystemSignalRef=DET_RANGE_VELOCITY_113_Rx
            DET_RANGE_VELOCITY_114_Rx_oRDR_FUSION_DET_113_116_oPCAN_RADAR_096f88b4_Rx: ComBitPosition=160, ComBitSize=15, ComSignalType=UINT16, ComSystemTemplateSystemSignalRef=DET_RANGE_VELOCITY_114_Rx
            DET_RANGE_VELOCITY_115_Rx_oRDR_FUSION_DET_113_116_oPCAN_RADAR_a62b1af3_Rx: ComBitPosition=272, ComBitSize=15, ComSignalType=UINT16, ComSystemTemplateSystemSignalRef=DET_RANGE_VELOCITY_115_Rx
            DET_RANGE_VELOCITY_116_Rx_oRDR_FUSION_DET_113_116_oPCAN_RADAR_8c97aa7b_Rx: ComBitPosition=384, ComBitSize=15, ComSignalType=UINT16, ComSystemTemplateSystemSignalRef=DET_RANGE_VELOCITY_116_Rx
            DET_RANGE_VELOCITY_ERR_113_Rx_oRDR_FUSION_DET_113_116_oPCAN_RADAR_6a360b21_Rx: ComBitPosition=64, ComBitSize=8, ComSignalType=UINT8, ComSystemTemplateSystemSignalRef=DET_RANGE_VELOCITY_ERR_113_Rx
            DET_RANGE_VELOCITY_ERR_114_Rx_oRDR_FUSION_DET_113_116_oPCAN_RADAR_900bf876_Rx: ComBitPosition=176, ComBitSize=8, ComSignalType=UINT8, ComSystemTemplateSystemSignalRef=DET_RANGE_VELOCITY_ERR_114_Rx
            DET_RANGE_VELOCITY_ERR_115_Rx_oRDR_FUSION_DET_113_116_oPCAN_RADAR_3f4f6a31_Rx: ComBitPosition=288, ComBitSize=8, ComSignalType=UINT8, ComSystemTemplateSystemSignalRef=DET_RANGE_VELOCITY_ERR_115_Rx
            DET_RANGE_VELOCITY_ERR_116_Rx_oRDR_FUSION_DET_113_116_oPCAN_RADAR_15f3dab9_Rx: ComBitPosition=400, ComBitSize=8, ComSignalType=UINT8, ComSystemTemplateSystemSignalRef=DET_RANGE_VELOCITY_ERR_116_Rx
            DET_RCS_113_Rx_oRDR_FUSION_DET_113_116_oPCAN_RADAR_3e99e9f8_Rx: ComBitPosition=128, ComBitSize=8, ComSignalType=UINT8, ComSystemTemplateSystemSignalRef=DET_RCS_113_Rx
            DET_RCS_114_Rx_oRDR_FUSION_DET_113_116_oPCAN_RADAR_c4a41aaf_Rx: ComBitPosition=240, ComBitSize=8, ComSignalType=UINT8, ComSystemTemplateSystemSignalRef=DET_RCS_114_Rx
            DET_RCS_115_Rx_oRDR_FUSION_DET_113_116_oPCAN_RADAR_6be088e8_Rx: ComBitPosition=352, ComBitSize=8, ComSignalType=UINT8, ComSystemTemplateSystemSignalRef=DET_RCS_115_Rx
            DET_RCS_116_Rx_oRDR_FUSION_DET_113_116_oPCAN_RADAR_415c3860_Rx: ComBitPosition=464, ComBitSize=8, ComSignalType=UINT8, ComSystemTemplateSystemSignalRef=DET_RCS_116_Rx
            DET_SNR_113_Rx_oRDR_FUSION_DET_113_116_oPCAN_RADAR_37c39811_Rx: ComBitPosition=120, ComBitSize=8, ComSignalType=UINT8, ComSystemTemplateSystemSignalRef=DET_SNR_113_Rx
            DET_SNR_114_Rx_oRDR_FUSION_DET_113_116_oPCAN_RADAR_cdfe6b46_Rx: ComBitPosition=232, ComBitSize=8, ComSignalType=UINT8, ComSystemTemplateSystemSignalRef=DET_SNR_114_Rx
            DET_SNR_115_Rx_oRDR_FUSION_DET_113_116_oPCAN_RADAR_62baf901_Rx: ComBitPosition=344, ComBitSize=8, ComSignalType=UINT8, ComSystemTemplateSystemSignalRef=DET_SNR_115_Rx
            DET_SNR_116_Rx_oRDR_FUSION_DET_113_116_oPCAN_RADAR_48064989_Rx: ComBitPosition=456, ComBitSize=8, ComSignalType=UINT8, ComSystemTemplateSystemSignalRef=DET_SNR_116_Rx
            DET_SUPER_RES_TARGET_113_Rx_oRDR_FUSION_DET_113_116_oPCAN_RADAR_fc38b911_Rx: ComBitPosition=87, ComBitSize=1, ComSignalType=BOOLEAN, ComSystemTemplateSystemSignalRef=DET_SUPER_RES_TARGET_113_Rx
            DET_SUPER_RES_TARGET_114_Rx_oRDR_FUSION_DET_113_116_oPCAN_RADAR_06054a46_Rx: ComBitPosition=199, ComBitSize=1, ComSignalType=BOOLEAN, ComSystemTemplateSystemSignalRef=DET_SUPER_RES_TARGET_114_Rx
            DET_SUPER_RES_TARGET_115_Rx_oRDR_FUSION_DET_113_116_oPCAN_RADAR_a941d801_Rx: ComBitPosition=311, ComBitSize=1, ComSignalType=BOOLEAN, ComSystemTemplateSystemSignalRef=DET_SUPER_RES_TARGET_115_Rx
            DET_SUPER_RES_TARGET_116_Rx_oRDR_FUSION_DET_113_116_oPCAN_RADAR_83fd6889_Rx: ComBitPosition=423, ComBitSize=1, ComSignalType=BOOLEAN, ComSystemTemplateSystemSignalRef=DET_SUPER_RES_TARGET_116_Rx
        SG_Fusion_Detections_117_120_oRDR_FUSION_DET_117_120_oPCAN_RADAR_56a2c27e_Rx: ComTimeout=0, ComSystemTemplateSignalGroupRef=SG_Fusion_Detections_117_120
          83 x ComGroupSignal, all with ComSignalEndianness=LITTLE_ENDIAN, ComSignalInitValue=0:
            DET_AZIMUTH_117_Rx_oRDR_FUSION_DET_117_120_oPCAN_RADAR_426c3a2c_Rx: ComBitPosition=88, ComBitSize=13, ComSignalType=UINT16, ComSystemTemplateSystemSignalRef=DET_AZIMUTH_117_Rx
            DET_AZIMUTH_118_Rx_oRDR_FUSION_DET_117_120_oPCAN_RADAR_c2224884_Rx: ComBitPosition=200, ComBitSize=13, ComSignalType=UINT16, ComSystemTemplateSystemSignalRef=DET_AZIMUTH_118_Rx
            DET_AZIMUTH_119_Rx_oRDR_FUSION_DET_117_120_oPCAN_RADAR_6d66dac3_Rx: ComBitPosition=312, ComBitSize=13, ComSignalType=UINT16, ComSystemTemplateSystemSignalRef=DET_AZIMUTH_119_Rx
            DET_AZIMUTH_120_Rx_oRDR_FUSION_DET_117_120_oPCAN_RADAR_5b187ed9_Rx: ComBitPosition=424, ComBitSize=13, ComSignalType=UINT16, ComSystemTemplateSystemSignalRef=DET_AZIMUTH_120_Rx
            DET_AZIMUTH_ERR_117_Rx_oRDR_FUSION_DET_117_120_oPCAN_RADAR_40059bae_Rx: ComBitPosition=105, ComBitSize=7, ComSignalType=UINT8, ComSystemTemplateSystemSignalRef=DET_AZIMUTH_ERR_117_Rx
            DET_AZIMUTH_ERR_118_Rx_oRDR_FUSION_DET_117_120_oPCAN_RADAR_c04be906_Rx: ComBitPosition=217, ComBitSize=7, ComSignalType=UINT8, ComSystemTemplateSystemSignalRef=DET_AZIMUTH_ERR_118_Rx
            DET_AZIMUTH_ERR_119_Rx_oRDR_FUSION_DET_117_120_oPCAN_RADAR_6f0f7b41_Rx: ComBitPosition=329, ComBitSize=7, ComSignalType=UINT8, ComSystemTemplateSystemSignalRef=DET_AZIMUTH_ERR_119_Rx
            DET_AZIMUTH_ERR_120_Rx_oRDR_FUSION_DET_117_120_oPCAN_RADAR_5971df5b_Rx: ComBitPosition=441, ComBitSize=7, ComSignalType=UINT8, ComSystemTemplateSystemSignalRef=DET_AZIMUTH_ERR_120_Rx
            DET_BELOW_RAIN_THOLD_117_Rx_oRDR_FUSION_DET_117_120_oPCAN_RADAR_24d6c599_Rx: ComBitPosition=39, ComBitSize=1, ComSignalType=BOOLEAN, ComSystemTemplateSystemSignalRef=DET_BELOW_RAIN_THOLD_117_Rx
            DET_BELOW_RAIN_THOLD_118_Rx_oRDR_FUSION_DET_117_120_oPCAN_RADAR_a498b731_Rx: ComBitPosition=151, ComBitSize=1, ComSignalType=BOOLEAN, ComSystemTemplateSystemSignalRef=DET_BELOW_RAIN_THOLD_118_Rx
            DET_BELOW_RAIN_THOLD_119_Rx_oRDR_FUSION_DET_117_120_oPCAN_RADAR_0bdc2576_Rx: ComBitPosition=263, ComBitSize=1, ComSignalType=BOOLEAN, ComSystemTemplateSystemSignalRef=DET_BELOW_RAIN_THOLD_119_Rx
            DET_BELOW_RAIN_THOLD_120_Rx_oRDR_FUSION_DET_117_120_oPCAN_RADAR_3da2816c_Rx: ComBitPosition=375, ComBitSize=1, ComSignalType=BOOLEAN, ComSystemTemplateSystemSignalRef=DET_BELOW_RAIN_THOLD_120_Rx
            DET_BI_STATIC_FLAG_117_Rx_oRDR_FUSION_DET_117_120_oPCAN_RADAR_53486e8a_Rx: ComBitPosition=104, ComBitSize=1, ComSignalType=BOOLEAN, ComSystemTemplateSystemSignalRef=DET_BI_STATIC_FLAG_117_Rx
            DET_BI_STATIC_FLAG_118_Rx_oRDR_FUSION_DET_117_120_oPCAN_RADAR_d3061c22_Rx: ComBitPosition=216, ComBitSize=1, ComSignalType=BOOLEAN, ComSystemTemplateSystemSignalRef=DET_BI_STATIC_FLAG_118_Rx
            DET_BI_STATIC_FLAG_119_Rx_oRDR_FUSION_DET_117_120_oPCAN_RADAR_7c428e65_Rx: ComBitPosition=328, ComBitSize=1, ComSignalType=BOOLEAN, ComSystemTemplateSystemSignalRef=DET_BI_STATIC_FLAG_119_Rx
            DET_BI_STATIC_FLAG_120_Rx_oRDR_FUSION_DET_117_120_oPCAN_RADAR_4a3c2a7f_Rx: ComBitPosition=440, ComBitSize=1, ComSignalType=BOOLEAN, ComSystemTemplateSystemSignalRef=DET_BI_STATIC_FLAG_120_Rx
            DET_CONFD_AZIMUTH_117_Rx_oRDR_FUSION_DET_117_120_oPCAN_RADAR_b02184de_Rx: ComBitPosition=118, ComBitSize=2, ComSignalType=UINT8, ComSystemTemplateSystemSignalRef=DET_CONFD_AZIMUTH_117_Rx
            DET_CONFD_AZIMUTH_118_Rx_oRDR_FUSION_DET_117_120_oPCAN_RADAR_306ff676_Rx: ComBitPosition=230, ComBitSize=2, ComSignalType=UINT8, ComSystemTemplateSystemSignalRef=DET_CONFD_AZIMUTH_118_Rx
            DET_CONFD_AZIMUTH_119_Rx_oRDR_FUSION_DET_117_120_oPCAN_RADAR_9f2b6431_Rx: ComBitPosition=342, ComBitSize=2, ComSignalType=UINT8, ComSystemTemplateSystemSignalRef=DET_CONFD_AZIMUTH_119_Rx
            DET_CONFD_AZIMUTH_120_Rx_oRDR_FUSION_DET_117_120_oPCAN_RADAR_a955c02b_Rx: ComBitPosition=454, ComBitSize=2, ComSignalType=UINT8, ComSystemTemplateSystemSignalRef=DET_CONFD_AZIMUTH_120_Rx
            DET_CONFD_ELEVATION_117_Rx_oRDR_FUSION_DET_117_120_oPCAN_RADAR_ba000759_Rx: ComBitPosition=101, ComBitSize=2, ComSignalType=UINT8, ComSystemTemplateSystemSignalRef=DET_CONFD_ELEVATION_117_Rx
            DET_CONFD_ELEVATION_118_Rx_oRDR_FUSION_DET_117_120_oPCAN_RADAR_3a4e75f1_Rx: ComBitPosition=213, ComBitSize=2, ComSignalType=UINT8, ComSystemTemplateSystemSignalRef=DET_CONFD_ELEVATION_118_Rx
            DET_CONFD_ELEVATION_119_Rx_oRDR_FUSION_DET_117_120_oPCAN_RADAR_950ae7b6_Rx: ComBitPosition=325, ComBitSize=2, ComSignalType=UINT8, ComSystemTemplateSystemSignalRef=DET_CONFD_ELEVATION_119_Rx
            DET_CONFD_ELEVATION_120_Rx_oRDR_FUSION_DET_117_120_oPCAN_RADAR_a37443ac_Rx: ComBitPosition=437, ComBitSize=2, ComSignalType=UINT8, ComSystemTemplateSystemSignalRef=DET_CONFD_ELEVATION_120_Rx
            DET_ELEVATION_117_Rx_oRDR_FUSION_DET_117_120_oPCAN_RADAR_b053e8a0_Rx: ComBitPosition=72, ComBitSize=8, ComSignalType=UINT8, ComSystemTemplateSystemSignalRef=DET_ELEVATION_117_Rx
            DET_ELEVATION_118_Rx_oRDR_FUSION_DET_117_120_oPCAN_RADAR_301d9a08_Rx: ComBitPosition=184, ComBitSize=8, ComSignalType=UINT8, ComSystemTemplateSystemSignalRef=DET_ELEVATION_118_Rx
            DET_ELEVATION_119_Rx_oRDR_FUSION_DET_117_120_oPCAN_RADAR_9f59084f_Rx: ComBitPosition=296, ComBitSize=8, ComSignalType=UINT8, ComSystemTemplateSystemSignalRef=DET_ELEVATION_119_Rx
            DET_ELEVATION_120_Rx_oRDR_FUSION_DET_117_120_oPCAN_RADAR_a927ac55_Rx: ComBitPosition=408, ComBitSize=8, ComSignalType=UINT8, ComSystemTemplateSystemSignalRef=DET_ELEVATION_120_Rx
            DET_ELEVATION_ERR_117_Rx_oRDR_FUSION_DET_117_120_oPCAN_RADAR_62eaca7f_Rx: ComBitPosition=80, ComBitSize=6, ComSignalType=UINT8, ComSystemTemplateSystemSignalRef=DET_ELEVATION_ERR_117_Rx
            DET_ELEVATION_ERR_118_Rx_oRDR_FUSION_DET_117_120_oPCAN_RADAR_e2a4b8d7_Rx: ComBitPosition=192, ComBitSize=6, ComSignalType=UINT8, ComSystemTemplateSystemSignalRef=DET_ELEVATION_ERR_118_Rx
            DET_ELEVATION_ERR_119_Rx_oRDR_FUSION_DET_117_120_oPCAN_RADAR_4de02a90_Rx: ComBitPosition=304, ComBitSize=6, ComSignalType=UINT8, ComSystemTemplateSystemSignalRef=DET_ELEVATION_ERR_119_Rx
            DET_ELEVATION_ERR_120_Rx_oRDR_FUSION_DET_117_120_oPCAN_RADAR_7b9e8e8a_Rx: ComBitPosition=416, ComBitSize=6, ComSignalType=UINT8, ComSystemTemplateSystemSignalRef=DET_ELEVATION_ERR_120_Rx
            DET_EXISTENCE_PROB_117_Rx_oRDR_FUSION_DET_117_120_oPCAN_RADAR_95f2b2ea_Rx: ComBitPosition=112, ComBitSize=6, ComSignalType=UINT8, ComSystemTemplateSystemSignalRef=DET_EXISTENCE_PROB_117_Rx
            DET_EXISTENCE_PROB_118_Rx_oRDR_FUSION_DET_117_120_oPCAN_RADAR_15bcc042_Rx: ComBitPosition=224, ComBitSize=6, ComSignalType=UINT8, ComSystemTemplateSystemSignalRef=DET_EXISTENCE_PROB_118_Rx
            DET_EXISTENCE_PROB_119_Rx_oRDR_FUSION_DET_117_120_oPCAN_RADAR_baf85205_Rx: ComBitPosition=336, ComBitSize=6, ComSignalType=UINT8, ComSystemTemplateSystemSignalRef=DET_EXISTENCE_PROB_119_Rx
            DET_EXISTENCE_PROB_120_Rx_oRDR_FUSION_DET_117_120_oPCAN_RADAR_8c86f61f_Rx: ComBitPosition=448, ComBitSize=6, ComSignalType=UINT8, ComSystemTemplateSystemSignalRef=DET_EXISTENCE_PROB_120_Rx
            DET_HVC_FLAG_117_Rx_oRDR_FUSION_DET_117_120_oPCAN_RADAR_482c5fa5_Rx: ComBitPosition=86, ComBitSize=1, ComSignalType=BOOLEAN, ComSystemTemplateSystemSignalRef=DET_HVC_FLAG_117_Rx
            DET_HVC_FLAG_118_Rx_oRDR_FUSION_DET_117_120_oPCAN_RADAR_c8622d0d_Rx: ComBitPosition=198, ComBitSize=1, ComSignalType=BOOLEAN, ComSystemTemplateSystemSignalRef=DET_HVC_FLAG_118_Rx
            DET_HVC_FLAG_119_Rx_oRDR_FUSION_DET_117_120_oPCAN_RADAR_6726bf4a_Rx: ComBitPosition=310, ComBitSize=1, ComSignalType=BOOLEAN, ComSystemTemplateSystemSignalRef=DET_HVC_FLAG_119_Rx
            DET_HVC_FLAG_120_Rx_oRDR_FUSION_DET_117_120_oPCAN_RADAR_51581b50_Rx: ComBitPosition=422, ComBitSize=1, ComSignalType=BOOLEAN, ComSystemTemplateSystemSignalRef=DET_HVC_FLAG_120_Rx
            DET_IDM_117_Rx_oRDR_FUSION_DET_117_120_oPCAN_RADAR_7deda6ed_Rx: ComBitPosition=63, ComBitSize=1, ComSignalType=BOOLEAN, ComSystemTemplateSystemSignalRef=DET_IDM_117_Rx
            DET_IDM_118_Rx_oRDR_FUSION_DET_117_120_oPCAN_RADAR_fda3d445_Rx: ComBitPosition=175, ComBitSize=1, ComSignalType=BOOLEAN, ComSystemTemplateSystemSignalRef=DET_IDM_118_Rx
            DET_IDM_119_Rx_oRDR_FUSION_DET_117_120_oPCAN_RADAR_52e74602_Rx: ComBitPosition=287, ComBitSize=1, ComSignalType=BOOLEAN, ComSystemTemplateSystemSignalRef=DET_IDM_119_Rx
            DET_IDM_120_Rx_oRDR_FUSION_DET_117_120_oPCAN_RADAR_6499e218_Rx: ComBitPosition=399, ComBitSize=1, ComSignalType=BOOLEAN, ComSystemTemplateSystemSignalRef=DET_IDM_120_Rx
            DET_MH_CRC16_117_120_Rx_oRDR_FUSION_DET_117_120_oPCAN_RADAR_2211e142_Rx: ComBitPosition=0, ComBitSize=16, ComSignalType=UINT16, ComSystemTemplateSystemSignalRef=DET_MH_CRC16_117_120_Rx
            DET_MH_CYCLE_COUNTER_117_120_Rx_oRDR_FUSION_DET_117_120_oPCAN_RADAR_2fcadc87_Rx: ComBitPosition=16, ComBitSize=8, ComSignalType=UINT8, ComSystemTemplateSystemSignalRef=DET_MH_CYCLE_COUNTER_117_120_Rx
            DET_MH_SCAN_INDEX_4LSB_117_120_Rx_oRDR_FUSION_DET_117_120_oPCAN_RADAR_4b7a13bc_Rx: ComBitPosition=476, ComBitSize=4, ComSignalType=UINT8, ComSystemTemplateSystemSignalRef=DET_MH_SCAN_INDEX_4LSB_117_120_Rx
            DET_MTD_117_Rx_oRDR_FUSION_DET_117_120_oPCAN_RADAR_c06e909d_Rx: ComBitPosition=47, ComBitSize=1, ComSignalType=BOOLEAN, ComSystemTemplateSystemSignalRef=DET_MTD_117_Rx
            DET_MTD_118_Rx_oRDR_FUSION_DET_117_120_oPCAN_RADAR_4020e235_Rx: ComBitPosition=159, ComBitSize=1, ComSignalType=BOOLEAN, ComSystemTemplateSystemSignalRef=DET_MTD_118_Rx
            DET_MTD_119_Rx_oRDR_FUSION_DET_117_120_oPCAN_RADAR_ef647072_Rx: ComBitPosition=271, ComBitSize=1, ComSignalType=BOOLEAN, ComSystemTemplateSystemSignalRef=DET_MTD_119_Rx
            DET_MTD_120_Rx_oRDR_FUSION_DET_117_120_oPCAN_RADAR_d91ad468_Rx: ComBitPosition=383, ComBitSize=1, ComSignalType=BOOLEAN, ComSystemTemplateSystemSignalRef=DET_MTD_120_Rx
            DET_PROB_1STAZHYPO_117_Rx_oRDR_FUSION_DET_117_120_oPCAN_RADAR_0a178e1c_Rx: ComBitPosition=103, ComBitSize=1, ComSignalType=BOOLEAN, ComSystemTemplateSystemSignalRef=DET_PROB_1STAZHYPO_117_Rx
            DET_PROB_1STAZHYPO_118_Rx_oRDR_FUSION_DET_117_120_oPCAN_RADAR_8a59fcb4_Rx: ComBitPosition=215, ComBitSize=1, ComSignalType=BOOLEAN, ComSystemTemplateSystemSignalRef=DET_PROB_1STAZHYPO_118_Rx
            DET_PROB_1STAZHYPO_119_Rx_oRDR_FUSION_DET_117_120_oPCAN_RADAR_251d6ef3_Rx: ComBitPosition=327, ComBitSize=1, ComSignalType=BOOLEAN, ComSystemTemplateSystemSignalRef=DET_PROB_1STAZHYPO_119_Rx
            DET_PROB_1STAZHYPO_120_Rx_oRDR_FUSION_DET_117_120_oPCAN_RADAR_1363cae9_Rx: ComBitPosition=439, ComBitSize=1, ComSignalType=BOOLEAN, ComSystemTemplateSystemSignalRef=DET_PROB_1STAZHYPO_120_Rx
            DET_RANGE_117_Rx_oRDR_FUSION_DET_117_120_oPCAN_RADAR_51aa660b_Rx: ComBitPosition=24, ComBitSize=15, ComSignalType=UINT16, ComSystemTemplateSystemSignalRef=DET_RANGE_117_Rx
            DET_RANGE_118_Rx_oRDR_FUSION_DET_117_120_oPCAN_RADAR_d1e414a3_Rx: ComBitPosition=136, ComBitSize=15, ComSignalType=UINT16, ComSystemTemplateSystemSignalRef=DET_RANGE_118_Rx
            DET_RANGE_119_Rx_oRDR_FUSION_DET_117_120_oPCAN_RADAR_7ea086e4_Rx: ComBitPosition=248, ComBitSize=15, ComSignalType=UINT16, ComSystemTemplateSystemSignalRef=DET_RANGE_119_Rx
            DET_RANGE_120_Rx_oRDR_FUSION_DET_117_120_oPCAN_RADAR_48de22fe_Rx: ComBitPosition=360, ComBitSize=15, ComSignalType=UINT16, ComSystemTemplateSystemSignalRef=DET_RANGE_120_Rx
            DET_RANGE_ERR_117_Rx_oRDR_FUSION_DET_117_120_oPCAN_RADAR_0158eaeb_Rx: ComBitPosition=40, ComBitSize=7, ComSignalType=UINT8, ComSystemTemplateSystemSignalRef=DET_RANGE_ERR_117_Rx
            DET_RANGE_ERR_118_Rx_oRDR_FUSION_DET_117_120_oPCAN_RADAR_81169843_Rx: ComBitPosition=152, ComBitSize=7, ComSignalType=UINT8, ComSystemTemplateSystemSignalRef=DET_RANGE_ERR_118_Rx
            DET_RANGE_ERR_119_Rx_oRDR_FUSION_DET_117_120_oPCAN_RADAR_2e520a04_Rx: ComBitPosition=264, ComBitSize=7, ComSignalType=UINT8, ComSystemTemplateSystemSignalRef=DET_RANGE_ERR_119_Rx
            DET_RANGE_ERR_120_Rx_oRDR_FUSION_DET_117_120_oPCAN_RADAR_182cae1e_Rx: ComBitPosition=376, ComBitSize=7, ComSignalType=UINT8, ComSystemTemplateSystemSignalRef=DET_RANGE_ERR_120_Rx
            DET_RANGE_VELOCITY_117_Rx_oRDR_FUSION_DET_117_120_oPCAN_RADAR_8c5fe5f5_Rx: ComBitPosition=48, ComBitSize=15, ComSignalType=UINT16, ComSystemTemplateSystemSignalRef=DET_RANGE_VELOCITY_117_Rx
            DET_RANGE_VELOCITY_118_Rx_oRDR_FUSION_DET_117_120_oPCAN_RADAR_0c11975d_Rx: ComBitPosition=160, ComBitSize=15, ComSignalType=UINT16, ComSystemTemplateSystemSignalRef=DET_RANGE_VELOCITY_118_Rx
            DET_RANGE_VELOCITY_119_Rx_oRDR_FUSION_DET_117_120_oPCAN_RADAR_a355051a_Rx: ComBitPosition=272, ComBitSize=15, ComSignalType=UINT16, ComSystemTemplateSystemSignalRef=DET_RANGE_VELOCITY_119_Rx
            DET_RANGE_VELOCITY_120_Rx_oRDR_FUSION_DET_117_120_oPCAN_RADAR_952ba100_Rx: ComBitPosition=384, ComBitSize=15, ComSignalType=UINT16, ComSystemTemplateSystemSignalRef=DET_RANGE_VELOCITY_120_Rx
            DET_RANGE_VELOCITY_ERR_117_Rx_oRDR_FUSION_DET_117_120_oPCAN_RADAR_153b9537_Rx: ComBitPosition=64, ComBitSize=8, ComSignalType=UINT8, ComSystemTemplateSystemSignalRef=DET_RANGE_VELOCITY_ERR_117_Rx
            DET_RANGE_VELOCITY_ERR_118_Rx_oRDR_FUSION_DET_117_120_oPCAN_RADAR_9575e79f_Rx: ComBitPosition=176, ComBitSize=8, ComSignalType=UINT8, ComSystemTemplateSystemSignalRef=DET_RANGE_VELOCITY_ERR_118_Rx
            DET_RANGE_VELOCITY_ERR_119_Rx_oRDR_FUSION_DET_117_120_oPCAN_RADAR_3a3175d8_Rx: ComBitPosition=288, ComBitSize=8, ComSignalType=UINT8, ComSystemTemplateSystemSignalRef=DET_RANGE_VELOCITY_ERR_119_Rx
            DET_RANGE_VELOCITY_ERR_120_Rx_oRDR_FUSION_DET_117_120_oPCAN_RADAR_0c4fd1c2_Rx: ComBitPosition=400, ComBitSize=8, ComSignalType=UINT8, ComSystemTemplateSystemSignalRef=DET_RANGE_VELOCITY_ERR_120_Rx
            DET_RCS_117_Rx_oRDR_FUSION_DET_117_120_oPCAN_RADAR_419477ee_Rx: ComBitPosition=128, ComBitSize=8, ComSignalType=UINT8, ComSystemTemplateSystemSignalRef=DET_RCS_117_Rx
            DET_RCS_118_Rx_oRDR_FUSION_DET_117_120_oPCAN_RADAR_c1da0546_Rx: ComBitPosition=240, ComBitSize=8, ComSignalType=UINT8, ComSystemTemplateSystemSignalRef=DET_RCS_118_Rx
            DET_RCS_119_Rx_oRDR_FUSION_DET_117_120_oPCAN_RADAR_6e9e9701_Rx: ComBitPosition=352, ComBitSize=8, ComSignalType=UINT8, ComSystemTemplateSystemSignalRef=DET_RCS_119_Rx
            DET_RCS_120_Rx_oRDR_FUSION_DET_117_120_oPCAN_RADAR_58e0331b_Rx: ComBitPosition=464, ComBitSize=8, ComSignalType=UINT8, ComSystemTemplateSystemSignalRef=DET_RCS_120_Rx
            DET_SNR_117_Rx_oRDR_FUSION_DET_117_120_oPCAN_RADAR_48ce0607_Rx: ComBitPosition=120, ComBitSize=8, ComSignalType=UINT8, ComSystemTemplateSystemSignalRef=DET_SNR_117_Rx
            DET_SNR_118_Rx_oRDR_FUSION_DET_117_120_oPCAN_RADAR_c88074af_Rx: ComBitPosition=232, ComBitSize=8, ComSignalType=UINT8, ComSystemTemplateSystemSignalRef=DET_SNR_118_Rx
            DET_SNR_119_Rx_oRDR_FUSION_DET_117_120_oPCAN_RADAR_67c4e6e8_Rx: ComBitPosition=344, ComBitSize=8, ComSignalType=UINT8, ComSystemTemplateSystemSignalRef=DET_SNR_119_Rx
            DET_SNR_120_Rx_oRDR_FUSION_DET_117_120_oPCAN_RADAR_51ba42f2_Rx: ComBitPosition=456, ComBitSize=8, ComSignalType=UINT8, ComSystemTemplateSystemSignalRef=DET_SNR_120_Rx
            DET_SUPER_RES_TARGET_117_Rx_oRDR_FUSION_DET_117_120_oPCAN_RADAR_83352707_Rx: ComBitPosition=87, ComBitSize=1, ComSignalType=BOOLEAN, ComSystemTemplateSystemSignalRef=DET_SUPER_RES_TARGET_117_Rx
            DET_SUPER_RES_TARGET_118_Rx_oRDR_FUSION_DET_117_120_oPCAN_RADAR_037b55af_Rx: ComBitPosition=199, ComBitSize=1, ComSignalType=BOOLEAN, ComSystemTemplateSystemSignalRef=DET_SUPER_RES_TARGET_118_Rx
            DET_SUPER_RES_TARGET_119_Rx_oRDR_FUSION_DET_117_120_oPCAN_RADAR_ac3fc7e8_Rx: ComBitPosition=311, ComBitSize=1, ComSignalType=BOOLEAN, ComSystemTemplateSystemSignalRef=DET_SUPER_RES_TARGET_119_Rx
            DET_SUPER_RES_TARGET_120_Rx_oRDR_FUSION_DET_117_120_oPCAN_RADAR_9a4163f2_Rx: ComBitPosition=423, ComBitSize=1, ComSignalType=BOOLEAN, ComSystemTemplateSystemSignalRef=DET_SUPER_RES_TARGET_120_Rx
        SG_Fusion_Detections_121_124_oRDR_FUSION_DET_121_124_oPCAN_RADAR_9023764b_Rx: ComTimeout=0, ComSystemTemplateSignalGroupRef=SG_Fusion_Detections_121_124
          83 x ComGroupSignal, all with ComSignalEndianness=LITTLE_ENDIAN, ComSignalInitValue=0:
            DET_AZIMUTH_121_Rx_oRDR_FUSION_DET_121_124_oPCAN_RADAR_7957ec62_Rx: ComBitPosition=88, ComBitSize=13, ComSignalType=UINT16, ComSystemTemplateSystemSignalRef=DET_AZIMUTH_121_Rx
            DET_AZIMUTH_122_Rx_oRDR_FUSION_DET_121_124_oPCAN_RADAR_53eb5cea_Rx: ComBitPosition=200, ComBitSize=13, ComSignalType=UINT16, ComSystemTemplateSystemSignalRef=DET_AZIMUTH_122_Rx
            DET_AZIMUTH_123_Rx_oRDR_FUSION_DET_121_124_oPCAN_RADAR_fcafcead_Rx: ComBitPosition=312, ComBitSize=13, ComSignalType=UINT16, ComSystemTemplateSystemSignalRef=DET_AZIMUTH_123_Rx
            DET_AZIMUTH_124_Rx_oRDR_FUSION_DET_121_124_oPCAN_RADAR_06923dfa_Rx: ComBitPosition=424, ComBitSize=13, ComSignalType=UINT16, ComSystemTemplateSystemSignalRef=DET_AZIMUTH_124_Rx
            DET_AZIMUTH_ERR_121_Rx_oRDR_FUSION_DET_121_124_oPCAN_RADAR_7b3e4de0_Rx: ComBitPosition=105, ComBitSize=7, ComSignalType=UINT8, ComSystemTemplateSystemSignalRef=DET_AZIMUTH_ERR_121_Rx
            DET_AZIMUTH_ERR_122_Rx_oRDR_FUSION_DET_121_124_oPCAN_RADAR_5182fd68_Rx: ComBitPosition=217, ComBitSize=7, ComSignalType=UINT8, ComSystemTemplateSystemSignalRef=DET_AZIMUTH_ERR_122_Rx
            DET_AZIMUTH_ERR_123_Rx_oRDR_FUSION_DET_121_124_oPCAN_RADAR_fec66f2f_Rx: ComBitPosition=329, ComBitSize=7, ComSignalType=UINT8, ComSystemTemplateSystemSignalRef=DET_AZIMUTH_ERR_123_Rx
            DET_AZIMUTH_ERR_124_Rx_oRDR_FUSION_DET_121_124_oPCAN_RADAR_04fb9c78_Rx: ComBitPosition=441, ComBitSize=7, ComSignalType=UINT8, ComSystemTemplateSystemSignalRef=DET_AZIMUTH_ERR_124_Rx
            DET_BELOW_RAIN_THOLD_121_Rx_oRDR_FUSION_DET_121_124_oPCAN_RADAR_1fed13d7_Rx: ComBitPosition=39, ComBitSize=1, ComSignalType=BOOLEAN, ComSystemTemplateSystemSignalRef=DET_BELOW_RAIN_THOLD_121_Rx
            DET_BELOW_RAIN_THOLD_122_Rx_oRDR_FUSION_DET_121_124_oPCAN_RADAR_3551a35f_Rx: ComBitPosition=151, ComBitSize=1, ComSignalType=BOOLEAN, ComSystemTemplateSystemSignalRef=DET_BELOW_RAIN_THOLD_122_Rx
            DET_BELOW_RAIN_THOLD_123_Rx_oRDR_FUSION_DET_121_124_oPCAN_RADAR_9a153118_Rx: ComBitPosition=263, ComBitSize=1, ComSignalType=BOOLEAN, ComSystemTemplateSystemSignalRef=DET_BELOW_RAIN_THOLD_123_Rx
            DET_BELOW_RAIN_THOLD_124_Rx_oRDR_FUSION_DET_121_124_oPCAN_RADAR_6028c24f_Rx: ComBitPosition=375, ComBitSize=1, ComSignalType=BOOLEAN, ComSystemTemplateSystemSignalRef=DET_BELOW_RAIN_THOLD_124_Rx
            DET_BI_STATIC_FLAG_121_Rx_oRDR_FUSION_DET_121_124_oPCAN_RADAR_6873b8c4_Rx: ComBitPosition=104, ComBitSize=1, ComSignalType=BOOLEAN, ComSystemTemplateSystemSignalRef=DET_BI_STATIC_FLAG_121_Rx
            DET_BI_STATIC_FLAG_122_Rx_oRDR_FUSION_DET_121_124_oPCAN_RADAR_42cf084c_Rx: ComBitPosition=216, ComBitSize=1, ComSignalType=BOOLEAN, ComSystemTemplateSystemSignalRef=DET_BI_STATIC_FLAG_122_Rx
            DET_BI_STATIC_FLAG_123_Rx_oRDR_FUSION_DET_121_124_oPCAN_RADAR_ed8b9a0b_Rx: ComBitPosition=328, ComBitSize=1, ComSignalType=BOOLEAN, ComSystemTemplateSystemSignalRef=DET_BI_STATIC_FLAG_123_Rx
            DET_BI_STATIC_FLAG_124_Rx_oRDR_FUSION_DET_121_124_oPCAN_RADAR_17b6695c_Rx: ComBitPosition=440, ComBitSize=1, ComSignalType=BOOLEAN, ComSystemTemplateSystemSignalRef=DET_BI_STATIC_FLAG_124_Rx
            DET_CONFD_AZIMUTH_121_Rx_oRDR_FUSION_DET_121_124_oPCAN_RADAR_8b1a5290_Rx: ComBitPosition=118, ComBitSize=2, ComSignalType=UINT8, ComSystemTemplateSystemSignalRef=DET_CONFD_AZIMUTH_121_Rx
            DET_CONFD_AZIMUTH_122_Rx_oRDR_FUSION_DET_121_124_oPCAN_RADAR_a1a6e218_Rx: ComBitPosition=230, ComBitSize=2, ComSignalType=UINT8, ComSystemTemplateSystemSignalRef=DET_CONFD_AZIMUTH_122_Rx
            DET_CONFD_AZIMUTH_123_Rx_oRDR_FUSION_DET_121_124_oPCAN_RADAR_0ee2705f_Rx: ComBitPosition=342, ComBitSize=2, ComSignalType=UINT8, ComSystemTemplateSystemSignalRef=DET_CONFD_AZIMUTH_123_Rx
            DET_CONFD_AZIMUTH_124_Rx_oRDR_FUSION_DET_121_124_oPCAN_RADAR_f4df8308_Rx: ComBitPosition=454, ComBitSize=2, ComSignalType=UINT8, ComSystemTemplateSystemSignalRef=DET_CONFD_AZIMUTH_124_Rx
            DET_CONFD_ELEVATION_121_Rx_oRDR_FUSION_DET_121_124_oPCAN_RADAR_813bd117_Rx: ComBitPosition=101, ComBitSize=2, ComSignalType=UINT8, ComSystemTemplateSystemSignalRef=DET_CONFD_ELEVATION_121_Rx
            DET_CONFD_ELEVATION_122_Rx_oRDR_FUSION_DET_121_124_oPCAN_RADAR_ab87619f_Rx: ComBitPosition=213, ComBitSize=2, ComSignalType=UINT8, ComSystemTemplateSystemSignalRef=DET_CONFD_ELEVATION_122_Rx
            DET_CONFD_ELEVATION_123_Rx_oRDR_FUSION_DET_121_124_oPCAN_RADAR_04c3f3d8_Rx: ComBitPosition=325, ComBitSize=2, ComSignalType=UINT8, ComSystemTemplateSystemSignalRef=DET_CONFD_ELEVATION_123_Rx
            DET_CONFD_ELEVATION_124_Rx_oRDR_FUSION_DET_121_124_oPCAN_RADAR_fefe008f_Rx: ComBitPosition=437, ComBitSize=2, ComSignalType=UINT8, ComSystemTemplateSystemSignalRef=DET_CONFD_ELEVATION_124_Rx
            DET_ELEVATION_121_Rx_oRDR_FUSION_DET_121_124_oPCAN_RADAR_8b683eee_Rx: ComBitPosition=72, ComBitSize=8, ComSignalType=UINT8, ComSystemTemplateSystemSignalRef=DET_ELEVATION_121_Rx
            DET_ELEVATION_122_Rx_oRDR_FUSION_DET_121_124_oPCAN_RADAR_a1d48e66_Rx: ComBitPosition=184, ComBitSize=8, ComSignalType=UINT8, ComSystemTemplateSystemSignalRef=DET_ELEVATION_122_Rx
            DET_ELEVATION_123_Rx_oRDR_FUSION_DET_121_124_oPCAN_RADAR_0e901c21_Rx: ComBitPosition=296, ComBitSize=8, ComSignalType=UINT8, ComSystemTemplateSystemSignalRef=DET_ELEVATION_123_Rx
            DET_ELEVATION_124_Rx_oRDR_FUSION_DET_121_124_oPCAN_RADAR_f4adef76_Rx: ComBitPosition=408, ComBitSize=8, ComSignalType=UINT8, ComSystemTemplateSystemSignalRef=DET_ELEVATION_124_Rx
            DET_ELEVATION_ERR_121_Rx_oRDR_FUSION_DET_121_124_oPCAN_RADAR_59d11c31_Rx: ComBitPosition=80, ComBitSize=6, ComSignalType=UINT8, ComSystemTemplateSystemSignalRef=DET_ELEVATION_ERR_121_Rx
            DET_ELEVATION_ERR_122_Rx_oRDR_FUSION_DET_121_124_oPCAN_RADAR_736dacb9_Rx: ComBitPosition=192, ComBitSize=6, ComSignalType=UINT8, ComSystemTemplateSystemSignalRef=DET_ELEVATION_ERR_122_Rx
            DET_ELEVATION_ERR_123_Rx_oRDR_FUSION_DET_121_124_oPCAN_RADAR_dc293efe_Rx: ComBitPosition=304, ComBitSize=6, ComSignalType=UINT8, ComSystemTemplateSystemSignalRef=DET_ELEVATION_ERR_123_Rx
            DET_ELEVATION_ERR_124_Rx_oRDR_FUSION_DET_121_124_oPCAN_RADAR_2614cda9_Rx: ComBitPosition=416, ComBitSize=6, ComSignalType=UINT8, ComSystemTemplateSystemSignalRef=DET_ELEVATION_ERR_124_Rx
            DET_EXISTENCE_PROB_121_Rx_oRDR_FUSION_DET_121_124_oPCAN_RADAR_aec964a4_Rx: ComBitPosition=112, ComBitSize=6, ComSignalType=UINT8, ComSystemTemplateSystemSignalRef=DET_EXISTENCE_PROB_121_Rx
            DET_EXISTENCE_PROB_122_Rx_oRDR_FUSION_DET_121_124_oPCAN_RADAR_8475d42c_Rx: ComBitPosition=224, ComBitSize=6, ComSignalType=UINT8, ComSystemTemplateSystemSignalRef=DET_EXISTENCE_PROB_122_Rx
            DET_EXISTENCE_PROB_123_Rx_oRDR_FUSION_DET_121_124_oPCAN_RADAR_2b31466b_Rx: ComBitPosition=336, ComBitSize=6, ComSignalType=UINT8, ComSystemTemplateSystemSignalRef=DET_EXISTENCE_PROB_123_Rx
            DET_EXISTENCE_PROB_124_Rx_oRDR_FUSION_DET_121_124_oPCAN_RADAR_d10cb53c_Rx: ComBitPosition=448, ComBitSize=6, ComSignalType=UINT8, ComSystemTemplateSystemSignalRef=DET_EXISTENCE_PROB_124_Rx
            DET_HVC_FLAG_121_Rx_oRDR_FUSION_DET_121_124_oPCAN_RADAR_731789eb_Rx: ComBitPosition=86, ComBitSize=1, ComSignalType=BOOLEAN, ComSystemTemplateSystemSignalRef=DET_HVC_FLAG_121_Rx
            DET_HVC_FLAG_122_Rx_oRDR_FUSION_DET_121_124_oPCAN_RADAR_59ab3963_Rx: ComBitPosition=198, ComBitSize=1, ComSignalType=BOOLEAN, ComSystemTemplateSystemSignalRef=DET_HVC_FLAG_122_Rx
            DET_HVC_FLAG_123_Rx_oRDR_FUSION_DET_121_124_oPCAN_RADAR_f6efab24_Rx: ComBitPosition=310, ComBitSize=1, ComSignalType=BOOLEAN, ComSystemTemplateSystemSignalRef=DET_HVC_FLAG_123_Rx
            DET_HVC_FLAG_124_Rx_oRDR_FUSION_DET_121_124_oPCAN_RADAR_0cd25873_Rx: ComBitPosition=422, ComBitSize=1, ComSignalType=BOOLEAN, ComSystemTemplateSystemSignalRef=DET_HVC_FLAG_124_Rx
            DET_IDM_121_Rx_oRDR_FUSION_DET_121_124_oPCAN_RADAR_46d670a3_Rx: ComBitPosition=63, ComBitSize=1, ComSignalType=BOOLEAN, ComSystemTemplateSystemSignalRef=DET_IDM_121_Rx
            DET_IDM_122_Rx_oRDR_FUSION_DET_121_124_oPCAN_RADAR_6c6ac02b_Rx: ComBitPosition=175, ComBitSize=1, ComSignalType=BOOLEAN, ComSystemTemplateSystemSignalRef=DET_IDM_122_Rx
            DET_IDM_123_Rx_oRDR_FUSION_DET_121_124_oPCAN_RADAR_c32e526c_Rx: ComBitPosition=287, ComBitSize=1, ComSignalType=BOOLEAN, ComSystemTemplateSystemSignalRef=DET_IDM_123_Rx
            DET_IDM_124_Rx_oRDR_FUSION_DET_121_124_oPCAN_RADAR_3913a13b_Rx: ComBitPosition=399, ComBitSize=1, ComSignalType=BOOLEAN, ComSystemTemplateSystemSignalRef=DET_IDM_124_Rx
            DET_MH_CRC16_121_124_Rx_oRDR_FUSION_DET_121_124_oPCAN_RADAR_bca04db8_Rx: ComBitPosition=0, ComBitSize=16, ComSignalType=UINT16, ComSystemTemplateSystemSignalRef=DET_MH_CRC16_121_124_Rx
            DET_MH_CYCLE_COUNTER_121_124_Rx_oRDR_FUSION_DET_121_124_oPCAN_RADAR_b17b707d_Rx: ComBitPosition=16, ComBitSize=8, ComSignalType=UINT8, ComSystemTemplateSystemSignalRef=DET_MH_CYCLE_COUNTER_121_124_Rx
            DET_MH_SCAN_INDEX_4LSB_121_124_Rx_oRDR_FUSION_DET_121_124_oPCAN_RADAR_d5cbbf46_Rx: ComBitPosition=476, ComBitSize=4, ComSignalType=UINT8, ComSystemTemplateSystemSignalRef=DET_MH_SCAN_INDEX_4LSB_121_124_Rx
            DET_MTD_121_Rx_oRDR_FUSION_DET_121_124_oPCAN_RADAR_fb5546d3_Rx: ComBitPosition=47, ComBitSize=1, ComSignalType=BOOLEAN, ComSystemTemplateSystemSignalRef=DET_MTD_121_Rx
            DET_MTD_122_Rx_oRDR_FUSION_DET_121_124_oPCAN_RADAR_d1e9f65b_Rx: ComBitPosition=159, ComBitSize=1, ComSignalType=BOOLEAN, ComSystemTemplateSystemSignalRef=DET_MTD_122_Rx
            DET_MTD_123_Rx_oRDR_FUSION_DET_121_124_oPCAN_RADAR_7ead641c_Rx: ComBitPosition=271, ComBitSize=1, ComSignalType=BOOLEAN, ComSystemTemplateSystemSignalRef=DET_MTD_123_Rx
            DET_MTD_124_Rx_oRDR_FUSION_DET_121_124_oPCAN_RADAR_8490974b_Rx: ComBitPosition=383, ComBitSize=1, ComSignalType=BOOLEAN, ComSystemTemplateSystemSignalRef=DET_MTD_124_Rx
            DET_PROB_1STAZHYPO_121_Rx_oRDR_FUSION_DET_121_124_oPCAN_RADAR_312c5852_Rx: ComBitPosition=103, ComBitSize=1, ComSignalType=BOOLEAN, ComSystemTemplateSystemSignalRef=DET_PROB_1STAZHYPO_121_Rx
            DET_PROB_1STAZHYPO_122_Rx_oRDR_FUSION_DET_121_124_oPCAN_RADAR_1b90e8da_Rx: ComBitPosition=215, ComBitSize=1, ComSignalType=BOOLEAN, ComSystemTemplateSystemSignalRef=DET_PROB_1STAZHYPO_122_Rx
            DET_PROB_1STAZHYPO_123_Rx_oRDR_FUSION_DET_121_124_oPCAN_RADAR_b4d47a9d_Rx: ComBitPosition=327, ComBitSize=1, ComSignalType=BOOLEAN, ComSystemTemplateSystemSignalRef=DET_PROB_1STAZHYPO_123_Rx
            DET_PROB_1STAZHYPO_124_Rx_oRDR_FUSION_DET_121_124_oPCAN_RADAR_4ee989ca_Rx: ComBitPosition=439, ComBitSize=1, ComSignalType=BOOLEAN, ComSystemTemplateSystemSignalRef=DET_PROB_1STAZHYPO_124_Rx
            DET_RANGE_121_Rx_oRDR_FUSION_DET_121_124_oPCAN_RADAR_6a91b045_Rx: ComBitPosition=24, ComBitSize=15, ComSignalType=UINT16, ComSystemTemplateSystemSignalRef=DET_RANGE_121_Rx
            DET_RANGE_122_Rx_oRDR_FUSION_DET_121_124_oPCAN_RADAR_402d00cd_Rx: ComBitPosition=136, ComBitSize=15, ComSignalType=UINT16, ComSystemTemplateSystemSignalRef=DET_RANGE_122_Rx
            DET_RANGE_123_Rx_oRDR_FUSION_DET_121_124_oPCAN_RADAR_ef69928a_Rx: ComBitPosition=248, ComBitSize=15, ComSignalType=UINT16, ComSystemTemplateSystemSignalRef=DET_RANGE_123_Rx
            DET_RANGE_124_Rx_oRDR_FUSION_DET_121_124_oPCAN_RADAR_155461dd_Rx: ComBitPosition=360, ComBitSize=15, ComSignalType=UINT16, ComSystemTemplateSystemSignalRef=DET_RANGE_124_Rx
            DET_RANGE_ERR_121_Rx_oRDR_FUSION_DET_121_124_oPCAN_RADAR_3a633ca5_Rx: ComBitPosition=40, ComBitSize=7, ComSignalType=UINT8, ComSystemTemplateSystemSignalRef=DET_RANGE_ERR_121_Rx
            DET_RANGE_ERR_122_Rx_oRDR_FUSION_DET_121_124_oPCAN_RADAR_10df8c2d_Rx: ComBitPosition=152, ComBitSize=7, ComSignalType=UINT8, ComSystemTemplateSystemSignalRef=DET_RANGE_ERR_122_Rx
            DET_RANGE_ERR_123_Rx_oRDR_FUSION_DET_121_124_oPCAN_RADAR_bf9b1e6a_Rx: ComBitPosition=264, ComBitSize=7, ComSignalType=UINT8, ComSystemTemplateSystemSignalRef=DET_RANGE_ERR_123_Rx
            DET_RANGE_ERR_124_Rx_oRDR_FUSION_DET_121_124_oPCAN_RADAR_45a6ed3d_Rx: ComBitPosition=376, ComBitSize=7, ComSignalType=UINT8, ComSystemTemplateSystemSignalRef=DET_RANGE_ERR_124_Rx
            DET_RANGE_VELOCITY_121_Rx_oRDR_FUSION_DET_121_124_oPCAN_RADAR_b76433bb_Rx: ComBitPosition=48, ComBitSize=15, ComSignalType=UINT16, ComSystemTemplateSystemSignalRef=DET_RANGE_VELOCITY_121_Rx
            DET_RANGE_VELOCITY_122_Rx_oRDR_FUSION_DET_121_124_oPCAN_RADAR_9dd88333_Rx: ComBitPosition=160, ComBitSize=15, ComSignalType=UINT16, ComSystemTemplateSystemSignalRef=DET_RANGE_VELOCITY_122_Rx
            DET_RANGE_VELOCITY_123_Rx_oRDR_FUSION_DET_121_124_oPCAN_RADAR_329c1174_Rx: ComBitPosition=272, ComBitSize=15, ComSignalType=UINT16, ComSystemTemplateSystemSignalRef=DET_RANGE_VELOCITY_123_Rx
            DET_RANGE_VELOCITY_124_Rx_oRDR_FUSION_DET_121_124_oPCAN_RADAR_c8a1e223_Rx: ComBitPosition=384, ComBitSize=15, ComSignalType=UINT16, ComSystemTemplateSystemSignalRef=DET_RANGE_VELOCITY_124_Rx
            DET_RANGE_VELOCITY_ERR_121_Rx_oRDR_FUSION_DET_121_124_oPCAN_RADAR_2e004379_Rx: ComBitPosition=64, ComBitSize=8, ComSignalType=UINT8, ComSystemTemplateSystemSignalRef=DET_RANGE_VELOCITY_ERR_121_Rx
            DET_RANGE_VELOCITY_ERR_122_Rx_oRDR_FUSION_DET_121_124_oPCAN_RADAR_04bcf3f1_Rx: ComBitPosition=176, ComBitSize=8, ComSignalType=UINT8, ComSystemTemplateSystemSignalRef=DET_RANGE_VELOCITY_ERR_122_Rx
            DET_RANGE_VELOCITY_ERR_123_Rx_oRDR_FUSION_DET_121_124_oPCAN_RADAR_abf861b6_Rx: ComBitPosition=288, ComBitSize=8, ComSignalType=UINT8, ComSystemTemplateSystemSignalRef=DET_RANGE_VELOCITY_ERR_123_Rx
            DET_RANGE_VELOCITY_ERR_124_Rx_oRDR_FUSION_DET_121_124_oPCAN_RADAR_51c592e1_Rx: ComBitPosition=400, ComBitSize=8, ComSignalType=UINT8, ComSystemTemplateSystemSignalRef=DET_RANGE_VELOCITY_ERR_124_Rx
            DET_RCS_121_Rx_oRDR_FUSION_DET_121_124_oPCAN_RADAR_7aafa1a0_Rx: ComBitPosition=128, ComBitSize=8, ComSignalType=UINT8, ComSystemTemplateSystemSignalRef=DET_RCS_121_Rx
            DET_RCS_122_Rx_oRDR_FUSION_DET_121_124_oPCAN_RADAR_50131128_Rx: ComBitPosition=240, ComBitSize=8, ComSignalType=UINT8, ComSystemTemplateSystemSignalRef=DET_RCS_122_Rx
            DET_RCS_123_Rx_oRDR_FUSION_DET_121_124_oPCAN_RADAR_ff57836f_Rx: ComBitPosition=352, ComBitSize=8, ComSignalType=UINT8, ComSystemTemplateSystemSignalRef=DET_RCS_123_Rx
            DET_RCS_124_Rx_oRDR_FUSION_DET_121_124_oPCAN_RADAR_056a7038_Rx: ComBitPosition=464, ComBitSize=8, ComSignalType=UINT8, ComSystemTemplateSystemSignalRef=DET_RCS_124_Rx
            DET_SNR_121_Rx_oRDR_FUSION_DET_121_124_oPCAN_RADAR_73f5d049_Rx: ComBitPosition=120, ComBitSize=8, ComSignalType=UINT8, ComSystemTemplateSystemSignalRef=DET_SNR_121_Rx
            DET_SNR_122_Rx_oRDR_FUSION_DET_121_124_oPCAN_RADAR_594960c1_Rx: ComBitPosition=232, ComBitSize=8, ComSignalType=UINT8, ComSystemTemplateSystemSignalRef=DET_SNR_122_Rx
            DET_SNR_123_Rx_oRDR_FUSION_DET_121_124_oPCAN_RADAR_f60df286_Rx: ComBitPosition=344, ComBitSize=8, ComSignalType=UINT8, ComSystemTemplateSystemSignalRef=DET_SNR_123_Rx
            DET_SNR_124_Rx_oRDR_FUSION_DET_121_124_oPCAN_RADAR_0c3001d1_Rx: ComBitPosition=456, ComBitSize=8, ComSignalType=UINT8, ComSystemTemplateSystemSignalRef=DET_SNR_124_Rx
            DET_SUPER_RES_TARGET_121_Rx_oRDR_FUSION_DET_121_124_oPCAN_RADAR_b80ef149_Rx: ComBitPosition=87, ComBitSize=1, ComSignalType=BOOLEAN, ComSystemTemplateSystemSignalRef=DET_SUPER_RES_TARGET_121_Rx
            DET_SUPER_RES_TARGET_122_Rx_oRDR_FUSION_DET_121_124_oPCAN_RADAR_92b241c1_Rx: ComBitPosition=199, ComBitSize=1, ComSignalType=BOOLEAN, ComSystemTemplateSystemSignalRef=DET_SUPER_RES_TARGET_122_Rx
            DET_SUPER_RES_TARGET_123_Rx_oRDR_FUSION_DET_121_124_oPCAN_RADAR_3df6d386_Rx: ComBitPosition=311, ComBitSize=1, ComSignalType=BOOLEAN, ComSystemTemplateSystemSignalRef=DET_SUPER_RES_TARGET_123_Rx
            DET_SUPER_RES_TARGET_124_Rx_oRDR_FUSION_DET_121_124_oPCAN_RADAR_c7cb20d1_Rx: ComBitPosition=423, ComBitSize=1, ComSignalType=BOOLEAN, ComSystemTemplateSystemSignalRef=DET_SUPER_RES_TARGET_124_Rx
        SG_Fusion_Detections_125_128_oRDR_FUSION_DET_125_128_oPCAN_RADAR_ddd85db8_Rx: ComTimeout=0, ComSystemTemplateSignalGroupRef=SG_Fusion_Detections_125_128
          83 x ComGroupSignal, all with ComSignalEndianness=LITTLE_ENDIAN, ComSignalInitValue=0:
            DET_AZIMUTH_125_Rx_oRDR_FUSION_DET_125_128_oPCAN_RADAR_40643189_Rx: ComBitPosition=88, ComBitSize=13, ComSignalType=UINT16, ComSystemTemplateSystemSignalRef=DET_AZIMUTH_125_Rx
            DET_AZIMUTH_126_Rx_oRDR_FUSION_DET_125_128_oPCAN_RADAR_6ad88101_Rx: ComBitPosition=200, ComBitSize=13, ComSignalType=UINT16, ComSystemTemplateSystemSignalRef=DET_AZIMUTH_126_Rx
            DET_AZIMUTH_127_Rx_oRDR_FUSION_DET_125_128_oPCAN_RADAR_c59c1346_Rx: ComBitPosition=312, ComBitSize=13, ComSignalType=UINT16, ComSystemTemplateSystemSignalRef=DET_AZIMUTH_127_Rx
            DET_AZIMUTH_128_Rx_oRDR_FUSION_DET_125_128_oPCAN_RADAR_45d261ee_Rx: ComBitPosition=424, ComBitSize=13, ComSignalType=UINT16, ComSystemTemplateSystemSignalRef=DET_AZIMUTH_128_Rx
            DET_AZIMUTH_ERR_125_Rx_oRDR_FUSION_DET_125_128_oPCAN_RADAR_420d900b_Rx: ComBitPosition=105, ComBitSize=7, ComSignalType=UINT8, ComSystemTemplateSystemSignalRef=DET_AZIMUTH_ERR_125_Rx
            DET_AZIMUTH_ERR_126_Rx_oRDR_FUSION_DET_125_128_oPCAN_RADAR_68b12083_Rx: ComBitPosition=217, ComBitSize=7, ComSignalType=UINT8, ComSystemTemplateSystemSignalRef=DET_AZIMUTH_ERR_126_Rx
            DET_AZIMUTH_ERR_127_Rx_oRDR_FUSION_DET_125_128_oPCAN_RADAR_c7f5b2c4_Rx: ComBitPosition=329, ComBitSize=7, ComSignalType=UINT8, ComSystemTemplateSystemSignalRef=DET_AZIMUTH_ERR_127_Rx
            DET_AZIMUTH_ERR_128_Rx_oRDR_FUSION_DET_125_128_oPCAN_RADAR_47bbc06c_Rx: ComBitPosition=441, ComBitSize=7, ComSignalType=UINT8, ComSystemTemplateSystemSignalRef=DET_AZIMUTH_ERR_128_Rx
            DET_BELOW_RAIN_THOLD_125_Rx_oRDR_FUSION_DET_125_128_oPCAN_RADAR_26dece3c_Rx: ComBitPosition=39, ComBitSize=1, ComSignalType=BOOLEAN, ComSystemTemplateSystemSignalRef=DET_BELOW_RAIN_THOLD_125_Rx
            DET_BELOW_RAIN_THOLD_126_Rx_oRDR_FUSION_DET_125_128_oPCAN_RADAR_0c627eb4_Rx: ComBitPosition=151, ComBitSize=1, ComSignalType=BOOLEAN, ComSystemTemplateSystemSignalRef=DET_BELOW_RAIN_THOLD_126_Rx
            DET_BELOW_RAIN_THOLD_127_Rx_oRDR_FUSION_DET_125_128_oPCAN_RADAR_a326ecf3_Rx: ComBitPosition=263, ComBitSize=1, ComSignalType=BOOLEAN, ComSystemTemplateSystemSignalRef=DET_BELOW_RAIN_THOLD_127_Rx
            DET_BELOW_RAIN_THOLD_128_Rx_oRDR_FUSION_DET_125_128_oPCAN_RADAR_23689e5b_Rx: ComBitPosition=375, ComBitSize=1, ComSignalType=BOOLEAN, ComSystemTemplateSystemSignalRef=DET_BELOW_RAIN_THOLD_128_Rx
            DET_BI_STATIC_FLAG_125_Rx_oRDR_FUSION_DET_125_128_oPCAN_RADAR_5140652f_Rx: ComBitPosition=104, ComBitSize=1, ComSignalType=BOOLEAN, ComSystemTemplateSystemSignalRef=DET_BI_STATIC_FLAG_125_Rx
            DET_BI_STATIC_FLAG_126_Rx_oRDR_FUSION_DET_125_128_oPCAN_RADAR_7bfcd5a7_Rx: ComBitPosition=216, ComBitSize=1, ComSignalType=BOOLEAN, ComSystemTemplateSystemSignalRef=DET_BI_STATIC_FLAG_126_Rx
            DET_BI_STATIC_FLAG_127_Rx_oRDR_FUSION_DET_125_128_oPCAN_RADAR_d4b847e0_Rx: ComBitPosition=328, ComBitSize=1, ComSignalType=BOOLEAN, ComSystemTemplateSystemSignalRef=DET_BI_STATIC_FLAG_127_Rx
            DET_BI_STATIC_FLAG_128_Rx_oRDR_FUSION_DET_125_128_oPCAN_RADAR_54f63548_Rx: ComBitPosition=440, ComBitSize=1, ComSignalType=BOOLEAN, ComSystemTemplateSystemSignalRef=DET_BI_STATIC_FLAG_128_Rx
            DET_CONFD_AZIMUTH_125_Rx_oRDR_FUSION_DET_125_128_oPCAN_RADAR_b2298f7b_Rx: ComBitPosition=118, ComBitSize=2, ComSignalType=UINT8, ComSystemTemplateSystemSignalRef=DET_CONFD_AZIMUTH_125_Rx
            DET_CONFD_AZIMUTH_126_Rx_oRDR_FUSION_DET_125_128_oPCAN_RADAR_98953ff3_Rx: ComBitPosition=230, ComBitSize=2, ComSignalType=UINT8, ComSystemTemplateSystemSignalRef=DET_CONFD_AZIMUTH_126_Rx
            DET_CONFD_AZIMUTH_127_Rx_oRDR_FUSION_DET_125_128_oPCAN_RADAR_37d1adb4_Rx: ComBitPosition=342, ComBitSize=2, ComSignalType=UINT8, ComSystemTemplateSystemSignalRef=DET_CONFD_AZIMUTH_127_Rx
            DET_CONFD_AZIMUTH_128_Rx_oRDR_FUSION_DET_125_128_oPCAN_RADAR_b79fdf1c_Rx: ComBitPosition=454, ComBitSize=2, ComSignalType=UINT8, ComSystemTemplateSystemSignalRef=DET_CONFD_AZIMUTH_128_Rx
            DET_CONFD_ELEVATION_125_Rx_oRDR_FUSION_DET_125_128_oPCAN_RADAR_b8080cfc_Rx: ComBitPosition=101, ComBitSize=2, ComSignalType=UINT8, ComSystemTemplateSystemSignalRef=DET_CONFD_ELEVATION_125_Rx
            DET_CONFD_ELEVATION_126_Rx_oRDR_FUSION_DET_125_128_oPCAN_RADAR_92b4bc74_Rx: ComBitPosition=213, ComBitSize=2, ComSignalType=UINT8, ComSystemTemplateSystemSignalRef=DET_CONFD_ELEVATION_126_Rx
            DET_CONFD_ELEVATION_127_Rx_oRDR_FUSION_DET_125_128_oPCAN_RADAR_3df02e33_Rx: ComBitPosition=325, ComBitSize=2, ComSignalType=UINT8, ComSystemTemplateSystemSignalRef=DET_CONFD_ELEVATION_127_Rx
            DET_CONFD_ELEVATION_128_Rx_oRDR_FUSION_DET_125_128_oPCAN_RADAR_bdbe5c9b_Rx: ComBitPosition=437, ComBitSize=2, ComSignalType=UINT8, ComSystemTemplateSystemSignalRef=DET_CONFD_ELEVATION_128_Rx
            DET_ELEVATION_125_Rx_oRDR_FUSION_DET_125_128_oPCAN_RADAR_b25be305_Rx: ComBitPosition=72, ComBitSize=8, ComSignalType=UINT8, ComSystemTemplateSystemSignalRef=DET_ELEVATION_125_Rx
            DET_ELEVATION_126_Rx_oRDR_FUSION_DET_125_128_oPCAN_RADAR_98e7538d_Rx: ComBitPosition=184, ComBitSize=8, ComSignalType=UINT8, ComSystemTemplateSystemSignalRef=DET_ELEVATION_126_Rx
            DET_ELEVATION_127_Rx_oRDR_FUSION_DET_125_128_oPCAN_RADAR_37a3c1ca_Rx: ComBitPosition=296, ComBitSize=8, ComSignalType=UINT8, ComSystemTemplateSystemSignalRef=DET_ELEVATION_127_Rx
            DET_ELEVATION_128_Rx_oRDR_FUSION_DET_125_128_oPCAN_RADAR_b7edb362_Rx: ComBitPosition=408, ComBitSize=8, ComSignalType=UINT8, ComSystemTemplateSystemSignalRef=DET_ELEVATION_128_Rx
            DET_ELEVATION_ERR_125_Rx_oRDR_FUSION_DET_125_128_oPCAN_RADAR_60e2c1da_Rx: ComBitPosition=80, ComBitSize=6, ComSignalType=UINT8, ComSystemTemplateSystemSignalRef=DET_ELEVATION_ERR_125_Rx
            DET_ELEVATION_ERR_126_Rx_oRDR_FUSION_DET_125_128_oPCAN_RADAR_4a5e7152_Rx: ComBitPosition=192, ComBitSize=6, ComSignalType=UINT8, ComSystemTemplateSystemSignalRef=DET_ELEVATION_ERR_126_Rx
            DET_ELEVATION_ERR_127_Rx_oRDR_FUSION_DET_125_128_oPCAN_RADAR_e51ae315_Rx: ComBitPosition=304, ComBitSize=6, ComSignalType=UINT8, ComSystemTemplateSystemSignalRef=DET_ELEVATION_ERR_127_Rx
            DET_ELEVATION_ERR_128_Rx_oRDR_FUSION_DET_125_128_oPCAN_RADAR_655491bd_Rx: ComBitPosition=416, ComBitSize=6, ComSignalType=UINT8, ComSystemTemplateSystemSignalRef=DET_ELEVATION_ERR_128_Rx
            DET_EXISTENCE_PROB_125_Rx_oRDR_FUSION_DET_125_128_oPCAN_RADAR_97fab94f_Rx: ComBitPosition=112, ComBitSize=6, ComSignalType=UINT8, ComSystemTemplateSystemSignalRef=DET_EXISTENCE_PROB_125_Rx
            DET_EXISTENCE_PROB_126_Rx_oRDR_FUSION_DET_125_128_oPCAN_RADAR_bd4609c7_Rx: ComBitPosition=224, ComBitSize=6, ComSignalType=UINT8, ComSystemTemplateSystemSignalRef=DET_EXISTENCE_PROB_126_Rx
            DET_EXISTENCE_PROB_127_Rx_oRDR_FUSION_DET_125_128_oPCAN_RADAR_12029b80_Rx: ComBitPosition=336, ComBitSize=6, ComSignalType=UINT8, ComSystemTemplateSystemSignalRef=DET_EXISTENCE_PROB_127_Rx
            DET_EXISTENCE_PROB_128_Rx_oRDR_FUSION_DET_125_128_oPCAN_RADAR_924ce928_Rx: ComBitPosition=448, ComBitSize=6, ComSignalType=UINT8, ComSystemTemplateSystemSignalRef=DET_EXISTENCE_PROB_128_Rx
            DET_HVC_FLAG_125_Rx_oRDR_FUSION_DET_125_128_oPCAN_RADAR_4a245400_Rx: ComBitPosition=86, ComBitSize=1, ComSignalType=BOOLEAN, ComSystemTemplateSystemSignalRef=DET_HVC_FLAG_125_Rx
            DET_HVC_FLAG_126_Rx_oRDR_FUSION_DET_125_128_oPCAN_RADAR_6098e488_Rx: ComBitPosition=198, ComBitSize=1, ComSignalType=BOOLEAN, ComSystemTemplateSystemSignalRef=DET_HVC_FLAG_126_Rx
            DET_HVC_FLAG_127_Rx_oRDR_FUSION_DET_125_128_oPCAN_RADAR_cfdc76cf_Rx: ComBitPosition=310, ComBitSize=1, ComSignalType=BOOLEAN, ComSystemTemplateSystemSignalRef=DET_HVC_FLAG_127_Rx
            DET_HVC_FLAG_128_Rx_oRDR_FUSION_DET_125_128_oPCAN_RADAR_4f920467_Rx: ComBitPosition=422, ComBitSize=1, ComSignalType=BOOLEAN, ComSystemTemplateSystemSignalRef=DET_HVC_FLAG_128_Rx
            DET_IDM_125_Rx_oRDR_FUSION_DET_125_128_oPCAN_RADAR_7fe5ad48_Rx: ComBitPosition=63, ComBitSize=1, ComSignalType=BOOLEAN, ComSystemTemplateSystemSignalRef=DET_IDM_125_Rx
            DET_IDM_126_Rx_oRDR_FUSION_DET_125_128_oPCAN_RADAR_55591dc0_Rx: ComBitPosition=175, ComBitSize=1, ComSignalType=BOOLEAN, ComSystemTemplateSystemSignalRef=DET_IDM_126_Rx
            DET_IDM_127_Rx_oRDR_FUSION_DET_125_128_oPCAN_RADAR_fa1d8f87_Rx: ComBitPosition=287, ComBitSize=1, ComSignalType=BOOLEAN, ComSystemTemplateSystemSignalRef=DET_IDM_127_Rx
            DET_IDM_128_Rx_oRDR_FUSION_DET_125_128_oPCAN_RADAR_7a53fd2f_Rx: ComBitPosition=399, ComBitSize=1, ComSignalType=BOOLEAN, ComSystemTemplateSystemSignalRef=DET_IDM_128_Rx
            DET_MH_CRC16_125_128_Rx_oRDR_FUSION_DET_125_128_oPCAN_RADAR_5740f024_Rx: ComBitPosition=0, ComBitSize=16, ComSignalType=UINT16, ComSystemTemplateSystemSignalRef=DET_MH_CRC16_125_128_Rx
            DET_MH_CYCLE_COUNTER_125_128_Rx_oRDR_FUSION_DET_125_128_oPCAN_RADAR_5a9bcde1_Rx: ComBitPosition=16, ComBitSize=8, ComSignalType=UINT8, ComSystemTemplateSystemSignalRef=DET_MH_CYCLE_COUNTER_125_128_Rx
            DET_MH_SCAN_INDEX_4LSB_125_128_Rx_oRDR_FUSION_DET_125_128_oPCAN_RADAR_3e2b02da_Rx: ComBitPosition=476, ComBitSize=4, ComSignalType=UINT8, ComSystemTemplateSystemSignalRef=DET_MH_SCAN_INDEX_4LSB_125_128_Rx
            DET_MTD_125_Rx_oRDR_FUSION_DET_125_128_oPCAN_RADAR_c2669b38_Rx: ComBitPosition=47, ComBitSize=1, ComSignalType=BOOLEAN, ComSystemTemplateSystemSignalRef=DET_MTD_125_Rx
            DET_MTD_126_Rx_oRDR_FUSION_DET_125_128_oPCAN_RADAR_e8da2bb0_Rx: ComBitPosition=159, ComBitSize=1, ComSignalType=BOOLEAN, ComSystemTemplateSystemSignalRef=DET_MTD_126_Rx
            DET_MTD_127_Rx_oRDR_FUSION_DET_125_128_oPCAN_RADAR_479eb9f7_Rx: ComBitPosition=271, ComBitSize=1, ComSignalType=BOOLEAN, ComSystemTemplateSystemSignalRef=DET_MTD_127_Rx
            DET_MTD_128_Rx_oRDR_FUSION_DET_125_128_oPCAN_RADAR_c7d0cb5f_Rx: ComBitPosition=383, ComBitSize=1, ComSignalType=BOOLEAN, ComSystemTemplateSystemSignalRef=DET_MTD_128_Rx
            DET_PROB_1STAZHYPO_125_Rx_oRDR_FUSION_DET_125_128_oPCAN_RADAR_081f85b9_Rx: ComBitPosition=103, ComBitSize=1, ComSignalType=BOOLEAN, ComSystemTemplateSystemSignalRef=DET_PROB_1STAZHYPO_125_Rx
            DET_PROB_1STAZHYPO_126_Rx_oRDR_FUSION_DET_125_128_oPCAN_RADAR_22a33531_Rx: ComBitPosition=215, ComBitSize=1, ComSignalType=BOOLEAN, ComSystemTemplateSystemSignalRef=DET_PROB_1STAZHYPO_126_Rx
            DET_PROB_1STAZHYPO_127_Rx_oRDR_FUSION_DET_125_128_oPCAN_RADAR_8de7a776_Rx: ComBitPosition=327, ComBitSize=1, ComSignalType=BOOLEAN, ComSystemTemplateSystemSignalRef=DET_PROB_1STAZHYPO_127_Rx
            DET_PROB_1STAZHYPO_128_Rx_oRDR_FUSION_DET_125_128_oPCAN_RADAR_0da9d5de_Rx: ComBitPosition=439, ComBitSize=1, ComSignalType=BOOLEAN, ComSystemTemplateSystemSignalRef=DET_PROB_1STAZHYPO_128_Rx
            DET_RANGE_125_Rx_oRDR_FUSION_DET_125_128_oPCAN_RADAR_53a26dae_Rx: ComBitPosition=24, ComBitSize=15, ComSignalType=UINT16, ComSystemTemplateSystemSignalRef=DET_RANGE_125_Rx
            DET_RANGE_126_Rx_oRDR_FUSION_DET_125_128_oPCAN_RADAR_791edd26_Rx: ComBitPosition=136, ComBitSize=15, ComSignalType=UINT16, ComSystemTemplateSystemSignalRef=DET_RANGE_126_Rx
            DET_RANGE_127_Rx_oRDR_FUSION_DET_125_128_oPCAN_RADAR_d65a4f61_Rx: ComBitPosition=248, ComBitSize=15, ComSignalType=UINT16, ComSystemTemplateSystemSignalRef=DET_RANGE_127_Rx
            DET_RANGE_128_Rx_oRDR_FUSION_DET_125_128_oPCAN_RADAR_56143dc9_Rx: ComBitPosition=360, ComBitSize=15, ComSignalType=UINT16, ComSystemTemplateSystemSignalRef=DET_RANGE_128_Rx
            DET_RANGE_ERR_125_Rx_oRDR_FUSION_DET_125_128_oPCAN_RADAR_0350e14e_Rx: ComBitPosition=40, ComBitSize=7, ComSignalType=UINT8, ComSystemTemplateSystemSignalRef=DET_RANGE_ERR_125_Rx
            DET_RANGE_ERR_126_Rx_oRDR_FUSION_DET_125_128_oPCAN_RADAR_29ec51c6_Rx: ComBitPosition=152, ComBitSize=7, ComSignalType=UINT8, ComSystemTemplateSystemSignalRef=DET_RANGE_ERR_126_Rx
            DET_RANGE_ERR_127_Rx_oRDR_FUSION_DET_125_128_oPCAN_RADAR_86a8c381_Rx: ComBitPosition=264, ComBitSize=7, ComSignalType=UINT8, ComSystemTemplateSystemSignalRef=DET_RANGE_ERR_127_Rx
            DET_RANGE_ERR_128_Rx_oRDR_FUSION_DET_125_128_oPCAN_RADAR_06e6b129_Rx: ComBitPosition=376, ComBitSize=7, ComSignalType=UINT8, ComSystemTemplateSystemSignalRef=DET_RANGE_ERR_128_Rx
            DET_RANGE_VELOCITY_125_Rx_oRDR_FUSION_DET_125_128_oPCAN_RADAR_8e57ee50_Rx: ComBitPosition=48, ComBitSize=15, ComSignalType=UINT16, ComSystemTemplateSystemSignalRef=DET_RANGE_VELOCITY_125_Rx
            DET_RANGE_VELOCITY_126_Rx_oRDR_FUSION_DET_125_128_oPCAN_RADAR_a4eb5ed8_Rx: ComBitPosition=160, ComBitSize=15, ComSignalType=UINT16, ComSystemTemplateSystemSignalRef=DET_RANGE_VELOCITY_126_Rx
            DET_RANGE_VELOCITY_127_Rx_oRDR_FUSION_DET_125_128_oPCAN_RADAR_0bafcc9f_Rx: ComBitPosition=272, ComBitSize=15, ComSignalType=UINT16, ComSystemTemplateSystemSignalRef=DET_RANGE_VELOCITY_127_Rx
            DET_RANGE_VELOCITY_128_Rx_oRDR_FUSION_DET_125_128_oPCAN_RADAR_8be1be37_Rx: ComBitPosition=384, ComBitSize=15, ComSignalType=UINT16, ComSystemTemplateSystemSignalRef=DET_RANGE_VELOCITY_128_Rx
            DET_RANGE_VELOCITY_ERR_125_Rx_oRDR_FUSION_DET_125_128_oPCAN_RADAR_17339e92_Rx: ComBitPosition=64, ComBitSize=8, ComSignalType=UINT8, ComSystemTemplateSystemSignalRef=DET_RANGE_VELOCITY_ERR_125_Rx
            DET_RANGE_VELOCITY_ERR_126_Rx_oRDR_FUSION_DET_125_128_oPCAN_RADAR_3d8f2e1a_Rx: ComBitPosition=176, ComBitSize=8, ComSignalType=UINT8, ComSystemTemplateSystemSignalRef=DET_RANGE_VELOCITY_ERR_126_Rx
            DET_RANGE_VELOCITY_ERR_127_Rx_oRDR_FUSION_DET_125_128_oPCAN_RADAR_92cbbc5d_Rx: ComBitPosition=288, ComBitSize=8, ComSignalType=UINT8, ComSystemTemplateSystemSignalRef=DET_RANGE_VELOCITY_ERR_127_Rx
            DET_RANGE_VELOCITY_ERR_128_Rx_oRDR_FUSION_DET_125_128_oPCAN_RADAR_1285cef5_Rx: ComBitPosition=400, ComBitSize=8, ComSignalType=UINT8, ComSystemTemplateSystemSignalRef=DET_RANGE_VELOCITY_ERR_128_Rx
            DET_RCS_125_Rx_oRDR_FUSION_DET_125_128_oPCAN_RADAR_439c7c4b_Rx: ComBitPosition=128, ComBitSize=8, ComSignalType=UINT8, ComSystemTemplateSystemSignalRef=DET_RCS_125_Rx
            DET_RCS_126_Rx_oRDR_FUSION_DET_125_128_oPCAN_RADAR_6920ccc3_Rx: ComBitPosition=240, ComBitSize=8, ComSignalType=UINT8, ComSystemTemplateSystemSignalRef=DET_RCS_126_Rx
            DET_RCS_127_Rx_oRDR_FUSION_DET_125_128_oPCAN_RADAR_c6645e84_Rx: ComBitPosition=352, ComBitSize=8, ComSignalType=UINT8, ComSystemTemplateSystemSignalRef=DET_RCS_127_Rx
            DET_RCS_128_Rx_oRDR_FUSION_DET_125_128_oPCAN_RADAR_462a2c2c_Rx: ComBitPosition=464, ComBitSize=8, ComSignalType=UINT8, ComSystemTemplateSystemSignalRef=DET_RCS_128_Rx
            DET_SNR_125_Rx_oRDR_FUSION_DET_125_128_oPCAN_RADAR_4ac60da2_Rx: ComBitPosition=120, ComBitSize=8, ComSignalType=UINT8, ComSystemTemplateSystemSignalRef=DET_SNR_125_Rx
            DET_SNR_126_Rx_oRDR_FUSION_DET_125_128_oPCAN_RADAR_607abd2a_Rx: ComBitPosition=232, ComBitSize=8, ComSignalType=UINT8, ComSystemTemplateSystemSignalRef=DET_SNR_126_Rx
            DET_SNR_127_Rx_oRDR_FUSION_DET_125_128_oPCAN_RADAR_cf3e2f6d_Rx: ComBitPosition=344, ComBitSize=8, ComSignalType=UINT8, ComSystemTemplateSystemSignalRef=DET_SNR_127_Rx
            DET_SNR_128_Rx_oRDR_FUSION_DET_125_128_oPCAN_RADAR_4f705dc5_Rx: ComBitPosition=456, ComBitSize=8, ComSignalType=UINT8, ComSystemTemplateSystemSignalRef=DET_SNR_128_Rx
            DET_SUPER_RES_TARGET_125_Rx_oRDR_FUSION_DET_125_128_oPCAN_RADAR_813d2ca2_Rx: ComBitPosition=87, ComBitSize=1, ComSignalType=BOOLEAN, ComSystemTemplateSystemSignalRef=DET_SUPER_RES_TARGET_125_Rx
            DET_SUPER_RES_TARGET_126_Rx_oRDR_FUSION_DET_125_128_oPCAN_RADAR_ab819c2a_Rx: ComBitPosition=199, ComBitSize=1, ComSignalType=BOOLEAN, ComSystemTemplateSystemSignalRef=DET_SUPER_RES_TARGET_126_Rx
            DET_SUPER_RES_TARGET_127_Rx_oRDR_FUSION_DET_125_128_oPCAN_RADAR_04c50e6d_Rx: ComBitPosition=311, ComBitSize=1, ComSignalType=BOOLEAN, ComSystemTemplateSystemSignalRef=DET_SUPER_RES_TARGET_127_Rx
            DET_SUPER_RES_TARGET_128_Rx_oRDR_FUSION_DET_125_128_oPCAN_RADAR_848b7cc5_Rx: ComBitPosition=423, ComBitSize=1, ComSignalType=BOOLEAN, ComSystemTemplateSystemSignalRef=DET_SUPER_RES_TARGET_128_Rx
        SG_Fusion_RadarCapability_oRDR_FUSION_CAPABILITY_oPCAN_RADAR_c3552fd5_Rx: ComSignalGroupArrayAccess=true, ComTimeout=0, ComSystemTemplateSignalGroupRef=SG_Fusion_RadarCapability
          31 x ComGroupSignal, all with ComSignalEndianness=LITTLE_ENDIAN, ComSignalInitValue=0:
            CAP_AngleAzimuthRangeEnd_Rx_oRDR_FUSION_CAPABILITY_oPCAN_RADAR_8071b245_Rx: ComBitPosition=99, ComBitSize=9, ComSignalType=SINT16, ComSystemTemplateSystemSignalRef=CAP_AngleAzimuthRangeEnd_Rx
            CAP_AngleAzimuthRangeStart_Rx_oRDR_FUSION_CAPABILITY_oPCAN_RADAR_b276ba71_Rx: ComBitPosition=90, ComBitSize=9, ComSignalType=SINT16, ComSystemTemplateSystemSignalRef=CAP_AngleAzimuthRangeStart_Rx
            CAP_BlockageActive_Rx_oRDR_FUSION_CAPABILITY_oPCAN_RADAR_379fa0e4_Rx: ComBitPosition=162, ComBitSize=1, ComSignalType=BOOLEAN, ComSystemTemplateSystemSignalRef=CAP_BlockageActive_Rx
            CAP_BlockageProbability_Rx_oRDR_FUSION_CAPABILITY_oPCAN_RADAR_397cd1e8_Rx: ComBitPosition=208, ComBitSize=7, ComSignalType=UINT8, ComSystemTemplateSystemSignalRef=CAP_BlockageProbability_Rx
            CAP_BlockageSensitivity_Rx_oRDR_FUSION_CAPABILITY_oPCAN_RADAR_8548cf44_Rx: ComBitPosition=200, ComBitSize=8, ComSignalType=UINT8, ComSystemTemplateSystemSignalRef=CAP_BlockageSensitivity_Rx
            CAP_BlockageStatus_Rx_oRDR_FUSION_CAPABILITY_oPCAN_RADAR_bfd94e34_Rx: ComBitPosition=163, ComBitSize=3, ComSignalType=UINT8, ComSystemTemplateSystemSignalRef=CAP_BlockageStatus_Rx
            CAP_BlockageValue_Rx_oRDR_FUSION_CAPABILITY_oPCAN_RADAR_2053f8c3_Rx: ComBitPosition=184, ComBitSize=3, ComSignalType=UINT8, ComSystemTemplateSystemSignalRef=CAP_BlockageValue_Rx
            CAP_CYCLE_COUNTER_Rx_oRDR_FUSION_CAPABILITY_oPCAN_RADAR_9144c2b9_Rx: ComBitPosition=16, ComBitSize=8, ComSignalType=UINT8, ComSystemTemplateSystemSignalRef=CAP_CYCLE_COUNTER_Rx
            CAP_DampingActive_Rx_oRDR_FUSION_CAPABILITY_oPCAN_RADAR_e5da1c2d_Rx: ComBitPosition=215, ComBitSize=1, ComSignalType=BOOLEAN, ComSystemTemplateSystemSignalRef=CAP_DampingActive_Rx
            CAP_DampingCurrent_Rx_oRDR_FUSION_CAPABILITY_oPCAN_RADAR_12be9d0c_Rx: ComBitPosition=32, ComBitSize=16, ComSignalType=UINT16, ComSystemTemplateSystemSignalRef=CAP_DampingCurrent_Rx
            CAP_DampingStandardDeviation_Rx_oRDR_FUSION_CAPABILITY_oPCAN_RADAR_9a983e87_Rx: ComBitPosition=48, ComBitSize=8, ComSignalType=UINT8, ComSystemTemplateSystemSignalRef=CAP_DampingStandardDeviation_Rx
            CAP_DampingStatus_Rx_oRDR_FUSION_CAPABILITY_oPCAN_RADAR_6d9cf2fd_Rx: ComBitPosition=187, ComBitSize=3, ComSignalType=UINT8, ComSystemTemplateSystemSignalRef=CAP_DampingStatus_Rx
            CAP_FreeSightCheckActive_Rx_oRDR_FUSION_CAPABILITY_oPCAN_RADAR_73e0c0e2_Rx: ComBitPosition=176, ComBitSize=8, ComSignalType=UINT8, ComSystemTemplateSystemSignalRef=CAP_FreeSightCheckActive_Rx
            CAP_FreeSightCheckStatus_Rx_oRDR_FUSION_CAPABILITY_oPCAN_RADAR_fba62e32_Rx: ComBitPosition=192, ComBitSize=8, ComSignalType=UINT8, ComSystemTemplateSystemSignalRef=CAP_FreeSightCheckStatus_Rx
            CAP_MH_CRC16_Rx_oRDR_FUSION_CAPABILITY_oPCAN_RADAR_018c523e_Rx: ComBitPosition=0, ComBitSize=16, ComSignalType=UINT16, ComSystemTemplateSystemSignalRef=CAP_MH_CRC16_Rx
            CAP_MaxDetRangeMotorbike_0_Rx_oRDR_FUSION_CAPABILITY_oPCAN_RADAR_1fe06f92_Rx: ComBitPosition=126, ComBitSize=9, ComSignalType=UINT16, ComSystemTemplateSystemSignalRef=CAP_MaxDetRangeMotorbike_0_Rx
            CAP_MaxDetRangeMotorbike_1_Rx_oRDR_FUSION_CAPABILITY_oPCAN_RADAR_5169643b_Rx: ComBitPosition=72, ComBitSize=9, ComSignalType=UINT16, ComSystemTemplateSystemSignalRef=CAP_MaxDetRangeMotorbike_1_Rx
            CAP_MaxDetRangeMotorbike_2_Rx_oRDR_FUSION_CAPABILITY_oPCAN_RADAR_82f278c0_Rx: ComBitPosition=144, ComBitSize=9, ComSignalType=UINT16, ComSystemTemplateSystemSignalRef=CAP_MaxDetRangeMotorbike_2_Rx
            CAP_MaxDetRangePedestrian_0_Rx_oRDR_FUSION_CAPABILITY_oPCAN_RADAR_f5a4bfe3_Rx: ComBitPosition=81, ComBitSize=9, ComSignalType=UINT16, ComSystemTemplateSystemSignalRef=CAP_MaxDetRangePedestrian_0_Rx
            CAP_MaxDetRangePedestrian_1_Rx_oRDR_FUSION_CAPABILITY_oPCAN_RADAR_bb2db44a_Rx: ComBitPosition=135, ComBitSize=9, ComSignalType=UINT16, ComSystemTemplateSystemSignalRef=CAP_MaxDetRangePedestrian_1_Rx
            CAP_MaxDetRangePedestrian_2_Rx_oRDR_FUSION_CAPABILITY_oPCAN_RADAR_68b6a8b1_Rx: ComBitPosition=153, ComBitSize=9, ComSignalType=UINT16, ComSystemTemplateSystemSignalRef=CAP_MaxDetRangePedestrian_2_Rx
            CAP_MaxDetectionRangeCar_0_Rx_oRDR_FUSION_CAPABILITY_oPCAN_RADAR_b0ec0cb5_Rx: ComBitPosition=63, ComBitSize=9, ComSignalType=UINT16, ComSystemTemplateSystemSignalRef=CAP_MaxDetectionRangeCar_0_Rx
            CAP_MaxDetectionRangeCar_1_Rx_oRDR_FUSION_CAPABILITY_oPCAN_RADAR_fe65071c_Rx: ComBitPosition=108, ComBitSize=9, ComSignalType=UINT16, ComSystemTemplateSystemSignalRef=CAP_MaxDetectionRangeCar_1_Rx
            CAP_MaxDetectionRangeCar_2_Rx_oRDR_FUSION_CAPABILITY_oPCAN_RADAR_2dfe1be7_Rx: ComBitPosition=117, ComBitSize=9, ComSignalType=UINT16, ComSystemTemplateSystemSignalRef=CAP_MaxDetectionRangeCar_2_Rx
            CAP_RangeEstimationActive_Rx_oRDR_FUSION_CAPABILITY_oPCAN_RADAR_92caa8b4_Rx: ComBitPosition=31, ComBitSize=1, ComSignalType=BOOLEAN, ComSystemTemplateSystemSignalRef=CAP_RangeEstimationActive_Rx
            CAP_RangeEstimationStatus_Rx_oRDR_FUSION_CAPABILITY_oPCAN_RADAR_1a8c4664_Rx: ComBitPosition=56, ComBitSize=3, ComSignalType=UINT8, ComSystemTemplateSystemSignalRef=CAP_RangeEstimationStatus_Rx
            CAP_SLBlockageFilterValue_Rx_oRDR_FUSION_CAPABILITY_oPCAN_RADAR_0444b24e_Rx: ComBitPosition=25, ComBitSize=6, ComSignalType=UINT8, ComSystemTemplateSystemSignalRef=CAP_SLBlockageFilterValue_Rx
            CAP_SLBlockageFlag_Rx_oRDR_FUSION_CAPABILITY_oPCAN_RADAR_21586390_Rx: ComBitPosition=24, ComBitSize=1, ComSignalType=BOOLEAN, ComSystemTemplateSystemSignalRef=CAP_SLBlockageFlag_Rx
            CAP_SLLMonitoringActive_Rx_oRDR_FUSION_CAPABILITY_oPCAN_RADAR_f5cab52b_Rx: ComBitPosition=59, ComBitSize=1, ComSignalType=BOOLEAN, ComSystemTemplateSystemSignalRef=CAP_SLLMonitoringActive_Rx
            CAP_SLLMonitoringStatus_Rx_oRDR_FUSION_CAPABILITY_oPCAN_RADAR_7d8c5bfb_Rx: ComBitPosition=60, ComBitSize=3, ComSignalType=UINT8, ComSystemTemplateSystemSignalRef=CAP_SLLMonitoringStatus_Rx
            CAP_SideLobeLevelBeamformer_Rx_oRDR_FUSION_CAPABILITY_oPCAN_RADAR_bb7efd72_Rx: ComBitPosition=168, ComBitSize=8, ComSignalType=UINT8, ComSystemTemplateSystemSignalRef=CAP_SideLobeLevelBeamformer_Rx
        SG_Fusion_RadarHeader_oRDR_FUSION_HEADER_001_oPCAN_RADAR_cad756d0_Rx: ComSignalGroupArrayAccess=true, ComTimeout=0, ComSystemTemplateSignalGroupRef=SG_Fusion_RadarHeader
          36 x ComGroupSignal:
            HED_ALIGN_HOR_REF_Rx_oRDR_FUSION_HEADER_001_oPCAN_RADAR_147e49df_Rx: ComBitPosition=184, ComBitSize=13, ComSignalEndianness=LITTLE_ENDIAN, ComSignalInitValue=0, ComSignalType=UINT16, ComSystemTemplateSystemSignalRef=HED_ALIGN_HOR_REF_Rx
            HED_ALIGN_VER_REF_Rx_oRDR_FUSION_HEADER_001_oPCAN_RADAR_90a2f389_Rx: ComBitPosition=174, ComBitSize=10, ComSignalEndianness=LITTLE_ENDIAN, ComSignalInitValue=0, ComSignalType=UINT16, ComSystemTemplateSystemSignalRef=HED_ALIGN_VER_REF_Rx
            HED_Auth_CRC32_Rx_oRDR_FUSION_HEADER_001_oPCAN_RADAR_70da9fad_Rx: ComBitPosition=376, ComBitSize=32, ComSignalEndianness=LITTLE_ENDIAN, ComSignalInitValue=0, ComSignalType=UINT32, ComSystemTemplateSystemSignalRef=HED_Auth_CRC32_Rx
            HED_DATA_QUALIFIER_Rx_oRDR_FUSION_HEADER_001_oPCAN_RADAR_5117e37a_Rx: ComBitPosition=44, ComBitSize=3, ComSignalEndianness=LITTLE_ENDIAN, ComSignalInitValue=0, ComSignalType=UINT8, ComSystemTemplateSystemSignalRef=HED_DATA_QUALIFIER_Rx
            HED_DET_BI_STATIC_COUNT_Rx_oRDR_FUSION_HEADER_001_oPCAN_RADAR_29976834_Rx: ComBitPosition=288, ComBitSize=8, ComSignalEndianness=LITTLE_ENDIAN, ComSignalInitValue=0, ComSignalType=UINT8, ComSystemTemplateSystemSignalRef=HED_DET_BI_STATIC_COUNT_Rx
            HED_DET_NUM_OF_1PASS_Rx_oRDR_FUSION_HEADER_001_oPCAN_RADAR_5e84b070_Rx: ComBitPosition=296, ComBitSize=10, ComSignalEndianness=LITTLE_ENDIAN, ComSignalInitValue=0, ComSignalType=UINT16, ComSystemTemplateSystemSignalRef=HED_DET_NUM_OF_1PASS_Rx
            HED_DET_NUM_OF_2PASS_Rx_oRDR_FUSION_HEADER_001_oPCAN_RADAR_97b0ab7d_Rx: ComBitPosition=306, ComBitSize=9, ComSignalEndianness=LITTLE_ENDIAN, ComSignalInitValue=0, ComSignalType=UINT16, ComSystemTemplateSystemSignalRef=HED_DET_NUM_OF_2PASS_Rx
            HED_DET_RANGE_MAX_Rx_oRDR_FUSION_HEADER_001_oPCAN_RADAR_76f895a6_Rx: ComBitPosition=64, ComBitSize=16, ComSignalEndianness=LITTLE_ENDIAN, ComSignalInitValue=0, ComSignalType=UINT16, ComSystemTemplateSystemSignalRef=HED_DET_RANGE_MAX_Rx
            HED_DET_RANGE_MIN_Rx_oRDR_FUSION_HEADER_001_oPCAN_RADAR_437a84f8_Rx: ComBitPosition=80, ComBitSize=16, ComSignalEndianness=LITTLE_ENDIAN, ComSignalInitValue=0, ComSignalType=UINT16, ComSystemTemplateSystemSignalRef=HED_DET_RANGE_MIN_Rx
            HED_DET_SPEED_RANGE_MAX_Rx_oRDR_FUSION_HEADER_001_oPCAN_RADAR_b7cc12b5_Rx: ComBitPosition=96, ComBitSize=16, ComSignalEndianness=LITTLE_ENDIAN, ComSignalInitValue=0, ComSignalType=UINT16, ComSystemTemplateSystemSignalRef=HED_DET_SPEED_RANGE_MAX_Rx
            HED_DET_SPEED_RANGE_MIN_Rx_oRDR_FUSION_HEADER_001_oPCAN_RADAR_824e03eb_Rx: ComBitPosition=112, ComBitSize=16, ComSignalEndianness=LITTLE_ENDIAN, ComSignalInitValue=0, ComSignalType=UINT16, ComSystemTemplateSystemSignalRef=HED_DET_SPEED_RANGE_MIN_Rx
            HED_FOV_HOR_MAX_Rx_oRDR_FUSION_HEADER_001_oPCAN_RADAR_4b891441_Rx: ComBitPosition=136, ComBitSize=8, ComSignalEndianness=LITTLE_ENDIAN, ComSignalInitValue=0, ComSignalType=UINT8, ComSystemTemplateSystemSignalRef=HED_FOV_HOR_MAX_Rx
            HED_FOV_HOR_MIN_Rx_oRDR_FUSION_HEADER_001_oPCAN_RADAR_7e0b051f_Rx: ComBitPosition=128, ComBitSize=8, ComSignalEndianness=LITTLE_ENDIAN, ComSignalInitValue=0, ComSignalType=UINT8, ComSystemTemplateSystemSignalRef=HED_FOV_HOR_MIN_Rx
            HED_FOV_VER_MAX_Rx_oRDR_FUSION_HEADER_001_oPCAN_RADAR_cf55ae17_Rx: ComBitPosition=152, ComBitSize=8, ComSignalEndianness=LITTLE_ENDIAN, ComSignalInitValue=0, ComSignalType=UINT8, ComSystemTemplateSystemSignalRef=HED_FOV_VER_MAX_Rx
            HED_FOV_VER_MIN_Rx_oRDR_FUSION_HEADER_001_oPCAN_RADAR_fad7bf49_Rx: ComBitPosition=144, ComBitSize=8, ComSignalEndianness=LITTLE_ENDIAN, ComSignalInitValue=0, ComSignalType=UINT8, ComSystemTemplateSystemSignalRef=HED_FOV_VER_MIN_Rx
            HED_LOOK_ID_Rx_oRDR_FUSION_HEADER_001_oPCAN_RADAR_1e55b53b_Rx: ComBitPosition=42, ComBitSize=2, ComSignalEndianness=LITTLE_ENDIAN, ComSignalInitValue=0, ComSignalType=UINT8, ComSystemTemplateSystemSignalRef=HED_LOOK_ID_Rx
            HED_LOOK_INDEX_Rx_oRDR_FUSION_HEADER_001_oPCAN_RADAR_2bf2972b_Rx: ComBitPosition=208, ComBitSize=16, ComSignalEndianness=LITTLE_ENDIAN, ComSignalInitValue=0, ComSignalType=UINT16, ComSystemTemplateSystemSignalRef=HED_LOOK_INDEX_Rx
            HED_MAX_NUM_OF_DETECTIONS_Rx_oRDR_FUSION_HEADER_001_oPCAN_RADAR_084cd53e_Rx: ComBitPosition=352, ComBitSize=9, ComSignalEndianness=LITTLE_ENDIAN, ComSignalInitValue=0, ComSignalType=UINT16, ComSystemTemplateSystemSignalRef=HED_MAX_NUM_OF_DETECTIONS_Rx
            HED_MH_CRC16_Rx_oRDR_FUSION_HEADER_001_oPCAN_RADAR_73943b50_Rx: ComBitPosition=0, ComBitSize=16, ComSignalEndianness=LITTLE_ENDIAN, ComSignalInitValue=0, ComSignalType=UINT16, ComSystemTemplateSystemSignalRef=HED_MH_CRC16_Rx
            HED_MH_CYCLE_COUNTER_Rx_oRDR_FUSION_HEADER_001_oPCAN_RADAR_ea0b66ed_Rx: ComBitPosition=16, ComBitSize=8, ComSignalEndianness=LITTLE_ENDIAN, ComSignalInitValue=0, ComSignalType=UINT8, ComSystemTemplateSystemSignalRef=HED_MH_CYCLE_COUNTER_Rx
            HED_NUM_OF_RESTBINS_USED_Rx_oRDR_FUSION_HEADER_001_oPCAN_RADAR_627cc09c_Rx: ComBitPosition=24, ComBitSize=9, ComSignalEndianness=LITTLE_ENDIAN, ComSignalInitValue=0, ComSignalType=UINT16, ComSystemTemplateSystemSignalRef=HED_NUM_OF_RESTBINS_USED_Rx
            HED_NUM_OF_VALID_DETECTIONS_Rx_oRDR_FUSION_HEADER_001_oPCAN_RADAR_460781da_Rx: ComBitPosition=33, ComBitSize=9, ComSignalEndianness=LITTLE_ENDIAN, ComSignalInitValue=0, ComSignalType=UINT16, ComSystemTemplateSystemSignalRef=HED_NUM_OF_VALID_DETECTIONS_Rx
            HED_OPERATION_MODE_Rx_oRDR_FUSION_HEADER_001_oPCAN_RADAR_de864358_Rx: ComBitPosition=315, ComBitSize=3, ComSignalEndianness=LITTLE_ENDIAN, ComSignalInitValue=0, ComSignalType=UINT8, ComSystemTemplateSystemSignalRef=HED_OPERATION_MODE_Rx
            HED_PROCESSED_RANGE_Rx_oRDR_FUSION_HEADER_001_oPCAN_RADAR_2cda03f8_Rx: ComBitPosition=160, ComBitSize=9, ComSignalEndianness=LITTLE_ENDIAN, ComSignalInitValue=0, ComSignalType=UINT16, ComSystemTemplateSystemSignalRef=HED_PROCESSED_RANGE_Rx
            HED_RDR_HEADER_CMAC_Rx_oRDR_FUSION_HEADER_001_oPCAN_RADAR_64fe3bc9_Rx: ComBitPosition=472, ComSignalEndianness=opaque, ComSignalInitValue=0 0 0 0 0, ComSignalLength=5, ComSignalType=UINT8_N, ComSystemTemplateSystemSignalRef=HED_RDR_HEADER_CMAC_Rx
            HED_RDR_HEADER_FV_Rx_oRDR_FUSION_HEADER_001_oPCAN_RADAR_b8f721a0_Rx: ComBitPosition=416, ComSignalEndianness=opaque, ComSignalInitValue=0 0 0 0 0 0 0, ComSignalLength=7, ComSignalType=UINT8_N, ComSystemTemplateSystemSignalRef=HED_RDR_HEADER_FV_Rx
            HED_R_WRAPPING_Rx_oRDR_FUSION_HEADER_001_oPCAN_RADAR_738d42d6_Rx: ComBitPosition=368, ComBitSize=8, ComSignalEndianness=LITTLE_ENDIAN, ComSignalInitValue=0, ComSignalType=UINT8, ComSystemTemplateSystemSignalRef=HED_R_WRAPPING_Rx
            HED_Rain_Level_Rx_oRDR_FUSION_HEADER_001_oPCAN_RADAR_0b0549b9_Rx: ComBitPosition=318, ComBitSize=2, ComSignalEndianness=LITTLE_ENDIAN, ComSignalInitValue=0, ComSignalType=UINT8, ComSystemTemplateSystemSignalRef=HED_Rain_Level_Rx
            HED_SCAN_INDEX_Rx_oRDR_FUSION_HEADER_001_oPCAN_RADAR_906dc02d_Rx: ComBitPosition=48, ComBitSize=16, ComSignalEndianness=LITTLE_ENDIAN, ComSignalInitValue=0, ComSignalType=UINT16, ComSystemTemplateSystemSignalRef=HED_SCAN_INDEX_Rx
            HED_SENSOR_TIME_STAMP_NS_Rx_oRDR_FUSION_HEADER_001_oPCAN_RADAR_6308a4c2_Rx: ComBitPosition=224, ComBitSize=32, ComSignalEndianness=LITTLE_ENDIAN, ComSignalInitValue=0, ComSignalType=UINT32, ComSystemTemplateSystemSignalRef=HED_SENSOR_TIME_STAMP_NS_Rx
            HED_SENSOR_TIME_STAMP_SEC_Rx_oRDR_FUSION_HEADER_001_oPCAN_RADAR_282ee70b_Rx: ComBitPosition=256, ComBitSize=32, ComSignalEndianness=LITTLE_ENDIAN, ComSignalInitValue=0, ComSignalType=UINT32, ComSystemTemplateSystemSignalRef=HED_SENSOR_TIME_STAMP_SEC_Rx
            HED_SLOPE_CORR_EXECUTIONFLAG_Rx_oRDR_FUSION_HEADER_001_oPCAN_RADAR_848519d1_Rx: ComBitPosition=172, ComBitSize=2, ComSignalEndianness=LITTLE_ENDIAN, ComSignalInitValue=0, ComSignalType=UINT8, ComSystemTemplateSystemSignalRef=HED_SLOPE_CORR_EXECUTIONFLAG_Rx
            HED_TIME_SYNC_SRC_MASTER_Rx_oRDR_FUSION_HEADER_001_oPCAN_RADAR_aeef5352_Rx: ComBitPosition=169, ComBitSize=1, ComSignalEndianness=LITTLE_ENDIAN, ComSignalInitValue=0, ComSignalType=BOOLEAN, ComSystemTemplateSystemSignalRef=HED_TIME_SYNC_SRC_MASTER_Rx
            HED_TIME_SYNC_VALIDITY_FLAG_Rx_oRDR_FUSION_HEADER_001_oPCAN_RADAR_cf6ff64d_Rx: ComBitPosition=170, ComBitSize=2, ComSignalEndianness=LITTLE_ENDIAN, ComSignalInitValue=0, ComSignalType=UINT8, ComSystemTemplateSystemSignalRef=HED_TIME_SYNC_VALIDITY_FLAG_Rx
            HED_TRIGGER_TIME_Rx_oRDR_FUSION_HEADER_001_oPCAN_RADAR_554e6103_Rx: ComBitPosition=320, ComBitSize=32, ComSignalEndianness=LITTLE_ENDIAN, ComSignalInitValue=0, ComSignalType=UINT32, ComSystemTemplateSystemSignalRef=HED_TRIGGER_TIME_Rx
            HED_V_WRAPPING_Rx_oRDR_FUSION_HEADER_001_oPCAN_RADAR_854af1a6_Rx: ComBitPosition=197, ComBitSize=11, ComSignalEndianness=LITTLE_ENDIAN, ComSignalInitValue=0, ComSignalType=UINT16, ComSystemTemplateSystemSignalRef=HED_V_WRAPPING_Rx
        SG_Fusion_RadarStatus2_oRDR_FUSION_STATUS_002_oPCAN_RADAR_458079fc_Rx: ComSignalGroupArrayAccess=true, ComTimeout=0, ComSystemTemplateSignalGroupRef=SG_Fusion_RadarStatus2
          38 x ComGroupSignal, all with ComSignalEndianness=LITTLE_ENDIAN, ComSignalInitValue=0:
            STS_AF_CORE_THROUGHPUT_Rx_oRDR_FUSION_STATUS_002_oPCAN_RADAR_fca7dcb6_Rx: ComBitPosition=128, ComBitSize=6, ComSignalType=UINT8, ComSystemTemplateSystemSignalRef=STS_AF_CORE_THROUGHPUT_Rx
            STS_BRR_STATUS_Rx_oRDR_FUSION_STATUS_002_oPCAN_RADAR_ab4c702f_Rx: ComBitPosition=41, ComBitSize=2, ComSignalType=UINT8, ComSystemTemplateSystemSignalRef=STS_BRR_STATUS_Rx
            STS_CAN_NM_State_Rx_oRDR_FUSION_STATUS_002_oPCAN_RADAR_69c86af9_Rx: ComBitPosition=64, ComBitSize=8, ComSignalType=UINT8, ComSystemTemplateSystemSignalRef=STS_CAN_NM_State_Rx
            STS_CORE_ACTV_FLT_BYTE_0_to_3_Rx_oRDR_FUSION_STATUS_002_oPCAN_RADAR_d8ff22f4_Rx: ComBitPosition=192, ComBitSize=32, ComSignalType=UINT32, ComSystemTemplateSystemSignalRef=STS_CORE_ACTV_FLT_BYTE_0_to_3_Rx
            STS_CORE_ACTV_FLT_BYTE_11_to_15_Rx_oRDR_FUSION_STATUS_002_oPCAN_RADAR_46956790_Rx: ComBitPosition=256, ComBitSize=32, ComSignalType=UINT32, ComSystemTemplateSystemSignalRef=STS_CORE_ACTV_FLT_BYTE_11_to_15_Rx
            STS_CORE_ACTV_FLT_BYTE_4_to_7_Rx_oRDR_FUSION_STATUS_002_oPCAN_RADAR_910aeb99_Rx: ComBitPosition=96, ComBitSize=32, ComSignalType=UINT32, ComSystemTemplateSystemSignalRef=STS_CORE_ACTV_FLT_BYTE_4_to_7_Rx
            STS_CORE_ACTV_FLT_BYTE_8_to_11_Rx_oRDR_FUSION_STATUS_002_oPCAN_RADAR_02a7f53e_Rx: ComBitPosition=224, ComBitSize=32, ComSignalType=UINT32, ComSystemTemplateSystemSignalRef=STS_CORE_ACTV_FLT_BYTE_8_to_11_Rx
            STS_First_CAN_Det_Inst_Latency_Rx_oRDR_FUSION_STATUS_002_oPCAN_RADAR_97228231_Rx: ComBitPosition=348, ComBitSize=12, ComSignalType=UINT16, ComSystemTemplateSystemSignalRef=STS_First_CAN_Det_Inst_Latency_Rx
            STS_Gear_Position_Rx_oRDR_FUSION_STATUS_002_oPCAN_RADAR_6cfac34a_Rx: ComBitPosition=59, ComBitSize=4, ComSignalType=UINT8, ComSystemTemplateSystemSignalRef=STS_Gear_Position_Rx
            STS_INTRFC_VERSION_ID_MAJOR_Rx_oRDR_FUSION_STATUS_002_oPCAN_RADAR_24081e81_Rx: ComBitPosition=376, ComBitSize=8, ComSignalType=UINT8, ComSystemTemplateSystemSignalRef=STS_INTRFC_VERSION_ID_MAJOR_Rx
            STS_INTRFC_VERSION_ID_MINOR_Rx_oRDR_FUSION_STATUS_002_oPCAN_RADAR_3b2f6430_Rx: ComBitPosition=384, ComBitSize=8, ComSignalType=UINT8, ComSystemTemplateSystemSignalRef=STS_INTRFC_VERSION_ID_MINOR_Rx
            STS_INTRFC_VERSION_ID_PATCH_Rx_oRDR_FUSION_STATUS_002_oPCAN_RADAR_2cd61204_Rx: ComBitPosition=392, ComBitSize=8, ComSignalType=UINT8, ComSystemTemplateSystemSignalRef=STS_INTRFC_VERSION_ID_PATCH_Rx
            STS_Last_CAN_Det_Inst_Latency_Rx_oRDR_FUSION_STATUS_002_oPCAN_RADAR_383e71e8_Rx: ComBitPosition=336, ComBitSize=12, ComSignalType=UINT16, ComSystemTemplateSystemSignalRef=STS_Last_CAN_Det_Inst_Latency_Rx
            STS_MCU_TEMP_Rx_oRDR_FUSION_STATUS_002_oPCAN_RADAR_b492ba9b_Rx: ComBitPosition=88, ComBitSize=8, ComSignalType=UINT8, ComSystemTemplateSystemSignalRef=STS_MCU_TEMP_Rx
            STS_MH_002_CRC16_Rx_oRDR_FUSION_STATUS_002_oPCAN_RADAR_75522b12_Rx: ComBitPosition=0, ComBitSize=16, ComSignalType=UINT16, ComSystemTemplateSystemSignalRef=STS_MH_002_CRC16_Rx
            STS_MH_002_CYCLE_COUNTER_Rx_oRDR_FUSION_STATUS_002_oPCAN_RADAR_97a416ac_Rx: ComBitPosition=16, ComBitSize=8, ComSignalType=UINT8, ComSystemTemplateSystemSignalRef=STS_MH_002_CYCLE_COUNTER_Rx
            STS_MMIC_RE_INIT_COUNT_Rx_oRDR_FUSION_STATUS_002_oPCAN_RADAR_1306724b_Rx: ComBitPosition=44, ComBitSize=4, ComSignalType=UINT8, ComSystemTemplateSystemSignalRef=STS_MMIC_RE_INIT_COUNT_Rx
            STS_MMIC_TEMP_RX_Rx_oRDR_FUSION_STATUS_002_oPCAN_RADAR_8467dc68_Rx: ComBitPosition=144, ComBitSize=8, ComSignalType=UINT8, ComSystemTemplateSystemSignalRef=STS_MMIC_TEMP_RX_Rx
            STS_MMIC_TEMP_TX0_Rx_oRDR_FUSION_STATUS_002_oPCAN_RADAR_3137a36b_Rx: ComBitPosition=168, ComBitSize=8, ComSignalType=UINT8, ComSystemTemplateSystemSignalRef=STS_MMIC_TEMP_TX0_Rx
            STS_MMIC_TEMP_TX1_2_Rx_oRDR_FUSION_STATUS_002_oPCAN_RADAR_8c03a0ef_Rx: ComBitPosition=72, ComBitSize=8, ComSignalType=UINT8, ComSystemTemplateSystemSignalRef=STS_MMIC_TEMP_TX1_2_Rx
            STS_MMIC_TEMP_TX3_4_Rx_oRDR_FUSION_STATUS_002_oPCAN_RADAR_fb1ab85b_Rx: ComBitPosition=80, ComBitSize=8, ComSignalType=UINT8, ComSystemTemplateSystemSignalRef=STS_MMIC_TEMP_TX3_4_Rx
            STS_NO_TSYN_ERROR_Rx_oRDR_FUSION_STATUS_002_oPCAN_RADAR_d3eee9d9_Rx: ComBitPosition=40, ComBitSize=1, ComSignalType=BOOLEAN, ComSystemTemplateSystemSignalRef=STS_NO_TSYN_ERROR_Rx
            STS_POINT_OF_TRIGGER_Rx_oRDR_FUSION_STATUS_002_oPCAN_RADAR_81e821a6_Rx: ComBitPosition=48, ComBitSize=10, ComSignalType=UINT16, ComSystemTemplateSystemSignalRef=STS_POINT_OF_TRIGGER_Rx
            STS_RAIN_COUNT_Rx_oRDR_FUSION_STATUS_002_oPCAN_RADAR_1e737e66_Rx: ComBitPosition=360, ComBitSize=9, ComSignalType=UINT16, ComSystemTemplateSystemSignalRef=STS_RAIN_COUNT_Rx
            STS_RDD_CORE_THROUGHPUT_Rx_oRDR_FUSION_STATUS_002_oPCAN_RADAR_e15fe345_Rx: ComBitPosition=136, ComBitSize=6, ComSignalType=UINT8, ComSystemTemplateSystemSignalRef=STS_RDD_CORE_THROUGHPUT_Rx
            STS_SCAN_TYPE_Rx_oRDR_FUSION_STATUS_002_oPCAN_RADAR_10a1b094_Rx: ComBitPosition=58, ComBitSize=1, ComSignalType=BOOLEAN, ComSystemTemplateSystemSignalRef=STS_SCAN_TYPE_Rx
            STS_STEERING_ANGLE_Rx_oRDR_FUSION_STATUS_002_oPCAN_RADAR_4b147df6_Rx: ComBitPosition=32, ComBitSize=8, ComSignalType=UINT8, ComSystemTemplateSystemSignalRef=STS_STEERING_ANGLE_Rx
            STS_STEERING_ANGLE_SIGN_Rx_oRDR_FUSION_STATUS_002_oPCAN_RADAR_9792032c_Rx: ComBitPosition=176, ComBitSize=1, ComSignalType=BOOLEAN, ComSystemTemplateSystemSignalRef=STS_STEERING_ANGLE_SIGN_Rx
            STS_TIME_SYNC_OFFSET_Rx_oRDR_FUSION_STATUS_002_oPCAN_RADAR_d61087bd_Rx: ComBitPosition=152, ComBitSize=16, ComSignalType=SINT16, ComSystemTemplateSystemSignalRef=STS_TIME_SYNC_OFFSET_Rx
            STS_TKEY_ACTV_FLT_BYTE_0_to_3_Rx_oRDR_FUSION_STATUS_002_oPCAN_RADAR_73aea715_Rx: ComBitPosition=288, ComBitSize=32, ComSignalType=UINT32, ComSystemTemplateSystemSignalRef=STS_TKEY_ACTV_FLT_BYTE_0_to_3_Rx
            STS_TKEY_ACTV_FLT_BYTE_4_to_5_Rx_oRDR_FUSION_STATUS_002_oPCAN_RADAR_a749792a_Rx: ComBitPosition=320, ComBitSize=16, ComSignalType=UINT16, ComSystemTemplateSystemSignalRef=STS_TKEY_ACTV_FLT_BYTE_4_to_5_Rx
            STS_VEHICLE_SPEED_CALC_Rx_oRDR_FUSION_STATUS_002_oPCAN_RADAR_ac8a2f2e_Rx: ComBitPosition=178, ComBitSize=14, ComSignalType=UINT16, ComSystemTemplateSystemSignalRef=STS_VEHICLE_SPEED_CALC_Rx
            STS_VEHICLE_SUPPLY_VOLTAGE_Rx_oRDR_FUSION_STATUS_002_oPCAN_RADAR_b633ed3e_Rx: ComBitPosition=24, ComBitSize=4, ComSignalType=UINT8, ComSystemTemplateSystemSignalRef=STS_VEHICLE_SUPPLY_VOLTAGE_Rx
            STS_VEH_SPEED_DIRECTION_Rx_oRDR_FUSION_STATUS_002_oPCAN_RADAR_238cca73_Rx: ComBitPosition=177, ComBitSize=1, ComSignalType=BOOLEAN, ComSystemTemplateSystemSignalRef=STS_VEH_SPEED_DIRECTION_Rx
            STS_Vehicle_Speed_Calc_QF_Rx_oRDR_FUSION_STATUS_002_oPCAN_RADAR_cf710cdf_Rx: ComBitPosition=134, ComBitSize=2, ComSignalType=UINT8, ComSystemTemplateSystemSignalRef=STS_Vehicle_Speed_Calc_QF_Rx
            STS_XCVR_OPERATIONAL_Rx_oRDR_FUSION_STATUS_002_oPCAN_RADAR_2d179a83_Rx: ComBitPosition=43, ComBitSize=1, ComSignalType=BOOLEAN, ComSystemTemplateSystemSignalRef=STS_XCVR_OPERATIONAL_Rx
            STS_YAW_RATE_BIAS_Rx_oRDR_FUSION_STATUS_002_oPCAN_RADAR_d7dadf21_Rx: ComBitPosition=28, ComBitSize=4, ComSignalType=UINT8, ComSystemTemplateSystemSignalRef=STS_YAW_RATE_BIAS_Rx
            STS_Yaw_Rate_Calc_QF_Rx_oRDR_FUSION_STATUS_002_oPCAN_RADAR_ba579c34_Rx: ComBitPosition=142, ComBitSize=2, ComSignalType=UINT8, ComSystemTemplateSystemSignalRef=STS_Yaw_Rate_Calc_QF_Rx
        SG_Fusion_RadarStatus_oRDR_FUSION_STATUS_001_oPCAN_RADAR_00ff53b8_Rx: ComSignalGroupArrayAccess=true, ComTimeout=0, ComSystemTemplateSignalGroupRef=SG_Fusion_RadarStatus
          46 x ComGroupSignal, all with ComSignalEndianness=LITTLE_ENDIAN, ComSignalInitValue=0:
            STS_AF_TIME_INST_Rx_oRDR_FUSION_STATUS_001_oPCAN_RADAR_e7ea07fd_Rx: ComBitPosition=424, ComBitSize=8, ComSignalType=UINT8, ComSystemTemplateSystemSignalRef=STS_AF_TIME_INST_Rx
            STS_AF_TIME_PEAK_Rx_oRDR_FUSION_STATUS_001_oPCAN_RADAR_fbf318d6_Rx: ComBitPosition=432, ComBitSize=8, ComSignalType=UINT8, ComSystemTemplateSystemSignalRef=STS_AF_TIME_PEAK_Rx
            STS_DET_DBC_BASE_VER_MAJOR_Rx_oRDR_FUSION_STATUS_001_oPCAN_RADAR_da72d0b4_Rx: ComBitPosition=376, ComBitSize=8, ComSignalType=UINT8, ComSystemTemplateSystemSignalRef=STS_DET_DBC_BASE_VER_MAJOR_Rx
            STS_DET_DBC_BASE_VER_MINOR_Rx_oRDR_FUSION_STATUS_001_oPCAN_RADAR_c555aa05_Rx: ComBitPosition=384, ComBitSize=8, ComSignalType=UINT8, ComSystemTemplateSystemSignalRef=STS_DET_DBC_BASE_VER_MINOR_Rx
            STS_DIST_FRNT_BMPR_TO_RR_AXL_Rx_oRDR_FUSION_STATUS_001_oPCAN_RADAR_d3356ae9_Rx: ComBitPosition=248, ComBitSize=13, ComSignalType=UINT16, ComSystemTemplateSystemSignalRef=STS_DIST_FRNT_BMPR_TO_RR_AXL_Rx
            STS_HARDWARE_VERSION_Rx_oRDR_FUSION_STATUS_001_oPCAN_RADAR_eb5d2e7e_Rx: ComBitPosition=112, ComBitSize=3, ComSignalType=UINT8, ComSystemTemplateSystemSignalRef=STS_HARDWARE_VERSION_Rx
            STS_MAIN_CORE_TIME_INST_Rx_oRDR_FUSION_STATUS_001_oPCAN_RADAR_119502a5_Rx: ComBitPosition=440, ComBitSize=8, ComSignalType=UINT8, ComSystemTemplateSystemSignalRef=STS_MAIN_CORE_TIME_INST_Rx
            STS_MAIN_CORE_TIME_PEAK_Rx_oRDR_FUSION_STATUS_001_oPCAN_RADAR_0d8c1d8e_Rx: ComBitPosition=448, ComBitSize=8, ComSignalType=UINT8, ComSystemTemplateSystemSignalRef=STS_MAIN_CORE_TIME_PEAK_Rx
            STS_MH_001_CRC16_Rx_oRDR_FUSION_STATUS_001_oPCAN_RADAR_f7533949_Rx: ComBitPosition=0, ComBitSize=16, ComSignalType=UINT16, ComSystemTemplateSystemSignalRef=STS_MH_001_CRC16_Rx
            STS_MH_001_CYCLE_COUNTER_Rx_oRDR_FUSION_STATUS_001_oPCAN_RADAR_a907aaa1_Rx: ComBitPosition=16, ComBitSize=8, ComSignalType=UINT8, ComSystemTemplateSystemSignalRef=STS_MH_001_CYCLE_COUNTER_Rx
            STS_PBL_VERSION_FIELD1_Rx_oRDR_FUSION_STATUS_001_oPCAN_RADAR_2fed7e79_Rx: ComBitPosition=200, ComBitSize=8, ComSignalType=UINT8, ComSystemTemplateSystemSignalRef=STS_PBL_VERSION_FIELD1_Rx
            STS_PBL_VERSION_FIELD2_Rx_oRDR_FUSION_STATUS_001_oPCAN_RADAR_fc766282_Rx: ComBitPosition=208, ComBitSize=8, ComSignalType=UINT8, ComSystemTemplateSystemSignalRef=STS_PBL_VERSION_FIELD2_Rx
            STS_PBL_VERSION_FIELD3_Rx_oRDR_FUSION_STATUS_001_oPCAN_RADAR_b2ff692b_Rx: ComBitPosition=216, ComBitSize=8, ComSignalType=UINT8, ComSystemTemplateSystemSignalRef=STS_PBL_VERSION_FIELD3_Rx
            STS_PBL_VERSION_FIELD4_Rx_oRDR_FUSION_STATUS_001_oPCAN_RADAR_80315d35_Rx: ComBitPosition=224, ComBitSize=8, ComSignalType=UINT8, ComSystemTemplateSystemSignalRef=STS_PBL_VERSION_FIELD4_Rx
            STS_PCAN_PROTOCOL_VER_MAJOR_Rx_oRDR_FUSION_STATUS_001_oPCAN_RADAR_ca576892_Rx: ComBitPosition=120, ComBitSize=8, ComSignalType=UINT8, ComSystemTemplateSystemSignalRef=STS_PCAN_PROTOCOL_VER_MAJOR_Rx
            STS_PCAN_PROTOCOL_VER_MINOR_Rx_oRDR_FUSION_STATUS_001_oPCAN_RADAR_d5701223_Rx: ComBitPosition=128, ComBitSize=8, ComSignalType=UINT8, ComSystemTemplateSystemSignalRef=STS_PCAN_PROTOCOL_VER_MINOR_Rx
            STS_PLATFORM_VARIANT_Rx_oRDR_FUSION_STATUS_001_oPCAN_RADAR_1ab3f6e1_Rx: ComBitPosition=162, ComBitSize=5, ComSignalType=UINT8, ComSystemTemplateSystemSignalRef=STS_PLATFORM_VARIANT_Rx
            STS_RDD_CORE_TIME_INST_Rx_oRDR_FUSION_STATUS_001_oPCAN_RADAR_b7ed7be5_Rx: ComBitPosition=456, ComBitSize=8, ComSignalType=UINT8, ComSystemTemplateSystemSignalRef=STS_RDD_CORE_TIME_INST_Rx
            STS_RDD_CORE_TIME_PEAK_Rx_oRDR_FUSION_STATUS_001_oPCAN_RADAR_abf464ce_Rx: ComBitPosition=464, ComBitSize=8, ComSignalType=UINT8, ComSystemTemplateSystemSignalRef=STS_RDD_CORE_TIME_PEAK_Rx
            STS_SENSOR_HEIGHT_Rx_oRDR_FUSION_STATUS_001_oPCAN_RADAR_afb05744_Rx: ComBitPosition=344, ComBitSize=32, ComSignalType=UINT32, ComSystemTemplateSystemSignalRef=STS_SENSOR_HEIGHT_Rx
            STS_SENSOR_MOUNT_ORNT_PITCH_Rx_oRDR_FUSION_STATUS_001_oPCAN_RADAR_5d2c301f_Rx: ComBitPosition=264, ComBitSize=14, ComSignalType=SINT16, ComSystemTemplateSystemSignalRef=STS_SENSOR_MOUNT_ORNT_PITCH_Rx
            STS_SENSOR_MOUNT_ORNT_ROLL_Rx_oRDR_FUSION_STATUS_001_oPCAN_RADAR_2eb23309_Rx: ComBitPosition=280, ComBitSize=14, ComSignalType=UINT16, ComSystemTemplateSystemSignalRef=STS_SENSOR_MOUNT_ORNT_ROLL_Rx
            STS_SENSOR_MOUNT_ORNT_YAW_Rx_oRDR_FUSION_STATUS_001_oPCAN_RADAR_0ebbf3ee_Rx: ComBitPosition=232, ComBitSize=14, ComSignalType=SINT16, ComSystemTemplateSystemSignalRef=STS_SENSOR_MOUNT_ORNT_YAW_Rx
            STS_SENSOR_MOUNT_POS_X_Rx_oRDR_FUSION_STATUS_001_oPCAN_RADAR_a13ba1df_Rx: ComBitPosition=296, ComBitSize=14, ComSignalType=UINT16, ComSystemTemplateSystemSignalRef=STS_SENSOR_MOUNT_POS_X_Rx
            STS_SENSOR_MOUNT_POS_Y_Rx_oRDR_FUSION_STATUS_001_oPCAN_RADAR_efb2aa76_Rx: ComBitPosition=312, ComBitSize=16, ComSignalType=UINT16, ComSystemTemplateSystemSignalRef=STS_SENSOR_MOUNT_POS_Y_Rx
            STS_SENSOR_MOUNT_POS_Z_Rx_oRDR_FUSION_STATUS_001_oPCAN_RADAR_3c29b68d_Rx: ComBitPosition=328, ComBitSize=16, ComSignalType=UINT16, ComSystemTemplateSystemSignalRef=STS_SENSOR_MOUNT_POS_Z_Rx
            STS_SENSOR_POLARITY_Rx_oRDR_FUSION_STATUS_001_oPCAN_RADAR_cb038873_Rx: ComBitPosition=246, ComBitSize=1, ComSignalType=BOOLEAN, ComSystemTemplateSystemSignalRef=STS_SENSOR_POLARITY_Rx
            STS_SENSOR_POSITION_Rx_oRDR_FUSION_STATUS_001_oPCAN_RADAR_d8d06a93_Rx: ComBitPosition=115, ComBitSize=3, ComSignalType=UINT8, ComSystemTemplateSystemSignalRef=STS_SENSOR_POSITION_Rx
            STS_SERIAL_NUMBER_SEQUENCE_Rx_oRDR_FUSION_STATUS_001_oPCAN_RADAR_18d84c3c_Rx: ComBitPosition=148, ComBitSize=14, ComSignalType=UINT16, ComSystemTemplateSystemSignalRef=STS_SERIAL_NUMBER_SEQUENCE_Rx
            STS_SERIAL_NUM_JULIAN_DAY_Rx_oRDR_FUSION_STATUS_001_oPCAN_RADAR_5edc9e7f_Rx: ComBitPosition=136, ComBitSize=9, ComSignalType=UINT16, ComSystemTemplateSystemSignalRef=STS_SERIAL_NUM_JULIAN_DAY_Rx
            STS_SERIAL_NUM_JULIAN_YEAR_Rx_oRDR_FUSION_STATUS_001_oPCAN_RADAR_901b4493_Rx: ComBitPosition=145, ComBitSize=3, ComSignalType=UINT8, ComSystemTemplateSystemSignalRef=STS_SERIAL_NUM_JULIAN_YEAR_Rx
            STS_SMC_CAL_VER_MAJOR_Rx_oRDR_FUSION_STATUS_001_oPCAN_RADAR_d198a980_Rx: ComBitPosition=72, ComBitSize=16, ComSignalType=UINT16, ComSystemTemplateSystemSignalRef=STS_SMC_CAL_VER_MAJOR_Rx
            STS_SMC_CAL_VER_MINOR_Rx_oRDR_FUSION_STATUS_001_oPCAN_RADAR_cebfd331_Rx: ComBitPosition=88, ComBitSize=16, ComSignalType=UINT16, ComSystemTemplateSystemSignalRef=STS_SMC_CAL_VER_MINOR_Rx
            STS_SMC_PLATFROM_VERSION_Rx_oRDR_FUSION_STATUS_001_oPCAN_RADAR_22874c18_Rx: ComBitPosition=104, ComBitSize=8, ComSignalType=UINT8, ComSystemTemplateSystemSignalRef=STS_SMC_PLATFROM_VERSION_Rx
            STS_SMC_SECTION_COMPTBLITY_Rx_oRDR_FUSION_STATUS_001_oPCAN_RADAR_09850e5f_Rx: ComBitPosition=488, ComBitSize=16, ComSignalType=UINT16, ComSystemTemplateSystemSignalRef=STS_SMC_SECTION_COMPTBLITY_Rx
            STS_SP_CORE_TIME_INST_Rx_oRDR_FUSION_STATUS_001_oPCAN_RADAR_eeeadfc2_Rx: ComBitPosition=480, ComBitSize=8, ComSignalType=UINT8, ComSystemTemplateSystemSignalRef=STS_SP_CORE_TIME_INST_Rx
            STS_SP_CORE_TIME_PEAK_Rx_oRDR_FUSION_STATUS_001_oPCAN_RADAR_f2f3c0e9_Rx: ComBitPosition=472, ComBitSize=8, ComSignalType=UINT8, ComSystemTemplateSystemSignalRef=STS_SP_CORE_TIME_PEAK_Rx
            STS_SW_VERSION_FIELD1_Rx_oRDR_FUSION_STATUS_001_oPCAN_RADAR_889c4622_Rx: ComBitPosition=168, ComBitSize=8, ComSignalType=UINT8, ComSystemTemplateSystemSignalRef=STS_SW_VERSION_FIELD1_Rx
            STS_SW_VERSION_FIELD2_Rx_oRDR_FUSION_STATUS_001_oPCAN_RADAR_5b075ad9_Rx: ComBitPosition=176, ComBitSize=8, ComSignalType=UINT8, ComSystemTemplateSystemSignalRef=STS_SW_VERSION_FIELD2_Rx
            STS_SW_VERSION_FIELD3_Rx_oRDR_FUSION_STATUS_001_oPCAN_RADAR_158e5170_Rx: ComBitPosition=184, ComBitSize=8, ComSignalType=UINT8, ComSystemTemplateSystemSignalRef=STS_SW_VERSION_FIELD3_Rx
            STS_SW_VERSION_FIELD4_Rx_oRDR_FUSION_STATUS_001_oPCAN_RADAR_2740656e_Rx: ComBitPosition=192, ComBitSize=8, ComSignalType=UINT8, ComSystemTemplateSystemSignalRef=STS_SW_VERSION_FIELD4_Rx
            STS_TIME_SINCE_POWER_ON_Rx_oRDR_FUSION_STATUS_001_oPCAN_RADAR_fe979836_Rx: ComBitPosition=392, ComBitSize=32, ComSignalType=UINT32, ComSystemTemplateSystemSignalRef=STS_TIME_SINCE_POWER_ON_Rx
            STS_USC_CAL_VER_MAJOR_Rx_oRDR_FUSION_STATUS_001_oPCAN_RADAR_0f3b2084_Rx: ComBitPosition=24, ComBitSize=16, ComSignalType=UINT16, ComSystemTemplateSystemSignalRef=STS_USC_CAL_VER_MAJOR_Rx
            STS_USC_CAL_VER_MINOR_Rx_oRDR_FUSION_STATUS_001_oPCAN_RADAR_101c5a35_Rx: ComBitPosition=40, ComBitSize=16, ComSignalType=UINT16, ComSystemTemplateSystemSignalRef=STS_USC_CAL_VER_MINOR_Rx
            STS_USC_SECTION_COMPTBLITY_Rx_oRDR_FUSION_STATUS_001_oPCAN_RADAR_a8d15a86_Rx: ComBitPosition=56, ComBitSize=16, ComSignalType=UINT16, ComSystemTemplateSystemSignalRef=STS_USC_SECTION_COMPTBLITY_Rx
            STS_VIN_Status_Rx_oRDR_FUSION_STATUS_001_oPCAN_RADAR_5e829ab0_Rx: ComBitPosition=118, ComBitSize=2, ComSignalType=UINT8, ComSystemTemplateSystemSignalRef=STS_VIN_Status_Rx
        SG_GW_ADAS_FN_Enable_disable_sts_oGW_ADAS_FN_Enable_disable_sts_oPCAN_RADAR_9a8054b4_Rx: ComTimeout=0, ComSystemTemplateSignalGroupRef=SG_GW_ADAS_FN_Enable_disable_sts
          8 x ComGroupSignal, all with ComSignalEndianness=LITTLE_ENDIAN, ComSignalInitValue=0, ComSignalType=UINT8:
            AEBS_FN_Switch_sts_oGW_ADAS_FN_Enable_disable_sts_oPCAN_RADAR_319f3146_Rx: ComBitPosition=11, ComBitSize=3, ComSystemTemplateSystemSignalRef=AEBS_FN_Switch_sts
            BSIS_fn_Switch_Sts_oGW_ADAS_FN_Enable_disable_sts_oPCAN_RADAR_5e1d7109_Rx: ComBitPosition=3, ComBitSize=3, ComSystemTemplateSystemSignalRef=BSIS_fn_Switch_Sts
            DDAW_fn_switch_sts_oGW_ADAS_FN_Enable_disable_sts_oPCAN_RADAR_a583cbd8_Rx: ComBitPosition=8, ComBitSize=3, ComSystemTemplateSystemSignalRef=DDAW_fn_switch_sts
            DDAW_warning_suppression_oGW_ADAS_FN_Enable_disable_sts_oPCAN_RADAR_e90c956f_Rx: ComBitPosition=19, ComBitSize=2, ComSystemTemplateSystemSignalRef=DDAW_warning_suppression
            LDWS_FN_Switch_sts_oGW_ADAS_FN_Enable_disable_sts_oPCAN_RADAR_c735f110_Rx: ComBitPosition=16, ComBitSize=3, ComSystemTemplateSystemSignalRef=LDWS_FN_Switch_sts
            MOIS_Fn_Switch_sts_oGW_ADAS_FN_Enable_disable_sts_oPCAN_RADAR_37aa4c7c_Rx: ComBitPosition=0, ComBitSize=3, ComSystemTemplateSystemSignalRef=MOIS_Fn_Switch_sts
            MessageAliveCounter_oGW_ADAS_FN_Enable_disable_sts_oPCAN_RADAR_4999ad4b_Rx: ComBitPosition=52, ComBitSize=4, ComSystemTemplateSystemSignalRef=MessageAliveCounter
            MessageCRC_oGW_ADAS_FN_Enable_disable_sts_oPCAN_RADAR_705ba35b_Rx: ComBitPosition=56, ComBitSize=8, ComSystemTemplateSystemSignalRef=MessageCRC
        SG_GW_CCVS1_oGW_CCVS1_oPCAN_RADAR_70857376_Rx: ComTimeout=0, ComSystemTemplateSignalGroupRef=SG_GW_CCVS1
          3 x ComGroupSignal, all with ComSignalEndianness=LITTLE_ENDIAN, ComSignalInitValue=0:
            BrakeSwitch_oGW_CCVS1_oPCAN_RADAR_4705a3bc_Rx: ComBitPosition=28, ComBitSize=2, ComSignalType=UINT8, ComSystemTemplateSystemSignalRef=BrakeSwitch
            ParkingBrakeSwitch_oGW_CCVS1_oPCAN_RADAR_4cb3f824_Rx: ComBitPosition=2, ComBitSize=2, ComSignalType=UINT8, ComSystemTemplateSystemSignalRef=ParkingBrakeSwitch
            WheelBasedVehicleSpeed_oGW_CCVS1_oPCAN_RADAR_96f6cac9_Rx: ComBitPosition=8, ComBitSize=16, ComSignalType=UINT16, ComSystemTemplateSystemSignalRef=WheelBasedVehicleSpeed
        SG_GW_CLS_Tx_16_oGW_CLS_Tx_16_oPCAN_RADAR_ecf85999_Rx: ComTimeout=0, ComSystemTemplateSignalGroupRef=SG_GW_CLS_Tx_16
          Crawler_confi_status_info_oGW_CLS_Tx_16_oPCAN_RADAR_698927ba_Rx (ComGroupSignal):
            ComBitPosition = 40
            ComBitSize = 1
            ComSignalEndianness = LITTLE_ENDIAN
            ComSignalInitValue = 0
            ComSignalType = BOOLEAN
            ComSystemTemplateSystemSignalRef = Crawler_confi_status_info
          Transmission_type_info_oGW_CLS_Tx_16_oPCAN_RADAR_9dcf5c49_Rx (ComGroupSignal):
            ComBitPosition = 41
            ComBitSize = 3
            ComSignalEndianness = LITTLE_ENDIAN
            ComSignalInitValue = 0
            ComSignalType = UINT8
            ComSystemTemplateSystemSignalRef = Transmission_type_info
        SG_GW_CLS_Tx_4_oGW_CLS_Tx_4_oPCAN_RADAR_474ec459_Rx: ComTimeout=0, ComSystemTemplateSignalGroupRef=SG_GW_CLS_Tx_4
          Ignition_oGW_CLS_Tx_4_oPCAN_RADAR_6b7ac456_Rx (ComGroupSignal):
            ComBitPosition = 32
            ComBitSize = 2
            ComSignalEndianness = LITTLE_ENDIAN
            ComSignalInitValue = 0
            ComSignalType = UINT8
            ComSystemTemplateSystemSignalRef = Ignition
          ReverseSwitchInfo_oGW_CLS_Tx_4_oPCAN_RADAR_82207cae_Rx (ComGroupSignal):
            ComBitPosition = 28
            ComBitSize = 2
            ComSignalEndianness = LITTLE_ENDIAN
            ComSignalInitValue = 0
            ComSignalType = UINT8
            ComSystemTemplateSystemSignalRef = ReverseSwitchInfo
        SG_GW_ETC2_03_oGW_ETC2_03_oPCAN_RADAR_04d9a8d8_Rx: ComTimeout=0, ComSystemTemplateSignalGroupRef=SG_GW_ETC2_03
          TransCurrentGear_03_oGW_ETC2_03_oPCAN_RADAR_e4621163_Rx (ComGroupSignal):
            ComBitPosition = 24
            ComBitSize = 8
            ComSignalEndianness = LITTLE_ENDIAN
            ComSignalInitValue = 0
            ComSignalType = UINT8
            ComSystemTemplateSystemSignalRef = TransCurrentGear_03
        SG_GW_ETC2_oGW_ETC2_oPCAN_RADAR_d84ef27a_Rx: ComTimeout=0, ComSystemTemplateSignalGroupRef=SG_GW_ETC2
          TransCurrentGear_00_oGW_ETC2_oPCAN_RADAR_2bdb78e8_Rx (ComGroupSignal):
            ComBitPosition = 24
            ComBitSize = 8
            ComSignalEndianness = LITTLE_ENDIAN
            ComSignalInitValue = 0
            ComSignalType = UINT8
            ComSystemTemplateSystemSignalRef = TransCurrentGear_00
        SG_GW_OEL_oGW_OEL_oPCAN_RADAR_dcaa9b38_Rx: ComTimeout=0, ComSystemTemplateSignalGroupRef=SG_GW_OEL
          3 x ComGroupSignal, all with ComSignalEndianness=LITTLE_ENDIAN, ComSignalInitValue=0, ComSignalType=UINT8:
            HazardLightSwitch_oGW_OEL_oPCAN_RADAR_5efed0a6_Rx: ComBitPosition=12, ComBitSize=2, ComSystemTemplateSystemSignalRef=HazardLightSwitch
            HighLowBeamSwitch_oGW_OEL_oPCAN_RADAR_5e6caf50_Rx: ComBitPosition=14, ComBitSize=2, ComSystemTemplateSystemSignalRef=HighLowBeamSwitch
            TurnSignalSwitch_oGW_OEL_oPCAN_RADAR_ae279c7f_Rx: ComBitPosition=8, ComBitSize=4, ComSystemTemplateSystemSignalRef=TurnSignalSwitch
        SG_GW_SAS_oGW_SAS_oPCAN_RADAR_0d213b5c_Rx: ComTimeout=0, ComSystemTemplateSignalGroupRef=SG_GW_SAS
          8 x ComGroupSignal, all with ComSignalEndianness=LITTLE_ENDIAN, ComSignalInitValue=0:
            MessageChecksum_oGW_SAS_oPCAN_RADAR_87a8a844_Rx: ComBitPosition=60, ComBitSize=4, ComSignalType=UINT8, ComSystemTemplateSystemSignalRef=MessageChecksum
            MessageCounter_oGW_SAS_oPCAN_RADAR_f51168b6_Rx: ComBitPosition=56, ComBitSize=4, ComSignalType=UINT8, ComSystemTemplateSystemSignalRef=MessageCounter
            SteerAngleSensorActiveMode_oGW_SAS_oPCAN_RADAR_8c83afe6_Rx: ComBitPosition=48, ComBitSize=2, ComSignalType=UINT8, ComSystemTemplateSystemSignalRef=SteerAngleSensorActiveMode
            SteerAngleSensorCalibrated_oGW_SAS_oPCAN_RADAR_883db374_Rx: ComBitPosition=50, ComBitSize=2, ComSignalType=UINT8, ComSystemTemplateSystemSignalRef=SteerAngleSensorCalibrated
            SteerWheelAngleRangeCounterType_oGW_SAS_oPCAN_RADAR_30be95a7_Rx: ComBitPosition=22, ComBitSize=2, ComSignalType=UINT8, ComSystemTemplateSystemSignalRef=SteerWheelAngleRangeCounterType
            SteerWheelAngleRangeCounter_oGW_SAS_oPCAN_RADAR_e6274286_Rx: ComBitPosition=16, ComBitSize=6, ComSignalType=UINT8, ComSystemTemplateSystemSignalRef=SteerWheelAngleRangeCounter
            SteerWheelAngleRange_oGW_SAS_oPCAN_RADAR_fe08ddff_Rx: ComBitPosition=32, ComBitSize=16, ComSignalType=UINT16, ComSystemTemplateSystemSignalRef=SteerWheelAngleRange
            SteerWheelAngle_oGW_SAS_oPCAN_RADAR_a582dc0a_Rx: ComBitPosition=0, ComBitSize=16, ComSignalType=UINT16, ComSystemTemplateSystemSignalRef=SteerWheelAngle
        SG_GW_TD_oGW_TD_oPCAN_RADAR_a8a59c34_Rx: ComTimeout=0, ComSystemTemplateSignalGroupRef=SG_GW_TD
          8 x ComGroupSignal, all with ComBitSize=8, ComSignalEndianness=LITTLE_ENDIAN, ComSignalInitValue=0, ComSignalType=UINT8:
            Day_oGW_TD_oPCAN_RADAR_5e7337eb_Rx: ComBitPosition=32, ComSystemTemplateSystemSignalRef=Day
            Hours_oGW_TD_oPCAN_RADAR_70f4ea38_Rx: ComBitPosition=16, ComSystemTemplateSystemSignalRef=Hours
            LocalHourOffset_oGW_TD_oPCAN_RADAR_ed7302cc_Rx: ComBitPosition=48, ComSystemTemplateSystemSignalRef=LocalHourOffset
            LocalMinuteOffset_oGW_TD_oPCAN_RADAR_6576cfca_Rx: ComBitPosition=56, ComSystemTemplateSystemSignalRef=LocalMinuteOffset
            Minutes_oGW_TD_oPCAN_RADAR_f3505ea9_Rx: ComBitPosition=8, ComSystemTemplateSystemSignalRef=Minutes
            Month_oGW_TD_oPCAN_RADAR_9592e5da_Rx: ComBitPosition=24, ComSystemTemplateSystemSignalRef=Month
            Seconds_oGW_TD_oPCAN_RADAR_930edb8a_Rx: ComBitPosition=0, ComSystemTemplateSystemSignalRef=Seconds
            Year_oGW_TD_oPCAN_RADAR_0a7d8ada_Rx: ComBitPosition=40, ComSystemTemplateSystemSignalRef=Year
        SG_GW_VDC2_oGW_VDC2_oPCAN_RADAR_41520959_Rx: ComTimeout=0, ComSystemTemplateSignalGroupRef=SG_GW_VDC2
          4 x ComGroupSignal, all with ComSignalEndianness=LITTLE_ENDIAN, ComSignalInitValue=0:
            LateralAcceleration_oGW_VDC2_oPCAN_RADAR_d68a0cd8_Rx: ComBitPosition=40, ComBitSize=16, ComSignalType=UINT16, ComSystemTemplateSystemSignalRef=LateralAcceleration
            LongitudinalAcceleration_oGW_VDC2_oPCAN_RADAR_c0095fa4_Rx: ComBitPosition=56, ComBitSize=8, ComSignalType=UINT8, ComSystemTemplateSystemSignalRef=LongitudinalAcceleration
            SteerWheelAngle_oGW_VDC2_oPCAN_RADAR_4fddc2e4_Rx: ComBitPosition=0, ComBitSize=16, ComSignalType=UINT16, ComSystemTemplateSystemSignalRef=SteerWheelAngle
            YawRate_oGW_VDC2_oPCAN_RADAR_f47de610_Rx: ComBitPosition=24, ComBitSize=16, ComSignalType=UINT16, ComSystemTemplateSystemSignalRef=YawRate
        SG_GW_VD_oGW_VD_oPCAN_RADAR_ad0f59e4_Rx: ComTimeout=0, ComSystemTemplateSignalGroupRef=SG_GW_VD
          TotalVehicleDistance_oGW_VD_oPCAN_RADAR_55cc86c5_Rx (ComGroupSignal):
            ComBitPosition = 32
            ComBitSize = 32
            ComSignalEndianness = LITTLE_ENDIAN
            ComSignalInitValue = 0
            ComSignalType = UINT32
            ComSystemTemplateSystemSignalRef = TotalVehicleDistance
        SG_GW_VI_oGW_VI_oPCAN_RADAR_5c723f37_Rx: ComTimeout=0, ComSystemTemplateSignalGroupRef=SG_GW_VI
          VehicleIdentification_oGW_VI_oPCAN_RADAR_d901cf94_Rx (ComGroupSignal):
            ComBitPosition = 0
            ComBitSize = 8
            ComSignalEndianness = LITTLE_ENDIAN
            ComSignalInitValue = 0
            ComSignalType = UINT8
            ComSystemTemplateSystemSignalRef = VehicleIdentification
        SG_GW_prop_ADAS_BSIS_info_oGW_prop_ADAS_BSIS_info_oPCAN_RADAR_e9da8865_Tx: ComSystemTemplateSignalGroupRef=SG_GW_prop_ADAS_BSIS_info
          BlindSpotCollisionWarningLevel_oGW_prop_ADAS_BSIS_info_oPCAN_RADAR_787ec14f_Tx (ComGroupSignal):
            ComBitPosition = 4
            ComBitSize = 4
            ComSignalEndianness = LITTLE_ENDIAN
            ComSignalInitValue = 0
            ComSignalType = SINT8
            ComTransferProperty = PENDING
            ComSystemTemplateSystemSignalRef = BlindSpotCollisionWarningLevel
          BlindSpotDetectionState_oGW_prop_ADAS_BSIS_info_oPCAN_RADAR_c0a7d424_Tx (ComGroupSignal):
            ComBitPosition = 0
            ComBitSize = 4
            ComSignalEndianness = LITTLE_ENDIAN
            ComSignalInitValue = 0
            ComSignalType = SINT8
            ComTransferProperty = PENDING
            ComSystemTemplateSystemSignalRef = BlindSpotDetectionState
        SG_MOIS_oMOIS_oVCAN_RADAR_f9ec408e_Tx: ComSystemTemplateSignalGroupRef=SG_MOIS
          MOISCollisionWarningLevel_oMOIS_oVCAN_RADAR_c4480988_Tx (ComGroupSignal):
            ComBitPosition = 4
            ComBitSize = 4
            ComSignalEndianness = LITTLE_ENDIAN
            ComSignalInitValue = 0
            ComSignalType = UINT8
            ComTransferProperty = PENDING
            ComSystemTemplateSystemSignalRef = MOISCollisionWarningLevel
          MovingObjectDetectionState_oMOIS_oVCAN_RADAR_133b7455_Tx (ComGroupSignal):
            ComBitPosition = 0
            ComBitSize = 4
            ComSignalEndianness = LITTLE_ENDIAN
            ComSignalInitValue = 0
            ComSignalType = UINT8
            ComTransferProperty = PENDING
            ComSystemTemplateSystemSignalRef = MovingObjectDetectionState
        SG_OEL_oOEL_oVCAN_RADAR_400a2f4d_Rx: ComSystemTemplateSignalGroupRef=SG_OEL
          3 x ComGroupSignal, all with ComSignalEndianness=LITTLE_ENDIAN, ComSignalInitValue=0, ComSignalType=UINT8:
            HazardLightSwitch_oOEL_oVCAN_RADAR_6e3514e2_Rx: ComBitPosition=12, ComBitSize=2, ComSystemTemplateSystemSignalRef=HazardLightSwitch
            HighLowBeamSwitch_oOEL_oVCAN_RADAR_71269e88_Rx: ComBitPosition=14, ComBitSize=2, ComSystemTemplateSystemSignalRef=HighLowBeamSwitch
            TurnSignalSwitch_oOEL_oVCAN_RADAR_e6019fee_Rx: ComBitPosition=8, ComBitSize=4, ComSystemTemplateSystemSignalRef=TurnSignalSwitch
        SG_RDR_BSD1_Tx_oRDR_BSD1_Tx_oPCAN_RADAR_bd131ac1_Tx: ComSystemTemplateSignalGroupRef=SG_RDR_BSD1_Tx
          BlindSpotCollisionWarningLevel_Tx_oRDR_BSD1_Tx_oPCAN_RADAR_5d3220a5_Tx (ComGroupSignal):
            ComBitPosition = 4
            ComBitSize = 4
            ComSignalEndianness = LITTLE_ENDIAN
            ComSignalInitValue = 0
            ComSignalType = UINT8
            ComTransferProperty = PENDING
            ComSystemTemplateSystemSignalRef = BlindSpotCollisionWarningLevel_Tx
          BlindSpotDetectionState_Tx_oRDR_BSD1_Tx_oPCAN_RADAR_edbb925a_Tx (ComGroupSignal):
            ComBitPosition = 0
            ComBitSize = 4
            ComSignalEndianness = LITTLE_ENDIAN
            ComSignalInitValue = 0
            ComSignalType = UINT8
            ComTransferProperty = PENDING
            ComSystemTemplateSystemSignalRef = BlindSpotDetectionState_Tx
        SG_RadarCapability_oRDR_CAPABILITY_oPCAN_RADAR_be2920f1_Tx: ComSignalGroupArrayAccess=true, ComSystemTemplateSignalGroupRef=SG_RadarCapability
          31 x ComGroupSignal, all with ComSignalEndianness=LITTLE_ENDIAN, ComTransferProperty=PENDING:
            CAP_AngleAzimuthRangeEnd_oRDR_CAPABILITY_oPCAN_RADAR_a9c23dc6_Tx: ComBitPosition=99, ComBitSize=9, ComSignalInitValue=0, ComSignalType=SINT16, ComSystemTemplateSystemSignalRef=CAP_AngleAzimuthRangeEnd
            CAP_AngleAzimuthRangeStart_oRDR_CAPABILITY_oPCAN_RADAR_2a8ffbb4_Tx: ComBitPosition=90, ComBitSize=9, ComSignalInitValue=0, ComSignalType=SINT16, ComSystemTemplateSystemSignalRef=CAP_AngleAzimuthRangeStart
            CAP_BlockageActive_oRDR_CAPABILITY_oPCAN_RADAR_5433d84c_Tx: ComBitPosition=162, ComBitSize=1, ComSignalInitValue=1, ComSignalType=BOOLEAN, ComSystemTemplateSystemSignalRef=CAP_BlockageActive
            CAP_BlockageProbability_oRDR_CAPABILITY_oPCAN_RADAR_75a4bbd9_Tx: ComBitPosition=208, ComBitSize=7, ComSignalInitValue=0, ComSignalType=UINT8, ComSystemTemplateSystemSignalRef=CAP_BlockageProbability
            CAP_BlockageSensitivity_oRDR_CAPABILITY_oPCAN_RADAR_0362010f_Tx: ComBitPosition=200, ComBitSize=8, ComSignalInitValue=2, ComSignalType=UINT8, ComSystemTemplateSystemSignalRef=CAP_BlockageSensitivity
            CAP_BlockageStatus_oRDR_CAPABILITY_oPCAN_RADAR_03af1b08_Tx: ComBitPosition=163, ComBitSize=3, ComSignalInitValue=3, ComSignalType=UINT8, ComSystemTemplateSystemSignalRef=CAP_BlockageStatus
            CAP_BlockageValue_oRDR_CAPABILITY_oPCAN_RADAR_006198cd_Tx: ComBitPosition=184, ComBitSize=3, ComSignalInitValue=5, ComSignalType=UINT8, ComSystemTemplateSystemSignalRef=CAP_BlockageValue
            CAP_CYCLE_COUNTER_oRDR_CAPABILITY_oPCAN_RADAR_4f1d1582_Tx: ComBitPosition=16, ComBitSize=8, ComSignalInitValue=0, ComSignalType=UINT8, ComSystemTemplateSystemSignalRef=CAP_CYCLE_COUNTER
            CAP_DampingActive_oRDR_CAPABILITY_oPCAN_RADAR_e25d461d_Tx: ComBitPosition=215, ComBitSize=1, ComSignalInitValue=0, ComSignalType=BOOLEAN, ComSystemTemplateSystemSignalRef=CAP_DampingActive
            CAP_DampingCurrent_oRDR_CAPABILITY_oPCAN_RADAR_52c5af4f_Tx: ComBitPosition=32, ComBitSize=16, ComSignalInitValue=25500, ComSignalType=UINT16, ComSystemTemplateSystemSignalRef=CAP_DampingCurrent
            CAP_DampingStandardDeviation_oRDR_CAPABILITY_oPCAN_RADAR_e78ef0d8_Tx: ComBitPosition=48, ComBitSize=8, ComSignalInitValue=0, ComSignalType=UINT8, ComSystemTemplateSystemSignalRef=CAP_DampingStandardDeviation
            CAP_DampingStatus_oRDR_CAPABILITY_oPCAN_RADAR_b5c18559_Tx: ComBitPosition=187, ComBitSize=3, ComSignalInitValue=3, ComSignalType=UINT8, ComSystemTemplateSystemSignalRef=CAP_DampingStatus
            CAP_FreeSightCheckActive_oRDR_CAPABILITY_oPCAN_RADAR_703f26f7_Tx: ComBitPosition=176, ComBitSize=8, ComSignalInitValue=1, ComSignalType=UINT8, ComSystemTemplateSystemSignalRef=CAP_FreeSightCheckActive
            CAP_FreeSightCheckStatus_oRDR_CAPABILITY_oPCAN_RADAR_27a3e5b3_Tx: ComBitPosition=192, ComBitSize=8, ComSignalInitValue=255, ComSignalType=UINT8, ComSystemTemplateSystemSignalRef=CAP_FreeSightCheckStatus
            CAP_MH_CRC16_oRDR_CAPABILITY_oPCAN_RADAR_8ad8d6d0_Tx: ComBitPosition=0, ComBitSize=16, ComSignalInitValue=0, ComSignalType=UINT16, ComSystemTemplateSystemSignalRef=CAP_MH_CRC16
            CAP_MaxDetRangeMotorbike_0_oRDR_CAPABILITY_oPCAN_RADAR_5af73033_Tx: ComBitPosition=126, ComBitSize=9, ComSignalInitValue=0, ComSignalType=UINT16, ComSystemTemplateSystemSignalRef=CAP_MaxDetRangeMotorbike_0
            CAP_MaxDetRangeMotorbike_1_oRDR_CAPABILITY_oPCAN_RADAR_39f0e917_Tx: ComBitPosition=72, ComBitSize=9, ComSignalInitValue=0, ComSignalType=UINT16, ComSystemTemplateSystemSignalRef=CAP_MaxDetRangeMotorbike_1
            CAP_MaxDetRangeMotorbike_2_oRDR_CAPABILITY_oPCAN_RADAR_9cf8827b_Tx: ComBitPosition=144, ComBitSize=9, ComSignalInitValue=0, ComSignalType=UINT16, ComSystemTemplateSystemSignalRef=CAP_MaxDetRangeMotorbike_2
            CAP_MaxDetRangePedestrian_0_oRDR_CAPABILITY_oPCAN_RADAR_fd5aacf5_Tx: ComBitPosition=81, ComBitSize=9, ComSignalInitValue=0, ComSignalType=UINT16, ComSystemTemplateSystemSignalRef=CAP_MaxDetRangePedestrian_0
            CAP_MaxDetRangePedestrian_1_oRDR_CAPABILITY_oPCAN_RADAR_9e5d75d1_Tx: ComBitPosition=135, ComBitSize=9, ComSignalInitValue=0, ComSignalType=UINT16, ComSystemTemplateSystemSignalRef=CAP_MaxDetRangePedestrian_1
            CAP_MaxDetRangePedestrian_2_oRDR_CAPABILITY_oPCAN_RADAR_3b551ebd_Tx: ComBitPosition=153, ComBitSize=9, ComSignalInitValue=0, ComSignalType=UINT16, ComSystemTemplateSystemSignalRef=CAP_MaxDetRangePedestrian_2
            CAP_MaxDetectionRangeCar_0_oRDR_CAPABILITY_oPCAN_RADAR_8e9eb9bb_Tx: ComBitPosition=63, ComBitSize=9, ComSignalInitValue=0, ComSignalType=UINT16, ComSystemTemplateSystemSignalRef=CAP_MaxDetectionRangeCar_0
            CAP_MaxDetectionRangeCar_1_oRDR_CAPABILITY_oPCAN_RADAR_ed99609f_Tx: ComBitPosition=108, ComBitSize=9, ComSignalInitValue=0, ComSignalType=UINT16, ComSystemTemplateSystemSignalRef=CAP_MaxDetectionRangeCar_1
            CAP_MaxDetectionRangeCar_2_oRDR_CAPABILITY_oPCAN_RADAR_48910bf3_Tx: ComBitPosition=117, ComBitSize=9, ComSignalInitValue=0, ComSignalType=UINT16, ComSystemTemplateSystemSignalRef=CAP_MaxDetectionRangeCar_2
            CAP_RangeEstimationActive_oRDR_CAPABILITY_oPCAN_RADAR_e859e5af_Tx: ComBitPosition=31, ComBitSize=1, ComSignalInitValue=1, ComSignalType=BOOLEAN, ComSystemTemplateSystemSignalRef=CAP_RangeEstimationActive
            CAP_RangeEstimationStatus_oRDR_CAPABILITY_oPCAN_RADAR_bfc526eb_Tx: ComBitPosition=56, ComBitSize=3, ComSignalInitValue=3, ComSignalType=UINT8, ComSystemTemplateSystemSignalRef=CAP_RangeEstimationStatus
            CAP_SLBlockageFilterValue_oRDR_CAPABILITY_oPCAN_RADAR_f709e9f9_Tx: ComBitPosition=25, ComBitSize=6, ComSignalInitValue=0, ComSignalType=UINT8, ComSystemTemplateSystemSignalRef=CAP_SLBlockageFilterValue
            CAP_SLBlockageFlag_oRDR_CAPABILITY_oPCAN_RADAR_01507d8d_Tx: ComBitPosition=24, ComBitSize=1, ComSignalInitValue=0, ComSignalType=BOOLEAN, ComSystemTemplateSystemSignalRef=CAP_SLBlockageFlag
            CAP_SLLMonitoringActive_oRDR_CAPABILITY_oPCAN_RADAR_5e159aec_Tx: ComBitPosition=59, ComBitSize=1, ComSignalInitValue=1, ComSignalType=BOOLEAN, ComSystemTemplateSystemSignalRef=CAP_SLLMonitoringActive
            CAP_SLLMonitoringStatus_oRDR_CAPABILITY_oPCAN_RADAR_098959a8_Tx: ComBitPosition=60, ComBitSize=3, ComSignalInitValue=3, ComSignalType=UINT8, ComSystemTemplateSystemSignalRef=CAP_SLLMonitoringStatus
            CAP_SideLobeLevelBeamformer_oRDR_CAPABILITY_oPCAN_RADAR_df16d7f9_Tx: ComBitPosition=168, ComBitSize=8, ComSignalInitValue=0, ComSignalType=UINT8, ComSystemTemplateSystemSignalRef=CAP_SideLobeLevelBeamformer
        SG_RadarHeader_oRDR_HEADER_001_oPCAN_RADAR_48334d97_Tx: ComSignalGroupArrayAccess=true, ComSystemTemplateSignalGroupRef=SG_RadarHeader
          36 x ComGroupSignal, all with ComTransferProperty=PENDING:
            HED_ALIGN_HOR_REF_oRDR_HEADER_001_oPCAN_RADAR_1f2e61cb_Tx: ComBitPosition=184, ComBitSize=13, ComSignalEndianness=LITTLE_ENDIAN, ComSignalInitValue=0, ComSignalType=UINT16, ComSystemTemplateSystemSignalRef=HED_ALIGN_HOR_REF
            HED_ALIGN_VER_REF_oRDR_HEADER_001_oPCAN_RADAR_e021d36b_Tx: ComBitPosition=174, ComBitSize=10, ComSignalEndianness=LITTLE_ENDIAN, ComSignalInitValue=0, ComSignalType=UINT16, ComSystemTemplateSystemSignalRef=HED_ALIGN_VER_REF
            HED_Auth_CRC32_oRDR_HEADER_001_oPCAN_RADAR_fe7f3dd8_Tx: ComBitPosition=376, ComBitSize=32, ComSignalEndianness=LITTLE_ENDIAN, ComSignalInitValue=0, ComSignalType=UINT32, ComSystemTemplateSystemSignalRef=HED_Auth_CRC32
            HED_DATA_QUALIFIER_oRDR_HEADER_001_oPCAN_RADAR_df26d8e4_Tx: ComBitPosition=44, ComBitSize=3, ComSignalEndianness=LITTLE_ENDIAN, ComSignalInitValue=1, ComSignalType=UINT8, ComSystemTemplateSystemSignalRef=HED_DATA_QUALIFIER
            HED_DET_BI_STATIC_COUNT_oRDR_HEADER_001_oPCAN_RADAR_2c7e7841_Tx: ComBitPosition=288, ComBitSize=8, ComSignalEndianness=LITTLE_ENDIAN, ComSignalInitValue=0, ComSignalType=UINT8, ComSystemTemplateSystemSignalRef=HED_DET_BI_STATIC_COUNT
            HED_DET_NUM_OF_1PASS_oRDR_HEADER_001_oPCAN_RADAR_4c4276c1_Tx: ComBitPosition=296, ComBitSize=10, ComSignalEndianness=LITTLE_ENDIAN, ComSignalInitValue=0, ComSignalType=UINT16, ComSystemTemplateSystemSignalRef=HED_DET_NUM_OF_1PASS
            HED_DET_NUM_OF_2PASS_oRDR_HEADER_001_oPCAN_RADAR_1755c7d4_Tx: ComBitPosition=306, ComBitSize=9, ComSignalEndianness=LITTLE_ENDIAN, ComSignalInitValue=0, ComSignalType=UINT16, ComSystemTemplateSystemSignalRef=HED_DET_NUM_OF_2PASS
            HED_DET_RANGE_MAX_oRDR_HEADER_001_oPCAN_RADAR_a89abc54_Tx: ComBitPosition=64, ComBitSize=16, ComSignalEndianness=LITTLE_ENDIAN, ComSignalInitValue=0, ComSignalType=UINT16, ComSystemTemplateSystemSignalRef=HED_DET_RANGE_MAX
            HED_DET_RANGE_MIN_oRDR_HEADER_001_oPCAN_RADAR_8745ffc9_Tx: ComBitPosition=80, ComBitSize=16, ComSignalEndianness=LITTLE_ENDIAN, ComSignalInitValue=0, ComSignalType=UINT16, ComSystemTemplateSystemSignalRef=HED_DET_RANGE_MIN
            HED_DET_SPEED_RANGE_MAX_oRDR_HEADER_001_oPCAN_RADAR_d83b01a3_Tx: ComBitPosition=96, ComBitSize=16, ComSignalEndianness=LITTLE_ENDIAN, ComSignalInitValue=32768, ComSignalType=UINT16, ComSystemTemplateSystemSignalRef=HED_DET_SPEED_RANGE_MAX
            HED_DET_SPEED_RANGE_MIN_oRDR_HEADER_001_oPCAN_RADAR_f7e4423e_Tx: ComBitPosition=112, ComBitSize=16, ComSignalEndianness=LITTLE_ENDIAN, ComSignalInitValue=32768, ComSignalType=UINT16, ComSystemTemplateSystemSignalRef=HED_DET_SPEED_RANGE_MIN
            HED_FOV_HOR_MAX_oRDR_HEADER_001_oPCAN_RADAR_6b8d6a34_Tx: ComBitPosition=136, ComBitSize=8, ComSignalEndianness=LITTLE_ENDIAN, ComSignalInitValue=0, ComSignalType=UINT8, ComSystemTemplateSystemSignalRef=HED_FOV_HOR_MAX
            HED_FOV_HOR_MIN_oRDR_HEADER_001_oPCAN_RADAR_445229a9_Tx: ComBitPosition=128, ComBitSize=8, ComSignalEndianness=LITTLE_ENDIAN, ComSignalInitValue=128, ComSignalType=UINT8, ComSystemTemplateSystemSignalRef=HED_FOV_HOR_MIN
            HED_FOV_VER_MAX_oRDR_HEADER_001_oPCAN_RADAR_9482d894_Tx: ComBitPosition=152, ComBitSize=8, ComSignalEndianness=LITTLE_ENDIAN, ComSignalInitValue=0, ComSignalType=UINT8, ComSystemTemplateSystemSignalRef=HED_FOV_VER_MAX
            HED_FOV_VER_MIN_oRDR_HEADER_001_oPCAN_RADAR_bb5d9b09_Tx: ComBitPosition=144, ComBitSize=8, ComSignalEndianness=LITTLE_ENDIAN, ComSignalInitValue=0, ComSignalType=UINT8, ComSystemTemplateSystemSignalRef=HED_FOV_VER_MIN
            HED_LOOK_ID_oRDR_HEADER_001_oPCAN_RADAR_d5499e41_Tx: ComBitPosition=42, ComBitSize=2, ComSignalEndianness=LITTLE_ENDIAN, ComSignalInitValue=0, ComSignalType=UINT8, ComSystemTemplateSystemSignalRef=HED_LOOK_ID
            HED_LOOK_INDEX_oRDR_HEADER_001_oPCAN_RADAR_a9c5ac4d_Tx: ComBitPosition=208, ComBitSize=16, ComSignalEndianness=LITTLE_ENDIAN, ComSignalInitValue=0, ComSignalType=UINT16, ComSystemTemplateSystemSignalRef=HED_LOOK_INDEX
            HED_MAX_NUM_OF_DETECTIONS_oRDR_HEADER_001_oPCAN_RADAR_a13979cd_Tx: ComBitPosition=352, ComBitSize=9, ComSignalEndianness=LITTLE_ENDIAN, ComSignalInitValue=0, ComSignalType=UINT16, ComSystemTemplateSystemSignalRef=HED_MAX_NUM_OF_DETECTIONS
            HED_MH_CRC16_oRDR_HEADER_001_oPCAN_RADAR_c11c9aeb_Tx: ComBitPosition=0, ComBitSize=16, ComSignalEndianness=LITTLE_ENDIAN, ComSignalInitValue=0, ComSignalType=UINT16, ComSystemTemplateSystemSignalRef=HED_MH_CRC16
            HED_MH_CYCLE_COUNTER_oRDR_HEADER_001_oPCAN_RADAR_d6fb5718_Tx: ComBitPosition=16, ComBitSize=8, ComSignalEndianness=LITTLE_ENDIAN, ComSignalInitValue=0, ComSignalType=UINT8, ComSystemTemplateSystemSignalRef=HED_MH_CYCLE_COUNTER
            HED_NUM_OF_RESTBINS_USED_oRDR_HEADER_001_oPCAN_RADAR_accc4f32_Tx: ComBitPosition=24, ComBitSize=9, ComSignalEndianness=LITTLE_ENDIAN, ComSignalInitValue=0, ComSignalType=UINT16, ComSystemTemplateSystemSignalRef=HED_NUM_OF_RESTBINS_USED
            HED_NUM_OF_VALID_DETECTIONS_oRDR_HEADER_001_oPCAN_RADAR_561f5894_Tx: ComBitPosition=33, ComBitSize=9, ComSignalEndianness=LITTLE_ENDIAN, ComSignalInitValue=0, ComSignalType=UINT16, ComSystemTemplateSystemSignalRef=HED_NUM_OF_VALID_DETECTIONS
            HED_OPERATION_MODE_oRDR_HEADER_001_oPCAN_RADAR_5d181f82_Tx: ComBitPosition=315, ComBitSize=3, ComSignalEndianness=LITTLE_ENDIAN, ComSignalInitValue=0, ComSignalType=UINT8, ComSystemTemplateSystemSignalRef=HED_OPERATION_MODE
            HED_PROCESSED_RANGE_oRDR_HEADER_001_oPCAN_RADAR_d69f60f9_Tx: ComBitPosition=160, ComBitSize=9, ComSignalEndianness=LITTLE_ENDIAN, ComSignalInitValue=0, ComSignalType=UINT16, ComSystemTemplateSystemSignalRef=HED_PROCESSED_RANGE
            HED_RDR_HEADER_CMAC_oRDR_HEADER_001_oPCAN_RADAR_6d131f27_Tx: ComBitPosition=472, ComSignalEndianness=opaque, ComSignalInitValue=0 0 0 0 0, ComSignalLength=5, ComSignalType=UINT8_N, ComSystemTemplateSystemSignalRef=HED_RDR_HEADER_CMAC
            HED_RDR_HEADER_FV_oRDR_HEADER_001_oPCAN_RADAR_de313513_Tx: ComBitPosition=416, ComSignalEndianness=opaque, ComSignalInitValue=0 0 0 0 0 0 0, ComSignalLength=7, ComSignalType=UINT8_N, ComSystemTemplateSystemSignalRef=HED_RDR_HEADER_FV
            HED_R_WRAPPING_oRDR_HEADER_001_oPCAN_RADAR_58de80d3_Tx: ComBitPosition=368, ComBitSize=8, ComSignalEndianness=LITTLE_ENDIAN, ComSignalInitValue=90, ComSignalType=UINT8, ComSystemTemplateSystemSignalRef=HED_R_WRAPPING
            HED_Rain_Level_oRDR_HEADER_001_oPCAN_RADAR_7b3bcf0b_Tx: ComBitPosition=318, ComBitSize=2, ComSignalEndianness=LITTLE_ENDIAN, ComSignalInitValue=0, ComSignalType=UINT8, ComSystemTemplateSystemSignalRef=HED_Rain_Level
            HED_SCAN_INDEX_oRDR_HEADER_001_oPCAN_RADAR_f1dfa1e3_Tx: ComBitPosition=48, ComBitSize=16, ComSignalEndianness=LITTLE_ENDIAN, ComSignalInitValue=0, ComSignalType=UINT16, ComSystemTemplateSystemSignalRef=HED_SCAN_INDEX
            HED_SENSOR_TIME_STAMP_NS_oRDR_HEADER_001_oPCAN_RADAR_3b625701_Tx: ComBitPosition=224, ComBitSize=32, ComSignalEndianness=LITTLE_ENDIAN, ComSignalInitValue=0, ComSignalType=UINT32, ComSystemTemplateSystemSignalRef=HED_SENSOR_TIME_STAMP_NS
            HED_SENSOR_TIME_STAMP_SEC_oRDR_HEADER_001_oPCAN_RADAR_6281522c_Tx: ComBitPosition=256, ComBitSize=32, ComSignalEndianness=LITTLE_ENDIAN, ComSignalInitValue=0, ComSignalType=UINT32, ComSystemTemplateSystemSignalRef=HED_SENSOR_TIME_STAMP_SEC
            HED_SLOPE_CORR_EXECUTIONFLAG_oRDR_HEADER_001_oPCAN_RADAR_1dd90300_Tx: ComBitPosition=172, ComBitSize=2, ComSignalEndianness=LITTLE_ENDIAN, ComSignalInitValue=0, ComSignalType=UINT8, ComSystemTemplateSystemSignalRef=HED_SLOPE_CORR_EXECUTIONFLAG
            HED_TIME_SYNC_SRC_MASTER_oRDR_HEADER_001_oPCAN_RADAR_cf69d55e_Tx: ComBitPosition=169, ComBitSize=1, ComSignalEndianness=LITTLE_ENDIAN, ComSignalInitValue=0, ComSignalType=BOOLEAN, ComSystemTemplateSystemSignalRef=HED_TIME_SYNC_SRC_MASTER
            HED_TIME_SYNC_VALIDITY_FLAG_oRDR_HEADER_001_oPCAN_RADAR_e68b9aad_Tx: ComBitPosition=170, ComBitSize=2, ComSignalEndianness=LITTLE_ENDIAN, ComSignalInitValue=0, ComSignalType=UINT8, ComSystemTemplateSystemSignalRef=HED_TIME_SYNC_VALIDITY_FLAG
            HED_TRIGGER_TIME_oRDR_HEADER_001_oPCAN_RADAR_c994f046_Tx: ComBitPosition=320, ComBitSize=32, ComSignalEndianness=LITTLE_ENDIAN, ComSignalInitValue=0, ComSignalType=UINT32, ComSystemTemplateSystemSignalRef=HED_TRIGGER_TIME
            HED_V_WRAPPING_oRDR_HEADER_001_oPCAN_RADAR_036e7d98_Tx: ComBitPosition=197, ComBitSize=11, ComSignalEndianness=LITTLE_ENDIAN, ComSignalInitValue=0, ComSignalType=UINT16, ComSystemTemplateSystemSignalRef=HED_V_WRAPPING
        SG_RadarStatus1_oRDR_STATUS_001_oPCAN_RADAR_4935b1b8_Tx: ComSignalGroupArrayAccess=true, ComSystemTemplateSignalGroupRef=SG_RadarStatus1
          46 x ComGroupSignal, all with ComSignalEndianness=LITTLE_ENDIAN, ComTransferProperty=PENDING:
            STS_AF_TIME_INST_oRDR_STATUS_001_oPCAN_RADAR_0e5415de_Tx: ComBitPosition=424, ComBitSize=8, ComSignalInitValue=0, ComSignalType=UINT8, ComSystemTemplateSystemSignalRef=STS_AF_TIME_INST
            STS_AF_TIME_PEAK_oRDR_STATUS_001_oPCAN_RADAR_b78b8e3a_Tx: ComBitPosition=432, ComBitSize=8, ComSignalInitValue=0, ComSignalType=UINT8, ComSystemTemplateSystemSignalRef=STS_AF_TIME_PEAK
            STS_DET_DBC_BASE_VER_MAJOR_oRDR_STATUS_001_oPCAN_RADAR_63ce1143_Tx: ComBitPosition=376, ComBitSize=8, ComSignalInitValue=0, ComSignalType=UINT8, ComSystemTemplateSystemSignalRef=STS_DET_DBC_BASE_VER_MAJOR
            STS_DET_DBC_BASE_VER_MINOR_oRDR_STATUS_001_oPCAN_RADAR_bb458653_Tx: ComBitPosition=384, ComBitSize=8, ComSignalInitValue=0, ComSignalType=UINT8, ComSystemTemplateSystemSignalRef=STS_DET_DBC_BASE_VER_MINOR
            STS_DIST_FRNT_BMPR_TO_RR_AXL_oRDR_STATUS_001_oPCAN_RADAR_c8135b01_Tx: ComBitPosition=248, ComBitSize=13, ComSignalInitValue=0, ComSignalType=UINT16, ComSystemTemplateSystemSignalRef=STS_DIST_FRNT_BMPR_TO_RR_AXL
            STS_HARDWARE_VERSION_oRDR_STATUS_001_oPCAN_RADAR_2d912d77_Tx: ComBitPosition=112, ComBitSize=3, ComSignalInitValue=0, ComSignalType=UINT8, ComSystemTemplateSystemSignalRef=STS_HARDWARE_VERSION
            STS_MAIN_CORE_TIME_INST_oRDR_STATUS_001_oPCAN_RADAR_471c051a_Tx: ComBitPosition=440, ComBitSize=8, ComSignalInitValue=0, ComSignalType=UINT8, ComSystemTemplateSystemSignalRef=STS_MAIN_CORE_TIME_INST
            STS_MAIN_CORE_TIME_PEAK_oRDR_STATUS_001_oPCAN_RADAR_fec39efe_Tx: ComBitPosition=448, ComBitSize=8, ComSignalInitValue=0, ComSignalType=UINT8, ComSystemTemplateSystemSignalRef=STS_MAIN_CORE_TIME_PEAK
            STS_MH_001_CRC16_oRDR_STATUS_001_oPCAN_RADAR_0ffb3f46_Tx: ComBitPosition=0, ComBitSize=16, ComSignalInitValue=0, ComSignalType=UINT16, ComSystemTemplateSystemSignalRef=STS_MH_001_CRC16
            STS_MH_001_CYCLE_COUNTER_oRDR_STATUS_001_oPCAN_RADAR_50a8eb37_Tx: ComBitPosition=16, ComBitSize=8, ComSignalInitValue=0, ComSignalType=UINT8, ComSystemTemplateSystemSignalRef=STS_MH_001_CYCLE_COUNTER
            STS_PBL_VERSION_FIELD1_oRDR_STATUS_001_oPCAN_RADAR_41398822_Tx: ComBitPosition=200, ComBitSize=8, ComSignalInitValue=0, ComSignalType=UINT8, ComSystemTemplateSystemSignalRef=STS_PBL_VERSION_FIELD1
            STS_PBL_VERSION_FIELD2_oRDR_STATUS_001_oPCAN_RADAR_e431e34e_Tx: ComBitPosition=208, ComBitSize=8, ComSignalInitValue=0, ComSignalType=UINT8, ComSystemTemplateSystemSignalRef=STS_PBL_VERSION_FIELD2
            STS_PBL_VERSION_FIELD3_oRDR_STATUS_001_oPCAN_RADAR_87363a6a_Tx: ComBitPosition=216, ComBitSize=8, ComSignalInitValue=0, ComSignalType=UINT8, ComSystemTemplateSystemSignalRef=STS_PBL_VERSION_FIELD3
            STS_PBL_VERSION_FIELD4_oRDR_STATUS_001_oPCAN_RADAR_755033d7_Tx: ComBitPosition=224, ComBitSize=8, ComSignalInitValue=0, ComSignalType=UINT8, ComSystemTemplateSystemSignalRef=STS_PBL_VERSION_FIELD4
            STS_PCAN_PROTOCOL_VER_MAJOR_oRDR_STATUS_001_oPCAN_RADAR_1a19377a_Tx: ComBitPosition=120, ComBitSize=8, ComSignalInitValue=0, ComSignalType=UINT8, ComSystemTemplateSystemSignalRef=STS_PCAN_PROTOCOL_VER_MAJOR
            STS_PCAN_PROTOCOL_VER_MINOR_oRDR_STATUS_001_oPCAN_RADAR_c292a06a_Tx: ComBitPosition=128, ComBitSize=8, ComSignalInitValue=0, ComSignalType=UINT8, ComSystemTemplateSystemSignalRef=STS_PCAN_PROTOCOL_VER_MINOR
            STS_PLATFORM_VARIANT_oRDR_STATUS_001_oPCAN_RADAR_df303069_Tx: ComBitPosition=162, ComBitSize=5, ComSignalInitValue=0, ComSignalType=UINT8, ComSystemTemplateSystemSignalRef=STS_PLATFORM_VARIANT
            STS_RDD_CORE_TIME_INST_oRDR_STATUS_001_oPCAN_RADAR_38fa4a94_Tx: ComBitPosition=456, ComBitSize=8, ComSignalInitValue=0, ComSignalType=UINT8, ComSystemTemplateSystemSignalRef=STS_RDD_CORE_TIME_INST
            STS_RDD_CORE_TIME_PEAK_oRDR_STATUS_001_oPCAN_RADAR_8125d170_Tx: ComBitPosition=464, ComBitSize=8, ComSignalInitValue=0, ComSignalType=UINT8, ComSystemTemplateSystemSignalRef=STS_RDD_CORE_TIME_PEAK
            STS_SENSOR_HEIGHT_oRDR_STATUS_001_oPCAN_RADAR_d61d9b04_Tx: ComBitPosition=344, ComBitSize=32, ComSignalInitValue=0, ComSignalType=UINT32, ComSystemTemplateSystemSignalRef=STS_SENSOR_HEIGHT
            STS_SENSOR_MOUNT_ORNT_PITCH_oRDR_STATUS_001_oPCAN_RADAR_ce18ff05_Tx: ComBitPosition=264, ComBitSize=14, ComSignalInitValue=0, ComSignalType=SINT16, ComSystemTemplateSystemSignalRef=STS_SENSOR_MOUNT_ORNT_PITCH
            STS_SENSOR_MOUNT_ORNT_ROLL_oRDR_STATUS_001_oPCAN_RADAR_c9a4f171_Tx: ComBitPosition=280, ComBitSize=14, ComSignalInitValue=0, ComSignalType=UINT16, ComSystemTemplateSystemSignalRef=STS_SENSOR_MOUNT_ORNT_ROLL
            STS_SENSOR_MOUNT_ORNT_YAW_oRDR_STATUS_001_oPCAN_RADAR_4c33f1ef_Tx: ComBitPosition=232, ComBitSize=14, ComSignalInitValue=0, ComSignalType=SINT16, ComSystemTemplateSystemSignalRef=STS_SENSOR_MOUNT_ORNT_YAW
            STS_SENSOR_MOUNT_POS_X_oRDR_STATUS_001_oPCAN_RADAR_545dac38_Tx: ComBitPosition=296, ComBitSize=14, ComSignalInitValue=8192, ComSignalType=UINT16, ComSystemTemplateSystemSignalRef=STS_SENSOR_MOUNT_POS_X
            STS_SENSOR_MOUNT_POS_Y_oRDR_STATUS_001_oPCAN_RADAR_375a751c_Tx: ComBitPosition=312, ComBitSize=16, ComSignalInitValue=32768, ComSignalType=UINT16, ComSystemTemplateSystemSignalRef=STS_SENSOR_MOUNT_POS_Y
            STS_SENSOR_MOUNT_POS_Z_oRDR_STATUS_001_oPCAN_RADAR_92521e70_Tx: ComBitPosition=328, ComBitSize=16, ComSignalInitValue=32768, ComSignalType=UINT16, ComSystemTemplateSystemSignalRef=STS_SENSOR_MOUNT_POS_Z
            STS_SENSOR_POLARITY_oRDR_STATUS_001_oPCAN_RADAR_2123e19b_Tx: ComBitPosition=246, ComBitSize=1, ComSignalInitValue=0, ComSignalType=BOOLEAN, ComSystemTemplateSystemSignalRef=STS_SENSOR_POLARITY
            STS_SENSOR_POSITION_oRDR_STATUS_001_oPCAN_RADAR_5946d50e_Tx: ComBitPosition=115, ComBitSize=3, ComSignalInitValue=0, ComSignalType=UINT8, ComSystemTemplateSystemSignalRef=STS_SENSOR_POSITION
            STS_SERIAL_NUMBER_SEQUENCE_oRDR_STATUS_001_oPCAN_RADAR_c239676f_Tx: ComBitPosition=148, ComBitSize=14, ComSignalInitValue=1234, ComSignalType=UINT16, ComSystemTemplateSystemSignalRef=STS_SERIAL_NUMBER_SEQUENCE
            STS_SERIAL_NUM_JULIAN_DAY_oRDR_STATUS_001_oPCAN_RADAR_1b351b71_Tx: ComBitPosition=136, ComBitSize=9, ComSignalInitValue=365, ComSignalType=UINT16, ComSystemTemplateSystemSignalRef=STS_SERIAL_NUM_JULIAN_DAY
            STS_SERIAL_NUM_JULIAN_YEAR_oRDR_STATUS_001_oPCAN_RADAR_1d761a02_Tx: ComBitPosition=145, ComBitSize=3, ComSignalInitValue=0, ComSignalType=UINT8, ComSystemTemplateSystemSignalRef=STS_SERIAL_NUM_JULIAN_YEAR
            STS_SMC_CAL_VER_MAJOR_oRDR_STATUS_001_oPCAN_RADAR_e3a30457_Tx: ComBitPosition=72, ComBitSize=16, ComSignalInitValue=0, ComSignalType=UINT16, ComSystemTemplateSystemSignalRef=STS_SMC_CAL_VER_MAJOR
            STS_SMC_CAL_VER_MINOR_oRDR_STATUS_001_oPCAN_RADAR_3b289347_Tx: ComBitPosition=88, ComBitSize=16, ComSignalInitValue=0, ComSignalType=UINT16, ComSystemTemplateSystemSignalRef=STS_SMC_CAL_VER_MINOR
            STS_SMC_PLATFROM_VERSION_oRDR_STATUS_001_oPCAN_RADAR_4cdd916f_Tx: ComBitPosition=104, ComBitSize=8, ComSignalInitValue=0, ComSignalType=UINT8, ComSystemTemplateSystemSignalRef=STS_SMC_PLATFROM_VERSION
            STS_SMC_SECTION_COMPTBLITY_oRDR_STATUS_001_oPCAN_RADAR_735f172e_Tx: ComBitPosition=488, ComBitSize=16, ComSignalInitValue=0, ComSignalType=UINT16, ComSystemTemplateSystemSignalRef=STS_SMC_SECTION_COMPTBLITY
            STS_SP_CORE_TIME_INST_oRDR_STATUS_001_oPCAN_RADAR_9eae4180_Tx: ComBitPosition=480, ComBitSize=8, ComSignalInitValue=0, ComSignalType=UINT8, ComSystemTemplateSystemSignalRef=STS_SP_CORE_TIME_INST
            STS_SP_CORE_TIME_PEAK_oRDR_STATUS_001_oPCAN_RADAR_2771da64_Tx: ComBitPosition=472, ComBitSize=8, ComSignalInitValue=0, ComSignalType=UINT8, ComSystemTemplateSystemSignalRef=STS_SP_CORE_TIME_PEAK
            STS_SW_VERSION_FIELD1_oRDR_STATUS_001_oPCAN_RADAR_3b802545_Tx: ComBitPosition=168, ComBitSize=8, ComSignalInitValue=0, ComSignalType=UINT8, ComSystemTemplateSystemSignalRef=STS_SW_VERSION_FIELD1
            STS_SW_VERSION_FIELD2_oRDR_STATUS_001_oPCAN_RADAR_9e884e29_Tx: ComBitPosition=176, ComBitSize=8, ComSignalInitValue=0, ComSignalType=UINT8, ComSystemTemplateSystemSignalRef=STS_SW_VERSION_FIELD2
            STS_SW_VERSION_FIELD3_oRDR_STATUS_001_oPCAN_RADAR_fd8f970d_Tx: ComBitPosition=184, ComBitSize=8, ComSignalInitValue=0, ComSignalType=UINT8, ComSystemTemplateSystemSignalRef=STS_SW_VERSION_FIELD3
            STS_SW_VERSION_FIELD4_oRDR_STATUS_001_oPCAN_RADAR_0fe99eb0_Tx: ComBitPosition=192, ComBitSize=8, ComSignalInitValue=0, ComSignalType=UINT8, ComSystemTemplateSystemSignalRef=STS_SW_VERSION_FIELD4
            STS_TIME_SINCE_POWER_ON_oRDR_STATUS_001_oPCAN_RADAR_b1d9cbc7_Tx: ComBitPosition=392, ComBitSize=32, ComSignalInitValue=0, ComSignalType=UINT32, ComSystemTemplateSystemSignalRef=STS_TIME_SINCE_POWER_ON
            STS_USC_CAL_VER_MAJOR_oRDR_STATUS_001_oPCAN_RADAR_25e52183_Tx: ComBitPosition=24, ComBitSize=16, ComSignalInitValue=0, ComSignalType=UINT16, ComSystemTemplateSystemSignalRef=STS_USC_CAL_VER_MAJOR
            STS_USC_CAL_VER_MINOR_oRDR_STATUS_001_oPCAN_RADAR_fd6eb693_Tx: ComBitPosition=40, ComBitSize=16, ComSignalInitValue=0, ComSignalType=UINT16, ComSystemTemplateSystemSignalRef=STS_USC_CAL_VER_MINOR
            STS_USC_SECTION_COMPTBLITY_oRDR_STATUS_001_oPCAN_RADAR_71711001_Tx: ComBitPosition=56, ComBitSize=16, ComSignalInitValue=0, ComSignalType=UINT16, ComSystemTemplateSystemSignalRef=STS_USC_SECTION_COMPTBLITY
            STS_VIN_Status_oRDR_STATUS_001_oPCAN_RADAR_cde190ae_Tx: ComBitPosition=118, ComBitSize=2, ComSignalInitValue=0, ComSignalType=UINT8, ComSystemTemplateSystemSignalRef=STS_VIN_Status
        SG_RadarStatus2_oRDR_STATUS_002_oPCAN_RADAR_51f7b61a_Tx: ComSignalGroupArrayAccess=true, ComSystemTemplateSignalGroupRef=SG_RadarStatus2
          38 x ComGroupSignal, all with ComSignalEndianness=LITTLE_ENDIAN, ComSignalInitValue=0, ComTransferProperty=PENDING:
            STS_AF_CORE_THROUGHPUT_oRDR_STATUS_002_oPCAN_RADAR_176d9e73_Tx: ComBitPosition=128, ComBitSize=6, ComSignalType=UINT8, ComSystemTemplateSystemSignalRef=STS_AF_CORE_THROUGHPUT
            STS_BRR_STATUS_oRDR_STATUS_002_oPCAN_RADAR_b18213d9_Tx: ComBitPosition=41, ComBitSize=2, ComSignalType=UINT8, ComSystemTemplateSystemSignalRef=STS_BRR_STATUS
            STS_CAN_NM_State_oRDR_STATUS_002_oPCAN_RADAR_b965e775_Tx: ComBitPosition=64, ComBitSize=8, ComSignalType=UINT8, ComSystemTemplateSystemSignalRef=STS_CAN_NM_State
            STS_CORE_ACTV_FLT_BYTE_0_to_3_oRDR_STATUS_002_oPCAN_RADAR_4eff1249_Tx: ComBitPosition=192, ComBitSize=32, ComSignalType=UINT32, ComSystemTemplateSystemSignalRef=STS_CORE_ACTV_FLT_BYTE_0_to_3
            STS_CORE_ACTV_FLT_BYTE_11_to_15_oRDR_STATUS_002_oPCAN_RADAR_f8237490_Tx: ComBitPosition=256, ComBitSize=32, ComSignalType=UINT32, ComSystemTemplateSystemSignalRef=STS_CORE_ACTV_FLT_BYTE_11_to_15
            STS_CORE_ACTV_FLT_BYTE_4_to_7_oRDR_STATUS_002_oPCAN_RADAR_8b983440_Tx: ComBitPosition=96, ComBitSize=32, ComSignalType=UINT32, ComSystemTemplateSystemSignalRef=STS_CORE_ACTV_FLT_BYTE_4_to_7
            STS_CORE_ACTV_FLT_BYTE_8_to_11_oRDR_STATUS_002_oPCAN_RADAR_4e4fcb1f_Tx: ComBitPosition=224, ComBitSize=32, ComSignalType=UINT32, ComSystemTemplateSystemSignalRef=STS_CORE_ACTV_FLT_BYTE_8_to_11
            STS_First_CAN_Det_Inst_Latency_oRDR_STATUS_002_oPCAN_RADAR_1df78923_Tx: ComBitPosition=348, ComBitSize=12, ComSignalType=UINT16, ComSystemTemplateSystemSignalRef=STS_First_CAN_Det_Inst_Latency
            STS_Gear_Position_oRDR_STATUS_002_oPCAN_RADAR_7ad98da4_Tx: ComBitPosition=59, ComBitSize=4, ComSignalType=UINT8, ComSystemTemplateSystemSignalRef=STS_Gear_Position
            STS_INTRFC_VERSION_ID_MAJOR_oRDR_STATUS_002_oPCAN_RADAR_2dc9e305_Tx: ComBitPosition=376, ComBitSize=8, ComSignalType=UINT8, ComSystemTemplateSystemSignalRef=STS_INTRFC_VERSION_ID_MAJOR
            STS_INTRFC_VERSION_ID_MINOR_oRDR_STATUS_002_oPCAN_RADAR_f5427415_Tx: ComBitPosition=384, ComBitSize=8, ComSignalType=UINT8, ComSystemTemplateSystemSignalRef=STS_INTRFC_VERSION_ID_MINOR
            STS_INTRFC_VERSION_ID_PATCH_oRDR_STATUS_002_oPCAN_RADAR_ed2063e1_Tx: ComBitPosition=392, ComBitSize=8, ComSignalType=UINT8, ComSystemTemplateSystemSignalRef=STS_INTRFC_VERSION_ID_PATCH
            STS_Last_CAN_Det_Inst_Latency_oRDR_STATUS_002_oPCAN_RADAR_f3b34cfa_Tx: ComBitPosition=336, ComBitSize=12, ComSignalType=UINT16, ComSystemTemplateSystemSignalRef=STS_Last_CAN_Det_Inst_Latency
            STS_MCU_TEMP_oRDR_STATUS_002_oPCAN_RADAR_c6a456e4_Tx: ComBitPosition=88, ComBitSize=8, ComSignalType=UINT8, ComSystemTemplateSystemSignalRef=STS_MCU_TEMP
            STS_MH_002_CRC16_oRDR_STATUS_002_oPCAN_RADAR_39e26d91_Tx: ComBitPosition=0, ComBitSize=16, ComSignalType=UINT16, ComSystemTemplateSystemSignalRef=STS_MH_002_CRC16
            STS_MH_002_CYCLE_COUNTER_oRDR_STATUS_002_oPCAN_RADAR_24569cf4_Tx: ComBitPosition=16, ComBitSize=8, ComSignalType=UINT8, ComSystemTemplateSystemSignalRef=STS_MH_002_CYCLE_COUNTER
            STS_MMIC_RE_INIT_COUNT_oRDR_STATUS_002_oPCAN_RADAR_0f504994_Tx: ComBitPosition=44, ComBitSize=4, ComSignalType=UINT8, ComSystemTemplateSystemSignalRef=STS_MMIC_RE_INIT_COUNT
            STS_MMIC_TEMP_RX_oRDR_STATUS_002_oPCAN_RADAR_57120d5e_Tx: ComBitPosition=144, ComBitSize=8, ComSignalType=UINT8, ComSystemTemplateSystemSignalRef=STS_MMIC_TEMP_RX
            STS_MMIC_TEMP_TX0_oRDR_STATUS_002_oPCAN_RADAR_3a566f10_Tx: ComBitPosition=168, ComBitSize=8, ComSignalType=UINT8, ComSystemTemplateSystemSignalRef=STS_MMIC_TEMP_TX0
            STS_MMIC_TEMP_TX1_2_oRDR_STATUS_002_oPCAN_RADAR_b5a34e6a_Tx: ComBitPosition=72, ComBitSize=8, ComSignalType=UINT8, ComSystemTemplateSystemSignalRef=STS_MMIC_TEMP_TX1_2
            STS_MMIC_TEMP_TX3_4_oRDR_STATUS_002_oPCAN_RADAR_390d4f51_Tx: ComBitPosition=80, ComBitSize=8, ComSignalType=UINT8, ComSystemTemplateSystemSignalRef=STS_MMIC_TEMP_TX3_4
            STS_NO_TSYN_ERROR_oRDR_STATUS_002_oPCAN_RADAR_20da0af2_Tx: ComBitPosition=40, ComBitSize=1, ComSignalType=BOOLEAN, ComSystemTemplateSystemSignalRef=STS_NO_TSYN_ERROR
            STS_POINT_OF_TRIGGER_oRDR_STATUS_002_oPCAN_RADAR_4dfeaf3a_Tx: ComBitPosition=48, ComBitSize=10, ComSignalType=UINT16, ComSystemTemplateSystemSignalRef=STS_POINT_OF_TRIGGER
            STS_RAIN_COUNT_oRDR_STATUS_002_oPCAN_RADAR_27958738_Tx: ComBitPosition=360, ComBitSize=9, ComSignalType=UINT16, ComSystemTemplateSystemSignalRef=STS_RAIN_COUNT
            STS_RDD_CORE_THROUGHPUT_oRDR_STATUS_002_oPCAN_RADAR_2585d773_Tx: ComBitPosition=136, ComBitSize=6, ComSignalType=UINT8, ComSystemTemplateSystemSignalRef=STS_RDD_CORE_THROUGHPUT
            STS_SCAN_TYPE_oRDR_STATUS_002_oPCAN_RADAR_e74f40f7_Tx: ComBitPosition=58, ComBitSize=1, ComSignalType=BOOLEAN, ComSystemTemplateSystemSignalRef=STS_SCAN_TYPE
            STS_STEERING_ANGLE_SIGN_oRDR_STATUS_002_oPCAN_RADAR_d05788d3_Tx: ComBitPosition=176, ComBitSize=1, ComSignalType=BOOLEAN, ComSystemTemplateSystemSignalRef=STS_STEERING_ANGLE_SIGN
            STS_STEERING_ANGLE_oRDR_STATUS_002_oPCAN_RADAR_23b55571_Tx: ComBitPosition=32, ComBitSize=8, ComSignalType=UINT8, ComSystemTemplateSystemSignalRef=STS_STEERING_ANGLE
            STS_TIME_SYNC_OFFSET_oRDR_STATUS_002_oPCAN_RADAR_0c9d43da_Tx: ComBitPosition=152, ComBitSize=16, ComSignalType=SINT16, ComSystemTemplateSystemSignalRef=STS_TIME_SYNC_OFFSET
            STS_TKEY_ACTV_FLT_BYTE_0_to_3_oRDR_STATUS_002_oPCAN_RADAR_b6823a3b_Tx: ComBitPosition=288, ComBitSize=32, ComSignalType=UINT32, ComSystemTemplateSystemSignalRef=STS_TKEY_ACTV_FLT_BYTE_0_to_3
            STS_TKEY_ACTV_FLT_BYTE_4_to_5_oRDR_STATUS_002_oPCAN_RADAR_b5eaae7a_Tx: ComBitPosition=320, ComBitSize=16, ComSignalType=UINT16, ComSystemTemplateSystemSignalRef=STS_TKEY_ACTV_FLT_BYTE_4_to_5
            STS_VEHICLE_SPEED_CALC_oRDR_STATUS_002_oPCAN_RADAR_b07702fe_Tx: ComBitPosition=178, ComBitSize=14, ComSignalType=UINT16, ComSystemTemplateSystemSignalRef=STS_VEHICLE_SPEED_CALC
            STS_VEHICLE_SUPPLY_VOLTAGE_oRDR_STATUS_002_oPCAN_RADAR_2e0227b4_Tx: ComBitPosition=24, ComBitSize=4, ComSignalType=UINT8, ComSystemTemplateSystemSignalRef=STS_VEHICLE_SUPPLY_VOLTAGE
            STS_VEH_SPEED_DIRECTION_oRDR_STATUS_002_oPCAN_RADAR_ab672289_Tx: ComBitPosition=177, ComBitSize=1, ComSignalType=BOOLEAN, ComSystemTemplateSystemSignalRef=STS_VEH_SPEED_DIRECTION
            STS_Vehicle_Speed_Calc_QF_oRDR_STATUS_002_oPCAN_RADAR_18f9a51b_Tx: ComBitPosition=134, ComBitSize=2, ComSignalType=UINT8, ComSystemTemplateSystemSignalRef=STS_Vehicle_Speed_Calc_QF
            STS_XCVR_OPERATIONAL_oRDR_STATUS_002_oPCAN_RADAR_0ef02f62_Tx: ComBitPosition=43, ComBitSize=1, ComSignalType=BOOLEAN, ComSystemTemplateSystemSignalRef=STS_XCVR_OPERATIONAL
            STS_YAW_RATE_BIAS_oRDR_STATUS_002_oPCAN_RADAR_9d7c088d_Tx: ComBitPosition=28, ComBitSize=4, ComSignalType=UINT8, ComSystemTemplateSystemSignalRef=STS_YAW_RATE_BIAS
            STS_Yaw_Rate_Calc_QF_oRDR_STATUS_002_oPCAN_RADAR_cd68faf6_Tx: ComBitPosition=142, ComBitSize=2, ComSignalType=UINT8, ComSystemTemplateSystemSignalRef=STS_Yaw_Rate_Calc_QF
