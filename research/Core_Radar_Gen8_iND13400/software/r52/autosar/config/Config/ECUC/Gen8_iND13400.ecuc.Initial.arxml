[part 12 of 24: package /InitialEcuC]
AUTOSAR XML (schema 00053)
package /InitialEcuC  (continued)
  module config Com  (continued)
    ComConfig  (continued)
      242 x ComSignalGroup, all with ComTransferProperty=PENDING:  (continued)
        SG_Detections_285_288_oRDR_DETECTION_285_288_oPCAN_RADAR_fe0d65c7_Tx: ComSystemTemplateSignalGroupRef=SG_Detections_285_288
          83 x ComGroupSignal, all with ComSignalEndianness=LITTLE_ENDIAN, ComTransferProperty=PENDING:
            DET_AZIMUTH_285_oRDR_DETECTION_285_288_oPCAN_RADAR_f1835445_Tx: ComBitPosition=88, ComBitSize=13, ComSignalInitValue=0, ComSignalType=UINT16, ComSystemTemplateSystemSignalRef=DET_AZIMUTH_285
            DET_AZIMUTH_286_oRDR_DETECTION_285_288_oPCAN_RADAR_95632fbb_Tx: ComBitPosition=200, ComBitSize=13, ComSignalInitValue=0, ComSignalType=UINT16, ComSystemTemplateSystemSignalRef=DET_AZIMUTH_286
            DET_AZIMUTH_287_oRDR_DETECTION_285_288_oPCAN_RADAR_0013fb2e_Tx: ComBitPosition=312, ComBitSize=13, ComSignalInitValue=0, ComSignalType=UINT16, ComSystemTemplateSystemSignalRef=DET_AZIMUTH_287
            DET_AZIMUTH_288_oRDR_DETECTION_285_288_oPCAN_RADAR_2c036969_Tx: ComBitPosition=424, ComBitSize=13, ComSignalInitValue=0, ComSignalType=UINT16, ComSystemTemplateSystemSignalRef=DET_AZIMUTH_288
            DET_AZIMUTH_ERR_285_oRDR_DETECTION_285_288_oPCAN_RADAR_5536c1b0_Tx: ComBitPosition=105, ComBitSize=7, ComSignalInitValue=0, ComSignalType=UINT8, ComSystemTemplateSystemSignalRef=DET_AZIMUTH_ERR_285
            DET_AZIMUTH_ERR_286_oRDR_DETECTION_285_288_oPCAN_RADAR_31d6ba4e_Tx: ComBitPosition=217, ComBitSize=7, ComSignalInitValue=0, ComSignalType=UINT8, ComSystemTemplateSystemSignalRef=DET_AZIMUTH_ERR_286
            DET_AZIMUTH_ERR_287_oRDR_DETECTION_285_288_oPCAN_RADAR_a4a66edb_Tx: ComBitPosition=329, ComBitSize=7, ComSignalInitValue=0, ComSignalType=UINT8, ComSystemTemplateSystemSignalRef=DET_AZIMUTH_ERR_287
            DET_AZIMUTH_ERR_288_oRDR_DETECTION_285_288_oPCAN_RADAR_88b6fc9c_Tx: ComBitPosition=441, ComBitSize=7, ComSignalInitValue=0, ComSignalType=UINT8, ComSystemTemplateSystemSignalRef=DET_AZIMUTH_ERR_288
            DET_BELOW_RAIN_THOLD_285_oRDR_DETECTION_285_288_oPCAN_RADAR_2482c785_Tx: ComBitPosition=39, ComBitSize=1, ComSignalInitValue=0, ComSignalType=BOOLEAN, ComSystemTemplateSystemSignalRef=DET_BELOW_RAIN_THOLD_285
            DET_BELOW_RAIN_THOLD_286_oRDR_DETECTION_285_288_oPCAN_RADAR_4062bc7b_Tx: ComBitPosition=151, ComBitSize=1, ComSignalInitValue=0, ComSignalType=BOOLEAN, ComSystemTemplateSystemSignalRef=DET_BELOW_RAIN_THOLD_286
            DET_BELOW_RAIN_THOLD_287_oRDR_DETECTION_285_288_oPCAN_RADAR_d51268ee_Tx: ComBitPosition=263, ComBitSize=1, ComSignalInitValue=0, ComSignalType=BOOLEAN, ComSystemTemplateSystemSignalRef=DET_BELOW_RAIN_THOLD_287
            DET_BELOW_RAIN_THOLD_288_oRDR_DETECTION_285_288_oPCAN_RADAR_f902faa9_Tx: ComBitPosition=375, ComBitSize=1, ComSignalInitValue=0, ComSignalType=BOOLEAN, ComSystemTemplateSystemSignalRef=DET_BELOW_RAIN_THOLD_288
            DET_BI_STATIC_FLAG_285_oRDR_DETECTION_285_288_oPCAN_RADAR_a7af14c0_Tx: ComBitPosition=104, ComBitSize=1, ComSignalInitValue=0, ComSignalType=BOOLEAN, ComSystemTemplateSystemSignalRef=DET_BI_STATIC_FLAG_285
            DET_BI_STATIC_FLAG_286_oRDR_DETECTION_285_288_oPCAN_RADAR_c34f6f3e_Tx: ComBitPosition=216, ComBitSize=1, ComSignalInitValue=0, ComSignalType=BOOLEAN, ComSystemTemplateSystemSignalRef=DET_BI_STATIC_FLAG_286
            DET_BI_STATIC_FLAG_287_oRDR_DETECTION_285_288_oPCAN_RADAR_563fbbab_Tx: ComBitPosition=328, ComBitSize=1, ComSignalInitValue=0, ComSignalType=BOOLEAN, ComSystemTemplateSystemSignalRef=DET_BI_STATIC_FLAG_287
            DET_BI_STATIC_FLAG_288_oRDR_DETECTION_285_288_oPCAN_RADAR_7a2f29ec_Tx: ComBitPosition=440, ComBitSize=1, ComSignalInitValue=0, ComSignalType=BOOLEAN, ComSystemTemplateSystemSignalRef=DET_BI_STATIC_FLAG_288
            DET_CONFD_AZIMUTH_285_oRDR_DETECTION_285_288_oPCAN_RADAR_f3655e8f_Tx: ComBitPosition=118, ComBitSize=2, ComSignalInitValue=0, ComSignalType=UINT8, ComSystemTemplateSystemSignalRef=DET_CONFD_AZIMUTH_285
            DET_CONFD_AZIMUTH_286_oRDR_DETECTION_285_288_oPCAN_RADAR_97852571_Tx: ComBitPosition=230, ComBitSize=2, ComSignalInitValue=0, ComSignalType=UINT8, ComSystemTemplateSystemSignalRef=DET_CONFD_AZIMUTH_286
            DET_CONFD_AZIMUTH_287_oRDR_DETECTION_285_288_oPCAN_RADAR_02f5f1e4_Tx: ComBitPosition=342, ComBitSize=2, ComSignalInitValue=0, ComSignalType=UINT8, ComSystemTemplateSystemSignalRef=DET_CONFD_AZIMUTH_287
            DET_CONFD_AZIMUTH_288_oRDR_DETECTION_285_288_oPCAN_RADAR_2ee563a3_Tx: ComBitPosition=454, ComBitSize=2, ComSignalInitValue=0, ComSignalType=UINT8, ComSystemTemplateSystemSignalRef=DET_CONFD_AZIMUTH_288
            DET_CONFD_ELEVATION_285_oRDR_DETECTION_285_288_oPCAN_RADAR_f1f05f75_Tx: ComBitPosition=101, ComBitSize=2, ComSignalInitValue=0, ComSignalType=UINT8, ComSystemTemplateSystemSignalRef=DET_CONFD_ELEVATION_285
            DET_CONFD_ELEVATION_286_oRDR_DETECTION_285_288_oPCAN_RADAR_9510248b_Tx: ComBitPosition=213, ComBitSize=2, ComSignalInitValue=0, ComSignalType=UINT8, ComSystemTemplateSystemSignalRef=DET_CONFD_ELEVATION_286
            DET_CONFD_ELEVATION_287_oRDR_DETECTION_285_288_oPCAN_RADAR_0060f01e_Tx: ComBitPosition=325, ComBitSize=2, ComSignalInitValue=0, ComSignalType=UINT8, ComSystemTemplateSystemSignalRef=DET_CONFD_ELEVATION_287
            DET_CONFD_ELEVATION_288_oRDR_DETECTION_285_288_oPCAN_RADAR_2c706259_Tx: ComBitPosition=437, ComBitSize=2, ComSignalInitValue=0, ComSignalType=UINT8, ComSystemTemplateSystemSignalRef=DET_CONFD_ELEVATION_288
            DET_ELEVATION_285_oRDR_DETECTION_285_288_oPCAN_RADAR_20308b49_Tx: ComBitPosition=72, ComBitSize=8, ComSignalInitValue=0, ComSignalType=UINT8, ComSystemTemplateSystemSignalRef=DET_ELEVATION_285
            DET_ELEVATION_286_oRDR_DETECTION_285_288_oPCAN_RADAR_44d0f0b7_Tx: ComBitPosition=184, ComBitSize=8, ComSignalInitValue=0, ComSignalType=UINT8, ComSystemTemplateSystemSignalRef=DET_ELEVATION_286
            DET_ELEVATION_287_oRDR_DETECTION_285_288_oPCAN_RADAR_d1a02422_Tx: ComBitPosition=296, ComBitSize=8, ComSignalInitValue=0, ComSignalType=UINT8, ComSystemTemplateSystemSignalRef=DET_ELEVATION_287
            DET_ELEVATION_288_oRDR_DETECTION_285_288_oPCAN_RADAR_fdb0b665_Tx: ComBitPosition=408, ComBitSize=8, ComSignalInitValue=0, ComSignalType=UINT8, ComSystemTemplateSystemSignalRef=DET_ELEVATION_288
            DET_ELEVATION_ERR_285_oRDR_DETECTION_285_288_oPCAN_RADAR_a709133c_Tx: ComBitPosition=80, ComBitSize=6, ComSignalInitValue=0, ComSignalType=UINT8, ComSystemTemplateSystemSignalRef=DET_ELEVATION_ERR_285
            DET_ELEVATION_ERR_286_oRDR_DETECTION_285_288_oPCAN_RADAR_c3e968c2_Tx: ComBitPosition=192, ComBitSize=6, ComSignalInitValue=0, ComSignalType=UINT8, ComSystemTemplateSystemSignalRef=DET_ELEVATION_ERR_286
            DET_ELEVATION_ERR_287_oRDR_DETECTION_285_288_oPCAN_RADAR_5699bc57_Tx: ComBitPosition=304, ComBitSize=6, ComSignalInitValue=0, ComSignalType=UINT8, ComSystemTemplateSystemSignalRef=DET_ELEVATION_ERR_287
            DET_ELEVATION_ERR_288_oRDR_DETECTION_285_288_oPCAN_RADAR_7a892e10_Tx: ComBitPosition=416, ComBitSize=6, ComSignalInitValue=0, ComSignalType=UINT8, ComSystemTemplateSystemSignalRef=DET_ELEVATION_ERR_288
            DET_EXISTENCE_PROB_285_oRDR_DETECTION_285_288_oPCAN_RADAR_7596665c_Tx: ComBitPosition=112, ComBitSize=6, ComSignalInitValue=0, ComSignalType=UINT8, ComSystemTemplateSystemSignalRef=DET_EXISTENCE_PROB_285
            DET_EXISTENCE_PROB_286_oRDR_DETECTION_285_288_oPCAN_RADAR_11761da2_Tx: ComBitPosition=224, ComBitSize=6, ComSignalInitValue=0, ComSignalType=UINT8, ComSystemTemplateSystemSignalRef=DET_EXISTENCE_PROB_286
            DET_EXISTENCE_PROB_287_oRDR_DETECTION_285_288_oPCAN_RADAR_8406c937_Tx: ComBitPosition=336, ComBitSize=6, ComSignalInitValue=0, ComSignalType=UINT8, ComSystemTemplateSystemSignalRef=DET_EXISTENCE_PROB_287
            DET_EXISTENCE_PROB_288_oRDR_DETECTION_285_288_oPCAN_RADAR_a8165b70_Tx: ComBitPosition=448, ComBitSize=6, ComSignalInitValue=0, ComSignalType=UINT8, ComSystemTemplateSystemSignalRef=DET_EXISTENCE_PROB_288
            DET_HVC_FLAG_285_oRDR_DETECTION_285_288_oPCAN_RADAR_94e22523_Tx: ComBitPosition=86, ComBitSize=1, ComSignalInitValue=0, ComSignalType=BOOLEAN, ComSystemTemplateSystemSignalRef=DET_HVC_FLAG_285
            DET_HVC_FLAG_286_oRDR_DETECTION_285_288_oPCAN_RADAR_f0025edd_Tx: ComBitPosition=198, ComBitSize=1, ComSignalInitValue=0, ComSignalType=BOOLEAN, ComSystemTemplateSystemSignalRef=DET_HVC_FLAG_286
            DET_HVC_FLAG_287_oRDR_DETECTION_285_288_oPCAN_RADAR_65728a48_Tx: ComBitPosition=310, ComBitSize=1, ComSignalInitValue=0, ComSignalType=BOOLEAN, ComSystemTemplateSystemSignalRef=DET_HVC_FLAG_287
            DET_HVC_FLAG_288_oRDR_DETECTION_285_288_oPCAN_RADAR_4962180f_Tx: ComBitPosition=422, ComBitSize=1, ComSignalInitValue=0, ComSignalType=BOOLEAN, ComSystemTemplateSystemSignalRef=DET_HVC_FLAG_288
            DET_IDM_285_oRDR_DETECTION_285_288_oPCAN_RADAR_1fb01e9e_Tx: ComBitPosition=63, ComBitSize=1, ComSignalInitValue=0, ComSignalType=BOOLEAN, ComSystemTemplateSystemSignalRef=DET_IDM_285
            DET_IDM_286_oRDR_DETECTION_285_288_oPCAN_RADAR_7b506560_Tx: ComBitPosition=175, ComBitSize=1, ComSignalInitValue=0, ComSignalType=BOOLEAN, ComSystemTemplateSystemSignalRef=DET_IDM_286
            DET_IDM_287_oRDR_DETECTION_285_288_oPCAN_RADAR_ee20b1f5_Tx: ComBitPosition=287, ComBitSize=1, ComSignalInitValue=0, ComSignalType=BOOLEAN, ComSystemTemplateSystemSignalRef=DET_IDM_287
            DET_IDM_288_oRDR_DETECTION_285_288_oPCAN_RADAR_c23023b2_Tx: ComBitPosition=399, ComBitSize=1, ComSignalInitValue=0, ComSignalType=BOOLEAN, ComSystemTemplateSystemSignalRef=DET_IDM_288
            DET_MH_CRC16_285_288_oRDR_DETECTION_285_288_oPCAN_RADAR_7a85b7cc_Tx: ComBitPosition=0, ComBitSize=16, ComSignalInitValue=0, ComSignalType=UINT16, ComSystemTemplateSystemSignalRef=DET_MH_CRC16_285_288
            DET_MH_CYCLE_COUNTER_285_288_oRDR_DETECTION_285_288_oPCAN_RADAR_fef016fb_Tx: ComBitPosition=16, ComBitSize=8, ComSignalInitValue=0, ComSignalType=UINT8, ComSystemTemplateSystemSignalRef=DET_MH_CYCLE_COUNTER_285_288
            DET_MH_SCAN_INDEX_4LSB_285_288_oRDR_DETECTION_285_288_oPCAN_RADAR_32da3377_Tx: ComBitPosition=476, ComBitSize=4, ComSignalInitValue=0, ComSignalType=UINT8, ComSystemTemplateSystemSignalRef=DET_MH_SCAN_INDEX_4LSB_285_288
            DET_MTD_285_oRDR_DETECTION_285_288_oPCAN_RADAR_79032c45_Tx: ComBitPosition=47, ComBitSize=1, ComSignalInitValue=0, ComSignalType=BOOLEAN, ComSystemTemplateSystemSignalRef=DET_MTD_285
            DET_MTD_286_oRDR_DETECTION_285_288_oPCAN_RADAR_1de357bb_Tx: ComBitPosition=159, ComBitSize=1, ComSignalInitValue=0, ComSignalType=BOOLEAN, ComSystemTemplateSystemSignalRef=DET_MTD_286
            DET_MTD_287_oRDR_DETECTION_285_288_oPCAN_RADAR_8893832e_Tx: ComBitPosition=271, ComBitSize=1, ComSignalInitValue=0, ComSignalType=BOOLEAN, ComSystemTemplateSystemSignalRef=DET_MTD_287
            DET_MTD_288_oRDR_DETECTION_285_288_oPCAN_RADAR_a4831169_Tx: ComBitPosition=383, ComBitSize=1, ComSignalInitValue=0, ComSignalType=BOOLEAN, ComSystemTemplateSystemSignalRef=DET_MTD_288
            DET_PROB_1STAZHYPO_285_oRDR_DETECTION_285_288_oPCAN_RADAR_eab7c488_Tx: ComBitPosition=103, ComBitSize=1, ComSignalInitValue=0, ComSignalType=BOOLEAN, ComSystemTemplateSystemSignalRef=DET_PROB_1STAZHYPO_285
            DET_PROB_1STAZHYPO_286_oRDR_DETECTION_285_288_oPCAN_RADAR_8e57bf76_Tx: ComBitPosition=215, ComBitSize=1, ComSignalInitValue=0, ComSignalType=BOOLEAN, ComSystemTemplateSystemSignalRef=DET_PROB_1STAZHYPO_286
            DET_PROB_1STAZHYPO_287_oRDR_DETECTION_285_288_oPCAN_RADAR_1b276be3_Tx: ComBitPosition=327, ComBitSize=1, ComSignalInitValue=0, ComSignalType=BOOLEAN, ComSystemTemplateSystemSignalRef=DET_PROB_1STAZHYPO_287
            DET_PROB_1STAZHYPO_288_oRDR_DETECTION_285_288_oPCAN_RADAR_3737f9a4_Tx: ComBitPosition=439, ComBitSize=1, ComSignalInitValue=0, ComSignalType=BOOLEAN, ComSystemTemplateSystemSignalRef=DET_PROB_1STAZHYPO_288
            DET_RANGE_285_oRDR_DETECTION_285_288_oPCAN_RADAR_e11827fe_Tx: ComBitPosition=24, ComBitSize=15, ComSignalInitValue=0, ComSignalType=UINT16, ComSystemTemplateSystemSignalRef=DET_RANGE_285
            DET_RANGE_286_oRDR_DETECTION_285_288_oPCAN_RADAR_85f85c00_Tx: ComBitPosition=136, ComBitSize=15, ComSignalInitValue=0, ComSignalType=UINT16, ComSystemTemplateSystemSignalRef=DET_RANGE_286
            DET_RANGE_287_oRDR_DETECTION_285_288_oPCAN_RADAR_10888895_Tx: ComBitPosition=248, ComBitSize=15, ComSignalInitValue=0, ComSignalType=UINT16, ComSystemTemplateSystemSignalRef=DET_RANGE_287
            DET_RANGE_288_oRDR_DETECTION_285_288_oPCAN_RADAR_3c981ad2_Tx: ComBitPosition=360, ComBitSize=15, ComSignalInitValue=0, ComSignalType=UINT16, ComSystemTemplateSystemSignalRef=DET_RANGE_288
            DET_RANGE_ERR_285_oRDR_DETECTION_285_288_oPCAN_RADAR_46f09d97_Tx: ComBitPosition=40, ComBitSize=7, ComSignalInitValue=0, ComSignalType=UINT8, ComSystemTemplateSystemSignalRef=DET_RANGE_ERR_285
            DET_RANGE_ERR_286_oRDR_DETECTION_285_288_oPCAN_RADAR_2210e669_Tx: ComBitPosition=152, ComBitSize=7, ComSignalInitValue=0, ComSignalType=UINT8, ComSystemTemplateSystemSignalRef=DET_RANGE_ERR_286
            DET_RANGE_ERR_287_oRDR_DETECTION_285_288_oPCAN_RADAR_b76032fc_Tx: ComBitPosition=264, ComBitSize=7, ComSignalInitValue=0, ComSignalType=UINT8, ComSystemTemplateSystemSignalRef=DET_RANGE_ERR_287
            DET_RANGE_ERR_288_oRDR_DETECTION_285_288_oPCAN_RADAR_9b70a0bb_Tx: ComBitPosition=376, ComBitSize=7, ComSignalInitValue=0, ComSignalType=UINT8, ComSystemTemplateSystemSignalRef=DET_RANGE_ERR_288
            DET_RANGE_VELOCITY_285_oRDR_DETECTION_285_288_oPCAN_RADAR_94bee5db_Tx: ComBitPosition=48, ComBitSize=15, ComSignalInitValue=16384, ComSignalType=UINT16, ComSystemTemplateSystemSignalRef=DET_RANGE_VELOCITY_285
            DET_RANGE_VELOCITY_286_oRDR_DETECTION_285_288_oPCAN_RADAR_f05e9e25_Tx: ComBitPosition=160, ComBitSize=15, ComSignalInitValue=16384, ComSignalType=UINT16, ComSystemTemplateSystemSignalRef=DET_RANGE_VELOCITY_286
            DET_RANGE_VELOCITY_287_oRDR_DETECTION_285_288_oPCAN_RADAR_652e4ab0_Tx: ComBitPosition=272, ComBitSize=15, ComSignalInitValue=16384, ComSignalType=UINT16, ComSystemTemplateSystemSignalRef=DET_RANGE_VELOCITY_287
            DET_RANGE_VELOCITY_288_oRDR_DETECTION_285_288_oPCAN_RADAR_493ed8f7_Tx: ComBitPosition=384, ComBitSize=15, ComSignalInitValue=16384, ComSignalType=UINT16, ComSystemTemplateSystemSignalRef=DET_RANGE_VELOCITY_288
            DET_RANGE_VELOCITY_ERR_285_oRDR_DETECTION_285_288_oPCAN_RADAR_9b051e69_Tx: ComBitPosition=64, ComBitSize=8, ComSignalInitValue=0, ComSignalType=UINT8, ComSystemTemplateSystemSignalRef=DET_RANGE_VELOCITY_ERR_285
            DET_RANGE_VELOCITY_ERR_286_oRDR_DETECTION_285_288_oPCAN_RADAR_ffe56597_Tx: ComBitPosition=176, ComBitSize=8, ComSignalInitValue=0, ComSignalType=UINT8, ComSystemTemplateSystemSignalRef=DET_RANGE_VELOCITY_ERR_286
            DET_RANGE_VELOCITY_ERR_287_oRDR_DETECTION_285_288_oPCAN_RADAR_6a95b102_Tx: ComBitPosition=288, ComBitSize=8, ComSignalInitValue=0, ComSignalType=UINT8, ComSystemTemplateSystemSignalRef=DET_RANGE_VELOCITY_ERR_287
            DET_RANGE_VELOCITY_ERR_288_oRDR_DETECTION_285_288_oPCAN_RADAR_46852345_Tx: ComBitPosition=400, ComBitSize=8, ComSignalInitValue=0, ComSignalType=UINT8, ComSystemTemplateSystemSignalRef=DET_RANGE_VELOCITY_ERR_288
            DET_RCS_285_oRDR_DETECTION_285_288_oPCAN_RADAR_133ed281_Tx: ComBitPosition=128, ComBitSize=8, ComSignalInitValue=128, ComSignalType=UINT8, ComSystemTemplateSystemSignalRef=DET_RCS_285
            DET_RCS_286_oRDR_DETECTION_285_288_oPCAN_RADAR_77dea97f_Tx: ComBitPosition=240, ComBitSize=8, ComSignalInitValue=128, ComSignalType=UINT8, ComSystemTemplateSystemSignalRef=DET_RCS_286
            DET_RCS_287_oRDR_DETECTION_285_288_oPCAN_RADAR_e2ae7dea_Tx: ComBitPosition=352, ComBitSize=8, ComSignalInitValue=128, ComSignalType=UINT8, ComSystemTemplateSystemSignalRef=DET_RCS_287
            DET_RCS_288_oRDR_DETECTION_285_288_oPCAN_RADAR_cebeefad_Tx: ComBitPosition=464, ComBitSize=8, ComSignalInitValue=128, ComSignalType=UINT8, ComSystemTemplateSystemSignalRef=DET_RCS_288
            DET_SNR_285_oRDR_DETECTION_285_288_oPCAN_RADAR_ce908683_Tx: ComBitPosition=120, ComBitSize=8, ComSignalInitValue=0, ComSignalType=UINT8, ComSystemTemplateSystemSignalRef=DET_SNR_285
            DET_SNR_286_oRDR_DETECTION_285_288_oPCAN_RADAR_aa70fd7d_Tx: ComBitPosition=232, ComBitSize=8, ComSignalInitValue=0, ComSignalType=UINT8, ComSystemTemplateSystemSignalRef=DET_SNR_286
            DET_SNR_287_oRDR_DETECTION_285_288_oPCAN_RADAR_3f0029e8_Tx: ComBitPosition=344, ComBitSize=8, ComSignalInitValue=0, ComSignalType=UINT8, ComSystemTemplateSystemSignalRef=DET_SNR_287
            DET_SNR_288_oRDR_DETECTION_285_288_oPCAN_RADAR_1310bbaf_Tx: ComBitPosition=456, ComBitSize=8, ComSignalInitValue=0, ComSignalType=UINT8, ComSystemTemplateSystemSignalRef=DET_SNR_288
            DET_SUPER_RES_TARGET_285_oRDR_DETECTION_285_288_oPCAN_RADAR_ff09aee6_Tx: ComBitPosition=87, ComBitSize=1, ComSignalInitValue=0, ComSignalType=BOOLEAN, ComSystemTemplateSystemSignalRef=DET_SUPER_RES_TARGET_285
            DET_SUPER_RES_TARGET_286_oRDR_DETECTION_285_288_oPCAN_RADAR_9be9d518_Tx: ComBitPosition=199, ComBitSize=1, ComSignalInitValue=0, ComSignalType=BOOLEAN, ComSystemTemplateSystemSignalRef=DET_SUPER_RES_TARGET_286
            DET_SUPER_RES_TARGET_287_oRDR_DETECTION_285_288_oPCAN_RADAR_0e99018d_Tx: ComBitPosition=311, ComBitSize=1, ComSignalInitValue=0, ComSignalType=BOOLEAN, ComSystemTemplateSystemSignalRef=DET_SUPER_RES_TARGET_287
            DET_SUPER_RES_TARGET_288_oRDR_DETECTION_285_288_oPCAN_RADAR_228993ca_Tx: ComBitPosition=423, ComBitSize=1, ComSignalInitValue=0, ComSignalType=BOOLEAN, ComSystemTemplateSystemSignalRef=DET_SUPER_RES_TARGET_288
        SG_Detections_289_292_oRDR_DETECTION_289_292_oPCAN_RADAR_677741bc_Tx: ComSystemTemplateSignalGroupRef=SG_Detections_289_292
          83 x ComGroupSignal, all with ComSignalEndianness=LITTLE_ENDIAN, ComTransferProperty=PENDING:
            DET_AZIMUTH_289_oRDR_DETECTION_289_292_oPCAN_RADAR_8b3b52fd_Tx: ComBitPosition=88, ComBitSize=13, ComSignalInitValue=0, ComSignalType=UINT16, ComSystemTemplateSystemSignalRef=DET_AZIMUTH_289
            DET_AZIMUTH_290_oRDR_DETECTION_289_292_oPCAN_RADAR_ee1b2059_Tx: ComBitPosition=200, ComBitSize=13, ComSignalInitValue=0, ComSignalType=UINT16, ComSystemTemplateSystemSignalRef=DET_AZIMUTH_290
            DET_AZIMUTH_291_oRDR_DETECTION_289_292_oPCAN_RADAR_7b6bf4cc_Tx: ComBitPosition=312, ComBitSize=13, ComSignalInitValue=0, ComSignalType=UINT16, ComSystemTemplateSystemSignalRef=DET_AZIMUTH_291
            DET_AZIMUTH_292_oRDR_DETECTION_289_292_oPCAN_RADAR_1f8b8f32_Tx: ComBitPosition=424, ComBitSize=13, ComSignalInitValue=0, ComSignalType=UINT16, ComSystemTemplateSystemSignalRef=DET_AZIMUTH_292
            DET_AZIMUTH_ERR_289_oRDR_DETECTION_289_292_oPCAN_RADAR_2f8ec708_Tx: ComBitPosition=105, ComBitSize=7, ComSignalInitValue=0, ComSignalType=UINT8, ComSystemTemplateSystemSignalRef=DET_AZIMUTH_ERR_289
            DET_AZIMUTH_ERR_290_oRDR_DETECTION_289_292_oPCAN_RADAR_4aaeb5ac_Tx: ComBitPosition=217, ComBitSize=7, ComSignalInitValue=0, ComSignalType=UINT8, ComSystemTemplateSystemSignalRef=DET_AZIMUTH_ERR_290
            DET_AZIMUTH_ERR_291_oRDR_DETECTION_289_292_oPCAN_RADAR_dfde6139_Tx: ComBitPosition=329, ComBitSize=7, ComSignalInitValue=0, ComSignalType=UINT8, ComSystemTemplateSystemSignalRef=DET_AZIMUTH_ERR_291
            DET_AZIMUTH_ERR_292_oRDR_DETECTION_289_292_oPCAN_RADAR_bb3e1ac7_Tx: ComBitPosition=441, ComBitSize=7, ComSignalInitValue=0, ComSignalType=UINT8, ComSystemTemplateSystemSignalRef=DET_AZIMUTH_ERR_292
            DET_BELOW_RAIN_THOLD_289_oRDR_DETECTION_289_292_oPCAN_RADAR_5e3ac13d_Tx: ComBitPosition=39, ComBitSize=1, ComSignalInitValue=0, ComSignalType=BOOLEAN, ComSystemTemplateSystemSignalRef=DET_BELOW_RAIN_THOLD_289
            DET_BELOW_RAIN_THOLD_290_oRDR_DETECTION_289_292_oPCAN_RADAR_3b1ab399_Tx: ComBitPosition=151, ComBitSize=1, ComSignalInitValue=0, ComSignalType=BOOLEAN, ComSystemTemplateSystemSignalRef=DET_BELOW_RAIN_THOLD_290
            DET_BELOW_RAIN_THOLD_291_oRDR_DETECTION_289_292_oPCAN_RADAR_ae6a670c_Tx: ComBitPosition=263, ComBitSize=1, ComSignalInitValue=0, ComSignalType=BOOLEAN, ComSystemTemplateSystemSignalRef=DET_BELOW_RAIN_THOLD_291
            DET_BELOW_RAIN_THOLD_292_oRDR_DETECTION_289_292_oPCAN_RADAR_ca8a1cf2_Tx: ComBitPosition=375, ComBitSize=1, ComSignalInitValue=0, ComSignalType=BOOLEAN, ComSystemTemplateSystemSignalRef=DET_BELOW_RAIN_THOLD_292
            DET_BI_STATIC_FLAG_289_oRDR_DETECTION_289_292_oPCAN_RADAR_dd171278_Tx: ComBitPosition=104, ComBitSize=1, ComSignalInitValue=0, ComSignalType=BOOLEAN, ComSystemTemplateSystemSignalRef=DET_BI_STATIC_FLAG_289
            DET_BI_STATIC_FLAG_290_oRDR_DETECTION_289_292_oPCAN_RADAR_b83760dc_Tx: ComBitPosition=216, ComBitSize=1, ComSignalInitValue=0, ComSignalType=BOOLEAN, ComSystemTemplateSystemSignalRef=DET_BI_STATIC_FLAG_290
            DET_BI_STATIC_FLAG_291_oRDR_DETECTION_289_292_oPCAN_RADAR_2d47b449_Tx: ComBitPosition=328, ComBitSize=1, ComSignalInitValue=0, ComSignalType=BOOLEAN, ComSystemTemplateSystemSignalRef=DET_BI_STATIC_FLAG_291
            DET_BI_STATIC_FLAG_292_oRDR_DETECTION_289_292_oPCAN_RADAR_49a7cfb7_Tx: ComBitPosition=440, ComBitSize=1, ComSignalInitValue=0, ComSignalType=BOOLEAN, ComSystemTemplateSystemSignalRef=DET_BI_STATIC_FLAG_292
            DET_CONFD_AZIMUTH_289_oRDR_DETECTION_289_292_oPCAN_RADAR_89dd5837_Tx: ComBitPosition=118, ComBitSize=2, ComSignalInitValue=0, ComSignalType=UINT8, ComSystemTemplateSystemSignalRef=DET_CONFD_AZIMUTH_289
            DET_CONFD_AZIMUTH_290_oRDR_DETECTION_289_292_oPCAN_RADAR_ecfd2a93_Tx: ComBitPosition=230, ComBitSize=2, ComSignalInitValue=0, ComSignalType=UINT8, ComSystemTemplateSystemSignalRef=DET_CONFD_AZIMUTH_290
            DET_CONFD_AZIMUTH_291_oRDR_DETECTION_289_292_oPCAN_RADAR_798dfe06_Tx: ComBitPosition=342, ComBitSize=2, ComSignalInitValue=0, ComSignalType=UINT8, ComSystemTemplateSystemSignalRef=DET_CONFD_AZIMUTH_291
            DET_CONFD_AZIMUTH_292_oRDR_DETECTION_289_292_oPCAN_RADAR_1d6d85f8_Tx: ComBitPosition=454, ComBitSize=2, ComSignalInitValue=0, ComSignalType=UINT8, ComSystemTemplateSystemSignalRef=DET_CONFD_AZIMUTH_292
            DET_CONFD_ELEVATION_289_oRDR_DETECTION_289_292_oPCAN_RADAR_8b4859cd_Tx: ComBitPosition=101, ComBitSize=2, ComSignalInitValue=0, ComSignalType=UINT8, ComSystemTemplateSystemSignalRef=DET_CONFD_ELEVATION_289
            DET_CONFD_ELEVATION_290_oRDR_DETECTION_289_292_oPCAN_RADAR_ee682b69_Tx: ComBitPosition=213, ComBitSize=2, ComSignalInitValue=0, ComSignalType=UINT8, ComSystemTemplateSystemSignalRef=DET_CONFD_ELEVATION_290
            DET_CONFD_ELEVATION_291_oRDR_DETECTION_289_292_oPCAN_RADAR_7b18fffc_Tx: ComBitPosition=325, ComBitSize=2, ComSignalInitValue=0, ComSignalType=UINT8, ComSystemTemplateSystemSignalRef=DET_CONFD_ELEVATION_291
            DET_CONFD_ELEVATION_292_oRDR_DETECTION_289_292_oPCAN_RADAR_1ff88402_Tx: ComBitPosition=437, ComBitSize=2, ComSignalInitValue=0, ComSignalType=UINT8, ComSystemTemplateSystemSignalRef=DET_CONFD_ELEVATION_292
            DET_ELEVATION_289_oRDR_DETECTION_289_292_oPCAN_RADAR_5a888df1_Tx: ComBitPosition=72, ComBitSize=8, ComSignalInitValue=0, ComSignalType=UINT8, ComSystemTemplateSystemSignalRef=DET_ELEVATION_289
            DET_ELEVATION_290_oRDR_DETECTION_289_292_oPCAN_RADAR_3fa8ff55_Tx: ComBitPosition=184, ComBitSize=8, ComSignalInitValue=0, ComSignalType=UINT8, ComSystemTemplateSystemSignalRef=DET_ELEVATION_290
            DET_ELEVATION_291_oRDR_DETECTION_289_292_oPCAN_RADAR_aad82bc0_Tx: ComBitPosition=296, ComBitSize=8, ComSignalInitValue=0, ComSignalType=UINT8, ComSystemTemplateSystemSignalRef=DET_ELEVATION_291
            DET_ELEVATION_292_oRDR_DETECTION_289_292_oPCAN_RADAR_ce38503e_Tx: ComBitPosition=408, ComBitSize=8, ComSignalInitValue=0, ComSignalType=UINT8, ComSystemTemplateSystemSignalRef=DET_ELEVATION_292
            DET_ELEVATION_ERR_289_oRDR_DETECTION_289_292_oPCAN_RADAR_ddb11584_Tx: ComBitPosition=80, ComBitSize=6, ComSignalInitValue=0, ComSignalType=UINT8, ComSystemTemplateSystemSignalRef=DET_ELEVATION_ERR_289
            DET_ELEVATION_ERR_290_oRDR_DETECTION_289_292_oPCAN_RADAR_b8916720_Tx: ComBitPosition=192, ComBitSize=6, ComSignalInitValue=0, ComSignalType=UINT8, ComSystemTemplateSystemSignalRef=DET_ELEVATION_ERR_290
            DET_ELEVATION_ERR_291_oRDR_DETECTION_289_292_oPCAN_RADAR_2de1b3b5_Tx: ComBitPosition=304, ComBitSize=6, ComSignalInitValue=0, ComSignalType=UINT8, ComSystemTemplateSystemSignalRef=DET_ELEVATION_ERR_291
            DET_ELEVATION_ERR_292_oRDR_DETECTION_289_292_oPCAN_RADAR_4901c84b_Tx: ComBitPosition=416, ComBitSize=6, ComSignalInitValue=0, ComSignalType=UINT8, ComSystemTemplateSystemSignalRef=DET_ELEVATION_ERR_292
            DET_EXISTENCE_PROB_289_oRDR_DETECTION_289_292_oPCAN_RADAR_0f2e60e4_Tx: ComBitPosition=112, ComBitSize=6, ComSignalInitValue=0, ComSignalType=UINT8, ComSystemTemplateSystemSignalRef=DET_EXISTENCE_PROB_289
            DET_EXISTENCE_PROB_290_oRDR_DETECTION_289_292_oPCAN_RADAR_6a0e1240_Tx: ComBitPosition=224, ComBitSize=6, ComSignalInitValue=0, ComSignalType=UINT8, ComSystemTemplateSystemSignalRef=DET_EXISTENCE_PROB_290
            DET_EXISTENCE_PROB_291_oRDR_DETECTION_289_292_oPCAN_RADAR_ff7ec6d5_Tx: ComBitPosition=336, ComBitSize=6, ComSignalInitValue=0, ComSignalType=UINT8, ComSystemTemplateSystemSignalRef=DET_EXISTENCE_PROB_291
            DET_EXISTENCE_PROB_292_oRDR_DETECTION_289_292_oPCAN_RADAR_9b9ebd2b_Tx: ComBitPosition=448, ComBitSize=6, ComSignalInitValue=0, ComSignalType=UINT8, ComSystemTemplateSystemSignalRef=DET_EXISTENCE_PROB_292
            DET_HVC_FLAG_289_oRDR_DETECTION_289_292_oPCAN_RADAR_ee5a239b_Tx: ComBitPosition=86, ComBitSize=1, ComSignalInitValue=0, ComSignalType=BOOLEAN, ComSystemTemplateSystemSignalRef=DET_HVC_FLAG_289
            DET_HVC_FLAG_290_oRDR_DETECTION_289_292_oPCAN_RADAR_8b7a513f_Tx: ComBitPosition=198, ComBitSize=1, ComSignalInitValue=0, ComSignalType=BOOLEAN, ComSystemTemplateSystemSignalRef=DET_HVC_FLAG_290
            DET_HVC_FLAG_291_oRDR_DETECTION_289_292_oPCAN_RADAR_1e0a85aa_Tx: ComBitPosition=310, ComBitSize=1, ComSignalInitValue=0, ComSignalType=BOOLEAN, ComSystemTemplateSystemSignalRef=DET_HVC_FLAG_291
            DET_HVC_FLAG_292_oRDR_DETECTION_289_292_oPCAN_RADAR_7aeafe54_Tx: ComBitPosition=422, ComBitSize=1, ComSignalInitValue=0, ComSignalType=BOOLEAN, ComSystemTemplateSystemSignalRef=DET_HVC_FLAG_292
            DET_IDM_289_oRDR_DETECTION_289_292_oPCAN_RADAR_65081826_Tx: ComBitPosition=63, ComBitSize=1, ComSignalInitValue=0, ComSignalType=BOOLEAN, ComSystemTemplateSystemSignalRef=DET_IDM_289
            DET_IDM_290_oRDR_DETECTION_289_292_oPCAN_RADAR_00286a82_Tx: ComBitPosition=175, ComBitSize=1, ComSignalInitValue=0, ComSignalType=BOOLEAN, ComSystemTemplateSystemSignalRef=DET_IDM_290
            DET_IDM_291_oRDR_DETECTION_289_292_oPCAN_RADAR_9558be17_Tx: ComBitPosition=287, ComBitSize=1, ComSignalInitValue=0, ComSignalType=BOOLEAN, ComSystemTemplateSystemSignalRef=DET_IDM_291
            DET_IDM_292_oRDR_DETECTION_289_292_oPCAN_RADAR_f1b8c5e9_Tx: ComBitPosition=399, ComBitSize=1, ComSignalInitValue=0, ComSignalType=BOOLEAN, ComSystemTemplateSystemSignalRef=DET_IDM_292
            DET_MH_CRC16_289_292_oRDR_DETECTION_289_292_oPCAN_RADAR_e3ff93b7_Tx: ComBitPosition=0, ComBitSize=16, ComSignalInitValue=0, ComSignalType=UINT16, ComSystemTemplateSystemSignalRef=DET_MH_CRC16_289_292
            DET_MH_CYCLE_COUNTER_289_292_oRDR_DETECTION_289_292_oPCAN_RADAR_678a3280_Tx: ComBitPosition=16, ComBitSize=8, ComSignalInitValue=0, ComSignalType=UINT8, ComSystemTemplateSystemSignalRef=DET_MH_CYCLE_COUNTER_289_292
            DET_MH_SCAN_INDEX_4LSB_289_292_oRDR_DETECTION_289_292_oPCAN_RADAR_aba0170c_Tx: ComBitPosition=476, ComBitSize=4, ComSignalInitValue=0, ComSignalType=UINT8, ComSystemTemplateSystemSignalRef=DET_MH_SCAN_INDEX_4LSB_289_292
            DET_MTD_289_oRDR_DETECTION_289_292_oPCAN_RADAR_03bb2afd_Tx: ComBitPosition=47, ComBitSize=1, ComSignalInitValue=0, ComSignalType=BOOLEAN, ComSystemTemplateSystemSignalRef=DET_MTD_289
            DET_MTD_290_oRDR_DETECTION_289_292_oPCAN_RADAR_669b5859_Tx: ComBitPosition=159, ComBitSize=1, ComSignalInitValue=0, ComSignalType=BOOLEAN, ComSystemTemplateSystemSignalRef=DET_MTD_290
            DET_MTD_291_oRDR_DETECTION_289_292_oPCAN_RADAR_f3eb8ccc_Tx: ComBitPosition=271, ComBitSize=1, ComSignalInitValue=0, ComSignalType=BOOLEAN, ComSystemTemplateSystemSignalRef=DET_MTD_291
            DET_MTD_292_oRDR_DETECTION_289_292_oPCAN_RADAR_970bf732_Tx: ComBitPosition=383, ComBitSize=1, ComSignalInitValue=0, ComSignalType=BOOLEAN, ComSystemTemplateSystemSignalRef=DET_MTD_292
            DET_PROB_1STAZHYPO_289_oRDR_DETECTION_289_292_oPCAN_RADAR_900fc230_Tx: ComBitPosition=103, ComBitSize=1, ComSignalInitValue=0, ComSignalType=BOOLEAN, ComSystemTemplateSystemSignalRef=DET_PROB_1STAZHYPO_289
            DET_PROB_1STAZHYPO_290_oRDR_DETECTION_289_292_oPCAN_RADAR_f52fb094_Tx: ComBitPosition=215, ComBitSize=1, ComSignalInitValue=0, ComSignalType=BOOLEAN, ComSystemTemplateSystemSignalRef=DET_PROB_1STAZHYPO_290
            DET_PROB_1STAZHYPO_291_oRDR_DETECTION_289_292_oPCAN_RADAR_605f6401_Tx: ComBitPosition=327, ComBitSize=1, ComSignalInitValue=0, ComSignalType=BOOLEAN, ComSystemTemplateSystemSignalRef=DET_PROB_1STAZHYPO_291
            DET_PROB_1STAZHYPO_292_oRDR_DETECTION_289_292_oPCAN_RADAR_04bf1fff_Tx: ComBitPosition=439, ComBitSize=1, ComSignalInitValue=0, ComSignalType=BOOLEAN, ComSystemTemplateSystemSignalRef=DET_PROB_1STAZHYPO_292
            DET_RANGE_289_oRDR_DETECTION_289_292_oPCAN_RADAR_9ba02146_Tx: ComBitPosition=24, ComBitSize=15, ComSignalInitValue=0, ComSignalType=UINT16, ComSystemTemplateSystemSignalRef=DET_RANGE_289
            DET_RANGE_290_oRDR_DETECTION_289_292_oPCAN_RADAR_fe8053e2_Tx: ComBitPosition=136, ComBitSize=15, ComSignalInitValue=0, ComSignalType=UINT16, ComSystemTemplateSystemSignalRef=DET_RANGE_290
            DET_RANGE_291_oRDR_DETECTION_289_292_oPCAN_RADAR_6bf08777_Tx: ComBitPosition=248, ComBitSize=15, ComSignalInitValue=0, ComSignalType=UINT16, ComSystemTemplateSystemSignalRef=DET_RANGE_291
            DET_RANGE_292_oRDR_DETECTION_289_292_oPCAN_RADAR_0f10fc89_Tx: ComBitPosition=360, ComBitSize=15, ComSignalInitValue=0, ComSignalType=UINT16, ComSystemTemplateSystemSignalRef=DET_RANGE_292
            DET_RANGE_ERR_289_oRDR_DETECTION_289_292_oPCAN_RADAR_3c489b2f_Tx: ComBitPosition=40, ComBitSize=7, ComSignalInitValue=0, ComSignalType=UINT8, ComSystemTemplateSystemSignalRef=DET_RANGE_ERR_289
            DET_RANGE_ERR_290_oRDR_DETECTION_289_292_oPCAN_RADAR_5968e98b_Tx: ComBitPosition=152, ComBitSize=7, ComSignalInitValue=0, ComSignalType=UINT8, ComSystemTemplateSystemSignalRef=DET_RANGE_ERR_290
            DET_RANGE_ERR_291_oRDR_DETECTION_289_292_oPCAN_RADAR_cc183d1e_Tx: ComBitPosition=264, ComBitSize=7, ComSignalInitValue=0, ComSignalType=UINT8, ComSystemTemplateSystemSignalRef=DET_RANGE_ERR_291
            DET_RANGE_ERR_292_oRDR_DETECTION_289_292_oPCAN_RADAR_a8f846e0_Tx: ComBitPosition=376, ComBitSize=7, ComSignalInitValue=0, ComSignalType=UINT8, ComSystemTemplateSystemSignalRef=DET_RANGE_ERR_292
            DET_RANGE_VELOCITY_289_oRDR_DETECTION_289_292_oPCAN_RADAR_ee06e363_Tx: ComBitPosition=48, ComBitSize=15, ComSignalInitValue=16384, ComSignalType=UINT16, ComSystemTemplateSystemSignalRef=DET_RANGE_VELOCITY_289
            DET_RANGE_VELOCITY_290_oRDR_DETECTION_289_292_oPCAN_RADAR_8b2691c7_Tx: ComBitPosition=160, ComBitSize=15, ComSignalInitValue=16384, ComSignalType=UINT16, ComSystemTemplateSystemSignalRef=DET_RANGE_VELOCITY_290
            DET_RANGE_VELOCITY_291_oRDR_DETECTION_289_292_oPCAN_RADAR_1e564552_Tx: ComBitPosition=272, ComBitSize=15, ComSignalInitValue=16384, ComSignalType=UINT16, ComSystemTemplateSystemSignalRef=DET_RANGE_VELOCITY_291
            DET_RANGE_VELOCITY_292_oRDR_DETECTION_289_292_oPCAN_RADAR_7ab63eac_Tx: ComBitPosition=384, ComBitSize=15, ComSignalInitValue=16384, ComSignalType=UINT16, ComSystemTemplateSystemSignalRef=DET_RANGE_VELOCITY_292
            DET_RANGE_VELOCITY_ERR_289_oRDR_DETECTION_289_292_oPCAN_RADAR_e1bd18d1_Tx: ComBitPosition=64, ComBitSize=8, ComSignalInitValue=0, ComSignalType=UINT8, ComSystemTemplateSystemSignalRef=DET_RANGE_VELOCITY_ERR_289
            DET_RANGE_VELOCITY_ERR_290_oRDR_DETECTION_289_292_oPCAN_RADAR_849d6a75_Tx: ComBitPosition=176, ComBitSize=8, ComSignalInitValue=0, ComSignalType=UINT8, ComSystemTemplateSystemSignalRef=DET_RANGE_VELOCITY_ERR_290
            DET_RANGE_VELOCITY_ERR_291_oRDR_DETECTION_289_292_oPCAN_RADAR_11edbee0_Tx: ComBitPosition=288, ComBitSize=8, ComSignalInitValue=0, ComSignalType=UINT8, ComSystemTemplateSystemSignalRef=DET_RANGE_VELOCITY_ERR_291
            DET_RANGE_VELOCITY_ERR_292_oRDR_DETECTION_289_292_oPCAN_RADAR_750dc51e_Tx: ComBitPosition=400, ComBitSize=8, ComSignalInitValue=0, ComSignalType=UINT8, ComSystemTemplateSystemSignalRef=DET_RANGE_VELOCITY_ERR_292
            DET_RCS_289_oRDR_DETECTION_289_292_oPCAN_RADAR_6986d439_Tx: ComBitPosition=128, ComBitSize=8, ComSignalInitValue=128, ComSignalType=UINT8, ComSystemTemplateSystemSignalRef=DET_RCS_289
            DET_RCS_290_oRDR_DETECTION_289_292_oPCAN_RADAR_0ca6a69d_Tx: ComBitPosition=240, ComBitSize=8, ComSignalInitValue=128, ComSignalType=UINT8, ComSystemTemplateSystemSignalRef=DET_RCS_290
            DET_RCS_291_oRDR_DETECTION_289_292_oPCAN_RADAR_99d67208_Tx: ComBitPosition=352, ComBitSize=8, ComSignalInitValue=128, ComSignalType=UINT8, ComSystemTemplateSystemSignalRef=DET_RCS_291
            DET_RCS_292_oRDR_DETECTION_289_292_oPCAN_RADAR_fd3609f6_Tx: ComBitPosition=464, ComBitSize=8, ComSignalInitValue=128, ComSignalType=UINT8, ComSystemTemplateSystemSignalRef=DET_RCS_292
            DET_SNR_289_oRDR_DETECTION_289_292_oPCAN_RADAR_b428803b_Tx: ComBitPosition=120, ComBitSize=8, ComSignalInitValue=0, ComSignalType=UINT8, ComSystemTemplateSystemSignalRef=DET_SNR_289
            DET_SNR_290_oRDR_DETECTION_289_292_oPCAN_RADAR_d108f29f_Tx: ComBitPosition=232, ComBitSize=8, ComSignalInitValue=0, ComSignalType=UINT8, ComSystemTemplateSystemSignalRef=DET_SNR_290
            DET_SNR_291_oRDR_DETECTION_289_292_oPCAN_RADAR_4478260a_Tx: ComBitPosition=344, ComBitSize=8, ComSignalInitValue=0, ComSignalType=UINT8, ComSystemTemplateSystemSignalRef=DET_SNR_291
            DET_SNR_292_oRDR_DETECTION_289_292_oPCAN_RADAR_20985df4_Tx: ComBitPosition=456, ComBitSize=8, ComSignalInitValue=0, ComSignalType=UINT8, ComSystemTemplateSystemSignalRef=DET_SNR_292
            DET_SUPER_RES_TARGET_289_oRDR_DETECTION_289_292_oPCAN_RADAR_85b1a85e_Tx: ComBitPosition=87, ComBitSize=1, ComSignalInitValue=0, ComSignalType=BOOLEAN, ComSystemTemplateSystemSignalRef=DET_SUPER_RES_TARGET_289
            DET_SUPER_RES_TARGET_290_oRDR_DETECTION_289_292_oPCAN_RADAR_e091dafa_Tx: ComBitPosition=199, ComBitSize=1, ComSignalInitValue=0, ComSignalType=BOOLEAN, ComSystemTemplateSystemSignalRef=DET_SUPER_RES_TARGET_290
            DET_SUPER_RES_TARGET_291_oRDR_DETECTION_289_292_oPCAN_RADAR_75e10e6f_Tx: ComBitPosition=311, ComBitSize=1, ComSignalInitValue=0, ComSignalType=BOOLEAN, ComSystemTemplateSystemSignalRef=DET_SUPER_RES_TARGET_291
            DET_SUPER_RES_TARGET_292_oRDR_DETECTION_289_292_oPCAN_RADAR_11017591_Tx: ComBitPosition=423, ComBitSize=1, ComSignalInitValue=0, ComSignalType=BOOLEAN, ComSystemTemplateSystemSignalRef=DET_SUPER_RES_TARGET_292
        SG_Detections_293_296_oRDR_DETECTION_293_296_oPCAN_RADAR_557c2994_Tx: ComSystemTemplateSignalGroupRef=SG_Detections_293_296
          83 x ComGroupSignal, all with ComSignalEndianness=LITTLE_ENDIAN, ComTransferProperty=PENDING:
            DET_AZIMUTH_293_oRDR_DETECTION_293_296_oPCAN_RADAR_973c5889_Tx: ComBitPosition=88, ComBitSize=13, ComSignalInitValue=0, ComSignalType=UINT16, ComSystemTemplateSystemSignalRef=DET_AZIMUTH_293
            DET_AZIMUTH_294_oRDR_DETECTION_293_296_oPCAN_RADAR_cb8c7be0_Tx: ComBitPosition=200, ComBitSize=13, ComSignalInitValue=0, ComSignalType=UINT16, ComSystemTemplateSystemSignalRef=DET_AZIMUTH_294
            DET_AZIMUTH_295_oRDR_DETECTION_293_296_oPCAN_RADAR_5efcaf75_Tx: ComBitPosition=312, ComBitSize=13, ComSignalInitValue=0, ComSignalType=UINT16, ComSystemTemplateSystemSignalRef=DET_AZIMUTH_295
            DET_AZIMUTH_296_oRDR_DETECTION_293_296_oPCAN_RADAR_3a1cd48b_Tx: ComBitPosition=424, ComBitSize=13, ComSignalInitValue=0, ComSignalType=UINT16, ComSystemTemplateSystemSignalRef=DET_AZIMUTH_296
            DET_AZIMUTH_ERR_293_oRDR_DETECTION_293_296_oPCAN_RADAR_3389cd7c_Tx: ComBitPosition=105, ComBitSize=7, ComSignalInitValue=0, ComSignalType=UINT8, ComSystemTemplateSystemSignalRef=DET_AZIMUTH_ERR_293
            DET_AZIMUTH_ERR_294_oRDR_DETECTION_293_296_oPCAN_RADAR_6f39ee15_Tx: ComBitPosition=217, ComBitSize=7, ComSignalInitValue=0, ComSignalType=UINT8, ComSystemTemplateSystemSignalRef=DET_AZIMUTH_ERR_294
            DET_AZIMUTH_ERR_295_oRDR_DETECTION_293_296_oPCAN_RADAR_fa493a80_Tx: ComBitPosition=329, ComBitSize=7, ComSignalInitValue=0, ComSignalType=UINT8, ComSystemTemplateSystemSignalRef=DET_AZIMUTH_ERR_295
            DET_AZIMUTH_ERR_296_oRDR_DETECTION_293_296_oPCAN_RADAR_9ea9417e_Tx: ComBitPosition=441, ComBitSize=7, ComSignalInitValue=0, ComSignalType=UINT8, ComSystemTemplateSystemSignalRef=DET_AZIMUTH_ERR_296
            DET_BELOW_RAIN_THOLD_293_oRDR_DETECTION_293_296_oPCAN_RADAR_423dcb49_Tx: ComBitPosition=39, ComBitSize=1, ComSignalInitValue=0, ComSignalType=BOOLEAN, ComSystemTemplateSystemSignalRef=DET_BELOW_RAIN_THOLD_293
            DET_BELOW_RAIN_THOLD_294_oRDR_DETECTION_293_296_oPCAN_RADAR_1e8de820_Tx: ComBitPosition=151, ComBitSize=1, ComSignalInitValue=0, ComSignalType=BOOLEAN, ComSystemTemplateSystemSignalRef=DET_BELOW_RAIN_THOLD_294
            DET_BELOW_RAIN_THOLD_295_oRDR_DETECTION_293_296_oPCAN_RADAR_8bfd3cb5_Tx: ComBitPosition=263, ComBitSize=1, ComSignalInitValue=0, ComSignalType=BOOLEAN, ComSystemTemplateSystemSignalRef=DET_BELOW_RAIN_THOLD_295
            DET_BELOW_RAIN_THOLD_296_oRDR_DETECTION_293_296_oPCAN_RADAR_ef1d474b_Tx: ComBitPosition=375, ComBitSize=1, ComSignalInitValue=0, ComSignalType=BOOLEAN, ComSystemTemplateSystemSignalRef=DET_BELOW_RAIN_THOLD_296
            DET_BI_STATIC_FLAG_293_oRDR_DETECTION_293_296_oPCAN_RADAR_c110180c_Tx: ComBitPosition=104, ComBitSize=1, ComSignalInitValue=0, ComSignalType=BOOLEAN, ComSystemTemplateSystemSignalRef=DET_BI_STATIC_FLAG_293
            DET_BI_STATIC_FLAG_294_oRDR_DETECTION_293_296_oPCAN_RADAR_9da03b65_Tx: ComBitPosition=216, ComBitSize=1, ComSignalInitValue=0, ComSignalType=BOOLEAN, ComSystemTemplateSystemSignalRef=DET_BI_STATIC_FLAG_294
            DET_BI_STATIC_FLAG_295_oRDR_DETECTION_293_296_oPCAN_RADAR_08d0eff0_Tx: ComBitPosition=328, ComBitSize=1, ComSignalInitValue=0, ComSignalType=BOOLEAN, ComSystemTemplateSystemSignalRef=DET_BI_STATIC_FLAG_295
            DET_BI_STATIC_FLAG_296_oRDR_DETECTION_293_296_oPCAN_RADAR_6c30940e_Tx: ComBitPosition=440, ComBitSize=1, ComSignalInitValue=0, ComSignalType=BOOLEAN, ComSystemTemplateSystemSignalRef=DET_BI_STATIC_FLAG_296
            DET_CONFD_AZIMUTH_293_oRDR_DETECTION_293_296_oPCAN_RADAR_95da5243_Tx: ComBitPosition=118, ComBitSize=2, ComSignalInitValue=0, ComSignalType=UINT8, ComSystemTemplateSystemSignalRef=DET_CONFD_AZIMUTH_293
            DET_CONFD_AZIMUTH_294_oRDR_DETECTION_293_296_oPCAN_RADAR_c96a712a_Tx: ComBitPosition=230, ComBitSize=2, ComSignalInitValue=0, ComSignalType=UINT8, ComSystemTemplateSystemSignalRef=DET_CONFD_AZIMUTH_294
            DET_CONFD_AZIMUTH_295_oRDR_DETECTION_293_296_oPCAN_RADAR_5c1aa5bf_Tx: ComBitPosition=342, ComBitSize=2, ComSignalInitValue=0, ComSignalType=UINT8, ComSystemTemplateSystemSignalRef=DET_CONFD_AZIMUTH_295
            DET_CONFD_AZIMUTH_296_oRDR_DETECTION_293_296_oPCAN_RADAR_38fade41_Tx: ComBitPosition=454, ComBitSize=2, ComSignalInitValue=0, ComSignalType=UINT8, ComSystemTemplateSystemSignalRef=DET_CONFD_AZIMUTH_296
            DET_CONFD_ELEVATION_293_oRDR_DETECTION_293_296_oPCAN_RADAR_974f53b9_Tx: ComBitPosition=101, ComBitSize=2, ComSignalInitValue=0, ComSignalType=UINT8, ComSystemTemplateSystemSignalRef=DET_CONFD_ELEVATION_293
            DET_CONFD_ELEVATION_294_oRDR_DETECTION_293_296_oPCAN_RADAR_cbff70d0_Tx: ComBitPosition=213, ComBitSize=2, ComSignalInitValue=0, ComSignalType=UINT8, ComSystemTemplateSystemSignalRef=DET_CONFD_ELEVATION_294
            DET_CONFD_ELEVATION_295_oRDR_DETECTION_293_296_oPCAN_RADAR_5e8fa445_Tx: ComBitPosition=325, ComBitSize=2, ComSignalInitValue=0, ComSignalType=UINT8, ComSystemTemplateSystemSignalRef=DET_CONFD_ELEVATION_295
            DET_CONFD_ELEVATION_296_oRDR_DETECTION_293_296_oPCAN_RADAR_3a6fdfbb_Tx: ComBitPosition=437, ComBitSize=2, ComSignalInitValue=0, ComSignalType=UINT8, ComSystemTemplateSystemSignalRef=DET_CONFD_ELEVATION_296
            DET_ELEVATION_293_oRDR_DETECTION_293_296_oPCAN_RADAR_468f8785_Tx: ComBitPosition=72, ComBitSize=8, ComSignalInitValue=0, ComSignalType=UINT8, ComSystemTemplateSystemSignalRef=DET_ELEVATION_293
            DET_ELEVATION_294_oRDR_DETECTION_293_296_oPCAN_RADAR_1a3fa4ec_Tx: ComBitPosition=184, ComBitSize=8, ComSignalInitValue=0, ComSignalType=UINT8, ComSystemTemplateSystemSignalRef=DET_ELEVATION_294
            DET_ELEVATION_295_oRDR_DETECTION_293_296_oPCAN_RADAR_8f4f7079_Tx: ComBitPosition=296, ComBitSize=8, ComSignalInitValue=0, ComSignalType=UINT8, ComSystemTemplateSystemSignalRef=DET_ELEVATION_295
            DET_ELEVATION_296_oRDR_DETECTION_293_296_oPCAN_RADAR_ebaf0b87_Tx: ComBitPosition=408, ComBitSize=8, ComSignalInitValue=0, ComSignalType=UINT8, ComSystemTemplateSystemSignalRef=DET_ELEVATION_296
            DET_ELEVATION_ERR_293_oRDR_DETECTION_293_296_oPCAN_RADAR_c1b61ff0_Tx: ComBitPosition=80, ComBitSize=6, ComSignalInitValue=0, ComSignalType=UINT8, ComSystemTemplateSystemSignalRef=DET_ELEVATION_ERR_293
            DET_ELEVATION_ERR_294_oRDR_DETECTION_293_296_oPCAN_RADAR_9d063c99_Tx: ComBitPosition=192, ComBitSize=6, ComSignalInitValue=0, ComSignalType=UINT8, ComSystemTemplateSystemSignalRef=DET_ELEVATION_ERR_294
            DET_ELEVATION_ERR_295_oRDR_DETECTION_293_296_oPCAN_RADAR_0876e80c_Tx: ComBitPosition=304, ComBitSize=6, ComSignalInitValue=0, ComSignalType=UINT8, ComSystemTemplateSystemSignalRef=DET_ELEVATION_ERR_295
            DET_ELEVATION_ERR_296_oRDR_DETECTION_293_296_oPCAN_RADAR_6c9693f2_Tx: ComBitPosition=416, ComBitSize=6, ComSignalInitValue=0, ComSignalType=UINT8, ComSystemTemplateSystemSignalRef=DET_ELEVATION_ERR_296
            DET_EXISTENCE_PROB_293_oRDR_DETECTION_293_296_oPCAN_RADAR_13296a90_Tx: ComBitPosition=112, ComBitSize=6, ComSignalInitValue=0, ComSignalType=UINT8, ComSystemTemplateSystemSignalRef=DET_EXISTENCE_PROB_293
            DET_EXISTENCE_PROB_294_oRDR_DETECTION_293_296_oPCAN_RADAR_4f9949f9_Tx: ComBitPosition=224, ComBitSize=6, ComSignalInitValue=0, ComSignalType=UINT8, ComSystemTemplateSystemSignalRef=DET_EXISTENCE_PROB_294
            DET_EXISTENCE_PROB_295_oRDR_DETECTION_293_296_oPCAN_RADAR_dae99d6c_Tx: ComBitPosition=336, ComBitSize=6, ComSignalInitValue=0, ComSignalType=UINT8, ComSystemTemplateSystemSignalRef=DET_EXISTENCE_PROB_295
            DET_EXISTENCE_PROB_296_oRDR_DETECTION_293_296_oPCAN_RADAR_be09e692_Tx: ComBitPosition=448, ComBitSize=6, ComSignalInitValue=0, ComSignalType=UINT8, ComSystemTemplateSystemSignalRef=DET_EXISTENCE_PROB_296
            DET_HVC_FLAG_293_oRDR_DETECTION_293_296_oPCAN_RADAR_f25d29ef_Tx: ComBitPosition=86, ComBitSize=1, ComSignalInitValue=0, ComSignalType=BOOLEAN, ComSystemTemplateSystemSignalRef=DET_HVC_FLAG_293
            DET_HVC_FLAG_294_oRDR_DETECTION_293_296_oPCAN_RADAR_aeed0a86_Tx: ComBitPosition=198, ComBitSize=1, ComSignalInitValue=0, ComSignalType=BOOLEAN, ComSystemTemplateSystemSignalRef=DET_HVC_FLAG_294
            DET_HVC_FLAG_295_oRDR_DETECTION_293_296_oPCAN_RADAR_3b9dde13_Tx: ComBitPosition=310, ComBitSize=1, ComSignalInitValue=0, ComSignalType=BOOLEAN, ComSystemTemplateSystemSignalRef=DET_HVC_FLAG_295
            DET_HVC_FLAG_296_oRDR_DETECTION_293_296_oPCAN_RADAR_5f7da5ed_Tx: ComBitPosition=422, ComBitSize=1, ComSignalInitValue=0, ComSignalType=BOOLEAN, ComSystemTemplateSystemSignalRef=DET_HVC_FLAG_296
            DET_IDM_293_oRDR_DETECTION_293_296_oPCAN_RADAR_790f1252_Tx: ComBitPosition=63, ComBitSize=1, ComSignalInitValue=0, ComSignalType=BOOLEAN, ComSystemTemplateSystemSignalRef=DET_IDM_293
            DET_IDM_294_oRDR_DETECTION_293_296_oPCAN_RADAR_25bf313b_Tx: ComBitPosition=175, ComBitSize=1, ComSignalInitValue=0, ComSignalType=BOOLEAN, ComSystemTemplateSystemSignalRef=DET_IDM_294
            DET_IDM_295_oRDR_DETECTION_293_296_oPCAN_RADAR_b0cfe5ae_Tx: ComBitPosition=287, ComBitSize=1, ComSignalInitValue=0, ComSignalType=BOOLEAN, ComSystemTemplateSystemSignalRef=DET_IDM_295
            DET_IDM_296_oRDR_DETECTION_293_296_oPCAN_RADAR_d42f9e50_Tx: ComBitPosition=399, ComBitSize=1, ComSignalInitValue=0, ComSignalType=BOOLEAN, ComSystemTemplateSystemSignalRef=DET_IDM_296
            DET_MH_CRC16_293_296_oRDR_DETECTION_293_296_oPCAN_RADAR_d1f4fb9f_Tx: ComBitPosition=0, ComBitSize=16, ComSignalInitValue=0, ComSignalType=UINT16, ComSystemTemplateSystemSignalRef=DET_MH_CRC16_293_296
            DET_MH_CYCLE_COUNTER_293_296_oRDR_DETECTION_293_296_oPCAN_RADAR_55815aa8_Tx: ComBitPosition=16, ComBitSize=8, ComSignalInitValue=0, ComSignalType=UINT8, ComSystemTemplateSystemSignalRef=DET_MH_CYCLE_COUNTER_293_296
            DET_MH_SCAN_INDEX_4LSB_293_296_oRDR_DETECTION_293_296_oPCAN_RADAR_99ab7f24_Tx: ComBitPosition=476, ComBitSize=4, ComSignalInitValue=0, ComSignalType=UINT8, ComSystemTemplateSystemSignalRef=DET_MH_SCAN_INDEX_4LSB_293_296
            DET_MTD_293_oRDR_DETECTION_293_296_oPCAN_RADAR_1fbc2089_Tx: ComBitPosition=47, ComBitSize=1, ComSignalInitValue=0, ComSignalType=BOOLEAN, ComSystemTemplateSystemSignalRef=DET_MTD_293
            DET_MTD_294_oRDR_DETECTION_293_296_oPCAN_RADAR_430c03e0_Tx: ComBitPosition=159, ComBitSize=1, ComSignalInitValue=0, ComSignalType=BOOLEAN, ComSystemTemplateSystemSignalRef=DET_MTD_294
            DET_MTD_295_oRDR_DETECTION_293_296_oPCAN_RADAR_d67cd775_Tx: ComBitPosition=271, ComBitSize=1, ComSignalInitValue=0, ComSignalType=BOOLEAN, ComSystemTemplateSystemSignalRef=DET_MTD_295
            DET_MTD_296_oRDR_DETECTION_293_296_oPCAN_RADAR_b29cac8b_Tx: ComBitPosition=383, ComBitSize=1, ComSignalInitValue=0, ComSignalType=BOOLEAN, ComSystemTemplateSystemSignalRef=DET_MTD_296
            DET_PROB_1STAZHYPO_293_oRDR_DETECTION_293_296_oPCAN_RADAR_8c08c844_Tx: ComBitPosition=103, ComBitSize=1, ComSignalInitValue=0, ComSignalType=BOOLEAN, ComSystemTemplateSystemSignalRef=DET_PROB_1STAZHYPO_293
            DET_PROB_1STAZHYPO_294_oRDR_DETECTION_293_296_oPCAN_RADAR_d0b8eb2d_Tx: ComBitPosition=215, ComBitSize=1, ComSignalInitValue=0, ComSignalType=BOOLEAN, ComSystemTemplateSystemSignalRef=DET_PROB_1STAZHYPO_294
            DET_PROB_1STAZHYPO_295_oRDR_DETECTION_293_296_oPCAN_RADAR_45c83fb8_Tx: ComBitPosition=327, ComBitSize=1, ComSignalInitValue=0, ComSignalType=BOOLEAN, ComSystemTemplateSystemSignalRef=DET_PROB_1STAZHYPO_295
            DET_PROB_1STAZHYPO_296_oRDR_DETECTION_293_296_oPCAN_RADAR_21284446_Tx: ComBitPosition=439, ComBitSize=1, ComSignalInitValue=0, ComSignalType=BOOLEAN, ComSystemTemplateSystemSignalRef=DET_PROB_1STAZHYPO_296
            DET_RANGE_293_oRDR_DETECTION_293_296_oPCAN_RADAR_87a72b32_Tx: ComBitPosition=24, ComBitSize=15, ComSignalInitValue=0, ComSignalType=UINT16, ComSystemTemplateSystemSignalRef=DET_RANGE_293
            DET_RANGE_294_oRDR_DETECTION_293_296_oPCAN_RADAR_db17085b_Tx: ComBitPosition=136, ComBitSize=15, ComSignalInitValue=0, ComSignalType=UINT16, ComSystemTemplateSystemSignalRef=DET_RANGE_294
            DET_RANGE_295_oRDR_DETECTION_293_296_oPCAN_RADAR_4e67dcce_Tx: ComBitPosition=248, ComBitSize=15, ComSignalInitValue=0, ComSignalType=UINT16, ComSystemTemplateSystemSignalRef=DET_RANGE_295
            DET_RANGE_296_oRDR_DETECTION_293_296_oPCAN_RADAR_2a87a730_Tx: ComBitPosition=360, ComBitSize=15, ComSignalInitValue=0, ComSignalType=UINT16, ComSystemTemplateSystemSignalRef=DET_RANGE_296
            DET_RANGE_ERR_293_oRDR_DETECTION_293_296_oPCAN_RADAR_204f915b_Tx: ComBitPosition=40, ComBitSize=7, ComSignalInitValue=0, ComSignalType=UINT8, ComSystemTemplateSystemSignalRef=DET_RANGE_ERR_293
            DET_RANGE_ERR_294_oRDR_DETECTION_293_296_oPCAN_RADAR_7cffb232_Tx: ComBitPosition=152, ComBitSize=7, ComSignalInitValue=0, ComSignalType=UINT8, ComSystemTemplateSystemSignalRef=DET_RANGE_ERR_294
            DET_RANGE_ERR_295_oRDR_DETECTION_293_296_oPCAN_RADAR_e98f66a7_Tx: ComBitPosition=264, ComBitSize=7, ComSignalInitValue=0, ComSignalType=UINT8, ComSystemTemplateSystemSignalRef=DET_RANGE_ERR_295
            DET_RANGE_ERR_296_oRDR_DETECTION_293_296_oPCAN_RADAR_8d6f1d59_Tx: ComBitPosition=376, ComBitSize=7, ComSignalInitValue=0, ComSignalType=UINT8, ComSystemTemplateSystemSignalRef=DET_RANGE_ERR_296
            DET_RANGE_VELOCITY_293_oRDR_DETECTION_293_296_oPCAN_RADAR_f201e917_Tx: ComBitPosition=48, ComBitSize=15, ComSignalInitValue=16384, ComSignalType=UINT16, ComSystemTemplateSystemSignalRef=DET_RANGE_VELOCITY_293
            DET_RANGE_VELOCITY_294_oRDR_DETECTION_293_296_oPCAN_RADAR_aeb1ca7e_Tx: ComBitPosition=160, ComBitSize=15, ComSignalInitValue=16384, ComSignalType=UINT16, ComSystemTemplateSystemSignalRef=DET_RANGE_VELOCITY_294
            DET_RANGE_VELOCITY_295_oRDR_DETECTION_293_296_oPCAN_RADAR_3bc11eeb_Tx: ComBitPosition=272, ComBitSize=15, ComSignalInitValue=16384, ComSignalType=UINT16, ComSystemTemplateSystemSignalRef=DET_RANGE_VELOCITY_295
            DET_RANGE_VELOCITY_296_oRDR_DETECTION_293_296_oPCAN_RADAR_5f216515_Tx: ComBitPosition=384, ComBitSize=15, ComSignalInitValue=16384, ComSignalType=UINT16, ComSystemTemplateSystemSignalRef=DET_RANGE_VELOCITY_296
            DET_RANGE_VELOCITY_ERR_293_oRDR_DETECTION_293_296_oPCAN_RADAR_fdba12a5_Tx: ComBitPosition=64, ComBitSize=8, ComSignalInitValue=0, ComSignalType=UINT8, ComSystemTemplateSystemSignalRef=DET_RANGE_VELOCITY_ERR_293
            DET_RANGE_VELOCITY_ERR_294_oRDR_DETECTION_293_296_oPCAN_RADAR_a10a31cc_Tx: ComBitPosition=176, ComBitSize=8, ComSignalInitValue=0, ComSignalType=UINT8, ComSystemTemplateSystemSignalRef=DET_RANGE_VELOCITY_ERR_294
            DET_RANGE_VELOCITY_ERR_295_oRDR_DETECTION_293_296_oPCAN_RADAR_347ae559_Tx: ComBitPosition=288, ComBitSize=8, ComSignalInitValue=0, ComSignalType=UINT8, ComSystemTemplateSystemSignalRef=DET_RANGE_VELOCITY_ERR_295
            DET_RANGE_VELOCITY_ERR_296_oRDR_DETECTION_293_296_oPCAN_RADAR_509a9ea7_Tx: ComBitPosition=400, ComBitSize=8, ComSignalInitValue=0, ComSignalType=UINT8, ComSystemTemplateSystemSignalRef=DET_RANGE_VELOCITY_ERR_296
            DET_RCS_293_oRDR_DETECTION_293_296_oPCAN_RADAR_7581de4d_Tx: ComBitPosition=128, ComBitSize=8, ComSignalInitValue=128, ComSignalType=UINT8, ComSystemTemplateSystemSignalRef=DET_RCS_293
            DET_RCS_294_oRDR_DETECTION_293_296_oPCAN_RADAR_2931fd24_Tx: ComBitPosition=240, ComBitSize=8, ComSignalInitValue=128, ComSignalType=UINT8, ComSystemTemplateSystemSignalRef=DET_RCS_294
            DET_RCS_295_oRDR_DETECTION_293_296_oPCAN_RADAR_bc4129b1_Tx: ComBitPosition=352, ComBitSize=8, ComSignalInitValue=128, ComSignalType=UINT8, ComSystemTemplateSystemSignalRef=DET_RCS_295
            DET_RCS_296_oRDR_DETECTION_293_296_oPCAN_RADAR_d8a1524f_Tx: ComBitPosition=464, ComBitSize=8, ComSignalInitValue=128, ComSignalType=UINT8, ComSystemTemplateSystemSignalRef=DET_RCS_296
            DET_SNR_293_oRDR_DETECTION_293_296_oPCAN_RADAR_a82f8a4f_Tx: ComBitPosition=120, ComBitSize=8, ComSignalInitValue=0, ComSignalType=UINT8, ComSystemTemplateSystemSignalRef=DET_SNR_293
            DET_SNR_294_oRDR_DETECTION_293_296_oPCAN_RADAR_f49fa926_Tx: ComBitPosition=232, ComBitSize=8, ComSignalInitValue=0, ComSignalType=UINT8, ComSystemTemplateSystemSignalRef=DET_SNR_294
            DET_SNR_295_oRDR_DETECTION_293_296_oPCAN_RADAR_61ef7db3_Tx: ComBitPosition=344, ComBitSize=8, ComSignalInitValue=0, ComSignalType=UINT8, ComSystemTemplateSystemSignalRef=DET_SNR_295
            DET_SNR_296_oRDR_DETECTION_293_296_oPCAN_RADAR_050f064d_Tx: ComBitPosition=456, ComBitSize=8, ComSignalInitValue=0, ComSignalType=UINT8, ComSystemTemplateSystemSignalRef=DET_SNR_296
            DET_SUPER_RES_TARGET_293_oRDR_DETECTION_293_296_oPCAN_RADAR_99b6a22a_Tx: ComBitPosition=87, ComBitSize=1, ComSignalInitValue=0, ComSignalType=BOOLEAN, ComSystemTemplateSystemSignalRef=DET_SUPER_RES_TARGET_293
            DET_SUPER_RES_TARGET_294_oRDR_DETECTION_293_296_oPCAN_RADAR_c5068143_Tx: ComBitPosition=199, ComBitSize=1, ComSignalInitValue=0, ComSignalType=BOOLEAN, ComSystemTemplateSystemSignalRef=DET_SUPER_RES_TARGET_294
            DET_SUPER_RES_TARGET_295_oRDR_DETECTION_293_296_oPCAN_RADAR_507655d6_Tx: ComBitPosition=311, ComBitSize=1, ComSignalInitValue=0, ComSignalType=BOOLEAN, ComSystemTemplateSystemSignalRef=DET_SUPER_RES_TARGET_295
            DET_SUPER_RES_TARGET_296_oRDR_DETECTION_293_296_oPCAN_RADAR_34962e28_Tx: ComBitPosition=423, ComBitSize=1, ComSignalInitValue=0, ComSignalType=BOOLEAN, ComSystemTemplateSystemSignalRef=DET_SUPER_RES_TARGET_296
        SG_Detections_297_300_oRDR_DETECTION_297_300_oPCAN_RADAR_59a3068e_Tx: ComSystemTemplateSignalGroupRef=SG_Detections_297_300
          83 x ComGroupSignal, all with ComSignalEndianness=LITTLE_ENDIAN, ComTransferProperty=PENDING:
            DET_AZIMUTH_297_oRDR_DETECTION_297_300_oPCAN_RADAR_6b2cdca4_Tx: ComBitPosition=88, ComBitSize=13, ComSignalInitValue=0, ComSignalType=UINT16, ComSystemTemplateSystemSignalRef=DET_AZIMUTH_297
            DET_AZIMUTH_298_oRDR_DETECTION_297_300_oPCAN_RADAR_473c4ee3_Tx: ComBitPosition=200, ComBitSize=13, ComSignalInitValue=0, ComSignalType=UINT16, ComSystemTemplateSystemSignalRef=DET_AZIMUTH_298
            DET_AZIMUTH_299_oRDR_DETECTION_297_300_oPCAN_RADAR_d24c9a76_Tx: ComBitPosition=312, ComBitSize=13, ComSignalInitValue=0, ComSignalType=UINT16, ComSystemTemplateSystemSignalRef=DET_AZIMUTH_299
            DET_AZIMUTH_300_oRDR_DETECTION_297_300_oPCAN_RADAR_e642b84e_Tx: ComBitPosition=424, ComBitSize=13, ComSignalInitValue=0, ComSignalType=UINT16, ComSystemTemplateSystemSignalRef=DET_AZIMUTH_300
            DET_AZIMUTH_ERR_297_oRDR_DETECTION_297_300_oPCAN_RADAR_cf994951_Tx: ComBitPosition=105, ComBitSize=7, ComSignalInitValue=0, ComSignalType=UINT8, ComSystemTemplateSystemSignalRef=DET_AZIMUTH_ERR_297
            DET_AZIMUTH_ERR_298_oRDR_DETECTION_297_300_oPCAN_RADAR_e389db16_Tx: ComBitPosition=217, ComBitSize=7, ComSignalInitValue=0, ComSignalType=UINT8, ComSystemTemplateSystemSignalRef=DET_AZIMUTH_ERR_298
            DET_AZIMUTH_ERR_299_oRDR_DETECTION_297_300_oPCAN_RADAR_76f90f83_Tx: ComBitPosition=329, ComBitSize=7, ComSignalInitValue=0, ComSignalType=UINT8, ComSystemTemplateSystemSignalRef=DET_AZIMUTH_ERR_299
            DET_AZIMUTH_ERR_300_oRDR_DETECTION_297_300_oPCAN_RADAR_42f72dbb_Tx: ComBitPosition=441, ComBitSize=7, ComSignalInitValue=0, ComSignalType=UINT8, ComSystemTemplateSystemSignalRef=DET_AZIMUTH_ERR_300
            DET_BELOW_RAIN_THOLD_297_oRDR_DETECTION_297_300_oPCAN_RADAR_be2d4f64_Tx: ComBitPosition=39, ComBitSize=1, ComSignalInitValue=0, ComSignalType=BOOLEAN, ComSystemTemplateSystemSignalRef=DET_BELOW_RAIN_THOLD_297
            DET_BELOW_RAIN_THOLD_298_oRDR_DETECTION_297_300_oPCAN_RADAR_923ddd23_Tx: ComBitPosition=151, ComBitSize=1, ComSignalInitValue=0, ComSignalType=BOOLEAN, ComSystemTemplateSystemSignalRef=DET_BELOW_RAIN_THOLD_298
            DET_BELOW_RAIN_THOLD_299_oRDR_DETECTION_297_300_oPCAN_RADAR_074d09b6_Tx: ComBitPosition=263, ComBitSize=1, ComSignalInitValue=0, ComSignalType=BOOLEAN, ComSystemTemplateSystemSignalRef=DET_BELOW_RAIN_THOLD_299
            DET_BELOW_RAIN_THOLD_300_oRDR_DETECTION_297_300_oPCAN_RADAR_33432b8e_Tx: ComBitPosition=375, ComBitSize=1, ComSignalInitValue=0, ComSignalType=BOOLEAN, ComSystemTemplateSystemSignalRef=DET_BELOW_RAIN_THOLD_300
            DET_BI_STATIC_FLAG_297_oRDR_DETECTION_297_300_oPCAN_RADAR_3d009c21_Tx: ComBitPosition=104, ComBitSize=1, ComSignalInitValue=0, ComSignalType=BOOLEAN, ComSystemTemplateSystemSignalRef=DET_BI_STATIC_FLAG_297
            DET_BI_STATIC_FLAG_298_oRDR_DETECTION_297_300_oPCAN_RADAR_11100e66_Tx: ComBitPosition=216, ComBitSize=1, ComSignalInitValue=0, ComSignalType=BOOLEAN, ComSystemTemplateSystemSignalRef=DET_BI_STATIC_FLAG_298
            DET_BI_STATIC_FLAG_299_oRDR_DETECTION_297_300_oPCAN_RADAR_8460daf3_Tx: ComBitPosition=328, ComBitSize=1, ComSignalInitValue=0, ComSignalType=BOOLEAN, ComSystemTemplateSystemSignalRef=DET_BI_STATIC_FLAG_299
            DET_BI_STATIC_FLAG_300_oRDR_DETECTION_297_300_oPCAN_RADAR_b06ef8cb_Tx: ComBitPosition=440, ComBitSize=1, ComSignalInitValue=0, ComSignalType=BOOLEAN, ComSystemTemplateSystemSignalRef=DET_BI_STATIC_FLAG_300
            DET_CONFD_AZIMUTH_297_oRDR_DETECTION_297_300_oPCAN_RADAR_69cad66e_Tx: ComBitPosition=118, ComBitSize=2, ComSignalInitValue=0, ComSignalType=UINT8, ComSystemTemplateSystemSignalRef=DET_CONFD_AZIMUTH_297
            DET_CONFD_AZIMUTH_298_oRDR_DETECTION_297_300_oPCAN_RADAR_45da4429_Tx: ComBitPosition=230, ComBitSize=2, ComSignalInitValue=0, ComSignalType=UINT8, ComSystemTemplateSystemSignalRef=DET_CONFD_AZIMUTH_298
            DET_CONFD_AZIMUTH_299_oRDR_DETECTION_297_300_oPCAN_RADAR_d0aa90bc_Tx: ComBitPosition=342, ComBitSize=2, ComSignalInitValue=0, ComSignalType=UINT8, ComSystemTemplateSystemSignalRef=DET_CONFD_AZIMUTH_299
            DET_CONFD_AZIMUTH_300_oRDR_DETECTION_297_300_oPCAN_RADAR_e4a4b284_Tx: ComBitPosition=454, ComBitSize=2, ComSignalInitValue=0, ComSignalType=UINT8, ComSystemTemplateSystemSignalRef=DET_CONFD_AZIMUTH_300
            DET_CONFD_ELEVATION_297_oRDR_DETECTION_297_300_oPCAN_RADAR_6b5fd794_Tx: ComBitPosition=101, ComBitSize=2, ComSignalInitValue=0, ComSignalType=UINT8, ComSystemTemplateSystemSignalRef=DET_CONFD_ELEVATION_297
            DET_CONFD_ELEVATION_298_oRDR_DETECTION_297_300_oPCAN_RADAR_474f45d3_Tx: ComBitPosition=213, ComBitSize=2, ComSignalInitValue=0, ComSignalType=UINT8, ComSystemTemplateSystemSignalRef=DET_CONFD_ELEVATION_298
            DET_CONFD_ELEVATION_299_oRDR_DETECTION_297_300_oPCAN_RADAR_d23f9146_Tx: ComBitPosition=325, ComBitSize=2, ComSignalInitValue=0, ComSignalType=UINT8, ComSystemTemplateSystemSignalRef=DET_CONFD_ELEVATION_299
            DET_CONFD_ELEVATION_300_oRDR_DETECTION_297_300_oPCAN_RADAR_e631b37e_Tx: ComBitPosition=437, ComBitSize=2, ComSignalInitValue=0, ComSignalType=UINT8, ComSystemTemplateSystemSignalRef=DET_CONFD_ELEVATION_300
            DET_ELEVATION_297_oRDR_DETECTION_297_300_oPCAN_RADAR_ba9f03a8_Tx: ComBitPosition=72, ComBitSize=8, ComSignalInitValue=0, ComSignalType=UINT8, ComSystemTemplateSystemSignalRef=DET_ELEVATION_297
            DET_ELEVATION_298_oRDR_DETECTION_297_300_oPCAN_RADAR_968f91ef_Tx: ComBitPosition=184, ComBitSize=8, ComSignalInitValue=0, ComSignalType=UINT8, ComSystemTemplateSystemSignalRef=DET_ELEVATION_298
            DET_ELEVATION_299_oRDR_DETECTION_297_300_oPCAN_RADAR_03ff457a_Tx: ComBitPosition=296, ComBitSize=8, ComSignalInitValue=0, ComSignalType=UINT8, ComSystemTemplateSystemSignalRef=DET_ELEVATION_299
            DET_ELEVATION_300_oRDR_DETECTION_297_300_oPCAN_RADAR_37f16742_Tx: ComBitPosition=408, ComBitSize=8, ComSignalInitValue=0, ComSignalType=UINT8, ComSystemTemplateSystemSignalRef=DET_ELEVATION_300
            DET_ELEVATION_ERR_297_oRDR_DETECTION_297_300_oPCAN_RADAR_3da69bdd_Tx: ComBitPosition=80, ComBitSize=6, ComSignalInitValue=0, ComSignalType=UINT8, ComSystemTemplateSystemSignalRef=DET_ELEVATION_ERR_297
            DET_ELEVATION_ERR_298_oRDR_DETECTION_297_300_oPCAN_RADAR_11b6099a_Tx: ComBitPosition=192, ComBitSize=6, ComSignalInitValue=0, ComSignalType=UINT8, ComSystemTemplateSystemSignalRef=DET_ELEVATION_ERR_298
            DET_ELEVATION_ERR_299_oRDR_DETECTION_297_300_oPCAN_RADAR_84c6dd0f_Tx: ComBitPosition=304, ComBitSize=6, ComSignalInitValue=0, ComSignalType=UINT8, ComSystemTemplateSystemSignalRef=DET_ELEVATION_ERR_299
            DET_ELEVATION_ERR_300_oRDR_DETECTION_297_300_oPCAN_RADAR_b0c8ff37_Tx: ComBitPosition=416, ComBitSize=6, ComSignalInitValue=0, ComSignalType=UINT8, ComSystemTemplateSystemSignalRef=DET_ELEVATION_ERR_300
            DET_EXISTENCE_PROB_297_oRDR_DETECTION_297_300_oPCAN_RADAR_ef39eebd_Tx: ComBitPosition=112, ComBitSize=6, ComSignalInitValue=0, ComSignalType=UINT8, ComSystemTemplateSystemSignalRef=DET_EXISTENCE_PROB_297
            DET_EXISTENCE_PROB_298_oRDR_DETECTION_297_300_oPCAN_RADAR_c3297cfa_Tx: ComBitPosition=224, ComBitSize=6, ComSignalInitValue=0, ComSignalType=UINT8, ComSystemTemplateSystemSignalRef=DET_EXISTENCE_PROB_298
            DET_EXISTENCE_PROB_299_oRDR_DETECTION_297_300_oPCAN_RADAR_5659a86f_Tx: ComBitPosition=336, ComBitSize=6, ComSignalInitValue=0, ComSignalType=UINT8, ComSystemTemplateSystemSignalRef=DET_EXISTENCE_PROB_299
            DET_EXISTENCE_PROB_300_oRDR_DETECTION_297_300_oPCAN_RADAR_62578a57_Tx: ComBitPosition=448, ComBitSize=6, ComSignalInitValue=0, ComSignalType=UINT8, ComSystemTemplateSystemSignalRef=DET_EXISTENCE_PROB_300
            DET_HVC_FLAG_297_oRDR_DETECTION_297_300_oPCAN_RADAR_0e4dadc2_Tx: ComBitPosition=86, ComBitSize=1, ComSignalInitValue=0, ComSignalType=BOOLEAN, ComSystemTemplateSystemSignalRef=DET_HVC_FLAG_297
            DET_HVC_FLAG_298_oRDR_DETECTION_297_300_oPCAN_RADAR_225d3f85_Tx: ComBitPosition=198, ComBitSize=1, ComSignalInitValue=0, ComSignalType=BOOLEAN, ComSystemTemplateSystemSignalRef=DET_HVC_FLAG_298
            DET_HVC_FLAG_299_oRDR_DETECTION_297_300_oPCAN_RADAR_b72deb10_Tx: ComBitPosition=310, ComBitSize=1, ComSignalInitValue=0, ComSignalType=BOOLEAN, ComSystemTemplateSystemSignalRef=DET_HVC_FLAG_299
            DET_HVC_FLAG_300_oRDR_DETECTION_297_300_oPCAN_RADAR_8323c928_Tx: ComBitPosition=422, ComBitSize=1, ComSignalInitValue=0, ComSignalType=BOOLEAN, ComSystemTemplateSystemSignalRef=DET_HVC_FLAG_300
            DET_IDM_297_oRDR_DETECTION_297_300_oPCAN_RADAR_851f967f_Tx: ComBitPosition=63, ComBitSize=1, ComSignalInitValue=0, ComSignalType=BOOLEAN, ComSystemTemplateSystemSignalRef=DET_IDM_297
            DET_IDM_298_oRDR_DETECTION_297_300_oPCAN_RADAR_a90f0438_Tx: ComBitPosition=175, ComBitSize=1, ComSignalInitValue=0, ComSignalType=BOOLEAN, ComSystemTemplateSystemSignalRef=DET_IDM_298
            DET_IDM_299_oRDR_DETECTION_297_300_oPCAN_RADAR_3c7fd0ad_Tx: ComBitPosition=287, ComBitSize=1, ComSignalInitValue=0, ComSignalType=BOOLEAN, ComSystemTemplateSystemSignalRef=DET_IDM_299
            DET_IDM_300_oRDR_DETECTION_297_300_oPCAN_RADAR_0871f295_Tx: ComBitPosition=399, ComBitSize=1, ComSignalInitValue=0, ComSignalType=BOOLEAN, ComSystemTemplateSystemSignalRef=DET_IDM_300
            DET_MH_CRC16_297_300_oRDR_DETECTION_297_300_oPCAN_RADAR_dd2bd485_Tx: ComBitPosition=0, ComBitSize=16, ComSignalInitValue=0, ComSignalType=UINT16, ComSystemTemplateSystemSignalRef=DET_MH_CRC16_297_300
            DET_MH_CYCLE_COUNTER_297_300_oRDR_DETECTION_297_300_oPCAN_RADAR_595e75b2_Tx: ComBitPosition=16, ComBitSize=8, ComSignalInitValue=0, ComSignalType=UINT8, ComSystemTemplateSystemSignalRef=DET_MH_CYCLE_COUNTER_297_300
            DET_MH_SCAN_INDEX_4LSB_297_300_oRDR_DETECTION_297_300_oPCAN_RADAR_9574503e_Tx: ComBitPosition=476, ComBitSize=4, ComSignalInitValue=0, ComSignalType=UINT8, ComSystemTemplateSystemSignalRef=DET_MH_SCAN_INDEX_4LSB_297_300
            DET_MTD_297_oRDR_DETECTION_297_300_oPCAN_RADAR_e3aca4a4_Tx: ComBitPosition=47, ComBitSize=1, ComSignalInitValue=0, ComSignalType=BOOLEAN, ComSystemTemplateSystemSignalRef=DET_MTD_297
            DET_MTD_298_oRDR_DETECTION_297_300_oPCAN_RADAR_cfbc36e3_Tx: ComBitPosition=159, ComBitSize=1, ComSignalInitValue=0, ComSignalType=BOOLEAN, ComSystemTemplateSystemSignalRef=DET_MTD_298
            DET_MTD_299_oRDR_DETECTION_297_300_oPCAN_RADAR_5acce276_Tx: ComBitPosition=271, ComBitSize=1, ComSignalInitValue=0, ComSignalType=BOOLEAN, ComSystemTemplateSystemSignalRef=DET_MTD_299
            DET_MTD_300_oRDR_DETECTION_297_300_oPCAN_RADAR_6ec2c04e_Tx: ComBitPosition=383, ComBitSize=1, ComSignalInitValue=0, ComSignalType=BOOLEAN, ComSystemTemplateSystemSignalRef=DET_MTD_300
            DET_PROB_1STAZHYPO_297_oRDR_DETECTION_297_300_oPCAN_RADAR_70184c69_Tx: ComBitPosition=103, ComBitSize=1, ComSignalInitValue=0, ComSignalType=BOOLEAN, ComSystemTemplateSystemSignalRef=DET_PROB_1STAZHYPO_297
            DET_PROB_1STAZHYPO_298_oRDR_DETECTION_297_300_oPCAN_RADAR_5c08de2e_Tx: ComBitPosition=215, ComBitSize=1, ComSignalInitValue=0, ComSignalType=BOOLEAN, ComSystemTemplateSystemSignalRef=DET_PROB_1STAZHYPO_298
            DET_PROB_1STAZHYPO_299_oRDR_DETECTION_297_300_oPCAN_RADAR_c9780abb_Tx: ComBitPosition=327, ComBitSize=1, ComSignalInitValue=0, ComSignalType=BOOLEAN, ComSystemTemplateSystemSignalRef=DET_PROB_1STAZHYPO_299
            DET_PROB_1STAZHYPO_300_oRDR_DETECTION_297_300_oPCAN_RADAR_fd762883_Tx: ComBitPosition=439, ComBitSize=1, ComSignalInitValue=0, ComSignalType=BOOLEAN, ComSystemTemplateSystemSignalRef=DET_PROB_1STAZHYPO_300
            DET_RANGE_297_oRDR_DETECTION_297_300_oPCAN_RADAR_7bb7af1f_Tx: ComBitPosition=24, ComBitSize=15, ComSignalInitValue=0, ComSignalType=UINT16, ComSystemTemplateSystemSignalRef=DET_RANGE_297
            DET_RANGE_298_oRDR_DETECTION_297_300_oPCAN_RADAR_57a73d58_Tx: ComBitPosition=136, ComBitSize=15, ComSignalInitValue=0, ComSignalType=UINT16, ComSystemTemplateSystemSignalRef=DET_RANGE_298
            DET_RANGE_299_oRDR_DETECTION_297_300_oPCAN_RADAR_c2d7e9cd_Tx: ComBitPosition=248, ComBitSize=15, ComSignalInitValue=0, ComSignalType=UINT16, ComSystemTemplateSystemSignalRef=DET_RANGE_299
            DET_RANGE_300_oRDR_DETECTION_297_300_oPCAN_RADAR_f6d9cbf5_Tx: ComBitPosition=360, ComBitSize=15, ComSignalInitValue=0, ComSignalType=UINT16, ComSystemTemplateSystemSignalRef=DET_RANGE_300
            DET_RANGE_ERR_297_oRDR_DETECTION_297_300_oPCAN_RADAR_dc5f1576_Tx: ComBitPosition=40, ComBitSize=7, ComSignalInitValue=0, ComSignalType=UINT8, ComSystemTemplateSystemSignalRef=DET_RANGE_ERR_297
            DET_RANGE_ERR_298_oRDR_DETECTION_297_300_oPCAN_RADAR_f04f8731_Tx: ComBitPosition=152, ComBitSize=7, ComSignalInitValue=0, ComSignalType=UINT8, ComSystemTemplateSystemSignalRef=DET_RANGE_ERR_298
            DET_RANGE_ERR_299_oRDR_DETECTION_297_300_oPCAN_RADAR_653f53a4_Tx: ComBitPosition=264, ComBitSize=7, ComSignalInitValue=0, ComSignalType=UINT8, ComSystemTemplateSystemSignalRef=DET_RANGE_ERR_299
            DET_RANGE_ERR_300_oRDR_DETECTION_297_300_oPCAN_RADAR_5131719c_Tx: ComBitPosition=376, ComBitSize=7, ComSignalInitValue=0, ComSignalType=UINT8, ComSystemTemplateSystemSignalRef=DET_RANGE_ERR_300
            DET_RANGE_VELOCITY_297_oRDR_DETECTION_297_300_oPCAN_RADAR_0e116d3a_Tx: ComBitPosition=48, ComBitSize=15, ComSignalInitValue=16384, ComSignalType=UINT16, ComSystemTemplateSystemSignalRef=DET_RANGE_VELOCITY_297
            DET_RANGE_VELOCITY_298_oRDR_DETECTION_297_300_oPCAN_RADAR_2201ff7d_Tx: ComBitPosition=160, ComBitSize=15, ComSignalInitValue=16384, ComSignalType=UINT16, ComSystemTemplateSystemSignalRef=DET_RANGE_VELOCITY_298
            DET_RANGE_VELOCITY_299_oRDR_DETECTION_297_300_oPCAN_RADAR_b7712be8_Tx: ComBitPosition=272, ComBitSize=15, ComSignalInitValue=16384, ComSignalType=UINT16, ComSystemTemplateSystemSignalRef=DET_RANGE_VELOCITY_299
            DET_RANGE_VELOCITY_300_oRDR_DETECTION_297_300_oPCAN_RADAR_837f09d0_Tx: ComBitPosition=384, ComBitSize=15, ComSignalInitValue=16384, ComSignalType=UINT16, ComSystemTemplateSystemSignalRef=DET_RANGE_VELOCITY_300
            DET_RANGE_VELOCITY_ERR_297_oRDR_DETECTION_297_300_oPCAN_RADAR_01aa9688_Tx: ComBitPosition=64, ComBitSize=8, ComSignalInitValue=0, ComSignalType=UINT8, ComSystemTemplateSystemSignalRef=DET_RANGE_VELOCITY_ERR_297
            DET_RANGE_VELOCITY_ERR_298_oRDR_DETECTION_297_300_oPCAN_RADAR_2dba04cf_Tx: ComBitPosition=176, ComBitSize=8, ComSignalInitValue=0, ComSignalType=UINT8, ComSystemTemplateSystemSignalRef=DET_RANGE_VELOCITY_ERR_298
            DET_RANGE_VELOCITY_ERR_299_oRDR_DETECTION_297_300_oPCAN_RADAR_b8cad05a_Tx: ComBitPosition=288, ComBitSize=8, ComSignalInitValue=0, ComSignalType=UINT8, ComSystemTemplateSystemSignalRef=DET_RANGE_VELOCITY_ERR_299
            DET_RANGE_VELOCITY_ERR_300_oRDR_DETECTION_297_300_oPCAN_RADAR_8cc4f262_Tx: ComBitPosition=400, ComBitSize=8, ComSignalInitValue=0, ComSignalType=UINT8, ComSystemTemplateSystemSignalRef=DET_RANGE_VELOCITY_ERR_300
            DET_RCS_297_oRDR_DETECTION_297_300_oPCAN_RADAR_89915a60_Tx: ComBitPosition=128, ComBitSize=8, ComSignalInitValue=128, ComSignalType=UINT8, ComSystemTemplateSystemSignalRef=DET_RCS_297
            DET_RCS_298_oRDR_DETECTION_297_300_oPCAN_RADAR_a581c827_Tx: ComBitPosition=240, ComBitSize=8, ComSignalInitValue=128, ComSignalType=UINT8, ComSystemTemplateSystemSignalRef=DET_RCS_298
            DET_RCS_299_oRDR_DETECTION_297_300_oPCAN_RADAR_30f11cb2_Tx: ComBitPosition=352, ComBitSize=8, ComSignalInitValue=128, ComSignalType=UINT8, ComSystemTemplateSystemSignalRef=DET_RCS_299
            DET_RCS_300_oRDR_DETECTION_297_300_oPCAN_RADAR_04ff3e8a_Tx: ComBitPosition=464, ComBitSize=8, ComSignalInitValue=128, ComSignalType=UINT8, ComSystemTemplateSystemSignalRef=DET_RCS_300
            DET_SNR_297_oRDR_DETECTION_297_300_oPCAN_RADAR_543f0e62_Tx: ComBitPosition=120, ComBitSize=8, ComSignalInitValue=0, ComSignalType=UINT8, ComSystemTemplateSystemSignalRef=DET_SNR_297
            DET_SNR_298_oRDR_DETECTION_297_300_oPCAN_RADAR_782f9c25_Tx: ComBitPosition=232, ComBitSize=8, ComSignalInitValue=0, ComSignalType=UINT8, ComSystemTemplateSystemSignalRef=DET_SNR_298
            DET_SNR_299_oRDR_DETECTION_297_300_oPCAN_RADAR_ed5f48b0_Tx: ComBitPosition=344, ComBitSize=8, ComSignalInitValue=0, ComSignalType=UINT8, ComSystemTemplateSystemSignalRef=DET_SNR_299
            DET_SNR_300_oRDR_DETECTION_297_300_oPCAN_RADAR_d9516a88_Tx: ComBitPosition=456, ComBitSize=8, ComSignalInitValue=0, ComSignalType=UINT8, ComSystemTemplateSystemSignalRef=DET_SNR_300
            DET_SUPER_RES_TARGET_297_oRDR_DETECTION_297_300_oPCAN_RADAR_65a62607_Tx: ComBitPosition=87, ComBitSize=1, ComSignalInitValue=0, ComSignalType=BOOLEAN, ComSystemTemplateSystemSignalRef=DET_SUPER_RES_TARGET_297
            DET_SUPER_RES_TARGET_298_oRDR_DETECTION_297_300_oPCAN_RADAR_49b6b440_Tx: ComBitPosition=199, ComBitSize=1, ComSignalInitValue=0, ComSignalType=BOOLEAN, ComSystemTemplateSystemSignalRef=DET_SUPER_RES_TARGET_298
            DET_SUPER_RES_TARGET_299_oRDR_DETECTION_297_300_oPCAN_RADAR_dcc660d5_Tx: ComBitPosition=311, ComBitSize=1, ComSignalInitValue=0, ComSignalType=BOOLEAN, ComSystemTemplateSystemSignalRef=DET_SUPER_RES_TARGET_299
            DET_SUPER_RES_TARGET_300_oRDR_DETECTION_297_300_oPCAN_RADAR_e8c842ed_Tx: ComBitPosition=423, ComBitSize=1, ComSignalInitValue=0, ComSignalType=BOOLEAN, ComSystemTemplateSystemSignalRef=DET_SUPER_RES_TARGET_300
        SG_Detections_301_304_oRDR_DETECTION_301_304_oPCAN_RADAR_18b0f261_Tx: ComSystemTemplateSignalGroupRef=SG_Detections_301_304
          83 x ComGroupSignal, all with ComSignalEndianness=LITTLE_ENDIAN, ComTransferProperty=PENDING:
            DET_AZIMUTH_301_oRDR_DETECTION_301_304_oPCAN_RADAR_3b5e29f0_Tx: ComBitPosition=88, ComBitSize=13, ComSignalInitValue=0, ComSignalType=UINT16, ComSystemTemplateSystemSignalRef=DET_AZIMUTH_301
            DET_AZIMUTH_302_oRDR_DETECTION_301_304_oPCAN_RADAR_5fbe520e_Tx: ComBitPosition=200, ComBitSize=13, ComSignalInitValue=0, ComSignalType=UINT16, ComSystemTemplateSystemSignalRef=DET_AZIMUTH_302
            DET_AZIMUTH_303_oRDR_DETECTION_301_304_oPCAN_RADAR_cace869b_Tx: ComBitPosition=312, ComBitSize=13, ComSignalInitValue=0, ComSignalType=UINT16, ComSystemTemplateSystemSignalRef=DET_AZIMUTH_303
            DET_AZIMUTH_304_oRDR_DETECTION_301_304_oPCAN_RADAR_967ea5f2_Tx: ComBitPosition=424, ComBitSize=13, ComSignalInitValue=0, ComSignalType=UINT16, ComSystemTemplateSystemSignalRef=DET_AZIMUTH_304
            DET_AZIMUTH_ERR_301_oRDR_DETECTION_301_304_oPCAN_RADAR_9febbc05_Tx: ComBitPosition=105, ComBitSize=7, ComSignalInitValue=0, ComSignalType=UINT8, ComSystemTemplateSystemSignalRef=DET_AZIMUTH_ERR_301
            DET_AZIMUTH_ERR_302_oRDR_DETECTION_301_304_oPCAN_RADAR_fb0bc7fb_Tx: ComBitPosition=217, ComBitSize=7, ComSignalInitValue=0, ComSignalType=UINT8, ComSystemTemplateSystemSignalRef=DET_AZIMUTH_ERR_302
            DET_AZIMUTH_ERR_303_oRDR_DETECTION_301_304_oPCAN_RADAR_6e7b136e_Tx: ComBitPosition=329, ComBitSize=7, ComSignalInitValue=0, ComSignalType=UINT8, ComSystemTemplateSystemSignalRef=DET_AZIMUTH_ERR_303
            DET_AZIMUTH_ERR_304_oRDR_DETECTION_301_304_oPCAN_RADAR_32cb3007_Tx: ComBitPosition=441, ComBitSize=7, ComSignalInitValue=0, ComSignalType=UINT8, ComSystemTemplateSystemSignalRef=DET_AZIMUTH_ERR_304
            DET_BELOW_RAIN_THOLD_301_oRDR_DETECTION_301_304_oPCAN_RADAR_ee5fba30_Tx: ComBitPosition=39, ComBitSize=1, ComSignalInitValue=0, ComSignalType=BOOLEAN, ComSystemTemplateSystemSignalRef=DET_BELOW_RAIN_THOLD_301
            DET_BELOW_RAIN_THOLD_302_oRDR_DETECTION_301_304_oPCAN_RADAR_8abfc1ce_Tx: ComBitPosition=151, ComBitSize=1, ComSignalInitValue=0, ComSignalType=BOOLEAN, ComSystemTemplateSystemSignalRef=DET_BELOW_RAIN_THOLD_302
            DET_BELOW_RAIN_THOLD_303_oRDR_DETECTION_301_304_oPCAN_RADAR_1fcf155b_Tx: ComBitPosition=263, ComBitSize=1, ComSignalInitValue=0, ComSignalType=BOOLEAN, ComSystemTemplateSystemSignalRef=DET_BELOW_RAIN_THOLD_303
            DET_BELOW_RAIN_THOLD_304_oRDR_DETECTION_301_304_oPCAN_RADAR_437f3632_Tx: ComBitPosition=375, ComBitSize=1, ComSignalInitValue=0, ComSignalType=BOOLEAN, ComSystemTemplateSystemSignalRef=DET_BELOW_RAIN_THOLD_304
            DET_BI_STATIC_FLAG_301_oRDR_DETECTION_301_304_oPCAN_RADAR_6d726975_Tx: ComBitPosition=104, ComBitSize=1, ComSignalInitValue=0, ComSignalType=BOOLEAN, ComSystemTemplateSystemSignalRef=DET_BI_STATIC_FLAG_301
            DET_BI_STATIC_FLAG_302_oRDR_DETECTION_301_304_oPCAN_RADAR_0992128b_Tx: ComBitPosition=216, ComBitSize=1, ComSignalInitValue=0, ComSignalType=BOOLEAN, ComSystemTemplateSystemSignalRef=DET_BI_STATIC_FLAG_302
            DET_BI_STATIC_FLAG_303_oRDR_DETECTION_301_304_oPCAN_RADAR_9ce2c61e_Tx: ComBitPosition=328, ComBitSize=1, ComSignalInitValue=0, ComSignalType=BOOLEAN, ComSystemTemplateSystemSignalRef=DET_BI_STATIC_FLAG_303
            DET_BI_STATIC_FLAG_304_oRDR_DETECTION_301_304_oPCAN_RADAR_c052e577_Tx: ComBitPosition=440, ComBitSize=1, ComSignalInitValue=0, ComSignalType=BOOLEAN, ComSystemTemplateSystemSignalRef=DET_BI_STATIC_FLAG_304
            DET_CONFD_AZIMUTH_301_oRDR_DETECTION_301_304_oPCAN_RADAR_39b8233a_Tx: ComBitPosition=118, ComBitSize=2, ComSignalInitValue=0, ComSignalType=UINT8, ComSystemTemplateSystemSignalRef=DET_CONFD_AZIMUTH_301
            DET_CONFD_AZIMUTH_302_oRDR_DETECTION_301_304_oPCAN_RADAR_5d5858c4_Tx: ComBitPosition=230, ComBitSize=2, ComSignalInitValue=0, ComSignalType=UINT8, ComSystemTemplateSystemSignalRef=DET_CONFD_AZIMUTH_302
            DET_CONFD_AZIMUTH_303_oRDR_DETECTION_301_304_oPCAN_RADAR_c8288c51_Tx: ComBitPosition=342, ComBitSize=2, ComSignalInitValue=0, ComSignalType=UINT8, ComSystemTemplateSystemSignalRef=DET_CONFD_AZIMUTH_303
            DET_CONFD_AZIMUTH_304_oRDR_DETECTION_301_304_oPCAN_RADAR_9498af38_Tx: ComBitPosition=454, ComBitSize=2, ComSignalInitValue=0, ComSignalType=UINT8, ComSystemTemplateSystemSignalRef=DET_CONFD_AZIMUTH_304
            DET_CONFD_ELEVATION_301_oRDR_DETECTION_301_304_oPCAN_RADAR_3b2d22c0_Tx: ComBitPosition=101, ComBitSize=2, ComSignalInitValue=0, ComSignalType=UINT8, ComSystemTemplateSystemSignalRef=DET_CONFD_ELEVATION_301
            DET_CONFD_ELEVATION_302_oRDR_DETECTION_301_304_oPCAN_RADAR_5fcd593e_Tx: ComBitPosition=213, ComBitSize=2, ComSignalInitValue=0, ComSignalType=UINT8, ComSystemTemplateSystemSignalRef=DET_CONFD_ELEVATION_302
            DET_CONFD_ELEVATION_303_oRDR_DETECTION_301_304_oPCAN_RADAR_cabd8dab_Tx: ComBitPosition=325, ComBitSize=2, ComSignalInitValue=0, ComSignalType=UINT8, ComSystemTemplateSystemSignalRef=DET_CONFD_ELEVATION_303
            DET_CONFD_ELEVATION_304_oRDR_DETECTION_301_304_oPCAN_RADAR_960daec2_Tx: ComBitPosition=437, ComBitSize=2, ComSignalInitValue=0, ComSignalType=UINT8, ComSystemTemplateSystemSignalRef=DET_CONFD_ELEVATION_304
            DET_ELEVATION_301_oRDR_DETECTION_301_304_oPCAN_RADAR_eaedf6fc_Tx: ComBitPosition=72, ComBitSize=8, ComSignalInitValue=0, ComSignalType=UINT8, ComSystemTemplateSystemSignalRef=DET_ELEVATION_301
            DET_ELEVATION_302_oRDR_DETECTION_301_304_oPCAN_RADAR_8e0d8d02_Tx: ComBitPosition=184, ComBitSize=8, ComSignalInitValue=0, ComSignalType=UINT8, ComSystemTemplateSystemSignalRef=DET_ELEVATION_302
            DET_ELEVATION_303_oRDR_DETECTION_301_304_oPCAN_RADAR_1b7d5997_Tx: ComBitPosition=296, ComBitSize=8, ComSignalInitValue=0, ComSignalType=UINT8, ComSystemTemplateSystemSignalRef=DET_ELEVATION_303
            DET_ELEVATION_304_oRDR_DETECTION_301_304_oPCAN_RADAR_47cd7afe_Tx: ComBitPosition=408, ComBitSize=8, ComSignalInitValue=0, ComSignalType=UINT8, ComSystemTemplateSystemSignalRef=DET_ELEVATION_304
            DET_ELEVATION_ERR_301_oRDR_DETECTION_301_304_oPCAN_RADAR_6dd46e89_Tx: ComBitPosition=80, ComBitSize=6, ComSignalInitValue=0, ComSignalType=UINT8, ComSystemTemplateSystemSignalRef=DET_ELEVATION_ERR_301
            DET_ELEVATION_ERR_302_oRDR_DETECTION_301_304_oPCAN_RADAR_09341577_Tx: ComBitPosition=192, ComBitSize=6, ComSignalInitValue=0, ComSignalType=UINT8, ComSystemTemplateSystemSignalRef=DET_ELEVATION_ERR_302
            DET_ELEVATION_ERR_303_oRDR_DETECTION_301_304_oPCAN_RADAR_9c44c1e2_Tx: ComBitPosition=304, ComBitSize=6, ComSignalInitValue=0, ComSignalType=UINT8, ComSystemTemplateSystemSignalRef=DET_ELEVATION_ERR_303
            DET_ELEVATION_ERR_304_oRDR_DETECTION_301_304_oPCAN_RADAR_c0f4e28b_Tx: ComBitPosition=416, ComBitSize=6, ComSignalInitValue=0, ComSignalType=UINT8, ComSystemTemplateSystemSignalRef=DET_ELEVATION_ERR_304
            DET_EXISTENCE_PROB_301_oRDR_DETECTION_301_304_oPCAN_RADAR_bf4b1be9_Tx: ComBitPosition=112, ComBitSize=6, ComSignalInitValue=0, ComSignalType=UINT8, ComSystemTemplateSystemSignalRef=DET_EXISTENCE_PROB_301
            DET_EXISTENCE_PROB_302_oRDR_DETECTION_301_304_oPCAN_RADAR_dbab6017_Tx: ComBitPosition=224, ComBitSize=6, ComSignalInitValue=0, ComSignalType=UINT8, ComSystemTemplateSystemSignalRef=DET_EXISTENCE_PROB_302
            DET_EXISTENCE_PROB_303_oRDR_DETECTION_301_304_oPCAN_RADAR_4edbb482_Tx: ComBitPosition=336, ComBitSize=6, ComSignalInitValue=0, ComSignalType=UINT8, ComSystemTemplateSystemSignalRef=DET_EXISTENCE_PROB_303
            DET_EXISTENCE_PROB_304_oRDR_DETECTION_301_304_oPCAN_RADAR_126b97eb_Tx: ComBitPosition=448, ComBitSize=6, ComSignalInitValue=0, ComSignalType=UINT8, ComSystemTemplateSystemSignalRef=DET_EXISTENCE_PROB_304
            DET_HVC_FLAG_301_oRDR_DETECTION_301_304_oPCAN_RADAR_5e3f5896_Tx: ComBitPosition=86, ComBitSize=1, ComSignalInitValue=0, ComSignalType=BOOLEAN, ComSystemTemplateSystemSignalRef=DET_HVC_FLAG_301
            DET_HVC_FLAG_302_oRDR_DETECTION_301_304_oPCAN_RADAR_3adf2368_Tx: ComBitPosition=198, ComBitSize=1, ComSignalInitValue=0, ComSignalType=BOOLEAN, ComSystemTemplateSystemSignalRef=DET_HVC_FLAG_302
            DET_HVC_FLAG_303_oRDR_DETECTION_301_304_oPCAN_RADAR_afaff7fd_Tx: ComBitPosition=310, ComBitSize=1, ComSignalInitValue=0, ComSignalType=BOOLEAN, ComSystemTemplateSystemSignalRef=DET_HVC_FLAG_303
            DET_HVC_FLAG_304_oRDR_DETECTION_301_304_oPCAN_RADAR_f31fd494_Tx: ComBitPosition=422, ComBitSize=1, ComSignalInitValue=0, ComSignalType=BOOLEAN, ComSystemTemplateSystemSignalRef=DET_HVC_FLAG_304
            DET_IDM_301_oRDR_DETECTION_301_304_oPCAN_RADAR_d56d632b_Tx: ComBitPosition=63, ComBitSize=1, ComSignalInitValue=0, ComSignalType=BOOLEAN, ComSystemTemplateSystemSignalRef=DET_IDM_301
            DET_IDM_302_oRDR_DETECTION_301_304_oPCAN_RADAR_b18d18d5_Tx: ComBitPosition=175, ComBitSize=1, ComSignalInitValue=0, ComSignalType=BOOLEAN, ComSystemTemplateSystemSignalRef=DET_IDM_302
            DET_IDM_303_oRDR_DETECTION_301_304_oPCAN_RADAR_24fdcc40_Tx: ComBitPosition=287, ComBitSize=1, ComSignalInitValue=0, ComSignalType=BOOLEAN, ComSystemTemplateSystemSignalRef=DET_IDM_303
            DET_IDM_304_oRDR_DETECTION_301_304_oPCAN_RADAR_784def29_Tx: ComBitPosition=399, ComBitSize=1, ComSignalInitValue=0, ComSignalType=BOOLEAN, ComSystemTemplateSystemSignalRef=DET_IDM_304
            DET_MH_CRC16_301_304_oRDR_DETECTION_301_304_oPCAN_RADAR_9c38206a_Tx: ComBitPosition=0, ComBitSize=16, ComSignalInitValue=0, ComSignalType=UINT16, ComSystemTemplateSystemSignalRef=DET_MH_CRC16_301_304
            DET_MH_CYCLE_COUNTER_301_304_oRDR_DETECTION_301_304_oPCAN_RADAR_184d815d_Tx: ComBitPosition=16, ComBitSize=8, ComSignalInitValue=0, ComSignalType=UINT8, ComSystemTemplateSystemSignalRef=DET_MH_CYCLE_COUNTER_301_304
            DET_MH_SCAN_INDEX_4LSB_301_304_oRDR_DETECTION_301_304_oPCAN_RADAR_d467a4d1_Tx: ComBitPosition=476, ComBitSize=4, ComSignalInitValue=0, ComSignalType=UINT8, ComSystemTemplateSystemSignalRef=DET_MH_SCAN_INDEX_4LSB_301_304
            DET_MTD_301_oRDR_DETECTION_301_304_oPCAN_RADAR_b3de51f0_Tx: ComBitPosition=47, ComBitSize=1, ComSignalInitValue=0, ComSignalType=BOOLEAN, ComSystemTemplateSystemSignalRef=DET_MTD_301
            DET_MTD_302_oRDR_DETECTION_301_304_oPCAN_RADAR_d73e2a0e_Tx: ComBitPosition=159, ComBitSize=1, ComSignalInitValue=0, ComSignalType=BOOLEAN, ComSystemTemplateSystemSignalRef=DET_MTD_302
            DET_MTD_303_oRDR_DETECTION_301_304_oPCAN_RADAR_424efe9b_Tx: ComBitPosition=271, ComBitSize=1, ComSignalInitValue=0, ComSignalType=BOOLEAN, ComSystemTemplateSystemSignalRef=DET_MTD_303
            DET_MTD_304_oRDR_DETECTION_301_304_oPCAN_RADAR_1efeddf2_Tx: ComBitPosition=383, ComBitSize=1, ComSignalInitValue=0, ComSignalType=BOOLEAN, ComSystemTemplateSystemSignalRef=DET_MTD_304
            DET_PROB_1STAZHYPO_301_oRDR_DETECTION_301_304_oPCAN_RADAR_206ab93d_Tx: ComBitPosition=103, ComBitSize=1, ComSignalInitValue=0, ComSignalType=BOOLEAN, ComSystemTemplateSystemSignalRef=DET_PROB_1STAZHYPO_301
            DET_PROB_1STAZHYPO_302_oRDR_DETECTION_301_304_oPCAN_RADAR_448ac2c3_Tx: ComBitPosition=215, ComBitSize=1, ComSignalInitValue=0, ComSignalType=BOOLEAN, ComSystemTemplateSystemSignalRef=DET_PROB_1STAZHYPO_302
            DET_PROB_1STAZHYPO_303_oRDR_DETECTION_301_304_oPCAN_RADAR_d1fa1656_Tx: ComBitPosition=327, ComBitSize=1, ComSignalInitValue=0, ComSignalType=BOOLEAN, ComSystemTemplateSystemSignalRef=DET_PROB_1STAZHYPO_303
            DET_PROB_1STAZHYPO_304_oRDR_DETECTION_301_304_oPCAN_RADAR_8d4a353f_Tx: ComBitPosition=439, ComBitSize=1, ComSignalInitValue=0, ComSignalType=BOOLEAN, ComSystemTemplateSystemSignalRef=DET_PROB_1STAZHYPO_304
            DET_RANGE_301_oRDR_DETECTION_301_304_oPCAN_RADAR_2bc55a4b_Tx: ComBitPosition=24, ComBitSize=15, ComSignalInitValue=0, ComSignalType=UINT16, ComSystemTemplateSystemSignalRef=DET_RANGE_301
            DET_RANGE_302_oRDR_DETECTION_301_304_oPCAN_RADAR_4f2521b5_Tx: ComBitPosition=136, ComBitSize=15, ComSignalInitValue=0, ComSignalType=UINT16, ComSystemTemplateSystemSignalRef=DET_RANGE_302
            DET_RANGE_303_oRDR_DETECTION_301_304_oPCAN_RADAR_da55f520_Tx: ComBitPosition=248, ComBitSize=15, ComSignalInitValue=0, ComSignalType=UINT16, ComSystemTemplateSystemSignalRef=DET_RANGE_303
            DET_RANGE_304_oRDR_DETECTION_301_304_oPCAN_RADAR_86e5d649_Tx: ComBitPosition=360, ComBitSize=15, ComSignalInitValue=0, ComSignalType=UINT16, ComSystemTemplateSystemSignalRef=DET_RANGE_304
            DET_RANGE_ERR_301_oRDR_DETECTION_301_304_oPCAN_RADAR_8c2de022_Tx: ComBitPosition=40, ComBitSize=7, ComSignalInitValue=0, ComSignalType=UINT8, ComSystemTemplateSystemSignalRef=DET_RANGE_ERR_301
            DET_RANGE_ERR_302_oRDR_DETECTION_301_304_oPCAN_RADAR_e8cd9bdc_Tx: ComBitPosition=152, ComBitSize=7, ComSignalInitValue=0, ComSignalType=UINT8, ComSystemTemplateSystemSignalRef=DET_RANGE_ERR_302
            DET_RANGE_ERR_303_oRDR_DETECTION_301_304_oPCAN_RADAR_7dbd4f49_Tx: ComBitPosition=264, ComBitSize=7, ComSignalInitValue=0, ComSignalType=UINT8, ComSystemTemplateSystemSignalRef=DET_RANGE_ERR_303
            DET_RANGE_ERR_304_oRDR_DETECTION_301_304_oPCAN_RADAR_210d6c20_Tx: ComBitPosition=376, ComBitSize=7, ComSignalInitValue=0, ComSignalType=UINT8, ComSystemTemplateSystemSignalRef=DET_RANGE_ERR_304
            DET_RANGE_VELOCITY_301_oRDR_DETECTION_301_304_oPCAN_RADAR_5e63986e_Tx: ComBitPosition=48, ComBitSize=15, ComSignalInitValue=16384, ComSignalType=UINT16, ComSystemTemplateSystemSignalRef=DET_RANGE_VELOCITY_301
            DET_RANGE_VELOCITY_302_oRDR_DETECTION_301_304_oPCAN_RADAR_3a83e390_Tx: ComBitPosition=160, ComBitSize=15, ComSignalInitValue=16384, ComSignalType=UINT16, ComSystemTemplateSystemSignalRef=DET_RANGE_VELOCITY_302
            DET_RANGE_VELOCITY_303_oRDR_DETECTION_301_304_oPCAN_RADAR_aff33705_Tx: ComBitPosition=272, ComBitSize=15, ComSignalInitValue=16384, ComSignalType=UINT16, ComSystemTemplateSystemSignalRef=DET_RANGE_VELOCITY_303
            DET_RANGE_VELOCITY_304_oRDR_DETECTION_301_304_oPCAN_RADAR_f343146c_Tx: ComBitPosition=384, ComBitSize=15, ComSignalInitValue=16384, ComSignalType=UINT16, ComSystemTemplateSystemSignalRef=DET_RANGE_VELOCITY_304
            DET_RANGE_VELOCITY_ERR_301_oRDR_DETECTION_301_304_oPCAN_RADAR_51d863dc_Tx: ComBitPosition=64, ComBitSize=8, ComSignalInitValue=0, ComSignalType=UINT8, ComSystemTemplateSystemSignalRef=DET_RANGE_VELOCITY_ERR_301
            DET_RANGE_VELOCITY_ERR_302_oRDR_DETECTION_301_304_oPCAN_RADAR_35381822_Tx: ComBitPosition=176, ComBitSize=8, ComSignalInitValue=0, ComSignalType=UINT8, ComSystemTemplateSystemSignalRef=DET_RANGE_VELOCITY_ERR_302
            DET_RANGE_VELOCITY_ERR_303_oRDR_DETECTION_301_304_oPCAN_RADAR_a048ccb7_Tx: ComBitPosition=288, ComBitSize=8, ComSignalInitValue=0, ComSignalType=UINT8, ComSystemTemplateSystemSignalRef=DET_RANGE_VELOCITY_ERR_303
            DET_RANGE_VELOCITY_ERR_304_oRDR_DETECTION_301_304_oPCAN_RADAR_fcf8efde_Tx: ComBitPosition=400, ComBitSize=8, ComSignalInitValue=0, ComSignalType=UINT8, ComSystemTemplateSystemSignalRef=DET_RANGE_VELOCITY_ERR_304
            DET_RCS_301_oRDR_DETECTION_301_304_oPCAN_RADAR_d9e3af34_Tx: ComBitPosition=128, ComBitSize=8, ComSignalInitValue=128, ComSignalType=UINT8, ComSystemTemplateSystemSignalRef=DET_RCS_301
            DET_RCS_302_oRDR_DETECTION_301_304_oPCAN_RADAR_bd03d4ca_Tx: ComBitPosition=240, ComBitSize=8, ComSignalInitValue=128, ComSignalType=UINT8, ComSystemTemplateSystemSignalRef=DET_RCS_302
            DET_RCS_303_oRDR_DETECTION_301_304_oPCAN_RADAR_2873005f_Tx: ComBitPosition=352, ComBitSize=8, ComSignalInitValue=128, ComSignalType=UINT8, ComSystemTemplateSystemSignalRef=DET_RCS_303
            DET_RCS_304_oRDR_DETECTION_301_304_oPCAN_RADAR_74c32336_Tx: ComBitPosition=464, ComBitSize=8, ComSignalInitValue=128, ComSignalType=UINT8, ComSystemTemplateSystemSignalRef=DET_RCS_304
            DET_SNR_301_oRDR_DETECTION_301_304_oPCAN_RADAR_044dfb36_Tx: ComBitPosition=120, ComBitSize=8, ComSignalInitValue=0, ComSignalType=UINT8, ComSystemTemplateSystemSignalRef=DET_SNR_301
            DET_SNR_302_oRDR_DETECTION_301_304_oPCAN_RADAR_60ad80c8_Tx: ComBitPosition=232, ComBitSize=8, ComSignalInitValue=0, ComSignalType=UINT8, ComSystemTemplateSystemSignalRef=DET_SNR_302
            DET_SNR_303_oRDR_DETECTION_301_304_oPCAN_RADAR_f5dd545d_Tx: ComBitPosition=344, ComBitSize=8, ComSignalInitValue=0, ComSignalType=UINT8, ComSystemTemplateSystemSignalRef=DET_SNR_303
            DET_SNR_304_oRDR_DETECTION_301_304_oPCAN_RADAR_a96d7734_Tx: ComBitPosition=456, ComBitSize=8, ComSignalInitValue=0, ComSignalType=UINT8, ComSystemTemplateSystemSignalRef=DET_SNR_304
            DET_SUPER_RES_TARGET_301_oRDR_DETECTION_301_304_oPCAN_RADAR_35d4d353_Tx: ComBitPosition=87, ComBitSize=1, ComSignalInitValue=0, ComSignalType=BOOLEAN, ComSystemTemplateSystemSignalRef=DET_SUPER_RES_TARGET_301
            DET_SUPER_RES_TARGET_302_oRDR_DETECTION_301_304_oPCAN_RADAR_5134a8ad_Tx: ComBitPosition=199, ComBitSize=1, ComSignalInitValue=0, ComSignalType=BOOLEAN, ComSystemTemplateSystemSignalRef=DET_SUPER_RES_TARGET_302
            DET_SUPER_RES_TARGET_303_oRDR_DETECTION_301_304_oPCAN_RADAR_c4447c38_Tx: ComBitPosition=311, ComBitSize=1, ComSignalInitValue=0, ComSignalType=BOOLEAN, ComSystemTemplateSystemSignalRef=DET_SUPER_RES_TARGET_303
            DET_SUPER_RES_TARGET_304_oRDR_DETECTION_301_304_oPCAN_RADAR_98f45f51_Tx: ComBitPosition=423, ComBitSize=1, ComSignalInitValue=0, ComSignalType=BOOLEAN, ComSystemTemplateSystemSignalRef=DET_SUPER_RES_TARGET_304
        SG_Detections_305_308_oRDR_DETECTION_305_308_oPCAN_RADAR_6973c633_Tx: ComSystemTemplateSignalGroupRef=SG_Detections_305_308
          83 x ComGroupSignal, all with ComSignalEndianness=LITTLE_ENDIAN, ComTransferProperty=PENDING:
            DET_AZIMUTH_305_oRDR_DETECTION_305_308_oPCAN_RADAR_eabcef53_Tx: ComBitPosition=88, ComBitSize=13, ComSignalInitValue=0, ComSignalType=UINT16, ComSystemTemplateSystemSignalRef=DET_AZIMUTH_305
            DET_AZIMUTH_306_oRDR_DETECTION_305_308_oPCAN_RADAR_8e5c94ad_Tx: ComBitPosition=200, ComBitSize=13, ComSignalInitValue=0, ComSignalType=UINT16, ComSystemTemplateSystemSignalRef=DET_AZIMUTH_306
            DET_AZIMUTH_307_oRDR_DETECTION_305_308_oPCAN_RADAR_1b2c4038_Tx: ComBitPosition=312, ComBitSize=13, ComSignalInitValue=0, ComSignalType=UINT16, ComSystemTemplateSystemSignalRef=DET_AZIMUTH_307
            DET_AZIMUTH_308_oRDR_DETECTION_305_308_oPCAN_RADAR_373cd27f_Tx: ComBitPosition=424, ComBitSize=13, ComSignalInitValue=0, ComSignalType=UINT16, ComSystemTemplateSystemSignalRef=DET_AZIMUTH_308
            DET_AZIMUTH_ERR_305_oRDR_DETECTION_305_308_oPCAN_RADAR_4e097aa6_Tx: ComBitPosition=105, ComBitSize=7, ComSignalInitValue=0, ComSignalType=UINT8, ComSystemTemplateSystemSignalRef=DET_AZIMUTH_ERR_305
            DET_AZIMUTH_ERR_306_oRDR_DETECTION_305_308_oPCAN_RADAR_2ae90158_Tx: ComBitPosition=217, ComBitSize=7, ComSignalInitValue=0, ComSignalType=UINT8, ComSystemTemplateSystemSignalRef=DET_AZIMUTH_ERR_306
            DET_AZIMUTH_ERR_307_oRDR_DETECTION_305_308_oPCAN_RADAR_bf99d5cd_Tx: ComBitPosition=329, ComBitSize=7, ComSignalInitValue=0, ComSignalType=UINT8, ComSystemTemplateSystemSignalRef=DET_AZIMUTH_ERR_307
            DET_AZIMUTH_ERR_308_oRDR_DETECTION_305_308_oPCAN_RADAR_9389478a_Tx: ComBitPosition=441, ComBitSize=7, ComSignalInitValue=0, ComSignalType=UINT8, ComSystemTemplateSystemSignalRef=DET_AZIMUTH_ERR_308
            DET_BELOW_RAIN_THOLD_305_oRDR_DETECTION_305_308_oPCAN_RADAR_3fbd7c93_Tx: ComBitPosition=39, ComBitSize=1, ComSignalInitValue=0, ComSignalType=BOOLEAN, ComSystemTemplateSystemSignalRef=DET_BELOW_RAIN_THOLD_305
            DET_BELOW_RAIN_THOLD_306_oRDR_DETECTION_305_308_oPCAN_RADAR_5b5d076d_Tx: ComBitPosition=151, ComBitSize=1, ComSignalInitValue=0, ComSignalType=BOOLEAN, ComSystemTemplateSystemSignalRef=DET_BELOW_RAIN_THOLD_306
            DET_BELOW_RAIN_THOLD_307_oRDR_DETECTION_305_308_oPCAN_RADAR_ce2dd3f8_Tx: ComBitPosition=263, ComBitSize=1, ComSignalInitValue=0, ComSignalType=BOOLEAN, ComSystemTemplateSystemSignalRef=DET_BELOW_RAIN_THOLD_307
            DET_BELOW_RAIN_THOLD_308_oRDR_DETECTION_305_308_oPCAN_RADAR_e23d41bf_Tx: ComBitPosition=375, ComBitSize=1, ComSignalInitValue=0, ComSignalType=BOOLEAN, ComSystemTemplateSystemSignalRef=DET_BELOW_RAIN_THOLD_308
            DET_BI_STATIC_FLAG_305_oRDR_DETECTION_305_308_oPCAN_RADAR_bc90afd6_Tx: ComBitPosition=104, ComBitSize=1, ComSignalInitValue=0, ComSignalType=BOOLEAN, ComSystemTemplateSystemSignalRef=DET_BI_STATIC_FLAG_305
            DET_BI_STATIC_FLAG_306_oRDR_DETECTION_305_308_oPCAN_RADAR_d870d428_Tx: ComBitPosition=216, ComBitSize=1, ComSignalInitValue=0, ComSignalType=BOOLEAN, ComSystemTemplateSystemSignalRef=DET_BI_STATIC_FLAG_306
            DET_BI_STATIC_FLAG_307_oRDR_DETECTION_305_308_oPCAN_RADAR_4d0000bd_Tx: ComBitPosition=328, ComBitSize=1, ComSignalInitValue=0, ComSignalType=BOOLEAN, ComSystemTemplateSystemSignalRef=DET_BI_STATIC_FLAG_307
            DET_BI_STATIC_FLAG_308_oRDR_DETECTION_305_308_oPCAN_RADAR_611092fa_Tx: ComBitPosition=440, ComBitSize=1, ComSignalInitValue=0, ComSignalType=BOOLEAN, ComSystemTemplateSystemSignalRef=DET_BI_STATIC_FLAG_308
            DET_CONFD_AZIMUTH_305_oRDR_DETECTION_305_308_oPCAN_RADAR_e85ae599_Tx: ComBitPosition=118, ComBitSize=2, ComSignalInitValue=0, ComSignalType=UINT8, ComSystemTemplateSystemSignalRef=DET_CONFD_AZIMUTH_305
            DET_CONFD_AZIMUTH_306_oRDR_DETECTION_305_308_oPCAN_RADAR_8cba9e67_Tx: ComBitPosition=230, ComBitSize=2, ComSignalInitValue=0, ComSignalType=UINT8, ComSystemTemplateSystemSignalRef=DET_CONFD_AZIMUTH_306
            DET_CONFD_AZIMUTH_307_oRDR_DETECTION_305_308_oPCAN_RADAR_19ca4af2_Tx: ComBitPosition=342, ComBitSize=2, ComSignalInitValue=0, ComSignalType=UINT8, ComSystemTemplateSystemSignalRef=DET_CONFD_AZIMUTH_307
            DET_CONFD_AZIMUTH_308_oRDR_DETECTION_305_308_oPCAN_RADAR_35dad8b5_Tx: ComBitPosition=454, ComBitSize=2, ComSignalInitValue=0, ComSignalType=UINT8, ComSystemTemplateSystemSignalRef=DET_CONFD_AZIMUTH_308
            DET_CONFD_ELEVATION_305_oRDR_DETECTION_305_308_oPCAN_RADAR_eacfe463_Tx: ComBitPosition=101, ComBitSize=2, ComSignalInitValue=0, ComSignalType=UINT8, ComSystemTemplateSystemSignalRef=DET_CONFD_ELEVATION_305
            DET_CONFD_ELEVATION_306_oRDR_DETECTION_305_308_oPCAN_RADAR_8e2f9f9d_Tx: ComBitPosition=213, ComBitSize=2, ComSignalInitValue=0, ComSignalType=UINT8, ComSystemTemplateSystemSignalRef=DET_CONFD_ELEVATION_306
            DET_CONFD_ELEVATION_307_oRDR_DETECTION_305_308_oPCAN_RADAR_1b5f4b08_Tx: ComBitPosition=325, ComBitSize=2, ComSignalInitValue=0, ComSignalType=UINT8, ComSystemTemplateSystemSignalRef=DET_CONFD_ELEVATION_307
            DET_CONFD_ELEVATION_308_oRDR_DETECTION_305_308_oPCAN_RADAR_374fd94f_Tx: ComBitPosition=437, ComBitSize=2, ComSignalInitValue=0, ComSignalType=UINT8, ComSystemTemplateSystemSignalRef=DET_CONFD_ELEVATION_308
            DET_ELEVATION_305_oRDR_DETECTION_305_308_oPCAN_RADAR_3b0f305f_Tx: ComBitPosition=72, ComBitSize=8, ComSignalInitValue=0, ComSignalType=UINT8, ComSystemTemplateSystemSignalRef=DET_ELEVATION_305
            DET_ELEVATION_306_oRDR_DETECTION_305_308_oPCAN_RADAR_5fef4ba1_Tx: ComBitPosition=184, ComBitSize=8, ComSignalInitValue=0, ComSignalType=UINT8, ComSystemTemplateSystemSignalRef=DET_ELEVATION_306
            DET_ELEVATION_307_oRDR_DETECTION_305_308_oPCAN_RADAR_ca9f9f34_Tx: ComBitPosition=296, ComBitSize=8, ComSignalInitValue=0, ComSignalType=UINT8, ComSystemTemplateSystemSignalRef=DET_ELEVATION_307
            DET_ELEVATION_308_oRDR_DETECTION_305_308_oPCAN_RADAR_e68f0d73_Tx: ComBitPosition=408, ComBitSize=8, ComSignalInitValue=0, ComSignalType=UINT8, ComSystemTemplateSystemSignalRef=DET_ELEVATION_308
            DET_ELEVATION_ERR_305_oRDR_DETECTION_305_308_oPCAN_RADAR_bc36a82a_Tx: ComBitPosition=80, ComBitSize=6, ComSignalInitValue=0, ComSignalType=UINT8, ComSystemTemplateSystemSignalRef=DET_ELEVATION_ERR_305
            DET_ELEVATION_ERR_306_oRDR_DETECTION_305_308_oPCAN_RADAR_d8d6d3d4_Tx: ComBitPosition=192, ComBitSize=6, ComSignalInitValue=0, ComSignalType=UINT8, ComSystemTemplateSystemSignalRef=DET_ELEVATION_ERR_306
            DET_ELEVATION_ERR_307_oRDR_DETECTION_305_308_oPCAN_RADAR_4da60741_Tx: ComBitPosition=304, ComBitSize=6, ComSignalInitValue=0, ComSignalType=UINT8, ComSystemTemplateSystemSignalRef=DET_ELEVATION_ERR_307
            DET_ELEVATION_ERR_308_oRDR_DETECTION_305_308_oPCAN_RADAR_61b69506_Tx: ComBitPosition=416, ComBitSize=6, ComSignalInitValue=0, ComSignalType=UINT8, ComSystemTemplateSystemSignalRef=DET_ELEVATION_ERR_308
            DET_EXISTENCE_PROB_305_oRDR_DETECTION_305_308_oPCAN_RADAR_6ea9dd4a_Tx: ComBitPosition=112, ComBitSize=6, ComSignalInitValue=0, ComSignalType=UINT8, ComSystemTemplateSystemSignalRef=DET_EXISTENCE_PROB_305
            DET_EXISTENCE_PROB_306_oRDR_DETECTION_305_308_oPCAN_RADAR_0a49a6b4_Tx: ComBitPosition=224, ComBitSize=6, ComSignalInitValue=0, ComSignalType=UINT8, ComSystemTemplateSystemSignalRef=DET_EXISTENCE_PROB_306
            DET_EXISTENCE_PROB_307_oRDR_DETECTION_305_308_oPCAN_RADAR_9f397221_Tx: ComBitPosition=336, ComBitSize=6, ComSignalInitValue=0, ComSignalType=UINT8, ComSystemTemplateSystemSignalRef=DET_EXISTENCE_PROB_307
            DET_EXISTENCE_PROB_308_oRDR_DETECTION_305_308_oPCAN_RADAR_b329e066_Tx: ComBitPosition=448, ComBitSize=6, ComSignalInitValue=0, ComSignalType=UINT8, ComSystemTemplateSystemSignalRef=DET_EXISTENCE_PROB_308
            DET_HVC_FLAG_305_oRDR_DETECTION_305_308_oPCAN_RADAR_8fdd9e35_Tx: ComBitPosition=86, ComBitSize=1, ComSignalInitValue=0, ComSignalType=BOOLEAN, ComSystemTemplateSystemSignalRef=DET_HVC_FLAG_305
            DET_HVC_FLAG_306_oRDR_DETECTION_305_308_oPCAN_RADAR_eb3de5cb_Tx: ComBitPosition=198, ComBitSize=1, ComSignalInitValue=0, ComSignalType=BOOLEAN, ComSystemTemplateSystemSignalRef=DET_HVC_FLAG_306
            DET_HVC_FLAG_307_oRDR_DETECTION_305_308_oPCAN_RADAR_7e4d315e_Tx: ComBitPosition=310, ComBitSize=1, ComSignalInitValue=0, ComSignalType=BOOLEAN, ComSystemTemplateSystemSignalRef=DET_HVC_FLAG_307
            DET_HVC_FLAG_308_oRDR_DETECTION_305_308_oPCAN_RADAR_525da319_Tx: ComBitPosition=422, ComBitSize=1, ComSignalInitValue=0, ComSignalType=BOOLEAN, ComSystemTemplateSystemSignalRef=DET_HVC_FLAG_308
            DET_IDM_305_oRDR_DETECTION_305_308_oPCAN_RADAR_048fa588_Tx: ComBitPosition=63, ComBitSize=1, ComSignalInitValue=0, ComSignalType=BOOLEAN, ComSystemTemplateSystemSignalRef=DET_IDM_305
            DET_IDM_306_oRDR_DETECTION_305_308_oPCAN_RADAR_606fde76_Tx: ComBitPosition=175, ComBitSize=1, ComSignalInitValue=0, ComSignalType=BOOLEAN, ComSystemTemplateSystemSignalRef=DET_IDM_306
            DET_IDM_307_oRDR_DETECTION_305_308_oPCAN_RADAR_f51f0ae3_Tx: ComBitPosition=287, ComBitSize=1, ComSignalInitValue=0, ComSignalType=BOOLEAN, ComSystemTemplateSystemSignalRef=DET_IDM_307
            DET_IDM_308_oRDR_DETECTION_305_308_oPCAN_RADAR_d90f98a4_Tx: ComBitPosition=399, ComBitSize=1, ComSignalInitValue=0, ComSignalType=BOOLEAN, ComSystemTemplateSystemSignalRef=DET_IDM_308
            DET_MH_CRC16_305_308_oRDR_DETECTION_305_308_oPCAN_RADAR_edfb1438_Tx: ComBitPosition=0, ComBitSize=16, ComSignalInitValue=0, ComSignalType=UINT16, ComSystemTemplateSystemSignalRef=DET_MH_CRC16_305_308
            DET_MH_CYCLE_COUNTER_305_308_oRDR_DETECTION_305_308_oPCAN_RADAR_698eb50f_Tx: ComBitPosition=16, ComBitSize=8, ComSignalInitValue=0, ComSignalType=UINT8, ComSystemTemplateSystemSignalRef=DET_MH_CYCLE_COUNTER_305_308
            DET_MH_SCAN_INDEX_4LSB_305_308_oRDR_DETECTION_305_308_oPCAN_RADAR_a5a49083_Tx: ComBitPosition=476, ComBitSize=4, ComSignalInitValue=0, ComSignalType=UINT8, ComSystemTemplateSystemSignalRef=DET_MH_SCAN_INDEX_4LSB_305_308
            DET_MTD_305_oRDR_DETECTION_305_308_oPCAN_RADAR_623c9753_Tx: ComBitPosition=47, ComBitSize=1, ComSignalInitValue=0, ComSignalType=BOOLEAN, ComSystemTemplateSystemSignalRef=DET_MTD_305
            DET_MTD_306_oRDR_DETECTION_305_308_oPCAN_RADAR_06dcecad_Tx: ComBitPosition=159, ComBitSize=1, ComSignalInitValue=0, ComSignalType=BOOLEAN, ComSystemTemplateSystemSignalRef=DET_MTD_306
            DET_MTD_307_oRDR_DETECTION_305_308_oPCAN_RADAR_93ac3838_Tx: ComBitPosition=271, ComBitSize=1, ComSignalInitValue=0, ComSignalType=BOOLEAN, ComSystemTemplateSystemSignalRef=DET_MTD_307
            DET_MTD_308_oRDR_DETECTION_305_308_oPCAN_RADAR_bfbcaa7f_Tx: ComBitPosition=383, ComBitSize=1, ComSignalInitValue=0, ComSignalType=BOOLEAN, ComSystemTemplateSystemSignalRef=DET_MTD_308
            DET_PROB_1STAZHYPO_305_oRDR_DETECTION_305_308_oPCAN_RADAR_f1887f9e_Tx: ComBitPosition=103, ComBitSize=1, ComSignalInitValue=0, ComSignalType=BOOLEAN, ComSystemTemplateSystemSignalRef=DET_PROB_1STAZHYPO_305
            DET_PROB_1STAZHYPO_306_oRDR_DETECTION_305_308_oPCAN_RADAR_95680460_Tx: ComBitPosition=215, ComBitSize=1, ComSignalInitValue=0, ComSignalType=BOOLEAN, ComSystemTemplateSystemSignalRef=DET_PROB_1STAZHYPO_306
            DET_PROB_1STAZHYPO_307_oRDR_DETECTION_305_308_oPCAN_RADAR_0018d0f5_Tx: ComBitPosition=327, ComBitSize=1, ComSignalInitValue=0, ComSignalType=BOOLEAN, ComSystemTemplateSystemSignalRef=DET_PROB_1STAZHYPO_307
            DET_PROB_1STAZHYPO_308_oRDR_DETECTION_305_308_oPCAN_RADAR_2c0842b2_Tx: ComBitPosition=439, ComBitSize=1, ComSignalInitValue=0, ComSignalType=BOOLEAN, ComSystemTemplateSystemSignalRef=DET_PROB_1STAZHYPO_308
            DET_RANGE_305_oRDR_DETECTION_305_308_oPCAN_RADAR_fa279ce8_Tx: ComBitPosition=24, ComBitSize=15, ComSignalInitValue=0, ComSignalType=UINT16, ComSystemTemplateSystemSignalRef=DET_RANGE_305
            DET_RANGE_306_oRDR_DETECTION_305_308_oPCAN_RADAR_9ec7e716_Tx: ComBitPosition=136, ComBitSize=15, ComSignalInitValue=0, ComSignalType=UINT16, ComSystemTemplateSystemSignalRef=DET_RANGE_306
            DET_RANGE_307_oRDR_DETECTION_305_308_oPCAN_RADAR_0bb73383_Tx: ComBitPosition=248, ComBitSize=15, ComSignalInitValue=0, ComSignalType=UINT16, ComSystemTemplateSystemSignalRef=DET_RANGE_307
            DET_RANGE_308_oRDR_DETECTION_305_308_oPCAN_RADAR_27a7a1c4_Tx: ComBitPosition=360, ComBitSize=15, ComSignalInitValue=0, ComSignalType=UINT16, ComSystemTemplateSystemSignalRef=DET_RANGE_308
            DET_RANGE_ERR_305_oRDR_DETECTION_305_308_oPCAN_RADAR_5dcf2681_Tx: ComBitPosition=40, ComBitSize=7, ComSignalInitValue=0, ComSignalType=UINT8, ComSystemTemplateSystemSignalRef=DET_RANGE_ERR_305
            DET_RANGE_ERR_306_oRDR_DETECTION_305_308_oPCAN_RADAR_392f5d7f_Tx: ComBitPosition=152, ComBitSize=7, ComSignalInitValue=0, ComSignalType=UINT8, ComSystemTemplateSystemSignalRef=DET_RANGE_ERR_306
            DET_RANGE_ERR_307_oRDR_DETECTION_305_308_oPCAN_RADAR_ac5f89ea_Tx: ComBitPosition=264, ComBitSize=7, ComSignalInitValue=0, ComSignalType=UINT8, ComSystemTemplateSystemSignalRef=DET_RANGE_ERR_307
            DET_RANGE_ERR_308_oRDR_DETECTION_305_308_oPCAN_RADAR_804f1bad_Tx: ComBitPosition=376, ComBitSize=7, ComSignalInitValue=0, ComSignalType=UINT8, ComSystemTemplateSystemSignalRef=DET_RANGE_ERR_308
            DET_RANGE_VELOCITY_305_oRDR_DETECTION_305_308_oPCAN_RADAR_8f815ecd_Tx: ComBitPosition=48, ComBitSize=15, ComSignalInitValue=16384, ComSignalType=UINT16, ComSystemTemplateSystemSignalRef=DET_RANGE_VELOCITY_305
            DET_RANGE_VELOCITY_306_oRDR_DETECTION_305_308_oPCAN_RADAR_eb612533_Tx: ComBitPosition=160, ComBitSize=15, ComSignalInitValue=16384, ComSignalType=UINT16, ComSystemTemplateSystemSignalRef=DET_RANGE_VELOCITY_306
            DET_RANGE_VELOCITY_307_oRDR_DETECTION_305_308_oPCAN_RADAR_7e11f1a6_Tx: ComBitPosition=272, ComBitSize=15, ComSignalInitValue=16384, ComSignalType=UINT16, ComSystemTemplateSystemSignalRef=DET_RANGE_VELOCITY_307
            DET_RANGE_VELOCITY_308_oRDR_DETECTION_305_308_oPCAN_RADAR_520163e1_Tx: ComBitPosition=384, ComBitSize=15, ComSignalInitValue=16384, ComSignalType=UINT16, ComSystemTemplateSystemSignalRef=DET_RANGE_VELOCITY_308
            DET_RANGE_VELOCITY_ERR_305_oRDR_DETECTION_305_308_oPCAN_RADAR_803aa57f_Tx: ComBitPosition=64, ComBitSize=8, ComSignalInitValue=0, ComSignalType=UINT8, ComSystemTemplateSystemSignalRef=DET_RANGE_VELOCITY_ERR_305
            DET_RANGE_VELOCITY_ERR_306_oRDR_DETECTION_305_308_oPCAN_RADAR_e4dade81_Tx: ComBitPosition=176, ComBitSize=8, ComSignalInitValue=0, ComSignalType=UINT8, ComSystemTemplateSystemSignalRef=DET_RANGE_VELOCITY_ERR_306
            DET_RANGE_VELOCITY_ERR_307_oRDR_DETECTION_305_308_oPCAN_RADAR_71aa0a14_Tx: ComBitPosition=288, ComBitSize=8, ComSignalInitValue=0, ComSignalType=UINT8, ComSystemTemplateSystemSignalRef=DET_RANGE_VELOCITY_ERR_307
            DET_RANGE_VELOCITY_ERR_308_oRDR_DETECTION_305_308_oPCAN_RADAR_5dba9853_Tx: ComBitPosition=400, ComBitSize=8, ComSignalInitValue=0, ComSignalType=UINT8, ComSystemTemplateSystemSignalRef=DET_RANGE_VELOCITY_ERR_308
            DET_RCS_305_oRDR_DETECTION_305_308_oPCAN_RADAR_08016997_Tx: ComBitPosition=128, ComBitSize=8, ComSignalInitValue=128, ComSignalType=UINT8, ComSystemTemplateSystemSignalRef=DET_RCS_305
            DET_RCS_306_oRDR_DETECTION_305_308_oPCAN_RADAR_6ce11269_Tx: ComBitPosition=240, ComBitSize=8, ComSignalInitValue=128, ComSignalType=UINT8, ComSystemTemplateSystemSignalRef=DET_RCS_306
            DET_RCS_307_oRDR_DETECTION_305_308_oPCAN_RADAR_f991c6fc_Tx: ComBitPosition=352, ComBitSize=8, ComSignalInitValue=128, ComSignalType=UINT8, ComSystemTemplateSystemSignalRef=DET_RCS_307
            DET_RCS_308_oRDR_DETECTION_305_308_oPCAN_RADAR_d58154bb_Tx: ComBitPosition=464, ComBitSize=8, ComSignalInitValue=128, ComSignalType=UINT8, ComSystemTemplateSystemSignalRef=DET_RCS_308
            DET_SNR_305_oRDR_DETECTION_305_308_oPCAN_RADAR_d5af3d95_Tx: ComBitPosition=120, ComBitSize=8, ComSignalInitValue=0, ComSignalType=UINT8, ComSystemTemplateSystemSignalRef=DET_SNR_305
            DET_SNR_306_oRDR_DETECTION_305_308_oPCAN_RADAR_b14f466b_Tx: ComBitPosition=232, ComBitSize=8, ComSignalInitValue=0, ComSignalType=UINT8, ComSystemTemplateSystemSignalRef=DET_SNR_306
            DET_SNR_307_oRDR_DETECTION_305_308_oPCAN_RADAR_243f92fe_Tx: ComBitPosition=344, ComBitSize=8, ComSignalInitValue=0, ComSignalType=UINT8, ComSystemTemplateSystemSignalRef=DET_SNR_307
            DET_SNR_308_oRDR_DETECTION_305_308_oPCAN_RADAR_082f00b9_Tx: ComBitPosition=456, ComBitSize=8, ComSignalInitValue=0, ComSignalType=UINT8, ComSystemTemplateSystemSignalRef=DET_SNR_308
            DET_SUPER_RES_TARGET_305_oRDR_DETECTION_305_308_oPCAN_RADAR_e43615f0_Tx: ComBitPosition=87, ComBitSize=1, ComSignalInitValue=0, ComSignalType=BOOLEAN, ComSystemTemplateSystemSignalRef=DET_SUPER_RES_TARGET_305
            DET_SUPER_RES_TARGET_306_oRDR_DETECTION_305_308_oPCAN_RADAR_80d66e0e_Tx: ComBitPosition=199, ComBitSize=1, ComSignalInitValue=0, ComSignalType=BOOLEAN, ComSystemTemplateSystemSignalRef=DET_SUPER_RES_TARGET_306
            DET_SUPER_RES_TARGET_307_oRDR_DETECTION_305_308_oPCAN_RADAR_15a6ba9b_Tx: ComBitPosition=311, ComBitSize=1, ComSignalInitValue=0, ComSignalType=BOOLEAN, ComSystemTemplateSystemSignalRef=DET_SUPER_RES_TARGET_307
            DET_SUPER_RES_TARGET_308_oRDR_DETECTION_305_308_oPCAN_RADAR_39b628dc_Tx: ComBitPosition=423, ComBitSize=1, ComSignalInitValue=0, ComSignalType=BOOLEAN, ComSystemTemplateSystemSignalRef=DET_SUPER_RES_TARGET_308
        SG_Detections_309_312_oRDR_DETECTION_309_312_oPCAN_RADAR_f009e248_Tx: ComSystemTemplateSignalGroupRef=SG_Detections_309_312
          83 x ComGroupSignal, all with ComSignalEndianness=LITTLE_ENDIAN, ComTransferProperty=PENDING:
            DET_AZIMUTH_309_oRDR_DETECTION_309_312_oPCAN_RADAR_9004e9eb_Tx: ComBitPosition=88, ComBitSize=13, ComSignalInitValue=0, ComSignalType=UINT16, ComSystemTemplateSystemSignalRef=DET_AZIMUTH_309
            DET_AZIMUTH_310_oRDR_DETECTION_309_312_oPCAN_RADAR_f5249b4f_Tx: ComBitPosition=200, ComBitSize=13, ComSignalInitValue=0, ComSignalType=UINT16, ComSystemTemplateSystemSignalRef=DET_AZIMUTH_310
            DET_AZIMUTH_311_oRDR_DETECTION_309_312_oPCAN_RADAR_60544fda_Tx: ComBitPosition=312, ComBitSize=13, ComSignalInitValue=0, ComSignalType=UINT16, ComSystemTemplateSystemSignalRef=DET_AZIMUTH_311
            DET_AZIMUTH_312_oRDR_DETECTION_309_312_oPCAN_RADAR_04b43424_Tx: ComBitPosition=424, ComBitSize=13, ComSignalInitValue=0, ComSignalType=UINT16, ComSystemTemplateSystemSignalRef=DET_AZIMUTH_312
            DET_AZIMUTH_ERR_309_oRDR_DETECTION_309_312_oPCAN_RADAR_34b17c1e_Tx: ComBitPosition=105, ComBitSize=7, ComSignalInitValue=0, ComSignalType=UINT8, ComSystemTemplateSystemSignalRef=DET_AZIMUTH_ERR_309
            DET_AZIMUTH_ERR_310_oRDR_DETECTION_309_312_oPCAN_RADAR_51910eba_Tx: ComBitPosition=217, ComBitSize=7, ComSignalInitValue=0, ComSignalType=UINT8, ComSystemTemplateSystemSignalRef=DET_AZIMUTH_ERR_310
            DET_AZIMUTH_ERR_311_oRDR_DETECTION_309_312_oPCAN_RADAR_c4e1da2f_Tx: ComBitPosition=329, ComBitSize=7, ComSignalInitValue=0, ComSignalType=UINT8, ComSystemTemplateSystemSignalRef=DET_AZIMUTH_ERR_311
            DET_AZIMUTH_ERR_312_oRDR_DETECTION_309_312_oPCAN_RADAR_a001a1d1_Tx: ComBitPosition=441, ComBitSize=7, ComSignalInitValue=0, ComSignalType=UINT8, ComSystemTemplateSystemSignalRef=DET_AZIMUTH_ERR_312
            DET_BELOW_RAIN_THOLD_309_oRDR_DETECTION_309_312_oPCAN_RADAR_45057a2b_Tx: ComBitPosition=39, ComBitSize=1, ComSignalInitValue=0, ComSignalType=BOOLEAN, ComSystemTemplateSystemSignalRef=DET_BELOW_RAIN_THOLD_309
            DET_BELOW_RAIN_THOLD_310_oRDR_DETECTION_309_312_oPCAN_RADAR_2025088f_Tx: ComBitPosition=151, ComBitSize=1, ComSignalInitValue=0, ComSignalType=BOOLEAN, ComSystemTemplateSystemSignalRef=DET_BELOW_RAIN_THOLD_310
            DET_BELOW_RAIN_THOLD_311_oRDR_DETECTION_309_312_oPCAN_RADAR_b555dc1a_Tx: ComBitPosition=263, ComBitSize=1, ComSignalInitValue=0, ComSignalType=BOOLEAN, ComSystemTemplateSystemSignalRef=DET_BELOW_RAIN_THOLD_311
            DET_BELOW_RAIN_THOLD_312_oRDR_DETECTION_309_312_oPCAN_RADAR_d1b5a7e4_Tx: ComBitPosition=375, ComBitSize=1, ComSignalInitValue=0, ComSignalType=BOOLEAN, ComSystemTemplateSystemSignalRef=DET_BELOW_RAIN_THOLD_312
            DET_BI_STATIC_FLAG_309_oRDR_DETECTION_309_312_oPCAN_RADAR_c628a96e_Tx: ComBitPosition=104, ComBitSize=1, ComSignalInitValue=0, ComSignalType=BOOLEAN, ComSystemTemplateSystemSignalRef=DET_BI_STATIC_FLAG_309
            DET_BI_STATIC_FLAG_310_oRDR_DETECTION_309_312_oPCAN_RADAR_a308dbca_Tx: ComBitPosition=216, ComBitSize=1, ComSignalInitValue=0, ComSignalType=BOOLEAN, ComSystemTemplateSystemSignalRef=DET_BI_STATIC_FLAG_310
            DET_BI_STATIC_FLAG_311_oRDR_DETECTION_309_312_oPCAN_RADAR_36780f5f_Tx: ComBitPosition=328, ComBitSize=1, ComSignalInitValue=0, ComSignalType=BOOLEAN, ComSystemTemplateSystemSignalRef=DET_BI_STATIC_FLAG_311
            DET_BI_STATIC_FLAG_312_oRDR_DETECTION_309_312_oPCAN_RADAR_529874a1_Tx: ComBitPosition=440, ComBitSize=1, ComSignalInitValue=0, ComSignalType=BOOLEAN, ComSystemTemplateSystemSignalRef=DET_BI_STATIC_FLAG_312
            DET_CONFD_AZIMUTH_309_oRDR_DETECTION_309_312_oPCAN_RADAR_92e2e321_Tx: ComBitPosition=118, ComBitSize=2, ComSignalInitValue=0, ComSignalType=UINT8, ComSystemTemplateSystemSignalRef=DET_CONFD_AZIMUTH_309
            DET_CONFD_AZIMUTH_310_oRDR_DETECTION_309_312_oPCAN_RADAR_f7c29185_Tx: ComBitPosition=230, ComBitSize=2, ComSignalInitValue=0, ComSignalType=UINT8, ComSystemTemplateSystemSignalRef=DET_CONFD_AZIMUTH_310
            DET_CONFD_AZIMUTH_311_oRDR_DETECTION_309_312_oPCAN_RADAR_62b24510_Tx: ComBitPosition=342, ComBitSize=2, ComSignalInitValue=0, ComSignalType=UINT8, ComSystemTemplateSystemSignalRef=DET_CONFD_AZIMUTH_311
            DET_CONFD_AZIMUTH_312_oRDR_DETECTION_309_312_oPCAN_RADAR_06523eee_Tx: ComBitPosition=454, ComBitSize=2, ComSignalInitValue=0, ComSignalType=UINT8, ComSystemTemplateSystemSignalRef=DET_CONFD_AZIMUTH_312
            DET_CONFD_ELEVATION_309_oRDR_DETECTION_309_312_oPCAN_RADAR_9077e2db_Tx: ComBitPosition=101, ComBitSize=2, ComSignalInitValue=0, ComSignalType=UINT8, ComSystemTemplateSystemSignalRef=DET_CONFD_ELEVATION_309
            DET_CONFD_ELEVATION_310_oRDR_DETECTION_309_312_oPCAN_RADAR_f557907f_Tx: ComBitPosition=213, ComBitSize=2, ComSignalInitValue=0, ComSignalType=UINT8, ComSystemTemplateSystemSignalRef=DET_CONFD_ELEVATION_310
            DET_CONFD_ELEVATION_311_oRDR_DETECTION_309_312_oPCAN_RADAR_602744ea_Tx: ComBitPosition=325, ComBitSize=2, ComSignalInitValue=0, ComSignalType=UINT8, ComSystemTemplateSystemSignalRef=DET_CONFD_ELEVATION_311
            DET_CONFD_ELEVATION_312_oRDR_DETECTION_309_312_oPCAN_RADAR_04c73f14_Tx: ComBitPosition=437, ComBitSize=2, ComSignalInitValue=0, ComSignalType=UINT8, ComSystemTemplateSystemSignalRef=DET_CONFD_ELEVATION_312
            DET_ELEVATION_309_oRDR_DETECTION_309_312_oPCAN_RADAR_41b736e7_Tx: ComBitPosition=72, ComBitSize=8, ComSignalInitValue=0, ComSignalType=UINT8, ComSystemTemplateSystemSignalRef=DET_ELEVATION_309
            DET_ELEVATION_310_oRDR_DETECTION_309_312_oPCAN_RADAR_24974443_Tx: ComBitPosition=184, ComBitSize=8, ComSignalInitValue=0, ComSignalType=UINT8, ComSystemTemplateSystemSignalRef=DET_ELEVATION_310
            DET_ELEVATION_311_oRDR_DETECTION_309_312_oPCAN_RADAR_b1e790d6_Tx: ComBitPosition=296, ComBitSize=8, ComSignalInitValue=0, ComSignalType=UINT8, ComSystemTemplateSystemSignalRef=DET_ELEVATION_311
            DET_ELEVATION_312_oRDR_DETECTION_309_312_oPCAN_RADAR_d507eb28_Tx: ComBitPosition=408, ComBitSize=8, ComSignalInitValue=0, ComSignalType=UINT8, ComSystemTemplateSystemSignalRef=DET_ELEVATION_312
            DET_ELEVATION_ERR_309_oRDR_DETECTION_309_312_oPCAN_RADAR_c68eae92_Tx: ComBitPosition=80, ComBitSize=6, ComSignalInitValue=0, ComSignalType=UINT8, ComSystemTemplateSystemSignalRef=DET_ELEVATION_ERR_309
            DET_ELEVATION_ERR_310_oRDR_DETECTION_309_312_oPCAN_RADAR_a3aedc36_Tx: ComBitPosition=192, ComBitSize=6, ComSignalInitValue=0, ComSignalType=UINT8, ComSystemTemplateSystemSignalRef=DET_ELEVATION_ERR_310
            DET_ELEVATION_ERR_311_oRDR_DETECTION_309_312_oPCAN_RADAR_36de08a3_Tx: ComBitPosition=304, ComBitSize=6, ComSignalInitValue=0, ComSignalType=UINT8, ComSystemTemplateSystemSignalRef=DET_ELEVATION_ERR_311
            DET_ELEVATION_ERR_312_oRDR_DETECTION_309_312_oPCAN_RADAR_523e735d_Tx: ComBitPosition=416, ComBitSize=6, ComSignalInitValue=0, ComSignalType=UINT8, ComSystemTemplateSystemSignalRef=DET_ELEVATION_ERR_312
            DET_EXISTENCE_PROB_309_oRDR_DETECTION_309_312_oPCAN_RADAR_1411dbf2_Tx: ComBitPosition=112, ComBitSize=6, ComSignalInitValue=0, ComSignalType=UINT8, ComSystemTemplateSystemSignalRef=DET_EXISTENCE_PROB_309
            DET_EXISTENCE_PROB_310_oRDR_DETECTION_309_312_oPCAN_RADAR_7131a956_Tx: ComBitPosition=224, ComBitSize=6, ComSignalInitValue=0, ComSignalType=UINT8, ComSystemTemplateSystemSignalRef=DET_EXISTENCE_PROB_310
            DET_EXISTENCE_PROB_311_oRDR_DETECTION_309_312_oPCAN_RADAR_e4417dc3_Tx: ComBitPosition=336, ComBitSize=6, ComSignalInitValue=0, ComSignalType=UINT8, ComSystemTemplateSystemSignalRef=DET_EXISTENCE_PROB_311
            DET_EXISTENCE_PROB_312_oRDR_DETECTION_309_312_oPCAN_RADAR_80a1063d_Tx: ComBitPosition=448, ComBitSize=6, ComSignalInitValue=0, ComSignalType=UINT8, ComSystemTemplateSystemSignalRef=DET_EXISTENCE_PROB_312
            DET_HVC_FLAG_309_oRDR_DETECTION_309_312_oPCAN_RADAR_f565988d_Tx: ComBitPosition=86, ComBitSize=1, ComSignalInitValue=0, ComSignalType=BOOLEAN, ComSystemTemplateSystemSignalRef=DET_HVC_FLAG_309
            DET_HVC_FLAG_310_oRDR_DETECTION_309_312_oPCAN_RADAR_9045ea29_Tx: ComBitPosition=198, ComBitSize=1, ComSignalInitValue=0, ComSignalType=BOOLEAN, ComSystemTemplateSystemSignalRef=DET_HVC_FLAG_310
            DET_HVC_FLAG_311_oRDR_DETECTION_309_312_oPCAN_RADAR_05353ebc_Tx: ComBitPosition=310, ComBitSize=1, ComSignalInitValue=0, ComSignalType=BOOLEAN, ComSystemTemplateSystemSignalRef=DET_HVC_FLAG_311
            DET_HVC_FLAG_312_oRDR_DETECTION_309_312_oPCAN_RADAR_61d54542_Tx: ComBitPosition=422, ComBitSize=1, ComSignalInitValue=0, ComSignalType=BOOLEAN, ComSystemTemplateSystemSignalRef=DET_HVC_FLAG_312
            DET_IDM_309_oRDR_DETECTION_309_312_oPCAN_RADAR_7e37a330_Tx: ComBitPosition=63, ComBitSize=1, ComSignalInitValue=0, ComSignalType=BOOLEAN, ComSystemTemplateSystemSignalRef=DET_IDM_309
            DET_IDM_310_oRDR_DETECTION_309_312_oPCAN_RADAR_1b17d194_Tx: ComBitPosition=175, ComBitSize=1, ComSignalInitValue=0, ComSignalType=BOOLEAN, ComSystemTemplateSystemSignalRef=DET_IDM_310
            DET_IDM_311_oRDR_DETECTION_309_312_oPCAN_RADAR_8e670501_Tx: ComBitPosition=287, ComBitSize=1, ComSignalInitValue=0, ComSignalType=BOOLEAN, ComSystemTemplateSystemSignalRef=DET_IDM_311
            DET_IDM_312_oRDR_DETECTION_309_312_oPCAN_RADAR_ea877eff_Tx: ComBitPosition=399, ComBitSize=1, ComSignalInitValue=0, ComSignalType=BOOLEAN, ComSystemTemplateSystemSignalRef=DET_IDM_312
            DET_MH_CRC16_309_312_oRDR_DETECTION_309_312_oPCAN_RADAR_74813043_Tx: ComBitPosition=0, ComBitSize=16, ComSignalInitValue=0, ComSignalType=UINT16, ComSystemTemplateSystemSignalRef=DET_MH_CRC16_309_312
            DET_MH_CYCLE_COUNTER_309_312_oRDR_DETECTION_309_312_oPCAN_RADAR_f0f49174_Tx: ComBitPosition=16, ComBitSize=8, ComSignalInitValue=0, ComSignalType=UINT8, ComSystemTemplateSystemSignalRef=DET_MH_CYCLE_COUNTER_309_312
            DET_MH_SCAN_INDEX_4LSB_309_312_oRDR_DETECTION_309_312_oPCAN_RADAR_3cdeb4f8_Tx: ComBitPosition=476, ComBitSize=4, ComSignalInitValue=0, ComSignalType=UINT8, ComSystemTemplateSystemSignalRef=DET_MH_SCAN_INDEX_4LSB_309_312
            DET_MTD_309_oRDR_DETECTION_309_312_oPCAN_RADAR_188491eb_Tx: ComBitPosition=47, ComBitSize=1, ComSignalInitValue=0, ComSignalType=BOOLEAN, ComSystemTemplateSystemSignalRef=DET_MTD_309
            DET_MTD_310_oRDR_DETECTION_309_312_oPCAN_RADAR_7da4e34f_Tx: ComBitPosition=159, ComBitSize=1, ComSignalInitValue=0, ComSignalType=BOOLEAN, ComSystemTemplateSystemSignalRef=DET_MTD_310
            DET_MTD_311_oRDR_DETECTION_309_312_oPCAN_RADAR_e8d437da_Tx: ComBitPosition=271, ComBitSize=1, ComSignalInitValue=0, ComSignalType=BOOLEAN, ComSystemTemplateSystemSignalRef=DET_MTD_311
            DET_MTD_312_oRDR_DETECTION_309_312_oPCAN_RADAR_8c344c24_Tx: ComBitPosition=383, ComBitSize=1, ComSignalInitValue=0, ComSignalType=BOOLEAN, ComSystemTemplateSystemSignalRef=DET_MTD_312
            DET_PROB_1STAZHYPO_309_oRDR_DETECTION_309_312_oPCAN_RADAR_8b307926_Tx: ComBitPosition=103, ComBitSize=1, ComSignalInitValue=0, ComSignalType=BOOLEAN, ComSystemTemplateSystemSignalRef=DET_PROB_1STAZHYPO_309
            DET_PROB_1STAZHYPO_310_oRDR_DETECTION_309_312_oPCAN_RADAR_ee100b82_Tx: ComBitPosition=215, ComBitSize=1, ComSignalInitValue=0, ComSignalType=BOOLEAN, ComSystemTemplateSystemSignalRef=DET_PROB_1STAZHYPO_310
            DET_PROB_1STAZHYPO_311_oRDR_DETECTION_309_312_oPCAN_RADAR_7b60df17_Tx: ComBitPosition=327, ComBitSize=1, ComSignalInitValue=0, ComSignalType=BOOLEAN, ComSystemTemplateSystemSignalRef=DET_PROB_1STAZHYPO_311
            DET_PROB_1STAZHYPO_312_oRDR_DETECTION_309_312_oPCAN_RADAR_1f80a4e9_Tx: ComBitPosition=439, ComBitSize=1, ComSignalInitValue=0, ComSignalType=BOOLEAN, ComSystemTemplateSystemSignalRef=DET_PROB_1STAZHYPO_312
            DET_RANGE_309_oRDR_DETECTION_309_312_oPCAN_RADAR_809f9a50_Tx: ComBitPosition=24, ComBitSize=15, ComSignalInitValue=0, ComSignalType=UINT16, ComSystemTemplateSystemSignalRef=DET_RANGE_309
            DET_RANGE_310_oRDR_DETECTION_309_312_oPCAN_RADAR_e5bfe8f4_Tx: ComBitPosition=136, ComBitSize=15, ComSignalInitValue=0, ComSignalType=UINT16, ComSystemTemplateSystemSignalRef=DET_RANGE_310
            DET_RANGE_311_oRDR_DETECTION_309_312_oPCAN_RADAR_70cf3c61_Tx: ComBitPosition=248, ComBitSize=15, ComSignalInitValue=0, ComSignalType=UINT16, ComSystemTemplateSystemSignalRef=DET_RANGE_311
            DET_RANGE_312_oRDR_DETECTION_309_312_oPCAN_RADAR_142f479f_Tx: ComBitPosition=360, ComBitSize=15, ComSignalInitValue=0, ComSignalType=UINT16, ComSystemTemplateSystemSignalRef=DET_RANGE_312
            DET_RANGE_ERR_309_oRDR_DETECTION_309_312_oPCAN_RADAR_27772039_Tx: ComBitPosition=40, ComBitSize=7, ComSignalInitValue=0, ComSignalType=UINT8, ComSystemTemplateSystemSignalRef=DET_RANGE_ERR_309
            DET_RANGE_ERR_310_oRDR_DETECTION_309_312_oPCAN_RADAR_4257529d_Tx: ComBitPosition=152, ComBitSize=7, ComSignalInitValue=0, ComSignalType=UINT8, ComSystemTemplateSystemSignalRef=DET_RANGE_ERR_310
            DET_RANGE_ERR_311_oRDR_DETECTION_309_312_oPCAN_RADAR_d7278608_Tx: ComBitPosition=264, ComBitSize=7, ComSignalInitValue=0, ComSignalType=UINT8, ComSystemTemplateSystemSignalRef=DET_RANGE_ERR_311
            DET_RANGE_ERR_312_oRDR_DETECTION_309_312_oPCAN_RADAR_b3c7fdf6_Tx: ComBitPosition=376, ComBitSize=7, ComSignalInitValue=0, ComSignalType=UINT8, ComSystemTemplateSystemSignalRef=DET_RANGE_ERR_312
            DET_RANGE_VELOCITY_309_oRDR_DETECTION_309_312_oPCAN_RADAR_f5395875_Tx: ComBitPosition=48, ComBitSize=15, ComSignalInitValue=16384, ComSignalType=UINT16, ComSystemTemplateSystemSignalRef=DET_RANGE_VELOCITY_309
            DET_RANGE_VELOCITY_310_oRDR_DETECTION_309_312_oPCAN_RADAR_90192ad1_Tx: ComBitPosition=160, ComBitSize=15, ComSignalInitValue=16384, ComSignalType=UINT16, ComSystemTemplateSystemSignalRef=DET_RANGE_VELOCITY_310
            DET_RANGE_VELOCITY_311_oRDR_DETECTION_309_312_oPCAN_RADAR_0569fe44_Tx: ComBitPosition=272, ComBitSize=15, ComSignalInitValue=16384, ComSignalType=UINT16, ComSystemTemplateSystemSignalRef=DET_RANGE_VELOCITY_311
            DET_RANGE_VELOCITY_312_oRDR_DETECTION_309_312_oPCAN_RADAR_618985ba_Tx: ComBitPosition=384, ComBitSize=15, ComSignalInitValue=16384, ComSignalType=UINT16, ComSystemTemplateSystemSignalRef=DET_RANGE_VELOCITY_312
            DET_RANGE_VELOCITY_ERR_309_oRDR_DETECTION_309_312_oPCAN_RADAR_fa82a3c7_Tx: ComBitPosition=64, ComBitSize=8, ComSignalInitValue=0, ComSignalType=UINT8, ComSystemTemplateSystemSignalRef=DET_RANGE_VELOCITY_ERR_309
            DET_RANGE_VELOCITY_ERR_310_oRDR_DETECTION_309_312_oPCAN_RADAR_9fa2d163_Tx: ComBitPosition=176, ComBitSize=8, ComSignalInitValue=0, ComSignalType=UINT8, ComSystemTemplateSystemSignalRef=DET_RANGE_VELOCITY_ERR_310
            DET_RANGE_VELOCITY_ERR_311_oRDR_DETECTION_309_312_oPCAN_RADAR_0ad205f6_Tx: ComBitPosition=288, ComBitSize=8, ComSignalInitValue=0, ComSignalType=UINT8, ComSystemTemplateSystemSignalRef=DET_RANGE_VELOCITY_ERR_311
            DET_RANGE_VELOCITY_ERR_312_oRDR_DETECTION_309_312_oPCAN_RADAR_6e327e08_Tx: ComBitPosition=400, ComBitSize=8, ComSignalInitValue=0, ComSignalType=UINT8, ComSystemTemplateSystemSignalRef=DET_RANGE_VELOCITY_ERR_312
            DET_RCS_309_oRDR_DETECTION_309_312_oPCAN_RADAR_72b96f2f_Tx: ComBitPosition=128, ComBitSize=8, ComSignalInitValue=128, ComSignalType=UINT8, ComSystemTemplateSystemSignalRef=DET_RCS_309
            DET_RCS_310_oRDR_DETECTION_309_312_oPCAN_RADAR_17991d8b_Tx: ComBitPosition=240, ComBitSize=8, ComSignalInitValue=128, ComSignalType=UINT8, ComSystemTemplateSystemSignalRef=DET_RCS_310
            DET_RCS_311_oRDR_DETECTION_309_312_oPCAN_RADAR_82e9c91e_Tx: ComBitPosition=352, ComBitSize=8, ComSignalInitValue=128, ComSignalType=UINT8, ComSystemTemplateSystemSignalRef=DET_RCS_311
            DET_RCS_312_oRDR_DETECTION_309_312_oPCAN_RADAR_e609b2e0_Tx: ComBitPosition=464, ComBitSize=8, ComSignalInitValue=128, ComSignalType=UINT8, ComSystemTemplateSystemSignalRef=DET_RCS_312
            DET_SNR_309_oRDR_DETECTION_309_312_oPCAN_RADAR_af173b2d_Tx: ComBitPosition=120, ComBitSize=8, ComSignalInitValue=0, ComSignalType=UINT8, ComSystemTemplateSystemSignalRef=DET_SNR_309
            DET_SNR_310_oRDR_DETECTION_309_312_oPCAN_RADAR_ca374989_Tx: ComBitPosition=232, ComBitSize=8, ComSignalInitValue=0, ComSignalType=UINT8, ComSystemTemplateSystemSignalRef=DET_SNR_310
            DET_SNR_311_oRDR_DETECTION_309_312_oPCAN_RADAR_5f479d1c_Tx: ComBitPosition=344, ComBitSize=8, ComSignalInitValue=0, ComSignalType=UINT8, ComSystemTemplateSystemSignalRef=DET_SNR_311
            DET_SNR_312_oRDR_DETECTION_309_312_oPCAN_RADAR_3ba7e6e2_Tx: ComBitPosition=456, ComBitSize=8, ComSignalInitValue=0, ComSignalType=UINT8, ComSystemTemplateSystemSignalRef=DET_SNR_312
            DET_SUPER_RES_TARGET_309_oRDR_DETECTION_309_312_oPCAN_RADAR_9e8e1348_Tx: ComBitPosition=87, ComBitSize=1, ComSignalInitValue=0, ComSignalType=BOOLEAN, ComSystemTemplateSystemSignalRef=DET_SUPER_RES_TARGET_309
            DET_SUPER_RES_TARGET_310_oRDR_DETECTION_309_312_oPCAN_RADAR_fbae61ec_Tx: ComBitPosition=199, ComBitSize=1, ComSignalInitValue=0, ComSignalType=BOOLEAN, ComSystemTemplateSystemSignalRef=DET_SUPER_RES_TARGET_310
            DET_SUPER_RES_TARGET_311_oRDR_DETECTION_309_312_oPCAN_RADAR_6edeb579_Tx: ComBitPosition=311, ComBitSize=1, ComSignalInitValue=0, ComSignalType=BOOLEAN, ComSystemTemplateSystemSignalRef=DET_SUPER_RES_TARGET_311
            DET_SUPER_RES_TARGET_312_oRDR_DETECTION_309_312_oPCAN_RADAR_0a3ece87_Tx: ComBitPosition=423, ComBitSize=1, ComSignalInitValue=0, ComSignalType=BOOLEAN, ComSystemTemplateSystemSignalRef=DET_SUPER_RES_TARGET_312
        SG_Detections_313_316_oRDR_DETECTION_313_316_oPCAN_RADAR_c2028a60_Tx: ComSystemTemplateSignalGroupRef=SG_Detections_313_316
          83 x ComGroupSignal, all with ComSignalEndianness=LITTLE_ENDIAN, ComTransferProperty=PENDING:
            DET_AZIMUTH_313_oRDR_DETECTION_313_316_oPCAN_RADAR_8c03e39f_Tx: ComBitPosition=88, ComBitSize=13, ComSignalInitValue=0, ComSignalType=UINT16, ComSystemTemplateSystemSignalRef=DET_AZIMUTH_313
            DET_AZIMUTH_314_oRDR_DETECTION_313_316_oPCAN_RADAR_d0b3c0f6_Tx: ComBitPosition=200, ComBitSize=13, ComSignalInitValue=0, ComSignalType=UINT16, ComSystemTemplateSystemSignalRef=DET_AZIMUTH_314
            DET_AZIMUTH_315_oRDR_DETECTION_313_316_oPCAN_RADAR_45c31463_Tx: ComBitPosition=312, ComBitSize=13, ComSignalInitValue=0, ComSignalType=UINT16, ComSystemTemplateSystemSignalRef=DET_AZIMUTH_315
            DET_AZIMUTH_316_oRDR_DETECTION_313_316_oPCAN_RADAR_21236f9d_Tx: ComBitPosition=424, ComBitSize=13, ComSignalInitValue=0, ComSignalType=UINT16, ComSystemTemplateSystemSignalRef=DET_AZIMUTH_316
            DET_AZIMUTH_ERR_313_oRDR_DETECTION_313_316_oPCAN_RADAR_28b6766a_Tx: ComBitPosition=105, ComBitSize=7, ComSignalInitValue=0, ComSignalType=UINT8, ComSystemTemplateSystemSignalRef=DET_AZIMUTH_ERR_313
            DET_AZIMUTH_ERR_314_oRDR_DETECTION_313_316_oPCAN_RADAR_74065503_Tx: ComBitPosition=217, ComBitSize=7, ComSignalInitValue=0, ComSignalType=UINT8, ComSystemTemplateSystemSignalRef=DET_AZIMUTH_ERR_314
            DET_AZIMUTH_ERR_315_oRDR_DETECTION_313_316_oPCAN_RADAR_e1768196_Tx: ComBitPosition=329, ComBitSize=7, ComSignalInitValue=0, ComSignalType=UINT8, ComSystemTemplateSystemSignalRef=DET_AZIMUTH_ERR_315
            DET_AZIMUTH_ERR_316_oRDR_DETECTION_313_316_oPCAN_RADAR_8596fa68_Tx: ComBitPosition=441, ComBitSize=7, ComSignalInitValue=0, ComSignalType=UINT8, ComSystemTemplateSystemSignalRef=DET_AZIMUTH_ERR_316
            DET_BELOW_RAIN_THOLD_313_oRDR_DETECTION_313_316_oPCAN_RADAR_5902705f_Tx: ComBitPosition=39, ComBitSize=1, ComSignalInitValue=0, ComSignalType=BOOLEAN, ComSystemTemplateSystemSignalRef=DET_BELOW_RAIN_THOLD_313
            DET_BELOW_RAIN_THOLD_314_oRDR_DETECTION_313_316_oPCAN_RADAR_05b25336_Tx: ComBitPosition=151, ComBitSize=1, ComSignalInitValue=0, ComSignalType=BOOLEAN, ComSystemTemplateSystemSignalRef=DET_BELOW_RAIN_THOLD_314
            DET_BELOW_RAIN_THOLD_315_oRDR_DETECTION_313_316_oPCAN_RADAR_90c287a3_Tx: ComBitPosition=263, ComBitSize=1, ComSignalInitValue=0, ComSignalType=BOOLEAN, ComSystemTemplateSystemSignalRef=DET_BELOW_RAIN_THOLD_315
            DET_BELOW_RAIN_THOLD_316_oRDR_DETECTION_313_316_oPCAN_RADAR_f422fc5d_Tx: ComBitPosition=375, ComBitSize=1, ComSignalInitValue=0, ComSignalType=BOOLEAN, ComSystemTemplateSystemSignalRef=DET_BELOW_RAIN_THOLD_316
            DET_BI_STATIC_FLAG_313_oRDR_DETECTION_313_316_oPCAN_RADAR_da2fa31a_Tx: ComBitPosition=104, ComBitSize=1, ComSignalInitValue=0, ComSignalType=BOOLEAN, ComSystemTemplateSystemSignalRef=DET_BI_STATIC_FLAG_313
            DET_BI_STATIC_FLAG_314_oRDR_DETECTION_313_316_oPCAN_RADAR_869f8073_Tx: ComBitPosition=216, ComBitSize=1, ComSignalInitValue=0, ComSignalType=BOOLEAN, ComSystemTemplateSystemSignalRef=DET_BI_STATIC_FLAG_314
            DET_BI_STATIC_FLAG_315_oRDR_DETECTION_313_316_oPCAN_RADAR_13ef54e6_Tx: ComBitPosition=328, ComBitSize=1, ComSignalInitValue=0, ComSignalType=BOOLEAN, ComSystemTemplateSystemSignalRef=DET_BI_STATIC_FLAG_315
            DET_BI_STATIC_FLAG_316_oRDR_DETECTION_313_316_oPCAN_RADAR_770f2f18_Tx: ComBitPosition=440, ComBitSize=1, ComSignalInitValue=0, ComSignalType=BOOLEAN, ComSystemTemplateSystemSignalRef=DET_BI_STATIC_FLAG_316
            DET_CONFD_AZIMUTH_313_oRDR_DETECTION_313_316_oPCAN_RADAR_8ee5e955_Tx: ComBitPosition=118, ComBitSize=2, ComSignalInitValue=0, ComSignalType=UINT8, ComSystemTemplateSystemSignalRef=DET_CONFD_AZIMUTH_313
            DET_CONFD_AZIMUTH_314_oRDR_DETECTION_313_316_oPCAN_RADAR_d255ca3c_Tx: ComBitPosition=230, ComBitSize=2, ComSignalInitValue=0, ComSignalType=UINT8, ComSystemTemplateSystemSignalRef=DET_CONFD_AZIMUTH_314
            DET_CONFD_AZIMUTH_315_oRDR_DETECTION_313_316_oPCAN_RADAR_47251ea9_Tx: ComBitPosition=342, ComBitSize=2, ComSignalInitValue=0, ComSignalType=UINT8, ComSystemTemplateSystemSignalRef=DET_CONFD_AZIMUTH_315
            DET_CONFD_AZIMUTH_316_oRDR_DETECTION_313_316_oPCAN_RADAR_23c56557_Tx: ComBitPosition=454, ComBitSize=2, ComSignalInitValue=0, ComSignalType=UINT8, ComSystemTemplateSystemSignalRef=DET_CONFD_AZIMUTH_316
            DET_CONFD_ELEVATION_313_oRDR_DETECTION_313_316_oPCAN_RADAR_8c70e8af_Tx: ComBitPosition=101, ComBitSize=2, ComSignalInitValue=0, ComSignalType=UINT8, ComSystemTemplateSystemSignalRef=DET_CONFD_ELEVATION_313
            DET_CONFD_ELEVATION_314_oRDR_DETECTION_313_316_oPCAN_RADAR_d0c0cbc6_Tx: ComBitPosition=213, ComBitSize=2, ComSignalInitValue=0, ComSignalType=UINT8, ComSystemTemplateSystemSignalRef=DET_CONFD_ELEVATION_314
            DET_CONFD_ELEVATION_315_oRDR_DETECTION_313_316_oPCAN_RADAR_45b01f53_Tx: ComBitPosition=325, ComBitSize=2, ComSignalInitValue=0, ComSignalType=UINT8, ComSystemTemplateSystemSignalRef=DET_CONFD_ELEVATION_315
            DET_CONFD_ELEVATION_316_oRDR_DETECTION_313_316_oPCAN_RADAR_215064ad_Tx: ComBitPosition=437, ComBitSize=2, ComSignalInitValue=0, ComSignalType=UINT8, ComSystemTemplateSystemSignalRef=DET_CONFD_ELEVATION_316
            DET_ELEVATION_313_oRDR_DETECTION_313_316_oPCAN_RADAR_5db03c93_Tx: ComBitPosition=72, ComBitSize=8, ComSignalInitValue=0, ComSignalType=UINT8, ComSystemTemplateSystemSignalRef=DET_ELEVATION_313
            DET_ELEVATION_314_oRDR_DETECTION_313_316_oPCAN_RADAR_01001ffa_Tx: ComBitPosition=184, ComBitSize=8, ComSignalInitValue=0, ComSignalType=UINT8, ComSystemTemplateSystemSignalRef=DET_ELEVATION_314
            DET_ELEVATION_315_oRDR_DETECTION_313_316_oPCAN_RADAR_9470cb6f_Tx: ComBitPosition=296, ComBitSize=8, ComSignalInitValue=0, ComSignalType=UINT8, ComSystemTemplateSystemSignalRef=DET_ELEVATION_315
            DET_ELEVATION_316_oRDR_DETECTION_313_316_oPCAN_RADAR_f090b091_Tx: ComBitPosition=408, ComBitSize=8, ComSignalInitValue=0, ComSignalType=UINT8, ComSystemTemplateSystemSignalRef=DET_ELEVATION_316
            DET_ELEVATION_ERR_313_oRDR_DETECTION_313_316_oPCAN_RADAR_da89a4e6_Tx: ComBitPosition=80, ComBitSize=6, ComSignalInitValue=0, ComSignalType=UINT8, ComSystemTemplateSystemSignalRef=DET_ELEVATION_ERR_313
            DET_ELEVATION_ERR_314_oRDR_DETECTION_313_316_oPCAN_RADAR_8639878f_Tx: ComBitPosition=192, ComBitSize=6, ComSignalInitValue=0, ComSignalType=UINT8, ComSystemTemplateSystemSignalRef=DET_ELEVATION_ERR_314
            DET_ELEVATION_ERR_315_oRDR_DETECTION_313_316_oPCAN_RADAR_1349531a_Tx: ComBitPosition=304, ComBitSize=6, ComSignalInitValue=0, ComSignalType=UINT8, ComSystemTemplateSystemSignalRef=DET_ELEVATION_ERR_315
            DET_ELEVATION_ERR_316_oRDR_DETECTION_313_316_oPCAN_RADAR_77a928e4_Tx: ComBitPosition=416, ComBitSize=6, ComSignalInitValue=0, ComSignalType=UINT8, ComSystemTemplateSystemSignalRef=DET_ELEVATION_ERR_316
            DET_EXISTENCE_PROB_313_oRDR_DETECTION_313_316_oPCAN_RADAR_0816d186_Tx: ComBitPosition=112, ComBitSize=6, ComSignalInitValue=0, ComSignalType=UINT8, ComSystemTemplateSystemSignalRef=DET_EXISTENCE_PROB_313
            DET_EXISTENCE_PROB_314_oRDR_DETECTION_313_316_oPCAN_RADAR_54a6f2ef_Tx: ComBitPosition=224, ComBitSize=6, ComSignalInitValue=0, ComSignalType=UINT8, ComSystemTemplateSystemSignalRef=DET_EXISTENCE_PROB_314
            DET_EXISTENCE_PROB_315_oRDR_DETECTION_313_316_oPCAN_RADAR_c1d6267a_Tx: ComBitPosition=336, ComBitSize=6, ComSignalInitValue=0, ComSignalType=UINT8, ComSystemTemplateSystemSignalRef=DET_EXISTENCE_PROB_315
            DET_EXISTENCE_PROB_316_oRDR_DETECTION_313_316_oPCAN_RADAR_a5365d84_Tx: ComBitPosition=448, ComBitSize=6, ComSignalInitValue=0, ComSignalType=UINT8, ComSystemTemplateSystemSignalRef=DET_EXISTENCE_PROB_316
            DET_HVC_FLAG_313_oRDR_DETECTION_313_316_oPCAN_RADAR_e96292f9_Tx: ComBitPosition=86, ComBitSize=1, ComSignalInitValue=0, ComSignalType=BOOLEAN, ComSystemTemplateSystemSignalRef=DET_HVC_FLAG_313
            DET_HVC_FLAG_314_oRDR_DETECTION_313_316_oPCAN_RADAR_b5d2b190_Tx: ComBitPosition=198, ComBitSize=1, ComSignalInitValue=0, ComSignalType=BOOLEAN, ComSystemTemplateSystemSignalRef=DET_HVC_FLAG_314
            DET_HVC_FLAG_315_oRDR_DETECTION_313_316_oPCAN_RADAR_20a26505_Tx: ComBitPosition=310, ComBitSize=1, ComSignalInitValue=0, ComSignalType=BOOLEAN, ComSystemTemplateSystemSignalRef=DET_HVC_FLAG_315
            DET_HVC_FLAG_316_oRDR_DETECTION_313_316_oPCAN_RADAR_44421efb_Tx: ComBitPosition=422, ComBitSize=1, ComSignalInitValue=0, ComSignalType=BOOLEAN, ComSystemTemplateSystemSignalRef=DET_HVC_FLAG_316
            DET_IDM_313_oRDR_DETECTION_313_316_oPCAN_RADAR_6230a944_Tx: ComBitPosition=63, ComBitSize=1, ComSignalInitValue=0, ComSignalType=BOOLEAN, ComSystemTemplateSystemSignalRef=DET_IDM_313
            DET_IDM_314_oRDR_DETECTION_313_316_oPCAN_RADAR_3e808a2d_Tx: ComBitPosition=175, ComBitSize=1, ComSignalInitValue=0, ComSignalType=BOOLEAN, ComSystemTemplateSystemSignalRef=DET_IDM_314
            DET_IDM_315_oRDR_DETECTION_313_316_oPCAN_RADAR_abf05eb8_Tx: ComBitPosition=287, ComBitSize=1, ComSignalInitValue=0, ComSignalType=BOOLEAN, ComSystemTemplateSystemSignalRef=DET_IDM_315
            DET_IDM_316_oRDR_DETECTION_313_316_oPCAN_RADAR_cf102546_Tx: ComBitPosition=399, ComBitSize=1, ComSignalInitValue=0, ComSignalType=BOOLEAN, ComSystemTemplateSystemSignalRef=DET_IDM_316
            DET_MH_CRC16_313_316_oRDR_DETECTION_313_316_oPCAN_RADAR_468a586b_Tx: ComBitPosition=0, ComBitSize=16, ComSignalInitValue=0, ComSignalType=UINT16, ComSystemTemplateSystemSignalRef=DET_MH_CRC16_313_316
            DET_MH_CYCLE_COUNTER_313_316_oRDR_DETECTION_313_316_oPCAN_RADAR_c2fff95c_Tx: ComBitPosition=16, ComBitSize=8, ComSignalInitValue=0, ComSignalType=UINT8, ComSystemTemplateSystemSignalRef=DET_MH_CYCLE_COUNTER_313_316
            DET_MH_SCAN_INDEX_4LSB_313_316_oRDR_DETECTION_313_316_oPCAN_RADAR_0ed5dcd0_Tx: ComBitPosition=476, ComBitSize=4, ComSignalInitValue=0, ComSignalType=UINT8, ComSystemTemplateSystemSignalRef=DET_MH_SCAN_INDEX_4LSB_313_316
            DET_MTD_313_oRDR_DETECTION_313_316_oPCAN_RADAR_04839b9f_Tx: ComBitPosition=47, ComBitSize=1, ComSignalInitValue=0, ComSignalType=BOOLEAN, ComSystemTemplateSystemSignalRef=DET_MTD_313
            DET_MTD_314_oRDR_DETECTION_313_316_oPCAN_RADAR_5833b8f6_Tx: ComBitPosition=159, ComBitSize=1, ComSignalInitValue=0, ComSignalType=BOOLEAN, ComSystemTemplateSystemSignalRef=DET_MTD_314
            DET_MTD_315_oRDR_DETECTION_313_316_oPCAN_RADAR_cd436c63_Tx: ComBitPosition=271, ComBitSize=1, ComSignalInitValue=0, ComSignalType=BOOLEAN, ComSystemTemplateSystemSignalRef=DET_MTD_315
            DET_MTD_316_oRDR_DETECTION_313_316_oPCAN_RADAR_a9a3179d_Tx: ComBitPosition=383, ComBitSize=1, ComSignalInitValue=0, ComSignalType=BOOLEAN, ComSystemTemplateSystemSignalRef=DET_MTD_316
            DET_PROB_1STAZHYPO_313_oRDR_DETECTION_313_316_oPCAN_RADAR_97377352_Tx: ComBitPosition=103, ComBitSize=1, ComSignalInitValue=0, ComSignalType=BOOLEAN, ComSystemTemplateSystemSignalRef=DET_PROB_1STAZHYPO_313
            DET_PROB_1STAZHYPO_314_oRDR_DETECTION_313_316_oPCAN_RADAR_cb87503b_Tx: ComBitPosition=215, ComBitSize=1, ComSignalInitValue=0, ComSignalType=BOOLEAN, ComSystemTemplateSystemSignalRef=DET_PROB_1STAZHYPO_314
            DET_PROB_1STAZHYPO_315_oRDR_DETECTION_313_316_oPCAN_RADAR_5ef784ae_Tx: ComBitPosition=327, ComBitSize=1, ComSignalInitValue=0, ComSignalType=BOOLEAN, ComSystemTemplateSystemSignalRef=DET_PROB_1STAZHYPO_315
            DET_PROB_1STAZHYPO_316_oRDR_DETECTION_313_316_oPCAN_RADAR_3a17ff50_Tx: ComBitPosition=439, ComBitSize=1, ComSignalInitValue=0, ComSignalType=BOOLEAN, ComSystemTemplateSystemSignalRef=DET_PROB_1STAZHYPO_316
            DET_RANGE_313_oRDR_DETECTION_313_316_oPCAN_RADAR_9c989024_Tx: ComBitPosition=24, ComBitSize=15, ComSignalInitValue=0, ComSignalType=UINT16, ComSystemTemplateSystemSignalRef=DET_RANGE_313
            DET_RANGE_314_oRDR_DETECTION_313_316_oPCAN_RADAR_c028b34d_Tx: ComBitPosition=136, ComBitSize=15, ComSignalInitValue=0, ComSignalType=UINT16, ComSystemTemplateSystemSignalRef=DET_RANGE_314
            DET_RANGE_315_oRDR_DETECTION_313_316_oPCAN_RADAR_555867d8_Tx: ComBitPosition=248, ComBitSize=15, ComSignalInitValue=0, ComSignalType=UINT16, ComSystemTemplateSystemSignalRef=DET_RANGE_315
            DET_RANGE_316_oRDR_DETECTION_313_316_oPCAN_RADAR_31b81c26_Tx: ComBitPosition=360, ComBitSize=15, ComSignalInitValue=0, ComSignalType=UINT16, ComSystemTemplateSystemSignalRef=DET_RANGE_316
            DET_RANGE_ERR_313_oRDR_DETECTION_313_316_oPCAN_RADAR_3b702a4d_Tx: ComBitPosition=40, ComBitSize=7, ComSignalInitValue=0, ComSignalType=UINT8, ComSystemTemplateSystemSignalRef=DET_RANGE_ERR_313
            DET_RANGE_ERR_314_oRDR_DETECTION_313_316_oPCAN_RADAR_67c00924_Tx: ComBitPosition=152, ComBitSize=7, ComSignalInitValue=0, ComSignalType=UINT8, ComSystemTemplateSystemSignalRef=DET_RANGE_ERR_314
            DET_RANGE_ERR_315_oRDR_DETECTION_313_316_oPCAN_RADAR_f2b0ddb1_Tx: ComBitPosition=264, ComBitSize=7, ComSignalInitValue=0, ComSignalType=UINT8, ComSystemTemplateSystemSignalRef=DET_RANGE_ERR_315
            DET_RANGE_ERR_316_oRDR_DETECTION_313_316_oPCAN_RADAR_9650a64f_Tx: ComBitPosition=376, ComBitSize=7, ComSignalInitValue=0, ComSignalType=UINT8, ComSystemTemplateSystemSignalRef=DET_RANGE_ERR_316
            DET_RANGE_VELOCITY_313_oRDR_DETECTION_313_316_oPCAN_RADAR_e93e5201_Tx: ComBitPosition=48, ComBitSize=15, ComSignalInitValue=16384, ComSignalType=UINT16, ComSystemTemplateSystemSignalRef=DET_RANGE_VELOCITY_313
            DET_RANGE_VELOCITY_314_oRDR_DETECTION_313_316_oPCAN_RADAR_b58e7168_Tx: ComBitPosition=160, ComBitSize=15, ComSignalInitValue=16384, ComSignalType=UINT16, ComSystemTemplateSystemSignalRef=DET_RANGE_VELOCITY_314
            DET_RANGE_VELOCITY_315_oRDR_DETECTION_313_316_oPCAN_RADAR_20fea5fd_Tx: ComBitPosition=272, ComBitSize=15, ComSignalInitValue=16384, ComSignalType=UINT16, ComSystemTemplateSystemSignalRef=DET_RANGE_VELOCITY_315
            DET_RANGE_VELOCITY_316_oRDR_DETECTION_313_316_oPCAN_RADAR_441ede03_Tx: ComBitPosition=384, ComBitSize=15, ComSignalInitValue=16384, ComSignalType=UINT16, ComSystemTemplateSystemSignalRef=DET_RANGE_VELOCITY_316
            DET_RANGE_VELOCITY_ERR_313_oRDR_DETECTION_313_316_oPCAN_RADAR_e685a9b3_Tx: ComBitPosition=64, ComBitSize=8, ComSignalInitValue=0, ComSignalType=UINT8, ComSystemTemplateSystemSignalRef=DET_RANGE_VELOCITY_ERR_313
            DET_RANGE_VELOCITY_ERR_314_oRDR_DETECTION_313_316_oPCAN_RADAR_ba358ada_Tx: ComBitPosition=176, ComBitSize=8, ComSignalInitValue=0, ComSignalType=UINT8, ComSystemTemplateSystemSignalRef=DET_RANGE_VELOCITY_ERR_314
            DET_RANGE_VELOCITY_ERR_315_oRDR_DETECTION_313_316_oPCAN_RADAR_2f455e4f_Tx: ComBitPosition=288, ComBitSize=8, ComSignalInitValue=0, ComSignalType=UINT8, ComSystemTemplateSystemSignalRef=DET_RANGE_VELOCITY_ERR_315
            DET_RANGE_VELOCITY_ERR_316_oRDR_DETECTION_313_316_oPCAN_RADAR_4ba525b1_Tx: ComBitPosition=400, ComBitSize=8, ComSignalInitValue=0, ComSignalType=UINT8, ComSystemTemplateSystemSignalRef=DET_RANGE_VELOCITY_ERR_316
            DET_RCS_313_oRDR_DETECTION_313_316_oPCAN_RADAR_6ebe655b_Tx: ComBitPosition=128, ComBitSize=8, ComSignalInitValue=128, ComSignalType=UINT8, ComSystemTemplateSystemSignalRef=DET_RCS_313
            DET_RCS_314_oRDR_DETECTION_313_316_oPCAN_RADAR_320e4632_Tx: ComBitPosition=240, ComBitSize=8, ComSignalInitValue=128, ComSignalType=UINT8, ComSystemTemplateSystemSignalRef=DET_RCS_314
            DET_RCS_315_oRDR_DETECTION_313_316_oPCAN_RADAR_a77e92a7_Tx: ComBitPosition=352, ComBitSize=8, ComSignalInitValue=128, ComSignalType=UINT8, ComSystemTemplateSystemSignalRef=DET_RCS_315
            DET_RCS_316_oRDR_DETECTION_313_316_oPCAN_RADAR_c39ee959_Tx: ComBitPosition=464, ComBitSize=8, ComSignalInitValue=128, ComSignalType=UINT8, ComSystemTemplateSystemSignalRef=DET_RCS_316
            DET_SNR_313_oRDR_DETECTION_313_316_oPCAN_RADAR_b3103159_Tx: ComBitPosition=120, ComBitSize=8, ComSignalInitValue=0, ComSignalType=UINT8, ComSystemTemplateSystemSignalRef=DET_SNR_313
            DET_SNR_314_oRDR_DETECTION_313_316_oPCAN_RADAR_efa01230_Tx: ComBitPosition=232, ComBitSize=8, ComSignalInitValue=0, ComSignalType=UINT8, ComSystemTemplateSystemSignalRef=DET_SNR_314
            DET_SNR_315_oRDR_DETECTION_313_316_oPCAN_RADAR_7ad0c6a5_Tx: ComBitPosition=344, ComBitSize=8, ComSignalInitValue=0, ComSignalType=UINT8, ComSystemTemplateSystemSignalRef=DET_SNR_315
            DET_SNR_316_oRDR_DETECTION_313_316_oPCAN_RADAR_1e30bd5b_Tx: ComBitPosition=456, ComBitSize=8, ComSignalInitValue=0, ComSignalType=UINT8, ComSystemTemplateSystemSignalRef=DET_SNR_316
            DET_SUPER_RES_TARGET_313_oRDR_DETECTION_313_316_oPCAN_RADAR_8289193c_Tx: ComBitPosition=87, ComBitSize=1, ComSignalInitValue=0, ComSignalType=BOOLEAN, ComSystemTemplateSystemSignalRef=DET_SUPER_RES_TARGET_313
            DET_SUPER_RES_TARGET_314_oRDR_DETECTION_313_316_oPCAN_RADAR_de393a55_Tx: ComBitPosition=199, ComBitSize=1, ComSignalInitValue=0, ComSignalType=BOOLEAN, ComSystemTemplateSystemSignalRef=DET_SUPER_RES_TARGET_314
            DET_SUPER_RES_TARGET_315_oRDR_DETECTION_313_316_oPCAN_RADAR_4b49eec0_Tx: ComBitPosition=311, ComBitSize=1, ComSignalInitValue=0, ComSignalType=BOOLEAN, ComSystemTemplateSystemSignalRef=DET_SUPER_RES_TARGET_315
            DET_SUPER_RES_TARGET_316_oRDR_DETECTION_313_316_oPCAN_RADAR_2fa9953e_Tx: ComBitPosition=423, ComBitSize=1, ComSignalInitValue=0, ComSignalType=BOOLEAN, ComSystemTemplateSystemSignalRef=DET_SUPER_RES_TARGET_316
        SG_Detections_317_320_oRDR_DETECTION_317_320_oPCAN_RADAR_2eaedcea_Tx: ComSystemTemplateSignalGroupRef=SG_Detections_317_320
          83 x ComGroupSignal, all with ComSignalEndianness=LITTLE_ENDIAN, ComTransferProperty=PENDING:
            DET_AZIMUTH_317_oRDR_DETECTION_317_320_oPCAN_RADAR_1bdf66c1_Tx: ComBitPosition=88, ComBitSize=13, ComSignalInitValue=0, ComSignalType=UINT16, ComSystemTemplateSystemSignalRef=DET_AZIMUTH_317
            DET_AZIMUTH_318_oRDR_DETECTION_317_320_oPCAN_RADAR_37cff486_Tx: ComBitPosition=200, ComBitSize=13, ComSignalInitValue=0, ComSignalType=UINT16, ComSystemTemplateSystemSignalRef=DET_AZIMUTH_318
            DET_AZIMUTH_319_oRDR_DETECTION_317_320_oPCAN_RADAR_a2bf2013_Tx: ComBitPosition=312, ComBitSize=13, ComSignalInitValue=0, ComSignalType=UINT16, ComSystemTemplateSystemSignalRef=DET_AZIMUTH_319
            DET_AZIMUTH_320_oRDR_DETECTION_317_320_oPCAN_RADAR_1d0e7ac8_Tx: ComBitPosition=424, ComBitSize=13, ComSignalInitValue=0, ComSignalType=UINT16, ComSystemTemplateSystemSignalRef=DET_AZIMUTH_320
            DET_AZIMUTH_ERR_317_oRDR_DETECTION_317_320_oPCAN_RADAR_bf6af334_Tx: ComBitPosition=105, ComBitSize=7, ComSignalInitValue=0, ComSignalType=UINT8, ComSystemTemplateSystemSignalRef=DET_AZIMUTH_ERR_317
            DET_AZIMUTH_ERR_318_oRDR_DETECTION_317_320_oPCAN_RADAR_937a6173_Tx: ComBitPosition=217, ComBitSize=7, ComSignalInitValue=0, ComSignalType=UINT8, ComSystemTemplateSystemSignalRef=DET_AZIMUTH_ERR_318
            DET_AZIMUTH_ERR_319_oRDR_DETECTION_317_320_oPCAN_RADAR_060ab5e6_Tx: ComBitPosition=329, ComBitSize=7, ComSignalInitValue=0, ComSignalType=UINT8, ComSystemTemplateSystemSignalRef=DET_AZIMUTH_ERR_319
            DET_AZIMUTH_ERR_320_oRDR_DETECTION_317_320_oPCAN_RADAR_b9bbef3d_Tx: ComBitPosition=441, ComBitSize=7, ComSignalInitValue=0, ComSignalType=UINT8, ComSystemTemplateSystemSignalRef=DET_AZIMUTH_ERR_320
            DET_BELOW_RAIN_THOLD_317_oRDR_DETECTION_317_320_oPCAN_RADAR_cedef501_Tx: ComBitPosition=39, ComBitSize=1, ComSignalInitValue=0, ComSignalType=BOOLEAN, ComSystemTemplateSystemSignalRef=DET_BELOW_RAIN_THOLD_317
            DET_BELOW_RAIN_THOLD_318_oRDR_DETECTION_317_320_oPCAN_RADAR_e2ce6746_Tx: ComBitPosition=151, ComBitSize=1, ComSignalInitValue=0, ComSignalType=BOOLEAN, ComSystemTemplateSystemSignalRef=DET_BELOW_RAIN_THOLD_318
            DET_BELOW_RAIN_THOLD_319_oRDR_DETECTION_317_320_oPCAN_RADAR_77beb3d3_Tx: ComBitPosition=263, ComBitSize=1, ComSignalInitValue=0, ComSignalType=BOOLEAN, ComSystemTemplateSystemSignalRef=DET_BELOW_RAIN_THOLD_319
            DET_BELOW_RAIN_THOLD_320_oRDR_DETECTION_317_320_oPCAN_RADAR_c80fe908_Tx: ComBitPosition=375, ComBitSize=1, ComSignalInitValue=0, ComSignalType=BOOLEAN, ComSystemTemplateSystemSignalRef=DET_BELOW_RAIN_THOLD_320
            DET_BI_STATIC_FLAG_317_oRDR_DETECTION_317_320_oPCAN_RADAR_4df32644_Tx: ComBitPosition=104, ComBitSize=1, ComSignalInitValue=0, ComSignalType=BOOLEAN, ComSystemTemplateSystemSignalRef=DET_BI_STATIC_FLAG_317
            DET_BI_STATIC_FLAG_318_oRDR_DETECTION_317_320_oPCAN_RADAR_61e3b403_Tx: ComBitPosition=216, ComBitSize=1, ComSignalInitValue=0, ComSignalType=BOOLEAN, ComSystemTemplateSystemSignalRef=DET_BI_STATIC_FLAG_318
            DET_BI_STATIC_FLAG_319_oRDR_DETECTION_317_320_oPCAN_RADAR_f4936096_Tx: ComBitPosition=328, ComBitSize=1, ComSignalInitValue=0, ComSignalType=BOOLEAN, ComSystemTemplateSystemSignalRef=DET_BI_STATIC_FLAG_319
            DET_BI_STATIC_FLAG_320_oRDR_DETECTION_317_320_oPCAN_RADAR_4b223a4d_Tx: ComBitPosition=440, ComBitSize=1, ComSignalInitValue=0, ComSignalType=BOOLEAN, ComSystemTemplateSystemSignalRef=DET_BI_STATIC_FLAG_320
            DET_CONFD_AZIMUTH_317_oRDR_DETECTION_317_320_oPCAN_RADAR_19396c0b_Tx: ComBitPosition=118, ComBitSize=2, ComSignalInitValue=0, ComSignalType=UINT8, ComSystemTemplateSystemSignalRef=DET_CONFD_AZIMUTH_317
            DET_CONFD_AZIMUTH_318_oRDR_DETECTION_317_320_oPCAN_RADAR_3529fe4c_Tx: ComBitPosition=230, ComBitSize=2, ComSignalInitValue=0, ComSignalType=UINT8, ComSystemTemplateSystemSignalRef=DET_CONFD_AZIMUTH_318
            DET_CONFD_AZIMUTH_319_oRDR_DETECTION_317_320_oPCAN_RADAR_a0592ad9_Tx: ComBitPosition=342, ComBitSize=2, ComSignalInitValue=0, ComSignalType=UINT8, ComSystemTemplateSystemSignalRef=DET_CONFD_AZIMUTH_319
            DET_CONFD_AZIMUTH_320_oRDR_DETECTION_317_320_oPCAN_RADAR_1fe87002_Tx: ComBitPosition=454, ComBitSize=2, ComSignalInitValue=0, ComSignalType=UINT8, ComSystemTemplateSystemSignalRef=DET_CONFD_AZIMUTH_320
            DET_CONFD_ELEVATION_317_oRDR_DETECTION_317_320_oPCAN_RADAR_1bac6df1_Tx: ComBitPosition=101, ComBitSize=2, ComSignalInitValue=0, ComSignalType=UINT8, ComSystemTemplateSystemSignalRef=DET_CONFD_ELEVATION_317
            DET_CONFD_ELEVATION_318_oRDR_DETECTION_317_320_oPCAN_RADAR_37bcffb6_Tx: ComBitPosition=213, ComBitSize=2, ComSignalInitValue=0, ComSignalType=UINT8, ComSystemTemplateSystemSignalRef=DET_CONFD_ELEVATION_318
            DET_CONFD_ELEVATION_319_oRDR_DETECTION_317_320_oPCAN_RADAR_a2cc2b23_Tx: ComBitPosition=325, ComBitSize=2, ComSignalInitValue=0, ComSignalType=UINT8, ComSystemTemplateSystemSignalRef=DET_CONFD_ELEVATION_319
            DET_CONFD_ELEVATION_320_oRDR_DETECTION_317_320_oPCAN_RADAR_1d7d71f8_Tx: ComBitPosition=437, ComBitSize=2, ComSignalInitValue=0, ComSignalType=UINT8, ComSystemTemplateSystemSignalRef=DET_CONFD_ELEVATION_320
            DET_ELEVATION_317_oRDR_DETECTION_317_320_oPCAN_RADAR_ca6cb9cd_Tx: ComBitPosition=72, ComBitSize=8, ComSignalInitValue=0, ComSignalType=UINT8, ComSystemTemplateSystemSignalRef=DET_ELEVATION_317
            DET_ELEVATION_318_oRDR_DETECTION_317_320_oPCAN_RADAR_e67c2b8a_Tx: ComBitPosition=184, ComBitSize=8, ComSignalInitValue=0, ComSignalType=UINT8, ComSystemTemplateSystemSignalRef=DET_ELEVATION_318
            DET_ELEVATION_319_oRDR_DETECTION_317_320_oPCAN_RADAR_730cff1f_Tx: ComBitPosition=296, ComBitSize=8, ComSignalInitValue=0, ComSignalType=UINT8, ComSystemTemplateSystemSignalRef=DET_ELEVATION_319
            DET_ELEVATION_320_oRDR_DETECTION_317_320_oPCAN_RADAR_ccbda5c4_Tx: ComBitPosition=408, ComBitSize=8, ComSignalInitValue=0, ComSignalType=UINT8, ComSystemTemplateSystemSignalRef=DET_ELEVATION_320
            DET_ELEVATION_ERR_317_oRDR_DETECTION_317_320_oPCAN_RADAR_4d5521b8_Tx: ComBitPosition=80, ComBitSize=6, ComSignalInitValue=0, ComSignalType=UINT8, ComSystemTemplateSystemSignalRef=DET_ELEVATION_ERR_317
            DET_ELEVATION_ERR_318_oRDR_DETECTION_317_320_oPCAN_RADAR_6145b3ff_Tx: ComBitPosition=192, ComBitSize=6, ComSignalInitValue=0, ComSignalType=UINT8, ComSystemTemplateSystemSignalRef=DET_ELEVATION_ERR_318
            DET_ELEVATION_ERR_319_oRDR_DETECTION_317_320_oPCAN_RADAR_f435676a_Tx: ComBitPosition=304, ComBitSize=6, ComSignalInitValue=0, ComSignalType=UINT8, ComSystemTemplateSystemSignalRef=DET_ELEVATION_ERR_319
            DET_ELEVATION_ERR_320_oRDR_DETECTION_317_320_oPCAN_RADAR_4b843db1_Tx: ComBitPosition=416, ComBitSize=6, ComSignalInitValue=0, ComSignalType=UINT8, ComSystemTemplateSystemSignalRef=DET_ELEVATION_ERR_320
            DET_EXISTENCE_PROB_317_oRDR_DETECTION_317_320_oPCAN_RADAR_9fca54d8_Tx: ComBitPosition=112, ComBitSize=6, ComSignalInitValue=0, ComSignalType=UINT8, ComSystemTemplateSystemSignalRef=DET_EXISTENCE_PROB_317
            DET_EXISTENCE_PROB_318_oRDR_DETECTION_317_320_oPCAN_RADAR_b3dac69f_Tx: ComBitPosition=224, ComBitSize=6, ComSignalInitValue=0, ComSignalType=UINT8, ComSystemTemplateSystemSignalRef=DET_EXISTENCE_PROB_318
            DET_EXISTENCE_PROB_319_oRDR_DETECTION_317_320_oPCAN_RADAR_26aa120a_Tx: ComBitPosition=336, ComBitSize=6, ComSignalInitValue=0, ComSignalType=UINT8, ComSystemTemplateSystemSignalRef=DET_EXISTENCE_PROB_319
            DET_EXISTENCE_PROB_320_oRDR_DETECTION_317_320_oPCAN_RADAR_991b48d1_Tx: ComBitPosition=448, ComBitSize=6, ComSignalInitValue=0, ComSignalType=UINT8, ComSystemTemplateSystemSignalRef=DET_EXISTENCE_PROB_320
            DET_HVC_FLAG_317_oRDR_DETECTION_317_320_oPCAN_RADAR_7ebe17a7_Tx: ComBitPosition=86, ComBitSize=1, ComSignalInitValue=0, ComSignalType=BOOLEAN, ComSystemTemplateSystemSignalRef=DET_HVC_FLAG_317
            DET_HVC_FLAG_318_oRDR_DETECTION_317_320_oPCAN_RADAR_52ae85e0_Tx: ComBitPosition=198, ComBitSize=1, ComSignalInitValue=0, ComSignalType=BOOLEAN, ComSystemTemplateSystemSignalRef=DET_HVC_FLAG_318
            DET_HVC_FLAG_319_oRDR_DETECTION_317_320_oPCAN_RADAR_c7de5175_Tx: ComBitPosition=310, ComBitSize=1, ComSignalInitValue=0, ComSignalType=BOOLEAN, ComSystemTemplateSystemSignalRef=DET_HVC_FLAG_319
            DET_HVC_FLAG_320_oRDR_DETECTION_317_320_oPCAN_RADAR_786f0bae_Tx: ComBitPosition=422, ComBitSize=1, ComSignalInitValue=0, ComSignalType=BOOLEAN, ComSystemTemplateSystemSignalRef=DET_HVC_FLAG_320
            DET_IDM_317_oRDR_DETECTION_317_320_oPCAN_RADAR_f5ec2c1a_Tx: ComBitPosition=63, ComBitSize=1, ComSignalInitValue=0, ComSignalType=BOOLEAN, ComSystemTemplateSystemSignalRef=DET_IDM_317
            DET_IDM_318_oRDR_DETECTION_317_320_oPCAN_RADAR_d9fcbe5d_Tx: ComBitPosition=175, ComBitSize=1, ComSignalInitValue=0, ComSignalType=BOOLEAN, ComSystemTemplateSystemSignalRef=DET_IDM_318
            DET_IDM_319_oRDR_DETECTION_317_320_oPCAN_RADAR_4c8c6ac8_Tx: ComBitPosition=287, ComBitSize=1, ComSignalInitValue=0, ComSignalType=BOOLEAN, ComSystemTemplateSystemSignalRef=DET_IDM_319
            DET_IDM_320_oRDR_DETECTION_317_320_oPCAN_RADAR_f33d3013_Tx: ComBitPosition=399, ComBitSize=1, ComSignalInitValue=0, ComSignalType=BOOLEAN, ComSystemTemplateSystemSignalRef=DET_IDM_320
            DET_MH_CRC16_317_320_oRDR_DETECTION_317_320_oPCAN_RADAR_aa260ee1_Tx: ComBitPosition=0, ComBitSize=16, ComSignalInitValue=0, ComSignalType=UINT16, ComSystemTemplateSystemSignalRef=DET_MH_CRC16_317_320
            DET_MH_CYCLE_COUNTER_317_320_oRDR_DETECTION_317_320_oPCAN_RADAR_2e53afd6_Tx: ComBitPosition=16, ComBitSize=8, ComSignalInitValue=0, ComSignalType=UINT8, ComSystemTemplateSystemSignalRef=DET_MH_CYCLE_COUNTER_317_320
            DET_MH_SCAN_INDEX_4LSB_317_320_oRDR_DETECTION_317_320_oPCAN_RADAR_e2798a5a_Tx: ComBitPosition=476, ComBitSize=4, ComSignalInitValue=0, ComSignalType=UINT8, ComSystemTemplateSystemSignalRef=DET_MH_SCAN_INDEX_4LSB_317_320
            DET_MTD_317_oRDR_DETECTION_317_320_oPCAN_RADAR_935f1ec1_Tx: ComBitPosition=47, ComBitSize=1, ComSignalInitValue=0, ComSignalType=BOOLEAN, ComSystemTemplateSystemSignalRef=DET_MTD_317
            DET_MTD_318_oRDR_DETECTION_317_320_oPCAN_RADAR_bf4f8c86_Tx: ComBitPosition=159, ComBitSize=1, ComSignalInitValue=0, ComSignalType=BOOLEAN, ComSystemTemplateSystemSignalRef=DET_MTD_318
            DET_MTD_319_oRDR_DETECTION_317_320_oPCAN_RADAR_2a3f5813_Tx: ComBitPosition=271, ComBitSize=1, ComSignalInitValue=0, ComSignalType=BOOLEAN, ComSystemTemplateSystemSignalRef=DET_MTD_319
            DET_MTD_320_oRDR_DETECTION_317_320_oPCAN_RADAR_958e02c8_Tx: ComBitPosition=383, ComBitSize=1, ComSignalInitValue=0, ComSignalType=BOOLEAN, ComSystemTemplateSystemSignalRef=DET_MTD_320
            DET_PROB_1STAZHYPO_317_oRDR_DETECTION_317_320_oPCAN_RADAR_00ebf60c_Tx: ComBitPosition=103, ComBitSize=1, ComSignalInitValue=0, ComSignalType=BOOLEAN, ComSystemTemplateSystemSignalRef=DET_PROB_1STAZHYPO_317
            DET_PROB_1STAZHYPO_318_oRDR_DETECTION_317_320_oPCAN_RADAR_2cfb644b_Tx: ComBitPosition=215, ComBitSize=1, ComSignalInitValue=0, ComSignalType=BOOLEAN, ComSystemTemplateSystemSignalRef=DET_PROB_1STAZHYPO_318
            DET_PROB_1STAZHYPO_319_oRDR_DETECTION_317_320_oPCAN_RADAR_b98bb0de_Tx: ComBitPosition=327, ComBitSize=1, ComSignalInitValue=0, ComSignalType=BOOLEAN, ComSystemTemplateSystemSignalRef=DET_PROB_1STAZHYPO_319
            DET_PROB_1STAZHYPO_320_oRDR_DETECTION_317_320_oPCAN_RADAR_063aea05_Tx: ComBitPosition=439, ComBitSize=1, ComSignalInitValue=0, ComSignalType=BOOLEAN, ComSystemTemplateSystemSignalRef=DET_PROB_1STAZHYPO_320
            DET_RANGE_317_oRDR_DETECTION_317_320_oPCAN_RADAR_0b44157a_Tx: ComBitPosition=24, ComBitSize=15, ComSignalInitValue=0, ComSignalType=UINT16, ComSystemTemplateSystemSignalRef=DET_RANGE_317
            DET_RANGE_318_oRDR_DETECTION_317_320_oPCAN_RADAR_2754873d_Tx: ComBitPosition=136, ComBitSize=15, ComSignalInitValue=0, ComSignalType=UINT16, ComSystemTemplateSystemSignalRef=DET_RANGE_318
            DET_RANGE_319_oRDR_DETECTION_317_320_oPCAN_RADAR_b22453a8_Tx: ComBitPosition=248, ComBitSize=15, ComSignalInitValue=0, ComSignalType=UINT16, ComSystemTemplateSystemSignalRef=DET_RANGE_319
            DET_RANGE_320_oRDR_DETECTION_317_320_oPCAN_RADAR_0d950973_Tx: ComBitPosition=360, ComBitSize=15, ComSignalInitValue=0, ComSignalType=UINT16, ComSystemTemplateSystemSignalRef=DET_RANGE_320
            DET_RANGE_ERR_317_oRDR_DETECTION_317_320_oPCAN_RADAR_acacaf13_Tx: ComBitPosition=40, ComBitSize=7, ComSignalInitValue=0, ComSignalType=UINT8, ComSystemTemplateSystemSignalRef=DET_RANGE_ERR_317
            DET_RANGE_ERR_318_oRDR_DETECTION_317_320_oPCAN_RADAR_80bc3d54_Tx: ComBitPosition=152, ComBitSize=7, ComSignalInitValue=0, ComSignalType=UINT8, ComSystemTemplateSystemSignalRef=DET_RANGE_ERR_318
            DET_RANGE_ERR_319_oRDR_DETECTION_317_320_oPCAN_RADAR_15cce9c1_Tx: ComBitPosition=264, ComBitSize=7, ComSignalInitValue=0, ComSignalType=UINT8, ComSystemTemplateSystemSignalRef=DET_RANGE_ERR_319
            DET_RANGE_ERR_320_oRDR_DETECTION_317_320_oPCAN_RADAR_aa7db31a_Tx: ComBitPosition=376, ComBitSize=7, ComSignalInitValue=0, ComSignalType=UINT8, ComSystemTemplateSystemSignalRef=DET_RANGE_ERR_320
            DET_RANGE_VELOCITY_317_oRDR_DETECTION_317_320_oPCAN_RADAR_7ee2d75f_Tx: ComBitPosition=48, ComBitSize=15, ComSignalInitValue=16384, ComSignalType=UINT16, ComSystemTemplateSystemSignalRef=DET_RANGE_VELOCITY_317
            DET_RANGE_VELOCITY_318_oRDR_DETECTION_317_320_oPCAN_RADAR_52f24518_Tx: ComBitPosition=160, ComBitSize=15, ComSignalInitValue=16384, ComSignalType=UINT16, ComSystemTemplateSystemSignalRef=DET_RANGE_VELOCITY_318
            DET_RANGE_VELOCITY_319_oRDR_DETECTION_317_320_oPCAN_RADAR_c782918d_Tx: ComBitPosition=272, ComBitSize=15, ComSignalInitValue=16384, ComSignalType=UINT16, ComSystemTemplateSystemSignalRef=DET_RANGE_VELOCITY_319
            DET_RANGE_VELOCITY_320_oRDR_DETECTION_317_320_oPCAN_RADAR_7833cb56_Tx: ComBitPosition=384, ComBitSize=15, ComSignalInitValue=16384, ComSignalType=UINT16, ComSystemTemplateSystemSignalRef=DET_RANGE_VELOCITY_320
            DET_RANGE_VELOCITY_ERR_317_oRDR_DETECTION_317_320_oPCAN_RADAR_71592ced_Tx: ComBitPosition=64, ComBitSize=8, ComSignalInitValue=0, ComSignalType=UINT8, ComSystemTemplateSystemSignalRef=DET_RANGE_VELOCITY_ERR_317
            DET_RANGE_VELOCITY_ERR_318_oRDR_DETECTION_317_320_oPCAN_RADAR_5d49beaa_Tx: ComBitPosition=176, ComBitSize=8, ComSignalInitValue=0, ComSignalType=UINT8, ComSystemTemplateSystemSignalRef=DET_RANGE_VELOCITY_ERR_318
            DET_RANGE_VELOCITY_ERR_319_oRDR_DETECTION_317_320_oPCAN_RADAR_c8396a3f_Tx: ComBitPosition=288, ComBitSize=8, ComSignalInitValue=0, ComSignalType=UINT8, ComSystemTemplateSystemSignalRef=DET_RANGE_VELOCITY_ERR_319
            DET_RANGE_VELOCITY_ERR_320_oRDR_DETECTION_317_320_oPCAN_RADAR_778830e4_Tx: ComBitPosition=400, ComBitSize=8, ComSignalInitValue=0, ComSignalType=UINT8, ComSystemTemplateSystemSignalRef=DET_RANGE_VELOCITY_ERR_320
            DET_RCS_317_oRDR_DETECTION_317_320_oPCAN_RADAR_f962e005_Tx: ComBitPosition=128, ComBitSize=8, ComSignalInitValue=128, ComSignalType=UINT8, ComSystemTemplateSystemSignalRef=DET_RCS_317
            DET_RCS_318_oRDR_DETECTION_317_320_oPCAN_RADAR_d5727242_Tx: ComBitPosition=240, ComBitSize=8, ComSignalInitValue=128, ComSignalType=UINT8, ComSystemTemplateSystemSignalRef=DET_RCS_318
            DET_RCS_319_oRDR_DETECTION_317_320_oPCAN_RADAR_4002a6d7_Tx: ComBitPosition=352, ComBitSize=8, ComSignalInitValue=128, ComSignalType=UINT8, ComSystemTemplateSystemSignalRef=DET_RCS_319
            DET_RCS_320_oRDR_DETECTION_317_320_oPCAN_RADAR_ffb3fc0c_Tx: ComBitPosition=464, ComBitSize=8, ComSignalInitValue=128, ComSignalType=UINT8, ComSystemTemplateSystemSignalRef=DET_RCS_320
            DET_SNR_317_oRDR_DETECTION_317_320_oPCAN_RADAR_24ccb407_Tx: ComBitPosition=120, ComBitSize=8, ComSignalInitValue=0, ComSignalType=UINT8, ComSystemTemplateSystemSignalRef=DET_SNR_317
            DET_SNR_318_oRDR_DETECTION_317_320_oPCAN_RADAR_08dc2640_Tx: ComBitPosition=232, ComBitSize=8, ComSignalInitValue=0, ComSignalType=UINT8, ComSystemTemplateSystemSignalRef=DET_SNR_318
            DET_SNR_319_oRDR_DETECTION_317_320_oPCAN_RADAR_9dacf2d5_Tx: ComBitPosition=344, ComBitSize=8, ComSignalInitValue=0, ComSignalType=UINT8, ComSystemTemplateSystemSignalRef=DET_SNR_319
            DET_SNR_320_oRDR_DETECTION_317_320_oPCAN_RADAR_221da80e_Tx: ComBitPosition=456, ComBitSize=8, ComSignalInitValue=0, ComSignalType=UINT8, ComSystemTemplateSystemSignalRef=DET_SNR_320
            DET_SUPER_RES_TARGET_317_oRDR_DETECTION_317_320_oPCAN_RADAR_15559c62_Tx: ComBitPosition=87, ComBitSize=1, ComSignalInitValue=0, ComSignalType=BOOLEAN, ComSystemTemplateSystemSignalRef=DET_SUPER_RES_TARGET_317
            DET_SUPER_RES_TARGET_318_oRDR_DETECTION_317_320_oPCAN_RADAR_39450e25_Tx: ComBitPosition=199, ComBitSize=1, ComSignalInitValue=0, ComSignalType=BOOLEAN, ComSystemTemplateSystemSignalRef=DET_SUPER_RES_TARGET_318
            DET_SUPER_RES_TARGET_319_oRDR_DETECTION_317_320_oPCAN_RADAR_ac35dab0_Tx: ComBitPosition=311, ComBitSize=1, ComSignalInitValue=0, ComSignalType=BOOLEAN, ComSystemTemplateSystemSignalRef=DET_SUPER_RES_TARGET_319
            DET_SUPER_RES_TARGET_320_oRDR_DETECTION_317_320_oPCAN_RADAR_1384806b_Tx: ComBitPosition=423, ComBitSize=1, ComSignalInitValue=0, ComSignalType=BOOLEAN, ComSystemTemplateSystemSignalRef=DET_SUPER_RES_TARGET_320
        SG_Detections_321_324_oRDR_DETECTION_321_324_oPCAN_RADAR_2dc55233_Tx: ComSystemTemplateSignalGroupRef=SG_Detections_321_324
          83 x ComGroupSignal, all with ComSignalEndianness=LITTLE_ENDIAN, ComTransferProperty=PENDING:
            DET_AZIMUTH_321_oRDR_DETECTION_321_324_oPCAN_RADAR_0575aea1_Tx: ComBitPosition=88, ComBitSize=13, ComSignalInitValue=0, ComSignalType=UINT16, ComSystemTemplateSystemSignalRef=DET_AZIMUTH_321
            DET_AZIMUTH_322_oRDR_DETECTION_321_324_oPCAN_RADAR_6195d55f_Tx: ComBitPosition=200, ComBitSize=13, ComSignalInitValue=0, ComSignalType=UINT16, ComSystemTemplateSystemSignalRef=DET_AZIMUTH_322
            DET_AZIMUTH_323_oRDR_DETECTION_321_324_oPCAN_RADAR_f4e501ca_Tx: ComBitPosition=312, ComBitSize=13, ComSignalInitValue=0, ComSignalType=UINT16, ComSystemTemplateSystemSignalRef=DET_AZIMUTH_323
            DET_AZIMUTH_324_oRDR_DETECTION_321_324_oPCAN_RADAR_a85522a3_Tx: ComBitPosition=424, ComBitSize=13, ComSignalInitValue=0, ComSignalType=UINT16, ComSystemTemplateSystemSignalRef=DET_AZIMUTH_324
            DET_AZIMUTH_ERR_321_oRDR_DETECTION_321_324_oPCAN_RADAR_a1c03b54_Tx: ComBitPosition=105, ComBitSize=7, ComSignalInitValue=0, ComSignalType=UINT8, ComSystemTemplateSystemSignalRef=DET_AZIMUTH_ERR_321
            DET_AZIMUTH_ERR_322_oRDR_DETECTION_321_324_oPCAN_RADAR_c52040aa_Tx: ComBitPosition=217, ComBitSize=7, ComSignalInitValue=0, ComSignalType=UINT8, ComSystemTemplateSystemSignalRef=DET_AZIMUTH_ERR_322
            DET_AZIMUTH_ERR_323_oRDR_DETECTION_321_324_oPCAN_RADAR_5050943f_Tx: ComBitPosition=329, ComBitSize=7, ComSignalInitValue=0, ComSignalType=UINT8, ComSystemTemplateSystemSignalRef=DET_AZIMUTH_ERR_323
            DET_AZIMUTH_ERR_324_oRDR_DETECTION_321_324_oPCAN_RADAR_0ce0b756_Tx: ComBitPosition=441, ComBitSize=7, ComSignalInitValue=0, ComSignalType=UINT8, ComSystemTemplateSystemSignalRef=DET_AZIMUTH_ERR_324
            DET_BELOW_RAIN_THOLD_321_oRDR_DETECTION_321_324_oPCAN_RADAR_d0743d61_Tx: ComBitPosition=39, ComBitSize=1, ComSignalInitValue=0, ComSignalType=BOOLEAN, ComSystemTemplateSystemSignalRef=DET_BELOW_RAIN_THOLD_321
            DET_BELOW_RAIN_THOLD_322_oRDR_DETECTION_321_324_oPCAN_RADAR_b494469f_Tx: ComBitPosition=151, ComBitSize=1, ComSignalInitValue=0, ComSignalType=BOOLEAN, ComSystemTemplateSystemSignalRef=DET_BELOW_RAIN_THOLD_322
            DET_BELOW_RAIN_THOLD_323_oRDR_DETECTION_321_324_oPCAN_RADAR_21e4920a_Tx: ComBitPosition=263, ComBitSize=1, ComSignalInitValue=0, ComSignalType=BOOLEAN, ComSystemTemplateSystemSignalRef=DET_BELOW_RAIN_THOLD_323
            DET_BELOW_RAIN_THOLD_324_oRDR_DETECTION_321_324_oPCAN_RADAR_7d54b163_Tx: ComBitPosition=375, ComBitSize=1, ComSignalInitValue=0, ComSignalType=BOOLEAN, ComSystemTemplateSystemSignalRef=DET_BELOW_RAIN_THOLD_324
            DET_BI_STATIC_FLAG_321_oRDR_DETECTION_321_324_oPCAN_RADAR_5359ee24_Tx: ComBitPosition=104, ComBitSize=1, ComSignalInitValue=0, ComSignalType=BOOLEAN, ComSystemTemplateSystemSignalRef=DET_BI_STATIC_FLAG_321
            DET_BI_STATIC_FLAG_322_oRDR_DETECTION_321_324_oPCAN_RADAR_37b995da_Tx: ComBitPosition=216, ComBitSize=1, ComSignalInitValue=0, ComSignalType=BOOLEAN, ComSystemTemplateSystemSignalRef=DET_BI_STATIC_FLAG_322
            DET_BI_STATIC_FLAG_323_oRDR_DETECTION_321_324_oPCAN_RADAR_a2c9414f_Tx: ComBitPosition=328, ComBitSize=1, ComSignalInitValue=0, ComSignalType=BOOLEAN, ComSystemTemplateSystemSignalRef=DET_BI_STATIC_FLAG_323
            DET_BI_STATIC_FLAG_324_oRDR_DETECTION_321_324_oPCAN_RADAR_fe796226_Tx: ComBitPosition=440, ComBitSize=1, ComSignalInitValue=0, ComSignalType=BOOLEAN, ComSystemTemplateSystemSignalRef=DET_BI_STATIC_FLAG_324
            DET_CONFD_AZIMUTH_321_oRDR_DETECTION_321_324_oPCAN_RADAR_0793a46b_Tx: ComBitPosition=118, ComBitSize=2, ComSignalInitValue=0, ComSignalType=UINT8, ComSystemTemplateSystemSignalRef=DET_CONFD_AZIMUTH_321
            DET_CONFD_AZIMUTH_322_oRDR_DETECTION_321_324_oPCAN_RADAR_6373df95_Tx: ComBitPosition=230, ComBitSize=2, ComSignalInitValue=0, ComSignalType=UINT8, ComSystemTemplateSystemSignalRef=DET_CONFD_AZIMUTH_322
            DET_CONFD_AZIMUTH_323_oRDR_DETECTION_321_324_oPCAN_RADAR_f6030b00_Tx: ComBitPosition=342, ComBitSize=2, ComSignalInitValue=0, ComSignalType=UINT8, ComSystemTemplateSystemSignalRef=DET_CONFD_AZIMUTH_323
            DET_CONFD_AZIMUTH_324_oRDR_DETECTION_321_324_oPCAN_RADAR_aab32869_Tx: ComBitPosition=454, ComBitSize=2, ComSignalInitValue=0, ComSignalType=UINT8, ComSystemTemplateSystemSignalRef=DET_CONFD_AZIMUTH_324
            DET_CONFD_ELEVATION_321_oRDR_DETECTION_321_324_oPCAN_RADAR_0506a591_Tx: ComBitPosition=101, ComBitSize=2, ComSignalInitValue=0, ComSignalType=UINT8, ComSystemTemplateSystemSignalRef=DET_CONFD_ELEVATION_321
            DET_CONFD_ELEVATION_322_oRDR_DETECTION_321_324_oPCAN_RADAR_61e6de6f_Tx: ComBitPosition=213, ComBitSize=2, ComSignalInitValue=0, ComSignalType=UINT8, ComSystemTemplateSystemSignalRef=DET_CONFD_ELEVATION_322
            DET_CONFD_ELEVATION_323_oRDR_DETECTION_321_324_oPCAN_RADAR_f4960afa_Tx: ComBitPosition=325, ComBitSize=2, ComSignalInitValue=0, ComSignalType=UINT8, ComSystemTemplateSystemSignalRef=DET_CONFD_ELEVATION_323
            DET_CONFD_ELEVATION_324_oRDR_DETECTION_321_324_oPCAN_RADAR_a8262993_Tx: ComBitPosition=437, ComBitSize=2, ComSignalInitValue=0, ComSignalType=UINT8, ComSystemTemplateSystemSignalRef=DET_CONFD_ELEVATION_324
            DET_ELEVATION_321_oRDR_DETECTION_321_324_oPCAN_RADAR_d4c671ad_Tx: ComBitPosition=72, ComBitSize=8, ComSignalInitValue=0, ComSignalType=UINT8, ComSystemTemplateSystemSignalRef=DET_ELEVATION_321
            DET_ELEVATION_322_oRDR_DETECTION_321_324_oPCAN_RADAR_b0260a53_Tx: ComBitPosition=184, ComBitSize=8, ComSignalInitValue=0, ComSignalType=UINT8, ComSystemTemplateSystemSignalRef=DET_ELEVATION_322
            DET_ELEVATION_323_oRDR_DETECTION_321_324_oPCAN_RADAR_2556dec6_Tx: ComBitPosition=296, ComBitSize=8, ComSignalInitValue=0, ComSignalType=UINT8, ComSystemTemplateSystemSignalRef=DET_ELEVATION_323
            DET_ELEVATION_324_oRDR_DETECTION_321_324_oPCAN_RADAR_79e6fdaf_Tx: ComBitPosition=408, ComBitSize=8, ComSignalInitValue=0, ComSignalType=UINT8, ComSystemTemplateSystemSignalRef=DET_ELEVATION_324
            DET_ELEVATION_ERR_321_oRDR_DETECTION_321_324_oPCAN_RADAR_53ffe9d8_Tx: ComBitPosition=80, ComBitSize=6, ComSignalInitValue=0, ComSignalType=UINT8, ComSystemTemplateSystemSignalRef=DET_ELEVATION_ERR_321
            DET_ELEVATION_ERR_322_oRDR_DETECTION_321_324_oPCAN_RADAR_371f9226_Tx: ComBitPosition=192, ComBitSize=6, ComSignalInitValue=0, ComSignalType=UINT8, ComSystemTemplateSystemSignalRef=DET_ELEVATION_ERR_322
            DET_ELEVATION_ERR_323_oRDR_DETECTION_321_324_oPCAN_RADAR_a26f46b3_Tx: ComBitPosition=304, ComBitSize=6, ComSignalInitValue=0, ComSignalType=UINT8, ComSystemTemplateSystemSignalRef=DET_ELEVATION_ERR_323
            DET_ELEVATION_ERR_324_oRDR_DETECTION_321_324_oPCAN_RADAR_fedf65da_Tx: ComBitPosition=416, ComBitSize=6, ComSignalInitValue=0, ComSignalType=UINT8, ComSystemTemplateSystemSignalRef=DET_ELEVATION_ERR_324
            DET_EXISTENCE_PROB_321_oRDR_DETECTION_321_324_oPCAN_RADAR_81609cb8_Tx: ComBitPosition=112, ComBitSize=6, ComSignalInitValue=0, ComSignalType=UINT8, ComSystemTemplateSystemSignalRef=DET_EXISTENCE_PROB_321
            DET_EXISTENCE_PROB_322_oRDR_DETECTION_321_324_oPCAN_RADAR_e580e746_Tx: ComBitPosition=224, ComBitSize=6, ComSignalInitValue=0, ComSignalType=UINT8, ComSystemTemplateSystemSignalRef=DET_EXISTENCE_PROB_322
            DET_EXISTENCE_PROB_323_oRDR_DETECTION_321_324_oPCAN_RADAR_70f033d3_Tx: ComBitPosition=336, ComBitSize=6, ComSignalInitValue=0, ComSignalType=UINT8, ComSystemTemplateSystemSignalRef=DET_EXISTENCE_PROB_323
            DET_EXISTENCE_PROB_324_oRDR_DETECTION_321_324_oPCAN_RADAR_2c4010ba_Tx: ComBitPosition=448, ComBitSize=6, ComSignalInitValue=0, ComSignalType=UINT8, ComSystemTemplateSystemSignalRef=DET_EXISTENCE_PROB_324
            DET_HVC_FLAG_321_oRDR_DETECTION_321_324_oPCAN_RADAR_6014dfc7_Tx: ComBitPosition=86, ComBitSize=1, ComSignalInitValue=0, ComSignalType=BOOLEAN, ComSystemTemplateSystemSignalRef=DET_HVC_FLAG_321
            DET_HVC_FLAG_322_oRDR_DETECTION_321_324_oPCAN_RADAR_04f4a439_Tx: ComBitPosition=198, ComBitSize=1, ComSignalInitValue=0, ComSignalType=BOOLEAN, ComSystemTemplateSystemSignalRef=DET_HVC_FLAG_322
            DET_HVC_FLAG_323_oRDR_DETECTION_321_324_oPCAN_RADAR_918470ac_Tx: ComBitPosition=310, ComBitSize=1, ComSignalInitValue=0, ComSignalType=BOOLEAN, ComSystemTemplateSystemSignalRef=DET_HVC_FLAG_323
            DET_HVC_FLAG_324_oRDR_DETECTION_321_324_oPCAN_RADAR_cd3453c5_Tx: ComBitPosition=422, ComBitSize=1, ComSignalInitValue=0, ComSignalType=BOOLEAN, ComSystemTemplateSystemSignalRef=DET_HVC_FLAG_324
            DET_IDM_321_oRDR_DETECTION_321_324_oPCAN_RADAR_eb46e47a_Tx: ComBitPosition=63, ComBitSize=1, ComSignalInitValue=0, ComSignalType=BOOLEAN, ComSystemTemplateSystemSignalRef=DET_IDM_321
            DET_IDM_322_oRDR_DETECTION_321_324_oPCAN_RADAR_8fa69f84_Tx: ComBitPosition=175, ComBitSize=1, ComSignalInitValue=0, ComSignalType=BOOLEAN, ComSystemTemplateSystemSignalRef=DET_IDM_322
            DET_IDM_323_oRDR_DETECTION_321_324_oPCAN_RADAR_1ad64b11_Tx: ComBitPosition=287, ComBitSize=1, ComSignalInitValue=0, ComSignalType=BOOLEAN, ComSystemTemplateSystemSignalRef=DET_IDM_323
            DET_IDM_324_oRDR_DETECTION_321_324_oPCAN_RADAR_46666878_Tx: ComBitPosition=399, ComBitSize=1, ComSignalInitValue=0, ComSignalType=BOOLEAN, ComSystemTemplateSystemSignalRef=DET_IDM_324
            DET_MH_CRC16_321_324_oRDR_DETECTION_321_324_oPCAN_RADAR_a94d8038_Tx: ComBitPosition=0, ComBitSize=16, ComSignalInitValue=0, ComSignalType=UINT16, ComSystemTemplateSystemSignalRef=DET_MH_CRC16_321_324
            DET_MH_CYCLE_COUNTER_321_324_oRDR_DETECTION_321_324_oPCAN_RADAR_2d38210f_Tx: ComBitPosition=16, ComBitSize=8, ComSignalInitValue=0, ComSignalType=UINT8, ComSystemTemplateSystemSignalRef=DET_MH_CYCLE_COUNTER_321_324
            DET_MH_SCAN_INDEX_4LSB_321_324_oRDR_DETECTION_321_324_oPCAN_RADAR_e1120483_Tx: ComBitPosition=476, ComBitSize=4, ComSignalInitValue=0, ComSignalType=UINT8, ComSystemTemplateSystemSignalRef=DET_MH_SCAN_INDEX_4LSB_321_324
            DET_MTD_321_oRDR_DETECTION_321_324_oPCAN_RADAR_8df5d6a1_Tx: ComBitPosition=47, ComBitSize=1, ComSignalInitValue=0, ComSignalType=BOOLEAN, ComSystemTemplateSystemSignalRef=DET_MTD_321
            DET_MTD_322_oRDR_DETECTION_321_324_oPCAN_RADAR_e915ad5f_Tx: ComBitPosition=159, ComBitSize=1, ComSignalInitValue=0, ComSignalType=BOOLEAN, ComSystemTemplateSystemSignalRef=DET_MTD_322
            DET_MTD_323_oRDR_DETECTION_321_324_oPCAN_RADAR_7c6579ca_Tx: ComBitPosition=271, ComBitSize=1, ComSignalInitValue=0, ComSignalType=BOOLEAN, ComSystemTemplateSystemSignalRef=DET_MTD_323
            DET_MTD_324_oRDR_DETECTION_321_324_oPCAN_RADAR_20d55aa3_Tx: ComBitPosition=383, ComBitSize=1, ComSignalInitValue=0, ComSignalType=BOOLEAN, ComSystemTemplateSystemSignalRef=DET_MTD_324
            DET_PROB_1STAZHYPO_321_oRDR_DETECTION_321_324_oPCAN_RADAR_1e413e6c_Tx: ComBitPosition=103, ComBitSize=1, ComSignalInitValue=0, ComSignalType=BOOLEAN, ComSystemTemplateSystemSignalRef=DET_PROB_1STAZHYPO_321
            DET_PROB_1STAZHYPO_322_oRDR_DETECTION_321_324_oPCAN_RADAR_7aa14592_Tx: ComBitPosition=215, ComBitSize=1, ComSignalInitValue=0, ComSignalType=BOOLEAN, ComSystemTemplateSystemSignalRef=DET_PROB_1STAZHYPO_322
            DET_PROB_1STAZHYPO_323_oRDR_DETECTION_321_324_oPCAN_RADAR_efd19107_Tx: ComBitPosition=327, ComBitSize=1, ComSignalInitValue=0, ComSignalType=BOOLEAN, ComSystemTemplateSystemSignalRef=DET_PROB_1STAZHYPO_323
            DET_PROB_1STAZHYPO_324_oRDR_DETECTION_321_324_oPCAN_RADAR_b361b26e_Tx: ComBitPosition=439, ComBitSize=1, ComSignalInitValue=0, ComSignalType=BOOLEAN, ComSystemTemplateSystemSignalRef=DET_PROB_1STAZHYPO_324
            DET_RANGE_321_oRDR_DETECTION_321_324_oPCAN_RADAR_15eedd1a_Tx: ComBitPosition=24, ComBitSize=15, ComSignalInitValue=0, ComSignalType=UINT16, ComSystemTemplateSystemSignalRef=DET_RANGE_321
            DET_RANGE_322_oRDR_DETECTION_321_324_oPCAN_RADAR_710ea6e4_Tx: ComBitPosition=136, ComBitSize=15, ComSignalInitValue=0, ComSignalType=UINT16, ComSystemTemplateSystemSignalRef=DET_RANGE_322
            DET_RANGE_323_oRDR_DETECTION_321_324_oPCAN_RADAR_e47e7271_Tx: ComBitPosition=248, ComBitSize=15, ComSignalInitValue=0, ComSignalType=UINT16, ComSystemTemplateSystemSignalRef=DET_RANGE_323
            DET_RANGE_324_oRDR_DETECTION_321_324_oPCAN_RADAR_b8ce5118_Tx: ComBitPosition=360, ComBitSize=15, ComSignalInitValue=0, ComSignalType=UINT16, ComSystemTemplateSystemSignalRef=DET_RANGE_324
            DET_RANGE_ERR_321_oRDR_DETECTION_321_324_oPCAN_RADAR_b2066773_Tx: ComBitPosition=40, ComBitSize=7, ComSignalInitValue=0, ComSignalType=UINT8, ComSystemTemplateSystemSignalRef=DET_RANGE_ERR_321
            DET_RANGE_ERR_322_oRDR_DETECTION_321_324_oPCAN_RADAR_d6e61c8d_Tx: ComBitPosition=152, ComBitSize=7, ComSignalInitValue=0, ComSignalType=UINT8, ComSystemTemplateSystemSignalRef=DET_RANGE_ERR_322
            DET_RANGE_ERR_323_oRDR_DETECTION_321_324_oPCAN_RADAR_4396c818_Tx: ComBitPosition=264, ComBitSize=7, ComSignalInitValue=0, ComSignalType=UINT8, ComSystemTemplateSystemSignalRef=DET_RANGE_ERR_323
            DET_RANGE_ERR_324_oRDR_DETECTION_321_324_oPCAN_RADAR_1f26eb71_Tx: ComBitPosition=376, ComBitSize=7, ComSignalInitValue=0, ComSignalType=UINT8, ComSystemTemplateSystemSignalRef=DET_RANGE_ERR_324
            DET_RANGE_VELOCITY_321_oRDR_DETECTION_321_324_oPCAN_RADAR_60481f3f_Tx: ComBitPosition=48, ComBitSize=15, ComSignalInitValue=16384, ComSignalType=UINT16, ComSystemTemplateSystemSignalRef=DET_RANGE_VELOCITY_321
            DET_RANGE_VELOCITY_322_oRDR_DETECTION_321_324_oPCAN_RADAR_04a864c1_Tx: ComBitPosition=160, ComBitSize=15, ComSignalInitValue=16384, ComSignalType=UINT16, ComSystemTemplateSystemSignalRef=DET_RANGE_VELOCITY_322
            DET_RANGE_VELOCITY_323_oRDR_DETECTION_321_324_oPCAN_RADAR_91d8b054_Tx: ComBitPosition=272, ComBitSize=15, ComSignalInitValue=16384, ComSignalType=UINT16, ComSystemTemplateSystemSignalRef=DET_RANGE_VELOCITY_323
            DET_RANGE_VELOCITY_324_oRDR_DETECTION_321_324_oPCAN_RADAR_cd68933d_Tx: ComBitPosition=384, ComBitSize=15, ComSignalInitValue=16384, ComSignalType=UINT16, ComSystemTemplateSystemSignalRef=DET_RANGE_VELOCITY_324
            DET_RANGE_VELOCITY_ERR_321_oRDR_DETECTION_321_324_oPCAN_RADAR_6ff3e48d_Tx: ComBitPosition=64, ComBitSize=8, ComSignalInitValue=0, ComSignalType=UINT8, ComSystemTemplateSystemSignalRef=DET_RANGE_VELOCITY_ERR_321
            DET_RANGE_VELOCITY_ERR_322_oRDR_DETECTION_321_324_oPCAN_RADAR_0b139f73_Tx: ComBitPosition=176, ComBitSize=8, ComSignalInitValue=0, ComSignalType=UINT8, ComSystemTemplateSystemSignalRef=DET_RANGE_VELOCITY_ERR_322
            DET_RANGE_VELOCITY_ERR_323_oRDR_DETECTION_321_324_oPCAN_RADAR_9e634be6_Tx: ComBitPosition=288, ComBitSize=8, ComSignalInitValue=0, ComSignalType=UINT8, ComSystemTemplateSystemSignalRef=DET_RANGE_VELOCITY_ERR_323
            DET_RANGE_VELOCITY_ERR_324_oRDR_DETECTION_321_324_oPCAN_RADAR_c2d3688f_Tx: ComBitPosition=400, ComBitSize=8, ComSignalInitValue=0, ComSignalType=UINT8, ComSystemTemplateSystemSignalRef=DET_RANGE_VELOCITY_ERR_324
            DET_RCS_321_oRDR_DETECTION_321_324_oPCAN_RADAR_e7c82865_Tx: ComBitPosition=128, ComBitSize=8, ComSignalInitValue=128, ComSignalType=UINT8, ComSystemTemplateSystemSignalRef=DET_RCS_321
            DET_RCS_322_oRDR_DETECTION_321_324_oPCAN_RADAR_8328539b_Tx: ComBitPosition=240, ComBitSize=8, ComSignalInitValue=128, ComSignalType=UINT8, ComSystemTemplateSystemSignalRef=DET_RCS_322
            DET_RCS_323_oRDR_DETECTION_321_324_oPCAN_RADAR_1658870e_Tx: ComBitPosition=352, ComBitSize=8, ComSignalInitValue=128, ComSignalType=UINT8, ComSystemTemplateSystemSignalRef=DET_RCS_323
            DET_RCS_324_oRDR_DETECTION_321_324_oPCAN_RADAR_4ae8a467_Tx: ComBitPosition=464, ComBitSize=8, ComSignalInitValue=128, ComSignalType=UINT8, ComSystemTemplateSystemSignalRef=DET_RCS_324
            DET_SNR_321_oRDR_DETECTION_321_324_oPCAN_RADAR_3a667c67_Tx: ComBitPosition=120, ComBitSize=8, ComSignalInitValue=0, ComSignalType=UINT8, ComSystemTemplateSystemSignalRef=DET_SNR_321
            DET_SNR_322_oRDR_DETECTION_321_324_oPCAN_RADAR_5e860799_Tx: ComBitPosition=232, ComBitSize=8, ComSignalInitValue=0, ComSignalType=UINT8, ComSystemTemplateSystemSignalRef=DET_SNR_322
            DET_SNR_323_oRDR_DETECTION_321_324_oPCAN_RADAR_cbf6d30c_Tx: ComBitPosition=344, ComBitSize=8, ComSignalInitValue=0, ComSignalType=UINT8, ComSystemTemplateSystemSignalRef=DET_SNR_323
            DET_SNR_324_oRDR_DETECTION_321_324_oPCAN_RADAR_9746f065_Tx: ComBitPosition=456, ComBitSize=8, ComSignalInitValue=0, ComSignalType=UINT8, ComSystemTemplateSystemSignalRef=DET_SNR_324
            DET_SUPER_RES_TARGET_321_oRDR_DETECTION_321_324_oPCAN_RADAR_0bff5402_Tx: ComBitPosition=87, ComBitSize=1, ComSignalInitValue=0, ComSignalType=BOOLEAN, ComSystemTemplateSystemSignalRef=DET_SUPER_RES_TARGET_321
            DET_SUPER_RES_TARGET_322_oRDR_DETECTION_321_324_oPCAN_RADAR_6f1f2ffc_Tx: ComBitPosition=199, ComBitSize=1, ComSignalInitValue=0, ComSignalType=BOOLEAN, ComSystemTemplateSystemSignalRef=DET_SUPER_RES_TARGET_322
            DET_SUPER_RES_TARGET_323_oRDR_DETECTION_321_324_oPCAN_RADAR_fa6ffb69_Tx: ComBitPosition=311, ComBitSize=1, ComSignalInitValue=0, ComSignalType=BOOLEAN, ComSystemTemplateSystemSignalRef=DET_SUPER_RES_TARGET_323
            DET_SUPER_RES_TARGET_324_oRDR_DETECTION_321_324_oPCAN_RADAR_a6dfd800_Tx: ComBitPosition=423, ComBitSize=1, ComSignalInitValue=0, ComSignalType=BOOLEAN, ComSystemTemplateSystemSignalRef=DET_SUPER_RES_TARGET_324
        SG_Detections_325_328_oRDR_DETECTION_325_328_oPCAN_RADAR_5c066661_Tx: ComSystemTemplateSignalGroupRef=SG_Detections_325_328
          83 x ComGroupSignal, all with ComSignalEndianness=LITTLE_ENDIAN, ComTransferProperty=PENDING:
            DET_AZIMUTH_325_oRDR_DETECTION_325_328_oPCAN_RADAR_d4976802_Tx: ComBitPosition=88, ComBitSize=13, ComSignalInitValue=0, ComSignalType=UINT16, ComSystemTemplateSystemSignalRef=DET_AZIMUTH_325
            DET_AZIMUTH_326_oRDR_DETECTION_325_328_oPCAN_RADAR_b07713fc_Tx: ComBitPosition=200, ComBitSize=13, ComSignalInitValue=0, ComSignalType=UINT16, ComSystemTemplateSystemSignalRef=DET_AZIMUTH_326
            DET_AZIMUTH_327_oRDR_DETECTION_325_328_oPCAN_RADAR_2507c769_Tx: ComBitPosition=312, ComBitSize=13, ComSignalInitValue=0, ComSignalType=UINT16, ComSystemTemplateSystemSignalRef=DET_AZIMUTH_327
            DET_AZIMUTH_328_oRDR_DETECTION_325_328_oPCAN_RADAR_0917552e_Tx: ComBitPosition=424, ComBitSize=13, ComSignalInitValue=0, ComSignalType=UINT16, ComSystemTemplateSystemSignalRef=DET_AZIMUTH_328
            DET_AZIMUTH_ERR_325_oRDR_DETECTION_325_328_oPCAN_RADAR_7022fdf7_Tx: ComBitPosition=105, ComBitSize=7, ComSignalInitValue=0, ComSignalType=UINT8, ComSystemTemplateSystemSignalRef=DET_AZIMUTH_ERR_325
            DET_AZIMUTH_ERR_326_oRDR_DETECTION_325_328_oPCAN_RADAR_14c28609_Tx: ComBitPosition=217, ComBitSize=7, ComSignalInitValue=0, ComSignalType=UINT8, ComSystemTemplateSystemSignalRef=DET_AZIMUTH_ERR_326
            DET_AZIMUTH_ERR_327_oRDR_DETECTION_325_328_oPCAN_RADAR_81b2529c_Tx: ComBitPosition=329, ComBitSize=7, ComSignalInitValue=0, ComSignalType=UINT8, ComSystemTemplateSystemSignalRef=DET_AZIMUTH_ERR_327
            DET_AZIMUTH_ERR_328_oRDR_DETECTION_325_328_oPCAN_RADAR_ada2c0db_Tx: ComBitPosition=441, ComBitSize=7, ComSignalInitValue=0, ComSignalType=UINT8, ComSystemTemplateSystemSignalRef=DET_AZIMUTH_ERR_328
            DET_BELOW_RAIN_THOLD_325_oRDR_DETECTION_325_328_oPCAN_RADAR_0196fbc2_Tx: ComBitPosition=39, ComBitSize=1, ComSignalInitValue=0, ComSignalType=BOOLEAN, ComSystemTemplateSystemSignalRef=DET_BELOW_RAIN_THOLD_325
            DET_BELOW_RAIN_THOLD_326_oRDR_DETECTION_325_328_oPCAN_RADAR_6576803c_Tx: ComBitPosition=151, ComBitSize=1, ComSignalInitValue=0, ComSignalType=BOOLEAN, ComSystemTemplateSystemSignalRef=DET_BELOW_RAIN_THOLD_326
            DET_BELOW_RAIN_THOLD_327_oRDR_DETECTION_325_328_oPCAN_RADAR_f00654a9_Tx: ComBitPosition=263, ComBitSize=1, ComSignalInitValue=0, ComSignalType=BOOLEAN, ComSystemTemplateSystemSignalRef=DET_BELOW_RAIN_THOLD_327
            DET_BELOW_RAIN_THOLD_328_oRDR_DETECTION_325_328_oPCAN_RADAR_dc16c6ee_Tx: ComBitPosition=375, ComBitSize=1, ComSignalInitValue=0, ComSignalType=BOOLEAN, ComSystemTemplateSystemSignalRef=DET_BELOW_RAIN_THOLD_328
            DET_BI_STATIC_FLAG_325_oRDR_DETECTION_325_328_oPCAN_RADAR_82bb2887_Tx: ComBitPosition=104, ComBitSize=1, ComSignalInitValue=0, ComSignalType=BOOLEAN, ComSystemTemplateSystemSignalRef=DET_BI_STATIC_FLAG_325
            DET_BI_STATIC_FLAG_326_oRDR_DETECTION_325_328_oPCAN_RADAR_e65b5379_Tx: ComBitPosition=216, ComBitSize=1, ComSignalInitValue=0, ComSignalType=BOOLEAN, ComSystemTemplateSystemSignalRef=DET_BI_STATIC_FLAG_326
            DET_BI_STATIC_FLAG_327_oRDR_DETECTION_325_328_oPCAN_RADAR_732b87ec_Tx: ComBitPosition=328, ComBitSize=1, ComSignalInitValue=0, ComSignalType=BOOLEAN, ComSystemTemplateSystemSignalRef=DET_BI_STATIC_FLAG_327
            DET_BI_STATIC_FLAG_328_oRDR_DETECTION_325_328_oPCAN_RADAR_5f3b15ab_Tx: ComBitPosition=440, ComBitSize=1, ComSignalInitValue=0, ComSignalType=BOOLEAN, ComSystemTemplateSystemSignalRef=DET_BI_STATIC_FLAG_328
            DET_CONFD_AZIMUTH_325_oRDR_DETECTION_325_328_oPCAN_RADAR_d67162c8_Tx: ComBitPosition=118, ComBitSize=2, ComSignalInitValue=0, ComSignalType=UINT8, ComSystemTemplateSystemSignalRef=DET_CONFD_AZIMUTH_325
            DET_CONFD_AZIMUTH_326_oRDR_DETECTION_325_328_oPCAN_RADAR_b2911936_Tx: ComBitPosition=230, ComBitSize=2, ComSignalInitValue=0, ComSignalType=UINT8, ComSystemTemplateSystemSignalRef=DET_CONFD_AZIMUTH_326
            DET_CONFD_AZIMUTH_327_oRDR_DETECTION_325_328_oPCAN_RADAR_27e1cda3_Tx: ComBitPosition=342, ComBitSize=2, ComSignalInitValue=0, ComSignalType=UINT8, ComSystemTemplateSystemSignalRef=DET_CONFD_AZIMUTH_327
            DET_CONFD_AZIMUTH_328_oRDR_DETECTION_325_328_oPCAN_RADAR_0bf15fe4_Tx: ComBitPosition=454, ComBitSize=2, ComSignalInitValue=0, ComSignalType=UINT8, ComSystemTemplateSystemSignalRef=DET_CONFD_AZIMUTH_328
            DET_CONFD_ELEVATION_325_oRDR_DETECTION_325_328_oPCAN_RADAR_d4e46332_Tx: ComBitPosition=101, ComBitSize=2, ComSignalInitValue=0, ComSignalType=UINT8, ComSystemTemplateSystemSignalRef=DET_CONFD_ELEVATION_325
            DET_CONFD_ELEVATION_326_oRDR_DETECTION_325_328_oPCAN_RADAR_b00418cc_Tx: ComBitPosition=213, ComBitSize=2, ComSignalInitValue=0, ComSignalType=UINT8, ComSystemTemplateSystemSignalRef=DET_CONFD_ELEVATION_326
            DET_CONFD_ELEVATION_327_oRDR_DETECTION_325_328_oPCAN_RADAR_2574cc59_Tx: ComBitPosition=325, ComBitSize=2, ComSignalInitValue=0, ComSignalType=UINT8, ComSystemTemplateSystemSignalRef=DET_CONFD_ELEVATION_327
            DET_CONFD_ELEVATION_328_oRDR_DETECTION_325_328_oPCAN_RADAR_09645e1e_Tx: ComBitPosition=437, ComBitSize=2, ComSignalInitValue=0, ComSignalType=UINT8, ComSystemTemplateSystemSignalRef=DET_CONFD_ELEVATION_328
            DET_ELEVATION_325_oRDR_DETECTION_325_328_oPCAN_RADAR_0524b70e_Tx: ComBitPosition=72, ComBitSize=8, ComSignalInitValue=0, ComSignalType=UINT8, ComSystemTemplateSystemSignalRef=DET_ELEVATION_325
            DET_ELEVATION_326_oRDR_DETECTION_325_328_oPCAN_RADAR_61c4ccf0_Tx: ComBitPosition=184, ComBitSize=8, ComSignalInitValue=0, ComSignalType=UINT8, ComSystemTemplateSystemSignalRef=DET_ELEVATION_326
            DET_ELEVATION_327_oRDR_DETECTION_325_328_oPCAN_RADAR_f4b41865_Tx: ComBitPosition=296, ComBitSize=8, ComSignalInitValue=0, ComSignalType=UINT8, ComSystemTemplateSystemSignalRef=DET_ELEVATION_327
            DET_ELEVATION_328_oRDR_DETECTION_325_328_oPCAN_RADAR_d8a48a22_Tx: ComBitPosition=408, ComBitSize=8, ComSignalInitValue=0, ComSignalType=UINT8, ComSystemTemplateSystemSignalRef=DET_ELEVATION_328
            DET_ELEVATION_ERR_325_oRDR_DETECTION_325_328_oPCAN_RADAR_821d2f7b_Tx: ComBitPosition=80, ComBitSize=6, ComSignalInitValue=0, ComSignalType=UINT8, ComSystemTemplateSystemSignalRef=DET_ELEVATION_ERR_325
            DET_ELEVATION_ERR_326_oRDR_DETECTION_325_328_oPCAN_RADAR_e6fd5485_Tx: ComBitPosition=192, ComBitSize=6, ComSignalInitValue=0, ComSignalType=UINT8, ComSystemTemplateSystemSignalRef=DET_ELEVATION_ERR_326
            DET_ELEVATION_ERR_327_oRDR_DETECTION_325_328_oPCAN_RADAR_738d8010_Tx: ComBitPosition=304, ComBitSize=6, ComSignalInitValue=0, ComSignalType=UINT8, ComSystemTemplateSystemSignalRef=DET_ELEVATION_ERR_327
            DET_ELEVATION_ERR_328_oRDR_DETECTION_325_328_oPCAN_RADAR_5f9d1257_Tx: ComBitPosition=416, ComBitSize=6, ComSignalInitValue=0, ComSignalType=UINT8, ComSystemTemplateSystemSignalRef=DET_ELEVATION_ERR_328
            DET_EXISTENCE_PROB_325_oRDR_DETECTION_325_328_oPCAN_RADAR_50825a1b_Tx: ComBitPosition=112, ComBitSize=6, ComSignalInitValue=0, ComSignalType=UINT8, ComSystemTemplateSystemSignalRef=DET_EXISTENCE_PROB_325
            DET_EXISTENCE_PROB_326_oRDR_DETECTION_325_328_oPCAN_RADAR_346221e5_Tx: ComBitPosition=224, ComBitSize=6, ComSignalInitValue=0, ComSignalType=UINT8, ComSystemTemplateSystemSignalRef=DET_EXISTENCE_PROB_326
            DET_EXISTENCE_PROB_327_oRDR_DETECTION_325_328_oPCAN_RADAR_a112f570_Tx: ComBitPosition=336, ComBitSize=6, ComSignalInitValue=0, ComSignalType=UINT8, ComSystemTemplateSystemSignalRef=DET_EXISTENCE_PROB_327
            DET_EXISTENCE_PROB_328_oRDR_DETECTION_325_328_oPCAN_RADAR_8d026737_Tx: ComBitPosition=448, ComBitSize=6, ComSignalInitValue=0, ComSignalType=UINT8, ComSystemTemplateSystemSignalRef=DET_EXISTENCE_PROB_328
            DET_HVC_FLAG_325_oRDR_DETECTION_325_328_oPCAN_RADAR_b1f61964_Tx: ComBitPosition=86, ComBitSize=1, ComSignalInitValue=0, ComSignalType=BOOLEAN, ComSystemTemplateSystemSignalRef=DET_HVC_FLAG_325
            DET_HVC_FLAG_326_oRDR_DETECTION_325_328_oPCAN_RADAR_d516629a_Tx: ComBitPosition=198, ComBitSize=1, ComSignalInitValue=0, ComSignalType=BOOLEAN, ComSystemTemplateSystemSignalRef=DET_HVC_FLAG_326
            DET_HVC_FLAG_327_oRDR_DETECTION_325_328_oPCAN_RADAR_4066b60f_Tx: ComBitPosition=310, ComBitSize=1, ComSignalInitValue=0, ComSignalType=BOOLEAN, ComSystemTemplateSystemSignalRef=DET_HVC_FLAG_327
            DET_HVC_FLAG_328_oRDR_DETECTION_325_328_oPCAN_RADAR_6c762448_Tx: ComBitPosition=422, ComBitSize=1, ComSignalInitValue=0, ComSignalType=BOOLEAN, ComSystemTemplateSystemSignalRef=DET_HVC_FLAG_328
            DET_IDM_325_oRDR_DETECTION_325_328_oPCAN_RADAR_3aa422d9_Tx: ComBitPosition=63, ComBitSize=1, ComSignalInitValue=0, ComSignalType=BOOLEAN, ComSystemTemplateSystemSignalRef=DET_IDM_325
            DET_IDM_326_oRDR_DETECTION_325_328_oPCAN_RADAR_5e445927_Tx: ComBitPosition=175, ComBitSize=1, ComSignalInitValue=0, ComSignalType=BOOLEAN, ComSystemTemplateSystemSignalRef=DET_IDM_326
            DET_IDM_327_oRDR_DETECTION_325_328_oPCAN_RADAR_cb348db2_Tx: ComBitPosition=287, ComBitSize=1, ComSignalInitValue=0, ComSignalType=BOOLEAN, ComSystemTemplateSystemSignalRef=DET_IDM_327
            DET_IDM_328_oRDR_DETECTION_325_328_oPCAN_RADAR_e7241ff5_Tx: ComBitPosition=399, ComBitSize=1, ComSignalInitValue=0, ComSignalType=BOOLEAN, ComSystemTemplateSystemSignalRef=DET_IDM_328
            DET_MH_CRC16_325_328_oRDR_DETECTION_325_328_oPCAN_RADAR_d88eb46a_Tx: ComBitPosition=0, ComBitSize=16, ComSignalInitValue=0, ComSignalType=UINT16, ComSystemTemplateSystemSignalRef=DET_MH_CRC16_325_328
            DET_MH_CYCLE_COUNTER_325_328_oRDR_DETECTION_325_328_oPCAN_RADAR_5cfb155d_Tx: ComBitPosition=16, ComBitSize=8, ComSignalInitValue=0, ComSignalType=UINT8, ComSystemTemplateSystemSignalRef=DET_MH_CYCLE_COUNTER_325_328
            DET_MH_SCAN_INDEX_4LSB_325_328_oRDR_DETECTION_325_328_oPCAN_RADAR_90d130d1_Tx: ComBitPosition=476, ComBitSize=4, ComSignalInitValue=0, ComSignalType=UINT8, ComSystemTemplateSystemSignalRef=DET_MH_SCAN_INDEX_4LSB_325_328
            DET_MTD_325_oRDR_DETECTION_325_328_oPCAN_RADAR_5c171002_Tx: ComBitPosition=47, ComBitSize=1, ComSignalInitValue=0, ComSignalType=BOOLEAN, ComSystemTemplateSystemSignalRef=DET_MTD_325
            DET_MTD_326_oRDR_DETECTION_325_328_oPCAN_RADAR_38f76bfc_Tx: ComBitPosition=159, ComBitSize=1, ComSignalInitValue=0, ComSignalType=BOOLEAN, ComSystemTemplateSystemSignalRef=DET_MTD_326
            DET_MTD_327_oRDR_DETECTION_325_328_oPCAN_RADAR_ad87bf69_Tx: ComBitPosition=271, ComBitSize=1, ComSignalInitValue=0, ComSignalType=BOOLEAN, ComSystemTemplateSystemSignalRef=DET_MTD_327
            DET_MTD_328_oRDR_DETECTION_325_328_oPCAN_RADAR_81972d2e_Tx: ComBitPosition=383, ComBitSize=1, ComSignalInitValue=0, ComSignalType=BOOLEAN, ComSystemTemplateSystemSignalRef=DET_MTD_328
            DET_PROB_1STAZHYPO_325_oRDR_DETECTION_325_328_oPCAN_RADAR_cfa3f8cf_Tx: ComBitPosition=103, ComBitSize=1, ComSignalInitValue=0, ComSignalType=BOOLEAN, ComSystemTemplateSystemSignalRef=DET_PROB_1STAZHYPO_325
            DET_PROB_1STAZHYPO_326_oRDR_DETECTION_325_328_oPCAN_RADAR_ab438331_Tx: ComBitPosition=215, ComBitSize=1, ComSignalInitValue=0, ComSignalType=BOOLEAN, ComSystemTemplateSystemSignalRef=DET_PROB_1STAZHYPO_326
            DET_PROB_1STAZHYPO_327_oRDR_DETECTION_325_328_oPCAN_RADAR_3e3357a4_Tx: ComBitPosition=327, ComBitSize=1, ComSignalInitValue=0, ComSignalType=BOOLEAN, ComSystemTemplateSystemSignalRef=DET_PROB_1STAZHYPO_327
            DET_PROB_1STAZHYPO_328_oRDR_DETECTION_325_328_oPCAN_RADAR_1223c5e3_Tx: ComBitPosition=439, ComBitSize=1, ComSignalInitValue=0, ComSignalType=BOOLEAN, ComSystemTemplateSystemSignalRef=DET_PROB_1STAZHYPO_328
            DET_RANGE_325_oRDR_DETECTION_325_328_oPCAN_RADAR_c40c1bb9_Tx: ComBitPosition=24, ComBitSize=15, ComSignalInitValue=0, ComSignalType=UINT16, ComSystemTemplateSystemSignalRef=DET_RANGE_325
            DET_RANGE_326_oRDR_DETECTION_325_328_oPCAN_RADAR_a0ec6047_Tx: ComBitPosition=136, ComBitSize=15, ComSignalInitValue=0, ComSignalType=UINT16, ComSystemTemplateSystemSignalRef=DET_RANGE_326
            DET_RANGE_327_oRDR_DETECTION_325_328_oPCAN_RADAR_359cb4d2_Tx: ComBitPosition=248, ComBitSize=15, ComSignalInitValue=0, ComSignalType=UINT16, ComSystemTemplateSystemSignalRef=DET_RANGE_327
            DET_RANGE_328_oRDR_DETECTION_325_328_oPCAN_RADAR_198c2695_Tx: ComBitPosition=360, ComBitSize=15, ComSignalInitValue=0, ComSignalType=UINT16, ComSystemTemplateSystemSignalRef=DET_RANGE_328
            DET_RANGE_ERR_325_oRDR_DETECTION_325_328_oPCAN_RADAR_63e4a1d0_Tx: ComBitPosition=40, ComBitSize=7, ComSignalInitValue=0, ComSignalType=UINT8, ComSystemTemplateSystemSignalRef=DET_RANGE_ERR_325
            DET_RANGE_ERR_326_oRDR_DETECTION_325_328_oPCAN_RADAR_0704da2e_Tx: ComBitPosition=152, ComBitSize=7, ComSignalInitValue=0, ComSignalType=UINT8, ComSystemTemplateSystemSignalRef=DET_RANGE_ERR_326
            DET_RANGE_ERR_327_oRDR_DETECTION_325_328_oPCAN_RADAR_92740ebb_Tx: ComBitPosition=264, ComBitSize=7, ComSignalInitValue=0, ComSignalType=UINT8, ComSystemTemplateSystemSignalRef=DET_RANGE_ERR_327
            DET_RANGE_ERR_328_oRDR_DETECTION_325_328_oPCAN_RADAR_be649cfc_Tx: ComBitPosition=376, ComBitSize=7, ComSignalInitValue=0, ComSignalType=UINT8, ComSystemTemplateSystemSignalRef=DET_RANGE_ERR_328
            DET_RANGE_VELOCITY_325_oRDR_DETECTION_325_328_oPCAN_RADAR_b1aad99c_Tx: ComBitPosition=48, ComBitSize=15, ComSignalInitValue=16384, ComSignalType=UINT16, ComSystemTemplateSystemSignalRef=DET_RANGE_VELOCITY_325
            DET_RANGE_VELOCITY_326_oRDR_DETECTION_325_328_oPCAN_RADAR_d54aa262_Tx: ComBitPosition=160, ComBitSize=15, ComSignalInitValue=16384, ComSignalType=UINT16, ComSystemTemplateSystemSignalRef=DET_RANGE_VELOCITY_326
            DET_RANGE_VELOCITY_327_oRDR_DETECTION_325_328_oPCAN_RADAR_403a76f7_Tx: ComBitPosition=272, ComBitSize=15, ComSignalInitValue=16384, ComSignalType=UINT16, ComSystemTemplateSystemSignalRef=DET_RANGE_VELOCITY_327
            DET_RANGE_VELOCITY_328_oRDR_DETECTION_325_328_oPCAN_RADAR_6c2ae4b0_Tx: ComBitPosition=384, ComBitSize=15, ComSignalInitValue=16384, ComSignalType=UINT16, ComSystemTemplateSystemSignalRef=DET_RANGE_VELOCITY_328
            DET_RANGE_VELOCITY_ERR_325_oRDR_DETECTION_325_328_oPCAN_RADAR_be11222e_Tx: ComBitPosition=64, ComBitSize=8, ComSignalInitValue=0, ComSignalType=UINT8, ComSystemTemplateSystemSignalRef=DET_RANGE_VELOCITY_ERR_325
            DET_RANGE_VELOCITY_ERR_326_oRDR_DETECTION_325_328_oPCAN_RADAR_daf159d0_Tx: ComBitPosition=176, ComBitSize=8, ComSignalInitValue=0, ComSignalType=UINT8, ComSystemTemplateSystemSignalRef=DET_RANGE_VELOCITY_ERR_326
            DET_RANGE_VELOCITY_ERR_327_oRDR_DETECTION_325_328_oPCAN_RADAR_4f818d45_Tx: ComBitPosition=288, ComBitSize=8, ComSignalInitValue=0, ComSignalType=UINT8, ComSystemTemplateSystemSignalRef=DET_RANGE_VELOCITY_ERR_327
            DET_RANGE_VELOCITY_ERR_328_oRDR_DETECTION_325_328_oPCAN_RADAR_63911f02_Tx: ComBitPosition=400, ComBitSize=8, ComSignalInitValue=0, ComSignalType=UINT8, ComSystemTemplateSystemSignalRef=DET_RANGE_VELOCITY_ERR_328
            DET_RCS_325_oRDR_DETECTION_325_328_oPCAN_RADAR_362aeec6_Tx: ComBitPosition=128, ComBitSize=8, ComSignalInitValue=128, ComSignalType=UINT8, ComSystemTemplateSystemSignalRef=DET_RCS_325
            DET_RCS_326_oRDR_DETECTION_325_328_oPCAN_RADAR_52ca9538_Tx: ComBitPosition=240, ComBitSize=8, ComSignalInitValue=128, ComSignalType=UINT8, ComSystemTemplateSystemSignalRef=DET_RCS_326
            DET_RCS_327_oRDR_DETECTION_325_328_oPCAN_RADAR_c7ba41ad_Tx: ComBitPosition=352, ComBitSize=8, ComSignalInitValue=128, ComSignalType=UINT8, ComSystemTemplateSystemSignalRef=DET_RCS_327
            DET_RCS_328_oRDR_DETECTION_325_328_oPCAN_RADAR_ebaad3ea_Tx: ComBitPosition=464, ComBitSize=8, ComSignalInitValue=128, ComSignalType=UINT8, ComSystemTemplateSystemSignalRef=DET_RCS_328
            DET_SNR_325_oRDR_DETECTION_325_328_oPCAN_RADAR_eb84bac4_Tx: ComBitPosition=120, ComBitSize=8, ComSignalInitValue=0, ComSignalType=UINT8, ComSystemTemplateSystemSignalRef=DET_SNR_325
            DET_SNR_326_oRDR_DETECTION_325_328_oPCAN_RADAR_8f64c13a_Tx: ComBitPosition=232, ComBitSize=8, ComSignalInitValue=0, ComSignalType=UINT8, ComSystemTemplateSystemSignalRef=DET_SNR_326
            DET_SNR_327_oRDR_DETECTION_325_328_oPCAN_RADAR_1a1415af_Tx: ComBitPosition=344, ComBitSize=8, ComSignalInitValue=0, ComSignalType=UINT8, ComSystemTemplateSystemSignalRef=DET_SNR_327
            DET_SNR_328_oRDR_DETECTION_325_328_oPCAN_RADAR_360487e8_Tx: ComBitPosition=456, ComBitSize=8, ComSignalInitValue=0, ComSignalType=UINT8, ComSystemTemplateSystemSignalRef=DET_SNR_328
            DET_SUPER_RES_TARGET_325_oRDR_DETECTION_325_328_oPCAN_RADAR_da1d92a1_Tx: ComBitPosition=87, ComBitSize=1, ComSignalInitValue=0, ComSignalType=BOOLEAN, ComSystemTemplateSystemSignalRef=DET_SUPER_RES_TARGET_325
            DET_SUPER_RES_TARGET_326_oRDR_DETECTION_325_328_oPCAN_RADAR_befde95f_Tx: ComBitPosition=199, ComBitSize=1, ComSignalInitValue=0, ComSignalType=BOOLEAN, ComSystemTemplateSystemSignalRef=DET_SUPER_RES_TARGET_326
            DET_SUPER_RES_TARGET_327_oRDR_DETECTION_325_328_oPCAN_RADAR_2b8d3dca_Tx: ComBitPosition=311, ComBitSize=1, ComSignalInitValue=0, ComSignalType=BOOLEAN, ComSystemTemplateSystemSignalRef=DET_SUPER_RES_TARGET_327
            DET_SUPER_RES_TARGET_328_oRDR_DETECTION_325_328_oPCAN_RADAR_079daf8d_Tx: ComBitPosition=423, ComBitSize=1, ComSignalInitValue=0, ComSignalType=BOOLEAN, ComSystemTemplateSystemSignalRef=DET_SUPER_RES_TARGET_328
