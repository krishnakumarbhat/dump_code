[part 16 of 24: package /InitialEcuC]
AUTOSAR XML (schema 00053)
package /InitialEcuC  (continued)
  module config Com  (continued)
    ComConfig  (continued)
      242 x ComSignalGroup, all with ComTransferProperty=PENDING:  (continued)
        SG_Fusion_Detections_057_060_oRDR_FUSION_DET_057_060_oPCAN_RADAR_91e0d8b1_Rx: ComTimeout=0, ComSystemTemplateSignalGroupRef=SG_Fusion_Detections_057_060
          83 x ComGroupSignal, all with ComSignalEndianness=LITTLE_ENDIAN, ComSignalInitValue=0:
            DET_AZIMUTH_057_Rx_oRDR_FUSION_DET_057_060_oPCAN_RADAR_89f4f369_Rx: ComBitPosition=88, ComBitSize=13, ComSignalType=UINT16, ComSystemTemplateSystemSignalRef=DET_AZIMUTH_057_Rx
            DET_AZIMUTH_058_Rx_oRDR_FUSION_DET_057_060_oPCAN_RADAR_09ba81c1_Rx: ComBitPosition=200, ComBitSize=13, ComSignalType=UINT16, ComSystemTemplateSystemSignalRef=DET_AZIMUTH_058_Rx
            DET_AZIMUTH_059_Rx_oRDR_FUSION_DET_057_060_oPCAN_RADAR_a6fe1386_Rx: ComBitPosition=312, ComBitSize=13, ComSignalType=UINT16, ComSystemTemplateSystemSignalRef=DET_AZIMUTH_059_Rx
            DET_AZIMUTH_060_Rx_oRDR_FUSION_DET_057_060_oPCAN_RADAR_9080b79c_Rx: ComBitPosition=424, ComBitSize=13, ComSignalType=UINT16, ComSystemTemplateSystemSignalRef=DET_AZIMUTH_060_Rx
            DET_AZIMUTH_ERR_057_Rx_oRDR_FUSION_DET_057_060_oPCAN_RADAR_8b9d52eb_Rx: ComBitPosition=105, ComBitSize=7, ComSignalType=UINT8, ComSystemTemplateSystemSignalRef=DET_AZIMUTH_ERR_057_Rx
            DET_AZIMUTH_ERR_058_Rx_oRDR_FUSION_DET_057_060_oPCAN_RADAR_0bd32043_Rx: ComBitPosition=217, ComBitSize=7, ComSignalType=UINT8, ComSystemTemplateSystemSignalRef=DET_AZIMUTH_ERR_058_Rx
            DET_AZIMUTH_ERR_059_Rx_oRDR_FUSION_DET_057_060_oPCAN_RADAR_a497b204_Rx: ComBitPosition=329, ComBitSize=7, ComSignalType=UINT8, ComSystemTemplateSystemSignalRef=DET_AZIMUTH_ERR_059_Rx
            DET_AZIMUTH_ERR_060_Rx_oRDR_FUSION_DET_057_060_oPCAN_RADAR_92e9161e_Rx: ComBitPosition=441, ComBitSize=7, ComSignalType=UINT8, ComSystemTemplateSystemSignalRef=DET_AZIMUTH_ERR_060_Rx
            DET_BELOW_RAIN_THOLD_057_Rx_oRDR_FUSION_DET_057_060_oPCAN_RADAR_ef4e0cdc_Rx: ComBitPosition=39, ComBitSize=1, ComSignalType=BOOLEAN, ComSystemTemplateSystemSignalRef=DET_BELOW_RAIN_THOLD_057_Rx
            DET_BELOW_RAIN_THOLD_058_Rx_oRDR_FUSION_DET_057_060_oPCAN_RADAR_6f007e74_Rx: ComBitPosition=151, ComBitSize=1, ComSignalType=BOOLEAN, ComSystemTemplateSystemSignalRef=DET_BELOW_RAIN_THOLD_058_Rx
            DET_BELOW_RAIN_THOLD_059_Rx_oRDR_FUSION_DET_057_060_oPCAN_RADAR_c044ec33_Rx: ComBitPosition=263, ComBitSize=1, ComSignalType=BOOLEAN, ComSystemTemplateSystemSignalRef=DET_BELOW_RAIN_THOLD_059_Rx
            DET_BELOW_RAIN_THOLD_060_Rx_oRDR_FUSION_DET_057_060_oPCAN_RADAR_f63a4829_Rx: ComBitPosition=375, ComBitSize=1, ComSignalType=BOOLEAN, ComSystemTemplateSystemSignalRef=DET_BELOW_RAIN_THOLD_060_Rx
            DET_BI_STATIC_FLAG_057_Rx_oRDR_FUSION_DET_057_060_oPCAN_RADAR_98d0a7cf_Rx: ComBitPosition=104, ComBitSize=1, ComSignalType=BOOLEAN, ComSystemTemplateSystemSignalRef=DET_BI_STATIC_FLAG_057_Rx
            DET_BI_STATIC_FLAG_058_Rx_oRDR_FUSION_DET_057_060_oPCAN_RADAR_189ed567_Rx: ComBitPosition=216, ComBitSize=1, ComSignalType=BOOLEAN, ComSystemTemplateSystemSignalRef=DET_BI_STATIC_FLAG_058_Rx
            DET_BI_STATIC_FLAG_059_Rx_oRDR_FUSION_DET_057_060_oPCAN_RADAR_b7da4720_Rx: ComBitPosition=328, ComBitSize=1, ComSignalType=BOOLEAN, ComSystemTemplateSystemSignalRef=DET_BI_STATIC_FLAG_059_Rx
            DET_BI_STATIC_FLAG_060_Rx_oRDR_FUSION_DET_057_060_oPCAN_RADAR_81a4e33a_Rx: ComBitPosition=440, ComBitSize=1, ComSignalType=BOOLEAN, ComSystemTemplateSystemSignalRef=DET_BI_STATIC_FLAG_060_Rx
            DET_CONFD_AZIMUTH_057_Rx_oRDR_FUSION_DET_057_060_oPCAN_RADAR_7bb94d9b_Rx: ComBitPosition=118, ComBitSize=2, ComSignalType=UINT8, ComSystemTemplateSystemSignalRef=DET_CONFD_AZIMUTH_057_Rx
            DET_CONFD_AZIMUTH_058_Rx_oRDR_FUSION_DET_057_060_oPCAN_RADAR_fbf73f33_Rx: ComBitPosition=230, ComBitSize=2, ComSignalType=UINT8, ComSystemTemplateSystemSignalRef=DET_CONFD_AZIMUTH_058_Rx
            DET_CONFD_AZIMUTH_059_Rx_oRDR_FUSION_DET_057_060_oPCAN_RADAR_54b3ad74_Rx: ComBitPosition=342, ComBitSize=2, ComSignalType=UINT8, ComSystemTemplateSystemSignalRef=DET_CONFD_AZIMUTH_059_Rx
            DET_CONFD_AZIMUTH_060_Rx_oRDR_FUSION_DET_057_060_oPCAN_RADAR_62cd096e_Rx: ComBitPosition=454, ComBitSize=2, ComSignalType=UINT8, ComSystemTemplateSystemSignalRef=DET_CONFD_AZIMUTH_060_Rx
            DET_CONFD_ELEVATION_057_Rx_oRDR_FUSION_DET_057_060_oPCAN_RADAR_7198ce1c_Rx: ComBitPosition=101, ComBitSize=2, ComSignalType=UINT8, ComSystemTemplateSystemSignalRef=DET_CONFD_ELEVATION_057_Rx
            DET_CONFD_ELEVATION_058_Rx_oRDR_FUSION_DET_057_060_oPCAN_RADAR_f1d6bcb4_Rx: ComBitPosition=213, ComBitSize=2, ComSignalType=UINT8, ComSystemTemplateSystemSignalRef=DET_CONFD_ELEVATION_058_Rx
            DET_CONFD_ELEVATION_059_Rx_oRDR_FUSION_DET_057_060_oPCAN_RADAR_5e922ef3_Rx: ComBitPosition=325, ComBitSize=2, ComSignalType=UINT8, ComSystemTemplateSystemSignalRef=DET_CONFD_ELEVATION_059_Rx
            DET_CONFD_ELEVATION_060_Rx_oRDR_FUSION_DET_057_060_oPCAN_RADAR_68ec8ae9_Rx: ComBitPosition=437, ComBitSize=2, ComSignalType=UINT8, ComSystemTemplateSystemSignalRef=DET_CONFD_ELEVATION_060_Rx
            DET_ELEVATION_057_Rx_oRDR_FUSION_DET_057_060_oPCAN_RADAR_7bcb21e5_Rx: ComBitPosition=72, ComBitSize=8, ComSignalType=UINT8, ComSystemTemplateSystemSignalRef=DET_ELEVATION_057_Rx
            DET_ELEVATION_058_Rx_oRDR_FUSION_DET_057_060_oPCAN_RADAR_fb85534d_Rx: ComBitPosition=184, ComBitSize=8, ComSignalType=UINT8, ComSystemTemplateSystemSignalRef=DET_ELEVATION_058_Rx
            DET_ELEVATION_059_Rx_oRDR_FUSION_DET_057_060_oPCAN_RADAR_54c1c10a_Rx: ComBitPosition=296, ComBitSize=8, ComSignalType=UINT8, ComSystemTemplateSystemSignalRef=DET_ELEVATION_059_Rx
            DET_ELEVATION_060_Rx_oRDR_FUSION_DET_057_060_oPCAN_RADAR_62bf6510_Rx: ComBitPosition=408, ComBitSize=8, ComSignalType=UINT8, ComSystemTemplateSystemSignalRef=DET_ELEVATION_060_Rx
            DET_ELEVATION_ERR_057_Rx_oRDR_FUSION_DET_057_060_oPCAN_RADAR_a972033a_Rx: ComBitPosition=80, ComBitSize=6, ComSignalType=UINT8, ComSystemTemplateSystemSignalRef=DET_ELEVATION_ERR_057_Rx
            DET_ELEVATION_ERR_058_Rx_oRDR_FUSION_DET_057_060_oPCAN_RADAR_293c7192_Rx: ComBitPosition=192, ComBitSize=6, ComSignalType=UINT8, ComSystemTemplateSystemSignalRef=DET_ELEVATION_ERR_058_Rx
            DET_ELEVATION_ERR_059_Rx_oRDR_FUSION_DET_057_060_oPCAN_RADAR_8678e3d5_Rx: ComBitPosition=304, ComBitSize=6, ComSignalType=UINT8, ComSystemTemplateSystemSignalRef=DET_ELEVATION_ERR_059_Rx
            DET_ELEVATION_ERR_060_Rx_oRDR_FUSION_DET_057_060_oPCAN_RADAR_b00647cf_Rx: ComBitPosition=416, ComBitSize=6, ComSignalType=UINT8, ComSystemTemplateSystemSignalRef=DET_ELEVATION_ERR_060_Rx
            DET_EXISTENCE_PROB_057_Rx_oRDR_FUSION_DET_057_060_oPCAN_RADAR_5e6a7baf_Rx: ComBitPosition=112, ComBitSize=6, ComSignalType=UINT8, ComSystemTemplateSystemSignalRef=DET_EXISTENCE_PROB_057_Rx
            DET_EXISTENCE_PROB_058_Rx_oRDR_FUSION_DET_057_060_oPCAN_RADAR_de240907_Rx: ComBitPosition=224, ComBitSize=6, ComSignalType=UINT8, ComSystemTemplateSystemSignalRef=DET_EXISTENCE_PROB_058_Rx
            DET_EXISTENCE_PROB_059_Rx_oRDR_FUSION_DET_057_060_oPCAN_RADAR_71609b40_Rx: ComBitPosition=336, ComBitSize=6, ComSignalType=UINT8, ComSystemTemplateSystemSignalRef=DET_EXISTENCE_PROB_059_Rx
            DET_EXISTENCE_PROB_060_Rx_oRDR_FUSION_DET_057_060_oPCAN_RADAR_471e3f5a_Rx: ComBitPosition=448, ComBitSize=6, ComSignalType=UINT8, ComSystemTemplateSystemSignalRef=DET_EXISTENCE_PROB_060_Rx
            DET_HVC_FLAG_057_Rx_oRDR_FUSION_DET_057_060_oPCAN_RADAR_83b496e0_Rx: ComBitPosition=86, ComBitSize=1, ComSignalType=BOOLEAN, ComSystemTemplateSystemSignalRef=DET_HVC_FLAG_057_Rx
            DET_HVC_FLAG_058_Rx_oRDR_FUSION_DET_057_060_oPCAN_RADAR_03fae448_Rx: ComBitPosition=198, ComBitSize=1, ComSignalType=BOOLEAN, ComSystemTemplateSystemSignalRef=DET_HVC_FLAG_058_Rx
            DET_HVC_FLAG_059_Rx_oRDR_FUSION_DET_057_060_oPCAN_RADAR_acbe760f_Rx: ComBitPosition=310, ComBitSize=1, ComSignalType=BOOLEAN, ComSystemTemplateSystemSignalRef=DET_HVC_FLAG_059_Rx
            DET_HVC_FLAG_060_Rx_oRDR_FUSION_DET_057_060_oPCAN_RADAR_9ac0d215_Rx: ComBitPosition=422, ComBitSize=1, ComSignalType=BOOLEAN, ComSystemTemplateSystemSignalRef=DET_HVC_FLAG_060_Rx
            DET_IDM_057_Rx_oRDR_FUSION_DET_057_060_oPCAN_RADAR_b6756fa8_Rx: ComBitPosition=63, ComBitSize=1, ComSignalType=BOOLEAN, ComSystemTemplateSystemSignalRef=DET_IDM_057_Rx
            DET_IDM_058_Rx_oRDR_FUSION_DET_057_060_oPCAN_RADAR_363b1d00_Rx: ComBitPosition=175, ComBitSize=1, ComSignalType=BOOLEAN, ComSystemTemplateSystemSignalRef=DET_IDM_058_Rx
            DET_IDM_059_Rx_oRDR_FUSION_DET_057_060_oPCAN_RADAR_997f8f47_Rx: ComBitPosition=287, ComBitSize=1, ComSignalType=BOOLEAN, ComSystemTemplateSystemSignalRef=DET_IDM_059_Rx
            DET_IDM_060_Rx_oRDR_FUSION_DET_057_060_oPCAN_RADAR_af012b5d_Rx: ComBitPosition=399, ComBitSize=1, ComSignalType=BOOLEAN, ComSystemTemplateSystemSignalRef=DET_IDM_060_Rx
            DET_MH_CRC16_057_060_Rx_oRDR_FUSION_DET_057_060_oPCAN_RADAR_758b1867_Rx: ComBitPosition=0, ComBitSize=16, ComSignalType=UINT16, ComSystemTemplateSystemSignalRef=DET_MH_CRC16_057_060_Rx
            DET_MH_CYCLE_COUNTER_057_060_Rx_oRDR_FUSION_DET_057_060_oPCAN_RADAR_785025a2_Rx: ComBitPosition=16, ComBitSize=8, ComSignalType=UINT8, ComSystemTemplateSystemSignalRef=DET_MH_CYCLE_COUNTER_057_060_Rx
            DET_MH_SCAN_INDEX_4LSB_057_060_Rx_oRDR_FUSION_DET_057_060_oPCAN_RADAR_1ce0ea99_Rx: ComBitPosition=476, ComBitSize=4, ComSignalType=UINT8, ComSystemTemplateSystemSignalRef=DET_MH_SCAN_INDEX_4LSB_057_060_Rx
            DET_MTD_057_Rx_oRDR_FUSION_DET_057_060_oPCAN_RADAR_0bf659d8_Rx: ComBitPosition=47, ComBitSize=1, ComSignalType=BOOLEAN, ComSystemTemplateSystemSignalRef=DET_MTD_057_Rx
            DET_MTD_058_Rx_oRDR_FUSION_DET_057_060_oPCAN_RADAR_8bb82b70_Rx: ComBitPosition=159, ComBitSize=1, ComSignalType=BOOLEAN, ComSystemTemplateSystemSignalRef=DET_MTD_058_Rx
            DET_MTD_059_Rx_oRDR_FUSION_DET_057_060_oPCAN_RADAR_24fcb937_Rx: ComBitPosition=271, ComBitSize=1, ComSignalType=BOOLEAN, ComSystemTemplateSystemSignalRef=DET_MTD_059_Rx
            DET_MTD_060_Rx_oRDR_FUSION_DET_057_060_oPCAN_RADAR_12821d2d_Rx: ComBitPosition=383, ComBitSize=1, ComSignalType=BOOLEAN, ComSystemTemplateSystemSignalRef=DET_MTD_060_Rx
            DET_PROB_1STAZHYPO_057_Rx_oRDR_FUSION_DET_057_060_oPCAN_RADAR_c18f4759_Rx: ComBitPosition=103, ComBitSize=1, ComSignalType=BOOLEAN, ComSystemTemplateSystemSignalRef=DET_PROB_1STAZHYPO_057_Rx
            DET_PROB_1STAZHYPO_058_Rx_oRDR_FUSION_DET_057_060_oPCAN_RADAR_41c135f1_Rx: ComBitPosition=215, ComBitSize=1, ComSignalType=BOOLEAN, ComSystemTemplateSystemSignalRef=DET_PROB_1STAZHYPO_058_Rx
            DET_PROB_1STAZHYPO_059_Rx_oRDR_FUSION_DET_057_060_oPCAN_RADAR_ee85a7b6_Rx: ComBitPosition=327, ComBitSize=1, ComSignalType=BOOLEAN, ComSystemTemplateSystemSignalRef=DET_PROB_1STAZHYPO_059_Rx
            DET_PROB_1STAZHYPO_060_Rx_oRDR_FUSION_DET_057_060_oPCAN_RADAR_d8fb03ac_Rx: ComBitPosition=439, ComBitSize=1, ComSignalType=BOOLEAN, ComSystemTemplateSystemSignalRef=DET_PROB_1STAZHYPO_060_Rx
            DET_RANGE_057_Rx_oRDR_FUSION_DET_057_060_oPCAN_RADAR_9a32af4e_Rx: ComBitPosition=24, ComBitSize=15, ComSignalType=UINT16, ComSystemTemplateSystemSignalRef=DET_RANGE_057_Rx
            DET_RANGE_058_Rx_oRDR_FUSION_DET_057_060_oPCAN_RADAR_1a7cdde6_Rx: ComBitPosition=136, ComBitSize=15, ComSignalType=UINT16, ComSystemTemplateSystemSignalRef=DET_RANGE_058_Rx
            DET_RANGE_059_Rx_oRDR_FUSION_DET_057_060_oPCAN_RADAR_b5384fa1_Rx: ComBitPosition=248, ComBitSize=15, ComSignalType=UINT16, ComSystemTemplateSystemSignalRef=DET_RANGE_059_Rx
            DET_RANGE_060_Rx_oRDR_FUSION_DET_057_060_oPCAN_RADAR_8346ebbb_Rx: ComBitPosition=360, ComBitSize=15, ComSignalType=UINT16, ComSystemTemplateSystemSignalRef=DET_RANGE_060_Rx
            DET_RANGE_ERR_057_Rx_oRDR_FUSION_DET_057_060_oPCAN_RADAR_cac023ae_Rx: ComBitPosition=40, ComBitSize=7, ComSignalType=UINT8, ComSystemTemplateSystemSignalRef=DET_RANGE_ERR_057_Rx
            DET_RANGE_ERR_058_Rx_oRDR_FUSION_DET_057_060_oPCAN_RADAR_4a8e5106_Rx: ComBitPosition=152, ComBitSize=7, ComSignalType=UINT8, ComSystemTemplateSystemSignalRef=DET_RANGE_ERR_058_Rx
            DET_RANGE_ERR_059_Rx_oRDR_FUSION_DET_057_060_oPCAN_RADAR_e5cac341_Rx: ComBitPosition=264, ComBitSize=7, ComSignalType=UINT8, ComSystemTemplateSystemSignalRef=DET_RANGE_ERR_059_Rx
            DET_RANGE_ERR_060_Rx_oRDR_FUSION_DET_057_060_oPCAN_RADAR_d3b4675b_Rx: ComBitPosition=376, ComBitSize=7, ComSignalType=UINT8, ComSystemTemplateSystemSignalRef=DET_RANGE_ERR_060_Rx
            DET_RANGE_VELOCITY_057_Rx_oRDR_FUSION_DET_057_060_oPCAN_RADAR_47c72cb0_Rx: ComBitPosition=48, ComBitSize=15, ComSignalType=UINT16, ComSystemTemplateSystemSignalRef=DET_RANGE_VELOCITY_057_Rx
            DET_RANGE_VELOCITY_058_Rx_oRDR_FUSION_DET_057_060_oPCAN_RADAR_c7895e18_Rx: ComBitPosition=160, ComBitSize=15, ComSignalType=UINT16, ComSystemTemplateSystemSignalRef=DET_RANGE_VELOCITY_058_Rx
            DET_RANGE_VELOCITY_059_Rx_oRDR_FUSION_DET_057_060_oPCAN_RADAR_68cdcc5f_Rx: ComBitPosition=272, ComBitSize=15, ComSignalType=UINT16, ComSystemTemplateSystemSignalRef=DET_RANGE_VELOCITY_059_Rx
            DET_RANGE_VELOCITY_060_Rx_oRDR_FUSION_DET_057_060_oPCAN_RADAR_5eb36845_Rx: ComBitPosition=384, ComBitSize=15, ComSignalType=UINT16, ComSystemTemplateSystemSignalRef=DET_RANGE_VELOCITY_060_Rx
            DET_RANGE_VELOCITY_ERR_057_Rx_oRDR_FUSION_DET_057_060_oPCAN_RADAR_dea35c72_Rx: ComBitPosition=64, ComBitSize=8, ComSignalType=UINT8, ComSystemTemplateSystemSignalRef=DET_RANGE_VELOCITY_ERR_057_Rx
            DET_RANGE_VELOCITY_ERR_058_Rx_oRDR_FUSION_DET_057_060_oPCAN_RADAR_5eed2eda_Rx: ComBitPosition=176, ComBitSize=8, ComSignalType=UINT8, ComSystemTemplateSystemSignalRef=DET_RANGE_VELOCITY_ERR_058_Rx
            DET_RANGE_VELOCITY_ERR_059_Rx_oRDR_FUSION_DET_057_060_oPCAN_RADAR_f1a9bc9d_Rx: ComBitPosition=288, ComBitSize=8, ComSignalType=UINT8, ComSystemTemplateSystemSignalRef=DET_RANGE_VELOCITY_ERR_059_Rx
            DET_RANGE_VELOCITY_ERR_060_Rx_oRDR_FUSION_DET_057_060_oPCAN_RADAR_c7d71887_Rx: ComBitPosition=400, ComBitSize=8, ComSignalType=UINT8, ComSystemTemplateSystemSignalRef=DET_RANGE_VELOCITY_ERR_060_Rx
            DET_RCS_057_Rx_oRDR_FUSION_DET_057_060_oPCAN_RADAR_8a0cbeab_Rx: ComBitPosition=128, ComBitSize=8, ComSignalType=UINT8, ComSystemTemplateSystemSignalRef=DET_RCS_057_Rx
            DET_RCS_058_Rx_oRDR_FUSION_DET_057_060_oPCAN_RADAR_0a42cc03_Rx: ComBitPosition=240, ComBitSize=8, ComSignalType=UINT8, ComSystemTemplateSystemSignalRef=DET_RCS_058_Rx
            DET_RCS_059_Rx_oRDR_FUSION_DET_057_060_oPCAN_RADAR_a5065e44_Rx: ComBitPosition=352, ComBitSize=8, ComSignalType=UINT8, ComSystemTemplateSystemSignalRef=DET_RCS_059_Rx
            DET_RCS_060_Rx_oRDR_FUSION_DET_057_060_oPCAN_RADAR_9378fa5e_Rx: ComBitPosition=464, ComBitSize=8, ComSignalType=UINT8, ComSystemTemplateSystemSignalRef=DET_RCS_060_Rx
            DET_SNR_057_Rx_oRDR_FUSION_DET_057_060_oPCAN_RADAR_8356cf42_Rx: ComBitPosition=120, ComBitSize=8, ComSignalType=UINT8, ComSystemTemplateSystemSignalRef=DET_SNR_057_Rx
            DET_SNR_058_Rx_oRDR_FUSION_DET_057_060_oPCAN_RADAR_0318bdea_Rx: ComBitPosition=232, ComBitSize=8, ComSignalType=UINT8, ComSystemTemplateSystemSignalRef=DET_SNR_058_Rx
            DET_SNR_059_Rx_oRDR_FUSION_DET_057_060_oPCAN_RADAR_ac5c2fad_Rx: ComBitPosition=344, ComBitSize=8, ComSignalType=UINT8, ComSystemTemplateSystemSignalRef=DET_SNR_059_Rx
            DET_SNR_060_Rx_oRDR_FUSION_DET_057_060_oPCAN_RADAR_9a228bb7_Rx: ComBitPosition=456, ComBitSize=8, ComSignalType=UINT8, ComSystemTemplateSystemSignalRef=DET_SNR_060_Rx
            DET_SUPER_RES_TARGET_057_Rx_oRDR_FUSION_DET_057_060_oPCAN_RADAR_48adee42_Rx: ComBitPosition=87, ComBitSize=1, ComSignalType=BOOLEAN, ComSystemTemplateSystemSignalRef=DET_SUPER_RES_TARGET_057_Rx
            DET_SUPER_RES_TARGET_058_Rx_oRDR_FUSION_DET_057_060_oPCAN_RADAR_c8e39cea_Rx: ComBitPosition=199, ComBitSize=1, ComSignalType=BOOLEAN, ComSystemTemplateSystemSignalRef=DET_SUPER_RES_TARGET_058_Rx
            DET_SUPER_RES_TARGET_059_Rx_oRDR_FUSION_DET_057_060_oPCAN_RADAR_67a70ead_Rx: ComBitPosition=311, ComBitSize=1, ComSignalType=BOOLEAN, ComSystemTemplateSystemSignalRef=DET_SUPER_RES_TARGET_059_Rx
            DET_SUPER_RES_TARGET_060_Rx_oRDR_FUSION_DET_057_060_oPCAN_RADAR_51d9aab7_Rx: ComBitPosition=423, ComBitSize=1, ComSignalType=BOOLEAN, ComSystemTemplateSystemSignalRef=DET_SUPER_RES_TARGET_060_Rx
        SG_Fusion_Detections_061_064_oRDR_FUSION_DET_061_064_oPCAN_RADAR_57616c84_Rx: ComTimeout=0, ComSystemTemplateSignalGroupRef=SG_Fusion_Detections_061_064
          83 x ComGroupSignal, all with ComSignalEndianness=LITTLE_ENDIAN, ComSignalInitValue=0:
            DET_AZIMUTH_061_Rx_oRDR_FUSION_DET_061_064_oPCAN_RADAR_b2cf2527_Rx: ComBitPosition=88, ComBitSize=13, ComSignalType=UINT16, ComSystemTemplateSystemSignalRef=DET_AZIMUTH_061_Rx
            DET_AZIMUTH_062_Rx_oRDR_FUSION_DET_061_064_oPCAN_RADAR_987395af_Rx: ComBitPosition=200, ComBitSize=13, ComSignalType=UINT16, ComSystemTemplateSystemSignalRef=DET_AZIMUTH_062_Rx
            DET_AZIMUTH_063_Rx_oRDR_FUSION_DET_061_064_oPCAN_RADAR_373707e8_Rx: ComBitPosition=312, ComBitSize=13, ComSignalType=UINT16, ComSystemTemplateSystemSignalRef=DET_AZIMUTH_063_Rx
            DET_AZIMUTH_064_Rx_oRDR_FUSION_DET_061_064_oPCAN_RADAR_cd0af4bf_Rx: ComBitPosition=424, ComBitSize=13, ComSignalType=UINT16, ComSystemTemplateSystemSignalRef=DET_AZIMUTH_064_Rx
            DET_AZIMUTH_ERR_061_Rx_oRDR_FUSION_DET_061_064_oPCAN_RADAR_b0a684a5_Rx: ComBitPosition=105, ComBitSize=7, ComSignalType=UINT8, ComSystemTemplateSystemSignalRef=DET_AZIMUTH_ERR_061_Rx
            DET_AZIMUTH_ERR_062_Rx_oRDR_FUSION_DET_061_064_oPCAN_RADAR_9a1a342d_Rx: ComBitPosition=217, ComBitSize=7, ComSignalType=UINT8, ComSystemTemplateSystemSignalRef=DET_AZIMUTH_ERR_062_Rx
            DET_AZIMUTH_ERR_063_Rx_oRDR_FUSION_DET_061_064_oPCAN_RADAR_355ea66a_Rx: ComBitPosition=329, ComBitSize=7, ComSignalType=UINT8, ComSystemTemplateSystemSignalRef=DET_AZIMUTH_ERR_063_Rx
            DET_AZIMUTH_ERR_064_Rx_oRDR_FUSION_DET_061_064_oPCAN_RADAR_cf63553d_Rx: ComBitPosition=441, ComBitSize=7, ComSignalType=UINT8, ComSystemTemplateSystemSignalRef=DET_AZIMUTH_ERR_064_Rx
            DET_BELOW_RAIN_THOLD_061_Rx_oRDR_FUSION_DET_061_064_oPCAN_RADAR_d475da92_Rx: ComBitPosition=39, ComBitSize=1, ComSignalType=BOOLEAN, ComSystemTemplateSystemSignalRef=DET_BELOW_RAIN_THOLD_061_Rx
            DET_BELOW_RAIN_THOLD_062_Rx_oRDR_FUSION_DET_061_064_oPCAN_RADAR_fec96a1a_Rx: ComBitPosition=151, ComBitSize=1, ComSignalType=BOOLEAN, ComSystemTemplateSystemSignalRef=DET_BELOW_RAIN_THOLD_062_Rx
            DET_BELOW_RAIN_THOLD_063_Rx_oRDR_FUSION_DET_061_064_oPCAN_RADAR_518df85d_Rx: ComBitPosition=263, ComBitSize=1, ComSignalType=BOOLEAN, ComSystemTemplateSystemSignalRef=DET_BELOW_RAIN_THOLD_063_Rx
            DET_BELOW_RAIN_THOLD_064_Rx_oRDR_FUSION_DET_061_064_oPCAN_RADAR_abb00b0a_Rx: ComBitPosition=375, ComBitSize=1, ComSignalType=BOOLEAN, ComSystemTemplateSystemSignalRef=DET_BELOW_RAIN_THOLD_064_Rx
            DET_BI_STATIC_FLAG_061_Rx_oRDR_FUSION_DET_061_064_oPCAN_RADAR_a3eb7181_Rx: ComBitPosition=104, ComBitSize=1, ComSignalType=BOOLEAN, ComSystemTemplateSystemSignalRef=DET_BI_STATIC_FLAG_061_Rx
            DET_BI_STATIC_FLAG_062_Rx_oRDR_FUSION_DET_061_064_oPCAN_RADAR_8957c109_Rx: ComBitPosition=216, ComBitSize=1, ComSignalType=BOOLEAN, ComSystemTemplateSystemSignalRef=DET_BI_STATIC_FLAG_062_Rx
            DET_BI_STATIC_FLAG_063_Rx_oRDR_FUSION_DET_061_064_oPCAN_RADAR_2613534e_Rx: ComBitPosition=328, ComBitSize=1, ComSignalType=BOOLEAN, ComSystemTemplateSystemSignalRef=DET_BI_STATIC_FLAG_063_Rx
            DET_BI_STATIC_FLAG_064_Rx_oRDR_FUSION_DET_061_064_oPCAN_RADAR_dc2ea019_Rx: ComBitPosition=440, ComBitSize=1, ComSignalType=BOOLEAN, ComSystemTemplateSystemSignalRef=DET_BI_STATIC_FLAG_064_Rx
            DET_CONFD_AZIMUTH_061_Rx_oRDR_FUSION_DET_061_064_oPCAN_RADAR_40829bd5_Rx: ComBitPosition=118, ComBitSize=2, ComSignalType=UINT8, ComSystemTemplateSystemSignalRef=DET_CONFD_AZIMUTH_061_Rx
            DET_CONFD_AZIMUTH_062_Rx_oRDR_FUSION_DET_061_064_oPCAN_RADAR_6a3e2b5d_Rx: ComBitPosition=230, ComBitSize=2, ComSignalType=UINT8, ComSystemTemplateSystemSignalRef=DET_CONFD_AZIMUTH_062_Rx
            DET_CONFD_AZIMUTH_063_Rx_oRDR_FUSION_DET_061_064_oPCAN_RADAR_c57ab91a_Rx: ComBitPosition=342, ComBitSize=2, ComSignalType=UINT8, ComSystemTemplateSystemSignalRef=DET_CONFD_AZIMUTH_063_Rx
            DET_CONFD_AZIMUTH_064_Rx_oRDR_FUSION_DET_061_064_oPCAN_RADAR_3f474a4d_Rx: ComBitPosition=454, ComBitSize=2, ComSignalType=UINT8, ComSystemTemplateSystemSignalRef=DET_CONFD_AZIMUTH_064_Rx
            DET_CONFD_ELEVATION_061_Rx_oRDR_FUSION_DET_061_064_oPCAN_RADAR_4aa31852_Rx: ComBitPosition=101, ComBitSize=2, ComSignalType=UINT8, ComSystemTemplateSystemSignalRef=DET_CONFD_ELEVATION_061_Rx
            DET_CONFD_ELEVATION_062_Rx_oRDR_FUSION_DET_061_064_oPCAN_RADAR_601fa8da_Rx: ComBitPosition=213, ComBitSize=2, ComSignalType=UINT8, ComSystemTemplateSystemSignalRef=DET_CONFD_ELEVATION_062_Rx
            DET_CONFD_ELEVATION_063_Rx_oRDR_FUSION_DET_061_064_oPCAN_RADAR_cf5b3a9d_Rx: ComBitPosition=325, ComBitSize=2, ComSignalType=UINT8, ComSystemTemplateSystemSignalRef=DET_CONFD_ELEVATION_063_Rx
            DET_CONFD_ELEVATION_064_Rx_oRDR_FUSION_DET_061_064_oPCAN_RADAR_3566c9ca_Rx: ComBitPosition=437, ComBitSize=2, ComSignalType=UINT8, ComSystemTemplateSystemSignalRef=DET_CONFD_ELEVATION_064_Rx
            DET_ELEVATION_061_Rx_oRDR_FUSION_DET_061_064_oPCAN_RADAR_40f0f7ab_Rx: ComBitPosition=72, ComBitSize=8, ComSignalType=UINT8, ComSystemTemplateSystemSignalRef=DET_ELEVATION_061_Rx
            DET_ELEVATION_062_Rx_oRDR_FUSION_DET_061_064_oPCAN_RADAR_6a4c4723_Rx: ComBitPosition=184, ComBitSize=8, ComSignalType=UINT8, ComSystemTemplateSystemSignalRef=DET_ELEVATION_062_Rx
            DET_ELEVATION_063_Rx_oRDR_FUSION_DET_061_064_oPCAN_RADAR_c508d564_Rx: ComBitPosition=296, ComBitSize=8, ComSignalType=UINT8, ComSystemTemplateSystemSignalRef=DET_ELEVATION_063_Rx
            DET_ELEVATION_064_Rx_oRDR_FUSION_DET_061_064_oPCAN_RADAR_3f352633_Rx: ComBitPosition=408, ComBitSize=8, ComSignalType=UINT8, ComSystemTemplateSystemSignalRef=DET_ELEVATION_064_Rx
            DET_ELEVATION_ERR_061_Rx_oRDR_FUSION_DET_061_064_oPCAN_RADAR_9249d574_Rx: ComBitPosition=80, ComBitSize=6, ComSignalType=UINT8, ComSystemTemplateSystemSignalRef=DET_ELEVATION_ERR_061_Rx
            DET_ELEVATION_ERR_062_Rx_oRDR_FUSION_DET_061_064_oPCAN_RADAR_b8f565fc_Rx: ComBitPosition=192, ComBitSize=6, ComSignalType=UINT8, ComSystemTemplateSystemSignalRef=DET_ELEVATION_ERR_062_Rx
            DET_ELEVATION_ERR_063_Rx_oRDR_FUSION_DET_061_064_oPCAN_RADAR_17b1f7bb_Rx: ComBitPosition=304, ComBitSize=6, ComSignalType=UINT8, ComSystemTemplateSystemSignalRef=DET_ELEVATION_ERR_063_Rx
            DET_ELEVATION_ERR_064_Rx_oRDR_FUSION_DET_061_064_oPCAN_RADAR_ed8c04ec_Rx: ComBitPosition=416, ComBitSize=6, ComSignalType=UINT8, ComSystemTemplateSystemSignalRef=DET_ELEVATION_ERR_064_Rx
            DET_EXISTENCE_PROB_061_Rx_oRDR_FUSION_DET_061_064_oPCAN_RADAR_6551ade1_Rx: ComBitPosition=112, ComBitSize=6, ComSignalType=UINT8, ComSystemTemplateSystemSignalRef=DET_EXISTENCE_PROB_061_Rx
            DET_EXISTENCE_PROB_062_Rx_oRDR_FUSION_DET_061_064_oPCAN_RADAR_4fed1d69_Rx: ComBitPosition=224, ComBitSize=6, ComSignalType=UINT8, ComSystemTemplateSystemSignalRef=DET_EXISTENCE_PROB_062_Rx
            DET_EXISTENCE_PROB_063_Rx_oRDR_FUSION_DET_061_064_oPCAN_RADAR_e0a98f2e_Rx: ComBitPosition=336, ComBitSize=6, ComSignalType=UINT8, ComSystemTemplateSystemSignalRef=DET_EXISTENCE_PROB_063_Rx
            DET_EXISTENCE_PROB_064_Rx_oRDR_FUSION_DET_061_064_oPCAN_RADAR_1a947c79_Rx: ComBitPosition=448, ComBitSize=6, ComSignalType=UINT8, ComSystemTemplateSystemSignalRef=DET_EXISTENCE_PROB_064_Rx
            DET_HVC_FLAG_061_Rx_oRDR_FUSION_DET_061_064_oPCAN_RADAR_b88f40ae_Rx: ComBitPosition=86, ComBitSize=1, ComSignalType=BOOLEAN, ComSystemTemplateSystemSignalRef=DET_HVC_FLAG_061_Rx
            DET_HVC_FLAG_062_Rx_oRDR_FUSION_DET_061_064_oPCAN_RADAR_9233f026_Rx: ComBitPosition=198, ComBitSize=1, ComSignalType=BOOLEAN, ComSystemTemplateSystemSignalRef=DET_HVC_FLAG_062_Rx
            DET_HVC_FLAG_063_Rx_oRDR_FUSION_DET_061_064_oPCAN_RADAR_3d776261_Rx: ComBitPosition=310, ComBitSize=1, ComSignalType=BOOLEAN, ComSystemTemplateSystemSignalRef=DET_HVC_FLAG_063_Rx
            DET_HVC_FLAG_064_Rx_oRDR_FUSION_DET_061_064_oPCAN_RADAR_c74a9136_Rx: ComBitPosition=422, ComBitSize=1, ComSignalType=BOOLEAN, ComSystemTemplateSystemSignalRef=DET_HVC_FLAG_064_Rx
            DET_IDM_061_Rx_oRDR_FUSION_DET_061_064_oPCAN_RADAR_8d4eb9e6_Rx: ComBitPosition=63, ComBitSize=1, ComSignalType=BOOLEAN, ComSystemTemplateSystemSignalRef=DET_IDM_061_Rx
            DET_IDM_062_Rx_oRDR_FUSION_DET_061_064_oPCAN_RADAR_a7f2096e_Rx: ComBitPosition=175, ComBitSize=1, ComSignalType=BOOLEAN, ComSystemTemplateSystemSignalRef=DET_IDM_062_Rx
            DET_IDM_063_Rx_oRDR_FUSION_DET_061_064_oPCAN_RADAR_08b69b29_Rx: ComBitPosition=287, ComBitSize=1, ComSignalType=BOOLEAN, ComSystemTemplateSystemSignalRef=DET_IDM_063_Rx
            DET_IDM_064_Rx_oRDR_FUSION_DET_061_064_oPCAN_RADAR_f28b687e_Rx: ComBitPosition=399, ComBitSize=1, ComSignalType=BOOLEAN, ComSystemTemplateSystemSignalRef=DET_IDM_064_Rx
            DET_MH_CRC16_061_064_Rx_oRDR_FUSION_DET_061_064_oPCAN_RADAR_eb3ab49d_Rx: ComBitPosition=0, ComBitSize=16, ComSignalType=UINT16, ComSystemTemplateSystemSignalRef=DET_MH_CRC16_061_064_Rx
            DET_MH_CYCLE_COUNTER_061_064_Rx_oRDR_FUSION_DET_061_064_oPCAN_RADAR_e6e18958_Rx: ComBitPosition=16, ComBitSize=8, ComSignalType=UINT8, ComSystemTemplateSystemSignalRef=DET_MH_CYCLE_COUNTER_061_064_Rx
            DET_MH_SCAN_INDEX_4LSB_061_064_Rx_oRDR_FUSION_DET_061_064_oPCAN_RADAR_82514663_Rx: ComBitPosition=476, ComBitSize=4, ComSignalType=UINT8, ComSystemTemplateSystemSignalRef=DET_MH_SCAN_INDEX_4LSB_061_064_Rx
            DET_MTD_061_Rx_oRDR_FUSION_DET_061_064_oPCAN_RADAR_30cd8f96_Rx: ComBitPosition=47, ComBitSize=1, ComSignalType=BOOLEAN, ComSystemTemplateSystemSignalRef=DET_MTD_061_Rx
            DET_MTD_062_Rx_oRDR_FUSION_DET_061_064_oPCAN_RADAR_1a713f1e_Rx: ComBitPosition=159, ComBitSize=1, ComSignalType=BOOLEAN, ComSystemTemplateSystemSignalRef=DET_MTD_062_Rx
            DET_MTD_063_Rx_oRDR_FUSION_DET_061_064_oPCAN_RADAR_b535ad59_Rx: ComBitPosition=271, ComBitSize=1, ComSignalType=BOOLEAN, ComSystemTemplateSystemSignalRef=DET_MTD_063_Rx
            DET_MTD_064_Rx_oRDR_FUSION_DET_061_064_oPCAN_RADAR_4f085e0e_Rx: ComBitPosition=383, ComBitSize=1, ComSignalType=BOOLEAN, ComSystemTemplateSystemSignalRef=DET_MTD_064_Rx
            DET_PROB_1STAZHYPO_061_Rx_oRDR_FUSION_DET_061_064_oPCAN_RADAR_fab49117_Rx: ComBitPosition=103, ComBitSize=1, ComSignalType=BOOLEAN, ComSystemTemplateSystemSignalRef=DET_PROB_1STAZHYPO_061_Rx
            DET_PROB_1STAZHYPO_062_Rx_oRDR_FUSION_DET_061_064_oPCAN_RADAR_d008219f_Rx: ComBitPosition=215, ComBitSize=1, ComSignalType=BOOLEAN, ComSystemTemplateSystemSignalRef=DET_PROB_1STAZHYPO_062_Rx
            DET_PROB_1STAZHYPO_063_Rx_oRDR_FUSION_DET_061_064_oPCAN_RADAR_7f4cb3d8_Rx: ComBitPosition=327, ComBitSize=1, ComSignalType=BOOLEAN, ComSystemTemplateSystemSignalRef=DET_PROB_1STAZHYPO_063_Rx
            DET_PROB_1STAZHYPO_064_Rx_oRDR_FUSION_DET_061_064_oPCAN_RADAR_8571408f_Rx: ComBitPosition=439, ComBitSize=1, ComSignalType=BOOLEAN, ComSystemTemplateSystemSignalRef=DET_PROB_1STAZHYPO_064_Rx
            DET_RANGE_061_Rx_oRDR_FUSION_DET_061_064_oPCAN_RADAR_a1097900_Rx: ComBitPosition=24, ComBitSize=15, ComSignalType=UINT16, ComSystemTemplateSystemSignalRef=DET_RANGE_061_Rx
            DET_RANGE_062_Rx_oRDR_FUSION_DET_061_064_oPCAN_RADAR_8bb5c988_Rx: ComBitPosition=136, ComBitSize=15, ComSignalType=UINT16, ComSystemTemplateSystemSignalRef=DET_RANGE_062_Rx
            DET_RANGE_063_Rx_oRDR_FUSION_DET_061_064_oPCAN_RADAR_24f15bcf_Rx: ComBitPosition=248, ComBitSize=15, ComSignalType=UINT16, ComSystemTemplateSystemSignalRef=DET_RANGE_063_Rx
            DET_RANGE_064_Rx_oRDR_FUSION_DET_061_064_oPCAN_RADAR_decca898_Rx: ComBitPosition=360, ComBitSize=15, ComSignalType=UINT16, ComSystemTemplateSystemSignalRef=DET_RANGE_064_Rx
            DET_RANGE_ERR_061_Rx_oRDR_FUSION_DET_061_064_oPCAN_RADAR_f1fbf5e0_Rx: ComBitPosition=40, ComBitSize=7, ComSignalType=UINT8, ComSystemTemplateSystemSignalRef=DET_RANGE_ERR_061_Rx
            DET_RANGE_ERR_062_Rx_oRDR_FUSION_DET_061_064_oPCAN_RADAR_db474568_Rx: ComBitPosition=152, ComBitSize=7, ComSignalType=UINT8, ComSystemTemplateSystemSignalRef=DET_RANGE_ERR_062_Rx
            DET_RANGE_ERR_063_Rx_oRDR_FUSION_DET_061_064_oPCAN_RADAR_7403d72f_Rx: ComBitPosition=264, ComBitSize=7, ComSignalType=UINT8, ComSystemTemplateSystemSignalRef=DET_RANGE_ERR_063_Rx
            DET_RANGE_ERR_064_Rx_oRDR_FUSION_DET_061_064_oPCAN_RADAR_8e3e2478_Rx: ComBitPosition=376, ComBitSize=7, ComSignalType=UINT8, ComSystemTemplateSystemSignalRef=DET_RANGE_ERR_064_Rx
            DET_RANGE_VELOCITY_061_Rx_oRDR_FUSION_DET_061_064_oPCAN_RADAR_7cfcfafe_Rx: ComBitPosition=48, ComBitSize=15, ComSignalType=UINT16, ComSystemTemplateSystemSignalRef=DET_RANGE_VELOCITY_061_Rx
            DET_RANGE_VELOCITY_062_Rx_oRDR_FUSION_DET_061_064_oPCAN_RADAR_56404a76_Rx: ComBitPosition=160, ComBitSize=15, ComSignalType=UINT16, ComSystemTemplateSystemSignalRef=DET_RANGE_VELOCITY_062_Rx
            DET_RANGE_VELOCITY_063_Rx_oRDR_FUSION_DET_061_064_oPCAN_RADAR_f904d831_Rx: ComBitPosition=272, ComBitSize=15, ComSignalType=UINT16, ComSystemTemplateSystemSignalRef=DET_RANGE_VELOCITY_063_Rx
            DET_RANGE_VELOCITY_064_Rx_oRDR_FUSION_DET_061_064_oPCAN_RADAR_03392b66_Rx: ComBitPosition=384, ComBitSize=15, ComSignalType=UINT16, ComSystemTemplateSystemSignalRef=DET_RANGE_VELOCITY_064_Rx
            DET_RANGE_VELOCITY_ERR_061_Rx_oRDR_FUSION_DET_061_064_oPCAN_RADAR_e5988a3c_Rx: ComBitPosition=64, ComBitSize=8, ComSignalType=UINT8, ComSystemTemplateSystemSignalRef=DET_RANGE_VELOCITY_ERR_061_Rx
            DET_RANGE_VELOCITY_ERR_062_Rx_oRDR_FUSION_DET_061_064_oPCAN_RADAR_cf243ab4_Rx: ComBitPosition=176, ComBitSize=8, ComSignalType=UINT8, ComSystemTemplateSystemSignalRef=DET_RANGE_VELOCITY_ERR_062_Rx
            DET_RANGE_VELOCITY_ERR_063_Rx_oRDR_FUSION_DET_061_064_oPCAN_RADAR_6060a8f3_Rx: ComBitPosition=288, ComBitSize=8, ComSignalType=UINT8, ComSystemTemplateSystemSignalRef=DET_RANGE_VELOCITY_ERR_063_Rx
            DET_RANGE_VELOCITY_ERR_064_Rx_oRDR_FUSION_DET_061_064_oPCAN_RADAR_9a5d5ba4_Rx: ComBitPosition=400, ComBitSize=8, ComSignalType=UINT8, ComSystemTemplateSystemSignalRef=DET_RANGE_VELOCITY_ERR_064_Rx
            DET_RCS_061_Rx_oRDR_FUSION_DET_061_064_oPCAN_RADAR_b13768e5_Rx: ComBitPosition=128, ComBitSize=8, ComSignalType=UINT8, ComSystemTemplateSystemSignalRef=DET_RCS_061_Rx
            DET_RCS_062_Rx_oRDR_FUSION_DET_061_064_oPCAN_RADAR_9b8bd86d_Rx: ComBitPosition=240, ComBitSize=8, ComSignalType=UINT8, ComSystemTemplateSystemSignalRef=DET_RCS_062_Rx
            DET_RCS_063_Rx_oRDR_FUSION_DET_061_064_oPCAN_RADAR_34cf4a2a_Rx: ComBitPosition=352, ComBitSize=8, ComSignalType=UINT8, ComSystemTemplateSystemSignalRef=DET_RCS_063_Rx
            DET_RCS_064_Rx_oRDR_FUSION_DET_061_064_oPCAN_RADAR_cef2b97d_Rx: ComBitPosition=464, ComBitSize=8, ComSignalType=UINT8, ComSystemTemplateSystemSignalRef=DET_RCS_064_Rx
            DET_SNR_061_Rx_oRDR_FUSION_DET_061_064_oPCAN_RADAR_b86d190c_Rx: ComBitPosition=120, ComBitSize=8, ComSignalType=UINT8, ComSystemTemplateSystemSignalRef=DET_SNR_061_Rx
            DET_SNR_062_Rx_oRDR_FUSION_DET_061_064_oPCAN_RADAR_92d1a984_Rx: ComBitPosition=232, ComBitSize=8, ComSignalType=UINT8, ComSystemTemplateSystemSignalRef=DET_SNR_062_Rx
            DET_SNR_063_Rx_oRDR_FUSION_DET_061_064_oPCAN_RADAR_3d953bc3_Rx: ComBitPosition=344, ComBitSize=8, ComSignalType=UINT8, ComSystemTemplateSystemSignalRef=DET_SNR_063_Rx
            DET_SNR_064_Rx_oRDR_FUSION_DET_061_064_oPCAN_RADAR_c7a8c894_Rx: ComBitPosition=456, ComBitSize=8, ComSignalType=UINT8, ComSystemTemplateSystemSignalRef=DET_SNR_064_Rx
            DET_SUPER_RES_TARGET_061_Rx_oRDR_FUSION_DET_061_064_oPCAN_RADAR_7396380c_Rx: ComBitPosition=87, ComBitSize=1, ComSignalType=BOOLEAN, ComSystemTemplateSystemSignalRef=DET_SUPER_RES_TARGET_061_Rx
            DET_SUPER_RES_TARGET_062_Rx_oRDR_FUSION_DET_061_064_oPCAN_RADAR_592a8884_Rx: ComBitPosition=199, ComBitSize=1, ComSignalType=BOOLEAN, ComSystemTemplateSystemSignalRef=DET_SUPER_RES_TARGET_062_Rx
            DET_SUPER_RES_TARGET_063_Rx_oRDR_FUSION_DET_061_064_oPCAN_RADAR_f66e1ac3_Rx: ComBitPosition=311, ComBitSize=1, ComSignalType=BOOLEAN, ComSystemTemplateSystemSignalRef=DET_SUPER_RES_TARGET_063_Rx
            DET_SUPER_RES_TARGET_064_Rx_oRDR_FUSION_DET_061_064_oPCAN_RADAR_0c53e994_Rx: ComBitPosition=423, ComBitSize=1, ComSignalType=BOOLEAN, ComSystemTemplateSystemSignalRef=DET_SUPER_RES_TARGET_064_Rx
        SG_Fusion_Detections_065_068_oRDR_FUSION_DET_065_068_oPCAN_RADAR_1a9a4777_Rx: ComTimeout=0, ComSystemTemplateSignalGroupRef=SG_Fusion_Detections_065_068
          83 x ComGroupSignal, all with ComSignalEndianness=LITTLE_ENDIAN, ComSignalInitValue=0:
            DET_AZIMUTH_065_Rx_oRDR_FUSION_DET_065_068_oPCAN_RADAR_8bfcf8cc_Rx: ComBitPosition=88, ComBitSize=13, ComSignalType=UINT16, ComSystemTemplateSystemSignalRef=DET_AZIMUTH_065_Rx
            DET_AZIMUTH_066_Rx_oRDR_FUSION_DET_065_068_oPCAN_RADAR_a1404844_Rx: ComBitPosition=200, ComBitSize=13, ComSignalType=UINT16, ComSystemTemplateSystemSignalRef=DET_AZIMUTH_066_Rx
            DET_AZIMUTH_067_Rx_oRDR_FUSION_DET_065_068_oPCAN_RADAR_0e04da03_Rx: ComBitPosition=312, ComBitSize=13, ComSignalType=UINT16, ComSystemTemplateSystemSignalRef=DET_AZIMUTH_067_Rx
            DET_AZIMUTH_068_Rx_oRDR_FUSION_DET_065_068_oPCAN_RADAR_8e4aa8ab_Rx: ComBitPosition=424, ComBitSize=13, ComSignalType=UINT16, ComSystemTemplateSystemSignalRef=DET_AZIMUTH_068_Rx
            DET_AZIMUTH_ERR_065_Rx_oRDR_FUSION_DET_065_068_oPCAN_RADAR_8995594e_Rx: ComBitPosition=105, ComBitSize=7, ComSignalType=UINT8, ComSystemTemplateSystemSignalRef=DET_AZIMUTH_ERR_065_Rx
            DET_AZIMUTH_ERR_066_Rx_oRDR_FUSION_DET_065_068_oPCAN_RADAR_a329e9c6_Rx: ComBitPosition=217, ComBitSize=7, ComSignalType=UINT8, ComSystemTemplateSystemSignalRef=DET_AZIMUTH_ERR_066_Rx
            DET_AZIMUTH_ERR_067_Rx_oRDR_FUSION_DET_065_068_oPCAN_RADAR_0c6d7b81_Rx: ComBitPosition=329, ComBitSize=7, ComSignalType=UINT8, ComSystemTemplateSystemSignalRef=DET_AZIMUTH_ERR_067_Rx
            DET_AZIMUTH_ERR_068_Rx_oRDR_FUSION_DET_065_068_oPCAN_RADAR_8c230929_Rx: ComBitPosition=441, ComBitSize=7, ComSignalType=UINT8, ComSystemTemplateSystemSignalRef=DET_AZIMUTH_ERR_068_Rx
            DET_BELOW_RAIN_THOLD_065_Rx_oRDR_FUSION_DET_065_068_oPCAN_RADAR_ed460779_Rx: ComBitPosition=39, ComBitSize=1, ComSignalType=BOOLEAN, ComSystemTemplateSystemSignalRef=DET_BELOW_RAIN_THOLD_065_Rx
            DET_BELOW_RAIN_THOLD_066_Rx_oRDR_FUSION_DET_065_068_oPCAN_RADAR_c7fab7f1_Rx: ComBitPosition=151, ComBitSize=1, ComSignalType=BOOLEAN, ComSystemTemplateSystemSignalRef=DET_BELOW_RAIN_THOLD_066_Rx
            DET_BELOW_RAIN_THOLD_067_Rx_oRDR_FUSION_DET_065_068_oPCAN_RADAR_68be25b6_Rx: ComBitPosition=263, ComBitSize=1, ComSignalType=BOOLEAN, ComSystemTemplateSystemSignalRef=DET_BELOW_RAIN_THOLD_067_Rx
            DET_BELOW_RAIN_THOLD_068_Rx_oRDR_FUSION_DET_065_068_oPCAN_RADAR_e8f0571e_Rx: ComBitPosition=375, ComBitSize=1, ComSignalType=BOOLEAN, ComSystemTemplateSystemSignalRef=DET_BELOW_RAIN_THOLD_068_Rx
            DET_BI_STATIC_FLAG_065_Rx_oRDR_FUSION_DET_065_068_oPCAN_RADAR_9ad8ac6a_Rx: ComBitPosition=104, ComBitSize=1, ComSignalType=BOOLEAN, ComSystemTemplateSystemSignalRef=DET_BI_STATIC_FLAG_065_Rx
            DET_BI_STATIC_FLAG_066_Rx_oRDR_FUSION_DET_065_068_oPCAN_RADAR_b0641ce2_Rx: ComBitPosition=216, ComBitSize=1, ComSignalType=BOOLEAN, ComSystemTemplateSystemSignalRef=DET_BI_STATIC_FLAG_066_Rx
            DET_BI_STATIC_FLAG_067_Rx_oRDR_FUSION_DET_065_068_oPCAN_RADAR_1f208ea5_Rx: ComBitPosition=328, ComBitSize=1, ComSignalType=BOOLEAN, ComSystemTemplateSystemSignalRef=DET_BI_STATIC_FLAG_067_Rx
            DET_BI_STATIC_FLAG_068_Rx_oRDR_FUSION_DET_065_068_oPCAN_RADAR_9f6efc0d_Rx: ComBitPosition=440, ComBitSize=1, ComSignalType=BOOLEAN, ComSystemTemplateSystemSignalRef=DET_BI_STATIC_FLAG_068_Rx
            DET_CONFD_AZIMUTH_065_Rx_oRDR_FUSION_DET_065_068_oPCAN_RADAR_79b1463e_Rx: ComBitPosition=118, ComBitSize=2, ComSignalType=UINT8, ComSystemTemplateSystemSignalRef=DET_CONFD_AZIMUTH_065_Rx
            DET_CONFD_AZIMUTH_066_Rx_oRDR_FUSION_DET_065_068_oPCAN_RADAR_530df6b6_Rx: ComBitPosition=230, ComBitSize=2, ComSignalType=UINT8, ComSystemTemplateSystemSignalRef=DET_CONFD_AZIMUTH_066_Rx
            DET_CONFD_AZIMUTH_067_Rx_oRDR_FUSION_DET_065_068_oPCAN_RADAR_fc4964f1_Rx: ComBitPosition=342, ComBitSize=2, ComSignalType=UINT8, ComSystemTemplateSystemSignalRef=DET_CONFD_AZIMUTH_067_Rx
            DET_CONFD_AZIMUTH_068_Rx_oRDR_FUSION_DET_065_068_oPCAN_RADAR_7c071659_Rx: ComBitPosition=454, ComBitSize=2, ComSignalType=UINT8, ComSystemTemplateSystemSignalRef=DET_CONFD_AZIMUTH_068_Rx
            DET_CONFD_ELEVATION_065_Rx_oRDR_FUSION_DET_065_068_oPCAN_RADAR_7390c5b9_Rx: ComBitPosition=101, ComBitSize=2, ComSignalType=UINT8, ComSystemTemplateSystemSignalRef=DET_CONFD_ELEVATION_065_Rx
            DET_CONFD_ELEVATION_066_Rx_oRDR_FUSION_DET_065_068_oPCAN_RADAR_592c7531_Rx: ComBitPosition=213, ComBitSize=2, ComSignalType=UINT8, ComSystemTemplateSystemSignalRef=DET_CONFD_ELEVATION_066_Rx
            DET_CONFD_ELEVATION_067_Rx_oRDR_FUSION_DET_065_068_oPCAN_RADAR_f668e776_Rx: ComBitPosition=325, ComBitSize=2, ComSignalType=UINT8, ComSystemTemplateSystemSignalRef=DET_CONFD_ELEVATION_067_Rx
            DET_CONFD_ELEVATION_068_Rx_oRDR_FUSION_DET_065_068_oPCAN_RADAR_762695de_Rx: ComBitPosition=437, ComBitSize=2, ComSignalType=UINT8, ComSystemTemplateSystemSignalRef=DET_CONFD_ELEVATION_068_Rx
            DET_ELEVATION_065_Rx_oRDR_FUSION_DET_065_068_oPCAN_RADAR_79c32a40_Rx: ComBitPosition=72, ComBitSize=8, ComSignalType=UINT8, ComSystemTemplateSystemSignalRef=DET_ELEVATION_065_Rx
            DET_ELEVATION_066_Rx_oRDR_FUSION_DET_065_068_oPCAN_RADAR_537f9ac8_Rx: ComBitPosition=184, ComBitSize=8, ComSignalType=UINT8, ComSystemTemplateSystemSignalRef=DET_ELEVATION_066_Rx
            DET_ELEVATION_067_Rx_oRDR_FUSION_DET_065_068_oPCAN_RADAR_fc3b088f_Rx: ComBitPosition=296, ComBitSize=8, ComSignalType=UINT8, ComSystemTemplateSystemSignalRef=DET_ELEVATION_067_Rx
            DET_ELEVATION_068_Rx_oRDR_FUSION_DET_065_068_oPCAN_RADAR_7c757a27_Rx: ComBitPosition=408, ComBitSize=8, ComSignalType=UINT8, ComSystemTemplateSystemSignalRef=DET_ELEVATION_068_Rx
            DET_ELEVATION_ERR_065_Rx_oRDR_FUSION_DET_065_068_oPCAN_RADAR_ab7a089f_Rx: ComBitPosition=80, ComBitSize=6, ComSignalType=UINT8, ComSystemTemplateSystemSignalRef=DET_ELEVATION_ERR_065_Rx
            DET_ELEVATION_ERR_066_Rx_oRDR_FUSION_DET_065_068_oPCAN_RADAR_81c6b817_Rx: ComBitPosition=192, ComBitSize=6, ComSignalType=UINT8, ComSystemTemplateSystemSignalRef=DET_ELEVATION_ERR_066_Rx
            DET_ELEVATION_ERR_067_Rx_oRDR_FUSION_DET_065_068_oPCAN_RADAR_2e822a50_Rx: ComBitPosition=304, ComBitSize=6, ComSignalType=UINT8, ComSystemTemplateSystemSignalRef=DET_ELEVATION_ERR_067_Rx
            DET_ELEVATION_ERR_068_Rx_oRDR_FUSION_DET_065_068_oPCAN_RADAR_aecc58f8_Rx: ComBitPosition=416, ComBitSize=6, ComSignalType=UINT8, ComSystemTemplateSystemSignalRef=DET_ELEVATION_ERR_068_Rx
            DET_EXISTENCE_PROB_065_Rx_oRDR_FUSION_DET_065_068_oPCAN_RADAR_5c62700a_Rx: ComBitPosition=112, ComBitSize=6, ComSignalType=UINT8, ComSystemTemplateSystemSignalRef=DET_EXISTENCE_PROB_065_Rx
            DET_EXISTENCE_PROB_066_Rx_oRDR_FUSION_DET_065_068_oPCAN_RADAR_76dec082_Rx: ComBitPosition=224, ComBitSize=6, ComSignalType=UINT8, ComSystemTemplateSystemSignalRef=DET_EXISTENCE_PROB_066_Rx
            DET_EXISTENCE_PROB_067_Rx_oRDR_FUSION_DET_065_068_oPCAN_RADAR_d99a52c5_Rx: ComBitPosition=336, ComBitSize=6, ComSignalType=UINT8, ComSystemTemplateSystemSignalRef=DET_EXISTENCE_PROB_067_Rx
            DET_EXISTENCE_PROB_068_Rx_oRDR_FUSION_DET_065_068_oPCAN_RADAR_59d4206d_Rx: ComBitPosition=448, ComBitSize=6, ComSignalType=UINT8, ComSystemTemplateSystemSignalRef=DET_EXISTENCE_PROB_068_Rx
            DET_HVC_FLAG_065_Rx_oRDR_FUSION_DET_065_068_oPCAN_RADAR_81bc9d45_Rx: ComBitPosition=86, ComBitSize=1, ComSignalType=BOOLEAN, ComSystemTemplateSystemSignalRef=DET_HVC_FLAG_065_Rx
            DET_HVC_FLAG_066_Rx_oRDR_FUSION_DET_065_068_oPCAN_RADAR_ab002dcd_Rx: ComBitPosition=198, ComBitSize=1, ComSignalType=BOOLEAN, ComSystemTemplateSystemSignalRef=DET_HVC_FLAG_066_Rx
            DET_HVC_FLAG_067_Rx_oRDR_FUSION_DET_065_068_oPCAN_RADAR_0444bf8a_Rx: ComBitPosition=310, ComBitSize=1, ComSignalType=BOOLEAN, ComSystemTemplateSystemSignalRef=DET_HVC_FLAG_067_Rx
            DET_HVC_FLAG_068_Rx_oRDR_FUSION_DET_065_068_oPCAN_RADAR_840acd22_Rx: ComBitPosition=422, ComBitSize=1, ComSignalType=BOOLEAN, ComSystemTemplateSystemSignalRef=DET_HVC_FLAG_068_Rx
            DET_IDM_065_Rx_oRDR_FUSION_DET_065_068_oPCAN_RADAR_b47d640d_Rx: ComBitPosition=63, ComBitSize=1, ComSignalType=BOOLEAN, ComSystemTemplateSystemSignalRef=DET_IDM_065_Rx
            DET_IDM_066_Rx_oRDR_FUSION_DET_065_068_oPCAN_RADAR_9ec1d485_Rx: ComBitPosition=175, ComBitSize=1, ComSignalType=BOOLEAN, ComSystemTemplateSystemSignalRef=DET_IDM_066_Rx
            DET_IDM_067_Rx_oRDR_FUSION_DET_065_068_oPCAN_RADAR_318546c2_Rx: ComBitPosition=287, ComBitSize=1, ComSignalType=BOOLEAN, ComSystemTemplateSystemSignalRef=DET_IDM_067_Rx
            DET_IDM_068_Rx_oRDR_FUSION_DET_065_068_oPCAN_RADAR_b1cb346a_Rx: ComBitPosition=399, ComBitSize=1, ComSignalType=BOOLEAN, ComSystemTemplateSystemSignalRef=DET_IDM_068_Rx
            DET_MH_CRC16_065_068_Rx_oRDR_FUSION_DET_065_068_oPCAN_RADAR_00da0901_Rx: ComBitPosition=0, ComBitSize=16, ComSignalType=UINT16, ComSystemTemplateSystemSignalRef=DET_MH_CRC16_065_068_Rx
            DET_MH_CYCLE_COUNTER_065_068_Rx_oRDR_FUSION_DET_065_068_oPCAN_RADAR_0d0134c4_Rx: ComBitPosition=16, ComBitSize=8, ComSignalType=UINT8, ComSystemTemplateSystemSignalRef=DET_MH_CYCLE_COUNTER_065_068_Rx
            DET_MH_SCAN_INDEX_4LSB_065_068_Rx_oRDR_FUSION_DET_065_068_oPCAN_RADAR_69b1fbff_Rx: ComBitPosition=476, ComBitSize=4, ComSignalType=UINT8, ComSystemTemplateSystemSignalRef=DET_MH_SCAN_INDEX_4LSB_065_068_Rx
            DET_MTD_065_Rx_oRDR_FUSION_DET_065_068_oPCAN_RADAR_09fe527d_Rx: ComBitPosition=47, ComBitSize=1, ComSignalType=BOOLEAN, ComSystemTemplateSystemSignalRef=DET_MTD_065_Rx
            DET_MTD_066_Rx_oRDR_FUSION_DET_065_068_oPCAN_RADAR_2342e2f5_Rx: ComBitPosition=159, ComBitSize=1, ComSignalType=BOOLEAN, ComSystemTemplateSystemSignalRef=DET_MTD_066_Rx
            DET_MTD_067_Rx_oRDR_FUSION_DET_065_068_oPCAN_RADAR_8c0670b2_Rx: ComBitPosition=271, ComBitSize=1, ComSignalType=BOOLEAN, ComSystemTemplateSystemSignalRef=DET_MTD_067_Rx
            DET_MTD_068_Rx_oRDR_FUSION_DET_065_068_oPCAN_RADAR_0c48021a_Rx: ComBitPosition=383, ComBitSize=1, ComSignalType=BOOLEAN, ComSystemTemplateSystemSignalRef=DET_MTD_068_Rx
            DET_PROB_1STAZHYPO_065_Rx_oRDR_FUSION_DET_065_068_oPCAN_RADAR_c3874cfc_Rx: ComBitPosition=103, ComBitSize=1, ComSignalType=BOOLEAN, ComSystemTemplateSystemSignalRef=DET_PROB_1STAZHYPO_065_Rx
            DET_PROB_1STAZHYPO_066_Rx_oRDR_FUSION_DET_065_068_oPCAN_RADAR_e93bfc74_Rx: ComBitPosition=215, ComBitSize=1, ComSignalType=BOOLEAN, ComSystemTemplateSystemSignalRef=DET_PROB_1STAZHYPO_066_Rx
            DET_PROB_1STAZHYPO_067_Rx_oRDR_FUSION_DET_065_068_oPCAN_RADAR_467f6e33_Rx: ComBitPosition=327, ComBitSize=1, ComSignalType=BOOLEAN, ComSystemTemplateSystemSignalRef=DET_PROB_1STAZHYPO_067_Rx
            DET_PROB_1STAZHYPO_068_Rx_oRDR_FUSION_DET_065_068_oPCAN_RADAR_c6311c9b_Rx: ComBitPosition=439, ComBitSize=1, ComSignalType=BOOLEAN, ComSystemTemplateSystemSignalRef=DET_PROB_1STAZHYPO_068_Rx
            DET_RANGE_065_Rx_oRDR_FUSION_DET_065_068_oPCAN_RADAR_983aa4eb_Rx: ComBitPosition=24, ComBitSize=15, ComSignalType=UINT16, ComSystemTemplateSystemSignalRef=DET_RANGE_065_Rx
            DET_RANGE_066_Rx_oRDR_FUSION_DET_065_068_oPCAN_RADAR_b2861463_Rx: ComBitPosition=136, ComBitSize=15, ComSignalType=UINT16, ComSystemTemplateSystemSignalRef=DET_RANGE_066_Rx
            DET_RANGE_067_Rx_oRDR_FUSION_DET_065_068_oPCAN_RADAR_1dc28624_Rx: ComBitPosition=248, ComBitSize=15, ComSignalType=UINT16, ComSystemTemplateSystemSignalRef=DET_RANGE_067_Rx
            DET_RANGE_068_Rx_oRDR_FUSION_DET_065_068_oPCAN_RADAR_9d8cf48c_Rx: ComBitPosition=360, ComBitSize=15, ComSignalType=UINT16, ComSystemTemplateSystemSignalRef=DET_RANGE_068_Rx
            DET_RANGE_ERR_065_Rx_oRDR_FUSION_DET_065_068_oPCAN_RADAR_c8c8280b_Rx: ComBitPosition=40, ComBitSize=7, ComSignalType=UINT8, ComSystemTemplateSystemSignalRef=DET_RANGE_ERR_065_Rx
            DET_RANGE_ERR_066_Rx_oRDR_FUSION_DET_065_068_oPCAN_RADAR_e2749883_Rx: ComBitPosition=152, ComBitSize=7, ComSignalType=UINT8, ComSystemTemplateSystemSignalRef=DET_RANGE_ERR_066_Rx
            DET_RANGE_ERR_067_Rx_oRDR_FUSION_DET_065_068_oPCAN_RADAR_4d300ac4_Rx: ComBitPosition=264, ComBitSize=7, ComSignalType=UINT8, ComSystemTemplateSystemSignalRef=DET_RANGE_ERR_067_Rx
            DET_RANGE_ERR_068_Rx_oRDR_FUSION_DET_065_068_oPCAN_RADAR_cd7e786c_Rx: ComBitPosition=376, ComBitSize=7, ComSignalType=UINT8, ComSystemTemplateSystemSignalRef=DET_RANGE_ERR_068_Rx
            DET_RANGE_VELOCITY_065_Rx_oRDR_FUSION_DET_065_068_oPCAN_RADAR_45cf2715_Rx: ComBitPosition=48, ComBitSize=15, ComSignalType=UINT16, ComSystemTemplateSystemSignalRef=DET_RANGE_VELOCITY_065_Rx
            DET_RANGE_VELOCITY_066_Rx_oRDR_FUSION_DET_065_068_oPCAN_RADAR_6f73979d_Rx: ComBitPosition=160, ComBitSize=15, ComSignalType=UINT16, ComSystemTemplateSystemSignalRef=DET_RANGE_VELOCITY_066_Rx
            DET_RANGE_VELOCITY_067_Rx_oRDR_FUSION_DET_065_068_oPCAN_RADAR_c03705da_Rx: ComBitPosition=272, ComBitSize=15, ComSignalType=UINT16, ComSystemTemplateSystemSignalRef=DET_RANGE_VELOCITY_067_Rx
            DET_RANGE_VELOCITY_068_Rx_oRDR_FUSION_DET_065_068_oPCAN_RADAR_40797772_Rx: ComBitPosition=384, ComBitSize=15, ComSignalType=UINT16, ComSystemTemplateSystemSignalRef=DET_RANGE_VELOCITY_068_Rx
            DET_RANGE_VELOCITY_ERR_065_Rx_oRDR_FUSION_DET_065_068_oPCAN_RADAR_dcab57d7_Rx: ComBitPosition=64, ComBitSize=8, ComSignalType=UINT8, ComSystemTemplateSystemSignalRef=DET_RANGE_VELOCITY_ERR_065_Rx
            DET_RANGE_VELOCITY_ERR_066_Rx_oRDR_FUSION_DET_065_068_oPCAN_RADAR_f617e75f_Rx: ComBitPosition=176, ComBitSize=8, ComSignalType=UINT8, ComSystemTemplateSystemSignalRef=DET_RANGE_VELOCITY_ERR_066_Rx
            DET_RANGE_VELOCITY_ERR_067_Rx_oRDR_FUSION_DET_065_068_oPCAN_RADAR_59537518_Rx: ComBitPosition=288, ComBitSize=8, ComSignalType=UINT8, ComSystemTemplateSystemSignalRef=DET_RANGE_VELOCITY_ERR_067_Rx
            DET_RANGE_VELOCITY_ERR_068_Rx_oRDR_FUSION_DET_065_068_oPCAN_RADAR_d91d07b0_Rx: ComBitPosition=400, ComBitSize=8, ComSignalType=UINT8, ComSystemTemplateSystemSignalRef=DET_RANGE_VELOCITY_ERR_068_Rx
            DET_RCS_065_Rx_oRDR_FUSION_DET_065_068_oPCAN_RADAR_8804b50e_Rx: ComBitPosition=128, ComBitSize=8, ComSignalType=UINT8, ComSystemTemplateSystemSignalRef=DET_RCS_065_Rx
            DET_RCS_066_Rx_oRDR_FUSION_DET_065_068_oPCAN_RADAR_a2b80586_Rx: ComBitPosition=240, ComBitSize=8, ComSignalType=UINT8, ComSystemTemplateSystemSignalRef=DET_RCS_066_Rx
            DET_RCS_067_Rx_oRDR_FUSION_DET_065_068_oPCAN_RADAR_0dfc97c1_Rx: ComBitPosition=352, ComBitSize=8, ComSignalType=UINT8, ComSystemTemplateSystemSignalRef=DET_RCS_067_Rx
            DET_RCS_068_Rx_oRDR_FUSION_DET_065_068_oPCAN_RADAR_8db2e569_Rx: ComBitPosition=464, ComBitSize=8, ComSignalType=UINT8, ComSystemTemplateSystemSignalRef=DET_RCS_068_Rx
            DET_SNR_065_Rx_oRDR_FUSION_DET_065_068_oPCAN_RADAR_815ec4e7_Rx: ComBitPosition=120, ComBitSize=8, ComSignalType=UINT8, ComSystemTemplateSystemSignalRef=DET_SNR_065_Rx
            DET_SNR_066_Rx_oRDR_FUSION_DET_065_068_oPCAN_RADAR_abe2746f_Rx: ComBitPosition=232, ComBitSize=8, ComSignalType=UINT8, ComSystemTemplateSystemSignalRef=DET_SNR_066_Rx
            DET_SNR_067_Rx_oRDR_FUSION_DET_065_068_oPCAN_RADAR_04a6e628_Rx: ComBitPosition=344, ComBitSize=8, ComSignalType=UINT8, ComSystemTemplateSystemSignalRef=DET_SNR_067_Rx
            DET_SNR_068_Rx_oRDR_FUSION_DET_065_068_oPCAN_RADAR_84e89480_Rx: ComBitPosition=456, ComBitSize=8, ComSignalType=UINT8, ComSystemTemplateSystemSignalRef=DET_SNR_068_Rx
            DET_SUPER_RES_TARGET_065_Rx_oRDR_FUSION_DET_065_068_oPCAN_RADAR_4aa5e5e7_Rx: ComBitPosition=87, ComBitSize=1, ComSignalType=BOOLEAN, ComSystemTemplateSystemSignalRef=DET_SUPER_RES_TARGET_065_Rx
            DET_SUPER_RES_TARGET_066_Rx_oRDR_FUSION_DET_065_068_oPCAN_RADAR_6019556f_Rx: ComBitPosition=199, ComBitSize=1, ComSignalType=BOOLEAN, ComSystemTemplateSystemSignalRef=DET_SUPER_RES_TARGET_066_Rx
            DET_SUPER_RES_TARGET_067_Rx_oRDR_FUSION_DET_065_068_oPCAN_RADAR_cf5dc728_Rx: ComBitPosition=311, ComBitSize=1, ComSignalType=BOOLEAN, ComSystemTemplateSystemSignalRef=DET_SUPER_RES_TARGET_067_Rx
            DET_SUPER_RES_TARGET_068_Rx_oRDR_FUSION_DET_065_068_oPCAN_RADAR_4f13b580_Rx: ComBitPosition=423, ComBitSize=1, ComSignalType=BOOLEAN, ComSystemTemplateSystemSignalRef=DET_SUPER_RES_TARGET_068_Rx
        SG_Fusion_Detections_069_072_oRDR_FUSION_DET_069_072_oPCAN_RADAR_98a9029f_Rx: ComTimeout=0, ComSystemTemplateSignalGroupRef=SG_Fusion_Detections_069_072
          83 x ComGroupSignal, all with ComSignalEndianness=LITTLE_ENDIAN, ComSignalInitValue=0:
            DET_AZIMUTH_069_Rx_oRDR_FUSION_DET_069_072_oPCAN_RADAR_1346d5ed_Rx: ComBitPosition=88, ComBitSize=13, ComSignalType=UINT16, ComSystemTemplateSystemSignalRef=DET_AZIMUTH_069_Rx
            DET_AZIMUTH_070_Rx_oRDR_FUSION_DET_069_072_oPCAN_RADAR_2e6656f4_Rx: ComBitPosition=200, ComBitSize=13, ComSignalType=UINT16, ComSystemTemplateSystemSignalRef=DET_AZIMUTH_070_Rx
            DET_AZIMUTH_071_Rx_oRDR_FUSION_DET_069_072_oPCAN_RADAR_8122c4b3_Rx: ComBitPosition=312, ComBitSize=13, ComSignalType=UINT16, ComSystemTemplateSystemSignalRef=DET_AZIMUTH_071_Rx
            DET_AZIMUTH_072_Rx_oRDR_FUSION_DET_069_072_oPCAN_RADAR_ab9e743b_Rx: ComBitPosition=424, ComBitSize=13, ComSignalType=UINT16, ComSystemTemplateSystemSignalRef=DET_AZIMUTH_072_Rx
            DET_AZIMUTH_ERR_069_Rx_oRDR_FUSION_DET_069_072_oPCAN_RADAR_112f746f_Rx: ComBitPosition=105, ComBitSize=7, ComSignalType=UINT8, ComSystemTemplateSystemSignalRef=DET_AZIMUTH_ERR_069_Rx
            DET_AZIMUTH_ERR_070_Rx_oRDR_FUSION_DET_069_072_oPCAN_RADAR_2c0ff776_Rx: ComBitPosition=217, ComBitSize=7, ComSignalType=UINT8, ComSystemTemplateSystemSignalRef=DET_AZIMUTH_ERR_070_Rx
            DET_AZIMUTH_ERR_071_Rx_oRDR_FUSION_DET_069_072_oPCAN_RADAR_834b6531_Rx: ComBitPosition=329, ComBitSize=7, ComSignalType=UINT8, ComSystemTemplateSystemSignalRef=DET_AZIMUTH_ERR_071_Rx
            DET_AZIMUTH_ERR_072_Rx_oRDR_FUSION_DET_069_072_oPCAN_RADAR_a9f7d5b9_Rx: ComBitPosition=441, ComBitSize=7, ComSignalType=UINT8, ComSystemTemplateSystemSignalRef=DET_AZIMUTH_ERR_072_Rx
            DET_BELOW_RAIN_THOLD_069_Rx_oRDR_FUSION_DET_069_072_oPCAN_RADAR_75fc2a58_Rx: ComBitPosition=39, ComBitSize=1, ComSignalType=BOOLEAN, ComSystemTemplateSystemSignalRef=DET_BELOW_RAIN_THOLD_069_Rx
            DET_BELOW_RAIN_THOLD_070_Rx_oRDR_FUSION_DET_069_072_oPCAN_RADAR_48dca941_Rx: ComBitPosition=151, ComBitSize=1, ComSignalType=BOOLEAN, ComSystemTemplateSystemSignalRef=DET_BELOW_RAIN_THOLD_070_Rx
            DET_BELOW_RAIN_THOLD_071_Rx_oRDR_FUSION_DET_069_072_oPCAN_RADAR_e7983b06_Rx: ComBitPosition=263, ComBitSize=1, ComSignalType=BOOLEAN, ComSystemTemplateSystemSignalRef=DET_BELOW_RAIN_THOLD_071_Rx
            DET_BELOW_RAIN_THOLD_072_Rx_oRDR_FUSION_DET_069_072_oPCAN_RADAR_cd248b8e_Rx: ComBitPosition=375, ComBitSize=1, ComSignalType=BOOLEAN, ComSystemTemplateSystemSignalRef=DET_BELOW_RAIN_THOLD_072_Rx
            DET_BI_STATIC_FLAG_069_Rx_oRDR_FUSION_DET_069_072_oPCAN_RADAR_0262814b_Rx: ComBitPosition=104, ComBitSize=1, ComSignalType=BOOLEAN, ComSystemTemplateSystemSignalRef=DET_BI_STATIC_FLAG_069_Rx
            DET_BI_STATIC_FLAG_070_Rx_oRDR_FUSION_DET_069_072_oPCAN_RADAR_3f420252_Rx: ComBitPosition=216, ComBitSize=1, ComSignalType=BOOLEAN, ComSystemTemplateSystemSignalRef=DET_BI_STATIC_FLAG_070_Rx
            DET_BI_STATIC_FLAG_071_Rx_oRDR_FUSION_DET_069_072_oPCAN_RADAR_90069015_Rx: ComBitPosition=328, ComBitSize=1, ComSignalType=BOOLEAN, ComSystemTemplateSystemSignalRef=DET_BI_STATIC_FLAG_071_Rx
            DET_BI_STATIC_FLAG_072_Rx_oRDR_FUSION_DET_069_072_oPCAN_RADAR_baba209d_Rx: ComBitPosition=440, ComBitSize=1, ComSignalType=BOOLEAN, ComSystemTemplateSystemSignalRef=DET_BI_STATIC_FLAG_072_Rx
            DET_CONFD_AZIMUTH_069_Rx_oRDR_FUSION_DET_069_072_oPCAN_RADAR_e10b6b1f_Rx: ComBitPosition=118, ComBitSize=2, ComSignalType=UINT8, ComSystemTemplateSystemSignalRef=DET_CONFD_AZIMUTH_069_Rx
            DET_CONFD_AZIMUTH_070_Rx_oRDR_FUSION_DET_069_072_oPCAN_RADAR_dc2be806_Rx: ComBitPosition=230, ComBitSize=2, ComSignalType=UINT8, ComSystemTemplateSystemSignalRef=DET_CONFD_AZIMUTH_070_Rx
            DET_CONFD_AZIMUTH_071_Rx_oRDR_FUSION_DET_069_072_oPCAN_RADAR_736f7a41_Rx: ComBitPosition=342, ComBitSize=2, ComSignalType=UINT8, ComSystemTemplateSystemSignalRef=DET_CONFD_AZIMUTH_071_Rx
            DET_CONFD_AZIMUTH_072_Rx_oRDR_FUSION_DET_069_072_oPCAN_RADAR_59d3cac9_Rx: ComBitPosition=454, ComBitSize=2, ComSignalType=UINT8, ComSystemTemplateSystemSignalRef=DET_CONFD_AZIMUTH_072_Rx
            DET_CONFD_ELEVATION_069_Rx_oRDR_FUSION_DET_069_072_oPCAN_RADAR_eb2ae898_Rx: ComBitPosition=101, ComBitSize=2, ComSignalType=UINT8, ComSystemTemplateSystemSignalRef=DET_CONFD_ELEVATION_069_Rx
            DET_CONFD_ELEVATION_070_Rx_oRDR_FUSION_DET_069_072_oPCAN_RADAR_d60a6b81_Rx: ComBitPosition=213, ComBitSize=2, ComSignalType=UINT8, ComSystemTemplateSystemSignalRef=DET_CONFD_ELEVATION_070_Rx
            DET_CONFD_ELEVATION_071_Rx_oRDR_FUSION_DET_069_072_oPCAN_RADAR_794ef9c6_Rx: ComBitPosition=325, ComBitSize=2, ComSignalType=UINT8, ComSystemTemplateSystemSignalRef=DET_CONFD_ELEVATION_071_Rx
            DET_CONFD_ELEVATION_072_Rx_oRDR_FUSION_DET_069_072_oPCAN_RADAR_53f2494e_Rx: ComBitPosition=437, ComBitSize=2, ComSignalType=UINT8, ComSystemTemplateSystemSignalRef=DET_CONFD_ELEVATION_072_Rx
            DET_ELEVATION_069_Rx_oRDR_FUSION_DET_069_072_oPCAN_RADAR_e1790761_Rx: ComBitPosition=72, ComBitSize=8, ComSignalType=UINT8, ComSystemTemplateSystemSignalRef=DET_ELEVATION_069_Rx
            DET_ELEVATION_070_Rx_oRDR_FUSION_DET_069_072_oPCAN_RADAR_dc598478_Rx: ComBitPosition=184, ComBitSize=8, ComSignalType=UINT8, ComSystemTemplateSystemSignalRef=DET_ELEVATION_070_Rx
            DET_ELEVATION_071_Rx_oRDR_FUSION_DET_069_072_oPCAN_RADAR_731d163f_Rx: ComBitPosition=296, ComBitSize=8, ComSignalType=UINT8, ComSystemTemplateSystemSignalRef=DET_ELEVATION_071_Rx
            DET_ELEVATION_072_Rx_oRDR_FUSION_DET_069_072_oPCAN_RADAR_59a1a6b7_Rx: ComBitPosition=408, ComBitSize=8, ComSignalType=UINT8, ComSystemTemplateSystemSignalRef=DET_ELEVATION_072_Rx
            DET_ELEVATION_ERR_069_Rx_oRDR_FUSION_DET_069_072_oPCAN_RADAR_33c025be_Rx: ComBitPosition=80, ComBitSize=6, ComSignalType=UINT8, ComSystemTemplateSystemSignalRef=DET_ELEVATION_ERR_069_Rx
            DET_ELEVATION_ERR_070_Rx_oRDR_FUSION_DET_069_072_oPCAN_RADAR_0ee0a6a7_Rx: ComBitPosition=192, ComBitSize=6, ComSignalType=UINT8, ComSystemTemplateSystemSignalRef=DET_ELEVATION_ERR_070_Rx
            DET_ELEVATION_ERR_071_Rx_oRDR_FUSION_DET_069_072_oPCAN_RADAR_a1a434e0_Rx: ComBitPosition=304, ComBitSize=6, ComSignalType=UINT8, ComSystemTemplateSystemSignalRef=DET_ELEVATION_ERR_071_Rx
            DET_ELEVATION_ERR_072_Rx_oRDR_FUSION_DET_069_072_oPCAN_RADAR_8b188468_Rx: ComBitPosition=416, ComBitSize=6, ComSignalType=UINT8, ComSystemTemplateSystemSignalRef=DET_ELEVATION_ERR_072_Rx
            DET_EXISTENCE_PROB_069_Rx_oRDR_FUSION_DET_069_072_oPCAN_RADAR_c4d85d2b_Rx: ComBitPosition=112, ComBitSize=6, ComSignalType=UINT8, ComSystemTemplateSystemSignalRef=DET_EXISTENCE_PROB_069_Rx
            DET_EXISTENCE_PROB_070_Rx_oRDR_FUSION_DET_069_072_oPCAN_RADAR_f9f8de32_Rx: ComBitPosition=224, ComBitSize=6, ComSignalType=UINT8, ComSystemTemplateSystemSignalRef=DET_EXISTENCE_PROB_070_Rx
            DET_EXISTENCE_PROB_071_Rx_oRDR_FUSION_DET_069_072_oPCAN_RADAR_56bc4c75_Rx: ComBitPosition=336, ComBitSize=6, ComSignalType=UINT8, ComSystemTemplateSystemSignalRef=DET_EXISTENCE_PROB_071_Rx
            DET_EXISTENCE_PROB_072_Rx_oRDR_FUSION_DET_069_072_oPCAN_RADAR_7c00fcfd_Rx: ComBitPosition=448, ComBitSize=6, ComSignalType=UINT8, ComSystemTemplateSystemSignalRef=DET_EXISTENCE_PROB_072_Rx
            DET_HVC_FLAG_069_Rx_oRDR_FUSION_DET_069_072_oPCAN_RADAR_1906b064_Rx: ComBitPosition=86, ComBitSize=1, ComSignalType=BOOLEAN, ComSystemTemplateSystemSignalRef=DET_HVC_FLAG_069_Rx
            DET_HVC_FLAG_070_Rx_oRDR_FUSION_DET_069_072_oPCAN_RADAR_2426337d_Rx: ComBitPosition=198, ComBitSize=1, ComSignalType=BOOLEAN, ComSystemTemplateSystemSignalRef=DET_HVC_FLAG_070_Rx
            DET_HVC_FLAG_071_Rx_oRDR_FUSION_DET_069_072_oPCAN_RADAR_8b62a13a_Rx: ComBitPosition=310, ComBitSize=1, ComSignalType=BOOLEAN, ComSystemTemplateSystemSignalRef=DET_HVC_FLAG_071_Rx
            DET_HVC_FLAG_072_Rx_oRDR_FUSION_DET_069_072_oPCAN_RADAR_a1de11b2_Rx: ComBitPosition=422, ComBitSize=1, ComSignalType=BOOLEAN, ComSystemTemplateSystemSignalRef=DET_HVC_FLAG_072_Rx
            DET_IDM_069_Rx_oRDR_FUSION_DET_069_072_oPCAN_RADAR_2cc7492c_Rx: ComBitPosition=63, ComBitSize=1, ComSignalType=BOOLEAN, ComSystemTemplateSystemSignalRef=DET_IDM_069_Rx
            DET_IDM_070_Rx_oRDR_FUSION_DET_069_072_oPCAN_RADAR_11e7ca35_Rx: ComBitPosition=175, ComBitSize=1, ComSignalType=BOOLEAN, ComSystemTemplateSystemSignalRef=DET_IDM_070_Rx
            DET_IDM_071_Rx_oRDR_FUSION_DET_069_072_oPCAN_RADAR_bea35872_Rx: ComBitPosition=287, ComBitSize=1, ComSignalType=BOOLEAN, ComSystemTemplateSystemSignalRef=DET_IDM_071_Rx
            DET_IDM_072_Rx_oRDR_FUSION_DET_069_072_oPCAN_RADAR_941fe8fa_Rx: ComBitPosition=399, ComBitSize=1, ComSignalType=BOOLEAN, ComSystemTemplateSystemSignalRef=DET_IDM_072_Rx
            DET_MH_CRC16_069_072_Rx_oRDR_FUSION_DET_069_072_oPCAN_RADAR_079ef148_Rx: ComBitPosition=0, ComBitSize=16, ComSignalType=UINT16, ComSystemTemplateSystemSignalRef=DET_MH_CRC16_069_072_Rx
            DET_MH_CYCLE_COUNTER_069_072_Rx_oRDR_FUSION_DET_069_072_oPCAN_RADAR_0a45cc8d_Rx: ComBitPosition=16, ComBitSize=8, ComSignalType=UINT8, ComSystemTemplateSystemSignalRef=DET_MH_CYCLE_COUNTER_069_072_Rx
            DET_MH_SCAN_INDEX_4LSB_069_072_Rx_oRDR_FUSION_DET_069_072_oPCAN_RADAR_6ef503b6_Rx: ComBitPosition=476, ComBitSize=4, ComSignalType=UINT8, ComSystemTemplateSystemSignalRef=DET_MH_SCAN_INDEX_4LSB_069_072_Rx
            DET_MTD_069_Rx_oRDR_FUSION_DET_069_072_oPCAN_RADAR_91447f5c_Rx: ComBitPosition=47, ComBitSize=1, ComSignalType=BOOLEAN, ComSystemTemplateSystemSignalRef=DET_MTD_069_Rx
            DET_MTD_070_Rx_oRDR_FUSION_DET_069_072_oPCAN_RADAR_ac64fc45_Rx: ComBitPosition=159, ComBitSize=1, ComSignalType=BOOLEAN, ComSystemTemplateSystemSignalRef=DET_MTD_070_Rx
            DET_MTD_071_Rx_oRDR_FUSION_DET_069_072_oPCAN_RADAR_03206e02_Rx: ComBitPosition=271, ComBitSize=1, ComSignalType=BOOLEAN, ComSystemTemplateSystemSignalRef=DET_MTD_071_Rx
            DET_MTD_072_Rx_oRDR_FUSION_DET_069_072_oPCAN_RADAR_299cde8a_Rx: ComBitPosition=383, ComBitSize=1, ComSignalType=BOOLEAN, ComSystemTemplateSystemSignalRef=DET_MTD_072_Rx
            DET_PROB_1STAZHYPO_069_Rx_oRDR_FUSION_DET_069_072_oPCAN_RADAR_5b3d61dd_Rx: ComBitPosition=103, ComBitSize=1, ComSignalType=BOOLEAN, ComSystemTemplateSystemSignalRef=DET_PROB_1STAZHYPO_069_Rx
            DET_PROB_1STAZHYPO_070_Rx_oRDR_FUSION_DET_069_072_oPCAN_RADAR_661de2c4_Rx: ComBitPosition=215, ComBitSize=1, ComSignalType=BOOLEAN, ComSystemTemplateSystemSignalRef=DET_PROB_1STAZHYPO_070_Rx
            DET_PROB_1STAZHYPO_071_Rx_oRDR_FUSION_DET_069_072_oPCAN_RADAR_c9597083_Rx: ComBitPosition=327, ComBitSize=1, ComSignalType=BOOLEAN, ComSystemTemplateSystemSignalRef=DET_PROB_1STAZHYPO_071_Rx
            DET_PROB_1STAZHYPO_072_Rx_oRDR_FUSION_DET_069_072_oPCAN_RADAR_e3e5c00b_Rx: ComBitPosition=439, ComBitSize=1, ComSignalType=BOOLEAN, ComSystemTemplateSystemSignalRef=DET_PROB_1STAZHYPO_072_Rx
            DET_RANGE_069_Rx_oRDR_FUSION_DET_069_072_oPCAN_RADAR_008089ca_Rx: ComBitPosition=24, ComBitSize=15, ComSignalType=UINT16, ComSystemTemplateSystemSignalRef=DET_RANGE_069_Rx
            DET_RANGE_070_Rx_oRDR_FUSION_DET_069_072_oPCAN_RADAR_3da00ad3_Rx: ComBitPosition=136, ComBitSize=15, ComSignalType=UINT16, ComSystemTemplateSystemSignalRef=DET_RANGE_070_Rx
            DET_RANGE_071_Rx_oRDR_FUSION_DET_069_072_oPCAN_RADAR_92e49894_Rx: ComBitPosition=248, ComBitSize=15, ComSignalType=UINT16, ComSystemTemplateSystemSignalRef=DET_RANGE_071_Rx
            DET_RANGE_072_Rx_oRDR_FUSION_DET_069_072_oPCAN_RADAR_b858281c_Rx: ComBitPosition=360, ComBitSize=15, ComSignalType=UINT16, ComSystemTemplateSystemSignalRef=DET_RANGE_072_Rx
            DET_RANGE_ERR_069_Rx_oRDR_FUSION_DET_069_072_oPCAN_RADAR_5072052a_Rx: ComBitPosition=40, ComBitSize=7, ComSignalType=UINT8, ComSystemTemplateSystemSignalRef=DET_RANGE_ERR_069_Rx
            DET_RANGE_ERR_070_Rx_oRDR_FUSION_DET_069_072_oPCAN_RADAR_6d528633_Rx: ComBitPosition=152, ComBitSize=7, ComSignalType=UINT8, ComSystemTemplateSystemSignalRef=DET_RANGE_ERR_070_Rx
            DET_RANGE_ERR_071_Rx_oRDR_FUSION_DET_069_072_oPCAN_RADAR_c2161474_Rx: ComBitPosition=264, ComBitSize=7, ComSignalType=UINT8, ComSystemTemplateSystemSignalRef=DET_RANGE_ERR_071_Rx
            DET_RANGE_ERR_072_Rx_oRDR_FUSION_DET_069_072_oPCAN_RADAR_e8aaa4fc_Rx: ComBitPosition=376, ComBitSize=7, ComSignalType=UINT8, ComSystemTemplateSystemSignalRef=DET_RANGE_ERR_072_Rx
            DET_RANGE_VELOCITY_069_Rx_oRDR_FUSION_DET_069_072_oPCAN_RADAR_dd750a34_Rx: ComBitPosition=48, ComBitSize=15, ComSignalType=UINT16, ComSystemTemplateSystemSignalRef=DET_RANGE_VELOCITY_069_Rx
            DET_RANGE_VELOCITY_070_Rx_oRDR_FUSION_DET_069_072_oPCAN_RADAR_e055892d_Rx: ComBitPosition=160, ComBitSize=15, ComSignalType=UINT16, ComSystemTemplateSystemSignalRef=DET_RANGE_VELOCITY_070_Rx
            DET_RANGE_VELOCITY_071_Rx_oRDR_FUSION_DET_069_072_oPCAN_RADAR_4f111b6a_Rx: ComBitPosition=272, ComBitSize=15, ComSignalType=UINT16, ComSystemTemplateSystemSignalRef=DET_RANGE_VELOCITY_071_Rx
            DET_RANGE_VELOCITY_072_Rx_oRDR_FUSION_DET_069_072_oPCAN_RADAR_65adabe2_Rx: ComBitPosition=384, ComBitSize=15, ComSignalType=UINT16, ComSystemTemplateSystemSignalRef=DET_RANGE_VELOCITY_072_Rx
            DET_RANGE_VELOCITY_ERR_069_Rx_oRDR_FUSION_DET_069_072_oPCAN_RADAR_44117af6_Rx: ComBitPosition=64, ComBitSize=8, ComSignalType=UINT8, ComSystemTemplateSystemSignalRef=DET_RANGE_VELOCITY_ERR_069_Rx
            DET_RANGE_VELOCITY_ERR_070_Rx_oRDR_FUSION_DET_069_072_oPCAN_RADAR_7931f9ef_Rx: ComBitPosition=176, ComBitSize=8, ComSignalType=UINT8, ComSystemTemplateSystemSignalRef=DET_RANGE_VELOCITY_ERR_070_Rx
            DET_RANGE_VELOCITY_ERR_071_Rx_oRDR_FUSION_DET_069_072_oPCAN_RADAR_d6756ba8_Rx: ComBitPosition=288, ComBitSize=8, ComSignalType=UINT8, ComSystemTemplateSystemSignalRef=DET_RANGE_VELOCITY_ERR_071_Rx
            DET_RANGE_VELOCITY_ERR_072_Rx_oRDR_FUSION_DET_069_072_oPCAN_RADAR_fcc9db20_Rx: ComBitPosition=400, ComBitSize=8, ComSignalType=UINT8, ComSystemTemplateSystemSignalRef=DET_RANGE_VELOCITY_ERR_072_Rx
            DET_RCS_069_Rx_oRDR_FUSION_DET_069_072_oPCAN_RADAR_10be982f_Rx: ComBitPosition=128, ComBitSize=8, ComSignalType=UINT8, ComSystemTemplateSystemSignalRef=DET_RCS_069_Rx
            DET_RCS_070_Rx_oRDR_FUSION_DET_069_072_oPCAN_RADAR_2d9e1b36_Rx: ComBitPosition=240, ComBitSize=8, ComSignalType=UINT8, ComSystemTemplateSystemSignalRef=DET_RCS_070_Rx
            DET_RCS_071_Rx_oRDR_FUSION_DET_069_072_oPCAN_RADAR_82da8971_Rx: ComBitPosition=352, ComBitSize=8, ComSignalType=UINT8, ComSystemTemplateSystemSignalRef=DET_RCS_071_Rx
            DET_RCS_072_Rx_oRDR_FUSION_DET_069_072_oPCAN_RADAR_a86639f9_Rx: ComBitPosition=464, ComBitSize=8, ComSignalType=UINT8, ComSystemTemplateSystemSignalRef=DET_RCS_072_Rx
            DET_SNR_069_Rx_oRDR_FUSION_DET_069_072_oPCAN_RADAR_19e4e9c6_Rx: ComBitPosition=120, ComBitSize=8, ComSignalType=UINT8, ComSystemTemplateSystemSignalRef=DET_SNR_069_Rx
            DET_SNR_070_Rx_oRDR_FUSION_DET_069_072_oPCAN_RADAR_24c46adf_Rx: ComBitPosition=232, ComBitSize=8, ComSignalType=UINT8, ComSystemTemplateSystemSignalRef=DET_SNR_070_Rx
            DET_SNR_071_Rx_oRDR_FUSION_DET_069_072_oPCAN_RADAR_8b80f898_Rx: ComBitPosition=344, ComBitSize=8, ComSignalType=UINT8, ComSystemTemplateSystemSignalRef=DET_SNR_071_Rx
            DET_SNR_072_Rx_oRDR_FUSION_DET_069_072_oPCAN_RADAR_a13c4810_Rx: ComBitPosition=456, ComBitSize=8, ComSignalType=UINT8, ComSystemTemplateSystemSignalRef=DET_SNR_072_Rx
            DET_SUPER_RES_TARGET_069_Rx_oRDR_FUSION_DET_069_072_oPCAN_RADAR_d21fc8c6_Rx: ComBitPosition=87, ComBitSize=1, ComSignalType=BOOLEAN, ComSystemTemplateSystemSignalRef=DET_SUPER_RES_TARGET_069_Rx
            DET_SUPER_RES_TARGET_070_Rx_oRDR_FUSION_DET_069_072_oPCAN_RADAR_ef3f4bdf_Rx: ComBitPosition=199, ComBitSize=1, ComSignalType=BOOLEAN, ComSystemTemplateSystemSignalRef=DET_SUPER_RES_TARGET_070_Rx
            DET_SUPER_RES_TARGET_071_Rx_oRDR_FUSION_DET_069_072_oPCAN_RADAR_407bd998_Rx: ComBitPosition=311, ComBitSize=1, ComSignalType=BOOLEAN, ComSystemTemplateSystemSignalRef=DET_SUPER_RES_TARGET_071_Rx
            DET_SUPER_RES_TARGET_072_Rx_oRDR_FUSION_DET_069_072_oPCAN_RADAR_6ac76910_Rx: ComBitPosition=423, ComBitSize=1, ComSignalType=BOOLEAN, ComSystemTemplateSystemSignalRef=DET_SUPER_RES_TARGET_072_Rx
        SG_Fusion_Detections_073_076_oRDR_FUSION_DET_073_076_oPCAN_RADAR_6c2268ef_Rx: ComTimeout=0, ComSystemTemplateSignalGroupRef=SG_Fusion_Detections_073_076
          83 x ComGroupSignal, all with ComSignalEndianness=LITTLE_ENDIAN, ComSignalInitValue=0:
            DET_AZIMUTH_073_Rx_oRDR_FUSION_DET_073_076_oPCAN_RADAR_191de552_Rx: ComBitPosition=88, ComBitSize=13, ComSignalType=UINT16, ComSystemTemplateSystemSignalRef=DET_AZIMUTH_073_Rx
            DET_AZIMUTH_074_Rx_oRDR_FUSION_DET_073_076_oPCAN_RADAR_e3201605_Rx: ComBitPosition=200, ComBitSize=13, ComSignalType=UINT16, ComSystemTemplateSystemSignalRef=DET_AZIMUTH_074_Rx
            DET_AZIMUTH_075_Rx_oRDR_FUSION_DET_073_076_oPCAN_RADAR_4c648442_Rx: ComBitPosition=312, ComBitSize=13, ComSignalType=UINT16, ComSystemTemplateSystemSignalRef=DET_AZIMUTH_075_Rx
            DET_AZIMUTH_076_Rx_oRDR_FUSION_DET_073_076_oPCAN_RADAR_66d834ca_Rx: ComBitPosition=424, ComBitSize=13, ComSignalType=UINT16, ComSystemTemplateSystemSignalRef=DET_AZIMUTH_076_Rx
            DET_AZIMUTH_ERR_073_Rx_oRDR_FUSION_DET_073_076_oPCAN_RADAR_1b7444d0_Rx: ComBitPosition=105, ComBitSize=7, ComSignalType=UINT8, ComSystemTemplateSystemSignalRef=DET_AZIMUTH_ERR_073_Rx
            DET_AZIMUTH_ERR_074_Rx_oRDR_FUSION_DET_073_076_oPCAN_RADAR_e149b787_Rx: ComBitPosition=217, ComBitSize=7, ComSignalType=UINT8, ComSystemTemplateSystemSignalRef=DET_AZIMUTH_ERR_074_Rx
            DET_AZIMUTH_ERR_075_Rx_oRDR_FUSION_DET_073_076_oPCAN_RADAR_4e0d25c0_Rx: ComBitPosition=329, ComBitSize=7, ComSignalType=UINT8, ComSystemTemplateSystemSignalRef=DET_AZIMUTH_ERR_075_Rx
            DET_AZIMUTH_ERR_076_Rx_oRDR_FUSION_DET_073_076_oPCAN_RADAR_64b19548_Rx: ComBitPosition=441, ComBitSize=7, ComSignalType=UINT8, ComSystemTemplateSystemSignalRef=DET_AZIMUTH_ERR_076_Rx
            DET_BELOW_RAIN_THOLD_073_Rx_oRDR_FUSION_DET_073_076_oPCAN_RADAR_7fa71ae7_Rx: ComBitPosition=39, ComBitSize=1, ComSignalType=BOOLEAN, ComSystemTemplateSystemSignalRef=DET_BELOW_RAIN_THOLD_073_Rx
            DET_BELOW_RAIN_THOLD_074_Rx_oRDR_FUSION_DET_073_076_oPCAN_RADAR_859ae9b0_Rx: ComBitPosition=151, ComBitSize=1, ComSignalType=BOOLEAN, ComSystemTemplateSystemSignalRef=DET_BELOW_RAIN_THOLD_074_Rx
            DET_BELOW_RAIN_THOLD_075_Rx_oRDR_FUSION_DET_073_076_oPCAN_RADAR_2ade7bf7_Rx: ComBitPosition=263, ComBitSize=1, ComSignalType=BOOLEAN, ComSystemTemplateSystemSignalRef=DET_BELOW_RAIN_THOLD_075_Rx
            DET_BELOW_RAIN_THOLD_076_Rx_oRDR_FUSION_DET_073_076_oPCAN_RADAR_0062cb7f_Rx: ComBitPosition=375, ComBitSize=1, ComSignalType=BOOLEAN, ComSystemTemplateSystemSignalRef=DET_BELOW_RAIN_THOLD_076_Rx
            DET_BI_STATIC_FLAG_073_Rx_oRDR_FUSION_DET_073_076_oPCAN_RADAR_0839b1f4_Rx: ComBitPosition=104, ComBitSize=1, ComSignalType=BOOLEAN, ComSystemTemplateSystemSignalRef=DET_BI_STATIC_FLAG_073_Rx
            DET_BI_STATIC_FLAG_074_Rx_oRDR_FUSION_DET_073_076_oPCAN_RADAR_f20442a3_Rx: ComBitPosition=216, ComBitSize=1, ComSignalType=BOOLEAN, ComSystemTemplateSystemSignalRef=DET_BI_STATIC_FLAG_074_Rx
            DET_BI_STATIC_FLAG_075_Rx_oRDR_FUSION_DET_073_076_oPCAN_RADAR_5d40d0e4_Rx: ComBitPosition=328, ComBitSize=1, ComSignalType=BOOLEAN, ComSystemTemplateSystemSignalRef=DET_BI_STATIC_FLAG_075_Rx
            DET_BI_STATIC_FLAG_076_Rx_oRDR_FUSION_DET_073_076_oPCAN_RADAR_77fc606c_Rx: ComBitPosition=440, ComBitSize=1, ComSignalType=BOOLEAN, ComSystemTemplateSystemSignalRef=DET_BI_STATIC_FLAG_076_Rx
            DET_CONFD_AZIMUTH_073_Rx_oRDR_FUSION_DET_073_076_oPCAN_RADAR_eb505ba0_Rx: ComBitPosition=118, ComBitSize=2, ComSignalType=UINT8, ComSystemTemplateSystemSignalRef=DET_CONFD_AZIMUTH_073_Rx
            DET_CONFD_AZIMUTH_074_Rx_oRDR_FUSION_DET_073_076_oPCAN_RADAR_116da8f7_Rx: ComBitPosition=230, ComBitSize=2, ComSignalType=UINT8, ComSystemTemplateSystemSignalRef=DET_CONFD_AZIMUTH_074_Rx
            DET_CONFD_AZIMUTH_075_Rx_oRDR_FUSION_DET_073_076_oPCAN_RADAR_be293ab0_Rx: ComBitPosition=342, ComBitSize=2, ComSignalType=UINT8, ComSystemTemplateSystemSignalRef=DET_CONFD_AZIMUTH_075_Rx
            DET_CONFD_AZIMUTH_076_Rx_oRDR_FUSION_DET_073_076_oPCAN_RADAR_94958a38_Rx: ComBitPosition=454, ComBitSize=2, ComSignalType=UINT8, ComSystemTemplateSystemSignalRef=DET_CONFD_AZIMUTH_076_Rx
            DET_CONFD_ELEVATION_073_Rx_oRDR_FUSION_DET_073_076_oPCAN_RADAR_e171d827_Rx: ComBitPosition=101, ComBitSize=2, ComSignalType=UINT8, ComSystemTemplateSystemSignalRef=DET_CONFD_ELEVATION_073_Rx
            DET_CONFD_ELEVATION_074_Rx_oRDR_FUSION_DET_073_076_oPCAN_RADAR_1b4c2b70_Rx: ComBitPosition=213, ComBitSize=2, ComSignalType=UINT8, ComSystemTemplateSystemSignalRef=DET_CONFD_ELEVATION_074_Rx
            DET_CONFD_ELEVATION_075_Rx_oRDR_FUSION_DET_073_076_oPCAN_RADAR_b408b937_Rx: ComBitPosition=325, ComBitSize=2, ComSignalType=UINT8, ComSystemTemplateSystemSignalRef=DET_CONFD_ELEVATION_075_Rx
            DET_CONFD_ELEVATION_076_Rx_oRDR_FUSION_DET_073_076_oPCAN_RADAR_9eb409bf_Rx: ComBitPosition=437, ComBitSize=2, ComSignalType=UINT8, ComSystemTemplateSystemSignalRef=DET_CONFD_ELEVATION_076_Rx
            DET_ELEVATION_073_Rx_oRDR_FUSION_DET_073_076_oPCAN_RADAR_eb2237de_Rx: ComBitPosition=72, ComBitSize=8, ComSignalType=UINT8, ComSystemTemplateSystemSignalRef=DET_ELEVATION_073_Rx
            DET_ELEVATION_074_Rx_oRDR_FUSION_DET_073_076_oPCAN_RADAR_111fc489_Rx: ComBitPosition=184, ComBitSize=8, ComSignalType=UINT8, ComSystemTemplateSystemSignalRef=DET_ELEVATION_074_Rx
            DET_ELEVATION_075_Rx_oRDR_FUSION_DET_073_076_oPCAN_RADAR_be5b56ce_Rx: ComBitPosition=296, ComBitSize=8, ComSignalType=UINT8, ComSystemTemplateSystemSignalRef=DET_ELEVATION_075_Rx
            DET_ELEVATION_076_Rx_oRDR_FUSION_DET_073_076_oPCAN_RADAR_94e7e646_Rx: ComBitPosition=408, ComBitSize=8, ComSignalType=UINT8, ComSystemTemplateSystemSignalRef=DET_ELEVATION_076_Rx
            DET_ELEVATION_ERR_073_Rx_oRDR_FUSION_DET_073_076_oPCAN_RADAR_399b1501_Rx: ComBitPosition=80, ComBitSize=6, ComSignalType=UINT8, ComSystemTemplateSystemSignalRef=DET_ELEVATION_ERR_073_Rx
            DET_ELEVATION_ERR_074_Rx_oRDR_FUSION_DET_073_076_oPCAN_RADAR_c3a6e656_Rx: ComBitPosition=192, ComBitSize=6, ComSignalType=UINT8, ComSystemTemplateSystemSignalRef=DET_ELEVATION_ERR_074_Rx
            DET_ELEVATION_ERR_075_Rx_oRDR_FUSION_DET_073_076_oPCAN_RADAR_6ce27411_Rx: ComBitPosition=304, ComBitSize=6, ComSignalType=UINT8, ComSystemTemplateSystemSignalRef=DET_ELEVATION_ERR_075_Rx
            DET_ELEVATION_ERR_076_Rx_oRDR_FUSION_DET_073_076_oPCAN_RADAR_465ec499_Rx: ComBitPosition=416, ComBitSize=6, ComSignalType=UINT8, ComSystemTemplateSystemSignalRef=DET_ELEVATION_ERR_076_Rx
            DET_EXISTENCE_PROB_073_Rx_oRDR_FUSION_DET_073_076_oPCAN_RADAR_ce836d94_Rx: ComBitPosition=112, ComBitSize=6, ComSignalType=UINT8, ComSystemTemplateSystemSignalRef=DET_EXISTENCE_PROB_073_Rx
            DET_EXISTENCE_PROB_074_Rx_oRDR_FUSION_DET_073_076_oPCAN_RADAR_34be9ec3_Rx: ComBitPosition=224, ComBitSize=6, ComSignalType=UINT8, ComSystemTemplateSystemSignalRef=DET_EXISTENCE_PROB_074_Rx
            DET_EXISTENCE_PROB_075_Rx_oRDR_FUSION_DET_073_076_oPCAN_RADAR_9bfa0c84_Rx: ComBitPosition=336, ComBitSize=6, ComSignalType=UINT8, ComSystemTemplateSystemSignalRef=DET_EXISTENCE_PROB_075_Rx
            DET_EXISTENCE_PROB_076_Rx_oRDR_FUSION_DET_073_076_oPCAN_RADAR_b146bc0c_Rx: ComBitPosition=448, ComBitSize=6, ComSignalType=UINT8, ComSystemTemplateSystemSignalRef=DET_EXISTENCE_PROB_076_Rx
            DET_HVC_FLAG_073_Rx_oRDR_FUSION_DET_073_076_oPCAN_RADAR_135d80db_Rx: ComBitPosition=86, ComBitSize=1, ComSignalType=BOOLEAN, ComSystemTemplateSystemSignalRef=DET_HVC_FLAG_073_Rx
            DET_HVC_FLAG_074_Rx_oRDR_FUSION_DET_073_076_oPCAN_RADAR_e960738c_Rx: ComBitPosition=198, ComBitSize=1, ComSignalType=BOOLEAN, ComSystemTemplateSystemSignalRef=DET_HVC_FLAG_074_Rx
            DET_HVC_FLAG_075_Rx_oRDR_FUSION_DET_073_076_oPCAN_RADAR_4624e1cb_Rx: ComBitPosition=310, ComBitSize=1, ComSignalType=BOOLEAN, ComSystemTemplateSystemSignalRef=DET_HVC_FLAG_075_Rx
            DET_HVC_FLAG_076_Rx_oRDR_FUSION_DET_073_076_oPCAN_RADAR_6c985143_Rx: ComBitPosition=422, ComBitSize=1, ComSignalType=BOOLEAN, ComSystemTemplateSystemSignalRef=DET_HVC_FLAG_076_Rx
            DET_IDM_073_Rx_oRDR_FUSION_DET_073_076_oPCAN_RADAR_269c7993_Rx: ComBitPosition=63, ComBitSize=1, ComSignalType=BOOLEAN, ComSystemTemplateSystemSignalRef=DET_IDM_073_Rx
            DET_IDM_074_Rx_oRDR_FUSION_DET_073_076_oPCAN_RADAR_dca18ac4_Rx: ComBitPosition=175, ComBitSize=1, ComSignalType=BOOLEAN, ComSystemTemplateSystemSignalRef=DET_IDM_074_Rx
            DET_IDM_075_Rx_oRDR_FUSION_DET_073_076_oPCAN_RADAR_73e51883_Rx: ComBitPosition=287, ComBitSize=1, ComSignalType=BOOLEAN, ComSystemTemplateSystemSignalRef=DET_IDM_075_Rx
            DET_IDM_076_Rx_oRDR_FUSION_DET_073_076_oPCAN_RADAR_5959a80b_Rx: ComBitPosition=399, ComBitSize=1, ComSignalType=BOOLEAN, ComSystemTemplateSystemSignalRef=DET_IDM_076_Rx
            DET_MH_CRC16_073_076_Rx_oRDR_FUSION_DET_073_076_oPCAN_RADAR_b72e2c60_Rx: ComBitPosition=0, ComBitSize=16, ComSignalType=UINT16, ComSystemTemplateSystemSignalRef=DET_MH_CRC16_073_076_Rx
            DET_MH_CYCLE_COUNTER_073_076_Rx_oRDR_FUSION_DET_073_076_oPCAN_RADAR_baf511a5_Rx: ComBitPosition=16, ComBitSize=8, ComSignalType=UINT8, ComSystemTemplateSystemSignalRef=DET_MH_CYCLE_COUNTER_073_076_Rx
            DET_MH_SCAN_INDEX_4LSB_073_076_Rx_oRDR_FUSION_DET_073_076_oPCAN_RADAR_de45de9e_Rx: ComBitPosition=476, ComBitSize=4, ComSignalType=UINT8, ComSystemTemplateSystemSignalRef=DET_MH_SCAN_INDEX_4LSB_073_076_Rx
            DET_MTD_073_Rx_oRDR_FUSION_DET_073_076_oPCAN_RADAR_9b1f4fe3_Rx: ComBitPosition=47, ComBitSize=1, ComSignalType=BOOLEAN, ComSystemTemplateSystemSignalRef=DET_MTD_073_Rx
            DET_MTD_074_Rx_oRDR_FUSION_DET_073_076_oPCAN_RADAR_6122bcb4_Rx: ComBitPosition=159, ComBitSize=1, ComSignalType=BOOLEAN, ComSystemTemplateSystemSignalRef=DET_MTD_074_Rx
            DET_MTD_075_Rx_oRDR_FUSION_DET_073_076_oPCAN_RADAR_ce662ef3_Rx: ComBitPosition=271, ComBitSize=1, ComSignalType=BOOLEAN, ComSystemTemplateSystemSignalRef=DET_MTD_075_Rx
            DET_MTD_076_Rx_oRDR_FUSION_DET_073_076_oPCAN_RADAR_e4da9e7b_Rx: ComBitPosition=383, ComBitSize=1, ComSignalType=BOOLEAN, ComSystemTemplateSystemSignalRef=DET_MTD_076_Rx
            DET_PROB_1STAZHYPO_073_Rx_oRDR_FUSION_DET_073_076_oPCAN_RADAR_51665162_Rx: ComBitPosition=103, ComBitSize=1, ComSignalType=BOOLEAN, ComSystemTemplateSystemSignalRef=DET_PROB_1STAZHYPO_073_Rx
            DET_PROB_1STAZHYPO_074_Rx_oRDR_FUSION_DET_073_076_oPCAN_RADAR_ab5ba235_Rx: ComBitPosition=215, ComBitSize=1, ComSignalType=BOOLEAN, ComSystemTemplateSystemSignalRef=DET_PROB_1STAZHYPO_074_Rx
            DET_PROB_1STAZHYPO_075_Rx_oRDR_FUSION_DET_073_076_oPCAN_RADAR_041f3072_Rx: ComBitPosition=327, ComBitSize=1, ComSignalType=BOOLEAN, ComSystemTemplateSystemSignalRef=DET_PROB_1STAZHYPO_075_Rx
            DET_PROB_1STAZHYPO_076_Rx_oRDR_FUSION_DET_073_076_oPCAN_RADAR_2ea380fa_Rx: ComBitPosition=439, ComBitSize=1, ComSignalType=BOOLEAN, ComSystemTemplateSystemSignalRef=DET_PROB_1STAZHYPO_076_Rx
            DET_RANGE_073_Rx_oRDR_FUSION_DET_073_076_oPCAN_RADAR_0adbb975_Rx: ComBitPosition=24, ComBitSize=15, ComSignalType=UINT16, ComSystemTemplateSystemSignalRef=DET_RANGE_073_Rx
            DET_RANGE_074_Rx_oRDR_FUSION_DET_073_076_oPCAN_RADAR_f0e64a22_Rx: ComBitPosition=136, ComBitSize=15, ComSignalType=UINT16, ComSystemTemplateSystemSignalRef=DET_RANGE_074_Rx
            DET_RANGE_075_Rx_oRDR_FUSION_DET_073_076_oPCAN_RADAR_5fa2d865_Rx: ComBitPosition=248, ComBitSize=15, ComSignalType=UINT16, ComSystemTemplateSystemSignalRef=DET_RANGE_075_Rx
            DET_RANGE_076_Rx_oRDR_FUSION_DET_073_076_oPCAN_RADAR_751e68ed_Rx: ComBitPosition=360, ComBitSize=15, ComSignalType=UINT16, ComSystemTemplateSystemSignalRef=DET_RANGE_076_Rx
            DET_RANGE_ERR_073_Rx_oRDR_FUSION_DET_073_076_oPCAN_RADAR_5a293595_Rx: ComBitPosition=40, ComBitSize=7, ComSignalType=UINT8, ComSystemTemplateSystemSignalRef=DET_RANGE_ERR_073_Rx
            DET_RANGE_ERR_074_Rx_oRDR_FUSION_DET_073_076_oPCAN_RADAR_a014c6c2_Rx: ComBitPosition=152, ComBitSize=7, ComSignalType=UINT8, ComSystemTemplateSystemSignalRef=DET_RANGE_ERR_074_Rx
            DET_RANGE_ERR_075_Rx_oRDR_FUSION_DET_073_076_oPCAN_RADAR_0f505485_Rx: ComBitPosition=264, ComBitSize=7, ComSignalType=UINT8, ComSystemTemplateSystemSignalRef=DET_RANGE_ERR_075_Rx
            DET_RANGE_ERR_076_Rx_oRDR_FUSION_DET_073_076_oPCAN_RADAR_25ece40d_Rx: ComBitPosition=376, ComBitSize=7, ComSignalType=UINT8, ComSystemTemplateSystemSignalRef=DET_RANGE_ERR_076_Rx
            DET_RANGE_VELOCITY_073_Rx_oRDR_FUSION_DET_073_076_oPCAN_RADAR_d72e3a8b_Rx: ComBitPosition=48, ComBitSize=15, ComSignalType=UINT16, ComSystemTemplateSystemSignalRef=DET_RANGE_VELOCITY_073_Rx
            DET_RANGE_VELOCITY_074_Rx_oRDR_FUSION_DET_073_076_oPCAN_RADAR_2d13c9dc_Rx: ComBitPosition=160, ComBitSize=15, ComSignalType=UINT16, ComSystemTemplateSystemSignalRef=DET_RANGE_VELOCITY_074_Rx
            DET_RANGE_VELOCITY_075_Rx_oRDR_FUSION_DET_073_076_oPCAN_RADAR_82575b9b_Rx: ComBitPosition=272, ComBitSize=15, ComSignalType=UINT16, ComSystemTemplateSystemSignalRef=DET_RANGE_VELOCITY_075_Rx
            DET_RANGE_VELOCITY_076_Rx_oRDR_FUSION_DET_073_076_oPCAN_RADAR_a8ebeb13_Rx: ComBitPosition=384, ComBitSize=15, ComSignalType=UINT16, ComSystemTemplateSystemSignalRef=DET_RANGE_VELOCITY_076_Rx
            DET_RANGE_VELOCITY_ERR_073_Rx_oRDR_FUSION_DET_073_076_oPCAN_RADAR_4e4a4a49_Rx: ComBitPosition=64, ComBitSize=8, ComSignalType=UINT8, ComSystemTemplateSystemSignalRef=DET_RANGE_VELOCITY_ERR_073_Rx
            DET_RANGE_VELOCITY_ERR_074_Rx_oRDR_FUSION_DET_073_076_oPCAN_RADAR_b477b91e_Rx: ComBitPosition=176, ComBitSize=8, ComSignalType=UINT8, ComSystemTemplateSystemSignalRef=DET_RANGE_VELOCITY_ERR_074_Rx
            DET_RANGE_VELOCITY_ERR_075_Rx_oRDR_FUSION_DET_073_076_oPCAN_RADAR_1b332b59_Rx: ComBitPosition=288, ComBitSize=8, ComSignalType=UINT8, ComSystemTemplateSystemSignalRef=DET_RANGE_VELOCITY_ERR_075_Rx
            DET_RANGE_VELOCITY_ERR_076_Rx_oRDR_FUSION_DET_073_076_oPCAN_RADAR_318f9bd1_Rx: ComBitPosition=400, ComBitSize=8, ComSignalType=UINT8, ComSystemTemplateSystemSignalRef=DET_RANGE_VELOCITY_ERR_076_Rx
            DET_RCS_073_Rx_oRDR_FUSION_DET_073_076_oPCAN_RADAR_1ae5a890_Rx: ComBitPosition=128, ComBitSize=8, ComSignalType=UINT8, ComSystemTemplateSystemSignalRef=DET_RCS_073_Rx
            DET_RCS_074_Rx_oRDR_FUSION_DET_073_076_oPCAN_RADAR_e0d85bc7_Rx: ComBitPosition=240, ComBitSize=8, ComSignalType=UINT8, ComSystemTemplateSystemSignalRef=DET_RCS_074_Rx
            DET_RCS_075_Rx_oRDR_FUSION_DET_073_076_oPCAN_RADAR_4f9cc980_Rx: ComBitPosition=352, ComBitSize=8, ComSignalType=UINT8, ComSystemTemplateSystemSignalRef=DET_RCS_075_Rx
            DET_RCS_076_Rx_oRDR_FUSION_DET_073_076_oPCAN_RADAR_65207908_Rx: ComBitPosition=464, ComBitSize=8, ComSignalType=UINT8, ComSystemTemplateSystemSignalRef=DET_RCS_076_Rx
            DET_SNR_073_Rx_oRDR_FUSION_DET_073_076_oPCAN_RADAR_13bfd979_Rx: ComBitPosition=120, ComBitSize=8, ComSignalType=UINT8, ComSystemTemplateSystemSignalRef=DET_SNR_073_Rx
            DET_SNR_074_Rx_oRDR_FUSION_DET_073_076_oPCAN_RADAR_e9822a2e_Rx: ComBitPosition=232, ComBitSize=8, ComSignalType=UINT8, ComSystemTemplateSystemSignalRef=DET_SNR_074_Rx
            DET_SNR_075_Rx_oRDR_FUSION_DET_073_076_oPCAN_RADAR_46c6b869_Rx: ComBitPosition=344, ComBitSize=8, ComSignalType=UINT8, ComSystemTemplateSystemSignalRef=DET_SNR_075_Rx
            DET_SNR_076_Rx_oRDR_FUSION_DET_073_076_oPCAN_RADAR_6c7a08e1_Rx: ComBitPosition=456, ComBitSize=8, ComSignalType=UINT8, ComSystemTemplateSystemSignalRef=DET_SNR_076_Rx
            DET_SUPER_RES_TARGET_073_Rx_oRDR_FUSION_DET_073_076_oPCAN_RADAR_d844f879_Rx: ComBitPosition=87, ComBitSize=1, ComSignalType=BOOLEAN, ComSystemTemplateSystemSignalRef=DET_SUPER_RES_TARGET_073_Rx
            DET_SUPER_RES_TARGET_074_Rx_oRDR_FUSION_DET_073_076_oPCAN_RADAR_22790b2e_Rx: ComBitPosition=199, ComBitSize=1, ComSignalType=BOOLEAN, ComSystemTemplateSystemSignalRef=DET_SUPER_RES_TARGET_074_Rx
            DET_SUPER_RES_TARGET_075_Rx_oRDR_FUSION_DET_073_076_oPCAN_RADAR_8d3d9969_Rx: ComBitPosition=311, ComBitSize=1, ComSignalType=BOOLEAN, ComSystemTemplateSystemSignalRef=DET_SUPER_RES_TARGET_075_Rx
            DET_SUPER_RES_TARGET_076_Rx_oRDR_FUSION_DET_073_076_oPCAN_RADAR_a78129e1_Rx: ComBitPosition=423, ComBitSize=1, ComSignalType=BOOLEAN, ComSystemTemplateSystemSignalRef=DET_SUPER_RES_TARGET_076_Rx
        SG_Fusion_Detections_077_080_oRDR_FUSION_DET_077_080_oPCAN_RADAR_ea1c1377_Rx: ComTimeout=0, ComSystemTemplateSignalGroupRef=SG_Fusion_Detections_077_080
          83 x ComGroupSignal, all with ComSignalEndianness=LITTLE_ENDIAN, ComSignalInitValue=0:
            DET_AZIMUTH_077_Rx_oRDR_FUSION_DET_077_080_oPCAN_RADAR_4ce5ea69_Rx: ComBitPosition=88, ComBitSize=13, ComSignalType=UINT16, ComSystemTemplateSystemSignalRef=DET_AZIMUTH_077_Rx
            DET_AZIMUTH_078_Rx_oRDR_FUSION_DET_077_080_oPCAN_RADAR_ccab98c1_Rx: ComBitPosition=200, ComBitSize=13, ComSignalType=UINT16, ComSystemTemplateSystemSignalRef=DET_AZIMUTH_078_Rx
            DET_AZIMUTH_079_Rx_oRDR_FUSION_DET_077_080_oPCAN_RADAR_63ef0a86_Rx: ComBitPosition=312, ComBitSize=13, ComSignalType=UINT16, ComSystemTemplateSystemSignalRef=DET_AZIMUTH_079_Rx
            DET_AZIMUTH_080_Rx_oRDR_FUSION_DET_077_080_oPCAN_RADAR_6e557c96_Rx: ComBitPosition=424, ComBitSize=13, ComSignalType=UINT16, ComSystemTemplateSystemSignalRef=DET_AZIMUTH_080_Rx
            DET_AZIMUTH_ERR_077_Rx_oRDR_FUSION_DET_077_080_oPCAN_RADAR_4e8c4beb_Rx: ComBitPosition=105, ComBitSize=7, ComSignalType=UINT8, ComSystemTemplateSystemSignalRef=DET_AZIMUTH_ERR_077_Rx
            DET_AZIMUTH_ERR_078_Rx_oRDR_FUSION_DET_077_080_oPCAN_RADAR_cec23943_Rx: ComBitPosition=217, ComBitSize=7, ComSignalType=UINT8, ComSystemTemplateSystemSignalRef=DET_AZIMUTH_ERR_078_Rx
            DET_AZIMUTH_ERR_079_Rx_oRDR_FUSION_DET_077_080_oPCAN_RADAR_6186ab04_Rx: ComBitPosition=329, ComBitSize=7, ComSignalType=UINT8, ComSystemTemplateSystemSignalRef=DET_AZIMUTH_ERR_079_Rx
            DET_AZIMUTH_ERR_080_Rx_oRDR_FUSION_DET_077_080_oPCAN_RADAR_6c3cdd14_Rx: ComBitPosition=441, ComBitSize=7, ComSignalType=UINT8, ComSystemTemplateSystemSignalRef=DET_AZIMUTH_ERR_080_Rx
            DET_BELOW_RAIN_THOLD_077_Rx_oRDR_FUSION_DET_077_080_oPCAN_RADAR_2a5f15dc_Rx: ComBitPosition=39, ComBitSize=1, ComSignalType=BOOLEAN, ComSystemTemplateSystemSignalRef=DET_BELOW_RAIN_THOLD_077_Rx
            DET_BELOW_RAIN_THOLD_078_Rx_oRDR_FUSION_DET_077_080_oPCAN_RADAR_aa116774_Rx: ComBitPosition=151, ComBitSize=1, ComSignalType=BOOLEAN, ComSystemTemplateSystemSignalRef=DET_BELOW_RAIN_THOLD_078_Rx
            DET_BELOW_RAIN_THOLD_079_Rx_oRDR_FUSION_DET_077_080_oPCAN_RADAR_0555f533_Rx: ComBitPosition=263, ComBitSize=1, ComSignalType=BOOLEAN, ComSystemTemplateSystemSignalRef=DET_BELOW_RAIN_THOLD_079_Rx
            DET_BELOW_RAIN_THOLD_080_Rx_oRDR_FUSION_DET_077_080_oPCAN_RADAR_08ef8323_Rx: ComBitPosition=375, ComBitSize=1, ComSignalType=BOOLEAN, ComSystemTemplateSystemSignalRef=DET_BELOW_RAIN_THOLD_080_Rx
            DET_BI_STATIC_FLAG_077_Rx_oRDR_FUSION_DET_077_080_oPCAN_RADAR_5dc1becf_Rx: ComBitPosition=104, ComBitSize=1, ComSignalType=BOOLEAN, ComSystemTemplateSystemSignalRef=DET_BI_STATIC_FLAG_077_Rx
            DET_BI_STATIC_FLAG_078_Rx_oRDR_FUSION_DET_077_080_oPCAN_RADAR_dd8fcc67_Rx: ComBitPosition=216, ComBitSize=1, ComSignalType=BOOLEAN, ComSystemTemplateSystemSignalRef=DET_BI_STATIC_FLAG_078_Rx
            DET_BI_STATIC_FLAG_079_Rx_oRDR_FUSION_DET_077_080_oPCAN_RADAR_72cb5e20_Rx: ComBitPosition=328, ComBitSize=1, ComSignalType=BOOLEAN, ComSystemTemplateSystemSignalRef=DET_BI_STATIC_FLAG_079_Rx
            DET_BI_STATIC_FLAG_080_Rx_oRDR_FUSION_DET_077_080_oPCAN_RADAR_7f712830_Rx: ComBitPosition=440, ComBitSize=1, ComSignalType=BOOLEAN, ComSystemTemplateSystemSignalRef=DET_BI_STATIC_FLAG_080_Rx
            DET_CONFD_AZIMUTH_077_Rx_oRDR_FUSION_DET_077_080_oPCAN_RADAR_bea8549b_Rx: ComBitPosition=118, ComBitSize=2, ComSignalType=UINT8, ComSystemTemplateSystemSignalRef=DET_CONFD_AZIMUTH_077_Rx
            DET_CONFD_AZIMUTH_078_Rx_oRDR_FUSION_DET_077_080_oPCAN_RADAR_3ee62633_Rx: ComBitPosition=230, ComBitSize=2, ComSignalType=UINT8, ComSystemTemplateSystemSignalRef=DET_CONFD_AZIMUTH_078_Rx
            DET_CONFD_AZIMUTH_079_Rx_oRDR_FUSION_DET_077_080_oPCAN_RADAR_91a2b474_Rx: ComBitPosition=342, ComBitSize=2, ComSignalType=UINT8, ComSystemTemplateSystemSignalRef=DET_CONFD_AZIMUTH_079_Rx
            DET_CONFD_AZIMUTH_080_Rx_oRDR_FUSION_DET_077_080_oPCAN_RADAR_9c18c264_Rx: ComBitPosition=454, ComBitSize=2, ComSignalType=UINT8, ComSystemTemplateSystemSignalRef=DET_CONFD_AZIMUTH_080_Rx
            DET_CONFD_ELEVATION_077_Rx_oRDR_FUSION_DET_077_080_oPCAN_RADAR_b489d71c_Rx: ComBitPosition=101, ComBitSize=2, ComSignalType=UINT8, ComSystemTemplateSystemSignalRef=DET_CONFD_ELEVATION_077_Rx
            DET_CONFD_ELEVATION_078_Rx_oRDR_FUSION_DET_077_080_oPCAN_RADAR_34c7a5b4_Rx: ComBitPosition=213, ComBitSize=2, ComSignalType=UINT8, ComSystemTemplateSystemSignalRef=DET_CONFD_ELEVATION_078_Rx
            DET_CONFD_ELEVATION_079_Rx_oRDR_FUSION_DET_077_080_oPCAN_RADAR_9b8337f3_Rx: ComBitPosition=325, ComBitSize=2, ComSignalType=UINT8, ComSystemTemplateSystemSignalRef=DET_CONFD_ELEVATION_079_Rx
            DET_CONFD_ELEVATION_080_Rx_oRDR_FUSION_DET_077_080_oPCAN_RADAR_963941e3_Rx: ComBitPosition=437, ComBitSize=2, ComSignalType=UINT8, ComSystemTemplateSystemSignalRef=DET_CONFD_ELEVATION_080_Rx
            DET_ELEVATION_077_Rx_oRDR_FUSION_DET_077_080_oPCAN_RADAR_beda38e5_Rx: ComBitPosition=72, ComBitSize=8, ComSignalType=UINT8, ComSystemTemplateSystemSignalRef=DET_ELEVATION_077_Rx
            DET_ELEVATION_078_Rx_oRDR_FUSION_DET_077_080_oPCAN_RADAR_3e944a4d_Rx: ComBitPosition=184, ComBitSize=8, ComSignalType=UINT8, ComSystemTemplateSystemSignalRef=DET_ELEVATION_078_Rx
            DET_ELEVATION_079_Rx_oRDR_FUSION_DET_077_080_oPCAN_RADAR_91d0d80a_Rx: ComBitPosition=296, ComBitSize=8, ComSignalType=UINT8, ComSystemTemplateSystemSignalRef=DET_ELEVATION_079_Rx
            DET_ELEVATION_080_Rx_oRDR_FUSION_DET_077_080_oPCAN_RADAR_9c6aae1a_Rx: ComBitPosition=408, ComBitSize=8, ComSignalType=UINT8, ComSystemTemplateSystemSignalRef=DET_ELEVATION_080_Rx
            DET_ELEVATION_ERR_077_Rx_oRDR_FUSION_DET_077_080_oPCAN_RADAR_6c631a3a_Rx: ComBitPosition=80, ComBitSize=6, ComSignalType=UINT8, ComSystemTemplateSystemSignalRef=DET_ELEVATION_ERR_077_Rx
            DET_ELEVATION_ERR_078_Rx_oRDR_FUSION_DET_077_080_oPCAN_RADAR_ec2d6892_Rx: ComBitPosition=192, ComBitSize=6, ComSignalType=UINT8, ComSystemTemplateSystemSignalRef=DET_ELEVATION_ERR_078_Rx
            DET_ELEVATION_ERR_079_Rx_oRDR_FUSION_DET_077_080_oPCAN_RADAR_4369fad5_Rx: ComBitPosition=304, ComBitSize=6, ComSignalType=UINT8, ComSystemTemplateSystemSignalRef=DET_ELEVATION_ERR_079_Rx
            DET_ELEVATION_ERR_080_Rx_oRDR_FUSION_DET_077_080_oPCAN_RADAR_4ed38cc5_Rx: ComBitPosition=416, ComBitSize=6, ComSignalType=UINT8, ComSystemTemplateSystemSignalRef=DET_ELEVATION_ERR_080_Rx
            DET_EXISTENCE_PROB_077_Rx_oRDR_FUSION_DET_077_080_oPCAN_RADAR_9b7b62af_Rx: ComBitPosition=112, ComBitSize=6, ComSignalType=UINT8, ComSystemTemplateSystemSignalRef=DET_EXISTENCE_PROB_077_Rx
            DET_EXISTENCE_PROB_078_Rx_oRDR_FUSION_DET_077_080_oPCAN_RADAR_1b351007_Rx: ComBitPosition=224, ComBitSize=6, ComSignalType=UINT8, ComSystemTemplateSystemSignalRef=DET_EXISTENCE_PROB_078_Rx
            DET_EXISTENCE_PROB_079_Rx_oRDR_FUSION_DET_077_080_oPCAN_RADAR_b4718240_Rx: ComBitPosition=336, ComBitSize=6, ComSignalType=UINT8, ComSystemTemplateSystemSignalRef=DET_EXISTENCE_PROB_079_Rx
            DET_EXISTENCE_PROB_080_Rx_oRDR_FUSION_DET_077_080_oPCAN_RADAR_b9cbf450_Rx: ComBitPosition=448, ComBitSize=6, ComSignalType=UINT8, ComSystemTemplateSystemSignalRef=DET_EXISTENCE_PROB_080_Rx
            DET_HVC_FLAG_077_Rx_oRDR_FUSION_DET_077_080_oPCAN_RADAR_46a58fe0_Rx: ComBitPosition=86, ComBitSize=1, ComSignalType=BOOLEAN, ComSystemTemplateSystemSignalRef=DET_HVC_FLAG_077_Rx
            DET_HVC_FLAG_078_Rx_oRDR_FUSION_DET_077_080_oPCAN_RADAR_c6ebfd48_Rx: ComBitPosition=198, ComBitSize=1, ComSignalType=BOOLEAN, ComSystemTemplateSystemSignalRef=DET_HVC_FLAG_078_Rx
            DET_HVC_FLAG_079_Rx_oRDR_FUSION_DET_077_080_oPCAN_RADAR_69af6f0f_Rx: ComBitPosition=310, ComBitSize=1, ComSignalType=BOOLEAN, ComSystemTemplateSystemSignalRef=DET_HVC_FLAG_079_Rx
            DET_HVC_FLAG_080_Rx_oRDR_FUSION_DET_077_080_oPCAN_RADAR_6415191f_Rx: ComBitPosition=422, ComBitSize=1, ComSignalType=BOOLEAN, ComSystemTemplateSystemSignalRef=DET_HVC_FLAG_080_Rx
            DET_IDM_077_Rx_oRDR_FUSION_DET_077_080_oPCAN_RADAR_736476a8_Rx: ComBitPosition=63, ComBitSize=1, ComSignalType=BOOLEAN, ComSystemTemplateSystemSignalRef=DET_IDM_077_Rx
            DET_IDM_078_Rx_oRDR_FUSION_DET_077_080_oPCAN_RADAR_f32a0400_Rx: ComBitPosition=175, ComBitSize=1, ComSignalType=BOOLEAN, ComSystemTemplateSystemSignalRef=DET_IDM_078_Rx
            DET_IDM_079_Rx_oRDR_FUSION_DET_077_080_oPCAN_RADAR_5c6e9647_Rx: ComBitPosition=287, ComBitSize=1, ComSignalType=BOOLEAN, ComSystemTemplateSystemSignalRef=DET_IDM_079_Rx
            DET_IDM_080_Rx_oRDR_FUSION_DET_077_080_oPCAN_RADAR_51d4e057_Rx: ComBitPosition=399, ComBitSize=1, ComSignalType=BOOLEAN, ComSystemTemplateSystemSignalRef=DET_IDM_080_Rx
            DET_MH_CRC16_077_080_Rx_oRDR_FUSION_DET_077_080_oPCAN_RADAR_170385b4_Rx: ComBitPosition=0, ComBitSize=16, ComSignalType=UINT16, ComSystemTemplateSystemSignalRef=DET_MH_CRC16_077_080_Rx
            DET_MH_CYCLE_COUNTER_077_080_Rx_oRDR_FUSION_DET_077_080_oPCAN_RADAR_1ad8b871_Rx: ComBitPosition=16, ComBitSize=8, ComSignalType=UINT8, ComSystemTemplateSystemSignalRef=DET_MH_CYCLE_COUNTER_077_080_Rx
            DET_MH_SCAN_INDEX_4LSB_077_080_Rx_oRDR_FUSION_DET_077_080_oPCAN_RADAR_7e68774a_Rx: ComBitPosition=476, ComBitSize=4, ComSignalType=UINT8, ComSystemTemplateSystemSignalRef=DET_MH_SCAN_INDEX_4LSB_077_080_Rx
            DET_MTD_077_Rx_oRDR_FUSION_DET_077_080_oPCAN_RADAR_cee740d8_Rx: ComBitPosition=47, ComBitSize=1, ComSignalType=BOOLEAN, ComSystemTemplateSystemSignalRef=DET_MTD_077_Rx
            DET_MTD_078_Rx_oRDR_FUSION_DET_077_080_oPCAN_RADAR_4ea93270_Rx: ComBitPosition=159, ComBitSize=1, ComSignalType=BOOLEAN, ComSystemTemplateSystemSignalRef=DET_MTD_078_Rx
            DET_MTD_079_Rx_oRDR_FUSION_DET_077_080_oPCAN_RADAR_e1eda037_Rx: ComBitPosition=271, ComBitSize=1, ComSignalType=BOOLEAN, ComSystemTemplateSystemSignalRef=DET_MTD_079_Rx
            DET_MTD_080_Rx_oRDR_FUSION_DET_077_080_oPCAN_RADAR_ec57d627_Rx: ComBitPosition=383, ComBitSize=1, ComSignalType=BOOLEAN, ComSystemTemplateSystemSignalRef=DET_MTD_080_Rx
            DET_PROB_1STAZHYPO_077_Rx_oRDR_FUSION_DET_077_080_oPCAN_RADAR_049e5e59_Rx: ComBitPosition=103, ComBitSize=1, ComSignalType=BOOLEAN, ComSystemTemplateSystemSignalRef=DET_PROB_1STAZHYPO_077_Rx
            DET_PROB_1STAZHYPO_078_Rx_oRDR_FUSION_DET_077_080_oPCAN_RADAR_84d02cf1_Rx: ComBitPosition=215, ComBitSize=1, ComSignalType=BOOLEAN, ComSystemTemplateSystemSignalRef=DET_PROB_1STAZHYPO_078_Rx
            DET_PROB_1STAZHYPO_079_Rx_oRDR_FUSION_DET_077_080_oPCAN_RADAR_2b94beb6_Rx: ComBitPosition=327, ComBitSize=1, ComSignalType=BOOLEAN, ComSystemTemplateSystemSignalRef=DET_PROB_1STAZHYPO_079_Rx
            DET_PROB_1STAZHYPO_080_Rx_oRDR_FUSION_DET_077_080_oPCAN_RADAR_262ec8a6_Rx: ComBitPosition=439, ComBitSize=1, ComSignalType=BOOLEAN, ComSystemTemplateSystemSignalRef=DET_PROB_1STAZHYPO_080_Rx
            DET_RANGE_077_Rx_oRDR_FUSION_DET_077_080_oPCAN_RADAR_5f23b64e_Rx: ComBitPosition=24, ComBitSize=15, ComSignalType=UINT16, ComSystemTemplateSystemSignalRef=DET_RANGE_077_Rx
            DET_RANGE_078_Rx_oRDR_FUSION_DET_077_080_oPCAN_RADAR_df6dc4e6_Rx: ComBitPosition=136, ComBitSize=15, ComSignalType=UINT16, ComSystemTemplateSystemSignalRef=DET_RANGE_078_Rx
            DET_RANGE_079_Rx_oRDR_FUSION_DET_077_080_oPCAN_RADAR_702956a1_Rx: ComBitPosition=248, ComBitSize=15, ComSignalType=UINT16, ComSystemTemplateSystemSignalRef=DET_RANGE_079_Rx
            DET_RANGE_080_Rx_oRDR_FUSION_DET_077_080_oPCAN_RADAR_7d9320b1_Rx: ComBitPosition=360, ComBitSize=15, ComSignalType=UINT16, ComSystemTemplateSystemSignalRef=DET_RANGE_080_Rx
            DET_RANGE_ERR_077_Rx_oRDR_FUSION_DET_077_080_oPCAN_RADAR_0fd13aae_Rx: ComBitPosition=40, ComBitSize=7, ComSignalType=UINT8, ComSystemTemplateSystemSignalRef=DET_RANGE_ERR_077_Rx
            DET_RANGE_ERR_078_Rx_oRDR_FUSION_DET_077_080_oPCAN_RADAR_8f9f4806_Rx: ComBitPosition=152, ComBitSize=7, ComSignalType=UINT8, ComSystemTemplateSystemSignalRef=DET_RANGE_ERR_078_Rx
            DET_RANGE_ERR_079_Rx_oRDR_FUSION_DET_077_080_oPCAN_RADAR_20dbda41_Rx: ComBitPosition=264, ComBitSize=7, ComSignalType=UINT8, ComSystemTemplateSystemSignalRef=DET_RANGE_ERR_079_Rx
            DET_RANGE_ERR_080_Rx_oRDR_FUSION_DET_077_080_oPCAN_RADAR_2d61ac51_Rx: ComBitPosition=376, ComBitSize=7, ComSignalType=UINT8, ComSystemTemplateSystemSignalRef=DET_RANGE_ERR_080_Rx
            DET_RANGE_VELOCITY_077_Rx_oRDR_FUSION_DET_077_080_oPCAN_RADAR_82d635b0_Rx: ComBitPosition=48, ComBitSize=15, ComSignalType=UINT16, ComSystemTemplateSystemSignalRef=DET_RANGE_VELOCITY_077_Rx
            DET_RANGE_VELOCITY_078_Rx_oRDR_FUSION_DET_077_080_oPCAN_RADAR_02984718_Rx: ComBitPosition=160, ComBitSize=15, ComSignalType=UINT16, ComSystemTemplateSystemSignalRef=DET_RANGE_VELOCITY_078_Rx
            DET_RANGE_VELOCITY_079_Rx_oRDR_FUSION_DET_077_080_oPCAN_RADAR_addcd55f_Rx: ComBitPosition=272, ComBitSize=15, ComSignalType=UINT16, ComSystemTemplateSystemSignalRef=DET_RANGE_VELOCITY_079_Rx
            DET_RANGE_VELOCITY_080_Rx_oRDR_FUSION_DET_077_080_oPCAN_RADAR_a066a34f_Rx: ComBitPosition=384, ComBitSize=15, ComSignalType=UINT16, ComSystemTemplateSystemSignalRef=DET_RANGE_VELOCITY_080_Rx
            DET_RANGE_VELOCITY_ERR_077_Rx_oRDR_FUSION_DET_077_080_oPCAN_RADAR_1bb24572_Rx: ComBitPosition=64, ComBitSize=8, ComSignalType=UINT8, ComSystemTemplateSystemSignalRef=DET_RANGE_VELOCITY_ERR_077_Rx
            DET_RANGE_VELOCITY_ERR_078_Rx_oRDR_FUSION_DET_077_080_oPCAN_RADAR_9bfc37da_Rx: ComBitPosition=176, ComBitSize=8, ComSignalType=UINT8, ComSystemTemplateSystemSignalRef=DET_RANGE_VELOCITY_ERR_078_Rx
            DET_RANGE_VELOCITY_ERR_079_Rx_oRDR_FUSION_DET_077_080_oPCAN_RADAR_34b8a59d_Rx: ComBitPosition=288, ComBitSize=8, ComSignalType=UINT8, ComSystemTemplateSystemSignalRef=DET_RANGE_VELOCITY_ERR_079_Rx
            DET_RANGE_VELOCITY_ERR_080_Rx_oRDR_FUSION_DET_077_080_oPCAN_RADAR_3902d38d_Rx: ComBitPosition=400, ComBitSize=8, ComSignalType=UINT8, ComSystemTemplateSystemSignalRef=DET_RANGE_VELOCITY_ERR_080_Rx
            DET_RCS_077_Rx_oRDR_FUSION_DET_077_080_oPCAN_RADAR_4f1da7ab_Rx: ComBitPosition=128, ComBitSize=8, ComSignalType=UINT8, ComSystemTemplateSystemSignalRef=DET_RCS_077_Rx
            DET_RCS_078_Rx_oRDR_FUSION_DET_077_080_oPCAN_RADAR_cf53d503_Rx: ComBitPosition=240, ComBitSize=8, ComSignalType=UINT8, ComSystemTemplateSystemSignalRef=DET_RCS_078_Rx
            DET_RCS_079_Rx_oRDR_FUSION_DET_077_080_oPCAN_RADAR_60174744_Rx: ComBitPosition=352, ComBitSize=8, ComSignalType=UINT8, ComSystemTemplateSystemSignalRef=DET_RCS_079_Rx
            DET_RCS_080_Rx_oRDR_FUSION_DET_077_080_oPCAN_RADAR_6dad3154_Rx: ComBitPosition=464, ComBitSize=8, ComSignalType=UINT8, ComSystemTemplateSystemSignalRef=DET_RCS_080_Rx
            DET_SNR_077_Rx_oRDR_FUSION_DET_077_080_oPCAN_RADAR_4647d642_Rx: ComBitPosition=120, ComBitSize=8, ComSignalType=UINT8, ComSystemTemplateSystemSignalRef=DET_SNR_077_Rx
            DET_SNR_078_Rx_oRDR_FUSION_DET_077_080_oPCAN_RADAR_c609a4ea_Rx: ComBitPosition=232, ComBitSize=8, ComSignalType=UINT8, ComSystemTemplateSystemSignalRef=DET_SNR_078_Rx
            DET_SNR_079_Rx_oRDR_FUSION_DET_077_080_oPCAN_RADAR_694d36ad_Rx: ComBitPosition=344, ComBitSize=8, ComSignalType=UINT8, ComSystemTemplateSystemSignalRef=DET_SNR_079_Rx
            DET_SNR_080_Rx_oRDR_FUSION_DET_077_080_oPCAN_RADAR_64f740bd_Rx: ComBitPosition=456, ComBitSize=8, ComSignalType=UINT8, ComSystemTemplateSystemSignalRef=DET_SNR_080_Rx
            DET_SUPER_RES_TARGET_077_Rx_oRDR_FUSION_DET_077_080_oPCAN_RADAR_8dbcf742_Rx: ComBitPosition=87, ComBitSize=1, ComSignalType=BOOLEAN, ComSystemTemplateSystemSignalRef=DET_SUPER_RES_TARGET_077_Rx
            DET_SUPER_RES_TARGET_078_Rx_oRDR_FUSION_DET_077_080_oPCAN_RADAR_0df285ea_Rx: ComBitPosition=199, ComBitSize=1, ComSignalType=BOOLEAN, ComSystemTemplateSystemSignalRef=DET_SUPER_RES_TARGET_078_Rx
            DET_SUPER_RES_TARGET_079_Rx_oRDR_FUSION_DET_077_080_oPCAN_RADAR_a2b617ad_Rx: ComBitPosition=311, ComBitSize=1, ComSignalType=BOOLEAN, ComSystemTemplateSystemSignalRef=DET_SUPER_RES_TARGET_079_Rx
            DET_SUPER_RES_TARGET_080_Rx_oRDR_FUSION_DET_077_080_oPCAN_RADAR_af0c61bd_Rx: ComBitPosition=423, ComBitSize=1, ComSignalType=BOOLEAN, ComSystemTemplateSystemSignalRef=DET_SUPER_RES_TARGET_080_Rx
        SG_Fusion_Detections_081_084_oRDR_FUSION_DET_081_084_oPCAN_RADAR_d08af384_Rx: ComTimeout=0, ComSystemTemplateSignalGroupRef=SG_Fusion_Detections_081_084
          83 x ComGroupSignal, all with ComSignalEndianness=LITTLE_ENDIAN, ComSignalInitValue=0:
            DET_AZIMUTH_081_Rx_oRDR_FUSION_DET_081_084_oPCAN_RADAR_50e39727_Rx: ComBitPosition=88, ComBitSize=13, ComSignalType=UINT16, ComSystemTemplateSystemSignalRef=DET_AZIMUTH_081_Rx
            DET_AZIMUTH_082_Rx_oRDR_FUSION_DET_081_084_oPCAN_RADAR_7a5f27af_Rx: ComBitPosition=200, ComBitSize=13, ComSignalType=UINT16, ComSystemTemplateSystemSignalRef=DET_AZIMUTH_082_Rx
            DET_AZIMUTH_083_Rx_oRDR_FUSION_DET_081_084_oPCAN_RADAR_d51bb5e8_Rx: ComBitPosition=312, ComBitSize=13, ComSignalType=UINT16, ComSystemTemplateSystemSignalRef=DET_AZIMUTH_083_Rx
            DET_AZIMUTH_084_Rx_oRDR_FUSION_DET_081_084_oPCAN_RADAR_2f2646bf_Rx: ComBitPosition=424, ComBitSize=13, ComSignalType=UINT16, ComSystemTemplateSystemSignalRef=DET_AZIMUTH_084_Rx
            DET_AZIMUTH_ERR_081_Rx_oRDR_FUSION_DET_081_084_oPCAN_RADAR_528a36a5_Rx: ComBitPosition=105, ComBitSize=7, ComSignalType=UINT8, ComSystemTemplateSystemSignalRef=DET_AZIMUTH_ERR_081_Rx
            DET_AZIMUTH_ERR_082_Rx_oRDR_FUSION_DET_081_084_oPCAN_RADAR_7836862d_Rx: ComBitPosition=217, ComBitSize=7, ComSignalType=UINT8, ComSystemTemplateSystemSignalRef=DET_AZIMUTH_ERR_082_Rx
            DET_AZIMUTH_ERR_083_Rx_oRDR_FUSION_DET_081_084_oPCAN_RADAR_d772146a_Rx: ComBitPosition=329, ComBitSize=7, ComSignalType=UINT8, ComSystemTemplateSystemSignalRef=DET_AZIMUTH_ERR_083_Rx
            DET_AZIMUTH_ERR_084_Rx_oRDR_FUSION_DET_081_084_oPCAN_RADAR_2d4fe73d_Rx: ComBitPosition=441, ComBitSize=7, ComSignalType=UINT8, ComSystemTemplateSystemSignalRef=DET_AZIMUTH_ERR_084_Rx
            DET_BELOW_RAIN_THOLD_081_Rx_oRDR_FUSION_DET_081_084_oPCAN_RADAR_36596892_Rx: ComBitPosition=39, ComBitSize=1, ComSignalType=BOOLEAN, ComSystemTemplateSystemSignalRef=DET_BELOW_RAIN_THOLD_081_Rx
            DET_BELOW_RAIN_THOLD_082_Rx_oRDR_FUSION_DET_081_084_oPCAN_RADAR_1ce5d81a_Rx: ComBitPosition=151, ComBitSize=1, ComSignalType=BOOLEAN, ComSystemTemplateSystemSignalRef=DET_BELOW_RAIN_THOLD_082_Rx
            DET_BELOW_RAIN_THOLD_083_Rx_oRDR_FUSION_DET_081_084_oPCAN_RADAR_b3a14a5d_Rx: ComBitPosition=263, ComBitSize=1, ComSignalType=BOOLEAN, ComSystemTemplateSystemSignalRef=DET_BELOW_RAIN_THOLD_083_Rx
            DET_BELOW_RAIN_THOLD_084_Rx_oRDR_FUSION_DET_081_084_oPCAN_RADAR_499cb90a_Rx: ComBitPosition=375, ComBitSize=1, ComSignalType=BOOLEAN, ComSystemTemplateSystemSignalRef=DET_BELOW_RAIN_THOLD_084_Rx
            DET_BI_STATIC_FLAG_081_Rx_oRDR_FUSION_DET_081_084_oPCAN_RADAR_41c7c381_Rx: ComBitPosition=104, ComBitSize=1, ComSignalType=BOOLEAN, ComSystemTemplateSystemSignalRef=DET_BI_STATIC_FLAG_081_Rx
            DET_BI_STATIC_FLAG_082_Rx_oRDR_FUSION_DET_081_084_oPCAN_RADAR_6b7b7309_Rx: ComBitPosition=216, ComBitSize=1, ComSignalType=BOOLEAN, ComSystemTemplateSystemSignalRef=DET_BI_STATIC_FLAG_082_Rx
            DET_BI_STATIC_FLAG_083_Rx_oRDR_FUSION_DET_081_084_oPCAN_RADAR_c43fe14e_Rx: ComBitPosition=328, ComBitSize=1, ComSignalType=BOOLEAN, ComSystemTemplateSystemSignalRef=DET_BI_STATIC_FLAG_083_Rx
            DET_BI_STATIC_FLAG_084_Rx_oRDR_FUSION_DET_081_084_oPCAN_RADAR_3e021219_Rx: ComBitPosition=440, ComBitSize=1, ComSignalType=BOOLEAN, ComSystemTemplateSystemSignalRef=DET_BI_STATIC_FLAG_084_Rx
            DET_CONFD_AZIMUTH_081_Rx_oRDR_FUSION_DET_081_084_oPCAN_RADAR_a2ae29d5_Rx: ComBitPosition=118, ComBitSize=2, ComSignalType=UINT8, ComSystemTemplateSystemSignalRef=DET_CONFD_AZIMUTH_081_Rx
            DET_CONFD_AZIMUTH_082_Rx_oRDR_FUSION_DET_081_084_oPCAN_RADAR_8812995d_Rx: ComBitPosition=230, ComBitSize=2, ComSignalType=UINT8, ComSystemTemplateSystemSignalRef=DET_CONFD_AZIMUTH_082_Rx
            DET_CONFD_AZIMUTH_083_Rx_oRDR_FUSION_DET_081_084_oPCAN_RADAR_27560b1a_Rx: ComBitPosition=342, ComBitSize=2, ComSignalType=UINT8, ComSystemTemplateSystemSignalRef=DET_CONFD_AZIMUTH_083_Rx
            DET_CONFD_AZIMUTH_084_Rx_oRDR_FUSION_DET_081_084_oPCAN_RADAR_dd6bf84d_Rx: ComBitPosition=454, ComBitSize=2, ComSignalType=UINT8, ComSystemTemplateSystemSignalRef=DET_CONFD_AZIMUTH_084_Rx
            DET_CONFD_ELEVATION_081_Rx_oRDR_FUSION_DET_081_084_oPCAN_RADAR_a88faa52_Rx: ComBitPosition=101, ComBitSize=2, ComSignalType=UINT8, ComSystemTemplateSystemSignalRef=DET_CONFD_ELEVATION_081_Rx
            DET_CONFD_ELEVATION_082_Rx_oRDR_FUSION_DET_081_084_oPCAN_RADAR_82331ada_Rx: ComBitPosition=213, ComBitSize=2, ComSignalType=UINT8, ComSystemTemplateSystemSignalRef=DET_CONFD_ELEVATION_082_Rx
            DET_CONFD_ELEVATION_083_Rx_oRDR_FUSION_DET_081_084_oPCAN_RADAR_2d77889d_Rx: ComBitPosition=325, ComBitSize=2, ComSignalType=UINT8, ComSystemTemplateSystemSignalRef=DET_CONFD_ELEVATION_083_Rx
            DET_CONFD_ELEVATION_084_Rx_oRDR_FUSION_DET_081_084_oPCAN_RADAR_d74a7bca_Rx: ComBitPosition=437, ComBitSize=2, ComSignalType=UINT8, ComSystemTemplateSystemSignalRef=DET_CONFD_ELEVATION_084_Rx
            DET_ELEVATION_081_Rx_oRDR_FUSION_DET_081_084_oPCAN_RADAR_a2dc45ab_Rx: ComBitPosition=72, ComBitSize=8, ComSignalType=UINT8, ComSystemTemplateSystemSignalRef=DET_ELEVATION_081_Rx
            DET_ELEVATION_082_Rx_oRDR_FUSION_DET_081_084_oPCAN_RADAR_8860f523_Rx: ComBitPosition=184, ComBitSize=8, ComSignalType=UINT8, ComSystemTemplateSystemSignalRef=DET_ELEVATION_082_Rx
            DET_ELEVATION_083_Rx_oRDR_FUSION_DET_081_084_oPCAN_RADAR_27246764_Rx: ComBitPosition=296, ComBitSize=8, ComSignalType=UINT8, ComSystemTemplateSystemSignalRef=DET_ELEVATION_083_Rx
            DET_ELEVATION_084_Rx_oRDR_FUSION_DET_081_084_oPCAN_RADAR_dd199433_Rx: ComBitPosition=408, ComBitSize=8, ComSignalType=UINT8, ComSystemTemplateSystemSignalRef=DET_ELEVATION_084_Rx
            DET_ELEVATION_ERR_081_Rx_oRDR_FUSION_DET_081_084_oPCAN_RADAR_70656774_Rx: ComBitPosition=80, ComBitSize=6, ComSignalType=UINT8, ComSystemTemplateSystemSignalRef=DET_ELEVATION_ERR_081_Rx
            DET_ELEVATION_ERR_082_Rx_oRDR_FUSION_DET_081_084_oPCAN_RADAR_5ad9d7fc_Rx: ComBitPosition=192, ComBitSize=6, ComSignalType=UINT8, ComSystemTemplateSystemSignalRef=DET_ELEVATION_ERR_082_Rx
            DET_ELEVATION_ERR_083_Rx_oRDR_FUSION_DET_081_084_oPCAN_RADAR_f59d45bb_Rx: ComBitPosition=304, ComBitSize=6, ComSignalType=UINT8, ComSystemTemplateSystemSignalRef=DET_ELEVATION_ERR_083_Rx
            DET_ELEVATION_ERR_084_Rx_oRDR_FUSION_DET_081_084_oPCAN_RADAR_0fa0b6ec_Rx: ComBitPosition=416, ComBitSize=6, ComSignalType=UINT8, ComSystemTemplateSystemSignalRef=DET_ELEVATION_ERR_084_Rx
            DET_EXISTENCE_PROB_081_Rx_oRDR_FUSION_DET_081_084_oPCAN_RADAR_877d1fe1_Rx: ComBitPosition=112, ComBitSize=6, ComSignalType=UINT8, ComSystemTemplateSystemSignalRef=DET_EXISTENCE_PROB_081_Rx
            DET_EXISTENCE_PROB_082_Rx_oRDR_FUSION_DET_081_084_oPCAN_RADAR_adc1af69_Rx: ComBitPosition=224, ComBitSize=6, ComSignalType=UINT8, ComSystemTemplateSystemSignalRef=DET_EXISTENCE_PROB_082_Rx
            DET_EXISTENCE_PROB_083_Rx_oRDR_FUSION_DET_081_084_oPCAN_RADAR_02853d2e_Rx: ComBitPosition=336, ComBitSize=6, ComSignalType=UINT8, ComSystemTemplateSystemSignalRef=DET_EXISTENCE_PROB_083_Rx
            DET_EXISTENCE_PROB_084_Rx_oRDR_FUSION_DET_081_084_oPCAN_RADAR_f8b8ce79_Rx: ComBitPosition=448, ComBitSize=6, ComSignalType=UINT8, ComSystemTemplateSystemSignalRef=DET_EXISTENCE_PROB_084_Rx
            DET_HVC_FLAG_081_Rx_oRDR_FUSION_DET_081_084_oPCAN_RADAR_5aa3f2ae_Rx: ComBitPosition=86, ComBitSize=1, ComSignalType=BOOLEAN, ComSystemTemplateSystemSignalRef=DET_HVC_FLAG_081_Rx
            DET_HVC_FLAG_082_Rx_oRDR_FUSION_DET_081_084_oPCAN_RADAR_701f4226_Rx: ComBitPosition=198, ComBitSize=1, ComSignalType=BOOLEAN, ComSystemTemplateSystemSignalRef=DET_HVC_FLAG_082_Rx
            DET_HVC_FLAG_083_Rx_oRDR_FUSION_DET_081_084_oPCAN_RADAR_df5bd061_Rx: ComBitPosition=310, ComBitSize=1, ComSignalType=BOOLEAN, ComSystemTemplateSystemSignalRef=DET_HVC_FLAG_083_Rx
            DET_HVC_FLAG_084_Rx_oRDR_FUSION_DET_081_084_oPCAN_RADAR_25662336_Rx: ComBitPosition=422, ComBitSize=1, ComSignalType=BOOLEAN, ComSystemTemplateSystemSignalRef=DET_HVC_FLAG_084_Rx
            DET_IDM_081_Rx_oRDR_FUSION_DET_081_084_oPCAN_RADAR_6f620be6_Rx: ComBitPosition=63, ComBitSize=1, ComSignalType=BOOLEAN, ComSystemTemplateSystemSignalRef=DET_IDM_081_Rx
            DET_IDM_082_Rx_oRDR_FUSION_DET_081_084_oPCAN_RADAR_45debb6e_Rx: ComBitPosition=175, ComBitSize=1, ComSignalType=BOOLEAN, ComSystemTemplateSystemSignalRef=DET_IDM_082_Rx
            DET_IDM_083_Rx_oRDR_FUSION_DET_081_084_oPCAN_RADAR_ea9a2929_Rx: ComBitPosition=287, ComBitSize=1, ComSignalType=BOOLEAN, ComSystemTemplateSystemSignalRef=DET_IDM_083_Rx
            DET_IDM_084_Rx_oRDR_FUSION_DET_081_084_oPCAN_RADAR_10a7da7e_Rx: ComBitPosition=399, ComBitSize=1, ComSignalType=BOOLEAN, ComSystemTemplateSystemSignalRef=DET_IDM_084_Rx
            DET_MH_CRC16_081_084_Rx_oRDR_FUSION_DET_081_084_oPCAN_RADAR_6a66aa10_Rx: ComBitPosition=0, ComBitSize=16, ComSignalType=UINT16, ComSystemTemplateSystemSignalRef=DET_MH_CRC16_081_084_Rx
            DET_MH_CYCLE_COUNTER_081_084_Rx_oRDR_FUSION_DET_081_084_oPCAN_RADAR_67bd97d5_Rx: ComBitPosition=16, ComBitSize=8, ComSignalType=UINT8, ComSystemTemplateSystemSignalRef=DET_MH_CYCLE_COUNTER_081_084_Rx
            DET_MH_SCAN_INDEX_4LSB_081_084_Rx_oRDR_FUSION_DET_081_084_oPCAN_RADAR_030d58ee_Rx: ComBitPosition=476, ComBitSize=4, ComSignalType=UINT8, ComSystemTemplateSystemSignalRef=DET_MH_SCAN_INDEX_4LSB_081_084_Rx
            DET_MTD_081_Rx_oRDR_FUSION_DET_081_084_oPCAN_RADAR_d2e13d96_Rx: ComBitPosition=47, ComBitSize=1, ComSignalType=BOOLEAN, ComSystemTemplateSystemSignalRef=DET_MTD_081_Rx
            DET_MTD_082_Rx_oRDR_FUSION_DET_081_084_oPCAN_RADAR_f85d8d1e_Rx: ComBitPosition=159, ComBitSize=1, ComSignalType=BOOLEAN, ComSystemTemplateSystemSignalRef=DET_MTD_082_Rx
            DET_MTD_083_Rx_oRDR_FUSION_DET_081_084_oPCAN_RADAR_57191f59_Rx: ComBitPosition=271, ComBitSize=1, ComSignalType=BOOLEAN, ComSystemTemplateSystemSignalRef=DET_MTD_083_Rx
            DET_MTD_084_Rx_oRDR_FUSION_DET_081_084_oPCAN_RADAR_ad24ec0e_Rx: ComBitPosition=383, ComBitSize=1, ComSignalType=BOOLEAN, ComSystemTemplateSystemSignalRef=DET_MTD_084_Rx
            DET_PROB_1STAZHYPO_081_Rx_oRDR_FUSION_DET_081_084_oPCAN_RADAR_18982317_Rx: ComBitPosition=103, ComBitSize=1, ComSignalType=BOOLEAN, ComSystemTemplateSystemSignalRef=DET_PROB_1STAZHYPO_081_Rx
            DET_PROB_1STAZHYPO_082_Rx_oRDR_FUSION_DET_081_084_oPCAN_RADAR_3224939f_Rx: ComBitPosition=215, ComBitSize=1, ComSignalType=BOOLEAN, ComSystemTemplateSystemSignalRef=DET_PROB_1STAZHYPO_082_Rx
            DET_PROB_1STAZHYPO_083_Rx_oRDR_FUSION_DET_081_084_oPCAN_RADAR_9d6001d8_Rx: ComBitPosition=327, ComBitSize=1, ComSignalType=BOOLEAN, ComSystemTemplateSystemSignalRef=DET_PROB_1STAZHYPO_083_Rx
            DET_PROB_1STAZHYPO_084_Rx_oRDR_FUSION_DET_081_084_oPCAN_RADAR_675df28f_Rx: ComBitPosition=439, ComBitSize=1, ComSignalType=BOOLEAN, ComSystemTemplateSystemSignalRef=DET_PROB_1STAZHYPO_084_Rx
            DET_RANGE_081_Rx_oRDR_FUSION_DET_081_084_oPCAN_RADAR_4325cb00_Rx: ComBitPosition=24, ComBitSize=15, ComSignalType=UINT16, ComSystemTemplateSystemSignalRef=DET_RANGE_081_Rx
            DET_RANGE_082_Rx_oRDR_FUSION_DET_081_084_oPCAN_RADAR_69997b88_Rx: ComBitPosition=136, ComBitSize=15, ComSignalType=UINT16, ComSystemTemplateSystemSignalRef=DET_RANGE_082_Rx
            DET_RANGE_083_Rx_oRDR_FUSION_DET_081_084_oPCAN_RADAR_c6dde9cf_Rx: ComBitPosition=248, ComBitSize=15, ComSignalType=UINT16, ComSystemTemplateSystemSignalRef=DET_RANGE_083_Rx
            DET_RANGE_084_Rx_oRDR_FUSION_DET_081_084_oPCAN_RADAR_3ce01a98_Rx: ComBitPosition=360, ComBitSize=15, ComSignalType=UINT16, ComSystemTemplateSystemSignalRef=DET_RANGE_084_Rx
            DET_RANGE_ERR_081_Rx_oRDR_FUSION_DET_081_084_oPCAN_RADAR_13d747e0_Rx: ComBitPosition=40, ComBitSize=7, ComSignalType=UINT8, ComSystemTemplateSystemSignalRef=DET_RANGE_ERR_081_Rx
            DET_RANGE_ERR_082_Rx_oRDR_FUSION_DET_081_084_oPCAN_RADAR_396bf768_Rx: ComBitPosition=152, ComBitSize=7, ComSignalType=UINT8, ComSystemTemplateSystemSignalRef=DET_RANGE_ERR_082_Rx
            DET_RANGE_ERR_083_Rx_oRDR_FUSION_DET_081_084_oPCAN_RADAR_962f652f_Rx: ComBitPosition=264, ComBitSize=7, ComSignalType=UINT8, ComSystemTemplateSystemSignalRef=DET_RANGE_ERR_083_Rx
            DET_RANGE_ERR_084_Rx_oRDR_FUSION_DET_081_084_oPCAN_RADAR_6c129678_Rx: ComBitPosition=376, ComBitSize=7, ComSignalType=UINT8, ComSystemTemplateSystemSignalRef=DET_RANGE_ERR_084_Rx
            DET_RANGE_VELOCITY_081_Rx_oRDR_FUSION_DET_081_084_oPCAN_RADAR_9ed048fe_Rx: ComBitPosition=48, ComBitSize=15, ComSignalType=UINT16, ComSystemTemplateSystemSignalRef=DET_RANGE_VELOCITY_081_Rx
            DET_RANGE_VELOCITY_082_Rx_oRDR_FUSION_DET_081_084_oPCAN_RADAR_b46cf876_Rx: ComBitPosition=160, ComBitSize=15, ComSignalType=UINT16, ComSystemTemplateSystemSignalRef=DET_RANGE_VELOCITY_082_Rx
            DET_RANGE_VELOCITY_083_Rx_oRDR_FUSION_DET_081_084_oPCAN_RADAR_1b286a31_Rx: ComBitPosition=272, ComBitSize=15, ComSignalType=UINT16, ComSystemTemplateSystemSignalRef=DET_RANGE_VELOCITY_083_Rx
            DET_RANGE_VELOCITY_084_Rx_oRDR_FUSION_DET_081_084_oPCAN_RADAR_e1159966_Rx: ComBitPosition=384, ComBitSize=15, ComSignalType=UINT16, ComSystemTemplateSystemSignalRef=DET_RANGE_VELOCITY_084_Rx
            DET_RANGE_VELOCITY_ERR_081_Rx_oRDR_FUSION_DET_081_084_oPCAN_RADAR_07b4383c_Rx: ComBitPosition=64, ComBitSize=8, ComSignalType=UINT8, ComSystemTemplateSystemSignalRef=DET_RANGE_VELOCITY_ERR_081_Rx
            DET_RANGE_VELOCITY_ERR_082_Rx_oRDR_FUSION_DET_081_084_oPCAN_RADAR_2d0888b4_Rx: ComBitPosition=176, ComBitSize=8, ComSignalType=UINT8, ComSystemTemplateSystemSignalRef=DET_RANGE_VELOCITY_ERR_082_Rx
            DET_RANGE_VELOCITY_ERR_083_Rx_oRDR_FUSION_DET_081_084_oPCAN_RADAR_824c1af3_Rx: ComBitPosition=288, ComBitSize=8, ComSignalType=UINT8, ComSystemTemplateSystemSignalRef=DET_RANGE_VELOCITY_ERR_083_Rx
            DET_RANGE_VELOCITY_ERR_084_Rx_oRDR_FUSION_DET_081_084_oPCAN_RADAR_7871e9a4_Rx: ComBitPosition=400, ComBitSize=8, ComSignalType=UINT8, ComSystemTemplateSystemSignalRef=DET_RANGE_VELOCITY_ERR_084_Rx
            DET_RCS_081_Rx_oRDR_FUSION_DET_081_084_oPCAN_RADAR_531bdae5_Rx: ComBitPosition=128, ComBitSize=8, ComSignalType=UINT8, ComSystemTemplateSystemSignalRef=DET_RCS_081_Rx
            DET_RCS_082_Rx_oRDR_FUSION_DET_081_084_oPCAN_RADAR_79a76a6d_Rx: ComBitPosition=240, ComBitSize=8, ComSignalType=UINT8, ComSystemTemplateSystemSignalRef=DET_RCS_082_Rx
            DET_RCS_083_Rx_oRDR_FUSION_DET_081_084_oPCAN_RADAR_d6e3f82a_Rx: ComBitPosition=352, ComBitSize=8, ComSignalType=UINT8, ComSystemTemplateSystemSignalRef=DET_RCS_083_Rx
            DET_RCS_084_Rx_oRDR_FUSION_DET_081_084_oPCAN_RADAR_2cde0b7d_Rx: ComBitPosition=464, ComBitSize=8, ComSignalType=UINT8, ComSystemTemplateSystemSignalRef=DET_RCS_084_Rx
            DET_SNR_081_Rx_oRDR_FUSION_DET_081_084_oPCAN_RADAR_5a41ab0c_Rx: ComBitPosition=120, ComBitSize=8, ComSignalType=UINT8, ComSystemTemplateSystemSignalRef=DET_SNR_081_Rx
            DET_SNR_082_Rx_oRDR_FUSION_DET_081_084_oPCAN_RADAR_70fd1b84_Rx: ComBitPosition=232, ComBitSize=8, ComSignalType=UINT8, ComSystemTemplateSystemSignalRef=DET_SNR_082_Rx
            DET_SNR_083_Rx_oRDR_FUSION_DET_081_084_oPCAN_RADAR_dfb989c3_Rx: ComBitPosition=344, ComBitSize=8, ComSignalType=UINT8, ComSystemTemplateSystemSignalRef=DET_SNR_083_Rx
            DET_SNR_084_Rx_oRDR_FUSION_DET_081_084_oPCAN_RADAR_25847a94_Rx: ComBitPosition=456, ComBitSize=8, ComSignalType=UINT8, ComSystemTemplateSystemSignalRef=DET_SNR_084_Rx
            DET_SUPER_RES_TARGET_081_Rx_oRDR_FUSION_DET_081_084_oPCAN_RADAR_91ba8a0c_Rx: ComBitPosition=87, ComBitSize=1, ComSignalType=BOOLEAN, ComSystemTemplateSystemSignalRef=DET_SUPER_RES_TARGET_081_Rx
            DET_SUPER_RES_TARGET_082_Rx_oRDR_FUSION_DET_081_084_oPCAN_RADAR_bb063a84_Rx: ComBitPosition=199, ComBitSize=1, ComSignalType=BOOLEAN, ComSystemTemplateSystemSignalRef=DET_SUPER_RES_TARGET_082_Rx
            DET_SUPER_RES_TARGET_083_Rx_oRDR_FUSION_DET_081_084_oPCAN_RADAR_1442a8c3_Rx: ComBitPosition=311, ComBitSize=1, ComSignalType=BOOLEAN, ComSystemTemplateSystemSignalRef=DET_SUPER_RES_TARGET_083_Rx
            DET_SUPER_RES_TARGET_084_Rx_oRDR_FUSION_DET_081_084_oPCAN_RADAR_ee7f5b94_Rx: ComBitPosition=423, ComBitSize=1, ComSignalType=BOOLEAN, ComSystemTemplateSystemSignalRef=DET_SUPER_RES_TARGET_084_Rx
        SG_Fusion_Detections_085_088_oRDR_FUSION_DET_085_088_oPCAN_RADAR_9d71d877_Rx: ComTimeout=0, ComSystemTemplateSignalGroupRef=SG_Fusion_Detections_085_088
          83 x ComGroupSignal, all with ComSignalEndianness=LITTLE_ENDIAN, ComSignalInitValue=0:
            DET_AZIMUTH_085_Rx_oRDR_FUSION_DET_085_088_oPCAN_RADAR_69d04acc_Rx: ComBitPosition=88, ComBitSize=13, ComSignalType=UINT16, ComSystemTemplateSystemSignalRef=DET_AZIMUTH_085_Rx
            DET_AZIMUTH_086_Rx_oRDR_FUSION_DET_085_088_oPCAN_RADAR_436cfa44_Rx: ComBitPosition=200, ComBitSize=13, ComSignalType=UINT16, ComSystemTemplateSystemSignalRef=DET_AZIMUTH_086_Rx
            DET_AZIMUTH_087_Rx_oRDR_FUSION_DET_085_088_oPCAN_RADAR_ec286803_Rx: ComBitPosition=312, ComBitSize=13, ComSignalType=UINT16, ComSystemTemplateSystemSignalRef=DET_AZIMUTH_087_Rx
            DET_AZIMUTH_088_Rx_oRDR_FUSION_DET_085_088_oPCAN_RADAR_6c661aab_Rx: ComBitPosition=424, ComBitSize=13, ComSignalType=UINT16, ComSystemTemplateSystemSignalRef=DET_AZIMUTH_088_Rx
            DET_AZIMUTH_ERR_085_Rx_oRDR_FUSION_DET_085_088_oPCAN_RADAR_6bb9eb4e_Rx: ComBitPosition=105, ComBitSize=7, ComSignalType=UINT8, ComSystemTemplateSystemSignalRef=DET_AZIMUTH_ERR_085_Rx
            DET_AZIMUTH_ERR_086_Rx_oRDR_FUSION_DET_085_088_oPCAN_RADAR_41055bc6_Rx: ComBitPosition=217, ComBitSize=7, ComSignalType=UINT8, ComSystemTemplateSystemSignalRef=DET_AZIMUTH_ERR_086_Rx
            DET_AZIMUTH_ERR_087_Rx_oRDR_FUSION_DET_085_088_oPCAN_RADAR_ee41c981_Rx: ComBitPosition=329, ComBitSize=7, ComSignalType=UINT8, ComSystemTemplateSystemSignalRef=DET_AZIMUTH_ERR_087_Rx
            DET_AZIMUTH_ERR_088_Rx_oRDR_FUSION_DET_085_088_oPCAN_RADAR_6e0fbb29_Rx: ComBitPosition=441, ComBitSize=7, ComSignalType=UINT8, ComSystemTemplateSystemSignalRef=DET_AZIMUTH_ERR_088_Rx
            DET_BELOW_RAIN_THOLD_085_Rx_oRDR_FUSION_DET_085_088_oPCAN_RADAR_0f6ab579_Rx: ComBitPosition=39, ComBitSize=1, ComSignalType=BOOLEAN, ComSystemTemplateSystemSignalRef=DET_BELOW_RAIN_THOLD_085_Rx
            DET_BELOW_RAIN_THOLD_086_Rx_oRDR_FUSION_DET_085_088_oPCAN_RADAR_25d605f1_Rx: ComBitPosition=151, ComBitSize=1, ComSignalType=BOOLEAN, ComSystemTemplateSystemSignalRef=DET_BELOW_RAIN_THOLD_086_Rx
            DET_BELOW_RAIN_THOLD_087_Rx_oRDR_FUSION_DET_085_088_oPCAN_RADAR_8a9297b6_Rx: ComBitPosition=263, ComBitSize=1, ComSignalType=BOOLEAN, ComSystemTemplateSystemSignalRef=DET_BELOW_RAIN_THOLD_087_Rx
            DET_BELOW_RAIN_THOLD_088_Rx_oRDR_FUSION_DET_085_088_oPCAN_RADAR_0adce51e_Rx: ComBitPosition=375, ComBitSize=1, ComSignalType=BOOLEAN, ComSystemTemplateSystemSignalRef=DET_BELOW_RAIN_THOLD_088_Rx
            DET_BI_STATIC_FLAG_085_Rx_oRDR_FUSION_DET_085_088_oPCAN_RADAR_78f41e6a_Rx: ComBitPosition=104, ComBitSize=1, ComSignalType=BOOLEAN, ComSystemTemplateSystemSignalRef=DET_BI_STATIC_FLAG_085_Rx
            DET_BI_STATIC_FLAG_086_Rx_oRDR_FUSION_DET_085_088_oPCAN_RADAR_5248aee2_Rx: ComBitPosition=216, ComBitSize=1, ComSignalType=BOOLEAN, ComSystemTemplateSystemSignalRef=DET_BI_STATIC_FLAG_086_Rx
            DET_BI_STATIC_FLAG_087_Rx_oRDR_FUSION_DET_085_088_oPCAN_RADAR_fd0c3ca5_Rx: ComBitPosition=328, ComBitSize=1, ComSignalType=BOOLEAN, ComSystemTemplateSystemSignalRef=DET_BI_STATIC_FLAG_087_Rx
            DET_BI_STATIC_FLAG_088_Rx_oRDR_FUSION_DET_085_088_oPCAN_RADAR_7d424e0d_Rx: ComBitPosition=440, ComBitSize=1, ComSignalType=BOOLEAN, ComSystemTemplateSystemSignalRef=DET_BI_STATIC_FLAG_088_Rx
            DET_CONFD_AZIMUTH_085_Rx_oRDR_FUSION_DET_085_088_oPCAN_RADAR_9b9df43e_Rx: ComBitPosition=118, ComBitSize=2, ComSignalType=UINT8, ComSystemTemplateSystemSignalRef=DET_CONFD_AZIMUTH_085_Rx
            DET_CONFD_AZIMUTH_086_Rx_oRDR_FUSION_DET_085_088_oPCAN_RADAR_b12144b6_Rx: ComBitPosition=230, ComBitSize=2, ComSignalType=UINT8, ComSystemTemplateSystemSignalRef=DET_CONFD_AZIMUTH_086_Rx
            DET_CONFD_AZIMUTH_087_Rx_oRDR_FUSION_DET_085_088_oPCAN_RADAR_1e65d6f1_Rx: ComBitPosition=342, ComBitSize=2, ComSignalType=UINT8, ComSystemTemplateSystemSignalRef=DET_CONFD_AZIMUTH_087_Rx
            DET_CONFD_AZIMUTH_088_Rx_oRDR_FUSION_DET_085_088_oPCAN_RADAR_9e2ba459_Rx: ComBitPosition=454, ComBitSize=2, ComSignalType=UINT8, ComSystemTemplateSystemSignalRef=DET_CONFD_AZIMUTH_088_Rx
            DET_CONFD_ELEVATION_085_Rx_oRDR_FUSION_DET_085_088_oPCAN_RADAR_91bc77b9_Rx: ComBitPosition=101, ComBitSize=2, ComSignalType=UINT8, ComSystemTemplateSystemSignalRef=DET_CONFD_ELEVATION_085_Rx
            DET_CONFD_ELEVATION_086_Rx_oRDR_FUSION_DET_085_088_oPCAN_RADAR_bb00c731_Rx: ComBitPosition=213, ComBitSize=2, ComSignalType=UINT8, ComSystemTemplateSystemSignalRef=DET_CONFD_ELEVATION_086_Rx
            DET_CONFD_ELEVATION_087_Rx_oRDR_FUSION_DET_085_088_oPCAN_RADAR_14445576_Rx: ComBitPosition=325, ComBitSize=2, ComSignalType=UINT8, ComSystemTemplateSystemSignalRef=DET_CONFD_ELEVATION_087_Rx
            DET_CONFD_ELEVATION_088_Rx_oRDR_FUSION_DET_085_088_oPCAN_RADAR_940a27de_Rx: ComBitPosition=437, ComBitSize=2, ComSignalType=UINT8, ComSystemTemplateSystemSignalRef=DET_CONFD_ELEVATION_088_Rx
            DET_ELEVATION_085_Rx_oRDR_FUSION_DET_085_088_oPCAN_RADAR_9bef9840_Rx: ComBitPosition=72, ComBitSize=8, ComSignalType=UINT8, ComSystemTemplateSystemSignalRef=DET_ELEVATION_085_Rx
            DET_ELEVATION_086_Rx_oRDR_FUSION_DET_085_088_oPCAN_RADAR_b15328c8_Rx: ComBitPosition=184, ComBitSize=8, ComSignalType=UINT8, ComSystemTemplateSystemSignalRef=DET_ELEVATION_086_Rx
            DET_ELEVATION_087_Rx_oRDR_FUSION_DET_085_088_oPCAN_RADAR_1e17ba8f_Rx: ComBitPosition=296, ComBitSize=8, ComSignalType=UINT8, ComSystemTemplateSystemSignalRef=DET_ELEVATION_087_Rx
            DET_ELEVATION_088_Rx_oRDR_FUSION_DET_085_088_oPCAN_RADAR_9e59c827_Rx: ComBitPosition=408, ComBitSize=8, ComSignalType=UINT8, ComSystemTemplateSystemSignalRef=DET_ELEVATION_088_Rx
            DET_ELEVATION_ERR_085_Rx_oRDR_FUSION_DET_085_088_oPCAN_RADAR_4956ba9f_Rx: ComBitPosition=80, ComBitSize=6, ComSignalType=UINT8, ComSystemTemplateSystemSignalRef=DET_ELEVATION_ERR_085_Rx
            DET_ELEVATION_ERR_086_Rx_oRDR_FUSION_DET_085_088_oPCAN_RADAR_63ea0a17_Rx: ComBitPosition=192, ComBitSize=6, ComSignalType=UINT8, ComSystemTemplateSystemSignalRef=DET_ELEVATION_ERR_086_Rx
            DET_ELEVATION_ERR_087_Rx_oRDR_FUSION_DET_085_088_oPCAN_RADAR_ccae9850_Rx: ComBitPosition=304, ComBitSize=6, ComSignalType=UINT8, ComSystemTemplateSystemSignalRef=DET_ELEVATION_ERR_087_Rx
            DET_ELEVATION_ERR_088_Rx_oRDR_FUSION_DET_085_088_oPCAN_RADAR_4ce0eaf8_Rx: ComBitPosition=416, ComBitSize=6, ComSignalType=UINT8, ComSystemTemplateSystemSignalRef=DET_ELEVATION_ERR_088_Rx
            DET_EXISTENCE_PROB_085_Rx_oRDR_FUSION_DET_085_088_oPCAN_RADAR_be4ec20a_Rx: ComBitPosition=112, ComBitSize=6, ComSignalType=UINT8, ComSystemTemplateSystemSignalRef=DET_EXISTENCE_PROB_085_Rx
            DET_EXISTENCE_PROB_086_Rx_oRDR_FUSION_DET_085_088_oPCAN_RADAR_94f27282_Rx: ComBitPosition=224, ComBitSize=6, ComSignalType=UINT8, ComSystemTemplateSystemSignalRef=DET_EXISTENCE_PROB_086_Rx
            DET_EXISTENCE_PROB_087_Rx_oRDR_FUSION_DET_085_088_oPCAN_RADAR_3bb6e0c5_Rx: ComBitPosition=336, ComBitSize=6, ComSignalType=UINT8, ComSystemTemplateSystemSignalRef=DET_EXISTENCE_PROB_087_Rx
            DET_EXISTENCE_PROB_088_Rx_oRDR_FUSION_DET_085_088_oPCAN_RADAR_bbf8926d_Rx: ComBitPosition=448, ComBitSize=6, ComSignalType=UINT8, ComSystemTemplateSystemSignalRef=DET_EXISTENCE_PROB_088_Rx
            DET_HVC_FLAG_085_Rx_oRDR_FUSION_DET_085_088_oPCAN_RADAR_63902f45_Rx: ComBitPosition=86, ComBitSize=1, ComSignalType=BOOLEAN, ComSystemTemplateSystemSignalRef=DET_HVC_FLAG_085_Rx
            DET_HVC_FLAG_086_Rx_oRDR_FUSION_DET_085_088_oPCAN_RADAR_492c9fcd_Rx: ComBitPosition=198, ComBitSize=1, ComSignalType=BOOLEAN, ComSystemTemplateSystemSignalRef=DET_HVC_FLAG_086_Rx
            DET_HVC_FLAG_087_Rx_oRDR_FUSION_DET_085_088_oPCAN_RADAR_e6680d8a_Rx: ComBitPosition=310, ComBitSize=1, ComSignalType=BOOLEAN, ComSystemTemplateSystemSignalRef=DET_HVC_FLAG_087_Rx
            DET_HVC_FLAG_088_Rx_oRDR_FUSION_DET_085_088_oPCAN_RADAR_66267f22_Rx: ComBitPosition=422, ComBitSize=1, ComSignalType=BOOLEAN, ComSystemTemplateSystemSignalRef=DET_HVC_FLAG_088_Rx
            DET_IDM_085_Rx_oRDR_FUSION_DET_085_088_oPCAN_RADAR_5651d60d_Rx: ComBitPosition=63, ComBitSize=1, ComSignalType=BOOLEAN, ComSystemTemplateSystemSignalRef=DET_IDM_085_Rx
            DET_IDM_086_Rx_oRDR_FUSION_DET_085_088_oPCAN_RADAR_7ced6685_Rx: ComBitPosition=175, ComBitSize=1, ComSignalType=BOOLEAN, ComSystemTemplateSystemSignalRef=DET_IDM_086_Rx
            DET_IDM_087_Rx_oRDR_FUSION_DET_085_088_oPCAN_RADAR_d3a9f4c2_Rx: ComBitPosition=287, ComBitSize=1, ComSignalType=BOOLEAN, ComSystemTemplateSystemSignalRef=DET_IDM_087_Rx
            DET_IDM_088_Rx_oRDR_FUSION_DET_085_088_oPCAN_RADAR_53e7866a_Rx: ComBitPosition=399, ComBitSize=1, ComSignalType=BOOLEAN, ComSystemTemplateSystemSignalRef=DET_IDM_088_Rx
            DET_MH_CRC16_085_088_Rx_oRDR_FUSION_DET_085_088_oPCAN_RADAR_8186178c_Rx: ComBitPosition=0, ComBitSize=16, ComSignalType=UINT16, ComSystemTemplateSystemSignalRef=DET_MH_CRC16_085_088_Rx
            DET_MH_CYCLE_COUNTER_085_088_Rx_oRDR_FUSION_DET_085_088_oPCAN_RADAR_8c5d2a49_Rx: ComBitPosition=16, ComBitSize=8, ComSignalType=UINT8, ComSystemTemplateSystemSignalRef=DET_MH_CYCLE_COUNTER_085_088_Rx
            DET_MH_SCAN_INDEX_4LSB_085_088_Rx_oRDR_FUSION_DET_085_088_oPCAN_RADAR_e8ede572_Rx: ComBitPosition=476, ComBitSize=4, ComSignalType=UINT8, ComSystemTemplateSystemSignalRef=DET_MH_SCAN_INDEX_4LSB_085_088_Rx
            DET_MTD_085_Rx_oRDR_FUSION_DET_085_088_oPCAN_RADAR_ebd2e07d_Rx: ComBitPosition=47, ComBitSize=1, ComSignalType=BOOLEAN, ComSystemTemplateSystemSignalRef=DET_MTD_085_Rx
            DET_MTD_086_Rx_oRDR_FUSION_DET_085_088_oPCAN_RADAR_c16e50f5_Rx: ComBitPosition=159, ComBitSize=1, ComSignalType=BOOLEAN, ComSystemTemplateSystemSignalRef=DET_MTD_086_Rx
            DET_MTD_087_Rx_oRDR_FUSION_DET_085_088_oPCAN_RADAR_6e2ac2b2_Rx: ComBitPosition=271, ComBitSize=1, ComSignalType=BOOLEAN, ComSystemTemplateSystemSignalRef=DET_MTD_087_Rx
            DET_MTD_088_Rx_oRDR_FUSION_DET_085_088_oPCAN_RADAR_ee64b01a_Rx: ComBitPosition=383, ComBitSize=1, ComSignalType=BOOLEAN, ComSystemTemplateSystemSignalRef=DET_MTD_088_Rx
            DET_PROB_1STAZHYPO_085_Rx_oRDR_FUSION_DET_085_088_oPCAN_RADAR_21abfefc_Rx: ComBitPosition=103, ComBitSize=1, ComSignalType=BOOLEAN, ComSystemTemplateSystemSignalRef=DET_PROB_1STAZHYPO_085_Rx
            DET_PROB_1STAZHYPO_086_Rx_oRDR_FUSION_DET_085_088_oPCAN_RADAR_0b174e74_Rx: ComBitPosition=215, ComBitSize=1, ComSignalType=BOOLEAN, ComSystemTemplateSystemSignalRef=DET_PROB_1STAZHYPO_086_Rx
            DET_PROB_1STAZHYPO_087_Rx_oRDR_FUSION_DET_085_088_oPCAN_RADAR_a453dc33_Rx: ComBitPosition=327, ComBitSize=1, ComSignalType=BOOLEAN, ComSystemTemplateSystemSignalRef=DET_PROB_1STAZHYPO_087_Rx
            DET_PROB_1STAZHYPO_088_Rx_oRDR_FUSION_DET_085_088_oPCAN_RADAR_241dae9b_Rx: ComBitPosition=439, ComBitSize=1, ComSignalType=BOOLEAN, ComSystemTemplateSystemSignalRef=DET_PROB_1STAZHYPO_088_Rx
            DET_RANGE_085_Rx_oRDR_FUSION_DET_085_088_oPCAN_RADAR_7a1616eb_Rx: ComBitPosition=24, ComBitSize=15, ComSignalType=UINT16, ComSystemTemplateSystemSignalRef=DET_RANGE_085_Rx
            DET_RANGE_086_Rx_oRDR_FUSION_DET_085_088_oPCAN_RADAR_50aaa663_Rx: ComBitPosition=136, ComBitSize=15, ComSignalType=UINT16, ComSystemTemplateSystemSignalRef=DET_RANGE_086_Rx
            DET_RANGE_087_Rx_oRDR_FUSION_DET_085_088_oPCAN_RADAR_ffee3424_Rx: ComBitPosition=248, ComBitSize=15, ComSignalType=UINT16, ComSystemTemplateSystemSignalRef=DET_RANGE_087_Rx
            DET_RANGE_088_Rx_oRDR_FUSION_DET_085_088_oPCAN_RADAR_7fa0468c_Rx: ComBitPosition=360, ComBitSize=15, ComSignalType=UINT16, ComSystemTemplateSystemSignalRef=DET_RANGE_088_Rx
            DET_RANGE_ERR_085_Rx_oRDR_FUSION_DET_085_088_oPCAN_RADAR_2ae49a0b_Rx: ComBitPosition=40, ComBitSize=7, ComSignalType=UINT8, ComSystemTemplateSystemSignalRef=DET_RANGE_ERR_085_Rx
            DET_RANGE_ERR_086_Rx_oRDR_FUSION_DET_085_088_oPCAN_RADAR_00582a83_Rx: ComBitPosition=152, ComBitSize=7, ComSignalType=UINT8, ComSystemTemplateSystemSignalRef=DET_RANGE_ERR_086_Rx
            DET_RANGE_ERR_087_Rx_oRDR_FUSION_DET_085_088_oPCAN_RADAR_af1cb8c4_Rx: ComBitPosition=264, ComBitSize=7, ComSignalType=UINT8, ComSystemTemplateSystemSignalRef=DET_RANGE_ERR_087_Rx
            DET_RANGE_ERR_088_Rx_oRDR_FUSION_DET_085_088_oPCAN_RADAR_2f52ca6c_Rx: ComBitPosition=376, ComBitSize=7, ComSignalType=UINT8, ComSystemTemplateSystemSignalRef=DET_RANGE_ERR_088_Rx
            DET_RANGE_VELOCITY_085_Rx_oRDR_FUSION_DET_085_088_oPCAN_RADAR_a7e39515_Rx: ComBitPosition=48, ComBitSize=15, ComSignalType=UINT16, ComSystemTemplateSystemSignalRef=DET_RANGE_VELOCITY_085_Rx
            DET_RANGE_VELOCITY_086_Rx_oRDR_FUSION_DET_085_088_oPCAN_RADAR_8d5f259d_Rx: ComBitPosition=160, ComBitSize=15, ComSignalType=UINT16, ComSystemTemplateSystemSignalRef=DET_RANGE_VELOCITY_086_Rx
            DET_RANGE_VELOCITY_087_Rx_oRDR_FUSION_DET_085_088_oPCAN_RADAR_221bb7da_Rx: ComBitPosition=272, ComBitSize=15, ComSignalType=UINT16, ComSystemTemplateSystemSignalRef=DET_RANGE_VELOCITY_087_Rx
            DET_RANGE_VELOCITY_088_Rx_oRDR_FUSION_DET_085_088_oPCAN_RADAR_a255c572_Rx: ComBitPosition=384, ComBitSize=15, ComSignalType=UINT16, ComSystemTemplateSystemSignalRef=DET_RANGE_VELOCITY_088_Rx
            DET_RANGE_VELOCITY_ERR_085_Rx_oRDR_FUSION_DET_085_088_oPCAN_RADAR_3e87e5d7_Rx: ComBitPosition=64, ComBitSize=8, ComSignalType=UINT8, ComSystemTemplateSystemSignalRef=DET_RANGE_VELOCITY_ERR_085_Rx
            DET_RANGE_VELOCITY_ERR_086_Rx_oRDR_FUSION_DET_085_088_oPCAN_RADAR_143b555f_Rx: ComBitPosition=176, ComBitSize=8, ComSignalType=UINT8, ComSystemTemplateSystemSignalRef=DET_RANGE_VELOCITY_ERR_086_Rx
            DET_RANGE_VELOCITY_ERR_087_Rx_oRDR_FUSION_DET_085_088_oPCAN_RADAR_bb7fc718_Rx: ComBitPosition=288, ComBitSize=8, ComSignalType=UINT8, ComSystemTemplateSystemSignalRef=DET_RANGE_VELOCITY_ERR_087_Rx
            DET_RANGE_VELOCITY_ERR_088_Rx_oRDR_FUSION_DET_085_088_oPCAN_RADAR_3b31b5b0_Rx: ComBitPosition=400, ComBitSize=8, ComSignalType=UINT8, ComSystemTemplateSystemSignalRef=DET_RANGE_VELOCITY_ERR_088_Rx
            DET_RCS_085_Rx_oRDR_FUSION_DET_085_088_oPCAN_RADAR_6a28070e_Rx: ComBitPosition=128, ComBitSize=8, ComSignalType=UINT8, ComSystemTemplateSystemSignalRef=DET_RCS_085_Rx
            DET_RCS_086_Rx_oRDR_FUSION_DET_085_088_oPCAN_RADAR_4094b786_Rx: ComBitPosition=240, ComBitSize=8, ComSignalType=UINT8, ComSystemTemplateSystemSignalRef=DET_RCS_086_Rx
            DET_RCS_087_Rx_oRDR_FUSION_DET_085_088_oPCAN_RADAR_efd025c1_Rx: ComBitPosition=352, ComBitSize=8, ComSignalType=UINT8, ComSystemTemplateSystemSignalRef=DET_RCS_087_Rx
            DET_RCS_088_Rx_oRDR_FUSION_DET_085_088_oPCAN_RADAR_6f9e5769_Rx: ComBitPosition=464, ComBitSize=8, ComSignalType=UINT8, ComSystemTemplateSystemSignalRef=DET_RCS_088_Rx
            DET_SNR_085_Rx_oRDR_FUSION_DET_085_088_oPCAN_RADAR_637276e7_Rx: ComBitPosition=120, ComBitSize=8, ComSignalType=UINT8, ComSystemTemplateSystemSignalRef=DET_SNR_085_Rx
            DET_SNR_086_Rx_oRDR_FUSION_DET_085_088_oPCAN_RADAR_49cec66f_Rx: ComBitPosition=232, ComBitSize=8, ComSignalType=UINT8, ComSystemTemplateSystemSignalRef=DET_SNR_086_Rx
            DET_SNR_087_Rx_oRDR_FUSION_DET_085_088_oPCAN_RADAR_e68a5428_Rx: ComBitPosition=344, ComBitSize=8, ComSignalType=UINT8, ComSystemTemplateSystemSignalRef=DET_SNR_087_Rx
            DET_SNR_088_Rx_oRDR_FUSION_DET_085_088_oPCAN_RADAR_66c42680_Rx: ComBitPosition=456, ComBitSize=8, ComSignalType=UINT8, ComSystemTemplateSystemSignalRef=DET_SNR_088_Rx
            DET_SUPER_RES_TARGET_085_Rx_oRDR_FUSION_DET_085_088_oPCAN_RADAR_a88957e7_Rx: ComBitPosition=87, ComBitSize=1, ComSignalType=BOOLEAN, ComSystemTemplateSystemSignalRef=DET_SUPER_RES_TARGET_085_Rx
            DET_SUPER_RES_TARGET_086_Rx_oRDR_FUSION_DET_085_088_oPCAN_RADAR_8235e76f_Rx: ComBitPosition=199, ComBitSize=1, ComSignalType=BOOLEAN, ComSystemTemplateSystemSignalRef=DET_SUPER_RES_TARGET_086_Rx
            DET_SUPER_RES_TARGET_087_Rx_oRDR_FUSION_DET_085_088_oPCAN_RADAR_2d717528_Rx: ComBitPosition=311, ComBitSize=1, ComSignalType=BOOLEAN, ComSystemTemplateSystemSignalRef=DET_SUPER_RES_TARGET_087_Rx
            DET_SUPER_RES_TARGET_088_Rx_oRDR_FUSION_DET_085_088_oPCAN_RADAR_ad3f0780_Rx: ComBitPosition=423, ComBitSize=1, ComSignalType=BOOLEAN, ComSystemTemplateSystemSignalRef=DET_SUPER_RES_TARGET_088_Rx
        SG_Fusion_Detections_089_092_oRDR_FUSION_DET_089_092_oPCAN_RADAR_1f429d9f_Rx: ComTimeout=0, ComSystemTemplateSignalGroupRef=SG_Fusion_Detections_089_092
          83 x ComGroupSignal, all with ComSignalEndianness=LITTLE_ENDIAN, ComSignalInitValue=0:
            DET_AZIMUTH_089_Rx_oRDR_FUSION_DET_089_092_oPCAN_RADAR_f16a67ed_Rx: ComBitPosition=88, ComBitSize=13, ComSignalType=UINT16, ComSystemTemplateSystemSignalRef=DET_AZIMUTH_089_Rx
            DET_AZIMUTH_090_Rx_oRDR_FUSION_DET_089_092_oPCAN_RADAR_cc4ae4f4_Rx: ComBitPosition=200, ComBitSize=13, ComSignalType=UINT16, ComSystemTemplateSystemSignalRef=DET_AZIMUTH_090_Rx
            DET_AZIMUTH_091_Rx_oRDR_FUSION_DET_089_092_oPCAN_RADAR_630e76b3_Rx: ComBitPosition=312, ComBitSize=13, ComSignalType=UINT16, ComSystemTemplateSystemSignalRef=DET_AZIMUTH_091_Rx
            DET_AZIMUTH_092_Rx_oRDR_FUSION_DET_089_092_oPCAN_RADAR_49b2c63b_Rx: ComBitPosition=424, ComBitSize=13, ComSignalType=UINT16, ComSystemTemplateSystemSignalRef=DET_AZIMUTH_092_Rx
            DET_AZIMUTH_ERR_089_Rx_oRDR_FUSION_DET_089_092_oPCAN_RADAR_f303c66f_Rx: ComBitPosition=105, ComBitSize=7, ComSignalType=UINT8, ComSystemTemplateSystemSignalRef=DET_AZIMUTH_ERR_089_Rx
            DET_AZIMUTH_ERR_090_Rx_oRDR_FUSION_DET_089_092_oPCAN_RADAR_ce234576_Rx: ComBitPosition=217, ComBitSize=7, ComSignalType=UINT8, ComSystemTemplateSystemSignalRef=DET_AZIMUTH_ERR_090_Rx
            DET_AZIMUTH_ERR_091_Rx_oRDR_FUSION_DET_089_092_oPCAN_RADAR_6167d731_Rx: ComBitPosition=329, ComBitSize=7, ComSignalType=UINT8, ComSystemTemplateSystemSignalRef=DET_AZIMUTH_ERR_091_Rx
            DET_AZIMUTH_ERR_092_Rx_oRDR_FUSION_DET_089_092_oPCAN_RADAR_4bdb67b9_Rx: ComBitPosition=441, ComBitSize=7, ComSignalType=UINT8, ComSystemTemplateSystemSignalRef=DET_AZIMUTH_ERR_092_Rx
            DET_BELOW_RAIN_THOLD_089_Rx_oRDR_FUSION_DET_089_092_oPCAN_RADAR_97d09858_Rx: ComBitPosition=39, ComBitSize=1, ComSignalType=BOOLEAN, ComSystemTemplateSystemSignalRef=DET_BELOW_RAIN_THOLD_089_Rx
            DET_BELOW_RAIN_THOLD_090_Rx_oRDR_FUSION_DET_089_092_oPCAN_RADAR_aaf01b41_Rx: ComBitPosition=151, ComBitSize=1, ComSignalType=BOOLEAN, ComSystemTemplateSystemSignalRef=DET_BELOW_RAIN_THOLD_090_Rx
            DET_BELOW_RAIN_THOLD_091_Rx_oRDR_FUSION_DET_089_092_oPCAN_RADAR_05b48906_Rx: ComBitPosition=263, ComBitSize=1, ComSignalType=BOOLEAN, ComSystemTemplateSystemSignalRef=DET_BELOW_RAIN_THOLD_091_Rx
            DET_BELOW_RAIN_THOLD_092_Rx_oRDR_FUSION_DET_089_092_oPCAN_RADAR_2f08398e_Rx: ComBitPosition=375, ComBitSize=1, ComSignalType=BOOLEAN, ComSystemTemplateSystemSignalRef=DET_BELOW_RAIN_THOLD_092_Rx
            DET_BI_STATIC_FLAG_089_Rx_oRDR_FUSION_DET_089_092_oPCAN_RADAR_e04e334b_Rx: ComBitPosition=104, ComBitSize=1, ComSignalType=BOOLEAN, ComSystemTemplateSystemSignalRef=DET_BI_STATIC_FLAG_089_Rx
            DET_BI_STATIC_FLAG_090_Rx_oRDR_FUSION_DET_089_092_oPCAN_RADAR_dd6eb052_Rx: ComBitPosition=216, ComBitSize=1, ComSignalType=BOOLEAN, ComSystemTemplateSystemSignalRef=DET_BI_STATIC_FLAG_090_Rx
            DET_BI_STATIC_FLAG_091_Rx_oRDR_FUSION_DET_089_092_oPCAN_RADAR_722a2215_Rx: ComBitPosition=328, ComBitSize=1, ComSignalType=BOOLEAN, ComSystemTemplateSystemSignalRef=DET_BI_STATIC_FLAG_091_Rx
            DET_BI_STATIC_FLAG_092_Rx_oRDR_FUSION_DET_089_092_oPCAN_RADAR_5896929d_Rx: ComBitPosition=440, ComBitSize=1, ComSignalType=BOOLEAN, ComSystemTemplateSystemSignalRef=DET_BI_STATIC_FLAG_092_Rx
            DET_CONFD_AZIMUTH_089_Rx_oRDR_FUSION_DET_089_092_oPCAN_RADAR_0327d91f_Rx: ComBitPosition=118, ComBitSize=2, ComSignalType=UINT8, ComSystemTemplateSystemSignalRef=DET_CONFD_AZIMUTH_089_Rx
            DET_CONFD_AZIMUTH_090_Rx_oRDR_FUSION_DET_089_092_oPCAN_RADAR_3e075a06_Rx: ComBitPosition=230, ComBitSize=2, ComSignalType=UINT8, ComSystemTemplateSystemSignalRef=DET_CONFD_AZIMUTH_090_Rx
            DET_CONFD_AZIMUTH_091_Rx_oRDR_FUSION_DET_089_092_oPCAN_RADAR_9143c841_Rx: ComBitPosition=342, ComBitSize=2, ComSignalType=UINT8, ComSystemTemplateSystemSignalRef=DET_CONFD_AZIMUTH_091_Rx
            DET_CONFD_AZIMUTH_092_Rx_oRDR_FUSION_DET_089_092_oPCAN_RADAR_bbff78c9_Rx: ComBitPosition=454, ComBitSize=2, ComSignalType=UINT8, ComSystemTemplateSystemSignalRef=DET_CONFD_AZIMUTH_092_Rx
            DET_CONFD_ELEVATION_089_Rx_oRDR_FUSION_DET_089_092_oPCAN_RADAR_09065a98_Rx: ComBitPosition=101, ComBitSize=2, ComSignalType=UINT8, ComSystemTemplateSystemSignalRef=DET_CONFD_ELEVATION_089_Rx
            DET_CONFD_ELEVATION_090_Rx_oRDR_FUSION_DET_089_092_oPCAN_RADAR_3426d981_Rx: ComBitPosition=213, ComBitSize=2, ComSignalType=UINT8, ComSystemTemplateSystemSignalRef=DET_CONFD_ELEVATION_090_Rx
            DET_CONFD_ELEVATION_091_Rx_oRDR_FUSION_DET_089_092_oPCAN_RADAR_9b624bc6_Rx: ComBitPosition=325, ComBitSize=2, ComSignalType=UINT8, ComSystemTemplateSystemSignalRef=DET_CONFD_ELEVATION_091_Rx
            DET_CONFD_ELEVATION_092_Rx_oRDR_FUSION_DET_089_092_oPCAN_RADAR_b1defb4e_Rx: ComBitPosition=437, ComBitSize=2, ComSignalType=UINT8, ComSystemTemplateSystemSignalRef=DET_CONFD_ELEVATION_092_Rx
            DET_ELEVATION_089_Rx_oRDR_FUSION_DET_089_092_oPCAN_RADAR_0355b561_Rx: ComBitPosition=72, ComBitSize=8, ComSignalType=UINT8, ComSystemTemplateSystemSignalRef=DET_ELEVATION_089_Rx
            DET_ELEVATION_090_Rx_oRDR_FUSION_DET_089_092_oPCAN_RADAR_3e753678_Rx: ComBitPosition=184, ComBitSize=8, ComSignalType=UINT8, ComSystemTemplateSystemSignalRef=DET_ELEVATION_090_Rx
            DET_ELEVATION_091_Rx_oRDR_FUSION_DET_089_092_oPCAN_RADAR_9131a43f_Rx: ComBitPosition=296, ComBitSize=8, ComSignalType=UINT8, ComSystemTemplateSystemSignalRef=DET_ELEVATION_091_Rx
            DET_ELEVATION_092_Rx_oRDR_FUSION_DET_089_092_oPCAN_RADAR_bb8d14b7_Rx: ComBitPosition=408, ComBitSize=8, ComSignalType=UINT8, ComSystemTemplateSystemSignalRef=DET_ELEVATION_092_Rx
            DET_ELEVATION_ERR_089_Rx_oRDR_FUSION_DET_089_092_oPCAN_RADAR_d1ec97be_Rx: ComBitPosition=80, ComBitSize=6, ComSignalType=UINT8, ComSystemTemplateSystemSignalRef=DET_ELEVATION_ERR_089_Rx
            DET_ELEVATION_ERR_090_Rx_oRDR_FUSION_DET_089_092_oPCAN_RADAR_eccc14a7_Rx: ComBitPosition=192, ComBitSize=6, ComSignalType=UINT8, ComSystemTemplateSystemSignalRef=DET_ELEVATION_ERR_090_Rx
            DET_ELEVATION_ERR_091_Rx_oRDR_FUSION_DET_089_092_oPCAN_RADAR_438886e0_Rx: ComBitPosition=304, ComBitSize=6, ComSignalType=UINT8, ComSystemTemplateSystemSignalRef=DET_ELEVATION_ERR_091_Rx
            DET_ELEVATION_ERR_092_Rx_oRDR_FUSION_DET_089_092_oPCAN_RADAR_69343668_Rx: ComBitPosition=416, ComBitSize=6, ComSignalType=UINT8, ComSystemTemplateSystemSignalRef=DET_ELEVATION_ERR_092_Rx
            DET_EXISTENCE_PROB_089_Rx_oRDR_FUSION_DET_089_092_oPCAN_RADAR_26f4ef2b_Rx: ComBitPosition=112, ComBitSize=6, ComSignalType=UINT8, ComSystemTemplateSystemSignalRef=DET_EXISTENCE_PROB_089_Rx
            DET_EXISTENCE_PROB_090_Rx_oRDR_FUSION_DET_089_092_oPCAN_RADAR_1bd46c32_Rx: ComBitPosition=224, ComBitSize=6, ComSignalType=UINT8, ComSystemTemplateSystemSignalRef=DET_EXISTENCE_PROB_090_Rx
            DET_EXISTENCE_PROB_091_Rx_oRDR_FUSION_DET_089_092_oPCAN_RADAR_b490fe75_Rx: ComBitPosition=336, ComBitSize=6, ComSignalType=UINT8, ComSystemTemplateSystemSignalRef=DET_EXISTENCE_PROB_091_Rx
            DET_EXISTENCE_PROB_092_Rx_oRDR_FUSION_DET_089_092_oPCAN_RADAR_9e2c4efd_Rx: ComBitPosition=448, ComBitSize=6, ComSignalType=UINT8, ComSystemTemplateSystemSignalRef=DET_EXISTENCE_PROB_092_Rx
            DET_HVC_FLAG_089_Rx_oRDR_FUSION_DET_089_092_oPCAN_RADAR_fb2a0264_Rx: ComBitPosition=86, ComBitSize=1, ComSignalType=BOOLEAN, ComSystemTemplateSystemSignalRef=DET_HVC_FLAG_089_Rx
            DET_HVC_FLAG_090_Rx_oRDR_FUSION_DET_089_092_oPCAN_RADAR_c60a817d_Rx: ComBitPosition=198, ComBitSize=1, ComSignalType=BOOLEAN, ComSystemTemplateSystemSignalRef=DET_HVC_FLAG_090_Rx
            DET_HVC_FLAG_091_Rx_oRDR_FUSION_DET_089_092_oPCAN_RADAR_694e133a_Rx: ComBitPosition=310, ComBitSize=1, ComSignalType=BOOLEAN, ComSystemTemplateSystemSignalRef=DET_HVC_FLAG_091_Rx
            DET_HVC_FLAG_092_Rx_oRDR_FUSION_DET_089_092_oPCAN_RADAR_43f2a3b2_Rx: ComBitPosition=422, ComBitSize=1, ComSignalType=BOOLEAN, ComSystemTemplateSystemSignalRef=DET_HVC_FLAG_092_Rx
            DET_IDM_089_Rx_oRDR_FUSION_DET_089_092_oPCAN_RADAR_ceebfb2c_Rx: ComBitPosition=63, ComBitSize=1, ComSignalType=BOOLEAN, ComSystemTemplateSystemSignalRef=DET_IDM_089_Rx
            DET_IDM_090_Rx_oRDR_FUSION_DET_089_092_oPCAN_RADAR_f3cb7835_Rx: ComBitPosition=175, ComBitSize=1, ComSignalType=BOOLEAN, ComSystemTemplateSystemSignalRef=DET_IDM_090_Rx
            DET_IDM_091_Rx_oRDR_FUSION_DET_089_092_oPCAN_RADAR_5c8fea72_Rx: ComBitPosition=287, ComBitSize=1, ComSignalType=BOOLEAN, ComSystemTemplateSystemSignalRef=DET_IDM_091_Rx
            DET_IDM_092_Rx_oRDR_FUSION_DET_089_092_oPCAN_RADAR_76335afa_Rx: ComBitPosition=399, ComBitSize=1, ComSignalType=BOOLEAN, ComSystemTemplateSystemSignalRef=DET_IDM_092_Rx
            DET_MH_CRC16_089_092_Rx_oRDR_FUSION_DET_089_092_oPCAN_RADAR_86c2efc5_Rx: ComBitPosition=0, ComBitSize=16, ComSignalType=UINT16, ComSystemTemplateSystemSignalRef=DET_MH_CRC16_089_092_Rx
            DET_MH_CYCLE_COUNTER_089_092_Rx_oRDR_FUSION_DET_089_092_oPCAN_RADAR_8b19d200_Rx: ComBitPosition=16, ComBitSize=8, ComSignalType=UINT8, ComSystemTemplateSystemSignalRef=DET_MH_CYCLE_COUNTER_089_092_Rx
            DET_MH_SCAN_INDEX_4LSB_089_092_Rx_oRDR_FUSION_DET_089_092_oPCAN_RADAR_efa91d3b_Rx: ComBitPosition=476, ComBitSize=4, ComSignalType=UINT8, ComSystemTemplateSystemSignalRef=DET_MH_SCAN_INDEX_4LSB_089_092_Rx
            DET_MTD_089_Rx_oRDR_FUSION_DET_089_092_oPCAN_RADAR_7368cd5c_Rx: ComBitPosition=47, ComBitSize=1, ComSignalType=BOOLEAN, ComSystemTemplateSystemSignalRef=DET_MTD_089_Rx
            DET_MTD_090_Rx_oRDR_FUSION_DET_089_092_oPCAN_RADAR_4e484e45_Rx: ComBitPosition=159, ComBitSize=1, ComSignalType=BOOLEAN, ComSystemTemplateSystemSignalRef=DET_MTD_090_Rx
            DET_MTD_091_Rx_oRDR_FUSION_DET_089_092_oPCAN_RADAR_e10cdc02_Rx: ComBitPosition=271, ComBitSize=1, ComSignalType=BOOLEAN, ComSystemTemplateSystemSignalRef=DET_MTD_091_Rx
            DET_MTD_092_Rx_oRDR_FUSION_DET_089_092_oPCAN_RADAR_cbb06c8a_Rx: ComBitPosition=383, ComBitSize=1, ComSignalType=BOOLEAN, ComSystemTemplateSystemSignalRef=DET_MTD_092_Rx
            DET_PROB_1STAZHYPO_089_Rx_oRDR_FUSION_DET_089_092_oPCAN_RADAR_b911d3dd_Rx: ComBitPosition=103, ComBitSize=1, ComSignalType=BOOLEAN, ComSystemTemplateSystemSignalRef=DET_PROB_1STAZHYPO_089_Rx
            DET_PROB_1STAZHYPO_090_Rx_oRDR_FUSION_DET_089_092_oPCAN_RADAR_843150c4_Rx: ComBitPosition=215, ComBitSize=1, ComSignalType=BOOLEAN, ComSystemTemplateSystemSignalRef=DET_PROB_1STAZHYPO_090_Rx
            DET_PROB_1STAZHYPO_091_Rx_oRDR_FUSION_DET_089_092_oPCAN_RADAR_2b75c283_Rx: ComBitPosition=327, ComBitSize=1, ComSignalType=BOOLEAN, ComSystemTemplateSystemSignalRef=DET_PROB_1STAZHYPO_091_Rx
            DET_PROB_1STAZHYPO_092_Rx_oRDR_FUSION_DET_089_092_oPCAN_RADAR_01c9720b_Rx: ComBitPosition=439, ComBitSize=1, ComSignalType=BOOLEAN, ComSystemTemplateSystemSignalRef=DET_PROB_1STAZHYPO_092_Rx
            DET_RANGE_089_Rx_oRDR_FUSION_DET_089_092_oPCAN_RADAR_e2ac3bca_Rx: ComBitPosition=24, ComBitSize=15, ComSignalType=UINT16, ComSystemTemplateSystemSignalRef=DET_RANGE_089_Rx
            DET_RANGE_090_Rx_oRDR_FUSION_DET_089_092_oPCAN_RADAR_df8cb8d3_Rx: ComBitPosition=136, ComBitSize=15, ComSignalType=UINT16, ComSystemTemplateSystemSignalRef=DET_RANGE_090_Rx
            DET_RANGE_091_Rx_oRDR_FUSION_DET_089_092_oPCAN_RADAR_70c82a94_Rx: ComBitPosition=248, ComBitSize=15, ComSignalType=UINT16, ComSystemTemplateSystemSignalRef=DET_RANGE_091_Rx
            DET_RANGE_092_Rx_oRDR_FUSION_DET_089_092_oPCAN_RADAR_5a749a1c_Rx: ComBitPosition=360, ComBitSize=15, ComSignalType=UINT16, ComSystemTemplateSystemSignalRef=DET_RANGE_092_Rx
            DET_RANGE_ERR_089_Rx_oRDR_FUSION_DET_089_092_oPCAN_RADAR_b25eb72a_Rx: ComBitPosition=40, ComBitSize=7, ComSignalType=UINT8, ComSystemTemplateSystemSignalRef=DET_RANGE_ERR_089_Rx
            DET_RANGE_ERR_090_Rx_oRDR_FUSION_DET_089_092_oPCAN_RADAR_8f7e3433_Rx: ComBitPosition=152, ComBitSize=7, ComSignalType=UINT8, ComSystemTemplateSystemSignalRef=DET_RANGE_ERR_090_Rx
            DET_RANGE_ERR_091_Rx_oRDR_FUSION_DET_089_092_oPCAN_RADAR_203aa674_Rx: ComBitPosition=264, ComBitSize=7, ComSignalType=UINT8, ComSystemTemplateSystemSignalRef=DET_RANGE_ERR_091_Rx
            DET_RANGE_ERR_092_Rx_oRDR_FUSION_DET_089_092_oPCAN_RADAR_0a8616fc_Rx: ComBitPosition=376, ComBitSize=7, ComSignalType=UINT8, ComSystemTemplateSystemSignalRef=DET_RANGE_ERR_092_Rx
            DET_RANGE_VELOCITY_089_Rx_oRDR_FUSION_DET_089_092_oPCAN_RADAR_3f59b834_Rx: ComBitPosition=48, ComBitSize=15, ComSignalType=UINT16, ComSystemTemplateSystemSignalRef=DET_RANGE_VELOCITY_089_Rx
            DET_RANGE_VELOCITY_090_Rx_oRDR_FUSION_DET_089_092_oPCAN_RADAR_02793b2d_Rx: ComBitPosition=160, ComBitSize=15, ComSignalType=UINT16, ComSystemTemplateSystemSignalRef=DET_RANGE_VELOCITY_090_Rx
            DET_RANGE_VELOCITY_091_Rx_oRDR_FUSION_DET_089_092_oPCAN_RADAR_ad3da96a_Rx: ComBitPosition=272, ComBitSize=15, ComSignalType=UINT16, ComSystemTemplateSystemSignalRef=DET_RANGE_VELOCITY_091_Rx
            DET_RANGE_VELOCITY_092_Rx_oRDR_FUSION_DET_089_092_oPCAN_RADAR_878119e2_Rx: ComBitPosition=384, ComBitSize=15, ComSignalType=UINT16, ComSystemTemplateSystemSignalRef=DET_RANGE_VELOCITY_092_Rx
            DET_RANGE_VELOCITY_ERR_089_Rx_oRDR_FUSION_DET_089_092_oPCAN_RADAR_a63dc8f6_Rx: ComBitPosition=64, ComBitSize=8, ComSignalType=UINT8, ComSystemTemplateSystemSignalRef=DET_RANGE_VELOCITY_ERR_089_Rx
            DET_RANGE_VELOCITY_ERR_090_Rx_oRDR_FUSION_DET_089_092_oPCAN_RADAR_9b1d4bef_Rx: ComBitPosition=176, ComBitSize=8, ComSignalType=UINT8, ComSystemTemplateSystemSignalRef=DET_RANGE_VELOCITY_ERR_090_Rx
            DET_RANGE_VELOCITY_ERR_091_Rx_oRDR_FUSION_DET_089_092_oPCAN_RADAR_3459d9a8_Rx: ComBitPosition=288, ComBitSize=8, ComSignalType=UINT8, ComSystemTemplateSystemSignalRef=DET_RANGE_VELOCITY_ERR_091_Rx
            DET_RANGE_VELOCITY_ERR_092_Rx_oRDR_FUSION_DET_089_092_oPCAN_RADAR_1ee56920_Rx: ComBitPosition=400, ComBitSize=8, ComSignalType=UINT8, ComSystemTemplateSystemSignalRef=DET_RANGE_VELOCITY_ERR_092_Rx
            DET_RCS_089_Rx_oRDR_FUSION_DET_089_092_oPCAN_RADAR_f2922a2f_Rx: ComBitPosition=128, ComBitSize=8, ComSignalType=UINT8, ComSystemTemplateSystemSignalRef=DET_RCS_089_Rx
            DET_RCS_090_Rx_oRDR_FUSION_DET_089_092_oPCAN_RADAR_cfb2a936_Rx: ComBitPosition=240, ComBitSize=8, ComSignalType=UINT8, ComSystemTemplateSystemSignalRef=DET_RCS_090_Rx
            DET_RCS_091_Rx_oRDR_FUSION_DET_089_092_oPCAN_RADAR_60f63b71_Rx: ComBitPosition=352, ComBitSize=8, ComSignalType=UINT8, ComSystemTemplateSystemSignalRef=DET_RCS_091_Rx
            DET_RCS_092_Rx_oRDR_FUSION_DET_089_092_oPCAN_RADAR_4a4a8bf9_Rx: ComBitPosition=464, ComBitSize=8, ComSignalType=UINT8, ComSystemTemplateSystemSignalRef=DET_RCS_092_Rx
            DET_SNR_089_Rx_oRDR_FUSION_DET_089_092_oPCAN_RADAR_fbc85bc6_Rx: ComBitPosition=120, ComBitSize=8, ComSignalType=UINT8, ComSystemTemplateSystemSignalRef=DET_SNR_089_Rx
            DET_SNR_090_Rx_oRDR_FUSION_DET_089_092_oPCAN_RADAR_c6e8d8df_Rx: ComBitPosition=232, ComBitSize=8, ComSignalType=UINT8, ComSystemTemplateSystemSignalRef=DET_SNR_090_Rx
            DET_SNR_091_Rx_oRDR_FUSION_DET_089_092_oPCAN_RADAR_69ac4a98_Rx: ComBitPosition=344, ComBitSize=8, ComSignalType=UINT8, ComSystemTemplateSystemSignalRef=DET_SNR_091_Rx
            DET_SNR_092_Rx_oRDR_FUSION_DET_089_092_oPCAN_RADAR_4310fa10_Rx: ComBitPosition=456, ComBitSize=8, ComSignalType=UINT8, ComSystemTemplateSystemSignalRef=DET_SNR_092_Rx
            DET_SUPER_RES_TARGET_089_Rx_oRDR_FUSION_DET_089_092_oPCAN_RADAR_30337ac6_Rx: ComBitPosition=87, ComBitSize=1, ComSignalType=BOOLEAN, ComSystemTemplateSystemSignalRef=DET_SUPER_RES_TARGET_089_Rx
            DET_SUPER_RES_TARGET_090_Rx_oRDR_FUSION_DET_089_092_oPCAN_RADAR_0d13f9df_Rx: ComBitPosition=199, ComBitSize=1, ComSignalType=BOOLEAN, ComSystemTemplateSystemSignalRef=DET_SUPER_RES_TARGET_090_Rx
            DET_SUPER_RES_TARGET_091_Rx_oRDR_FUSION_DET_089_092_oPCAN_RADAR_a2576b98_Rx: ComBitPosition=311, ComBitSize=1, ComSignalType=BOOLEAN, ComSystemTemplateSystemSignalRef=DET_SUPER_RES_TARGET_091_Rx
            DET_SUPER_RES_TARGET_092_Rx_oRDR_FUSION_DET_089_092_oPCAN_RADAR_88ebdb10_Rx: ComBitPosition=423, ComBitSize=1, ComSignalType=BOOLEAN, ComSystemTemplateSystemSignalRef=DET_SUPER_RES_TARGET_092_Rx
        SG_Fusion_Detections_093_096_oRDR_FUSION_DET_093_096_oPCAN_RADAR_ebc9f7ef_Rx: ComTimeout=0, ComSystemTemplateSignalGroupRef=SG_Fusion_Detections_093_096
          83 x ComGroupSignal, all with ComSignalEndianness=LITTLE_ENDIAN, ComSignalInitValue=0:
            DET_AZIMUTH_093_Rx_oRDR_FUSION_DET_093_096_oPCAN_RADAR_fb315752_Rx: ComBitPosition=88, ComBitSize=13, ComSignalType=UINT16, ComSystemTemplateSystemSignalRef=DET_AZIMUTH_093_Rx
            DET_AZIMUTH_094_Rx_oRDR_FUSION_DET_093_096_oPCAN_RADAR_010ca405_Rx: ComBitPosition=200, ComBitSize=13, ComSignalType=UINT16, ComSystemTemplateSystemSignalRef=DET_AZIMUTH_094_Rx
            DET_AZIMUTH_095_Rx_oRDR_FUSION_DET_093_096_oPCAN_RADAR_ae483642_Rx: ComBitPosition=312, ComBitSize=13, ComSignalType=UINT16, ComSystemTemplateSystemSignalRef=DET_AZIMUTH_095_Rx
            DET_AZIMUTH_096_Rx_oRDR_FUSION_DET_093_096_oPCAN_RADAR_84f486ca_Rx: ComBitPosition=424, ComBitSize=13, ComSignalType=UINT16, ComSystemTemplateSystemSignalRef=DET_AZIMUTH_096_Rx
            DET_AZIMUTH_ERR_093_Rx_oRDR_FUSION_DET_093_096_oPCAN_RADAR_f958f6d0_Rx: ComBitPosition=105, ComBitSize=7, ComSignalType=UINT8, ComSystemTemplateSystemSignalRef=DET_AZIMUTH_ERR_093_Rx
            DET_AZIMUTH_ERR_094_Rx_oRDR_FUSION_DET_093_096_oPCAN_RADAR_03650587_Rx: ComBitPosition=217, ComBitSize=7, ComSignalType=UINT8, ComSystemTemplateSystemSignalRef=DET_AZIMUTH_ERR_094_Rx
            DET_AZIMUTH_ERR_095_Rx_oRDR_FUSION_DET_093_096_oPCAN_RADAR_ac2197c0_Rx: ComBitPosition=329, ComBitSize=7, ComSignalType=UINT8, ComSystemTemplateSystemSignalRef=DET_AZIMUTH_ERR_095_Rx
            DET_AZIMUTH_ERR_096_Rx_oRDR_FUSION_DET_093_096_oPCAN_RADAR_869d2748_Rx: ComBitPosition=441, ComBitSize=7, ComSignalType=UINT8, ComSystemTemplateSystemSignalRef=DET_AZIMUTH_ERR_096_Rx
            DET_BELOW_RAIN_THOLD_093_Rx_oRDR_FUSION_DET_093_096_oPCAN_RADAR_9d8ba8e7_Rx: ComBitPosition=39, ComBitSize=1, ComSignalType=BOOLEAN, ComSystemTemplateSystemSignalRef=DET_BELOW_RAIN_THOLD_093_Rx
            DET_BELOW_RAIN_THOLD_094_Rx_oRDR_FUSION_DET_093_096_oPCAN_RADAR_67b65bb0_Rx: ComBitPosition=151, ComBitSize=1, ComSignalType=BOOLEAN, ComSystemTemplateSystemSignalRef=DET_BELOW_RAIN_THOLD_094_Rx
            DET_BELOW_RAIN_THOLD_095_Rx_oRDR_FUSION_DET_093_096_oPCAN_RADAR_c8f2c9f7_Rx: ComBitPosition=263, ComBitSize=1, ComSignalType=BOOLEAN, ComSystemTemplateSystemSignalRef=DET_BELOW_RAIN_THOLD_095_Rx
            DET_BELOW_RAIN_THOLD_096_Rx_oRDR_FUSION_DET_093_096_oPCAN_RADAR_e24e797f_Rx: ComBitPosition=375, ComBitSize=1, ComSignalType=BOOLEAN, ComSystemTemplateSystemSignalRef=DET_BELOW_RAIN_THOLD_096_Rx
            DET_BI_STATIC_FLAG_093_Rx_oRDR_FUSION_DET_093_096_oPCAN_RADAR_ea1503f4_Rx: ComBitPosition=104, ComBitSize=1, ComSignalType=BOOLEAN, ComSystemTemplateSystemSignalRef=DET_BI_STATIC_FLAG_093_Rx
            DET_BI_STATIC_FLAG_094_Rx_oRDR_FUSION_DET_093_096_oPCAN_RADAR_1028f0a3_Rx: ComBitPosition=216, ComBitSize=1, ComSignalType=BOOLEAN, ComSystemTemplateSystemSignalRef=DET_BI_STATIC_FLAG_094_Rx
            DET_BI_STATIC_FLAG_095_Rx_oRDR_FUSION_DET_093_096_oPCAN_RADAR_bf6c62e4_Rx: ComBitPosition=328, ComBitSize=1, ComSignalType=BOOLEAN, ComSystemTemplateSystemSignalRef=DET_BI_STATIC_FLAG_095_Rx
            DET_BI_STATIC_FLAG_096_Rx_oRDR_FUSION_DET_093_096_oPCAN_RADAR_95d0d26c_Rx: ComBitPosition=440, ComBitSize=1, ComSignalType=BOOLEAN, ComSystemTemplateSystemSignalRef=DET_BI_STATIC_FLAG_096_Rx
            DET_CONFD_AZIMUTH_093_Rx_oRDR_FUSION_DET_093_096_oPCAN_RADAR_097ce9a0_Rx: ComBitPosition=118, ComBitSize=2, ComSignalType=UINT8, ComSystemTemplateSystemSignalRef=DET_CONFD_AZIMUTH_093_Rx
            DET_CONFD_AZIMUTH_094_Rx_oRDR_FUSION_DET_093_096_oPCAN_RADAR_f3411af7_Rx: ComBitPosition=230, ComBitSize=2, ComSignalType=UINT8, ComSystemTemplateSystemSignalRef=DET_CONFD_AZIMUTH_094_Rx
            DET_CONFD_AZIMUTH_095_Rx_oRDR_FUSION_DET_093_096_oPCAN_RADAR_5c0588b0_Rx: ComBitPosition=342, ComBitSize=2, ComSignalType=UINT8, ComSystemTemplateSystemSignalRef=DET_CONFD_AZIMUTH_095_Rx
            DET_CONFD_AZIMUTH_096_Rx_oRDR_FUSION_DET_093_096_oPCAN_RADAR_76b93838_Rx: ComBitPosition=454, ComBitSize=2, ComSignalType=UINT8, ComSystemTemplateSystemSignalRef=DET_CONFD_AZIMUTH_096_Rx
            DET_CONFD_ELEVATION_093_Rx_oRDR_FUSION_DET_093_096_oPCAN_RADAR_035d6a27_Rx: ComBitPosition=101, ComBitSize=2, ComSignalType=UINT8, ComSystemTemplateSystemSignalRef=DET_CONFD_ELEVATION_093_Rx
            DET_CONFD_ELEVATION_094_Rx_oRDR_FUSION_DET_093_096_oPCAN_RADAR_f9609970_Rx: ComBitPosition=213, ComBitSize=2, ComSignalType=UINT8, ComSystemTemplateSystemSignalRef=DET_CONFD_ELEVATION_094_Rx
            DET_CONFD_ELEVATION_095_Rx_oRDR_FUSION_DET_093_096_oPCAN_RADAR_56240b37_Rx: ComBitPosition=325, ComBitSize=2, ComSignalType=UINT8, ComSystemTemplateSystemSignalRef=DET_CONFD_ELEVATION_095_Rx
            DET_CONFD_ELEVATION_096_Rx_oRDR_FUSION_DET_093_096_oPCAN_RADAR_7c98bbbf_Rx: ComBitPosition=437, ComBitSize=2, ComSignalType=UINT8, ComSystemTemplateSystemSignalRef=DET_CONFD_ELEVATION_096_Rx
            DET_ELEVATION_093_Rx_oRDR_FUSION_DET_093_096_oPCAN_RADAR_090e85de_Rx: ComBitPosition=72, ComBitSize=8, ComSignalType=UINT8, ComSystemTemplateSystemSignalRef=DET_ELEVATION_093_Rx
            DET_ELEVATION_094_Rx_oRDR_FUSION_DET_093_096_oPCAN_RADAR_f3337689_Rx: ComBitPosition=184, ComBitSize=8, ComSignalType=UINT8, ComSystemTemplateSystemSignalRef=DET_ELEVATION_094_Rx
            DET_ELEVATION_095_Rx_oRDR_FUSION_DET_093_096_oPCAN_RADAR_5c77e4ce_Rx: ComBitPosition=296, ComBitSize=8, ComSignalType=UINT8, ComSystemTemplateSystemSignalRef=DET_ELEVATION_095_Rx
            DET_ELEVATION_096_Rx_oRDR_FUSION_DET_093_096_oPCAN_RADAR_76cb5446_Rx: ComBitPosition=408, ComBitSize=8, ComSignalType=UINT8, ComSystemTemplateSystemSignalRef=DET_ELEVATION_096_Rx
            DET_ELEVATION_ERR_093_Rx_oRDR_FUSION_DET_093_096_oPCAN_RADAR_dbb7a701_Rx: ComBitPosition=80, ComBitSize=6, ComSignalType=UINT8, ComSystemTemplateSystemSignalRef=DET_ELEVATION_ERR_093_Rx
            DET_ELEVATION_ERR_094_Rx_oRDR_FUSION_DET_093_096_oPCAN_RADAR_218a5456_Rx: ComBitPosition=192, ComBitSize=6, ComSignalType=UINT8, ComSystemTemplateSystemSignalRef=DET_ELEVATION_ERR_094_Rx
            DET_ELEVATION_ERR_095_Rx_oRDR_FUSION_DET_093_096_oPCAN_RADAR_8ecec611_Rx: ComBitPosition=304, ComBitSize=6, ComSignalType=UINT8, ComSystemTemplateSystemSignalRef=DET_ELEVATION_ERR_095_Rx
            DET_ELEVATION_ERR_096_Rx_oRDR_FUSION_DET_093_096_oPCAN_RADAR_a4727699_Rx: ComBitPosition=416, ComBitSize=6, ComSignalType=UINT8, ComSystemTemplateSystemSignalRef=DET_ELEVATION_ERR_096_Rx
            DET_EXISTENCE_PROB_093_Rx_oRDR_FUSION_DET_093_096_oPCAN_RADAR_2cafdf94_Rx: ComBitPosition=112, ComBitSize=6, ComSignalType=UINT8, ComSystemTemplateSystemSignalRef=DET_EXISTENCE_PROB_093_Rx
            DET_EXISTENCE_PROB_094_Rx_oRDR_FUSION_DET_093_096_oPCAN_RADAR_d6922cc3_Rx: ComBitPosition=224, ComBitSize=6, ComSignalType=UINT8, ComSystemTemplateSystemSignalRef=DET_EXISTENCE_PROB_094_Rx
            DET_EXISTENCE_PROB_095_Rx_oRDR_FUSION_DET_093_096_oPCAN_RADAR_79d6be84_Rx: ComBitPosition=336, ComBitSize=6, ComSignalType=UINT8, ComSystemTemplateSystemSignalRef=DET_EXISTENCE_PROB_095_Rx
            DET_EXISTENCE_PROB_096_Rx_oRDR_FUSION_DET_093_096_oPCAN_RADAR_536a0e0c_Rx: ComBitPosition=448, ComBitSize=6, ComSignalType=UINT8, ComSystemTemplateSystemSignalRef=DET_EXISTENCE_PROB_096_Rx
            DET_HVC_FLAG_093_Rx_oRDR_FUSION_DET_093_096_oPCAN_RADAR_f17132db_Rx: ComBitPosition=86, ComBitSize=1, ComSignalType=BOOLEAN, ComSystemTemplateSystemSignalRef=DET_HVC_FLAG_093_Rx
            DET_HVC_FLAG_094_Rx_oRDR_FUSION_DET_093_096_oPCAN_RADAR_0b4cc18c_Rx: ComBitPosition=198, ComBitSize=1, ComSignalType=BOOLEAN, ComSystemTemplateSystemSignalRef=DET_HVC_FLAG_094_Rx
            DET_HVC_FLAG_095_Rx_oRDR_FUSION_DET_093_096_oPCAN_RADAR_a40853cb_Rx: ComBitPosition=310, ComBitSize=1, ComSignalType=BOOLEAN, ComSystemTemplateSystemSignalRef=DET_HVC_FLAG_095_Rx
            DET_HVC_FLAG_096_Rx_oRDR_FUSION_DET_093_096_oPCAN_RADAR_8eb4e343_Rx: ComBitPosition=422, ComBitSize=1, ComSignalType=BOOLEAN, ComSystemTemplateSystemSignalRef=DET_HVC_FLAG_096_Rx
            DET_IDM_093_Rx_oRDR_FUSION_DET_093_096_oPCAN_RADAR_c4b0cb93_Rx: ComBitPosition=63, ComBitSize=1, ComSignalType=BOOLEAN, ComSystemTemplateSystemSignalRef=DET_IDM_093_Rx
            DET_IDM_094_Rx_oRDR_FUSION_DET_093_096_oPCAN_RADAR_3e8d38c4_Rx: ComBitPosition=175, ComBitSize=1, ComSignalType=BOOLEAN, ComSystemTemplateSystemSignalRef=DET_IDM_094_Rx
            DET_IDM_095_Rx_oRDR_FUSION_DET_093_096_oPCAN_RADAR_91c9aa83_Rx: ComBitPosition=287, ComBitSize=1, ComSignalType=BOOLEAN, ComSystemTemplateSystemSignalRef=DET_IDM_095_Rx
            DET_IDM_096_Rx_oRDR_FUSION_DET_093_096_oPCAN_RADAR_bb751a0b_Rx: ComBitPosition=399, ComBitSize=1, ComSignalType=BOOLEAN, ComSystemTemplateSystemSignalRef=DET_IDM_096_Rx
            DET_MH_CRC16_093_096_Rx_oRDR_FUSION_DET_093_096_oPCAN_RADAR_367232ed_Rx: ComBitPosition=0, ComBitSize=16, ComSignalType=UINT16, ComSystemTemplateSystemSignalRef=DET_MH_CRC16_093_096_Rx
            DET_MH_CYCLE_COUNTER_093_096_Rx_oRDR_FUSION_DET_093_096_oPCAN_RADAR_3ba90f28_Rx: ComBitPosition=16, ComBitSize=8, ComSignalType=UINT8, ComSystemTemplateSystemSignalRef=DET_MH_CYCLE_COUNTER_093_096_Rx
            DET_MH_SCAN_INDEX_4LSB_093_096_Rx_oRDR_FUSION_DET_093_096_oPCAN_RADAR_5f19c013_Rx: ComBitPosition=476, ComBitSize=4, ComSignalType=UINT8, ComSystemTemplateSystemSignalRef=DET_MH_SCAN_INDEX_4LSB_093_096_Rx
            DET_MTD_093_Rx_oRDR_FUSION_DET_093_096_oPCAN_RADAR_7933fde3_Rx: ComBitPosition=47, ComBitSize=1, ComSignalType=BOOLEAN, ComSystemTemplateSystemSignalRef=DET_MTD_093_Rx
            DET_MTD_094_Rx_oRDR_FUSION_DET_093_096_oPCAN_RADAR_830e0eb4_Rx: ComBitPosition=159, ComBitSize=1, ComSignalType=BOOLEAN, ComSystemTemplateSystemSignalRef=DET_MTD_094_Rx
            DET_MTD_095_Rx_oRDR_FUSION_DET_093_096_oPCAN_RADAR_2c4a9cf3_Rx: ComBitPosition=271, ComBitSize=1, ComSignalType=BOOLEAN, ComSystemTemplateSystemSignalRef=DET_MTD_095_Rx
            DET_MTD_096_Rx_oRDR_FUSION_DET_093_096_oPCAN_RADAR_06f62c7b_Rx: ComBitPosition=383, ComBitSize=1, ComSignalType=BOOLEAN, ComSystemTemplateSystemSignalRef=DET_MTD_096_Rx
            DET_PROB_1STAZHYPO_093_Rx_oRDR_FUSION_DET_093_096_oPCAN_RADAR_b34ae362_Rx: ComBitPosition=103, ComBitSize=1, ComSignalType=BOOLEAN, ComSystemTemplateSystemSignalRef=DET_PROB_1STAZHYPO_093_Rx
            DET_PROB_1STAZHYPO_094_Rx_oRDR_FUSION_DET_093_096_oPCAN_RADAR_49771035_Rx: ComBitPosition=215, ComBitSize=1, ComSignalType=BOOLEAN, ComSystemTemplateSystemSignalRef=DET_PROB_1STAZHYPO_094_Rx
            DET_PROB_1STAZHYPO_095_Rx_oRDR_FUSION_DET_093_096_oPCAN_RADAR_e6338272_Rx: ComBitPosition=327, ComBitSize=1, ComSignalType=BOOLEAN, ComSystemTemplateSystemSignalRef=DET_PROB_1STAZHYPO_095_Rx
            DET_PROB_1STAZHYPO_096_Rx_oRDR_FUSION_DET_093_096_oPCAN_RADAR_cc8f32fa_Rx: ComBitPosition=439, ComBitSize=1, ComSignalType=BOOLEAN, ComSystemTemplateSystemSignalRef=DET_PROB_1STAZHYPO_096_Rx
            DET_RANGE_093_Rx_oRDR_FUSION_DET_093_096_oPCAN_RADAR_e8f70b75_Rx: ComBitPosition=24, ComBitSize=15, ComSignalType=UINT16, ComSystemTemplateSystemSignalRef=DET_RANGE_093_Rx
            DET_RANGE_094_Rx_oRDR_FUSION_DET_093_096_oPCAN_RADAR_12caf822_Rx: ComBitPosition=136, ComBitSize=15, ComSignalType=UINT16, ComSystemTemplateSystemSignalRef=DET_RANGE_094_Rx
            DET_RANGE_095_Rx_oRDR_FUSION_DET_093_096_oPCAN_RADAR_bd8e6a65_Rx: ComBitPosition=248, ComBitSize=15, ComSignalType=UINT16, ComSystemTemplateSystemSignalRef=DET_RANGE_095_Rx
            DET_RANGE_096_Rx_oRDR_FUSION_DET_093_096_oPCAN_RADAR_9732daed_Rx: ComBitPosition=360, ComBitSize=15, ComSignalType=UINT16, ComSystemTemplateSystemSignalRef=DET_RANGE_096_Rx
            DET_RANGE_ERR_093_Rx_oRDR_FUSION_DET_093_096_oPCAN_RADAR_b8058795_Rx: ComBitPosition=40, ComBitSize=7, ComSignalType=UINT8, ComSystemTemplateSystemSignalRef=DET_RANGE_ERR_093_Rx
            DET_RANGE_ERR_094_Rx_oRDR_FUSION_DET_093_096_oPCAN_RADAR_423874c2_Rx: ComBitPosition=152, ComBitSize=7, ComSignalType=UINT8, ComSystemTemplateSystemSignalRef=DET_RANGE_ERR_094_Rx
            DET_RANGE_ERR_095_Rx_oRDR_FUSION_DET_093_096_oPCAN_RADAR_ed7ce685_Rx: ComBitPosition=264, ComBitSize=7, ComSignalType=UINT8, ComSystemTemplateSystemSignalRef=DET_RANGE_ERR_095_Rx
            DET_RANGE_ERR_096_Rx_oRDR_FUSION_DET_093_096_oPCAN_RADAR_c7c0560d_Rx: ComBitPosition=376, ComBitSize=7, ComSignalType=UINT8, ComSystemTemplateSystemSignalRef=DET_RANGE_ERR_096_Rx
            DET_RANGE_VELOCITY_093_Rx_oRDR_FUSION_DET_093_096_oPCAN_RADAR_3502888b_Rx: ComBitPosition=48, ComBitSize=15, ComSignalType=UINT16, ComSystemTemplateSystemSignalRef=DET_RANGE_VELOCITY_093_Rx
            DET_RANGE_VELOCITY_094_Rx_oRDR_FUSION_DET_093_096_oPCAN_RADAR_cf3f7bdc_Rx: ComBitPosition=160, ComBitSize=15, ComSignalType=UINT16, ComSystemTemplateSystemSignalRef=DET_RANGE_VELOCITY_094_Rx
            DET_RANGE_VELOCITY_095_Rx_oRDR_FUSION_DET_093_096_oPCAN_RADAR_607be99b_Rx: ComBitPosition=272, ComBitSize=15, ComSignalType=UINT16, ComSystemTemplateSystemSignalRef=DET_RANGE_VELOCITY_095_Rx
            DET_RANGE_VELOCITY_096_Rx_oRDR_FUSION_DET_093_096_oPCAN_RADAR_4ac75913_Rx: ComBitPosition=384, ComBitSize=15, ComSignalType=UINT16, ComSystemTemplateSystemSignalRef=DET_RANGE_VELOCITY_096_Rx
            DET_RANGE_VELOCITY_ERR_093_Rx_oRDR_FUSION_DET_093_096_oPCAN_RADAR_ac66f849_Rx: ComBitPosition=64, ComBitSize=8, ComSignalType=UINT8, ComSystemTemplateSystemSignalRef=DET_RANGE_VELOCITY_ERR_093_Rx
            DET_RANGE_VELOCITY_ERR_094_Rx_oRDR_FUSION_DET_093_096_oPCAN_RADAR_565b0b1e_Rx: ComBitPosition=176, ComBitSize=8, ComSignalType=UINT8, ComSystemTemplateSystemSignalRef=DET_RANGE_VELOCITY_ERR_094_Rx
            DET_RANGE_VELOCITY_ERR_095_Rx_oRDR_FUSION_DET_093_096_oPCAN_RADAR_f91f9959_Rx: ComBitPosition=288, ComBitSize=8, ComSignalType=UINT8, ComSystemTemplateSystemSignalRef=DET_RANGE_VELOCITY_ERR_095_Rx
            DET_RANGE_VELOCITY_ERR_096_Rx_oRDR_FUSION_DET_093_096_oPCAN_RADAR_d3a329d1_Rx: ComBitPosition=400, ComBitSize=8, ComSignalType=UINT8, ComSystemTemplateSystemSignalRef=DET_RANGE_VELOCITY_ERR_096_Rx
            DET_RCS_093_Rx_oRDR_FUSION_DET_093_096_oPCAN_RADAR_f8c91a90_Rx: ComBitPosition=128, ComBitSize=8, ComSignalType=UINT8, ComSystemTemplateSystemSignalRef=DET_RCS_093_Rx
            DET_RCS_094_Rx_oRDR_FUSION_DET_093_096_oPCAN_RADAR_02f4e9c7_Rx: ComBitPosition=240, ComBitSize=8, ComSignalType=UINT8, ComSystemTemplateSystemSignalRef=DET_RCS_094_Rx
            DET_RCS_095_Rx_oRDR_FUSION_DET_093_096_oPCAN_RADAR_adb07b80_Rx: ComBitPosition=352, ComBitSize=8, ComSignalType=UINT8, ComSystemTemplateSystemSignalRef=DET_RCS_095_Rx
            DET_RCS_096_Rx_oRDR_FUSION_DET_093_096_oPCAN_RADAR_870ccb08_Rx: ComBitPosition=464, ComBitSize=8, ComSignalType=UINT8, ComSystemTemplateSystemSignalRef=DET_RCS_096_Rx
            DET_SNR_093_Rx_oRDR_FUSION_DET_093_096_oPCAN_RADAR_f1936b79_Rx: ComBitPosition=120, ComBitSize=8, ComSignalType=UINT8, ComSystemTemplateSystemSignalRef=DET_SNR_093_Rx
            DET_SNR_094_Rx_oRDR_FUSION_DET_093_096_oPCAN_RADAR_0bae982e_Rx: ComBitPosition=232, ComBitSize=8, ComSignalType=UINT8, ComSystemTemplateSystemSignalRef=DET_SNR_094_Rx
            DET_SNR_095_Rx_oRDR_FUSION_DET_093_096_oPCAN_RADAR_a4ea0a69_Rx: ComBitPosition=344, ComBitSize=8, ComSignalType=UINT8, ComSystemTemplateSystemSignalRef=DET_SNR_095_Rx
            DET_SNR_096_Rx_oRDR_FUSION_DET_093_096_oPCAN_RADAR_8e56bae1_Rx: ComBitPosition=456, ComBitSize=8, ComSignalType=UINT8, ComSystemTemplateSystemSignalRef=DET_SNR_096_Rx
            DET_SUPER_RES_TARGET_093_Rx_oRDR_FUSION_DET_093_096_oPCAN_RADAR_3a684a79_Rx: ComBitPosition=87, ComBitSize=1, ComSignalType=BOOLEAN, ComSystemTemplateSystemSignalRef=DET_SUPER_RES_TARGET_093_Rx
            DET_SUPER_RES_TARGET_094_Rx_oRDR_FUSION_DET_093_096_oPCAN_RADAR_c055b92e_Rx: ComBitPosition=199, ComBitSize=1, ComSignalType=BOOLEAN, ComSystemTemplateSystemSignalRef=DET_SUPER_RES_TARGET_094_Rx
            DET_SUPER_RES_TARGET_095_Rx_oRDR_FUSION_DET_093_096_oPCAN_RADAR_6f112b69_Rx: ComBitPosition=311, ComBitSize=1, ComSignalType=BOOLEAN, ComSystemTemplateSystemSignalRef=DET_SUPER_RES_TARGET_095_Rx
            DET_SUPER_RES_TARGET_096_Rx_oRDR_FUSION_DET_093_096_oPCAN_RADAR_45ad9be1_Rx: ComBitPosition=423, ComBitSize=1, ComSignalType=BOOLEAN, ComSystemTemplateSystemSignalRef=DET_SUPER_RES_TARGET_096_Rx
        SG_Fusion_Detections_097_100_oRDR_FUSION_DET_097_100_oPCAN_RADAR_f997174e_Rx: ComTimeout=0, ComSystemTemplateSignalGroupRef=SG_Fusion_Detections_097_100
          83 x ComGroupSignal, all with ComSignalEndianness=LITTLE_ENDIAN, ComSignalInitValue=0:
            DET_AZIMUTH_097_Rx_oRDR_FUSION_DET_097_100_oPCAN_RADAR_eff0c837_Rx: ComBitPosition=88, ComBitSize=13, ComSignalType=UINT16, ComSystemTemplateSystemSignalRef=DET_AZIMUTH_097_Rx
            DET_AZIMUTH_098_Rx_oRDR_FUSION_DET_097_100_oPCAN_RADAR_6fbeba9f_Rx: ComBitPosition=200, ComBitSize=13, ComSignalType=UINT16, ComSystemTemplateSystemSignalRef=DET_AZIMUTH_098_Rx
            DET_AZIMUTH_099_Rx_oRDR_FUSION_DET_097_100_oPCAN_RADAR_c0fa28d8_Rx: ComBitPosition=312, ComBitSize=13, ComSignalType=UINT16, ComSystemTemplateSystemSignalRef=DET_AZIMUTH_099_Rx
            DET_AZIMUTH_100_Rx_oRDR_FUSION_DET_097_100_oPCAN_RADAR_719bb323_Rx: ComBitPosition=424, ComBitSize=13, ComSignalType=UINT16, ComSystemTemplateSystemSignalRef=DET_AZIMUTH_100_Rx
            DET_AZIMUTH_ERR_097_Rx_oRDR_FUSION_DET_097_100_oPCAN_RADAR_ed9969b5_Rx: ComBitPosition=105, ComBitSize=7, ComSignalType=UINT8, ComSystemTemplateSystemSignalRef=DET_AZIMUTH_ERR_097_Rx
            DET_AZIMUTH_ERR_098_Rx_oRDR_FUSION_DET_097_100_oPCAN_RADAR_6dd71b1d_Rx: ComBitPosition=217, ComBitSize=7, ComSignalType=UINT8, ComSystemTemplateSystemSignalRef=DET_AZIMUTH_ERR_098_Rx
            DET_AZIMUTH_ERR_099_Rx_oRDR_FUSION_DET_097_100_oPCAN_RADAR_c293895a_Rx: ComBitPosition=329, ComBitSize=7, ComSignalType=UINT8, ComSystemTemplateSystemSignalRef=DET_AZIMUTH_ERR_099_Rx
            DET_AZIMUTH_ERR_100_Rx_oRDR_FUSION_DET_097_100_oPCAN_RADAR_73f212a1_Rx: ComBitPosition=441, ComBitSize=7, ComSignalType=UINT8, ComSystemTemplateSystemSignalRef=DET_AZIMUTH_ERR_100_Rx
            DET_BELOW_RAIN_THOLD_097_Rx_oRDR_FUSION_DET_097_100_oPCAN_RADAR_894a3782_Rx: ComBitPosition=39, ComBitSize=1, ComSignalType=BOOLEAN, ComSystemTemplateSystemSignalRef=DET_BELOW_RAIN_THOLD_097_Rx
            DET_BELOW_RAIN_THOLD_098_Rx_oRDR_FUSION_DET_097_100_oPCAN_RADAR_0904452a_Rx: ComBitPosition=151, ComBitSize=1, ComSignalType=BOOLEAN, ComSystemTemplateSystemSignalRef=DET_BELOW_RAIN_THOLD_098_Rx
            DET_BELOW_RAIN_THOLD_099_Rx_oRDR_FUSION_DET_097_100_oPCAN_RADAR_a640d76d_Rx: ComBitPosition=263, ComBitSize=1, ComSignalType=BOOLEAN, ComSystemTemplateSystemSignalRef=DET_BELOW_RAIN_THOLD_099_Rx
            DET_BELOW_RAIN_THOLD_100_Rx_oRDR_FUSION_DET_097_100_oPCAN_RADAR_17214c96_Rx: ComBitPosition=375, ComBitSize=1, ComSignalType=BOOLEAN, ComSystemTemplateSystemSignalRef=DET_BELOW_RAIN_THOLD_100_Rx
            DET_BI_STATIC_FLAG_097_Rx_oRDR_FUSION_DET_097_100_oPCAN_RADAR_fed49c91_Rx: ComBitPosition=104, ComBitSize=1, ComSignalType=BOOLEAN, ComSystemTemplateSystemSignalRef=DET_BI_STATIC_FLAG_097_Rx
            DET_BI_STATIC_FLAG_098_Rx_oRDR_FUSION_DET_097_100_oPCAN_RADAR_7e9aee39_Rx: ComBitPosition=216, ComBitSize=1, ComSignalType=BOOLEAN, ComSystemTemplateSystemSignalRef=DET_BI_STATIC_FLAG_098_Rx
            DET_BI_STATIC_FLAG_099_Rx_oRDR_FUSION_DET_097_100_oPCAN_RADAR_d1de7c7e_Rx: ComBitPosition=328, ComBitSize=1, ComSignalType=BOOLEAN, ComSystemTemplateSystemSignalRef=DET_BI_STATIC_FLAG_099_Rx
            DET_BI_STATIC_FLAG_100_Rx_oRDR_FUSION_DET_097_100_oPCAN_RADAR_60bfe785_Rx: ComBitPosition=440, ComBitSize=1, ComSignalType=BOOLEAN, ComSystemTemplateSystemSignalRef=DET_BI_STATIC_FLAG_100_Rx
            DET_CONFD_AZIMUTH_097_Rx_oRDR_FUSION_DET_097_100_oPCAN_RADAR_1dbd76c5_Rx: ComBitPosition=118, ComBitSize=2, ComSignalType=UINT8, ComSystemTemplateSystemSignalRef=DET_CONFD_AZIMUTH_097_Rx
            DET_CONFD_AZIMUTH_098_Rx_oRDR_FUSION_DET_097_100_oPCAN_RADAR_9df3046d_Rx: ComBitPosition=230, ComBitSize=2, ComSignalType=UINT8, ComSystemTemplateSystemSignalRef=DET_CONFD_AZIMUTH_098_Rx
            DET_CONFD_AZIMUTH_099_Rx_oRDR_FUSION_DET_097_100_oPCAN_RADAR_32b7962a_Rx: ComBitPosition=342, ComBitSize=2, ComSignalType=UINT8, ComSystemTemplateSystemSignalRef=DET_CONFD_AZIMUTH_099_Rx
            DET_CONFD_AZIMUTH_100_Rx_oRDR_FUSION_DET_097_100_oPCAN_RADAR_83d60dd1_Rx: ComBitPosition=454, ComBitSize=2, ComSignalType=UINT8, ComSystemTemplateSystemSignalRef=DET_CONFD_AZIMUTH_100_Rx
            DET_CONFD_ELEVATION_097_Rx_oRDR_FUSION_DET_097_100_oPCAN_RADAR_179cf542_Rx: ComBitPosition=101, ComBitSize=2, ComSignalType=UINT8, ComSystemTemplateSystemSignalRef=DET_CONFD_ELEVATION_097_Rx
            DET_CONFD_ELEVATION_098_Rx_oRDR_FUSION_DET_097_100_oPCAN_RADAR_97d287ea_Rx: ComBitPosition=213, ComBitSize=2, ComSignalType=UINT8, ComSystemTemplateSystemSignalRef=DET_CONFD_ELEVATION_098_Rx
            DET_CONFD_ELEVATION_099_Rx_oRDR_FUSION_DET_097_100_oPCAN_RADAR_389615ad_Rx: ComBitPosition=325, ComBitSize=2, ComSignalType=UINT8, ComSystemTemplateSystemSignalRef=DET_CONFD_ELEVATION_099_Rx
            DET_CONFD_ELEVATION_100_Rx_oRDR_FUSION_DET_097_100_oPCAN_RADAR_89f78e56_Rx: ComBitPosition=437, ComBitSize=2, ComSignalType=UINT8, ComSystemTemplateSystemSignalRef=DET_CONFD_ELEVATION_100_Rx
            DET_ELEVATION_097_Rx_oRDR_FUSION_DET_097_100_oPCAN_RADAR_1dcf1abb_Rx: ComBitPosition=72, ComBitSize=8, ComSignalType=UINT8, ComSystemTemplateSystemSignalRef=DET_ELEVATION_097_Rx
            DET_ELEVATION_098_Rx_oRDR_FUSION_DET_097_100_oPCAN_RADAR_9d816813_Rx: ComBitPosition=184, ComBitSize=8, ComSignalType=UINT8, ComSystemTemplateSystemSignalRef=DET_ELEVATION_098_Rx
            DET_ELEVATION_099_Rx_oRDR_FUSION_DET_097_100_oPCAN_RADAR_32c5fa54_Rx: ComBitPosition=296, ComBitSize=8, ComSignalType=UINT8, ComSystemTemplateSystemSignalRef=DET_ELEVATION_099_Rx
            DET_ELEVATION_100_Rx_oRDR_FUSION_DET_097_100_oPCAN_RADAR_83a461af_Rx: ComBitPosition=408, ComBitSize=8, ComSignalType=UINT8, ComSystemTemplateSystemSignalRef=DET_ELEVATION_100_Rx
            DET_ELEVATION_ERR_097_Rx_oRDR_FUSION_DET_097_100_oPCAN_RADAR_cf763864_Rx: ComBitPosition=80, ComBitSize=6, ComSignalType=UINT8, ComSystemTemplateSystemSignalRef=DET_ELEVATION_ERR_097_Rx
            DET_ELEVATION_ERR_098_Rx_oRDR_FUSION_DET_097_100_oPCAN_RADAR_4f384acc_Rx: ComBitPosition=192, ComBitSize=6, ComSignalType=UINT8, ComSystemTemplateSystemSignalRef=DET_ELEVATION_ERR_098_Rx
            DET_ELEVATION_ERR_099_Rx_oRDR_FUSION_DET_097_100_oPCAN_RADAR_e07cd88b_Rx: ComBitPosition=304, ComBitSize=6, ComSignalType=UINT8, ComSystemTemplateSystemSignalRef=DET_ELEVATION_ERR_099_Rx
            DET_ELEVATION_ERR_100_Rx_oRDR_FUSION_DET_097_100_oPCAN_RADAR_511d4370_Rx: ComBitPosition=416, ComBitSize=6, ComSignalType=UINT8, ComSystemTemplateSystemSignalRef=DET_ELEVATION_ERR_100_Rx
            DET_EXISTENCE_PROB_097_Rx_oRDR_FUSION_DET_097_100_oPCAN_RADAR_386e40f1_Rx: ComBitPosition=112, ComBitSize=6, ComSignalType=UINT8, ComSystemTemplateSystemSignalRef=DET_EXISTENCE_PROB_097_Rx
            DET_EXISTENCE_PROB_098_Rx_oRDR_FUSION_DET_097_100_oPCAN_RADAR_b8203259_Rx: ComBitPosition=224, ComBitSize=6, ComSignalType=UINT8, ComSystemTemplateSystemSignalRef=DET_EXISTENCE_PROB_098_Rx
            DET_EXISTENCE_PROB_099_Rx_oRDR_FUSION_DET_097_100_oPCAN_RADAR_1764a01e_Rx: ComBitPosition=336, ComBitSize=6, ComSignalType=UINT8, ComSystemTemplateSystemSignalRef=DET_EXISTENCE_PROB_099_Rx
            DET_EXISTENCE_PROB_100_Rx_oRDR_FUSION_DET_097_100_oPCAN_RADAR_a6053be5_Rx: ComBitPosition=448, ComBitSize=6, ComSignalType=UINT8, ComSystemTemplateSystemSignalRef=DET_EXISTENCE_PROB_100_Rx
            DET_HVC_FLAG_097_Rx_oRDR_FUSION_DET_097_100_oPCAN_RADAR_e5b0adbe_Rx: ComBitPosition=86, ComBitSize=1, ComSignalType=BOOLEAN, ComSystemTemplateSystemSignalRef=DET_HVC_FLAG_097_Rx
            DET_HVC_FLAG_098_Rx_oRDR_FUSION_DET_097_100_oPCAN_RADAR_65fedf16_Rx: ComBitPosition=198, ComBitSize=1, ComSignalType=BOOLEAN, ComSystemTemplateSystemSignalRef=DET_HVC_FLAG_098_Rx
            DET_HVC_FLAG_099_Rx_oRDR_FUSION_DET_097_100_oPCAN_RADAR_caba4d51_Rx: ComBitPosition=310, ComBitSize=1, ComSignalType=BOOLEAN, ComSystemTemplateSystemSignalRef=DET_HVC_FLAG_099_Rx
            DET_HVC_FLAG_100_Rx_oRDR_FUSION_DET_097_100_oPCAN_RADAR_7bdbd6aa_Rx: ComBitPosition=422, ComBitSize=1, ComSignalType=BOOLEAN, ComSystemTemplateSystemSignalRef=DET_HVC_FLAG_100_Rx
            DET_IDM_097_Rx_oRDR_FUSION_DET_097_100_oPCAN_RADAR_d07154f6_Rx: ComBitPosition=63, ComBitSize=1, ComSignalType=BOOLEAN, ComSystemTemplateSystemSignalRef=DET_IDM_097_Rx
            DET_IDM_098_Rx_oRDR_FUSION_DET_097_100_oPCAN_RADAR_503f265e_Rx: ComBitPosition=175, ComBitSize=1, ComSignalType=BOOLEAN, ComSystemTemplateSystemSignalRef=DET_IDM_098_Rx
            DET_IDM_099_Rx_oRDR_FUSION_DET_097_100_oPCAN_RADAR_ff7bb419_Rx: ComBitPosition=287, ComBitSize=1, ComSignalType=BOOLEAN, ComSystemTemplateSystemSignalRef=DET_IDM_099_Rx
            DET_IDM_100_Rx_oRDR_FUSION_DET_097_100_oPCAN_RADAR_4e1a2fe2_Rx: ComBitPosition=399, ComBitSize=1, ComSignalType=BOOLEAN, ComSystemTemplateSystemSignalRef=DET_IDM_100_Rx
            DET_MH_CRC16_097_100_Rx_oRDR_FUSION_DET_097_100_oPCAN_RADAR_6bbde68c_Rx: ComBitPosition=0, ComBitSize=16, ComSignalType=UINT16, ComSystemTemplateSystemSignalRef=DET_MH_CRC16_097_100_Rx
            DET_MH_CYCLE_COUNTER_097_100_Rx_oRDR_FUSION_DET_097_100_oPCAN_RADAR_6666db49_Rx: ComBitPosition=16, ComBitSize=8, ComSignalType=UINT8, ComSystemTemplateSystemSignalRef=DET_MH_CYCLE_COUNTER_097_100_Rx
            DET_MH_SCAN_INDEX_4LSB_097_100_Rx_oRDR_FUSION_DET_097_100_oPCAN_RADAR_02d61472_Rx: ComBitPosition=476, ComBitSize=4, ComSignalType=UINT8, ComSystemTemplateSystemSignalRef=DET_MH_SCAN_INDEX_4LSB_097_100_Rx
            DET_MTD_097_Rx_oRDR_FUSION_DET_097_100_oPCAN_RADAR_6df26286_Rx: ComBitPosition=47, ComBitSize=1, ComSignalType=BOOLEAN, ComSystemTemplateSystemSignalRef=DET_MTD_097_Rx
            DET_MTD_098_Rx_oRDR_FUSION_DET_097_100_oPCAN_RADAR_edbc102e_Rx: ComBitPosition=159, ComBitSize=1, ComSignalType=BOOLEAN, ComSystemTemplateSystemSignalRef=DET_MTD_098_Rx
            DET_MTD_099_Rx_oRDR_FUSION_DET_097_100_oPCAN_RADAR_42f88269_Rx: ComBitPosition=271, ComBitSize=1, ComSignalType=BOOLEAN, ComSystemTemplateSystemSignalRef=DET_MTD_099_Rx
            DET_MTD_100_Rx_oRDR_FUSION_DET_097_100_oPCAN_RADAR_f3991992_Rx: ComBitPosition=383, ComBitSize=1, ComSignalType=BOOLEAN, ComSystemTemplateSystemSignalRef=DET_MTD_100_Rx
            DET_PROB_1STAZHYPO_097_Rx_oRDR_FUSION_DET_097_100_oPCAN_RADAR_a78b7c07_Rx: ComBitPosition=103, ComBitSize=1, ComSignalType=BOOLEAN, ComSystemTemplateSystemSignalRef=DET_PROB_1STAZHYPO_097_Rx
            DET_PROB_1STAZHYPO_098_Rx_oRDR_FUSION_DET_097_100_oPCAN_RADAR_27c50eaf_Rx: ComBitPosition=215, ComBitSize=1, ComSignalType=BOOLEAN, ComSystemTemplateSystemSignalRef=DET_PROB_1STAZHYPO_098_Rx
            DET_PROB_1STAZHYPO_099_Rx_oRDR_FUSION_DET_097_100_oPCAN_RADAR_88819ce8_Rx: ComBitPosition=327, ComBitSize=1, ComSignalType=BOOLEAN, ComSystemTemplateSystemSignalRef=DET_PROB_1STAZHYPO_099_Rx
            DET_PROB_1STAZHYPO_100_Rx_oRDR_FUSION_DET_097_100_oPCAN_RADAR_39e00713_Rx: ComBitPosition=439, ComBitSize=1, ComSignalType=BOOLEAN, ComSystemTemplateSystemSignalRef=DET_PROB_1STAZHYPO_100_Rx
            DET_RANGE_097_Rx_oRDR_FUSION_DET_097_100_oPCAN_RADAR_fc369410_Rx: ComBitPosition=24, ComBitSize=15, ComSignalType=UINT16, ComSystemTemplateSystemSignalRef=DET_RANGE_097_Rx
            DET_RANGE_098_Rx_oRDR_FUSION_DET_097_100_oPCAN_RADAR_7c78e6b8_Rx: ComBitPosition=136, ComBitSize=15, ComSignalType=UINT16, ComSystemTemplateSystemSignalRef=DET_RANGE_098_Rx
            DET_RANGE_099_Rx_oRDR_FUSION_DET_097_100_oPCAN_RADAR_d33c74ff_Rx: ComBitPosition=248, ComBitSize=15, ComSignalType=UINT16, ComSystemTemplateSystemSignalRef=DET_RANGE_099_Rx
            DET_RANGE_100_Rx_oRDR_FUSION_DET_097_100_oPCAN_RADAR_625def04_Rx: ComBitPosition=360, ComBitSize=15, ComSignalType=UINT16, ComSystemTemplateSystemSignalRef=DET_RANGE_100_Rx
            DET_RANGE_ERR_097_Rx_oRDR_FUSION_DET_097_100_oPCAN_RADAR_acc418f0_Rx: ComBitPosition=40, ComBitSize=7, ComSignalType=UINT8, ComSystemTemplateSystemSignalRef=DET_RANGE_ERR_097_Rx
            DET_RANGE_ERR_098_Rx_oRDR_FUSION_DET_097_100_oPCAN_RADAR_2c8a6a58_Rx: ComBitPosition=152, ComBitSize=7, ComSignalType=UINT8, ComSystemTemplateSystemSignalRef=DET_RANGE_ERR_098_Rx
            DET_RANGE_ERR_099_Rx_oRDR_FUSION_DET_097_100_oPCAN_RADAR_83cef81f_Rx: ComBitPosition=264, ComBitSize=7, ComSignalType=UINT8, ComSystemTemplateSystemSignalRef=DET_RANGE_ERR_099_Rx
            DET_RANGE_ERR_100_Rx_oRDR_FUSION_DET_097_100_oPCAN_RADAR_32af63e4_Rx: ComBitPosition=376, ComBitSize=7, ComSignalType=UINT8, ComSystemTemplateSystemSignalRef=DET_RANGE_ERR_100_Rx
            DET_RANGE_VELOCITY_097_Rx_oRDR_FUSION_DET_097_100_oPCAN_RADAR_21c317ee_Rx: ComBitPosition=48, ComBitSize=15, ComSignalType=UINT16, ComSystemTemplateSystemSignalRef=DET_RANGE_VELOCITY_097_Rx
            DET_RANGE_VELOCITY_098_Rx_oRDR_FUSION_DET_097_100_oPCAN_RADAR_a18d6546_Rx: ComBitPosition=160, ComBitSize=15, ComSignalType=UINT16, ComSystemTemplateSystemSignalRef=DET_RANGE_VELOCITY_098_Rx
            DET_RANGE_VELOCITY_099_Rx_oRDR_FUSION_DET_097_100_oPCAN_RADAR_0ec9f701_Rx: ComBitPosition=272, ComBitSize=15, ComSignalType=UINT16, ComSystemTemplateSystemSignalRef=DET_RANGE_VELOCITY_099_Rx
            DET_RANGE_VELOCITY_100_Rx_oRDR_FUSION_DET_097_100_oPCAN_RADAR_bfa86cfa_Rx: ComBitPosition=384, ComBitSize=15, ComSignalType=UINT16, ComSystemTemplateSystemSignalRef=DET_RANGE_VELOCITY_100_Rx
            DET_RANGE_VELOCITY_ERR_097_Rx_oRDR_FUSION_DET_097_100_oPCAN_RADAR_b8a7672c_Rx: ComBitPosition=64, ComBitSize=8, ComSignalType=UINT8, ComSystemTemplateSystemSignalRef=DET_RANGE_VELOCITY_ERR_097_Rx
            DET_RANGE_VELOCITY_ERR_098_Rx_oRDR_FUSION_DET_097_100_oPCAN_RADAR_38e91584_Rx: ComBitPosition=176, ComBitSize=8, ComSignalType=UINT8, ComSystemTemplateSystemSignalRef=DET_RANGE_VELOCITY_ERR_098_Rx
            DET_RANGE_VELOCITY_ERR_099_Rx_oRDR_FUSION_DET_097_100_oPCAN_RADAR_97ad87c3_Rx: ComBitPosition=288, ComBitSize=8, ComSignalType=UINT8, ComSystemTemplateSystemSignalRef=DET_RANGE_VELOCITY_ERR_099_Rx
            DET_RANGE_VELOCITY_ERR_100_Rx_oRDR_FUSION_DET_097_100_oPCAN_RADAR_26cc1c38_Rx: ComBitPosition=400, ComBitSize=8, ComSignalType=UINT8, ComSystemTemplateSystemSignalRef=DET_RANGE_VELOCITY_ERR_100_Rx
            DET_RCS_097_Rx_oRDR_FUSION_DET_097_100_oPCAN_RADAR_ec0885f5_Rx: ComBitPosition=128, ComBitSize=8, ComSignalType=UINT8, ComSystemTemplateSystemSignalRef=DET_RCS_097_Rx
            DET_RCS_098_Rx_oRDR_FUSION_DET_097_100_oPCAN_RADAR_6c46f75d_Rx: ComBitPosition=240, ComBitSize=8, ComSignalType=UINT8, ComSystemTemplateSystemSignalRef=DET_RCS_098_Rx
            DET_RCS_099_Rx_oRDR_FUSION_DET_097_100_oPCAN_RADAR_c302651a_Rx: ComBitPosition=352, ComBitSize=8, ComSignalType=UINT8, ComSystemTemplateSystemSignalRef=DET_RCS_099_Rx
            DET_RCS_100_Rx_oRDR_FUSION_DET_097_100_oPCAN_RADAR_7263fee1_Rx: ComBitPosition=464, ComBitSize=8, ComSignalType=UINT8, ComSystemTemplateSystemSignalRef=DET_RCS_100_Rx
            DET_SNR_097_Rx_oRDR_FUSION_DET_097_100_oPCAN_RADAR_e552f41c_Rx: ComBitPosition=120, ComBitSize=8, ComSignalType=UINT8, ComSystemTemplateSystemSignalRef=DET_SNR_097_Rx
            DET_SNR_098_Rx_oRDR_FUSION_DET_097_100_oPCAN_RADAR_651c86b4_Rx: ComBitPosition=232, ComBitSize=8, ComSignalType=UINT8, ComSystemTemplateSystemSignalRef=DET_SNR_098_Rx
            DET_SNR_099_Rx_oRDR_FUSION_DET_097_100_oPCAN_RADAR_ca5814f3_Rx: ComBitPosition=344, ComBitSize=8, ComSignalType=UINT8, ComSystemTemplateSystemSignalRef=DET_SNR_099_Rx
            DET_SNR_100_Rx_oRDR_FUSION_DET_097_100_oPCAN_RADAR_7b398f08_Rx: ComBitPosition=456, ComBitSize=8, ComSignalType=UINT8, ComSystemTemplateSystemSignalRef=DET_SNR_100_Rx
            DET_SUPER_RES_TARGET_097_Rx_oRDR_FUSION_DET_097_100_oPCAN_RADAR_2ea9d51c_Rx: ComBitPosition=87, ComBitSize=1, ComSignalType=BOOLEAN, ComSystemTemplateSystemSignalRef=DET_SUPER_RES_TARGET_097_Rx
            DET_SUPER_RES_TARGET_098_Rx_oRDR_FUSION_DET_097_100_oPCAN_RADAR_aee7a7b4_Rx: ComBitPosition=199, ComBitSize=1, ComSignalType=BOOLEAN, ComSystemTemplateSystemSignalRef=DET_SUPER_RES_TARGET_098_Rx
            DET_SUPER_RES_TARGET_099_Rx_oRDR_FUSION_DET_097_100_oPCAN_RADAR_01a335f3_Rx: ComBitPosition=311, ComBitSize=1, ComSignalType=BOOLEAN, ComSystemTemplateSystemSignalRef=DET_SUPER_RES_TARGET_099_Rx
            DET_SUPER_RES_TARGET_100_Rx_oRDR_FUSION_DET_097_100_oPCAN_RADAR_b0c2ae08_Rx: ComBitPosition=423, ComBitSize=1, ComSignalType=BOOLEAN, ComSystemTemplateSystemSignalRef=DET_SUPER_RES_TARGET_100_Rx
