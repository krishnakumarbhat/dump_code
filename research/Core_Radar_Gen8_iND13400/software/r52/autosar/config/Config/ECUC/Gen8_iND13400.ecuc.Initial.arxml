[part 2 of 24: package /InitialEcuC]
AUTOSAR XML (schema 00053)
package /InitialEcuC  (continued)
  module config CanIf  (continued)
    CanIfInitCfg  (continued)
      238 x CanIfTxPduCfg:  (continued)
        RDR_DETECTION_341_344_oPCAN_RADAR_69c89c67_Tx: CanIfTxPduCanId=341 if post-build-variant-condition{matching-criterion=RDR_POS, value=0}, CanIfTxPduCanIdType=STANDARD_FD_CAN, CanIfTxPduDlc=64, CanIfTxPduUserTxConfirmationName=PduR_CanIfTxConfirmation, CanIfTxPduUserTxConfirmationUL=PDUR, CanIfTxPduCanId=469 if post-build-variant-condition{matching-criterion=RDR_POS, value=1}, CanIfTxPduCanId=597 if post-build-variant-condition{matching-criterion=RDR_POS, value=2}, CanIfTxPduCanId=725 if post-build-variant-condition{matching-criterion=RDR_POS, value=3}, CanIfTxPduCanId=853 if post-build-variant-condition{matching-criterion=RDR_POS, value=4}, CanIfTxPduCanId=981 if post-build-variant-condition{matching-criterion=RDR_POS, value=5}, CanIfTxPduCanId=1109 if post-build-variant-condition{matching-criterion=RDR_POS, value=6}, CanIfTxPduCanId=1237 if post-build-variant-condition{matching-criterion=RDR_POS, value=7}, CanIfTxPduBufferRef=CanIfInitCfg/CHNL_2ad3227b, CanIfTxPduRef=EcucPduCollection/RDR_DETECTION_341_344_oPCAN_RADAR_4a9c3acc_Tx
        RDR_DETECTION_345_348_oPCAN_RADAR_bcde1c3d_Tx: CanIfTxPduCanId=342 if post-build-variant-condition{matching-criterion=RDR_POS, value=0}, CanIfTxPduCanIdType=STANDARD_FD_CAN, CanIfTxPduDlc=64, CanIfTxPduUserTxConfirmationName=PduR_CanIfTxConfirmation, CanIfTxPduUserTxConfirmationUL=PDUR, CanIfTxPduCanId=470 if post-build-variant-condition{matching-criterion=RDR_POS, value=1}, CanIfTxPduCanId=598 if post-build-variant-condition{matching-criterion=RDR_POS, value=2}, CanIfTxPduCanId=726 if post-build-variant-condition{matching-criterion=RDR_POS, value=3}, CanIfTxPduCanId=854 if post-build-variant-condition{matching-criterion=RDR_POS, value=4}, CanIfTxPduCanId=982 if post-build-variant-condition{matching-criterion=RDR_POS, value=5}, CanIfTxPduCanId=1110 if post-build-variant-condition{matching-criterion=RDR_POS, value=6}, CanIfTxPduCanId=1238 if post-build-variant-condition{matching-criterion=RDR_POS, value=7}, CanIfTxPduBufferRef=CanIfInitCfg/CHNL_2ad3227b, CanIfTxPduRef=EcucPduCollection/RDR_DETECTION_345_348_oPCAN_RADAR_93e0ae66_Tx
        RDR_DETECTION_349_352_oPCAN_RADAR_af062188_Tx: CanIfTxPduCanId=343 if post-build-variant-condition{matching-criterion=RDR_POS, value=0}, CanIfTxPduCanIdType=STANDARD_FD_CAN, CanIfTxPduDlc=64, CanIfTxPduUserTxConfirmationName=PduR_CanIfTxConfirmation, CanIfTxPduUserTxConfirmationUL=PDUR, CanIfTxPduCanId=471 if post-build-variant-condition{matching-criterion=RDR_POS, value=1}, CanIfTxPduCanId=599 if post-build-variant-condition{matching-criterion=RDR_POS, value=2}, CanIfTxPduCanId=727 if post-build-variant-condition{matching-criterion=RDR_POS, value=3}, CanIfTxPduCanId=855 if post-build-variant-condition{matching-criterion=RDR_POS, value=4}, CanIfTxPduCanId=983 if post-build-variant-condition{matching-criterion=RDR_POS, value=5}, CanIfTxPduCanId=1111 if post-build-variant-condition{matching-criterion=RDR_POS, value=6}, CanIfTxPduCanId=1239 if post-build-variant-condition{matching-criterion=RDR_POS, value=7}, CanIfTxPduBufferRef=CanIfInitCfg/CHNL_2ad3227b, CanIfTxPduRef=EcucPduCollection/RDR_DETECTION_349_352_oPCAN_RADAR_0497a4ae_Tx
        RDR_DETECTION_353_356_oPCAN_RADAR_a5dde231_Tx: CanIfTxPduCanId=344 if post-build-variant-condition{matching-criterion=RDR_POS, value=0}, CanIfTxPduCanIdType=STANDARD_FD_CAN, CanIfTxPduDlc=64, CanIfTxPduUserTxConfirmationName=PduR_CanIfTxConfirmation, CanIfTxPduUserTxConfirmationUL=PDUR, CanIfTxPduCanId=472 if post-build-variant-condition{matching-criterion=RDR_POS, value=1}, CanIfTxPduCanId=600 if post-build-variant-condition{matching-criterion=RDR_POS, value=2}, CanIfTxPduCanId=728 if post-build-variant-condition{matching-criterion=RDR_POS, value=3}, CanIfTxPduCanId=856 if post-build-variant-condition{matching-criterion=RDR_POS, value=4}, CanIfTxPduCanId=984 if post-build-variant-condition{matching-criterion=RDR_POS, value=5}, CanIfTxPduCanId=1112 if post-build-variant-condition{matching-criterion=RDR_POS, value=6}, CanIfTxPduCanId=1240 if post-build-variant-condition{matching-criterion=RDR_POS, value=7}, CanIfTxPduBufferRef=CanIfInitCfg/CHNL_2ad3227b, CanIfTxPduRef=EcucPduCollection/RDR_DETECTION_353_356_oPCAN_RADAR_54e29f81_Tx
        RDR_DETECTION_357_360_oPCAN_RADAR_b87321d3_Tx: CanIfTxPduCanId=345 if post-build-variant-condition{matching-criterion=RDR_POS, value=0}, CanIfTxPduCanIdType=STANDARD_FD_CAN, CanIfTxPduDlc=64, CanIfTxPduUserTxConfirmationName=PduR_CanIfTxConfirmation, CanIfTxPduUserTxConfirmationUL=PDUR, CanIfTxPduCanId=473 if post-build-variant-condition{matching-criterion=RDR_POS, value=1}, CanIfTxPduCanId=601 if post-build-variant-condition{matching-criterion=RDR_POS, value=2}, CanIfTxPduCanId=729 if post-build-variant-condition{matching-criterion=RDR_POS, value=3}, CanIfTxPduCanId=857 if post-build-variant-condition{matching-criterion=RDR_POS, value=4}, CanIfTxPduCanId=985 if post-build-variant-condition{matching-criterion=RDR_POS, value=5}, CanIfTxPduCanId=1113 if post-build-variant-condition{matching-criterion=RDR_POS, value=6}, CanIfTxPduCanId=1241 if post-build-variant-condition{matching-criterion=RDR_POS, value=7}, CanIfTxPduBufferRef=CanIfInitCfg/CHNL_2ad3227b, CanIfTxPduRef=EcucPduCollection/RDR_DETECTION_357_360_oPCAN_RADAR_e118584e_Tx
        RDR_DETECTION_361_364_oPCAN_RADAR_195632c1_Tx: CanIfTxPduCanId=346 if post-build-variant-condition{matching-criterion=RDR_POS, value=0}, CanIfTxPduCanIdType=STANDARD_FD_CAN, CanIfTxPduDlc=64, CanIfTxPduUserTxConfirmationName=PduR_CanIfTxConfirmation, CanIfTxPduUserTxConfirmationUL=PDUR, CanIfTxPduCanId=474 if post-build-variant-condition{matching-criterion=RDR_POS, value=1}, CanIfTxPduCanId=602 if post-build-variant-condition{matching-criterion=RDR_POS, value=2}, CanIfTxPduCanId=730 if post-build-variant-condition{matching-criterion=RDR_POS, value=3}, CanIfTxPduCanId=858 if post-build-variant-condition{matching-criterion=RDR_POS, value=4}, CanIfTxPduCanId=986 if post-build-variant-condition{matching-criterion=RDR_POS, value=5}, CanIfTxPduCanId=1114 if post-build-variant-condition{matching-criterion=RDR_POS, value=6}, CanIfTxPduCanId=1242 if post-build-variant-condition{matching-criterion=RDR_POS, value=7}, CanIfTxPduBufferRef=CanIfInitCfg/CHNL_2ad3227b, CanIfTxPduRef=EcucPduCollection/RDR_DETECTION_361_364_oPCAN_RADAR_c3f86525_Tx
        RDR_DETECTION_365_368_oPCAN_RADAR_cc40b29b_Tx: CanIfTxPduCanId=347 if post-build-variant-condition{matching-criterion=RDR_POS, value=0}, CanIfTxPduCanIdType=STANDARD_FD_CAN, CanIfTxPduDlc=64, CanIfTxPduUserTxConfirmationName=PduR_CanIfTxConfirmation, CanIfTxPduUserTxConfirmationUL=PDUR, CanIfTxPduCanId=475 if post-build-variant-condition{matching-criterion=RDR_POS, value=1}, CanIfTxPduCanId=603 if post-build-variant-condition{matching-criterion=RDR_POS, value=2}, CanIfTxPduCanId=731 if post-build-variant-condition{matching-criterion=RDR_POS, value=3}, CanIfTxPduCanId=859 if post-build-variant-condition{matching-criterion=RDR_POS, value=4}, CanIfTxPduCanId=987 if post-build-variant-condition{matching-criterion=RDR_POS, value=5}, CanIfTxPduCanId=1115 if post-build-variant-condition{matching-criterion=RDR_POS, value=6}, CanIfTxPduCanId=1243 if post-build-variant-condition{matching-criterion=RDR_POS, value=7}, CanIfTxPduBufferRef=CanIfInitCfg/CHNL_2ad3227b, CanIfTxPduRef=EcucPduCollection/RDR_DETECTION_365_368_oPCAN_RADAR_1a84f18f_Tx
        RDR_DETECTION_369_372_oPCAN_RADAR_df988f2e_Tx: CanIfTxPduCanId=348 if post-build-variant-condition{matching-criterion=RDR_POS, value=0}, CanIfTxPduCanIdType=STANDARD_FD_CAN, CanIfTxPduDlc=64, CanIfTxPduUserTxConfirmationName=PduR_CanIfTxConfirmation, CanIfTxPduUserTxConfirmationUL=PDUR, CanIfTxPduCanId=476 if post-build-variant-condition{matching-criterion=RDR_POS, value=1}, CanIfTxPduCanId=604 if post-build-variant-condition{matching-criterion=RDR_POS, value=2}, CanIfTxPduCanId=732 if post-build-variant-condition{matching-criterion=RDR_POS, value=3}, CanIfTxPduCanId=860 if post-build-variant-condition{matching-criterion=RDR_POS, value=4}, CanIfTxPduCanId=988 if post-build-variant-condition{matching-criterion=RDR_POS, value=5}, CanIfTxPduCanId=1116 if post-build-variant-condition{matching-criterion=RDR_POS, value=6}, CanIfTxPduCanId=1244 if post-build-variant-condition{matching-criterion=RDR_POS, value=7}, CanIfTxPduBufferRef=CanIfInitCfg/CHNL_2ad3227b, CanIfTxPduRef=EcucPduCollection/RDR_DETECTION_369_372_oPCAN_RADAR_8df3fb47_Tx
        RDR_DETECTION_373_376_oPCAN_RADAR_d5434c97_Tx: CanIfTxPduCanId=349 if post-build-variant-condition{matching-criterion=RDR_POS, value=0}, CanIfTxPduCanIdType=STANDARD_FD_CAN, CanIfTxPduDlc=64, CanIfTxPduUserTxConfirmationName=PduR_CanIfTxConfirmation, CanIfTxPduUserTxConfirmationUL=PDUR, CanIfTxPduCanId=477 if post-build-variant-condition{matching-criterion=RDR_POS, value=1}, CanIfTxPduCanId=605 if post-build-variant-condition{matching-criterion=RDR_POS, value=2}, CanIfTxPduCanId=733 if post-build-variant-condition{matching-criterion=RDR_POS, value=3}, CanIfTxPduCanId=861 if post-build-variant-condition{matching-criterion=RDR_POS, value=4}, CanIfTxPduCanId=989 if post-build-variant-condition{matching-criterion=RDR_POS, value=5}, CanIfTxPduCanId=1117 if post-build-variant-condition{matching-criterion=RDR_POS, value=6}, CanIfTxPduCanId=1245 if post-build-variant-condition{matching-criterion=RDR_POS, value=7}, CanIfTxPduBufferRef=CanIfInitCfg/CHNL_2ad3227b, CanIfTxPduRef=EcucPduCollection/RDR_DETECTION_373_376_oPCAN_RADAR_dd86c068_Tx
        RDR_DETECTION_377_380_oPCAN_RADAR_979005c0_Tx: CanIfTxPduCanId=350 if post-build-variant-condition{matching-criterion=RDR_POS, value=0}, CanIfTxPduCanIdType=STANDARD_FD_CAN, CanIfTxPduDlc=64, CanIfTxPduUserTxConfirmationName=PduR_CanIfTxConfirmation, CanIfTxPduUserTxConfirmationUL=PDUR, CanIfTxPduCanId=478 if post-build-variant-condition{matching-criterion=RDR_POS, value=1}, CanIfTxPduCanId=606 if post-build-variant-condition{matching-criterion=RDR_POS, value=2}, CanIfTxPduCanId=734 if post-build-variant-condition{matching-criterion=RDR_POS, value=3}, CanIfTxPduCanId=862 if post-build-variant-condition{matching-criterion=RDR_POS, value=4}, CanIfTxPduCanId=990 if post-build-variant-condition{matching-criterion=RDR_POS, value=5}, CanIfTxPduCanId=1118 if post-build-variant-condition{matching-criterion=RDR_POS, value=6}, CanIfTxPduCanId=1246 if post-build-variant-condition{matching-criterion=RDR_POS, value=7}, CanIfTxPduBufferRef=CanIfInitCfg/CHNL_2ad3227b, CanIfTxPduRef=EcucPduCollection/RDR_DETECTION_377_380_oPCAN_RADAR_0516cc8e_Tx
        RDR_DETECTION_381_384_oPCAN_RADAR_91fe7df2_Tx: CanIfTxPduCanId=351 if post-build-variant-condition{matching-criterion=RDR_POS, value=0}, CanIfTxPduCanIdType=STANDARD_FD_CAN, CanIfTxPduDlc=64, CanIfTxPduUserTxConfirmationName=PduR_CanIfTxConfirmation, CanIfTxPduUserTxConfirmationUL=PDUR, CanIfTxPduCanId=479 if post-build-variant-condition{matching-criterion=RDR_POS, value=1}, CanIfTxPduCanId=607 if post-build-variant-condition{matching-criterion=RDR_POS, value=2}, CanIfTxPduCanId=735 if post-build-variant-condition{matching-criterion=RDR_POS, value=3}, CanIfTxPduCanId=863 if post-build-variant-condition{matching-criterion=RDR_POS, value=4}, CanIfTxPduCanId=991 if post-build-variant-condition{matching-criterion=RDR_POS, value=5}, CanIfTxPduCanId=1119 if post-build-variant-condition{matching-criterion=RDR_POS, value=6}, CanIfTxPduCanId=1247 if post-build-variant-condition{matching-criterion=RDR_POS, value=7}, CanIfTxPduBufferRef=CanIfInitCfg/CHNL_2ad3227b, CanIfTxPduRef=EcucPduCollection/RDR_DETECTION_381_384_oPCAN_RADAR_cb27f638_Tx
        RDR_DETECTION_385_388_oPCAN_RADAR_44e8fda8_Tx: CanIfTxPduCanId=352 if post-build-variant-condition{matching-criterion=RDR_POS, value=0}, CanIfTxPduCanIdType=STANDARD_FD_CAN, CanIfTxPduDlc=64, CanIfTxPduUserTxConfirmationName=PduR_CanIfTxConfirmation, CanIfTxPduUserTxConfirmationUL=PDUR, CanIfTxPduCanId=480 if post-build-variant-condition{matching-criterion=RDR_POS, value=1}, CanIfTxPduCanId=608 if post-build-variant-condition{matching-criterion=RDR_POS, value=2}, CanIfTxPduCanId=736 if post-build-variant-condition{matching-criterion=RDR_POS, value=3}, CanIfTxPduCanId=864 if post-build-variant-condition{matching-criterion=RDR_POS, value=4}, CanIfTxPduCanId=992 if post-build-variant-condition{matching-criterion=RDR_POS, value=5}, CanIfTxPduCanId=1120 if post-build-variant-condition{matching-criterion=RDR_POS, value=6}, CanIfTxPduCanId=1248 if post-build-variant-condition{matching-criterion=RDR_POS, value=7}, CanIfTxPduBufferRef=CanIfInitCfg/CHNL_2ad3227b, CanIfTxPduRef=EcucPduCollection/RDR_DETECTION_385_388_oPCAN_RADAR_125b6292_Tx
        RDR_DETECTION_389_392_oPCAN_RADAR_5730c01d_Tx: CanIfTxPduCanId=353 if post-build-variant-condition{matching-criterion=RDR_POS, value=0}, CanIfTxPduCanIdType=STANDARD_FD_CAN, CanIfTxPduDlc=64, CanIfTxPduUserTxConfirmationName=PduR_CanIfTxConfirmation, CanIfTxPduUserTxConfirmationUL=PDUR, CanIfTxPduCanId=481 if post-build-variant-condition{matching-criterion=RDR_POS, value=1}, CanIfTxPduCanId=609 if post-build-variant-condition{matching-criterion=RDR_POS, value=2}, CanIfTxPduCanId=737 if post-build-variant-condition{matching-criterion=RDR_POS, value=3}, CanIfTxPduCanId=865 if post-build-variant-condition{matching-criterion=RDR_POS, value=4}, CanIfTxPduCanId=993 if post-build-variant-condition{matching-criterion=RDR_POS, value=5}, CanIfTxPduCanId=1121 if post-build-variant-condition{matching-criterion=RDR_POS, value=6}, CanIfTxPduCanId=1249 if post-build-variant-condition{matching-criterion=RDR_POS, value=7}, CanIfTxPduBufferRef=CanIfInitCfg/CHNL_2ad3227b, CanIfTxPduRef=EcucPduCollection/RDR_DETECTION_389_392_oPCAN_RADAR_852c685a_Tx
        RDR_DETECTION_393_396_oPCAN_RADAR_5deb03a4_Tx: CanIfTxPduCanId=354 if post-build-variant-condition{matching-criterion=RDR_POS, value=0}, CanIfTxPduCanIdType=STANDARD_FD_CAN, CanIfTxPduDlc=64, CanIfTxPduUserTxConfirmationName=PduR_CanIfTxConfirmation, CanIfTxPduUserTxConfirmationUL=PDUR, CanIfTxPduCanId=482 if post-build-variant-condition{matching-criterion=RDR_POS, value=1}, CanIfTxPduCanId=610 if post-build-variant-condition{matching-criterion=RDR_POS, value=2}, CanIfTxPduCanId=738 if post-build-variant-condition{matching-criterion=RDR_POS, value=3}, CanIfTxPduCanId=866 if post-build-variant-condition{matching-criterion=RDR_POS, value=4}, CanIfTxPduCanId=994 if post-build-variant-condition{matching-criterion=RDR_POS, value=5}, CanIfTxPduCanId=1122 if post-build-variant-condition{matching-criterion=RDR_POS, value=6}, CanIfTxPduCanId=1250 if post-build-variant-condition{matching-criterion=RDR_POS, value=7}, CanIfTxPduBufferRef=CanIfInitCfg/CHNL_2ad3227b, CanIfTxPduRef=EcucPduCollection/RDR_DETECTION_393_396_oPCAN_RADAR_d5595375_Tx
        RDR_DETECTION_397_400_oPCAN_RADAR_ec04aa3c_Tx: CanIfTxPduCanId=355 if post-build-variant-condition{matching-criterion=RDR_POS, value=0}, CanIfTxPduCanIdType=STANDARD_FD_CAN, CanIfTxPduDlc=64, CanIfTxPduUserTxConfirmationName=PduR_CanIfTxConfirmation, CanIfTxPduUserTxConfirmationUL=PDUR, CanIfTxPduCanId=483 if post-build-variant-condition{matching-criterion=RDR_POS, value=1}, CanIfTxPduCanId=611 if post-build-variant-condition{matching-criterion=RDR_POS, value=2}, CanIfTxPduCanId=739 if post-build-variant-condition{matching-criterion=RDR_POS, value=3}, CanIfTxPduCanId=867 if post-build-variant-condition{matching-criterion=RDR_POS, value=4}, CanIfTxPduCanId=995 if post-build-variant-condition{matching-criterion=RDR_POS, value=5}, CanIfTxPduCanId=1123 if post-build-variant-condition{matching-criterion=RDR_POS, value=6}, CanIfTxPduCanId=1251 if post-build-variant-condition{matching-criterion=RDR_POS, value=7}, CanIfTxPduBufferRef=CanIfInitCfg/CHNL_2ad3227b, CanIfTxPduRef=EcucPduCollection/RDR_DETECTION_397_400_oPCAN_RADAR_d58dd49c_Tx
        RDR_DIAG_RESP_PHYS_Tp_oPCAN_RADAR_20_77b41024_Tx: CanIfTxPduCanId=20 if post-build-variant-condition{matching-criterion=RDR_POS, value=0}, CanIfTxPduCanIdType=STANDARD_CAN, CanIfTxPduDlc=8, CanIfTxPduUserTxConfirmationUL=CDD, CanIfTxPduCanId=28 if post-build-variant-condition{matching-criterion=RDR_POS, value=1}, CanIfTxPduCanId=36 if post-build-variant-condition{matching-criterion=RDR_POS, value=2}, CanIfTxPduCanId=44 if post-build-variant-condition{matching-criterion=RDR_POS, value=3}, CanIfTxPduCanId=52 if post-build-variant-condition{matching-criterion=RDR_POS, value=4}, CanIfTxPduCanId=60 if post-build-variant-condition{matching-criterion=RDR_POS, value=5}, CanIfTxPduCanId=68 if post-build-variant-condition{matching-criterion=RDR_POS, value=6}, CanIfTxPduCanId=76 if post-build-variant-condition{matching-criterion=RDR_POS, value=7}, CanIfTxPduBufferRef=CanIfInitCfg/CHNL_2ad3227b, CanIfTxPduRef=RDR_DIAG_RESP_PHYS_Tp_oPCAN_RADAR_20_66cb5f46_Tx
        RDR_DIAG_RESP_PHYS_Tp_oPCAN_RADAR_ef99b387_Tx: CanIfTxPduCanId=20 if post-build-variant-condition{matching-criterion=RDR_POS, value=0}, CanIfTxPduCanIdType=STANDARD_FD_CAN, CanIfTxPduDlc=64, CanIfTxPduUserTxConfirmationUL=CDD, CanIfTxPduCanId=28 if post-build-variant-condition{matching-criterion=RDR_POS, value=1}, CanIfTxPduCanId=36 if post-build-variant-condition{matching-criterion=RDR_POS, value=2}, CanIfTxPduCanId=44 if post-build-variant-condition{matching-criterion=RDR_POS, value=3}, CanIfTxPduCanId=52 if post-build-variant-condition{matching-criterion=RDR_POS, value=4}, CanIfTxPduCanId=60 if post-build-variant-condition{matching-criterion=RDR_POS, value=5}, CanIfTxPduCanId=68 if post-build-variant-condition{matching-criterion=RDR_POS, value=6}, CanIfTxPduCanId=76 if post-build-variant-condition{matching-criterion=RDR_POS, value=7}, CanIfTxPduBufferRef=CanIfInitCfg/CHNL_2ad3227b, CanIfTxPduRef=RDR_DIAG_RESP_PHYS_Tp_oPCAN_RADAR_b7c1ab06_Tx
        RDR_HEADER_001_oPCAN_RADAR_051a0060_Tx: CanIfTxPduCanId=128 if post-build-variant-condition{matching-criterion=RDR_POS, value=0}, CanIfTxPduCanIdType=STANDARD_FD_CAN, CanIfTxPduDlc=64, CanIfTxPduUserTxConfirmationName=PduR_CanIfTxConfirmation, CanIfTxPduUserTxConfirmationUL=PDUR, CanIfTxPduCanId=136 if post-build-variant-condition{matching-criterion=RDR_POS, value=1}, CanIfTxPduCanId=144 if post-build-variant-condition{matching-criterion=RDR_POS, value=2}, CanIfTxPduCanId=152 if post-build-variant-condition{matching-criterion=RDR_POS, value=3}, CanIfTxPduCanId=160 if post-build-variant-condition{matching-criterion=RDR_POS, value=4}, CanIfTxPduCanId=168 if post-build-variant-condition{matching-criterion=RDR_POS, value=5}, CanIfTxPduCanId=176 if post-build-variant-condition{matching-criterion=RDR_POS, value=6}, CanIfTxPduCanId=184 if post-build-variant-condition{matching-criterion=RDR_POS, value=7}, CanIfTxPduBufferRef=CanIfInitCfg/CHNL_2ad3227b, CanIfTxPduRef=EcucPduCollection/RDR_HEADER_001_oPCAN_RADAR_48304dbd_Tx
        RDR_IDSM_Audit_Log_Tp_oPCAN_RADAR_5a14a88e_Tx: CanIfTxPduCanId=21 if post-build-variant-condition{matching-criterion=RDR_POS, value=0}, CanIfTxPduCanIdType=STANDARD_FD_CAN, CanIfTxPduDlc=64, CanIfTxPduUserTxConfirmationUL=CDD, CanIfTxPduCanId=29 if post-build-variant-condition{matching-criterion=RDR_POS, value=1}, CanIfTxPduCanId=37 if post-build-variant-condition{matching-criterion=RDR_POS, value=2}, CanIfTxPduCanId=45 if post-build-variant-condition{matching-criterion=RDR_POS, value=3}, CanIfTxPduCanId=53 if post-build-variant-condition{matching-criterion=RDR_POS, value=4}, CanIfTxPduCanId=61 if post-build-variant-condition{matching-criterion=RDR_POS, value=5}, CanIfTxPduCanId=69 if post-build-variant-condition{matching-criterion=RDR_POS, value=6}, CanIfTxPduCanId=77 if post-build-variant-condition{matching-criterion=RDR_POS, value=7}, CanIfTxPduBufferRef=CanIfInitCfg/CHNL_2ad3227b, CanIfTxPduRef=RDR_IDSM_Audit_Log_Tp_oPCAN_RADAR_ea04d42a_Tx
        RDR_NM_oPCAN_RADAR_0ce2db80_Tx: CanIfTxPduCanId=1281 if post-build-variant-condition{matching-criterion=RDR_POS, value=0}, CanIfTxPduCanIdType=STANDARD_FD_CAN, CanIfTxPduDlc=64, CanIfTxPduUserTxConfirmationName=CanNm_TxConfirmation, CanIfTxPduUserTxConfirmationUL=CAN_NM, CanIfTxPduCanId=1282 if post-build-variant-condition{matching-criterion=RDR_POS, value=1}, CanIfTxPduCanId=1283 if post-build-variant-condition{matching-criterion=RDR_POS, value=2}, CanIfTxPduCanId=1284 if post-build-variant-condition{matching-criterion=RDR_POS, value=3}, CanIfTxPduCanId=1285 if post-build-variant-condition{matching-criterion=RDR_POS, value=4}, CanIfTxPduCanId=1286 if post-build-variant-condition{matching-criterion=RDR_POS, value=5}, CanIfTxPduCanId=1287 if post-build-variant-condition{matching-criterion=RDR_POS, value=6}, CanIfTxPduCanId=1288 if post-build-variant-condition{matching-criterion=RDR_POS, value=7}, CanIfTxPduBufferRef=CanIfInitCfg/CHNL_2ad3227b, CanIfTxPduRef=RDR_NM_oPCAN_RADAR_21bce8cc_Tx
        RDR_OBJ_HEADER_002_oPCAN_RADAR_0a1b3262_Tx: CanIfTxPduCanId=129 if post-build-variant-condition{matching-criterion=RDR_POS, value=0}, CanIfTxPduCanIdType=STANDARD_FD_CAN, CanIfTxPduDlc=64, CanIfTxPduUserTxConfirmationName=PduR_CanIfTxConfirmation, CanIfTxPduUserTxConfirmationUL=PDUR, CanIfTxPduCanId=137 if post-build-variant-condition{matching-criterion=RDR_POS, value=1}, CanIfTxPduCanId=145 if post-build-variant-condition{matching-criterion=RDR_POS, value=2}, CanIfTxPduCanId=153 if post-build-variant-condition{matching-criterion=RDR_POS, value=3}, CanIfTxPduCanId=161 if post-build-variant-condition{matching-criterion=RDR_POS, value=4}, CanIfTxPduCanId=169 if post-build-variant-condition{matching-criterion=RDR_POS, value=5}, CanIfTxPduCanId=177 if post-build-variant-condition{matching-criterion=RDR_POS, value=6}, CanIfTxPduCanId=185 if post-build-variant-condition{matching-criterion=RDR_POS, value=7}, CanIfTxPduBufferRef=CanIfInitCfg/CHNL_2ad3227b, CanIfTxPduRef=EcucPduCollection/RDR_OBJ_HEADER_002_oPCAN_RADAR_018ea437_Tx
        RDR_OBJ_STATUS_003_oPCAN_RADAR_24cf7f10_Tx: CanIfTxPduCanId=130 if post-build-variant-condition{matching-criterion=RDR_POS, value=0}, CanIfTxPduCanIdType=STANDARD_FD_CAN, CanIfTxPduDlc=64, CanIfTxPduUserTxConfirmationName=PduR_CanIfTxConfirmation, CanIfTxPduUserTxConfirmationUL=PDUR, CanIfTxPduCanId=138 if post-build-variant-condition{matching-criterion=RDR_POS, value=1}, CanIfTxPduCanId=146 if post-build-variant-condition{matching-criterion=RDR_POS, value=2}, CanIfTxPduCanId=154 if post-build-variant-condition{matching-criterion=RDR_POS, value=3}, CanIfTxPduCanId=162 if post-build-variant-condition{matching-criterion=RDR_POS, value=4}, CanIfTxPduCanId=170 if post-build-variant-condition{matching-criterion=RDR_POS, value=5}, CanIfTxPduCanId=178 if post-build-variant-condition{matching-criterion=RDR_POS, value=6}, CanIfTxPduCanId=186 if post-build-variant-condition{matching-criterion=RDR_POS, value=7}, CanIfTxPduBufferRef=CanIfInitCfg/CHNL_2ad3227b, CanIfTxPduRef=EcucPduCollection/RDR_OBJ_STATUS_003_oPCAN_RADAR_a1f801b3_Tx
        RDR_STATUS_001_oPCAN_RADAR_0ddc5064_Tx: CanIfTxPduCanId=131 if post-build-variant-condition{matching-criterion=RDR_POS, value=0}, CanIfTxPduCanIdType=STANDARD_FD_CAN, CanIfTxPduDlc=64, CanIfTxPduUserTxConfirmationName=PduR_CanIfTxConfirmation, CanIfTxPduUserTxConfirmationUL=PDUR, CanIfTxPduCanId=139 if post-build-variant-condition{matching-criterion=RDR_POS, value=1}, CanIfTxPduCanId=147 if post-build-variant-condition{matching-criterion=RDR_POS, value=2}, CanIfTxPduCanId=155 if post-build-variant-condition{matching-criterion=RDR_POS, value=3}, CanIfTxPduCanId=163 if post-build-variant-condition{matching-criterion=RDR_POS, value=4}, CanIfTxPduCanId=171 if post-build-variant-condition{matching-criterion=RDR_POS, value=5}, CanIfTxPduCanId=179 if post-build-variant-condition{matching-criterion=RDR_POS, value=6}, CanIfTxPduCanId=187 if post-build-variant-condition{matching-criterion=RDR_POS, value=7}, CanIfTxPduBufferRef=CanIfInitCfg/CHNL_2ad3227b, CanIfTxPduRef=EcucPduCollection/RDR_STATUS_001_oPCAN_RADAR_deb478ca_Tx
        RDR_STATUS_002_oPCAN_RADAR_b26a35a7_Tx: CanIfTxPduCanId=132 if post-build-variant-condition{matching-criterion=RDR_POS, value=0}, CanIfTxPduCanIdType=STANDARD_FD_CAN, CanIfTxPduDlc=64, CanIfTxPduUserTxConfirmationName=PduR_CanIfTxConfirmation, CanIfTxPduUserTxConfirmationUL=PDUR, CanIfTxPduCanId=140 if post-build-variant-condition{matching-criterion=RDR_POS, value=1}, CanIfTxPduCanId=148 if post-build-variant-condition{matching-criterion=RDR_POS, value=2}, CanIfTxPduCanId=156 if post-build-variant-condition{matching-criterion=RDR_POS, value=3}, CanIfTxPduCanId=164 if post-build-variant-condition{matching-criterion=RDR_POS, value=4}, CanIfTxPduCanId=172 if post-build-variant-condition{matching-criterion=RDR_POS, value=5}, CanIfTxPduCanId=180 if post-build-variant-condition{matching-criterion=RDR_POS, value=6}, CanIfTxPduCanId=188 if post-build-variant-condition{matching-criterion=RDR_POS, value=7}, CanIfTxPduBufferRef=CanIfInitCfg/CHNL_2ad3227b, CanIfTxPduRef=EcucPduCollection/RDR_STATUS_002_oPCAN_RADAR_85a3c9df_Tx
        RDR_TRACKER_OBJ_001_oPCAN_RADAR_7d6cb36b_Tx: CanIfTxPduCanId=1296 if post-build-variant-condition{matching-criterion=RDR_POS, value=0}, CanIfTxPduCanIdType=STANDARD_FD_CAN, CanIfTxPduDlc=64, CanIfTxPduUserTxConfirmationName=PduR_CanIfTxConfirmation, CanIfTxPduUserTxConfirmationUL=PDUR, CanIfTxPduCanId=1360 if post-build-variant-condition{matching-criterion=RDR_POS, value=1}, CanIfTxPduCanId=1424 if post-build-variant-condition{matching-criterion=RDR_POS, value=2}, CanIfTxPduCanId=1488 if post-build-variant-condition{matching-criterion=RDR_POS, value=3}, CanIfTxPduCanId=1552 if post-build-variant-condition{matching-criterion=RDR_POS, value=4}, CanIfTxPduCanId=1616 if post-build-variant-condition{matching-criterion=RDR_POS, value=5}, CanIfTxPduCanId=1680 if post-build-variant-condition{matching-criterion=RDR_POS, value=6}, CanIfTxPduCanId=1744 if post-build-variant-condition{matching-criterion=RDR_POS, value=7}, CanIfTxPduBufferRef=CanIfInitCfg/CHNL_2ad3227b, CanIfTxPduRef=EcucPduCollection/RDR_TRACKER_OBJ_001_oPCAN_RADAR_eb452802_Tx
        RDR_TRACKER_OBJ_002_oPCAN_RADAR_62323590_Tx: CanIfTxPduCanId=1297 if post-build-variant-condition{matching-criterion=RDR_POS, value=0}, CanIfTxPduCanIdType=STANDARD_FD_CAN, CanIfTxPduDlc=64, CanIfTxPduUserTxConfirmationName=PduR_CanIfTxConfirmation, CanIfTxPduUserTxConfirmationUL=PDUR, CanIfTxPduCanId=1361 if post-build-variant-condition{matching-criterion=RDR_POS, value=1}, CanIfTxPduCanId=1425 if post-build-variant-condition{matching-criterion=RDR_POS, value=2}, CanIfTxPduCanId=1489 if post-build-variant-condition{matching-criterion=RDR_POS, value=3}, CanIfTxPduCanId=1553 if post-build-variant-condition{matching-criterion=RDR_POS, value=4}, CanIfTxPduCanId=1617 if post-build-variant-condition{matching-criterion=RDR_POS, value=5}, CanIfTxPduCanId=1681 if post-build-variant-condition{matching-criterion=RDR_POS, value=6}, CanIfTxPduCanId=1745 if post-build-variant-condition{matching-criterion=RDR_POS, value=7}, CanIfTxPduBufferRef=CanIfInitCfg/CHNL_2ad3227b, CanIfTxPduRef=EcucPduCollection/RDR_TRACKER_OBJ_002_oPCAN_RADAR_b0529917_Tx
        RDR_TRACKER_OBJ_003_oPCAN_RADAR_68f84839_Tx: CanIfTxPduCanId=1298 if post-build-variant-condition{matching-criterion=RDR_POS, value=0}, CanIfTxPduCanIdType=STANDARD_FD_CAN, CanIfTxPduDlc=64, CanIfTxPduUserTxConfirmationName=PduR_CanIfTxConfirmation, CanIfTxPduUserTxConfirmationUL=PDUR, CanIfTxPduCanId=1362 if post-build-variant-condition{matching-criterion=RDR_POS, value=1}, CanIfTxPduCanId=1426 if post-build-variant-condition{matching-criterion=RDR_POS, value=2}, CanIfTxPduCanId=1490 if post-build-variant-condition{matching-criterion=RDR_POS, value=3}, CanIfTxPduCanId=1554 if post-build-variant-condition{matching-criterion=RDR_POS, value=4}, CanIfTxPduCanId=1618 if post-build-variant-condition{matching-criterion=RDR_POS, value=5}, CanIfTxPduCanId=1682 if post-build-variant-condition{matching-criterion=RDR_POS, value=6}, CanIfTxPduCanId=1746 if post-build-variant-condition{matching-criterion=RDR_POS, value=7}, CanIfTxPduBufferRef=CanIfInitCfg/CHNL_2ad3227b, CanIfTxPduRef=EcucPduCollection/RDR_TRACKER_OBJ_003_oPCAN_RADAR_86a009e4_Tx
        RDR_TRACKER_OBJ_004_oPCAN_RADAR_5c8f3866_Tx: CanIfTxPduCanId=1299 if post-build-variant-condition{matching-criterion=RDR_POS, value=0}, CanIfTxPduCanIdType=STANDARD_FD_CAN, CanIfTxPduDlc=64, CanIfTxPduUserTxConfirmationName=PduR_CanIfTxConfirmation, CanIfTxPduUserTxConfirmationUL=PDUR, CanIfTxPduCanId=1363 if post-build-variant-condition{matching-criterion=RDR_POS, value=1}, CanIfTxPduCanId=1427 if post-build-variant-condition{matching-criterion=RDR_POS, value=2}, CanIfTxPduCanId=1491 if post-build-variant-condition{matching-criterion=RDR_POS, value=3}, CanIfTxPduCanId=1555 if post-build-variant-condition{matching-criterion=RDR_POS, value=4}, CanIfTxPduCanId=1619 if post-build-variant-condition{matching-criterion=RDR_POS, value=5}, CanIfTxPduCanId=1683 if post-build-variant-condition{matching-criterion=RDR_POS, value=6}, CanIfTxPduCanId=1747 if post-build-variant-condition{matching-criterion=RDR_POS, value=7}, CanIfTxPduBufferRef=CanIfInitCfg/CHNL_2ad3227b, CanIfTxPduRef=EcucPduCollection/RDR_TRACKER_OBJ_004_oPCAN_RADAR_067dfb3d_Tx
        RDR_TRACKER_OBJ_005_oPCAN_RADAR_564545cf_Tx: CanIfTxPduCanId=1300 if post-build-variant-condition{matching-criterion=RDR_POS, value=0}, CanIfTxPduCanIdType=STANDARD_FD_CAN, CanIfTxPduDlc=64, CanIfTxPduUserTxConfirmationName=PduR_CanIfTxConfirmation, CanIfTxPduUserTxConfirmationUL=PDUR, CanIfTxPduCanId=1364 if post-build-variant-condition{matching-criterion=RDR_POS, value=1}, CanIfTxPduCanId=1428 if post-build-variant-condition{matching-criterion=RDR_POS, value=2}, CanIfTxPduCanId=1492 if post-build-variant-condition{matching-criterion=RDR_POS, value=3}, CanIfTxPduCanId=1556 if post-build-variant-condition{matching-criterion=RDR_POS, value=4}, CanIfTxPduCanId=1620 if post-build-variant-condition{matching-criterion=RDR_POS, value=5}, CanIfTxPduCanId=1684 if post-build-variant-condition{matching-criterion=RDR_POS, value=6}, CanIfTxPduCanId=1748 if post-build-variant-condition{matching-criterion=RDR_POS, value=7}, CanIfTxPduBufferRef=CanIfInitCfg/CHNL_2ad3227b, CanIfTxPduRef=EcucPduCollection/RDR_TRACKER_OBJ_005_oPCAN_RADAR_308f6bce_Tx
        RDR_TRACKER_OBJ_006_oPCAN_RADAR_491bc334_Tx: CanIfTxPduCanId=1301 if post-build-variant-condition{matching-criterion=RDR_POS, value=0}, CanIfTxPduCanIdType=STANDARD_FD_CAN, CanIfTxPduDlc=64, CanIfTxPduUserTxConfirmationName=PduR_CanIfTxConfirmation, CanIfTxPduUserTxConfirmationUL=PDUR, CanIfTxPduCanId=1365 if post-build-variant-condition{matching-criterion=RDR_POS, value=1}, CanIfTxPduCanId=1429 if post-build-variant-condition{matching-criterion=RDR_POS, value=2}, CanIfTxPduCanId=1493 if post-build-variant-condition{matching-criterion=RDR_POS, value=3}, CanIfTxPduCanId=1557 if post-build-variant-condition{matching-criterion=RDR_POS, value=4}, CanIfTxPduCanId=1621 if post-build-variant-condition{matching-criterion=RDR_POS, value=5}, CanIfTxPduCanId=1685 if post-build-variant-condition{matching-criterion=RDR_POS, value=6}, CanIfTxPduCanId=1749 if post-build-variant-condition{matching-criterion=RDR_POS, value=7}, CanIfTxPduBufferRef=CanIfInitCfg/CHNL_2ad3227b, CanIfTxPduRef=EcucPduCollection/RDR_TRACKER_OBJ_006_oPCAN_RADAR_6b98dadb_Tx
        RDR_TRACKER_OBJ_007_oPCAN_RADAR_43d1be9d_Tx: CanIfTxPduCanId=1302 if post-build-variant-condition{matching-criterion=RDR_POS, value=0}, CanIfTxPduCanIdType=STANDARD_FD_CAN, CanIfTxPduDlc=64, CanIfTxPduUserTxConfirmationName=PduR_CanIfTxConfirmation, CanIfTxPduUserTxConfirmationUL=PDUR, CanIfTxPduCanId=1366 if post-build-variant-condition{matching-criterion=RDR_POS, value=1}, CanIfTxPduCanId=1430 if post-build-variant-condition{matching-criterion=RDR_POS, value=2}, CanIfTxPduCanId=1494 if post-build-variant-condition{matching-criterion=RDR_POS, value=3}, CanIfTxPduCanId=1558 if post-build-variant-condition{matching-criterion=RDR_POS, value=4}, CanIfTxPduCanId=1622 if post-build-variant-condition{matching-criterion=RDR_POS, value=5}, CanIfTxPduCanId=1686 if post-build-variant-condition{matching-criterion=RDR_POS, value=6}, CanIfTxPduCanId=1750 if post-build-variant-condition{matching-criterion=RDR_POS, value=7}, CanIfTxPduBufferRef=CanIfInitCfg/CHNL_2ad3227b, CanIfTxPduRef=EcucPduCollection/RDR_TRACKER_OBJ_007_oPCAN_RADAR_5d6a4a28_Tx
        RDR_TRACKER_OBJ_008_oPCAN_RADAR_21f5238a_Tx: CanIfTxPduCanId=1303 if post-build-variant-condition{matching-criterion=RDR_POS, value=0}, CanIfTxPduCanIdType=STANDARD_FD_CAN, CanIfTxPduDlc=64, CanIfTxPduUserTxConfirmationName=PduR_CanIfTxConfirmation, CanIfTxPduUserTxConfirmationUL=PDUR, CanIfTxPduCanId=1367 if post-build-variant-condition{matching-criterion=RDR_POS, value=1}, CanIfTxPduCanId=1431 if post-build-variant-condition{matching-criterion=RDR_POS, value=2}, CanIfTxPduCanId=1495 if post-build-variant-condition{matching-criterion=RDR_POS, value=3}, CanIfTxPduCanId=1559 if post-build-variant-condition{matching-criterion=RDR_POS, value=4}, CanIfTxPduCanId=1623 if post-build-variant-condition{matching-criterion=RDR_POS, value=5}, CanIfTxPduCanId=1687 if post-build-variant-condition{matching-criterion=RDR_POS, value=6}, CanIfTxPduCanId=1751 if post-build-variant-condition{matching-criterion=RDR_POS, value=7}, CanIfTxPduBufferRef=CanIfInitCfg/CHNL_2ad3227b, CanIfTxPduRef=EcucPduCollection/RDR_TRACKER_OBJ_008_oPCAN_RADAR_b1523928_Tx
        RDR_TRACKER_OBJ_009_oPCAN_RADAR_2b3f5e23_Tx: CanIfTxPduCanId=1304 if post-build-variant-condition{matching-criterion=RDR_POS, value=0}, CanIfTxPduCanIdType=STANDARD_FD_CAN, CanIfTxPduDlc=64, CanIfTxPduUserTxConfirmationName=PduR_CanIfTxConfirmation, CanIfTxPduUserTxConfirmationUL=PDUR, CanIfTxPduCanId=1368 if post-build-variant-condition{matching-criterion=RDR_POS, value=1}, CanIfTxPduCanId=1432 if post-build-variant-condition{matching-criterion=RDR_POS, value=2}, CanIfTxPduCanId=1496 if post-build-variant-condition{matching-criterion=RDR_POS, value=3}, CanIfTxPduCanId=1560 if post-build-variant-condition{matching-criterion=RDR_POS, value=4}, CanIfTxPduCanId=1624 if post-build-variant-condition{matching-criterion=RDR_POS, value=5}, CanIfTxPduCanId=1688 if post-build-variant-condition{matching-criterion=RDR_POS, value=6}, CanIfTxPduCanId=1752 if post-build-variant-condition{matching-criterion=RDR_POS, value=7}, CanIfTxPduBufferRef=CanIfInitCfg/CHNL_2ad3227b, CanIfTxPduRef=EcucPduCollection/RDR_TRACKER_OBJ_009_oPCAN_RADAR_87a0a9db_Tx
        RDR_TRACKER_OBJ_010_oPCAN_RADAR_d8a61ff3_Tx: CanIfTxPduCanId=1305 if post-build-variant-condition{matching-criterion=RDR_POS, value=0}, CanIfTxPduCanIdType=STANDARD_FD_CAN, CanIfTxPduDlc=64, CanIfTxPduUserTxConfirmationName=PduR_CanIfTxConfirmation, CanIfTxPduUserTxConfirmationUL=PDUR, CanIfTxPduCanId=1369 if post-build-variant-condition{matching-criterion=RDR_POS, value=1}, CanIfTxPduCanId=1433 if post-build-variant-condition{matching-criterion=RDR_POS, value=2}, CanIfTxPduCanId=1497 if post-build-variant-condition{matching-criterion=RDR_POS, value=3}, CanIfTxPduCanId=1561 if post-build-variant-condition{matching-criterion=RDR_POS, value=4}, CanIfTxPduCanId=1625 if post-build-variant-condition{matching-criterion=RDR_POS, value=5}, CanIfTxPduCanId=1689 if post-build-variant-condition{matching-criterion=RDR_POS, value=6}, CanIfTxPduCanId=1753 if post-build-variant-condition{matching-criterion=RDR_POS, value=7}, CanIfTxPduBufferRef=CanIfInitCfg/CHNL_2ad3227b, CanIfTxPduRef=EcucPduCollection/RDR_TRACKER_OBJ_010_oPCAN_RADAR_f935e9c7_Tx
        RDR_TRACKER_OBJ_011_oPCAN_RADAR_d26c625a_Tx: CanIfTxPduCanId=1306 if post-build-variant-condition{matching-criterion=RDR_POS, value=0}, CanIfTxPduCanIdType=STANDARD_FD_CAN, CanIfTxPduDlc=64, CanIfTxPduUserTxConfirmationName=PduR_CanIfTxConfirmation, CanIfTxPduUserTxConfirmationUL=PDUR, CanIfTxPduCanId=1370 if post-build-variant-condition{matching-criterion=RDR_POS, value=1}, CanIfTxPduCanId=1434 if post-build-variant-condition{matching-criterion=RDR_POS, value=2}, CanIfTxPduCanId=1498 if post-build-variant-condition{matching-criterion=RDR_POS, value=3}, CanIfTxPduCanId=1562 if post-build-variant-condition{matching-criterion=RDR_POS, value=4}, CanIfTxPduCanId=1626 if post-build-variant-condition{matching-criterion=RDR_POS, value=5}, CanIfTxPduCanId=1690 if post-build-variant-condition{matching-criterion=RDR_POS, value=6}, CanIfTxPduCanId=1754 if post-build-variant-condition{matching-criterion=RDR_POS, value=7}, CanIfTxPduBufferRef=CanIfInitCfg/CHNL_2ad3227b, CanIfTxPduRef=EcucPduCollection/RDR_TRACKER_OBJ_011_oPCAN_RADAR_cfc77934_Tx
        RDR_TRACKER_OBJ_012_oPCAN_RADAR_cd32e4a1_Tx: CanIfTxPduCanId=1307 if post-build-variant-condition{matching-criterion=RDR_POS, value=0}, CanIfTxPduCanIdType=STANDARD_FD_CAN, CanIfTxPduDlc=64, CanIfTxPduUserTxConfirmationName=PduR_CanIfTxConfirmation, CanIfTxPduUserTxConfirmationUL=PDUR, CanIfTxPduCanId=1371 if post-build-variant-condition{matching-criterion=RDR_POS, value=1}, CanIfTxPduCanId=1435 if post-build-variant-condition{matching-criterion=RDR_POS, value=2}, CanIfTxPduCanId=1499 if post-build-variant-condition{matching-criterion=RDR_POS, value=3}, CanIfTxPduCanId=1563 if post-build-variant-condition{matching-criterion=RDR_POS, value=4}, CanIfTxPduCanId=1627 if post-build-variant-condition{matching-criterion=RDR_POS, value=5}, CanIfTxPduCanId=1691 if post-build-variant-condition{matching-criterion=RDR_POS, value=6}, CanIfTxPduCanId=1755 if post-build-variant-condition{matching-criterion=RDR_POS, value=7}, CanIfTxPduBufferRef=CanIfInitCfg/CHNL_2ad3227b, CanIfTxPduRef=EcucPduCollection/RDR_TRACKER_OBJ_012_oPCAN_RADAR_94d0c821_Tx
        RDR_TRACKER_OBJ_013_oPCAN_RADAR_c7f89908_Tx: CanIfTxPduCanId=1308 if post-build-variant-condition{matching-criterion=RDR_POS, value=0}, CanIfTxPduCanIdType=STANDARD_FD_CAN, CanIfTxPduDlc=64, CanIfTxPduUserTxConfirmationName=PduR_CanIfTxConfirmation, CanIfTxPduUserTxConfirmationUL=PDUR, CanIfTxPduCanId=1372 if post-build-variant-condition{matching-criterion=RDR_POS, value=1}, CanIfTxPduCanId=1436 if post-build-variant-condition{matching-criterion=RDR_POS, value=2}, CanIfTxPduCanId=1500 if post-build-variant-condition{matching-criterion=RDR_POS, value=3}, CanIfTxPduCanId=1564 if post-build-variant-condition{matching-criterion=RDR_POS, value=4}, CanIfTxPduCanId=1628 if post-build-variant-condition{matching-criterion=RDR_POS, value=5}, CanIfTxPduCanId=1692 if post-build-variant-condition{matching-criterion=RDR_POS, value=6}, CanIfTxPduCanId=1756 if post-build-variant-condition{matching-criterion=RDR_POS, value=7}, CanIfTxPduBufferRef=CanIfInitCfg/CHNL_2ad3227b, CanIfTxPduRef=EcucPduCollection/RDR_TRACKER_OBJ_013_oPCAN_RADAR_a22258d2_Tx
        RDR_TRACKER_OBJ_014_oPCAN_RADAR_f38fe957_Tx: CanIfTxPduCanId=1309 if post-build-variant-condition{matching-criterion=RDR_POS, value=0}, CanIfTxPduCanIdType=STANDARD_FD_CAN, CanIfTxPduDlc=64, CanIfTxPduUserTxConfirmationName=PduR_CanIfTxConfirmation, CanIfTxPduUserTxConfirmationUL=PDUR, CanIfTxPduCanId=1373 if post-build-variant-condition{matching-criterion=RDR_POS, value=1}, CanIfTxPduCanId=1437 if post-build-variant-condition{matching-criterion=RDR_POS, value=2}, CanIfTxPduCanId=1501 if post-build-variant-condition{matching-criterion=RDR_POS, value=3}, CanIfTxPduCanId=1565 if post-build-variant-condition{matching-criterion=RDR_POS, value=4}, CanIfTxPduCanId=1629 if post-build-variant-condition{matching-criterion=RDR_POS, value=5}, CanIfTxPduCanId=1693 if post-build-variant-condition{matching-criterion=RDR_POS, value=6}, CanIfTxPduCanId=1757 if post-build-variant-condition{matching-criterion=RDR_POS, value=7}, CanIfTxPduBufferRef=CanIfInitCfg/CHNL_2ad3227b, CanIfTxPduRef=EcucPduCollection/RDR_TRACKER_OBJ_014_oPCAN_RADAR_22ffaa0b_Tx
        RDR_TRACKER_OBJ_015_oPCAN_RADAR_f94594fe_Tx: CanIfTxPduCanId=1310 if post-build-variant-condition{matching-criterion=RDR_POS, value=0}, CanIfTxPduCanIdType=STANDARD_FD_CAN, CanIfTxPduDlc=64, CanIfTxPduUserTxConfirmationName=PduR_CanIfTxConfirmation, CanIfTxPduUserTxConfirmationUL=PDUR, CanIfTxPduCanId=1374 if post-build-variant-condition{matching-criterion=RDR_POS, value=1}, CanIfTxPduCanId=1438 if post-build-variant-condition{matching-criterion=RDR_POS, value=2}, CanIfTxPduCanId=1502 if post-build-variant-condition{matching-criterion=RDR_POS, value=3}, CanIfTxPduCanId=1566 if post-build-variant-condition{matching-criterion=RDR_POS, value=4}, CanIfTxPduCanId=1630 if post-build-variant-condition{matching-criterion=RDR_POS, value=5}, CanIfTxPduCanId=1694 if post-build-variant-condition{matching-criterion=RDR_POS, value=6}, CanIfTxPduCanId=1758 if post-build-variant-condition{matching-criterion=RDR_POS, value=7}, CanIfTxPduBufferRef=CanIfInitCfg/CHNL_2ad3227b, CanIfTxPduRef=EcucPduCollection/RDR_TRACKER_OBJ_015_oPCAN_RADAR_140d3af8_Tx
        RDR_TRACKER_OBJ_016_oPCAN_RADAR_e61b1205_Tx: CanIfTxPduCanId=1311 if post-build-variant-condition{matching-criterion=RDR_POS, value=0}, CanIfTxPduCanIdType=STANDARD_FD_CAN, CanIfTxPduDlc=64, CanIfTxPduUserTxConfirmationName=PduR_CanIfTxConfirmation, CanIfTxPduUserTxConfirmationUL=PDUR, CanIfTxPduCanId=1375 if post-build-variant-condition{matching-criterion=RDR_POS, value=1}, CanIfTxPduCanId=1439 if post-build-variant-condition{matching-criterion=RDR_POS, value=2}, CanIfTxPduCanId=1503 if post-build-variant-condition{matching-criterion=RDR_POS, value=3}, CanIfTxPduCanId=1567 if post-build-variant-condition{matching-criterion=RDR_POS, value=4}, CanIfTxPduCanId=1631 if post-build-variant-condition{matching-criterion=RDR_POS, value=5}, CanIfTxPduCanId=1695 if post-build-variant-condition{matching-criterion=RDR_POS, value=6}, CanIfTxPduCanId=1759 if post-build-variant-condition{matching-criterion=RDR_POS, value=7}, CanIfTxPduBufferRef=CanIfInitCfg/CHNL_2ad3227b, CanIfTxPduRef=EcucPduCollection/RDR_TRACKER_OBJ_016_oPCAN_RADAR_4f1a8bed_Tx
        RDR_TRACKER_OBJ_017_oPCAN_RADAR_ecd16fac_Tx: CanIfTxPduCanId=1312 if post-build-variant-condition{matching-criterion=RDR_POS, value=0}, CanIfTxPduCanIdType=STANDARD_FD_CAN, CanIfTxPduDlc=64, CanIfTxPduUserTxConfirmationName=PduR_CanIfTxConfirmation, CanIfTxPduUserTxConfirmationUL=PDUR, CanIfTxPduCanId=1376 if post-build-variant-condition{matching-criterion=RDR_POS, value=1}, CanIfTxPduCanId=1440 if post-build-variant-condition{matching-criterion=RDR_POS, value=2}, CanIfTxPduCanId=1504 if post-build-variant-condition{matching-criterion=RDR_POS, value=3}, CanIfTxPduCanId=1568 if post-build-variant-condition{matching-criterion=RDR_POS, value=4}, CanIfTxPduCanId=1632 if post-build-variant-condition{matching-criterion=RDR_POS, value=5}, CanIfTxPduCanId=1696 if post-build-variant-condition{matching-criterion=RDR_POS, value=6}, CanIfTxPduCanId=1760 if post-build-variant-condition{matching-criterion=RDR_POS, value=7}, CanIfTxPduBufferRef=CanIfInitCfg/CHNL_2ad3227b, CanIfTxPduRef=EcucPduCollection/RDR_TRACKER_OBJ_017_oPCAN_RADAR_79e81b1e_Tx
        RDR_TRACKER_OBJ_018_oPCAN_RADAR_8ef5f2bb_Tx: CanIfTxPduCanId=1313 if post-build-variant-condition{matching-criterion=RDR_POS, value=0}, CanIfTxPduCanIdType=STANDARD_FD_CAN, CanIfTxPduDlc=64, CanIfTxPduUserTxConfirmationName=PduR_CanIfTxConfirmation, CanIfTxPduUserTxConfirmationUL=PDUR, CanIfTxPduCanId=1377 if post-build-variant-condition{matching-criterion=RDR_POS, value=1}, CanIfTxPduCanId=1441 if post-build-variant-condition{matching-criterion=RDR_POS, value=2}, CanIfTxPduCanId=1505 if post-build-variant-condition{matching-criterion=RDR_POS, value=3}, CanIfTxPduCanId=1569 if post-build-variant-condition{matching-criterion=RDR_POS, value=4}, CanIfTxPduCanId=1633 if post-build-variant-condition{matching-criterion=RDR_POS, value=5}, CanIfTxPduCanId=1697 if post-build-variant-condition{matching-criterion=RDR_POS, value=6}, CanIfTxPduCanId=1761 if post-build-variant-condition{matching-criterion=RDR_POS, value=7}, CanIfTxPduBufferRef=CanIfInitCfg/CHNL_2ad3227b, CanIfTxPduRef=EcucPduCollection/RDR_TRACKER_OBJ_018_oPCAN_RADAR_95d0681e_Tx
        RDR_TRACKER_OBJ_019_oPCAN_RADAR_843f8f12_Tx: CanIfTxPduCanId=1314 if post-build-variant-condition{matching-criterion=RDR_POS, value=0}, CanIfTxPduCanIdType=STANDARD_FD_CAN, CanIfTxPduDlc=64, CanIfTxPduUserTxConfirmationName=PduR_CanIfTxConfirmation, CanIfTxPduUserTxConfirmationUL=PDUR, CanIfTxPduCanId=1378 if post-build-variant-condition{matching-criterion=RDR_POS, value=1}, CanIfTxPduCanId=1442 if post-build-variant-condition{matching-criterion=RDR_POS, value=2}, CanIfTxPduCanId=1506 if post-build-variant-condition{matching-criterion=RDR_POS, value=3}, CanIfTxPduCanId=1570 if post-build-variant-condition{matching-criterion=RDR_POS, value=4}, CanIfTxPduCanId=1634 if post-build-variant-condition{matching-criterion=RDR_POS, value=5}, CanIfTxPduCanId=1698 if post-build-variant-condition{matching-criterion=RDR_POS, value=6}, CanIfTxPduCanId=1762 if post-build-variant-condition{matching-criterion=RDR_POS, value=7}, CanIfTxPduBufferRef=CanIfInitCfg/CHNL_2ad3227b, CanIfTxPduRef=EcucPduCollection/RDR_TRACKER_OBJ_019_oPCAN_RADAR_a322f8ed_Tx
        RDR_TRACKER_OBJ_020_oPCAN_RADAR_f2d66ae1_Tx: CanIfTxPduCanId=1315 if post-build-variant-condition{matching-criterion=RDR_POS, value=0}, CanIfTxPduCanIdType=STANDARD_FD_CAN, CanIfTxPduDlc=64, CanIfTxPduUserTxConfirmationName=PduR_CanIfTxConfirmation, CanIfTxPduUserTxConfirmationUL=PDUR, CanIfTxPduCanId=1379 if post-build-variant-condition{matching-criterion=RDR_POS, value=1}, CanIfTxPduCanId=1443 if post-build-variant-condition{matching-criterion=RDR_POS, value=2}, CanIfTxPduCanId=1507 if post-build-variant-condition{matching-criterion=RDR_POS, value=3}, CanIfTxPduCanId=1571 if post-build-variant-condition{matching-criterion=RDR_POS, value=4}, CanIfTxPduCanId=1635 if post-build-variant-condition{matching-criterion=RDR_POS, value=5}, CanIfTxPduCanId=1699 if post-build-variant-condition{matching-criterion=RDR_POS, value=6}, CanIfTxPduCanId=1763 if post-build-variant-condition{matching-criterion=RDR_POS, value=7}, CanIfTxPduBufferRef=CanIfInitCfg/CHNL_2ad3227b, CanIfTxPduRef=EcucPduCollection/RDR_TRACKER_OBJ_020_oPCAN_RADAR_94b31a9d_Tx
        RDR_TRACKER_OBJ_021_oPCAN_RADAR_f81c1748_Tx: CanIfTxPduCanId=1316 if post-build-variant-condition{matching-criterion=RDR_POS, value=0}, CanIfTxPduCanIdType=STANDARD_FD_CAN, CanIfTxPduDlc=64, CanIfTxPduUserTxConfirmationName=PduR_CanIfTxConfirmation, CanIfTxPduUserTxConfirmationUL=PDUR, CanIfTxPduCanId=1380 if post-build-variant-condition{matching-criterion=RDR_POS, value=1}, CanIfTxPduCanId=1444 if post-build-variant-condition{matching-criterion=RDR_POS, value=2}, CanIfTxPduCanId=1508 if post-build-variant-condition{matching-criterion=RDR_POS, value=3}, CanIfTxPduCanId=1572 if post-build-variant-condition{matching-criterion=RDR_POS, value=4}, CanIfTxPduCanId=1636 if post-build-variant-condition{matching-criterion=RDR_POS, value=5}, CanIfTxPduCanId=1700 if post-build-variant-condition{matching-criterion=RDR_POS, value=6}, CanIfTxPduCanId=1764 if post-build-variant-condition{matching-criterion=RDR_POS, value=7}, CanIfTxPduBufferRef=CanIfInitCfg/CHNL_2ad3227b, CanIfTxPduRef=EcucPduCollection/RDR_TRACKER_OBJ_021_oPCAN_RADAR_a2418a6e_Tx
        RDR_TRACKER_OBJ_022_oPCAN_RADAR_e74291b3_Tx: CanIfTxPduCanId=1317 if post-build-variant-condition{matching-criterion=RDR_POS, value=0}, CanIfTxPduCanIdType=STANDARD_FD_CAN, CanIfTxPduDlc=64, CanIfTxPduUserTxConfirmationName=PduR_CanIfTxConfirmation, CanIfTxPduUserTxConfirmationUL=PDUR, CanIfTxPduCanId=1381 if post-build-variant-condition{matching-criterion=RDR_POS, value=1}, CanIfTxPduCanId=1445 if post-build-variant-condition{matching-criterion=RDR_POS, value=2}, CanIfTxPduCanId=1509 if post-build-variant-condition{matching-criterion=RDR_POS, value=3}, CanIfTxPduCanId=1573 if post-build-variant-condition{matching-criterion=RDR_POS, value=4}, CanIfTxPduCanId=1637 if post-build-variant-condition{matching-criterion=RDR_POS, value=5}, CanIfTxPduCanId=1701 if post-build-variant-condition{matching-criterion=RDR_POS, value=6}, CanIfTxPduCanId=1765 if post-build-variant-condition{matching-criterion=RDR_POS, value=7}, CanIfTxPduBufferRef=CanIfInitCfg/CHNL_2ad3227b, CanIfTxPduRef=EcucPduCollection/RDR_TRACKER_OBJ_022_oPCAN_RADAR_f9563b7b_Tx
        RDR_TRACKER_OBJ_023_oPCAN_RADAR_ed88ec1a_Tx: CanIfTxPduCanId=1318 if post-build-variant-condition{matching-criterion=RDR_POS, value=0}, CanIfTxPduCanIdType=STANDARD_FD_CAN, CanIfTxPduDlc=64, CanIfTxPduUserTxConfirmationName=PduR_CanIfTxConfirmation, CanIfTxPduUserTxConfirmationUL=PDUR, CanIfTxPduCanId=1382 if post-build-variant-condition{matching-criterion=RDR_POS, value=1}, CanIfTxPduCanId=1446 if post-build-variant-condition{matching-criterion=RDR_POS, value=2}, CanIfTxPduCanId=1510 if post-build-variant-condition{matching-criterion=RDR_POS, value=3}, CanIfTxPduCanId=1574 if post-build-variant-condition{matching-criterion=RDR_POS, value=4}, CanIfTxPduCanId=1638 if post-build-variant-condition{matching-criterion=RDR_POS, value=5}, CanIfTxPduCanId=1702 if post-build-variant-condition{matching-criterion=RDR_POS, value=6}, CanIfTxPduCanId=1766 if post-build-variant-condition{matching-criterion=RDR_POS, value=7}, CanIfTxPduBufferRef=CanIfInitCfg/CHNL_2ad3227b, CanIfTxPduRef=EcucPduCollection/RDR_TRACKER_OBJ_023_oPCAN_RADAR_cfa4ab88_Tx
        RDR_TRACKER_OBJ_024_oPCAN_RADAR_d9ff9c45_Tx: CanIfTxPduCanId=1319 if post-build-variant-condition{matching-criterion=RDR_POS, value=0}, CanIfTxPduCanIdType=STANDARD_FD_CAN, CanIfTxPduDlc=64, CanIfTxPduUserTxConfirmationName=PduR_CanIfTxConfirmation, CanIfTxPduUserTxConfirmationUL=PDUR, CanIfTxPduCanId=1383 if post-build-variant-condition{matching-criterion=RDR_POS, value=1}, CanIfTxPduCanId=1447 if post-build-variant-condition{matching-criterion=RDR_POS, value=2}, CanIfTxPduCanId=1511 if post-build-variant-condition{matching-criterion=RDR_POS, value=3}, CanIfTxPduCanId=1575 if post-build-variant-condition{matching-criterion=RDR_POS, value=4}, CanIfTxPduCanId=1639 if post-build-variant-condition{matching-criterion=RDR_POS, value=5}, CanIfTxPduCanId=1703 if post-build-variant-condition{matching-criterion=RDR_POS, value=6}, CanIfTxPduCanId=1767 if post-build-variant-condition{matching-criterion=RDR_POS, value=7}, CanIfTxPduBufferRef=CanIfInitCfg/CHNL_2ad3227b, CanIfTxPduRef=EcucPduCollection/RDR_TRACKER_OBJ_024_oPCAN_RADAR_4f795951_Tx
        RDR_TRACKER_OBJ_025_oPCAN_RADAR_d335e1ec_Tx: CanIfTxPduCanId=1320 if post-build-variant-condition{matching-criterion=RDR_POS, value=0}, CanIfTxPduCanIdType=STANDARD_FD_CAN, CanIfTxPduDlc=64, CanIfTxPduUserTxConfirmationName=PduR_CanIfTxConfirmation, CanIfTxPduUserTxConfirmationUL=PDUR, CanIfTxPduCanId=1384 if post-build-variant-condition{matching-criterion=RDR_POS, value=1}, CanIfTxPduCanId=1448 if post-build-variant-condition{matching-criterion=RDR_POS, value=2}, CanIfTxPduCanId=1512 if post-build-variant-condition{matching-criterion=RDR_POS, value=3}, CanIfTxPduCanId=1576 if post-build-variant-condition{matching-criterion=RDR_POS, value=4}, CanIfTxPduCanId=1640 if post-build-variant-condition{matching-criterion=RDR_POS, value=5}, CanIfTxPduCanId=1704 if post-build-variant-condition{matching-criterion=RDR_POS, value=6}, CanIfTxPduCanId=1768 if post-build-variant-condition{matching-criterion=RDR_POS, value=7}, CanIfTxPduBufferRef=CanIfInitCfg/CHNL_2ad3227b, CanIfTxPduRef=EcucPduCollection/RDR_TRACKER_OBJ_025_oPCAN_RADAR_798bc9a2_Tx
        RDR_TRACKER_OBJ_026_oPCAN_RADAR_cc6b6717_Tx: CanIfTxPduCanId=1321 if post-build-variant-condition{matching-criterion=RDR_POS, value=0}, CanIfTxPduCanIdType=STANDARD_FD_CAN, CanIfTxPduDlc=64, CanIfTxPduUserTxConfirmationName=PduR_CanIfTxConfirmation, CanIfTxPduUserTxConfirmationUL=PDUR, CanIfTxPduCanId=1385 if post-build-variant-condition{matching-criterion=RDR_POS, value=1}, CanIfTxPduCanId=1449 if post-build-variant-condition{matching-criterion=RDR_POS, value=2}, CanIfTxPduCanId=1513 if post-build-variant-condition{matching-criterion=RDR_POS, value=3}, CanIfTxPduCanId=1577 if post-build-variant-condition{matching-criterion=RDR_POS, value=4}, CanIfTxPduCanId=1641 if post-build-variant-condition{matching-criterion=RDR_POS, value=5}, CanIfTxPduCanId=1705 if post-build-variant-condition{matching-criterion=RDR_POS, value=6}, CanIfTxPduCanId=1769 if post-build-variant-condition{matching-criterion=RDR_POS, value=7}, CanIfTxPduBufferRef=CanIfInitCfg/CHNL_2ad3227b, CanIfTxPduRef=EcucPduCollection/RDR_TRACKER_OBJ_026_oPCAN_RADAR_229c78b7_Tx
        RDR_TRACKER_OBJ_027_oPCAN_RADAR_c6a11abe_Tx: CanIfTxPduCanId=1322 if post-build-variant-condition{matching-criterion=RDR_POS, value=0}, CanIfTxPduCanIdType=STANDARD_FD_CAN, CanIfTxPduDlc=64, CanIfTxPduUserTxConfirmationName=PduR_CanIfTxConfirmation, CanIfTxPduUserTxConfirmationUL=PDUR, CanIfTxPduCanId=1386 if post-build-variant-condition{matching-criterion=RDR_POS, value=1}, CanIfTxPduCanId=1450 if post-build-variant-condition{matching-criterion=RDR_POS, value=2}, CanIfTxPduCanId=1514 if post-build-variant-condition{matching-criterion=RDR_POS, value=3}, CanIfTxPduCanId=1578 if post-build-variant-condition{matching-criterion=RDR_POS, value=4}, CanIfTxPduCanId=1642 if post-build-variant-condition{matching-criterion=RDR_POS, value=5}, CanIfTxPduCanId=1706 if post-build-variant-condition{matching-criterion=RDR_POS, value=6}, CanIfTxPduCanId=1770 if post-build-variant-condition{matching-criterion=RDR_POS, value=7}, CanIfTxPduBufferRef=CanIfInitCfg/CHNL_2ad3227b, CanIfTxPduRef=EcucPduCollection/RDR_TRACKER_OBJ_027_oPCAN_RADAR_146ee844_Tx
        RDR_TRACKER_OBJ_028_oPCAN_RADAR_a48587a9_Tx: CanIfTxPduCanId=1323 if post-build-variant-condition{matching-criterion=RDR_POS, value=0}, CanIfTxPduCanIdType=STANDARD_FD_CAN, CanIfTxPduDlc=64, CanIfTxPduUserTxConfirmationName=PduR_CanIfTxConfirmation, CanIfTxPduUserTxConfirmationUL=PDUR, CanIfTxPduCanId=1387 if post-build-variant-condition{matching-criterion=RDR_POS, value=1}, CanIfTxPduCanId=1451 if post-build-variant-condition{matching-criterion=RDR_POS, value=2}, CanIfTxPduCanId=1515 if post-build-variant-condition{matching-criterion=RDR_POS, value=3}, CanIfTxPduCanId=1579 if post-build-variant-condition{matching-criterion=RDR_POS, value=4}, CanIfTxPduCanId=1643 if post-build-variant-condition{matching-criterion=RDR_POS, value=5}, CanIfTxPduCanId=1707 if post-build-variant-condition{matching-criterion=RDR_POS, value=6}, CanIfTxPduCanId=1771 if post-build-variant-condition{matching-criterion=RDR_POS, value=7}, CanIfTxPduBufferRef=CanIfInitCfg/CHNL_2ad3227b, CanIfTxPduRef=EcucPduCollection/RDR_TRACKER_OBJ_028_oPCAN_RADAR_f8569b44_Tx
        RDR_TRACKER_OBJ_029_oPCAN_RADAR_ae4ffa00_Tx: CanIfTxPduCanId=1324 if post-build-variant-condition{matching-criterion=RDR_POS, value=0}, CanIfTxPduCanIdType=STANDARD_FD_CAN, CanIfTxPduDlc=64, CanIfTxPduUserTxConfirmationName=PduR_CanIfTxConfirmation, CanIfTxPduUserTxConfirmationUL=PDUR, CanIfTxPduCanId=1388 if post-build-variant-condition{matching-criterion=RDR_POS, value=1}, CanIfTxPduCanId=1452 if post-build-variant-condition{matching-criterion=RDR_POS, value=2}, CanIfTxPduCanId=1516 if post-build-variant-condition{matching-criterion=RDR_POS, value=3}, CanIfTxPduCanId=1580 if post-build-variant-condition{matching-criterion=RDR_POS, value=4}, CanIfTxPduCanId=1644 if post-build-variant-condition{matching-criterion=RDR_POS, value=5}, CanIfTxPduCanId=1708 if post-build-variant-condition{matching-criterion=RDR_POS, value=6}, CanIfTxPduCanId=1772 if post-build-variant-condition{matching-criterion=RDR_POS, value=7}, CanIfTxPduBufferRef=CanIfInitCfg/CHNL_2ad3227b, CanIfTxPduRef=EcucPduCollection/RDR_TRACKER_OBJ_029_oPCAN_RADAR_cea40bb7_Tx
        RDR_TRACKER_OBJ_030_oPCAN_RADAR_5dd6bbd0_Tx: CanIfTxPduCanId=1325 if post-build-variant-condition{matching-criterion=RDR_POS, value=0}, CanIfTxPduCanIdType=STANDARD_FD_CAN, CanIfTxPduDlc=64, CanIfTxPduUserTxConfirmationName=PduR_CanIfTxConfirmation, CanIfTxPduUserTxConfirmationUL=PDUR, CanIfTxPduCanId=1389 if post-build-variant-condition{matching-criterion=RDR_POS, value=1}, CanIfTxPduCanId=1453 if post-build-variant-condition{matching-criterion=RDR_POS, value=2}, CanIfTxPduCanId=1517 if post-build-variant-condition{matching-criterion=RDR_POS, value=3}, CanIfTxPduCanId=1581 if post-build-variant-condition{matching-criterion=RDR_POS, value=4}, CanIfTxPduCanId=1645 if post-build-variant-condition{matching-criterion=RDR_POS, value=5}, CanIfTxPduCanId=1709 if post-build-variant-condition{matching-criterion=RDR_POS, value=6}, CanIfTxPduCanId=1773 if post-build-variant-condition{matching-criterion=RDR_POS, value=7}, CanIfTxPduBufferRef=CanIfInitCfg/CHNL_2ad3227b, CanIfTxPduRef=EcucPduCollection/RDR_TRACKER_OBJ_030_oPCAN_RADAR_b0314bab_Tx
        RDR_TRACKER_OBJ_031_oPCAN_RADAR_571cc679_Tx: CanIfTxPduCanId=1326 if post-build-variant-condition{matching-criterion=RDR_POS, value=0}, CanIfTxPduCanIdType=STANDARD_FD_CAN, CanIfTxPduDlc=64, CanIfTxPduUserTxConfirmationName=PduR_CanIfTxConfirmation, CanIfTxPduUserTxConfirmationUL=PDUR, CanIfTxPduCanId=1390 if post-build-variant-condition{matching-criterion=RDR_POS, value=1}, CanIfTxPduCanId=1454 if post-build-variant-condition{matching-criterion=RDR_POS, value=2}, CanIfTxPduCanId=1518 if post-build-variant-condition{matching-criterion=RDR_POS, value=3}, CanIfTxPduCanId=1582 if post-build-variant-condition{matching-criterion=RDR_POS, value=4}, CanIfTxPduCanId=1646 if post-build-variant-condition{matching-criterion=RDR_POS, value=5}, CanIfTxPduCanId=1710 if post-build-variant-condition{matching-criterion=RDR_POS, value=6}, CanIfTxPduCanId=1774 if post-build-variant-condition{matching-criterion=RDR_POS, value=7}, CanIfTxPduBufferRef=CanIfInitCfg/CHNL_2ad3227b, CanIfTxPduRef=EcucPduCollection/RDR_TRACKER_OBJ_031_oPCAN_RADAR_86c3db58_Tx
        RDR_TRACKER_OBJ_032_oPCAN_RADAR_48424082_Tx: CanIfTxPduCanId=1327 if post-build-variant-condition{matching-criterion=RDR_POS, value=0}, CanIfTxPduCanIdType=STANDARD_FD_CAN, CanIfTxPduDlc=64, CanIfTxPduUserTxConfirmationName=PduR_CanIfTxConfirmation, CanIfTxPduUserTxConfirmationUL=PDUR, CanIfTxPduCanId=1391 if post-build-variant-condition{matching-criterion=RDR_POS, value=1}, CanIfTxPduCanId=1455 if post-build-variant-condition{matching-criterion=RDR_POS, value=2}, CanIfTxPduCanId=1519 if post-build-variant-condition{matching-criterion=RDR_POS, value=3}, CanIfTxPduCanId=1583 if post-build-variant-condition{matching-criterion=RDR_POS, value=4}, CanIfTxPduCanId=1647 if post-build-variant-condition{matching-criterion=RDR_POS, value=5}, CanIfTxPduCanId=1711 if post-build-variant-condition{matching-criterion=RDR_POS, value=6}, CanIfTxPduCanId=1775 if post-build-variant-condition{matching-criterion=RDR_POS, value=7}, CanIfTxPduBufferRef=CanIfInitCfg/CHNL_2ad3227b, CanIfTxPduRef=EcucPduCollection/RDR_TRACKER_OBJ_032_oPCAN_RADAR_ddd46a4d_Tx
        RDR_TRACKER_OBJ_033_oPCAN_RADAR_42883d2b_Tx: CanIfTxPduCanId=1328 if post-build-variant-condition{matching-criterion=RDR_POS, value=0}, CanIfTxPduCanIdType=STANDARD_FD_CAN, CanIfTxPduDlc=64, CanIfTxPduUserTxConfirmationName=PduR_CanIfTxConfirmation, CanIfTxPduUserTxConfirmationUL=PDUR, CanIfTxPduCanId=1392 if post-build-variant-condition{matching-criterion=RDR_POS, value=1}, CanIfTxPduCanId=1456 if post-build-variant-condition{matching-criterion=RDR_POS, value=2}, CanIfTxPduCanId=1520 if post-build-variant-condition{matching-criterion=RDR_POS, value=3}, CanIfTxPduCanId=1584 if post-build-variant-condition{matching-criterion=RDR_POS, value=4}, CanIfTxPduCanId=1648 if post-build-variant-condition{matching-criterion=RDR_POS, value=5}, CanIfTxPduCanId=1712 if post-build-variant-condition{matching-criterion=RDR_POS, value=6}, CanIfTxPduCanId=1776 if post-build-variant-condition{matching-criterion=RDR_POS, value=7}, CanIfTxPduBufferRef=CanIfInitCfg/CHNL_2ad3227b, CanIfTxPduRef=EcucPduCollection/RDR_TRACKER_OBJ_033_oPCAN_RADAR_eb26fabe_Tx
        RDR_TRACKER_OBJ_034_oPCAN_RADAR_76ff4d74_Tx: CanIfTxPduCanId=1329 if post-build-variant-condition{matching-criterion=RDR_POS, value=0}, CanIfTxPduCanIdType=STANDARD_FD_CAN, CanIfTxPduDlc=64, CanIfTxPduUserTxConfirmationName=PduR_CanIfTxConfirmation, CanIfTxPduUserTxConfirmationUL=PDUR, CanIfTxPduCanId=1393 if post-build-variant-condition{matching-criterion=RDR_POS, value=1}, CanIfTxPduCanId=1457 if post-build-variant-condition{matching-criterion=RDR_POS, value=2}, CanIfTxPduCanId=1521 if post-build-variant-condition{matching-criterion=RDR_POS, value=3}, CanIfTxPduCanId=1585 if post-build-variant-condition{matching-criterion=RDR_POS, value=4}, CanIfTxPduCanId=1649 if post-build-variant-condition{matching-criterion=RDR_POS, value=5}, CanIfTxPduCanId=1713 if post-build-variant-condition{matching-criterion=RDR_POS, value=6}, CanIfTxPduCanId=1777 if post-build-variant-condition{matching-criterion=RDR_POS, value=7}, CanIfTxPduBufferRef=CanIfInitCfg/CHNL_2ad3227b, CanIfTxPduRef=EcucPduCollection/RDR_TRACKER_OBJ_034_oPCAN_RADAR_6bfb0867_Tx
        RDR_TRACKER_OBJ_035_oPCAN_RADAR_7c3530dd_Tx: CanIfTxPduCanId=1330 if post-build-variant-condition{matching-criterion=RDR_POS, value=0}, CanIfTxPduCanIdType=STANDARD_FD_CAN, CanIfTxPduDlc=64, CanIfTxPduUserTxConfirmationName=PduR_CanIfTxConfirmation, CanIfTxPduUserTxConfirmationUL=PDUR, CanIfTxPduCanId=1394 if post-build-variant-condition{matching-criterion=RDR_POS, value=1}, CanIfTxPduCanId=1458 if post-build-variant-condition{matching-criterion=RDR_POS, value=2}, CanIfTxPduCanId=1522 if post-build-variant-condition{matching-criterion=RDR_POS, value=3}, CanIfTxPduCanId=1586 if post-build-variant-condition{matching-criterion=RDR_POS, value=4}, CanIfTxPduCanId=1650 if post-build-variant-condition{matching-criterion=RDR_POS, value=5}, CanIfTxPduCanId=1714 if post-build-variant-condition{matching-criterion=RDR_POS, value=6}, CanIfTxPduCanId=1778 if post-build-variant-condition{matching-criterion=RDR_POS, value=7}, CanIfTxPduBufferRef=CanIfInitCfg/CHNL_2ad3227b, CanIfTxPduRef=EcucPduCollection/RDR_TRACKER_OBJ_035_oPCAN_RADAR_5d099894_Tx
        RDR_TRACKER_OBJ_036_oPCAN_RADAR_636bb626_Tx: CanIfTxPduCanId=1331 if post-build-variant-condition{matching-criterion=RDR_POS, value=0}, CanIfTxPduCanIdType=STANDARD_FD_CAN, CanIfTxPduDlc=64, CanIfTxPduUserTxConfirmationName=PduR_CanIfTxConfirmation, CanIfTxPduUserTxConfirmationUL=PDUR, CanIfTxPduCanId=1395 if post-build-variant-condition{matching-criterion=RDR_POS, value=1}, CanIfTxPduCanId=1459 if post-build-variant-condition{matching-criterion=RDR_POS, value=2}, CanIfTxPduCanId=1523 if post-build-variant-condition{matching-criterion=RDR_POS, value=3}, CanIfTxPduCanId=1587 if post-build-variant-condition{matching-criterion=RDR_POS, value=4}, CanIfTxPduCanId=1651 if post-build-variant-condition{matching-criterion=RDR_POS, value=5}, CanIfTxPduCanId=1715 if post-build-variant-condition{matching-criterion=RDR_POS, value=6}, CanIfTxPduCanId=1779 if post-build-variant-condition{matching-criterion=RDR_POS, value=7}, CanIfTxPduBufferRef=CanIfInitCfg/CHNL_2ad3227b, CanIfTxPduRef=EcucPduCollection/RDR_TRACKER_OBJ_036_oPCAN_RADAR_061e2981_Tx
        RDR_TRACKER_OBJ_037_oPCAN_RADAR_69a1cb8f_Tx: CanIfTxPduCanId=1332 if post-build-variant-condition{matching-criterion=RDR_POS, value=0}, CanIfTxPduCanIdType=STANDARD_FD_CAN, CanIfTxPduDlc=64, CanIfTxPduUserTxConfirmationName=PduR_CanIfTxConfirmation, CanIfTxPduUserTxConfirmationUL=PDUR, CanIfTxPduCanId=1396 if post-build-variant-condition{matching-criterion=RDR_POS, value=1}, CanIfTxPduCanId=1460 if post-build-variant-condition{matching-criterion=RDR_POS, value=2}, CanIfTxPduCanId=1524 if post-build-variant-condition{matching-criterion=RDR_POS, value=3}, CanIfTxPduCanId=1588 if post-build-variant-condition{matching-criterion=RDR_POS, value=4}, CanIfTxPduCanId=1652 if post-build-variant-condition{matching-criterion=RDR_POS, value=5}, CanIfTxPduCanId=1716 if post-build-variant-condition{matching-criterion=RDR_POS, value=6}, CanIfTxPduCanId=1780 if post-build-variant-condition{matching-criterion=RDR_POS, value=7}, CanIfTxPduBufferRef=CanIfInitCfg/CHNL_2ad3227b, CanIfTxPduRef=EcucPduCollection/RDR_TRACKER_OBJ_037_oPCAN_RADAR_30ecb972_Tx
        RDR_TRACKER_OBJ_038_oPCAN_RADAR_0b855698_Tx: CanIfTxPduCanId=1333 if post-build-variant-condition{matching-criterion=RDR_POS, value=0}, CanIfTxPduCanIdType=STANDARD_FD_CAN, CanIfTxPduDlc=64, CanIfTxPduUserTxConfirmationName=PduR_CanIfTxConfirmation, CanIfTxPduUserTxConfirmationUL=PDUR, CanIfTxPduCanId=1397 if post-build-variant-condition{matching-criterion=RDR_POS, value=1}, CanIfTxPduCanId=1461 if post-build-variant-condition{matching-criterion=RDR_POS, value=2}, CanIfTxPduCanId=1525 if post-build-variant-condition{matching-criterion=RDR_POS, value=3}, CanIfTxPduCanId=1589 if post-build-variant-condition{matching-criterion=RDR_POS, value=4}, CanIfTxPduCanId=1653 if post-build-variant-condition{matching-criterion=RDR_POS, value=5}, CanIfTxPduCanId=1717 if post-build-variant-condition{matching-criterion=RDR_POS, value=6}, CanIfTxPduCanId=1781 if post-build-variant-condition{matching-criterion=RDR_POS, value=7}, CanIfTxPduBufferRef=CanIfInitCfg/CHNL_2ad3227b, CanIfTxPduRef=EcucPduCollection/RDR_TRACKER_OBJ_038_oPCAN_RADAR_dcd4ca72_Tx
        RDR_TRACKER_OBJ_039_oPCAN_RADAR_014f2b31_Tx: CanIfTxPduCanId=1334 if post-build-variant-condition{matching-criterion=RDR_POS, value=0}, CanIfTxPduCanIdType=STANDARD_FD_CAN, CanIfTxPduDlc=64, CanIfTxPduUserTxConfirmationName=PduR_CanIfTxConfirmation, CanIfTxPduUserTxConfirmationUL=PDUR, CanIfTxPduCanId=1398 if post-build-variant-condition{matching-criterion=RDR_POS, value=1}, CanIfTxPduCanId=1462 if post-build-variant-condition{matching-criterion=RDR_POS, value=2}, CanIfTxPduCanId=1526 if post-build-variant-condition{matching-criterion=RDR_POS, value=3}, CanIfTxPduCanId=1590 if post-build-variant-condition{matching-criterion=RDR_POS, value=4}, CanIfTxPduCanId=1654 if post-build-variant-condition{matching-criterion=RDR_POS, value=5}, CanIfTxPduCanId=1718 if post-build-variant-condition{matching-criterion=RDR_POS, value=6}, CanIfTxPduCanId=1782 if post-build-variant-condition{matching-criterion=RDR_POS, value=7}, CanIfTxPduBufferRef=CanIfInitCfg/CHNL_2ad3227b, CanIfTxPduRef=EcucPduCollection/RDR_TRACKER_OBJ_039_oPCAN_RADAR_ea265a81_Tx
        RDR_TRACKER_OBJ_040_oPCAN_RADAR_a63680c5_Tx: CanIfTxPduCanId=1335 if post-build-variant-condition{matching-criterion=RDR_POS, value=0}, CanIfTxPduCanIdType=STANDARD_FD_CAN, CanIfTxPduDlc=64, CanIfTxPduUserTxConfirmationName=PduR_CanIfTxConfirmation, CanIfTxPduUserTxConfirmationUL=PDUR, CanIfTxPduCanId=1399 if post-build-variant-condition{matching-criterion=RDR_POS, value=1}, CanIfTxPduCanId=1463 if post-build-variant-condition{matching-criterion=RDR_POS, value=2}, CanIfTxPduCanId=1527 if post-build-variant-condition{matching-criterion=RDR_POS, value=3}, CanIfTxPduCanId=1591 if post-build-variant-condition{matching-criterion=RDR_POS, value=4}, CanIfTxPduCanId=1655 if post-build-variant-condition{matching-criterion=RDR_POS, value=5}, CanIfTxPduCanId=1719 if post-build-variant-condition{matching-criterion=RDR_POS, value=6}, CanIfTxPduCanId=1783 if post-build-variant-condition{matching-criterion=RDR_POS, value=7}, CanIfTxPduBufferRef=CanIfInitCfg/CHNL_2ad3227b, CanIfTxPduRef=EcucPduCollection/RDR_TRACKER_OBJ_040_oPCAN_RADAR_4fbefc29_Tx
        RDR_TRACKER_OBJ_041_oPCAN_RADAR_acfcfd6c_Tx: CanIfTxPduCanId=1336 if post-build-variant-condition{matching-criterion=RDR_POS, value=0}, CanIfTxPduCanIdType=STANDARD_FD_CAN, CanIfTxPduDlc=64, CanIfTxPduUserTxConfirmationName=PduR_CanIfTxConfirmation, CanIfTxPduUserTxConfirmationUL=PDUR, CanIfTxPduCanId=1400 if post-build-variant-condition{matching-criterion=RDR_POS, value=1}, CanIfTxPduCanId=1464 if post-build-variant-condition{matching-criterion=RDR_POS, value=2}, CanIfTxPduCanId=1528 if post-build-variant-condition{matching-criterion=RDR_POS, value=3}, CanIfTxPduCanId=1592 if post-build-variant-condition{matching-criterion=RDR_POS, value=4}, CanIfTxPduCanId=1656 if post-build-variant-condition{matching-criterion=RDR_POS, value=5}, CanIfTxPduCanId=1720 if post-build-variant-condition{matching-criterion=RDR_POS, value=6}, CanIfTxPduCanId=1784 if post-build-variant-condition{matching-criterion=RDR_POS, value=7}, CanIfTxPduBufferRef=CanIfInitCfg/CHNL_2ad3227b, CanIfTxPduRef=EcucPduCollection/RDR_TRACKER_OBJ_041_oPCAN_RADAR_794c6cda_Tx
        RDR_TRACKER_OBJ_042_oPCAN_RADAR_b3a27b97_Tx: CanIfTxPduCanId=1337 if post-build-variant-condition{matching-criterion=RDR_POS, value=0}, CanIfTxPduCanIdType=STANDARD_FD_CAN, CanIfTxPduDlc=64, CanIfTxPduUserTxConfirmationName=PduR_CanIfTxConfirmation, CanIfTxPduUserTxConfirmationUL=PDUR, CanIfTxPduCanId=1401 if post-build-variant-condition{matching-criterion=RDR_POS, value=1}, CanIfTxPduCanId=1465 if post-build-variant-condition{matching-criterion=RDR_POS, value=2}, CanIfTxPduCanId=1529 if post-build-variant-condition{matching-criterion=RDR_POS, value=3}, CanIfTxPduCanId=1593 if post-build-variant-condition{matching-criterion=RDR_POS, value=4}, CanIfTxPduCanId=1657 if post-build-variant-condition{matching-criterion=RDR_POS, value=5}, CanIfTxPduCanId=1721 if post-build-variant-condition{matching-criterion=RDR_POS, value=6}, CanIfTxPduCanId=1785 if post-build-variant-condition{matching-criterion=RDR_POS, value=7}, CanIfTxPduBufferRef=CanIfInitCfg/CHNL_2ad3227b, CanIfTxPduRef=EcucPduCollection/RDR_TRACKER_OBJ_042_oPCAN_RADAR_225bddcf_Tx
        RDR_TRACKER_OBJ_043_oPCAN_RADAR_b968063e_Tx: CanIfTxPduCanId=1338 if post-build-variant-condition{matching-criterion=RDR_POS, value=0}, CanIfTxPduCanIdType=STANDARD_FD_CAN, CanIfTxPduDlc=64, CanIfTxPduUserTxConfirmationName=PduR_CanIfTxConfirmation, CanIfTxPduUserTxConfirmationUL=PDUR, CanIfTxPduCanId=1402 if post-build-variant-condition{matching-criterion=RDR_POS, value=1}, CanIfTxPduCanId=1466 if post-build-variant-condition{matching-criterion=RDR_POS, value=2}, CanIfTxPduCanId=1530 if post-build-variant-condition{matching-criterion=RDR_POS, value=3}, CanIfTxPduCanId=1594 if post-build-variant-condition{matching-criterion=RDR_POS, value=4}, CanIfTxPduCanId=1658 if post-build-variant-condition{matching-criterion=RDR_POS, value=5}, CanIfTxPduCanId=1722 if post-build-variant-condition{matching-criterion=RDR_POS, value=6}, CanIfTxPduCanId=1786 if post-build-variant-condition{matching-criterion=RDR_POS, value=7}, CanIfTxPduBufferRef=CanIfInitCfg/CHNL_2ad3227b, CanIfTxPduRef=EcucPduCollection/RDR_TRACKER_OBJ_043_oPCAN_RADAR_14a94d3c_Tx
        RDR_TRACKER_OBJ_044_oPCAN_RADAR_8d1f7661_Tx: CanIfTxPduCanId=1339 if post-build-variant-condition{matching-criterion=RDR_POS, value=0}, CanIfTxPduCanIdType=STANDARD_FD_CAN, CanIfTxPduDlc=64, CanIfTxPduUserTxConfirmationName=PduR_CanIfTxConfirmation, CanIfTxPduUserTxConfirmationUL=PDUR, CanIfTxPduCanId=1403 if post-build-variant-condition{matching-criterion=RDR_POS, value=1}, CanIfTxPduCanId=1467 if post-build-variant-condition{matching-criterion=RDR_POS, value=2}, CanIfTxPduCanId=1531 if post-build-variant-condition{matching-criterion=RDR_POS, value=3}, CanIfTxPduCanId=1595 if post-build-variant-condition{matching-criterion=RDR_POS, value=4}, CanIfTxPduCanId=1659 if post-build-variant-condition{matching-criterion=RDR_POS, value=5}, CanIfTxPduCanId=1723 if post-build-variant-condition{matching-criterion=RDR_POS, value=6}, CanIfTxPduCanId=1787 if post-build-variant-condition{matching-criterion=RDR_POS, value=7}, CanIfTxPduBufferRef=CanIfInitCfg/CHNL_2ad3227b, CanIfTxPduRef=EcucPduCollection/RDR_TRACKER_OBJ_044_oPCAN_RADAR_9474bfe5_Tx
        RDR_TRACKER_OBJ_045_oPCAN_RADAR_87d50bc8_Tx: CanIfTxPduCanId=1340 if post-build-variant-condition{matching-criterion=RDR_POS, value=0}, CanIfTxPduCanIdType=STANDARD_FD_CAN, CanIfTxPduDlc=64, CanIfTxPduUserTxConfirmationName=PduR_CanIfTxConfirmation, CanIfTxPduUserTxConfirmationUL=PDUR, CanIfTxPduCanId=1404 if post-build-variant-condition{matching-criterion=RDR_POS, value=1}, CanIfTxPduCanId=1468 if post-build-variant-condition{matching-criterion=RDR_POS, value=2}, CanIfTxPduCanId=1532 if post-build-variant-condition{matching-criterion=RDR_POS, value=3}, CanIfTxPduCanId=1596 if post-build-variant-condition{matching-criterion=RDR_POS, value=4}, CanIfTxPduCanId=1660 if post-build-variant-condition{matching-criterion=RDR_POS, value=5}, CanIfTxPduCanId=1724 if post-build-variant-condition{matching-criterion=RDR_POS, value=6}, CanIfTxPduCanId=1788 if post-build-variant-condition{matching-criterion=RDR_POS, value=7}, CanIfTxPduBufferRef=CanIfInitCfg/CHNL_2ad3227b, CanIfTxPduRef=EcucPduCollection/RDR_TRACKER_OBJ_045_oPCAN_RADAR_a2862f16_Tx
        RDR_TRACKER_OBJ_046_oPCAN_RADAR_988b8d33_Tx: CanIfTxPduCanId=1341 if post-build-variant-condition{matching-criterion=RDR_POS, value=0}, CanIfTxPduCanIdType=STANDARD_FD_CAN, CanIfTxPduDlc=64, CanIfTxPduUserTxConfirmationName=PduR_CanIfTxConfirmation, CanIfTxPduUserTxConfirmationUL=PDUR, CanIfTxPduCanId=1405 if post-build-variant-condition{matching-criterion=RDR_POS, value=1}, CanIfTxPduCanId=1469 if post-build-variant-condition{matching-criterion=RDR_POS, value=2}, CanIfTxPduCanId=1533 if post-build-variant-condition{matching-criterion=RDR_POS, value=3}, CanIfTxPduCanId=1597 if post-build-variant-condition{matching-criterion=RDR_POS, value=4}, CanIfTxPduCanId=1661 if post-build-variant-condition{matching-criterion=RDR_POS, value=5}, CanIfTxPduCanId=1725 if post-build-variant-condition{matching-criterion=RDR_POS, value=6}, CanIfTxPduCanId=1789 if post-build-variant-condition{matching-criterion=RDR_POS, value=7}, CanIfTxPduBufferRef=CanIfInitCfg/CHNL_2ad3227b, CanIfTxPduRef=EcucPduCollection/RDR_TRACKER_OBJ_046_oPCAN_RADAR_f9919e03_Tx
        RDR_TRACKER_OBJ_047_oPCAN_RADAR_9241f09a_Tx: CanIfTxPduCanId=1342 if post-build-variant-condition{matching-criterion=RDR_POS, value=0}, CanIfTxPduCanIdType=STANDARD_FD_CAN, CanIfTxPduDlc=64, CanIfTxPduUserTxConfirmationName=PduR_CanIfTxConfirmation, CanIfTxPduUserTxConfirmationUL=PDUR, CanIfTxPduCanId=1406 if post-build-variant-condition{matching-criterion=RDR_POS, value=1}, CanIfTxPduCanId=1470 if post-build-variant-condition{matching-criterion=RDR_POS, value=2}, CanIfTxPduCanId=1534 if post-build-variant-condition{matching-criterion=RDR_POS, value=3}, CanIfTxPduCanId=1598 if post-build-variant-condition{matching-criterion=RDR_POS, value=4}, CanIfTxPduCanId=1662 if post-build-variant-condition{matching-criterion=RDR_POS, value=5}, CanIfTxPduCanId=1726 if post-build-variant-condition{matching-criterion=RDR_POS, value=6}, CanIfTxPduCanId=1790 if post-build-variant-condition{matching-criterion=RDR_POS, value=7}, CanIfTxPduBufferRef=CanIfInitCfg/CHNL_2ad3227b, CanIfTxPduRef=EcucPduCollection/RDR_TRACKER_OBJ_047_oPCAN_RADAR_cf630ef0_Tx
        RDR_TRACKER_OBJ_048_oPCAN_RADAR_f0656d8d_Tx: CanIfTxPduCanId=1343 if post-build-variant-condition{matching-criterion=RDR_POS, value=0}, CanIfTxPduCanIdType=STANDARD_FD_CAN, CanIfTxPduDlc=64, CanIfTxPduUserTxConfirmationName=PduR_CanIfTxConfirmation, CanIfTxPduUserTxConfirmationUL=PDUR, CanIfTxPduCanId=1407 if post-build-variant-condition{matching-criterion=RDR_POS, value=1}, CanIfTxPduCanId=1471 if post-build-variant-condition{matching-criterion=RDR_POS, value=2}, CanIfTxPduCanId=1535 if post-build-variant-condition{matching-criterion=RDR_POS, value=3}, CanIfTxPduCanId=1599 if post-build-variant-condition{matching-criterion=RDR_POS, value=4}, CanIfTxPduCanId=1663 if post-build-variant-condition{matching-criterion=RDR_POS, value=5}, CanIfTxPduCanId=1727 if post-build-variant-condition{matching-criterion=RDR_POS, value=6}, CanIfTxPduCanId=1791 if post-build-variant-condition{matching-criterion=RDR_POS, value=7}, CanIfTxPduBufferRef=CanIfInitCfg/CHNL_2ad3227b, CanIfTxPduRef=EcucPduCollection/RDR_TRACKER_OBJ_048_oPCAN_RADAR_235b7df0_Tx
        RDR_TRACKER_OBJ_049_oPCAN_RADAR_faaf1024_Tx: CanIfTxPduCanId=1344 if post-build-variant-condition{matching-criterion=RDR_POS, value=0}, CanIfTxPduCanIdType=STANDARD_FD_CAN, CanIfTxPduDlc=64, CanIfTxPduUserTxConfirmationName=PduR_CanIfTxConfirmation, CanIfTxPduUserTxConfirmationUL=PDUR, CanIfTxPduCanId=1408 if post-build-variant-condition{matching-criterion=RDR_POS, value=1}, CanIfTxPduCanId=1472 if post-build-variant-condition{matching-criterion=RDR_POS, value=2}, CanIfTxPduCanId=1536 if post-build-variant-condition{matching-criterion=RDR_POS, value=3}, CanIfTxPduCanId=1600 if post-build-variant-condition{matching-criterion=RDR_POS, value=4}, CanIfTxPduCanId=1664 if post-build-variant-condition{matching-criterion=RDR_POS, value=5}, CanIfTxPduCanId=1728 if post-build-variant-condition{matching-criterion=RDR_POS, value=6}, CanIfTxPduCanId=1792 if post-build-variant-condition{matching-criterion=RDR_POS, value=7}, CanIfTxPduBufferRef=CanIfInitCfg/CHNL_2ad3227b, CanIfTxPduRef=EcucPduCollection/RDR_TRACKER_OBJ_049_oPCAN_RADAR_15a9ed03_Tx
        RDR_TRACKER_OBJ_050_oPCAN_RADAR_093651f4_Tx: CanIfTxPduCanId=1345 if post-build-variant-condition{matching-criterion=RDR_POS, value=0}, CanIfTxPduCanIdType=STANDARD_FD_CAN, CanIfTxPduDlc=64, CanIfTxPduUserTxConfirmationName=PduR_CanIfTxConfirmation, CanIfTxPduUserTxConfirmationUL=PDUR, CanIfTxPduCanId=1409 if post-build-variant-condition{matching-criterion=RDR_POS, value=1}, CanIfTxPduCanId=1473 if post-build-variant-condition{matching-criterion=RDR_POS, value=2}, CanIfTxPduCanId=1537 if post-build-variant-condition{matching-criterion=RDR_POS, value=3}, CanIfTxPduCanId=1601 if post-build-variant-condition{matching-criterion=RDR_POS, value=4}, CanIfTxPduCanId=1665 if post-build-variant-condition{matching-criterion=RDR_POS, value=5}, CanIfTxPduCanId=1729 if post-build-variant-condition{matching-criterion=RDR_POS, value=6}, CanIfTxPduCanId=1793 if post-build-variant-condition{matching-criterion=RDR_POS, value=7}, CanIfTxPduBufferRef=CanIfInitCfg/CHNL_2ad3227b, CanIfTxPduRef=EcucPduCollection/RDR_TRACKER_OBJ_050_oPCAN_RADAR_6b3cad1f_Tx
        RDR_TRACKER_OBJ_051_oPCAN_RADAR_03fc2c5d_Tx: CanIfTxPduCanId=1346 if post-build-variant-condition{matching-criterion=RDR_POS, value=0}, CanIfTxPduCanIdType=STANDARD_FD_CAN, CanIfTxPduDlc=64, CanIfTxPduUserTxConfirmationName=PduR_CanIfTxConfirmation, CanIfTxPduUserTxConfirmationUL=PDUR, CanIfTxPduCanId=1410 if post-build-variant-condition{matching-criterion=RDR_POS, value=1}, CanIfTxPduCanId=1474 if post-build-variant-condition{matching-criterion=RDR_POS, value=2}, CanIfTxPduCanId=1538 if post-build-variant-condition{matching-criterion=RDR_POS, value=3}, CanIfTxPduCanId=1602 if post-build-variant-condition{matching-criterion=RDR_POS, value=4}, CanIfTxPduCanId=1666 if post-build-variant-condition{matching-criterion=RDR_POS, value=5}, CanIfTxPduCanId=1730 if post-build-variant-condition{matching-criterion=RDR_POS, value=6}, CanIfTxPduCanId=1794 if post-build-variant-condition{matching-criterion=RDR_POS, value=7}, CanIfTxPduBufferRef=CanIfInitCfg/CHNL_2ad3227b, CanIfTxPduRef=EcucPduCollection/RDR_TRACKER_OBJ_051_oPCAN_RADAR_5dce3dec_Tx
        RDR_TRACKER_OBJ_052_oPCAN_RADAR_1ca2aaa6_Tx: CanIfTxPduCanId=1347 if post-build-variant-condition{matching-criterion=RDR_POS, value=0}, CanIfTxPduCanIdType=STANDARD_FD_CAN, CanIfTxPduDlc=64, CanIfTxPduUserTxConfirmationName=PduR_CanIfTxConfirmation, CanIfTxPduUserTxConfirmationUL=PDUR, CanIfTxPduCanId=1411 if post-build-variant-condition{matching-criterion=RDR_POS, value=1}, CanIfTxPduCanId=1475 if post-build-variant-condition{matching-criterion=RDR_POS, value=2}, CanIfTxPduCanId=1539 if post-build-variant-condition{matching-criterion=RDR_POS, value=3}, CanIfTxPduCanId=1603 if post-build-variant-condition{matching-criterion=RDR_POS, value=4}, CanIfTxPduCanId=1667 if post-build-variant-condition{matching-criterion=RDR_POS, value=5}, CanIfTxPduCanId=1731 if post-build-variant-condition{matching-criterion=RDR_POS, value=6}, CanIfTxPduCanId=1795 if post-build-variant-condition{matching-criterion=RDR_POS, value=7}, CanIfTxPduBufferRef=CanIfInitCfg/CHNL_2ad3227b, CanIfTxPduRef=EcucPduCollection/RDR_TRACKER_OBJ_052_oPCAN_RADAR_06d98cf9_Tx
        RDR_TRACKER_OBJ_053_oPCAN_RADAR_1668d70f_Tx: CanIfTxPduCanId=1348 if post-build-variant-condition{matching-criterion=RDR_POS, value=0}, CanIfTxPduCanIdType=STANDARD_FD_CAN, CanIfTxPduDlc=64, CanIfTxPduUserTxConfirmationName=PduR_CanIfTxConfirmation, CanIfTxPduUserTxConfirmationUL=PDUR, CanIfTxPduCanId=1412 if post-build-variant-condition{matching-criterion=RDR_POS, value=1}, CanIfTxPduCanId=1476 if post-build-variant-condition{matching-criterion=RDR_POS, value=2}, CanIfTxPduCanId=1540 if post-build-variant-condition{matching-criterion=RDR_POS, value=3}, CanIfTxPduCanId=1604 if post-build-variant-condition{matching-criterion=RDR_POS, value=4}, CanIfTxPduCanId=1668 if post-build-variant-condition{matching-criterion=RDR_POS, value=5}, CanIfTxPduCanId=1732 if post-build-variant-condition{matching-criterion=RDR_POS, value=6}, CanIfTxPduCanId=1796 if post-build-variant-condition{matching-criterion=RDR_POS, value=7}, CanIfTxPduBufferRef=CanIfInitCfg/CHNL_2ad3227b, CanIfTxPduRef=EcucPduCollection/RDR_TRACKER_OBJ_053_oPCAN_RADAR_302b1c0a_Tx
        RDR_TRACKER_OBJ_054_oPCAN_RADAR_221fa750_Tx: CanIfTxPduCanId=1349 if post-build-variant-condition{matching-criterion=RDR_POS, value=0}, CanIfTxPduCanIdType=STANDARD_FD_CAN, CanIfTxPduDlc=64, CanIfTxPduUserTxConfirmationName=PduR_CanIfTxConfirmation, CanIfTxPduUserTxConfirmationUL=PDUR, CanIfTxPduCanId=1413 if post-build-variant-condition{matching-criterion=RDR_POS, value=1}, CanIfTxPduCanId=1477 if post-build-variant-condition{matching-criterion=RDR_POS, value=2}, CanIfTxPduCanId=1541 if post-build-variant-condition{matching-criterion=RDR_POS, value=3}, CanIfTxPduCanId=1605 if post-build-variant-condition{matching-criterion=RDR_POS, value=4}, CanIfTxPduCanId=1669 if post-build-variant-condition{matching-criterion=RDR_POS, value=5}, CanIfTxPduCanId=1733 if post-build-variant-condition{matching-criterion=RDR_POS, value=6}, CanIfTxPduCanId=1797 if post-build-variant-condition{matching-criterion=RDR_POS, value=7}, CanIfTxPduBufferRef=CanIfInitCfg/CHNL_2ad3227b, CanIfTxPduRef=EcucPduCollection/RDR_TRACKER_OBJ_054_oPCAN_RADAR_b0f6eed3_Tx
        RDR_TRACKER_OBJ_055_oPCAN_RADAR_28d5daf9_Tx: CanIfTxPduCanId=1350 if post-build-variant-condition{matching-criterion=RDR_POS, value=0}, CanIfTxPduCanIdType=STANDARD_FD_CAN, CanIfTxPduDlc=64, CanIfTxPduUserTxConfirmationName=PduR_CanIfTxConfirmation, CanIfTxPduUserTxConfirmationUL=PDUR, CanIfTxPduCanId=1414 if post-build-variant-condition{matching-criterion=RDR_POS, value=1}, CanIfTxPduCanId=1478 if post-build-variant-condition{matching-criterion=RDR_POS, value=2}, CanIfTxPduCanId=1542 if post-build-variant-condition{matching-criterion=RDR_POS, value=3}, CanIfTxPduCanId=1606 if post-build-variant-condition{matching-criterion=RDR_POS, value=4}, CanIfTxPduCanId=1670 if post-build-variant-condition{matching-criterion=RDR_POS, value=5}, CanIfTxPduCanId=1734 if post-build-variant-condition{matching-criterion=RDR_POS, value=6}, CanIfTxPduCanId=1798 if post-build-variant-condition{matching-criterion=RDR_POS, value=7}, CanIfTxPduBufferRef=CanIfInitCfg/CHNL_2ad3227b, CanIfTxPduRef=EcucPduCollection/RDR_TRACKER_OBJ_055_oPCAN_RADAR_86047e20_Tx
        RDR_TRACKER_OBJ_056_oPCAN_RADAR_378b5c02_Tx: CanIfTxPduCanId=1351 if post-build-variant-condition{matching-criterion=RDR_POS, value=0}, CanIfTxPduCanIdType=STANDARD_FD_CAN, CanIfTxPduDlc=64, CanIfTxPduUserTxConfirmationName=PduR_CanIfTxConfirmation, CanIfTxPduUserTxConfirmationUL=PDUR, CanIfTxPduCanId=1415 if post-build-variant-condition{matching-criterion=RDR_POS, value=1}, CanIfTxPduCanId=1479 if post-build-variant-condition{matching-criterion=RDR_POS, value=2}, CanIfTxPduCanId=1543 if post-build-variant-condition{matching-criterion=RDR_POS, value=3}, CanIfTxPduCanId=1607 if post-build-variant-condition{matching-criterion=RDR_POS, value=4}, CanIfTxPduCanId=1671 if post-build-variant-condition{matching-criterion=RDR_POS, value=5}, CanIfTxPduCanId=1735 if post-build-variant-condition{matching-criterion=RDR_POS, value=6}, CanIfTxPduCanId=1799 if post-build-variant-condition{matching-criterion=RDR_POS, value=7}, CanIfTxPduBufferRef=CanIfInitCfg/CHNL_2ad3227b, CanIfTxPduRef=EcucPduCollection/RDR_TRACKER_OBJ_056_oPCAN_RADAR_dd13cf35_Tx
        RDR_TRACKER_OBJ_057_oPCAN_RADAR_3d4121ab_Tx: CanIfTxPduCanId=1352 if post-build-variant-condition{matching-criterion=RDR_POS, value=0}, CanIfTxPduCanIdType=STANDARD_FD_CAN, CanIfTxPduDlc=64, CanIfTxPduUserTxConfirmationName=PduR_CanIfTxConfirmation, CanIfTxPduUserTxConfirmationUL=PDUR, CanIfTxPduCanId=1416 if post-build-variant-condition{matching-criterion=RDR_POS, value=1}, CanIfTxPduCanId=1480 if post-build-variant-condition{matching-criterion=RDR_POS, value=2}, CanIfTxPduCanId=1544 if post-build-variant-condition{matching-criterion=RDR_POS, value=3}, CanIfTxPduCanId=1608 if post-build-variant-condition{matching-criterion=RDR_POS, value=4}, CanIfTxPduCanId=1672 if post-build-variant-condition{matching-criterion=RDR_POS, value=5}, CanIfTxPduCanId=1736 if post-build-variant-condition{matching-criterion=RDR_POS, value=6}, CanIfTxPduCanId=1800 if post-build-variant-condition{matching-criterion=RDR_POS, value=7}, CanIfTxPduBufferRef=CanIfInitCfg/CHNL_2ad3227b, CanIfTxPduRef=EcucPduCollection/RDR_TRACKER_OBJ_057_oPCAN_RADAR_ebe15fc6_Tx
        RDR_TRACKER_OBJ_058_oPCAN_RADAR_5f65bcbc_Tx: CanIfTxPduCanId=1353 if post-build-variant-condition{matching-criterion=RDR_POS, value=0}, CanIfTxPduCanIdType=STANDARD_FD_CAN, CanIfTxPduDlc=64, CanIfTxPduUserTxConfirmationName=PduR_CanIfTxConfirmation, CanIfTxPduUserTxConfirmationUL=PDUR, CanIfTxPduCanId=1417 if post-build-variant-condition{matching-criterion=RDR_POS, value=1}, CanIfTxPduCanId=1481 if post-build-variant-condition{matching-criterion=RDR_POS, value=2}, CanIfTxPduCanId=1545 if post-build-variant-condition{matching-criterion=RDR_POS, value=3}, CanIfTxPduCanId=1609 if post-build-variant-condition{matching-criterion=RDR_POS, value=4}, CanIfTxPduCanId=1673 if post-build-variant-condition{matching-criterion=RDR_POS, value=5}, CanIfTxPduCanId=1737 if post-build-variant-condition{matching-criterion=RDR_POS, value=6}, CanIfTxPduCanId=1801 if post-build-variant-condition{matching-criterion=RDR_POS, value=7}, CanIfTxPduBufferRef=CanIfInitCfg/CHNL_2ad3227b, CanIfTxPduRef=EcucPduCollection/RDR_TRACKER_OBJ_058_oPCAN_RADAR_07d92cc6_Tx
        RDR_TRACKER_OBJ_059_oPCAN_RADAR_55afc115_Tx: CanIfTxPduCanId=1354 if post-build-variant-condition{matching-criterion=RDR_POS, value=0}, CanIfTxPduCanIdType=STANDARD_FD_CAN, CanIfTxPduDlc=64, CanIfTxPduUserTxConfirmationName=PduR_CanIfTxConfirmation, CanIfTxPduUserTxConfirmationUL=PDUR, CanIfTxPduCanId=1418 if post-build-variant-condition{matching-criterion=RDR_POS, value=1}, CanIfTxPduCanId=1482 if post-build-variant-condition{matching-criterion=RDR_POS, value=2}, CanIfTxPduCanId=1546 if post-build-variant-condition{matching-criterion=RDR_POS, value=3}, CanIfTxPduCanId=1610 if post-build-variant-condition{matching-criterion=RDR_POS, value=4}, CanIfTxPduCanId=1674 if post-build-variant-condition{matching-criterion=RDR_POS, value=5}, CanIfTxPduCanId=1738 if post-build-variant-condition{matching-criterion=RDR_POS, value=6}, CanIfTxPduCanId=1802 if post-build-variant-condition{matching-criterion=RDR_POS, value=7}, CanIfTxPduBufferRef=CanIfInitCfg/CHNL_2ad3227b, CanIfTxPduRef=EcucPduCollection/RDR_TRACKER_OBJ_059_oPCAN_RADAR_312bbc35_Tx
        RDR_TRACKER_OBJ_060_oPCAN_RADAR_234624e6_Tx: CanIfTxPduCanId=1355 if post-build-variant-condition{matching-criterion=RDR_POS, value=0}, CanIfTxPduCanIdType=STANDARD_FD_CAN, CanIfTxPduDlc=64, CanIfTxPduUserTxConfirmationName=PduR_CanIfTxConfirmation, CanIfTxPduUserTxConfirmationUL=PDUR, CanIfTxPduCanId=1419 if post-build-variant-condition{matching-criterion=RDR_POS, value=1}, CanIfTxPduCanId=1483 if post-build-variant-condition{matching-criterion=RDR_POS, value=2}, CanIfTxPduCanId=1547 if post-build-variant-condition{matching-criterion=RDR_POS, value=3}, CanIfTxPduCanId=1611 if post-build-variant-condition{matching-criterion=RDR_POS, value=4}, CanIfTxPduCanId=1675 if post-build-variant-condition{matching-criterion=RDR_POS, value=5}, CanIfTxPduCanId=1739 if post-build-variant-condition{matching-criterion=RDR_POS, value=6}, CanIfTxPduCanId=1803 if post-build-variant-condition{matching-criterion=RDR_POS, value=7}, CanIfTxPduBufferRef=CanIfInitCfg/CHNL_2ad3227b, CanIfTxPduRef=EcucPduCollection/RDR_TRACKER_OBJ_060_oPCAN_RADAR_06ba5e45_Tx
        RDR_TRACKER_OBJ_061_oPCAN_RADAR_298c594f_Tx: CanIfTxPduCanId=1356 if post-build-variant-condition{matching-criterion=RDR_POS, value=0}, CanIfTxPduCanIdType=STANDARD_FD_CAN, CanIfTxPduDlc=64, CanIfTxPduUserTxConfirmationName=PduR_CanIfTxConfirmation, CanIfTxPduUserTxConfirmationUL=PDUR, CanIfTxPduCanId=1420 if post-build-variant-condition{matching-criterion=RDR_POS, value=1}, CanIfTxPduCanId=1484 if post-build-variant-condition{matching-criterion=RDR_POS, value=2}, CanIfTxPduCanId=1548 if post-build-variant-condition{matching-criterion=RDR_POS, value=3}, CanIfTxPduCanId=1612 if post-build-variant-condition{matching-criterion=RDR_POS, value=4}, CanIfTxPduCanId=1676 if post-build-variant-condition{matching-criterion=RDR_POS, value=5}, CanIfTxPduCanId=1740 if post-build-variant-condition{matching-criterion=RDR_POS, value=6}, CanIfTxPduCanId=1804 if post-build-variant-condition{matching-criterion=RDR_POS, value=7}, CanIfTxPduBufferRef=CanIfInitCfg/CHNL_2ad3227b, CanIfTxPduRef=EcucPduCollection/RDR_TRACKER_OBJ_061_oPCAN_RADAR_3048ceb6_Tx
        RDR_TRACKER_OBJ_062_oPCAN_RADAR_36d2dfb4_Tx: CanIfTxPduCanId=1357 if post-build-variant-condition{matching-criterion=RDR_POS, value=0}, CanIfTxPduCanIdType=STANDARD_FD_CAN, CanIfTxPduDlc=64, CanIfTxPduUserTxConfirmationName=PduR_CanIfTxConfirmation, CanIfTxPduUserTxConfirmationUL=PDUR, CanIfTxPduCanId=1421 if post-build-variant-condition{matching-criterion=RDR_POS, value=1}, CanIfTxPduCanId=1485 if post-build-variant-condition{matching-criterion=RDR_POS, value=2}, CanIfTxPduCanId=1549 if post-build-variant-condition{matching-criterion=RDR_POS, value=3}, CanIfTxPduCanId=1613 if post-build-variant-condition{matching-criterion=RDR_POS, value=4}, CanIfTxPduCanId=1677 if post-build-variant-condition{matching-criterion=RDR_POS, value=5}, CanIfTxPduCanId=1741 if post-build-variant-condition{matching-criterion=RDR_POS, value=6}, CanIfTxPduCanId=1805 if post-build-variant-condition{matching-criterion=RDR_POS, value=7}, CanIfTxPduBufferRef=CanIfInitCfg/CHNL_2ad3227b, CanIfTxPduRef=EcucPduCollection/RDR_TRACKER_OBJ_062_oPCAN_RADAR_6b5f7fa3_Tx
        RDR_TRACKER_OBJ_063_oPCAN_RADAR_3c18a21d_Tx: CanIfTxPduCanId=1358 if post-build-variant-condition{matching-criterion=RDR_POS, value=0}, CanIfTxPduCanIdType=STANDARD_FD_CAN, CanIfTxPduDlc=64, CanIfTxPduUserTxConfirmationName=PduR_CanIfTxConfirmation, CanIfTxPduUserTxConfirmationUL=PDUR, CanIfTxPduCanId=1422 if post-build-variant-condition{matching-criterion=RDR_POS, value=1}, CanIfTxPduCanId=1486 if post-build-variant-condition{matching-criterion=RDR_POS, value=2}, CanIfTxPduCanId=1550 if post-build-variant-condition{matching-criterion=RDR_POS, value=3}, CanIfTxPduCanId=1614 if post-build-variant-condition{matching-criterion=RDR_POS, value=4}, CanIfTxPduCanId=1678 if post-build-variant-condition{matching-criterion=RDR_POS, value=5}, CanIfTxPduCanId=1742 if post-build-variant-condition{matching-criterion=RDR_POS, value=6}, CanIfTxPduCanId=1806 if post-build-variant-condition{matching-criterion=RDR_POS, value=7}, CanIfTxPduBufferRef=CanIfInitCfg/CHNL_2ad3227b, CanIfTxPduRef=EcucPduCollection/RDR_TRACKER_OBJ_063_oPCAN_RADAR_5dadef50_Tx
        RDR_TRACKER_OBJ_064_oPCAN_RADAR_086fd242_Tx: CanIfTxPduCanId=1359 if post-build-variant-condition{matching-criterion=RDR_POS, value=0}, CanIfTxPduCanIdType=STANDARD_FD_CAN, CanIfTxPduDlc=64, CanIfTxPduUserTxConfirmationName=PduR_CanIfTxConfirmation, CanIfTxPduUserTxConfirmationUL=PDUR, CanIfTxPduCanId=1423 if post-build-variant-condition{matching-criterion=RDR_POS, value=1}, CanIfTxPduCanId=1487 if post-build-variant-condition{matching-criterion=RDR_POS, value=2}, CanIfTxPduCanId=1551 if post-build-variant-condition{matching-criterion=RDR_POS, value=3}, CanIfTxPduCanId=1615 if post-build-variant-condition{matching-criterion=RDR_POS, value=4}, CanIfTxPduCanId=1679 if post-build-variant-condition{matching-criterion=RDR_POS, value=5}, CanIfTxPduCanId=1743 if post-build-variant-condition{matching-criterion=RDR_POS, value=6}, CanIfTxPduCanId=1807 if post-build-variant-condition{matching-criterion=RDR_POS, value=7}, CanIfTxPduBufferRef=CanIfInitCfg/CHNL_2ad3227b, CanIfTxPduRef=EcucPduCollection/RDR_TRACKER_OBJ_064_oPCAN_RADAR_dd701d89_Tx
        RDR_XCP_CTO_RESP_oPCAN_RADAR_ebd76419_Tx: CanIfTxPduCanId=17 if post-build-variant-condition{matching-criterion=RDR_POS, value=0}, CanIfTxPduCanIdType=STANDARD_FD_CAN, CanIfTxPduDlc=64, CanIfTxPduUserTxConfirmationName=PduR_CanIfTxConfirmation, CanIfTxPduUserTxConfirmationUL=PDUR, CanIfTxPduCanId=25 if post-build-variant-condition{matching-criterion=RDR_POS, value=1}, CanIfTxPduCanId=33 if post-build-variant-condition{matching-criterion=RDR_POS, value=2}, CanIfTxPduCanId=41 if post-build-variant-condition{matching-criterion=RDR_POS, value=3}, CanIfTxPduCanId=49 if post-build-variant-condition{matching-criterion=RDR_POS, value=4}, CanIfTxPduCanId=57 if post-build-variant-condition{matching-criterion=RDR_POS, value=5}, CanIfTxPduCanId=65 if post-build-variant-condition{matching-criterion=RDR_POS, value=6}, CanIfTxPduCanId=73 if post-build-variant-condition{matching-criterion=RDR_POS, value=7}, CanIfTxPduBufferRef=CanIfInitCfg/CHNL_2ad3227b, CanIfTxPduRef=EcucPduCollection/RDR_XCP_CTO_RESP_oPCAN_RADAR_e3946380_Tx
        RDR_XCP_DAQ_RESP_oPCAN_RADAR_42f3f200_Tx: CanIfTxPduCanId=18 if post-build-variant-condition{matching-criterion=RDR_POS, value=0}, CanIfTxPduCanIdType=STANDARD_FD_CAN, CanIfTxPduDlc=64, CanIfTxPduUserTxConfirmationName=PduR_CanIfTxConfirmation, CanIfTxPduUserTxConfirmationUL=PDUR, CanIfTxPduCanId=26 if post-build-variant-condition{matching-criterion=RDR_POS, value=1}, CanIfTxPduCanId=34 if post-build-variant-condition{matching-criterion=RDR_POS, value=2}, CanIfTxPduCanId=42 if post-build-variant-condition{matching-criterion=RDR_POS, value=3}, CanIfTxPduCanId=50 if post-build-variant-condition{matching-criterion=RDR_POS, value=4}, CanIfTxPduCanId=58 if post-build-variant-condition{matching-criterion=RDR_POS, value=5}, CanIfTxPduCanId=66 if post-build-variant-condition{matching-criterion=RDR_POS, value=6}, CanIfTxPduCanId=74 if post-build-variant-condition{matching-criterion=RDR_POS, value=7}, CanIfTxPduBufferRef=CanIfInitCfg/CHNL_2ad3227b, CanIfTxPduRef=EcucPduCollection/RDR_XCP_DAQ_RESP_oPCAN_RADAR_1cc015b8_Tx
        SOFT_D0_oVCAN_RADAR_63a90e9b_Tx: CanIfTxPduCanId=419355344, CanIfTxPduCanIdType=EXTENDED_CAN, CanIfTxPduDlc=8, CanIfTxPduUserTxConfirmationUL=CDD, CanIfTxPduBufferRef=CanIfInitCfg/CHNL_0829f689, CanIfTxPduRef=EcucPduCollection/SOFT_D0_oVCAN_RADAR_9a3a9c0b_Tx
        SR1_DIAG_RES_PHY_OBD1_oVCAN_RADAR_5315d9a7_Tx: CanIfTxPduCanId=417001649, CanIfTxPduCanIdMask=4294902015, CanIfTxPduCanIdType=EXTENDED_CAN, CanIfTxPduDlc=8, CanIfTxPduUserTxConfirmationUL=CDD, CanIfTxPduBufferRef=CanIfInitCfg/CHNL_0829f689, CanIfTxPduRef=EcucPduCollection/SR1_DIAG_RES_PHY_OBD1_oVCAN_RADAR_6638d82d_Tx
        SR1_DIAG_RES_PHY_OBD2_oVCAN_RADAR_3bc93779_Tx: CanIfTxPduCanId=417001905, CanIfTxPduCanIdMask=4294902015, CanIfTxPduCanIdType=EXTENDED_CAN, CanIfTxPduDlc=8, CanIfTxPduUserTxConfirmationUL=CDD, CanIfTxPduBufferRef=CanIfInitCfg/CHNL_0829f689, CanIfTxPduRef=EcucPduCollection/SR1_DIAG_RES_PHY_OBD2_oVCAN_RADAR_3d2f6938_Tx
        SR1_DIAG_RES_PHY_OTA_oVCAN_RADAR_b9a3928f_Tx: CanIfTxPduCanId=417002673, CanIfTxPduCanIdMask=4294902015, CanIfTxPduCanIdType=EXTENDED_CAN, CanIfTxPduDlc=8, CanIfTxPduUserTxConfirmationUL=CDD, CanIfTxPduBufferRef=CanIfInitCfg/CHNL_0829f689, CanIfTxPduRef=EcucPduCollection/SR1_DIAG_RES_PHY_OTA_oVCAN_RADAR_349e32f6_Tx
        SR1_DIAG_RES_PHY_PLANT_oVCAN_RADAR_16d34ef3_Tx: CanIfTxPduCanId=417002929, CanIfTxPduCanIdMask=4294902015, CanIfTxPduCanIdType=EXTENDED_CAN, CanIfTxPduDlc=8, CanIfTxPduUserTxConfirmationUL=CDD, CanIfTxPduBufferRef=CanIfInitCfg/CHNL_0829f689, CanIfTxPduRef=EcucPduCollection/SR1_DIAG_RES_PHY_PLANT_oVCAN_RADAR_9afe60a3_Tx
        SR2_DIAG_RES_PHY_OBD1_oVCAN_RADAR_46011a9b_Tx: CanIfTxPduCanId=417001648, CanIfTxPduCanIdMask=4294902015, CanIfTxPduCanIdType=EXTENDED_CAN, CanIfTxPduDlc=8, CanIfTxPduUserTxConfirmationUL=CDD, CanIfTxPduBufferRef=CanIfInitCfg/CHNL_0829f689, CanIfTxPduRef=EcucPduCollection/SR2_DIAG_RES_PHY_OBD1_oVCAN_RADAR_e30acad9_Tx
        SR2_DIAG_RES_PHY_OBD2_oVCAN_RADAR_2eddf445_Tx: CanIfTxPduCanId=417001904, CanIfTxPduCanIdMask=4294902015, CanIfTxPduCanIdType=EXTENDED_CAN, CanIfTxPduDlc=8, CanIfTxPduUserTxConfirmationUL=CDD, CanIfTxPduBufferRef=CanIfInitCfg/CHNL_0829f689, CanIfTxPduRef=EcucPduCollection/SR2_DIAG_RES_PHY_OBD2_oVCAN_RADAR_b81d7bcc_Tx
        SR2_DIAG_RES_PHY_OTA_oVCAN_RADAR_8f2ed61e_Tx: CanIfTxPduCanId=417002672, CanIfTxPduCanIdMask=4294902015, CanIfTxPduCanIdType=EXTENDED_CAN, CanIfTxPduDlc=8, CanIfTxPduUserTxConfirmationUL=CDD, CanIfTxPduBufferRef=CanIfInitCfg/CHNL_0829f689, CanIfTxPduRef=EcucPduCollection/SR2_DIAG_RES_PHY_OTA_oVCAN_RADAR_63bc1ea4_Tx
        SR2_DIAG_RES_PHY_PLANT_oVCAN_RADAR_b3fa7e3b_Tx: CanIfTxPduCanId=417002928, CanIfTxPduCanIdMask=4294902015, CanIfTxPduCanIdType=EXTENDED_CAN, CanIfTxPduDlc=8, CanIfTxPduUserTxConfirmationUL=CDD, CanIfTxPduBufferRef=CanIfInitCfg/CHNL_0829f689, CanIfTxPduRef=EcucPduCollection/SR2_DIAG_RES_PHY_PLANT_oVCAN_RADAR_20ab64b4_Tx
        SRR_FL_DIAG_REQ_PHYS_OBD1_Tx_oPCAN_RADAR_47cc77aa_Tx: CanIfTxPduCanId=416985584, CanIfTxPduCanIdType=STANDARD_FD_CAN, CanIfTxPduDlc=64, CanIfTxPduUserTxConfirmationUL=CDD, CanIfTxPduBufferRef=CanIfInitCfg/CHNL_2ad3227b, CanIfTxPduRef=SRR_FL_DIAG_REQ_PHYS_OBD1_Tx_oPCAN_RADAR_1d0fb5b4_Tx
        SRR_FL_DIAG_REQ_PHYS_OBD2_Tx_oPCAN_RADAR_965c3a17_Tx: CanIfTxPduCanId=416985585, CanIfTxPduCanIdType=STANDARD_FD_CAN, CanIfTxPduDlc=64, CanIfTxPduUserTxConfirmationUL=CDD, CanIfTxPduBufferRef=CanIfInitCfg/CHNL_2ad3227b, CanIfTxPduRef=SRR_FL_DIAG_REQ_PHYS_OBD2_Tx_oPCAN_RADAR_79efce4a_Tx
        SRR_FL_DIAG_REQ_PHYS_OTA_Tx_oPCAN_RADAR_2ec4d37f_Tx: CanIfTxPduCanId=416985588, CanIfTxPduCanIdType=STANDARD_FD_CAN, CanIfTxPduDlc=64, CanIfTxPduUserTxConfirmationUL=CDD, CanIfTxPduBufferRef=CanIfInitCfg/CHNL_2ad3227b, CanIfTxPduRef=SRR_FL_DIAG_REQ_PHYS_OTA_Tx_oPCAN_RADAR_ebda6543_Tx
        SRR_FL_DIAG_REQ_PHYS_PLANT_Tx_oPCAN_RADAR_82406e1b_Tx: CanIfTxPduCanId=416985589, CanIfTxPduCanIdType=STANDARD_FD_CAN, CanIfTxPduDlc=64, CanIfTxPduUserTxConfirmationUL=CDD, CanIfTxPduBufferRef=CanIfInitCfg/CHNL_2ad3227b, CanIfTxPduRef=SRR_FL_DIAG_REQ_PHYS_PLANT_Tx_oPCAN_RADAR_a38832c1_Tx
        SRR_RL_DIAG_REQ_PHYS_OBD1_Tx_oPCAN_RADAR_d15e4aba_Tx: CanIfTxPduCanId=416985328, CanIfTxPduCanIdType=STANDARD_FD_CAN, CanIfTxPduDlc=64, CanIfTxPduUserTxConfirmationUL=CDD, CanIfTxPduBufferRef=CanIfInitCfg/CHNL_2ad3227b, CanIfTxPduRef=SRR_RL_DIAG_REQ_PHYS_OBD1_Tx_oPCAN_RADAR_697bc1d9_Tx
        SRR_RL_DIAG_REQ_PHYS_OBD2_Tx_oPCAN_RADAR_00ce0707_Tx: CanIfTxPduCanId=416985329, CanIfTxPduCanIdType=STANDARD_FD_CAN, CanIfTxPduDlc=64, CanIfTxPduUserTxConfirmationUL=CDD, CanIfTxPduBufferRef=CanIfInitCfg/CHNL_2ad3227b, CanIfTxPduRef=SRR_RL_DIAG_REQ_PHYS_OBD2_Tx_oPCAN_RADAR_0d9bba27_Tx
        SRR_RL_DIAG_REQ_PHYS_OTA_Tx_oPCAN_RADAR_2be0d721_Tx: CanIfTxPduCanId=416985332, CanIfTxPduCanIdType=STANDARD_FD_CAN, CanIfTxPduDlc=64, CanIfTxPduUserTxConfirmationUL=CDD, CanIfTxPduBufferRef=CanIfInitCfg/CHNL_2ad3227b, CanIfTxPduRef=SRR_RL_DIAG_REQ_PHYS_OTA_Tx_oPCAN_RADAR_2e7c92c0_Tx
        SRR_RL_DIAG_REQ_PHYS_PLANT_Tx_oPCAN_RADAR_b38606fa_Tx: CanIfTxPduCanId=416985333, CanIfTxPduCanIdType=STANDARD_FD_CAN, CanIfTxPduDlc=64, CanIfTxPduUserTxConfirmationUL=CDD, CanIfTxPduBufferRef=CanIfInitCfg/CHNL_2ad3227b, CanIfTxPduRef=SRR_RL_DIAG_REQ_PHYS_PLANT_Tx_oPCAN_RADAR_90ff5b50_Tx
        TPCM_SR1_oVCAN_RADAR_264f0b3c_Tx: CanIfTxPduCanId=418219602, CanIfTxPduCanIdMask=4294902015, CanIfTxPduCanIdType=EXTENDED_CAN, CanIfTxPduDlc=8, CanIfTxPduUserTxConfirmationUL=CDD, CanIfTxPduBufferRef=CanIfInitCfg/CHNL_0829f689, CanIfTxPduRef=EcucPduCollection/TPCM_SR1_oVCAN_RADAR_42f3de03_Tx
        TPCM_SR2_oVCAN_RADAR_e86476d4_Tx: CanIfTxPduCanId=418219603, CanIfTxPduCanIdMask=4294902015, CanIfTxPduCanIdType=EXTENDED_CAN, CanIfTxPduDlc=8, CanIfTxPduUserTxConfirmationUL=CDD, CanIfTxPduBufferRef=CanIfInitCfg/CHNL_0829f689, CanIfTxPduRef=EcucPduCollection/TPCM_SR2_oVCAN_RADAR_19e46f16_Tx
        TPCM_Tp_oVCAN_RADAR_229e257c_Tx: CanIfTxPduCanId=485293822, CanIfTxPduCanIdMask=3825139712, CanIfTxPduCanIdType=EXTENDED_CAN, CanIfTxPduDlc=8, CanIfTxPduUserTxConfirmationName=J1939Tp_TxConfirmation, CanIfTxPduUserTxConfirmationUL=J1939TP, CanIfTxPduBufferRef=CanIfInitCfg/CHNL_0829f689, CanIfTxPduRef=TPCM_Tp_oVCAN_RADAR_a235016c_Tx
        TPDT_B0_oVCAN_RADAR_d6e4df39_Tx: CanIfTxPduCanId=418219600, CanIfTxPduCanIdMask=4294902015, CanIfTxPduCanIdType=EXTENDED_CAN, CanIfTxPduDlc=8, CanIfTxPduUserTxConfirmationUL=CDD, CanIfTxPduBufferRef=CanIfInitCfg/CHNL_0829f689, CanIfTxPduRef=EcucPduCollection/TPDT_B0_oVCAN_RADAR_bde39209_Tx
        TPDT_B1_oVCAN_RADAR_2ebbc0bc_Tx: CanIfTxPduCanId=418219601, CanIfTxPduCanIdMask=4294902015, CanIfTxPduCanIdType=EXTENDED_CAN, CanIfTxPduDlc=8, CanIfTxPduUserTxConfirmationUL=CDD, CanIfTxPduBufferRef=CanIfInitCfg/CHNL_0829f689, CanIfTxPduRef=EcucPduCollection/TPDT_B1_oVCAN_RADAR_8b1102fa_Tx
        TPDT_Tp_oVCAN_RADAR_95c1c45e_Tx: CanIfTxPduCanId=485228286, CanIfTxPduCanIdMask=3825139712, CanIfTxPduCanIdType=EXTENDED_CAN, CanIfTxPduDlc=8, CanIfTxPduUserTxConfirmationName=J1939Tp_TxConfirmation, CanIfTxPduUserTxConfirmationUL=J1939TP, CanIfTxPduBufferRef=CanIfInitCfg/CHNL_0829f689, CanIfTxPduRef=TPDT_Tp_oVCAN_RADAR_92966f54_Tx
        prop_ADAS_BSIS_info_oVCAN_RADAR_42f884ce_Tx: CanIfTxPduCanId=419407024, CanIfTxPduCanIdType=EXTENDED_CAN, CanIfTxPduDlc=8, CanIfTxPduUserTxConfirmationUL=CDD, CanIfTxPduBufferRef=CanIfInitCfg/CHNL_0829f689, CanIfTxPduRef=EcucPduCollection/prop_ADAS_BSIS_info_oVCAN_RADAR_a7fddec0_Tx
        prop_ADAS_MOIS_info_oVCAN_RADAR_dba7da57_Tx: CanIfTxPduCanId=419407056, CanIfTxPduCanIdType=EXTENDED_CAN, CanIfTxPduDlc=8, CanIfTxPduUserTxConfirmationName=PduR_CanIfTxConfirmation, CanIfTxPduUserTxConfirmationUL=PDUR, CanIfTxPduBufferRef=CanIfInitCfg/CHNL_0829f689, CanIfTxPduRef=EcucPduCollection/prop_ADAS_MOIS_info_oVCAN_RADAR_21657ab6_Tx
        SYS_TIME_SYNC_oPCAN_RADAR_231d6bb9_Tx: CanIfTxPduCanId=1, CanIfTxPduCanIdType=STANDARD_FD_CAN, CanIfTxPduDlc=8, CanIfTxPduUserTxConfirmationName=PduR_CanIfTxConfirmation, CanIfTxPduUserTxConfirmationUL=PDUR, CanIfTxPduBufferRef=CanIfInitCfg/CHNL_2ad3227b, CanIfTxPduRef=EcucPduCollection/SYS_TIME_SYNC_oPCAN_RADAR_ba7b9b28_Tx, variation-point=post-build-variant-condition{matching-criterion=RDR_POS, value=4}
      6 x CanIfRxPduCfg, all with CanIfRxPduCanId=1, CanIfRxPduCanIdType=STANDARD_CAN, CanIfRxPduDlc=8, CanIfRxPduUserRxIndicationName=PduR_CanIfRxIndication, CanIfRxPduUserRxIndicationUL=PDUR, CanIfRxPduHrhIdRef=CanIfInitHohCfg/CN_PCAN_RADAR_a729ccfc_Rx, CanIfRxPduRef=EcucPduCollection/SYS_TIME_SYNC_oPCAN_RADAR_ba7b9b28_Rx:
        SYS_TIME_SYNC_oPCAN_RADAR_231d6bb9_Rx: variation-point=post-build-variant-condition{matching-criterion=RDR_POS, value={1..3}}
        SYS_TIME_SYNC_oPCAN_RADAR_231d6bb9_Rx: variation-point=post-build-variant-condition{matching-criterion=RDR_POS, value={5..7}}
    CanIfPrivateCfg: CanIfPrivateSoftwareFilterType=LINEAR
    CanIfPublicCfg: CanIfPublicPnSupport=false
  module config CanSM
    CanSMConfiguration
      CHNL_0829f689 (CanSMManagerNetwork): CanSMComMNetworkHandleRef=ComMConfigSet/CN_VCAN_RADAR_489180b6
        CT_VCAN_RADAR_a6a4a2e0 (CanSMController): CanSMControllerId=CanIfCtrlDrvCfg_7d254554/CT_VCAN_RADAR_aebe852b
      CHNL_2ad3227b (CanSMManagerNetwork): CanSMComMNetworkHandleRef=ComMConfigSet/CN_PCAN_RADAR_458ff0f1
        CT_PCAN_RADAR_48890c61 (CanSMController): CanSMControllerId=CanIfCtrlDrvCfg_7d254554/CT_PCAN_RADAR_a3a0f56c
