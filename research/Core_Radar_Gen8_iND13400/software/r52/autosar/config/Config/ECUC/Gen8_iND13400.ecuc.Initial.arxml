[part 4 of 24: package /InitialEcuC]
AUTOSAR XML (schema 00053)
package /InitialEcuC  (continued)
  module config Com  (continued)
    ComConfig  (continued)
      246 x ComIPdu, all with ComIPduType=NORMAL:  (continued)
        RDR_DETECTION_033_036_oPCAN_RADAR_92c5dd75_Tx: ComIPduDirection=SEND, ComIPduChannelRef=ComMConfigSet/CN_PCAN_RADAR_458ff0f1, ComIPduGroupRef=RDR01_oPCAN_RADAR_Tx_b6bdb067 if post-build-variant-condition{matching-criterion=RDR_POS, value=0}, ComIPduSignalGroupRef=SG_Detections_033_036_oRDR_DETECTION_033_036_oPCAN_RADAR_308f4df6_Tx, ComPduIdRef=EcucPduCollection/RDR_DETECTION_033_036_oPCAN_RADAR_92c5dd75_Tx, ComIPduGroupRef=RDR02_oPCAN_RADAR_Tx_9f750495 if post-build-variant-condition{matching-criterion=RDR_POS, value=1}, ComIPduGroupRef=RDR03_oPCAN_RADAR_Tx_311d9504 if post-build-variant-condition{matching-criterion=RDR_POS, value=2}, ComIPduGroupRef=RDR04_oPCAN_RADAR_Tx_cce46d71 if post-build-variant-condition{matching-criterion=RDR_POS, value=3}, ComIPduGroupRef=RDR05_oPCAN_RADAR_Tx_628cfce0 if post-build-variant-condition{matching-criterion=RDR_POS, value=4}, ComIPduGroupRef=RDR06_oPCAN_RADAR_Tx_4b444812 if post-build-variant-condition{matching-criterion=RDR_POS, value=5}, ComIPduGroupRef=RDR07_oPCAN_RADAR_Tx_e52cd983 if post-build-variant-condition{matching-criterion=RDR_POS, value=6}, ComIPduGroupRef=RDR08_oPCAN_RADAR_Tx_6bc6beb9 if post-build-variant-condition{matching-criterion=RDR_POS, value=7}
          ComTxIPdu: ComMinimumDelayTime=0, ComTxIPduUnusedAreasDefault=0
        RDR_DETECTION_037_040_oPCAN_RADAR_24e58fa7_Tx: ComIPduDirection=SEND, ComIPduChannelRef=ComMConfigSet/CN_PCAN_RADAR_458ff0f1, ComIPduGroupRef=RDR01_oPCAN_RADAR_Tx_b6bdb067 if post-build-variant-condition{matching-criterion=RDR_POS, value=0}, ComIPduSignalGroupRef=SG_Detections_037_040_oRDR_DETECTION_037_040_oPCAN_RADAR_abdcc2d8_Tx, ComPduIdRef=EcucPduCollection/RDR_DETECTION_037_040_oPCAN_RADAR_24e58fa7_Tx, ComIPduGroupRef=RDR02_oPCAN_RADAR_Tx_9f750495 if post-build-variant-condition{matching-criterion=RDR_POS, value=1}, ComIPduGroupRef=RDR03_oPCAN_RADAR_Tx_311d9504 if post-build-variant-condition{matching-criterion=RDR_POS, value=2}, ComIPduGroupRef=RDR04_oPCAN_RADAR_Tx_cce46d71 if post-build-variant-condition{matching-criterion=RDR_POS, value=3}, ComIPduGroupRef=RDR05_oPCAN_RADAR_Tx_628cfce0 if post-build-variant-condition{matching-criterion=RDR_POS, value=4}, ComIPduGroupRef=RDR06_oPCAN_RADAR_Tx_4b444812 if post-build-variant-condition{matching-criterion=RDR_POS, value=5}, ComIPduGroupRef=RDR07_oPCAN_RADAR_Tx_e52cd983 if post-build-variant-condition{matching-criterion=RDR_POS, value=6}, ComIPduGroupRef=RDR08_oPCAN_RADAR_Tx_6bc6beb9 if post-build-variant-condition{matching-criterion=RDR_POS, value=7}
          ComTxIPdu: ComMinimumDelayTime=0, ComTxIPduUnusedAreasDefault=0
        RDR_DETECTION_041_044_oPCAN_RADAR_a246585d_Tx: ComIPduDirection=SEND, ComIPduChannelRef=ComMConfigSet/CN_PCAN_RADAR_458ff0f1, ComIPduGroupRef=RDR01_oPCAN_RADAR_Tx_b6bdb067 if post-build-variant-condition{matching-criterion=RDR_POS, value=0}, ComIPduSignalGroupRef=SG_Detections_041_044_oRDR_DETECTION_041_044_oPCAN_RADAR_b5a3d501_Tx, ComPduIdRef=EcucPduCollection/RDR_DETECTION_041_044_oPCAN_RADAR_a246585d_Tx, ComIPduGroupRef=RDR02_oPCAN_RADAR_Tx_9f750495 if post-build-variant-condition{matching-criterion=RDR_POS, value=1}, ComIPduGroupRef=RDR03_oPCAN_RADAR_Tx_311d9504 if post-build-variant-condition{matching-criterion=RDR_POS, value=2}, ComIPduGroupRef=RDR04_oPCAN_RADAR_Tx_cce46d71 if post-build-variant-condition{matching-criterion=RDR_POS, value=3}, ComIPduGroupRef=RDR05_oPCAN_RADAR_Tx_628cfce0 if post-build-variant-condition{matching-criterion=RDR_POS, value=4}, ComIPduGroupRef=RDR06_oPCAN_RADAR_Tx_4b444812 if post-build-variant-condition{matching-criterion=RDR_POS, value=5}, ComIPduGroupRef=RDR07_oPCAN_RADAR_Tx_e52cd983 if post-build-variant-condition{matching-criterion=RDR_POS, value=6}, ComIPduGroupRef=RDR08_oPCAN_RADAR_Tx_6bc6beb9 if post-build-variant-condition{matching-criterion=RDR_POS, value=7}
          ComTxIPdu: ComMinimumDelayTime=0, ComTxIPduUnusedAreasDefault=0
        RDR_DETECTION_045_048_oPCAN_RADAR_4bf4c669_Tx: ComIPduDirection=SEND, ComIPduChannelRef=ComMConfigSet/CN_PCAN_RADAR_458ff0f1, ComIPduGroupRef=RDR01_oPCAN_RADAR_Tx_b6bdb067 if post-build-variant-condition{matching-criterion=RDR_POS, value=0}, ComIPduSignalGroupRef=SG_Detections_045_048_oRDR_DETECTION_045_048_oPCAN_RADAR_c460e153_Tx, ComPduIdRef=EcucPduCollection/RDR_DETECTION_045_048_oPCAN_RADAR_4bf4c669_Tx, ComIPduGroupRef=RDR02_oPCAN_RADAR_Tx_9f750495 if post-build-variant-condition{matching-criterion=RDR_POS, value=1}, ComIPduGroupRef=RDR03_oPCAN_RADAR_Tx_311d9504 if post-build-variant-condition{matching-criterion=RDR_POS, value=2}, ComIPduGroupRef=RDR04_oPCAN_RADAR_Tx_cce46d71 if post-build-variant-condition{matching-criterion=RDR_POS, value=3}, ComIPduGroupRef=RDR05_oPCAN_RADAR_Tx_628cfce0 if post-build-variant-condition{matching-criterion=RDR_POS, value=4}, ComIPduGroupRef=RDR06_oPCAN_RADAR_Tx_4b444812 if post-build-variant-condition{matching-criterion=RDR_POS, value=5}, ComIPduGroupRef=RDR07_oPCAN_RADAR_Tx_e52cd983 if post-build-variant-condition{matching-criterion=RDR_POS, value=6}, ComIPduGroupRef=RDR08_oPCAN_RADAR_Tx_6bc6beb9 if post-build-variant-condition{matching-criterion=RDR_POS, value=7}
          ComTxIPdu: ComMinimumDelayTime=0, ComTxIPduUnusedAreasDefault=0
        RDR_DETECTION_049_052_oPCAN_RADAR_79bc2968_Tx: ComIPduDirection=SEND, ComIPduChannelRef=ComMConfigSet/CN_PCAN_RADAR_458ff0f1, ComIPduGroupRef=RDR01_oPCAN_RADAR_Tx_b6bdb067 if post-build-variant-condition{matching-criterion=RDR_POS, value=0}, ComIPduSignalGroupRef=SG_Detections_049_052_oRDR_DETECTION_049_052_oPCAN_RADAR_5d1ac528_Tx, ComPduIdRef=EcucPduCollection/RDR_DETECTION_049_052_oPCAN_RADAR_79bc2968_Tx, ComIPduGroupRef=RDR02_oPCAN_RADAR_Tx_9f750495 if post-build-variant-condition{matching-criterion=RDR_POS, value=1}, ComIPduGroupRef=RDR03_oPCAN_RADAR_Tx_311d9504 if post-build-variant-condition{matching-criterion=RDR_POS, value=2}, ComIPduGroupRef=RDR04_oPCAN_RADAR_Tx_cce46d71 if post-build-variant-condition{matching-criterion=RDR_POS, value=3}, ComIPduGroupRef=RDR05_oPCAN_RADAR_Tx_628cfce0 if post-build-variant-condition{matching-criterion=RDR_POS, value=4}, ComIPduGroupRef=RDR06_oPCAN_RADAR_Tx_4b444812 if post-build-variant-condition{matching-criterion=RDR_POS, value=5}, ComIPduGroupRef=RDR07_oPCAN_RADAR_Tx_e52cd983 if post-build-variant-condition{matching-criterion=RDR_POS, value=6}, ComIPduGroupRef=RDR08_oPCAN_RADAR_Tx_6bc6beb9 if post-build-variant-condition{matching-criterion=RDR_POS, value=7}
          ComTxIPdu: ComMinimumDelayTime=0, ComTxIPduUnusedAreasDefault=0
        RDR_DETECTION_053_056_oPCAN_RADAR_647b2a46_Tx: ComIPduDirection=SEND, ComIPduChannelRef=ComMConfigSet/CN_PCAN_RADAR_458ff0f1, ComIPduGroupRef=RDR01_oPCAN_RADAR_Tx_b6bdb067 if post-build-variant-condition{matching-criterion=RDR_POS, value=0}, ComIPduSignalGroupRef=SG_Detections_053_056_oRDR_DETECTION_053_056_oPCAN_RADAR_6f11ad00_Tx, ComPduIdRef=EcucPduCollection/RDR_DETECTION_053_056_oPCAN_RADAR_647b2a46_Tx, ComIPduGroupRef=RDR02_oPCAN_RADAR_Tx_9f750495 if post-build-variant-condition{matching-criterion=RDR_POS, value=1}, ComIPduGroupRef=RDR03_oPCAN_RADAR_Tx_311d9504 if post-build-variant-condition{matching-criterion=RDR_POS, value=2}, ComIPduGroupRef=RDR04_oPCAN_RADAR_Tx_cce46d71 if post-build-variant-condition{matching-criterion=RDR_POS, value=3}, ComIPduGroupRef=RDR05_oPCAN_RADAR_Tx_628cfce0 if post-build-variant-condition{matching-criterion=RDR_POS, value=4}, ComIPduGroupRef=RDR06_oPCAN_RADAR_Tx_4b444812 if post-build-variant-condition{matching-criterion=RDR_POS, value=5}, ComIPduGroupRef=RDR07_oPCAN_RADAR_Tx_e52cd983 if post-build-variant-condition{matching-criterion=RDR_POS, value=6}, ComIPduGroupRef=RDR08_oPCAN_RADAR_Tx_6bc6beb9 if post-build-variant-condition{matching-criterion=RDR_POS, value=7}
          ComTxIPdu: ComMinimumDelayTime=0, ComTxIPduUnusedAreasDefault=0
        RDR_DETECTION_057_060_oPCAN_RADAR_cbf7f78f_Tx: ComIPduDirection=SEND, ComIPduChannelRef=ComMConfigSet/CN_PCAN_RADAR_458ff0f1, ComIPduGroupRef=RDR01_oPCAN_RADAR_Tx_b6bdb067 if post-build-variant-condition{matching-criterion=RDR_POS, value=0}, ComIPduSignalGroupRef=SG_Detections_057_060_oRDR_DETECTION_057_060_oPCAN_RADAR_83bdfb8a_Tx, ComPduIdRef=EcucPduCollection/RDR_DETECTION_057_060_oPCAN_RADAR_cbf7f78f_Tx, ComIPduGroupRef=RDR02_oPCAN_RADAR_Tx_9f750495 if post-build-variant-condition{matching-criterion=RDR_POS, value=1}, ComIPduGroupRef=RDR03_oPCAN_RADAR_Tx_311d9504 if post-build-variant-condition{matching-criterion=RDR_POS, value=2}, ComIPduGroupRef=RDR04_oPCAN_RADAR_Tx_cce46d71 if post-build-variant-condition{matching-criterion=RDR_POS, value=3}, ComIPduGroupRef=RDR05_oPCAN_RADAR_Tx_628cfce0 if post-build-variant-condition{matching-criterion=RDR_POS, value=4}, ComIPduGroupRef=RDR06_oPCAN_RADAR_Tx_4b444812 if post-build-variant-condition{matching-criterion=RDR_POS, value=5}, ComIPduGroupRef=RDR07_oPCAN_RADAR_Tx_e52cd983 if post-build-variant-condition{matching-criterion=RDR_POS, value=6}, ComIPduGroupRef=RDR08_oPCAN_RADAR_Tx_6bc6beb9 if post-build-variant-condition{matching-criterion=RDR_POS, value=7}
          ComTxIPdu: ComMinimumDelayTime=0, ComTxIPduUnusedAreasDefault=0
        RDR_DETECTION_061_064_oPCAN_RADAR_46fcf773_Tx: ComIPduDirection=SEND, ComIPduChannelRef=ComMConfigSet/CN_PCAN_RADAR_458ff0f1, ComIPduGroupRef=RDR01_oPCAN_RADAR_Tx_b6bdb067 if post-build-variant-condition{matching-criterion=RDR_POS, value=0}, ComIPduSignalGroupRef=SG_Detections_061_064_oRDR_DETECTION_061_064_oPCAN_RADAR_80d67553_Tx, ComPduIdRef=EcucPduCollection/RDR_DETECTION_061_064_oPCAN_RADAR_46fcf773_Tx, ComIPduGroupRef=RDR02_oPCAN_RADAR_Tx_9f750495 if post-build-variant-condition{matching-criterion=RDR_POS, value=1}, ComIPduGroupRef=RDR03_oPCAN_RADAR_Tx_311d9504 if post-build-variant-condition{matching-criterion=RDR_POS, value=2}, ComIPduGroupRef=RDR04_oPCAN_RADAR_Tx_cce46d71 if post-build-variant-condition{matching-criterion=RDR_POS, value=3}, ComIPduGroupRef=RDR05_oPCAN_RADAR_Tx_628cfce0 if post-build-variant-condition{matching-criterion=RDR_POS, value=4}, ComIPduGroupRef=RDR06_oPCAN_RADAR_Tx_4b444812 if post-build-variant-condition{matching-criterion=RDR_POS, value=5}, ComIPduGroupRef=RDR07_oPCAN_RADAR_Tx_e52cd983 if post-build-variant-condition{matching-criterion=RDR_POS, value=6}, ComIPduGroupRef=RDR08_oPCAN_RADAR_Tx_6bc6beb9 if post-build-variant-condition{matching-criterion=RDR_POS, value=7}
          ComTxIPdu: ComMinimumDelayTime=0, ComTxIPduUnusedAreasDefault=0
        RDR_DETECTION_065_068_oPCAN_RADAR_af4e6947_Tx: ComIPduDirection=SEND, ComIPduChannelRef=ComMConfigSet/CN_PCAN_RADAR_458ff0f1, ComIPduGroupRef=RDR01_oPCAN_RADAR_Tx_b6bdb067 if post-build-variant-condition{matching-criterion=RDR_POS, value=0}, ComIPduSignalGroupRef=SG_Detections_065_068_oRDR_DETECTION_065_068_oPCAN_RADAR_f1154101_Tx, ComPduIdRef=EcucPduCollection/RDR_DETECTION_065_068_oPCAN_RADAR_af4e6947_Tx, ComIPduGroupRef=RDR02_oPCAN_RADAR_Tx_9f750495 if post-build-variant-condition{matching-criterion=RDR_POS, value=1}, ComIPduGroupRef=RDR03_oPCAN_RADAR_Tx_311d9504 if post-build-variant-condition{matching-criterion=RDR_POS, value=2}, ComIPduGroupRef=RDR04_oPCAN_RADAR_Tx_cce46d71 if post-build-variant-condition{matching-criterion=RDR_POS, value=3}, ComIPduGroupRef=RDR05_oPCAN_RADAR_Tx_628cfce0 if post-build-variant-condition{matching-criterion=RDR_POS, value=4}, ComIPduGroupRef=RDR06_oPCAN_RADAR_Tx_4b444812 if post-build-variant-condition{matching-criterion=RDR_POS, value=5}, ComIPduGroupRef=RDR07_oPCAN_RADAR_Tx_e52cd983 if post-build-variant-condition{matching-criterion=RDR_POS, value=6}, ComIPduGroupRef=RDR08_oPCAN_RADAR_Tx_6bc6beb9 if post-build-variant-condition{matching-criterion=RDR_POS, value=7}
          ComTxIPdu: ComMinimumDelayTime=0, ComTxIPduUnusedAreasDefault=0
        RDR_DETECTION_069_072_oPCAN_RADAR_9d068646_Tx: ComIPduDirection=SEND, ComIPduChannelRef=ComMConfigSet/CN_PCAN_RADAR_458ff0f1, ComIPduGroupRef=RDR01_oPCAN_RADAR_Tx_b6bdb067 if post-build-variant-condition{matching-criterion=RDR_POS, value=0}, ComIPduSignalGroupRef=SG_Detections_069_072_oRDR_DETECTION_069_072_oPCAN_RADAR_686f657a_Tx, ComPduIdRef=EcucPduCollection/RDR_DETECTION_069_072_oPCAN_RADAR_9d068646_Tx, ComIPduGroupRef=RDR02_oPCAN_RADAR_Tx_9f750495 if post-build-variant-condition{matching-criterion=RDR_POS, value=1}, ComIPduGroupRef=RDR03_oPCAN_RADAR_Tx_311d9504 if post-build-variant-condition{matching-criterion=RDR_POS, value=2}, ComIPduGroupRef=RDR04_oPCAN_RADAR_Tx_cce46d71 if post-build-variant-condition{matching-criterion=RDR_POS, value=3}, ComIPduGroupRef=RDR05_oPCAN_RADAR_Tx_628cfce0 if post-build-variant-condition{matching-criterion=RDR_POS, value=4}, ComIPduGroupRef=RDR06_oPCAN_RADAR_Tx_4b444812 if post-build-variant-condition{matching-criterion=RDR_POS, value=5}, ComIPduGroupRef=RDR07_oPCAN_RADAR_Tx_e52cd983 if post-build-variant-condition{matching-criterion=RDR_POS, value=6}, ComIPduGroupRef=RDR08_oPCAN_RADAR_Tx_6bc6beb9 if post-build-variant-condition{matching-criterion=RDR_POS, value=7}
          ComTxIPdu: ComMinimumDelayTime=0, ComTxIPduUnusedAreasDefault=0
        RDR_DETECTION_073_076_oPCAN_RADAR_80c18568_Tx: ComIPduDirection=SEND, ComIPduChannelRef=ComMConfigSet/CN_PCAN_RADAR_458ff0f1, ComIPduGroupRef=RDR01_oPCAN_RADAR_Tx_b6bdb067 if post-build-variant-condition{matching-criterion=RDR_POS, value=0}, ComIPduSignalGroupRef=SG_Detections_073_076_oRDR_DETECTION_073_076_oPCAN_RADAR_5a640d52_Tx, ComPduIdRef=EcucPduCollection/RDR_DETECTION_073_076_oPCAN_RADAR_80c18568_Tx, ComIPduGroupRef=RDR02_oPCAN_RADAR_Tx_9f750495 if post-build-variant-condition{matching-criterion=RDR_POS, value=1}, ComIPduGroupRef=RDR03_oPCAN_RADAR_Tx_311d9504 if post-build-variant-condition{matching-criterion=RDR_POS, value=2}, ComIPduGroupRef=RDR04_oPCAN_RADAR_Tx_cce46d71 if post-build-variant-condition{matching-criterion=RDR_POS, value=3}, ComIPduGroupRef=RDR05_oPCAN_RADAR_Tx_628cfce0 if post-build-variant-condition{matching-criterion=RDR_POS, value=4}, ComIPduGroupRef=RDR06_oPCAN_RADAR_Tx_4b444812 if post-build-variant-condition{matching-criterion=RDR_POS, value=5}, ComIPduGroupRef=RDR07_oPCAN_RADAR_Tx_e52cd983 if post-build-variant-condition{matching-criterion=RDR_POS, value=6}, ComIPduGroupRef=RDR08_oPCAN_RADAR_Tx_6bc6beb9 if post-build-variant-condition{matching-criterion=RDR_POS, value=7}
          ComTxIPdu: ComMinimumDelayTime=0, ComTxIPduUnusedAreasDefault=0
        RDR_DETECTION_077_080_oPCAN_RADAR_05b8c98c_Tx: ComIPduDirection=SEND, ComIPduChannelRef=ComMConfigSet/CN_PCAN_RADAR_458ff0f1, ComIPduGroupRef=RDR01_oPCAN_RADAR_Tx_b6bdb067 if post-build-variant-condition{matching-criterion=RDR_POS, value=0}, ComIPduSignalGroupRef=SG_Detections_077_080_oRDR_DETECTION_077_080_oPCAN_RADAR_2ec83134_Tx, ComPduIdRef=EcucPduCollection/RDR_DETECTION_077_080_oPCAN_RADAR_05b8c98c_Tx, ComIPduGroupRef=RDR02_oPCAN_RADAR_Tx_9f750495 if post-build-variant-condition{matching-criterion=RDR_POS, value=1}, ComIPduGroupRef=RDR03_oPCAN_RADAR_Tx_311d9504 if post-build-variant-condition{matching-criterion=RDR_POS, value=2}, ComIPduGroupRef=RDR04_oPCAN_RADAR_Tx_cce46d71 if post-build-variant-condition{matching-criterion=RDR_POS, value=3}, ComIPduGroupRef=RDR05_oPCAN_RADAR_Tx_628cfce0 if post-build-variant-condition{matching-criterion=RDR_POS, value=4}, ComIPduGroupRef=RDR06_oPCAN_RADAR_Tx_4b444812 if post-build-variant-condition{matching-criterion=RDR_POS, value=5}, ComIPduGroupRef=RDR07_oPCAN_RADAR_Tx_e52cd983 if post-build-variant-condition{matching-criterion=RDR_POS, value=6}, ComIPduGroupRef=RDR08_oPCAN_RADAR_Tx_6bc6beb9 if post-build-variant-condition{matching-criterion=RDR_POS, value=7}
          ComTxIPdu: ComMinimumDelayTime=0, ComTxIPduUnusedAreasDefault=0
        RDR_DETECTION_081_084_oPCAN_RADAR_944ab07a_Tx: ComIPduDirection=SEND, ComIPduChannelRef=ComMConfigSet/CN_PCAN_RADAR_458ff0f1, ComIPduGroupRef=RDR01_oPCAN_RADAR_Tx_b6bdb067 if post-build-variant-condition{matching-criterion=RDR_POS, value=0}, ComIPduSignalGroupRef=SG_Detections_081_084_oRDR_DETECTION_081_084_oPCAN_RADAR_0a9e14ed_Tx, ComPduIdRef=EcucPduCollection/RDR_DETECTION_081_084_oPCAN_RADAR_944ab07a_Tx, ComIPduGroupRef=RDR02_oPCAN_RADAR_Tx_9f750495 if post-build-variant-condition{matching-criterion=RDR_POS, value=1}, ComIPduGroupRef=RDR03_oPCAN_RADAR_Tx_311d9504 if post-build-variant-condition{matching-criterion=RDR_POS, value=2}, ComIPduGroupRef=RDR04_oPCAN_RADAR_Tx_cce46d71 if post-build-variant-condition{matching-criterion=RDR_POS, value=3}, ComIPduGroupRef=RDR05_oPCAN_RADAR_Tx_628cfce0 if post-build-variant-condition{matching-criterion=RDR_POS, value=4}, ComIPduGroupRef=RDR06_oPCAN_RADAR_Tx_4b444812 if post-build-variant-condition{matching-criterion=RDR_POS, value=5}, ComIPduGroupRef=RDR07_oPCAN_RADAR_Tx_e52cd983 if post-build-variant-condition{matching-criterion=RDR_POS, value=6}, ComIPduGroupRef=RDR08_oPCAN_RADAR_Tx_6bc6beb9 if post-build-variant-condition{matching-criterion=RDR_POS, value=7}
          ComTxIPdu: ComMinimumDelayTime=0, ComTxIPduUnusedAreasDefault=0
        RDR_DETECTION_085_088_oPCAN_RADAR_7df82e4e_Tx: ComIPduDirection=SEND, ComIPduChannelRef=ComMConfigSet/CN_PCAN_RADAR_458ff0f1, ComIPduGroupRef=RDR01_oPCAN_RADAR_Tx_b6bdb067 if post-build-variant-condition{matching-criterion=RDR_POS, value=0}, ComIPduSignalGroupRef=SG_Detections_085_088_oRDR_DETECTION_085_088_oPCAN_RADAR_7b5d20bf_Tx, ComPduIdRef=EcucPduCollection/RDR_DETECTION_085_088_oPCAN_RADAR_7df82e4e_Tx, ComIPduGroupRef=RDR02_oPCAN_RADAR_Tx_9f750495 if post-build-variant-condition{matching-criterion=RDR_POS, value=1}, ComIPduGroupRef=RDR03_oPCAN_RADAR_Tx_311d9504 if post-build-variant-condition{matching-criterion=RDR_POS, value=2}, ComIPduGroupRef=RDR04_oPCAN_RADAR_Tx_cce46d71 if post-build-variant-condition{matching-criterion=RDR_POS, value=3}, ComIPduGroupRef=RDR05_oPCAN_RADAR_Tx_628cfce0 if post-build-variant-condition{matching-criterion=RDR_POS, value=4}, ComIPduGroupRef=RDR06_oPCAN_RADAR_Tx_4b444812 if post-build-variant-condition{matching-criterion=RDR_POS, value=5}, ComIPduGroupRef=RDR07_oPCAN_RADAR_Tx_e52cd983 if post-build-variant-condition{matching-criterion=RDR_POS, value=6}, ComIPduGroupRef=RDR08_oPCAN_RADAR_Tx_6bc6beb9 if post-build-variant-condition{matching-criterion=RDR_POS, value=7}
          ComTxIPdu: ComMinimumDelayTime=0, ComTxIPduUnusedAreasDefault=0
        RDR_DETECTION_089_092_oPCAN_RADAR_4fb0c14f_Tx: ComIPduDirection=SEND, ComIPduChannelRef=ComMConfigSet/CN_PCAN_RADAR_458ff0f1, ComIPduGroupRef=RDR01_oPCAN_RADAR_Tx_b6bdb067 if post-build-variant-condition{matching-criterion=RDR_POS, value=0}, ComIPduSignalGroupRef=SG_Detections_089_092_oRDR_DETECTION_089_092_oPCAN_RADAR_e22704c4_Tx, ComPduIdRef=EcucPduCollection/RDR_DETECTION_089_092_oPCAN_RADAR_4fb0c14f_Tx, ComIPduGroupRef=RDR02_oPCAN_RADAR_Tx_9f750495 if post-build-variant-condition{matching-criterion=RDR_POS, value=1}, ComIPduGroupRef=RDR03_oPCAN_RADAR_Tx_311d9504 if post-build-variant-condition{matching-criterion=RDR_POS, value=2}, ComIPduGroupRef=RDR04_oPCAN_RADAR_Tx_cce46d71 if post-build-variant-condition{matching-criterion=RDR_POS, value=3}, ComIPduGroupRef=RDR05_oPCAN_RADAR_Tx_628cfce0 if post-build-variant-condition{matching-criterion=RDR_POS, value=4}, ComIPduGroupRef=RDR06_oPCAN_RADAR_Tx_4b444812 if post-build-variant-condition{matching-criterion=RDR_POS, value=5}, ComIPduGroupRef=RDR07_oPCAN_RADAR_Tx_e52cd983 if post-build-variant-condition{matching-criterion=RDR_POS, value=6}, ComIPduGroupRef=RDR08_oPCAN_RADAR_Tx_6bc6beb9 if post-build-variant-condition{matching-criterion=RDR_POS, value=7}
          ComTxIPdu: ComMinimumDelayTime=0, ComTxIPduUnusedAreasDefault=0
        RDR_DETECTION_093_096_oPCAN_RADAR_5277c261_Tx: ComIPduDirection=SEND, ComIPduChannelRef=ComMConfigSet/CN_PCAN_RADAR_458ff0f1, ComIPduGroupRef=RDR01_oPCAN_RADAR_Tx_b6bdb067 if post-build-variant-condition{matching-criterion=RDR_POS, value=0}, ComIPduSignalGroupRef=SG_Detections_093_096_oRDR_DETECTION_093_096_oPCAN_RADAR_d02c6cec_Tx, ComPduIdRef=EcucPduCollection/RDR_DETECTION_093_096_oPCAN_RADAR_5277c261_Tx, ComIPduGroupRef=RDR02_oPCAN_RADAR_Tx_9f750495 if post-build-variant-condition{matching-criterion=RDR_POS, value=1}, ComIPduGroupRef=RDR03_oPCAN_RADAR_Tx_311d9504 if post-build-variant-condition{matching-criterion=RDR_POS, value=2}, ComIPduGroupRef=RDR04_oPCAN_RADAR_Tx_cce46d71 if post-build-variant-condition{matching-criterion=RDR_POS, value=3}, ComIPduGroupRef=RDR05_oPCAN_RADAR_Tx_628cfce0 if post-build-variant-condition{matching-criterion=RDR_POS, value=4}, ComIPduGroupRef=RDR06_oPCAN_RADAR_Tx_4b444812 if post-build-variant-condition{matching-criterion=RDR_POS, value=5}, ComIPduGroupRef=RDR07_oPCAN_RADAR_Tx_e52cd983 if post-build-variant-condition{matching-criterion=RDR_POS, value=6}, ComIPduGroupRef=RDR08_oPCAN_RADAR_Tx_6bc6beb9 if post-build-variant-condition{matching-criterion=RDR_POS, value=7}
          ComTxIPdu: ComMinimumDelayTime=0, ComTxIPduUnusedAreasDefault=0
        RDR_DETECTION_097_100_oPCAN_RADAR_96371edb_Tx: ComIPduDirection=SEND, ComIPduChannelRef=ComMConfigSet/CN_PCAN_RADAR_458ff0f1, ComIPduGroupRef=RDR01_oPCAN_RADAR_Tx_b6bdb067 if post-build-variant-condition{matching-criterion=RDR_POS, value=0}, ComIPduSignalGroupRef=SG_Detections_097_100_oRDR_DETECTION_097_100_oPCAN_RADAR_dcf343f6_Tx, ComPduIdRef=EcucPduCollection/RDR_DETECTION_097_100_oPCAN_RADAR_96371edb_Tx, ComIPduGroupRef=RDR02_oPCAN_RADAR_Tx_9f750495 if post-build-variant-condition{matching-criterion=RDR_POS, value=1}, ComIPduGroupRef=RDR03_oPCAN_RADAR_Tx_311d9504 if post-build-variant-condition{matching-criterion=RDR_POS, value=2}, ComIPduGroupRef=RDR04_oPCAN_RADAR_Tx_cce46d71 if post-build-variant-condition{matching-criterion=RDR_POS, value=3}, ComIPduGroupRef=RDR05_oPCAN_RADAR_Tx_628cfce0 if post-build-variant-condition{matching-criterion=RDR_POS, value=4}, ComIPduGroupRef=RDR06_oPCAN_RADAR_Tx_4b444812 if post-build-variant-condition{matching-criterion=RDR_POS, value=5}, ComIPduGroupRef=RDR07_oPCAN_RADAR_Tx_e52cd983 if post-build-variant-condition{matching-criterion=RDR_POS, value=6}, ComIPduGroupRef=RDR08_oPCAN_RADAR_Tx_6bc6beb9 if post-build-variant-condition{matching-criterion=RDR_POS, value=7}
          ComTxIPdu: ComMinimumDelayTime=0, ComTxIPduUnusedAreasDefault=0
        RDR_DETECTION_101_104_oPCAN_RADAR_de5b5bf0_Tx: ComIPduDirection=SEND, ComIPduChannelRef=ComMConfigSet/CN_PCAN_RADAR_458ff0f1, ComIPduGroupRef=RDR01_oPCAN_RADAR_Tx_b6bdb067 if post-build-variant-condition{matching-criterion=RDR_POS, value=0}, ComIPduSignalGroupRef=SG_Detections_101_104_oRDR_DETECTION_101_104_oPCAN_RADAR_9de0b719_Tx, ComPduIdRef=EcucPduCollection/RDR_DETECTION_101_104_oPCAN_RADAR_de5b5bf0_Tx, ComIPduGroupRef=RDR02_oPCAN_RADAR_Tx_9f750495 if post-build-variant-condition{matching-criterion=RDR_POS, value=1}, ComIPduGroupRef=RDR03_oPCAN_RADAR_Tx_311d9504 if post-build-variant-condition{matching-criterion=RDR_POS, value=2}, ComIPduGroupRef=RDR04_oPCAN_RADAR_Tx_cce46d71 if post-build-variant-condition{matching-criterion=RDR_POS, value=3}, ComIPduGroupRef=RDR05_oPCAN_RADAR_Tx_628cfce0 if post-build-variant-condition{matching-criterion=RDR_POS, value=4}, ComIPduGroupRef=RDR06_oPCAN_RADAR_Tx_4b444812 if post-build-variant-condition{matching-criterion=RDR_POS, value=5}, ComIPduGroupRef=RDR07_oPCAN_RADAR_Tx_e52cd983 if post-build-variant-condition{matching-criterion=RDR_POS, value=6}, ComIPduGroupRef=RDR08_oPCAN_RADAR_Tx_6bc6beb9 if post-build-variant-condition{matching-criterion=RDR_POS, value=7}
          ComTxIPdu: ComMinimumDelayTime=0, ComTxIPduUnusedAreasDefault=0
        RDR_DETECTION_105_108_oPCAN_RADAR_37e9c5c4_Tx: ComIPduDirection=SEND, ComIPduChannelRef=ComMConfigSet/CN_PCAN_RADAR_458ff0f1, ComIPduGroupRef=RDR01_oPCAN_RADAR_Tx_b6bdb067 if post-build-variant-condition{matching-criterion=RDR_POS, value=0}, ComIPduSignalGroupRef=SG_Detections_105_108_oRDR_DETECTION_105_108_oPCAN_RADAR_ec23834b_Tx, ComPduIdRef=EcucPduCollection/RDR_DETECTION_105_108_oPCAN_RADAR_37e9c5c4_Tx, ComIPduGroupRef=RDR02_oPCAN_RADAR_Tx_9f750495 if post-build-variant-condition{matching-criterion=RDR_POS, value=1}, ComIPduGroupRef=RDR03_oPCAN_RADAR_Tx_311d9504 if post-build-variant-condition{matching-criterion=RDR_POS, value=2}, ComIPduGroupRef=RDR04_oPCAN_RADAR_Tx_cce46d71 if post-build-variant-condition{matching-criterion=RDR_POS, value=3}, ComIPduGroupRef=RDR05_oPCAN_RADAR_Tx_628cfce0 if post-build-variant-condition{matching-criterion=RDR_POS, value=4}, ComIPduGroupRef=RDR06_oPCAN_RADAR_Tx_4b444812 if post-build-variant-condition{matching-criterion=RDR_POS, value=5}, ComIPduGroupRef=RDR07_oPCAN_RADAR_Tx_e52cd983 if post-build-variant-condition{matching-criterion=RDR_POS, value=6}, ComIPduGroupRef=RDR08_oPCAN_RADAR_Tx_6bc6beb9 if post-build-variant-condition{matching-criterion=RDR_POS, value=7}
          ComTxIPdu: ComMinimumDelayTime=0, ComTxIPduUnusedAreasDefault=0
        RDR_DETECTION_109_112_oPCAN_RADAR_05a12ac5_Tx: ComIPduDirection=SEND, ComIPduChannelRef=ComMConfigSet/CN_PCAN_RADAR_458ff0f1, ComIPduGroupRef=RDR01_oPCAN_RADAR_Tx_b6bdb067 if post-build-variant-condition{matching-criterion=RDR_POS, value=0}, ComIPduSignalGroupRef=SG_Detections_109_112_oRDR_DETECTION_109_112_oPCAN_RADAR_7559a730_Tx, ComPduIdRef=EcucPduCollection/RDR_DETECTION_109_112_oPCAN_RADAR_05a12ac5_Tx, ComIPduGroupRef=RDR02_oPCAN_RADAR_Tx_9f750495 if post-build-variant-condition{matching-criterion=RDR_POS, value=1}, ComIPduGroupRef=RDR03_oPCAN_RADAR_Tx_311d9504 if post-build-variant-condition{matching-criterion=RDR_POS, value=2}, ComIPduGroupRef=RDR04_oPCAN_RADAR_Tx_cce46d71 if post-build-variant-condition{matching-criterion=RDR_POS, value=3}, ComIPduGroupRef=RDR05_oPCAN_RADAR_Tx_628cfce0 if post-build-variant-condition{matching-criterion=RDR_POS, value=4}, ComIPduGroupRef=RDR06_oPCAN_RADAR_Tx_4b444812 if post-build-variant-condition{matching-criterion=RDR_POS, value=5}, ComIPduGroupRef=RDR07_oPCAN_RADAR_Tx_e52cd983 if post-build-variant-condition{matching-criterion=RDR_POS, value=6}, ComIPduGroupRef=RDR08_oPCAN_RADAR_Tx_6bc6beb9 if post-build-variant-condition{matching-criterion=RDR_POS, value=7}
          ComTxIPdu: ComMinimumDelayTime=0, ComTxIPduUnusedAreasDefault=0
        RDR_DETECTION_113_116_oPCAN_RADAR_186629eb_Tx: ComIPduDirection=SEND, ComIPduChannelRef=ComMConfigSet/CN_PCAN_RADAR_458ff0f1, ComIPduGroupRef=RDR01_oPCAN_RADAR_Tx_b6bdb067 if post-build-variant-condition{matching-criterion=RDR_POS, value=0}, ComIPduSignalGroupRef=SG_Detections_113_116_oRDR_DETECTION_113_116_oPCAN_RADAR_4752cf18_Tx, ComPduIdRef=EcucPduCollection/RDR_DETECTION_113_116_oPCAN_RADAR_186629eb_Tx, ComIPduGroupRef=RDR02_oPCAN_RADAR_Tx_9f750495 if post-build-variant-condition{matching-criterion=RDR_POS, value=1}, ComIPduGroupRef=RDR03_oPCAN_RADAR_Tx_311d9504 if post-build-variant-condition{matching-criterion=RDR_POS, value=2}, ComIPduGroupRef=RDR04_oPCAN_RADAR_Tx_cce46d71 if post-build-variant-condition{matching-criterion=RDR_POS, value=3}, ComIPduGroupRef=RDR05_oPCAN_RADAR_Tx_628cfce0 if post-build-variant-condition{matching-criterion=RDR_POS, value=4}, ComIPduGroupRef=RDR06_oPCAN_RADAR_Tx_4b444812 if post-build-variant-condition{matching-criterion=RDR_POS, value=5}, ComIPduGroupRef=RDR07_oPCAN_RADAR_Tx_e52cd983 if post-build-variant-condition{matching-criterion=RDR_POS, value=6}, ComIPduGroupRef=RDR08_oPCAN_RADAR_Tx_6bc6beb9 if post-build-variant-condition{matching-criterion=RDR_POS, value=7}
          ComTxIPdu: ComMinimumDelayTime=0, ComTxIPduUnusedAreasDefault=0
        RDR_DETECTION_117_120_oPCAN_RADAR_b7eaf422_Tx: ComIPduDirection=SEND, ComIPduChannelRef=ComMConfigSet/CN_PCAN_RADAR_458ff0f1, ComIPduGroupRef=RDR01_oPCAN_RADAR_Tx_b6bdb067 if post-build-variant-condition{matching-criterion=RDR_POS, value=0}, ComIPduSignalGroupRef=SG_Detections_117_120_oRDR_DETECTION_117_120_oPCAN_RADAR_abfe9992_Tx, ComPduIdRef=EcucPduCollection/RDR_DETECTION_117_120_oPCAN_RADAR_b7eaf422_Tx, ComIPduGroupRef=RDR02_oPCAN_RADAR_Tx_9f750495 if post-build-variant-condition{matching-criterion=RDR_POS, value=1}, ComIPduGroupRef=RDR03_oPCAN_RADAR_Tx_311d9504 if post-build-variant-condition{matching-criterion=RDR_POS, value=2}, ComIPduGroupRef=RDR04_oPCAN_RADAR_Tx_cce46d71 if post-build-variant-condition{matching-criterion=RDR_POS, value=3}, ComIPduGroupRef=RDR05_oPCAN_RADAR_Tx_628cfce0 if post-build-variant-condition{matching-criterion=RDR_POS, value=4}, ComIPduGroupRef=RDR06_oPCAN_RADAR_Tx_4b444812 if post-build-variant-condition{matching-criterion=RDR_POS, value=5}, ComIPduGroupRef=RDR07_oPCAN_RADAR_Tx_e52cd983 if post-build-variant-condition{matching-criterion=RDR_POS, value=6}, ComIPduGroupRef=RDR08_oPCAN_RADAR_Tx_6bc6beb9 if post-build-variant-condition{matching-criterion=RDR_POS, value=7}
          ComTxIPdu: ComMinimumDelayTime=0, ComTxIPduUnusedAreasDefault=0
        RDR_DETECTION_121_124_oPCAN_RADAR_3ae1f4de_Tx: ComIPduDirection=SEND, ComIPduChannelRef=ComMConfigSet/CN_PCAN_RADAR_458ff0f1, ComIPduGroupRef=RDR01_oPCAN_RADAR_Tx_b6bdb067 if post-build-variant-condition{matching-criterion=RDR_POS, value=0}, ComIPduSignalGroupRef=SG_Detections_121_124_oRDR_DETECTION_121_124_oPCAN_RADAR_a895174b_Tx, ComPduIdRef=EcucPduCollection/RDR_DETECTION_121_124_oPCAN_RADAR_3ae1f4de_Tx, ComIPduGroupRef=RDR02_oPCAN_RADAR_Tx_9f750495 if post-build-variant-condition{matching-criterion=RDR_POS, value=1}, ComIPduGroupRef=RDR03_oPCAN_RADAR_Tx_311d9504 if post-build-variant-condition{matching-criterion=RDR_POS, value=2}, ComIPduGroupRef=RDR04_oPCAN_RADAR_Tx_cce46d71 if post-build-variant-condition{matching-criterion=RDR_POS, value=3}, ComIPduGroupRef=RDR05_oPCAN_RADAR_Tx_628cfce0 if post-build-variant-condition{matching-criterion=RDR_POS, value=4}, ComIPduGroupRef=RDR06_oPCAN_RADAR_Tx_4b444812 if post-build-variant-condition{matching-criterion=RDR_POS, value=5}, ComIPduGroupRef=RDR07_oPCAN_RADAR_Tx_e52cd983 if post-build-variant-condition{matching-criterion=RDR_POS, value=6}, ComIPduGroupRef=RDR08_oPCAN_RADAR_Tx_6bc6beb9 if post-build-variant-condition{matching-criterion=RDR_POS, value=7}
          ComTxIPdu: ComMinimumDelayTime=0, ComTxIPduUnusedAreasDefault=0
        RDR_DETECTION_125_128_oPCAN_RADAR_d3536aea_Tx: ComIPduDirection=SEND, ComIPduChannelRef=ComMConfigSet/CN_PCAN_RADAR_458ff0f1, ComIPduGroupRef=RDR01_oPCAN_RADAR_Tx_b6bdb067 if post-build-variant-condition{matching-criterion=RDR_POS, value=0}, ComIPduSignalGroupRef=SG_Detections_125_128_oRDR_DETECTION_125_128_oPCAN_RADAR_d9562319_Tx, ComPduIdRef=EcucPduCollection/RDR_DETECTION_125_128_oPCAN_RADAR_d3536aea_Tx, ComIPduGroupRef=RDR02_oPCAN_RADAR_Tx_9f750495 if post-build-variant-condition{matching-criterion=RDR_POS, value=1}, ComIPduGroupRef=RDR03_oPCAN_RADAR_Tx_311d9504 if post-build-variant-condition{matching-criterion=RDR_POS, value=2}, ComIPduGroupRef=RDR04_oPCAN_RADAR_Tx_cce46d71 if post-build-variant-condition{matching-criterion=RDR_POS, value=3}, ComIPduGroupRef=RDR05_oPCAN_RADAR_Tx_628cfce0 if post-build-variant-condition{matching-criterion=RDR_POS, value=4}, ComIPduGroupRef=RDR06_oPCAN_RADAR_Tx_4b444812 if post-build-variant-condition{matching-criterion=RDR_POS, value=5}, ComIPduGroupRef=RDR07_oPCAN_RADAR_Tx_e52cd983 if post-build-variant-condition{matching-criterion=RDR_POS, value=6}, ComIPduGroupRef=RDR08_oPCAN_RADAR_Tx_6bc6beb9 if post-build-variant-condition{matching-criterion=RDR_POS, value=7}
          ComTxIPdu: ComMinimumDelayTime=0, ComTxIPduUnusedAreasDefault=0
        RDR_DETECTION_129_132_oPCAN_RADAR_e11b85eb_Tx: ComIPduDirection=SEND, ComIPduChannelRef=ComMConfigSet/CN_PCAN_RADAR_458ff0f1, ComIPduGroupRef=RDR01_oPCAN_RADAR_Tx_b6bdb067 if post-build-variant-condition{matching-criterion=RDR_POS, value=0}, ComIPduSignalGroupRef=SG_Detections_129_132_oRDR_DETECTION_129_132_oPCAN_RADAR_402c0762_Tx, ComPduIdRef=EcucPduCollection/RDR_DETECTION_129_132_oPCAN_RADAR_e11b85eb_Tx, ComIPduGroupRef=RDR02_oPCAN_RADAR_Tx_9f750495 if post-build-variant-condition{matching-criterion=RDR_POS, value=1}, ComIPduGroupRef=RDR03_oPCAN_RADAR_Tx_311d9504 if post-build-variant-condition{matching-criterion=RDR_POS, value=2}, ComIPduGroupRef=RDR04_oPCAN_RADAR_Tx_cce46d71 if post-build-variant-condition{matching-criterion=RDR_POS, value=3}, ComIPduGroupRef=RDR05_oPCAN_RADAR_Tx_628cfce0 if post-build-variant-condition{matching-criterion=RDR_POS, value=4}, ComIPduGroupRef=RDR06_oPCAN_RADAR_Tx_4b444812 if post-build-variant-condition{matching-criterion=RDR_POS, value=5}, ComIPduGroupRef=RDR07_oPCAN_RADAR_Tx_e52cd983 if post-build-variant-condition{matching-criterion=RDR_POS, value=6}, ComIPduGroupRef=RDR08_oPCAN_RADAR_Tx_6bc6beb9 if post-build-variant-condition{matching-criterion=RDR_POS, value=7}
          ComTxIPdu: ComMinimumDelayTime=0, ComTxIPduUnusedAreasDefault=0
        RDR_DETECTION_133_136_oPCAN_RADAR_fcdc86c5_Tx: ComIPduDirection=SEND, ComIPduChannelRef=ComMConfigSet/CN_PCAN_RADAR_458ff0f1, ComIPduGroupRef=RDR01_oPCAN_RADAR_Tx_b6bdb067 if post-build-variant-condition{matching-criterion=RDR_POS, value=0}, ComIPduSignalGroupRef=SG_Detections_133_136_oRDR_DETECTION_133_136_oPCAN_RADAR_72276f4a_Tx, ComPduIdRef=EcucPduCollection/RDR_DETECTION_133_136_oPCAN_RADAR_fcdc86c5_Tx, ComIPduGroupRef=RDR02_oPCAN_RADAR_Tx_9f750495 if post-build-variant-condition{matching-criterion=RDR_POS, value=1}, ComIPduGroupRef=RDR03_oPCAN_RADAR_Tx_311d9504 if post-build-variant-condition{matching-criterion=RDR_POS, value=2}, ComIPduGroupRef=RDR04_oPCAN_RADAR_Tx_cce46d71 if post-build-variant-condition{matching-criterion=RDR_POS, value=3}, ComIPduGroupRef=RDR05_oPCAN_RADAR_Tx_628cfce0 if post-build-variant-condition{matching-criterion=RDR_POS, value=4}, ComIPduGroupRef=RDR06_oPCAN_RADAR_Tx_4b444812 if post-build-variant-condition{matching-criterion=RDR_POS, value=5}, ComIPduGroupRef=RDR07_oPCAN_RADAR_Tx_e52cd983 if post-build-variant-condition{matching-criterion=RDR_POS, value=6}, ComIPduGroupRef=RDR08_oPCAN_RADAR_Tx_6bc6beb9 if post-build-variant-condition{matching-criterion=RDR_POS, value=7}
          ComTxIPdu: ComMinimumDelayTime=0, ComTxIPduUnusedAreasDefault=0
        RDR_DETECTION_137_140_oPCAN_RADAR_4afcd417_Tx: ComIPduDirection=SEND, ComIPduChannelRef=ComMConfigSet/CN_PCAN_RADAR_458ff0f1, ComIPduGroupRef=RDR01_oPCAN_RADAR_Tx_b6bdb067 if post-build-variant-condition{matching-criterion=RDR_POS, value=0}, ComIPduSignalGroupRef=SG_Detections_137_140_oRDR_DETECTION_137_140_oPCAN_RADAR_e974e064_Tx, ComPduIdRef=EcucPduCollection/RDR_DETECTION_137_140_oPCAN_RADAR_4afcd417_Tx, ComIPduGroupRef=RDR02_oPCAN_RADAR_Tx_9f750495 if post-build-variant-condition{matching-criterion=RDR_POS, value=1}, ComIPduGroupRef=RDR03_oPCAN_RADAR_Tx_311d9504 if post-build-variant-condition{matching-criterion=RDR_POS, value=2}, ComIPduGroupRef=RDR04_oPCAN_RADAR_Tx_cce46d71 if post-build-variant-condition{matching-criterion=RDR_POS, value=3}, ComIPduGroupRef=RDR05_oPCAN_RADAR_Tx_628cfce0 if post-build-variant-condition{matching-criterion=RDR_POS, value=4}, ComIPduGroupRef=RDR06_oPCAN_RADAR_Tx_4b444812 if post-build-variant-condition{matching-criterion=RDR_POS, value=5}, ComIPduGroupRef=RDR07_oPCAN_RADAR_Tx_e52cd983 if post-build-variant-condition{matching-criterion=RDR_POS, value=6}, ComIPduGroupRef=RDR08_oPCAN_RADAR_Tx_6bc6beb9 if post-build-variant-condition{matching-criterion=RDR_POS, value=7}
          ComTxIPdu: ComMinimumDelayTime=0, ComTxIPduUnusedAreasDefault=0
        RDR_DETECTION_141_144_oPCAN_RADAR_cc5f03ed_Tx: ComIPduDirection=SEND, ComIPduChannelRef=ComMConfigSet/CN_PCAN_RADAR_458ff0f1, ComIPduGroupRef=RDR01_oPCAN_RADAR_Tx_b6bdb067 if post-build-variant-condition{matching-criterion=RDR_POS, value=0}, ComIPduSignalGroupRef=SG_Detections_141_144_oRDR_DETECTION_141_144_oPCAN_RADAR_f70bf7bd_Tx, ComPduIdRef=EcucPduCollection/RDR_DETECTION_141_144_oPCAN_RADAR_cc5f03ed_Tx, ComIPduGroupRef=RDR02_oPCAN_RADAR_Tx_9f750495 if post-build-variant-condition{matching-criterion=RDR_POS, value=1}, ComIPduGroupRef=RDR03_oPCAN_RADAR_Tx_311d9504 if post-build-variant-condition{matching-criterion=RDR_POS, value=2}, ComIPduGroupRef=RDR04_oPCAN_RADAR_Tx_cce46d71 if post-build-variant-condition{matching-criterion=RDR_POS, value=3}, ComIPduGroupRef=RDR05_oPCAN_RADAR_Tx_628cfce0 if post-build-variant-condition{matching-criterion=RDR_POS, value=4}, ComIPduGroupRef=RDR06_oPCAN_RADAR_Tx_4b444812 if post-build-variant-condition{matching-criterion=RDR_POS, value=5}, ComIPduGroupRef=RDR07_oPCAN_RADAR_Tx_e52cd983 if post-build-variant-condition{matching-criterion=RDR_POS, value=6}, ComIPduGroupRef=RDR08_oPCAN_RADAR_Tx_6bc6beb9 if post-build-variant-condition{matching-criterion=RDR_POS, value=7}
          ComTxIPdu: ComMinimumDelayTime=0, ComTxIPduUnusedAreasDefault=0
        RDR_DETECTION_145_148_oPCAN_RADAR_25ed9dd9_Tx: ComIPduDirection=SEND, ComIPduChannelRef=ComMConfigSet/CN_PCAN_RADAR_458ff0f1, ComIPduGroupRef=RDR01_oPCAN_RADAR_Tx_b6bdb067 if post-build-variant-condition{matching-criterion=RDR_POS, value=0}, ComIPduSignalGroupRef=SG_Detections_145_148_oRDR_DETECTION_145_148_oPCAN_RADAR_86c8c3ef_Tx, ComPduIdRef=EcucPduCollection/RDR_DETECTION_145_148_oPCAN_RADAR_25ed9dd9_Tx, ComIPduGroupRef=RDR02_oPCAN_RADAR_Tx_9f750495 if post-build-variant-condition{matching-criterion=RDR_POS, value=1}, ComIPduGroupRef=RDR03_oPCAN_RADAR_Tx_311d9504 if post-build-variant-condition{matching-criterion=RDR_POS, value=2}, ComIPduGroupRef=RDR04_oPCAN_RADAR_Tx_cce46d71 if post-build-variant-condition{matching-criterion=RDR_POS, value=3}, ComIPduGroupRef=RDR05_oPCAN_RADAR_Tx_628cfce0 if post-build-variant-condition{matching-criterion=RDR_POS, value=4}, ComIPduGroupRef=RDR06_oPCAN_RADAR_Tx_4b444812 if post-build-variant-condition{matching-criterion=RDR_POS, value=5}, ComIPduGroupRef=RDR07_oPCAN_RADAR_Tx_e52cd983 if post-build-variant-condition{matching-criterion=RDR_POS, value=6}, ComIPduGroupRef=RDR08_oPCAN_RADAR_Tx_6bc6beb9 if post-build-variant-condition{matching-criterion=RDR_POS, value=7}
          ComTxIPdu: ComMinimumDelayTime=0, ComTxIPduUnusedAreasDefault=0
        RDR_DETECTION_149_152_oPCAN_RADAR_17a572d8_Tx: ComIPduDirection=SEND, ComIPduChannelRef=ComMConfigSet/CN_PCAN_RADAR_458ff0f1, ComIPduGroupRef=RDR01_oPCAN_RADAR_Tx_b6bdb067 if post-build-variant-condition{matching-criterion=RDR_POS, value=0}, ComIPduSignalGroupRef=SG_Detections_149_152_oRDR_DETECTION_149_152_oPCAN_RADAR_1fb2e794_Tx, ComPduIdRef=EcucPduCollection/RDR_DETECTION_149_152_oPCAN_RADAR_17a572d8_Tx, ComIPduGroupRef=RDR02_oPCAN_RADAR_Tx_9f750495 if post-build-variant-condition{matching-criterion=RDR_POS, value=1}, ComIPduGroupRef=RDR03_oPCAN_RADAR_Tx_311d9504 if post-build-variant-condition{matching-criterion=RDR_POS, value=2}, ComIPduGroupRef=RDR04_oPCAN_RADAR_Tx_cce46d71 if post-build-variant-condition{matching-criterion=RDR_POS, value=3}, ComIPduGroupRef=RDR05_oPCAN_RADAR_Tx_628cfce0 if post-build-variant-condition{matching-criterion=RDR_POS, value=4}, ComIPduGroupRef=RDR06_oPCAN_RADAR_Tx_4b444812 if post-build-variant-condition{matching-criterion=RDR_POS, value=5}, ComIPduGroupRef=RDR07_oPCAN_RADAR_Tx_e52cd983 if post-build-variant-condition{matching-criterion=RDR_POS, value=6}, ComIPduGroupRef=RDR08_oPCAN_RADAR_Tx_6bc6beb9 if post-build-variant-condition{matching-criterion=RDR_POS, value=7}
          ComTxIPdu: ComMinimumDelayTime=0, ComTxIPduUnusedAreasDefault=0
        RDR_DETECTION_153_156_oPCAN_RADAR_0a6271f6_Tx: ComIPduDirection=SEND, ComIPduChannelRef=ComMConfigSet/CN_PCAN_RADAR_458ff0f1, ComIPduGroupRef=RDR01_oPCAN_RADAR_Tx_b6bdb067 if post-build-variant-condition{matching-criterion=RDR_POS, value=0}, ComIPduSignalGroupRef=SG_Detections_153_156_oRDR_DETECTION_153_156_oPCAN_RADAR_2db98fbc_Tx, ComPduIdRef=EcucPduCollection/RDR_DETECTION_153_156_oPCAN_RADAR_0a6271f6_Tx, ComIPduGroupRef=RDR02_oPCAN_RADAR_Tx_9f750495 if post-build-variant-condition{matching-criterion=RDR_POS, value=1}, ComIPduGroupRef=RDR03_oPCAN_RADAR_Tx_311d9504 if post-build-variant-condition{matching-criterion=RDR_POS, value=2}, ComIPduGroupRef=RDR04_oPCAN_RADAR_Tx_cce46d71 if post-build-variant-condition{matching-criterion=RDR_POS, value=3}, ComIPduGroupRef=RDR05_oPCAN_RADAR_Tx_628cfce0 if post-build-variant-condition{matching-criterion=RDR_POS, value=4}, ComIPduGroupRef=RDR06_oPCAN_RADAR_Tx_4b444812 if post-build-variant-condition{matching-criterion=RDR_POS, value=5}, ComIPduGroupRef=RDR07_oPCAN_RADAR_Tx_e52cd983 if post-build-variant-condition{matching-criterion=RDR_POS, value=6}, ComIPduGroupRef=RDR08_oPCAN_RADAR_Tx_6bc6beb9 if post-build-variant-condition{matching-criterion=RDR_POS, value=7}
          ComTxIPdu: ComMinimumDelayTime=0, ComTxIPduUnusedAreasDefault=0
        RDR_DETECTION_157_160_oPCAN_RADAR_a5eeac3f_Tx: ComIPduDirection=SEND, ComIPduChannelRef=ComMConfigSet/CN_PCAN_RADAR_458ff0f1, ComIPduGroupRef=RDR01_oPCAN_RADAR_Tx_b6bdb067 if post-build-variant-condition{matching-criterion=RDR_POS, value=0}, ComIPduSignalGroupRef=SG_Detections_157_160_oRDR_DETECTION_157_160_oPCAN_RADAR_c115d936_Tx, ComPduIdRef=EcucPduCollection/RDR_DETECTION_157_160_oPCAN_RADAR_a5eeac3f_Tx, ComIPduGroupRef=RDR02_oPCAN_RADAR_Tx_9f750495 if post-build-variant-condition{matching-criterion=RDR_POS, value=1}, ComIPduGroupRef=RDR03_oPCAN_RADAR_Tx_311d9504 if post-build-variant-condition{matching-criterion=RDR_POS, value=2}, ComIPduGroupRef=RDR04_oPCAN_RADAR_Tx_cce46d71 if post-build-variant-condition{matching-criterion=RDR_POS, value=3}, ComIPduGroupRef=RDR05_oPCAN_RADAR_Tx_628cfce0 if post-build-variant-condition{matching-criterion=RDR_POS, value=4}, ComIPduGroupRef=RDR06_oPCAN_RADAR_Tx_4b444812 if post-build-variant-condition{matching-criterion=RDR_POS, value=5}, ComIPduGroupRef=RDR07_oPCAN_RADAR_Tx_e52cd983 if post-build-variant-condition{matching-criterion=RDR_POS, value=6}, ComIPduGroupRef=RDR08_oPCAN_RADAR_Tx_6bc6beb9 if post-build-variant-condition{matching-criterion=RDR_POS, value=7}
          ComTxIPdu: ComMinimumDelayTime=0, ComTxIPduUnusedAreasDefault=0
        RDR_DETECTION_161_164_oPCAN_RADAR_28e5acc3_Tx: ComIPduDirection=SEND, ComIPduChannelRef=ComMConfigSet/CN_PCAN_RADAR_458ff0f1, ComIPduGroupRef=RDR01_oPCAN_RADAR_Tx_b6bdb067 if post-build-variant-condition{matching-criterion=RDR_POS, value=0}, ComIPduSignalGroupRef=SG_Detections_161_164_oRDR_DETECTION_161_164_oPCAN_RADAR_c27e57ef_Tx, ComPduIdRef=EcucPduCollection/RDR_DETECTION_161_164_oPCAN_RADAR_28e5acc3_Tx, ComIPduGroupRef=RDR02_oPCAN_RADAR_Tx_9f750495 if post-build-variant-condition{matching-criterion=RDR_POS, value=1}, ComIPduGroupRef=RDR03_oPCAN_RADAR_Tx_311d9504 if post-build-variant-condition{matching-criterion=RDR_POS, value=2}, ComIPduGroupRef=RDR04_oPCAN_RADAR_Tx_cce46d71 if post-build-variant-condition{matching-criterion=RDR_POS, value=3}, ComIPduGroupRef=RDR05_oPCAN_RADAR_Tx_628cfce0 if post-build-variant-condition{matching-criterion=RDR_POS, value=4}, ComIPduGroupRef=RDR06_oPCAN_RADAR_Tx_4b444812 if post-build-variant-condition{matching-criterion=RDR_POS, value=5}, ComIPduGroupRef=RDR07_oPCAN_RADAR_Tx_e52cd983 if post-build-variant-condition{matching-criterion=RDR_POS, value=6}, ComIPduGroupRef=RDR08_oPCAN_RADAR_Tx_6bc6beb9 if post-build-variant-condition{matching-criterion=RDR_POS, value=7}
          ComTxIPdu: ComMinimumDelayTime=0, ComTxIPduUnusedAreasDefault=0
        RDR_DETECTION_165_168_oPCAN_RADAR_c15732f7_Tx: ComIPduDirection=SEND, ComIPduChannelRef=ComMConfigSet/CN_PCAN_RADAR_458ff0f1, ComIPduGroupRef=RDR01_oPCAN_RADAR_Tx_b6bdb067 if post-build-variant-condition{matching-criterion=RDR_POS, value=0}, ComIPduSignalGroupRef=SG_Detections_165_168_oRDR_DETECTION_165_168_oPCAN_RADAR_b3bd63bd_Tx, ComPduIdRef=EcucPduCollection/RDR_DETECTION_165_168_oPCAN_RADAR_c15732f7_Tx, ComIPduGroupRef=RDR02_oPCAN_RADAR_Tx_9f750495 if post-build-variant-condition{matching-criterion=RDR_POS, value=1}, ComIPduGroupRef=RDR03_oPCAN_RADAR_Tx_311d9504 if post-build-variant-condition{matching-criterion=RDR_POS, value=2}, ComIPduGroupRef=RDR04_oPCAN_RADAR_Tx_cce46d71 if post-build-variant-condition{matching-criterion=RDR_POS, value=3}, ComIPduGroupRef=RDR05_oPCAN_RADAR_Tx_628cfce0 if post-build-variant-condition{matching-criterion=RDR_POS, value=4}, ComIPduGroupRef=RDR06_oPCAN_RADAR_Tx_4b444812 if post-build-variant-condition{matching-criterion=RDR_POS, value=5}, ComIPduGroupRef=RDR07_oPCAN_RADAR_Tx_e52cd983 if post-build-variant-condition{matching-criterion=RDR_POS, value=6}, ComIPduGroupRef=RDR08_oPCAN_RADAR_Tx_6bc6beb9 if post-build-variant-condition{matching-criterion=RDR_POS, value=7}
          ComTxIPdu: ComMinimumDelayTime=0, ComTxIPduUnusedAreasDefault=0
        RDR_DETECTION_169_172_oPCAN_RADAR_f31fddf6_Tx: ComIPduDirection=SEND, ComIPduChannelRef=ComMConfigSet/CN_PCAN_RADAR_458ff0f1, ComIPduGroupRef=RDR01_oPCAN_RADAR_Tx_b6bdb067 if post-build-variant-condition{matching-criterion=RDR_POS, value=0}, ComIPduSignalGroupRef=SG_Detections_169_172_oRDR_DETECTION_169_172_oPCAN_RADAR_2ac747c6_Tx, ComPduIdRef=EcucPduCollection/RDR_DETECTION_169_172_oPCAN_RADAR_f31fddf6_Tx, ComIPduGroupRef=RDR02_oPCAN_RADAR_Tx_9f750495 if post-build-variant-condition{matching-criterion=RDR_POS, value=1}, ComIPduGroupRef=RDR03_oPCAN_RADAR_Tx_311d9504 if post-build-variant-condition{matching-criterion=RDR_POS, value=2}, ComIPduGroupRef=RDR04_oPCAN_RADAR_Tx_cce46d71 if post-build-variant-condition{matching-criterion=RDR_POS, value=3}, ComIPduGroupRef=RDR05_oPCAN_RADAR_Tx_628cfce0 if post-build-variant-condition{matching-criterion=RDR_POS, value=4}, ComIPduGroupRef=RDR06_oPCAN_RADAR_Tx_4b444812 if post-build-variant-condition{matching-criterion=RDR_POS, value=5}, ComIPduGroupRef=RDR07_oPCAN_RADAR_Tx_e52cd983 if post-build-variant-condition{matching-criterion=RDR_POS, value=6}, ComIPduGroupRef=RDR08_oPCAN_RADAR_Tx_6bc6beb9 if post-build-variant-condition{matching-criterion=RDR_POS, value=7}
          ComTxIPdu: ComMinimumDelayTime=0, ComTxIPduUnusedAreasDefault=0
        RDR_DETECTION_173_176_oPCAN_RADAR_eed8ded8_Tx: ComIPduDirection=SEND, ComIPduChannelRef=ComMConfigSet/CN_PCAN_RADAR_458ff0f1, ComIPduGroupRef=RDR01_oPCAN_RADAR_Tx_b6bdb067 if post-build-variant-condition{matching-criterion=RDR_POS, value=0}, ComIPduSignalGroupRef=SG_Detections_173_176_oRDR_DETECTION_173_176_oPCAN_RADAR_18cc2fee_Tx, ComPduIdRef=EcucPduCollection/RDR_DETECTION_173_176_oPCAN_RADAR_eed8ded8_Tx, ComIPduGroupRef=RDR02_oPCAN_RADAR_Tx_9f750495 if post-build-variant-condition{matching-criterion=RDR_POS, value=1}, ComIPduGroupRef=RDR03_oPCAN_RADAR_Tx_311d9504 if post-build-variant-condition{matching-criterion=RDR_POS, value=2}, ComIPduGroupRef=RDR04_oPCAN_RADAR_Tx_cce46d71 if post-build-variant-condition{matching-criterion=RDR_POS, value=3}, ComIPduGroupRef=RDR05_oPCAN_RADAR_Tx_628cfce0 if post-build-variant-condition{matching-criterion=RDR_POS, value=4}, ComIPduGroupRef=RDR06_oPCAN_RADAR_Tx_4b444812 if post-build-variant-condition{matching-criterion=RDR_POS, value=5}, ComIPduGroupRef=RDR07_oPCAN_RADAR_Tx_e52cd983 if post-build-variant-condition{matching-criterion=RDR_POS, value=6}, ComIPduGroupRef=RDR08_oPCAN_RADAR_Tx_6bc6beb9 if post-build-variant-condition{matching-criterion=RDR_POS, value=7}
          ComTxIPdu: ComMinimumDelayTime=0, ComTxIPduUnusedAreasDefault=0
        RDR_DETECTION_177_180_oPCAN_RADAR_6ba1923c_Tx: ComIPduDirection=SEND, ComIPduChannelRef=ComMConfigSet/CN_PCAN_RADAR_458ff0f1, ComIPduGroupRef=RDR01_oPCAN_RADAR_Tx_b6bdb067 if post-build-variant-condition{matching-criterion=RDR_POS, value=0}, ComIPduSignalGroupRef=SG_Detections_177_180_oRDR_DETECTION_177_180_oPCAN_RADAR_6c601388_Tx, ComPduIdRef=EcucPduCollection/RDR_DETECTION_177_180_oPCAN_RADAR_6ba1923c_Tx, ComIPduGroupRef=RDR02_oPCAN_RADAR_Tx_9f750495 if post-build-variant-condition{matching-criterion=RDR_POS, value=1}, ComIPduGroupRef=RDR03_oPCAN_RADAR_Tx_311d9504 if post-build-variant-condition{matching-criterion=RDR_POS, value=2}, ComIPduGroupRef=RDR04_oPCAN_RADAR_Tx_cce46d71 if post-build-variant-condition{matching-criterion=RDR_POS, value=3}, ComIPduGroupRef=RDR05_oPCAN_RADAR_Tx_628cfce0 if post-build-variant-condition{matching-criterion=RDR_POS, value=4}, ComIPduGroupRef=RDR06_oPCAN_RADAR_Tx_4b444812 if post-build-variant-condition{matching-criterion=RDR_POS, value=5}, ComIPduGroupRef=RDR07_oPCAN_RADAR_Tx_e52cd983 if post-build-variant-condition{matching-criterion=RDR_POS, value=6}, ComIPduGroupRef=RDR08_oPCAN_RADAR_Tx_6bc6beb9 if post-build-variant-condition{matching-criterion=RDR_POS, value=7}
          ComTxIPdu: ComMinimumDelayTime=0, ComTxIPduUnusedAreasDefault=0
        RDR_DETECTION_181_184_oPCAN_RADAR_fa53ebca_Tx: ComIPduDirection=SEND, ComIPduChannelRef=ComMConfigSet/CN_PCAN_RADAR_458ff0f1, ComIPduGroupRef=RDR01_oPCAN_RADAR_Tx_b6bdb067 if post-build-variant-condition{matching-criterion=RDR_POS, value=0}, ComIPduSignalGroupRef=SG_Detections_181_184_oRDR_DETECTION_181_184_oPCAN_RADAR_48363651_Tx, ComPduIdRef=EcucPduCollection/RDR_DETECTION_181_184_oPCAN_RADAR_fa53ebca_Tx, ComIPduGroupRef=RDR02_oPCAN_RADAR_Tx_9f750495 if post-build-variant-condition{matching-criterion=RDR_POS, value=1}, ComIPduGroupRef=RDR03_oPCAN_RADAR_Tx_311d9504 if post-build-variant-condition{matching-criterion=RDR_POS, value=2}, ComIPduGroupRef=RDR04_oPCAN_RADAR_Tx_cce46d71 if post-build-variant-condition{matching-criterion=RDR_POS, value=3}, ComIPduGroupRef=RDR05_oPCAN_RADAR_Tx_628cfce0 if post-build-variant-condition{matching-criterion=RDR_POS, value=4}, ComIPduGroupRef=RDR06_oPCAN_RADAR_Tx_4b444812 if post-build-variant-condition{matching-criterion=RDR_POS, value=5}, ComIPduGroupRef=RDR07_oPCAN_RADAR_Tx_e52cd983 if post-build-variant-condition{matching-criterion=RDR_POS, value=6}, ComIPduGroupRef=RDR08_oPCAN_RADAR_Tx_6bc6beb9 if post-build-variant-condition{matching-criterion=RDR_POS, value=7}
          ComTxIPdu: ComMinimumDelayTime=0, ComTxIPduUnusedAreasDefault=0
        RDR_DETECTION_185_188_oPCAN_RADAR_13e175fe_Tx: ComIPduDirection=SEND, ComIPduChannelRef=ComMConfigSet/CN_PCAN_RADAR_458ff0f1, ComIPduGroupRef=RDR01_oPCAN_RADAR_Tx_b6bdb067 if post-build-variant-condition{matching-criterion=RDR_POS, value=0}, ComIPduSignalGroupRef=SG_Detections_185_188_oRDR_DETECTION_185_188_oPCAN_RADAR_39f50203_Tx, ComPduIdRef=EcucPduCollection/RDR_DETECTION_185_188_oPCAN_RADAR_13e175fe_Tx, ComIPduGroupRef=RDR02_oPCAN_RADAR_Tx_9f750495 if post-build-variant-condition{matching-criterion=RDR_POS, value=1}, ComIPduGroupRef=RDR03_oPCAN_RADAR_Tx_311d9504 if post-build-variant-condition{matching-criterion=RDR_POS, value=2}, ComIPduGroupRef=RDR04_oPCAN_RADAR_Tx_cce46d71 if post-build-variant-condition{matching-criterion=RDR_POS, value=3}, ComIPduGroupRef=RDR05_oPCAN_RADAR_Tx_628cfce0 if post-build-variant-condition{matching-criterion=RDR_POS, value=4}, ComIPduGroupRef=RDR06_oPCAN_RADAR_Tx_4b444812 if post-build-variant-condition{matching-criterion=RDR_POS, value=5}, ComIPduGroupRef=RDR07_oPCAN_RADAR_Tx_e52cd983 if post-build-variant-condition{matching-criterion=RDR_POS, value=6}, ComIPduGroupRef=RDR08_oPCAN_RADAR_Tx_6bc6beb9 if post-build-variant-condition{matching-criterion=RDR_POS, value=7}
          ComTxIPdu: ComMinimumDelayTime=0, ComTxIPduUnusedAreasDefault=0
        RDR_DETECTION_189_192_oPCAN_RADAR_21a99aff_Tx: ComIPduDirection=SEND, ComIPduChannelRef=ComMConfigSet/CN_PCAN_RADAR_458ff0f1, ComIPduGroupRef=RDR01_oPCAN_RADAR_Tx_b6bdb067 if post-build-variant-condition{matching-criterion=RDR_POS, value=0}, ComIPduSignalGroupRef=SG_Detections_189_192_oRDR_DETECTION_189_192_oPCAN_RADAR_a08f2678_Tx, ComPduIdRef=EcucPduCollection/RDR_DETECTION_189_192_oPCAN_RADAR_21a99aff_Tx, ComIPduGroupRef=RDR02_oPCAN_RADAR_Tx_9f750495 if post-build-variant-condition{matching-criterion=RDR_POS, value=1}, ComIPduGroupRef=RDR03_oPCAN_RADAR_Tx_311d9504 if post-build-variant-condition{matching-criterion=RDR_POS, value=2}, ComIPduGroupRef=RDR04_oPCAN_RADAR_Tx_cce46d71 if post-build-variant-condition{matching-criterion=RDR_POS, value=3}, ComIPduGroupRef=RDR05_oPCAN_RADAR_Tx_628cfce0 if post-build-variant-condition{matching-criterion=RDR_POS, value=4}, ComIPduGroupRef=RDR06_oPCAN_RADAR_Tx_4b444812 if post-build-variant-condition{matching-criterion=RDR_POS, value=5}, ComIPduGroupRef=RDR07_oPCAN_RADAR_Tx_e52cd983 if post-build-variant-condition{matching-criterion=RDR_POS, value=6}, ComIPduGroupRef=RDR08_oPCAN_RADAR_Tx_6bc6beb9 if post-build-variant-condition{matching-criterion=RDR_POS, value=7}
          ComTxIPdu: ComMinimumDelayTime=0, ComTxIPduUnusedAreasDefault=0
        RDR_DETECTION_193_196_oPCAN_RADAR_3c6e99d1_Tx: ComIPduDirection=SEND, ComIPduChannelRef=ComMConfigSet/CN_PCAN_RADAR_458ff0f1, ComIPduGroupRef=RDR01_oPCAN_RADAR_Tx_b6bdb067 if post-build-variant-condition{matching-criterion=RDR_POS, value=0}, ComIPduSignalGroupRef=SG_Detections_193_196_oRDR_DETECTION_193_196_oPCAN_RADAR_92844e50_Tx, ComPduIdRef=EcucPduCollection/RDR_DETECTION_193_196_oPCAN_RADAR_3c6e99d1_Tx, ComIPduGroupRef=RDR02_oPCAN_RADAR_Tx_9f750495 if post-build-variant-condition{matching-criterion=RDR_POS, value=1}, ComIPduGroupRef=RDR03_oPCAN_RADAR_Tx_311d9504 if post-build-variant-condition{matching-criterion=RDR_POS, value=2}, ComIPduGroupRef=RDR04_oPCAN_RADAR_Tx_cce46d71 if post-build-variant-condition{matching-criterion=RDR_POS, value=3}, ComIPduGroupRef=RDR05_oPCAN_RADAR_Tx_628cfce0 if post-build-variant-condition{matching-criterion=RDR_POS, value=4}, ComIPduGroupRef=RDR06_oPCAN_RADAR_Tx_4b444812 if post-build-variant-condition{matching-criterion=RDR_POS, value=5}, ComIPduGroupRef=RDR07_oPCAN_RADAR_Tx_e52cd983 if post-build-variant-condition{matching-criterion=RDR_POS, value=6}, ComIPduGroupRef=RDR08_oPCAN_RADAR_Tx_6bc6beb9 if post-build-variant-condition{matching-criterion=RDR_POS, value=7}
          ComTxIPdu: ComMinimumDelayTime=0, ComTxIPduUnusedAreasDefault=0
        RDR_DETECTION_197_200_oPCAN_RADAR_50a8f4fa_Tx: ComIPduDirection=SEND, ComIPduChannelRef=ComMConfigSet/CN_PCAN_RADAR_458ff0f1, ComIPduGroupRef=RDR01_oPCAN_RADAR_Tx_b6bdb067 if post-build-variant-condition{matching-criterion=RDR_POS, value=0}, ComIPduSignalGroupRef=SG_Detections_197_200_oRDR_DETECTION_197_200_oPCAN_RADAR_f6bd2d5e_Tx, ComPduIdRef=EcucPduCollection/RDR_DETECTION_197_200_oPCAN_RADAR_50a8f4fa_Tx, ComIPduGroupRef=RDR02_oPCAN_RADAR_Tx_9f750495 if post-build-variant-condition{matching-criterion=RDR_POS, value=1}, ComIPduGroupRef=RDR03_oPCAN_RADAR_Tx_311d9504 if post-build-variant-condition{matching-criterion=RDR_POS, value=2}, ComIPduGroupRef=RDR04_oPCAN_RADAR_Tx_cce46d71 if post-build-variant-condition{matching-criterion=RDR_POS, value=3}, ComIPduGroupRef=RDR05_oPCAN_RADAR_Tx_628cfce0 if post-build-variant-condition{matching-criterion=RDR_POS, value=4}, ComIPduGroupRef=RDR06_oPCAN_RADAR_Tx_4b444812 if post-build-variant-condition{matching-criterion=RDR_POS, value=5}, ComIPduGroupRef=RDR07_oPCAN_RADAR_Tx_e52cd983 if post-build-variant-condition{matching-criterion=RDR_POS, value=6}, ComIPduGroupRef=RDR08_oPCAN_RADAR_Tx_6bc6beb9 if post-build-variant-condition{matching-criterion=RDR_POS, value=7}
          ComTxIPdu: ComMinimumDelayTime=0, ComTxIPduUnusedAreasDefault=0
        RDR_DETECTION_201_204_oPCAN_RADAR_6c70b720_Tx: ComIPduDirection=SEND, ComIPduChannelRef=ComMConfigSet/CN_PCAN_RADAR_458ff0f1, ComIPduGroupRef=RDR01_oPCAN_RADAR_Tx_b6bdb067 if post-build-variant-condition{matching-criterion=RDR_POS, value=0}, ComIPduSignalGroupRef=SG_Detections_201_204_oRDR_DETECTION_201_204_oPCAN_RADAR_5a18d0dd_Tx, ComPduIdRef=EcucPduCollection/RDR_DETECTION_201_204_oPCAN_RADAR_6c70b720_Tx, ComIPduGroupRef=RDR02_oPCAN_RADAR_Tx_9f750495 if post-build-variant-condition{matching-criterion=RDR_POS, value=1}, ComIPduGroupRef=RDR03_oPCAN_RADAR_Tx_311d9504 if post-build-variant-condition{matching-criterion=RDR_POS, value=2}, ComIPduGroupRef=RDR04_oPCAN_RADAR_Tx_cce46d71 if post-build-variant-condition{matching-criterion=RDR_POS, value=3}, ComIPduGroupRef=RDR05_oPCAN_RADAR_Tx_628cfce0 if post-build-variant-condition{matching-criterion=RDR_POS, value=4}, ComIPduGroupRef=RDR06_oPCAN_RADAR_Tx_4b444812 if post-build-variant-condition{matching-criterion=RDR_POS, value=5}, ComIPduGroupRef=RDR07_oPCAN_RADAR_Tx_e52cd983 if post-build-variant-condition{matching-criterion=RDR_POS, value=6}, ComIPduGroupRef=RDR08_oPCAN_RADAR_Tx_6bc6beb9 if post-build-variant-condition{matching-criterion=RDR_POS, value=7}
          ComTxIPdu: ComMinimumDelayTime=0, ComTxIPduUnusedAreasDefault=0
        RDR_DETECTION_205_208_oPCAN_RADAR_85c22914_Tx: ComIPduDirection=SEND, ComIPduChannelRef=ComMConfigSet/CN_PCAN_RADAR_458ff0f1, ComIPduGroupRef=RDR01_oPCAN_RADAR_Tx_b6bdb067 if post-build-variant-condition{matching-criterion=RDR_POS, value=0}, ComIPduSignalGroupRef=SG_Detections_205_208_oRDR_DETECTION_205_208_oPCAN_RADAR_2bdbe48f_Tx, ComPduIdRef=EcucPduCollection/RDR_DETECTION_205_208_oPCAN_RADAR_85c22914_Tx, ComIPduGroupRef=RDR02_oPCAN_RADAR_Tx_9f750495 if post-build-variant-condition{matching-criterion=RDR_POS, value=1}, ComIPduGroupRef=RDR03_oPCAN_RADAR_Tx_311d9504 if post-build-variant-condition{matching-criterion=RDR_POS, value=2}, ComIPduGroupRef=RDR04_oPCAN_RADAR_Tx_cce46d71 if post-build-variant-condition{matching-criterion=RDR_POS, value=3}, ComIPduGroupRef=RDR05_oPCAN_RADAR_Tx_628cfce0 if post-build-variant-condition{matching-criterion=RDR_POS, value=4}, ComIPduGroupRef=RDR06_oPCAN_RADAR_Tx_4b444812 if post-build-variant-condition{matching-criterion=RDR_POS, value=5}, ComIPduGroupRef=RDR07_oPCAN_RADAR_Tx_e52cd983 if post-build-variant-condition{matching-criterion=RDR_POS, value=6}, ComIPduGroupRef=RDR08_oPCAN_RADAR_Tx_6bc6beb9 if post-build-variant-condition{matching-criterion=RDR_POS, value=7}
          ComTxIPdu: ComMinimumDelayTime=0, ComTxIPduUnusedAreasDefault=0
        RDR_DETECTION_209_212_oPCAN_RADAR_b78ac615_Tx: ComIPduDirection=SEND, ComIPduChannelRef=ComMConfigSet/CN_PCAN_RADAR_458ff0f1, ComIPduGroupRef=RDR01_oPCAN_RADAR_Tx_b6bdb067 if post-build-variant-condition{matching-criterion=RDR_POS, value=0}, ComIPduSignalGroupRef=SG_Detections_209_212_oRDR_DETECTION_209_212_oPCAN_RADAR_b2a1c0f4_Tx, ComPduIdRef=EcucPduCollection/RDR_DETECTION_209_212_oPCAN_RADAR_b78ac615_Tx, ComIPduGroupRef=RDR02_oPCAN_RADAR_Tx_9f750495 if post-build-variant-condition{matching-criterion=RDR_POS, value=1}, ComIPduGroupRef=RDR03_oPCAN_RADAR_Tx_311d9504 if post-build-variant-condition{matching-criterion=RDR_POS, value=2}, ComIPduGroupRef=RDR04_oPCAN_RADAR_Tx_cce46d71 if post-build-variant-condition{matching-criterion=RDR_POS, value=3}, ComIPduGroupRef=RDR05_oPCAN_RADAR_Tx_628cfce0 if post-build-variant-condition{matching-criterion=RDR_POS, value=4}, ComIPduGroupRef=RDR06_oPCAN_RADAR_Tx_4b444812 if post-build-variant-condition{matching-criterion=RDR_POS, value=5}, ComIPduGroupRef=RDR07_oPCAN_RADAR_Tx_e52cd983 if post-build-variant-condition{matching-criterion=RDR_POS, value=6}, ComIPduGroupRef=RDR08_oPCAN_RADAR_Tx_6bc6beb9 if post-build-variant-condition{matching-criterion=RDR_POS, value=7}
          ComTxIPdu: ComMinimumDelayTime=0, ComTxIPduUnusedAreasDefault=0
        RDR_DETECTION_213_216_oPCAN_RADAR_aa4dc53b_Tx: ComIPduDirection=SEND, ComIPduChannelRef=ComMConfigSet/CN_PCAN_RADAR_458ff0f1, ComIPduGroupRef=RDR01_oPCAN_RADAR_Tx_b6bdb067 if post-build-variant-condition{matching-criterion=RDR_POS, value=0}, ComIPduSignalGroupRef=SG_Detections_213_216_oRDR_DETECTION_213_216_oPCAN_RADAR_80aaa8dc_Tx, ComPduIdRef=EcucPduCollection/RDR_DETECTION_213_216_oPCAN_RADAR_aa4dc53b_Tx, ComIPduGroupRef=RDR02_oPCAN_RADAR_Tx_9f750495 if post-build-variant-condition{matching-criterion=RDR_POS, value=1}, ComIPduGroupRef=RDR03_oPCAN_RADAR_Tx_311d9504 if post-build-variant-condition{matching-criterion=RDR_POS, value=2}, ComIPduGroupRef=RDR04_oPCAN_RADAR_Tx_cce46d71 if post-build-variant-condition{matching-criterion=RDR_POS, value=3}, ComIPduGroupRef=RDR05_oPCAN_RADAR_Tx_628cfce0 if post-build-variant-condition{matching-criterion=RDR_POS, value=4}, ComIPduGroupRef=RDR06_oPCAN_RADAR_Tx_4b444812 if post-build-variant-condition{matching-criterion=RDR_POS, value=5}, ComIPduGroupRef=RDR07_oPCAN_RADAR_Tx_e52cd983 if post-build-variant-condition{matching-criterion=RDR_POS, value=6}, ComIPduGroupRef=RDR08_oPCAN_RADAR_Tx_6bc6beb9 if post-build-variant-condition{matching-criterion=RDR_POS, value=7}
          ComTxIPdu: ComMinimumDelayTime=0, ComTxIPduUnusedAreasDefault=0
        RDR_DETECTION_217_220_oPCAN_RADAR_05c118f2_Tx: ComIPduDirection=SEND, ComIPduChannelRef=ComMConfigSet/CN_PCAN_RADAR_458ff0f1, ComIPduGroupRef=RDR01_oPCAN_RADAR_Tx_b6bdb067 if post-build-variant-condition{matching-criterion=RDR_POS, value=0}, ComIPduSignalGroupRef=SG_Detections_217_220_oRDR_DETECTION_217_220_oPCAN_RADAR_6c06fe56_Tx, ComPduIdRef=EcucPduCollection/RDR_DETECTION_217_220_oPCAN_RADAR_05c118f2_Tx, ComIPduGroupRef=RDR02_oPCAN_RADAR_Tx_9f750495 if post-build-variant-condition{matching-criterion=RDR_POS, value=1}, ComIPduGroupRef=RDR03_oPCAN_RADAR_Tx_311d9504 if post-build-variant-condition{matching-criterion=RDR_POS, value=2}, ComIPduGroupRef=RDR04_oPCAN_RADAR_Tx_cce46d71 if post-build-variant-condition{matching-criterion=RDR_POS, value=3}, ComIPduGroupRef=RDR05_oPCAN_RADAR_Tx_628cfce0 if post-build-variant-condition{matching-criterion=RDR_POS, value=4}, ComIPduGroupRef=RDR06_oPCAN_RADAR_Tx_4b444812 if post-build-variant-condition{matching-criterion=RDR_POS, value=5}, ComIPduGroupRef=RDR07_oPCAN_RADAR_Tx_e52cd983 if post-build-variant-condition{matching-criterion=RDR_POS, value=6}, ComIPduGroupRef=RDR08_oPCAN_RADAR_Tx_6bc6beb9 if post-build-variant-condition{matching-criterion=RDR_POS, value=7}
          ComTxIPdu: ComMinimumDelayTime=0, ComTxIPduUnusedAreasDefault=0
        RDR_DETECTION_221_224_oPCAN_RADAR_88ca180e_Tx: ComIPduDirection=SEND, ComIPduChannelRef=ComMConfigSet/CN_PCAN_RADAR_458ff0f1, ComIPduGroupRef=RDR01_oPCAN_RADAR_Tx_b6bdb067 if post-build-variant-condition{matching-criterion=RDR_POS, value=0}, ComIPduSignalGroupRef=SG_Detections_221_224_oRDR_DETECTION_221_224_oPCAN_RADAR_6f6d708f_Tx, ComPduIdRef=EcucPduCollection/RDR_DETECTION_221_224_oPCAN_RADAR_88ca180e_Tx, ComIPduGroupRef=RDR02_oPCAN_RADAR_Tx_9f750495 if post-build-variant-condition{matching-criterion=RDR_POS, value=1}, ComIPduGroupRef=RDR03_oPCAN_RADAR_Tx_311d9504 if post-build-variant-condition{matching-criterion=RDR_POS, value=2}, ComIPduGroupRef=RDR04_oPCAN_RADAR_Tx_cce46d71 if post-build-variant-condition{matching-criterion=RDR_POS, value=3}, ComIPduGroupRef=RDR05_oPCAN_RADAR_Tx_628cfce0 if post-build-variant-condition{matching-criterion=RDR_POS, value=4}, ComIPduGroupRef=RDR06_oPCAN_RADAR_Tx_4b444812 if post-build-variant-condition{matching-criterion=RDR_POS, value=5}, ComIPduGroupRef=RDR07_oPCAN_RADAR_Tx_e52cd983 if post-build-variant-condition{matching-criterion=RDR_POS, value=6}, ComIPduGroupRef=RDR08_oPCAN_RADAR_Tx_6bc6beb9 if post-build-variant-condition{matching-criterion=RDR_POS, value=7}
          ComTxIPdu: ComMinimumDelayTime=0, ComTxIPduUnusedAreasDefault=0
        RDR_DETECTION_225_228_oPCAN_RADAR_6178863a_Tx: ComIPduDirection=SEND, ComIPduChannelRef=ComMConfigSet/CN_PCAN_RADAR_458ff0f1, ComIPduGroupRef=RDR01_oPCAN_RADAR_Tx_b6bdb067 if post-build-variant-condition{matching-criterion=RDR_POS, value=0}, ComIPduSignalGroupRef=SG_Detections_225_228_oRDR_DETECTION_225_228_oPCAN_RADAR_1eae44dd_Tx, ComPduIdRef=EcucPduCollection/RDR_DETECTION_225_228_oPCAN_RADAR_6178863a_Tx, ComIPduGroupRef=RDR02_oPCAN_RADAR_Tx_9f750495 if post-build-variant-condition{matching-criterion=RDR_POS, value=1}, ComIPduGroupRef=RDR03_oPCAN_RADAR_Tx_311d9504 if post-build-variant-condition{matching-criterion=RDR_POS, value=2}, ComIPduGroupRef=RDR04_oPCAN_RADAR_Tx_cce46d71 if post-build-variant-condition{matching-criterion=RDR_POS, value=3}, ComIPduGroupRef=RDR05_oPCAN_RADAR_Tx_628cfce0 if post-build-variant-condition{matching-criterion=RDR_POS, value=4}, ComIPduGroupRef=RDR06_oPCAN_RADAR_Tx_4b444812 if post-build-variant-condition{matching-criterion=RDR_POS, value=5}, ComIPduGroupRef=RDR07_oPCAN_RADAR_Tx_e52cd983 if post-build-variant-condition{matching-criterion=RDR_POS, value=6}, ComIPduGroupRef=RDR08_oPCAN_RADAR_Tx_6bc6beb9 if post-build-variant-condition{matching-criterion=RDR_POS, value=7}
          ComTxIPdu: ComMinimumDelayTime=0, ComTxIPduUnusedAreasDefault=0
        RDR_DETECTION_229_232_oPCAN_RADAR_5330693b_Tx: ComIPduDirection=SEND, ComIPduChannelRef=ComMConfigSet/CN_PCAN_RADAR_458ff0f1, ComIPduGroupRef=RDR01_oPCAN_RADAR_Tx_b6bdb067 if post-build-variant-condition{matching-criterion=RDR_POS, value=0}, ComIPduSignalGroupRef=SG_Detections_229_232_oRDR_DETECTION_229_232_oPCAN_RADAR_87d460a6_Tx, ComPduIdRef=EcucPduCollection/RDR_DETECTION_229_232_oPCAN_RADAR_5330693b_Tx, ComIPduGroupRef=RDR02_oPCAN_RADAR_Tx_9f750495 if post-build-variant-condition{matching-criterion=RDR_POS, value=1}, ComIPduGroupRef=RDR03_oPCAN_RADAR_Tx_311d9504 if post-build-variant-condition{matching-criterion=RDR_POS, value=2}, ComIPduGroupRef=RDR04_oPCAN_RADAR_Tx_cce46d71 if post-build-variant-condition{matching-criterion=RDR_POS, value=3}, ComIPduGroupRef=RDR05_oPCAN_RADAR_Tx_628cfce0 if post-build-variant-condition{matching-criterion=RDR_POS, value=4}, ComIPduGroupRef=RDR06_oPCAN_RADAR_Tx_4b444812 if post-build-variant-condition{matching-criterion=RDR_POS, value=5}, ComIPduGroupRef=RDR07_oPCAN_RADAR_Tx_e52cd983 if post-build-variant-condition{matching-criterion=RDR_POS, value=6}, ComIPduGroupRef=RDR08_oPCAN_RADAR_Tx_6bc6beb9 if post-build-variant-condition{matching-criterion=RDR_POS, value=7}
          ComTxIPdu: ComMinimumDelayTime=0, ComTxIPduUnusedAreasDefault=0
        RDR_DETECTION_233_236_oPCAN_RADAR_4ef76a15_Tx: ComIPduDirection=SEND, ComIPduChannelRef=ComMConfigSet/CN_PCAN_RADAR_458ff0f1, ComIPduGroupRef=RDR01_oPCAN_RADAR_Tx_b6bdb067 if post-build-variant-condition{matching-criterion=RDR_POS, value=0}, ComIPduSignalGroupRef=SG_Detections_233_236_oRDR_DETECTION_233_236_oPCAN_RADAR_b5df088e_Tx, ComPduIdRef=EcucPduCollection/RDR_DETECTION_233_236_oPCAN_RADAR_4ef76a15_Tx, ComIPduGroupRef=RDR02_oPCAN_RADAR_Tx_9f750495 if post-build-variant-condition{matching-criterion=RDR_POS, value=1}, ComIPduGroupRef=RDR03_oPCAN_RADAR_Tx_311d9504 if post-build-variant-condition{matching-criterion=RDR_POS, value=2}, ComIPduGroupRef=RDR04_oPCAN_RADAR_Tx_cce46d71 if post-build-variant-condition{matching-criterion=RDR_POS, value=3}, ComIPduGroupRef=RDR05_oPCAN_RADAR_Tx_628cfce0 if post-build-variant-condition{matching-criterion=RDR_POS, value=4}, ComIPduGroupRef=RDR06_oPCAN_RADAR_Tx_4b444812 if post-build-variant-condition{matching-criterion=RDR_POS, value=5}, ComIPduGroupRef=RDR07_oPCAN_RADAR_Tx_e52cd983 if post-build-variant-condition{matching-criterion=RDR_POS, value=6}, ComIPduGroupRef=RDR08_oPCAN_RADAR_Tx_6bc6beb9 if post-build-variant-condition{matching-criterion=RDR_POS, value=7}
          ComTxIPdu: ComMinimumDelayTime=0, ComTxIPduUnusedAreasDefault=0
        RDR_DETECTION_237_240_oPCAN_RADAR_f8d738c7_Tx: ComIPduDirection=SEND, ComIPduChannelRef=ComMConfigSet/CN_PCAN_RADAR_458ff0f1, ComIPduGroupRef=RDR01_oPCAN_RADAR_Tx_b6bdb067 if post-build-variant-condition{matching-criterion=RDR_POS, value=0}, ComIPduSignalGroupRef=SG_Detections_237_240_oRDR_DETECTION_237_240_oPCAN_RADAR_2e8c87a0_Tx, ComPduIdRef=EcucPduCollection/RDR_DETECTION_237_240_oPCAN_RADAR_f8d738c7_Tx, ComIPduGroupRef=RDR02_oPCAN_RADAR_Tx_9f750495 if post-build-variant-condition{matching-criterion=RDR_POS, value=1}, ComIPduGroupRef=RDR03_oPCAN_RADAR_Tx_311d9504 if post-build-variant-condition{matching-criterion=RDR_POS, value=2}, ComIPduGroupRef=RDR04_oPCAN_RADAR_Tx_cce46d71 if post-build-variant-condition{matching-criterion=RDR_POS, value=3}, ComIPduGroupRef=RDR05_oPCAN_RADAR_Tx_628cfce0 if post-build-variant-condition{matching-criterion=RDR_POS, value=4}, ComIPduGroupRef=RDR06_oPCAN_RADAR_Tx_4b444812 if post-build-variant-condition{matching-criterion=RDR_POS, value=5}, ComIPduGroupRef=RDR07_oPCAN_RADAR_Tx_e52cd983 if post-build-variant-condition{matching-criterion=RDR_POS, value=6}, ComIPduGroupRef=RDR08_oPCAN_RADAR_Tx_6bc6beb9 if post-build-variant-condition{matching-criterion=RDR_POS, value=7}
          ComTxIPdu: ComMinimumDelayTime=0, ComTxIPduUnusedAreasDefault=0
        RDR_DETECTION_241_244_oPCAN_RADAR_7e74ef3d_Tx: ComIPduDirection=SEND, ComIPduChannelRef=ComMConfigSet/CN_PCAN_RADAR_458ff0f1, ComIPduGroupRef=RDR01_oPCAN_RADAR_Tx_b6bdb067 if post-build-variant-condition{matching-criterion=RDR_POS, value=0}, ComIPduSignalGroupRef=SG_Detections_241_244_oRDR_DETECTION_241_244_oPCAN_RADAR_30f39079_Tx, ComPduIdRef=EcucPduCollection/RDR_DETECTION_241_244_oPCAN_RADAR_7e74ef3d_Tx, ComIPduGroupRef=RDR02_oPCAN_RADAR_Tx_9f750495 if post-build-variant-condition{matching-criterion=RDR_POS, value=1}, ComIPduGroupRef=RDR03_oPCAN_RADAR_Tx_311d9504 if post-build-variant-condition{matching-criterion=RDR_POS, value=2}, ComIPduGroupRef=RDR04_oPCAN_RADAR_Tx_cce46d71 if post-build-variant-condition{matching-criterion=RDR_POS, value=3}, ComIPduGroupRef=RDR05_oPCAN_RADAR_Tx_628cfce0 if post-build-variant-condition{matching-criterion=RDR_POS, value=4}, ComIPduGroupRef=RDR06_oPCAN_RADAR_Tx_4b444812 if post-build-variant-condition{matching-criterion=RDR_POS, value=5}, ComIPduGroupRef=RDR07_oPCAN_RADAR_Tx_e52cd983 if post-build-variant-condition{matching-criterion=RDR_POS, value=6}, ComIPduGroupRef=RDR08_oPCAN_RADAR_Tx_6bc6beb9 if post-build-variant-condition{matching-criterion=RDR_POS, value=7}
          ComTxIPdu: ComMinimumDelayTime=0, ComTxIPduUnusedAreasDefault=0
        RDR_DETECTION_245_248_oPCAN_RADAR_97c67109_Tx: ComIPduDirection=SEND, ComIPduChannelRef=ComMConfigSet/CN_PCAN_RADAR_458ff0f1, ComIPduGroupRef=RDR01_oPCAN_RADAR_Tx_b6bdb067 if post-build-variant-condition{matching-criterion=RDR_POS, value=0}, ComIPduSignalGroupRef=SG_Detections_245_248_oRDR_DETECTION_245_248_oPCAN_RADAR_4130a42b_Tx, ComPduIdRef=EcucPduCollection/RDR_DETECTION_245_248_oPCAN_RADAR_97c67109_Tx, ComIPduGroupRef=RDR02_oPCAN_RADAR_Tx_9f750495 if post-build-variant-condition{matching-criterion=RDR_POS, value=1}, ComIPduGroupRef=RDR03_oPCAN_RADAR_Tx_311d9504 if post-build-variant-condition{matching-criterion=RDR_POS, value=2}, ComIPduGroupRef=RDR04_oPCAN_RADAR_Tx_cce46d71 if post-build-variant-condition{matching-criterion=RDR_POS, value=3}, ComIPduGroupRef=RDR05_oPCAN_RADAR_Tx_628cfce0 if post-build-variant-condition{matching-criterion=RDR_POS, value=4}, ComIPduGroupRef=RDR06_oPCAN_RADAR_Tx_4b444812 if post-build-variant-condition{matching-criterion=RDR_POS, value=5}, ComIPduGroupRef=RDR07_oPCAN_RADAR_Tx_e52cd983 if post-build-variant-condition{matching-criterion=RDR_POS, value=6}, ComIPduGroupRef=RDR08_oPCAN_RADAR_Tx_6bc6beb9 if post-build-variant-condition{matching-criterion=RDR_POS, value=7}
          ComTxIPdu: ComMinimumDelayTime=0, ComTxIPduUnusedAreasDefault=0
        RDR_DETECTION_249_252_oPCAN_RADAR_a58e9e08_Tx: ComIPduDirection=SEND, ComIPduChannelRef=ComMConfigSet/CN_PCAN_RADAR_458ff0f1, ComIPduGroupRef=RDR01_oPCAN_RADAR_Tx_b6bdb067 if post-build-variant-condition{matching-criterion=RDR_POS, value=0}, ComIPduSignalGroupRef=SG_Detections_249_252_oRDR_DETECTION_249_252_oPCAN_RADAR_d84a8050_Tx, ComPduIdRef=EcucPduCollection/RDR_DETECTION_249_252_oPCAN_RADAR_a58e9e08_Tx, ComIPduGroupRef=RDR02_oPCAN_RADAR_Tx_9f750495 if post-build-variant-condition{matching-criterion=RDR_POS, value=1}, ComIPduGroupRef=RDR03_oPCAN_RADAR_Tx_311d9504 if post-build-variant-condition{matching-criterion=RDR_POS, value=2}, ComIPduGroupRef=RDR04_oPCAN_RADAR_Tx_cce46d71 if post-build-variant-condition{matching-criterion=RDR_POS, value=3}, ComIPduGroupRef=RDR05_oPCAN_RADAR_Tx_628cfce0 if post-build-variant-condition{matching-criterion=RDR_POS, value=4}, ComIPduGroupRef=RDR06_oPCAN_RADAR_Tx_4b444812 if post-build-variant-condition{matching-criterion=RDR_POS, value=5}, ComIPduGroupRef=RDR07_oPCAN_RADAR_Tx_e52cd983 if post-build-variant-condition{matching-criterion=RDR_POS, value=6}, ComIPduGroupRef=RDR08_oPCAN_RADAR_Tx_6bc6beb9 if post-build-variant-condition{matching-criterion=RDR_POS, value=7}
          ComTxIPdu: ComMinimumDelayTime=0, ComTxIPduUnusedAreasDefault=0
        RDR_DETECTION_253_256_oPCAN_RADAR_b8499d26_Tx: ComIPduDirection=SEND, ComIPduChannelRef=ComMConfigSet/CN_PCAN_RADAR_458ff0f1, ComIPduGroupRef=RDR01_oPCAN_RADAR_Tx_b6bdb067 if post-build-variant-condition{matching-criterion=RDR_POS, value=0}, ComIPduSignalGroupRef=SG_Detections_253_256_oRDR_DETECTION_253_256_oPCAN_RADAR_ea41e878_Tx, ComPduIdRef=EcucPduCollection/RDR_DETECTION_253_256_oPCAN_RADAR_b8499d26_Tx, ComIPduGroupRef=RDR02_oPCAN_RADAR_Tx_9f750495 if post-build-variant-condition{matching-criterion=RDR_POS, value=1}, ComIPduGroupRef=RDR03_oPCAN_RADAR_Tx_311d9504 if post-build-variant-condition{matching-criterion=RDR_POS, value=2}, ComIPduGroupRef=RDR04_oPCAN_RADAR_Tx_cce46d71 if post-build-variant-condition{matching-criterion=RDR_POS, value=3}, ComIPduGroupRef=RDR05_oPCAN_RADAR_Tx_628cfce0 if post-build-variant-condition{matching-criterion=RDR_POS, value=4}, ComIPduGroupRef=RDR06_oPCAN_RADAR_Tx_4b444812 if post-build-variant-condition{matching-criterion=RDR_POS, value=5}, ComIPduGroupRef=RDR07_oPCAN_RADAR_Tx_e52cd983 if post-build-variant-condition{matching-criterion=RDR_POS, value=6}, ComIPduGroupRef=RDR08_oPCAN_RADAR_Tx_6bc6beb9 if post-build-variant-condition{matching-criterion=RDR_POS, value=7}
          ComTxIPdu: ComMinimumDelayTime=0, ComTxIPduUnusedAreasDefault=0
        RDR_DETECTION_257_260_oPCAN_RADAR_17c540ef_Tx: ComIPduDirection=SEND, ComIPduChannelRef=ComMConfigSet/CN_PCAN_RADAR_458ff0f1, ComIPduGroupRef=RDR01_oPCAN_RADAR_Tx_b6bdb067 if post-build-variant-condition{matching-criterion=RDR_POS, value=0}, ComIPduSignalGroupRef=SG_Detections_257_260_oRDR_DETECTION_257_260_oPCAN_RADAR_06edbef2_Tx, ComPduIdRef=EcucPduCollection/RDR_DETECTION_257_260_oPCAN_RADAR_17c540ef_Tx, ComIPduGroupRef=RDR02_oPCAN_RADAR_Tx_9f750495 if post-build-variant-condition{matching-criterion=RDR_POS, value=1}, ComIPduGroupRef=RDR03_oPCAN_RADAR_Tx_311d9504 if post-build-variant-condition{matching-criterion=RDR_POS, value=2}, ComIPduGroupRef=RDR04_oPCAN_RADAR_Tx_cce46d71 if post-build-variant-condition{matching-criterion=RDR_POS, value=3}, ComIPduGroupRef=RDR05_oPCAN_RADAR_Tx_628cfce0 if post-build-variant-condition{matching-criterion=RDR_POS, value=4}, ComIPduGroupRef=RDR06_oPCAN_RADAR_Tx_4b444812 if post-build-variant-condition{matching-criterion=RDR_POS, value=5}, ComIPduGroupRef=RDR07_oPCAN_RADAR_Tx_e52cd983 if post-build-variant-condition{matching-criterion=RDR_POS, value=6}, ComIPduGroupRef=RDR08_oPCAN_RADAR_Tx_6bc6beb9 if post-build-variant-condition{matching-criterion=RDR_POS, value=7}
          ComTxIPdu: ComMinimumDelayTime=0, ComTxIPduUnusedAreasDefault=0
        RDR_DETECTION_261_264_oPCAN_RADAR_9ace4013_Tx: ComIPduDirection=SEND, ComIPduChannelRef=ComMConfigSet/CN_PCAN_RADAR_458ff0f1, ComIPduGroupRef=RDR01_oPCAN_RADAR_Tx_b6bdb067 if post-build-variant-condition{matching-criterion=RDR_POS, value=0}, ComIPduSignalGroupRef=SG_Detections_261_264_oRDR_DETECTION_261_264_oPCAN_RADAR_0586302b_Tx, ComPduIdRef=EcucPduCollection/RDR_DETECTION_261_264_oPCAN_RADAR_9ace4013_Tx, ComIPduGroupRef=RDR02_oPCAN_RADAR_Tx_9f750495 if post-build-variant-condition{matching-criterion=RDR_POS, value=1}, ComIPduGroupRef=RDR03_oPCAN_RADAR_Tx_311d9504 if post-build-variant-condition{matching-criterion=RDR_POS, value=2}, ComIPduGroupRef=RDR04_oPCAN_RADAR_Tx_cce46d71 if post-build-variant-condition{matching-criterion=RDR_POS, value=3}, ComIPduGroupRef=RDR05_oPCAN_RADAR_Tx_628cfce0 if post-build-variant-condition{matching-criterion=RDR_POS, value=4}, ComIPduGroupRef=RDR06_oPCAN_RADAR_Tx_4b444812 if post-build-variant-condition{matching-criterion=RDR_POS, value=5}, ComIPduGroupRef=RDR07_oPCAN_RADAR_Tx_e52cd983 if post-build-variant-condition{matching-criterion=RDR_POS, value=6}, ComIPduGroupRef=RDR08_oPCAN_RADAR_Tx_6bc6beb9 if post-build-variant-condition{matching-criterion=RDR_POS, value=7}
          ComTxIPdu: ComMinimumDelayTime=0, ComTxIPduUnusedAreasDefault=0
        RDR_DETECTION_265_268_oPCAN_RADAR_737cde27_Tx: ComIPduDirection=SEND, ComIPduChannelRef=ComMConfigSet/CN_PCAN_RADAR_458ff0f1, ComIPduGroupRef=RDR01_oPCAN_RADAR_Tx_b6bdb067 if post-build-variant-condition{matching-criterion=RDR_POS, value=0}, ComIPduSignalGroupRef=SG_Detections_265_268_oRDR_DETECTION_265_268_oPCAN_RADAR_74450479_Tx, ComPduIdRef=EcucPduCollection/RDR_DETECTION_265_268_oPCAN_RADAR_737cde27_Tx, ComIPduGroupRef=RDR02_oPCAN_RADAR_Tx_9f750495 if post-build-variant-condition{matching-criterion=RDR_POS, value=1}, ComIPduGroupRef=RDR03_oPCAN_RADAR_Tx_311d9504 if post-build-variant-condition{matching-criterion=RDR_POS, value=2}, ComIPduGroupRef=RDR04_oPCAN_RADAR_Tx_cce46d71 if post-build-variant-condition{matching-criterion=RDR_POS, value=3}, ComIPduGroupRef=RDR05_oPCAN_RADAR_Tx_628cfce0 if post-build-variant-condition{matching-criterion=RDR_POS, value=4}, ComIPduGroupRef=RDR06_oPCAN_RADAR_Tx_4b444812 if post-build-variant-condition{matching-criterion=RDR_POS, value=5}, ComIPduGroupRef=RDR07_oPCAN_RADAR_Tx_e52cd983 if post-build-variant-condition{matching-criterion=RDR_POS, value=6}, ComIPduGroupRef=RDR08_oPCAN_RADAR_Tx_6bc6beb9 if post-build-variant-condition{matching-criterion=RDR_POS, value=7}
          ComTxIPdu: ComMinimumDelayTime=0, ComTxIPduUnusedAreasDefault=0
        RDR_DETECTION_269_272_oPCAN_RADAR_41343126_Tx: ComIPduDirection=SEND, ComIPduChannelRef=ComMConfigSet/CN_PCAN_RADAR_458ff0f1, ComIPduGroupRef=RDR01_oPCAN_RADAR_Tx_b6bdb067 if post-build-variant-condition{matching-criterion=RDR_POS, value=0}, ComIPduSignalGroupRef=SG_Detections_269_272_oRDR_DETECTION_269_272_oPCAN_RADAR_ed3f2002_Tx, ComPduIdRef=EcucPduCollection/RDR_DETECTION_269_272_oPCAN_RADAR_41343126_Tx, ComIPduGroupRef=RDR02_oPCAN_RADAR_Tx_9f750495 if post-build-variant-condition{matching-criterion=RDR_POS, value=1}, ComIPduGroupRef=RDR03_oPCAN_RADAR_Tx_311d9504 if post-build-variant-condition{matching-criterion=RDR_POS, value=2}, ComIPduGroupRef=RDR04_oPCAN_RADAR_Tx_cce46d71 if post-build-variant-condition{matching-criterion=RDR_POS, value=3}, ComIPduGroupRef=RDR05_oPCAN_RADAR_Tx_628cfce0 if post-build-variant-condition{matching-criterion=RDR_POS, value=4}, ComIPduGroupRef=RDR06_oPCAN_RADAR_Tx_4b444812 if post-build-variant-condition{matching-criterion=RDR_POS, value=5}, ComIPduGroupRef=RDR07_oPCAN_RADAR_Tx_e52cd983 if post-build-variant-condition{matching-criterion=RDR_POS, value=6}, ComIPduGroupRef=RDR08_oPCAN_RADAR_Tx_6bc6beb9 if post-build-variant-condition{matching-criterion=RDR_POS, value=7}
          ComTxIPdu: ComMinimumDelayTime=0, ComTxIPduUnusedAreasDefault=0
        RDR_DETECTION_273_276_oPCAN_RADAR_5cf33208_Tx: ComIPduDirection=SEND, ComIPduChannelRef=ComMConfigSet/CN_PCAN_RADAR_458ff0f1, ComIPduGroupRef=RDR01_oPCAN_RADAR_Tx_b6bdb067 if post-build-variant-condition{matching-criterion=RDR_POS, value=0}, ComIPduSignalGroupRef=SG_Detections_273_276_oRDR_DETECTION_273_276_oPCAN_RADAR_df34482a_Tx, ComPduIdRef=EcucPduCollection/RDR_DETECTION_273_276_oPCAN_RADAR_5cf33208_Tx, ComIPduGroupRef=RDR02_oPCAN_RADAR_Tx_9f750495 if post-build-variant-condition{matching-criterion=RDR_POS, value=1}, ComIPduGroupRef=RDR03_oPCAN_RADAR_Tx_311d9504 if post-build-variant-condition{matching-criterion=RDR_POS, value=2}, ComIPduGroupRef=RDR04_oPCAN_RADAR_Tx_cce46d71 if post-build-variant-condition{matching-criterion=RDR_POS, value=3}, ComIPduGroupRef=RDR05_oPCAN_RADAR_Tx_628cfce0 if post-build-variant-condition{matching-criterion=RDR_POS, value=4}, ComIPduGroupRef=RDR06_oPCAN_RADAR_Tx_4b444812 if post-build-variant-condition{matching-criterion=RDR_POS, value=5}, ComIPduGroupRef=RDR07_oPCAN_RADAR_Tx_e52cd983 if post-build-variant-condition{matching-criterion=RDR_POS, value=6}, ComIPduGroupRef=RDR08_oPCAN_RADAR_Tx_6bc6beb9 if post-build-variant-condition{matching-criterion=RDR_POS, value=7}
          ComTxIPdu: ComMinimumDelayTime=0, ComTxIPduUnusedAreasDefault=0
        RDR_DETECTION_277_280_oPCAN_RADAR_d98a7eec_Tx: ComIPduDirection=SEND, ComIPduChannelRef=ComMConfigSet/CN_PCAN_RADAR_458ff0f1, ComIPduGroupRef=RDR01_oPCAN_RADAR_Tx_b6bdb067 if post-build-variant-condition{matching-criterion=RDR_POS, value=0}, ComIPduSignalGroupRef=SG_Detections_277_280_oRDR_DETECTION_277_280_oPCAN_RADAR_ab98744c_Tx, ComPduIdRef=EcucPduCollection/RDR_DETECTION_277_280_oPCAN_RADAR_d98a7eec_Tx, ComIPduGroupRef=RDR02_oPCAN_RADAR_Tx_9f750495 if post-build-variant-condition{matching-criterion=RDR_POS, value=1}, ComIPduGroupRef=RDR03_oPCAN_RADAR_Tx_311d9504 if post-build-variant-condition{matching-criterion=RDR_POS, value=2}, ComIPduGroupRef=RDR04_oPCAN_RADAR_Tx_cce46d71 if post-build-variant-condition{matching-criterion=RDR_POS, value=3}, ComIPduGroupRef=RDR05_oPCAN_RADAR_Tx_628cfce0 if post-build-variant-condition{matching-criterion=RDR_POS, value=4}, ComIPduGroupRef=RDR06_oPCAN_RADAR_Tx_4b444812 if post-build-variant-condition{matching-criterion=RDR_POS, value=5}, ComIPduGroupRef=RDR07_oPCAN_RADAR_Tx_e52cd983 if post-build-variant-condition{matching-criterion=RDR_POS, value=6}, ComIPduGroupRef=RDR08_oPCAN_RADAR_Tx_6bc6beb9 if post-build-variant-condition{matching-criterion=RDR_POS, value=7}
          ComTxIPdu: ComMinimumDelayTime=0, ComTxIPduUnusedAreasDefault=0
        RDR_DETECTION_281_284_oPCAN_RADAR_4878071a_Tx: ComIPduDirection=SEND, ComIPduChannelRef=ComMConfigSet/CN_PCAN_RADAR_458ff0f1, ComIPduGroupRef=RDR01_oPCAN_RADAR_Tx_b6bdb067 if post-build-variant-condition{matching-criterion=RDR_POS, value=0}, ComIPduSignalGroupRef=SG_Detections_281_284_oRDR_DETECTION_281_284_oPCAN_RADAR_8fce5195_Tx, ComPduIdRef=EcucPduCollection/RDR_DETECTION_281_284_oPCAN_RADAR_4878071a_Tx, ComIPduGroupRef=RDR02_oPCAN_RADAR_Tx_9f750495 if post-build-variant-condition{matching-criterion=RDR_POS, value=1}, ComIPduGroupRef=RDR03_oPCAN_RADAR_Tx_311d9504 if post-build-variant-condition{matching-criterion=RDR_POS, value=2}, ComIPduGroupRef=RDR04_oPCAN_RADAR_Tx_cce46d71 if post-build-variant-condition{matching-criterion=RDR_POS, value=3}, ComIPduGroupRef=RDR05_oPCAN_RADAR_Tx_628cfce0 if post-build-variant-condition{matching-criterion=RDR_POS, value=4}, ComIPduGroupRef=RDR06_oPCAN_RADAR_Tx_4b444812 if post-build-variant-condition{matching-criterion=RDR_POS, value=5}, ComIPduGroupRef=RDR07_oPCAN_RADAR_Tx_e52cd983 if post-build-variant-condition{matching-criterion=RDR_POS, value=6}, ComIPduGroupRef=RDR08_oPCAN_RADAR_Tx_6bc6beb9 if post-build-variant-condition{matching-criterion=RDR_POS, value=7}
          ComTxIPdu: ComMinimumDelayTime=0, ComTxIPduUnusedAreasDefault=0
        RDR_DETECTION_285_288_oPCAN_RADAR_a1ca992e_Tx: ComIPduDirection=SEND, ComIPduChannelRef=ComMConfigSet/CN_PCAN_RADAR_458ff0f1, ComIPduGroupRef=RDR01_oPCAN_RADAR_Tx_b6bdb067 if post-build-variant-condition{matching-criterion=RDR_POS, value=0}, ComIPduSignalGroupRef=SG_Detections_285_288_oRDR_DETECTION_285_288_oPCAN_RADAR_fe0d65c7_Tx, ComPduIdRef=EcucPduCollection/RDR_DETECTION_285_288_oPCAN_RADAR_a1ca992e_Tx, ComIPduGroupRef=RDR02_oPCAN_RADAR_Tx_9f750495 if post-build-variant-condition{matching-criterion=RDR_POS, value=1}, ComIPduGroupRef=RDR03_oPCAN_RADAR_Tx_311d9504 if post-build-variant-condition{matching-criterion=RDR_POS, value=2}, ComIPduGroupRef=RDR04_oPCAN_RADAR_Tx_cce46d71 if post-build-variant-condition{matching-criterion=RDR_POS, value=3}, ComIPduGroupRef=RDR05_oPCAN_RADAR_Tx_628cfce0 if post-build-variant-condition{matching-criterion=RDR_POS, value=4}, ComIPduGroupRef=RDR06_oPCAN_RADAR_Tx_4b444812 if post-build-variant-condition{matching-criterion=RDR_POS, value=5}, ComIPduGroupRef=RDR07_oPCAN_RADAR_Tx_e52cd983 if post-build-variant-condition{matching-criterion=RDR_POS, value=6}, ComIPduGroupRef=RDR08_oPCAN_RADAR_Tx_6bc6beb9 if post-build-variant-condition{matching-criterion=RDR_POS, value=7}
          ComTxIPdu: ComMinimumDelayTime=0, ComTxIPduUnusedAreasDefault=0
        RDR_DETECTION_289_292_oPCAN_RADAR_9382762f_Tx: ComIPduDirection=SEND, ComIPduChannelRef=ComMConfigSet/CN_PCAN_RADAR_458ff0f1, ComIPduGroupRef=RDR01_oPCAN_RADAR_Tx_b6bdb067 if post-build-variant-condition{matching-criterion=RDR_POS, value=0}, ComIPduSignalGroupRef=SG_Detections_289_292_oRDR_DETECTION_289_292_oPCAN_RADAR_677741bc_Tx, ComPduIdRef=EcucPduCollection/RDR_DETECTION_289_292_oPCAN_RADAR_9382762f_Tx, ComIPduGroupRef=RDR02_oPCAN_RADAR_Tx_9f750495 if post-build-variant-condition{matching-criterion=RDR_POS, value=1}, ComIPduGroupRef=RDR03_oPCAN_RADAR_Tx_311d9504 if post-build-variant-condition{matching-criterion=RDR_POS, value=2}, ComIPduGroupRef=RDR04_oPCAN_RADAR_Tx_cce46d71 if post-build-variant-condition{matching-criterion=RDR_POS, value=3}, ComIPduGroupRef=RDR05_oPCAN_RADAR_Tx_628cfce0 if post-build-variant-condition{matching-criterion=RDR_POS, value=4}, ComIPduGroupRef=RDR06_oPCAN_RADAR_Tx_4b444812 if post-build-variant-condition{matching-criterion=RDR_POS, value=5}, ComIPduGroupRef=RDR07_oPCAN_RADAR_Tx_e52cd983 if post-build-variant-condition{matching-criterion=RDR_POS, value=6}, ComIPduGroupRef=RDR08_oPCAN_RADAR_Tx_6bc6beb9 if post-build-variant-condition{matching-criterion=RDR_POS, value=7}
          ComTxIPdu: ComMinimumDelayTime=0, ComTxIPduUnusedAreasDefault=0
        RDR_DETECTION_293_296_oPCAN_RADAR_8e457501_Tx: ComIPduDirection=SEND, ComIPduChannelRef=ComMConfigSet/CN_PCAN_RADAR_458ff0f1, ComIPduGroupRef=RDR01_oPCAN_RADAR_Tx_b6bdb067 if post-build-variant-condition{matching-criterion=RDR_POS, value=0}, ComIPduSignalGroupRef=SG_Detections_293_296_oRDR_DETECTION_293_296_oPCAN_RADAR_557c2994_Tx, ComPduIdRef=EcucPduCollection/RDR_DETECTION_293_296_oPCAN_RADAR_8e457501_Tx, ComIPduGroupRef=RDR02_oPCAN_RADAR_Tx_9f750495 if post-build-variant-condition{matching-criterion=RDR_POS, value=1}, ComIPduGroupRef=RDR03_oPCAN_RADAR_Tx_311d9504 if post-build-variant-condition{matching-criterion=RDR_POS, value=2}, ComIPduGroupRef=RDR04_oPCAN_RADAR_Tx_cce46d71 if post-build-variant-condition{matching-criterion=RDR_POS, value=3}, ComIPduGroupRef=RDR05_oPCAN_RADAR_Tx_628cfce0 if post-build-variant-condition{matching-criterion=RDR_POS, value=4}, ComIPduGroupRef=RDR06_oPCAN_RADAR_Tx_4b444812 if post-build-variant-condition{matching-criterion=RDR_POS, value=5}, ComIPduGroupRef=RDR07_oPCAN_RADAR_Tx_e52cd983 if post-build-variant-condition{matching-criterion=RDR_POS, value=6}, ComIPduGroupRef=RDR08_oPCAN_RADAR_Tx_6bc6beb9 if post-build-variant-condition{matching-criterion=RDR_POS, value=7}
          ComTxIPdu: ComMinimumDelayTime=0, ComTxIPduUnusedAreasDefault=0
        RDR_DETECTION_297_300_oPCAN_RADAR_4a05a9bb_Tx: ComIPduDirection=SEND, ComIPduChannelRef=ComMConfigSet/CN_PCAN_RADAR_458ff0f1, ComIPduGroupRef=RDR01_oPCAN_RADAR_Tx_b6bdb067 if post-build-variant-condition{matching-criterion=RDR_POS, value=0}, ComIPduSignalGroupRef=SG_Detections_297_300_oRDR_DETECTION_297_300_oPCAN_RADAR_59a3068e_Tx, ComPduIdRef=EcucPduCollection/RDR_DETECTION_297_300_oPCAN_RADAR_4a05a9bb_Tx, ComIPduGroupRef=RDR02_oPCAN_RADAR_Tx_9f750495 if post-build-variant-condition{matching-criterion=RDR_POS, value=1}, ComIPduGroupRef=RDR03_oPCAN_RADAR_Tx_311d9504 if post-build-variant-condition{matching-criterion=RDR_POS, value=2}, ComIPduGroupRef=RDR04_oPCAN_RADAR_Tx_cce46d71 if post-build-variant-condition{matching-criterion=RDR_POS, value=3}, ComIPduGroupRef=RDR05_oPCAN_RADAR_Tx_628cfce0 if post-build-variant-condition{matching-criterion=RDR_POS, value=4}, ComIPduGroupRef=RDR06_oPCAN_RADAR_Tx_4b444812 if post-build-variant-condition{matching-criterion=RDR_POS, value=5}, ComIPduGroupRef=RDR07_oPCAN_RADAR_Tx_e52cd983 if post-build-variant-condition{matching-criterion=RDR_POS, value=6}, ComIPduGroupRef=RDR08_oPCAN_RADAR_Tx_6bc6beb9 if post-build-variant-condition{matching-criterion=RDR_POS, value=7}
          ComTxIPdu: ComMinimumDelayTime=0, ComTxIPduUnusedAreasDefault=0
        RDR_DETECTION_301_304_oPCAN_RADAR_0269ec90_Tx: ComIPduDirection=SEND, ComIPduChannelRef=ComMConfigSet/CN_PCAN_RADAR_458ff0f1, ComIPduGroupRef=RDR01_oPCAN_RADAR_Tx_b6bdb067 if post-build-variant-condition{matching-criterion=RDR_POS, value=0}, ComIPduSignalGroupRef=SG_Detections_301_304_oRDR_DETECTION_301_304_oPCAN_RADAR_18b0f261_Tx, ComPduIdRef=EcucPduCollection/RDR_DETECTION_301_304_oPCAN_RADAR_0269ec90_Tx, ComIPduGroupRef=RDR02_oPCAN_RADAR_Tx_9f750495 if post-build-variant-condition{matching-criterion=RDR_POS, value=1}, ComIPduGroupRef=RDR03_oPCAN_RADAR_Tx_311d9504 if post-build-variant-condition{matching-criterion=RDR_POS, value=2}, ComIPduGroupRef=RDR04_oPCAN_RADAR_Tx_cce46d71 if post-build-variant-condition{matching-criterion=RDR_POS, value=3}, ComIPduGroupRef=RDR05_oPCAN_RADAR_Tx_628cfce0 if post-build-variant-condition{matching-criterion=RDR_POS, value=4}, ComIPduGroupRef=RDR06_oPCAN_RADAR_Tx_4b444812 if post-build-variant-condition{matching-criterion=RDR_POS, value=5}, ComIPduGroupRef=RDR07_oPCAN_RADAR_Tx_e52cd983 if post-build-variant-condition{matching-criterion=RDR_POS, value=6}, ComIPduGroupRef=RDR08_oPCAN_RADAR_Tx_6bc6beb9 if post-build-variant-condition{matching-criterion=RDR_POS, value=7}
          ComTxIPdu: ComMinimumDelayTime=0, ComTxIPduUnusedAreasDefault=0
        RDR_DETECTION_305_308_oPCAN_RADAR_ebdb72a4_Tx: ComIPduDirection=SEND, ComIPduChannelRef=ComMConfigSet/CN_PCAN_RADAR_458ff0f1, ComIPduGroupRef=RDR01_oPCAN_RADAR_Tx_b6bdb067 if post-build-variant-condition{matching-criterion=RDR_POS, value=0}, ComIPduSignalGroupRef=SG_Detections_305_308_oRDR_DETECTION_305_308_oPCAN_RADAR_6973c633_Tx, ComPduIdRef=EcucPduCollection/RDR_DETECTION_305_308_oPCAN_RADAR_ebdb72a4_Tx, ComIPduGroupRef=RDR02_oPCAN_RADAR_Tx_9f750495 if post-build-variant-condition{matching-criterion=RDR_POS, value=1}, ComIPduGroupRef=RDR03_oPCAN_RADAR_Tx_311d9504 if post-build-variant-condition{matching-criterion=RDR_POS, value=2}, ComIPduGroupRef=RDR04_oPCAN_RADAR_Tx_cce46d71 if post-build-variant-condition{matching-criterion=RDR_POS, value=3}, ComIPduGroupRef=RDR05_oPCAN_RADAR_Tx_628cfce0 if post-build-variant-condition{matching-criterion=RDR_POS, value=4}, ComIPduGroupRef=RDR06_oPCAN_RADAR_Tx_4b444812 if post-build-variant-condition{matching-criterion=RDR_POS, value=5}, ComIPduGroupRef=RDR07_oPCAN_RADAR_Tx_e52cd983 if post-build-variant-condition{matching-criterion=RDR_POS, value=6}, ComIPduGroupRef=RDR08_oPCAN_RADAR_Tx_6bc6beb9 if post-build-variant-condition{matching-criterion=RDR_POS, value=7}
          ComTxIPdu: ComMinimumDelayTime=0, ComTxIPduUnusedAreasDefault=0
        RDR_DETECTION_309_312_oPCAN_RADAR_d9939da5_Tx: ComIPduDirection=SEND, ComIPduChannelRef=ComMConfigSet/CN_PCAN_RADAR_458ff0f1, ComIPduGroupRef=RDR01_oPCAN_RADAR_Tx_b6bdb067 if post-build-variant-condition{matching-criterion=RDR_POS, value=0}, ComIPduSignalGroupRef=SG_Detections_309_312_oRDR_DETECTION_309_312_oPCAN_RADAR_f009e248_Tx, ComPduIdRef=EcucPduCollection/RDR_DETECTION_309_312_oPCAN_RADAR_d9939da5_Tx, ComIPduGroupRef=RDR02_oPCAN_RADAR_Tx_9f750495 if post-build-variant-condition{matching-criterion=RDR_POS, value=1}, ComIPduGroupRef=RDR03_oPCAN_RADAR_Tx_311d9504 if post-build-variant-condition{matching-criterion=RDR_POS, value=2}, ComIPduGroupRef=RDR04_oPCAN_RADAR_Tx_cce46d71 if post-build-variant-condition{matching-criterion=RDR_POS, value=3}, ComIPduGroupRef=RDR05_oPCAN_RADAR_Tx_628cfce0 if post-build-variant-condition{matching-criterion=RDR_POS, value=4}, ComIPduGroupRef=RDR06_oPCAN_RADAR_Tx_4b444812 if post-build-variant-condition{matching-criterion=RDR_POS, value=5}, ComIPduGroupRef=RDR07_oPCAN_RADAR_Tx_e52cd983 if post-build-variant-condition{matching-criterion=RDR_POS, value=6}, ComIPduGroupRef=RDR08_oPCAN_RADAR_Tx_6bc6beb9 if post-build-variant-condition{matching-criterion=RDR_POS, value=7}
          ComTxIPdu: ComMinimumDelayTime=0, ComTxIPduUnusedAreasDefault=0
        RDR_DETECTION_313_316_oPCAN_RADAR_c4549e8b_Tx: ComIPduDirection=SEND, ComIPduChannelRef=ComMConfigSet/CN_PCAN_RADAR_458ff0f1, ComIPduGroupRef=RDR01_oPCAN_RADAR_Tx_b6bdb067 if post-build-variant-condition{matching-criterion=RDR_POS, value=0}, ComIPduSignalGroupRef=SG_Detections_313_316_oRDR_DETECTION_313_316_oPCAN_RADAR_c2028a60_Tx, ComPduIdRef=EcucPduCollection/RDR_DETECTION_313_316_oPCAN_RADAR_c4549e8b_Tx, ComIPduGroupRef=RDR02_oPCAN_RADAR_Tx_9f750495 if post-build-variant-condition{matching-criterion=RDR_POS, value=1}, ComIPduGroupRef=RDR03_oPCAN_RADAR_Tx_311d9504 if post-build-variant-condition{matching-criterion=RDR_POS, value=2}, ComIPduGroupRef=RDR04_oPCAN_RADAR_Tx_cce46d71 if post-build-variant-condition{matching-criterion=RDR_POS, value=3}, ComIPduGroupRef=RDR05_oPCAN_RADAR_Tx_628cfce0 if post-build-variant-condition{matching-criterion=RDR_POS, value=4}, ComIPduGroupRef=RDR06_oPCAN_RADAR_Tx_4b444812 if post-build-variant-condition{matching-criterion=RDR_POS, value=5}, ComIPduGroupRef=RDR07_oPCAN_RADAR_Tx_e52cd983 if post-build-variant-condition{matching-criterion=RDR_POS, value=6}, ComIPduGroupRef=RDR08_oPCAN_RADAR_Tx_6bc6beb9 if post-build-variant-condition{matching-criterion=RDR_POS, value=7}
          ComTxIPdu: ComMinimumDelayTime=0, ComTxIPduUnusedAreasDefault=0
        RDR_DETECTION_317_320_oPCAN_RADAR_6bd84342_Tx: ComIPduDirection=SEND, ComIPduChannelRef=ComMConfigSet/CN_PCAN_RADAR_458ff0f1, ComIPduGroupRef=RDR01_oPCAN_RADAR_Tx_b6bdb067 if post-build-variant-condition{matching-criterion=RDR_POS, value=0}, ComIPduSignalGroupRef=SG_Detections_317_320_oRDR_DETECTION_317_320_oPCAN_RADAR_2eaedcea_Tx, ComPduIdRef=EcucPduCollection/RDR_DETECTION_317_320_oPCAN_RADAR_6bd84342_Tx, ComIPduGroupRef=RDR02_oPCAN_RADAR_Tx_9f750495 if post-build-variant-condition{matching-criterion=RDR_POS, value=1}, ComIPduGroupRef=RDR03_oPCAN_RADAR_Tx_311d9504 if post-build-variant-condition{matching-criterion=RDR_POS, value=2}, ComIPduGroupRef=RDR04_oPCAN_RADAR_Tx_cce46d71 if post-build-variant-condition{matching-criterion=RDR_POS, value=3}, ComIPduGroupRef=RDR05_oPCAN_RADAR_Tx_628cfce0 if post-build-variant-condition{matching-criterion=RDR_POS, value=4}, ComIPduGroupRef=RDR06_oPCAN_RADAR_Tx_4b444812 if post-build-variant-condition{matching-criterion=RDR_POS, value=5}, ComIPduGroupRef=RDR07_oPCAN_RADAR_Tx_e52cd983 if post-build-variant-condition{matching-criterion=RDR_POS, value=6}, ComIPduGroupRef=RDR08_oPCAN_RADAR_Tx_6bc6beb9 if post-build-variant-condition{matching-criterion=RDR_POS, value=7}
          ComTxIPdu: ComMinimumDelayTime=0, ComTxIPduUnusedAreasDefault=0
        RDR_DETECTION_321_324_oPCAN_RADAR_e6d343be_Tx: ComIPduDirection=SEND, ComIPduChannelRef=ComMConfigSet/CN_PCAN_RADAR_458ff0f1, ComIPduGroupRef=RDR01_oPCAN_RADAR_Tx_b6bdb067 if post-build-variant-condition{matching-criterion=RDR_POS, value=0}, ComIPduSignalGroupRef=SG_Detections_321_324_oRDR_DETECTION_321_324_oPCAN_RADAR_2dc55233_Tx, ComPduIdRef=EcucPduCollection/RDR_DETECTION_321_324_oPCAN_RADAR_e6d343be_Tx, ComIPduGroupRef=RDR02_oPCAN_RADAR_Tx_9f750495 if post-build-variant-condition{matching-criterion=RDR_POS, value=1}, ComIPduGroupRef=RDR03_oPCAN_RADAR_Tx_311d9504 if post-build-variant-condition{matching-criterion=RDR_POS, value=2}, ComIPduGroupRef=RDR04_oPCAN_RADAR_Tx_cce46d71 if post-build-variant-condition{matching-criterion=RDR_POS, value=3}, ComIPduGroupRef=RDR05_oPCAN_RADAR_Tx_628cfce0 if post-build-variant-condition{matching-criterion=RDR_POS, value=4}, ComIPduGroupRef=RDR06_oPCAN_RADAR_Tx_4b444812 if post-build-variant-condition{matching-criterion=RDR_POS, value=5}, ComIPduGroupRef=RDR07_oPCAN_RADAR_Tx_e52cd983 if post-build-variant-condition{matching-criterion=RDR_POS, value=6}, ComIPduGroupRef=RDR08_oPCAN_RADAR_Tx_6bc6beb9 if post-build-variant-condition{matching-criterion=RDR_POS, value=7}
          ComTxIPdu: ComMinimumDelayTime=0, ComTxIPduUnusedAreasDefault=0
        RDR_DETECTION_325_328_oPCAN_RADAR_0f61dd8a_Tx: ComIPduDirection=SEND, ComIPduChannelRef=ComMConfigSet/CN_PCAN_RADAR_458ff0f1, ComIPduGroupRef=RDR01_oPCAN_RADAR_Tx_b6bdb067 if post-build-variant-condition{matching-criterion=RDR_POS, value=0}, ComIPduSignalGroupRef=SG_Detections_325_328_oRDR_DETECTION_325_328_oPCAN_RADAR_5c066661_Tx, ComPduIdRef=EcucPduCollection/RDR_DETECTION_325_328_oPCAN_RADAR_0f61dd8a_Tx, ComIPduGroupRef=RDR02_oPCAN_RADAR_Tx_9f750495 if post-build-variant-condition{matching-criterion=RDR_POS, value=1}, ComIPduGroupRef=RDR03_oPCAN_RADAR_Tx_311d9504 if post-build-variant-condition{matching-criterion=RDR_POS, value=2}, ComIPduGroupRef=RDR04_oPCAN_RADAR_Tx_cce46d71 if post-build-variant-condition{matching-criterion=RDR_POS, value=3}, ComIPduGroupRef=RDR05_oPCAN_RADAR_Tx_628cfce0 if post-build-variant-condition{matching-criterion=RDR_POS, value=4}, ComIPduGroupRef=RDR06_oPCAN_RADAR_Tx_4b444812 if post-build-variant-condition{matching-criterion=RDR_POS, value=5}, ComIPduGroupRef=RDR07_oPCAN_RADAR_Tx_e52cd983 if post-build-variant-condition{matching-criterion=RDR_POS, value=6}, ComIPduGroupRef=RDR08_oPCAN_RADAR_Tx_6bc6beb9 if post-build-variant-condition{matching-criterion=RDR_POS, value=7}
          ComTxIPdu: ComMinimumDelayTime=0, ComTxIPduUnusedAreasDefault=0
        RDR_DETECTION_329_332_oPCAN_RADAR_3d29328b_Tx: ComIPduDirection=SEND, ComIPduChannelRef=ComMConfigSet/CN_PCAN_RADAR_458ff0f1, ComIPduGroupRef=RDR01_oPCAN_RADAR_Tx_b6bdb067 if post-build-variant-condition{matching-criterion=RDR_POS, value=0}, ComIPduSignalGroupRef=SG_Detections_329_332_oRDR_DETECTION_329_332_oPCAN_RADAR_c57c421a_Tx, ComPduIdRef=EcucPduCollection/RDR_DETECTION_329_332_oPCAN_RADAR_3d29328b_Tx, ComIPduGroupRef=RDR02_oPCAN_RADAR_Tx_9f750495 if post-build-variant-condition{matching-criterion=RDR_POS, value=1}, ComIPduGroupRef=RDR03_oPCAN_RADAR_Tx_311d9504 if post-build-variant-condition{matching-criterion=RDR_POS, value=2}, ComIPduGroupRef=RDR04_oPCAN_RADAR_Tx_cce46d71 if post-build-variant-condition{matching-criterion=RDR_POS, value=3}, ComIPduGroupRef=RDR05_oPCAN_RADAR_Tx_628cfce0 if post-build-variant-condition{matching-criterion=RDR_POS, value=4}, ComIPduGroupRef=RDR06_oPCAN_RADAR_Tx_4b444812 if post-build-variant-condition{matching-criterion=RDR_POS, value=5}, ComIPduGroupRef=RDR07_oPCAN_RADAR_Tx_e52cd983 if post-build-variant-condition{matching-criterion=RDR_POS, value=6}, ComIPduGroupRef=RDR08_oPCAN_RADAR_Tx_6bc6beb9 if post-build-variant-condition{matching-criterion=RDR_POS, value=7}
          ComTxIPdu: ComMinimumDelayTime=0, ComTxIPduUnusedAreasDefault=0
        RDR_DETECTION_333_336_oPCAN_RADAR_20ee31a5_Tx: ComIPduDirection=SEND, ComIPduChannelRef=ComMConfigSet/CN_PCAN_RADAR_458ff0f1, ComIPduGroupRef=RDR01_oPCAN_RADAR_Tx_b6bdb067 if post-build-variant-condition{matching-criterion=RDR_POS, value=0}, ComIPduSignalGroupRef=SG_Detections_333_336_oRDR_DETECTION_333_336_oPCAN_RADAR_f7772a32_Tx, ComPduIdRef=EcucPduCollection/RDR_DETECTION_333_336_oPCAN_RADAR_20ee31a5_Tx, ComIPduGroupRef=RDR02_oPCAN_RADAR_Tx_9f750495 if post-build-variant-condition{matching-criterion=RDR_POS, value=1}, ComIPduGroupRef=RDR03_oPCAN_RADAR_Tx_311d9504 if post-build-variant-condition{matching-criterion=RDR_POS, value=2}, ComIPduGroupRef=RDR04_oPCAN_RADAR_Tx_cce46d71 if post-build-variant-condition{matching-criterion=RDR_POS, value=3}, ComIPduGroupRef=RDR05_oPCAN_RADAR_Tx_628cfce0 if post-build-variant-condition{matching-criterion=RDR_POS, value=4}, ComIPduGroupRef=RDR06_oPCAN_RADAR_Tx_4b444812 if post-build-variant-condition{matching-criterion=RDR_POS, value=5}, ComIPduGroupRef=RDR07_oPCAN_RADAR_Tx_e52cd983 if post-build-variant-condition{matching-criterion=RDR_POS, value=6}, ComIPduGroupRef=RDR08_oPCAN_RADAR_Tx_6bc6beb9 if post-build-variant-condition{matching-criterion=RDR_POS, value=7}
          ComTxIPdu: ComMinimumDelayTime=0, ComTxIPduUnusedAreasDefault=0
        RDR_DETECTION_337_340_oPCAN_RADAR_96ce6377_Tx: ComIPduDirection=SEND, ComIPduChannelRef=ComMConfigSet/CN_PCAN_RADAR_458ff0f1, ComIPduGroupRef=RDR01_oPCAN_RADAR_Tx_b6bdb067 if post-build-variant-condition{matching-criterion=RDR_POS, value=0}, ComIPduSignalGroupRef=SG_Detections_337_340_oRDR_DETECTION_337_340_oPCAN_RADAR_6c24a51c_Tx, ComPduIdRef=EcucPduCollection/RDR_DETECTION_337_340_oPCAN_RADAR_96ce6377_Tx, ComIPduGroupRef=RDR02_oPCAN_RADAR_Tx_9f750495 if post-build-variant-condition{matching-criterion=RDR_POS, value=1}, ComIPduGroupRef=RDR03_oPCAN_RADAR_Tx_311d9504 if post-build-variant-condition{matching-criterion=RDR_POS, value=2}, ComIPduGroupRef=RDR04_oPCAN_RADAR_Tx_cce46d71 if post-build-variant-condition{matching-criterion=RDR_POS, value=3}, ComIPduGroupRef=RDR05_oPCAN_RADAR_Tx_628cfce0 if post-build-variant-condition{matching-criterion=RDR_POS, value=4}, ComIPduGroupRef=RDR06_oPCAN_RADAR_Tx_4b444812 if post-build-variant-condition{matching-criterion=RDR_POS, value=5}, ComIPduGroupRef=RDR07_oPCAN_RADAR_Tx_e52cd983 if post-build-variant-condition{matching-criterion=RDR_POS, value=6}, ComIPduGroupRef=RDR08_oPCAN_RADAR_Tx_6bc6beb9 if post-build-variant-condition{matching-criterion=RDR_POS, value=7}
          ComTxIPdu: ComMinimumDelayTime=0, ComTxIPduUnusedAreasDefault=0
        RDR_DETECTION_341_344_oPCAN_RADAR_106db48d_Tx: ComIPduDirection=SEND, ComIPduChannelRef=ComMConfigSet/CN_PCAN_RADAR_458ff0f1, ComIPduGroupRef=RDR01_oPCAN_RADAR_Tx_b6bdb067 if post-build-variant-condition{matching-criterion=RDR_POS, value=0}, ComIPduSignalGroupRef=SG_Detections_341_344_oRDR_DETECTION_341_344_oPCAN_RADAR_725bb2c5_Tx, ComPduIdRef=EcucPduCollection/RDR_DETECTION_341_344_oPCAN_RADAR_106db48d_Tx, ComIPduGroupRef=RDR02_oPCAN_RADAR_Tx_9f750495 if post-build-variant-condition{matching-criterion=RDR_POS, value=1}, ComIPduGroupRef=RDR03_oPCAN_RADAR_Tx_311d9504 if post-build-variant-condition{matching-criterion=RDR_POS, value=2}, ComIPduGroupRef=RDR04_oPCAN_RADAR_Tx_cce46d71 if post-build-variant-condition{matching-criterion=RDR_POS, value=3}, ComIPduGroupRef=RDR05_oPCAN_RADAR_Tx_628cfce0 if post-build-variant-condition{matching-criterion=RDR_POS, value=4}, ComIPduGroupRef=RDR06_oPCAN_RADAR_Tx_4b444812 if post-build-variant-condition{matching-criterion=RDR_POS, value=5}, ComIPduGroupRef=RDR07_oPCAN_RADAR_Tx_e52cd983 if post-build-variant-condition{matching-criterion=RDR_POS, value=6}, ComIPduGroupRef=RDR08_oPCAN_RADAR_Tx_6bc6beb9 if post-build-variant-condition{matching-criterion=RDR_POS, value=7}
          ComTxIPdu: ComMinimumDelayTime=0, ComTxIPduUnusedAreasDefault=0
        RDR_DETECTION_345_348_oPCAN_RADAR_f9df2ab9_Tx: ComIPduDirection=SEND, ComIPduChannelRef=ComMConfigSet/CN_PCAN_RADAR_458ff0f1, ComIPduGroupRef=RDR01_oPCAN_RADAR_Tx_b6bdb067 if post-build-variant-condition{matching-criterion=RDR_POS, value=0}, ComIPduSignalGroupRef=SG_Detections_345_348_oRDR_DETECTION_345_348_oPCAN_RADAR_03988697_Tx, ComPduIdRef=EcucPduCollection/RDR_DETECTION_345_348_oPCAN_RADAR_f9df2ab9_Tx, ComIPduGroupRef=RDR02_oPCAN_RADAR_Tx_9f750495 if post-build-variant-condition{matching-criterion=RDR_POS, value=1}, ComIPduGroupRef=RDR03_oPCAN_RADAR_Tx_311d9504 if post-build-variant-condition{matching-criterion=RDR_POS, value=2}, ComIPduGroupRef=RDR04_oPCAN_RADAR_Tx_cce46d71 if post-build-variant-condition{matching-criterion=RDR_POS, value=3}, ComIPduGroupRef=RDR05_oPCAN_RADAR_Tx_628cfce0 if post-build-variant-condition{matching-criterion=RDR_POS, value=4}, ComIPduGroupRef=RDR06_oPCAN_RADAR_Tx_4b444812 if post-build-variant-condition{matching-criterion=RDR_POS, value=5}, ComIPduGroupRef=RDR07_oPCAN_RADAR_Tx_e52cd983 if post-build-variant-condition{matching-criterion=RDR_POS, value=6}, ComIPduGroupRef=RDR08_oPCAN_RADAR_Tx_6bc6beb9 if post-build-variant-condition{matching-criterion=RDR_POS, value=7}
          ComTxIPdu: ComMinimumDelayTime=0, ComTxIPduUnusedAreasDefault=0
        RDR_DETECTION_349_352_oPCAN_RADAR_cb97c5b8_Tx: ComIPduDirection=SEND, ComIPduChannelRef=ComMConfigSet/CN_PCAN_RADAR_458ff0f1, ComIPduGroupRef=RDR01_oPCAN_RADAR_Tx_b6bdb067 if post-build-variant-condition{matching-criterion=RDR_POS, value=0}, ComIPduSignalGroupRef=SG_Detections_349_352_oRDR_DETECTION_349_352_oPCAN_RADAR_9ae2a2ec_Tx, ComPduIdRef=EcucPduCollection/RDR_DETECTION_349_352_oPCAN_RADAR_cb97c5b8_Tx, ComIPduGroupRef=RDR02_oPCAN_RADAR_Tx_9f750495 if post-build-variant-condition{matching-criterion=RDR_POS, value=1}, ComIPduGroupRef=RDR03_oPCAN_RADAR_Tx_311d9504 if post-build-variant-condition{matching-criterion=RDR_POS, value=2}, ComIPduGroupRef=RDR04_oPCAN_RADAR_Tx_cce46d71 if post-build-variant-condition{matching-criterion=RDR_POS, value=3}, ComIPduGroupRef=RDR05_oPCAN_RADAR_Tx_628cfce0 if post-build-variant-condition{matching-criterion=RDR_POS, value=4}, ComIPduGroupRef=RDR06_oPCAN_RADAR_Tx_4b444812 if post-build-variant-condition{matching-criterion=RDR_POS, value=5}, ComIPduGroupRef=RDR07_oPCAN_RADAR_Tx_e52cd983 if post-build-variant-condition{matching-criterion=RDR_POS, value=6}, ComIPduGroupRef=RDR08_oPCAN_RADAR_Tx_6bc6beb9 if post-build-variant-condition{matching-criterion=RDR_POS, value=7}
          ComTxIPdu: ComMinimumDelayTime=0, ComTxIPduUnusedAreasDefault=0
        RDR_DETECTION_353_356_oPCAN_RADAR_d650c696_Tx: ComIPduDirection=SEND, ComIPduChannelRef=ComMConfigSet/CN_PCAN_RADAR_458ff0f1, ComIPduGroupRef=RDR01_oPCAN_RADAR_Tx_b6bdb067 if post-build-variant-condition{matching-criterion=RDR_POS, value=0}, ComIPduSignalGroupRef=SG_Detections_353_356_oRDR_DETECTION_353_356_oPCAN_RADAR_a8e9cac4_Tx, ComPduIdRef=EcucPduCollection/RDR_DETECTION_353_356_oPCAN_RADAR_d650c696_Tx, ComIPduGroupRef=RDR02_oPCAN_RADAR_Tx_9f750495 if post-build-variant-condition{matching-criterion=RDR_POS, value=1}, ComIPduGroupRef=RDR03_oPCAN_RADAR_Tx_311d9504 if post-build-variant-condition{matching-criterion=RDR_POS, value=2}, ComIPduGroupRef=RDR04_oPCAN_RADAR_Tx_cce46d71 if post-build-variant-condition{matching-criterion=RDR_POS, value=3}, ComIPduGroupRef=RDR05_oPCAN_RADAR_Tx_628cfce0 if post-build-variant-condition{matching-criterion=RDR_POS, value=4}, ComIPduGroupRef=RDR06_oPCAN_RADAR_Tx_4b444812 if post-build-variant-condition{matching-criterion=RDR_POS, value=5}, ComIPduGroupRef=RDR07_oPCAN_RADAR_Tx_e52cd983 if post-build-variant-condition{matching-criterion=RDR_POS, value=6}, ComIPduGroupRef=RDR08_oPCAN_RADAR_Tx_6bc6beb9 if post-build-variant-condition{matching-criterion=RDR_POS, value=7}
          ComTxIPdu: ComMinimumDelayTime=0, ComTxIPduUnusedAreasDefault=0
        RDR_DETECTION_357_360_oPCAN_RADAR_79dc1b5f_Tx: ComIPduDirection=SEND, ComIPduChannelRef=ComMConfigSet/CN_PCAN_RADAR_458ff0f1, ComIPduGroupRef=RDR01_oPCAN_RADAR_Tx_b6bdb067 if post-build-variant-condition{matching-criterion=RDR_POS, value=0}, ComIPduSignalGroupRef=SG_Detections_357_360_oRDR_DETECTION_357_360_oPCAN_RADAR_44459c4e_Tx, ComPduIdRef=EcucPduCollection/RDR_DETECTION_357_360_oPCAN_RADAR_79dc1b5f_Tx, ComIPduGroupRef=RDR02_oPCAN_RADAR_Tx_9f750495 if post-build-variant-condition{matching-criterion=RDR_POS, value=1}, ComIPduGroupRef=RDR03_oPCAN_RADAR_Tx_311d9504 if post-build-variant-condition{matching-criterion=RDR_POS, value=2}, ComIPduGroupRef=RDR04_oPCAN_RADAR_Tx_cce46d71 if post-build-variant-condition{matching-criterion=RDR_POS, value=3}, ComIPduGroupRef=RDR05_oPCAN_RADAR_Tx_628cfce0 if post-build-variant-condition{matching-criterion=RDR_POS, value=4}, ComIPduGroupRef=RDR06_oPCAN_RADAR_Tx_4b444812 if post-build-variant-condition{matching-criterion=RDR_POS, value=5}, ComIPduGroupRef=RDR07_oPCAN_RADAR_Tx_e52cd983 if post-build-variant-condition{matching-criterion=RDR_POS, value=6}, ComIPduGroupRef=RDR08_oPCAN_RADAR_Tx_6bc6beb9 if post-build-variant-condition{matching-criterion=RDR_POS, value=7}
          ComTxIPdu: ComMinimumDelayTime=0, ComTxIPduUnusedAreasDefault=0
        RDR_DETECTION_361_364_oPCAN_RADAR_f4d71ba3_Tx: ComIPduDirection=SEND, ComIPduChannelRef=ComMConfigSet/CN_PCAN_RADAR_458ff0f1, ComIPduGroupRef=RDR01_oPCAN_RADAR_Tx_b6bdb067 if post-build-variant-condition{matching-criterion=RDR_POS, value=0}, ComIPduSignalGroupRef=SG_Detections_361_364_oRDR_DETECTION_361_364_oPCAN_RADAR_472e1297_Tx, ComPduIdRef=EcucPduCollection/RDR_DETECTION_361_364_oPCAN_RADAR_f4d71ba3_Tx, ComIPduGroupRef=RDR02_oPCAN_RADAR_Tx_9f750495 if post-build-variant-condition{matching-criterion=RDR_POS, value=1}, ComIPduGroupRef=RDR03_oPCAN_RADAR_Tx_311d9504 if post-build-variant-condition{matching-criterion=RDR_POS, value=2}, ComIPduGroupRef=RDR04_oPCAN_RADAR_Tx_cce46d71 if post-build-variant-condition{matching-criterion=RDR_POS, value=3}, ComIPduGroupRef=RDR05_oPCAN_RADAR_Tx_628cfce0 if post-build-variant-condition{matching-criterion=RDR_POS, value=4}, ComIPduGroupRef=RDR06_oPCAN_RADAR_Tx_4b444812 if post-build-variant-condition{matching-criterion=RDR_POS, value=5}, ComIPduGroupRef=RDR07_oPCAN_RADAR_Tx_e52cd983 if post-build-variant-condition{matching-criterion=RDR_POS, value=6}, ComIPduGroupRef=RDR08_oPCAN_RADAR_Tx_6bc6beb9 if post-build-variant-condition{matching-criterion=RDR_POS, value=7}
          ComTxIPdu: ComMinimumDelayTime=0, ComTxIPduUnusedAreasDefault=0
        RDR_DETECTION_365_368_oPCAN_RADAR_1d658597_Tx: ComIPduDirection=SEND, ComIPduChannelRef=ComMConfigSet/CN_PCAN_RADAR_458ff0f1, ComIPduGroupRef=RDR01_oPCAN_RADAR_Tx_b6bdb067 if post-build-variant-condition{matching-criterion=RDR_POS, value=0}, ComIPduSignalGroupRef=SG_Detections_365_368_oRDR_DETECTION_365_368_oPCAN_RADAR_36ed26c5_Tx, ComPduIdRef=EcucPduCollection/RDR_DETECTION_365_368_oPCAN_RADAR_1d658597_Tx, ComIPduGroupRef=RDR02_oPCAN_RADAR_Tx_9f750495 if post-build-variant-condition{matching-criterion=RDR_POS, value=1}, ComIPduGroupRef=RDR03_oPCAN_RADAR_Tx_311d9504 if post-build-variant-condition{matching-criterion=RDR_POS, value=2}, ComIPduGroupRef=RDR04_oPCAN_RADAR_Tx_cce46d71 if post-build-variant-condition{matching-criterion=RDR_POS, value=3}, ComIPduGroupRef=RDR05_oPCAN_RADAR_Tx_628cfce0 if post-build-variant-condition{matching-criterion=RDR_POS, value=4}, ComIPduGroupRef=RDR06_oPCAN_RADAR_Tx_4b444812 if post-build-variant-condition{matching-criterion=RDR_POS, value=5}, ComIPduGroupRef=RDR07_oPCAN_RADAR_Tx_e52cd983 if post-build-variant-condition{matching-criterion=RDR_POS, value=6}, ComIPduGroupRef=RDR08_oPCAN_RADAR_Tx_6bc6beb9 if post-build-variant-condition{matching-criterion=RDR_POS, value=7}
          ComTxIPdu: ComMinimumDelayTime=0, ComTxIPduUnusedAreasDefault=0
        RDR_DETECTION_369_372_oPCAN_RADAR_2f2d6a96_Tx: ComIPduDirection=SEND, ComIPduChannelRef=ComMConfigSet/CN_PCAN_RADAR_458ff0f1, ComIPduGroupRef=RDR01_oPCAN_RADAR_Tx_b6bdb067 if post-build-variant-condition{matching-criterion=RDR_POS, value=0}, ComIPduSignalGroupRef=SG_Detections_369_372_oRDR_DETECTION_369_372_oPCAN_RADAR_af9702be_Tx, ComPduIdRef=EcucPduCollection/RDR_DETECTION_369_372_oPCAN_RADAR_2f2d6a96_Tx, ComIPduGroupRef=RDR02_oPCAN_RADAR_Tx_9f750495 if post-build-variant-condition{matching-criterion=RDR_POS, value=1}, ComIPduGroupRef=RDR03_oPCAN_RADAR_Tx_311d9504 if post-build-variant-condition{matching-criterion=RDR_POS, value=2}, ComIPduGroupRef=RDR04_oPCAN_RADAR_Tx_cce46d71 if post-build-variant-condition{matching-criterion=RDR_POS, value=3}, ComIPduGroupRef=RDR05_oPCAN_RADAR_Tx_628cfce0 if post-build-variant-condition{matching-criterion=RDR_POS, value=4}, ComIPduGroupRef=RDR06_oPCAN_RADAR_Tx_4b444812 if post-build-variant-condition{matching-criterion=RDR_POS, value=5}, ComIPduGroupRef=RDR07_oPCAN_RADAR_Tx_e52cd983 if post-build-variant-condition{matching-criterion=RDR_POS, value=6}, ComIPduGroupRef=RDR08_oPCAN_RADAR_Tx_6bc6beb9 if post-build-variant-condition{matching-criterion=RDR_POS, value=7}
          ComTxIPdu: ComMinimumDelayTime=0, ComTxIPduUnusedAreasDefault=0
        RDR_DETECTION_373_376_oPCAN_RADAR_32ea69b8_Tx: ComIPduDirection=SEND, ComIPduChannelRef=ComMConfigSet/CN_PCAN_RADAR_458ff0f1, ComIPduGroupRef=RDR01_oPCAN_RADAR_Tx_b6bdb067 if post-build-variant-condition{matching-criterion=RDR_POS, value=0}, ComIPduSignalGroupRef=SG_Detections_373_376_oRDR_DETECTION_373_376_oPCAN_RADAR_9d9c6a96_Tx, ComPduIdRef=EcucPduCollection/RDR_DETECTION_373_376_oPCAN_RADAR_32ea69b8_Tx, ComIPduGroupRef=RDR02_oPCAN_RADAR_Tx_9f750495 if post-build-variant-condition{matching-criterion=RDR_POS, value=1}, ComIPduGroupRef=RDR03_oPCAN_RADAR_Tx_311d9504 if post-build-variant-condition{matching-criterion=RDR_POS, value=2}, ComIPduGroupRef=RDR04_oPCAN_RADAR_Tx_cce46d71 if post-build-variant-condition{matching-criterion=RDR_POS, value=3}, ComIPduGroupRef=RDR05_oPCAN_RADAR_Tx_628cfce0 if post-build-variant-condition{matching-criterion=RDR_POS, value=4}, ComIPduGroupRef=RDR06_oPCAN_RADAR_Tx_4b444812 if post-build-variant-condition{matching-criterion=RDR_POS, value=5}, ComIPduGroupRef=RDR07_oPCAN_RADAR_Tx_e52cd983 if post-build-variant-condition{matching-criterion=RDR_POS, value=6}, ComIPduGroupRef=RDR08_oPCAN_RADAR_Tx_6bc6beb9 if post-build-variant-condition{matching-criterion=RDR_POS, value=7}
          ComTxIPdu: ComMinimumDelayTime=0, ComTxIPduUnusedAreasDefault=0
        RDR_DETECTION_377_380_oPCAN_RADAR_b793255c_Tx: ComIPduDirection=SEND, ComIPduChannelRef=ComMConfigSet/CN_PCAN_RADAR_458ff0f1, ComIPduGroupRef=RDR01_oPCAN_RADAR_Tx_b6bdb067 if post-build-variant-condition{matching-criterion=RDR_POS, value=0}, ComIPduSignalGroupRef=SG_Detections_377_380_oRDR_DETECTION_377_380_oPCAN_RADAR_e93056f0_Tx, ComPduIdRef=EcucPduCollection/RDR_DETECTION_377_380_oPCAN_RADAR_b793255c_Tx, ComIPduGroupRef=RDR02_oPCAN_RADAR_Tx_9f750495 if post-build-variant-condition{matching-criterion=RDR_POS, value=1}, ComIPduGroupRef=RDR03_oPCAN_RADAR_Tx_311d9504 if post-build-variant-condition{matching-criterion=RDR_POS, value=2}, ComIPduGroupRef=RDR04_oPCAN_RADAR_Tx_cce46d71 if post-build-variant-condition{matching-criterion=RDR_POS, value=3}, ComIPduGroupRef=RDR05_oPCAN_RADAR_Tx_628cfce0 if post-build-variant-condition{matching-criterion=RDR_POS, value=4}, ComIPduGroupRef=RDR06_oPCAN_RADAR_Tx_4b444812 if post-build-variant-condition{matching-criterion=RDR_POS, value=5}, ComIPduGroupRef=RDR07_oPCAN_RADAR_Tx_e52cd983 if post-build-variant-condition{matching-criterion=RDR_POS, value=6}, ComIPduGroupRef=RDR08_oPCAN_RADAR_Tx_6bc6beb9 if post-build-variant-condition{matching-criterion=RDR_POS, value=7}
          ComTxIPdu: ComMinimumDelayTime=0, ComTxIPduUnusedAreasDefault=0
        RDR_DETECTION_381_384_oPCAN_RADAR_26615caa_Tx: ComIPduDirection=SEND, ComIPduChannelRef=ComMConfigSet/CN_PCAN_RADAR_458ff0f1, ComIPduGroupRef=RDR01_oPCAN_RADAR_Tx_b6bdb067 if post-build-variant-condition{matching-criterion=RDR_POS, value=0}, ComIPduSignalGroupRef=SG_Detections_381_384_oRDR_DETECTION_381_384_oPCAN_RADAR_cd667329_Tx, ComPduIdRef=EcucPduCollection/RDR_DETECTION_381_384_oPCAN_RADAR_26615caa_Tx, ComIPduGroupRef=RDR02_oPCAN_RADAR_Tx_9f750495 if post-build-variant-condition{matching-criterion=RDR_POS, value=1}, ComIPduGroupRef=RDR03_oPCAN_RADAR_Tx_311d9504 if post-build-variant-condition{matching-criterion=RDR_POS, value=2}, ComIPduGroupRef=RDR04_oPCAN_RADAR_Tx_cce46d71 if post-build-variant-condition{matching-criterion=RDR_POS, value=3}, ComIPduGroupRef=RDR05_oPCAN_RADAR_Tx_628cfce0 if post-build-variant-condition{matching-criterion=RDR_POS, value=4}, ComIPduGroupRef=RDR06_oPCAN_RADAR_Tx_4b444812 if post-build-variant-condition{matching-criterion=RDR_POS, value=5}, ComIPduGroupRef=RDR07_oPCAN_RADAR_Tx_e52cd983 if post-build-variant-condition{matching-criterion=RDR_POS, value=6}, ComIPduGroupRef=RDR08_oPCAN_RADAR_Tx_6bc6beb9 if post-build-variant-condition{matching-criterion=RDR_POS, value=7}
          ComTxIPdu: ComMinimumDelayTime=0, ComTxIPduUnusedAreasDefault=0
        RDR_DETECTION_385_388_oPCAN_RADAR_cfd3c29e_Tx: ComIPduDirection=SEND, ComIPduChannelRef=ComMConfigSet/CN_PCAN_RADAR_458ff0f1, ComIPduGroupRef=RDR01_oPCAN_RADAR_Tx_b6bdb067 if post-build-variant-condition{matching-criterion=RDR_POS, value=0}, ComIPduSignalGroupRef=SG_Detections_385_388_oRDR_DETECTION_385_388_oPCAN_RADAR_bca5477b_Tx, ComPduIdRef=EcucPduCollection/RDR_DETECTION_385_388_oPCAN_RADAR_cfd3c29e_Tx, ComIPduGroupRef=RDR02_oPCAN_RADAR_Tx_9f750495 if post-build-variant-condition{matching-criterion=RDR_POS, value=1}, ComIPduGroupRef=RDR03_oPCAN_RADAR_Tx_311d9504 if post-build-variant-condition{matching-criterion=RDR_POS, value=2}, ComIPduGroupRef=RDR04_oPCAN_RADAR_Tx_cce46d71 if post-build-variant-condition{matching-criterion=RDR_POS, value=3}, ComIPduGroupRef=RDR05_oPCAN_RADAR_Tx_628cfce0 if post-build-variant-condition{matching-criterion=RDR_POS, value=4}, ComIPduGroupRef=RDR06_oPCAN_RADAR_Tx_4b444812 if post-build-variant-condition{matching-criterion=RDR_POS, value=5}, ComIPduGroupRef=RDR07_oPCAN_RADAR_Tx_e52cd983 if post-build-variant-condition{matching-criterion=RDR_POS, value=6}, ComIPduGroupRef=RDR08_oPCAN_RADAR_Tx_6bc6beb9 if post-build-variant-condition{matching-criterion=RDR_POS, value=7}
          ComTxIPdu: ComMinimumDelayTime=0, ComTxIPduUnusedAreasDefault=0
        RDR_DETECTION_389_392_oPCAN_RADAR_fd9b2d9f_Tx: ComIPduDirection=SEND, ComIPduChannelRef=ComMConfigSet/CN_PCAN_RADAR_458ff0f1, ComIPduGroupRef=RDR01_oPCAN_RADAR_Tx_b6bdb067 if post-build-variant-condition{matching-criterion=RDR_POS, value=0}, ComIPduSignalGroupRef=SG_Detections_389_392_oRDR_DETECTION_389_392_oPCAN_RADAR_25df6300_Tx, ComPduIdRef=EcucPduCollection/RDR_DETECTION_389_392_oPCAN_RADAR_fd9b2d9f_Tx, ComIPduGroupRef=RDR02_oPCAN_RADAR_Tx_9f750495 if post-build-variant-condition{matching-criterion=RDR_POS, value=1}, ComIPduGroupRef=RDR03_oPCAN_RADAR_Tx_311d9504 if post-build-variant-condition{matching-criterion=RDR_POS, value=2}, ComIPduGroupRef=RDR04_oPCAN_RADAR_Tx_cce46d71 if post-build-variant-condition{matching-criterion=RDR_POS, value=3}, ComIPduGroupRef=RDR05_oPCAN_RADAR_Tx_628cfce0 if post-build-variant-condition{matching-criterion=RDR_POS, value=4}, ComIPduGroupRef=RDR06_oPCAN_RADAR_Tx_4b444812 if post-build-variant-condition{matching-criterion=RDR_POS, value=5}, ComIPduGroupRef=RDR07_oPCAN_RADAR_Tx_e52cd983 if post-build-variant-condition{matching-criterion=RDR_POS, value=6}, ComIPduGroupRef=RDR08_oPCAN_RADAR_Tx_6bc6beb9 if post-build-variant-condition{matching-criterion=RDR_POS, value=7}
          ComTxIPdu: ComMinimumDelayTime=0, ComTxIPduUnusedAreasDefault=0
        RDR_DETECTION_393_396_oPCAN_RADAR_e05c2eb1_Tx: ComIPduDirection=SEND, ComIPduChannelRef=ComMConfigSet/CN_PCAN_RADAR_458ff0f1, ComIPduGroupRef=RDR01_oPCAN_RADAR_Tx_b6bdb067 if post-build-variant-condition{matching-criterion=RDR_POS, value=0}, ComIPduSignalGroupRef=SG_Detections_393_396_oRDR_DETECTION_393_396_oPCAN_RADAR_17d40b28_Tx, ComPduIdRef=EcucPduCollection/RDR_DETECTION_393_396_oPCAN_RADAR_e05c2eb1_Tx, ComIPduGroupRef=RDR02_oPCAN_RADAR_Tx_9f750495 if post-build-variant-condition{matching-criterion=RDR_POS, value=1}, ComIPduGroupRef=RDR03_oPCAN_RADAR_Tx_311d9504 if post-build-variant-condition{matching-criterion=RDR_POS, value=2}, ComIPduGroupRef=RDR04_oPCAN_RADAR_Tx_cce46d71 if post-build-variant-condition{matching-criterion=RDR_POS, value=3}, ComIPduGroupRef=RDR05_oPCAN_RADAR_Tx_628cfce0 if post-build-variant-condition{matching-criterion=RDR_POS, value=4}, ComIPduGroupRef=RDR06_oPCAN_RADAR_Tx_4b444812 if post-build-variant-condition{matching-criterion=RDR_POS, value=5}, ComIPduGroupRef=RDR07_oPCAN_RADAR_Tx_e52cd983 if post-build-variant-condition{matching-criterion=RDR_POS, value=6}, ComIPduGroupRef=RDR08_oPCAN_RADAR_Tx_6bc6beb9 if post-build-variant-condition{matching-criterion=RDR_POS, value=7}
          ComTxIPdu: ComMinimumDelayTime=0, ComTxIPduUnusedAreasDefault=0
        RDR_DETECTION_397_400_oPCAN_RADAR_06e626f9_Tx: ComIPduDirection=SEND, ComIPduChannelRef=ComMConfigSet/CN_PCAN_RADAR_458ff0f1, ComIPduGroupRef=RDR01_oPCAN_RADAR_Tx_b6bdb067 if post-build-variant-condition{matching-criterion=RDR_POS, value=0}, ComIPduSignalGroupRef=SG_Detections_397_400_oRDR_DETECTION_397_400_oPCAN_RADAR_a221f00e_Tx, ComPduIdRef=EcucPduCollection/RDR_DETECTION_397_400_oPCAN_RADAR_06e626f9_Tx, ComIPduGroupRef=RDR02_oPCAN_RADAR_Tx_9f750495 if post-build-variant-condition{matching-criterion=RDR_POS, value=1}, ComIPduGroupRef=RDR03_oPCAN_RADAR_Tx_311d9504 if post-build-variant-condition{matching-criterion=RDR_POS, value=2}, ComIPduGroupRef=RDR04_oPCAN_RADAR_Tx_cce46d71 if post-build-variant-condition{matching-criterion=RDR_POS, value=3}, ComIPduGroupRef=RDR05_oPCAN_RADAR_Tx_628cfce0 if post-build-variant-condition{matching-criterion=RDR_POS, value=4}, ComIPduGroupRef=RDR06_oPCAN_RADAR_Tx_4b444812 if post-build-variant-condition{matching-criterion=RDR_POS, value=5}, ComIPduGroupRef=RDR07_oPCAN_RADAR_Tx_e52cd983 if post-build-variant-condition{matching-criterion=RDR_POS, value=6}, ComIPduGroupRef=RDR08_oPCAN_RADAR_Tx_6bc6beb9 if post-build-variant-condition{matching-criterion=RDR_POS, value=7}
          ComTxIPdu: ComMinimumDelayTime=0, ComTxIPduUnusedAreasDefault=0
        RDR_FUSION_ALIGNMENT_STATUS_001_oPCAN_RADAR_5cbb3751_Rx: ComIPduDirection=RECEIVE, ComIPduChannelRef=ComMConfigSet/CN_PCAN_RADAR_458ff0f1, ComIPduGroupRef=RDR01_oPCAN_RADAR_Rx_e0e717e1 if post-build-variant-condition{matching-criterion=RDR_POS, value=0}, ComIPduSignalGroupRef=SG_Fusion_AlignmentStatus1_oRDR_FUSION_ALIGNMENT_STATUS_001_oPCAN_RADAR_2e5fc362_Rx, ComPduIdRef=EcucPduCollection/RDR_FUSION_ALIGNMENT_STATUS_001_oPCAN_RADAR_5cbb3751_Rx, ComIPduGroupRef=RDR02_oPCAN_RADAR_Rx_c92fa313 if post-build-variant-condition{matching-criterion=RDR_POS, value=1}, ComIPduGroupRef=RDR03_oPCAN_RADAR_Rx_67473282 if post-build-variant-condition{matching-criterion=RDR_POS, value=2}, ComIPduGroupRef=RDR04_oPCAN_RADAR_Rx_9abecaf7 if post-build-variant-condition{matching-criterion=RDR_POS, value=3}, ComIPduGroupRef=RDR05_oPCAN_RADAR_Rx_34d65b66 if post-build-variant-condition{matching-criterion=RDR_POS, value=4}, ComIPduGroupRef=RDR06_oPCAN_RADAR_Rx_1d1eef94 if post-build-variant-condition{matching-criterion=RDR_POS, value=5}, ComIPduGroupRef=RDR07_oPCAN_RADAR_Rx_b3767e05 if post-build-variant-condition{matching-criterion=RDR_POS, value=6}, ComIPduGroupRef=RDR08_oPCAN_RADAR_Rx_3d9c193f if post-build-variant-condition{matching-criterion=RDR_POS, value=7}
        RDR_FUSION_ALIGNMENT_STATUS_002_oPCAN_RADAR_e1715b9f_Rx: ComIPduDirection=RECEIVE, ComIPduChannelRef=ComMConfigSet/CN_PCAN_RADAR_458ff0f1, ComIPduGroupRef=RDR01_oPCAN_RADAR_Rx_e0e717e1 if post-build-variant-condition{matching-criterion=RDR_POS, value=0}, ComIPduSignalGroupRef=SG_Fusion_AlignmentStatus2_oRDR_FUSION_ALIGNMENT_STATUS_002_oPCAN_RADAR_13cf0319_Rx, ComPduIdRef=EcucPduCollection/RDR_FUSION_ALIGNMENT_STATUS_002_oPCAN_RADAR_e1715b9f_Rx, ComIPduGroupRef=RDR02_oPCAN_RADAR_Rx_c92fa313 if post-build-variant-condition{matching-criterion=RDR_POS, value=1}, ComIPduGroupRef=RDR03_oPCAN_RADAR_Rx_67473282 if post-build-variant-condition{matching-criterion=RDR_POS, value=2}, ComIPduGroupRef=RDR04_oPCAN_RADAR_Rx_9abecaf7 if post-build-variant-condition{matching-criterion=RDR_POS, value=3}, ComIPduGroupRef=RDR05_oPCAN_RADAR_Rx_34d65b66 if post-build-variant-condition{matching-criterion=RDR_POS, value=4}, ComIPduGroupRef=RDR06_oPCAN_RADAR_Rx_1d1eef94 if post-build-variant-condition{matching-criterion=RDR_POS, value=5}, ComIPduGroupRef=RDR07_oPCAN_RADAR_Rx_b3767e05 if post-build-variant-condition{matching-criterion=RDR_POS, value=6}, ComIPduGroupRef=RDR08_oPCAN_RADAR_Rx_3d9c193f if post-build-variant-condition{matching-criterion=RDR_POS, value=7}
        RDR_FUSION_CAPABILITY_oPCAN_RADAR_d81ad430_Rx: ComIPduDirection=RECEIVE, ComIPduChannelRef=ComMConfigSet/CN_PCAN_RADAR_458ff0f1, ComIPduGroupRef=RDR01_oPCAN_RADAR_Rx_e0e717e1 if post-build-variant-condition{matching-criterion=RDR_POS, value=0}, ComIPduSignalGroupRef=SG_Fusion_RadarCapability_oRDR_FUSION_CAPABILITY_oPCAN_RADAR_c3552fd5_Rx, ComPduIdRef=EcucPduCollection/RDR_FUSION_CAPABILITY_oPCAN_RADAR_d81ad430_Rx, ComIPduGroupRef=RDR02_oPCAN_RADAR_Rx_c92fa313 if post-build-variant-condition{matching-criterion=RDR_POS, value=1}, ComIPduGroupRef=RDR03_oPCAN_RADAR_Rx_67473282 if post-build-variant-condition{matching-criterion=RDR_POS, value=2}, ComIPduGroupRef=RDR04_oPCAN_RADAR_Rx_9abecaf7 if post-build-variant-condition{matching-criterion=RDR_POS, value=3}, ComIPduGroupRef=RDR05_oPCAN_RADAR_Rx_34d65b66 if post-build-variant-condition{matching-criterion=RDR_POS, value=4}, ComIPduGroupRef=RDR06_oPCAN_RADAR_Rx_1d1eef94 if post-build-variant-condition{matching-criterion=RDR_POS, value=5}, ComIPduGroupRef=RDR07_oPCAN_RADAR_Rx_b3767e05 if post-build-variant-condition{matching-criterion=RDR_POS, value=6}, ComIPduGroupRef=RDR08_oPCAN_RADAR_Rx_3d9c193f if post-build-variant-condition{matching-criterion=RDR_POS, value=7}
        RDR_FUSION_DET_001_004_oPCAN_RADAR_d39eadb5_Rx: ComIPduDirection=RECEIVE, ComIPduChannelRef=ComMConfigSet/CN_PCAN_RADAR_458ff0f1, ComIPduGroupRef=RDR01_oPCAN_RADAR_Rx_e0e717e1 if post-build-variant-condition{matching-criterion=RDR_POS, value=0}, ComIPduSignalGroupRef=SG_Fusion_Detections_001_004_oRDR_FUSION_DET_001_004_oPCAN_RADAR_4a788d9f_Rx, ComPduIdRef=EcucPduCollection/RDR_FUSION_DET_001_004_oPCAN_RADAR_d39eadb5_Rx, ComIPduGroupRef=RDR02_oPCAN_RADAR_Rx_c92fa313 if post-build-variant-condition{matching-criterion=RDR_POS, value=1}, ComIPduGroupRef=RDR03_oPCAN_RADAR_Rx_67473282 if post-build-variant-condition{matching-criterion=RDR_POS, value=2}, ComIPduGroupRef=RDR04_oPCAN_RADAR_Rx_9abecaf7 if post-build-variant-condition{matching-criterion=RDR_POS, value=3}, ComIPduGroupRef=RDR05_oPCAN_RADAR_Rx_34d65b66 if post-build-variant-condition{matching-criterion=RDR_POS, value=4}, ComIPduGroupRef=RDR06_oPCAN_RADAR_Rx_1d1eef94 if post-build-variant-condition{matching-criterion=RDR_POS, value=5}, ComIPduGroupRef=RDR07_oPCAN_RADAR_Rx_b3767e05 if post-build-variant-condition{matching-criterion=RDR_POS, value=6}, ComIPduGroupRef=RDR08_oPCAN_RADAR_Rx_3d9c193f if post-build-variant-condition{matching-criterion=RDR_POS, value=7}
        RDR_FUSION_DET_005_008_oPCAN_RADAR_3a2c3381_Rx: ComIPduDirection=RECEIVE, ComIPduChannelRef=ComMConfigSet/CN_PCAN_RADAR_458ff0f1, ComIPduGroupRef=RDR01_oPCAN_RADAR_Rx_e0e717e1 if post-build-variant-condition{matching-criterion=RDR_POS, value=0}, ComIPduSignalGroupRef=SG_Fusion_Detections_005_008_oRDR_FUSION_DET_005_008_oPCAN_RADAR_0783a66c_Rx, ComPduIdRef=EcucPduCollection/RDR_FUSION_DET_005_008_oPCAN_RADAR_3a2c3381_Rx, ComIPduGroupRef=RDR02_oPCAN_RADAR_Rx_c92fa313 if post-build-variant-condition{matching-criterion=RDR_POS, value=1}, ComIPduGroupRef=RDR03_oPCAN_RADAR_Rx_67473282 if post-build-variant-condition{matching-criterion=RDR_POS, value=2}, ComIPduGroupRef=RDR04_oPCAN_RADAR_Rx_9abecaf7 if post-build-variant-condition{matching-criterion=RDR_POS, value=3}, ComIPduGroupRef=RDR05_oPCAN_RADAR_Rx_34d65b66 if post-build-variant-condition{matching-criterion=RDR_POS, value=4}, ComIPduGroupRef=RDR06_oPCAN_RADAR_Rx_1d1eef94 if post-build-variant-condition{matching-criterion=RDR_POS, value=5}, ComIPduGroupRef=RDR07_oPCAN_RADAR_Rx_b3767e05 if post-build-variant-condition{matching-criterion=RDR_POS, value=6}, ComIPduGroupRef=RDR08_oPCAN_RADAR_Rx_3d9c193f if post-build-variant-condition{matching-criterion=RDR_POS, value=7}
        RDR_FUSION_DET_009_012_oPCAN_RADAR_0864dc80_Rx: ComIPduDirection=RECEIVE, ComIPduChannelRef=ComMConfigSet/CN_PCAN_RADAR_458ff0f1, ComIPduGroupRef=RDR01_oPCAN_RADAR_Rx_e0e717e1 if post-build-variant-condition{matching-criterion=RDR_POS, value=0}, ComIPduSignalGroupRef=SG_Fusion_Detections_009_012_oRDR_FUSION_DET_009_012_oPCAN_RADAR_85b0e384_Rx, ComPduIdRef=EcucPduCollection/RDR_FUSION_DET_009_012_oPCAN_RADAR_0864dc80_Rx, ComIPduGroupRef=RDR02_oPCAN_RADAR_Rx_c92fa313 if post-build-variant-condition{matching-criterion=RDR_POS, value=1}, ComIPduGroupRef=RDR03_oPCAN_RADAR_Rx_67473282 if post-build-variant-condition{matching-criterion=RDR_POS, value=2}, ComIPduGroupRef=RDR04_oPCAN_RADAR_Rx_9abecaf7 if post-build-variant-condition{matching-criterion=RDR_POS, value=3}, ComIPduGroupRef=RDR05_oPCAN_RADAR_Rx_34d65b66 if post-build-variant-condition{matching-criterion=RDR_POS, value=4}, ComIPduGroupRef=RDR06_oPCAN_RADAR_Rx_1d1eef94 if post-build-variant-condition{matching-criterion=RDR_POS, value=5}, ComIPduGroupRef=RDR07_oPCAN_RADAR_Rx_b3767e05 if post-build-variant-condition{matching-criterion=RDR_POS, value=6}, ComIPduGroupRef=RDR08_oPCAN_RADAR_Rx_3d9c193f if post-build-variant-condition{matching-criterion=RDR_POS, value=7}
        RDR_FUSION_DET_013_016_oPCAN_RADAR_15a3dfae_Rx: ComIPduDirection=RECEIVE, ComIPduChannelRef=ComMConfigSet/CN_PCAN_RADAR_458ff0f1, ComIPduGroupRef=RDR01_oPCAN_RADAR_Rx_e0e717e1 if post-build-variant-condition{matching-criterion=RDR_POS, value=0}, ComIPduSignalGroupRef=SG_Fusion_Detections_013_016_oRDR_FUSION_DET_013_016_oPCAN_RADAR_713b89f4_Rx, ComPduIdRef=EcucPduCollection/RDR_FUSION_DET_013_016_oPCAN_RADAR_15a3dfae_Rx, ComIPduGroupRef=RDR02_oPCAN_RADAR_Rx_c92fa313 if post-build-variant-condition{matching-criterion=RDR_POS, value=1}, ComIPduGroupRef=RDR03_oPCAN_RADAR_Rx_67473282 if post-build-variant-condition{matching-criterion=RDR_POS, value=2}, ComIPduGroupRef=RDR04_oPCAN_RADAR_Rx_9abecaf7 if post-build-variant-condition{matching-criterion=RDR_POS, value=3}, ComIPduGroupRef=RDR05_oPCAN_RADAR_Rx_34d65b66 if post-build-variant-condition{matching-criterion=RDR_POS, value=4}, ComIPduGroupRef=RDR06_oPCAN_RADAR_Rx_1d1eef94 if post-build-variant-condition{matching-criterion=RDR_POS, value=5}, ComIPduGroupRef=RDR07_oPCAN_RADAR_Rx_b3767e05 if post-build-variant-condition{matching-criterion=RDR_POS, value=6}, ComIPduGroupRef=RDR08_oPCAN_RADAR_Rx_3d9c193f if post-build-variant-condition{matching-criterion=RDR_POS, value=7}
        RDR_FUSION_DET_017_020_oPCAN_RADAR_ba2f0267_Rx: ComIPduDirection=RECEIVE, ComIPduChannelRef=ComMConfigSet/CN_PCAN_RADAR_458ff0f1, ComIPduGroupRef=RDR01_oPCAN_RADAR_Rx_e0e717e1 if post-build-variant-condition{matching-criterion=RDR_POS, value=0}, ComIPduSignalGroupRef=SG_Fusion_Detections_017_020_oRDR_FUSION_DET_017_020_oPCAN_RADAR_3121649c_Rx, ComPduIdRef=EcucPduCollection/RDR_FUSION_DET_017_020_oPCAN_RADAR_ba2f0267_Rx, ComIPduGroupRef=RDR02_oPCAN_RADAR_Rx_c92fa313 if post-build-variant-condition{matching-criterion=RDR_POS, value=1}, ComIPduGroupRef=RDR03_oPCAN_RADAR_Rx_67473282 if post-build-variant-condition{matching-criterion=RDR_POS, value=2}, ComIPduGroupRef=RDR04_oPCAN_RADAR_Rx_9abecaf7 if post-build-variant-condition{matching-criterion=RDR_POS, value=3}, ComIPduGroupRef=RDR05_oPCAN_RADAR_Rx_34d65b66 if post-build-variant-condition{matching-criterion=RDR_POS, value=4}, ComIPduGroupRef=RDR06_oPCAN_RADAR_Rx_1d1eef94 if post-build-variant-condition{matching-criterion=RDR_POS, value=5}, ComIPduGroupRef=RDR07_oPCAN_RADAR_Rx_b3767e05 if post-build-variant-condition{matching-criterion=RDR_POS, value=6}, ComIPduGroupRef=RDR08_oPCAN_RADAR_Rx_3d9c193f if post-build-variant-condition{matching-criterion=RDR_POS, value=7}
        RDR_FUSION_DET_021_024_oPCAN_RADAR_3724029b_Rx: ComIPduDirection=RECEIVE, ComIPduChannelRef=ComMConfigSet/CN_PCAN_RADAR_458ff0f1, ComIPduGroupRef=RDR01_oPCAN_RADAR_Rx_e0e717e1 if post-build-variant-condition{matching-criterion=RDR_POS, value=0}, ComIPduSignalGroupRef=SG_Fusion_Detections_021_024_oRDR_FUSION_DET_021_024_oPCAN_RADAR_f7a0d0a9_Rx, ComPduIdRef=EcucPduCollection/RDR_FUSION_DET_021_024_oPCAN_RADAR_3724029b_Rx, ComIPduGroupRef=RDR02_oPCAN_RADAR_Rx_c92fa313 if post-build-variant-condition{matching-criterion=RDR_POS, value=1}, ComIPduGroupRef=RDR03_oPCAN_RADAR_Rx_67473282 if post-build-variant-condition{matching-criterion=RDR_POS, value=2}, ComIPduGroupRef=RDR04_oPCAN_RADAR_Rx_9abecaf7 if post-build-variant-condition{matching-criterion=RDR_POS, value=3}, ComIPduGroupRef=RDR05_oPCAN_RADAR_Rx_34d65b66 if post-build-variant-condition{matching-criterion=RDR_POS, value=4}, ComIPduGroupRef=RDR06_oPCAN_RADAR_Rx_1d1eef94 if post-build-variant-condition{matching-criterion=RDR_POS, value=5}, ComIPduGroupRef=RDR07_oPCAN_RADAR_Rx_b3767e05 if post-build-variant-condition{matching-criterion=RDR_POS, value=6}, ComIPduGroupRef=RDR08_oPCAN_RADAR_Rx_3d9c193f if post-build-variant-condition{matching-criterion=RDR_POS, value=7}
        RDR_FUSION_DET_025_028_oPCAN_RADAR_de969caf_Rx: ComIPduDirection=RECEIVE, ComIPduChannelRef=ComMConfigSet/CN_PCAN_RADAR_458ff0f1, ComIPduGroupRef=RDR01_oPCAN_RADAR_Rx_e0e717e1 if post-build-variant-condition{matching-criterion=RDR_POS, value=0}, ComIPduSignalGroupRef=SG_Fusion_Detections_025_028_oRDR_FUSION_DET_025_028_oPCAN_RADAR_ba5bfb5a_Rx, ComPduIdRef=EcucPduCollection/RDR_FUSION_DET_025_028_oPCAN_RADAR_de969caf_Rx, ComIPduGroupRef=RDR02_oPCAN_RADAR_Rx_c92fa313 if post-build-variant-condition{matching-criterion=RDR_POS, value=1}, ComIPduGroupRef=RDR03_oPCAN_RADAR_Rx_67473282 if post-build-variant-condition{matching-criterion=RDR_POS, value=2}, ComIPduGroupRef=RDR04_oPCAN_RADAR_Rx_9abecaf7 if post-build-variant-condition{matching-criterion=RDR_POS, value=3}, ComIPduGroupRef=RDR05_oPCAN_RADAR_Rx_34d65b66 if post-build-variant-condition{matching-criterion=RDR_POS, value=4}, ComIPduGroupRef=RDR06_oPCAN_RADAR_Rx_1d1eef94 if post-build-variant-condition{matching-criterion=RDR_POS, value=5}, ComIPduGroupRef=RDR07_oPCAN_RADAR_Rx_b3767e05 if post-build-variant-condition{matching-criterion=RDR_POS, value=6}, ComIPduGroupRef=RDR08_oPCAN_RADAR_Rx_3d9c193f if post-build-variant-condition{matching-criterion=RDR_POS, value=7}
        RDR_FUSION_DET_029_032_oPCAN_RADAR_ecde73ae_Rx: ComIPduDirection=RECEIVE, ComIPduChannelRef=ComMConfigSet/CN_PCAN_RADAR_458ff0f1, ComIPduGroupRef=RDR01_oPCAN_RADAR_Rx_e0e717e1 if post-build-variant-condition{matching-criterion=RDR_POS, value=0}, ComIPduSignalGroupRef=SG_Fusion_Detections_029_032_oRDR_FUSION_DET_029_032_oPCAN_RADAR_3868beb2_Rx, ComPduIdRef=EcucPduCollection/RDR_FUSION_DET_029_032_oPCAN_RADAR_ecde73ae_Rx, ComIPduGroupRef=RDR02_oPCAN_RADAR_Rx_c92fa313 if post-build-variant-condition{matching-criterion=RDR_POS, value=1}, ComIPduGroupRef=RDR03_oPCAN_RADAR_Rx_67473282 if post-build-variant-condition{matching-criterion=RDR_POS, value=2}, ComIPduGroupRef=RDR04_oPCAN_RADAR_Rx_9abecaf7 if post-build-variant-condition{matching-criterion=RDR_POS, value=3}, ComIPduGroupRef=RDR05_oPCAN_RADAR_Rx_34d65b66 if post-build-variant-condition{matching-criterion=RDR_POS, value=4}, ComIPduGroupRef=RDR06_oPCAN_RADAR_Rx_1d1eef94 if post-build-variant-condition{matching-criterion=RDR_POS, value=5}, ComIPduGroupRef=RDR07_oPCAN_RADAR_Rx_b3767e05 if post-build-variant-condition{matching-criterion=RDR_POS, value=6}, ComIPduGroupRef=RDR08_oPCAN_RADAR_Rx_3d9c193f if post-build-variant-condition{matching-criterion=RDR_POS, value=7}
        RDR_FUSION_DET_033_036_oPCAN_RADAR_f1197080_Rx: ComIPduDirection=RECEIVE, ComIPduChannelRef=ComMConfigSet/CN_PCAN_RADAR_458ff0f1, ComIPduGroupRef=RDR01_oPCAN_RADAR_Rx_e0e717e1 if post-build-variant-condition{matching-criterion=RDR_POS, value=0}, ComIPduSignalGroupRef=SG_Fusion_Detections_033_036_oRDR_FUSION_DET_033_036_oPCAN_RADAR_cce3d4c2_Rx, ComPduIdRef=EcucPduCollection/RDR_FUSION_DET_033_036_oPCAN_RADAR_f1197080_Rx, ComIPduGroupRef=RDR02_oPCAN_RADAR_Rx_c92fa313 if post-build-variant-condition{matching-criterion=RDR_POS, value=1}, ComIPduGroupRef=RDR03_oPCAN_RADAR_Rx_67473282 if post-build-variant-condition{matching-criterion=RDR_POS, value=2}, ComIPduGroupRef=RDR04_oPCAN_RADAR_Rx_9abecaf7 if post-build-variant-condition{matching-criterion=RDR_POS, value=3}, ComIPduGroupRef=RDR05_oPCAN_RADAR_Rx_34d65b66 if post-build-variant-condition{matching-criterion=RDR_POS, value=4}, ComIPduGroupRef=RDR06_oPCAN_RADAR_Rx_1d1eef94 if post-build-variant-condition{matching-criterion=RDR_POS, value=5}, ComIPduGroupRef=RDR07_oPCAN_RADAR_Rx_b3767e05 if post-build-variant-condition{matching-criterion=RDR_POS, value=6}, ComIPduGroupRef=RDR08_oPCAN_RADAR_Rx_3d9c193f if post-build-variant-condition{matching-criterion=RDR_POS, value=7}
        RDR_FUSION_DET_037_040_oPCAN_RADAR_47392252_Rx: ComIPduDirection=RECEIVE, ComIPduChannelRef=ComMConfigSet/CN_PCAN_RADAR_458ff0f1, ComIPduGroupRef=RDR01_oPCAN_RADAR_Rx_e0e717e1 if post-build-variant-condition{matching-criterion=RDR_POS, value=0}, ComIPduSignalGroupRef=SG_Fusion_Detections_037_040_oRDR_FUSION_DET_037_040_oPCAN_RADAR_cee54bfa_Rx, ComPduIdRef=EcucPduCollection/RDR_FUSION_DET_037_040_oPCAN_RADAR_47392252_Rx, ComIPduGroupRef=RDR02_oPCAN_RADAR_Rx_c92fa313 if post-build-variant-condition{matching-criterion=RDR_POS, value=1}, ComIPduGroupRef=RDR03_oPCAN_RADAR_Rx_67473282 if post-build-variant-condition{matching-criterion=RDR_POS, value=2}, ComIPduGroupRef=RDR04_oPCAN_RADAR_Rx_9abecaf7 if post-build-variant-condition{matching-criterion=RDR_POS, value=3}, ComIPduGroupRef=RDR05_oPCAN_RADAR_Rx_34d65b66 if post-build-variant-condition{matching-criterion=RDR_POS, value=4}, ComIPduGroupRef=RDR06_oPCAN_RADAR_Rx_1d1eef94 if post-build-variant-condition{matching-criterion=RDR_POS, value=5}, ComIPduGroupRef=RDR07_oPCAN_RADAR_Rx_b3767e05 if post-build-variant-condition{matching-criterion=RDR_POS, value=6}, ComIPduGroupRef=RDR08_oPCAN_RADAR_Rx_3d9c193f if post-build-variant-condition{matching-criterion=RDR_POS, value=7}
        RDR_FUSION_DET_041_044_oPCAN_RADAR_c19af5a8_Rx: ComIPduDirection=RECEIVE, ComIPduChannelRef=ComMConfigSet/CN_PCAN_RADAR_458ff0f1, ComIPduGroupRef=RDR01_oPCAN_RADAR_Rx_e0e717e1 if post-build-variant-condition{matching-criterion=RDR_POS, value=0}, ComIPduSignalGroupRef=SG_Fusion_Detections_041_044_oRDR_FUSION_DET_041_044_oPCAN_RADAR_eab931b2_Rx, ComPduIdRef=EcucPduCollection/RDR_FUSION_DET_041_044_oPCAN_RADAR_c19af5a8_Rx, ComIPduGroupRef=RDR02_oPCAN_RADAR_Rx_c92fa313 if post-build-variant-condition{matching-criterion=RDR_POS, value=1}, ComIPduGroupRef=RDR03_oPCAN_RADAR_Rx_67473282 if post-build-variant-condition{matching-criterion=RDR_POS, value=2}, ComIPduGroupRef=RDR04_oPCAN_RADAR_Rx_9abecaf7 if post-build-variant-condition{matching-criterion=RDR_POS, value=3}, ComIPduGroupRef=RDR05_oPCAN_RADAR_Rx_34d65b66 if post-build-variant-condition{matching-criterion=RDR_POS, value=4}, ComIPduGroupRef=RDR06_oPCAN_RADAR_Rx_1d1eef94 if post-build-variant-condition{matching-criterion=RDR_POS, value=5}, ComIPduGroupRef=RDR07_oPCAN_RADAR_Rx_b3767e05 if post-build-variant-condition{matching-criterion=RDR_POS, value=6}, ComIPduGroupRef=RDR08_oPCAN_RADAR_Rx_3d9c193f if post-build-variant-condition{matching-criterion=RDR_POS, value=7}
        RDR_FUSION_DET_045_048_oPCAN_RADAR_28286b9c_Rx: ComIPduDirection=RECEIVE, ComIPduChannelRef=ComMConfigSet/CN_PCAN_RADAR_458ff0f1, ComIPduGroupRef=RDR01_oPCAN_RADAR_Rx_e0e717e1 if post-build-variant-condition{matching-criterion=RDR_POS, value=0}, ComIPduSignalGroupRef=SG_Fusion_Detections_045_048_oRDR_FUSION_DET_045_048_oPCAN_RADAR_a7421a41_Rx, ComPduIdRef=EcucPduCollection/RDR_FUSION_DET_045_048_oPCAN_RADAR_28286b9c_Rx, ComIPduGroupRef=RDR02_oPCAN_RADAR_Rx_c92fa313 if post-build-variant-condition{matching-criterion=RDR_POS, value=1}, ComIPduGroupRef=RDR03_oPCAN_RADAR_Rx_67473282 if post-build-variant-condition{matching-criterion=RDR_POS, value=2}, ComIPduGroupRef=RDR04_oPCAN_RADAR_Rx_9abecaf7 if post-build-variant-condition{matching-criterion=RDR_POS, value=3}, ComIPduGroupRef=RDR05_oPCAN_RADAR_Rx_34d65b66 if post-build-variant-condition{matching-criterion=RDR_POS, value=4}, ComIPduGroupRef=RDR06_oPCAN_RADAR_Rx_1d1eef94 if post-build-variant-condition{matching-criterion=RDR_POS, value=5}, ComIPduGroupRef=RDR07_oPCAN_RADAR_Rx_b3767e05 if post-build-variant-condition{matching-criterion=RDR_POS, value=6}, ComIPduGroupRef=RDR08_oPCAN_RADAR_Rx_3d9c193f if post-build-variant-condition{matching-criterion=RDR_POS, value=7}
        RDR_FUSION_DET_049_052_oPCAN_RADAR_1a60849d_Rx: ComIPduDirection=RECEIVE, ComIPduChannelRef=ComMConfigSet/CN_PCAN_RADAR_458ff0f1, ComIPduGroupRef=RDR01_oPCAN_RADAR_Rx_e0e717e1 if post-build-variant-condition{matching-criterion=RDR_POS, value=0}, ComIPduSignalGroupRef=SG_Fusion_Detections_049_052_oRDR_FUSION_DET_049_052_oPCAN_RADAR_25715fa9_Rx, ComPduIdRef=EcucPduCollection/RDR_FUSION_DET_049_052_oPCAN_RADAR_1a60849d_Rx, ComIPduGroupRef=RDR02_oPCAN_RADAR_Rx_c92fa313 if post-build-variant-condition{matching-criterion=RDR_POS, value=1}, ComIPduGroupRef=RDR03_oPCAN_RADAR_Rx_67473282 if post-build-variant-condition{matching-criterion=RDR_POS, value=2}, ComIPduGroupRef=RDR04_oPCAN_RADAR_Rx_9abecaf7 if post-build-variant-condition{matching-criterion=RDR_POS, value=3}, ComIPduGroupRef=RDR05_oPCAN_RADAR_Rx_34d65b66 if post-build-variant-condition{matching-criterion=RDR_POS, value=4}, ComIPduGroupRef=RDR06_oPCAN_RADAR_Rx_1d1eef94 if post-build-variant-condition{matching-criterion=RDR_POS, value=5}, ComIPduGroupRef=RDR07_oPCAN_RADAR_Rx_b3767e05 if post-build-variant-condition{matching-criterion=RDR_POS, value=6}, ComIPduGroupRef=RDR08_oPCAN_RADAR_Rx_3d9c193f if post-build-variant-condition{matching-criterion=RDR_POS, value=7}
        RDR_FUSION_DET_053_056_oPCAN_RADAR_07a787b3_Rx: ComIPduDirection=RECEIVE, ComIPduChannelRef=ComMConfigSet/CN_PCAN_RADAR_458ff0f1, ComIPduGroupRef=RDR01_oPCAN_RADAR_Rx_e0e717e1 if post-build-variant-condition{matching-criterion=RDR_POS, value=0}, ComIPduSignalGroupRef=SG_Fusion_Detections_053_056_oRDR_FUSION_DET_053_056_oPCAN_RADAR_d1fa35d9_Rx, ComPduIdRef=EcucPduCollection/RDR_FUSION_DET_053_056_oPCAN_RADAR_07a787b3_Rx, ComIPduGroupRef=RDR02_oPCAN_RADAR_Rx_c92fa313 if post-build-variant-condition{matching-criterion=RDR_POS, value=1}, ComIPduGroupRef=RDR03_oPCAN_RADAR_Rx_67473282 if post-build-variant-condition{matching-criterion=RDR_POS, value=2}, ComIPduGroupRef=RDR04_oPCAN_RADAR_Rx_9abecaf7 if post-build-variant-condition{matching-criterion=RDR_POS, value=3}, ComIPduGroupRef=RDR05_oPCAN_RADAR_Rx_34d65b66 if post-build-variant-condition{matching-criterion=RDR_POS, value=4}, ComIPduGroupRef=RDR06_oPCAN_RADAR_Rx_1d1eef94 if post-build-variant-condition{matching-criterion=RDR_POS, value=5}, ComIPduGroupRef=RDR07_oPCAN_RADAR_Rx_b3767e05 if post-build-variant-condition{matching-criterion=RDR_POS, value=6}, ComIPduGroupRef=RDR08_oPCAN_RADAR_Rx_3d9c193f if post-build-variant-condition{matching-criterion=RDR_POS, value=7}
        RDR_FUSION_DET_057_060_oPCAN_RADAR_a82b5a7a_Rx: ComIPduDirection=RECEIVE, ComIPduChannelRef=ComMConfigSet/CN_PCAN_RADAR_458ff0f1, ComIPduGroupRef=RDR01_oPCAN_RADAR_Rx_e0e717e1 if post-build-variant-condition{matching-criterion=RDR_POS, value=0}, ComIPduSignalGroupRef=SG_Fusion_Detections_057_060_oRDR_FUSION_DET_057_060_oPCAN_RADAR_91e0d8b1_Rx, ComPduIdRef=EcucPduCollection/RDR_FUSION_DET_057_060_oPCAN_RADAR_a82b5a7a_Rx, ComIPduGroupRef=RDR02_oPCAN_RADAR_Rx_c92fa313 if post-build-variant-condition{matching-criterion=RDR_POS, value=1}, ComIPduGroupRef=RDR03_oPCAN_RADAR_Rx_67473282 if post-build-variant-condition{matching-criterion=RDR_POS, value=2}, ComIPduGroupRef=RDR04_oPCAN_RADAR_Rx_9abecaf7 if post-build-variant-condition{matching-criterion=RDR_POS, value=3}, ComIPduGroupRef=RDR05_oPCAN_RADAR_Rx_34d65b66 if post-build-variant-condition{matching-criterion=RDR_POS, value=4}, ComIPduGroupRef=RDR06_oPCAN_RADAR_Rx_1d1eef94 if post-build-variant-condition{matching-criterion=RDR_POS, value=5}, ComIPduGroupRef=RDR07_oPCAN_RADAR_Rx_b3767e05 if post-build-variant-condition{matching-criterion=RDR_POS, value=6}, ComIPduGroupRef=RDR08_oPCAN_RADAR_Rx_3d9c193f if post-build-variant-condition{matching-criterion=RDR_POS, value=7}
        RDR_FUSION_DET_061_064_oPCAN_RADAR_25205a86_Rx: ComIPduDirection=RECEIVE, ComIPduChannelRef=ComMConfigSet/CN_PCAN_RADAR_458ff0f1, ComIPduGroupRef=RDR01_oPCAN_RADAR_Rx_e0e717e1 if post-build-variant-condition{matching-criterion=RDR_POS, value=0}, ComIPduSignalGroupRef=SG_Fusion_Detections_061_064_oRDR_FUSION_DET_061_064_oPCAN_RADAR_57616c84_Rx, ComPduIdRef=EcucPduCollection/RDR_FUSION_DET_061_064_oPCAN_RADAR_25205a86_Rx, ComIPduGroupRef=RDR02_oPCAN_RADAR_Rx_c92fa313 if post-build-variant-condition{matching-criterion=RDR_POS, value=1}, ComIPduGroupRef=RDR03_oPCAN_RADAR_Rx_67473282 if post-build-variant-condition{matching-criterion=RDR_POS, value=2}, ComIPduGroupRef=RDR04_oPCAN_RADAR_Rx_9abecaf7 if post-build-variant-condition{matching-criterion=RDR_POS, value=3}, ComIPduGroupRef=RDR05_oPCAN_RADAR_Rx_34d65b66 if post-build-variant-condition{matching-criterion=RDR_POS, value=4}, ComIPduGroupRef=RDR06_oPCAN_RADAR_Rx_1d1eef94 if post-build-variant-condition{matching-criterion=RDR_POS, value=5}, ComIPduGroupRef=RDR07_oPCAN_RADAR_Rx_b3767e05 if post-build-variant-condition{matching-criterion=RDR_POS, value=6}, ComIPduGroupRef=RDR08_oPCAN_RADAR_Rx_3d9c193f if post-build-variant-condition{matching-criterion=RDR_POS, value=7}
        RDR_FUSION_DET_065_068_oPCAN_RADAR_cc92c4b2_Rx: ComIPduDirection=RECEIVE, ComIPduChannelRef=ComMConfigSet/CN_PCAN_RADAR_458ff0f1, ComIPduGroupRef=RDR01_oPCAN_RADAR_Rx_e0e717e1 if post-build-variant-condition{matching-criterion=RDR_POS, value=0}, ComIPduSignalGroupRef=SG_Fusion_Detections_065_068_oRDR_FUSION_DET_065_068_oPCAN_RADAR_1a9a4777_Rx, ComPduIdRef=EcucPduCollection/RDR_FUSION_DET_065_068_oPCAN_RADAR_cc92c4b2_Rx, ComIPduGroupRef=RDR02_oPCAN_RADAR_Rx_c92fa313 if post-build-variant-condition{matching-criterion=RDR_POS, value=1}, ComIPduGroupRef=RDR03_oPCAN_RADAR_Rx_67473282 if post-build-variant-condition{matching-criterion=RDR_POS, value=2}, ComIPduGroupRef=RDR04_oPCAN_RADAR_Rx_9abecaf7 if post-build-variant-condition{matching-criterion=RDR_POS, value=3}, ComIPduGroupRef=RDR05_oPCAN_RADAR_Rx_34d65b66 if post-build-variant-condition{matching-criterion=RDR_POS, value=4}, ComIPduGroupRef=RDR06_oPCAN_RADAR_Rx_1d1eef94 if post-build-variant-condition{matching-criterion=RDR_POS, value=5}, ComIPduGroupRef=RDR07_oPCAN_RADAR_Rx_b3767e05 if post-build-variant-condition{matching-criterion=RDR_POS, value=6}, ComIPduGroupRef=RDR08_oPCAN_RADAR_Rx_3d9c193f if post-build-variant-condition{matching-criterion=RDR_POS, value=7}
        RDR_FUSION_DET_069_072_oPCAN_RADAR_feda2bb3_Rx: ComIPduDirection=RECEIVE, ComIPduChannelRef=ComMConfigSet/CN_PCAN_RADAR_458ff0f1, ComIPduGroupRef=RDR01_oPCAN_RADAR_Rx_e0e717e1 if post-build-variant-condition{matching-criterion=RDR_POS, value=0}, ComIPduSignalGroupRef=SG_Fusion_Detections_069_072_oRDR_FUSION_DET_069_072_oPCAN_RADAR_98a9029f_Rx, ComPduIdRef=EcucPduCollection/RDR_FUSION_DET_069_072_oPCAN_RADAR_feda2bb3_Rx, ComIPduGroupRef=RDR02_oPCAN_RADAR_Rx_c92fa313 if post-build-variant-condition{matching-criterion=RDR_POS, value=1}, ComIPduGroupRef=RDR03_oPCAN_RADAR_Rx_67473282 if post-build-variant-condition{matching-criterion=RDR_POS, value=2}, ComIPduGroupRef=RDR04_oPCAN_RADAR_Rx_9abecaf7 if post-build-variant-condition{matching-criterion=RDR_POS, value=3}, ComIPduGroupRef=RDR05_oPCAN_RADAR_Rx_34d65b66 if post-build-variant-condition{matching-criterion=RDR_POS, value=4}, ComIPduGroupRef=RDR06_oPCAN_RADAR_Rx_1d1eef94 if post-build-variant-condition{matching-criterion=RDR_POS, value=5}, ComIPduGroupRef=RDR07_oPCAN_RADAR_Rx_b3767e05 if post-build-variant-condition{matching-criterion=RDR_POS, value=6}, ComIPduGroupRef=RDR08_oPCAN_RADAR_Rx_3d9c193f if post-build-variant-condition{matching-criterion=RDR_POS, value=7}
        RDR_FUSION_DET_073_076_oPCAN_RADAR_e31d289d_Rx: ComIPduDirection=RECEIVE, ComIPduChannelRef=ComMConfigSet/CN_PCAN_RADAR_458ff0f1, ComIPduGroupRef=RDR01_oPCAN_RADAR_Rx_e0e717e1 if post-build-variant-condition{matching-criterion=RDR_POS, value=0}, ComIPduSignalGroupRef=SG_Fusion_Detections_073_076_oRDR_FUSION_DET_073_076_oPCAN_RADAR_6c2268ef_Rx, ComPduIdRef=EcucPduCollection/RDR_FUSION_DET_073_076_oPCAN_RADAR_e31d289d_Rx, ComIPduGroupRef=RDR02_oPCAN_RADAR_Rx_c92fa313 if post-build-variant-condition{matching-criterion=RDR_POS, value=1}, ComIPduGroupRef=RDR03_oPCAN_RADAR_Rx_67473282 if post-build-variant-condition{matching-criterion=RDR_POS, value=2}, ComIPduGroupRef=RDR04_oPCAN_RADAR_Rx_9abecaf7 if post-build-variant-condition{matching-criterion=RDR_POS, value=3}, ComIPduGroupRef=RDR05_oPCAN_RADAR_Rx_34d65b66 if post-build-variant-condition{matching-criterion=RDR_POS, value=4}, ComIPduGroupRef=RDR06_oPCAN_RADAR_Rx_1d1eef94 if post-build-variant-condition{matching-criterion=RDR_POS, value=5}, ComIPduGroupRef=RDR07_oPCAN_RADAR_Rx_b3767e05 if post-build-variant-condition{matching-criterion=RDR_POS, value=6}, ComIPduGroupRef=RDR08_oPCAN_RADAR_Rx_3d9c193f if post-build-variant-condition{matching-criterion=RDR_POS, value=7}
        RDR_FUSION_DET_077_080_oPCAN_RADAR_66646479_Rx: ComIPduDirection=RECEIVE, ComIPduChannelRef=ComMConfigSet/CN_PCAN_RADAR_458ff0f1, ComIPduGroupRef=RDR01_oPCAN_RADAR_Rx_e0e717e1 if post-build-variant-condition{matching-criterion=RDR_POS, value=0}, ComIPduSignalGroupRef=SG_Fusion_Detections_077_080_oRDR_FUSION_DET_077_080_oPCAN_RADAR_ea1c1377_Rx, ComPduIdRef=EcucPduCollection/RDR_FUSION_DET_077_080_oPCAN_RADAR_66646479_Rx, ComIPduGroupRef=RDR02_oPCAN_RADAR_Rx_c92fa313 if post-build-variant-condition{matching-criterion=RDR_POS, value=1}, ComIPduGroupRef=RDR03_oPCAN_RADAR_Rx_67473282 if post-build-variant-condition{matching-criterion=RDR_POS, value=2}, ComIPduGroupRef=RDR04_oPCAN_RADAR_Rx_9abecaf7 if post-build-variant-condition{matching-criterion=RDR_POS, value=3}, ComIPduGroupRef=RDR05_oPCAN_RADAR_Rx_34d65b66 if post-build-variant-condition{matching-criterion=RDR_POS, value=4}, ComIPduGroupRef=RDR06_oPCAN_RADAR_Rx_1d1eef94 if post-build-variant-condition{matching-criterion=RDR_POS, value=5}, ComIPduGroupRef=RDR07_oPCAN_RADAR_Rx_b3767e05 if post-build-variant-condition{matching-criterion=RDR_POS, value=6}, ComIPduGroupRef=RDR08_oPCAN_RADAR_Rx_3d9c193f if post-build-variant-condition{matching-criterion=RDR_POS, value=7}
        RDR_FUSION_DET_081_084_oPCAN_RADAR_f7961d8f_Rx: ComIPduDirection=RECEIVE, ComIPduChannelRef=ComMConfigSet/CN_PCAN_RADAR_458ff0f1, ComIPduGroupRef=RDR01_oPCAN_RADAR_Rx_e0e717e1 if post-build-variant-condition{matching-criterion=RDR_POS, value=0}, ComIPduSignalGroupRef=SG_Fusion_Detections_081_084_oRDR_FUSION_DET_081_084_oPCAN_RADAR_d08af384_Rx, ComPduIdRef=EcucPduCollection/RDR_FUSION_DET_081_084_oPCAN_RADAR_f7961d8f_Rx, ComIPduGroupRef=RDR02_oPCAN_RADAR_Rx_c92fa313 if post-build-variant-condition{matching-criterion=RDR_POS, value=1}, ComIPduGroupRef=RDR03_oPCAN_RADAR_Rx_67473282 if post-build-variant-condition{matching-criterion=RDR_POS, value=2}, ComIPduGroupRef=RDR04_oPCAN_RADAR_Rx_9abecaf7 if post-build-variant-condition{matching-criterion=RDR_POS, value=3}, ComIPduGroupRef=RDR05_oPCAN_RADAR_Rx_34d65b66 if post-build-variant-condition{matching-criterion=RDR_POS, value=4}, ComIPduGroupRef=RDR06_oPCAN_RADAR_Rx_1d1eef94 if post-build-variant-condition{matching-criterion=RDR_POS, value=5}, ComIPduGroupRef=RDR07_oPCAN_RADAR_Rx_b3767e05 if post-build-variant-condition{matching-criterion=RDR_POS, value=6}, ComIPduGroupRef=RDR08_oPCAN_RADAR_Rx_3d9c193f if post-build-variant-condition{matching-criterion=RDR_POS, value=7}
        RDR_FUSION_DET_085_088_oPCAN_RADAR_1e2483bb_Rx: ComIPduDirection=RECEIVE, ComIPduChannelRef=ComMConfigSet/CN_PCAN_RADAR_458ff0f1, ComIPduGroupRef=RDR01_oPCAN_RADAR_Rx_e0e717e1 if post-build-variant-condition{matching-criterion=RDR_POS, value=0}, ComIPduSignalGroupRef=SG_Fusion_Detections_085_088_oRDR_FUSION_DET_085_088_oPCAN_RADAR_9d71d877_Rx, ComPduIdRef=EcucPduCollection/RDR_FUSION_DET_085_088_oPCAN_RADAR_1e2483bb_Rx, ComIPduGroupRef=RDR02_oPCAN_RADAR_Rx_c92fa313 if post-build-variant-condition{matching-criterion=RDR_POS, value=1}, ComIPduGroupRef=RDR03_oPCAN_RADAR_Rx_67473282 if post-build-variant-condition{matching-criterion=RDR_POS, value=2}, ComIPduGroupRef=RDR04_oPCAN_RADAR_Rx_9abecaf7 if post-build-variant-condition{matching-criterion=RDR_POS, value=3}, ComIPduGroupRef=RDR05_oPCAN_RADAR_Rx_34d65b66 if post-build-variant-condition{matching-criterion=RDR_POS, value=4}, ComIPduGroupRef=RDR06_oPCAN_RADAR_Rx_1d1eef94 if post-build-variant-condition{matching-criterion=RDR_POS, value=5}, ComIPduGroupRef=RDR07_oPCAN_RADAR_Rx_b3767e05 if post-build-variant-condition{matching-criterion=RDR_POS, value=6}, ComIPduGroupRef=RDR08_oPCAN_RADAR_Rx_3d9c193f if post-build-variant-condition{matching-criterion=RDR_POS, value=7}
        RDR_FUSION_DET_089_092_oPCAN_RADAR_2c6c6cba_Rx: ComIPduDirection=RECEIVE, ComIPduChannelRef=ComMConfigSet/CN_PCAN_RADAR_458ff0f1, ComIPduGroupRef=RDR01_oPCAN_RADAR_Rx_e0e717e1 if post-build-variant-condition{matching-criterion=RDR_POS, value=0}, ComIPduSignalGroupRef=SG_Fusion_Detections_089_092_oRDR_FUSION_DET_089_092_oPCAN_RADAR_1f429d9f_Rx, ComPduIdRef=EcucPduCollection/RDR_FUSION_DET_089_092_oPCAN_RADAR_2c6c6cba_Rx, ComIPduGroupRef=RDR02_oPCAN_RADAR_Rx_c92fa313 if post-build-variant-condition{matching-criterion=RDR_POS, value=1}, ComIPduGroupRef=RDR03_oPCAN_RADAR_Rx_67473282 if post-build-variant-condition{matching-criterion=RDR_POS, value=2}, ComIPduGroupRef=RDR04_oPCAN_RADAR_Rx_9abecaf7 if post-build-variant-condition{matching-criterion=RDR_POS, value=3}, ComIPduGroupRef=RDR05_oPCAN_RADAR_Rx_34d65b66 if post-build-variant-condition{matching-criterion=RDR_POS, value=4}, ComIPduGroupRef=RDR06_oPCAN_RADAR_Rx_1d1eef94 if post-build-variant-condition{matching-criterion=RDR_POS, value=5}, ComIPduGroupRef=RDR07_oPCAN_RADAR_Rx_b3767e05 if post-build-variant-condition{matching-criterion=RDR_POS, value=6}, ComIPduGroupRef=RDR08_oPCAN_RADAR_Rx_3d9c193f if post-build-variant-condition{matching-criterion=RDR_POS, value=7}
        RDR_FUSION_DET_093_096_oPCAN_RADAR_31ab6f94_Rx: ComIPduDirection=RECEIVE, ComIPduChannelRef=ComMConfigSet/CN_PCAN_RADAR_458ff0f1, ComIPduGroupRef=RDR01_oPCAN_RADAR_Rx_e0e717e1 if post-build-variant-condition{matching-criterion=RDR_POS, value=0}, ComIPduSignalGroupRef=SG_Fusion_Detections_093_096_oRDR_FUSION_DET_093_096_oPCAN_RADAR_ebc9f7ef_Rx, ComPduIdRef=EcucPduCollection/RDR_FUSION_DET_093_096_oPCAN_RADAR_31ab6f94_Rx, ComIPduGroupRef=RDR02_oPCAN_RADAR_Rx_c92fa313 if post-build-variant-condition{matching-criterion=RDR_POS, value=1}, ComIPduGroupRef=RDR03_oPCAN_RADAR_Rx_67473282 if post-build-variant-condition{matching-criterion=RDR_POS, value=2}, ComIPduGroupRef=RDR04_oPCAN_RADAR_Rx_9abecaf7 if post-build-variant-condition{matching-criterion=RDR_POS, value=3}, ComIPduGroupRef=RDR05_oPCAN_RADAR_Rx_34d65b66 if post-build-variant-condition{matching-criterion=RDR_POS, value=4}, ComIPduGroupRef=RDR06_oPCAN_RADAR_Rx_1d1eef94 if post-build-variant-condition{matching-criterion=RDR_POS, value=5}, ComIPduGroupRef=RDR07_oPCAN_RADAR_Rx_b3767e05 if post-build-variant-condition{matching-criterion=RDR_POS, value=6}, ComIPduGroupRef=RDR08_oPCAN_RADAR_Rx_3d9c193f if post-build-variant-condition{matching-criterion=RDR_POS, value=7}
        RDR_FUSION_DET_097_100_oPCAN_RADAR_f5ebb32e_Rx: ComIPduDirection=RECEIVE, ComIPduChannelRef=ComMConfigSet/CN_PCAN_RADAR_458ff0f1, ComIPduGroupRef=RDR01_oPCAN_RADAR_Rx_e0e717e1 if post-build-variant-condition{matching-criterion=RDR_POS, value=0}, ComIPduSignalGroupRef=SG_Fusion_Detections_097_100_oRDR_FUSION_DET_097_100_oPCAN_RADAR_f997174e_Rx, ComPduIdRef=EcucPduCollection/RDR_FUSION_DET_097_100_oPCAN_RADAR_f5ebb32e_Rx, ComIPduGroupRef=RDR02_oPCAN_RADAR_Rx_c92fa313 if post-build-variant-condition{matching-criterion=RDR_POS, value=1}, ComIPduGroupRef=RDR03_oPCAN_RADAR_Rx_67473282 if post-build-variant-condition{matching-criterion=RDR_POS, value=2}, ComIPduGroupRef=RDR04_oPCAN_RADAR_Rx_9abecaf7 if post-build-variant-condition{matching-criterion=RDR_POS, value=3}, ComIPduGroupRef=RDR05_oPCAN_RADAR_Rx_34d65b66 if post-build-variant-condition{matching-criterion=RDR_POS, value=4}, ComIPduGroupRef=RDR06_oPCAN_RADAR_Rx_1d1eef94 if post-build-variant-condition{matching-criterion=RDR_POS, value=5}, ComIPduGroupRef=RDR07_oPCAN_RADAR_Rx_b3767e05 if post-build-variant-condition{matching-criterion=RDR_POS, value=6}, ComIPduGroupRef=RDR08_oPCAN_RADAR_Rx_3d9c193f if post-build-variant-condition{matching-criterion=RDR_POS, value=7}
        RDR_FUSION_DET_101_104_oPCAN_RADAR_bd87f605_Rx: ComIPduDirection=RECEIVE, ComIPduChannelRef=ComMConfigSet/CN_PCAN_RADAR_458ff0f1, ComIPduGroupRef=RDR01_oPCAN_RADAR_Rx_e0e717e1 if post-build-variant-condition{matching-criterion=RDR_POS, value=0}, ComIPduSignalGroupRef=SG_Fusion_Detections_101_104_oRDR_FUSION_DET_101_104_oPCAN_RADAR_2dfb2b7d_Rx, ComPduIdRef=EcucPduCollection/RDR_FUSION_DET_101_104_oPCAN_RADAR_bd87f605_Rx, ComIPduGroupRef=RDR02_oPCAN_RADAR_Rx_c92fa313 if post-build-variant-condition{matching-criterion=RDR_POS, value=1}, ComIPduGroupRef=RDR03_oPCAN_RADAR_Rx_67473282 if post-build-variant-condition{matching-criterion=RDR_POS, value=2}, ComIPduGroupRef=RDR04_oPCAN_RADAR_Rx_9abecaf7 if post-build-variant-condition{matching-criterion=RDR_POS, value=3}, ComIPduGroupRef=RDR05_oPCAN_RADAR_Rx_34d65b66 if post-build-variant-condition{matching-criterion=RDR_POS, value=4}, ComIPduGroupRef=RDR06_oPCAN_RADAR_Rx_1d1eef94 if post-build-variant-condition{matching-criterion=RDR_POS, value=5}, ComIPduGroupRef=RDR07_oPCAN_RADAR_Rx_b3767e05 if post-build-variant-condition{matching-criterion=RDR_POS, value=6}, ComIPduGroupRef=RDR08_oPCAN_RADAR_Rx_3d9c193f if post-build-variant-condition{matching-criterion=RDR_POS, value=7}
        RDR_FUSION_DET_105_108_oPCAN_RADAR_54356831_Rx: ComIPduDirection=RECEIVE, ComIPduChannelRef=ComMConfigSet/CN_PCAN_RADAR_458ff0f1, ComIPduGroupRef=RDR01_oPCAN_RADAR_Rx_e0e717e1 if post-build-variant-condition{matching-criterion=RDR_POS, value=0}, ComIPduSignalGroupRef=SG_Fusion_Detections_105_108_oRDR_FUSION_DET_105_108_oPCAN_RADAR_6000008e_Rx, ComPduIdRef=EcucPduCollection/RDR_FUSION_DET_105_108_oPCAN_RADAR_54356831_Rx, ComIPduGroupRef=RDR02_oPCAN_RADAR_Rx_c92fa313 if post-build-variant-condition{matching-criterion=RDR_POS, value=1}, ComIPduGroupRef=RDR03_oPCAN_RADAR_Rx_67473282 if post-build-variant-condition{matching-criterion=RDR_POS, value=2}, ComIPduGroupRef=RDR04_oPCAN_RADAR_Rx_9abecaf7 if post-build-variant-condition{matching-criterion=RDR_POS, value=3}, ComIPduGroupRef=RDR05_oPCAN_RADAR_Rx_34d65b66 if post-build-variant-condition{matching-criterion=RDR_POS, value=4}, ComIPduGroupRef=RDR06_oPCAN_RADAR_Rx_1d1eef94 if post-build-variant-condition{matching-criterion=RDR_POS, value=5}, ComIPduGroupRef=RDR07_oPCAN_RADAR_Rx_b3767e05 if post-build-variant-condition{matching-criterion=RDR_POS, value=6}, ComIPduGroupRef=RDR08_oPCAN_RADAR_Rx_3d9c193f if post-build-variant-condition{matching-criterion=RDR_POS, value=7}
        RDR_FUSION_DET_109_112_oPCAN_RADAR_667d8730_Rx: ComIPduDirection=RECEIVE, ComIPduChannelRef=ComMConfigSet/CN_PCAN_RADAR_458ff0f1, ComIPduGroupRef=RDR01_oPCAN_RADAR_Rx_e0e717e1 if post-build-variant-condition{matching-criterion=RDR_POS, value=0}, ComIPduSignalGroupRef=SG_Fusion_Detections_109_112_oRDR_FUSION_DET_109_112_oPCAN_RADAR_e2334566_Rx, ComPduIdRef=EcucPduCollection/RDR_FUSION_DET_109_112_oPCAN_RADAR_667d8730_Rx, ComIPduGroupRef=RDR02_oPCAN_RADAR_Rx_c92fa313 if post-build-variant-condition{matching-criterion=RDR_POS, value=1}, ComIPduGroupRef=RDR03_oPCAN_RADAR_Rx_67473282 if post-build-variant-condition{matching-criterion=RDR_POS, value=2}, ComIPduGroupRef=RDR04_oPCAN_RADAR_Rx_9abecaf7 if post-build-variant-condition{matching-criterion=RDR_POS, value=3}, ComIPduGroupRef=RDR05_oPCAN_RADAR_Rx_34d65b66 if post-build-variant-condition{matching-criterion=RDR_POS, value=4}, ComIPduGroupRef=RDR06_oPCAN_RADAR_Rx_1d1eef94 if post-build-variant-condition{matching-criterion=RDR_POS, value=5}, ComIPduGroupRef=RDR07_oPCAN_RADAR_Rx_b3767e05 if post-build-variant-condition{matching-criterion=RDR_POS, value=6}, ComIPduGroupRef=RDR08_oPCAN_RADAR_Rx_3d9c193f if post-build-variant-condition{matching-criterion=RDR_POS, value=7}
        RDR_FUSION_DET_113_116_oPCAN_RADAR_7bba841e_Rx: ComIPduDirection=RECEIVE, ComIPduChannelRef=ComMConfigSet/CN_PCAN_RADAR_458ff0f1, ComIPduGroupRef=RDR01_oPCAN_RADAR_Rx_e0e717e1 if post-build-variant-condition{matching-criterion=RDR_POS, value=0}, ComIPduSignalGroupRef=SG_Fusion_Detections_113_116_oRDR_FUSION_DET_113_116_oPCAN_RADAR_16b82f16_Rx, ComPduIdRef=EcucPduCollection/RDR_FUSION_DET_113_116_oPCAN_RADAR_7bba841e_Rx, ComIPduGroupRef=RDR02_oPCAN_RADAR_Rx_c92fa313 if post-build-variant-condition{matching-criterion=RDR_POS, value=1}, ComIPduGroupRef=RDR03_oPCAN_RADAR_Rx_67473282 if post-build-variant-condition{matching-criterion=RDR_POS, value=2}, ComIPduGroupRef=RDR04_oPCAN_RADAR_Rx_9abecaf7 if post-build-variant-condition{matching-criterion=RDR_POS, value=3}, ComIPduGroupRef=RDR05_oPCAN_RADAR_Rx_34d65b66 if post-build-variant-condition{matching-criterion=RDR_POS, value=4}, ComIPduGroupRef=RDR06_oPCAN_RADAR_Rx_1d1eef94 if post-build-variant-condition{matching-criterion=RDR_POS, value=5}, ComIPduGroupRef=RDR07_oPCAN_RADAR_Rx_b3767e05 if post-build-variant-condition{matching-criterion=RDR_POS, value=6}, ComIPduGroupRef=RDR08_oPCAN_RADAR_Rx_3d9c193f if post-build-variant-condition{matching-criterion=RDR_POS, value=7}
        RDR_FUSION_DET_117_120_oPCAN_RADAR_d43659d7_Rx: ComIPduDirection=RECEIVE, ComIPduChannelRef=ComMConfigSet/CN_PCAN_RADAR_458ff0f1, ComIPduGroupRef=RDR01_oPCAN_RADAR_Rx_e0e717e1 if post-build-variant-condition{matching-criterion=RDR_POS, value=0}, ComIPduSignalGroupRef=SG_Fusion_Detections_117_120_oRDR_FUSION_DET_117_120_oPCAN_RADAR_56a2c27e_Rx, ComPduIdRef=EcucPduCollection/RDR_FUSION_DET_117_120_oPCAN_RADAR_d43659d7_Rx, ComIPduGroupRef=RDR02_oPCAN_RADAR_Rx_c92fa313 if post-build-variant-condition{matching-criterion=RDR_POS, value=1}, ComIPduGroupRef=RDR03_oPCAN_RADAR_Rx_67473282 if post-build-variant-condition{matching-criterion=RDR_POS, value=2}, ComIPduGroupRef=RDR04_oPCAN_RADAR_Rx_9abecaf7 if post-build-variant-condition{matching-criterion=RDR_POS, value=3}, ComIPduGroupRef=RDR05_oPCAN_RADAR_Rx_34d65b66 if post-build-variant-condition{matching-criterion=RDR_POS, value=4}, ComIPduGroupRef=RDR06_oPCAN_RADAR_Rx_1d1eef94 if post-build-variant-condition{matching-criterion=RDR_POS, value=5}, ComIPduGroupRef=RDR07_oPCAN_RADAR_Rx_b3767e05 if post-build-variant-condition{matching-criterion=RDR_POS, value=6}, ComIPduGroupRef=RDR08_oPCAN_RADAR_Rx_3d9c193f if post-build-variant-condition{matching-criterion=RDR_POS, value=7}
        RDR_FUSION_DET_121_124_oPCAN_RADAR_593d592b_Rx: ComIPduDirection=RECEIVE, ComIPduChannelRef=ComMConfigSet/CN_PCAN_RADAR_458ff0f1, ComIPduGroupRef=RDR01_oPCAN_RADAR_Rx_e0e717e1 if post-build-variant-condition{matching-criterion=RDR_POS, value=0}, ComIPduSignalGroupRef=SG_Fusion_Detections_121_124_oRDR_FUSION_DET_121_124_oPCAN_RADAR_9023764b_Rx, ComPduIdRef=EcucPduCollection/RDR_FUSION_DET_121_124_oPCAN_RADAR_593d592b_Rx, ComIPduGroupRef=RDR02_oPCAN_RADAR_Rx_c92fa313 if post-build-variant-condition{matching-criterion=RDR_POS, value=1}, ComIPduGroupRef=RDR03_oPCAN_RADAR_Rx_67473282 if post-build-variant-condition{matching-criterion=RDR_POS, value=2}, ComIPduGroupRef=RDR04_oPCAN_RADAR_Rx_9abecaf7 if post-build-variant-condition{matching-criterion=RDR_POS, value=3}, ComIPduGroupRef=RDR05_oPCAN_RADAR_Rx_34d65b66 if post-build-variant-condition{matching-criterion=RDR_POS, value=4}, ComIPduGroupRef=RDR06_oPCAN_RADAR_Rx_1d1eef94 if post-build-variant-condition{matching-criterion=RDR_POS, value=5}, ComIPduGroupRef=RDR07_oPCAN_RADAR_Rx_b3767e05 if post-build-variant-condition{matching-criterion=RDR_POS, value=6}, ComIPduGroupRef=RDR08_oPCAN_RADAR_Rx_3d9c193f if post-build-variant-condition{matching-criterion=RDR_POS, value=7}
        RDR_FUSION_DET_125_128_oPCAN_RADAR_b08fc71f_Rx: ComIPduDirection=RECEIVE, ComIPduChannelRef=ComMConfigSet/CN_PCAN_RADAR_458ff0f1, ComIPduGroupRef=RDR01_oPCAN_RADAR_Rx_e0e717e1 if post-build-variant-condition{matching-criterion=RDR_POS, value=0}, ComIPduSignalGroupRef=SG_Fusion_Detections_125_128_oRDR_FUSION_DET_125_128_oPCAN_RADAR_ddd85db8_Rx, ComPduIdRef=EcucPduCollection/RDR_FUSION_DET_125_128_oPCAN_RADAR_b08fc71f_Rx, ComIPduGroupRef=RDR02_oPCAN_RADAR_Rx_c92fa313 if post-build-variant-condition{matching-criterion=RDR_POS, value=1}, ComIPduGroupRef=RDR03_oPCAN_RADAR_Rx_67473282 if post-build-variant-condition{matching-criterion=RDR_POS, value=2}, ComIPduGroupRef=RDR04_oPCAN_RADAR_Rx_9abecaf7 if post-build-variant-condition{matching-criterion=RDR_POS, value=3}, ComIPduGroupRef=RDR05_oPCAN_RADAR_Rx_34d65b66 if post-build-variant-condition{matching-criterion=RDR_POS, value=4}, ComIPduGroupRef=RDR06_oPCAN_RADAR_Rx_1d1eef94 if post-build-variant-condition{matching-criterion=RDR_POS, value=5}, ComIPduGroupRef=RDR07_oPCAN_RADAR_Rx_b3767e05 if post-build-variant-condition{matching-criterion=RDR_POS, value=6}, ComIPduGroupRef=RDR08_oPCAN_RADAR_Rx_3d9c193f if post-build-variant-condition{matching-criterion=RDR_POS, value=7}
        RDR_FUSION_HEADER_001_oPCAN_RADAR_cc468fbf_Rx: ComIPduDirection=RECEIVE, ComIPduChannelRef=ComMConfigSet/CN_PCAN_RADAR_458ff0f1, ComIPduGroupRef=RDR01_oPCAN_RADAR_Rx_e0e717e1 if post-build-variant-condition{matching-criterion=RDR_POS, value=0}, ComIPduSignalGroupRef=SG_Fusion_RadarHeader_oRDR_FUSION_HEADER_001_oPCAN_RADAR_cad756d0_Rx, ComPduIdRef=EcucPduCollection/RDR_FUSION_HEADER_001_oPCAN_RADAR_cc468fbf_Rx, ComIPduGroupRef=RDR02_oPCAN_RADAR_Rx_c92fa313 if post-build-variant-condition{matching-criterion=RDR_POS, value=1}, ComIPduGroupRef=RDR03_oPCAN_RADAR_Rx_67473282 if post-build-variant-condition{matching-criterion=RDR_POS, value=2}, ComIPduGroupRef=RDR04_oPCAN_RADAR_Rx_9abecaf7 if post-build-variant-condition{matching-criterion=RDR_POS, value=3}, ComIPduGroupRef=RDR05_oPCAN_RADAR_Rx_34d65b66 if post-build-variant-condition{matching-criterion=RDR_POS, value=4}, ComIPduGroupRef=RDR06_oPCAN_RADAR_Rx_1d1eef94 if post-build-variant-condition{matching-criterion=RDR_POS, value=5}, ComIPduGroupRef=RDR07_oPCAN_RADAR_Rx_b3767e05 if post-build-variant-condition{matching-criterion=RDR_POS, value=6}, ComIPduGroupRef=RDR08_oPCAN_RADAR_Rx_3d9c193f if post-build-variant-condition{matching-criterion=RDR_POS, value=7}
        RDR_FUSION_STATUS_001_oPCAN_RADAR_8bf3739d_Rx: ComIPduDirection=RECEIVE, ComIPduChannelRef=ComMConfigSet/CN_PCAN_RADAR_458ff0f1, ComIPduGroupRef=RDR01_oPCAN_RADAR_Rx_e0e717e1 if post-build-variant-condition{matching-criterion=RDR_POS, value=0}, ComIPduSignalGroupRef=SG_Fusion_RadarStatus_oRDR_FUSION_STATUS_001_oPCAN_RADAR_00ff53b8_Rx, ComPduIdRef=EcucPduCollection/RDR_FUSION_STATUS_001_oPCAN_RADAR_8bf3739d_Rx, ComIPduGroupRef=RDR02_oPCAN_RADAR_Rx_c92fa313 if post-build-variant-condition{matching-criterion=RDR_POS, value=1}, ComIPduGroupRef=RDR03_oPCAN_RADAR_Rx_67473282 if post-build-variant-condition{matching-criterion=RDR_POS, value=2}, ComIPduGroupRef=RDR04_oPCAN_RADAR_Rx_9abecaf7 if post-build-variant-condition{matching-criterion=RDR_POS, value=3}, ComIPduGroupRef=RDR05_oPCAN_RADAR_Rx_34d65b66 if post-build-variant-condition{matching-criterion=RDR_POS, value=4}, ComIPduGroupRef=RDR06_oPCAN_RADAR_Rx_1d1eef94 if post-build-variant-condition{matching-criterion=RDR_POS, value=5}, ComIPduGroupRef=RDR07_oPCAN_RADAR_Rx_b3767e05 if post-build-variant-condition{matching-criterion=RDR_POS, value=6}, ComIPduGroupRef=RDR08_oPCAN_RADAR_Rx_3d9c193f if post-build-variant-condition{matching-criterion=RDR_POS, value=7}
        RDR_FUSION_STATUS_002_oPCAN_RADAR_36391f53_Rx: ComIPduDirection=RECEIVE, ComIPduChannelRef=ComMConfigSet/CN_PCAN_RADAR_458ff0f1, ComIPduGroupRef=RDR01_oPCAN_RADAR_Rx_e0e717e1 if post-build-variant-condition{matching-criterion=RDR_POS, value=0}, ComIPduSignalGroupRef=SG_Fusion_RadarStatus2_oRDR_FUSION_STATUS_002_oPCAN_RADAR_458079fc_Rx, ComPduIdRef=EcucPduCollection/RDR_FUSION_STATUS_002_oPCAN_RADAR_36391f53_Rx, ComIPduGroupRef=RDR02_oPCAN_RADAR_Rx_c92fa313 if post-build-variant-condition{matching-criterion=RDR_POS, value=1}, ComIPduGroupRef=RDR03_oPCAN_RADAR_Rx_67473282 if post-build-variant-condition{matching-criterion=RDR_POS, value=2}, ComIPduGroupRef=RDR04_oPCAN_RADAR_Rx_9abecaf7 if post-build-variant-condition{matching-criterion=RDR_POS, value=3}, ComIPduGroupRef=RDR05_oPCAN_RADAR_Rx_34d65b66 if post-build-variant-condition{matching-criterion=RDR_POS, value=4}, ComIPduGroupRef=RDR06_oPCAN_RADAR_Rx_1d1eef94 if post-build-variant-condition{matching-criterion=RDR_POS, value=5}, ComIPduGroupRef=RDR07_oPCAN_RADAR_Rx_b3767e05 if post-build-variant-condition{matching-criterion=RDR_POS, value=6}, ComIPduGroupRef=RDR08_oPCAN_RADAR_Rx_3d9c193f if post-build-variant-condition{matching-criterion=RDR_POS, value=7}
        RDR_HEADER_001_oPCAN_RADAR_0cd81ee7_Tx: ComIPduDirection=SEND, ComIPduChannelRef=ComMConfigSet/CN_PCAN_RADAR_458ff0f1, ComIPduGroupRef=RDR01_oPCAN_RADAR_Tx_b6bdb067 if post-build-variant-condition{matching-criterion=RDR_POS, value=0}, ComIPduSignalGroupRef=SG_RadarHeader_oRDR_HEADER_001_oPCAN_RADAR_48334d97_Tx, ComPduIdRef=EcucPduCollection/RDR_HEADER_001_oPCAN_RADAR_0cd81ee7_Tx, ComIPduGroupRef=RDR02_oPCAN_RADAR_Tx_9f750495 if post-build-variant-condition{matching-criterion=RDR_POS, value=1}, ComIPduGroupRef=RDR03_oPCAN_RADAR_Tx_311d9504 if post-build-variant-condition{matching-criterion=RDR_POS, value=2}, ComIPduGroupRef=RDR04_oPCAN_RADAR_Tx_cce46d71 if post-build-variant-condition{matching-criterion=RDR_POS, value=3}, ComIPduGroupRef=RDR05_oPCAN_RADAR_Tx_628cfce0 if post-build-variant-condition{matching-criterion=RDR_POS, value=4}, ComIPduGroupRef=RDR06_oPCAN_RADAR_Tx_4b444812 if post-build-variant-condition{matching-criterion=RDR_POS, value=5}, ComIPduGroupRef=RDR07_oPCAN_RADAR_Tx_e52cd983 if post-build-variant-condition{matching-criterion=RDR_POS, value=6}, ComIPduGroupRef=RDR08_oPCAN_RADAR_Tx_6bc6beb9 if post-build-variant-condition{matching-criterion=RDR_POS, value=7}
          ComTxIPdu: ComMinimumDelayTime=0, ComTxIPduUnusedAreasDefault=0
        RDR_NM_oPCAN_RADAR_e768d4ad_Tx: ComIPduDirection=SEND, ComIPduSignalRef=RDR_NM_CAN_NM_State_oRDR_NM_oPCAN_RADAR_1bab6607_Tx, ComIPduSignalRef=RDR_NM_CBV_ActWakeBit_4_oRDR_NM_oPCAN_RADAR_0227ef40_Tx, ComIPduSignalRef=RDR_NM_CBV_NMCoordBit_3_oRDR_NM_oPCAN_RADAR_a134f8ab_Tx, ComIPduSignalRef=RDR_NM_CBV_PNIBit_6_oRDR_NM_oPCAN_RADAR_9b76e7e6_Tx, ComIPduSignalRef=RDR_NM_CBV_ReptMsgBit0_oRDR_NM_oPCAN_RADAR_e7779b42_Tx, ComIPduSignalRef=RDR_NM_CBV_ResdBit_1_oRDR_NM_oPCAN_RADAR_c2cd19c3_Tx, ComIPduSignalRef=RDR_NM_CBV_ResdBit_2_oRDR_NM_oPCAN_RADAR_b9d39b20_Tx, ComIPduSignalRef=RDR_NM_CBV_ResdBit_5_oRDR_NM_oPCAN_RADAR_d0341d78_Tx, ComIPduSignalRef=RDR_NM_CBV_ResdBit_7_oRDR_NM_oPCAN_RADAR_34f01c05_Tx, ComIPduSignalRef=RDR_NM_PNC_Reserved1_oRDR_NM_oPCAN_RADAR_a181c714_Tx, ComIPduSignalRef=RDR_NM_PNC_Reserved2_oRDR_NM_oPCAN_RADAR_da9f45f7_Tx, ComIPduSignalRef=RDR_NM_PNC_Reserved3_oRDR_NM_oPCAN_RADAR_4545c669_Tx, ComIPduSignalRef=RDR_NM_PN_User_Data_oRDR_NM_oPCAN_RADAR_befb962b_Tx, ComIPduSignalRef=RDR_NM_Wakeup_And_Reason_oRDR_NM_oPCAN_RADAR_bb9c29d2_Tx, ComPduIdRef=EcucPduCollection/RDR_NM_oPCAN_RADAR_e768d4ad_Tx
          ComTxIPdu: ComTxIPduUnusedAreasDefault=0  # RDR_NM_oPCAN_RADAR
        RDR_OBJ_HEADER_002_oPCAN_RADAR_1ea433e3_Tx: ComIPduDirection=SEND, ComIPduChannelRef=ComMConfigSet/CN_PCAN_RADAR_458ff0f1, ComIPduGroupRef=RDR01_oPCAN_RADAR_Tx_b6bdb067 if post-build-variant-condition{matching-criterion=RDR_POS, value=0}, ComIPduSignalGroupRef=SG_TrackerHeader_oRDR_OBJ_HEADER_002_oPCAN_RADAR_563ddea3_Tx, ComPduIdRef=EcucPduCollection/RDR_OBJ_HEADER_002_oPCAN_RADAR_1ea433e3_Tx, ComIPduGroupRef=RDR02_oPCAN_RADAR_Tx_9f750495 if post-build-variant-condition{matching-criterion=RDR_POS, value=1}, ComIPduGroupRef=RDR03_oPCAN_RADAR_Tx_311d9504 if post-build-variant-condition{matching-criterion=RDR_POS, value=2}, ComIPduGroupRef=RDR04_oPCAN_RADAR_Tx_cce46d71 if post-build-variant-condition{matching-criterion=RDR_POS, value=3}, ComIPduGroupRef=RDR05_oPCAN_RADAR_Tx_628cfce0 if post-build-variant-condition{matching-criterion=RDR_POS, value=4}, ComIPduGroupRef=RDR06_oPCAN_RADAR_Tx_4b444812 if post-build-variant-condition{matching-criterion=RDR_POS, value=5}, ComIPduGroupRef=RDR07_oPCAN_RADAR_Tx_e52cd983 if post-build-variant-condition{matching-criterion=RDR_POS, value=6}, ComIPduGroupRef=RDR08_oPCAN_RADAR_Tx_6bc6beb9 if post-build-variant-condition{matching-criterion=RDR_POS, value=7}
          ComTxIPdu: ComMinimumDelayTime=0, ComTxIPduUnusedAreasDefault=0
        RDR_OBJ_STATUS_003_oPCAN_RADAR_84871644_Tx: ComIPduDirection=SEND, ComIPduChannelRef=ComMConfigSet/CN_PCAN_RADAR_458ff0f1, ComIPduGroupRef=RDR01_oPCAN_RADAR_Tx_b6bdb067 if post-build-variant-condition{matching-criterion=RDR_POS, value=0}, ComIPduSignalGroupRef=SG_TrackerStatus_oRDR_OBJ_STATUS_003_oPCAN_RADAR_3d577421_Tx, ComPduIdRef=EcucPduCollection/RDR_OBJ_STATUS_003_oPCAN_RADAR_84871644_Tx, ComIPduGroupRef=RDR02_oPCAN_RADAR_Tx_9f750495 if post-build-variant-condition{matching-criterion=RDR_POS, value=1}, ComIPduGroupRef=RDR03_oPCAN_RADAR_Tx_311d9504 if post-build-variant-condition{matching-criterion=RDR_POS, value=2}, ComIPduGroupRef=RDR04_oPCAN_RADAR_Tx_cce46d71 if post-build-variant-condition{matching-criterion=RDR_POS, value=3}, ComIPduGroupRef=RDR05_oPCAN_RADAR_Tx_628cfce0 if post-build-variant-condition{matching-criterion=RDR_POS, value=4}, ComIPduGroupRef=RDR06_oPCAN_RADAR_Tx_4b444812 if post-build-variant-condition{matching-criterion=RDR_POS, value=5}, ComIPduGroupRef=RDR07_oPCAN_RADAR_Tx_e52cd983 if post-build-variant-condition{matching-criterion=RDR_POS, value=6}, ComIPduGroupRef=RDR08_oPCAN_RADAR_Tx_6bc6beb9 if post-build-variant-condition{matching-criterion=RDR_POS, value=7}
          ComTxIPdu: ComMinimumDelayTime=0, ComTxIPduUnusedAreasDefault=0
        RDR_STATUS_001_oPCAN_RADAR_4b6de2c5_Tx: ComIPduDirection=SEND, ComIPduChannelRef=ComMConfigSet/CN_PCAN_RADAR_458ff0f1, ComIPduGroupRef=RDR01_oPCAN_RADAR_Tx_b6bdb067 if post-build-variant-condition{matching-criterion=RDR_POS, value=0}, ComIPduSignalGroupRef=SG_RadarStatus1_oRDR_STATUS_001_oPCAN_RADAR_4935b1b8_Tx, ComPduIdRef=EcucPduCollection/RDR_STATUS_001_oPCAN_RADAR_4b6de2c5_Tx, ComIPduGroupRef=RDR02_oPCAN_RADAR_Tx_9f750495 if post-build-variant-condition{matching-criterion=RDR_POS, value=1}, ComIPduGroupRef=RDR03_oPCAN_RADAR_Tx_311d9504 if post-build-variant-condition{matching-criterion=RDR_POS, value=2}, ComIPduGroupRef=RDR04_oPCAN_RADAR_Tx_cce46d71 if post-build-variant-condition{matching-criterion=RDR_POS, value=3}, ComIPduGroupRef=RDR05_oPCAN_RADAR_Tx_628cfce0 if post-build-variant-condition{matching-criterion=RDR_POS, value=4}, ComIPduGroupRef=RDR06_oPCAN_RADAR_Tx_4b444812 if post-build-variant-condition{matching-criterion=RDR_POS, value=5}, ComIPduGroupRef=RDR07_oPCAN_RADAR_Tx_e52cd983 if post-build-variant-condition{matching-criterion=RDR_POS, value=6}, ComIPduGroupRef=RDR08_oPCAN_RADAR_Tx_6bc6beb9 if post-build-variant-condition{matching-criterion=RDR_POS, value=7}
          ComTxIPdu: ComMinimumDelayTime=0, ComTxIPduUnusedAreasDefault=0
            ComTxModeFalse
              ComTxMode: ComTxModeMode=PERIODIC, ComTxModeTimeOffset=0, ComTxModeTimePeriod=1
            ComTxModeTrue
              ComTxMode: ComTxModeMode=PERIODIC, ComTxModeTimeOffset=0, ComTxModeTimePeriod=1
        RDR_STATUS_002_oPCAN_RADAR_f6a78e0b_Tx: ComIPduDirection=SEND, ComIPduChannelRef=ComMConfigSet/CN_PCAN_RADAR_458ff0f1, ComIPduGroupRef=RDR01_oPCAN_RADAR_Tx_b6bdb067 if post-build-variant-condition{matching-criterion=RDR_POS, value=0}, ComIPduSignalGroupRef=SG_RadarStatus2_oRDR_STATUS_002_oPCAN_RADAR_51f7b61a_Tx, ComPduIdRef=EcucPduCollection/RDR_STATUS_002_oPCAN_RADAR_f6a78e0b_Tx, ComIPduGroupRef=RDR02_oPCAN_RADAR_Tx_9f750495 if post-build-variant-condition{matching-criterion=RDR_POS, value=1}, ComIPduGroupRef=RDR03_oPCAN_RADAR_Tx_311d9504 if post-build-variant-condition{matching-criterion=RDR_POS, value=2}, ComIPduGroupRef=RDR04_oPCAN_RADAR_Tx_cce46d71 if post-build-variant-condition{matching-criterion=RDR_POS, value=3}, ComIPduGroupRef=RDR05_oPCAN_RADAR_Tx_628cfce0 if post-build-variant-condition{matching-criterion=RDR_POS, value=4}, ComIPduGroupRef=RDR06_oPCAN_RADAR_Tx_4b444812 if post-build-variant-condition{matching-criterion=RDR_POS, value=5}, ComIPduGroupRef=RDR07_oPCAN_RADAR_Tx_e52cd983 if post-build-variant-condition{matching-criterion=RDR_POS, value=6}, ComIPduGroupRef=RDR08_oPCAN_RADAR_Tx_6bc6beb9 if post-build-variant-condition{matching-criterion=RDR_POS, value=7}
          ComTxIPdu: ComMinimumDelayTime=0, ComTxIPduUnusedAreasDefault=0
            ComTxModeFalse
              ComTxMode: ComTxModeMode=PERIODIC, ComTxModeTimeOffset=0, ComTxModeTimePeriod=0.05
            ComTxModeTrue
              ComTxMode: ComTxModeMode=PERIODIC, ComTxModeTimeOffset=0, ComTxModeTimePeriod=0.05
        RDR_TRACKER_OBJ_001_oPCAN_RADAR_2e87fb56_Tx: ComIPduDirection=SEND, ComIPduChannelRef=ComMConfigSet/CN_PCAN_RADAR_458ff0f1, ComIPduGroupRef=RDR01_oPCAN_RADAR_Tx_b6bdb067 if post-build-variant-condition{matching-criterion=RDR_POS, value=0}, ComIPduSignalGroupRef=SG_TrackerObject001_oRDR_TRACKER_OBJ_001_oPCAN_RADAR_a5be7e9d_Tx, ComPduIdRef=EcucPduCollection/RDR_TRACKER_OBJ_001_oPCAN_RADAR_2e87fb56_Tx, ComIPduGroupRef=RDR02_oPCAN_RADAR_Tx_9f750495 if post-build-variant-condition{matching-criterion=RDR_POS, value=1}, ComIPduGroupRef=RDR03_oPCAN_RADAR_Tx_311d9504 if post-build-variant-condition{matching-criterion=RDR_POS, value=2}, ComIPduGroupRef=RDR04_oPCAN_RADAR_Tx_cce46d71 if post-build-variant-condition{matching-criterion=RDR_POS, value=3}, ComIPduGroupRef=RDR05_oPCAN_RADAR_Tx_628cfce0 if post-build-variant-condition{matching-criterion=RDR_POS, value=4}, ComIPduGroupRef=RDR06_oPCAN_RADAR_Tx_4b444812 if post-build-variant-condition{matching-criterion=RDR_POS, value=5}, ComIPduGroupRef=RDR07_oPCAN_RADAR_Tx_e52cd983 if post-build-variant-condition{matching-criterion=RDR_POS, value=6}, ComIPduGroupRef=RDR08_oPCAN_RADAR_Tx_6bc6beb9 if post-build-variant-condition{matching-criterion=RDR_POS, value=7}
          ComTxIPdu: ComMinimumDelayTime=0, ComTxIPduUnusedAreasDefault=0
        RDR_TRACKER_OBJ_002_oPCAN_RADAR_934d9798_Tx: ComIPduDirection=SEND, ComIPduChannelRef=ComMConfigSet/CN_PCAN_RADAR_458ff0f1, ComIPduGroupRef=RDR01_oPCAN_RADAR_Tx_b6bdb067 if post-build-variant-condition{matching-criterion=RDR_POS, value=0}, ComIPduSignalGroupRef=SG_TrackerObject002_oRDR_TRACKER_OBJ_002_oPCAN_RADAR_75f2e109_Tx, ComPduIdRef=EcucPduCollection/RDR_TRACKER_OBJ_002_oPCAN_RADAR_934d9798_Tx, ComIPduGroupRef=RDR02_oPCAN_RADAR_Tx_9f750495 if post-build-variant-condition{matching-criterion=RDR_POS, value=1}, ComIPduGroupRef=RDR03_oPCAN_RADAR_Tx_311d9504 if post-build-variant-condition{matching-criterion=RDR_POS, value=2}, ComIPduGroupRef=RDR04_oPCAN_RADAR_Tx_cce46d71 if post-build-variant-condition{matching-criterion=RDR_POS, value=3}, ComIPduGroupRef=RDR05_oPCAN_RADAR_Tx_628cfce0 if post-build-variant-condition{matching-criterion=RDR_POS, value=4}, ComIPduGroupRef=RDR06_oPCAN_RADAR_Tx_4b444812 if post-build-variant-condition{matching-criterion=RDR_POS, value=5}, ComIPduGroupRef=RDR07_oPCAN_RADAR_Tx_e52cd983 if post-build-variant-condition{matching-criterion=RDR_POS, value=6}, ComIPduGroupRef=RDR08_oPCAN_RADAR_Tx_6bc6beb9 if post-build-variant-condition{matching-criterion=RDR_POS, value=7}
          ComTxIPdu: ComMinimumDelayTime=0, ComTxIPduUnusedAreasDefault=0
        RDR_TRACKER_OBJ_003_oPCAN_RADAR_4edb4e1d_Tx: ComIPduDirection=SEND, ComIPduChannelRef=ComMConfigSet/CN_PCAN_RADAR_458ff0f1, ComIPduGroupRef=RDR01_oPCAN_RADAR_Tx_b6bdb067 if post-build-variant-condition{matching-criterion=RDR_POS, value=0}, ComIPduSignalGroupRef=SG_TrackerObject003_oRDR_TRACKER_OBJ_003_oPCAN_RADAR_8ce669ba_Tx, ComPduIdRef=EcucPduCollection/RDR_TRACKER_OBJ_003_oPCAN_RADAR_4edb4e1d_Tx, ComIPduGroupRef=RDR02_oPCAN_RADAR_Tx_9f750495 if post-build-variant-condition{matching-criterion=RDR_POS, value=1}, ComIPduGroupRef=RDR03_oPCAN_RADAR_Tx_311d9504 if post-build-variant-condition{matching-criterion=RDR_POS, value=2}, ComIPduGroupRef=RDR04_oPCAN_RADAR_Tx_cce46d71 if post-build-variant-condition{matching-criterion=RDR_POS, value=3}, ComIPduGroupRef=RDR05_oPCAN_RADAR_Tx_628cfce0 if post-build-variant-condition{matching-criterion=RDR_POS, value=4}, ComIPduGroupRef=RDR06_oPCAN_RADAR_Tx_4b444812 if post-build-variant-condition{matching-criterion=RDR_POS, value=5}, ComIPduGroupRef=RDR07_oPCAN_RADAR_Tx_e52cd983 if post-build-variant-condition{matching-criterion=RDR_POS, value=6}, ComIPduGroupRef=RDR08_oPCAN_RADAR_Tx_6bc6beb9 if post-build-variant-condition{matching-criterion=RDR_POS, value=7}
          ComTxIPdu: ComMinimumDelayTime=0, ComTxIPduUnusedAreasDefault=0
        RDR_TRACKER_OBJ_004_oPCAN_RADAR_33a84845_Tx: ComIPduDirection=SEND, ComIPduChannelRef=ComMConfigSet/CN_PCAN_RADAR_458ff0f1, ComIPduGroupRef=RDR01_oPCAN_RADAR_Tx_b6bdb067 if post-build-variant-condition{matching-criterion=RDR_POS, value=0}, ComIPduSignalGroupRef=SG_TrackerObject004_oRDR_TRACKER_OBJ_004_oPCAN_RADAR_0e1ad860_Tx, ComPduIdRef=EcucPduCollection/RDR_TRACKER_OBJ_004_oPCAN_RADAR_33a84845_Tx, ComIPduGroupRef=RDR02_oPCAN_RADAR_Tx_9f750495 if post-build-variant-condition{matching-criterion=RDR_POS, value=1}, ComIPduGroupRef=RDR03_oPCAN_RADAR_Tx_311d9504 if post-build-variant-condition{matching-criterion=RDR_POS, value=2}, ComIPduGroupRef=RDR04_oPCAN_RADAR_Tx_cce46d71 if post-build-variant-condition{matching-criterion=RDR_POS, value=3}, ComIPduGroupRef=RDR05_oPCAN_RADAR_Tx_628cfce0 if post-build-variant-condition{matching-criterion=RDR_POS, value=4}, ComIPduGroupRef=RDR06_oPCAN_RADAR_Tx_4b444812 if post-build-variant-condition{matching-criterion=RDR_POS, value=5}, ComIPduGroupRef=RDR07_oPCAN_RADAR_Tx_e52cd983 if post-build-variant-condition{matching-criterion=RDR_POS, value=6}, ComIPduGroupRef=RDR08_oPCAN_RADAR_Tx_6bc6beb9 if post-build-variant-condition{matching-criterion=RDR_POS, value=7}
          ComTxIPdu: ComMinimumDelayTime=0, ComTxIPduUnusedAreasDefault=0
        RDR_TRACKER_OBJ_005_oPCAN_RADAR_ee3e91c0_Tx: ComIPduDirection=SEND, ComIPduChannelRef=ComMConfigSet/CN_PCAN_RADAR_458ff0f1, ComIPduGroupRef=RDR01_oPCAN_RADAR_Tx_b6bdb067 if post-build-variant-condition{matching-criterion=RDR_POS, value=0}, ComIPduSignalGroupRef=SG_TrackerObject005_oRDR_TRACKER_OBJ_005_oPCAN_RADAR_f70e50d3_Tx, ComPduIdRef=EcucPduCollection/RDR_TRACKER_OBJ_005_oPCAN_RADAR_ee3e91c0_Tx, ComIPduGroupRef=RDR02_oPCAN_RADAR_Tx_9f750495 if post-build-variant-condition{matching-criterion=RDR_POS, value=1}, ComIPduGroupRef=RDR03_oPCAN_RADAR_Tx_311d9504 if post-build-variant-condition{matching-criterion=RDR_POS, value=2}, ComIPduGroupRef=RDR04_oPCAN_RADAR_Tx_cce46d71 if post-build-variant-condition{matching-criterion=RDR_POS, value=3}, ComIPduGroupRef=RDR05_oPCAN_RADAR_Tx_628cfce0 if post-build-variant-condition{matching-criterion=RDR_POS, value=4}, ComIPduGroupRef=RDR06_oPCAN_RADAR_Tx_4b444812 if post-build-variant-condition{matching-criterion=RDR_POS, value=5}, ComIPduGroupRef=RDR07_oPCAN_RADAR_Tx_e52cd983 if post-build-variant-condition{matching-criterion=RDR_POS, value=6}, ComIPduGroupRef=RDR08_oPCAN_RADAR_Tx_6bc6beb9 if post-build-variant-condition{matching-criterion=RDR_POS, value=7}
          ComTxIPdu: ComMinimumDelayTime=0, ComTxIPduUnusedAreasDefault=0
        RDR_TRACKER_OBJ_006_oPCAN_RADAR_53f4fd0e_Tx: ComIPduDirection=SEND, ComIPduChannelRef=ComMConfigSet/CN_PCAN_RADAR_458ff0f1, ComIPduGroupRef=RDR01_oPCAN_RADAR_Tx_b6bdb067 if post-build-variant-condition{matching-criterion=RDR_POS, value=0}, ComIPduSignalGroupRef=SG_TrackerObject006_oRDR_TRACKER_OBJ_006_oPCAN_RADAR_2742cf47_Tx, ComPduIdRef=EcucPduCollection/RDR_TRACKER_OBJ_006_oPCAN_RADAR_53f4fd0e_Tx, ComIPduGroupRef=RDR02_oPCAN_RADAR_Tx_9f750495 if post-build-variant-condition{matching-criterion=RDR_POS, value=1}, ComIPduGroupRef=RDR03_oPCAN_RADAR_Tx_311d9504 if post-build-variant-condition{matching-criterion=RDR_POS, value=2}, ComIPduGroupRef=RDR04_oPCAN_RADAR_Tx_cce46d71 if post-build-variant-condition{matching-criterion=RDR_POS, value=3}, ComIPduGroupRef=RDR05_oPCAN_RADAR_Tx_628cfce0 if post-build-variant-condition{matching-criterion=RDR_POS, value=4}, ComIPduGroupRef=RDR06_oPCAN_RADAR_Tx_4b444812 if post-build-variant-condition{matching-criterion=RDR_POS, value=5}, ComIPduGroupRef=RDR07_oPCAN_RADAR_Tx_e52cd983 if post-build-variant-condition{matching-criterion=RDR_POS, value=6}, ComIPduGroupRef=RDR08_oPCAN_RADAR_Tx_6bc6beb9 if post-build-variant-condition{matching-criterion=RDR_POS, value=7}
          ComTxIPdu: ComMinimumDelayTime=0, ComTxIPduUnusedAreasDefault=0
        RDR_TRACKER_OBJ_007_oPCAN_RADAR_8e62248b_Tx: ComIPduDirection=SEND, ComIPduChannelRef=ComMConfigSet/CN_PCAN_RADAR_458ff0f1, ComIPduGroupRef=RDR01_oPCAN_RADAR_Tx_b6bdb067 if post-build-variant-condition{matching-criterion=RDR_POS, value=0}, ComIPduSignalGroupRef=SG_TrackerObject007_oRDR_TRACKER_OBJ_007_oPCAN_RADAR_de5647f4_Tx, ComPduIdRef=EcucPduCollection/RDR_TRACKER_OBJ_007_oPCAN_RADAR_8e62248b_Tx, ComIPduGroupRef=RDR02_oPCAN_RADAR_Tx_9f750495 if post-build-variant-condition{matching-criterion=RDR_POS, value=1}, ComIPduGroupRef=RDR03_oPCAN_RADAR_Tx_311d9504 if post-build-variant-condition{matching-criterion=RDR_POS, value=2}, ComIPduGroupRef=RDR04_oPCAN_RADAR_Tx_cce46d71 if post-build-variant-condition{matching-criterion=RDR_POS, value=3}, ComIPduGroupRef=RDR05_oPCAN_RADAR_Tx_628cfce0 if post-build-variant-condition{matching-criterion=RDR_POS, value=4}, ComIPduGroupRef=RDR06_oPCAN_RADAR_Tx_4b444812 if post-build-variant-condition{matching-criterion=RDR_POS, value=5}, ComIPduGroupRef=RDR07_oPCAN_RADAR_Tx_e52cd983 if post-build-variant-condition{matching-criterion=RDR_POS, value=6}, ComIPduGroupRef=RDR08_oPCAN_RADAR_Tx_6bc6beb9 if post-build-variant-condition{matching-criterion=RDR_POS, value=7}
          ComTxIPdu: ComMinimumDelayTime=0, ComTxIPduUnusedAreasDefault=0
        RDR_TRACKER_OBJ_008_oPCAN_RADAR_a912f1be_Tx: ComIPduDirection=SEND, ComIPduChannelRef=ComMConfigSet/CN_PCAN_RADAR_458ff0f1, ComIPduGroupRef=RDR01_oPCAN_RADAR_Tx_b6bdb067 if post-build-variant-condition{matching-criterion=RDR_POS, value=0}, ComIPduSignalGroupRef=SG_TrackerObject008_oRDR_TRACKER_OBJ_008_oPCAN_RADAR_f9caaab2_Tx, ComPduIdRef=EcucPduCollection/RDR_TRACKER_OBJ_008_oPCAN_RADAR_a912f1be_Tx, ComIPduGroupRef=RDR02_oPCAN_RADAR_Tx_9f750495 if post-build-variant-condition{matching-criterion=RDR_POS, value=1}, ComIPduGroupRef=RDR03_oPCAN_RADAR_Tx_311d9504 if post-build-variant-condition{matching-criterion=RDR_POS, value=2}, ComIPduGroupRef=RDR04_oPCAN_RADAR_Tx_cce46d71 if post-build-variant-condition{matching-criterion=RDR_POS, value=3}, ComIPduGroupRef=RDR05_oPCAN_RADAR_Tx_628cfce0 if post-build-variant-condition{matching-criterion=RDR_POS, value=4}, ComIPduGroupRef=RDR06_oPCAN_RADAR_Tx_4b444812 if post-build-variant-condition{matching-criterion=RDR_POS, value=5}, ComIPduGroupRef=RDR07_oPCAN_RADAR_Tx_e52cd983 if post-build-variant-condition{matching-criterion=RDR_POS, value=6}, ComIPduGroupRef=RDR08_oPCAN_RADAR_Tx_6bc6beb9 if post-build-variant-condition{matching-criterion=RDR_POS, value=7}
          ComTxIPdu: ComMinimumDelayTime=0, ComTxIPduUnusedAreasDefault=0
        RDR_TRACKER_OBJ_009_oPCAN_RADAR_7484283b_Tx: ComIPduDirection=SEND, ComIPduChannelRef=ComMConfigSet/CN_PCAN_RADAR_458ff0f1, ComIPduGroupRef=RDR01_oPCAN_RADAR_Tx_b6bdb067 if post-build-variant-condition{matching-criterion=RDR_POS, value=0}, ComIPduSignalGroupRef=SG_TrackerObject009_oRDR_TRACKER_OBJ_009_oPCAN_RADAR_00de2201_Tx, ComPduIdRef=EcucPduCollection/RDR_TRACKER_OBJ_009_oPCAN_RADAR_7484283b_Tx, ComIPduGroupRef=RDR02_oPCAN_RADAR_Tx_9f750495 if post-build-variant-condition{matching-criterion=RDR_POS, value=1}, ComIPduGroupRef=RDR03_oPCAN_RADAR_Tx_311d9504 if post-build-variant-condition{matching-criterion=RDR_POS, value=2}, ComIPduGroupRef=RDR04_oPCAN_RADAR_Tx_cce46d71 if post-build-variant-condition{matching-criterion=RDR_POS, value=3}, ComIPduGroupRef=RDR05_oPCAN_RADAR_Tx_628cfce0 if post-build-variant-condition{matching-criterion=RDR_POS, value=4}, ComIPduGroupRef=RDR06_oPCAN_RADAR_Tx_4b444812 if post-build-variant-condition{matching-criterion=RDR_POS, value=5}, ComIPduGroupRef=RDR07_oPCAN_RADAR_Tx_e52cd983 if post-build-variant-condition{matching-criterion=RDR_POS, value=6}, ComIPduGroupRef=RDR08_oPCAN_RADAR_Tx_6bc6beb9 if post-build-variant-condition{matching-criterion=RDR_POS, value=7}
          ComTxIPdu: ComMinimumDelayTime=0, ComTxIPduUnusedAreasDefault=0
        RDR_TRACKER_OBJ_010_oPCAN_RADAR_6e1ec3a5_Tx: ComIPduDirection=SEND, ComIPduChannelRef=ComMConfigSet/CN_PCAN_RADAR_458ff0f1, ComIPduGroupRef=RDR01_oPCAN_RADAR_Tx_b6bdb067 if post-build-variant-condition{matching-criterion=RDR_POS, value=0}, ComIPduSignalGroupRef=SG_TrackerObject010_oRDR_TRACKER_OBJ_010_oPCAN_RADAR_0e3b0090_Tx, ComPduIdRef=EcucPduCollection/RDR_TRACKER_OBJ_010_oPCAN_RADAR_6e1ec3a5_Tx, ComIPduGroupRef=RDR02_oPCAN_RADAR_Tx_9f750495 if post-build-variant-condition{matching-criterion=RDR_POS, value=1}, ComIPduGroupRef=RDR03_oPCAN_RADAR_Tx_311d9504 if post-build-variant-condition{matching-criterion=RDR_POS, value=2}, ComIPduGroupRef=RDR04_oPCAN_RADAR_Tx_cce46d71 if post-build-variant-condition{matching-criterion=RDR_POS, value=3}, ComIPduGroupRef=RDR05_oPCAN_RADAR_Tx_628cfce0 if post-build-variant-condition{matching-criterion=RDR_POS, value=4}, ComIPduGroupRef=RDR06_oPCAN_RADAR_Tx_4b444812 if post-build-variant-condition{matching-criterion=RDR_POS, value=5}, ComIPduGroupRef=RDR07_oPCAN_RADAR_Tx_e52cd983 if post-build-variant-condition{matching-criterion=RDR_POS, value=6}, ComIPduGroupRef=RDR08_oPCAN_RADAR_Tx_6bc6beb9 if post-build-variant-condition{matching-criterion=RDR_POS, value=7}
          ComTxIPdu: ComMinimumDelayTime=0, ComTxIPduUnusedAreasDefault=0
        RDR_TRACKER_OBJ_011_oPCAN_RADAR_b3881a20_Tx: ComIPduDirection=SEND, ComIPduChannelRef=ComMConfigSet/CN_PCAN_RADAR_458ff0f1, ComIPduGroupRef=RDR01_oPCAN_RADAR_Tx_b6bdb067 if post-build-variant-condition{matching-criterion=RDR_POS, value=0}, ComIPduSignalGroupRef=SG_TrackerObject011_oRDR_TRACKER_OBJ_011_oPCAN_RADAR_f72f8823_Tx, ComPduIdRef=EcucPduCollection/RDR_TRACKER_OBJ_011_oPCAN_RADAR_b3881a20_Tx, ComIPduGroupRef=RDR02_oPCAN_RADAR_Tx_9f750495 if post-build-variant-condition{matching-criterion=RDR_POS, value=1}, ComIPduGroupRef=RDR03_oPCAN_RADAR_Tx_311d9504 if post-build-variant-condition{matching-criterion=RDR_POS, value=2}, ComIPduGroupRef=RDR04_oPCAN_RADAR_Tx_cce46d71 if post-build-variant-condition{matching-criterion=RDR_POS, value=3}, ComIPduGroupRef=RDR05_oPCAN_RADAR_Tx_628cfce0 if post-build-variant-condition{matching-criterion=RDR_POS, value=4}, ComIPduGroupRef=RDR06_oPCAN_RADAR_Tx_4b444812 if post-build-variant-condition{matching-criterion=RDR_POS, value=5}, ComIPduGroupRef=RDR07_oPCAN_RADAR_Tx_e52cd983 if post-build-variant-condition{matching-criterion=RDR_POS, value=6}, ComIPduGroupRef=RDR08_oPCAN_RADAR_Tx_6bc6beb9 if post-build-variant-condition{matching-criterion=RDR_POS, value=7}
          ComTxIPdu: ComMinimumDelayTime=0, ComTxIPduUnusedAreasDefault=0
        RDR_TRACKER_OBJ_012_oPCAN_RADAR_0e4276ee_Tx: ComIPduDirection=SEND, ComIPduChannelRef=ComMConfigSet/CN_PCAN_RADAR_458ff0f1, ComIPduGroupRef=RDR01_oPCAN_RADAR_Tx_b6bdb067 if post-build-variant-condition{matching-criterion=RDR_POS, value=0}, ComIPduSignalGroupRef=SG_TrackerObject012_oRDR_TRACKER_OBJ_012_oPCAN_RADAR_276317b7_Tx, ComPduIdRef=EcucPduCollection/RDR_TRACKER_OBJ_012_oPCAN_RADAR_0e4276ee_Tx, ComIPduGroupRef=RDR02_oPCAN_RADAR_Tx_9f750495 if post-build-variant-condition{matching-criterion=RDR_POS, value=1}, ComIPduGroupRef=RDR03_oPCAN_RADAR_Tx_311d9504 if post-build-variant-condition{matching-criterion=RDR_POS, value=2}, ComIPduGroupRef=RDR04_oPCAN_RADAR_Tx_cce46d71 if post-build-variant-condition{matching-criterion=RDR_POS, value=3}, ComIPduGroupRef=RDR05_oPCAN_RADAR_Tx_628cfce0 if post-build-variant-condition{matching-criterion=RDR_POS, value=4}, ComIPduGroupRef=RDR06_oPCAN_RADAR_Tx_4b444812 if post-build-variant-condition{matching-criterion=RDR_POS, value=5}, ComIPduGroupRef=RDR07_oPCAN_RADAR_Tx_e52cd983 if post-build-variant-condition{matching-criterion=RDR_POS, value=6}, ComIPduGroupRef=RDR08_oPCAN_RADAR_Tx_6bc6beb9 if post-build-variant-condition{matching-criterion=RDR_POS, value=7}
          ComTxIPdu: ComMinimumDelayTime=0, ComTxIPduUnusedAreasDefault=0
        RDR_TRACKER_OBJ_013_oPCAN_RADAR_d3d4af6b_Tx: ComIPduDirection=SEND, ComIPduChannelRef=ComMConfigSet/CN_PCAN_RADAR_458ff0f1, ComIPduGroupRef=RDR01_oPCAN_RADAR_Tx_b6bdb067 if post-build-variant-condition{matching-criterion=RDR_POS, value=0}, ComIPduSignalGroupRef=SG_TrackerObject013_oRDR_TRACKER_OBJ_013_oPCAN_RADAR_de779f04_Tx, ComPduIdRef=EcucPduCollection/RDR_TRACKER_OBJ_013_oPCAN_RADAR_d3d4af6b_Tx, ComIPduGroupRef=RDR02_oPCAN_RADAR_Tx_9f750495 if post-build-variant-condition{matching-criterion=RDR_POS, value=1}, ComIPduGroupRef=RDR03_oPCAN_RADAR_Tx_311d9504 if post-build-variant-condition{matching-criterion=RDR_POS, value=2}, ComIPduGroupRef=RDR04_oPCAN_RADAR_Tx_cce46d71 if post-build-variant-condition{matching-criterion=RDR_POS, value=3}, ComIPduGroupRef=RDR05_oPCAN_RADAR_Tx_628cfce0 if post-build-variant-condition{matching-criterion=RDR_POS, value=4}, ComIPduGroupRef=RDR06_oPCAN_RADAR_Tx_4b444812 if post-build-variant-condition{matching-criterion=RDR_POS, value=5}, ComIPduGroupRef=RDR07_oPCAN_RADAR_Tx_e52cd983 if post-build-variant-condition{matching-criterion=RDR_POS, value=6}, ComIPduGroupRef=RDR08_oPCAN_RADAR_Tx_6bc6beb9 if post-build-variant-condition{matching-criterion=RDR_POS, value=7}
          ComTxIPdu: ComMinimumDelayTime=0, ComTxIPduUnusedAreasDefault=0
        RDR_TRACKER_OBJ_014_oPCAN_RADAR_aea7a933_Tx: ComIPduDirection=SEND, ComIPduChannelRef=ComMConfigSet/CN_PCAN_RADAR_458ff0f1, ComIPduGroupRef=RDR01_oPCAN_RADAR_Tx_b6bdb067 if post-build-variant-condition{matching-criterion=RDR_POS, value=0}, ComIPduSignalGroupRef=SG_TrackerObject014_oRDR_TRACKER_OBJ_014_oPCAN_RADAR_5c8b2ede_Tx, ComPduIdRef=EcucPduCollection/RDR_TRACKER_OBJ_014_oPCAN_RADAR_aea7a933_Tx, ComIPduGroupRef=RDR02_oPCAN_RADAR_Tx_9f750495 if post-build-variant-condition{matching-criterion=RDR_POS, value=1}, ComIPduGroupRef=RDR03_oPCAN_RADAR_Tx_311d9504 if post-build-variant-condition{matching-criterion=RDR_POS, value=2}, ComIPduGroupRef=RDR04_oPCAN_RADAR_Tx_cce46d71 if post-build-variant-condition{matching-criterion=RDR_POS, value=3}, ComIPduGroupRef=RDR05_oPCAN_RADAR_Tx_628cfce0 if post-build-variant-condition{matching-criterion=RDR_POS, value=4}, ComIPduGroupRef=RDR06_oPCAN_RADAR_Tx_4b444812 if post-build-variant-condition{matching-criterion=RDR_POS, value=5}, ComIPduGroupRef=RDR07_oPCAN_RADAR_Tx_e52cd983 if post-build-variant-condition{matching-criterion=RDR_POS, value=6}, ComIPduGroupRef=RDR08_oPCAN_RADAR_Tx_6bc6beb9 if post-build-variant-condition{matching-criterion=RDR_POS, value=7}
          ComTxIPdu: ComMinimumDelayTime=0, ComTxIPduUnusedAreasDefault=0
        RDR_TRACKER_OBJ_015_oPCAN_RADAR_733170b6_Tx: ComIPduDirection=SEND, ComIPduChannelRef=ComMConfigSet/CN_PCAN_RADAR_458ff0f1, ComIPduGroupRef=RDR01_oPCAN_RADAR_Tx_b6bdb067 if post-build-variant-condition{matching-criterion=RDR_POS, value=0}, ComIPduSignalGroupRef=SG_TrackerObject015_oRDR_TRACKER_OBJ_015_oPCAN_RADAR_a59fa66d_Tx, ComPduIdRef=EcucPduCollection/RDR_TRACKER_OBJ_015_oPCAN_RADAR_733170b6_Tx, ComIPduGroupRef=RDR02_oPCAN_RADAR_Tx_9f750495 if post-build-variant-condition{matching-criterion=RDR_POS, value=1}, ComIPduGroupRef=RDR03_oPCAN_RADAR_Tx_311d9504 if post-build-variant-condition{matching-criterion=RDR_POS, value=2}, ComIPduGroupRef=RDR04_oPCAN_RADAR_Tx_cce46d71 if post-build-variant-condition{matching-criterion=RDR_POS, value=3}, ComIPduGroupRef=RDR05_oPCAN_RADAR_Tx_628cfce0 if post-build-variant-condition{matching-criterion=RDR_POS, value=4}, ComIPduGroupRef=RDR06_oPCAN_RADAR_Tx_4b444812 if post-build-variant-condition{matching-criterion=RDR_POS, value=5}, ComIPduGroupRef=RDR07_oPCAN_RADAR_Tx_e52cd983 if post-build-variant-condition{matching-criterion=RDR_POS, value=6}, ComIPduGroupRef=RDR08_oPCAN_RADAR_Tx_6bc6beb9 if post-build-variant-condition{matching-criterion=RDR_POS, value=7}
          ComTxIPdu: ComMinimumDelayTime=0, ComTxIPduUnusedAreasDefault=0
